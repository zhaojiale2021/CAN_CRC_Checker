VERSION "Version"

NS_ :

BS_:

BU_: CCU ADC FAPA IFC FLR FRR RRR RLR INU Tester CBM VIU SRS IDC PCS AMP IMR FIMR TBOX IBCS IXCU V2XOBU WHUD RLBMS CCURT2 RT2_C3 OTAWL ZCUF ZCUL ZCUR ZCUT IPS DCU NIDU RBM WACUFL IID CCURT1 RT1_C0 RT1_C1 AVAS FLLCM FRLCM RLLCMA RRLCMA RLLCMB RRLCMB LBMS LBMSAD MFS FCP IDU ITS BCB DCDC PCU EOP DCU2 BMS TMC EPS ECS CD PAS SBM WCM ETC TBOX2 DSM FLPDM FRPDM RLPDM RRPDM HVSMR SCMRL SCMRR EBU EPB VDC EVCC ADM PLGM FBLCM RLISD RRISD RCP RFR WCMFR SCMR TFOAR TROAR HVSPRL HVSPRR

BO_ 615 CCU_BCS_1_C: 64 CCU
 SG_ BCS_1_CRC : 7|16@0+ (1,0) [0|65535] ""  ZCUF,ZCUT,DCU,NIDU,IXCU,IDC,ADC,FAPA,FLR,FRR,RLR,RRR,VIU,IFC,INU
 SG_ BCS_1_Counter : 23|8@0+ (1,0) [0|255] ""  ZCUF,ZCUT,DCU,NIDU,IXCU,IDC,ADC,FAPA,FLR,FRR,RLR,RRR,VIU,IFC,INU
 SG_ BCS_FLWheelSpd : 31|13@0+ (0.05625,0) [0|240] "km/h"  ZCUF,ZCUT,DCU,DCU2,NIDU,IXCU,IDC,ADC,FAPA,FLR,FRR,RLR,RRR,VIU,IFC,PCS,INU
 SG_ BCS_FLWheelSpdVD : 34|1@0+ (1,0) [0|1] ""  ZCUF,ZCUT,DCU,NIDU,IXCU,ADC,FAPA,FLR,FRR,RLR,RRR,VIU,IFC,PCS,INU
 SG_ BCS_FLWheelRotatedDirection : 33|1@0+ (1,0) [0|1] ""  IDC,ADC,FAPA,FLR,FRR,RLR,RRR,VIU,IFC,PCS,INU
 SG_ BCS_FLWheelRotatedDirectionVD : 32|1@0+ (1,0) [0|1] ""  ADC,FAPA,FLR,FRR,RLR,RRR,VIU,IFC,PCS,INU
 SG_ BCS_FRWheelSpd : 47|13@0+ (0.05625,0) [0|240] "km/h"  ZCUF,ZCUT,DCU,DCU2,NIDU,IXCU,IDC,ADC,FAPA,FLR,FRR,RLR,RRR,VIU,IFC,PCS,INU
 SG_ BCS_FRWheelSpdVD : 50|1@0+ (1,0) [0|1] ""  ZCUF,ZCUT,DCU,NIDU,IXCU,ADC,FAPA,FLR,FRR,RLR,RRR,VIU,IFC,PCS,INU
 SG_ BCS_FRWheelRotatedDirection : 49|1@0+ (1,0) [0|1] ""  IDC,ADC,FAPA,FLR,FRR,RLR,RRR,VIU,IFC,PCS,INU
 SG_ BCS_FRWheelRotatedDirectionVD : 48|1@0+ (1,0) [0|1] ""  ADC,FAPA,FLR,FRR,RLR,RRR,VIU,IFC,PCS,INU
 SG_ BCS_RLWheelSpd : 63|13@0+ (0.05625,0) [0|240] "km/h"  ZCUF,ZCUT,DCU,DCU2,NIDU,IXCU,IDC,ADC,FAPA,FLR,FRR,RLR,RRR,VIU,IFC,PCS,INU
 SG_ BCS_RLWheelSpdVD : 66|1@0+ (1,0) [0|1] ""  ZCUF,ZCUT,DCU,NIDU,IXCU,ADC,FAPA,FLR,FRR,RLR,RRR,VIU,IFC,PCS,INU
 SG_ BCS_RLWheelRotatedDirection : 65|1@0+ (1,0) [0|1] ""  IDC,ADC,FAPA,FLR,FRR,RLR,RRR,VIU,IFC,PCS,INU
 SG_ BCS_RLWheelRotatedDirectionVD : 64|1@0+ (1,0) [0|1] ""  ADC,FAPA,FLR,FRR,RLR,RRR,VIU,IFC,PCS,INU
 SG_ BCS_RRWheelSpd : 79|13@0+ (0.05625,0) [0|240] "km/h"  ZCUF,ZCUT,DCU,DCU2,NIDU,IXCU,IDC,ADC,FAPA,FLR,FRR,RLR,RRR,VIU,IFC,PCS,INU
 SG_ BCS_RRWheelSpdVD : 82|1@0+ (1,0) [0|1] ""  ZCUF,ZCUT,DCU,NIDU,IXCU,ADC,FAPA,FLR,FRR,RLR,RRR,VIU,IFC,PCS,INU
 SG_ BCS_RRWheelRotatedDirection : 81|1@0+ (1,0) [0|1] ""  IDC,ADC,FAPA,FLR,FRR,RLR,RRR,VIU,IFC,PCS,INU
 SG_ BCS_RRWheelRotatedDirectionVD : 80|1@0+ (1,0) [0|1] ""  ADC,FAPA,FLR,FRR,RLR,RRR,VIU,IFC,PCS,INU
 SG_ BCS_HHCCtrlSt : 95|1@0+ (1,0) [0|1] ""  DCU,DCU2,NIDU,IXCU,ADC,FAPA,VIU,IFC
 SG_ BCS_HDCCtrlSt : 93|2@0+ (1,0) [0|3] ""  DCU,DCU2,NIDU,IXCU,IDC,ADC,FAPA,FLR,FRR,RLR,RRR,VIU,IFC
 SG_ BCS_HDCErrSt : 91|1@0+ (1,0) [0|1] ""  IDC,ADC,FAPA,FLR,FRR,RLR,RRR,VIU,IFC
 SG_ BCS_FLWheelSpdEdgesSum : 103|12@0+ (1,0) [0|4095] ""  ZCUF,ZCUT,IDC,ADC,FAPA,FLR,FRR,RLR,RRR,VIU,IFC,PAS,PCS
 SG_ BCS_FRWheelSpdEdgesSum : 107|12@0+ (1,0) [0|4095] ""  ZCUF,ZCUT,IDC,ADC,FAPA,FLR,FRR,RLR,RRR,VIU,IFC,PAS,PCS
 SG_ BCS_RLWheelSpdEdgesSum : 127|12@0+ (1,0) [0|4095] ""  ZCUF,ZCUT,IDC,ADC,FAPA,FLR,FRR,RLR,RRR,VIU,IFC,PAS,PCS
 SG_ BCS_RRWheelSpdEdgesSum : 131|12@0+ (1,0) [0|4095] ""  ZCUF,ZCUT,IDC,ADC,FAPA,FLR,FRR,RLR,RRR,VIU,IFC,PAS,PCS
 SG_ BCS_FLWheelSpdEdgesSumVD : 151|1@0+ (1,0) [0|1] ""  ZCUF,ZCUT,IDC,ADC,FAPA,FLR,FRR,RLR,RRR,VIU,IFC,PAS,PCS
 SG_ BCS_FRWheelSpdEdgesSumVD : 150|1@0+ (1,0) [0|1] ""  ZCUF,ZCUT,ADC,FAPA,FLR,FRR,RLR,RRR,VIU,IFC,PAS,PCS
 SG_ BCS_RLWheelSpdEdgesSumVD : 149|1@0+ (1,0) [0|1] ""  ZCUF,ZCUT,IDC,ADC,FAPA,FLR,FRR,RLR,RRR,VIU,IFC,PAS,PCS
 SG_ BCS_RRWheelSpdEdgesSumVD : 148|1@0+ (1,0) [0|1] ""  ZCUF,ZCUT,ADC,FAPA,FLR,FRR,RLR,RRR,VIU,IFC,PAS,PCS
 SG_ BCS_FLWheelRotatedDirectionAPA : 147|2@0+ (1,0) [0|3] ""  ADC,FAPA,VIU,IFC,PAS
 SG_ BCS_FRWheelRotatedDirectionAPA : 145|2@0+ (1,0) [0|3] ""  ADC,FAPA,VIU,IFC,PAS
 SG_ BCS_RLWheelRotatedDirectionAPA : 159|2@0+ (1,0) [0|3] ""  ADC,FAPA,VIU,IFC,PAS
 SG_ BCS_RRWheelRotatedDirectionAPA : 157|2@0+ (1,0) [0|3] ""  ADC,FAPA,VIU,IFC,PAS
 SG_ BCS_ParkingReqToEPB : 155|2@0+ (1,0) [0|3] ""  ZCUF,ZCUT,ADC,FAPA,VIU,IFC
 SG_ BCS_VDCOff : 153|1@0+ (1,0) [0|1] ""  SRS,IDC,ADC,FAPA,FLR,FRR,VIU,IFC
 SG_ BCS_AVHSt : 152|1@0+ (1,0) [0|1] ""  ZCUF,ZCUR,ZCUT,DCU,DCU2,NIDU,IXCU,IDC,ADC,FAPA,VIU,IFC,SBM
 SG_ BCS_AVHStandby : 167|1@0+ (1,0) [0|1] ""  ZCUF,ZCUT,IDC,ADC,FAPA,IFC
 SG_ BCS_AVHAvailable : 166|1@0+ (1,0) [0|1] ""  ZCUF,ZCUT,IDC,ADC,FAPA,IFC
 SG_ BCS_TCSOff : 165|1@0+ (1,0) [0|1] ""  SRS,IDC,ADC,FAPA,FLR,FRR,VIU,IFC
 SG_ BCS_BrkPdlPstVD : 163|1@0+ (1,0) [0|1] ""  SRS,ADC,FAPA,VIU
 SG_ BCS_NoBrakeForce : 161|1@0+ (1,0) [0|1] ""  ADC,FAPA,VIU,IFC
 SG_ BCS_BrakeOverHeat : 160|1@0+ (1,0) [0|1] ""  ADC,FAPA,VIU,IFC
 SG_ BCS_ABAactive : 175|1@0+ (1,0) [0|1] ""  ADC,FAPA,VIU,IFC
 SG_ BCS_ABAavailable : 174|1@0+ (1,0) [0|1] ""  ADC,FAPA,VIU,IFC
 SG_ BCS_ABPActive : 173|1@0+ (1,0) [0|1] ""  ADC,FAPA,VIU,IFC
 SG_ BCS_ABPAvailable : 172|1@0+ (1,0) [0|1] ""  ADC,FAPA,VIU,IFC
 SG_ BCS_AEBActive : 171|1@0+ (1,0) [0|1] ""  DCU,NIDU,IXCU,ADC,FAPA,FLR,FRR,VIU,IFC,TBOX
 SG_ BCS_AEBAvailable : 170|1@0+ (1,0) [0|1] ""  ADC,FAPA,FLR,FRR,VIU,IFC,TBOX
 SG_ BCS_AWBActive : 169|1@0+ (1,0) [0|1] ""  ADC,FAPA,VIU,IFC
 SG_ BCS_AWBAvailable : 168|1@0+ (1,0) [0|1] ""  ADC,FAPA,VIU,IFC
 SG_ BCS_BrkPdlPst : 191|8@0+ (0.392,0) [0|99.96] "%"  SRS,ADC,FAPA,VIU
 SG_ BCS_VehicleStandStillSt : 180|2@0+ (1,0) [0|3] ""  ADC,FAPA,VIU,IFC
 SG_ BCS_AEBBAActive : 178|1@0+ (1,0) [0|1] ""  ADC,FAPA,VIU,IFC
 SG_ BCS_2ParkDrvBrkOverrideFlg : 201|2@0+ (1,0) [0|3] ""  ADC,FAPA,VIU,IFC
 SG_ IPB_InputRodStroke : 363|10@0+ (0.05,-5) [-5|46.15] "mm"  DCU,DCU2,NIDU,IXCU,IDC,AMP,ADC,FAPA,VIU,IFC
 SG_ IPB_InputRodStrokeSt : 379|1@0+ (1,0) [0|1] ""  DCU,NIDU,IXCU,IDC,AMP,ADC,FAPA,VIU,IFC
 SG_ BCS_RAEBActive : 378|1@0+ (1,0) [0|1] ""  ADC,FAPA,VIU
 SG_ BCS_RAEBAvailable : 377|1@0+ (1,0) [0|1] ""  ADC,FAPA,VIU
 SG_ BCS_DrvModeAvailable : 380|1@0+ (1,0) [0|1] ""  IDC,ADC
 SG_ BCS_DrvMode : 383|3@0+ (1,0) [0|7] ""  IDC,ADC
 SG_ IPB_PlungerPressure : 391|12@0+ (0.3,-5) [-5|301.9] "bar"  ZCUF,ZCUT,DCU,DCU2,NIDU,RBM,IXCU,ADC,FAPA,FLR,FRR,RLR,RRR,VIU,IFC
 SG_ IPB_PlungerPressureSt : 376|1@0+ (1,0) [0|1] ""  ZCUF,ZCUT,DCU,NIDU,RBM,IXCU,ADC,FAPA,FLR,FRR,RLR,RRR,VIU,IFC

BO_ 352 CCU_BCS_2_C: 64 CCU
 SG_ BCS_2_CRC : 7|16@0+ (1,0) [0|65535] ""  ZCUF,ZCUL,ZCUR,ZCUT,DCU,NIDU,BMS,IXCU,IDC,ADC,FAPA,FLR,FRR,RLR,RRR,VIU,IFC,INU
 SG_ BCS_2_Counter : 23|8@0+ (1,0) [0|255] ""  ZCUF,ZCUL,ZCUR,ZCUT,DCU,NIDU,BMS,IXCU,IDC,ADC,FAPA,FLR,FRR,RLR,RRR,VIU,IFC,INU
 SG_ BCS_VehSpd : 31|13@0+ (0.05625,0) [0|240] "km/h"  OTAWL,ZCUF,ZCUL,ZCUR,ZCUT,LBMS,MFS,FCP,IDU,ITS,PCU,DCU,DCU2,NIDU,BMS,TMC,IXCU,IDC,IID,AMP,IMR,FIMR,ADC,FAPA,FLR,FRR,RLR,RRR,VIU,IFC,PAS,PCS,INU
 SG_ BCS_VehSpdVD : 34|1@0+ (1,0) [0|1] ""  OTAWL,ZCUF,ZCUL,ZCUR,ZCUT,LBMS,MFS,FCP,IDU,ITS,PCU,DCU,NIDU,BMS,TMC,IXCU,IDC,IID,AMP,IMR,FIMR,ADC,FAPA,FLR,FRR,RLR,RRR,VIU,IFC,PAS,INU
 SG_ BCS_EBDActiveSt : 32|1@0+ (1,0) [0|1] ""  ZCUF,ZCUT,DCU,NIDU,IXCU,ADC,FAPA,FLR,FRR,IFC
 SG_ BCS_EBDFaultSt : 47|1@0+ (1,0) [0|1] ""  ZCUF,ZCUT,DCU,NIDU,IXCU,IDC,ADC,FAPA,VIU,IFC
 SG_ BCS_ABSActiveSt : 46|1@0+ (1,0) [0|1] ""  ZCUF,ZCUT,DCU,DCU2,NIDU,IXCU,ADC,FAPA,FLR,FRR,VIU,IFC,TBOX
 SG_ BCS_ABSFaultSt : 45|1@0+ (1,0) [0|1] ""  ZCUF,ZCUT,DCU,NIDU,IXCU,IDC,ADC,FAPA,VIU,IFC
 SG_ BCS_TCSActiveSt : 44|1@0+ (1,0) [0|1] ""  ZCUF,ZCUT,DCU,DCU2,NIDU,IXCU,IDC,ADC,FAPA,FLR,FRR,VIU,IFC
 SG_ BCS_TCSFaultSt : 43|1@0+ (1,0) [0|1] ""  ZCUF,ZCUT,DCU,NIDU,IXCU,IDC,ADC,FAPA,VIU,IFC
 SG_ BCS_VDCActiveSt : 42|1@0+ (1,0) [0|1] ""  ZCUF,ZCUT,DCU,DCU2,NIDU,IXCU,IDC,ADC,FAPA,FLR,FRR,VIU,IFC,PCS
 SG_ BCS_VDCFaultSt : 41|1@0+ (1,0) [0|1] ""  ZCUF,ZCUT,DCU,NIDU,IXCU,IDC,ADC,FAPA,VIU,IFC
 SG_ BCS_EngTorqDecActiveSt : 71|1@0+ (1,0) [0|1] ""  ZCUF,ZCUT,DCU,DCU2,NIDU,IXCU,ADC,FAPA,VIU,IFC
 SG_ BCS_EngTorqIncActiveSt : 69|1@0+ (1,0) [0|1] ""  ADC,FAPA,VIU,IFC
 SG_ BCS_RegenModulationAvailable : 64|1@0+ (1,0) [0|1] ""  ADC,FAPA,VIU,IFC
 SG_ BCS_RegenModuleActive : 79|1@0+ (1,0) [0|1] ""  DCU,DCU2,NIDU,IXCU,ADC,FAPA,VIU,IFC
 SG_ BCS_EngTorqDecFastRANm : 55|16@0+ (1,-30000) [-30000|30000] "Nm"  ADC,FAPA,IFC
 SG_ BCS_EngTorqIncRANm : 77|14@0+ (1,-6000) [-6000|10380] "Nm"  ADC,FAPA,IFC
 SG_ BCS_RealTCSActiveSt : 95|1@0+ (1,0) [0|1] ""  ADC,FAPA,VIU
 SG_ BCS_TargetRecpTorqRq : 93|14@0+ (1,-6000) [-6000|6000] "Nm"  ADC,FAPA,VIU,IFC
 SG_ BCS_TargetRecpTorqRqSt : 111|2@0+ (1,0) [0|3] ""  ADC,FAPA,VIU,IFC
 SG_ BCS_CrbsActive : 105|1@0+ (1,0) [0|1] ""  ADC,FAPA,IFC
 SG_ BCS_EngTorqDecFastFA : 189|8@0+ (0.392,0) [0|99.96] "%"  ADC,FAPA,IFC
 SG_ BCS_TargetRecpTorqRqFA : 197|14@0+ (1,-6000) [-6000|6000] "Nm"  ADC,FAPA,IFC
 SG_ BCS_TargetRecpTorqRqFASt : 215|2@0+ (1,0) [0|3] ""  ADC,FAPA,IFC
 SG_ BCS_TargetRecpTorqRqRA : 213|14@0+ (1,-6000) [-6000|6000] "Nm"  ADC,FAPA,IFC
 SG_ BCS_TargetRecpTorqRqRASt : 231|2@0+ (1,0) [0|3] ""  ADC,FAPA,IFC
 SG_ IPB_BrakePedalSt : 227|2@0+ (1,0) [0|3] ""  ZCUF,ZCUT,IDC,ADC,FAPA,FLR,FRR,VIU,IFC
 SG_ IPB_BrakePedalStsVld : 224|1@0+ (1,0) [0|1] ""  ADC,FAPA,IFC
 SG_ BCS_ESP2Park_DrvBrkOverrideFlg : 234|1@0+ (1,0) [0|1] ""  ZCUF,ZCUT,ADC,FAPA,VIU,IFC
 SG_ BCS_EngTorqDecActiveStRA : 233|1@0+ (1,0) [0|1] ""  DCU,DCU2,NIDU,IXCU,ADC,FAPA,VIU,IFC
 SG_ BCS_EngTorqIncActiveStRA : 232|1@0+ (1,0) [0|1] ""  ADC,FAPA,VIU,IFC
 SG_ BCS_EngTorqIncActiveStFA : 239|1@0+ (1,0) [0|1] ""  ADC,FAPA,IFC
 SG_ BCS_EngTorqDecFastRA : 247|8@0+ (0.392,0) [0|99.96] "%"  ADC,FAPA,VIU,IFC
 SG_ BCS_EngTorqIncRA : 255|8@0+ (0.392,0) [0|99.96] "%"  ADC,FAPA,VIU,IFC
 SG_ BCS_EngTorqDecActiveStFA : 275|1@0+ (1,0) [0|1] ""  DCU2,ADC,FAPA,IFC
 SG_ BCS_PrimBrkCDAAvailableSt : 274|3@0+ (1,0) [0|7] ""  RBM,ADC,FAPA,VIU,IFC
 SG_ BCS_PrimBrkCommuniSt : 287|1@0+ (1,0) [0|1] ""  RBM,ADC,FAPA,VIU,IFC
 SG_ BCS_PrimBrkActiveSt : 286|2@0+ (1,0) [0|3] ""  ZCUF,ZCUT,RBM,ADC,FAPA,VIU,IFC
 SG_ BCS_2ParkDynamicAVPavailability : 282|2@0+ (1,0) [0|3] ""  ADC,FAPA,VIU
 SG_ BCS_2ParkCddApActiveVehHld : 280|1@0+ (1,0) [0|1] ""  ADC,FAPA,IFC
 SG_ BCS_2ParkAPCStatus : 311|3@0+ (1,0) [0|7] ""  ZCUF,ZCUT,ADC,FAPA,VIU,IFC
 SG_ BCS_2ParkAPAavailability : 308|3@0+ (1,0) [0|7] ""  ADC,FAPA,VIU,IFC
 SG_ BCS_2ParkRPAAVPavailability : 305|2@0+ (1,0) [0|3] ""  ZCUF,ZCUT,ADC,FAPA,VIU,IFC
 SG_ BCS_2ParkAPCFailureSts : 319|3@0+ (1,0) [0|7] ""  ADC,FAPA,VIU,IFC
 SG_ BCS_APCMain2BackupReq : 316|1@0+ (1,0) [0|1] ""  ZCUF,ZCUT,ADC,FAPA,VIU,IFC
 SG_ BCS_PrimBrkCtrlUsedChannel : 315|2@0+ (1,0) [0|3] ""  ADC,FAPA,VIU,IFC
 SG_ BCS_PrimBrkCDAActiveSt : 313|1@0+ (1,0) [0|1] ""  ZCUF,ZCUT,ADC,FAPA,IFC
 SG_ BCS_PrimBrkDecCtrlActiveSt : 312|1@0+ (1,0) [0|1] ""  ADC,FAPA,VIU,IFC
 SG_ BCS_PrimBrkCDDAvailableSt : 330|2@0+ (1,0) [0|3] ""  ZCUF,ZCUT,ADC,FAPA,VIU
 SG_ BCS_EngTorqIncFA : 432|8@0+ (0.392,0) [0|99.96] "%"  ADC,FAPA,IFC

BO_ 611 CCU_BCS_3_C: 64 CCU
 SG_ BCS_HydBrkActvTq_FL_1 : 103|16@0+ (1,-32768) [-32768|32767] "Nm"  ADC
 SG_ BCS_HydBrkActvTq_FR_1 : 119|16@0+ (1,-32768) [-32768|32767] "Nm"  ADC
 SG_ BCS_HydBrkActvTq_RL_1 : 135|16@0+ (1,-32768) [-32768|32767] "Nm"  ADC
 SG_ BCS_HydBrkActvTq_RR_1 : 151|16@0+ (1,-32768) [-32768|32767] "Nm"  ADC
 SG_ BCS_PrimCommPathSt : 200|1@0+ (1,0) [0|1] ""  ADC
 SG_ BCS_SeconCommPathSt : 201|1@0+ (1,0) [0|1] ""  ADC
 SG_ BCS_PressureHldSt : 202|1@0+ (1,0) [0|1] ""  ADC
 SG_ BCS_CDDFuncSt : 203|1@0+ (1,0) [0|1] ""  ADC
 SG_ IPB_SimulatorPressure : 199|12@0+ (0.3,-5) [-5|301.9] "bar"  ADC,FAPA,IFC
 SG_ IPB_SimulatorPressureSt : 223|1@0+ (1,0) [0|1] ""  ADC,FAPA,IFC
 SG_ IBCS_SystemSt : 226|3@0+ (1,0) [0|7] ""  IDC,ADC,FAPA,IFC
 SG_ IBCS_FWAWarning : 239|2@0+ (1,0) [0|3] ""  IDC,ADC,FAPA,IFC
 SG_ IPB_CSTSt : 233|2@0+ (1,0) [0|3] ""  IDC,ADC,FAPA,IFC
 SG_ BCS_AVDCActive : 240|1@0+ (1,0) [0|1] ""  ADC,FAPA,IFC
 SG_ BCS_AVDCAvailable : 241|1@0+ (1,0) [0|1] ""  ADC,FAPA,IFC

BO_ 360 CCU_BCS_6_C: 64 CCU
 SG_ BCS_6_CRC : 7|16@0+ (1,0) [0|65535] ""  ADC,FAPA,IFC
 SG_ BCS_6_Counter : 23|8@0+ (1,0) [0|255] ""  ADC,FAPA,IFC
 SG_ BCS_HydBrkActvTq_FL : 31|16@0+ (1,-32768) [-32768|32767] "Nm"  ADC,FAPA,IFC
 SG_ BCS_HydBrkActvTq_FR : 47|16@0+ (1,-32768) [-32768|32767] "Nm"  ADC,FAPA,IFC
 SG_ BCS_HydBrkActvTq_RL : 63|16@0+ (1,-32768) [-32768|32767] "Nm"  ADC,FAPA,IFC
 SG_ BCS_HydBrkActvTq_RR : 79|16@0+ (1,-32768) [-32768|32767] "Nm"  ADC,FAPA,IFC
 SG_ BCS_HydBrkReqTq : 95|16@0+ (1,-32768) [-32768|32767] "Nm"  ADC,FAPA,IFC
 SG_ BCS_BrkActvTq : 111|16@0+ (1,-32768) [-32768|32767] "Nm"  ADC,FAPA,IFC
 SG_ BCS_HydBrkActvTq : 127|16@0+ (1,-32768) [-32768|32767] "Nm"  ADC,FAPA,IFC
 SG_ BCS_DycESCActTq : 143|16@0+ (1,-32768) [-32768|32767] "Nm"  ADC,FAPA,IFC
 SG_ BCS_BrkTqCtrlAvlDriving : 159|3@0+ (1,0) [0|7] ""  ADC,FAPA,IFC
 SG_ BCS_BrkTqCtrlAvlParking : 173|2@0+ (1,0) [0|3] ""  ADC,FAPA,IFC
 SG_ BCS_BrkTqCtrlActv : 175|2@0+ (1,0) [0|3] ""  ADC,FAPA,IFC
 SG_ BCS_DycEscTarTqCtrlAvl : 191|1@0+ (1,0) [0|1] ""  ADC,FAPA,IFC
 SG_ BCS_DrvrBrkOvrd : 217|1@0+ (1,0) [0|1] ""  ADC,FAPA,IFC
 SG_ BCS_DrvrBrkOvrdVld : 218|1@0+ (1,0) [0|1] ""  ADC,FAPA,IFC
 SG_ BCS_DycEscTarTqActv : 219|1@0+ (1,0) [0|1] ""  ADC,FAPA,IFC
 SG_ BCS_DrvrTqDes : 231|16@0+ (1,-32768) [-32768|32767] "Nm"  ADC,FAPA,IFC
 SG_ BCS_ERV_VehSpd : 156|13@0+ (0.05625,0) [0|240] "km/h"  ADC,FAPA,IFC
 SG_ BCS_ERV_VehSpdVld : 188|1@0+ (1,0) [0|1] ""  ADC,FAPA,IFC
 SG_ BCS_EspFailrSts : 189|1@0+ (1,0) [0|1] ""  ADC,FAPA,IFC
 SG_ BCS_ActvSts : 190|1@0+ (1,0) [0|1] ""  ADC,FAPA,IFC
 SG_ BCS_BDCActive : 209|2@0+ (1,0) [0|3] ""  ADC,FAPA,IFC
 SG_ BCS_DTCActvSts : 211|2@0+ (1,0) [0|3] ""  ADC,FAPA,IFC
 SG_ BCS_errorFb : 215|4@0+ (1,0) [0|15] ""  ADC,FAPA,IFC
 SG_ BCS_WheelSlipFLValid : 220|1@0+ (1,0) [0|1] ""  ADC,FAPA,IFC
 SG_ BCS_WheelSlipFRValid : 221|1@0+ (1,0) [0|1] ""  ADC,FAPA,IFC
 SG_ BCS_WheelSlipRLValid : 222|1@0+ (1,0) [0|1] ""  ADC,FAPA,IFC
 SG_ BCS_WheelSlipRRValid : 223|1@0+ (1,0) [0|1] ""  ADC,FAPA,IFC
 SG_ BCS_CrbsTarRecpTorqRqFA : 247|14@0+ (1,-6000) [-6000|10380] "Nm"  ADC,FAPA,IFC
 SG_ BCS_CrbsTarRecpTorqRqFASt : 249|2@0+ (1,0) [0|3] ""  ADC,FAPA,IFC
 SG_ BCS_CrbsTarRecpTorqRqRA : 263|14@0+ (1,-6000) [-6000|10380] "Nm"  ADC,FAPA,IFC
 SG_ BCS_CrbsTarRecpTorqRqRASt : 265|2@0+ (1,0) [0|3] ""  ADC,FAPA,IFC
 SG_ BCS_CrbsTarRecpTorqRqSum : 279|14@0+ (1,-6000) [-6000|10380] "Nm"  ADC,FAPA,IFC
 SG_ BCS_CrbsTarRecpTorqRqSumSt : 281|2@0+ (1,0) [0|3] ""  ADC,FAPA,IFC
 SG_ BCS_WheelSlipFL : 199|8@0+ (0.004,0) [0|1.002] ""  ADC,FAPA,IFC
 SG_ BCS_WheelSlipFR : 207|8@0+ (0.004,0) [0|1.002] ""  ADC,FAPA,IFC
 SG_ BCS_WheelSlipRL : 343|8@0+ (0.004,0) [0|1.002] ""  ADC,FAPA,IFC
 SG_ BCS_WheelSlipRR : 351|8@0+ (0.004,0) [0|1.002] ""  ADC,FAPA,IFC

BO_ 618 CCU_EPB_1: 32 CCU
 SG_ EPB_1_CRC : 7|16@0+ (1,0) [0|65535] ""  ZCUF,ZCUR,RBM,IBCS,IDC,ADC,FAPA,VIU,IFC,PAS
 SG_ EPB_1_Counter : 23|8@0+ (1,0) [0|255] ""  ZCUF,ZCUR,RBM,IBCS,IDC,ADC,FAPA,VIU,IFC,PAS
 SG_ EPB_SwitchSt : 31|2@0+ (1,0) [0|3] ""  ZCUF,ZCUR,SRS,RBM,IBCS,ADC,FAPA,VIU,IFC,PAS
 SG_ EPB_SwitchStVD : 29|1@0+ (1,0) [0|1] ""  ZCUF,ZCUR,SRS,RBM,IBCS,ADC,FAPA,VIU,IFC,PAS
 SG_ EPB_SysSt : 28|3@0+ (1,0) [0|7] ""  ZCUF,ZCUR,SRS,RBM,IBCS,IDC,ADC,FAPA,VIU,IFC,PAS
 SG_ EPB_FailSt : 39|1@0+ (1,0) [0|1] ""  ZCUF,SRS,RBM,IBCS,IDC,ADC,FAPA,VIU,IFC,PAS
 SG_ EPB_ExtAvailable : 47|2@0+ (1,0) [0|3] ""  ZCUF,RBM,IBCS,ADC,FAPA,VIU,IFC
 SG_ EPB_DynamicApplySt : 82|3@0+ (1,0) [0|7] ""  ZCUF,RBM,IBCS,ADC,FAPA,VIU,IFC
 SG_ EPB_ActuatorSt_R : 107|4@0+ (1,0) [0|15] ""  ZCUF,RBM,IBCS,ADC,FAPA,VIU,IFC
 SG_ EPB_RWUActvSts : 109|2@0+ (1,0) [0|3] ""  ADC,FAPA,IFC
 SG_ EPB_RWUAvl : 111|2@0+ (1,0) [0|3] ""  ADC,FAPA,VIU,IFC
 SG_ EPB_EpbAvl : 119|2@0+ (1,0) [0|3] ""  ADC,FAPA,IFC
 SG_ EPB_RPAAVPAvailability : 129|2@0+ (1,0) [0|3] ""  ZCUF,ADC,FAPA,VIU
 SG_ EPB_APAAvailability : 143|1@0+ (1,0) [0|1] ""  ZCUF,ADC,FAPA,VIU
 SG_ EPB_ActuatorSt_L_1 : 141|4@0+ (1,0) [0|15] ""  IBCS,ADC,FAPA,VIU
 SG_ EPB_MotorCurrent_L_1 : 137|10@0+ (0.1,-51.1) [-51.1|51.1] "A"  IBCS,ADC,FAPA

BO_ 446 CCU_RBM_1_C: 64 CCU
 SG_ RBM_1_CRC : 7|16@0+ (1,0) [0|65535] ""  ZCUF,ZCUT,ADC,FAPA,VIU,IFC
 SG_ RBM_1_Counter : 23|8@0+ (1,0) [0|255] ""  ZCUF,ZCUT,ADC,FAPA,VIU,IFC
 SG_ RBM_BATResultSt : 81|1@0+ (1,0) [0|1] ""  IBCS,ADC
 SG_ RBU_VehSpdVD : 138|1@0+ (1,0) [0|1] ""  ZCUF,ZCUT,ADC,FAPA,VIU,IFC
 SG_ RBU_VehSpd : 135|13@0+ (0.05625,0) [0|240] "km/h"  ZCUF,ZCUT,ADC,FAPA,VIU,IFC
 SG_ RBU_SeconBrkCDAAvailableSt : 151|3@0+ (1,0) [0|7] ""  ADC,FAPA,VIU,IFC
 SG_ RBU_SeconBrkCommuniSt : 148|1@0+ (1,0) [0|1] ""  ADC,FAPA,VIU,IFC
 SG_ RBU_SeconBrkCDAActiveSt : 147|1@0+ (1,0) [0|1] ""  ADC,FAPA,VIU,IFC
 SG_ RBU_SeconBrkEPBst : 146|3@0+ (1,0) [0|7] ""  ADC,FAPA,VIU,IFC
 SG_ RBU_SeconBrkComChannel : 159|2@0+ (1,0) [0|3] ""  ADC,FAPA,VIU,IFC
 SG_ RBU_FourwhlsBrkTrq : 157|14@0+ (1,0) [0|10230] "N"  ADC,FAPA,VIU,IFC
 SG_ RBU_FLWheelSpdEdgesSum : 175|12@0+ (1,0) [0|4095] ""  ZCUF,ZCUT,ADC,FAPA,VIU,IFC
 SG_ RBU_FRWheelSpdEdgesSum : 179|12@0+ (1,0) [0|4095] ""  ZCUF,ZCUT,ADC,FAPA,VIU,IFC
 SG_ RBU_RLWheelSpdEdgesSum : 199|12@0+ (1,0) [0|4095] ""  ZCUF,ZCUT,ADC,FAPA,VIU,IFC
 SG_ RBU_RRWheelSpdEdgesSum : 203|12@0+ (1,0) [0|4095] ""  ZCUF,ZCUT,ADC,FAPA,VIU,IFC
 SG_ RBU_FLWheelSpd : 223|13@0+ (0.05625,0) [0|240] "km/h"  ZCUF,ZCUT,ADC,FAPA,VIU,IFC
 SG_ RBU_FLWheelSpdVD : 226|1@0+ (1,0) [0|1] ""  ZCUF,ZCUT,ADC,FAPA,VIU,IFC
 SG_ RBU_RLWheelRotatedDirection : 225|1@0+ (1,0) [0|1] ""  ADC,FAPA,VIU,IFC
 SG_ RBU_RLWheelRotatedDirectionVD : 224|1@0+ (1,0) [0|1] ""  ADC,FAPA,VIU,IFC
 SG_ RBU_FRWheelSpd : 239|13@0+ (0.05625,0) [0|240] "km/h"  ZCUF,ZCUT,ADC,FAPA,VIU,IFC
 SG_ RBU_FRWheelSpdVD : 242|1@0+ (1,0) [0|1] ""  ZCUF,ZCUT,ADC,FAPA,VIU,IFC
 SG_ RBU_RRWheelRotatedDirection : 241|1@0+ (1,0) [0|1] ""  ADC,FAPA,VIU,IFC
 SG_ RBU_RRWheelRotatedDirectionVD : 240|1@0+ (1,0) [0|1] ""  ADC,FAPA,VIU,IFC
 SG_ RBU_RLWheelSpd : 255|13@0+ (0.05625,0) [0|240] "km/h"  ZCUF,ZCUT,ADC,FAPA,VIU,IFC
 SG_ RBU_RLWheelSpdVD : 258|1@0+ (1,0) [0|1] ""  ZCUF,ZCUT,ADC,FAPA,VIU,IFC
 SG_ RBU_RRWheelSpd : 271|13@0+ (0.05625,0) [0|240] "km/h"  ZCUF,ZCUT,ADC,FAPA,VIU,IFC
 SG_ RBU_RRWheelSpdVD : 274|1@0+ (1,0) [0|1] ""  ZCUF,ZCUT,ADC,FAPA,VIU,IFC
 SG_ RBU_FLWheelSpdEdgesSumVD : 287|1@0+ (1,0) [0|1] ""  ZCUF,ZCUT,ADC,FAPA,VIU,IFC
 SG_ RBU_FRWheelSpdEdgesSumVD : 286|1@0+ (1,0) [0|1] ""  ZCUF,ZCUT,ADC,FAPA,VIU,IFC
 SG_ RBU_RLWheelSpdEdgesSumVD : 285|1@0+ (1,0) [0|1] ""  ZCUF,ZCUT,ADC,FAPA,VIU,IFC
 SG_ RBU_RRWheelSpdEdgesSumVD : 284|1@0+ (1,0) [0|1] ""  ZCUF,ZCUT,ADC,FAPA,VIU,IFC
 SG_ RBU_FLWheelRotatedDirection : 283|1@0+ (1,0) [0|1] ""  ADC,FAPA,VIU,IFC
 SG_ RBU_FLWheelRotatedDirectionVD : 282|1@0+ (1,0) [0|1] ""  ADC,FAPA,VIU,IFC
 SG_ RBU_FRWheelRotatedDirection : 281|1@0+ (1,0) [0|1] ""  ADC,FAPA,VIU,IFC
 SG_ RBU_FRWheelRotatedDirectionVD : 280|1@0+ (1,0) [0|1] ""  ADC,FAPA,VIU,IFC
 SG_ RBU_SeconBrkDecCtrlActiveSt : 297|1@0+ (1,0) [0|1] ""  ADC,FAPA,VIU,IFC

CM_ SG_ 615 BCS_1_CRC "E2E Profile 5 CRC";
CM_ SG_ 615 BCS_1_Counter "E2E Profile 5 Counter";
CM_ SG_ 615 BCS_FLWheelSpd "Current wheel speed information of front left wheel";
CM_ SG_ 615 BCS_FLWheelSpdVD "Quality/fault information to current wheel speed of front left wheel";
CM_ SG_ 615 BCS_FLWheelRotatedDirection "FL wheel rotate direction";
CM_ SG_ 615 BCS_FLWheelRotatedDirectionVD "FL wheel rotate direction validity";
CM_ SG_ 615 BCS_FRWheelSpd "Current wheel speed information of front right wheel";
CM_ SG_ 615 BCS_FRWheelSpdVD "Quality/fault information to current wheel speed of front right wheel";
CM_ SG_ 615 BCS_FRWheelRotatedDirection "FR wheel rotate direction";
CM_ SG_ 615 BCS_FRWheelRotatedDirectionVD "FR wheel rotate direction validity";
CM_ SG_ 615 BCS_RLWheelSpd "Current wheel speed information of rear left wheel";
CM_ SG_ 615 BCS_RLWheelSpdVD "Quality/fault information to current wheel speed of rear left wheel";
CM_ SG_ 615 BCS_RLWheelRotatedDirection "RL wheel rotate direction";
CM_ SG_ 615 BCS_RLWheelRotatedDirectionVD "RL wheel rotate direction validity";
CM_ SG_ 615 BCS_RRWheelSpd "Current wheel speed information of rear right wheel";
CM_ SG_ 615 BCS_RRWheelSpdVD "Quality/fault information to current wheel speed of rear right wheel";
CM_ SG_ 615 BCS_RRWheelRotatedDirection "RR wheel rotate direction";
CM_ SG_ 615 BCS_RRWheelRotatedDirectionVD "RR wheel rotate direction validity";
CM_ SG_ 615 BCS_HHCCtrlSt "HHC(Hill Hold Control) control status";
CM_ SG_ 615 BCS_HDCCtrlSt "HDC(Hill Descent Control) control status";
CM_ SG_ 615 BCS_HDCErrSt "HDC error status";
CM_ SG_ 615 BCS_FLWheelSpdEdgesSum "Accumulated sum of rising and falling edges of front left wheel speed sensor output·since IGN ON( the wheel plate have 48 teeth/cycle,the edge is 96)";
CM_ SG_ 615 BCS_FRWheelSpdEdgesSum "Accumulated sum of rising and falling edges of front right wheel speed sensor output·since IGN ON( the wheel plate have 48 teeth/cycle,the edge is 96)";
CM_ SG_ 615 BCS_RLWheelSpdEdgesSum "Accumulated sum of rising and falling edges of rear left wheel speed sensor output·since IGN ON( the wheel plate have 48 teeth/cycle,the edge is 96)";
CM_ SG_ 615 BCS_RRWheelSpdEdgesSum "Accumulated sum of rising and falling edges of  rear right wheel speed sensor output·since IGN ON( the wheel plate have 48 teeth/cycle,the edge is 96)";
CM_ SG_ 615 BCS_FLWheelSpdEdgesSumVD "Quality/fault information to current wheel speed edges sum of front left wheel";
CM_ SG_ 615 BCS_FRWheelSpdEdgesSumVD "Quality/fault information to current wheel speed edges sum of front right wheel";
CM_ SG_ 615 BCS_RLWheelSpdEdgesSumVD "Quality/fault information to current wheel speed edges sum of rear left wheel";
CM_ SG_ 615 BCS_RRWheelSpdEdgesSumVD "Quality/fault information to current wheel speed edges sum of rear right wheel";
CM_ SG_ 615 BCS_FLWheelRotatedDirectionAPA "FL wheel rotate direction for APA";
CM_ SG_ 615 BCS_FRWheelRotatedDirectionAPA "FR wheel rotate direction for APA";
CM_ SG_ 615 BCS_RLWheelRotatedDirectionAPA "RL wheel rotate direction for APA";
CM_ SG_ 615 BCS_RRWheelRotatedDirectionAPA "RR wheel rotate direction for APA";
CM_ SG_ 615 BCS_ParkingReqToEPB "Indicates the release/lock brake request to EPB";
CM_ SG_ 615 BCS_VDCOff "VDC is switched off ";
CM_ SG_ 615 BCS_AVHSt "Indicates AVH(Auto Vehicle Hold)in active or not ";
CM_ SG_ 615 BCS_AVHStandby "Indicates AVH(Auto Vehicle Hold)in standby mode or not ";
CM_ SG_ 615 BCS_AVHAvailable "HMI responsible, can get degrate AVH(Auto Vehicle Hold) statement from DSW and send out ";
CM_ SG_ 615 BCS_TCSOff "TCS is switched off ";
CM_ SG_ 615 BCS_BrkPdlPstVD "Current brake pedal position valid data";
CM_ SG_ 615 BCS_NoBrakeForce "No brake pressure applied,generally it regards wheel cylinder presure";
CM_ SG_ 615 BCS_BrakeOverHeat "Indicating brake temperature too high or not";
CM_ SG_ 615 BCS_ABAactive "ABA(Adaptive Brake Assistance) is active";
CM_ SG_ 615 BCS_ABAavailable "The ABA(Adaptive Brake Assistance)  function is available";
CM_ SG_ 615 BCS_ABPActive "ABP(Automatic brake Pre-fill) is active";
CM_ SG_ 615 BCS_ABPAvailable "ABP(Automatic brake Pre-fill) is available";
CM_ SG_ 615 BCS_AEBActive "AEB(Automatic EmergencyBraking) is active (in deceleration)";
CM_ SG_ 615 BCS_AEBAvailable "AEB(Automatic EmergencyBraking) is available";
CM_ SG_ 615 BCS_AWBActive "AWB(Automatic Warning Brake) is active";
CM_ SG_ 615 BCS_AWBAvailable "AWB(Automatic Warning Brake) is available";
CM_ SG_ 615 BCS_BrkPdlPst "Current brake pedal position";
CM_ SG_ 615 BCS_VehicleStandStillSt "Indicating whether the vehicle is standstill or not;must not be set until standstill is surely reached.";
CM_ SG_ 615 BCS_AEBBAActive "Indicates AEBBA active or not";
CM_ SG_ 615 BCS_2ParkDrvBrkOverrideFlg "Indicate driver brakes more than the system. ";
CM_ SG_ 615 IPB_InputRodStroke "Indicate inputRod stroke value";
CM_ SG_ 615 IPB_InputRodStrokeSt "Indicate inputRod stroke status";
CM_ SG_ 615 BCS_RAEBActive "RAEB is active ";
CM_ SG_ 615 BCS_RAEBAvailable "RAEB is available ";
CM_ SG_ 615 BCS_DrvModeAvailable "indicater zhe ability to go into abnormal patterns for ESP";
CM_ SG_ 615 BCS_DrvMode "indicate current driving mode parameters for ESP";
CM_ SG_ 615 IPB_PlungerPressure "Indicate plunger pressure value";
CM_ SG_ 615 IPB_PlungerPressureSt "Indicate plunger pressure status";
CM_ SG_ 352 BCS_2_CRC "E2E Profile 5 CRC";
CM_ SG_ 352 BCS_2_Counter "E2E Profile 5 Counter";
CM_ SG_ 352 BCS_VehSpd "Vehicle speed";
CM_ SG_ 352 BCS_VehSpdVD "Quality/fault information to vehicle speed";
CM_ SG_ 352 BCS_EBDActiveSt "Indication that EBD system currently performs a brake/engine intervention";
CM_ SG_ 352 BCS_EBDFaultSt "ABS system has detected a heavy fault, which does not even allow a reliable electronic brake distribution and is therefore completely shut down";
CM_ SG_ 352 BCS_ABSActiveSt "Indication that ABS system currently performs a brake intervention";
CM_ SG_ 352 BCS_ABSFaultSt "ABS system has detected a failure which does no allow a reliable ABS regulation and is therefore switched off";
CM_ SG_ 352 BCS_TCSActiveSt "Indication that TCS system currently performs a brake/engine intervention";
CM_ SG_ 352 BCS_TCSFaultSt "TCS is switched off due to detected failure";
CM_ SG_ 352 BCS_VDCActiveSt "Indication that VDC system currently performs a brake/engine intervention when ESP adjust the posture of vehicle ";
CM_ SG_ 352 BCS_VDCFaultSt "VDC is switched off due to detected failure";
CM_ SG_ 352 BCS_EngTorqDecActiveSt "Decrease enginetorque  active status (fast and low)";
CM_ SG_ 352 BCS_EngTorqIncActiveSt "Increased engine torque  active status";
CM_ SG_ 352 BCS_RegenModulationAvailable "Indicate whether ESP can follow ePedal request and modify the recuperation torque";
CM_ SG_ 352 BCS_RegenModuleActive "Reduce repcuperation torque requested by oppotize TCS control active status";
CM_ SG_ 352 BCS_EngTorqDecFastRANm "This torque  is engine combustion(indicated)decreased target torque (fast) for Rear Axle";
CM_ SG_ 352 BCS_EngTorqIncRANm "This torque  is  increased enginecombustion(indicated)target torque for Rear Axle";
CM_ SG_ 352 BCS_RealTCSActiveSt "Indication that TCS system currently real performs a brake/engine intervention ";
CM_ SG_ 352 BCS_TargetRecpTorqRq "Target recuperation torque request by BCS to generator,applies to 4WD and front wheel drive";
CM_ SG_ 352 BCS_TargetRecpTorqRqSt "Status of target recuperation torque request by BCS to generator,applies to 4WD and front wheel drive";
CM_ SG_ 352 BCS_CrbsActive "Indicate whether ESP recuperation torque is controlled by CRBS ";
CM_ SG_ 352 BCS_EngTorqDecFastFA "This torque  is engine combustion(indicated) decreased target torque (fast)";
CM_ SG_ 352 BCS_TargetRecpTorqRqFA "Target recuperation torque request by BCS to generator,applies to 4WD and front wheel drive";
CM_ SG_ 352 BCS_TargetRecpTorqRqFASt "Status of target recuperation torque request by BCS to generator,applies to 4WD and front wheel drive";
CM_ SG_ 352 BCS_TargetRecpTorqRqRA "Target recuperation torque request by BCS to generator,applies to 4WD and rear wheel drive";
CM_ SG_ 352 BCS_TargetRecpTorqRqRASt "Status of target recuperation torque request by BCS to generator,applies to 4WD and rear wheel drive";
CM_ SG_ 352 IPB_BrakePedalSt "IBCS Brake Pedal Status";
CM_ SG_ 352 IPB_BrakePedalStsVld "The validity  of brake pedal status";
CM_ SG_ 352 BCS_ESP2Park_DrvBrkOverrideFlg "Indicate driver brakes more than the system. ";
CM_ SG_ 352 BCS_EngTorqDecActiveStRA "Decrease enginetorque  active status (fast and low) for Rear Axle";
CM_ SG_ 352 BCS_EngTorqIncActiveStRA "Increased engine torque  active status for Rear Axle";
CM_ SG_ 352 BCS_EngTorqIncActiveStFA "Increased engine torque active status for Front Axle";
CM_ SG_ 352 BCS_EngTorqDecFastRA "This torque  is engine combustion(indicated)decreased target torque (fast) for Rear Axle";
CM_ SG_ 352 BCS_EngTorqIncRA "This torque  is  increased enginecombustion(indicated)target torque for Rear Axle";
CM_ SG_ 352 BCS_EngTorqDecActiveStFA "Decrease enginetorque active status (fast and low) for Front Axle";
CM_ SG_ 352 BCS_PrimBrkCDAAvailableSt "Primary brake actuator L2++ Cruise funtion interface healthy status.CDA NotAvailable: not available forL2++ system due to not initialization or failure or BAT not Finish. .CDA NotAvailable By Situation: not available for L2++ system due to rules not fulfilled.CDA NotAvailable For RBU Failure: CDA not available due to redundant system failure.CDA NotAvailable By Situation: CDA  not available due to rules not fulfilled.CDA Available With Fault: L2++ system Available with failure in short time.CDA Available With Situation: L2++ system active with rules not fulfilled in short time.CDA Available:No failure detected, pre-condition for activing L2++ are fullfilled";
CM_ SG_ 352 BCS_PrimBrkCommuniSt "Primary brake actuator communication healthy status.ADC and Primary brake actuator relevant network communication can be received on at least one channel.Invalid meaning communication is impossible , ADC need to receive the brake actuator signals from RBU.";
CM_ SG_ 352 BCS_PrimBrkActiveSt "Primary brake actuator working status.CDD (Controlled Deceleration for Driver) for L2.CDA (Controlled Deceleration for Automated Driving) for L2++ or Advance Cruise .L2 Active: Brake actuator working in L2 Cruise;L2++ Active：Brake actuator  working in L2++ or Advance Cruise";
CM_ SG_ 352 BCS_2ParkDynamicAVPavailability "Flag indicate  Dynamic AVP availability for longitudinal control";
CM_ SG_ 352 BCS_2ParkCddApActiveVehHld "Flag indicate that vehicle is activly hold by longitudinal actuator controller";
CM_ SG_ 352 BCS_2ParkAPCStatus "Longitudinal controller status";
CM_ SG_ 352 BCS_2ParkAPAavailability "Flag indicate  APA availability for longitudinal control";
CM_ SG_ 352 BCS_2ParkRPAAVPavailability "Flag indicate  RPA AVP availability for longitudinal control";
CM_ SG_ 352 BCS_2ParkAPCFailureSts "detailed information why this APC maneuver failed";
CM_ SG_ 352 BCS_APCMain2BackupReq "APC_24 main activation request towards backup for RPA/AVP";
CM_ SG_ 352 BCS_PrimBrkCtrlUsedChannel "Primary brake actuator Feekback which communication channel is used for ADC Control";
CM_ SG_ 352 BCS_PrimBrkCDAActiveSt "Primary brake actuator CDA(Controlled Deceleration for Automated Driving) working status.L2++ Active:Brake actuator  working in L2++ or Advance Cruise.";
CM_ SG_ 352 BCS_PrimBrkDecCtrlActiveSt "Primary Brake actuator Deceleration Control Active Status for ADC Ax Request .(CDD or CDA)";
CM_ SG_ 352 BCS_PrimBrkCDDAvailableSt "Primary brake actuator L2 Cruise funtion interface healthy status.";
CM_ SG_ 352 BCS_EngTorqIncFA "This torque is increased engine combustion(indicated)target torque for Front ear Axle";
CM_ SG_ 611 BCS_HydBrkActvTq_FL_1 "Hydraulic brake torque of the  front left wheel";
CM_ SG_ 611 BCS_HydBrkActvTq_FR_1 "Hydraulic brake torque of the  front right wheel";
CM_ SG_ 611 BCS_HydBrkActvTq_RL_1 "Hydraulic brake torque of the  rear left wheel";
CM_ SG_ 611 BCS_HydBrkActvTq_RR_1 "Hydraulic brake torque of the  rear right wheel";
CM_ SG_ 611 BCS_PrimCommPathSt "Indicates the communication error status of the primary CAN channel monitored by the brake control system.";
CM_ SG_ 611 BCS_SeconCommPathSt "Indicates the communication error status of the Secondary CAN channel monitored by the brake control system.";
CM_ SG_ 611 BCS_PressureHldSt "Indicates the pressure holding status of the brake control system.";
CM_ SG_ 611 BCS_CDDFuncSt "Indicates the CDD function status of  the brake control system.";
CM_ SG_ 611 IPB_SimulatorPressure "Indicate simulator pressure value";
CM_ SG_ 611 IPB_SimulatorPressureSt "Indicate simulator pressure status";
CM_ SG_ 611 IBCS_SystemSt "IBCS system state";
CM_ SG_ 611 IBCS_FWAWarning "Indicate FWA state, dashboard need warn driver";
CM_ SG_ 611 IPB_CSTSt "indicates CST status. Only valid for project with CST function.";
CM_ SG_ 611 BCS_AVDCActive "Indicate AVDC deceleration active or not";
CM_ SG_ 611 BCS_AVDCAvailable "Indicate AVDC deceleration available ornot";
CM_ SG_ 360 BCS_6_CRC "E2E Profile 5 CRC";
CM_ SG_ 360 BCS_6_Counter "E2E Profile 5 Counter";
CM_ SG_ 360 BCS_HydBrkActvTq_FL "Hydraulic brake torque of the  front left wheel";
CM_ SG_ 360 BCS_HydBrkActvTq_FR "Hydraulic brake torque of the  front right wheel";
CM_ SG_ 360 BCS_HydBrkActvTq_RL "Hydraulic brake torque of the  rear left wheel";
CM_ SG_ 360 BCS_HydBrkActvTq_RR "Hydraulic brake torque of the  rear right wheel";
CM_ SG_ 360 BCS_HydBrkReqTq "It is the target brake torque to hydraulic brake";
CM_ SG_ 360 BCS_BrkActvTq "It is the real total brake  torque carried out by electric motor（ recuperation torque or electric brake torque）and ESP/IPB（hydraulic braketorque）.";
CM_ SG_ 360 BCS_HydBrkActvTq "It is the real hydraulic brake  torque carried out by ESP/IPB.";
CM_ SG_ 360 BCS_DycESCActTq "The real  DYC(Direct  yaw moment control)  of the ESP/IPB";
CM_ SG_ 360 BCS_BrkTqCtrlAvlDriving "It indicates  whether  ESP/IPB is available for cruise function.";
CM_ SG_ 360 BCS_BrkTqCtrlAvlParking "It indicates  whether  ESP/IPB is available for parking function.";
CM_ SG_ 360 BCS_BrkTqCtrlActv "It indicates  whether  ESP/IPB is  responsed for the brake request of ADAS.";
CM_ SG_ 360 BCS_DycEscTarTqCtrlAvl "The validity  of the DYC(Direct  yaw moment control)  of the ESP/IPB";
CM_ SG_ 360 BCS_DrvrBrkOvrd "Indicate driver brakes torque more than the ADAS/ADS. ";
CM_ SG_ 360 BCS_DrvrBrkOvrdVld "The validity  of  BCS_DrvrBrkOvrd";
CM_ SG_ 360 BCS_DycEscTarTqActv "Indicates the DYC of the ESP/IPB in active or not";
CM_ SG_ 360 BCS_DrvrTqDes "When driver prsees brake pedal，It is the brake torque calculated by ESP/IPB corresponding to  inputRod stroke.";
CM_ SG_ 360 BCS_ERV_VehSpd "Vehicle reference speed ";
CM_ SG_ 360 BCS_ERV_VehSpdVld "Quality/fault information to vehicle  reference speed ";
CM_ SG_ 360 BCS_EspFailrSts "It indicates whether ESP/IPB is error.When any function of ESP/IPB is error ，it will be error。";
CM_ SG_ 360 BCS_ActvSts "It indicates whether ESP/IPB is active. When any function of ESP/IPB is active ，it will be active。";
CM_ SG_ 360 BCS_BDCActive "Indicates Brake Disc Cleaning in active or not";
CM_ SG_ 360 BCS_DTCActvSts "Dragging Torque Control activation status";
CM_ SG_ 360 BCS_errorFb "Errors related to the braking system(ESP/IPB).It indicates the braking system can not respond to the deceleration request（brake torque） of the ADAS。";
CM_ SG_ 360 BCS_WheelSlipFLValid "The validity  of slip ratio of the  front left wheel";
CM_ SG_ 360 BCS_WheelSlipFRValid "The validity of slip ratio of the  front right wheel";
CM_ SG_ 360 BCS_WheelSlipRLValid "The validity of slip ratio of the  rear left wheel";
CM_ SG_ 360 BCS_WheelSlipRRValid "The validity of slip ratio of the  rear right wheel";
CM_ SG_ 360 BCS_CrbsTarRecpTorqRqFA "CRBS target recuperation torque requested by BCS to generator,applies to  front wheel drive ";
CM_ SG_ 360 BCS_CrbsTarRecpTorqRqFASt "Status of  BCS_CrbsTarRecpTorqRqFA";
CM_ SG_ 360 BCS_CrbsTarRecpTorqRqRA "CRBS target recuperation torque requested by BCS to generator,applies to  rear wheel drive ";
CM_ SG_ 360 BCS_CrbsTarRecpTorqRqRASt "Status of  BCS_CrbsTarRecpTorqRqRA";
CM_ SG_ 360 BCS_CrbsTarRecpTorqRqSum "CRBS target recuperation torque requested by BCS to generator,applies to 4WD and front wheel drive /rear wheel drive";
CM_ SG_ 360 BCS_CrbsTarRecpTorqRqSumSt "CRBS target recuperation torque requested by BCS to generator,applies to 4WD and front wheel drive /rear wheel drive";
CM_ SG_ 360 BCS_WheelSlipFL "Slip ratio of the  front left wheel";
CM_ SG_ 360 BCS_WheelSlipFR "Slip ratio of the  front right wheel";
CM_ SG_ 360 BCS_WheelSlipRL "Slip ratio of the  rear left wheel";
CM_ SG_ 360 BCS_WheelSlipRR "Slip ratio of the  rear right wheel";
CM_ SG_ 618 EPB_1_CRC "E2E Profile 5 CRC";
CM_ SG_ 618 EPB_1_Counter "E2E Profile 5 Counter";
CM_ SG_ 618 EPB_SwitchSt "EPB switch status ";
CM_ SG_ 618 EPB_SwitchStVD "EPB switch status validity";
CM_ SG_ 618 EPB_SysSt "EPB system status";
CM_ SG_ 618 EPB_FailSt "EPB fail status,to indicate wether EPB can response to external apply  request or not";
CM_ SG_ 618 EPB_ExtAvailable "EPB  status,to indicate wetherEPB can response to externalapply request or not";
CM_ SG_ 618 EPB_DynamicApplySt "EPB dynamic apply status";
CM_ SG_ 618 EPB_ActuatorSt_R "EPB right  actuator status";
CM_ SG_ 618 EPB_RWUActvSts "It indicates whether the RWU  of the ESP/IPB is active";
CM_ SG_ 618 EPB_RWUAvl "It indicates whether the RWU  of the EPB  is available";
CM_ SG_ 618 EPB_EpbAvl "The validity  of  EPB";
CM_ SG_ 618 EPB_RPAAVPAvailability "Flag indicate  RPA AVP availability for EPB control";
CM_ SG_ 618 EPB_APAAvailability "Flag indicate  APA availability for EPB control";
CM_ SG_ 618 EPB_ActuatorSt_L_1 "EPB left  actuator status";
CM_ SG_ 618 EPB_MotorCurrent_L_1 "EPB left motor current ";
CM_ SG_ 446 RBM_1_CRC "E2E Profile 5 CRC";
CM_ SG_ 446 RBM_1_Counter "E2E Profile 5 Counter";
CM_ SG_ 446 RBM_BATResultSt "Indicates the BAT(Brake Actuator Test) result status of the brake control system.";
CM_ SG_ 446 RBU_VehSpdVD "Quality/fault information to vehicle speed";
CM_ SG_ 446 RBU_VehSpd "Vehicle speed";
CM_ SG_ 446 RBU_SeconBrkCDAAvailableSt "Secondary brake actuator L2++ Cruise funtion interface healthy status .CDA NotAvailable: not available for L2++ system due to not initialization or failure.CDA NotAvailable By Situation: not available for L2++ system due to rules not fulfilled.CDA Available With Fault: L2++ system active with failure.CDA Available With Situation: L2++ system active with rules not fulfilled.CDA Available: No failure detected, pre-conditions for activing L2++ are fulfilled";
CM_ SG_ 446 RBU_SeconBrkCommuniSt "Secondary brake actuator communication healthy status.If ADC and Primary brake actuator relevant network communication is invalid , ADC need to receive the brake actuator signals from RBU.";
CM_ SG_ 446 RBU_SeconBrkCDAActiveSt "Secondary brake actuator working status in L2++.CDA Active: CDA(Controlled Deceleration for Automated Driving)  in L2++ system active.";
CM_ SG_ 446 RBU_SeconBrkEPBst "Secondary brake actuator-EPB system status.";
CM_ SG_ 446 RBU_SeconBrkComChannel "Secondary brake actuator Feekback which communication channel is used for ADC Control";
CM_ SG_ 446 RBU_FourwhlsBrkTrq "The total brake friction wheel_torque at four wheels.";
CM_ SG_ 446 RBU_FLWheelSpdEdgesSum "Accumulated sum of rising and falling edges of front left wheel speed sensor output·since IGN ON( the wheel plate have 43 teeth/cycle,the edge is 86)";
CM_ SG_ 446 RBU_FRWheelSpdEdgesSum "Accumulated sum of rising and falling edges of front right wheel speed sensor output·since IGN ON( the wheel plate have 43 teeth/cycle,the edge is 86)";
CM_ SG_ 446 RBU_RLWheelSpdEdgesSum "Accumulated sum of rising and falling edges of rear left wheel speed sensor output·since IGN ON( the wheel plate have 43teeth/cycle,the edge is 86)";
CM_ SG_ 446 RBU_RRWheelSpdEdgesSum "Accumulated sum of rising and falling edges of  rear right wheel speed sensor output·since IGN ON( the wheel plate have 43 teeth/cycle,the edge is 86)";
CM_ SG_ 446 RBU_FLWheelSpd "Current wheel speed information of front left wheel";
CM_ SG_ 446 RBU_FLWheelSpdVD "Quality/fault information to current wheel speed of front left wheel,be used for validity of BCS_FLWheelSpd and BCS_FLWheelSpdEdgesSum signal";
CM_ SG_ 446 RBU_RLWheelRotatedDirection "RL wheel rotate direction";
CM_ SG_ 446 RBU_RLWheelRotatedDirectionVD "RL wheel rotate direction validity";
CM_ SG_ 446 RBU_FRWheelSpd "Current wheel speed information of front right wheel";
CM_ SG_ 446 RBU_FRWheelSpdVD "Quality/fault information to current wheel speed of front left wheel,be used for validity of BCS_FRWheelSpd and BCS_FRWheelSpdEdgesSum signal";
CM_ SG_ 446 RBU_RRWheelRotatedDirection "RR wheel rotate direction";
CM_ SG_ 446 RBU_RRWheelRotatedDirectionVD "RR wheel rotate direction validity";
CM_ SG_ 446 RBU_RLWheelSpd "Current wheel speed information of rear left wheel";
CM_ SG_ 446 RBU_RLWheelSpdVD "Quality/fault information to current wheel speed of front left wheel,be used for validity of BCS_RLWheelSpd and BCS_RLWheelSpdEdgesSum signal";
CM_ SG_ 446 RBU_RRWheelSpd "Current wheel speed information of rear right wheel";
CM_ SG_ 446 RBU_RRWheelSpdVD "Quality/fault information to current wheel speed of RRont left wheel,be used for validity of BCS_RRWheelSpd and BCS_RRWheelSpdEdgesSum signal";
CM_ SG_ 446 RBU_FLWheelSpdEdgesSumVD "Quality/fault information to current wheel speed edges sum of front left wheel";
CM_ SG_ 446 RBU_FRWheelSpdEdgesSumVD "Quality/fault information to current wheel speed edges sum of front right wheel";
CM_ SG_ 446 RBU_RLWheelSpdEdgesSumVD "Quality/fault information to current wheel speed edges sum of rear left wheel";
CM_ SG_ 446 RBU_RRWheelSpdEdgesSumVD "Quality/fault information to current wheel speed edges sum of rear right wheel";
CM_ SG_ 446 RBU_FLWheelRotatedDirection "FL wheel rotate direction";
CM_ SG_ 446 RBU_FLWheelRotatedDirectionVD "FL wheel rotate direction validity";
CM_ SG_ 446 RBU_FRWheelRotatedDirection "FR wheel rotate direction";
CM_ SG_ 446 RBU_FRWheelRotatedDirectionVD "FR wheel rotate direction validity";
CM_ SG_ 446 RBU_SeconBrkDecCtrlActiveSt "Secondary brake actuator Deceleration Control Active Status for ADC Ax Request .(CDA)";

BA_DEF_ BO_  "GenMsgCycleTime" INT 0 0;
BA_DEF_ BO_  "GenMsgCycleTimeFast" INT 0 0;
BA_DEF_ BO_  "GenMsgSendType" ENUM  "Periodic","Event","IfActive","POE","PA","FixedPeriodic","Event","EnabledPeriodic","NotUsed","NotUsed","EventPeriodic","NotUsed","NotUsed","NoMsgSendType";
BA_DEF_ BO_  "VFrameFormat" ENUM  "StandardCAN","ExtendedCAN","reserved","reserved","reserved","reserved","reserved","reserved","reserved","reserved","reserved","reserved","reserved","reserved","StandardCAN_FD","ExtendedCAN_FD";
BA_DEF_ BO_  "CANFD_BRS" ENUM  "0","1";
BA_DEF_ SG_  "EventCommandSignal" ENUM  "No","Yes";
BA_DEF_ SG_  "GatewayedSignals" ENUM  "No","Yes";
BA_DEF_ SG_  "GenSigInactiveValue" HEX 0 0;
BA_DEF_ SG_  "GenSigInvalidValue" HEX 0 0;
BA_DEF_ SG_  "GenSigSendType" ENUM  "Trigger","Passive","Cyclic","OnWrite","OnWriteWithRepetition","OnChange","OnChangeWithRepetition","IfActive","IfActiveWithRepetition","NoSigSendType";
BA_DEF_ SG_  "GenSigStartValue" HEX 0 0;
BA_DEF_ SG_  "GenSigTimeoutValue" HEX 0 0;
BA_DEF_ SG_  "Remark" STRING ;
BA_ "GenMsgCycleTime" BO_ 615 20;
BA_ "GenMsgCycleTimeFast" BO_ 615 0;
BA_ "GenMsgSendType" BO_ 615 0;
BA_ "VFrameFormat" BO_ 615 14;
BA_ "CANFD_BRS" BO_ 615 1;
BA_ "GenMsgCycleTime" BO_ 615 20;
BA_ "GenMsgCycleTimeFast" BO_ 615 0;
BA_ "GenMsgSendType" BO_ 615 0;
BA_ "VFrameFormat" BO_ 615 14;
BA_ "CANFD_BRS" BO_ 615 1;
BA_ "GenMsgCycleTime" BO_ 615 20;
BA_ "GenMsgCycleTimeFast" BO_ 615 0;
BA_ "GenMsgSendType" BO_ 615 0;
BA_ "VFrameFormat" BO_ 615 14;
BA_ "CANFD_BRS" BO_ 615 1;
BA_ "GenMsgCycleTime" BO_ 615 20;
BA_ "GenMsgCycleTimeFast" BO_ 615 0;
BA_ "GenMsgSendType" BO_ 615 0;
BA_ "VFrameFormat" BO_ 615 14;
BA_ "CANFD_BRS" BO_ 615 1;
BA_ "GenMsgCycleTime" BO_ 615 20;
BA_ "GenMsgCycleTimeFast" BO_ 615 0;
BA_ "GenMsgSendType" BO_ 615 0;
BA_ "VFrameFormat" BO_ 615 14;
BA_ "CANFD_BRS" BO_ 615 1;
BA_ "GenMsgCycleTime" BO_ 615 20;
BA_ "GenMsgCycleTimeFast" BO_ 615 0;
BA_ "GenMsgSendType" BO_ 615 0;
BA_ "VFrameFormat" BO_ 615 14;
BA_ "CANFD_BRS" BO_ 615 1;
BA_ "GenMsgCycleTime" BO_ 615 20;
BA_ "GenMsgCycleTimeFast" BO_ 615 0;
BA_ "GenMsgSendType" BO_ 615 0;
BA_ "VFrameFormat" BO_ 615 14;
BA_ "CANFD_BRS" BO_ 615 1;
BA_ "GenMsgCycleTime" BO_ 615 20;
BA_ "GenMsgCycleTimeFast" BO_ 615 0;
BA_ "GenMsgSendType" BO_ 615 0;
BA_ "VFrameFormat" BO_ 615 14;
BA_ "CANFD_BRS" BO_ 615 1;
BA_ "GenMsgCycleTime" BO_ 615 20;
BA_ "GenMsgCycleTimeFast" BO_ 615 0;
BA_ "GenMsgSendType" BO_ 615 0;
BA_ "VFrameFormat" BO_ 615 14;
BA_ "CANFD_BRS" BO_ 615 1;
BA_ "GenMsgCycleTime" BO_ 615 20;
BA_ "GenMsgCycleTimeFast" BO_ 615 0;
BA_ "GenMsgSendType" BO_ 615 0;
BA_ "VFrameFormat" BO_ 615 14;
BA_ "CANFD_BRS" BO_ 615 1;
BA_ "GenMsgCycleTime" BO_ 615 20;
BA_ "GenMsgCycleTimeFast" BO_ 615 0;
BA_ "GenMsgSendType" BO_ 615 0;
BA_ "VFrameFormat" BO_ 615 14;
BA_ "CANFD_BRS" BO_ 615 1;
BA_ "GenMsgCycleTime" BO_ 615 20;
BA_ "GenMsgCycleTimeFast" BO_ 615 0;
BA_ "GenMsgSendType" BO_ 615 0;
BA_ "VFrameFormat" BO_ 615 14;
BA_ "CANFD_BRS" BO_ 615 1;
BA_ "GenMsgCycleTime" BO_ 615 20;
BA_ "GenMsgCycleTimeFast" BO_ 615 0;
BA_ "GenMsgSendType" BO_ 615 0;
BA_ "VFrameFormat" BO_ 615 14;
BA_ "CANFD_BRS" BO_ 615 1;
BA_ "GenMsgCycleTime" BO_ 615 20;
BA_ "GenMsgCycleTimeFast" BO_ 615 0;
BA_ "GenMsgSendType" BO_ 615 0;
BA_ "VFrameFormat" BO_ 615 14;
BA_ "CANFD_BRS" BO_ 615 1;
BA_ "GenMsgCycleTime" BO_ 615 20;
BA_ "GenMsgCycleTimeFast" BO_ 615 0;
BA_ "GenMsgSendType" BO_ 615 0;
BA_ "VFrameFormat" BO_ 615 14;
BA_ "CANFD_BRS" BO_ 615 1;
BA_ "GenMsgCycleTime" BO_ 615 20;
BA_ "GenMsgCycleTimeFast" BO_ 615 0;
BA_ "GenMsgSendType" BO_ 615 0;
BA_ "VFrameFormat" BO_ 615 14;
BA_ "CANFD_BRS" BO_ 615 1;
BA_ "GenMsgCycleTime" BO_ 615 20;
BA_ "GenMsgCycleTimeFast" BO_ 615 0;
BA_ "GenMsgSendType" BO_ 615 0;
BA_ "VFrameFormat" BO_ 615 14;
BA_ "CANFD_BRS" BO_ 615 1;
BA_ "GenMsgCycleTime" BO_ 615 20;
BA_ "GenMsgCycleTimeFast" BO_ 615 0;
BA_ "GenMsgSendType" BO_ 615 0;
BA_ "VFrameFormat" BO_ 615 14;
BA_ "CANFD_BRS" BO_ 615 1;
BA_ "GenMsgCycleTime" BO_ 615 20;
BA_ "GenMsgCycleTimeFast" BO_ 615 0;
BA_ "GenMsgSendType" BO_ 615 0;
BA_ "VFrameFormat" BO_ 615 14;
BA_ "CANFD_BRS" BO_ 615 1;
BA_ "GenMsgCycleTime" BO_ 615 20;
BA_ "GenMsgCycleTimeFast" BO_ 615 0;
BA_ "GenMsgSendType" BO_ 615 0;
BA_ "VFrameFormat" BO_ 615 14;
BA_ "CANFD_BRS" BO_ 615 1;
BA_ "GenMsgCycleTime" BO_ 615 20;
BA_ "GenMsgCycleTimeFast" BO_ 615 0;
BA_ "GenMsgSendType" BO_ 615 0;
BA_ "VFrameFormat" BO_ 615 14;
BA_ "CANFD_BRS" BO_ 615 1;
BA_ "GenMsgCycleTime" BO_ 615 20;
BA_ "GenMsgCycleTimeFast" BO_ 615 0;
BA_ "GenMsgSendType" BO_ 615 0;
BA_ "VFrameFormat" BO_ 615 14;
BA_ "CANFD_BRS" BO_ 615 1;
BA_ "GenMsgCycleTime" BO_ 615 20;
BA_ "GenMsgCycleTimeFast" BO_ 615 0;
BA_ "GenMsgSendType" BO_ 615 0;
BA_ "VFrameFormat" BO_ 615 14;
BA_ "CANFD_BRS" BO_ 615 1;
BA_ "GenMsgCycleTime" BO_ 615 20;
BA_ "GenMsgCycleTimeFast" BO_ 615 0;
BA_ "GenMsgSendType" BO_ 615 0;
BA_ "VFrameFormat" BO_ 615 14;
BA_ "CANFD_BRS" BO_ 615 1;
BA_ "GenMsgCycleTime" BO_ 615 20;
BA_ "GenMsgCycleTimeFast" BO_ 615 0;
BA_ "GenMsgSendType" BO_ 615 0;
BA_ "VFrameFormat" BO_ 615 14;
BA_ "CANFD_BRS" BO_ 615 1;
BA_ "GenMsgCycleTime" BO_ 615 20;
BA_ "GenMsgCycleTimeFast" BO_ 615 0;
BA_ "GenMsgSendType" BO_ 615 0;
BA_ "VFrameFormat" BO_ 615 14;
BA_ "CANFD_BRS" BO_ 615 1;
BA_ "GenMsgCycleTime" BO_ 615 20;
BA_ "GenMsgCycleTimeFast" BO_ 615 0;
BA_ "GenMsgSendType" BO_ 615 0;
BA_ "VFrameFormat" BO_ 615 14;
BA_ "CANFD_BRS" BO_ 615 1;
BA_ "GenMsgCycleTime" BO_ 615 20;
BA_ "GenMsgCycleTimeFast" BO_ 615 0;
BA_ "GenMsgSendType" BO_ 615 0;
BA_ "VFrameFormat" BO_ 615 14;
BA_ "CANFD_BRS" BO_ 615 1;
BA_ "GenMsgCycleTime" BO_ 615 20;
BA_ "GenMsgCycleTimeFast" BO_ 615 0;
BA_ "GenMsgSendType" BO_ 615 0;
BA_ "VFrameFormat" BO_ 615 14;
BA_ "CANFD_BRS" BO_ 615 1;
BA_ "GenMsgCycleTime" BO_ 615 20;
BA_ "GenMsgCycleTimeFast" BO_ 615 0;
BA_ "GenMsgSendType" BO_ 615 0;
BA_ "VFrameFormat" BO_ 615 14;
BA_ "CANFD_BRS" BO_ 615 1;
BA_ "GenMsgCycleTime" BO_ 615 20;
BA_ "GenMsgCycleTimeFast" BO_ 615 0;
BA_ "GenMsgSendType" BO_ 615 0;
BA_ "VFrameFormat" BO_ 615 14;
BA_ "CANFD_BRS" BO_ 615 1;
BA_ "GenMsgCycleTime" BO_ 615 20;
BA_ "GenMsgCycleTimeFast" BO_ 615 0;
BA_ "GenMsgSendType" BO_ 615 0;
BA_ "VFrameFormat" BO_ 615 14;
BA_ "CANFD_BRS" BO_ 615 1;
BA_ "GenMsgCycleTime" BO_ 615 20;
BA_ "GenMsgCycleTimeFast" BO_ 615 0;
BA_ "GenMsgSendType" BO_ 615 0;
BA_ "VFrameFormat" BO_ 615 14;
BA_ "CANFD_BRS" BO_ 615 1;
BA_ "GenMsgCycleTime" BO_ 615 20;
BA_ "GenMsgCycleTimeFast" BO_ 615 0;
BA_ "GenMsgSendType" BO_ 615 0;
BA_ "VFrameFormat" BO_ 615 14;
BA_ "CANFD_BRS" BO_ 615 1;
BA_ "GenMsgCycleTime" BO_ 615 20;
BA_ "GenMsgCycleTimeFast" BO_ 615 0;
BA_ "GenMsgSendType" BO_ 615 0;
BA_ "VFrameFormat" BO_ 615 14;
BA_ "CANFD_BRS" BO_ 615 1;
BA_ "GenMsgCycleTime" BO_ 615 20;
BA_ "GenMsgCycleTimeFast" BO_ 615 0;
BA_ "GenMsgSendType" BO_ 615 0;
BA_ "VFrameFormat" BO_ 615 14;
BA_ "CANFD_BRS" BO_ 615 1;
BA_ "GenMsgCycleTime" BO_ 615 20;
BA_ "GenMsgCycleTimeFast" BO_ 615 0;
BA_ "GenMsgSendType" BO_ 615 0;
BA_ "VFrameFormat" BO_ 615 14;
BA_ "CANFD_BRS" BO_ 615 1;
BA_ "GenMsgCycleTime" BO_ 615 20;
BA_ "GenMsgCycleTimeFast" BO_ 615 0;
BA_ "GenMsgSendType" BO_ 615 0;
BA_ "VFrameFormat" BO_ 615 14;
BA_ "CANFD_BRS" BO_ 615 1;
BA_ "GenMsgCycleTime" BO_ 615 20;
BA_ "GenMsgCycleTimeFast" BO_ 615 0;
BA_ "GenMsgSendType" BO_ 615 0;
BA_ "VFrameFormat" BO_ 615 14;
BA_ "CANFD_BRS" BO_ 615 1;
BA_ "GenMsgCycleTime" BO_ 615 20;
BA_ "GenMsgCycleTimeFast" BO_ 615 0;
BA_ "GenMsgSendType" BO_ 615 0;
BA_ "VFrameFormat" BO_ 615 14;
BA_ "CANFD_BRS" BO_ 615 1;
BA_ "GenMsgCycleTime" BO_ 615 20;
BA_ "GenMsgCycleTimeFast" BO_ 615 0;
BA_ "GenMsgSendType" BO_ 615 0;
BA_ "VFrameFormat" BO_ 615 14;
BA_ "CANFD_BRS" BO_ 615 1;
BA_ "GenMsgCycleTime" BO_ 615 20;
BA_ "GenMsgCycleTimeFast" BO_ 615 0;
BA_ "GenMsgSendType" BO_ 615 0;
BA_ "VFrameFormat" BO_ 615 14;
BA_ "CANFD_BRS" BO_ 615 1;
BA_ "GenMsgCycleTime" BO_ 615 20;
BA_ "GenMsgCycleTimeFast" BO_ 615 0;
BA_ "GenMsgSendType" BO_ 615 0;
BA_ "VFrameFormat" BO_ 615 14;
BA_ "CANFD_BRS" BO_ 615 1;
BA_ "GenMsgCycleTime" BO_ 615 20;
BA_ "GenMsgCycleTimeFast" BO_ 615 0;
BA_ "GenMsgSendType" BO_ 615 0;
BA_ "VFrameFormat" BO_ 615 14;
BA_ "CANFD_BRS" BO_ 615 1;
BA_ "GenMsgCycleTime" BO_ 615 20;
BA_ "GenMsgCycleTimeFast" BO_ 615 0;
BA_ "GenMsgSendType" BO_ 615 0;
BA_ "VFrameFormat" BO_ 615 14;
BA_ "CANFD_BRS" BO_ 615 1;
BA_ "GenMsgCycleTime" BO_ 615 20;
BA_ "GenMsgCycleTimeFast" BO_ 615 0;
BA_ "GenMsgSendType" BO_ 615 0;
BA_ "VFrameFormat" BO_ 615 14;
BA_ "CANFD_BRS" BO_ 615 1;
BA_ "GenMsgCycleTime" BO_ 615 20;
BA_ "GenMsgCycleTimeFast" BO_ 615 0;
BA_ "GenMsgSendType" BO_ 615 0;
BA_ "VFrameFormat" BO_ 615 14;
BA_ "CANFD_BRS" BO_ 615 1;
BA_ "GenMsgCycleTime" BO_ 615 20;
BA_ "GenMsgCycleTimeFast" BO_ 615 0;
BA_ "GenMsgSendType" BO_ 615 0;
BA_ "VFrameFormat" BO_ 615 14;
BA_ "CANFD_BRS" BO_ 615 1;
BA_ "GenMsgCycleTime" BO_ 615 20;
BA_ "GenMsgCycleTimeFast" BO_ 615 0;
BA_ "GenMsgSendType" BO_ 615 0;
BA_ "VFrameFormat" BO_ 615 14;
BA_ "CANFD_BRS" BO_ 615 1;
BA_ "GenMsgCycleTime" BO_ 615 20;
BA_ "GenMsgCycleTimeFast" BO_ 615 0;
BA_ "GenMsgSendType" BO_ 615 0;
BA_ "VFrameFormat" BO_ 615 14;
BA_ "CANFD_BRS" BO_ 615 1;
BA_ "GenMsgCycleTime" BO_ 615 20;
BA_ "GenMsgCycleTimeFast" BO_ 615 0;
BA_ "GenMsgSendType" BO_ 615 0;
BA_ "VFrameFormat" BO_ 615 14;
BA_ "CANFD_BRS" BO_ 615 1;
BA_ "GenMsgCycleTime" BO_ 615 20;
BA_ "GenMsgCycleTimeFast" BO_ 615 0;
BA_ "GenMsgSendType" BO_ 615 0;
BA_ "VFrameFormat" BO_ 615 14;
BA_ "CANFD_BRS" BO_ 615 1;
BA_ "GenMsgCycleTime" BO_ 615 20;
BA_ "GenMsgCycleTimeFast" BO_ 615 0;
BA_ "GenMsgSendType" BO_ 615 0;
BA_ "VFrameFormat" BO_ 615 14;
BA_ "CANFD_BRS" BO_ 615 1;
BA_ "GenMsgCycleTime" BO_ 615 20;
BA_ "GenMsgCycleTimeFast" BO_ 615 0;
BA_ "GenMsgSendType" BO_ 615 0;
BA_ "VFrameFormat" BO_ 615 14;
BA_ "CANFD_BRS" BO_ 615 1;
BA_ "GenMsgCycleTime" BO_ 615 20;
BA_ "GenMsgCycleTimeFast" BO_ 615 0;
BA_ "GenMsgSendType" BO_ 615 0;
BA_ "VFrameFormat" BO_ 615 14;
BA_ "CANFD_BRS" BO_ 615 1;
BA_ "GenMsgCycleTime" BO_ 615 20;
BA_ "GenMsgCycleTimeFast" BO_ 615 0;
BA_ "GenMsgSendType" BO_ 615 0;
BA_ "VFrameFormat" BO_ 615 14;
BA_ "CANFD_BRS" BO_ 615 1;
BA_ "GenMsgCycleTime" BO_ 615 20;
BA_ "GenMsgCycleTimeFast" BO_ 615 0;
BA_ "GenMsgSendType" BO_ 615 0;
BA_ "VFrameFormat" BO_ 615 14;
BA_ "CANFD_BRS" BO_ 615 1;
BA_ "GenMsgCycleTime" BO_ 615 20;
BA_ "GenMsgCycleTimeFast" BO_ 615 0;
BA_ "GenMsgSendType" BO_ 615 0;
BA_ "VFrameFormat" BO_ 615 14;
BA_ "CANFD_BRS" BO_ 615 1;
BA_ "GenMsgCycleTime" BO_ 615 20;
BA_ "GenMsgCycleTimeFast" BO_ 615 0;
BA_ "GenMsgSendType" BO_ 615 0;
BA_ "VFrameFormat" BO_ 615 14;
BA_ "CANFD_BRS" BO_ 615 1;
BA_ "GenMsgCycleTime" BO_ 615 20;
BA_ "GenMsgCycleTimeFast" BO_ 615 0;
BA_ "GenMsgSendType" BO_ 615 0;
BA_ "VFrameFormat" BO_ 615 14;
BA_ "CANFD_BRS" BO_ 615 1;
BA_ "GenMsgCycleTime" BO_ 615 20;
BA_ "GenMsgCycleTimeFast" BO_ 615 0;
BA_ "GenMsgSendType" BO_ 615 0;
BA_ "VFrameFormat" BO_ 615 14;
BA_ "CANFD_BRS" BO_ 615 1;
BA_ "GenMsgCycleTime" BO_ 615 20;
BA_ "GenMsgCycleTimeFast" BO_ 615 0;
BA_ "GenMsgSendType" BO_ 615 0;
BA_ "VFrameFormat" BO_ 615 14;
BA_ "CANFD_BRS" BO_ 615 1;
BA_ "GenMsgCycleTime" BO_ 352 10;
BA_ "GenMsgCycleTimeFast" BO_ 352 0;
BA_ "GenMsgSendType" BO_ 352 0;
BA_ "VFrameFormat" BO_ 352 14;
BA_ "CANFD_BRS" BO_ 352 1;
BA_ "GenMsgCycleTime" BO_ 352 10;
BA_ "GenMsgCycleTimeFast" BO_ 352 0;
BA_ "GenMsgSendType" BO_ 352 0;
BA_ "VFrameFormat" BO_ 352 14;
BA_ "CANFD_BRS" BO_ 352 1;
BA_ "GenMsgCycleTime" BO_ 352 10;
BA_ "GenMsgCycleTimeFast" BO_ 352 0;
BA_ "GenMsgSendType" BO_ 352 0;
BA_ "VFrameFormat" BO_ 352 14;
BA_ "CANFD_BRS" BO_ 352 1;
BA_ "GenMsgCycleTime" BO_ 352 10;
BA_ "GenMsgCycleTimeFast" BO_ 352 0;
BA_ "GenMsgSendType" BO_ 352 0;
BA_ "VFrameFormat" BO_ 352 14;
BA_ "CANFD_BRS" BO_ 352 1;
BA_ "GenMsgCycleTime" BO_ 352 10;
BA_ "GenMsgCycleTimeFast" BO_ 352 0;
BA_ "GenMsgSendType" BO_ 352 0;
BA_ "VFrameFormat" BO_ 352 14;
BA_ "CANFD_BRS" BO_ 352 1;
BA_ "GenMsgCycleTime" BO_ 352 10;
BA_ "GenMsgCycleTimeFast" BO_ 352 0;
BA_ "GenMsgSendType" BO_ 352 0;
BA_ "VFrameFormat" BO_ 352 14;
BA_ "CANFD_BRS" BO_ 352 1;
BA_ "GenMsgCycleTime" BO_ 352 10;
BA_ "GenMsgCycleTimeFast" BO_ 352 0;
BA_ "GenMsgSendType" BO_ 352 0;
BA_ "VFrameFormat" BO_ 352 14;
BA_ "CANFD_BRS" BO_ 352 1;
BA_ "GenMsgCycleTime" BO_ 352 10;
BA_ "GenMsgCycleTimeFast" BO_ 352 0;
BA_ "GenMsgSendType" BO_ 352 0;
BA_ "VFrameFormat" BO_ 352 14;
BA_ "CANFD_BRS" BO_ 352 1;
BA_ "GenMsgCycleTime" BO_ 352 10;
BA_ "GenMsgCycleTimeFast" BO_ 352 0;
BA_ "GenMsgSendType" BO_ 352 0;
BA_ "VFrameFormat" BO_ 352 14;
BA_ "CANFD_BRS" BO_ 352 1;
BA_ "GenMsgCycleTime" BO_ 352 10;
BA_ "GenMsgCycleTimeFast" BO_ 352 0;
BA_ "GenMsgSendType" BO_ 352 0;
BA_ "VFrameFormat" BO_ 352 14;
BA_ "CANFD_BRS" BO_ 352 1;
BA_ "GenMsgCycleTime" BO_ 352 10;
BA_ "GenMsgCycleTimeFast" BO_ 352 0;
BA_ "GenMsgSendType" BO_ 352 0;
BA_ "VFrameFormat" BO_ 352 14;
BA_ "CANFD_BRS" BO_ 352 1;
BA_ "GenMsgCycleTime" BO_ 352 10;
BA_ "GenMsgCycleTimeFast" BO_ 352 0;
BA_ "GenMsgSendType" BO_ 352 0;
BA_ "VFrameFormat" BO_ 352 14;
BA_ "CANFD_BRS" BO_ 352 1;
BA_ "GenMsgCycleTime" BO_ 352 10;
BA_ "GenMsgCycleTimeFast" BO_ 352 0;
BA_ "GenMsgSendType" BO_ 352 0;
BA_ "VFrameFormat" BO_ 352 14;
BA_ "CANFD_BRS" BO_ 352 1;
BA_ "GenMsgCycleTime" BO_ 352 10;
BA_ "GenMsgCycleTimeFast" BO_ 352 0;
BA_ "GenMsgSendType" BO_ 352 0;
BA_ "VFrameFormat" BO_ 352 14;
BA_ "CANFD_BRS" BO_ 352 1;
BA_ "GenMsgCycleTime" BO_ 352 10;
BA_ "GenMsgCycleTimeFast" BO_ 352 0;
BA_ "GenMsgSendType" BO_ 352 0;
BA_ "VFrameFormat" BO_ 352 14;
BA_ "CANFD_BRS" BO_ 352 1;
BA_ "GenMsgCycleTime" BO_ 352 10;
BA_ "GenMsgCycleTimeFast" BO_ 352 0;
BA_ "GenMsgSendType" BO_ 352 0;
BA_ "VFrameFormat" BO_ 352 14;
BA_ "CANFD_BRS" BO_ 352 1;
BA_ "GenMsgCycleTime" BO_ 352 10;
BA_ "GenMsgCycleTimeFast" BO_ 352 0;
BA_ "GenMsgSendType" BO_ 352 0;
BA_ "VFrameFormat" BO_ 352 14;
BA_ "CANFD_BRS" BO_ 352 1;
BA_ "GenMsgCycleTime" BO_ 352 10;
BA_ "GenMsgCycleTimeFast" BO_ 352 0;
BA_ "GenMsgSendType" BO_ 352 0;
BA_ "VFrameFormat" BO_ 352 14;
BA_ "CANFD_BRS" BO_ 352 1;
BA_ "GenMsgCycleTime" BO_ 352 10;
BA_ "GenMsgCycleTimeFast" BO_ 352 0;
BA_ "GenMsgSendType" BO_ 352 0;
BA_ "VFrameFormat" BO_ 352 14;
BA_ "CANFD_BRS" BO_ 352 1;
BA_ "GenMsgCycleTime" BO_ 352 10;
BA_ "GenMsgCycleTimeFast" BO_ 352 0;
BA_ "GenMsgSendType" BO_ 352 0;
BA_ "VFrameFormat" BO_ 352 14;
BA_ "CANFD_BRS" BO_ 352 1;
BA_ "GenMsgCycleTime" BO_ 352 10;
BA_ "GenMsgCycleTimeFast" BO_ 352 0;
BA_ "GenMsgSendType" BO_ 352 0;
BA_ "VFrameFormat" BO_ 352 14;
BA_ "CANFD_BRS" BO_ 352 1;
BA_ "GenMsgCycleTime" BO_ 352 10;
BA_ "GenMsgCycleTimeFast" BO_ 352 0;
BA_ "GenMsgSendType" BO_ 352 0;
BA_ "VFrameFormat" BO_ 352 14;
BA_ "CANFD_BRS" BO_ 352 1;
BA_ "GenMsgCycleTime" BO_ 352 10;
BA_ "GenMsgCycleTimeFast" BO_ 352 0;
BA_ "GenMsgSendType" BO_ 352 0;
BA_ "VFrameFormat" BO_ 352 14;
BA_ "CANFD_BRS" BO_ 352 1;
BA_ "GenMsgCycleTime" BO_ 352 10;
BA_ "GenMsgCycleTimeFast" BO_ 352 0;
BA_ "GenMsgSendType" BO_ 352 0;
BA_ "VFrameFormat" BO_ 352 14;
BA_ "CANFD_BRS" BO_ 352 1;
BA_ "GenMsgCycleTime" BO_ 352 10;
BA_ "GenMsgCycleTimeFast" BO_ 352 0;
BA_ "GenMsgSendType" BO_ 352 0;
BA_ "VFrameFormat" BO_ 352 14;
BA_ "CANFD_BRS" BO_ 352 1;
BA_ "GenMsgCycleTime" BO_ 352 10;
BA_ "GenMsgCycleTimeFast" BO_ 352 0;
BA_ "GenMsgSendType" BO_ 352 0;
BA_ "VFrameFormat" BO_ 352 14;
BA_ "CANFD_BRS" BO_ 352 1;
BA_ "GenMsgCycleTime" BO_ 352 10;
BA_ "GenMsgCycleTimeFast" BO_ 352 0;
BA_ "GenMsgSendType" BO_ 352 0;
BA_ "VFrameFormat" BO_ 352 14;
BA_ "CANFD_BRS" BO_ 352 1;
BA_ "GenMsgCycleTime" BO_ 352 10;
BA_ "GenMsgCycleTimeFast" BO_ 352 0;
BA_ "GenMsgSendType" BO_ 352 0;
BA_ "VFrameFormat" BO_ 352 14;
BA_ "CANFD_BRS" BO_ 352 1;
BA_ "GenMsgCycleTime" BO_ 352 10;
BA_ "GenMsgCycleTimeFast" BO_ 352 0;
BA_ "GenMsgSendType" BO_ 352 0;
BA_ "VFrameFormat" BO_ 352 14;
BA_ "CANFD_BRS" BO_ 352 1;
BA_ "GenMsgCycleTime" BO_ 352 10;
BA_ "GenMsgCycleTimeFast" BO_ 352 0;
BA_ "GenMsgSendType" BO_ 352 0;
BA_ "VFrameFormat" BO_ 352 14;
BA_ "CANFD_BRS" BO_ 352 1;
BA_ "GenMsgCycleTime" BO_ 352 10;
BA_ "GenMsgCycleTimeFast" BO_ 352 0;
BA_ "GenMsgSendType" BO_ 352 0;
BA_ "VFrameFormat" BO_ 352 14;
BA_ "CANFD_BRS" BO_ 352 1;
BA_ "GenMsgCycleTime" BO_ 352 10;
BA_ "GenMsgCycleTimeFast" BO_ 352 0;
BA_ "GenMsgSendType" BO_ 352 0;
BA_ "VFrameFormat" BO_ 352 14;
BA_ "CANFD_BRS" BO_ 352 1;
BA_ "GenMsgCycleTime" BO_ 352 10;
BA_ "GenMsgCycleTimeFast" BO_ 352 0;
BA_ "GenMsgSendType" BO_ 352 0;
BA_ "VFrameFormat" BO_ 352 14;
BA_ "CANFD_BRS" BO_ 352 1;
BA_ "GenMsgCycleTime" BO_ 352 10;
BA_ "GenMsgCycleTimeFast" BO_ 352 0;
BA_ "GenMsgSendType" BO_ 352 0;
BA_ "VFrameFormat" BO_ 352 14;
BA_ "CANFD_BRS" BO_ 352 1;
BA_ "GenMsgCycleTime" BO_ 352 10;
BA_ "GenMsgCycleTimeFast" BO_ 352 0;
BA_ "GenMsgSendType" BO_ 352 0;
BA_ "VFrameFormat" BO_ 352 14;
BA_ "CANFD_BRS" BO_ 352 1;
BA_ "GenMsgCycleTime" BO_ 352 10;
BA_ "GenMsgCycleTimeFast" BO_ 352 0;
BA_ "GenMsgSendType" BO_ 352 0;
BA_ "VFrameFormat" BO_ 352 14;
BA_ "CANFD_BRS" BO_ 352 1;
BA_ "GenMsgCycleTime" BO_ 352 10;
BA_ "GenMsgCycleTimeFast" BO_ 352 0;
BA_ "GenMsgSendType" BO_ 352 0;
BA_ "VFrameFormat" BO_ 352 14;
BA_ "CANFD_BRS" BO_ 352 1;
BA_ "GenMsgCycleTime" BO_ 352 10;
BA_ "GenMsgCycleTimeFast" BO_ 352 0;
BA_ "GenMsgSendType" BO_ 352 0;
BA_ "VFrameFormat" BO_ 352 14;
BA_ "CANFD_BRS" BO_ 352 1;
BA_ "GenMsgCycleTime" BO_ 352 10;
BA_ "GenMsgCycleTimeFast" BO_ 352 0;
BA_ "GenMsgSendType" BO_ 352 0;
BA_ "VFrameFormat" BO_ 352 14;
BA_ "CANFD_BRS" BO_ 352 1;
BA_ "GenMsgCycleTime" BO_ 352 10;
BA_ "GenMsgCycleTimeFast" BO_ 352 0;
BA_ "GenMsgSendType" BO_ 352 0;
BA_ "VFrameFormat" BO_ 352 14;
BA_ "CANFD_BRS" BO_ 352 1;
BA_ "GenMsgCycleTime" BO_ 352 10;
BA_ "GenMsgCycleTimeFast" BO_ 352 0;
BA_ "GenMsgSendType" BO_ 352 0;
BA_ "VFrameFormat" BO_ 352 14;
BA_ "CANFD_BRS" BO_ 352 1;
BA_ "GenMsgCycleTime" BO_ 352 10;
BA_ "GenMsgCycleTimeFast" BO_ 352 0;
BA_ "GenMsgSendType" BO_ 352 0;
BA_ "VFrameFormat" BO_ 352 14;
BA_ "CANFD_BRS" BO_ 352 1;
BA_ "GenMsgCycleTime" BO_ 352 10;
BA_ "GenMsgCycleTimeFast" BO_ 352 0;
BA_ "GenMsgSendType" BO_ 352 0;
BA_ "VFrameFormat" BO_ 352 14;
BA_ "CANFD_BRS" BO_ 352 1;
BA_ "GenMsgCycleTime" BO_ 352 10;
BA_ "GenMsgCycleTimeFast" BO_ 352 0;
BA_ "GenMsgSendType" BO_ 352 0;
BA_ "VFrameFormat" BO_ 352 14;
BA_ "CANFD_BRS" BO_ 352 1;
BA_ "GenMsgCycleTime" BO_ 352 10;
BA_ "GenMsgCycleTimeFast" BO_ 352 0;
BA_ "GenMsgSendType" BO_ 352 0;
BA_ "VFrameFormat" BO_ 352 14;
BA_ "CANFD_BRS" BO_ 352 1;
BA_ "GenMsgCycleTime" BO_ 352 10;
BA_ "GenMsgCycleTimeFast" BO_ 352 0;
BA_ "GenMsgSendType" BO_ 352 0;
BA_ "VFrameFormat" BO_ 352 14;
BA_ "CANFD_BRS" BO_ 352 1;
BA_ "GenMsgCycleTime" BO_ 352 10;
BA_ "GenMsgCycleTimeFast" BO_ 352 0;
BA_ "GenMsgSendType" BO_ 352 0;
BA_ "VFrameFormat" BO_ 352 14;
BA_ "CANFD_BRS" BO_ 352 1;
BA_ "GenMsgCycleTime" BO_ 352 10;
BA_ "GenMsgCycleTimeFast" BO_ 352 0;
BA_ "GenMsgSendType" BO_ 352 0;
BA_ "VFrameFormat" BO_ 352 14;
BA_ "CANFD_BRS" BO_ 352 1;
BA_ "GenMsgCycleTime" BO_ 352 10;
BA_ "GenMsgCycleTimeFast" BO_ 352 0;
BA_ "GenMsgSendType" BO_ 352 0;
BA_ "VFrameFormat" BO_ 352 14;
BA_ "CANFD_BRS" BO_ 352 1;
BA_ "GenMsgCycleTime" BO_ 352 10;
BA_ "GenMsgCycleTimeFast" BO_ 352 0;
BA_ "GenMsgSendType" BO_ 352 0;
BA_ "VFrameFormat" BO_ 352 14;
BA_ "CANFD_BRS" BO_ 352 1;
BA_ "GenMsgCycleTime" BO_ 352 10;
BA_ "GenMsgCycleTimeFast" BO_ 352 0;
BA_ "GenMsgSendType" BO_ 352 0;
BA_ "VFrameFormat" BO_ 352 14;
BA_ "CANFD_BRS" BO_ 352 1;
BA_ "GenMsgCycleTime" BO_ 611 20;
BA_ "GenMsgCycleTimeFast" BO_ 611 0;
BA_ "GenMsgSendType" BO_ 611 0;
BA_ "VFrameFormat" BO_ 611 14;
BA_ "CANFD_BRS" BO_ 611 1;
BA_ "GenMsgCycleTime" BO_ 611 20;
BA_ "GenMsgCycleTimeFast" BO_ 611 0;
BA_ "GenMsgSendType" BO_ 611 0;
BA_ "VFrameFormat" BO_ 611 14;
BA_ "CANFD_BRS" BO_ 611 1;
BA_ "GenMsgCycleTime" BO_ 611 20;
BA_ "GenMsgCycleTimeFast" BO_ 611 0;
BA_ "GenMsgSendType" BO_ 611 0;
BA_ "VFrameFormat" BO_ 611 14;
BA_ "CANFD_BRS" BO_ 611 1;
BA_ "GenMsgCycleTime" BO_ 611 20;
BA_ "GenMsgCycleTimeFast" BO_ 611 0;
BA_ "GenMsgSendType" BO_ 611 0;
BA_ "VFrameFormat" BO_ 611 14;
BA_ "CANFD_BRS" BO_ 611 1;
BA_ "GenMsgCycleTime" BO_ 611 20;
BA_ "GenMsgCycleTimeFast" BO_ 611 0;
BA_ "GenMsgSendType" BO_ 611 0;
BA_ "VFrameFormat" BO_ 611 14;
BA_ "CANFD_BRS" BO_ 611 1;
BA_ "GenMsgCycleTime" BO_ 611 20;
BA_ "GenMsgCycleTimeFast" BO_ 611 0;
BA_ "GenMsgSendType" BO_ 611 0;
BA_ "VFrameFormat" BO_ 611 14;
BA_ "CANFD_BRS" BO_ 611 1;
BA_ "GenMsgCycleTime" BO_ 611 20;
BA_ "GenMsgCycleTimeFast" BO_ 611 0;
BA_ "GenMsgSendType" BO_ 611 0;
BA_ "VFrameFormat" BO_ 611 14;
BA_ "CANFD_BRS" BO_ 611 1;
BA_ "GenMsgCycleTime" BO_ 611 20;
BA_ "GenMsgCycleTimeFast" BO_ 611 0;
BA_ "GenMsgSendType" BO_ 611 0;
BA_ "VFrameFormat" BO_ 611 14;
BA_ "CANFD_BRS" BO_ 611 1;
BA_ "GenMsgCycleTime" BO_ 611 20;
BA_ "GenMsgCycleTimeFast" BO_ 611 0;
BA_ "GenMsgSendType" BO_ 611 0;
BA_ "VFrameFormat" BO_ 611 14;
BA_ "CANFD_BRS" BO_ 611 1;
BA_ "GenMsgCycleTime" BO_ 611 20;
BA_ "GenMsgCycleTimeFast" BO_ 611 0;
BA_ "GenMsgSendType" BO_ 611 0;
BA_ "VFrameFormat" BO_ 611 14;
BA_ "CANFD_BRS" BO_ 611 1;
BA_ "GenMsgCycleTime" BO_ 611 20;
BA_ "GenMsgCycleTimeFast" BO_ 611 0;
BA_ "GenMsgSendType" BO_ 611 0;
BA_ "VFrameFormat" BO_ 611 14;
BA_ "CANFD_BRS" BO_ 611 1;
BA_ "GenMsgCycleTime" BO_ 611 20;
BA_ "GenMsgCycleTimeFast" BO_ 611 0;
BA_ "GenMsgSendType" BO_ 611 0;
BA_ "VFrameFormat" BO_ 611 14;
BA_ "CANFD_BRS" BO_ 611 1;
BA_ "GenMsgCycleTime" BO_ 611 20;
BA_ "GenMsgCycleTimeFast" BO_ 611 0;
BA_ "GenMsgSendType" BO_ 611 0;
BA_ "VFrameFormat" BO_ 611 14;
BA_ "CANFD_BRS" BO_ 611 1;
BA_ "GenMsgCycleTime" BO_ 611 20;
BA_ "GenMsgCycleTimeFast" BO_ 611 0;
BA_ "GenMsgSendType" BO_ 611 0;
BA_ "VFrameFormat" BO_ 611 14;
BA_ "CANFD_BRS" BO_ 611 1;
BA_ "GenMsgCycleTime" BO_ 611 20;
BA_ "GenMsgCycleTimeFast" BO_ 611 0;
BA_ "GenMsgSendType" BO_ 611 0;
BA_ "VFrameFormat" BO_ 611 14;
BA_ "CANFD_BRS" BO_ 611 1;
BA_ "GenMsgCycleTime" BO_ 360 10;
BA_ "GenMsgCycleTimeFast" BO_ 360 0;
BA_ "GenMsgSendType" BO_ 360 0;
BA_ "VFrameFormat" BO_ 360 14;
BA_ "CANFD_BRS" BO_ 360 1;
BA_ "GenMsgCycleTime" BO_ 360 10;
BA_ "GenMsgCycleTimeFast" BO_ 360 0;
BA_ "GenMsgSendType" BO_ 360 0;
BA_ "VFrameFormat" BO_ 360 14;
BA_ "CANFD_BRS" BO_ 360 1;
BA_ "GenMsgCycleTime" BO_ 360 10;
BA_ "GenMsgCycleTimeFast" BO_ 360 0;
BA_ "GenMsgSendType" BO_ 360 0;
BA_ "VFrameFormat" BO_ 360 14;
BA_ "CANFD_BRS" BO_ 360 1;
BA_ "GenMsgCycleTime" BO_ 360 10;
BA_ "GenMsgCycleTimeFast" BO_ 360 0;
BA_ "GenMsgSendType" BO_ 360 0;
BA_ "VFrameFormat" BO_ 360 14;
BA_ "CANFD_BRS" BO_ 360 1;
BA_ "GenMsgCycleTime" BO_ 360 10;
BA_ "GenMsgCycleTimeFast" BO_ 360 0;
BA_ "GenMsgSendType" BO_ 360 0;
BA_ "VFrameFormat" BO_ 360 14;
BA_ "CANFD_BRS" BO_ 360 1;
BA_ "GenMsgCycleTime" BO_ 360 10;
BA_ "GenMsgCycleTimeFast" BO_ 360 0;
BA_ "GenMsgSendType" BO_ 360 0;
BA_ "VFrameFormat" BO_ 360 14;
BA_ "CANFD_BRS" BO_ 360 1;
BA_ "GenMsgCycleTime" BO_ 360 10;
BA_ "GenMsgCycleTimeFast" BO_ 360 0;
BA_ "GenMsgSendType" BO_ 360 0;
BA_ "VFrameFormat" BO_ 360 14;
BA_ "CANFD_BRS" BO_ 360 1;
BA_ "GenMsgCycleTime" BO_ 360 10;
BA_ "GenMsgCycleTimeFast" BO_ 360 0;
BA_ "GenMsgSendType" BO_ 360 0;
BA_ "VFrameFormat" BO_ 360 14;
BA_ "CANFD_BRS" BO_ 360 1;
BA_ "GenMsgCycleTime" BO_ 360 10;
BA_ "GenMsgCycleTimeFast" BO_ 360 0;
BA_ "GenMsgSendType" BO_ 360 0;
BA_ "VFrameFormat" BO_ 360 14;
BA_ "CANFD_BRS" BO_ 360 1;
BA_ "GenMsgCycleTime" BO_ 360 10;
BA_ "GenMsgCycleTimeFast" BO_ 360 0;
BA_ "GenMsgSendType" BO_ 360 0;
BA_ "VFrameFormat" BO_ 360 14;
BA_ "CANFD_BRS" BO_ 360 1;
BA_ "GenMsgCycleTime" BO_ 360 10;
BA_ "GenMsgCycleTimeFast" BO_ 360 0;
BA_ "GenMsgSendType" BO_ 360 0;
BA_ "VFrameFormat" BO_ 360 14;
BA_ "CANFD_BRS" BO_ 360 1;
BA_ "GenMsgCycleTime" BO_ 360 10;
BA_ "GenMsgCycleTimeFast" BO_ 360 0;
BA_ "GenMsgSendType" BO_ 360 0;
BA_ "VFrameFormat" BO_ 360 14;
BA_ "CANFD_BRS" BO_ 360 1;
BA_ "GenMsgCycleTime" BO_ 360 10;
BA_ "GenMsgCycleTimeFast" BO_ 360 0;
BA_ "GenMsgSendType" BO_ 360 0;
BA_ "VFrameFormat" BO_ 360 14;
BA_ "CANFD_BRS" BO_ 360 1;
BA_ "GenMsgCycleTime" BO_ 360 10;
BA_ "GenMsgCycleTimeFast" BO_ 360 0;
BA_ "GenMsgSendType" BO_ 360 0;
BA_ "VFrameFormat" BO_ 360 14;
BA_ "CANFD_BRS" BO_ 360 1;
BA_ "GenMsgCycleTime" BO_ 360 10;
BA_ "GenMsgCycleTimeFast" BO_ 360 0;
BA_ "GenMsgSendType" BO_ 360 0;
BA_ "VFrameFormat" BO_ 360 14;
BA_ "CANFD_BRS" BO_ 360 1;
BA_ "GenMsgCycleTime" BO_ 360 10;
BA_ "GenMsgCycleTimeFast" BO_ 360 0;
BA_ "GenMsgSendType" BO_ 360 0;
BA_ "VFrameFormat" BO_ 360 14;
BA_ "CANFD_BRS" BO_ 360 1;
BA_ "GenMsgCycleTime" BO_ 360 10;
BA_ "GenMsgCycleTimeFast" BO_ 360 0;
BA_ "GenMsgSendType" BO_ 360 0;
BA_ "VFrameFormat" BO_ 360 14;
BA_ "CANFD_BRS" BO_ 360 1;
BA_ "GenMsgCycleTime" BO_ 360 10;
BA_ "GenMsgCycleTimeFast" BO_ 360 0;
BA_ "GenMsgSendType" BO_ 360 0;
BA_ "VFrameFormat" BO_ 360 14;
BA_ "CANFD_BRS" BO_ 360 1;
BA_ "GenMsgCycleTime" BO_ 360 10;
BA_ "GenMsgCycleTimeFast" BO_ 360 0;
BA_ "GenMsgSendType" BO_ 360 0;
BA_ "VFrameFormat" BO_ 360 14;
BA_ "CANFD_BRS" BO_ 360 1;
BA_ "GenMsgCycleTime" BO_ 360 10;
BA_ "GenMsgCycleTimeFast" BO_ 360 0;
BA_ "GenMsgSendType" BO_ 360 0;
BA_ "VFrameFormat" BO_ 360 14;
BA_ "CANFD_BRS" BO_ 360 1;
BA_ "GenMsgCycleTime" BO_ 360 10;
BA_ "GenMsgCycleTimeFast" BO_ 360 0;
BA_ "GenMsgSendType" BO_ 360 0;
BA_ "VFrameFormat" BO_ 360 14;
BA_ "CANFD_BRS" BO_ 360 1;
BA_ "GenMsgCycleTime" BO_ 360 10;
BA_ "GenMsgCycleTimeFast" BO_ 360 0;
BA_ "GenMsgSendType" BO_ 360 0;
BA_ "VFrameFormat" BO_ 360 14;
BA_ "CANFD_BRS" BO_ 360 1;
BA_ "GenMsgCycleTime" BO_ 360 10;
BA_ "GenMsgCycleTimeFast" BO_ 360 0;
BA_ "GenMsgSendType" BO_ 360 0;
BA_ "VFrameFormat" BO_ 360 14;
BA_ "CANFD_BRS" BO_ 360 1;
BA_ "GenMsgCycleTime" BO_ 360 10;
BA_ "GenMsgCycleTimeFast" BO_ 360 0;
BA_ "GenMsgSendType" BO_ 360 0;
BA_ "VFrameFormat" BO_ 360 14;
BA_ "CANFD_BRS" BO_ 360 1;
BA_ "GenMsgCycleTime" BO_ 360 10;
BA_ "GenMsgCycleTimeFast" BO_ 360 0;
BA_ "GenMsgSendType" BO_ 360 0;
BA_ "VFrameFormat" BO_ 360 14;
BA_ "CANFD_BRS" BO_ 360 1;
BA_ "GenMsgCycleTime" BO_ 360 10;
BA_ "GenMsgCycleTimeFast" BO_ 360 0;
BA_ "GenMsgSendType" BO_ 360 0;
BA_ "VFrameFormat" BO_ 360 14;
BA_ "CANFD_BRS" BO_ 360 1;
BA_ "GenMsgCycleTime" BO_ 360 10;
BA_ "GenMsgCycleTimeFast" BO_ 360 0;
BA_ "GenMsgSendType" BO_ 360 0;
BA_ "VFrameFormat" BO_ 360 14;
BA_ "CANFD_BRS" BO_ 360 1;
BA_ "GenMsgCycleTime" BO_ 360 10;
BA_ "GenMsgCycleTimeFast" BO_ 360 0;
BA_ "GenMsgSendType" BO_ 360 0;
BA_ "VFrameFormat" BO_ 360 14;
BA_ "CANFD_BRS" BO_ 360 1;
BA_ "GenMsgCycleTime" BO_ 360 10;
BA_ "GenMsgCycleTimeFast" BO_ 360 0;
BA_ "GenMsgSendType" BO_ 360 0;
BA_ "VFrameFormat" BO_ 360 14;
BA_ "CANFD_BRS" BO_ 360 1;
BA_ "GenMsgCycleTime" BO_ 360 10;
BA_ "GenMsgCycleTimeFast" BO_ 360 0;
BA_ "GenMsgSendType" BO_ 360 0;
BA_ "VFrameFormat" BO_ 360 14;
BA_ "CANFD_BRS" BO_ 360 1;
BA_ "GenMsgCycleTime" BO_ 360 10;
BA_ "GenMsgCycleTimeFast" BO_ 360 0;
BA_ "GenMsgSendType" BO_ 360 0;
BA_ "VFrameFormat" BO_ 360 14;
BA_ "CANFD_BRS" BO_ 360 1;
BA_ "GenMsgCycleTime" BO_ 360 10;
BA_ "GenMsgCycleTimeFast" BO_ 360 0;
BA_ "GenMsgSendType" BO_ 360 0;
BA_ "VFrameFormat" BO_ 360 14;
BA_ "CANFD_BRS" BO_ 360 1;
BA_ "GenMsgCycleTime" BO_ 360 10;
BA_ "GenMsgCycleTimeFast" BO_ 360 0;
BA_ "GenMsgSendType" BO_ 360 0;
BA_ "VFrameFormat" BO_ 360 14;
BA_ "CANFD_BRS" BO_ 360 1;
BA_ "GenMsgCycleTime" BO_ 360 10;
BA_ "GenMsgCycleTimeFast" BO_ 360 0;
BA_ "GenMsgSendType" BO_ 360 0;
BA_ "VFrameFormat" BO_ 360 14;
BA_ "CANFD_BRS" BO_ 360 1;
BA_ "GenMsgCycleTime" BO_ 360 10;
BA_ "GenMsgCycleTimeFast" BO_ 360 0;
BA_ "GenMsgSendType" BO_ 360 0;
BA_ "VFrameFormat" BO_ 360 14;
BA_ "CANFD_BRS" BO_ 360 1;
BA_ "GenMsgCycleTime" BO_ 360 10;
BA_ "GenMsgCycleTimeFast" BO_ 360 0;
BA_ "GenMsgSendType" BO_ 360 0;
BA_ "VFrameFormat" BO_ 360 14;
BA_ "CANFD_BRS" BO_ 360 1;
BA_ "GenMsgCycleTime" BO_ 360 10;
BA_ "GenMsgCycleTimeFast" BO_ 360 0;
BA_ "GenMsgSendType" BO_ 360 0;
BA_ "VFrameFormat" BO_ 360 14;
BA_ "CANFD_BRS" BO_ 360 1;
BA_ "GenMsgCycleTime" BO_ 360 10;
BA_ "GenMsgCycleTimeFast" BO_ 360 0;
BA_ "GenMsgSendType" BO_ 360 0;
BA_ "VFrameFormat" BO_ 360 14;
BA_ "CANFD_BRS" BO_ 360 1;
BA_ "GenMsgCycleTime" BO_ 360 10;
BA_ "GenMsgCycleTimeFast" BO_ 360 0;
BA_ "GenMsgSendType" BO_ 360 0;
BA_ "VFrameFormat" BO_ 360 14;
BA_ "CANFD_BRS" BO_ 360 1;
BA_ "GenMsgCycleTime" BO_ 618 20;
BA_ "GenMsgCycleTimeFast" BO_ 618 0;
BA_ "GenMsgSendType" BO_ 618 0;
BA_ "VFrameFormat" BO_ 618 14;
BA_ "CANFD_BRS" BO_ 618 1;
BA_ "GenMsgCycleTime" BO_ 618 20;
BA_ "GenMsgCycleTimeFast" BO_ 618 0;
BA_ "GenMsgSendType" BO_ 618 0;
BA_ "VFrameFormat" BO_ 618 14;
BA_ "CANFD_BRS" BO_ 618 1;
BA_ "GenMsgCycleTime" BO_ 618 20;
BA_ "GenMsgCycleTimeFast" BO_ 618 0;
BA_ "GenMsgSendType" BO_ 618 0;
BA_ "VFrameFormat" BO_ 618 14;
BA_ "CANFD_BRS" BO_ 618 1;
BA_ "GenMsgCycleTime" BO_ 618 20;
BA_ "GenMsgCycleTimeFast" BO_ 618 0;
BA_ "GenMsgSendType" BO_ 618 0;
BA_ "VFrameFormat" BO_ 618 14;
BA_ "CANFD_BRS" BO_ 618 1;
BA_ "GenMsgCycleTime" BO_ 618 20;
BA_ "GenMsgCycleTimeFast" BO_ 618 0;
BA_ "GenMsgSendType" BO_ 618 0;
BA_ "VFrameFormat" BO_ 618 14;
BA_ "CANFD_BRS" BO_ 618 1;
BA_ "GenMsgCycleTime" BO_ 618 20;
BA_ "GenMsgCycleTimeFast" BO_ 618 0;
BA_ "GenMsgSendType" BO_ 618 0;
BA_ "VFrameFormat" BO_ 618 14;
BA_ "CANFD_BRS" BO_ 618 1;
BA_ "GenMsgCycleTime" BO_ 618 20;
BA_ "GenMsgCycleTimeFast" BO_ 618 0;
BA_ "GenMsgSendType" BO_ 618 0;
BA_ "VFrameFormat" BO_ 618 14;
BA_ "CANFD_BRS" BO_ 618 1;
BA_ "GenMsgCycleTime" BO_ 618 20;
BA_ "GenMsgCycleTimeFast" BO_ 618 0;
BA_ "GenMsgSendType" BO_ 618 0;
BA_ "VFrameFormat" BO_ 618 14;
BA_ "CANFD_BRS" BO_ 618 1;
BA_ "GenMsgCycleTime" BO_ 618 20;
BA_ "GenMsgCycleTimeFast" BO_ 618 0;
BA_ "GenMsgSendType" BO_ 618 0;
BA_ "VFrameFormat" BO_ 618 14;
BA_ "CANFD_BRS" BO_ 618 1;
BA_ "GenMsgCycleTime" BO_ 618 20;
BA_ "GenMsgCycleTimeFast" BO_ 618 0;
BA_ "GenMsgSendType" BO_ 618 0;
BA_ "VFrameFormat" BO_ 618 14;
BA_ "CANFD_BRS" BO_ 618 1;
BA_ "GenMsgCycleTime" BO_ 618 20;
BA_ "GenMsgCycleTimeFast" BO_ 618 0;
BA_ "GenMsgSendType" BO_ 618 0;
BA_ "VFrameFormat" BO_ 618 14;
BA_ "CANFD_BRS" BO_ 618 1;
BA_ "GenMsgCycleTime" BO_ 618 20;
BA_ "GenMsgCycleTimeFast" BO_ 618 0;
BA_ "GenMsgSendType" BO_ 618 0;
BA_ "VFrameFormat" BO_ 618 14;
BA_ "CANFD_BRS" BO_ 618 1;
BA_ "GenMsgCycleTime" BO_ 618 20;
BA_ "GenMsgCycleTimeFast" BO_ 618 0;
BA_ "GenMsgSendType" BO_ 618 0;
BA_ "VFrameFormat" BO_ 618 14;
BA_ "CANFD_BRS" BO_ 618 1;
BA_ "GenMsgCycleTime" BO_ 618 20;
BA_ "GenMsgCycleTimeFast" BO_ 618 0;
BA_ "GenMsgSendType" BO_ 618 0;
BA_ "VFrameFormat" BO_ 618 14;
BA_ "CANFD_BRS" BO_ 618 1;
BA_ "GenMsgCycleTime" BO_ 618 20;
BA_ "GenMsgCycleTimeFast" BO_ 618 0;
BA_ "GenMsgSendType" BO_ 618 0;
BA_ "VFrameFormat" BO_ 618 14;
BA_ "CANFD_BRS" BO_ 618 1;
BA_ "GenMsgCycleTime" BO_ 618 20;
BA_ "GenMsgCycleTimeFast" BO_ 618 0;
BA_ "GenMsgSendType" BO_ 618 0;
BA_ "VFrameFormat" BO_ 618 14;
BA_ "CANFD_BRS" BO_ 618 1;
BA_ "GenMsgCycleTime" BO_ 446 10;
BA_ "GenMsgCycleTimeFast" BO_ 446 0;
BA_ "GenMsgSendType" BO_ 446 0;
BA_ "VFrameFormat" BO_ 446 14;
BA_ "CANFD_BRS" BO_ 446 1;
BA_ "GenMsgCycleTime" BO_ 446 10;
BA_ "GenMsgCycleTimeFast" BO_ 446 0;
BA_ "GenMsgSendType" BO_ 446 0;
BA_ "VFrameFormat" BO_ 446 14;
BA_ "CANFD_BRS" BO_ 446 1;
BA_ "GenMsgCycleTime" BO_ 446 10;
BA_ "GenMsgCycleTimeFast" BO_ 446 0;
BA_ "GenMsgSendType" BO_ 446 0;
BA_ "VFrameFormat" BO_ 446 14;
BA_ "CANFD_BRS" BO_ 446 1;
BA_ "GenMsgCycleTime" BO_ 446 10;
BA_ "GenMsgCycleTimeFast" BO_ 446 0;
BA_ "GenMsgSendType" BO_ 446 0;
BA_ "VFrameFormat" BO_ 446 14;
BA_ "CANFD_BRS" BO_ 446 1;
BA_ "GenMsgCycleTime" BO_ 446 10;
BA_ "GenMsgCycleTimeFast" BO_ 446 0;
BA_ "GenMsgSendType" BO_ 446 0;
BA_ "VFrameFormat" BO_ 446 14;
BA_ "CANFD_BRS" BO_ 446 1;
BA_ "GenMsgCycleTime" BO_ 446 10;
BA_ "GenMsgCycleTimeFast" BO_ 446 0;
BA_ "GenMsgSendType" BO_ 446 0;
BA_ "VFrameFormat" BO_ 446 14;
BA_ "CANFD_BRS" BO_ 446 1;
BA_ "GenMsgCycleTime" BO_ 446 10;
BA_ "GenMsgCycleTimeFast" BO_ 446 0;
BA_ "GenMsgSendType" BO_ 446 0;
BA_ "VFrameFormat" BO_ 446 14;
BA_ "CANFD_BRS" BO_ 446 1;
BA_ "GenMsgCycleTime" BO_ 446 10;
BA_ "GenMsgCycleTimeFast" BO_ 446 0;
BA_ "GenMsgSendType" BO_ 446 0;
BA_ "VFrameFormat" BO_ 446 14;
BA_ "CANFD_BRS" BO_ 446 1;
BA_ "GenMsgCycleTime" BO_ 446 10;
BA_ "GenMsgCycleTimeFast" BO_ 446 0;
BA_ "GenMsgSendType" BO_ 446 0;
BA_ "VFrameFormat" BO_ 446 14;
BA_ "CANFD_BRS" BO_ 446 1;
BA_ "GenMsgCycleTime" BO_ 446 10;
BA_ "GenMsgCycleTimeFast" BO_ 446 0;
BA_ "GenMsgSendType" BO_ 446 0;
BA_ "VFrameFormat" BO_ 446 14;
BA_ "CANFD_BRS" BO_ 446 1;
BA_ "GenMsgCycleTime" BO_ 446 10;
BA_ "GenMsgCycleTimeFast" BO_ 446 0;
BA_ "GenMsgSendType" BO_ 446 0;
BA_ "VFrameFormat" BO_ 446 14;
BA_ "CANFD_BRS" BO_ 446 1;
BA_ "GenMsgCycleTime" BO_ 446 10;
BA_ "GenMsgCycleTimeFast" BO_ 446 0;
BA_ "GenMsgSendType" BO_ 446 0;
BA_ "VFrameFormat" BO_ 446 14;
BA_ "CANFD_BRS" BO_ 446 1;
BA_ "GenMsgCycleTime" BO_ 446 10;
BA_ "GenMsgCycleTimeFast" BO_ 446 0;
BA_ "GenMsgSendType" BO_ 446 0;
BA_ "VFrameFormat" BO_ 446 14;
BA_ "CANFD_BRS" BO_ 446 1;
BA_ "GenMsgCycleTime" BO_ 446 10;
BA_ "GenMsgCycleTimeFast" BO_ 446 0;
BA_ "GenMsgSendType" BO_ 446 0;
BA_ "VFrameFormat" BO_ 446 14;
BA_ "CANFD_BRS" BO_ 446 1;
BA_ "GenMsgCycleTime" BO_ 446 10;
BA_ "GenMsgCycleTimeFast" BO_ 446 0;
BA_ "GenMsgSendType" BO_ 446 0;
BA_ "VFrameFormat" BO_ 446 14;
BA_ "CANFD_BRS" BO_ 446 1;
BA_ "GenMsgCycleTime" BO_ 446 10;
BA_ "GenMsgCycleTimeFast" BO_ 446 0;
BA_ "GenMsgSendType" BO_ 446 0;
BA_ "VFrameFormat" BO_ 446 14;
BA_ "CANFD_BRS" BO_ 446 1;
BA_ "GenMsgCycleTime" BO_ 446 10;
BA_ "GenMsgCycleTimeFast" BO_ 446 0;
BA_ "GenMsgSendType" BO_ 446 0;
BA_ "VFrameFormat" BO_ 446 14;
BA_ "CANFD_BRS" BO_ 446 1;
BA_ "GenMsgCycleTime" BO_ 446 10;
BA_ "GenMsgCycleTimeFast" BO_ 446 0;
BA_ "GenMsgSendType" BO_ 446 0;
BA_ "VFrameFormat" BO_ 446 14;
BA_ "CANFD_BRS" BO_ 446 1;
BA_ "GenMsgCycleTime" BO_ 446 10;
BA_ "GenMsgCycleTimeFast" BO_ 446 0;
BA_ "GenMsgSendType" BO_ 446 0;
BA_ "VFrameFormat" BO_ 446 14;
BA_ "CANFD_BRS" BO_ 446 1;
BA_ "GenMsgCycleTime" BO_ 446 10;
BA_ "GenMsgCycleTimeFast" BO_ 446 0;
BA_ "GenMsgSendType" BO_ 446 0;
BA_ "VFrameFormat" BO_ 446 14;
BA_ "CANFD_BRS" BO_ 446 1;
BA_ "GenMsgCycleTime" BO_ 446 10;
BA_ "GenMsgCycleTimeFast" BO_ 446 0;
BA_ "GenMsgSendType" BO_ 446 0;
BA_ "VFrameFormat" BO_ 446 14;
BA_ "CANFD_BRS" BO_ 446 1;
BA_ "GenMsgCycleTime" BO_ 446 10;
BA_ "GenMsgCycleTimeFast" BO_ 446 0;
BA_ "GenMsgSendType" BO_ 446 0;
BA_ "VFrameFormat" BO_ 446 14;
BA_ "CANFD_BRS" BO_ 446 1;
BA_ "GenMsgCycleTime" BO_ 446 10;
BA_ "GenMsgCycleTimeFast" BO_ 446 0;
BA_ "GenMsgSendType" BO_ 446 0;
BA_ "VFrameFormat" BO_ 446 14;
BA_ "CANFD_BRS" BO_ 446 1;
BA_ "GenMsgCycleTime" BO_ 446 10;
BA_ "GenMsgCycleTimeFast" BO_ 446 0;
BA_ "GenMsgSendType" BO_ 446 0;
BA_ "VFrameFormat" BO_ 446 14;
BA_ "CANFD_BRS" BO_ 446 1;
BA_ "GenMsgCycleTime" BO_ 446 10;
BA_ "GenMsgCycleTimeFast" BO_ 446 0;
BA_ "GenMsgSendType" BO_ 446 0;
BA_ "VFrameFormat" BO_ 446 14;
BA_ "CANFD_BRS" BO_ 446 1;
BA_ "GenMsgCycleTime" BO_ 446 10;
BA_ "GenMsgCycleTimeFast" BO_ 446 0;
BA_ "GenMsgSendType" BO_ 446 0;
BA_ "VFrameFormat" BO_ 446 14;
BA_ "CANFD_BRS" BO_ 446 1;
BA_ "GenMsgCycleTime" BO_ 446 10;
BA_ "GenMsgCycleTimeFast" BO_ 446 0;
BA_ "GenMsgSendType" BO_ 446 0;
BA_ "VFrameFormat" BO_ 446 14;
BA_ "CANFD_BRS" BO_ 446 1;
BA_ "GenMsgCycleTime" BO_ 446 10;
BA_ "GenMsgCycleTimeFast" BO_ 446 0;
BA_ "GenMsgSendType" BO_ 446 0;
BA_ "VFrameFormat" BO_ 446 14;
BA_ "CANFD_BRS" BO_ 446 1;
BA_ "GenMsgCycleTime" BO_ 446 10;
BA_ "GenMsgCycleTimeFast" BO_ 446 0;
BA_ "GenMsgSendType" BO_ 446 0;
BA_ "VFrameFormat" BO_ 446 14;
BA_ "CANFD_BRS" BO_ 446 1;
BA_ "GenMsgCycleTime" BO_ 446 10;
BA_ "GenMsgCycleTimeFast" BO_ 446 0;
BA_ "GenMsgSendType" BO_ 446 0;
BA_ "VFrameFormat" BO_ 446 14;
BA_ "CANFD_BRS" BO_ 446 1;
BA_ "GenMsgCycleTime" BO_ 446 10;
BA_ "GenMsgCycleTimeFast" BO_ 446 0;
BA_ "GenMsgSendType" BO_ 446 0;
BA_ "VFrameFormat" BO_ 446 14;
BA_ "CANFD_BRS" BO_ 446 1;
BA_ "GenMsgCycleTime" BO_ 446 10;
BA_ "GenMsgCycleTimeFast" BO_ 446 0;
BA_ "GenMsgSendType" BO_ 446 0;
BA_ "VFrameFormat" BO_ 446 14;
BA_ "CANFD_BRS" BO_ 446 1;
BA_ "GenMsgCycleTime" BO_ 446 10;
BA_ "GenMsgCycleTimeFast" BO_ 446 0;
BA_ "GenMsgSendType" BO_ 446 0;
BA_ "VFrameFormat" BO_ 446 14;
BA_ "CANFD_BRS" BO_ 446 1;
BA_ "GenMsgCycleTime" BO_ 446 10;
BA_ "GenMsgCycleTimeFast" BO_ 446 0;
BA_ "GenMsgSendType" BO_ 446 0;
BA_ "VFrameFormat" BO_ 446 14;
BA_ "CANFD_BRS" BO_ 446 1;
BA_ "GenMsgCycleTime" BO_ 446 10;
BA_ "GenMsgCycleTimeFast" BO_ 446 0;
BA_ "GenMsgSendType" BO_ 446 0;
BA_ "VFrameFormat" BO_ 446 14;
BA_ "CANFD_BRS" BO_ 446 1;
BA_ "GenMsgCycleTime" BO_ 446 10;
BA_ "GenMsgCycleTimeFast" BO_ 446 0;
BA_ "GenMsgSendType" BO_ 446 0;
BA_ "VFrameFormat" BO_ 446 14;
BA_ "CANFD_BRS" BO_ 446 1;
BA_ "EventCommandSignal" SG_ 615 BCS_1_CRC 0;
BA_ "GatewayedSignals" SG_ 615 BCS_1_CRC 0;
BA_ "GenSigInactiveValue" SG_ 615 BCS_1_CRC 0;
BA_ "GenSigInvalidValue" SG_ 615 BCS_1_CRC 0;
BA_ "GenSigSendType" SG_ 615 BCS_1_CRC 1;
BA_ "GenSigStartValue" SG_ 615 BCS_1_CRC 0;
BA_ "GenSigTimeoutValue" SG_ 615 BCS_1_CRC 0;
BA_ "Remark" SG_ 615 BCS_1_CRC "";
BA_ "EventCommandSignal" SG_ 615 BCS_1_Counter 0;
BA_ "GatewayedSignals" SG_ 615 BCS_1_Counter 0;
BA_ "GenSigInactiveValue" SG_ 615 BCS_1_Counter 0;
BA_ "GenSigInvalidValue" SG_ 615 BCS_1_Counter 0;
BA_ "GenSigSendType" SG_ 615 BCS_1_Counter 1;
BA_ "GenSigStartValue" SG_ 615 BCS_1_Counter 0;
BA_ "GenSigTimeoutValue" SG_ 615 BCS_1_Counter 0;
BA_ "Remark" SG_ 615 BCS_1_Counter "";
BA_ "EventCommandSignal" SG_ 615 BCS_FLWheelSpd 0;
BA_ "GatewayedSignals" SG_ 615 BCS_FLWheelSpd 0;
BA_ "GenSigInactiveValue" SG_ 615 BCS_FLWheelSpd 0;
BA_ "GenSigInvalidValue" SG_ 615 BCS_FLWheelSpd 0;
BA_ "GenSigSendType" SG_ 615 BCS_FLWheelSpd 1;
BA_ "GenSigStartValue" SG_ 615 BCS_FLWheelSpd 0;
BA_ "GenSigTimeoutValue" SG_ 615 BCS_FLWheelSpd 0;
BA_ "Remark" SG_ 615 BCS_FLWheelSpd "";
BA_ "EventCommandSignal" SG_ 615 BCS_FLWheelSpdVD 0;
BA_ "GatewayedSignals" SG_ 615 BCS_FLWheelSpdVD 0;
BA_ "GenSigInactiveValue" SG_ 615 BCS_FLWheelSpdVD 0;
BA_ "GenSigInvalidValue" SG_ 615 BCS_FLWheelSpdVD 0;
BA_ "GenSigSendType" SG_ 615 BCS_FLWheelSpdVD 1;
BA_ "GenSigStartValue" SG_ 615 BCS_FLWheelSpdVD 0;
BA_ "GenSigTimeoutValue" SG_ 615 BCS_FLWheelSpdVD 0;
BA_ "Remark" SG_ 615 BCS_FLWheelSpdVD "";
BA_ "EventCommandSignal" SG_ 615 BCS_FLWheelRotatedDirection 0;
BA_ "GatewayedSignals" SG_ 615 BCS_FLWheelRotatedDirection 0;
BA_ "GenSigInactiveValue" SG_ 615 BCS_FLWheelRotatedDirection 0;
BA_ "GenSigInvalidValue" SG_ 615 BCS_FLWheelRotatedDirection 0;
BA_ "GenSigSendType" SG_ 615 BCS_FLWheelRotatedDirection 1;
BA_ "GenSigStartValue" SG_ 615 BCS_FLWheelRotatedDirection 0;
BA_ "GenSigTimeoutValue" SG_ 615 BCS_FLWheelRotatedDirection 0;
BA_ "Remark" SG_ 615 BCS_FLWheelRotatedDirection "";
BA_ "EventCommandSignal" SG_ 615 BCS_FLWheelRotatedDirectionVD 0;
BA_ "GatewayedSignals" SG_ 615 BCS_FLWheelRotatedDirectionVD 0;
BA_ "GenSigInactiveValue" SG_ 615 BCS_FLWheelRotatedDirectionVD 0;
BA_ "GenSigInvalidValue" SG_ 615 BCS_FLWheelRotatedDirectionVD 0;
BA_ "GenSigSendType" SG_ 615 BCS_FLWheelRotatedDirectionVD 1;
BA_ "GenSigStartValue" SG_ 615 BCS_FLWheelRotatedDirectionVD 0;
BA_ "GenSigTimeoutValue" SG_ 615 BCS_FLWheelRotatedDirectionVD 0;
BA_ "Remark" SG_ 615 BCS_FLWheelRotatedDirectionVD "";
BA_ "EventCommandSignal" SG_ 615 BCS_FRWheelSpd 0;
BA_ "GatewayedSignals" SG_ 615 BCS_FRWheelSpd 0;
BA_ "GenSigInactiveValue" SG_ 615 BCS_FRWheelSpd 0;
BA_ "GenSigInvalidValue" SG_ 615 BCS_FRWheelSpd 0;
BA_ "GenSigSendType" SG_ 615 BCS_FRWheelSpd 1;
BA_ "GenSigStartValue" SG_ 615 BCS_FRWheelSpd 0;
BA_ "GenSigTimeoutValue" SG_ 615 BCS_FRWheelSpd 0;
BA_ "Remark" SG_ 615 BCS_FRWheelSpd "";
BA_ "EventCommandSignal" SG_ 615 BCS_FRWheelSpdVD 0;
BA_ "GatewayedSignals" SG_ 615 BCS_FRWheelSpdVD 0;
BA_ "GenSigInactiveValue" SG_ 615 BCS_FRWheelSpdVD 0;
BA_ "GenSigInvalidValue" SG_ 615 BCS_FRWheelSpdVD 0;
BA_ "GenSigSendType" SG_ 615 BCS_FRWheelSpdVD 1;
BA_ "GenSigStartValue" SG_ 615 BCS_FRWheelSpdVD 0;
BA_ "GenSigTimeoutValue" SG_ 615 BCS_FRWheelSpdVD 0;
BA_ "Remark" SG_ 615 BCS_FRWheelSpdVD "";
BA_ "EventCommandSignal" SG_ 615 BCS_FRWheelRotatedDirection 0;
BA_ "GatewayedSignals" SG_ 615 BCS_FRWheelRotatedDirection 0;
BA_ "GenSigInactiveValue" SG_ 615 BCS_FRWheelRotatedDirection 0;
BA_ "GenSigInvalidValue" SG_ 615 BCS_FRWheelRotatedDirection 0;
BA_ "GenSigSendType" SG_ 615 BCS_FRWheelRotatedDirection 1;
BA_ "GenSigStartValue" SG_ 615 BCS_FRWheelRotatedDirection 0;
BA_ "GenSigTimeoutValue" SG_ 615 BCS_FRWheelRotatedDirection 0;
BA_ "Remark" SG_ 615 BCS_FRWheelRotatedDirection "";
BA_ "EventCommandSignal" SG_ 615 BCS_FRWheelRotatedDirectionVD 0;
BA_ "GatewayedSignals" SG_ 615 BCS_FRWheelRotatedDirectionVD 0;
BA_ "GenSigInactiveValue" SG_ 615 BCS_FRWheelRotatedDirectionVD 0;
BA_ "GenSigInvalidValue" SG_ 615 BCS_FRWheelRotatedDirectionVD 0;
BA_ "GenSigSendType" SG_ 615 BCS_FRWheelRotatedDirectionVD 1;
BA_ "GenSigStartValue" SG_ 615 BCS_FRWheelRotatedDirectionVD 0;
BA_ "GenSigTimeoutValue" SG_ 615 BCS_FRWheelRotatedDirectionVD 0;
BA_ "Remark" SG_ 615 BCS_FRWheelRotatedDirectionVD "";
BA_ "EventCommandSignal" SG_ 615 BCS_RLWheelSpd 0;
BA_ "GatewayedSignals" SG_ 615 BCS_RLWheelSpd 0;
BA_ "GenSigInactiveValue" SG_ 615 BCS_RLWheelSpd 0;
BA_ "GenSigInvalidValue" SG_ 615 BCS_RLWheelSpd 0;
BA_ "GenSigSendType" SG_ 615 BCS_RLWheelSpd 1;
BA_ "GenSigStartValue" SG_ 615 BCS_RLWheelSpd 0;
BA_ "GenSigTimeoutValue" SG_ 615 BCS_RLWheelSpd 0;
BA_ "Remark" SG_ 615 BCS_RLWheelSpd "";
BA_ "EventCommandSignal" SG_ 615 BCS_RLWheelSpdVD 0;
BA_ "GatewayedSignals" SG_ 615 BCS_RLWheelSpdVD 0;
BA_ "GenSigInactiveValue" SG_ 615 BCS_RLWheelSpdVD 0;
BA_ "GenSigInvalidValue" SG_ 615 BCS_RLWheelSpdVD 0;
BA_ "GenSigSendType" SG_ 615 BCS_RLWheelSpdVD 1;
BA_ "GenSigStartValue" SG_ 615 BCS_RLWheelSpdVD 0;
BA_ "GenSigTimeoutValue" SG_ 615 BCS_RLWheelSpdVD 0;
BA_ "Remark" SG_ 615 BCS_RLWheelSpdVD "";
BA_ "EventCommandSignal" SG_ 615 BCS_RLWheelRotatedDirection 0;
BA_ "GatewayedSignals" SG_ 615 BCS_RLWheelRotatedDirection 0;
BA_ "GenSigInactiveValue" SG_ 615 BCS_RLWheelRotatedDirection 0;
BA_ "GenSigInvalidValue" SG_ 615 BCS_RLWheelRotatedDirection 0;
BA_ "GenSigSendType" SG_ 615 BCS_RLWheelRotatedDirection 1;
BA_ "GenSigStartValue" SG_ 615 BCS_RLWheelRotatedDirection 0;
BA_ "GenSigTimeoutValue" SG_ 615 BCS_RLWheelRotatedDirection 0;
BA_ "Remark" SG_ 615 BCS_RLWheelRotatedDirection "";
BA_ "EventCommandSignal" SG_ 615 BCS_RLWheelRotatedDirectionVD 0;
BA_ "GatewayedSignals" SG_ 615 BCS_RLWheelRotatedDirectionVD 0;
BA_ "GenSigInactiveValue" SG_ 615 BCS_RLWheelRotatedDirectionVD 0;
BA_ "GenSigInvalidValue" SG_ 615 BCS_RLWheelRotatedDirectionVD 0;
BA_ "GenSigSendType" SG_ 615 BCS_RLWheelRotatedDirectionVD 1;
BA_ "GenSigStartValue" SG_ 615 BCS_RLWheelRotatedDirectionVD 0;
BA_ "GenSigTimeoutValue" SG_ 615 BCS_RLWheelRotatedDirectionVD 0;
BA_ "Remark" SG_ 615 BCS_RLWheelRotatedDirectionVD "";
BA_ "EventCommandSignal" SG_ 615 BCS_RRWheelSpd 0;
BA_ "GatewayedSignals" SG_ 615 BCS_RRWheelSpd 0;
BA_ "GenSigInactiveValue" SG_ 615 BCS_RRWheelSpd 0;
BA_ "GenSigInvalidValue" SG_ 615 BCS_RRWheelSpd 0;
BA_ "GenSigSendType" SG_ 615 BCS_RRWheelSpd 1;
BA_ "GenSigStartValue" SG_ 615 BCS_RRWheelSpd 0;
BA_ "GenSigTimeoutValue" SG_ 615 BCS_RRWheelSpd 0;
BA_ "Remark" SG_ 615 BCS_RRWheelSpd "";
BA_ "EventCommandSignal" SG_ 615 BCS_RRWheelSpdVD 0;
BA_ "GatewayedSignals" SG_ 615 BCS_RRWheelSpdVD 0;
BA_ "GenSigInactiveValue" SG_ 615 BCS_RRWheelSpdVD 0;
BA_ "GenSigInvalidValue" SG_ 615 BCS_RRWheelSpdVD 0;
BA_ "GenSigSendType" SG_ 615 BCS_RRWheelSpdVD 1;
BA_ "GenSigStartValue" SG_ 615 BCS_RRWheelSpdVD 0;
BA_ "GenSigTimeoutValue" SG_ 615 BCS_RRWheelSpdVD 0;
BA_ "Remark" SG_ 615 BCS_RRWheelSpdVD "";
BA_ "EventCommandSignal" SG_ 615 BCS_RRWheelRotatedDirection 0;
BA_ "GatewayedSignals" SG_ 615 BCS_RRWheelRotatedDirection 0;
BA_ "GenSigInactiveValue" SG_ 615 BCS_RRWheelRotatedDirection 0;
BA_ "GenSigInvalidValue" SG_ 615 BCS_RRWheelRotatedDirection 0;
BA_ "GenSigSendType" SG_ 615 BCS_RRWheelRotatedDirection 1;
BA_ "GenSigStartValue" SG_ 615 BCS_RRWheelRotatedDirection 0;
BA_ "GenSigTimeoutValue" SG_ 615 BCS_RRWheelRotatedDirection 0;
BA_ "Remark" SG_ 615 BCS_RRWheelRotatedDirection "";
BA_ "EventCommandSignal" SG_ 615 BCS_RRWheelRotatedDirectionVD 0;
BA_ "GatewayedSignals" SG_ 615 BCS_RRWheelRotatedDirectionVD 0;
BA_ "GenSigInactiveValue" SG_ 615 BCS_RRWheelRotatedDirectionVD 0;
BA_ "GenSigInvalidValue" SG_ 615 BCS_RRWheelRotatedDirectionVD 0;
BA_ "GenSigSendType" SG_ 615 BCS_RRWheelRotatedDirectionVD 1;
BA_ "GenSigStartValue" SG_ 615 BCS_RRWheelRotatedDirectionVD 0;
BA_ "GenSigTimeoutValue" SG_ 615 BCS_RRWheelRotatedDirectionVD 0;
BA_ "Remark" SG_ 615 BCS_RRWheelRotatedDirectionVD "";
BA_ "EventCommandSignal" SG_ 615 BCS_HHCCtrlSt 0;
BA_ "GatewayedSignals" SG_ 615 BCS_HHCCtrlSt 0;
BA_ "GenSigInactiveValue" SG_ 615 BCS_HHCCtrlSt 0;
BA_ "GenSigInvalidValue" SG_ 615 BCS_HHCCtrlSt 0;
BA_ "GenSigSendType" SG_ 615 BCS_HHCCtrlSt 1;
BA_ "GenSigStartValue" SG_ 615 BCS_HHCCtrlSt 0;
BA_ "GenSigTimeoutValue" SG_ 615 BCS_HHCCtrlSt 0;
BA_ "Remark" SG_ 615 BCS_HHCCtrlSt "";
BA_ "EventCommandSignal" SG_ 615 BCS_HDCCtrlSt 0;
BA_ "GatewayedSignals" SG_ 615 BCS_HDCCtrlSt 0;
BA_ "GenSigInactiveValue" SG_ 615 BCS_HDCCtrlSt 0;
BA_ "GenSigInvalidValue" SG_ 615 BCS_HDCCtrlSt 0;
BA_ "GenSigSendType" SG_ 615 BCS_HDCCtrlSt 1;
BA_ "GenSigStartValue" SG_ 615 BCS_HDCCtrlSt 0;
BA_ "GenSigTimeoutValue" SG_ 615 BCS_HDCCtrlSt 0;
BA_ "Remark" SG_ 615 BCS_HDCCtrlSt "";
BA_ "EventCommandSignal" SG_ 615 BCS_HDCErrSt 0;
BA_ "GatewayedSignals" SG_ 615 BCS_HDCErrSt 0;
BA_ "GenSigInactiveValue" SG_ 615 BCS_HDCErrSt 0;
BA_ "GenSigInvalidValue" SG_ 615 BCS_HDCErrSt 0;
BA_ "GenSigSendType" SG_ 615 BCS_HDCErrSt 1;
BA_ "GenSigStartValue" SG_ 615 BCS_HDCErrSt 0;
BA_ "GenSigTimeoutValue" SG_ 615 BCS_HDCErrSt 1;
BA_ "Remark" SG_ 615 BCS_HDCErrSt "";
BA_ "EventCommandSignal" SG_ 615 BCS_FLWheelSpdEdgesSum 0;
BA_ "GatewayedSignals" SG_ 615 BCS_FLWheelSpdEdgesSum 0;
BA_ "GenSigInactiveValue" SG_ 615 BCS_FLWheelSpdEdgesSum 0;
BA_ "GenSigInvalidValue" SG_ 615 BCS_FLWheelSpdEdgesSum 0;
BA_ "GenSigSendType" SG_ 615 BCS_FLWheelSpdEdgesSum 1;
BA_ "GenSigStartValue" SG_ 615 BCS_FLWheelSpdEdgesSum 0;
BA_ "GenSigTimeoutValue" SG_ 615 BCS_FLWheelSpdEdgesSum 0;
BA_ "Remark" SG_ 615 BCS_FLWheelSpdEdgesSum "";
BA_ "EventCommandSignal" SG_ 615 BCS_FRWheelSpdEdgesSum 0;
BA_ "GatewayedSignals" SG_ 615 BCS_FRWheelSpdEdgesSum 0;
BA_ "GenSigInactiveValue" SG_ 615 BCS_FRWheelSpdEdgesSum 0;
BA_ "GenSigInvalidValue" SG_ 615 BCS_FRWheelSpdEdgesSum 0;
BA_ "GenSigSendType" SG_ 615 BCS_FRWheelSpdEdgesSum 1;
BA_ "GenSigStartValue" SG_ 615 BCS_FRWheelSpdEdgesSum 0;
BA_ "GenSigTimeoutValue" SG_ 615 BCS_FRWheelSpdEdgesSum 0;
BA_ "Remark" SG_ 615 BCS_FRWheelSpdEdgesSum "";
BA_ "EventCommandSignal" SG_ 615 BCS_RLWheelSpdEdgesSum 0;
BA_ "GatewayedSignals" SG_ 615 BCS_RLWheelSpdEdgesSum 0;
BA_ "GenSigInactiveValue" SG_ 615 BCS_RLWheelSpdEdgesSum 0;
BA_ "GenSigInvalidValue" SG_ 615 BCS_RLWheelSpdEdgesSum 0;
BA_ "GenSigSendType" SG_ 615 BCS_RLWheelSpdEdgesSum 1;
BA_ "GenSigStartValue" SG_ 615 BCS_RLWheelSpdEdgesSum 0;
BA_ "GenSigTimeoutValue" SG_ 615 BCS_RLWheelSpdEdgesSum 0;
BA_ "Remark" SG_ 615 BCS_RLWheelSpdEdgesSum "";
BA_ "EventCommandSignal" SG_ 615 BCS_RRWheelSpdEdgesSum 0;
BA_ "GatewayedSignals" SG_ 615 BCS_RRWheelSpdEdgesSum 0;
BA_ "GenSigInactiveValue" SG_ 615 BCS_RRWheelSpdEdgesSum 0;
BA_ "GenSigInvalidValue" SG_ 615 BCS_RRWheelSpdEdgesSum 0;
BA_ "GenSigSendType" SG_ 615 BCS_RRWheelSpdEdgesSum 1;
BA_ "GenSigStartValue" SG_ 615 BCS_RRWheelSpdEdgesSum 0;
BA_ "GenSigTimeoutValue" SG_ 615 BCS_RRWheelSpdEdgesSum 0;
BA_ "Remark" SG_ 615 BCS_RRWheelSpdEdgesSum "";
BA_ "EventCommandSignal" SG_ 615 BCS_FLWheelSpdEdgesSumVD 0;
BA_ "GatewayedSignals" SG_ 615 BCS_FLWheelSpdEdgesSumVD 0;
BA_ "GenSigInactiveValue" SG_ 615 BCS_FLWheelSpdEdgesSumVD 0;
BA_ "GenSigInvalidValue" SG_ 615 BCS_FLWheelSpdEdgesSumVD 0;
BA_ "GenSigSendType" SG_ 615 BCS_FLWheelSpdEdgesSumVD 1;
BA_ "GenSigStartValue" SG_ 615 BCS_FLWheelSpdEdgesSumVD 0;
BA_ "GenSigTimeoutValue" SG_ 615 BCS_FLWheelSpdEdgesSumVD 0;
BA_ "Remark" SG_ 615 BCS_FLWheelSpdEdgesSumVD "";
BA_ "EventCommandSignal" SG_ 615 BCS_FRWheelSpdEdgesSumVD 0;
BA_ "GatewayedSignals" SG_ 615 BCS_FRWheelSpdEdgesSumVD 0;
BA_ "GenSigInactiveValue" SG_ 615 BCS_FRWheelSpdEdgesSumVD 0;
BA_ "GenSigInvalidValue" SG_ 615 BCS_FRWheelSpdEdgesSumVD 0;
BA_ "GenSigSendType" SG_ 615 BCS_FRWheelSpdEdgesSumVD 1;
BA_ "GenSigStartValue" SG_ 615 BCS_FRWheelSpdEdgesSumVD 0;
BA_ "GenSigTimeoutValue" SG_ 615 BCS_FRWheelSpdEdgesSumVD 0;
BA_ "Remark" SG_ 615 BCS_FRWheelSpdEdgesSumVD "";
BA_ "EventCommandSignal" SG_ 615 BCS_RLWheelSpdEdgesSumVD 0;
BA_ "GatewayedSignals" SG_ 615 BCS_RLWheelSpdEdgesSumVD 0;
BA_ "GenSigInactiveValue" SG_ 615 BCS_RLWheelSpdEdgesSumVD 0;
BA_ "GenSigInvalidValue" SG_ 615 BCS_RLWheelSpdEdgesSumVD 0;
BA_ "GenSigSendType" SG_ 615 BCS_RLWheelSpdEdgesSumVD 1;
BA_ "GenSigStartValue" SG_ 615 BCS_RLWheelSpdEdgesSumVD 0;
BA_ "GenSigTimeoutValue" SG_ 615 BCS_RLWheelSpdEdgesSumVD 0;
BA_ "Remark" SG_ 615 BCS_RLWheelSpdEdgesSumVD "";
BA_ "EventCommandSignal" SG_ 615 BCS_RRWheelSpdEdgesSumVD 0;
BA_ "GatewayedSignals" SG_ 615 BCS_RRWheelSpdEdgesSumVD 0;
BA_ "GenSigInactiveValue" SG_ 615 BCS_RRWheelSpdEdgesSumVD 0;
BA_ "GenSigInvalidValue" SG_ 615 BCS_RRWheelSpdEdgesSumVD 0;
BA_ "GenSigSendType" SG_ 615 BCS_RRWheelSpdEdgesSumVD 1;
BA_ "GenSigStartValue" SG_ 615 BCS_RRWheelSpdEdgesSumVD 0;
BA_ "GenSigTimeoutValue" SG_ 615 BCS_RRWheelSpdEdgesSumVD 0;
BA_ "Remark" SG_ 615 BCS_RRWheelSpdEdgesSumVD "";
BA_ "EventCommandSignal" SG_ 615 BCS_FLWheelRotatedDirectionAPA 0;
BA_ "GatewayedSignals" SG_ 615 BCS_FLWheelRotatedDirectionAPA 0;
BA_ "GenSigInactiveValue" SG_ 615 BCS_FLWheelRotatedDirectionAPA 0;
BA_ "GenSigInvalidValue" SG_ 615 BCS_FLWheelRotatedDirectionAPA 0;
BA_ "GenSigSendType" SG_ 615 BCS_FLWheelRotatedDirectionAPA 1;
BA_ "GenSigStartValue" SG_ 615 BCS_FLWheelRotatedDirectionAPA 0;
BA_ "GenSigTimeoutValue" SG_ 615 BCS_FLWheelRotatedDirectionAPA 0;
BA_ "Remark" SG_ 615 BCS_FLWheelRotatedDirectionAPA "";
BA_ "EventCommandSignal" SG_ 615 BCS_FRWheelRotatedDirectionAPA 0;
BA_ "GatewayedSignals" SG_ 615 BCS_FRWheelRotatedDirectionAPA 0;
BA_ "GenSigInactiveValue" SG_ 615 BCS_FRWheelRotatedDirectionAPA 0;
BA_ "GenSigInvalidValue" SG_ 615 BCS_FRWheelRotatedDirectionAPA 0;
BA_ "GenSigSendType" SG_ 615 BCS_FRWheelRotatedDirectionAPA 1;
BA_ "GenSigStartValue" SG_ 615 BCS_FRWheelRotatedDirectionAPA 0;
BA_ "GenSigTimeoutValue" SG_ 615 BCS_FRWheelRotatedDirectionAPA 0;
BA_ "Remark" SG_ 615 BCS_FRWheelRotatedDirectionAPA "";
BA_ "EventCommandSignal" SG_ 615 BCS_RLWheelRotatedDirectionAPA 0;
BA_ "GatewayedSignals" SG_ 615 BCS_RLWheelRotatedDirectionAPA 0;
BA_ "GenSigInactiveValue" SG_ 615 BCS_RLWheelRotatedDirectionAPA 0;
BA_ "GenSigInvalidValue" SG_ 615 BCS_RLWheelRotatedDirectionAPA 0;
BA_ "GenSigSendType" SG_ 615 BCS_RLWheelRotatedDirectionAPA 1;
BA_ "GenSigStartValue" SG_ 615 BCS_RLWheelRotatedDirectionAPA 0;
BA_ "GenSigTimeoutValue" SG_ 615 BCS_RLWheelRotatedDirectionAPA 0;
BA_ "Remark" SG_ 615 BCS_RLWheelRotatedDirectionAPA "";
BA_ "EventCommandSignal" SG_ 615 BCS_RRWheelRotatedDirectionAPA 0;
BA_ "GatewayedSignals" SG_ 615 BCS_RRWheelRotatedDirectionAPA 0;
BA_ "GenSigInactiveValue" SG_ 615 BCS_RRWheelRotatedDirectionAPA 0;
BA_ "GenSigInvalidValue" SG_ 615 BCS_RRWheelRotatedDirectionAPA 0;
BA_ "GenSigSendType" SG_ 615 BCS_RRWheelRotatedDirectionAPA 1;
BA_ "GenSigStartValue" SG_ 615 BCS_RRWheelRotatedDirectionAPA 0;
BA_ "GenSigTimeoutValue" SG_ 615 BCS_RRWheelRotatedDirectionAPA 0;
BA_ "Remark" SG_ 615 BCS_RRWheelRotatedDirectionAPA "";
BA_ "EventCommandSignal" SG_ 615 BCS_ParkingReqToEPB 0;
BA_ "GatewayedSignals" SG_ 615 BCS_ParkingReqToEPB 0;
BA_ "GenSigInactiveValue" SG_ 615 BCS_ParkingReqToEPB 0;
BA_ "GenSigInvalidValue" SG_ 615 BCS_ParkingReqToEPB 0;
BA_ "GenSigSendType" SG_ 615 BCS_ParkingReqToEPB 1;
BA_ "GenSigStartValue" SG_ 615 BCS_ParkingReqToEPB 0;
BA_ "GenSigTimeoutValue" SG_ 615 BCS_ParkingReqToEPB 0;
BA_ "Remark" SG_ 615 BCS_ParkingReqToEPB "";
BA_ "EventCommandSignal" SG_ 615 BCS_VDCOff 0;
BA_ "GatewayedSignals" SG_ 615 BCS_VDCOff 0;
BA_ "GenSigInactiveValue" SG_ 615 BCS_VDCOff 0;
BA_ "GenSigInvalidValue" SG_ 615 BCS_VDCOff 0;
BA_ "GenSigSendType" SG_ 615 BCS_VDCOff 1;
BA_ "GenSigStartValue" SG_ 615 BCS_VDCOff 0;
BA_ "GenSigTimeoutValue" SG_ 615 BCS_VDCOff 0;
BA_ "Remark" SG_ 615 BCS_VDCOff "";
BA_ "EventCommandSignal" SG_ 615 BCS_AVHSt 0;
BA_ "GatewayedSignals" SG_ 615 BCS_AVHSt 0;
BA_ "GenSigInactiveValue" SG_ 615 BCS_AVHSt 0;
BA_ "GenSigInvalidValue" SG_ 615 BCS_AVHSt 0;
BA_ "GenSigSendType" SG_ 615 BCS_AVHSt 1;
BA_ "GenSigStartValue" SG_ 615 BCS_AVHSt 0;
BA_ "GenSigTimeoutValue" SG_ 615 BCS_AVHSt 0;
BA_ "Remark" SG_ 615 BCS_AVHSt "";
BA_ "EventCommandSignal" SG_ 615 BCS_AVHStandby 0;
BA_ "GatewayedSignals" SG_ 615 BCS_AVHStandby 0;
BA_ "GenSigInactiveValue" SG_ 615 BCS_AVHStandby 0;
BA_ "GenSigInvalidValue" SG_ 615 BCS_AVHStandby 0;
BA_ "GenSigSendType" SG_ 615 BCS_AVHStandby 1;
BA_ "GenSigStartValue" SG_ 615 BCS_AVHStandby 0;
BA_ "GenSigTimeoutValue" SG_ 615 BCS_AVHStandby 0;
BA_ "Remark" SG_ 615 BCS_AVHStandby "";
BA_ "EventCommandSignal" SG_ 615 BCS_AVHAvailable 0;
BA_ "GatewayedSignals" SG_ 615 BCS_AVHAvailable 0;
BA_ "GenSigInactiveValue" SG_ 615 BCS_AVHAvailable 0;
BA_ "GenSigInvalidValue" SG_ 615 BCS_AVHAvailable 0;
BA_ "GenSigSendType" SG_ 615 BCS_AVHAvailable 1;
BA_ "GenSigStartValue" SG_ 615 BCS_AVHAvailable 0;
BA_ "GenSigTimeoutValue" SG_ 615 BCS_AVHAvailable 0;
BA_ "Remark" SG_ 615 BCS_AVHAvailable "";
BA_ "EventCommandSignal" SG_ 615 BCS_TCSOff 0;
BA_ "GatewayedSignals" SG_ 615 BCS_TCSOff 0;
BA_ "GenSigInactiveValue" SG_ 615 BCS_TCSOff 0;
BA_ "GenSigInvalidValue" SG_ 615 BCS_TCSOff 0;
BA_ "GenSigSendType" SG_ 615 BCS_TCSOff 1;
BA_ "GenSigStartValue" SG_ 615 BCS_TCSOff 0;
BA_ "GenSigTimeoutValue" SG_ 615 BCS_TCSOff 0;
BA_ "Remark" SG_ 615 BCS_TCSOff "";
BA_ "EventCommandSignal" SG_ 615 BCS_BrkPdlPstVD 0;
BA_ "GatewayedSignals" SG_ 615 BCS_BrkPdlPstVD 0;
BA_ "GenSigInactiveValue" SG_ 615 BCS_BrkPdlPstVD 0;
BA_ "GenSigInvalidValue" SG_ 615 BCS_BrkPdlPstVD 0;
BA_ "GenSigSendType" SG_ 615 BCS_BrkPdlPstVD 1;
BA_ "GenSigStartValue" SG_ 615 BCS_BrkPdlPstVD 0;
BA_ "GenSigTimeoutValue" SG_ 615 BCS_BrkPdlPstVD 0;
BA_ "Remark" SG_ 615 BCS_BrkPdlPstVD "";
BA_ "EventCommandSignal" SG_ 615 BCS_NoBrakeForce 0;
BA_ "GatewayedSignals" SG_ 615 BCS_NoBrakeForce 0;
BA_ "GenSigInactiveValue" SG_ 615 BCS_NoBrakeForce 0;
BA_ "GenSigInvalidValue" SG_ 615 BCS_NoBrakeForce 0;
BA_ "GenSigSendType" SG_ 615 BCS_NoBrakeForce 1;
BA_ "GenSigStartValue" SG_ 615 BCS_NoBrakeForce 0;
BA_ "GenSigTimeoutValue" SG_ 615 BCS_NoBrakeForce 0;
BA_ "Remark" SG_ 615 BCS_NoBrakeForce "";
BA_ "EventCommandSignal" SG_ 615 BCS_BrakeOverHeat 0;
BA_ "GatewayedSignals" SG_ 615 BCS_BrakeOverHeat 0;
BA_ "GenSigInactiveValue" SG_ 615 BCS_BrakeOverHeat 0;
BA_ "GenSigInvalidValue" SG_ 615 BCS_BrakeOverHeat 0;
BA_ "GenSigSendType" SG_ 615 BCS_BrakeOverHeat 1;
BA_ "GenSigStartValue" SG_ 615 BCS_BrakeOverHeat 0;
BA_ "GenSigTimeoutValue" SG_ 615 BCS_BrakeOverHeat 0;
BA_ "Remark" SG_ 615 BCS_BrakeOverHeat "";
BA_ "EventCommandSignal" SG_ 615 BCS_ABAactive 0;
BA_ "GatewayedSignals" SG_ 615 BCS_ABAactive 0;
BA_ "GenSigInactiveValue" SG_ 615 BCS_ABAactive 0;
BA_ "GenSigInvalidValue" SG_ 615 BCS_ABAactive 0;
BA_ "GenSigSendType" SG_ 615 BCS_ABAactive 1;
BA_ "GenSigStartValue" SG_ 615 BCS_ABAactive 0;
BA_ "GenSigTimeoutValue" SG_ 615 BCS_ABAactive 0;
BA_ "Remark" SG_ 615 BCS_ABAactive "";
BA_ "EventCommandSignal" SG_ 615 BCS_ABAavailable 0;
BA_ "GatewayedSignals" SG_ 615 BCS_ABAavailable 0;
BA_ "GenSigInactiveValue" SG_ 615 BCS_ABAavailable 0;
BA_ "GenSigInvalidValue" SG_ 615 BCS_ABAavailable 0;
BA_ "GenSigSendType" SG_ 615 BCS_ABAavailable 1;
BA_ "GenSigStartValue" SG_ 615 BCS_ABAavailable 0;
BA_ "GenSigTimeoutValue" SG_ 615 BCS_ABAavailable 0;
BA_ "Remark" SG_ 615 BCS_ABAavailable "";
BA_ "EventCommandSignal" SG_ 615 BCS_ABPActive 0;
BA_ "GatewayedSignals" SG_ 615 BCS_ABPActive 0;
BA_ "GenSigInactiveValue" SG_ 615 BCS_ABPActive 0;
BA_ "GenSigInvalidValue" SG_ 615 BCS_ABPActive 0;
BA_ "GenSigSendType" SG_ 615 BCS_ABPActive 1;
BA_ "GenSigStartValue" SG_ 615 BCS_ABPActive 0;
BA_ "GenSigTimeoutValue" SG_ 615 BCS_ABPActive 0;
BA_ "Remark" SG_ 615 BCS_ABPActive "";
BA_ "EventCommandSignal" SG_ 615 BCS_ABPAvailable 0;
BA_ "GatewayedSignals" SG_ 615 BCS_ABPAvailable 0;
BA_ "GenSigInactiveValue" SG_ 615 BCS_ABPAvailable 0;
BA_ "GenSigInvalidValue" SG_ 615 BCS_ABPAvailable 0;
BA_ "GenSigSendType" SG_ 615 BCS_ABPAvailable 1;
BA_ "GenSigStartValue" SG_ 615 BCS_ABPAvailable 0;
BA_ "GenSigTimeoutValue" SG_ 615 BCS_ABPAvailable 0;
BA_ "Remark" SG_ 615 BCS_ABPAvailable "";
BA_ "EventCommandSignal" SG_ 615 BCS_AEBActive 0;
BA_ "GatewayedSignals" SG_ 615 BCS_AEBActive 0;
BA_ "GenSigInactiveValue" SG_ 615 BCS_AEBActive 0;
BA_ "GenSigInvalidValue" SG_ 615 BCS_AEBActive 0;
BA_ "GenSigSendType" SG_ 615 BCS_AEBActive 1;
BA_ "GenSigStartValue" SG_ 615 BCS_AEBActive 0;
BA_ "GenSigTimeoutValue" SG_ 615 BCS_AEBActive 0;
BA_ "Remark" SG_ 615 BCS_AEBActive "";
BA_ "EventCommandSignal" SG_ 615 BCS_AEBAvailable 0;
BA_ "GatewayedSignals" SG_ 615 BCS_AEBAvailable 0;
BA_ "GenSigInactiveValue" SG_ 615 BCS_AEBAvailable 0;
BA_ "GenSigInvalidValue" SG_ 615 BCS_AEBAvailable 0;
BA_ "GenSigSendType" SG_ 615 BCS_AEBAvailable 1;
BA_ "GenSigStartValue" SG_ 615 BCS_AEBAvailable 0;
BA_ "GenSigTimeoutValue" SG_ 615 BCS_AEBAvailable 0;
BA_ "Remark" SG_ 615 BCS_AEBAvailable "";
BA_ "EventCommandSignal" SG_ 615 BCS_AWBActive 0;
BA_ "GatewayedSignals" SG_ 615 BCS_AWBActive 0;
BA_ "GenSigInactiveValue" SG_ 615 BCS_AWBActive 0;
BA_ "GenSigInvalidValue" SG_ 615 BCS_AWBActive 0;
BA_ "GenSigSendType" SG_ 615 BCS_AWBActive 1;
BA_ "GenSigStartValue" SG_ 615 BCS_AWBActive 0;
BA_ "GenSigTimeoutValue" SG_ 615 BCS_AWBActive 0;
BA_ "Remark" SG_ 615 BCS_AWBActive "";
BA_ "EventCommandSignal" SG_ 615 BCS_AWBAvailable 0;
BA_ "GatewayedSignals" SG_ 615 BCS_AWBAvailable 0;
BA_ "GenSigInactiveValue" SG_ 615 BCS_AWBAvailable 0;
BA_ "GenSigInvalidValue" SG_ 615 BCS_AWBAvailable 0;
BA_ "GenSigSendType" SG_ 615 BCS_AWBAvailable 1;
BA_ "GenSigStartValue" SG_ 615 BCS_AWBAvailable 0;
BA_ "GenSigTimeoutValue" SG_ 615 BCS_AWBAvailable 0;
BA_ "Remark" SG_ 615 BCS_AWBAvailable "";
BA_ "EventCommandSignal" SG_ 615 BCS_BrkPdlPst 0;
BA_ "GatewayedSignals" SG_ 615 BCS_BrkPdlPst 0;
BA_ "GenSigInactiveValue" SG_ 615 BCS_BrkPdlPst 0;
BA_ "GenSigInvalidValue" SG_ 615 BCS_BrkPdlPst 0;
BA_ "GenSigSendType" SG_ 615 BCS_BrkPdlPst 1;
BA_ "GenSigStartValue" SG_ 615 BCS_BrkPdlPst 0;
BA_ "GenSigTimeoutValue" SG_ 615 BCS_BrkPdlPst 0;
BA_ "Remark" SG_ 615 BCS_BrkPdlPst "";
BA_ "EventCommandSignal" SG_ 615 BCS_VehicleStandStillSt 0;
BA_ "GatewayedSignals" SG_ 615 BCS_VehicleStandStillSt 0;
BA_ "GenSigInactiveValue" SG_ 615 BCS_VehicleStandStillSt 0;
BA_ "GenSigInvalidValue" SG_ 615 BCS_VehicleStandStillSt 0;
BA_ "GenSigSendType" SG_ 615 BCS_VehicleStandStillSt 1;
BA_ "GenSigStartValue" SG_ 615 BCS_VehicleStandStillSt 0;
BA_ "GenSigTimeoutValue" SG_ 615 BCS_VehicleStandStillSt 0;
BA_ "Remark" SG_ 615 BCS_VehicleStandStillSt "";
BA_ "EventCommandSignal" SG_ 615 BCS_AEBBAActive 0;
BA_ "GatewayedSignals" SG_ 615 BCS_AEBBAActive 0;
BA_ "GenSigInactiveValue" SG_ 615 BCS_AEBBAActive 0;
BA_ "GenSigInvalidValue" SG_ 615 BCS_AEBBAActive 0;
BA_ "GenSigSendType" SG_ 615 BCS_AEBBAActive 1;
BA_ "GenSigStartValue" SG_ 615 BCS_AEBBAActive 0;
BA_ "GenSigTimeoutValue" SG_ 615 BCS_AEBBAActive 0;
BA_ "Remark" SG_ 615 BCS_AEBBAActive "";
BA_ "EventCommandSignal" SG_ 615 BCS_2ParkDrvBrkOverrideFlg 0;
BA_ "GatewayedSignals" SG_ 615 BCS_2ParkDrvBrkOverrideFlg 0;
BA_ "GenSigInactiveValue" SG_ 615 BCS_2ParkDrvBrkOverrideFlg 0;
BA_ "GenSigInvalidValue" SG_ 615 BCS_2ParkDrvBrkOverrideFlg 0;
BA_ "GenSigSendType" SG_ 615 BCS_2ParkDrvBrkOverrideFlg 1;
BA_ "GenSigStartValue" SG_ 615 BCS_2ParkDrvBrkOverrideFlg 0;
BA_ "GenSigTimeoutValue" SG_ 615 BCS_2ParkDrvBrkOverrideFlg 0;
BA_ "Remark" SG_ 615 BCS_2ParkDrvBrkOverrideFlg "";
BA_ "EventCommandSignal" SG_ 615 IPB_InputRodStroke 0;
BA_ "GatewayedSignals" SG_ 615 IPB_InputRodStroke 0;
BA_ "GenSigInactiveValue" SG_ 615 IPB_InputRodStroke 0;
BA_ "GenSigInvalidValue" SG_ 615 IPB_InputRodStroke 0;
BA_ "GenSigSendType" SG_ 615 IPB_InputRodStroke 1;
BA_ "GenSigStartValue" SG_ 615 IPB_InputRodStroke 100;
BA_ "GenSigTimeoutValue" SG_ 615 IPB_InputRodStroke 0;
BA_ "Remark" SG_ 615 IPB_InputRodStroke "";
BA_ "EventCommandSignal" SG_ 615 IPB_InputRodStrokeSt 0;
BA_ "GatewayedSignals" SG_ 615 IPB_InputRodStrokeSt 0;
BA_ "GenSigInactiveValue" SG_ 615 IPB_InputRodStrokeSt 0;
BA_ "GenSigInvalidValue" SG_ 615 IPB_InputRodStrokeSt 0;
BA_ "GenSigSendType" SG_ 615 IPB_InputRodStrokeSt 1;
BA_ "GenSigStartValue" SG_ 615 IPB_InputRodStrokeSt 0;
BA_ "GenSigTimeoutValue" SG_ 615 IPB_InputRodStrokeSt 0;
BA_ "Remark" SG_ 615 IPB_InputRodStrokeSt "";
BA_ "EventCommandSignal" SG_ 615 BCS_RAEBActive 0;
BA_ "GatewayedSignals" SG_ 615 BCS_RAEBActive 0;
BA_ "GenSigInactiveValue" SG_ 615 BCS_RAEBActive 0;
BA_ "GenSigInvalidValue" SG_ 615 BCS_RAEBActive 0;
BA_ "GenSigSendType" SG_ 615 BCS_RAEBActive 1;
BA_ "GenSigStartValue" SG_ 615 BCS_RAEBActive 0;
BA_ "GenSigTimeoutValue" SG_ 615 BCS_RAEBActive 0;
BA_ "Remark" SG_ 615 BCS_RAEBActive "";
BA_ "EventCommandSignal" SG_ 615 BCS_RAEBAvailable 0;
BA_ "GatewayedSignals" SG_ 615 BCS_RAEBAvailable 0;
BA_ "GenSigInactiveValue" SG_ 615 BCS_RAEBAvailable 0;
BA_ "GenSigInvalidValue" SG_ 615 BCS_RAEBAvailable 0;
BA_ "GenSigSendType" SG_ 615 BCS_RAEBAvailable 1;
BA_ "GenSigStartValue" SG_ 615 BCS_RAEBAvailable 0;
BA_ "GenSigTimeoutValue" SG_ 615 BCS_RAEBAvailable 0;
BA_ "Remark" SG_ 615 BCS_RAEBAvailable "";
BA_ "EventCommandSignal" SG_ 615 BCS_DrvModeAvailable 0;
BA_ "GatewayedSignals" SG_ 615 BCS_DrvModeAvailable 0;
BA_ "GenSigInactiveValue" SG_ 615 BCS_DrvModeAvailable 0;
BA_ "GenSigInvalidValue" SG_ 615 BCS_DrvModeAvailable 0;
BA_ "GenSigSendType" SG_ 615 BCS_DrvModeAvailable 1;
BA_ "GenSigStartValue" SG_ 615 BCS_DrvModeAvailable 0;
BA_ "GenSigTimeoutValue" SG_ 615 BCS_DrvModeAvailable 0;
BA_ "Remark" SG_ 615 BCS_DrvModeAvailable "";
BA_ "EventCommandSignal" SG_ 615 BCS_DrvMode 0;
BA_ "GatewayedSignals" SG_ 615 BCS_DrvMode 0;
BA_ "GenSigInactiveValue" SG_ 615 BCS_DrvMode 0;
BA_ "GenSigInvalidValue" SG_ 615 BCS_DrvMode 0;
BA_ "GenSigSendType" SG_ 615 BCS_DrvMode 1;
BA_ "GenSigStartValue" SG_ 615 BCS_DrvMode 0;
BA_ "GenSigTimeoutValue" SG_ 615 BCS_DrvMode 0;
BA_ "Remark" SG_ 615 BCS_DrvMode "";
BA_ "EventCommandSignal" SG_ 615 IPB_PlungerPressure 0;
BA_ "GatewayedSignals" SG_ 615 IPB_PlungerPressure 0;
BA_ "GenSigInactiveValue" SG_ 615 IPB_PlungerPressure 0;
BA_ "GenSigInvalidValue" SG_ 615 IPB_PlungerPressure 0;
BA_ "GenSigSendType" SG_ 615 IPB_PlungerPressure 1;
BA_ "GenSigStartValue" SG_ 615 IPB_PlungerPressure 17;
BA_ "GenSigTimeoutValue" SG_ 615 IPB_PlungerPressure 0;
BA_ "Remark" SG_ 615 IPB_PlungerPressure "";
BA_ "EventCommandSignal" SG_ 615 IPB_PlungerPressureSt 0;
BA_ "GatewayedSignals" SG_ 615 IPB_PlungerPressureSt 0;
BA_ "GenSigInactiveValue" SG_ 615 IPB_PlungerPressureSt 0;
BA_ "GenSigInvalidValue" SG_ 615 IPB_PlungerPressureSt 0;
BA_ "GenSigSendType" SG_ 615 IPB_PlungerPressureSt 1;
BA_ "GenSigStartValue" SG_ 615 IPB_PlungerPressureSt 0;
BA_ "GenSigTimeoutValue" SG_ 615 IPB_PlungerPressureSt 0;
BA_ "Remark" SG_ 615 IPB_PlungerPressureSt "";
BA_ "EventCommandSignal" SG_ 352 BCS_2_CRC 0;
BA_ "GatewayedSignals" SG_ 352 BCS_2_CRC 0;
BA_ "GenSigInactiveValue" SG_ 352 BCS_2_CRC 0;
BA_ "GenSigInvalidValue" SG_ 352 BCS_2_CRC 0;
BA_ "GenSigSendType" SG_ 352 BCS_2_CRC 1;
BA_ "GenSigStartValue" SG_ 352 BCS_2_CRC 0;
BA_ "GenSigTimeoutValue" SG_ 352 BCS_2_CRC 0;
BA_ "Remark" SG_ 352 BCS_2_CRC "";
BA_ "EventCommandSignal" SG_ 352 BCS_2_Counter 0;
BA_ "GatewayedSignals" SG_ 352 BCS_2_Counter 0;
BA_ "GenSigInactiveValue" SG_ 352 BCS_2_Counter 0;
BA_ "GenSigInvalidValue" SG_ 352 BCS_2_Counter 0;
BA_ "GenSigSendType" SG_ 352 BCS_2_Counter 1;
BA_ "GenSigStartValue" SG_ 352 BCS_2_Counter 0;
BA_ "GenSigTimeoutValue" SG_ 352 BCS_2_Counter 0;
BA_ "Remark" SG_ 352 BCS_2_Counter "";
BA_ "EventCommandSignal" SG_ 352 BCS_VehSpd 0;
BA_ "GatewayedSignals" SG_ 352 BCS_VehSpd 0;
BA_ "GenSigInactiveValue" SG_ 352 BCS_VehSpd 0;
BA_ "GenSigInvalidValue" SG_ 352 BCS_VehSpd 0;
BA_ "GenSigSendType" SG_ 352 BCS_VehSpd 1;
BA_ "GenSigStartValue" SG_ 352 BCS_VehSpd 0;
BA_ "GenSigTimeoutValue" SG_ 352 BCS_VehSpd 0;
BA_ "Remark" SG_ 352 BCS_VehSpd "";
BA_ "EventCommandSignal" SG_ 352 BCS_VehSpdVD 0;
BA_ "GatewayedSignals" SG_ 352 BCS_VehSpdVD 0;
BA_ "GenSigInactiveValue" SG_ 352 BCS_VehSpdVD 0;
BA_ "GenSigInvalidValue" SG_ 352 BCS_VehSpdVD 0;
BA_ "GenSigSendType" SG_ 352 BCS_VehSpdVD 1;
BA_ "GenSigStartValue" SG_ 352 BCS_VehSpdVD 0;
BA_ "GenSigTimeoutValue" SG_ 352 BCS_VehSpdVD 0;
BA_ "Remark" SG_ 352 BCS_VehSpdVD "";
BA_ "EventCommandSignal" SG_ 352 BCS_EBDActiveSt 0;
BA_ "GatewayedSignals" SG_ 352 BCS_EBDActiveSt 0;
BA_ "GenSigInactiveValue" SG_ 352 BCS_EBDActiveSt 0;
BA_ "GenSigInvalidValue" SG_ 352 BCS_EBDActiveSt 0;
BA_ "GenSigSendType" SG_ 352 BCS_EBDActiveSt 1;
BA_ "GenSigStartValue" SG_ 352 BCS_EBDActiveSt 0;
BA_ "GenSigTimeoutValue" SG_ 352 BCS_EBDActiveSt 0;
BA_ "Remark" SG_ 352 BCS_EBDActiveSt "";
BA_ "EventCommandSignal" SG_ 352 BCS_EBDFaultSt 0;
BA_ "GatewayedSignals" SG_ 352 BCS_EBDFaultSt 0;
BA_ "GenSigInactiveValue" SG_ 352 BCS_EBDFaultSt 0;
BA_ "GenSigInvalidValue" SG_ 352 BCS_EBDFaultSt 0;
BA_ "GenSigSendType" SG_ 352 BCS_EBDFaultSt 1;
BA_ "GenSigStartValue" SG_ 352 BCS_EBDFaultSt 1;
BA_ "GenSigTimeoutValue" SG_ 352 BCS_EBDFaultSt 1;
BA_ "Remark" SG_ 352 BCS_EBDFaultSt "";
BA_ "EventCommandSignal" SG_ 352 BCS_ABSActiveSt 0;
BA_ "GatewayedSignals" SG_ 352 BCS_ABSActiveSt 0;
BA_ "GenSigInactiveValue" SG_ 352 BCS_ABSActiveSt 0;
BA_ "GenSigInvalidValue" SG_ 352 BCS_ABSActiveSt 0;
BA_ "GenSigSendType" SG_ 352 BCS_ABSActiveSt 1;
BA_ "GenSigStartValue" SG_ 352 BCS_ABSActiveSt 0;
BA_ "GenSigTimeoutValue" SG_ 352 BCS_ABSActiveSt 0;
BA_ "Remark" SG_ 352 BCS_ABSActiveSt "";
BA_ "EventCommandSignal" SG_ 352 BCS_ABSFaultSt 0;
BA_ "GatewayedSignals" SG_ 352 BCS_ABSFaultSt 0;
BA_ "GenSigInactiveValue" SG_ 352 BCS_ABSFaultSt 0;
BA_ "GenSigInvalidValue" SG_ 352 BCS_ABSFaultSt 0;
BA_ "GenSigSendType" SG_ 352 BCS_ABSFaultSt 1;
BA_ "GenSigStartValue" SG_ 352 BCS_ABSFaultSt 1;
BA_ "GenSigTimeoutValue" SG_ 352 BCS_ABSFaultSt 1;
BA_ "Remark" SG_ 352 BCS_ABSFaultSt "";
BA_ "EventCommandSignal" SG_ 352 BCS_TCSActiveSt 0;
BA_ "GatewayedSignals" SG_ 352 BCS_TCSActiveSt 0;
BA_ "GenSigInactiveValue" SG_ 352 BCS_TCSActiveSt 0;
BA_ "GenSigInvalidValue" SG_ 352 BCS_TCSActiveSt 0;
BA_ "GenSigSendType" SG_ 352 BCS_TCSActiveSt 1;
BA_ "GenSigStartValue" SG_ 352 BCS_TCSActiveSt 0;
BA_ "GenSigTimeoutValue" SG_ 352 BCS_TCSActiveSt 0;
BA_ "Remark" SG_ 352 BCS_TCSActiveSt "";
BA_ "EventCommandSignal" SG_ 352 BCS_TCSFaultSt 0;
BA_ "GatewayedSignals" SG_ 352 BCS_TCSFaultSt 0;
BA_ "GenSigInactiveValue" SG_ 352 BCS_TCSFaultSt 0;
BA_ "GenSigInvalidValue" SG_ 352 BCS_TCSFaultSt 0;
BA_ "GenSigSendType" SG_ 352 BCS_TCSFaultSt 1;
BA_ "GenSigStartValue" SG_ 352 BCS_TCSFaultSt 1;
BA_ "GenSigTimeoutValue" SG_ 352 BCS_TCSFaultSt 1;
BA_ "Remark" SG_ 352 BCS_TCSFaultSt "";
BA_ "EventCommandSignal" SG_ 352 BCS_VDCActiveSt 0;
BA_ "GatewayedSignals" SG_ 352 BCS_VDCActiveSt 0;
BA_ "GenSigInactiveValue" SG_ 352 BCS_VDCActiveSt 0;
BA_ "GenSigInvalidValue" SG_ 352 BCS_VDCActiveSt 0;
BA_ "GenSigSendType" SG_ 352 BCS_VDCActiveSt 1;
BA_ "GenSigStartValue" SG_ 352 BCS_VDCActiveSt 0;
BA_ "GenSigTimeoutValue" SG_ 352 BCS_VDCActiveSt 0;
BA_ "Remark" SG_ 352 BCS_VDCActiveSt "";
BA_ "EventCommandSignal" SG_ 352 BCS_VDCFaultSt 0;
BA_ "GatewayedSignals" SG_ 352 BCS_VDCFaultSt 0;
BA_ "GenSigInactiveValue" SG_ 352 BCS_VDCFaultSt 0;
BA_ "GenSigInvalidValue" SG_ 352 BCS_VDCFaultSt 0;
BA_ "GenSigSendType" SG_ 352 BCS_VDCFaultSt 1;
BA_ "GenSigStartValue" SG_ 352 BCS_VDCFaultSt 1;
BA_ "GenSigTimeoutValue" SG_ 352 BCS_VDCFaultSt 1;
BA_ "Remark" SG_ 352 BCS_VDCFaultSt "";
BA_ "EventCommandSignal" SG_ 352 BCS_EngTorqDecActiveSt 0;
BA_ "GatewayedSignals" SG_ 352 BCS_EngTorqDecActiveSt 0;
BA_ "GenSigInactiveValue" SG_ 352 BCS_EngTorqDecActiveSt 0;
BA_ "GenSigInvalidValue" SG_ 352 BCS_EngTorqDecActiveSt 0;
BA_ "GenSigSendType" SG_ 352 BCS_EngTorqDecActiveSt 1;
BA_ "GenSigStartValue" SG_ 352 BCS_EngTorqDecActiveSt 0;
BA_ "GenSigTimeoutValue" SG_ 352 BCS_EngTorqDecActiveSt 0;
BA_ "Remark" SG_ 352 BCS_EngTorqDecActiveSt "";
BA_ "EventCommandSignal" SG_ 352 BCS_EngTorqIncActiveSt 0;
BA_ "GatewayedSignals" SG_ 352 BCS_EngTorqIncActiveSt 0;
BA_ "GenSigInactiveValue" SG_ 352 BCS_EngTorqIncActiveSt 0;
BA_ "GenSigInvalidValue" SG_ 352 BCS_EngTorqIncActiveSt 0;
BA_ "GenSigSendType" SG_ 352 BCS_EngTorqIncActiveSt 1;
BA_ "GenSigStartValue" SG_ 352 BCS_EngTorqIncActiveSt 0;
BA_ "GenSigTimeoutValue" SG_ 352 BCS_EngTorqIncActiveSt 0;
BA_ "Remark" SG_ 352 BCS_EngTorqIncActiveSt "";
BA_ "EventCommandSignal" SG_ 352 BCS_RegenModulationAvailable 0;
BA_ "GatewayedSignals" SG_ 352 BCS_RegenModulationAvailable 0;
BA_ "GenSigInactiveValue" SG_ 352 BCS_RegenModulationAvailable 0;
BA_ "GenSigInvalidValue" SG_ 352 BCS_RegenModulationAvailable 0;
BA_ "GenSigSendType" SG_ 352 BCS_RegenModulationAvailable 1;
BA_ "GenSigStartValue" SG_ 352 BCS_RegenModulationAvailable 0;
BA_ "GenSigTimeoutValue" SG_ 352 BCS_RegenModulationAvailable 0;
BA_ "Remark" SG_ 352 BCS_RegenModulationAvailable "";
BA_ "EventCommandSignal" SG_ 352 BCS_RegenModuleActive 0;
BA_ "GatewayedSignals" SG_ 352 BCS_RegenModuleActive 0;
BA_ "GenSigInactiveValue" SG_ 352 BCS_RegenModuleActive 0;
BA_ "GenSigInvalidValue" SG_ 352 BCS_RegenModuleActive 0;
BA_ "GenSigSendType" SG_ 352 BCS_RegenModuleActive 1;
BA_ "GenSigStartValue" SG_ 352 BCS_RegenModuleActive 0;
BA_ "GenSigTimeoutValue" SG_ 352 BCS_RegenModuleActive 0;
BA_ "Remark" SG_ 352 BCS_RegenModuleActive "";
BA_ "EventCommandSignal" SG_ 352 BCS_EngTorqDecFastRANm 0;
BA_ "GatewayedSignals" SG_ 352 BCS_EngTorqDecFastRANm 0;
BA_ "GenSigInactiveValue" SG_ 352 BCS_EngTorqDecFastRANm 0;
BA_ "GenSigInvalidValue" SG_ 352 BCS_EngTorqDecFastRANm 0;
BA_ "GenSigSendType" SG_ 352 BCS_EngTorqDecFastRANm 1;
BA_ "GenSigStartValue" SG_ 352 BCS_EngTorqDecFastRANm 60000;
BA_ "GenSigTimeoutValue" SG_ 352 BCS_EngTorqDecFastRANm 0;
BA_ "Remark" SG_ 352 BCS_EngTorqDecFastRANm "";
BA_ "EventCommandSignal" SG_ 352 BCS_EngTorqIncRANm 0;
BA_ "GatewayedSignals" SG_ 352 BCS_EngTorqIncRANm 0;
BA_ "GenSigInactiveValue" SG_ 352 BCS_EngTorqIncRANm 0;
BA_ "GenSigInvalidValue" SG_ 352 BCS_EngTorqIncRANm 0;
BA_ "GenSigSendType" SG_ 352 BCS_EngTorqIncRANm 1;
BA_ "GenSigStartValue" SG_ 352 BCS_EngTorqIncRANm 0;
BA_ "GenSigTimeoutValue" SG_ 352 BCS_EngTorqIncRANm 0;
BA_ "Remark" SG_ 352 BCS_EngTorqIncRANm "";
BA_ "EventCommandSignal" SG_ 352 BCS_RealTCSActiveSt 0;
BA_ "GatewayedSignals" SG_ 352 BCS_RealTCSActiveSt 0;
BA_ "GenSigInactiveValue" SG_ 352 BCS_RealTCSActiveSt 0;
BA_ "GenSigInvalidValue" SG_ 352 BCS_RealTCSActiveSt 0;
BA_ "GenSigSendType" SG_ 352 BCS_RealTCSActiveSt 1;
BA_ "GenSigStartValue" SG_ 352 BCS_RealTCSActiveSt 0;
BA_ "GenSigTimeoutValue" SG_ 352 BCS_RealTCSActiveSt 0;
BA_ "Remark" SG_ 352 BCS_RealTCSActiveSt "";
BA_ "EventCommandSignal" SG_ 352 BCS_TargetRecpTorqRq 0;
BA_ "GatewayedSignals" SG_ 352 BCS_TargetRecpTorqRq 0;
BA_ "GenSigInactiveValue" SG_ 352 BCS_TargetRecpTorqRq 0;
BA_ "GenSigInvalidValue" SG_ 352 BCS_TargetRecpTorqRq 0;
BA_ "GenSigSendType" SG_ 352 BCS_TargetRecpTorqRq 1;
BA_ "GenSigStartValue" SG_ 352 BCS_TargetRecpTorqRq 6000;
BA_ "GenSigTimeoutValue" SG_ 352 BCS_TargetRecpTorqRq 0;
BA_ "Remark" SG_ 352 BCS_TargetRecpTorqRq "";
BA_ "EventCommandSignal" SG_ 352 BCS_TargetRecpTorqRqSt 0;
BA_ "GatewayedSignals" SG_ 352 BCS_TargetRecpTorqRqSt 0;
BA_ "GenSigInactiveValue" SG_ 352 BCS_TargetRecpTorqRqSt 0;
BA_ "GenSigInvalidValue" SG_ 352 BCS_TargetRecpTorqRqSt 0;
BA_ "GenSigSendType" SG_ 352 BCS_TargetRecpTorqRqSt 1;
BA_ "GenSigStartValue" SG_ 352 BCS_TargetRecpTorqRqSt 0;
BA_ "GenSigTimeoutValue" SG_ 352 BCS_TargetRecpTorqRqSt 0;
BA_ "Remark" SG_ 352 BCS_TargetRecpTorqRqSt "";
BA_ "EventCommandSignal" SG_ 352 BCS_CrbsActive 0;
BA_ "GatewayedSignals" SG_ 352 BCS_CrbsActive 0;
BA_ "GenSigInactiveValue" SG_ 352 BCS_CrbsActive 0;
BA_ "GenSigInvalidValue" SG_ 352 BCS_CrbsActive 0;
BA_ "GenSigSendType" SG_ 352 BCS_CrbsActive 1;
BA_ "GenSigStartValue" SG_ 352 BCS_CrbsActive 0;
BA_ "GenSigTimeoutValue" SG_ 352 BCS_CrbsActive 0;
BA_ "Remark" SG_ 352 BCS_CrbsActive "";
BA_ "EventCommandSignal" SG_ 352 BCS_EngTorqDecFastFA 0;
BA_ "GatewayedSignals" SG_ 352 BCS_EngTorqDecFastFA 0;
BA_ "GenSigInactiveValue" SG_ 352 BCS_EngTorqDecFastFA 0;
BA_ "GenSigInvalidValue" SG_ 352 BCS_EngTorqDecFastFA 0;
BA_ "GenSigSendType" SG_ 352 BCS_EngTorqDecFastFA 1;
BA_ "GenSigStartValue" SG_ 352 BCS_EngTorqDecFastFA 255;
BA_ "GenSigTimeoutValue" SG_ 352 BCS_EngTorqDecFastFA 0;
BA_ "Remark" SG_ 352 BCS_EngTorqDecFastFA "";
BA_ "EventCommandSignal" SG_ 352 BCS_TargetRecpTorqRqFA 0;
BA_ "GatewayedSignals" SG_ 352 BCS_TargetRecpTorqRqFA 0;
BA_ "GenSigInactiveValue" SG_ 352 BCS_TargetRecpTorqRqFA 0;
BA_ "GenSigInvalidValue" SG_ 352 BCS_TargetRecpTorqRqFA 0;
BA_ "GenSigSendType" SG_ 352 BCS_TargetRecpTorqRqFA 1;
BA_ "GenSigStartValue" SG_ 352 BCS_TargetRecpTorqRqFA 6000;
BA_ "GenSigTimeoutValue" SG_ 352 BCS_TargetRecpTorqRqFA 0;
BA_ "Remark" SG_ 352 BCS_TargetRecpTorqRqFA "";
BA_ "EventCommandSignal" SG_ 352 BCS_TargetRecpTorqRqFASt 0;
BA_ "GatewayedSignals" SG_ 352 BCS_TargetRecpTorqRqFASt 0;
BA_ "GenSigInactiveValue" SG_ 352 BCS_TargetRecpTorqRqFASt 0;
BA_ "GenSigInvalidValue" SG_ 352 BCS_TargetRecpTorqRqFASt 0;
BA_ "GenSigSendType" SG_ 352 BCS_TargetRecpTorqRqFASt 1;
BA_ "GenSigStartValue" SG_ 352 BCS_TargetRecpTorqRqFASt 0;
BA_ "GenSigTimeoutValue" SG_ 352 BCS_TargetRecpTorqRqFASt 0;
BA_ "Remark" SG_ 352 BCS_TargetRecpTorqRqFASt "";
BA_ "EventCommandSignal" SG_ 352 BCS_TargetRecpTorqRqRA 0;
BA_ "GatewayedSignals" SG_ 352 BCS_TargetRecpTorqRqRA 0;
BA_ "GenSigInactiveValue" SG_ 352 BCS_TargetRecpTorqRqRA 0;
BA_ "GenSigInvalidValue" SG_ 352 BCS_TargetRecpTorqRqRA 0;
BA_ "GenSigSendType" SG_ 352 BCS_TargetRecpTorqRqRA 1;
BA_ "GenSigStartValue" SG_ 352 BCS_TargetRecpTorqRqRA 6000;
BA_ "GenSigTimeoutValue" SG_ 352 BCS_TargetRecpTorqRqRA 0;
BA_ "Remark" SG_ 352 BCS_TargetRecpTorqRqRA "";
BA_ "EventCommandSignal" SG_ 352 BCS_TargetRecpTorqRqRASt 0;
BA_ "GatewayedSignals" SG_ 352 BCS_TargetRecpTorqRqRASt 0;
BA_ "GenSigInactiveValue" SG_ 352 BCS_TargetRecpTorqRqRASt 0;
BA_ "GenSigInvalidValue" SG_ 352 BCS_TargetRecpTorqRqRASt 0;
BA_ "GenSigSendType" SG_ 352 BCS_TargetRecpTorqRqRASt 1;
BA_ "GenSigStartValue" SG_ 352 BCS_TargetRecpTorqRqRASt 0;
BA_ "GenSigTimeoutValue" SG_ 352 BCS_TargetRecpTorqRqRASt 0;
BA_ "Remark" SG_ 352 BCS_TargetRecpTorqRqRASt "";
BA_ "EventCommandSignal" SG_ 352 IPB_BrakePedalSt 0;
BA_ "GatewayedSignals" SG_ 352 IPB_BrakePedalSt 0;
BA_ "GenSigInactiveValue" SG_ 352 IPB_BrakePedalSt 0;
BA_ "GenSigInvalidValue" SG_ 352 IPB_BrakePedalSt 0;
BA_ "GenSigSendType" SG_ 352 IPB_BrakePedalSt 1;
BA_ "GenSigStartValue" SG_ 352 IPB_BrakePedalSt 0;
BA_ "GenSigTimeoutValue" SG_ 352 IPB_BrakePedalSt 0;
BA_ "Remark" SG_ 352 IPB_BrakePedalSt "";
BA_ "EventCommandSignal" SG_ 352 IPB_BrakePedalStsVld 0;
BA_ "GatewayedSignals" SG_ 352 IPB_BrakePedalStsVld 0;
BA_ "GenSigInactiveValue" SG_ 352 IPB_BrakePedalStsVld 0;
BA_ "GenSigInvalidValue" SG_ 352 IPB_BrakePedalStsVld 0;
BA_ "GenSigSendType" SG_ 352 IPB_BrakePedalStsVld 1;
BA_ "GenSigStartValue" SG_ 352 IPB_BrakePedalStsVld 0;
BA_ "GenSigTimeoutValue" SG_ 352 IPB_BrakePedalStsVld 0;
BA_ "Remark" SG_ 352 IPB_BrakePedalStsVld "";
BA_ "EventCommandSignal" SG_ 352 BCS_ESP2Park_DrvBrkOverrideFlg 0;
BA_ "GatewayedSignals" SG_ 352 BCS_ESP2Park_DrvBrkOverrideFlg 0;
BA_ "GenSigInactiveValue" SG_ 352 BCS_ESP2Park_DrvBrkOverrideFlg 0;
BA_ "GenSigInvalidValue" SG_ 352 BCS_ESP2Park_DrvBrkOverrideFlg 0;
BA_ "GenSigSendType" SG_ 352 BCS_ESP2Park_DrvBrkOverrideFlg 1;
BA_ "GenSigStartValue" SG_ 352 BCS_ESP2Park_DrvBrkOverrideFlg 0;
BA_ "GenSigTimeoutValue" SG_ 352 BCS_ESP2Park_DrvBrkOverrideFlg 0;
BA_ "Remark" SG_ 352 BCS_ESP2Park_DrvBrkOverrideFlg "";
BA_ "EventCommandSignal" SG_ 352 BCS_EngTorqDecActiveStRA 0;
BA_ "GatewayedSignals" SG_ 352 BCS_EngTorqDecActiveStRA 0;
BA_ "GenSigInactiveValue" SG_ 352 BCS_EngTorqDecActiveStRA 0;
BA_ "GenSigInvalidValue" SG_ 352 BCS_EngTorqDecActiveStRA 0;
BA_ "GenSigSendType" SG_ 352 BCS_EngTorqDecActiveStRA 1;
BA_ "GenSigStartValue" SG_ 352 BCS_EngTorqDecActiveStRA 0;
BA_ "GenSigTimeoutValue" SG_ 352 BCS_EngTorqDecActiveStRA 0;
BA_ "Remark" SG_ 352 BCS_EngTorqDecActiveStRA "";
BA_ "EventCommandSignal" SG_ 352 BCS_EngTorqIncActiveStRA 0;
BA_ "GatewayedSignals" SG_ 352 BCS_EngTorqIncActiveStRA 0;
BA_ "GenSigInactiveValue" SG_ 352 BCS_EngTorqIncActiveStRA 0;
BA_ "GenSigInvalidValue" SG_ 352 BCS_EngTorqIncActiveStRA 0;
BA_ "GenSigSendType" SG_ 352 BCS_EngTorqIncActiveStRA 1;
BA_ "GenSigStartValue" SG_ 352 BCS_EngTorqIncActiveStRA 0;
BA_ "GenSigTimeoutValue" SG_ 352 BCS_EngTorqIncActiveStRA 0;
BA_ "Remark" SG_ 352 BCS_EngTorqIncActiveStRA "";
BA_ "EventCommandSignal" SG_ 352 BCS_EngTorqIncActiveStFA 0;
BA_ "GatewayedSignals" SG_ 352 BCS_EngTorqIncActiveStFA 0;
BA_ "GenSigInactiveValue" SG_ 352 BCS_EngTorqIncActiveStFA 0;
BA_ "GenSigInvalidValue" SG_ 352 BCS_EngTorqIncActiveStFA 0;
BA_ "GenSigSendType" SG_ 352 BCS_EngTorqIncActiveStFA 1;
BA_ "GenSigStartValue" SG_ 352 BCS_EngTorqIncActiveStFA 0;
BA_ "GenSigTimeoutValue" SG_ 352 BCS_EngTorqIncActiveStFA 0;
BA_ "Remark" SG_ 352 BCS_EngTorqIncActiveStFA "";
BA_ "EventCommandSignal" SG_ 352 BCS_EngTorqDecFastRA 0;
BA_ "GatewayedSignals" SG_ 352 BCS_EngTorqDecFastRA 0;
BA_ "GenSigInactiveValue" SG_ 352 BCS_EngTorqDecFastRA 0;
BA_ "GenSigInvalidValue" SG_ 352 BCS_EngTorqDecFastRA 0;
BA_ "GenSigSendType" SG_ 352 BCS_EngTorqDecFastRA 1;
BA_ "GenSigStartValue" SG_ 352 BCS_EngTorqDecFastRA 255;
BA_ "GenSigTimeoutValue" SG_ 352 BCS_EngTorqDecFastRA 0;
BA_ "Remark" SG_ 352 BCS_EngTorqDecFastRA "";
BA_ "EventCommandSignal" SG_ 352 BCS_EngTorqIncRA 0;
BA_ "GatewayedSignals" SG_ 352 BCS_EngTorqIncRA 0;
BA_ "GenSigInactiveValue" SG_ 352 BCS_EngTorqIncRA 0;
BA_ "GenSigInvalidValue" SG_ 352 BCS_EngTorqIncRA 0;
BA_ "GenSigSendType" SG_ 352 BCS_EngTorqIncRA 1;
BA_ "GenSigStartValue" SG_ 352 BCS_EngTorqIncRA 255;
BA_ "GenSigTimeoutValue" SG_ 352 BCS_EngTorqIncRA 0;
BA_ "Remark" SG_ 352 BCS_EngTorqIncRA "";
BA_ "EventCommandSignal" SG_ 352 BCS_EngTorqDecActiveStFA 0;
BA_ "GatewayedSignals" SG_ 352 BCS_EngTorqDecActiveStFA 0;
BA_ "GenSigInactiveValue" SG_ 352 BCS_EngTorqDecActiveStFA 0;
BA_ "GenSigInvalidValue" SG_ 352 BCS_EngTorqDecActiveStFA 0;
BA_ "GenSigSendType" SG_ 352 BCS_EngTorqDecActiveStFA 1;
BA_ "GenSigStartValue" SG_ 352 BCS_EngTorqDecActiveStFA 0;
BA_ "GenSigTimeoutValue" SG_ 352 BCS_EngTorqDecActiveStFA 0;
BA_ "Remark" SG_ 352 BCS_EngTorqDecActiveStFA "";
BA_ "EventCommandSignal" SG_ 352 BCS_PrimBrkCDAAvailableSt 0;
BA_ "GatewayedSignals" SG_ 352 BCS_PrimBrkCDAAvailableSt 0;
BA_ "GenSigInactiveValue" SG_ 352 BCS_PrimBrkCDAAvailableSt 0;
BA_ "GenSigInvalidValue" SG_ 352 BCS_PrimBrkCDAAvailableSt 0;
BA_ "GenSigSendType" SG_ 352 BCS_PrimBrkCDAAvailableSt 1;
BA_ "GenSigStartValue" SG_ 352 BCS_PrimBrkCDAAvailableSt 0;
BA_ "GenSigTimeoutValue" SG_ 352 BCS_PrimBrkCDAAvailableSt 0;
BA_ "Remark" SG_ 352 BCS_PrimBrkCDAAvailableSt "";
BA_ "EventCommandSignal" SG_ 352 BCS_PrimBrkCommuniSt 0;
BA_ "GatewayedSignals" SG_ 352 BCS_PrimBrkCommuniSt 0;
BA_ "GenSigInactiveValue" SG_ 352 BCS_PrimBrkCommuniSt 0;
BA_ "GenSigInvalidValue" SG_ 352 BCS_PrimBrkCommuniSt 0;
BA_ "GenSigSendType" SG_ 352 BCS_PrimBrkCommuniSt 1;
BA_ "GenSigStartValue" SG_ 352 BCS_PrimBrkCommuniSt 0;
BA_ "GenSigTimeoutValue" SG_ 352 BCS_PrimBrkCommuniSt 0;
BA_ "Remark" SG_ 352 BCS_PrimBrkCommuniSt "";
BA_ "EventCommandSignal" SG_ 352 BCS_PrimBrkActiveSt 0;
BA_ "GatewayedSignals" SG_ 352 BCS_PrimBrkActiveSt 0;
BA_ "GenSigInactiveValue" SG_ 352 BCS_PrimBrkActiveSt 0;
BA_ "GenSigInvalidValue" SG_ 352 BCS_PrimBrkActiveSt 0;
BA_ "GenSigSendType" SG_ 352 BCS_PrimBrkActiveSt 1;
BA_ "GenSigStartValue" SG_ 352 BCS_PrimBrkActiveSt 0;
BA_ "GenSigTimeoutValue" SG_ 352 BCS_PrimBrkActiveSt 0;
BA_ "Remark" SG_ 352 BCS_PrimBrkActiveSt "";
BA_ "EventCommandSignal" SG_ 352 BCS_2ParkDynamicAVPavailability 0;
BA_ "GatewayedSignals" SG_ 352 BCS_2ParkDynamicAVPavailability 0;
BA_ "GenSigInactiveValue" SG_ 352 BCS_2ParkDynamicAVPavailability 0;
BA_ "GenSigInvalidValue" SG_ 352 BCS_2ParkDynamicAVPavailability 0;
BA_ "GenSigSendType" SG_ 352 BCS_2ParkDynamicAVPavailability 1;
BA_ "GenSigStartValue" SG_ 352 BCS_2ParkDynamicAVPavailability 0;
BA_ "GenSigTimeoutValue" SG_ 352 BCS_2ParkDynamicAVPavailability 0;
BA_ "Remark" SG_ 352 BCS_2ParkDynamicAVPavailability "";
BA_ "EventCommandSignal" SG_ 352 BCS_2ParkCddApActiveVehHld 0;
BA_ "GatewayedSignals" SG_ 352 BCS_2ParkCddApActiveVehHld 0;
BA_ "GenSigInactiveValue" SG_ 352 BCS_2ParkCddApActiveVehHld 0;
BA_ "GenSigInvalidValue" SG_ 352 BCS_2ParkCddApActiveVehHld 0;
BA_ "GenSigSendType" SG_ 352 BCS_2ParkCddApActiveVehHld 1;
BA_ "GenSigStartValue" SG_ 352 BCS_2ParkCddApActiveVehHld 0;
BA_ "GenSigTimeoutValue" SG_ 352 BCS_2ParkCddApActiveVehHld 0;
BA_ "Remark" SG_ 352 BCS_2ParkCddApActiveVehHld "";
BA_ "EventCommandSignal" SG_ 352 BCS_2ParkAPCStatus 0;
BA_ "GatewayedSignals" SG_ 352 BCS_2ParkAPCStatus 0;
BA_ "GenSigInactiveValue" SG_ 352 BCS_2ParkAPCStatus 0;
BA_ "GenSigInvalidValue" SG_ 352 BCS_2ParkAPCStatus 0;
BA_ "GenSigSendType" SG_ 352 BCS_2ParkAPCStatus 1;
BA_ "GenSigStartValue" SG_ 352 BCS_2ParkAPCStatus 0;
BA_ "GenSigTimeoutValue" SG_ 352 BCS_2ParkAPCStatus 0;
BA_ "Remark" SG_ 352 BCS_2ParkAPCStatus "";
BA_ "EventCommandSignal" SG_ 352 BCS_2ParkAPAavailability 0;
BA_ "GatewayedSignals" SG_ 352 BCS_2ParkAPAavailability 0;
BA_ "GenSigInactiveValue" SG_ 352 BCS_2ParkAPAavailability 0;
BA_ "GenSigInvalidValue" SG_ 352 BCS_2ParkAPAavailability 0;
BA_ "GenSigSendType" SG_ 352 BCS_2ParkAPAavailability 1;
BA_ "GenSigStartValue" SG_ 352 BCS_2ParkAPAavailability 0;
BA_ "GenSigTimeoutValue" SG_ 352 BCS_2ParkAPAavailability 0;
BA_ "Remark" SG_ 352 BCS_2ParkAPAavailability "";
BA_ "EventCommandSignal" SG_ 352 BCS_2ParkRPAAVPavailability 0;
BA_ "GatewayedSignals" SG_ 352 BCS_2ParkRPAAVPavailability 0;
BA_ "GenSigInactiveValue" SG_ 352 BCS_2ParkRPAAVPavailability 0;
BA_ "GenSigInvalidValue" SG_ 352 BCS_2ParkRPAAVPavailability 0;
BA_ "GenSigSendType" SG_ 352 BCS_2ParkRPAAVPavailability 1;
BA_ "GenSigStartValue" SG_ 352 BCS_2ParkRPAAVPavailability 0;
BA_ "GenSigTimeoutValue" SG_ 352 BCS_2ParkRPAAVPavailability 0;
BA_ "Remark" SG_ 352 BCS_2ParkRPAAVPavailability "";
BA_ "EventCommandSignal" SG_ 352 BCS_2ParkAPCFailureSts 0;
BA_ "GatewayedSignals" SG_ 352 BCS_2ParkAPCFailureSts 0;
BA_ "GenSigInactiveValue" SG_ 352 BCS_2ParkAPCFailureSts 0;
BA_ "GenSigInvalidValue" SG_ 352 BCS_2ParkAPCFailureSts 0;
BA_ "GenSigSendType" SG_ 352 BCS_2ParkAPCFailureSts 1;
BA_ "GenSigStartValue" SG_ 352 BCS_2ParkAPCFailureSts 0;
BA_ "GenSigTimeoutValue" SG_ 352 BCS_2ParkAPCFailureSts 0;
BA_ "Remark" SG_ 352 BCS_2ParkAPCFailureSts "";
BA_ "EventCommandSignal" SG_ 352 BCS_APCMain2BackupReq 0;
BA_ "GatewayedSignals" SG_ 352 BCS_APCMain2BackupReq 0;
BA_ "GenSigInactiveValue" SG_ 352 BCS_APCMain2BackupReq 0;
BA_ "GenSigInvalidValue" SG_ 352 BCS_APCMain2BackupReq 0;
BA_ "GenSigSendType" SG_ 352 BCS_APCMain2BackupReq 1;
BA_ "GenSigStartValue" SG_ 352 BCS_APCMain2BackupReq 0;
BA_ "GenSigTimeoutValue" SG_ 352 BCS_APCMain2BackupReq 0;
BA_ "Remark" SG_ 352 BCS_APCMain2BackupReq "";
BA_ "EventCommandSignal" SG_ 352 BCS_PrimBrkCtrlUsedChannel 0;
BA_ "GatewayedSignals" SG_ 352 BCS_PrimBrkCtrlUsedChannel 0;
BA_ "GenSigInactiveValue" SG_ 352 BCS_PrimBrkCtrlUsedChannel 0;
BA_ "GenSigInvalidValue" SG_ 352 BCS_PrimBrkCtrlUsedChannel 0;
BA_ "GenSigSendType" SG_ 352 BCS_PrimBrkCtrlUsedChannel 1;
BA_ "GenSigStartValue" SG_ 352 BCS_PrimBrkCtrlUsedChannel 0;
BA_ "GenSigTimeoutValue" SG_ 352 BCS_PrimBrkCtrlUsedChannel 0;
BA_ "Remark" SG_ 352 BCS_PrimBrkCtrlUsedChannel "";
BA_ "EventCommandSignal" SG_ 352 BCS_PrimBrkCDAActiveSt 0;
BA_ "GatewayedSignals" SG_ 352 BCS_PrimBrkCDAActiveSt 0;
BA_ "GenSigInactiveValue" SG_ 352 BCS_PrimBrkCDAActiveSt 0;
BA_ "GenSigInvalidValue" SG_ 352 BCS_PrimBrkCDAActiveSt 0;
BA_ "GenSigSendType" SG_ 352 BCS_PrimBrkCDAActiveSt 1;
BA_ "GenSigStartValue" SG_ 352 BCS_PrimBrkCDAActiveSt 0;
BA_ "GenSigTimeoutValue" SG_ 352 BCS_PrimBrkCDAActiveSt 0;
BA_ "Remark" SG_ 352 BCS_PrimBrkCDAActiveSt "";
BA_ "EventCommandSignal" SG_ 352 BCS_PrimBrkDecCtrlActiveSt 0;
BA_ "GatewayedSignals" SG_ 352 BCS_PrimBrkDecCtrlActiveSt 0;
BA_ "GenSigInactiveValue" SG_ 352 BCS_PrimBrkDecCtrlActiveSt 0;
BA_ "GenSigInvalidValue" SG_ 352 BCS_PrimBrkDecCtrlActiveSt 0;
BA_ "GenSigSendType" SG_ 352 BCS_PrimBrkDecCtrlActiveSt 1;
BA_ "GenSigStartValue" SG_ 352 BCS_PrimBrkDecCtrlActiveSt 0;
BA_ "GenSigTimeoutValue" SG_ 352 BCS_PrimBrkDecCtrlActiveSt 0;
BA_ "Remark" SG_ 352 BCS_PrimBrkDecCtrlActiveSt "";
BA_ "EventCommandSignal" SG_ 352 BCS_PrimBrkCDDAvailableSt 0;
BA_ "GatewayedSignals" SG_ 352 BCS_PrimBrkCDDAvailableSt 0;
BA_ "GenSigInactiveValue" SG_ 352 BCS_PrimBrkCDDAvailableSt 0;
BA_ "GenSigInvalidValue" SG_ 352 BCS_PrimBrkCDDAvailableSt 0;
BA_ "GenSigSendType" SG_ 352 BCS_PrimBrkCDDAvailableSt 1;
BA_ "GenSigStartValue" SG_ 352 BCS_PrimBrkCDDAvailableSt 0;
BA_ "GenSigTimeoutValue" SG_ 352 BCS_PrimBrkCDDAvailableSt 0;
BA_ "Remark" SG_ 352 BCS_PrimBrkCDDAvailableSt "";
BA_ "EventCommandSignal" SG_ 352 BCS_EngTorqIncFA 0;
BA_ "GatewayedSignals" SG_ 352 BCS_EngTorqIncFA 0;
BA_ "GenSigInactiveValue" SG_ 352 BCS_EngTorqIncFA 0;
BA_ "GenSigInvalidValue" SG_ 352 BCS_EngTorqIncFA 0;
BA_ "GenSigSendType" SG_ 352 BCS_EngTorqIncFA 1;
BA_ "GenSigStartValue" SG_ 352 BCS_EngTorqIncFA 255;
BA_ "GenSigTimeoutValue" SG_ 352 BCS_EngTorqIncFA 0;
BA_ "Remark" SG_ 352 BCS_EngTorqIncFA "";
BA_ "EventCommandSignal" SG_ 611 BCS_HydBrkActvTq_FL_1 0;
BA_ "GatewayedSignals" SG_ 611 BCS_HydBrkActvTq_FL_1 0;
BA_ "GenSigInactiveValue" SG_ 611 BCS_HydBrkActvTq_FL_1 0;
BA_ "GenSigInvalidValue" SG_ 611 BCS_HydBrkActvTq_FL_1 0;
BA_ "GenSigSendType" SG_ 611 BCS_HydBrkActvTq_FL_1 1;
BA_ "GenSigStartValue" SG_ 611 BCS_HydBrkActvTq_FL_1 0;
BA_ "GenSigTimeoutValue" SG_ 611 BCS_HydBrkActvTq_FL_1 0;
BA_ "Remark" SG_ 611 BCS_HydBrkActvTq_FL_1 "";
BA_ "EventCommandSignal" SG_ 611 BCS_HydBrkActvTq_FR_1 0;
BA_ "GatewayedSignals" SG_ 611 BCS_HydBrkActvTq_FR_1 0;
BA_ "GenSigInactiveValue" SG_ 611 BCS_HydBrkActvTq_FR_1 0;
BA_ "GenSigInvalidValue" SG_ 611 BCS_HydBrkActvTq_FR_1 0;
BA_ "GenSigSendType" SG_ 611 BCS_HydBrkActvTq_FR_1 1;
BA_ "GenSigStartValue" SG_ 611 BCS_HydBrkActvTq_FR_1 0;
BA_ "GenSigTimeoutValue" SG_ 611 BCS_HydBrkActvTq_FR_1 0;
BA_ "Remark" SG_ 611 BCS_HydBrkActvTq_FR_1 "";
BA_ "EventCommandSignal" SG_ 611 BCS_HydBrkActvTq_RL_1 0;
BA_ "GatewayedSignals" SG_ 611 BCS_HydBrkActvTq_RL_1 0;
BA_ "GenSigInactiveValue" SG_ 611 BCS_HydBrkActvTq_RL_1 0;
BA_ "GenSigInvalidValue" SG_ 611 BCS_HydBrkActvTq_RL_1 0;
BA_ "GenSigSendType" SG_ 611 BCS_HydBrkActvTq_RL_1 1;
BA_ "GenSigStartValue" SG_ 611 BCS_HydBrkActvTq_RL_1 0;
BA_ "GenSigTimeoutValue" SG_ 611 BCS_HydBrkActvTq_RL_1 0;
BA_ "Remark" SG_ 611 BCS_HydBrkActvTq_RL_1 "";
BA_ "EventCommandSignal" SG_ 611 BCS_HydBrkActvTq_RR_1 0;
BA_ "GatewayedSignals" SG_ 611 BCS_HydBrkActvTq_RR_1 0;
BA_ "GenSigInactiveValue" SG_ 611 BCS_HydBrkActvTq_RR_1 0;
BA_ "GenSigInvalidValue" SG_ 611 BCS_HydBrkActvTq_RR_1 0;
BA_ "GenSigSendType" SG_ 611 BCS_HydBrkActvTq_RR_1 1;
BA_ "GenSigStartValue" SG_ 611 BCS_HydBrkActvTq_RR_1 0;
BA_ "GenSigTimeoutValue" SG_ 611 BCS_HydBrkActvTq_RR_1 0;
BA_ "Remark" SG_ 611 BCS_HydBrkActvTq_RR_1 "";
BA_ "EventCommandSignal" SG_ 611 BCS_PrimCommPathSt 0;
BA_ "GatewayedSignals" SG_ 611 BCS_PrimCommPathSt 0;
BA_ "GenSigInactiveValue" SG_ 611 BCS_PrimCommPathSt 0;
BA_ "GenSigInvalidValue" SG_ 611 BCS_PrimCommPathSt 0;
BA_ "GenSigSendType" SG_ 611 BCS_PrimCommPathSt 1;
BA_ "GenSigStartValue" SG_ 611 BCS_PrimCommPathSt 0;
BA_ "GenSigTimeoutValue" SG_ 611 BCS_PrimCommPathSt 0;
BA_ "Remark" SG_ 611 BCS_PrimCommPathSt "";
BA_ "EventCommandSignal" SG_ 611 BCS_SeconCommPathSt 0;
BA_ "GatewayedSignals" SG_ 611 BCS_SeconCommPathSt 0;
BA_ "GenSigInactiveValue" SG_ 611 BCS_SeconCommPathSt 0;
BA_ "GenSigInvalidValue" SG_ 611 BCS_SeconCommPathSt 0;
BA_ "GenSigSendType" SG_ 611 BCS_SeconCommPathSt 1;
BA_ "GenSigStartValue" SG_ 611 BCS_SeconCommPathSt 0;
BA_ "GenSigTimeoutValue" SG_ 611 BCS_SeconCommPathSt 0;
BA_ "Remark" SG_ 611 BCS_SeconCommPathSt "";
BA_ "EventCommandSignal" SG_ 611 BCS_PressureHldSt 0;
BA_ "GatewayedSignals" SG_ 611 BCS_PressureHldSt 0;
BA_ "GenSigInactiveValue" SG_ 611 BCS_PressureHldSt 0;
BA_ "GenSigInvalidValue" SG_ 611 BCS_PressureHldSt 0;
BA_ "GenSigSendType" SG_ 611 BCS_PressureHldSt 1;
BA_ "GenSigStartValue" SG_ 611 BCS_PressureHldSt 0;
BA_ "GenSigTimeoutValue" SG_ 611 BCS_PressureHldSt 0;
BA_ "Remark" SG_ 611 BCS_PressureHldSt "";
BA_ "EventCommandSignal" SG_ 611 BCS_CDDFuncSt 0;
BA_ "GatewayedSignals" SG_ 611 BCS_CDDFuncSt 0;
BA_ "GenSigInactiveValue" SG_ 611 BCS_CDDFuncSt 0;
BA_ "GenSigInvalidValue" SG_ 611 BCS_CDDFuncSt 0;
BA_ "GenSigSendType" SG_ 611 BCS_CDDFuncSt 1;
BA_ "GenSigStartValue" SG_ 611 BCS_CDDFuncSt 0;
BA_ "GenSigTimeoutValue" SG_ 611 BCS_CDDFuncSt 0;
BA_ "Remark" SG_ 611 BCS_CDDFuncSt "";
BA_ "EventCommandSignal" SG_ 611 IPB_SimulatorPressure 0;
BA_ "GatewayedSignals" SG_ 611 IPB_SimulatorPressure 0;
BA_ "GenSigInactiveValue" SG_ 611 IPB_SimulatorPressure 0;
BA_ "GenSigInvalidValue" SG_ 611 IPB_SimulatorPressure 0;
BA_ "GenSigSendType" SG_ 611 IPB_SimulatorPressure 1;
BA_ "GenSigStartValue" SG_ 611 IPB_SimulatorPressure 17;
BA_ "GenSigTimeoutValue" SG_ 611 IPB_SimulatorPressure 0;
BA_ "Remark" SG_ 611 IPB_SimulatorPressure "";
BA_ "EventCommandSignal" SG_ 611 IPB_SimulatorPressureSt 0;
BA_ "GatewayedSignals" SG_ 611 IPB_SimulatorPressureSt 0;
BA_ "GenSigInactiveValue" SG_ 611 IPB_SimulatorPressureSt 0;
BA_ "GenSigInvalidValue" SG_ 611 IPB_SimulatorPressureSt 0;
BA_ "GenSigSendType" SG_ 611 IPB_SimulatorPressureSt 1;
BA_ "GenSigStartValue" SG_ 611 IPB_SimulatorPressureSt 0;
BA_ "GenSigTimeoutValue" SG_ 611 IPB_SimulatorPressureSt 0;
BA_ "Remark" SG_ 611 IPB_SimulatorPressureSt "";
BA_ "EventCommandSignal" SG_ 611 IBCS_SystemSt 0;
BA_ "GatewayedSignals" SG_ 611 IBCS_SystemSt 0;
BA_ "GenSigInactiveValue" SG_ 611 IBCS_SystemSt 0;
BA_ "GenSigInvalidValue" SG_ 611 IBCS_SystemSt 0;
BA_ "GenSigSendType" SG_ 611 IBCS_SystemSt 1;
BA_ "GenSigStartValue" SG_ 611 IBCS_SystemSt 0;
BA_ "GenSigTimeoutValue" SG_ 611 IBCS_SystemSt 0;
BA_ "Remark" SG_ 611 IBCS_SystemSt "";
BA_ "EventCommandSignal" SG_ 611 IBCS_FWAWarning 0;
BA_ "GatewayedSignals" SG_ 611 IBCS_FWAWarning 0;
BA_ "GenSigInactiveValue" SG_ 611 IBCS_FWAWarning 0;
BA_ "GenSigInvalidValue" SG_ 611 IBCS_FWAWarning 0;
BA_ "GenSigSendType" SG_ 611 IBCS_FWAWarning 1;
BA_ "GenSigStartValue" SG_ 611 IBCS_FWAWarning 0;
BA_ "GenSigTimeoutValue" SG_ 611 IBCS_FWAWarning 0;
BA_ "Remark" SG_ 611 IBCS_FWAWarning "";
BA_ "EventCommandSignal" SG_ 611 IPB_CSTSt 0;
BA_ "GatewayedSignals" SG_ 611 IPB_CSTSt 0;
BA_ "GenSigInactiveValue" SG_ 611 IPB_CSTSt 0;
BA_ "GenSigInvalidValue" SG_ 611 IPB_CSTSt 0;
BA_ "GenSigSendType" SG_ 611 IPB_CSTSt 1;
BA_ "GenSigStartValue" SG_ 611 IPB_CSTSt 0;
BA_ "GenSigTimeoutValue" SG_ 611 IPB_CSTSt 0;
BA_ "Remark" SG_ 611 IPB_CSTSt "";
BA_ "EventCommandSignal" SG_ 611 BCS_AVDCActive 0;
BA_ "GatewayedSignals" SG_ 611 BCS_AVDCActive 0;
BA_ "GenSigInactiveValue" SG_ 611 BCS_AVDCActive 0;
BA_ "GenSigInvalidValue" SG_ 611 BCS_AVDCActive 0;
BA_ "GenSigSendType" SG_ 611 BCS_AVDCActive 1;
BA_ "GenSigStartValue" SG_ 611 BCS_AVDCActive 0;
BA_ "GenSigTimeoutValue" SG_ 611 BCS_AVDCActive 0;
BA_ "Remark" SG_ 611 BCS_AVDCActive "";
BA_ "EventCommandSignal" SG_ 611 BCS_AVDCAvailable 0;
BA_ "GatewayedSignals" SG_ 611 BCS_AVDCAvailable 0;
BA_ "GenSigInactiveValue" SG_ 611 BCS_AVDCAvailable 0;
BA_ "GenSigInvalidValue" SG_ 611 BCS_AVDCAvailable 0;
BA_ "GenSigSendType" SG_ 611 BCS_AVDCAvailable 1;
BA_ "GenSigStartValue" SG_ 611 BCS_AVDCAvailable 0;
BA_ "GenSigTimeoutValue" SG_ 611 BCS_AVDCAvailable 0;
BA_ "Remark" SG_ 611 BCS_AVDCAvailable "";
BA_ "EventCommandSignal" SG_ 360 BCS_6_CRC 0;
BA_ "GatewayedSignals" SG_ 360 BCS_6_CRC 0;
BA_ "GenSigInactiveValue" SG_ 360 BCS_6_CRC 0;
BA_ "GenSigInvalidValue" SG_ 360 BCS_6_CRC 0;
BA_ "GenSigSendType" SG_ 360 BCS_6_CRC 1;
BA_ "GenSigStartValue" SG_ 360 BCS_6_CRC 0;
BA_ "GenSigTimeoutValue" SG_ 360 BCS_6_CRC 0;
BA_ "Remark" SG_ 360 BCS_6_CRC "";
BA_ "EventCommandSignal" SG_ 360 BCS_6_Counter 0;
BA_ "GatewayedSignals" SG_ 360 BCS_6_Counter 0;
BA_ "GenSigInactiveValue" SG_ 360 BCS_6_Counter 0;
BA_ "GenSigInvalidValue" SG_ 360 BCS_6_Counter 0;
BA_ "GenSigSendType" SG_ 360 BCS_6_Counter 1;
BA_ "GenSigStartValue" SG_ 360 BCS_6_Counter 0;
BA_ "GenSigTimeoutValue" SG_ 360 BCS_6_Counter 0;
BA_ "Remark" SG_ 360 BCS_6_Counter "";
BA_ "EventCommandSignal" SG_ 360 BCS_HydBrkActvTq_FL 0;
BA_ "GatewayedSignals" SG_ 360 BCS_HydBrkActvTq_FL 0;
BA_ "GenSigInactiveValue" SG_ 360 BCS_HydBrkActvTq_FL 0;
BA_ "GenSigInvalidValue" SG_ 360 BCS_HydBrkActvTq_FL 0;
BA_ "GenSigSendType" SG_ 360 BCS_HydBrkActvTq_FL 1;
BA_ "GenSigStartValue" SG_ 360 BCS_HydBrkActvTq_FL 0;
BA_ "GenSigTimeoutValue" SG_ 360 BCS_HydBrkActvTq_FL 0;
BA_ "Remark" SG_ 360 BCS_HydBrkActvTq_FL "";
BA_ "EventCommandSignal" SG_ 360 BCS_HydBrkActvTq_FR 0;
BA_ "GatewayedSignals" SG_ 360 BCS_HydBrkActvTq_FR 0;
BA_ "GenSigInactiveValue" SG_ 360 BCS_HydBrkActvTq_FR 0;
BA_ "GenSigInvalidValue" SG_ 360 BCS_HydBrkActvTq_FR 0;
BA_ "GenSigSendType" SG_ 360 BCS_HydBrkActvTq_FR 1;
BA_ "GenSigStartValue" SG_ 360 BCS_HydBrkActvTq_FR 0;
BA_ "GenSigTimeoutValue" SG_ 360 BCS_HydBrkActvTq_FR 0;
BA_ "Remark" SG_ 360 BCS_HydBrkActvTq_FR "";
BA_ "EventCommandSignal" SG_ 360 BCS_HydBrkActvTq_RL 0;
BA_ "GatewayedSignals" SG_ 360 BCS_HydBrkActvTq_RL 0;
BA_ "GenSigInactiveValue" SG_ 360 BCS_HydBrkActvTq_RL 0;
BA_ "GenSigInvalidValue" SG_ 360 BCS_HydBrkActvTq_RL 0;
BA_ "GenSigSendType" SG_ 360 BCS_HydBrkActvTq_RL 1;
BA_ "GenSigStartValue" SG_ 360 BCS_HydBrkActvTq_RL 0;
BA_ "GenSigTimeoutValue" SG_ 360 BCS_HydBrkActvTq_RL 0;
BA_ "Remark" SG_ 360 BCS_HydBrkActvTq_RL "";
BA_ "EventCommandSignal" SG_ 360 BCS_HydBrkActvTq_RR 0;
BA_ "GatewayedSignals" SG_ 360 BCS_HydBrkActvTq_RR 0;
BA_ "GenSigInactiveValue" SG_ 360 BCS_HydBrkActvTq_RR 0;
BA_ "GenSigInvalidValue" SG_ 360 BCS_HydBrkActvTq_RR 0;
BA_ "GenSigSendType" SG_ 360 BCS_HydBrkActvTq_RR 1;
BA_ "GenSigStartValue" SG_ 360 BCS_HydBrkActvTq_RR 0;
BA_ "GenSigTimeoutValue" SG_ 360 BCS_HydBrkActvTq_RR 0;
BA_ "Remark" SG_ 360 BCS_HydBrkActvTq_RR "";
BA_ "EventCommandSignal" SG_ 360 BCS_HydBrkReqTq 0;
BA_ "GatewayedSignals" SG_ 360 BCS_HydBrkReqTq 0;
BA_ "GenSigInactiveValue" SG_ 360 BCS_HydBrkReqTq 0;
BA_ "GenSigInvalidValue" SG_ 360 BCS_HydBrkReqTq 0;
BA_ "GenSigSendType" SG_ 360 BCS_HydBrkReqTq 1;
BA_ "GenSigStartValue" SG_ 360 BCS_HydBrkReqTq 0;
BA_ "GenSigTimeoutValue" SG_ 360 BCS_HydBrkReqTq 0;
BA_ "Remark" SG_ 360 BCS_HydBrkReqTq "";
BA_ "EventCommandSignal" SG_ 360 BCS_BrkActvTq 0;
BA_ "GatewayedSignals" SG_ 360 BCS_BrkActvTq 0;
BA_ "GenSigInactiveValue" SG_ 360 BCS_BrkActvTq 0;
BA_ "GenSigInvalidValue" SG_ 360 BCS_BrkActvTq 0;
BA_ "GenSigSendType" SG_ 360 BCS_BrkActvTq 1;
BA_ "GenSigStartValue" SG_ 360 BCS_BrkActvTq 0;
BA_ "GenSigTimeoutValue" SG_ 360 BCS_BrkActvTq 0;
BA_ "Remark" SG_ 360 BCS_BrkActvTq "";
BA_ "EventCommandSignal" SG_ 360 BCS_HydBrkActvTq 0;
BA_ "GatewayedSignals" SG_ 360 BCS_HydBrkActvTq 0;
BA_ "GenSigInactiveValue" SG_ 360 BCS_HydBrkActvTq 0;
BA_ "GenSigInvalidValue" SG_ 360 BCS_HydBrkActvTq 0;
BA_ "GenSigSendType" SG_ 360 BCS_HydBrkActvTq 1;
BA_ "GenSigStartValue" SG_ 360 BCS_HydBrkActvTq 0;
BA_ "GenSigTimeoutValue" SG_ 360 BCS_HydBrkActvTq 0;
BA_ "Remark" SG_ 360 BCS_HydBrkActvTq "";
BA_ "EventCommandSignal" SG_ 360 BCS_DycESCActTq 0;
BA_ "GatewayedSignals" SG_ 360 BCS_DycESCActTq 0;
BA_ "GenSigInactiveValue" SG_ 360 BCS_DycESCActTq 0;
BA_ "GenSigInvalidValue" SG_ 360 BCS_DycESCActTq 0;
BA_ "GenSigSendType" SG_ 360 BCS_DycESCActTq 1;
BA_ "GenSigStartValue" SG_ 360 BCS_DycESCActTq 0;
BA_ "GenSigTimeoutValue" SG_ 360 BCS_DycESCActTq 0;
BA_ "Remark" SG_ 360 BCS_DycESCActTq "";
BA_ "EventCommandSignal" SG_ 360 BCS_BrkTqCtrlAvlDriving 0;
BA_ "GatewayedSignals" SG_ 360 BCS_BrkTqCtrlAvlDriving 0;
BA_ "GenSigInactiveValue" SG_ 360 BCS_BrkTqCtrlAvlDriving 0;
BA_ "GenSigInvalidValue" SG_ 360 BCS_BrkTqCtrlAvlDriving 0;
BA_ "GenSigSendType" SG_ 360 BCS_BrkTqCtrlAvlDriving 1;
BA_ "GenSigStartValue" SG_ 360 BCS_BrkTqCtrlAvlDriving 0;
BA_ "GenSigTimeoutValue" SG_ 360 BCS_BrkTqCtrlAvlDriving 0;
BA_ "Remark" SG_ 360 BCS_BrkTqCtrlAvlDriving "";
BA_ "EventCommandSignal" SG_ 360 BCS_BrkTqCtrlAvlParking 0;
BA_ "GatewayedSignals" SG_ 360 BCS_BrkTqCtrlAvlParking 0;
BA_ "GenSigInactiveValue" SG_ 360 BCS_BrkTqCtrlAvlParking 0;
BA_ "GenSigInvalidValue" SG_ 360 BCS_BrkTqCtrlAvlParking 0;
BA_ "GenSigSendType" SG_ 360 BCS_BrkTqCtrlAvlParking 1;
BA_ "GenSigStartValue" SG_ 360 BCS_BrkTqCtrlAvlParking 0;
BA_ "GenSigTimeoutValue" SG_ 360 BCS_BrkTqCtrlAvlParking 0;
BA_ "Remark" SG_ 360 BCS_BrkTqCtrlAvlParking "";
BA_ "EventCommandSignal" SG_ 360 BCS_BrkTqCtrlActv 0;
BA_ "GatewayedSignals" SG_ 360 BCS_BrkTqCtrlActv 0;
BA_ "GenSigInactiveValue" SG_ 360 BCS_BrkTqCtrlActv 0;
BA_ "GenSigInvalidValue" SG_ 360 BCS_BrkTqCtrlActv 0;
BA_ "GenSigSendType" SG_ 360 BCS_BrkTqCtrlActv 1;
BA_ "GenSigStartValue" SG_ 360 BCS_BrkTqCtrlActv 0;
BA_ "GenSigTimeoutValue" SG_ 360 BCS_BrkTqCtrlActv 0;
BA_ "Remark" SG_ 360 BCS_BrkTqCtrlActv "";
BA_ "EventCommandSignal" SG_ 360 BCS_DycEscTarTqCtrlAvl 0;
BA_ "GatewayedSignals" SG_ 360 BCS_DycEscTarTqCtrlAvl 0;
BA_ "GenSigInactiveValue" SG_ 360 BCS_DycEscTarTqCtrlAvl 0;
BA_ "GenSigInvalidValue" SG_ 360 BCS_DycEscTarTqCtrlAvl 0;
BA_ "GenSigSendType" SG_ 360 BCS_DycEscTarTqCtrlAvl 1;
BA_ "GenSigStartValue" SG_ 360 BCS_DycEscTarTqCtrlAvl 0;
BA_ "GenSigTimeoutValue" SG_ 360 BCS_DycEscTarTqCtrlAvl 0;
BA_ "Remark" SG_ 360 BCS_DycEscTarTqCtrlAvl "";
BA_ "EventCommandSignal" SG_ 360 BCS_DrvrBrkOvrd 0;
BA_ "GatewayedSignals" SG_ 360 BCS_DrvrBrkOvrd 0;
BA_ "GenSigInactiveValue" SG_ 360 BCS_DrvrBrkOvrd 0;
BA_ "GenSigInvalidValue" SG_ 360 BCS_DrvrBrkOvrd 0;
BA_ "GenSigSendType" SG_ 360 BCS_DrvrBrkOvrd 1;
BA_ "GenSigStartValue" SG_ 360 BCS_DrvrBrkOvrd 0;
BA_ "GenSigTimeoutValue" SG_ 360 BCS_DrvrBrkOvrd 0;
BA_ "Remark" SG_ 360 BCS_DrvrBrkOvrd "";
BA_ "EventCommandSignal" SG_ 360 BCS_DrvrBrkOvrdVld 0;
BA_ "GatewayedSignals" SG_ 360 BCS_DrvrBrkOvrdVld 0;
BA_ "GenSigInactiveValue" SG_ 360 BCS_DrvrBrkOvrdVld 0;
BA_ "GenSigInvalidValue" SG_ 360 BCS_DrvrBrkOvrdVld 0;
BA_ "GenSigSendType" SG_ 360 BCS_DrvrBrkOvrdVld 1;
BA_ "GenSigStartValue" SG_ 360 BCS_DrvrBrkOvrdVld 0;
BA_ "GenSigTimeoutValue" SG_ 360 BCS_DrvrBrkOvrdVld 0;
BA_ "Remark" SG_ 360 BCS_DrvrBrkOvrdVld "";
BA_ "EventCommandSignal" SG_ 360 BCS_DycEscTarTqActv 0;
BA_ "GatewayedSignals" SG_ 360 BCS_DycEscTarTqActv 0;
BA_ "GenSigInactiveValue" SG_ 360 BCS_DycEscTarTqActv 0;
BA_ "GenSigInvalidValue" SG_ 360 BCS_DycEscTarTqActv 0;
BA_ "GenSigSendType" SG_ 360 BCS_DycEscTarTqActv 1;
BA_ "GenSigStartValue" SG_ 360 BCS_DycEscTarTqActv 0;
BA_ "GenSigTimeoutValue" SG_ 360 BCS_DycEscTarTqActv 0;
BA_ "Remark" SG_ 360 BCS_DycEscTarTqActv "";
BA_ "EventCommandSignal" SG_ 360 BCS_DrvrTqDes 0;
BA_ "GatewayedSignals" SG_ 360 BCS_DrvrTqDes 0;
BA_ "GenSigInactiveValue" SG_ 360 BCS_DrvrTqDes 0;
BA_ "GenSigInvalidValue" SG_ 360 BCS_DrvrTqDes 0;
BA_ "GenSigSendType" SG_ 360 BCS_DrvrTqDes 1;
BA_ "GenSigStartValue" SG_ 360 BCS_DrvrTqDes 0;
BA_ "GenSigTimeoutValue" SG_ 360 BCS_DrvrTqDes 0;
BA_ "Remark" SG_ 360 BCS_DrvrTqDes "";
BA_ "EventCommandSignal" SG_ 360 BCS_ERV_VehSpd 0;
BA_ "GatewayedSignals" SG_ 360 BCS_ERV_VehSpd 0;
BA_ "GenSigInactiveValue" SG_ 360 BCS_ERV_VehSpd 0;
BA_ "GenSigInvalidValue" SG_ 360 BCS_ERV_VehSpd 0;
BA_ "GenSigSendType" SG_ 360 BCS_ERV_VehSpd 1;
BA_ "GenSigStartValue" SG_ 360 BCS_ERV_VehSpd 0;
BA_ "GenSigTimeoutValue" SG_ 360 BCS_ERV_VehSpd 0;
BA_ "Remark" SG_ 360 BCS_ERV_VehSpd "";
BA_ "EventCommandSignal" SG_ 360 BCS_ERV_VehSpdVld 0;
BA_ "GatewayedSignals" SG_ 360 BCS_ERV_VehSpdVld 0;
BA_ "GenSigInactiveValue" SG_ 360 BCS_ERV_VehSpdVld 0;
BA_ "GenSigInvalidValue" SG_ 360 BCS_ERV_VehSpdVld 0;
BA_ "GenSigSendType" SG_ 360 BCS_ERV_VehSpdVld 1;
BA_ "GenSigStartValue" SG_ 360 BCS_ERV_VehSpdVld 0;
BA_ "GenSigTimeoutValue" SG_ 360 BCS_ERV_VehSpdVld 0;
BA_ "Remark" SG_ 360 BCS_ERV_VehSpdVld "";
BA_ "EventCommandSignal" SG_ 360 BCS_EspFailrSts 0;
BA_ "GatewayedSignals" SG_ 360 BCS_EspFailrSts 0;
BA_ "GenSigInactiveValue" SG_ 360 BCS_EspFailrSts 0;
BA_ "GenSigInvalidValue" SG_ 360 BCS_EspFailrSts 0;
BA_ "GenSigSendType" SG_ 360 BCS_EspFailrSts 1;
BA_ "GenSigStartValue" SG_ 360 BCS_EspFailrSts 1;
BA_ "GenSigTimeoutValue" SG_ 360 BCS_EspFailrSts 1;
BA_ "Remark" SG_ 360 BCS_EspFailrSts "";
BA_ "EventCommandSignal" SG_ 360 BCS_ActvSts 0;
BA_ "GatewayedSignals" SG_ 360 BCS_ActvSts 0;
BA_ "GenSigInactiveValue" SG_ 360 BCS_ActvSts 0;
BA_ "GenSigInvalidValue" SG_ 360 BCS_ActvSts 0;
BA_ "GenSigSendType" SG_ 360 BCS_ActvSts 1;
BA_ "GenSigStartValue" SG_ 360 BCS_ActvSts 0;
BA_ "GenSigTimeoutValue" SG_ 360 BCS_ActvSts 0;
BA_ "Remark" SG_ 360 BCS_ActvSts "";
BA_ "EventCommandSignal" SG_ 360 BCS_BDCActive 0;
BA_ "GatewayedSignals" SG_ 360 BCS_BDCActive 0;
BA_ "GenSigInactiveValue" SG_ 360 BCS_BDCActive 0;
BA_ "GenSigInvalidValue" SG_ 360 BCS_BDCActive 0;
BA_ "GenSigSendType" SG_ 360 BCS_BDCActive 1;
BA_ "GenSigStartValue" SG_ 360 BCS_BDCActive 0;
BA_ "GenSigTimeoutValue" SG_ 360 BCS_BDCActive 0;
BA_ "Remark" SG_ 360 BCS_BDCActive "";
BA_ "EventCommandSignal" SG_ 360 BCS_DTCActvSts 0;
BA_ "GatewayedSignals" SG_ 360 BCS_DTCActvSts 0;
BA_ "GenSigInactiveValue" SG_ 360 BCS_DTCActvSts 0;
BA_ "GenSigInvalidValue" SG_ 360 BCS_DTCActvSts 0;
BA_ "GenSigSendType" SG_ 360 BCS_DTCActvSts 1;
BA_ "GenSigStartValue" SG_ 360 BCS_DTCActvSts 0;
BA_ "GenSigTimeoutValue" SG_ 360 BCS_DTCActvSts 0;
BA_ "Remark" SG_ 360 BCS_DTCActvSts "";
BA_ "EventCommandSignal" SG_ 360 BCS_errorFb 0;
BA_ "GatewayedSignals" SG_ 360 BCS_errorFb 0;
BA_ "GenSigInactiveValue" SG_ 360 BCS_errorFb 0;
BA_ "GenSigInvalidValue" SG_ 360 BCS_errorFb 0;
BA_ "GenSigSendType" SG_ 360 BCS_errorFb 1;
BA_ "GenSigStartValue" SG_ 360 BCS_errorFb 0;
BA_ "GenSigTimeoutValue" SG_ 360 BCS_errorFb 0;
BA_ "Remark" SG_ 360 BCS_errorFb "";
BA_ "EventCommandSignal" SG_ 360 BCS_WheelSlipFLValid 0;
BA_ "GatewayedSignals" SG_ 360 BCS_WheelSlipFLValid 0;
BA_ "GenSigInactiveValue" SG_ 360 BCS_WheelSlipFLValid 0;
BA_ "GenSigInvalidValue" SG_ 360 BCS_WheelSlipFLValid 0;
BA_ "GenSigSendType" SG_ 360 BCS_WheelSlipFLValid 1;
BA_ "GenSigStartValue" SG_ 360 BCS_WheelSlipFLValid 0;
BA_ "GenSigTimeoutValue" SG_ 360 BCS_WheelSlipFLValid 0;
BA_ "Remark" SG_ 360 BCS_WheelSlipFLValid "";
BA_ "EventCommandSignal" SG_ 360 BCS_WheelSlipFRValid 0;
BA_ "GatewayedSignals" SG_ 360 BCS_WheelSlipFRValid 0;
BA_ "GenSigInactiveValue" SG_ 360 BCS_WheelSlipFRValid 0;
BA_ "GenSigInvalidValue" SG_ 360 BCS_WheelSlipFRValid 0;
BA_ "GenSigSendType" SG_ 360 BCS_WheelSlipFRValid 1;
BA_ "GenSigStartValue" SG_ 360 BCS_WheelSlipFRValid 0;
BA_ "GenSigTimeoutValue" SG_ 360 BCS_WheelSlipFRValid 0;
BA_ "Remark" SG_ 360 BCS_WheelSlipFRValid "";
BA_ "EventCommandSignal" SG_ 360 BCS_WheelSlipRLValid 0;
BA_ "GatewayedSignals" SG_ 360 BCS_WheelSlipRLValid 0;
BA_ "GenSigInactiveValue" SG_ 360 BCS_WheelSlipRLValid 0;
BA_ "GenSigInvalidValue" SG_ 360 BCS_WheelSlipRLValid 0;
BA_ "GenSigSendType" SG_ 360 BCS_WheelSlipRLValid 1;
BA_ "GenSigStartValue" SG_ 360 BCS_WheelSlipRLValid 0;
BA_ "GenSigTimeoutValue" SG_ 360 BCS_WheelSlipRLValid 0;
BA_ "Remark" SG_ 360 BCS_WheelSlipRLValid "";
BA_ "EventCommandSignal" SG_ 360 BCS_WheelSlipRRValid 0;
BA_ "GatewayedSignals" SG_ 360 BCS_WheelSlipRRValid 0;
BA_ "GenSigInactiveValue" SG_ 360 BCS_WheelSlipRRValid 0;
BA_ "GenSigInvalidValue" SG_ 360 BCS_WheelSlipRRValid 0;
BA_ "GenSigSendType" SG_ 360 BCS_WheelSlipRRValid 1;
BA_ "GenSigStartValue" SG_ 360 BCS_WheelSlipRRValid 0;
BA_ "GenSigTimeoutValue" SG_ 360 BCS_WheelSlipRRValid 0;
BA_ "Remark" SG_ 360 BCS_WheelSlipRRValid "";
BA_ "EventCommandSignal" SG_ 360 BCS_CrbsTarRecpTorqRqFA 0;
BA_ "GatewayedSignals" SG_ 360 BCS_CrbsTarRecpTorqRqFA 0;
BA_ "GenSigInactiveValue" SG_ 360 BCS_CrbsTarRecpTorqRqFA 0;
BA_ "GenSigInvalidValue" SG_ 360 BCS_CrbsTarRecpTorqRqFA 0;
BA_ "GenSigSendType" SG_ 360 BCS_CrbsTarRecpTorqRqFA 1;
BA_ "GenSigStartValue" SG_ 360 BCS_CrbsTarRecpTorqRqFA 6000;
BA_ "GenSigTimeoutValue" SG_ 360 BCS_CrbsTarRecpTorqRqFA 0;
BA_ "Remark" SG_ 360 BCS_CrbsTarRecpTorqRqFA "";
BA_ "EventCommandSignal" SG_ 360 BCS_CrbsTarRecpTorqRqFASt 0;
BA_ "GatewayedSignals" SG_ 360 BCS_CrbsTarRecpTorqRqFASt 0;
BA_ "GenSigInactiveValue" SG_ 360 BCS_CrbsTarRecpTorqRqFASt 0;
BA_ "GenSigInvalidValue" SG_ 360 BCS_CrbsTarRecpTorqRqFASt 0;
BA_ "GenSigSendType" SG_ 360 BCS_CrbsTarRecpTorqRqFASt 1;
BA_ "GenSigStartValue" SG_ 360 BCS_CrbsTarRecpTorqRqFASt 0;
BA_ "GenSigTimeoutValue" SG_ 360 BCS_CrbsTarRecpTorqRqFASt 0;
BA_ "Remark" SG_ 360 BCS_CrbsTarRecpTorqRqFASt "";
BA_ "EventCommandSignal" SG_ 360 BCS_CrbsTarRecpTorqRqRA 0;
BA_ "GatewayedSignals" SG_ 360 BCS_CrbsTarRecpTorqRqRA 0;
BA_ "GenSigInactiveValue" SG_ 360 BCS_CrbsTarRecpTorqRqRA 0;
BA_ "GenSigInvalidValue" SG_ 360 BCS_CrbsTarRecpTorqRqRA 0;
BA_ "GenSigSendType" SG_ 360 BCS_CrbsTarRecpTorqRqRA 1;
BA_ "GenSigStartValue" SG_ 360 BCS_CrbsTarRecpTorqRqRA 6000;
BA_ "GenSigTimeoutValue" SG_ 360 BCS_CrbsTarRecpTorqRqRA 0;
BA_ "Remark" SG_ 360 BCS_CrbsTarRecpTorqRqRA "";
BA_ "EventCommandSignal" SG_ 360 BCS_CrbsTarRecpTorqRqRASt 0;
BA_ "GatewayedSignals" SG_ 360 BCS_CrbsTarRecpTorqRqRASt 0;
BA_ "GenSigInactiveValue" SG_ 360 BCS_CrbsTarRecpTorqRqRASt 0;
BA_ "GenSigInvalidValue" SG_ 360 BCS_CrbsTarRecpTorqRqRASt 0;
BA_ "GenSigSendType" SG_ 360 BCS_CrbsTarRecpTorqRqRASt 1;
BA_ "GenSigStartValue" SG_ 360 BCS_CrbsTarRecpTorqRqRASt 0;
BA_ "GenSigTimeoutValue" SG_ 360 BCS_CrbsTarRecpTorqRqRASt 0;
BA_ "Remark" SG_ 360 BCS_CrbsTarRecpTorqRqRASt "";
BA_ "EventCommandSignal" SG_ 360 BCS_CrbsTarRecpTorqRqSum 0;
BA_ "GatewayedSignals" SG_ 360 BCS_CrbsTarRecpTorqRqSum 0;
BA_ "GenSigInactiveValue" SG_ 360 BCS_CrbsTarRecpTorqRqSum 0;
BA_ "GenSigInvalidValue" SG_ 360 BCS_CrbsTarRecpTorqRqSum 0;
BA_ "GenSigSendType" SG_ 360 BCS_CrbsTarRecpTorqRqSum 1;
BA_ "GenSigStartValue" SG_ 360 BCS_CrbsTarRecpTorqRqSum 6000;
BA_ "GenSigTimeoutValue" SG_ 360 BCS_CrbsTarRecpTorqRqSum 0;
BA_ "Remark" SG_ 360 BCS_CrbsTarRecpTorqRqSum "";
BA_ "EventCommandSignal" SG_ 360 BCS_CrbsTarRecpTorqRqSumSt 0;
BA_ "GatewayedSignals" SG_ 360 BCS_CrbsTarRecpTorqRqSumSt 0;
BA_ "GenSigInactiveValue" SG_ 360 BCS_CrbsTarRecpTorqRqSumSt 0;
BA_ "GenSigInvalidValue" SG_ 360 BCS_CrbsTarRecpTorqRqSumSt 0;
BA_ "GenSigSendType" SG_ 360 BCS_CrbsTarRecpTorqRqSumSt 1;
BA_ "GenSigStartValue" SG_ 360 BCS_CrbsTarRecpTorqRqSumSt 0;
BA_ "GenSigTimeoutValue" SG_ 360 BCS_CrbsTarRecpTorqRqSumSt 0;
BA_ "Remark" SG_ 360 BCS_CrbsTarRecpTorqRqSumSt "";
BA_ "EventCommandSignal" SG_ 360 BCS_WheelSlipFL 0;
BA_ "GatewayedSignals" SG_ 360 BCS_WheelSlipFL 0;
BA_ "GenSigInactiveValue" SG_ 360 BCS_WheelSlipFL 0;
BA_ "GenSigInvalidValue" SG_ 360 BCS_WheelSlipFL 0;
BA_ "GenSigSendType" SG_ 360 BCS_WheelSlipFL 1;
BA_ "GenSigStartValue" SG_ 360 BCS_WheelSlipFL 0;
BA_ "GenSigTimeoutValue" SG_ 360 BCS_WheelSlipFL 0;
BA_ "Remark" SG_ 360 BCS_WheelSlipFL "";
BA_ "EventCommandSignal" SG_ 360 BCS_WheelSlipFR 0;
BA_ "GatewayedSignals" SG_ 360 BCS_WheelSlipFR 0;
BA_ "GenSigInactiveValue" SG_ 360 BCS_WheelSlipFR 0;
BA_ "GenSigInvalidValue" SG_ 360 BCS_WheelSlipFR 0;
BA_ "GenSigSendType" SG_ 360 BCS_WheelSlipFR 1;
BA_ "GenSigStartValue" SG_ 360 BCS_WheelSlipFR 0;
BA_ "GenSigTimeoutValue" SG_ 360 BCS_WheelSlipFR 0;
BA_ "Remark" SG_ 360 BCS_WheelSlipFR "";
BA_ "EventCommandSignal" SG_ 360 BCS_WheelSlipRL 0;
BA_ "GatewayedSignals" SG_ 360 BCS_WheelSlipRL 0;
BA_ "GenSigInactiveValue" SG_ 360 BCS_WheelSlipRL 0;
BA_ "GenSigInvalidValue" SG_ 360 BCS_WheelSlipRL 0;
BA_ "GenSigSendType" SG_ 360 BCS_WheelSlipRL 1;
BA_ "GenSigStartValue" SG_ 360 BCS_WheelSlipRL 0;
BA_ "GenSigTimeoutValue" SG_ 360 BCS_WheelSlipRL 0;
BA_ "Remark" SG_ 360 BCS_WheelSlipRL "";
BA_ "EventCommandSignal" SG_ 360 BCS_WheelSlipRR 0;
BA_ "GatewayedSignals" SG_ 360 BCS_WheelSlipRR 0;
BA_ "GenSigInactiveValue" SG_ 360 BCS_WheelSlipRR 0;
BA_ "GenSigInvalidValue" SG_ 360 BCS_WheelSlipRR 0;
BA_ "GenSigSendType" SG_ 360 BCS_WheelSlipRR 1;
BA_ "GenSigStartValue" SG_ 360 BCS_WheelSlipRR 0;
BA_ "GenSigTimeoutValue" SG_ 360 BCS_WheelSlipRR 0;
BA_ "Remark" SG_ 360 BCS_WheelSlipRR "";
BA_ "EventCommandSignal" SG_ 618 EPB_1_CRC 0;
BA_ "GatewayedSignals" SG_ 618 EPB_1_CRC 0;
BA_ "GenSigInactiveValue" SG_ 618 EPB_1_CRC 0;
BA_ "GenSigInvalidValue" SG_ 618 EPB_1_CRC 0;
BA_ "GenSigSendType" SG_ 618 EPB_1_CRC 1;
BA_ "GenSigStartValue" SG_ 618 EPB_1_CRC 0;
BA_ "GenSigTimeoutValue" SG_ 618 EPB_1_CRC 0;
BA_ "Remark" SG_ 618 EPB_1_CRC "";
BA_ "EventCommandSignal" SG_ 618 EPB_1_Counter 0;
BA_ "GatewayedSignals" SG_ 618 EPB_1_Counter 0;
BA_ "GenSigInactiveValue" SG_ 618 EPB_1_Counter 0;
BA_ "GenSigInvalidValue" SG_ 618 EPB_1_Counter 0;
BA_ "GenSigSendType" SG_ 618 EPB_1_Counter 1;
BA_ "GenSigStartValue" SG_ 618 EPB_1_Counter 0;
BA_ "GenSigTimeoutValue" SG_ 618 EPB_1_Counter 0;
BA_ "Remark" SG_ 618 EPB_1_Counter "";
BA_ "EventCommandSignal" SG_ 618 EPB_SwitchSt 0;
BA_ "GatewayedSignals" SG_ 618 EPB_SwitchSt 0;
BA_ "GenSigInactiveValue" SG_ 618 EPB_SwitchSt 0;
BA_ "GenSigInvalidValue" SG_ 618 EPB_SwitchSt 0;
BA_ "GenSigSendType" SG_ 618 EPB_SwitchSt 1;
BA_ "GenSigStartValue" SG_ 618 EPB_SwitchSt 0;
BA_ "GenSigTimeoutValue" SG_ 618 EPB_SwitchSt 0;
BA_ "Remark" SG_ 618 EPB_SwitchSt "";
BA_ "EventCommandSignal" SG_ 618 EPB_SwitchStVD 0;
BA_ "GatewayedSignals" SG_ 618 EPB_SwitchStVD 0;
BA_ "GenSigInactiveValue" SG_ 618 EPB_SwitchStVD 0;
BA_ "GenSigInvalidValue" SG_ 618 EPB_SwitchStVD 0;
BA_ "GenSigSendType" SG_ 618 EPB_SwitchStVD 1;
BA_ "GenSigStartValue" SG_ 618 EPB_SwitchStVD 0;
BA_ "GenSigTimeoutValue" SG_ 618 EPB_SwitchStVD 0;
BA_ "Remark" SG_ 618 EPB_SwitchStVD "";
BA_ "EventCommandSignal" SG_ 618 EPB_SysSt 0;
BA_ "GatewayedSignals" SG_ 618 EPB_SysSt 0;
BA_ "GenSigInactiveValue" SG_ 618 EPB_SysSt 0;
BA_ "GenSigInvalidValue" SG_ 618 EPB_SysSt 0;
BA_ "GenSigSendType" SG_ 618 EPB_SysSt 1;
BA_ "GenSigStartValue" SG_ 618 EPB_SysSt 0;
BA_ "GenSigTimeoutValue" SG_ 618 EPB_SysSt 7;
BA_ "Remark" SG_ 618 EPB_SysSt "";
BA_ "EventCommandSignal" SG_ 618 EPB_FailSt 0;
BA_ "GatewayedSignals" SG_ 618 EPB_FailSt 0;
BA_ "GenSigInactiveValue" SG_ 618 EPB_FailSt 0;
BA_ "GenSigInvalidValue" SG_ 618 EPB_FailSt 0;
BA_ "GenSigSendType" SG_ 618 EPB_FailSt 1;
BA_ "GenSigStartValue" SG_ 618 EPB_FailSt 0;
BA_ "GenSigTimeoutValue" SG_ 618 EPB_FailSt 1;
BA_ "Remark" SG_ 618 EPB_FailSt "";
BA_ "EventCommandSignal" SG_ 618 EPB_ExtAvailable 0;
BA_ "GatewayedSignals" SG_ 618 EPB_ExtAvailable 0;
BA_ "GenSigInactiveValue" SG_ 618 EPB_ExtAvailable 0;
BA_ "GenSigInvalidValue" SG_ 618 EPB_ExtAvailable 0;
BA_ "GenSigSendType" SG_ 618 EPB_ExtAvailable 1;
BA_ "GenSigStartValue" SG_ 618 EPB_ExtAvailable 0;
BA_ "GenSigTimeoutValue" SG_ 618 EPB_ExtAvailable 0;
BA_ "Remark" SG_ 618 EPB_ExtAvailable "";
BA_ "EventCommandSignal" SG_ 618 EPB_DynamicApplySt 0;
BA_ "GatewayedSignals" SG_ 618 EPB_DynamicApplySt 0;
BA_ "GenSigInactiveValue" SG_ 618 EPB_DynamicApplySt 0;
BA_ "GenSigInvalidValue" SG_ 618 EPB_DynamicApplySt 0;
BA_ "GenSigSendType" SG_ 618 EPB_DynamicApplySt 1;
BA_ "GenSigStartValue" SG_ 618 EPB_DynamicApplySt 0;
BA_ "GenSigTimeoutValue" SG_ 618 EPB_DynamicApplySt 0;
BA_ "Remark" SG_ 618 EPB_DynamicApplySt "";
BA_ "EventCommandSignal" SG_ 618 EPB_ActuatorSt_R 0;
BA_ "GatewayedSignals" SG_ 618 EPB_ActuatorSt_R 0;
BA_ "GenSigInactiveValue" SG_ 618 EPB_ActuatorSt_R 0;
BA_ "GenSigInvalidValue" SG_ 618 EPB_ActuatorSt_R 0;
BA_ "GenSigSendType" SG_ 618 EPB_ActuatorSt_R 1;
BA_ "GenSigStartValue" SG_ 618 EPB_ActuatorSt_R 0;
BA_ "GenSigTimeoutValue" SG_ 618 EPB_ActuatorSt_R 0;
BA_ "Remark" SG_ 618 EPB_ActuatorSt_R "";
BA_ "EventCommandSignal" SG_ 618 EPB_RWUActvSts 0;
BA_ "GatewayedSignals" SG_ 618 EPB_RWUActvSts 0;
BA_ "GenSigInactiveValue" SG_ 618 EPB_RWUActvSts 0;
BA_ "GenSigInvalidValue" SG_ 618 EPB_RWUActvSts 0;
BA_ "GenSigSendType" SG_ 618 EPB_RWUActvSts 1;
BA_ "GenSigStartValue" SG_ 618 EPB_RWUActvSts 0;
BA_ "GenSigTimeoutValue" SG_ 618 EPB_RWUActvSts 0;
BA_ "Remark" SG_ 618 EPB_RWUActvSts "";
BA_ "EventCommandSignal" SG_ 618 EPB_RWUAvl 0;
BA_ "GatewayedSignals" SG_ 618 EPB_RWUAvl 0;
BA_ "GenSigInactiveValue" SG_ 618 EPB_RWUAvl 0;
BA_ "GenSigInvalidValue" SG_ 618 EPB_RWUAvl 0;
BA_ "GenSigSendType" SG_ 618 EPB_RWUAvl 1;
BA_ "GenSigStartValue" SG_ 618 EPB_RWUAvl 0;
BA_ "GenSigTimeoutValue" SG_ 618 EPB_RWUAvl 0;
BA_ "Remark" SG_ 618 EPB_RWUAvl "";
BA_ "EventCommandSignal" SG_ 618 EPB_EpbAvl 0;
BA_ "GatewayedSignals" SG_ 618 EPB_EpbAvl 0;
BA_ "GenSigInactiveValue" SG_ 618 EPB_EpbAvl 0;
BA_ "GenSigInvalidValue" SG_ 618 EPB_EpbAvl 0;
BA_ "GenSigSendType" SG_ 618 EPB_EpbAvl 1;
BA_ "GenSigStartValue" SG_ 618 EPB_EpbAvl 0;
BA_ "GenSigTimeoutValue" SG_ 618 EPB_EpbAvl 0;
BA_ "Remark" SG_ 618 EPB_EpbAvl "";
BA_ "EventCommandSignal" SG_ 618 EPB_RPAAVPAvailability 0;
BA_ "GatewayedSignals" SG_ 618 EPB_RPAAVPAvailability 0;
BA_ "GenSigInactiveValue" SG_ 618 EPB_RPAAVPAvailability 0;
BA_ "GenSigInvalidValue" SG_ 618 EPB_RPAAVPAvailability 0;
BA_ "GenSigSendType" SG_ 618 EPB_RPAAVPAvailability 1;
BA_ "GenSigStartValue" SG_ 618 EPB_RPAAVPAvailability 0;
BA_ "GenSigTimeoutValue" SG_ 618 EPB_RPAAVPAvailability 0;
BA_ "Remark" SG_ 618 EPB_RPAAVPAvailability "PT1开始发送";
BA_ "EventCommandSignal" SG_ 618 EPB_APAAvailability 0;
BA_ "GatewayedSignals" SG_ 618 EPB_APAAvailability 0;
BA_ "GenSigInactiveValue" SG_ 618 EPB_APAAvailability 0;
BA_ "GenSigInvalidValue" SG_ 618 EPB_APAAvailability 0;
BA_ "GenSigSendType" SG_ 618 EPB_APAAvailability 1;
BA_ "GenSigStartValue" SG_ 618 EPB_APAAvailability 0;
BA_ "GenSigTimeoutValue" SG_ 618 EPB_APAAvailability 0;
BA_ "Remark" SG_ 618 EPB_APAAvailability "PT1开始发送";
BA_ "EventCommandSignal" SG_ 618 EPB_ActuatorSt_L_1 0;
BA_ "GatewayedSignals" SG_ 618 EPB_ActuatorSt_L_1 0;
BA_ "GenSigInactiveValue" SG_ 618 EPB_ActuatorSt_L_1 0;
BA_ "GenSigInvalidValue" SG_ 618 EPB_ActuatorSt_L_1 0;
BA_ "GenSigSendType" SG_ 618 EPB_ActuatorSt_L_1 1;
BA_ "GenSigStartValue" SG_ 618 EPB_ActuatorSt_L_1 0;
BA_ "GenSigTimeoutValue" SG_ 618 EPB_ActuatorSt_L_1 0;
BA_ "Remark" SG_ 618 EPB_ActuatorSt_L_1 "";
BA_ "EventCommandSignal" SG_ 618 EPB_MotorCurrent_L_1 0;
BA_ "GatewayedSignals" SG_ 618 EPB_MotorCurrent_L_1 0;
BA_ "GenSigInactiveValue" SG_ 618 EPB_MotorCurrent_L_1 0;
BA_ "GenSigInvalidValue" SG_ 618 EPB_MotorCurrent_L_1 0;
BA_ "GenSigSendType" SG_ 618 EPB_MotorCurrent_L_1 1;
BA_ "GenSigStartValue" SG_ 618 EPB_MotorCurrent_L_1 0;
BA_ "GenSigTimeoutValue" SG_ 618 EPB_MotorCurrent_L_1 0;
BA_ "Remark" SG_ 618 EPB_MotorCurrent_L_1 "";
BA_ "EventCommandSignal" SG_ 446 RBM_1_CRC 0;
BA_ "GatewayedSignals" SG_ 446 RBM_1_CRC 0;
BA_ "GenSigInactiveValue" SG_ 446 RBM_1_CRC 0;
BA_ "GenSigInvalidValue" SG_ 446 RBM_1_CRC 0;
BA_ "GenSigSendType" SG_ 446 RBM_1_CRC 1;
BA_ "GenSigStartValue" SG_ 446 RBM_1_CRC 0;
BA_ "GenSigTimeoutValue" SG_ 446 RBM_1_CRC 0;
BA_ "Remark" SG_ 446 RBM_1_CRC "";
BA_ "EventCommandSignal" SG_ 446 RBM_1_Counter 0;
BA_ "GatewayedSignals" SG_ 446 RBM_1_Counter 0;
BA_ "GenSigInactiveValue" SG_ 446 RBM_1_Counter 0;
BA_ "GenSigInvalidValue" SG_ 446 RBM_1_Counter 0;
BA_ "GenSigSendType" SG_ 446 RBM_1_Counter 1;
BA_ "GenSigStartValue" SG_ 446 RBM_1_Counter 0;
BA_ "GenSigTimeoutValue" SG_ 446 RBM_1_Counter 0;
BA_ "Remark" SG_ 446 RBM_1_Counter "";
BA_ "EventCommandSignal" SG_ 446 RBM_BATResultSt 0;
BA_ "GatewayedSignals" SG_ 446 RBM_BATResultSt 0;
BA_ "GenSigInactiveValue" SG_ 446 RBM_BATResultSt 0;
BA_ "GenSigInvalidValue" SG_ 446 RBM_BATResultSt 0;
BA_ "GenSigSendType" SG_ 446 RBM_BATResultSt 1;
BA_ "GenSigStartValue" SG_ 446 RBM_BATResultSt 0;
BA_ "GenSigTimeoutValue" SG_ 446 RBM_BATResultSt 0;
BA_ "Remark" SG_ 446 RBM_BATResultSt "";
BA_ "EventCommandSignal" SG_ 446 RBU_VehSpdVD 0;
BA_ "GatewayedSignals" SG_ 446 RBU_VehSpdVD 0;
BA_ "GenSigInactiveValue" SG_ 446 RBU_VehSpdVD 0;
BA_ "GenSigInvalidValue" SG_ 446 RBU_VehSpdVD 0;
BA_ "GenSigSendType" SG_ 446 RBU_VehSpdVD 1;
BA_ "GenSigStartValue" SG_ 446 RBU_VehSpdVD 0;
BA_ "GenSigTimeoutValue" SG_ 446 RBU_VehSpdVD 0;
BA_ "Remark" SG_ 446 RBU_VehSpdVD "";
BA_ "EventCommandSignal" SG_ 446 RBU_VehSpd 0;
BA_ "GatewayedSignals" SG_ 446 RBU_VehSpd 0;
BA_ "GenSigInactiveValue" SG_ 446 RBU_VehSpd 0;
BA_ "GenSigInvalidValue" SG_ 446 RBU_VehSpd 0;
BA_ "GenSigSendType" SG_ 446 RBU_VehSpd 1;
BA_ "GenSigStartValue" SG_ 446 RBU_VehSpd 0;
BA_ "GenSigTimeoutValue" SG_ 446 RBU_VehSpd 0;
BA_ "Remark" SG_ 446 RBU_VehSpd "";
BA_ "EventCommandSignal" SG_ 446 RBU_SeconBrkCDAAvailableSt 0;
BA_ "GatewayedSignals" SG_ 446 RBU_SeconBrkCDAAvailableSt 0;
BA_ "GenSigInactiveValue" SG_ 446 RBU_SeconBrkCDAAvailableSt 0;
BA_ "GenSigInvalidValue" SG_ 446 RBU_SeconBrkCDAAvailableSt 0;
BA_ "GenSigSendType" SG_ 446 RBU_SeconBrkCDAAvailableSt 1;
BA_ "GenSigStartValue" SG_ 446 RBU_SeconBrkCDAAvailableSt 0;
BA_ "GenSigTimeoutValue" SG_ 446 RBU_SeconBrkCDAAvailableSt 0;
BA_ "Remark" SG_ 446 RBU_SeconBrkCDAAvailableSt "";
BA_ "EventCommandSignal" SG_ 446 RBU_SeconBrkCommuniSt 0;
BA_ "GatewayedSignals" SG_ 446 RBU_SeconBrkCommuniSt 0;
BA_ "GenSigInactiveValue" SG_ 446 RBU_SeconBrkCommuniSt 0;
BA_ "GenSigInvalidValue" SG_ 446 RBU_SeconBrkCommuniSt 0;
BA_ "GenSigSendType" SG_ 446 RBU_SeconBrkCommuniSt 1;
BA_ "GenSigStartValue" SG_ 446 RBU_SeconBrkCommuniSt 0;
BA_ "GenSigTimeoutValue" SG_ 446 RBU_SeconBrkCommuniSt 0;
BA_ "Remark" SG_ 446 RBU_SeconBrkCommuniSt "";
BA_ "EventCommandSignal" SG_ 446 RBU_SeconBrkCDAActiveSt 0;
BA_ "GatewayedSignals" SG_ 446 RBU_SeconBrkCDAActiveSt 0;
BA_ "GenSigInactiveValue" SG_ 446 RBU_SeconBrkCDAActiveSt 0;
BA_ "GenSigInvalidValue" SG_ 446 RBU_SeconBrkCDAActiveSt 0;
BA_ "GenSigSendType" SG_ 446 RBU_SeconBrkCDAActiveSt 1;
BA_ "GenSigStartValue" SG_ 446 RBU_SeconBrkCDAActiveSt 0;
BA_ "GenSigTimeoutValue" SG_ 446 RBU_SeconBrkCDAActiveSt 0;
BA_ "Remark" SG_ 446 RBU_SeconBrkCDAActiveSt "";
BA_ "EventCommandSignal" SG_ 446 RBU_SeconBrkEPBst 0;
BA_ "GatewayedSignals" SG_ 446 RBU_SeconBrkEPBst 0;
BA_ "GenSigInactiveValue" SG_ 446 RBU_SeconBrkEPBst 0;
BA_ "GenSigInvalidValue" SG_ 446 RBU_SeconBrkEPBst 0;
BA_ "GenSigSendType" SG_ 446 RBU_SeconBrkEPBst 1;
BA_ "GenSigStartValue" SG_ 446 RBU_SeconBrkEPBst 0;
BA_ "GenSigTimeoutValue" SG_ 446 RBU_SeconBrkEPBst 0;
BA_ "Remark" SG_ 446 RBU_SeconBrkEPBst "";
BA_ "EventCommandSignal" SG_ 446 RBU_SeconBrkComChannel 0;
BA_ "GatewayedSignals" SG_ 446 RBU_SeconBrkComChannel 0;
BA_ "GenSigInactiveValue" SG_ 446 RBU_SeconBrkComChannel 0;
BA_ "GenSigInvalidValue" SG_ 446 RBU_SeconBrkComChannel 0;
BA_ "GenSigSendType" SG_ 446 RBU_SeconBrkComChannel 1;
BA_ "GenSigStartValue" SG_ 446 RBU_SeconBrkComChannel 0;
BA_ "GenSigTimeoutValue" SG_ 446 RBU_SeconBrkComChannel 0;
BA_ "Remark" SG_ 446 RBU_SeconBrkComChannel "";
BA_ "EventCommandSignal" SG_ 446 RBU_FourwhlsBrkTrq 0;
BA_ "GatewayedSignals" SG_ 446 RBU_FourwhlsBrkTrq 0;
BA_ "GenSigInactiveValue" SG_ 446 RBU_FourwhlsBrkTrq 0;
BA_ "GenSigInvalidValue" SG_ 446 RBU_FourwhlsBrkTrq 0;
BA_ "GenSigSendType" SG_ 446 RBU_FourwhlsBrkTrq 1;
BA_ "GenSigStartValue" SG_ 446 RBU_FourwhlsBrkTrq 0;
BA_ "GenSigTimeoutValue" SG_ 446 RBU_FourwhlsBrkTrq 0;
BA_ "Remark" SG_ 446 RBU_FourwhlsBrkTrq "";
BA_ "EventCommandSignal" SG_ 446 RBU_FLWheelSpdEdgesSum 0;
BA_ "GatewayedSignals" SG_ 446 RBU_FLWheelSpdEdgesSum 0;
BA_ "GenSigInactiveValue" SG_ 446 RBU_FLWheelSpdEdgesSum 0;
BA_ "GenSigInvalidValue" SG_ 446 RBU_FLWheelSpdEdgesSum 0;
BA_ "GenSigSendType" SG_ 446 RBU_FLWheelSpdEdgesSum 1;
BA_ "GenSigStartValue" SG_ 446 RBU_FLWheelSpdEdgesSum 0;
BA_ "GenSigTimeoutValue" SG_ 446 RBU_FLWheelSpdEdgesSum 0;
BA_ "Remark" SG_ 446 RBU_FLWheelSpdEdgesSum "";
BA_ "EventCommandSignal" SG_ 446 RBU_FRWheelSpdEdgesSum 0;
BA_ "GatewayedSignals" SG_ 446 RBU_FRWheelSpdEdgesSum 0;
BA_ "GenSigInactiveValue" SG_ 446 RBU_FRWheelSpdEdgesSum 0;
BA_ "GenSigInvalidValue" SG_ 446 RBU_FRWheelSpdEdgesSum 0;
BA_ "GenSigSendType" SG_ 446 RBU_FRWheelSpdEdgesSum 1;
BA_ "GenSigStartValue" SG_ 446 RBU_FRWheelSpdEdgesSum 0;
BA_ "GenSigTimeoutValue" SG_ 446 RBU_FRWheelSpdEdgesSum 0;
BA_ "Remark" SG_ 446 RBU_FRWheelSpdEdgesSum "";
BA_ "EventCommandSignal" SG_ 446 RBU_RLWheelSpdEdgesSum 0;
BA_ "GatewayedSignals" SG_ 446 RBU_RLWheelSpdEdgesSum 0;
BA_ "GenSigInactiveValue" SG_ 446 RBU_RLWheelSpdEdgesSum 0;
BA_ "GenSigInvalidValue" SG_ 446 RBU_RLWheelSpdEdgesSum 0;
BA_ "GenSigSendType" SG_ 446 RBU_RLWheelSpdEdgesSum 1;
BA_ "GenSigStartValue" SG_ 446 RBU_RLWheelSpdEdgesSum 0;
BA_ "GenSigTimeoutValue" SG_ 446 RBU_RLWheelSpdEdgesSum 0;
BA_ "Remark" SG_ 446 RBU_RLWheelSpdEdgesSum "";
BA_ "EventCommandSignal" SG_ 446 RBU_RRWheelSpdEdgesSum 0;
BA_ "GatewayedSignals" SG_ 446 RBU_RRWheelSpdEdgesSum 0;
BA_ "GenSigInactiveValue" SG_ 446 RBU_RRWheelSpdEdgesSum 0;
BA_ "GenSigInvalidValue" SG_ 446 RBU_RRWheelSpdEdgesSum 0;
BA_ "GenSigSendType" SG_ 446 RBU_RRWheelSpdEdgesSum 1;
BA_ "GenSigStartValue" SG_ 446 RBU_RRWheelSpdEdgesSum 0;
BA_ "GenSigTimeoutValue" SG_ 446 RBU_RRWheelSpdEdgesSum 0;
BA_ "Remark" SG_ 446 RBU_RRWheelSpdEdgesSum "";
BA_ "EventCommandSignal" SG_ 446 RBU_FLWheelSpd 0;
BA_ "GatewayedSignals" SG_ 446 RBU_FLWheelSpd 0;
BA_ "GenSigInactiveValue" SG_ 446 RBU_FLWheelSpd 0;
BA_ "GenSigInvalidValue" SG_ 446 RBU_FLWheelSpd 0;
BA_ "GenSigSendType" SG_ 446 RBU_FLWheelSpd 1;
BA_ "GenSigStartValue" SG_ 446 RBU_FLWheelSpd 0;
BA_ "GenSigTimeoutValue" SG_ 446 RBU_FLWheelSpd 0;
BA_ "Remark" SG_ 446 RBU_FLWheelSpd "";
BA_ "EventCommandSignal" SG_ 446 RBU_FLWheelSpdVD 0;
BA_ "GatewayedSignals" SG_ 446 RBU_FLWheelSpdVD 0;
BA_ "GenSigInactiveValue" SG_ 446 RBU_FLWheelSpdVD 0;
BA_ "GenSigInvalidValue" SG_ 446 RBU_FLWheelSpdVD 0;
BA_ "GenSigSendType" SG_ 446 RBU_FLWheelSpdVD 1;
BA_ "GenSigStartValue" SG_ 446 RBU_FLWheelSpdVD 0;
BA_ "GenSigTimeoutValue" SG_ 446 RBU_FLWheelSpdVD 0;
BA_ "Remark" SG_ 446 RBU_FLWheelSpdVD "";
BA_ "EventCommandSignal" SG_ 446 RBU_RLWheelRotatedDirection 0;
BA_ "GatewayedSignals" SG_ 446 RBU_RLWheelRotatedDirection 0;
BA_ "GenSigInactiveValue" SG_ 446 RBU_RLWheelRotatedDirection 0;
BA_ "GenSigInvalidValue" SG_ 446 RBU_RLWheelRotatedDirection 0;
BA_ "GenSigSendType" SG_ 446 RBU_RLWheelRotatedDirection 1;
BA_ "GenSigStartValue" SG_ 446 RBU_RLWheelRotatedDirection 0;
BA_ "GenSigTimeoutValue" SG_ 446 RBU_RLWheelRotatedDirection 0;
BA_ "Remark" SG_ 446 RBU_RLWheelRotatedDirection "";
BA_ "EventCommandSignal" SG_ 446 RBU_RLWheelRotatedDirectionVD 0;
BA_ "GatewayedSignals" SG_ 446 RBU_RLWheelRotatedDirectionVD 0;
BA_ "GenSigInactiveValue" SG_ 446 RBU_RLWheelRotatedDirectionVD 0;
BA_ "GenSigInvalidValue" SG_ 446 RBU_RLWheelRotatedDirectionVD 0;
BA_ "GenSigSendType" SG_ 446 RBU_RLWheelRotatedDirectionVD 1;
BA_ "GenSigStartValue" SG_ 446 RBU_RLWheelRotatedDirectionVD 0;
BA_ "GenSigTimeoutValue" SG_ 446 RBU_RLWheelRotatedDirectionVD 0;
BA_ "Remark" SG_ 446 RBU_RLWheelRotatedDirectionVD "";
BA_ "EventCommandSignal" SG_ 446 RBU_FRWheelSpd 0;
BA_ "GatewayedSignals" SG_ 446 RBU_FRWheelSpd 0;
BA_ "GenSigInactiveValue" SG_ 446 RBU_FRWheelSpd 0;
BA_ "GenSigInvalidValue" SG_ 446 RBU_FRWheelSpd 0;
BA_ "GenSigSendType" SG_ 446 RBU_FRWheelSpd 1;
BA_ "GenSigStartValue" SG_ 446 RBU_FRWheelSpd 0;
BA_ "GenSigTimeoutValue" SG_ 446 RBU_FRWheelSpd 0;
BA_ "Remark" SG_ 446 RBU_FRWheelSpd "";
BA_ "EventCommandSignal" SG_ 446 RBU_FRWheelSpdVD 0;
BA_ "GatewayedSignals" SG_ 446 RBU_FRWheelSpdVD 0;
BA_ "GenSigInactiveValue" SG_ 446 RBU_FRWheelSpdVD 0;
BA_ "GenSigInvalidValue" SG_ 446 RBU_FRWheelSpdVD 0;
BA_ "GenSigSendType" SG_ 446 RBU_FRWheelSpdVD 1;
BA_ "GenSigStartValue" SG_ 446 RBU_FRWheelSpdVD 0;
BA_ "GenSigTimeoutValue" SG_ 446 RBU_FRWheelSpdVD 0;
BA_ "Remark" SG_ 446 RBU_FRWheelSpdVD "";
BA_ "EventCommandSignal" SG_ 446 RBU_RRWheelRotatedDirection 0;
BA_ "GatewayedSignals" SG_ 446 RBU_RRWheelRotatedDirection 0;
BA_ "GenSigInactiveValue" SG_ 446 RBU_RRWheelRotatedDirection 0;
BA_ "GenSigInvalidValue" SG_ 446 RBU_RRWheelRotatedDirection 0;
BA_ "GenSigSendType" SG_ 446 RBU_RRWheelRotatedDirection 1;
BA_ "GenSigStartValue" SG_ 446 RBU_RRWheelRotatedDirection 0;
BA_ "GenSigTimeoutValue" SG_ 446 RBU_RRWheelRotatedDirection 0;
BA_ "Remark" SG_ 446 RBU_RRWheelRotatedDirection "";
BA_ "EventCommandSignal" SG_ 446 RBU_RRWheelRotatedDirectionVD 0;
BA_ "GatewayedSignals" SG_ 446 RBU_RRWheelRotatedDirectionVD 0;
BA_ "GenSigInactiveValue" SG_ 446 RBU_RRWheelRotatedDirectionVD 0;
BA_ "GenSigInvalidValue" SG_ 446 RBU_RRWheelRotatedDirectionVD 0;
BA_ "GenSigSendType" SG_ 446 RBU_RRWheelRotatedDirectionVD 1;
BA_ "GenSigStartValue" SG_ 446 RBU_RRWheelRotatedDirectionVD 0;
BA_ "GenSigTimeoutValue" SG_ 446 RBU_RRWheelRotatedDirectionVD 0;
BA_ "Remark" SG_ 446 RBU_RRWheelRotatedDirectionVD "";
BA_ "EventCommandSignal" SG_ 446 RBU_RLWheelSpd 0;
BA_ "GatewayedSignals" SG_ 446 RBU_RLWheelSpd 0;
BA_ "GenSigInactiveValue" SG_ 446 RBU_RLWheelSpd 0;
BA_ "GenSigInvalidValue" SG_ 446 RBU_RLWheelSpd 0;
BA_ "GenSigSendType" SG_ 446 RBU_RLWheelSpd 1;
BA_ "GenSigStartValue" SG_ 446 RBU_RLWheelSpd 0;
BA_ "GenSigTimeoutValue" SG_ 446 RBU_RLWheelSpd 0;
BA_ "Remark" SG_ 446 RBU_RLWheelSpd "";
BA_ "EventCommandSignal" SG_ 446 RBU_RLWheelSpdVD 0;
BA_ "GatewayedSignals" SG_ 446 RBU_RLWheelSpdVD 0;
BA_ "GenSigInactiveValue" SG_ 446 RBU_RLWheelSpdVD 0;
BA_ "GenSigInvalidValue" SG_ 446 RBU_RLWheelSpdVD 0;
BA_ "GenSigSendType" SG_ 446 RBU_RLWheelSpdVD 1;
BA_ "GenSigStartValue" SG_ 446 RBU_RLWheelSpdVD 0;
BA_ "GenSigTimeoutValue" SG_ 446 RBU_RLWheelSpdVD 0;
BA_ "Remark" SG_ 446 RBU_RLWheelSpdVD "";
BA_ "EventCommandSignal" SG_ 446 RBU_RRWheelSpd 0;
BA_ "GatewayedSignals" SG_ 446 RBU_RRWheelSpd 0;
BA_ "GenSigInactiveValue" SG_ 446 RBU_RRWheelSpd 0;
BA_ "GenSigInvalidValue" SG_ 446 RBU_RRWheelSpd 0;
BA_ "GenSigSendType" SG_ 446 RBU_RRWheelSpd 1;
BA_ "GenSigStartValue" SG_ 446 RBU_RRWheelSpd 0;
BA_ "GenSigTimeoutValue" SG_ 446 RBU_RRWheelSpd 0;
BA_ "Remark" SG_ 446 RBU_RRWheelSpd "";
BA_ "EventCommandSignal" SG_ 446 RBU_RRWheelSpdVD 0;
BA_ "GatewayedSignals" SG_ 446 RBU_RRWheelSpdVD 0;
BA_ "GenSigInactiveValue" SG_ 446 RBU_RRWheelSpdVD 0;
BA_ "GenSigInvalidValue" SG_ 446 RBU_RRWheelSpdVD 0;
BA_ "GenSigSendType" SG_ 446 RBU_RRWheelSpdVD 1;
BA_ "GenSigStartValue" SG_ 446 RBU_RRWheelSpdVD 0;
BA_ "GenSigTimeoutValue" SG_ 446 RBU_RRWheelSpdVD 0;
BA_ "Remark" SG_ 446 RBU_RRWheelSpdVD "";
BA_ "EventCommandSignal" SG_ 446 RBU_FLWheelSpdEdgesSumVD 0;
BA_ "GatewayedSignals" SG_ 446 RBU_FLWheelSpdEdgesSumVD 0;
BA_ "GenSigInactiveValue" SG_ 446 RBU_FLWheelSpdEdgesSumVD 0;
BA_ "GenSigInvalidValue" SG_ 446 RBU_FLWheelSpdEdgesSumVD 0;
BA_ "GenSigSendType" SG_ 446 RBU_FLWheelSpdEdgesSumVD 1;
BA_ "GenSigStartValue" SG_ 446 RBU_FLWheelSpdEdgesSumVD 0;
BA_ "GenSigTimeoutValue" SG_ 446 RBU_FLWheelSpdEdgesSumVD 0;
BA_ "Remark" SG_ 446 RBU_FLWheelSpdEdgesSumVD "";
BA_ "EventCommandSignal" SG_ 446 RBU_FRWheelSpdEdgesSumVD 0;
BA_ "GatewayedSignals" SG_ 446 RBU_FRWheelSpdEdgesSumVD 0;
BA_ "GenSigInactiveValue" SG_ 446 RBU_FRWheelSpdEdgesSumVD 0;
BA_ "GenSigInvalidValue" SG_ 446 RBU_FRWheelSpdEdgesSumVD 0;
BA_ "GenSigSendType" SG_ 446 RBU_FRWheelSpdEdgesSumVD 1;
BA_ "GenSigStartValue" SG_ 446 RBU_FRWheelSpdEdgesSumVD 0;
BA_ "GenSigTimeoutValue" SG_ 446 RBU_FRWheelSpdEdgesSumVD 0;
BA_ "Remark" SG_ 446 RBU_FRWheelSpdEdgesSumVD "";
BA_ "EventCommandSignal" SG_ 446 RBU_RLWheelSpdEdgesSumVD 0;
BA_ "GatewayedSignals" SG_ 446 RBU_RLWheelSpdEdgesSumVD 0;
BA_ "GenSigInactiveValue" SG_ 446 RBU_RLWheelSpdEdgesSumVD 0;
BA_ "GenSigInvalidValue" SG_ 446 RBU_RLWheelSpdEdgesSumVD 0;
BA_ "GenSigSendType" SG_ 446 RBU_RLWheelSpdEdgesSumVD 1;
BA_ "GenSigStartValue" SG_ 446 RBU_RLWheelSpdEdgesSumVD 0;
BA_ "GenSigTimeoutValue" SG_ 446 RBU_RLWheelSpdEdgesSumVD 0;
BA_ "Remark" SG_ 446 RBU_RLWheelSpdEdgesSumVD "";
BA_ "EventCommandSignal" SG_ 446 RBU_RRWheelSpdEdgesSumVD 0;
BA_ "GatewayedSignals" SG_ 446 RBU_RRWheelSpdEdgesSumVD 0;
BA_ "GenSigInactiveValue" SG_ 446 RBU_RRWheelSpdEdgesSumVD 0;
BA_ "GenSigInvalidValue" SG_ 446 RBU_RRWheelSpdEdgesSumVD 0;
BA_ "GenSigSendType" SG_ 446 RBU_RRWheelSpdEdgesSumVD 1;
BA_ "GenSigStartValue" SG_ 446 RBU_RRWheelSpdEdgesSumVD 0;
BA_ "GenSigTimeoutValue" SG_ 446 RBU_RRWheelSpdEdgesSumVD 0;
BA_ "Remark" SG_ 446 RBU_RRWheelSpdEdgesSumVD "";
BA_ "EventCommandSignal" SG_ 446 RBU_FLWheelRotatedDirection 0;
BA_ "GatewayedSignals" SG_ 446 RBU_FLWheelRotatedDirection 0;
BA_ "GenSigInactiveValue" SG_ 446 RBU_FLWheelRotatedDirection 0;
BA_ "GenSigInvalidValue" SG_ 446 RBU_FLWheelRotatedDirection 0;
BA_ "GenSigSendType" SG_ 446 RBU_FLWheelRotatedDirection 1;
BA_ "GenSigStartValue" SG_ 446 RBU_FLWheelRotatedDirection 0;
BA_ "GenSigTimeoutValue" SG_ 446 RBU_FLWheelRotatedDirection 0;
BA_ "Remark" SG_ 446 RBU_FLWheelRotatedDirection "";
BA_ "EventCommandSignal" SG_ 446 RBU_FLWheelRotatedDirectionVD 0;
BA_ "GatewayedSignals" SG_ 446 RBU_FLWheelRotatedDirectionVD 0;
BA_ "GenSigInactiveValue" SG_ 446 RBU_FLWheelRotatedDirectionVD 0;
BA_ "GenSigInvalidValue" SG_ 446 RBU_FLWheelRotatedDirectionVD 0;
BA_ "GenSigSendType" SG_ 446 RBU_FLWheelRotatedDirectionVD 1;
BA_ "GenSigStartValue" SG_ 446 RBU_FLWheelRotatedDirectionVD 0;
BA_ "GenSigTimeoutValue" SG_ 446 RBU_FLWheelRotatedDirectionVD 0;
BA_ "Remark" SG_ 446 RBU_FLWheelRotatedDirectionVD "";
BA_ "EventCommandSignal" SG_ 446 RBU_FRWheelRotatedDirection 0;
BA_ "GatewayedSignals" SG_ 446 RBU_FRWheelRotatedDirection 0;
BA_ "GenSigInactiveValue" SG_ 446 RBU_FRWheelRotatedDirection 0;
BA_ "GenSigInvalidValue" SG_ 446 RBU_FRWheelRotatedDirection 0;
BA_ "GenSigSendType" SG_ 446 RBU_FRWheelRotatedDirection 1;
BA_ "GenSigStartValue" SG_ 446 RBU_FRWheelRotatedDirection 0;
BA_ "GenSigTimeoutValue" SG_ 446 RBU_FRWheelRotatedDirection 0;
BA_ "Remark" SG_ 446 RBU_FRWheelRotatedDirection "";
BA_ "EventCommandSignal" SG_ 446 RBU_FRWheelRotatedDirectionVD 0;
BA_ "GatewayedSignals" SG_ 446 RBU_FRWheelRotatedDirectionVD 0;
BA_ "GenSigInactiveValue" SG_ 446 RBU_FRWheelRotatedDirectionVD 0;
BA_ "GenSigInvalidValue" SG_ 446 RBU_FRWheelRotatedDirectionVD 0;
BA_ "GenSigSendType" SG_ 446 RBU_FRWheelRotatedDirectionVD 1;
BA_ "GenSigStartValue" SG_ 446 RBU_FRWheelRotatedDirectionVD 0;
BA_ "GenSigTimeoutValue" SG_ 446 RBU_FRWheelRotatedDirectionVD 0;
BA_ "Remark" SG_ 446 RBU_FRWheelRotatedDirectionVD "";
BA_ "EventCommandSignal" SG_ 446 RBU_SeconBrkDecCtrlActiveSt 0;
BA_ "GatewayedSignals" SG_ 446 RBU_SeconBrkDecCtrlActiveSt 0;
BA_ "GenSigInactiveValue" SG_ 446 RBU_SeconBrkDecCtrlActiveSt 0;
BA_ "GenSigInvalidValue" SG_ 446 RBU_SeconBrkDecCtrlActiveSt 0;
BA_ "GenSigSendType" SG_ 446 RBU_SeconBrkDecCtrlActiveSt 1;
BA_ "GenSigStartValue" SG_ 446 RBU_SeconBrkDecCtrlActiveSt 0;
BA_ "GenSigTimeoutValue" SG_ 446 RBU_SeconBrkDecCtrlActiveSt 0;
BA_ "Remark" SG_ 446 RBU_SeconBrkDecCtrlActiveSt "";
VAL_ 615 BCS_FLWheelSpdVD 0 "Not valid" 1 "Valid"  ;
VAL_ 615 BCS_FLWheelRotatedDirection 0 "Forward" 1 "Backward"  ;
VAL_ 615 BCS_FLWheelRotatedDirectionVD 0 "Not valid" 1 "Valid"  ;
VAL_ 615 BCS_FRWheelSpdVD 0 "Not valid" 1 "Valid"  ;
VAL_ 615 BCS_FRWheelRotatedDirection 0 "Forward" 1 "Backward"  ;
VAL_ 615 BCS_FRWheelRotatedDirectionVD 0 "Not valid" 1 "Valid"  ;
VAL_ 615 BCS_RLWheelSpdVD 0 "Not valid" 1 "Valid"  ;
VAL_ 615 BCS_RLWheelRotatedDirection 0 "Forward" 1 "Backward"  ;
VAL_ 615 BCS_RLWheelRotatedDirectionVD 0 "Not valid" 1 "Valid"  ;
VAL_ 615 BCS_RRWheelSpdVD 0 "Not valid" 1 "Valid"  ;
VAL_ 615 BCS_RRWheelRotatedDirection 0 "Forward" 1 "Backward"  ;
VAL_ 615 BCS_RRWheelRotatedDirectionVD 0 "Not valid" 1 "Valid"  ;
VAL_ 615 BCS_HHCCtrlSt 0 "Not active" 1 "Active"  ;
VAL_ 615 BCS_HDCCtrlSt 0 "Off" 1 "On active braking" 2 "On not active braking" 3 "Not used"  ;
VAL_ 615 BCS_HDCErrSt 0 "No error" 1 "Error"  ;
VAL_ 615 BCS_FLWheelSpdEdgesSumVD 0 "Not valid" 1 "Valid"  ;
VAL_ 615 BCS_FRWheelSpdEdgesSumVD 0 "Not valid" 1 "Valid"  ;
VAL_ 615 BCS_RLWheelSpdEdgesSumVD 0 "Not valid" 1 "Valid"  ;
VAL_ 615 BCS_RRWheelSpdEdgesSumVD 0 "Not valid" 1 "Valid"  ;
VAL_ 615 BCS_FLWheelRotatedDirectionAPA 0 "Standstill" 1 "Forward" 2 "Backward" 3 "Unknown"  ;
VAL_ 615 BCS_FRWheelRotatedDirectionAPA 0 "Standstill" 1 "Forward" 2 "Backward" 3 "Unknown"  ;
VAL_ 615 BCS_RLWheelRotatedDirectionAPA 0 "Standstill" 1 "Forward" 2 "Backward" 3 "Unknown"  ;
VAL_ 615 BCS_RRWheelRotatedDirectionAPA 0 "Standstill" 1 "Forward" 2 "Backward" 3 "Unknown"  ;
VAL_ 615 BCS_ParkingReqToEPB 0 "No request" 1 "Release brake request" 2 "Lock brake request" 3 "Not used"  ;
VAL_ 615 BCS_VDCOff 0 "On" 1 "Off"  ;
VAL_ 615 BCS_AVHSt 0 "Not active" 1 "Active"  ;
VAL_ 615 BCS_AVHStandby 0 "Not standby" 1 "Standby"  ;
VAL_ 615 BCS_AVHAvailable 0 "Not available" 1 "Available"  ;
VAL_ 615 BCS_TCSOff 0 "On" 1 "Off"  ;
VAL_ 615 BCS_BrkPdlPstVD 0 "Not valid" 1 "Valid"  ;
VAL_ 615 BCS_NoBrakeForce 0 "Exist brake force" 1 "No brake force"  ;
VAL_ 615 BCS_BrakeOverHeat 0 "Not high" 1 "Temp too high"  ;
VAL_ 615 BCS_ABAactive 0 "Not active" 1 "Active"  ;
VAL_ 615 BCS_ABAavailable 0 "Not available" 1 "Available"  ;
VAL_ 615 BCS_ABPActive 0 "Not active" 1 "Active"  ;
VAL_ 615 BCS_ABPAvailable 0 "Not available" 1 "Available"  ;
VAL_ 615 BCS_AEBActive 0 "Not active" 1 "Active"  ;
VAL_ 615 BCS_AEBAvailable 0 "Not available" 1 "Available"  ;
VAL_ 615 BCS_AWBActive 0 "Not active" 1 "Active"  ;
VAL_ 615 BCS_AWBAvailable 0 "Not available" 1 "Available"  ;
VAL_ 615 BCS_VehicleStandStillSt 0 "Not standstill" 1 "standstill" 2 "Invalid (short unavailability, max 3s)" 3 "Not used"  ;
VAL_ 615 BCS_AEBBAActive 0 "Not active" 1 "Active"  ;
VAL_ 615 BCS_2ParkDrvBrkOverrideFlg 0 "False" 1 "True"  ;
VAL_ 615 IPB_InputRodStrokeSt 0 "Valid/Init" 1 "Invalid/Default"  ;
VAL_ 615 BCS_RAEBActive 0 "Not active" 1 "Active"  ;
VAL_ 615 BCS_RAEBAvailable 0 "Not avaialbe" 1 "Available"  ;
VAL_ 615 BCS_DrvModeAvailable 0 "Not available" 1 "Available"  ;
VAL_ 615 BCS_DrvMode 0 "Normal" 1 "Sport" 2 "Snow" 3 "ipedal" 4 "Offroad" 5 "Slippery" 6 "Sand" 7 "Wade"  ;
VAL_ 615 IPB_PlungerPressureSt 0 "Valid/Init" 1 "Invalid/Default"  ;
VAL_ 352 BCS_VehSpdVD 0 "Not Valid" 1 "Valid"  ;
VAL_ 352 BCS_EBDActiveSt 0 "Not active" 1 "Active"  ;
VAL_ 352 BCS_EBDFaultSt 0 "Not fault" 1 "Fault"  ;
VAL_ 352 BCS_ABSActiveSt 0 "Not active" 1 "Active"  ;
VAL_ 352 BCS_ABSFaultSt 0 "Not fault" 1 "Fault"  ;
VAL_ 352 BCS_TCSActiveSt 0 "Not active" 1 "Active"  ;
VAL_ 352 BCS_TCSFaultSt 0 "Not fault" 1 "Fault"  ;
VAL_ 352 BCS_VDCActiveSt 0 "Not active" 1 "Active"  ;
VAL_ 352 BCS_VDCFaultSt 0 "Not fault" 1 "Fault"  ;
VAL_ 352 BCS_EngTorqDecActiveSt 0 "Not active" 1 "Active"  ;
VAL_ 352 BCS_EngTorqIncActiveSt 0 "Not active" 1 "Active"  ;
VAL_ 352 BCS_RegenModulationAvailable 0 "Not available" 1 "Available"  ;
VAL_ 352 BCS_RegenModuleActive 0 "Not Active" 1 "Active"  ;
VAL_ 352 BCS_RealTCSActiveSt 0 "Not active" 1 "Active"  ;
VAL_ 352 BCS_TargetRecpTorqRqSt 0 "NotIntialized" 1 "Normal" 2 "Faulty" 3 "Reserved"  ;
VAL_ 352 BCS_CrbsActive 0 "Not Active" 1 "Active"  ;
VAL_ 352 BCS_TargetRecpTorqRqFASt 0 "NotIntialized" 1 "Normal" 2 "Faulty" 3 "Reserved"  ;
VAL_ 352 BCS_TargetRecpTorqRqRASt 0 "NotIntialized" 1 "Normal" 2 "Faulty" 3 "Reserved"  ;
VAL_ 352 IPB_BrakePedalSt 0 "Not_Pressed/Init/Default" 1 "Pressed" 2 "Reserved" 3 "Error"  ;
VAL_ 352 IPB_BrakePedalStsVld 0 "Invalid" 1 "Valid"  ;
VAL_ 352 BCS_ESP2Park_DrvBrkOverrideFlg 0 "False" 1 "True"  ;
VAL_ 352 BCS_EngTorqDecActiveStRA 0 "Not active" 1 "Active"  ;
VAL_ 352 BCS_EngTorqIncActiveStRA 0 "Not active" 2 "Active"  ;
VAL_ 352 BCS_EngTorqIncActiveStFA 0 "Not active" 1 "Active"  ;
VAL_ 352 BCS_EngTorqDecActiveStFA 0 "Not active" 1 "Active"  ;
VAL_ 352 BCS_PrimBrkCDAAvailableSt 0 "CDA NotAvailable" 1 "CDA NotAvailable By Situation" 2 "CDA Available With Fault" 3 "CDA Available With Situation" 4 "CDA Available" 5 "Not used" 6 "Not used" 7 "Not used"  ;
VAL_ 352 BCS_PrimBrkCommuniSt 0 "Valid" 1 "Invalid"  ;
VAL_ 352 BCS_PrimBrkActiveSt 0 "L2 or L2++ NotActive" 1 "L2 Acitve" 2 "L2++ Active" 3 "Not used"  ;
VAL_ 352 BCS_2ParkDynamicAVPavailability 0 "NotAvailable" 1 "Available" 2 "TestPending"  ;
VAL_ 352 BCS_2ParkCddApActiveVehHld 0 "False" 1 "True"  ;
VAL_ 352 BCS_2ParkAPCStatus 0 "Standby" 1 "Active_APA" 2 "Active_RPA" 3 "Active_AVP" 4 "Active_DynamicAVP"  ;
VAL_ 352 BCS_2ParkAPAavailability 0 "NotAvailable" 1 "Available"  ;
VAL_ 352 BCS_2ParkRPAAVPavailability 0 "NotAvailable" 1 "Available" 2 "TestPending"  ;
VAL_ 352 BCS_2ParkAPCFailureSts 0 "no error" 1 "APC1(APA) driver not present" 2 "too high speed" 3 "unexpect EPB Apply" 4 "reserved" 5 "reserved" 6 "Error" 7 "APC24(RPA AVP) trigger without secure"  ;
VAL_ 352 BCS_APCMain2BackupReq 0 "NoReq" 1 "StopRequest"  ;
VAL_ 352 BCS_PrimBrkCtrlUsedChannel 0 "No Channel used" 1 "Main ADC com1 Used" 2 "Main ADC com2 Used" 3 "Back up IFC com1 Used"  ;
VAL_ 352 BCS_PrimBrkCDAActiveSt 0 "L2++ NotActive" 1 "L2++ Active"  ;
VAL_ 352 BCS_PrimBrkDecCtrlActiveSt 0 "NotActive" 1 "Active"  ;
VAL_ 352 BCS_PrimBrkCDDAvailableSt 0 "CDD NotAvailable" 1 "CDD NotAvailable By Situation" 2 "CDD Available" 3 "Reserve"  ;
VAL_ 611 BCS_PrimCommPathSt 0 "Normal" 1 "Error"  ;
VAL_ 611 BCS_SeconCommPathSt 0 "Normal" 1 "Error"  ;
VAL_ 611 BCS_PressureHldSt 0 "Not holding" 1 "Holding"  ;
VAL_ 611 BCS_CDDFuncSt 0 "Normal" 1 "Degrade"  ;
VAL_ 611 IPB_SimulatorPressureSt 0 "Valid/Init" 1 "Invalid/Default"  ;
VAL_ 611 IBCS_SystemSt 0 "BBF_FullSys/Init/Default" 1 "BBF_DegradedPedalFeel" 2 "BBF_CircuitSperation" 3 "BBF_C1/2BoostOnly" 4 "HydBack w/ act / HydBack w/o act"  ;
VAL_ 611 IBCS_FWAWarning 0 "no failure/Init/Default" 1 "Warnig level 1 for high Temp. of Brake system" 2 "Warnig level 2 for high Temp. of Brake system" 3 "reserved"  ;
VAL_ 611 IPB_CSTSt 0 "CST is disabled/Init/Default" 1 "CST is Standby" 2 "CST is Active" 3 "CST is Failure"  ;
VAL_ 611 BCS_AVDCActive 0 "Not active" 1 "Active"  ;
VAL_ 611 BCS_AVDCAvailable 0 "Not active" 1 "Active"  ;
VAL_ 360 BCS_BrkTqCtrlAvlDriving 0 "Not available" 1 "Available" 2 "Available degraded1（Redundant Project）" 3 "Available degraded2 （Redundant Project）" 4 "Reserved" 5 "Reserved" 6 "Reserved" 7 "Reserved"  ;
VAL_ 360 BCS_BrkTqCtrlAvlParking 0 "Not available" 1 "available" 2 "parking overspeed--for BOSCH ADAS" 3 "Reserved"  ;
VAL_ 360 BCS_BrkTqCtrlActv 0 "NotActive" 1 "APA Active" 2 "ACC Active" 3 "Reserved"  ;
VAL_ 360 BCS_DycEscTarTqCtrlAvl 0 "Not available" 1 "Available"  ;
VAL_ 360 BCS_DrvrBrkOvrd 0 "Not override" 1 "Override"  ;
VAL_ 360 BCS_DrvrBrkOvrdVld 0 "Invalid" 1 "Valid"  ;
VAL_ 360 BCS_DycEscTarTqActv 0 "NotActive" 1 "Active"  ;
VAL_ 360 BCS_ERV_VehSpdVld 0 "Invalid" 1 "Valid"  ;
VAL_ 360 BCS_EspFailrSts 0 "No error" 1 "Error"  ;
VAL_ 360 BCS_ActvSts 0 "Not active" 1 "Active"  ;
VAL_ 360 BCS_BDCActive 0 "Not active" 1 "Active"  ;
VAL_ 360 BCS_DTCActvSts 0 "Not active" 1 "Active"  ;
VAL_ 360 BCS_errorFb 0 "No error" 1 "Invalid Request of ADAS" 2 "Fault related to wheelspd" 2 "Fault related to steeringangel" 3 "Fault related to powertrain" 4 "Fault related to EPB" 7 "ADAS E2E fault or timeoutt"  ;
VAL_ 360 BCS_WheelSlipFLValid 0 "Invalid" 1 "Valid"  ;
VAL_ 360 BCS_WheelSlipFRValid 0 "Invalid" 1 "Valid"  ;
VAL_ 360 BCS_WheelSlipRLValid 0 "Invalid" 1 "Valid"  ;
VAL_ 360 BCS_WheelSlipRRValid 0 "Invalid" 1 "Valid"  ;
VAL_ 360 BCS_CrbsTarRecpTorqRqFASt 0 "NotIntialized" 1 "Normal（valid）" 2 "Faulty（invalid）" 3 "Reserved"  ;
VAL_ 360 BCS_CrbsTarRecpTorqRqRASt 0 "NotIntialized" 1 "Normal（valid）" 2 "Faulty（invalid）" 3 "Reserved"  ;
VAL_ 360 BCS_CrbsTarRecpTorqRqSumSt 0 "NotIntialized" 1 "Normal（valid）" 2 "Faulty（invalid）" 3 "Reserved"  ;
VAL_ 618 EPB_SwitchSt 0 "Not active" 1 "Released" 2 "Applied" 3 "Not used"  ;
VAL_ 618 EPB_SwitchStVD 0 "Not valid" 1 "Valid"  ;
VAL_ 618 EPB_SysSt 0 "Release (fully released)" 1 "Apply (fully applied)" 2 "Releasing" 3 "Applying" 4 "Disengaged" 5 "Not used" 6 "Not used" 7 "Fault(not sure position)"  ;
VAL_ 618 EPB_FailSt 0 "No error" 1 "Error"  ;
VAL_ 618 EPB_ExtAvailable 0 "Apply and release" 1 "Only apply" 2 "Only release" 3 "None"  ;
VAL_ 618 EPB_DynamicApplySt 0 "Not active" 1 "BCS dynamic apply" 2 "Anti-Lock Apply" 3 "EPB degraded apply" 4 "Not used" 5 "Not used" 6 "Not used" 7 "Not used"  ;
VAL_ 618 EPB_ActuatorSt_R 0 "PbcActuatorState_Applied" 1 "PbcActuatorState_Released" 2 "PbcActuatorState_Applying" 3 "PbcActuatorState_Releasing" 4 "PbcActuatorState_Unknown" 5 "PbcActuatorState_HoldApplied" 6 "PbcActuatorState_CompletelyReleased" 7 "Not used" 8 "Not used" 9 "Not used" 10 "Not used" 11 "Not used" 12 "Not used" 13 "Not used" 14 "Not used" 15 "Not used"  ;
VAL_ 618 EPB_RWUActvSts 0 "Not active" 1 "CDP active" 2 "RWU active" 3 "Limp home"  ;
VAL_ 618 EPB_RWUAvl 0 "Not available" 1 "Reserved" 2 "RWU available" 3 "Limp home available"  ;
VAL_ 618 EPB_EpbAvl 0 "not available" 1 "available" 2 "available degraed（lone side is available，left or right）"  ;
VAL_ 618 EPB_RPAAVPAvailability 0 "NotAvailable" 1 "Available" 2 "TestPending"  ;
VAL_ 618 EPB_APAAvailability 0 "NotAvailable" 1 "Available"  ;
VAL_ 618 EPB_ActuatorSt_L_1 0 "PbcActuatorState_Applied" 1 "PbcActuatorState_Released" 2 "PbcActuatorState_Applying" 3 "PbcActuatorState_Releasing" 4 "PbcActuatorState_Unknown" 5 "PbcActuatorState_HoldApplied" 6 "PbcActuatorState_CompletelyReleased" 7 "Not used" 8 "Not used" 9 "Not used" 10 "Not used" 11 "Not used" 12 "Not used" 13 "Not used" 14 "Not used" 15 "Not used"  ;
VAL_ 446 RBM_BATResultSt 0 "BAT Fail" 1 "BAT Pass"  ;
VAL_ 446 RBU_SeconBrkCDAAvailableSt 0 "CDA NotAvailable" 1 "CDA NotAvailable By Situation" 2 "CDA active With Fault" 3 "CDA active With Situation" 4 "CDA Available" 5 "Not used" 6 "Not used" 7 "Not used"  ;
VAL_ 446 RBU_SeconBrkCommuniSt 0 "Valid" 1 "Invalid"  ;
VAL_ 446 RBU_SeconBrkCDAActiveSt 0 "CDA NotActive" 1 "CDA Active"  ;
VAL_ 446 RBU_SeconBrkEPBst 0 "ParkBrakeState_Unknown" 1 "ParkBrakeState_Applying" 2 "ParkBrakeState_Applied" 3 "ParkBrakeState_Releasing" 4 "ParkBrakeState_Released" 5 "Not used" 6 "Not used" 7 "Not used"  ;
VAL_ 446 RBU_SeconBrkComChannel 0 "No Channel used" 1 "Main ADC and Main bus Used" 2 "Main ADC and Back bus Used" 3 "Back up ADC and Main Bus Used"  ;
VAL_ 446 RBU_FLWheelSpdVD 0 "Not valid" 1 "Valid"  ;
VAL_ 446 RBU_RLWheelRotatedDirection 0 "Forward" 1 "Backward"  ;
VAL_ 446 RBU_RLWheelRotatedDirectionVD 0 "Not valid" 1 "Valid"  ;
VAL_ 446 RBU_FRWheelSpdVD 0 "Not valid" 1 "Valid"  ;
VAL_ 446 RBU_RRWheelRotatedDirection 0 "Forward" 1 "Backward"  ;
VAL_ 446 RBU_RRWheelRotatedDirectionVD 0 "Not valid" 1 "Valid"  ;
VAL_ 446 RBU_RLWheelSpdVD 0 "Not valid" 1 "Valid"  ;
VAL_ 446 RBU_RRWheelSpdVD 0 "Not valid" 1 "Valid"  ;
VAL_ 446 RBU_FLWheelSpdEdgesSumVD 0 "Not valid" 1 "Valid"  ;
VAL_ 446 RBU_FRWheelSpdEdgesSumVD 0 "Not valid" 1 "Valid"  ;
VAL_ 446 RBU_RLWheelSpdEdgesSumVD 0 "Not valid" 1 "Valid"  ;
VAL_ 446 RBU_RRWheelSpdEdgesSumVD 0 "Not valid" 1 "Valid"  ;
VAL_ 446 RBU_FLWheelRotatedDirection 0 "Forward" 1 "Backward"  ;
VAL_ 446 RBU_FLWheelRotatedDirectionVD 0 "Not valid" 1 "Valid"  ;
VAL_ 446 RBU_FRWheelRotatedDirection 0 "Forward" 1 "Backward"  ;
VAL_ 446 RBU_FRWheelRotatedDirectionVD 0 "Not valid" 1 "Valid"  ;
VAL_ 446 RBU_SeconBrkDecCtrlActiveSt 0 "NotActive" 1 "Active"  ;
