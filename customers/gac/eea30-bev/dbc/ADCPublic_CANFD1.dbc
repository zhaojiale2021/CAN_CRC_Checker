VERSION "Version"

NS_ :

BS_:

BU_: CCU ADC FAPA IFC FLR FRR RRR RLR INU Tester CBM VIU SRS IDC PCS AMP IMR FIMR TBOX IBCS IXCU V2XOBU WHUD RLBMS CCURT2 RT2_C3 OTAWL ZCUF ZCUL ZCUR ZCUT IPS DCU NIDU RBM WACUFL IID CCURT1 RT1_C0 RT1_C1 AVAS FLLCM FRLCM RLLCMA RRLCMA RLLCMB RRLCMB LBMS LBMSAD MFS FCP IDU ITS BCB DCDC PCU EOP DCU2 BMS TMC EPS ECS CD PAS SBM WCM ETC TBOX2 DSM FLPDM FRPDM RLPDM RRPDM HVSMR SCMRL SCMRR EBU EPB VDC EVCC ADM PLGM FBLCM RLISD RRISD RCP RFR WCMFR SCMR TFOAR TROAR HVSPRL HVSPRR

BO_ 909 CCU_ZCU_1: 64 CCU
 SG_ LCK_HoodAjarSt : 37|1@0+ (1,0) [0|1] ""  OTAWL,ZCUL,ZCUR,ZCUT,IDC,IID,AMP,ADC,FAPA,FLR,FRR,RLR,RRR,VIU,IFC,PCS
 SG_ LCK_FrontLeftDoorAjarSt : 36|1@0+ (1,0) [0|1] ""  OTAWL,ZCUF,ZCUR,ZCUT,RBM,IBCS,EPB,IXCU,WACUFL,IDC,IID,AMP,IMR,ADC,FAPA,FLR,FRR,RLR,RRR,VIU,IFC,TBOX,V2XOBU
 SG_ LCK_FrontRightDoorAjarSt : 35|1@0+ (1,0) [0|1] ""  ZCUF,ZCUL,ZCUT,RBM,IBCS,IXCU,WACUFL,IDC,IID,AMP,IMR,ADC,FAPA,FLR,FRR,RLR,RRR,VIU,IFC,TBOX
 SG_ LCK_RearLeftDoorAjarSt : 34|1@0+ (1,0) [0|1] ""  OTAWL,ZCUF,ZCUL,ZCUR,RBM,IBCS,IXCU,WACUFL,IDC,IID,AMP,IMR,ADC,FAPA,FLR,FRR,RLR,RRR,VIU,IFC,PCS,TBOX
 SG_ LCK_RearRightDoorAjarSt : 33|1@0+ (1,0) [0|1] ""  OTAWL,ZCUF,ZCUL,ZCUR,RBM,IBCS,IXCU,WACUFL,IDC,IID,AMP,IMR,ADC,FAPA,FLR,FRR,RLR,RRR,VIU,IFC,PCS,TBOX
 SG_ LCK_TrunkAjarSt : 32|1@0+ (1,0) [0|1] ""  OTAWL,ZCUF,ZCUL,ZCUR,IDC,IID,AMP,ADC,FAPA,FLR,FRR,RLR,RRR,VIU,IFC,PCS
 SG_ LCK_FrontLeftDoorLockSt : 47|1@0+ (1,0) [0|1] ""  OTAWL,ZCUF,ZCUR,ZCUT,CBM,IDC,ADC,FAPA,FLR,FRR,RLR,RRR,VIU,IFC
 SG_ LCK_FrontRightDoorLockSt : 46|1@0+ (1,0) [0|1] ""  OTAWL,ZCUF,ZCUL,ZCUT,CBM,IDC,ADC,FAPA,FLR,FRR,RLR,RRR,VIU,IFC
 SG_ LCK_RearLeftDoorLockSt : 45|1@0+ (1,0) [0|1] ""  OTAWL,ZCUF,ZCUL,ZCUR,CBM,IDC,ADC,FAPA,FLR,FRR,RLR,RRR,VIU,IFC
 SG_ LCK_RearRightDoorLockSt : 44|1@0+ (1,0) [0|1] ""  OTAWL,ZCUF,ZCUL,ZCUR,CBM,IDC,ADC,FAPA,FLR,FRR,RLR,RRR,VIU,IFC
 SG_ LCK_RearLeftChildSaftyLockSt : 43|1@0+ (1,0) [0|1] ""  ZCUF,ZCUL,ZCUR,CBM,IDC,ADC,FAPA,FLR,FRR,RLR,RRR,VIU,IFC
 SG_ LCK_RearRightChildSaftyLockSt : 42|1@0+ (1,0) [0|1] ""  ZCUF,ZCUL,ZCUR,CBM,IDC,ADC,FAPA,FLR,FRR,RLR,RRR,VIU,IFC
 SG_ LCK_FrontLeftDoorHandlePosition : 135|8@0+ (1,0) [0|255] ""  IDC,ADC,FAPA,IFC
 SG_ LCK_FrontRightDoorHandlePosition : 143|8@0+ (1,0) [0|255] ""  IDC,ADC,FAPA,IFC
 SG_ LCK_RearLeftDoorHandlePosition : 151|8@0+ (1,0) [0|255] ""  IDC,ADC,FAPA,IFC
 SG_ LCK_RearRightDoorHandlePosition : 159|8@0+ (1,0) [0|255] ""  IDC,ADC,FAPA,IFC
 SG_ LCK_FillerCapASt : 239|1@0+ (1,0) [0|1] ""  ADC,FAPA,IFC
 SG_ LCK_FillerCapBSt : 238|1@0+ (1,0) [0|1] ""  ADC,FAPA,IFC
 SG_ MR_LeftMirrorFoldUnfoldSt : 233|2@0+ (1,0) [0|3] ""  IDC,ADC,FAPA,FLR,FRR,RLR,RRR,VIU,PCS
 SG_ SBM_SwapHvBattModeSt : 247|4@0+ (1,0) [0|15] ""  ADC,FAPA,VIU
 SG_ SBM_SwapStaDiagCode : 243|4@0+ (1,0) [0|15] ""  ADC,FAPA,VIU
 SG_ SBM_SwapVehDiagCode : 255|4@0+ (1,0) [0|15] ""  ADC,FAPA,VIU
 SG_ SBM_SwapHvBattModeFaultSt : 251|3@0+ (1,0) [0|7] ""  ADC,FAPA,VIU
 SG_ POD_CurDoorPosFL : 262|7@0+ (1,0) [0|100] "%"  ZCUR,IDC,ADC,FAPA,VIU,SBM
 SG_ IPDS_HDMapPowerSt : 271|1@0+ (1,0) [0|1] ""  ADC,FAPA,VIU,IFC
 SG_ IPDS_KL15L1PowerSt : 270|1@0+ (1,0) [0|1] ""  EPS,ADC,FAPA,FLR,FRR,RLR,RRR,VIU,IFC
 SG_ IPDS_SRSECUPowerSt : 269|1@0+ (1,0) [0|1] ""  ADC,FAPA,VIU,IFC
 SG_ IPDS_HODPowerSt : 268|1@0+ (1,0) [0|1] ""  ADC,FAPA,VIU,IFC
 SG_ KAE_BLEOption : 265|1@0+ (1,0) [0|1] ""  ADC,FAPA,VIU,IFC
 SG_ KAE_UWBOption : 264|1@0+ (1,0) [0|1] ""  ADC,FAPA,VIU,IFC
 SG_ WW_RWPMotorSt : 226|3@0+ (1,0) [0|7] ""  ADC,FAPA,VIU
 SG_ ACEleclocksSt : 282|3@0+ (1,0) [0|7] ""  BMS,EVCC,ADC,FAPA
 SG_ WCM_Reminder : 103|1@0+ (1,0) [0|1] ""  ADC,FAPA,IFC
 SG_ WCM_ChargingSt : 89|2@0+ (1,0) [0|3] ""  ADC,FAPA,IFC
 SG_ AVAS_ActivatedSt : 231|3@0+ (1,0) [0|7] ""  ADC,FAPA,IFC
 SG_ PWL_WinCurrentPos_FLWinPst : 470|8@0+ (0.5,0) [0|100] "%"  ADC,FAPA,IFC
 SG_ UINM_FrontLeftPowerReleaseReq : 456|1@0+ (1,0) [0|1] ""  ADC,FAPA,IFC
 SG_ UINM_FrontLeftPowerReleaseFaultSt : 457|1@0+ (1,0) [0|1] ""  ADC,FAPA,IFC
 SG_ UINM_FrontRightPowerReleaseReq : 458|1@0+ (1,0) [0|1] ""  ADC,FAPA,IFC
 SG_ UINM_FrontRightPowerReleaseFaultSt : 459|1@0+ (1,0) [0|1] ""  ADC,FAPA,IFC
 SG_ UINM_RearLeftPowerReleaseFaultSt : 460|1@0+ (1,0) [0|1] ""  ADC,FAPA,IFC
 SG_ UINM_RearLeftPowerReleaseReq : 461|1@0+ (1,0) [0|1] ""  ADC,FAPA,IFC
 SG_ UINM_RearRightPowerReleaseFaultSt : 462|1@0+ (1,0) [0|1] ""  ADC,FAPA,IFC
 SG_ UINM_RearRightPowerReleaseReq : 471|1@0+ (1,0) [0|1] ""  ADC,FAPA,IFC
 SG_ PWL_WinCurrentPos_RRWinPst : 503|8@0+ (0.5,0) [0|100] "%"  IDC,AMP,IMR,FIMR,ADC,FAPA,VIU,IFC
 SG_ PWL_WinCurrentPos_RLWinPst : 511|8@0+ (0.5,0) [0|100] "%"  IDC,AMP,IMR,FIMR,ADC,FAPA,VIU,IFC

BO_ 334 CCU_15: 64 CCU
 SG_ CSM_RC_ViewExtvideo : 215|16@0+ (1,0) [0|65535] ""  IDC,ADC,FAPA
 SG_ CSM_RC_ViewExtvideoReq : 231|1@0+ (1,0) [0|1] ""  IDC,ADC,FAPA
 SG_ Theft_Auth_Status : 379|12@0+ (1,0) [0|4095] ""  CCURT1,RT1_C1,VDC,ADC,FAPA,IFC

BO_ 290 CCU_PowerOn: 64 CCU
 SG_ IPDS_Lidar1PowerSup : 77|2@0+ (1,0) [0|3] ""  ZCUL,ADC

BO_ 905 CCU_IDC_ICM_1: 64 CCU
 SG_ ICM_SetIACCSt : 27|1@0+ (1,0) [0|1] ""  ADC,FAPA,VIU
 SG_ ICM_TotalOdometer : 35|20@0+ (1,0) [0|999999] "km"  ZCUF,ZCUT,BMS,EPS,RBM,IBCS,ECS,EBU,EPB,IXCU,WACUFL,ADC,FAPA,FLR,FRR,RLR,RRR,VIU,PCS
 SG_ ICM_VehInsSpd : 103|8@0+ (1,0) [0|254] "km/h"  SRS,ADC,FAPA,VIU,IFC
 SG_ ICM_VehInsSpd_accurate : 272|11@0+ (0.1,0) [0|204.6] "km/h"  ECS,ADC,FAPA,RLR,RRR,VIU
 SG_ ICM_FuelAvaibleDriveDistance : 311|11@0+ (1,0) [0|2046] "km"  ADC
 SG_ ICM_TotalAvaibleDriveDistance : 316|11@0+ (1,0) [0|2046] "km"  ADC

BO_ 161 CCU_IDC_1: 64 CCU
 SG_ ACU_FaceID_Delete : 119|4@0+ (1,0) [0|15] ""  ADC,FAPA,IFC
 SG_ ACU_RegisterTriger : 115|4@0+ (1,0) [0|15] ""  ADC,FAPA,IFC
 SG_ ACU_VerifyTriger : 127|4@0+ (1,0) [0|15] ""  ADC,FAPA,IFC
 SG_ ACU_FaceIDQuit : 123|1@0+ (1,0) [0|1] ""  ADC,FAPA,IFC
 SG_ ACU_FaceIDSwitch : 122|2@0+ (1,0) [0|3] ""  ADC,FAPA,IFC
 SG_ ACU_AVAS_SwitchCfgReq : 273|2@0+ (1,0) [0|3] ""  ZCUF,ADC,FAPA,IFC

BO_ 351 CCU_IDC_2: 64 CCU
 SG_ ACU_VirtualPowerOFFReq : 31|1@0+ (1,0) [0|1] ""  ADC,FAPA,IFC
 SG_ ACU_FactoryResetReq : 174|1@0+ (1,0) [0|1] ""  ZCUR,ADC,FAPA,IFC,TBOX
 SG_ ACU_Account_Uld : 171|4@0+ (1,0) [0|15] ""  ADC,FAPA,VIU
 SG_ ACU_Account_Delete : 183|8@0+ (1,0) [0|255] ""  ADC,FAPA,VIU
 SG_ ACU_FrontWiperIntCfgVkReq : 191|4@0+ (1,0) [0|15] ""  ADC,FAPA,VIU
 SG_ ACU_FrontWiperAutoCfgVkReq : 187|4@0+ (1,0) [0|15] ""  ADC,FAPA,VIU
 SG_ IDC_VoicePAAReq : 364|1@0+ (1,0) [0|1] ""  ZCUR,ADC
 SG_ IDC_VoiceParkCheckReq : 365|1@0+ (1,0) [0|1] ""  ZCUR,ADC

BO_ 879 CCU_IDC_3: 64 CCU
 SG_ ACU_PCS_SVM_MODCmd : 38|1@0+ (1,0) [0|1] ""  ADC,FAPA
 SG_ ACU_HeadLightVirtualSwSt : 159|3@0+ (1,0) [0|7] ""  ADC,FAPA,VIU,TBOX
 SG_ ACU_FrontFogLightVirtualSwSt : 156|1@0+ (1,0) [0|1] ""  ADC,FAPA,TBOX
 SG_ ACU_RearFogLightVirtualSwSt : 155|1@0+ (1,0) [0|1] ""  ADC,FAPA,TBOX
 SG_ IDC_HPAParkingSpdsSw : 255|2@0+ (1,0) [0|3] ""  ADC,FAPA
 SG_ ACU_Account_Uid : 251|4@0+ (1,0) [0|15] ""  ADC,FAPA,IFC
 SG_ ACU_FCWWarnDistanceCfg : 263|2@0+ (1,0) [0|3] ""  ADC,FAPA,IFC
 SG_ ACU_FCWCfg : 261|2@0+ (1,0) [0|3] ""  ADC,FAPA,IFC
 SG_ ACU_AEBOff : 259|2@0+ (1,0) [0|3] ""  ADC,FAPA
 SG_ ACU_TSR_SwitchReq : 271|2@0+ (1,0) [0|3] ""  ADC,FAPA,IFC
 SG_ ACU_IHBC_SwitchReq : 269|2@0+ (1,0) [0|3] ""  ADC,FAPA,IFC
 SG_ ACU_LDS_TypeReq : 267|2@0+ (1,0) [0|3] ""  ADC,FAPA
 SG_ ACU_BSDCfg : 265|2@0+ (1,0) [0|3] ""  ADC,FAPA
 SG_ ACU_RCTACfg : 279|2@0+ (1,0) [0|3] ""  ADC,FAPA
 SG_ ACU_DOWCfg : 277|2@0+ (1,0) [0|3] ""  ADC,FAPA
 SG_ ACU_TSR_AudioWarnReq : 273|2@0+ (1,0) [0|3] ""  ADC,FAPA,IFC
 SG_ ACU_HWAHFCfg : 287|2@0+ (1,0) [0|3] ""  ADC,FAPA
 SG_ ACU_HWAHF_AudioWarningTypeCfg : 285|2@0+ (1,0) [0|3] ""  ADC,FAPA
 SG_ ACU_HWA_SwitchReq : 283|2@0+ (1,0) [0|3] ""  ADC,FAPA
 SG_ ACU_ELKCfg : 281|2@0+ (1,0) [0|3] ""  ADC,FAPA
 SG_ ACU_FCTACfg : 295|2@0+ (1,0) [0|3] ""  ADC,FAPA
 SG_ ACU_RAWCfg : 293|2@0+ (1,0) [0|3] ""  ADC,FAPA
 SG_ ACU_RCTA_TypeReqCfg : 291|2@0+ (1,0) [0|3] ""  ADC,FAPA
 SG_ ACU_FCTA_TypeReqCfg : 289|2@0+ (1,0) [0|3] ""  ADC,FAPA
 SG_ ACU_NDASwitchReq : 303|2@0+ (1,0) [0|3] ""  ADC,FAPA
 SG_ ACU_NDALCConSwitchReq : 301|2@0+ (1,0) [0|3] ""  ADC,FAPA
 SG_ ACU_NDALCStySwitchReq : 299|2@0+ (1,0) [0|3] ""  ADC,FAPA
 SG_ ACU_ADASWarnTypeSwitch : 297|2@0+ (1,0) [0|3] ""  ADC,FAPA
 SG_ ACU_ESACfg : 311|2@0+ (1,0) [0|3] ""  ADC,FAPA
 SG_ ACU_ILCCfg : 309|2@0+ (1,0) [0|3] ""  ADC,FAPA
 SG_ ACU_AESCfg : 307|2@0+ (1,0) [0|3] ""  ADC,FAPA
 SG_ ACU_ILOACfg : 305|2@0+ (1,0) [0|3] ""  ADC,FAPA
 SG_ ACU_iACC_StyleConfirmSwitchReq : 319|2@0+ (1,0) [0|3] ""  ADC,FAPA
 SG_ ACU_IFC_SpeedLimit : 327|8@0+ (1,0) [0|255] "km/h"  ADC,FAPA,IFC
 SG_ ACU_IFC_ISDRestOfdis : 335|8@0+ (1,0) [0|70] "km"  ADC,FAPA,IFC
 SG_ ACU_IFC_SpeedLimitUnit : 339|2@0+ (1,0) [0|3] ""  ADC,FAPA,IFC
 SG_ ACU_ThemeType : 337|1@0+ (1,0) [0|1] ""  ADC,FAPA,PCS
 SG_ ACU_IFC_SpeedLimtType : 351|4@0+ (1,0) [0|15] ""  ADC,FAPA,IFC
 SG_ ACU_IFC_RoadType : 347|4@0+ (1,0) [0|15] ""  ADC,FAPA,IFC
 SG_ ACU_IFC_ZoneCode : 359|3@0+ (1,0) [0|7] ""  ADC,FAPA,IFC
 SG_ ACU_IFC_NaviSt : 356|2@0+ (1,0) [0|3] ""  ADC,FAPA,IFC
 SG_ ACU_IFC_NaviCorp : 354|3@0+ (1,0) [0|7] ""  ADC,FAPA,IFC
 SG_ ACU_IFC_NaviNewIconDis : 367|5@0+ (0.1,0) [0|2] "km"  ADC,FAPA,IFC
 SG_ ACU_IFC_OfframpSt : 362|1@0+ (1,0) [0|1] ""  ADC,FAPA,IFC
 SG_ ACU_IFC_NaviNewIcon : 375|4@0+ (1,0) [0|15] ""  ADC,FAPA,IFC
 SG_ ACU_IFC_SLCAheadDis : 383|8@0+ (5,0) [0|1250] "m"  ADC,FAPA,IFC
 SG_ ACU_DVR_Switch : 398|1@0+ (1,0) [0|1] ""  ADC,FAPA
 SG_ ACU_IFC_OfframpDis : 455|8@0+ (10,0) [0|2000] "m"  ADC,FAPA,IFC

BO_ 475 CCU_IDC_4: 64 CCU
 SG_ ACU_MirrSteeringAdjFlag : 409|2@0+ (1,0) [0|3] ""  ADC,FAPA

BO_ 1045 CCU_IDC_6: 64 CCU
 SG_ ACU_Longitude : 31|28@0+ (0.000001,0) [0|180] "℃"  ADC,FAPA,IFC
 SG_ ACU_Latitude : 51|28@0+ (0.000001,0) [0|90] "℃"  ADC,FAPA,IFC
 SG_ ACU_CampingModeSt : 350|2@0+ (1,0) [0|3] ""  ZCUR,ADC

BO_ 163 CCU_IDC_11: 64 CCU
 SG_ ACU_PAAMode : 7|4@0+ (1,0) [0|15] ""  ADC,FAPA
 SG_ ACU_SVM_Button : 3|1@0+ (1,0) [0|1] ""  ADC,FAPA,PCS
 SG_ ACU_RAEBcfg : 2|2@0+ (1,0) [0|2] ""  ADC,FAPA
 SG_ ACU_PCS_MirrorpagedownButtonST : 0|1@0+ (1,0) [0|1] ""  ADC,FAPA,PCS
 SG_ ACU_PCS_ScreenTouchSt : 15|2@0+ (1,0) [0|3] ""  ADC,FAPA,PCS
 SG_ ACU_LanguageTypeSet : 13|6@0+ (1,0) [0|63] ""  ZCUL,ZCUR,ADC,FAPA,PCS
 SG_ ACU_PCS_SVM_FunctionCmd : 23|4@0+ (1,0) [0|15] ""  ADC,FAPA,PCS
 SG_ ACU_PCS_ScreenCoordY : 19|12@0+ (1,0) [0|1439] ""  ADC,FAPA,PCS
 SG_ ACU_PCS_ScreenCoordX : 39|12@0+ (1,0) [0|2559] ""  ADC,FAPA,PCS
 SG_ ACU_APAMessageSt : 43|3@0+ (1,0) [0|7] ""  ADC,FAPA
 SG_ ACU_PAS_ButtonPress : 40|1@0+ (1,0) [0|1] ""  ADC,FAPA,PAS
 SG_ ACU_HPAMessageSt : 55|3@0+ (1,0) [0|7] ""  ADC,FAPA
 SG_ ACU_AVPMessageSt : 52|3@0+ (1,0) [0|7] ""  ADC,FAPA
 SG_ ACU_HPALearningSetParkLot : 49|2@0+ (1,0) [0|3] ""  ADC,FAPA
 SG_ ACU_HPALearningProcessInfo : 63|5@0+ (1,0) [0|31] ""  ADC,FAPA
 SG_ ACU_SDEnterParkingLot : 58|2@0+ (1,0) [0|3] ""  ADC,FAPA
 SG_ ACU_PCS_ER_QuitConfirm : 56|1@0+ (1,0) [0|1] ""  ADC,FAPA,PCS
 SG_ ACU_DisplayReq : 71|2@0+ (1,0) [0|3] ""  ADC,FAPA
 SG_ ACU_ER_FuncCfg : 69|2@0+ (1,0) [0|3] ""  ADC,FAPA
 SG_ ACU_PCS_ER_EnterCmd : 67|1@0+ (1,0) [0|1] ""  ADC,FAPA,PCS
 SG_ ACU_PCS_ScreenTouchSignal : 66|2@0+ (1,0) [0|3] ""  ADC,FAPA,PCS
 SG_ ACU_PCSModeSt_A : 74|2@0+ (1,0) [0|2] ""  ADC,FAPA,PCS
 SG_ ACU_DPMessageSt : 79|3@0+ (1,0) [0|7] ""  ADC,FAPA
 SG_ ACU_ParkingBoxMidX : 87|12@0+ (1,0) [0|1919] ""  ADC,FAPA
 SG_ ACU_ParkingBoxMidY : 91|12@0+ (1,0) [0|1079] ""  ADC,FAPA
 SG_ ACU_ParkingBoxAngle : 111|12@0+ (0.1,-180) [-180|180] "°"  ADC,FAPA
 SG_ ACU_PCSModeSt : 115|1@0+ (1,0) [0|1] ""  ADC,FAPA,PCS
 SG_ ACU_LowPowerConfig : 114|3@0+ (1,0) [0|7] ""  ADC,FAPA
 SG_ ACU_NDAVoicePromptTypeCfg : 127|2@0+ (1,0) [0|3] ""  ADC,FAPA
 SG_ IDC_SenslesEtyParkingSwSt : 121|2@0+ (1,0) [0|3] ""  ADC,FAPA
 SG_ IDC_DskScreenOperationSt : 123|2@0+ (1,0) [0|3] ""  ADC,FAPA
 SG_ IDC_APAParkingSpdsSfg : 125|2@0+ (1,0) [0|3] ""  ADC,FAPA
 SG_ ACU_VR_APAControl : 131|4@0+ (1,0) [0|15] ""  ADC,FAPA,IFC
 SG_ ACU_SteeringPrkgButton : 135|4@0+ (1,0) [0|15] ""  ADC,FAPA
 SG_ IDC_SenslesEtyParkingDskScene : 143|3@0+ (1,0) [0|7] ""  ADC,FAPA
 SG_ ACU_SVM_Button_A : 343|3@0+ (1,0) [0|7] ""  ADC
 SG_ ACU_ActiveNDAMessageSt : 162|3@0+ (1,0) [0|4] ""  ADC,FAPA
 SG_ ACU_ActiveAVPMessageSt : 175|3@0+ (1,0) [0|4] ""  ADC,FAPA
 SG_ ACU_LeftLaneChangeMessageSt : 169|3@0+ (1,0) [0|4] ""  ADC,FAPA
 SG_ ACU_RigthLaneChangeMessageSt : 172|3@0+ (1,0) [0|4] ""  ADC,FAPA
 SG_ ACU_ICANDAIconMessageSt : 182|1@0+ (1,0) [0|1] ""  ADC,FAPA

BO_ 780 CCU_IDC_15: 64 CCU
 SG_ ACU_ISACountryID : 7|10@0+ (1,0) [0|1023] ""  ADC,FAPA
 SG_ ACU_ISARoadTyp : 13|4@0+ (1,0) [0|15] ""  ADC,FAPA
 SG_ ACU_ISARoadSpdLimit : 23|8@0+ (1,0) [0|255] ""  ADC,FAPA
 SG_ ACU_ISASpdLimitUnit : 9|2@0+ (1,0) [0|3] ""  ADC,FAPA
 SG_ ACU_ISASpdLimitTyp : 49|2@0+ (1,0) [0|3] ""  ADC,FAPA
 SG_ ACU_ISARampTyp : 77|2@0+ (1,0) [0|3] ""  ADC,FAPA
 SG_ ACU_ISARampDist : 31|10@0+ (1,0) [0|1023] "m"  ADC,FAPA
 SG_ ACU_ISAJunctDist : 37|10@0+ (1,0) [0|1023] ""  ADC,FAPA
 SG_ ACU_ISARDBDist : 43|10@0+ (1,0) [0|1023] ""  ADC,FAPA
 SG_ ACU_ISACondSpdLimit : 63|8@0+ (1,0) [0|255] ""  ADC,FAPA
 SG_ ACU_ISACondSpdLimitTyp : 71|4@0+ (1,0) [0|15] ""  ADC,FAPA
 SG_ ACU_ISACondSpdLimitVd : 79|2@0+ (1,0) [0|3] ""  ADC,FAPA
 SG_ ACU_ISASupplierInfo : 67|4@0+ (1,0) [0|15] ""  ADC,FAPA
 SG_ IDC_FuncReq_SentryModDetec : 72|1@0+ (1,0) [0|1] ""  ADC
 SG_ ACU_ISAServiceWorkSt : 75|3@0+ (1,0) [0|7] ""  ADC,FAPA
 SG_ IDC_SentryModeVideoReq : 87|2@0+ (1,0) [0|3] ""  ADC

BO_ 967 CCU_IDC_DMS_1: 64 CCU
 SG_ DMS_1_CRC : 7|16@0+ (1,0) [0|65535] ""  SRS,ADC,FAPA
 SG_ DMS_1_Counter : 23|8@0+ (1,0) [0|255] ""  SRS,ADC,FAPA
 SG_ DMS_SysErrSt : 31|3@0+ (1,0) [0|7] ""  ADC,FAPA,TBOX
 SG_ DMS_DrvrDetSts : 28|3@0+ (1,0) [0|7] ""  ADC,FAPA,TBOX
 SG_ DMS_InterestsRegion : 39|5@0+ (1,0) [0|31] ""  ADC,FAPA
 SG_ DMS_L3DriverDistractionSt : 33|6@0+ (1,0) [0|63] ""  ADC,FAPA,TBOX
 SG_ DMS_L3DriverFatigueSt : 43|12@0+ (1,0) [0|4095] ""  ADC,FAPA,TBOX
 SG_ DMS_FaceIDStatus : 60|2@0+ (1,0) [0|3] ""  ADC,FAPA,TBOX
 SG_ DMS_FaceID : 58|4@0+ (1,0) [0|15] ""  ADC,FAPA
 SG_ DMS_FaceIDVerifyResult : 68|2@0+ (1,0) [0|3] ""  ADC,FAPA,IFC
 SG_ DMS_LeftEyeOpenSt : 64|2@0+ (1,0) [0|3] ""  ADC,FAPA
 SG_ DMS_RightEyeOpenSt : 78|2@0+ (1,0) [0|3] ""  ADC,FAPA
 SG_ DMS_DriverSmokeSt : 74|2@0+ (1,0) [0|3] ""  ADC,FAPA,TBOX
 SG_ DMS_DriverTelephoneSt : 72|2@0+ (1,0) [0|3] ""  ADC,FAPA,TBOX
 SG_ DMS_DriverHealthSt : 86|3@0+ (1,0) [0|7] ""  ADC,FAPA,TBOX
 SG_ DMS_FatigWarnSt : 81|3@0+ (1,0) [0|7] ""  ADC,FAPA
 SG_ DMS_DistrWarnSt : 94|3@0+ (1,0) [0|7] ""  ADC,FAPA
 SG_ DMS_DriverExpressionSt : 268|4@0+ (1,0) [0|15] ""  ADC,FAPA
 SG_ DMS_YawnSt : 276|2@0+ (1,0) [0|3] ""  ADC,FAPA

BO_ 400 CCU_MFS_1: 32 CCU
 SG_ UINM_1_CRC : 7|16@0+ (1,0) [0|65535] ""  ADC,FAPA,VIU
 SG_ UINM_1_Counter : 23|8@0+ (1,0) [0|255] ""  ADC,FAPA,VIU
 SG_ UINM_DrvReqShft : 31|4@0+ (1,0) [0|15] ""  ADC,FAPA,VIU
 SG_ UINM_DrvReqShftInv : 27|4@0+ (1,0) [0|15] ""  ADC,FAPA,VIU
 SG_ UINM_FuSaErrSt : 39|1@0+ (1,0) [0|1] ""  ADC,FAPA,VIU
 SG_ UINM_ShftFault : 38|1@0+ (1,0) [0|1] ""  ADC,FAPA,VIU
 SG_ UINM_PositionLightSwSt : 37|2@0+ (1,0) [0|3] ""  ADC,FAPA,FLR,FRR,RLR,RRR,VIU
 SG_ UINM_LowBeamSwSt : 35|2@0+ (1,0) [0|3] ""  ADC,FAPA,FLR,FRR,RLR,RRR,VIU
 SG_ UINM_AutoLightSwSt : 33|2@0+ (1,0) [0|3] ""  ADC,FAPA,FLR,FRR,RLR,RRR,VIU
 SG_ UINM_FrontFogLightSwSt : 47|1@0+ (1,0) [0|1] ""  ADC,FAPA,FLR,FRR,RLR,RRR,VIU
 SG_ UINM_RearFogLightSwSt : 46|1@0+ (1,0) [0|1] ""  ADC,FAPA,FLR,FRR,RLR,RRR,VIU
 SG_ UINM_HighBeamSwSt : 45|2@0+ (1,0) [0|3] ""  ADC,FAPA,FLR,FRR,RLR,RRR,VIU
 SG_ UINM_TurnLightSwSt : 43|3@0+ (1,0) [0|7] ""  ADC,FAPA,FLR,FRR,RLR,RRR,VIU,PCS
 SG_ UINM_ButCtlMaskFlag : 40|1@0+ (1,0) [0|1] ""  ADC,FAPA,VIU
 SG_ UINM_FrontWiperSwSt : 55|3@0+ (1,0) [0|7] ""  ADC,FAPA,FLR,FRR,RLR,RRR,VIU
 SG_ UINM_FrontWiperIntAdjSwSt : 52|4@0+ (1,0) [0|15] ""  ADC,FAPA,FLR,FRR,RLR,RRR,VIU
 SG_ UINM_FrontWasherSwSt : 48|1@0+ (1,0) [0|1] ""  ADC,FAPA,FLR,FRR,RLR,RRR,VIU
 SG_ UINM_RearWiperSwSt : 63|3@0+ (1,0) [0|7] ""  ADC,FAPA,FLR,FRR,RLR,RRR,VIU
 SG_ UINM_RearWiperIntAdjSwSt : 60|4@0+ (1,0) [0|15] ""  ADC,FAPA,FLR,FRR,RLR,RRR,VIU
 SG_ UINM_RearWasherSwSt : 56|1@0+ (1,0) [0|1] ""  ADC,FAPA,FLR,FRR,RLR,RRR,VIU
 SG_ UINM_HeadLampWasherSwSt : 71|1@0+ (1,0) [0|1] ""  ADC,FAPA,FLR,FRR,RLR,RRR,VIU

CM_ SG_ 909 LCK_HoodAjarSt "HoodAjarSt";
CM_ SG_ 909 LCK_FrontLeftDoorAjarSt "FrontLeftDoorAjarSt";
CM_ SG_ 909 LCK_FrontRightDoorAjarSt "FrontRightDoorAjarSt";
CM_ SG_ 909 LCK_RearLeftDoorAjarSt "RearLeftDoorAjarSt";
CM_ SG_ 909 LCK_RearRightDoorAjarSt "RearRightDoorAjarSt";
CM_ SG_ 909 LCK_TrunkAjarSt "TrunkAjarSt";
CM_ SG_ 909 LCK_FrontLeftDoorLockSt "FrontLeftDoorLockSt";
CM_ SG_ 909 LCK_FrontRightDoorLockSt "FrontRightDoorLockSt";
CM_ SG_ 909 LCK_RearLeftDoorLockSt "RearLeftDoorLockSt";
CM_ SG_ 909 LCK_RearRightDoorLockSt "RearRightDoorLockSt";
CM_ SG_ 909 LCK_RearLeftChildSaftyLockSt "RearLeftChildSaftyLockSt";
CM_ SG_ 909 LCK_RearRightChildSaftyLockSt "RearRightChildSaftyLockSt";
CM_ SG_ 909 LCK_FrontLeftDoorHandlePosition "FrontLeftDoorHandlePosition";
CM_ SG_ 909 LCK_FrontRightDoorHandlePosition "FrontRightDoorHandlePosition";
CM_ SG_ 909 LCK_RearLeftDoorHandlePosition "RearLeftDoorHandlePosition";
CM_ SG_ 909 LCK_RearRightDoorHandlePosition "RearRightDoorHandlePosition";
CM_ SG_ 909 LCK_FillerCapASt "FillerCapASt";
CM_ SG_ 909 LCK_FillerCapBSt "FillerCapBSt";
CM_ SG_ 909 MR_LeftMirrorFoldUnfoldSt "Left Mirror Fold Unfold Status";
CM_ SG_ 909 SBM_SwapHvBattModeSt "Swap station mode statue";
CM_ SG_ 909 SBM_SwapStaDiagCode "Swap station erroe";
CM_ SG_ 909 SBM_SwapVehDiagCode "vehicl erroe in swap station";
CM_ SG_ 909 SBM_SwapHvBattModeFaultSt "Swap station mode fault statue";
CM_ SG_ 909 POD_CurDoorPosFL "The current position of power operation door";
CM_ SG_ 909 IPDS_HDMapPowerSt "HD map power state";
CM_ SG_ 909 IPDS_KL15L1PowerSt "KL15 L1 power state";
CM_ SG_ 909 IPDS_SRSECUPowerSt "SRS ECU power state";
CM_ SG_ 909 IPDS_HODPowerSt "HOD power state";
CM_ SG_ 909 KAE_BLEOption "BLEOption";
CM_ SG_ 909 KAE_UWBOption "UWB Option";
CM_ SG_ 909 WW_RWPMotorSt "RearWiper Motor status";
CM_ SG_ 909 ACEleclocksSt "AC gun electronic lock status feedback";
CM_ SG_ 909 WCM_Reminder "Reminder the Phone left";
CM_ SG_ 909 WCM_ChargingSt "Charging is ongoing or stopped";
CM_ SG_ 909 AVAS_ActivatedSt "AVAS activated status";
CM_ SG_ 909 PWL_WinCurrentPos_FLWinPst "Front Left Window Current Position";
CM_ SG_ 909 UINM_FrontLeftPowerReleaseReq "FrontLeftPowerReleaseReq";
CM_ SG_ 909 UINM_FrontLeftPowerReleaseFaultSt "Front Left Power Release Swtich fault state";
CM_ SG_ 909 UINM_FrontRightPowerReleaseReq "FrontRightPowerReleaseReq";
CM_ SG_ 909 UINM_FrontRightPowerReleaseFaultSt "Front Right Power Release Swtich fault state";
CM_ SG_ 909 UINM_RearLeftPowerReleaseFaultSt "RearLeftPowerReleaseReq";
CM_ SG_ 909 UINM_RearLeftPowerReleaseReq "RearLeftPowerReleaseReq";
CM_ SG_ 909 UINM_RearRightPowerReleaseFaultSt "RearRightPowerReleaseReq";
CM_ SG_ 909 UINM_RearRightPowerReleaseReq "RearRightPowerReleaseReq";
CM_ SG_ 909 PWL_WinCurrentPos_RRWinPst "Rear Right Window Current Position";
CM_ SG_ 909 PWL_WinCurrentPos_RLWinPst "Rear Left Window Current Position";
CM_ SG_ 334 CSM_RC_ViewExtvideo "View Exterior-car video remotely (远程查看车外视频)";
CM_ SG_ 334 CSM_RC_ViewExtvideoReq "View Exterior-car video remotely Request (远程查看车外视频请求信号)";
CM_ SG_ 334 Theft_Auth_Status "Anti-theft authentication result";
CM_ SG_ 290 IPDS_Lidar1PowerSup "Lidar1 power supply";
CM_ SG_ 905 ICM_SetIACCSt "ICM set IACC status";
CM_ SG_ 905 ICM_TotalOdometer "Total odometer";
CM_ SG_ 905 ICM_VehInsSpd "Vehicle instantaneous speed";
CM_ SG_ 905 ICM_VehInsSpd_accurate "Vehicle instantaneous speed";
CM_ SG_ 905 ICM_FuelAvaibleDriveDistance "The available driving distance according to the fuel";
CM_ SG_ 905 ICM_TotalAvaibleDriveDistance "The available driving distance according to the total";
CM_ SG_ 161 ACU_FaceID_Delete "Delete_FaceID";
CM_ SG_ 161 ACU_RegisterTriger "FaceID register triger";
CM_ SG_ 161 ACU_VerifyTriger "FaceID verify triger";
CM_ SG_ 161 ACU_FaceIDQuit "FaceID quit triger";
CM_ SG_ 161 ACU_FaceIDSwitch "FaceID switch triger";
CM_ SG_ 161 ACU_AVAS_SwitchCfgReq "AVAS switch configuration require";
CM_ SG_ 351 ACU_VirtualPowerOFFReq "Virtual Power OFF Request";
CM_ SG_ 351 ACU_FactoryResetReq "CDC Factory Reset Request";
CM_ SG_ 351 ACU_Account_Uld "Account_Uid";
CM_ SG_ 351 ACU_Account_Delete "Account Delete";
CM_ SG_ 351 ACU_FrontWiperIntCfgVkReq "Front wiper interval Softkey status";
CM_ SG_ 351 ACU_FrontWiperAutoCfgVkReq "Front wiper RLS  sensitivity status";
CM_ SG_ 351 IDC_VoicePAAReq "Voice Park Request from IDC";
CM_ SG_ 351 IDC_VoiceParkCheckReq "Voice Park Check Request from IDC";
CM_ SG_ 879 ACU_PCS_SVM_MODCmd "Panorama function setting option MOD function switch";
CM_ SG_ 879 ACU_HeadLightVirtualSwSt "HeadLight virtual switch status";
CM_ SG_ 879 ACU_FrontFogLightVirtualSwSt "Front fog light virtual switch status";
CM_ SG_ 879 ACU_RearFogLightVirtualSwSt "Rear fog light virtual switch status";
CM_ SG_ 879 IDC_HPAParkingSpdsSw "HPA Parking speed configuration";
CM_ SG_ 879 ACU_Account_Uid "Account_Uid";
CM_ SG_ 879 ACU_FCWWarnDistanceCfg "Configurates FCW(Front Collision Warning) warning distance";
CM_ SG_ 879 ACU_FCWCfg "Configurates FCW (front collision warning assist)";
CM_ SG_ 879 ACU_AEBOff "AEB is turned off";
CM_ SG_ 879 ACU_TSR_SwitchReq "TSR(Traffic Sign Recognition) switch signal";
CM_ SG_ 879 ACU_IHBC_SwitchReq "IHBC(Intelligent High Beam Control) switch signal";
CM_ SG_ 879 ACU_LDS_TypeReq "LDS lane aid type request";
CM_ SG_ 879 ACU_BSDCfg "Configurates BSD Switch Signal";
CM_ SG_ 879 ACU_RCTACfg "Configurates RCTA Switch Signal";
CM_ SG_ 879 ACU_DOWCfg "Configurates DOW Switch Signal";
CM_ SG_ 879 ACU_TSR_AudioWarnReq "TSR(Traffic Sign Recognition) audio warning on off signal";
CM_ SG_ 879 ACU_HWAHFCfg "HWAHF on/off request";
CM_ SG_ 879 ACU_HWAHF_AudioWarningTypeCfg "HWAHF audio warning type request";
CM_ SG_ 879 ACU_HWA_SwitchReq "HWA(High Way Assist)  on/off switch";
CM_ SG_ 879 ACU_ELKCfg "Configurates ELKA function";
CM_ SG_ 879 ACU_FCTACfg "Configurates FCTA function";
CM_ SG_ 879 ACU_RAWCfg "Configurates RAW function";
CM_ SG_ 879 ACU_RCTA_TypeReqCfg "RCTA assist type request";
CM_ SG_ 879 ACU_FCTA_TypeReqCfg "FCTA assist type request";
CM_ SG_ 879 ACU_NDASwitchReq "NDA main switch request";
CM_ SG_ 879 ACU_NDALCConSwitchReq "NDA lane change driver confirm switch request";
CM_ SG_ 879 ACU_NDALCStySwitchReq "NDA lane change style switch request";
CM_ SG_ 879 ACU_ADASWarnTypeSwitch "ADAS warning type switch signal";
CM_ SG_ 879 ACU_ESACfg "Configurates ESA function";
CM_ SG_ 879 ACU_ILCCfg "Configurates ILC function";
CM_ SG_ 879 ACU_AESCfg "Configurates AES function";
CM_ SG_ 879 ACU_ILOACfg "Configurates ILOA function";
CM_ SG_ 879 ACU_iACC_StyleConfirmSwitchReq "iACC Style confirm switch";
CM_ SG_ 879 ACU_IFC_SpeedLimit "Speed limit value from navigation map dataand GPS location.";
CM_ SG_ 879 ACU_IFC_ISDRestOfdis "Interval speed detection rest of distacne.Once navigation jduge vehicle run in aninterval speed detection area of road, thissignal begin to send specific value,otherwise keep sending 0x0.";
CM_ SG_ 879 ACU_IFC_SpeedLimitUnit "Speed limit unit ";
CM_ SG_ 879 ACU_ThemeType "AVNT theme type";
CM_ SG_ 879 ACU_IFC_SpeedLimtType "speed limit type from navigation map dataand GPS location.";
CM_ SG_ 879 ACU_IFC_RoadType "Road type from navigation map data andGPS location.";
CM_ SG_ 879 ACU_IFC_ZoneCode "Zone code ";
CM_ SG_ 879 ACU_IFC_NaviSt "Navigation state ";
CM_ SG_ 879 ACU_IFC_NaviCorp "the working navigation map corporation ";
CM_ SG_ 879 ACU_IFC_NaviNewIconDis "the remain distances of navigation newIcon ";
CM_ SG_ 879 ACU_IFC_OfframpSt "The front is off-ramp or not whennavigation";
CM_ SG_ 879 ACU_IFC_NaviNewIcon "indication the navigation newIcon ";
CM_ SG_ 879 ACU_IFC_SLCAheadDis "speed limit camera ahead distacne. Oncenavigation jduge there is a speed limitcamera ahead that the vehicle will pass by,this signal begin to send specific value,otherwise keep sending 0x0.";
CM_ SG_ 879 ACU_DVR_Switch "DVR Function Switch";
CM_ SG_ 879 ACU_IFC_OfframpDis "The distance to front off-ramp ";
CM_ SG_ 475 ACU_MirrSteeringAdjFlag "ACU Mirror Steering wheel adjust active statue";
CM_ SG_ 1045 ACU_Longitude "Longitude";
CM_ SG_ 1045 ACU_Latitude "Latitude";
CM_ SG_ 1045 ACU_CampingModeSt "The state of camping mode";
CM_ SG_ 163 ACU_PAAMode "The Mode of PAA? which ACU request for";
CM_ SG_ 163 ACU_SVM_Button "SVM button press status";
CM_ SG_ 163 ACU_RAEBcfg "RAEB Configuration";
CM_ SG_ 163 ACU_PCS_MirrorpagedownButtonST "Mirror Pagedown Button Status";
CM_ SG_ 163 ACU_PCS_ScreenTouchSt "ACU screen touch status";
CM_ SG_ 163 ACU_LanguageTypeSet "language type set";
CM_ SG_ 163 ACU_PCS_ScreenCoordY "Screen touched in ER coordinate Y";
CM_ SG_ 163 ACU_PCS_ScreenCoordX "Screen touched in ER coordinate X";
CM_ SG_ 163 ACU_APAMessageSt "The State of APA Message";
CM_ SG_ 163 ACU_PAS_ButtonPress "PAS button press state";
CM_ SG_ 163 ACU_HPAMessageSt "The State of HPA Message";
CM_ SG_ 163 ACU_AVPMessageSt "The State of AVP Message";
CM_ SG_ 163 ACU_HPALearningSetParkLot "User set HAVP parkLot type";
CM_ SG_ 163 ACU_HPALearningProcessInfo "AVP controller will send this singnal to show indications through HU to driver during learning process";
CM_ SG_ 163 ACU_SDEnterParkingLot "The vehicle enter parking lot";
CM_ SG_ 163 ACU_PCS_ER_QuitConfirm "Event record quit confirm ";
CM_ SG_ 163 ACU_ER_FuncCfg "Event record funtion configuration";
CM_ SG_ 163 ACU_PCS_ER_EnterCmd "Event record enter command";
CM_ SG_ 163 ACU_PCS_ScreenTouchSignal "ACU screen touch status";
CM_ SG_ 163 ACU_PCSModeSt_A "The mode of the host request panorama display";
CM_ SG_ 163 ACU_DPMessageSt "The State of DP Message";
CM_ SG_ 163 ACU_ParkingBoxMidX "X coordinate pixel value of  parking space frame handle";
CM_ SG_ 163 ACU_ParkingBoxMidY "Y coordinate pixel value of  parking space frame handle";
CM_ SG_ 163 ACU_ParkingBoxAngle "Angle of parking space frame";
CM_ SG_ 163 ACU_PCSModeSt "The mode of the host request panorama display";
CM_ SG_ 163 ACU_LowPowerConfig "ACU_LowPowerMode Config";
CM_ SG_ 163 ACU_NDAVoicePromptTypeCfg "NDA Voice mode switch";
CM_ SG_ 163 IDC_SenslesEtyParkingSwSt "Senseless entry parking switch";
CM_ SG_ 163 IDC_DskScreenOperationSt "Screen Touch status";
CM_ SG_ 163 IDC_APAParkingSpdsSfg "APA Parking speed configuration";
CM_ SG_ 163 ACU_VR_APAControl "Parking voice wake up";
CM_ SG_ 163 ACU_SteeringPrkgButton "Steering Parking Button";
CM_ SG_ 163 IDC_SenslesEtyParkingDskScene "Senseless entry parking desktop  scene";
CM_ SG_ 163 ACU_SVM_Button_A "SVM button press status";
CM_ SG_ 163 ACU_ActiveNDAMessageSt "“recommend switch to NDA” card state";
CM_ SG_ 163 ACU_ActiveAVPMessageSt "\"recommend switch to AVP\" card state";
CM_ SG_ 163 ACU_LeftLaneChangeMessageSt "\"recommed LeftLane Change\" card state";
CM_ SG_ 163 ACU_RigthLaneChangeMessageSt "\"recommed RighLane Change\" card state";
CM_ SG_ 163 ACU_ICANDAIconMessageSt "driver click ICON button state";
CM_ SG_ 780 ACU_ISACountryID "country ID refer to ISO 3166-1";
CM_ SG_ 780 ACU_ISARoadTyp "indicate the road type";
CM_ SG_ 780 ACU_ISARoadSpdLimit "road speed limit value";
CM_ SG_ 780 ACU_ISASpdLimitUnit "road speed limit unit";
CM_ SG_ 780 ACU_ISASpdLimitTyp "speed limit type";
CM_ SG_ 780 ACU_ISARampTyp "indicate the  front nearest ramp type within 1km";
CM_ SG_ 780 ACU_ISARampDist "indicate the  front nearest ramp distance within 1km";
CM_ SG_ 780 ACU_ISAJunctDist "indicate the  front nearest junction distance within 1km";
CM_ SG_ 780 ACU_ISARDBDist "indicate the  front nearest roundabout distance within 1km";
CM_ SG_ 780 ACU_ISACondSpdLimit "condition speed limit value";
CM_ SG_ 780 ACU_ISACondSpdLimitTyp "indicate the condition speed limit type";
CM_ SG_ 780 ACU_ISACondSpdLimitVd "condition speed limit validity";
CM_ SG_ 780 ACU_ISASupplierInfo "ISA supplier information";
CM_ SG_ 780 IDC_FuncReq_SentryModDetec "Sentry?Mode?Keep?HV";
CM_ SG_ 780 ACU_ISAServiceWorkSt "indicate the work status of the map service";
CM_ SG_ 780 IDC_SentryModeVideoReq "Video Stream Request";
CM_ SG_ 967 DMS_1_CRC "E2E Profile 5 CRC";
CM_ SG_ 967 DMS_1_Counter "E2E Profile 5 Counter";
CM_ SG_ 967 DMS_SysErrSt "Driver monitoring system error status";
CM_ SG_ 967 DMS_DrvrDetSts "States whether the driver facing camera has detected the presence of a driver.";
CM_ SG_ 967 DMS_InterestsRegion "region of interests";
CM_ SG_ 967 DMS_L3DriverDistractionSt "driver distraction state for L3";
CM_ SG_ 967 DMS_L3DriverFatigueSt "driver fatigue state for L3";
CM_ SG_ 967 DMS_FaceIDStatus "Indication FaceID Status";
CM_ SG_ 967 DMS_FaceID "FaceID";
CM_ SG_ 967 DMS_FaceIDVerifyResult "Indication FaceID_Verify_result";
CM_ SG_ 967 DMS_LeftEyeOpenSt "Indication Driver's Left Eye Open Status";
CM_ SG_ 967 DMS_RightEyeOpenSt "Indication Driver's Right Eye Open Status";
CM_ SG_ 967 DMS_DriverSmokeSt "Indication_DriverSmokeSt";
CM_ SG_ 967 DMS_DriverTelephoneSt "Indication_DriverTelephoneSt";
CM_ SG_ 967 DMS_DriverHealthSt "Indication_DriverHealthSt";
CM_ SG_ 967 DMS_FatigWarnSt "Indicates the fatigue level of the driver";
CM_ SG_ 967 DMS_DistrWarnSt "Provides the driver distraction determined by thedriver facing camera";
CM_ SG_ 967 DMS_DriverExpressionSt "Driver Expression status";
CM_ SG_ 967 DMS_YawnSt "Indication Driver's mouth Status";
CM_ SG_ 400 UINM_1_CRC "E2E Profile 5 CRC";
CM_ SG_ 400 UINM_1_Counter "E2E Profile 5 Counter";
CM_ SG_ 400 UINM_DrvReqShft "Driver requested gear shift position";
CM_ SG_ 400 UINM_DrvReqShftInv "Driver requested gear shift position inverse";
CM_ SG_ 400 UINM_FuSaErrSt "function safety Error status";
CM_ SG_ 400 UINM_ShftFault "this signal indicate E-shift fault which represent E-shift can not reflect the real driver demand because of any reason.";
CM_ SG_ 400 UINM_PositionLightSwSt "Position light switch state";
CM_ SG_ 400 UINM_LowBeamSwSt "Low beam switch state";
CM_ SG_ 400 UINM_AutoLightSwSt "Auto light switch state";
CM_ SG_ 400 UINM_FrontFogLightSwSt "Front fog light switch state";
CM_ SG_ 400 UINM_RearFogLightSwSt "Rear fog light switch state";
CM_ SG_ 400 UINM_HighBeamSwSt "High beam switch state";
CM_ SG_ 400 UINM_TurnLightSwSt "Turn light switch state";
CM_ SG_ 400 UINM_ButCtlMaskFlag "Button control Mask Flag";
CM_ SG_ 400 UINM_FrontWiperSwSt "Front wiper interval switch status";
CM_ SG_ 400 UINM_FrontWiperIntAdjSwSt "Front wiper interval switch state";
CM_ SG_ 400 UINM_FrontWasherSwSt "Front Washer switch status ";
CM_ SG_ 400 UINM_RearWiperSwSt "Rear Wiper Switch Status";
CM_ SG_ 400 UINM_RearWiperIntAdjSwSt "RearWiperIntAdjSwSt ";
CM_ SG_ 400 UINM_RearWasherSwSt "Front Washer switch status ";
CM_ SG_ 400 UINM_HeadLampWasherSwSt "HeadLamp Washer switch status";

BA_DEF_ BO_  "GenMsgCycleTime" INT 0 0;
BA_DEF_ BO_  "GenMsgCycleTimeFast" INT 0 0;
BA_DEF_ BO_  "GenMsgSendType" ENUM  "Periodic","Event","IfActive","POE","PA","FixedPeriodic","Event","EnabledPeriodic","NotUsed","NotUsed","EventPeriodic","NotUsed","NotUsed","NoMsgSendType";
BA_DEF_ BO_  "VFrameFormat" ENUM  "StandardCAN","ExtendedCAN","reserved","reserved","reserved","reserved","reserved","reserved","reserved","reserved","reserved","reserved","reserved","reserved","StandardCAN_FD","ExtendedCAN_FD";
BA_DEF_ BO_  "CANFD_BRS" ENUM  "0","1";
BA_DEF_ SG_  "EventCommandSignal" ENUM  "No","Yes";
BA_DEF_ SG_  "GatewayedSignals" ENUM  "No","Yes";
BA_DEF_ SG_  "GenSigInactiveValue" HEX 0 0;
BA_DEF_ SG_  "GenSigInvalidValue" HEX 0 0;
BA_DEF_ SG_  "GenSigSendType" ENUM  "Trigger","Passive","Cyclic","OnWrite","OnWriteWithRepetition","OnChange","OnChangeWithRepetition","IfActive","IfActiveWithRepetition","NoSigSendType";
BA_DEF_ SG_  "GenSigStartValue" HEX 0 0;
BA_DEF_ SG_  "GenSigTimeoutValue" HEX 0 0;
BA_DEF_ SG_  "Remark" STRING ;
BA_ "GenMsgCycleTime" BO_ 909 100;
BA_ "GenMsgCycleTimeFast" BO_ 909 0;
BA_ "GenMsgSendType" BO_ 909 0;
BA_ "VFrameFormat" BO_ 909 14;
BA_ "CANFD_BRS" BO_ 909 1;
BA_ "GenMsgCycleTime" BO_ 909 100;
BA_ "GenMsgCycleTimeFast" BO_ 909 0;
BA_ "GenMsgSendType" BO_ 909 0;
BA_ "VFrameFormat" BO_ 909 14;
BA_ "CANFD_BRS" BO_ 909 1;
BA_ "GenMsgCycleTime" BO_ 909 100;
BA_ "GenMsgCycleTimeFast" BO_ 909 0;
BA_ "GenMsgSendType" BO_ 909 0;
BA_ "VFrameFormat" BO_ 909 14;
BA_ "CANFD_BRS" BO_ 909 1;
BA_ "GenMsgCycleTime" BO_ 909 100;
BA_ "GenMsgCycleTimeFast" BO_ 909 0;
BA_ "GenMsgSendType" BO_ 909 0;
BA_ "VFrameFormat" BO_ 909 14;
BA_ "CANFD_BRS" BO_ 909 1;
BA_ "GenMsgCycleTime" BO_ 909 100;
BA_ "GenMsgCycleTimeFast" BO_ 909 0;
BA_ "GenMsgSendType" BO_ 909 0;
BA_ "VFrameFormat" BO_ 909 14;
BA_ "CANFD_BRS" BO_ 909 1;
BA_ "GenMsgCycleTime" BO_ 909 100;
BA_ "GenMsgCycleTimeFast" BO_ 909 0;
BA_ "GenMsgSendType" BO_ 909 0;
BA_ "VFrameFormat" BO_ 909 14;
BA_ "CANFD_BRS" BO_ 909 1;
BA_ "GenMsgCycleTime" BO_ 909 100;
BA_ "GenMsgCycleTimeFast" BO_ 909 0;
BA_ "GenMsgSendType" BO_ 909 0;
BA_ "VFrameFormat" BO_ 909 14;
BA_ "CANFD_BRS" BO_ 909 1;
BA_ "GenMsgCycleTime" BO_ 909 100;
BA_ "GenMsgCycleTimeFast" BO_ 909 0;
BA_ "GenMsgSendType" BO_ 909 0;
BA_ "VFrameFormat" BO_ 909 14;
BA_ "CANFD_BRS" BO_ 909 1;
BA_ "GenMsgCycleTime" BO_ 909 100;
BA_ "GenMsgCycleTimeFast" BO_ 909 0;
BA_ "GenMsgSendType" BO_ 909 0;
BA_ "VFrameFormat" BO_ 909 14;
BA_ "CANFD_BRS" BO_ 909 1;
BA_ "GenMsgCycleTime" BO_ 909 100;
BA_ "GenMsgCycleTimeFast" BO_ 909 0;
BA_ "GenMsgSendType" BO_ 909 0;
BA_ "VFrameFormat" BO_ 909 14;
BA_ "CANFD_BRS" BO_ 909 1;
BA_ "GenMsgCycleTime" BO_ 909 100;
BA_ "GenMsgCycleTimeFast" BO_ 909 0;
BA_ "GenMsgSendType" BO_ 909 0;
BA_ "VFrameFormat" BO_ 909 14;
BA_ "CANFD_BRS" BO_ 909 1;
BA_ "GenMsgCycleTime" BO_ 909 100;
BA_ "GenMsgCycleTimeFast" BO_ 909 0;
BA_ "GenMsgSendType" BO_ 909 0;
BA_ "VFrameFormat" BO_ 909 14;
BA_ "CANFD_BRS" BO_ 909 1;
BA_ "GenMsgCycleTime" BO_ 909 100;
BA_ "GenMsgCycleTimeFast" BO_ 909 0;
BA_ "GenMsgSendType" BO_ 909 0;
BA_ "VFrameFormat" BO_ 909 14;
BA_ "CANFD_BRS" BO_ 909 1;
BA_ "GenMsgCycleTime" BO_ 909 100;
BA_ "GenMsgCycleTimeFast" BO_ 909 0;
BA_ "GenMsgSendType" BO_ 909 0;
BA_ "VFrameFormat" BO_ 909 14;
BA_ "CANFD_BRS" BO_ 909 1;
BA_ "GenMsgCycleTime" BO_ 909 100;
BA_ "GenMsgCycleTimeFast" BO_ 909 0;
BA_ "GenMsgSendType" BO_ 909 0;
BA_ "VFrameFormat" BO_ 909 14;
BA_ "CANFD_BRS" BO_ 909 1;
BA_ "GenMsgCycleTime" BO_ 909 100;
BA_ "GenMsgCycleTimeFast" BO_ 909 0;
BA_ "GenMsgSendType" BO_ 909 0;
BA_ "VFrameFormat" BO_ 909 14;
BA_ "CANFD_BRS" BO_ 909 1;
BA_ "GenMsgCycleTime" BO_ 909 100;
BA_ "GenMsgCycleTimeFast" BO_ 909 0;
BA_ "GenMsgSendType" BO_ 909 0;
BA_ "VFrameFormat" BO_ 909 14;
BA_ "CANFD_BRS" BO_ 909 1;
BA_ "GenMsgCycleTime" BO_ 909 100;
BA_ "GenMsgCycleTimeFast" BO_ 909 0;
BA_ "GenMsgSendType" BO_ 909 0;
BA_ "VFrameFormat" BO_ 909 14;
BA_ "CANFD_BRS" BO_ 909 1;
BA_ "GenMsgCycleTime" BO_ 909 100;
BA_ "GenMsgCycleTimeFast" BO_ 909 0;
BA_ "GenMsgSendType" BO_ 909 0;
BA_ "VFrameFormat" BO_ 909 14;
BA_ "CANFD_BRS" BO_ 909 1;
BA_ "GenMsgCycleTime" BO_ 909 100;
BA_ "GenMsgCycleTimeFast" BO_ 909 0;
BA_ "GenMsgSendType" BO_ 909 0;
BA_ "VFrameFormat" BO_ 909 14;
BA_ "CANFD_BRS" BO_ 909 1;
BA_ "GenMsgCycleTime" BO_ 909 100;
BA_ "GenMsgCycleTimeFast" BO_ 909 0;
BA_ "GenMsgSendType" BO_ 909 0;
BA_ "VFrameFormat" BO_ 909 14;
BA_ "CANFD_BRS" BO_ 909 1;
BA_ "GenMsgCycleTime" BO_ 909 100;
BA_ "GenMsgCycleTimeFast" BO_ 909 0;
BA_ "GenMsgSendType" BO_ 909 0;
BA_ "VFrameFormat" BO_ 909 14;
BA_ "CANFD_BRS" BO_ 909 1;
BA_ "GenMsgCycleTime" BO_ 909 100;
BA_ "GenMsgCycleTimeFast" BO_ 909 0;
BA_ "GenMsgSendType" BO_ 909 0;
BA_ "VFrameFormat" BO_ 909 14;
BA_ "CANFD_BRS" BO_ 909 1;
BA_ "GenMsgCycleTime" BO_ 909 100;
BA_ "GenMsgCycleTimeFast" BO_ 909 0;
BA_ "GenMsgSendType" BO_ 909 0;
BA_ "VFrameFormat" BO_ 909 14;
BA_ "CANFD_BRS" BO_ 909 1;
BA_ "GenMsgCycleTime" BO_ 909 100;
BA_ "GenMsgCycleTimeFast" BO_ 909 0;
BA_ "GenMsgSendType" BO_ 909 0;
BA_ "VFrameFormat" BO_ 909 14;
BA_ "CANFD_BRS" BO_ 909 1;
BA_ "GenMsgCycleTime" BO_ 909 100;
BA_ "GenMsgCycleTimeFast" BO_ 909 0;
BA_ "GenMsgSendType" BO_ 909 0;
BA_ "VFrameFormat" BO_ 909 14;
BA_ "CANFD_BRS" BO_ 909 1;
BA_ "GenMsgCycleTime" BO_ 909 100;
BA_ "GenMsgCycleTimeFast" BO_ 909 0;
BA_ "GenMsgSendType" BO_ 909 0;
BA_ "VFrameFormat" BO_ 909 14;
BA_ "CANFD_BRS" BO_ 909 1;
BA_ "GenMsgCycleTime" BO_ 909 100;
BA_ "GenMsgCycleTimeFast" BO_ 909 0;
BA_ "GenMsgSendType" BO_ 909 0;
BA_ "VFrameFormat" BO_ 909 14;
BA_ "CANFD_BRS" BO_ 909 1;
BA_ "GenMsgCycleTime" BO_ 909 100;
BA_ "GenMsgCycleTimeFast" BO_ 909 0;
BA_ "GenMsgSendType" BO_ 909 0;
BA_ "VFrameFormat" BO_ 909 14;
BA_ "CANFD_BRS" BO_ 909 1;
BA_ "GenMsgCycleTime" BO_ 909 100;
BA_ "GenMsgCycleTimeFast" BO_ 909 0;
BA_ "GenMsgSendType" BO_ 909 0;
BA_ "VFrameFormat" BO_ 909 14;
BA_ "CANFD_BRS" BO_ 909 1;
BA_ "GenMsgCycleTime" BO_ 909 100;
BA_ "GenMsgCycleTimeFast" BO_ 909 0;
BA_ "GenMsgSendType" BO_ 909 0;
BA_ "VFrameFormat" BO_ 909 14;
BA_ "CANFD_BRS" BO_ 909 1;
BA_ "GenMsgCycleTime" BO_ 909 100;
BA_ "GenMsgCycleTimeFast" BO_ 909 0;
BA_ "GenMsgSendType" BO_ 909 0;
BA_ "VFrameFormat" BO_ 909 14;
BA_ "CANFD_BRS" BO_ 909 1;
BA_ "GenMsgCycleTime" BO_ 909 100;
BA_ "GenMsgCycleTimeFast" BO_ 909 0;
BA_ "GenMsgSendType" BO_ 909 0;
BA_ "VFrameFormat" BO_ 909 14;
BA_ "CANFD_BRS" BO_ 909 1;
BA_ "GenMsgCycleTime" BO_ 909 100;
BA_ "GenMsgCycleTimeFast" BO_ 909 0;
BA_ "GenMsgSendType" BO_ 909 0;
BA_ "VFrameFormat" BO_ 909 14;
BA_ "CANFD_BRS" BO_ 909 1;
BA_ "GenMsgCycleTime" BO_ 909 100;
BA_ "GenMsgCycleTimeFast" BO_ 909 0;
BA_ "GenMsgSendType" BO_ 909 0;
BA_ "VFrameFormat" BO_ 909 14;
BA_ "CANFD_BRS" BO_ 909 1;
BA_ "GenMsgCycleTime" BO_ 909 100;
BA_ "GenMsgCycleTimeFast" BO_ 909 0;
BA_ "GenMsgSendType" BO_ 909 0;
BA_ "VFrameFormat" BO_ 909 14;
BA_ "CANFD_BRS" BO_ 909 1;
BA_ "GenMsgCycleTime" BO_ 909 100;
BA_ "GenMsgCycleTimeFast" BO_ 909 0;
BA_ "GenMsgSendType" BO_ 909 0;
BA_ "VFrameFormat" BO_ 909 14;
BA_ "CANFD_BRS" BO_ 909 1;
BA_ "GenMsgCycleTime" BO_ 909 100;
BA_ "GenMsgCycleTimeFast" BO_ 909 0;
BA_ "GenMsgSendType" BO_ 909 0;
BA_ "VFrameFormat" BO_ 909 14;
BA_ "CANFD_BRS" BO_ 909 1;
BA_ "GenMsgCycleTime" BO_ 909 100;
BA_ "GenMsgCycleTimeFast" BO_ 909 0;
BA_ "GenMsgSendType" BO_ 909 0;
BA_ "VFrameFormat" BO_ 909 14;
BA_ "CANFD_BRS" BO_ 909 1;
BA_ "GenMsgCycleTime" BO_ 909 100;
BA_ "GenMsgCycleTimeFast" BO_ 909 0;
BA_ "GenMsgSendType" BO_ 909 0;
BA_ "VFrameFormat" BO_ 909 14;
BA_ "CANFD_BRS" BO_ 909 1;
BA_ "GenMsgCycleTime" BO_ 909 100;
BA_ "GenMsgCycleTimeFast" BO_ 909 0;
BA_ "GenMsgSendType" BO_ 909 0;
BA_ "VFrameFormat" BO_ 909 14;
BA_ "CANFD_BRS" BO_ 909 1;
BA_ "GenMsgCycleTime" BO_ 909 100;
BA_ "GenMsgCycleTimeFast" BO_ 909 0;
BA_ "GenMsgSendType" BO_ 909 0;
BA_ "VFrameFormat" BO_ 909 14;
BA_ "CANFD_BRS" BO_ 909 1;
BA_ "GenMsgCycleTime" BO_ 909 100;
BA_ "GenMsgCycleTimeFast" BO_ 909 0;
BA_ "GenMsgSendType" BO_ 909 0;
BA_ "VFrameFormat" BO_ 909 14;
BA_ "CANFD_BRS" BO_ 909 1;
BA_ "GenMsgCycleTime" BO_ 909 100;
BA_ "GenMsgCycleTimeFast" BO_ 909 0;
BA_ "GenMsgSendType" BO_ 909 0;
BA_ "VFrameFormat" BO_ 909 14;
BA_ "CANFD_BRS" BO_ 909 1;
BA_ "GenMsgCycleTime" BO_ 909 100;
BA_ "GenMsgCycleTimeFast" BO_ 909 0;
BA_ "GenMsgSendType" BO_ 909 0;
BA_ "VFrameFormat" BO_ 909 14;
BA_ "CANFD_BRS" BO_ 909 1;
BA_ "GenMsgCycleTime" BO_ 909 100;
BA_ "GenMsgCycleTimeFast" BO_ 909 0;
BA_ "GenMsgSendType" BO_ 909 0;
BA_ "VFrameFormat" BO_ 909 14;
BA_ "CANFD_BRS" BO_ 909 1;
BA_ "GenMsgCycleTime" BO_ 334 500;
BA_ "GenMsgCycleTimeFast" BO_ 334 40;
BA_ "GenMsgSendType" BO_ 334 3;
BA_ "VFrameFormat" BO_ 334 14;
BA_ "CANFD_BRS" BO_ 334 1;
BA_ "GenMsgCycleTime" BO_ 334 500;
BA_ "GenMsgCycleTimeFast" BO_ 334 40;
BA_ "GenMsgSendType" BO_ 334 3;
BA_ "VFrameFormat" BO_ 334 14;
BA_ "CANFD_BRS" BO_ 334 1;
BA_ "GenMsgCycleTime" BO_ 334 500;
BA_ "GenMsgCycleTimeFast" BO_ 334 40;
BA_ "GenMsgSendType" BO_ 334 3;
BA_ "VFrameFormat" BO_ 334 14;
BA_ "CANFD_BRS" BO_ 334 1;
BA_ "GenMsgCycleTime" BO_ 290 500;
BA_ "GenMsgCycleTimeFast" BO_ 290 40;
BA_ "GenMsgSendType" BO_ 290 3;
BA_ "VFrameFormat" BO_ 290 14;
BA_ "CANFD_BRS" BO_ 290 1;
BA_ "GenMsgCycleTime" BO_ 905 100;
BA_ "GenMsgCycleTimeFast" BO_ 905 0;
BA_ "GenMsgSendType" BO_ 905 0;
BA_ "VFrameFormat" BO_ 905 14;
BA_ "CANFD_BRS" BO_ 905 1;
BA_ "GenMsgCycleTime" BO_ 905 100;
BA_ "GenMsgCycleTimeFast" BO_ 905 0;
BA_ "GenMsgSendType" BO_ 905 0;
BA_ "VFrameFormat" BO_ 905 14;
BA_ "CANFD_BRS" BO_ 905 1;
BA_ "GenMsgCycleTime" BO_ 905 100;
BA_ "GenMsgCycleTimeFast" BO_ 905 0;
BA_ "GenMsgSendType" BO_ 905 0;
BA_ "VFrameFormat" BO_ 905 14;
BA_ "CANFD_BRS" BO_ 905 1;
BA_ "GenMsgCycleTime" BO_ 905 100;
BA_ "GenMsgCycleTimeFast" BO_ 905 0;
BA_ "GenMsgSendType" BO_ 905 0;
BA_ "VFrameFormat" BO_ 905 14;
BA_ "CANFD_BRS" BO_ 905 1;
BA_ "GenMsgCycleTime" BO_ 905 100;
BA_ "GenMsgCycleTimeFast" BO_ 905 0;
BA_ "GenMsgSendType" BO_ 905 0;
BA_ "VFrameFormat" BO_ 905 14;
BA_ "CANFD_BRS" BO_ 905 1;
BA_ "GenMsgCycleTime" BO_ 905 100;
BA_ "GenMsgCycleTimeFast" BO_ 905 0;
BA_ "GenMsgSendType" BO_ 905 0;
BA_ "VFrameFormat" BO_ 905 14;
BA_ "CANFD_BRS" BO_ 905 1;
BA_ "GenMsgCycleTime" BO_ 161 0;
BA_ "GenMsgCycleTimeFast" BO_ 161 0;
BA_ "GenMsgSendType" BO_ 161 1;
BA_ "VFrameFormat" BO_ 161 14;
BA_ "CANFD_BRS" BO_ 161 1;
BA_ "GenMsgCycleTime" BO_ 161 0;
BA_ "GenMsgCycleTimeFast" BO_ 161 0;
BA_ "GenMsgSendType" BO_ 161 1;
BA_ "VFrameFormat" BO_ 161 14;
BA_ "CANFD_BRS" BO_ 161 1;
BA_ "GenMsgCycleTime" BO_ 161 0;
BA_ "GenMsgCycleTimeFast" BO_ 161 0;
BA_ "GenMsgSendType" BO_ 161 1;
BA_ "VFrameFormat" BO_ 161 14;
BA_ "CANFD_BRS" BO_ 161 1;
BA_ "GenMsgCycleTime" BO_ 161 0;
BA_ "GenMsgCycleTimeFast" BO_ 161 0;
BA_ "GenMsgSendType" BO_ 161 1;
BA_ "VFrameFormat" BO_ 161 14;
BA_ "CANFD_BRS" BO_ 161 1;
BA_ "GenMsgCycleTime" BO_ 161 0;
BA_ "GenMsgCycleTimeFast" BO_ 161 0;
BA_ "GenMsgSendType" BO_ 161 1;
BA_ "VFrameFormat" BO_ 161 14;
BA_ "CANFD_BRS" BO_ 161 1;
BA_ "GenMsgCycleTime" BO_ 161 0;
BA_ "GenMsgCycleTimeFast" BO_ 161 0;
BA_ "GenMsgSendType" BO_ 161 1;
BA_ "VFrameFormat" BO_ 161 14;
BA_ "CANFD_BRS" BO_ 161 1;
BA_ "GenMsgCycleTime" BO_ 351 200;
BA_ "GenMsgCycleTimeFast" BO_ 351 40;
BA_ "GenMsgSendType" BO_ 351 3;
BA_ "VFrameFormat" BO_ 351 14;
BA_ "CANFD_BRS" BO_ 351 1;
BA_ "GenMsgCycleTime" BO_ 351 200;
BA_ "GenMsgCycleTimeFast" BO_ 351 40;
BA_ "GenMsgSendType" BO_ 351 3;
BA_ "VFrameFormat" BO_ 351 14;
BA_ "CANFD_BRS" BO_ 351 1;
BA_ "GenMsgCycleTime" BO_ 351 200;
BA_ "GenMsgCycleTimeFast" BO_ 351 40;
BA_ "GenMsgSendType" BO_ 351 3;
BA_ "VFrameFormat" BO_ 351 14;
BA_ "CANFD_BRS" BO_ 351 1;
BA_ "GenMsgCycleTime" BO_ 351 200;
BA_ "GenMsgCycleTimeFast" BO_ 351 40;
BA_ "GenMsgSendType" BO_ 351 3;
BA_ "VFrameFormat" BO_ 351 14;
BA_ "CANFD_BRS" BO_ 351 1;
BA_ "GenMsgCycleTime" BO_ 351 200;
BA_ "GenMsgCycleTimeFast" BO_ 351 40;
BA_ "GenMsgSendType" BO_ 351 3;
BA_ "VFrameFormat" BO_ 351 14;
BA_ "CANFD_BRS" BO_ 351 1;
BA_ "GenMsgCycleTime" BO_ 351 200;
BA_ "GenMsgCycleTimeFast" BO_ 351 40;
BA_ "GenMsgSendType" BO_ 351 3;
BA_ "VFrameFormat" BO_ 351 14;
BA_ "CANFD_BRS" BO_ 351 1;
BA_ "GenMsgCycleTime" BO_ 351 200;
BA_ "GenMsgCycleTimeFast" BO_ 351 40;
BA_ "GenMsgSendType" BO_ 351 3;
BA_ "VFrameFormat" BO_ 351 14;
BA_ "CANFD_BRS" BO_ 351 1;
BA_ "GenMsgCycleTime" BO_ 351 200;
BA_ "GenMsgCycleTimeFast" BO_ 351 40;
BA_ "GenMsgSendType" BO_ 351 3;
BA_ "VFrameFormat" BO_ 351 14;
BA_ "CANFD_BRS" BO_ 351 1;
BA_ "GenMsgCycleTime" BO_ 879 50;
BA_ "GenMsgCycleTimeFast" BO_ 879 0;
BA_ "GenMsgSendType" BO_ 879 0;
BA_ "VFrameFormat" BO_ 879 14;
BA_ "CANFD_BRS" BO_ 879 1;
BA_ "GenMsgCycleTime" BO_ 879 50;
BA_ "GenMsgCycleTimeFast" BO_ 879 0;
BA_ "GenMsgSendType" BO_ 879 0;
BA_ "VFrameFormat" BO_ 879 14;
BA_ "CANFD_BRS" BO_ 879 1;
BA_ "GenMsgCycleTime" BO_ 879 50;
BA_ "GenMsgCycleTimeFast" BO_ 879 0;
BA_ "GenMsgSendType" BO_ 879 0;
BA_ "VFrameFormat" BO_ 879 14;
BA_ "CANFD_BRS" BO_ 879 1;
BA_ "GenMsgCycleTime" BO_ 879 50;
BA_ "GenMsgCycleTimeFast" BO_ 879 0;
BA_ "GenMsgSendType" BO_ 879 0;
BA_ "VFrameFormat" BO_ 879 14;
BA_ "CANFD_BRS" BO_ 879 1;
BA_ "GenMsgCycleTime" BO_ 879 50;
BA_ "GenMsgCycleTimeFast" BO_ 879 0;
BA_ "GenMsgSendType" BO_ 879 0;
BA_ "VFrameFormat" BO_ 879 14;
BA_ "CANFD_BRS" BO_ 879 1;
BA_ "GenMsgCycleTime" BO_ 879 50;
BA_ "GenMsgCycleTimeFast" BO_ 879 0;
BA_ "GenMsgSendType" BO_ 879 0;
BA_ "VFrameFormat" BO_ 879 14;
BA_ "CANFD_BRS" BO_ 879 1;
BA_ "GenMsgCycleTime" BO_ 879 50;
BA_ "GenMsgCycleTimeFast" BO_ 879 0;
BA_ "GenMsgSendType" BO_ 879 0;
BA_ "VFrameFormat" BO_ 879 14;
BA_ "CANFD_BRS" BO_ 879 1;
BA_ "GenMsgCycleTime" BO_ 879 50;
BA_ "GenMsgCycleTimeFast" BO_ 879 0;
BA_ "GenMsgSendType" BO_ 879 0;
BA_ "VFrameFormat" BO_ 879 14;
BA_ "CANFD_BRS" BO_ 879 1;
BA_ "GenMsgCycleTime" BO_ 879 50;
BA_ "GenMsgCycleTimeFast" BO_ 879 0;
BA_ "GenMsgSendType" BO_ 879 0;
BA_ "VFrameFormat" BO_ 879 14;
BA_ "CANFD_BRS" BO_ 879 1;
BA_ "GenMsgCycleTime" BO_ 879 50;
BA_ "GenMsgCycleTimeFast" BO_ 879 0;
BA_ "GenMsgSendType" BO_ 879 0;
BA_ "VFrameFormat" BO_ 879 14;
BA_ "CANFD_BRS" BO_ 879 1;
BA_ "GenMsgCycleTime" BO_ 879 50;
BA_ "GenMsgCycleTimeFast" BO_ 879 0;
BA_ "GenMsgSendType" BO_ 879 0;
BA_ "VFrameFormat" BO_ 879 14;
BA_ "CANFD_BRS" BO_ 879 1;
BA_ "GenMsgCycleTime" BO_ 879 50;
BA_ "GenMsgCycleTimeFast" BO_ 879 0;
BA_ "GenMsgSendType" BO_ 879 0;
BA_ "VFrameFormat" BO_ 879 14;
BA_ "CANFD_BRS" BO_ 879 1;
BA_ "GenMsgCycleTime" BO_ 879 50;
BA_ "GenMsgCycleTimeFast" BO_ 879 0;
BA_ "GenMsgSendType" BO_ 879 0;
BA_ "VFrameFormat" BO_ 879 14;
BA_ "CANFD_BRS" BO_ 879 1;
BA_ "GenMsgCycleTime" BO_ 879 50;
BA_ "GenMsgCycleTimeFast" BO_ 879 0;
BA_ "GenMsgSendType" BO_ 879 0;
BA_ "VFrameFormat" BO_ 879 14;
BA_ "CANFD_BRS" BO_ 879 1;
BA_ "GenMsgCycleTime" BO_ 879 50;
BA_ "GenMsgCycleTimeFast" BO_ 879 0;
BA_ "GenMsgSendType" BO_ 879 0;
BA_ "VFrameFormat" BO_ 879 14;
BA_ "CANFD_BRS" BO_ 879 1;
BA_ "GenMsgCycleTime" BO_ 879 50;
BA_ "GenMsgCycleTimeFast" BO_ 879 0;
BA_ "GenMsgSendType" BO_ 879 0;
BA_ "VFrameFormat" BO_ 879 14;
BA_ "CANFD_BRS" BO_ 879 1;
BA_ "GenMsgCycleTime" BO_ 879 50;
BA_ "GenMsgCycleTimeFast" BO_ 879 0;
BA_ "GenMsgSendType" BO_ 879 0;
BA_ "VFrameFormat" BO_ 879 14;
BA_ "CANFD_BRS" BO_ 879 1;
BA_ "GenMsgCycleTime" BO_ 879 50;
BA_ "GenMsgCycleTimeFast" BO_ 879 0;
BA_ "GenMsgSendType" BO_ 879 0;
BA_ "VFrameFormat" BO_ 879 14;
BA_ "CANFD_BRS" BO_ 879 1;
BA_ "GenMsgCycleTime" BO_ 879 50;
BA_ "GenMsgCycleTimeFast" BO_ 879 0;
BA_ "GenMsgSendType" BO_ 879 0;
BA_ "VFrameFormat" BO_ 879 14;
BA_ "CANFD_BRS" BO_ 879 1;
BA_ "GenMsgCycleTime" BO_ 879 50;
BA_ "GenMsgCycleTimeFast" BO_ 879 0;
BA_ "GenMsgSendType" BO_ 879 0;
BA_ "VFrameFormat" BO_ 879 14;
BA_ "CANFD_BRS" BO_ 879 1;
BA_ "GenMsgCycleTime" BO_ 879 50;
BA_ "GenMsgCycleTimeFast" BO_ 879 0;
BA_ "GenMsgSendType" BO_ 879 0;
BA_ "VFrameFormat" BO_ 879 14;
BA_ "CANFD_BRS" BO_ 879 1;
BA_ "GenMsgCycleTime" BO_ 879 50;
BA_ "GenMsgCycleTimeFast" BO_ 879 0;
BA_ "GenMsgSendType" BO_ 879 0;
BA_ "VFrameFormat" BO_ 879 14;
BA_ "CANFD_BRS" BO_ 879 1;
BA_ "GenMsgCycleTime" BO_ 879 50;
BA_ "GenMsgCycleTimeFast" BO_ 879 0;
BA_ "GenMsgSendType" BO_ 879 0;
BA_ "VFrameFormat" BO_ 879 14;
BA_ "CANFD_BRS" BO_ 879 1;
BA_ "GenMsgCycleTime" BO_ 879 50;
BA_ "GenMsgCycleTimeFast" BO_ 879 0;
BA_ "GenMsgSendType" BO_ 879 0;
BA_ "VFrameFormat" BO_ 879 14;
BA_ "CANFD_BRS" BO_ 879 1;
BA_ "GenMsgCycleTime" BO_ 879 50;
BA_ "GenMsgCycleTimeFast" BO_ 879 0;
BA_ "GenMsgSendType" BO_ 879 0;
BA_ "VFrameFormat" BO_ 879 14;
BA_ "CANFD_BRS" BO_ 879 1;
BA_ "GenMsgCycleTime" BO_ 879 50;
BA_ "GenMsgCycleTimeFast" BO_ 879 0;
BA_ "GenMsgSendType" BO_ 879 0;
BA_ "VFrameFormat" BO_ 879 14;
BA_ "CANFD_BRS" BO_ 879 1;
BA_ "GenMsgCycleTime" BO_ 879 50;
BA_ "GenMsgCycleTimeFast" BO_ 879 0;
BA_ "GenMsgSendType" BO_ 879 0;
BA_ "VFrameFormat" BO_ 879 14;
BA_ "CANFD_BRS" BO_ 879 1;
BA_ "GenMsgCycleTime" BO_ 879 50;
BA_ "GenMsgCycleTimeFast" BO_ 879 0;
BA_ "GenMsgSendType" BO_ 879 0;
BA_ "VFrameFormat" BO_ 879 14;
BA_ "CANFD_BRS" BO_ 879 1;
BA_ "GenMsgCycleTime" BO_ 879 50;
BA_ "GenMsgCycleTimeFast" BO_ 879 0;
BA_ "GenMsgSendType" BO_ 879 0;
BA_ "VFrameFormat" BO_ 879 14;
BA_ "CANFD_BRS" BO_ 879 1;
BA_ "GenMsgCycleTime" BO_ 879 50;
BA_ "GenMsgCycleTimeFast" BO_ 879 0;
BA_ "GenMsgSendType" BO_ 879 0;
BA_ "VFrameFormat" BO_ 879 14;
BA_ "CANFD_BRS" BO_ 879 1;
BA_ "GenMsgCycleTime" BO_ 879 50;
BA_ "GenMsgCycleTimeFast" BO_ 879 0;
BA_ "GenMsgSendType" BO_ 879 0;
BA_ "VFrameFormat" BO_ 879 14;
BA_ "CANFD_BRS" BO_ 879 1;
BA_ "GenMsgCycleTime" BO_ 879 50;
BA_ "GenMsgCycleTimeFast" BO_ 879 0;
BA_ "GenMsgSendType" BO_ 879 0;
BA_ "VFrameFormat" BO_ 879 14;
BA_ "CANFD_BRS" BO_ 879 1;
BA_ "GenMsgCycleTime" BO_ 879 50;
BA_ "GenMsgCycleTimeFast" BO_ 879 0;
BA_ "GenMsgSendType" BO_ 879 0;
BA_ "VFrameFormat" BO_ 879 14;
BA_ "CANFD_BRS" BO_ 879 1;
BA_ "GenMsgCycleTime" BO_ 879 50;
BA_ "GenMsgCycleTimeFast" BO_ 879 0;
BA_ "GenMsgSendType" BO_ 879 0;
BA_ "VFrameFormat" BO_ 879 14;
BA_ "CANFD_BRS" BO_ 879 1;
BA_ "GenMsgCycleTime" BO_ 879 50;
BA_ "GenMsgCycleTimeFast" BO_ 879 0;
BA_ "GenMsgSendType" BO_ 879 0;
BA_ "VFrameFormat" BO_ 879 14;
BA_ "CANFD_BRS" BO_ 879 1;
BA_ "GenMsgCycleTime" BO_ 879 50;
BA_ "GenMsgCycleTimeFast" BO_ 879 0;
BA_ "GenMsgSendType" BO_ 879 0;
BA_ "VFrameFormat" BO_ 879 14;
BA_ "CANFD_BRS" BO_ 879 1;
BA_ "GenMsgCycleTime" BO_ 879 50;
BA_ "GenMsgCycleTimeFast" BO_ 879 0;
BA_ "GenMsgSendType" BO_ 879 0;
BA_ "VFrameFormat" BO_ 879 14;
BA_ "CANFD_BRS" BO_ 879 1;
BA_ "GenMsgCycleTime" BO_ 879 50;
BA_ "GenMsgCycleTimeFast" BO_ 879 0;
BA_ "GenMsgSendType" BO_ 879 0;
BA_ "VFrameFormat" BO_ 879 14;
BA_ "CANFD_BRS" BO_ 879 1;
BA_ "GenMsgCycleTime" BO_ 879 50;
BA_ "GenMsgCycleTimeFast" BO_ 879 0;
BA_ "GenMsgSendType" BO_ 879 0;
BA_ "VFrameFormat" BO_ 879 14;
BA_ "CANFD_BRS" BO_ 879 1;
BA_ "GenMsgCycleTime" BO_ 879 50;
BA_ "GenMsgCycleTimeFast" BO_ 879 0;
BA_ "GenMsgSendType" BO_ 879 0;
BA_ "VFrameFormat" BO_ 879 14;
BA_ "CANFD_BRS" BO_ 879 1;
BA_ "GenMsgCycleTime" BO_ 879 50;
BA_ "GenMsgCycleTimeFast" BO_ 879 0;
BA_ "GenMsgSendType" BO_ 879 0;
BA_ "VFrameFormat" BO_ 879 14;
BA_ "CANFD_BRS" BO_ 879 1;
BA_ "GenMsgCycleTime" BO_ 879 50;
BA_ "GenMsgCycleTimeFast" BO_ 879 0;
BA_ "GenMsgSendType" BO_ 879 0;
BA_ "VFrameFormat" BO_ 879 14;
BA_ "CANFD_BRS" BO_ 879 1;
BA_ "GenMsgCycleTime" BO_ 879 50;
BA_ "GenMsgCycleTimeFast" BO_ 879 0;
BA_ "GenMsgSendType" BO_ 879 0;
BA_ "VFrameFormat" BO_ 879 14;
BA_ "CANFD_BRS" BO_ 879 1;
BA_ "GenMsgCycleTime" BO_ 879 50;
BA_ "GenMsgCycleTimeFast" BO_ 879 0;
BA_ "GenMsgSendType" BO_ 879 0;
BA_ "VFrameFormat" BO_ 879 14;
BA_ "CANFD_BRS" BO_ 879 1;
BA_ "GenMsgCycleTime" BO_ 879 50;
BA_ "GenMsgCycleTimeFast" BO_ 879 0;
BA_ "GenMsgSendType" BO_ 879 0;
BA_ "VFrameFormat" BO_ 879 14;
BA_ "CANFD_BRS" BO_ 879 1;
BA_ "GenMsgCycleTime" BO_ 879 50;
BA_ "GenMsgCycleTimeFast" BO_ 879 0;
BA_ "GenMsgSendType" BO_ 879 0;
BA_ "VFrameFormat" BO_ 879 14;
BA_ "CANFD_BRS" BO_ 879 1;
BA_ "GenMsgCycleTime" BO_ 879 50;
BA_ "GenMsgCycleTimeFast" BO_ 879 0;
BA_ "GenMsgSendType" BO_ 879 0;
BA_ "VFrameFormat" BO_ 879 14;
BA_ "CANFD_BRS" BO_ 879 1;
BA_ "GenMsgCycleTime" BO_ 879 50;
BA_ "GenMsgCycleTimeFast" BO_ 879 0;
BA_ "GenMsgSendType" BO_ 879 0;
BA_ "VFrameFormat" BO_ 879 14;
BA_ "CANFD_BRS" BO_ 879 1;
BA_ "GenMsgCycleTime" BO_ 475 1000;
BA_ "GenMsgCycleTimeFast" BO_ 475 40;
BA_ "GenMsgSendType" BO_ 475 4;
BA_ "VFrameFormat" BO_ 475 14;
BA_ "CANFD_BRS" BO_ 475 1;
BA_ "GenMsgCycleTime" BO_ 1045 1000;
BA_ "GenMsgCycleTimeFast" BO_ 1045 0;
BA_ "GenMsgSendType" BO_ 1045 0;
BA_ "VFrameFormat" BO_ 1045 14;
BA_ "CANFD_BRS" BO_ 1045 1;
BA_ "GenMsgCycleTime" BO_ 1045 1000;
BA_ "GenMsgCycleTimeFast" BO_ 1045 0;
BA_ "GenMsgSendType" BO_ 1045 0;
BA_ "VFrameFormat" BO_ 1045 14;
BA_ "CANFD_BRS" BO_ 1045 1;
BA_ "GenMsgCycleTime" BO_ 1045 1000;
BA_ "GenMsgCycleTimeFast" BO_ 1045 0;
BA_ "GenMsgSendType" BO_ 1045 0;
BA_ "VFrameFormat" BO_ 1045 14;
BA_ "CANFD_BRS" BO_ 1045 1;
BA_ "GenMsgCycleTime" BO_ 163 0;
BA_ "GenMsgCycleTimeFast" BO_ 163 0;
BA_ "GenMsgSendType" BO_ 163 1;
BA_ "VFrameFormat" BO_ 163 14;
BA_ "CANFD_BRS" BO_ 163 1;
BA_ "GenMsgCycleTime" BO_ 163 0;
BA_ "GenMsgCycleTimeFast" BO_ 163 0;
BA_ "GenMsgSendType" BO_ 163 1;
BA_ "VFrameFormat" BO_ 163 14;
BA_ "CANFD_BRS" BO_ 163 1;
BA_ "GenMsgCycleTime" BO_ 163 0;
BA_ "GenMsgCycleTimeFast" BO_ 163 0;
BA_ "GenMsgSendType" BO_ 163 1;
BA_ "VFrameFormat" BO_ 163 14;
BA_ "CANFD_BRS" BO_ 163 1;
BA_ "GenMsgCycleTime" BO_ 163 0;
BA_ "GenMsgCycleTimeFast" BO_ 163 0;
BA_ "GenMsgSendType" BO_ 163 1;
BA_ "VFrameFormat" BO_ 163 14;
BA_ "CANFD_BRS" BO_ 163 1;
BA_ "GenMsgCycleTime" BO_ 163 0;
BA_ "GenMsgCycleTimeFast" BO_ 163 0;
BA_ "GenMsgSendType" BO_ 163 1;
BA_ "VFrameFormat" BO_ 163 14;
BA_ "CANFD_BRS" BO_ 163 1;
BA_ "GenMsgCycleTime" BO_ 163 0;
BA_ "GenMsgCycleTimeFast" BO_ 163 0;
BA_ "GenMsgSendType" BO_ 163 1;
BA_ "VFrameFormat" BO_ 163 14;
BA_ "CANFD_BRS" BO_ 163 1;
BA_ "GenMsgCycleTime" BO_ 163 0;
BA_ "GenMsgCycleTimeFast" BO_ 163 0;
BA_ "GenMsgSendType" BO_ 163 1;
BA_ "VFrameFormat" BO_ 163 14;
BA_ "CANFD_BRS" BO_ 163 1;
BA_ "GenMsgCycleTime" BO_ 163 0;
BA_ "GenMsgCycleTimeFast" BO_ 163 0;
BA_ "GenMsgSendType" BO_ 163 1;
BA_ "VFrameFormat" BO_ 163 14;
BA_ "CANFD_BRS" BO_ 163 1;
BA_ "GenMsgCycleTime" BO_ 163 0;
BA_ "GenMsgCycleTimeFast" BO_ 163 0;
BA_ "GenMsgSendType" BO_ 163 1;
BA_ "VFrameFormat" BO_ 163 14;
BA_ "CANFD_BRS" BO_ 163 1;
BA_ "GenMsgCycleTime" BO_ 163 0;
BA_ "GenMsgCycleTimeFast" BO_ 163 0;
BA_ "GenMsgSendType" BO_ 163 1;
BA_ "VFrameFormat" BO_ 163 14;
BA_ "CANFD_BRS" BO_ 163 1;
BA_ "GenMsgCycleTime" BO_ 163 0;
BA_ "GenMsgCycleTimeFast" BO_ 163 0;
BA_ "GenMsgSendType" BO_ 163 1;
BA_ "VFrameFormat" BO_ 163 14;
BA_ "CANFD_BRS" BO_ 163 1;
BA_ "GenMsgCycleTime" BO_ 163 0;
BA_ "GenMsgCycleTimeFast" BO_ 163 0;
BA_ "GenMsgSendType" BO_ 163 1;
BA_ "VFrameFormat" BO_ 163 14;
BA_ "CANFD_BRS" BO_ 163 1;
BA_ "GenMsgCycleTime" BO_ 163 0;
BA_ "GenMsgCycleTimeFast" BO_ 163 0;
BA_ "GenMsgSendType" BO_ 163 1;
BA_ "VFrameFormat" BO_ 163 14;
BA_ "CANFD_BRS" BO_ 163 1;
BA_ "GenMsgCycleTime" BO_ 163 0;
BA_ "GenMsgCycleTimeFast" BO_ 163 0;
BA_ "GenMsgSendType" BO_ 163 1;
BA_ "VFrameFormat" BO_ 163 14;
BA_ "CANFD_BRS" BO_ 163 1;
BA_ "GenMsgCycleTime" BO_ 163 0;
BA_ "GenMsgCycleTimeFast" BO_ 163 0;
BA_ "GenMsgSendType" BO_ 163 1;
BA_ "VFrameFormat" BO_ 163 14;
BA_ "CANFD_BRS" BO_ 163 1;
BA_ "GenMsgCycleTime" BO_ 163 0;
BA_ "GenMsgCycleTimeFast" BO_ 163 0;
BA_ "GenMsgSendType" BO_ 163 1;
BA_ "VFrameFormat" BO_ 163 14;
BA_ "CANFD_BRS" BO_ 163 1;
BA_ "GenMsgCycleTime" BO_ 163 0;
BA_ "GenMsgCycleTimeFast" BO_ 163 0;
BA_ "GenMsgSendType" BO_ 163 1;
BA_ "VFrameFormat" BO_ 163 14;
BA_ "CANFD_BRS" BO_ 163 1;
BA_ "GenMsgCycleTime" BO_ 163 0;
BA_ "GenMsgCycleTimeFast" BO_ 163 0;
BA_ "GenMsgSendType" BO_ 163 1;
BA_ "VFrameFormat" BO_ 163 14;
BA_ "CANFD_BRS" BO_ 163 1;
BA_ "GenMsgCycleTime" BO_ 163 0;
BA_ "GenMsgCycleTimeFast" BO_ 163 0;
BA_ "GenMsgSendType" BO_ 163 1;
BA_ "VFrameFormat" BO_ 163 14;
BA_ "CANFD_BRS" BO_ 163 1;
BA_ "GenMsgCycleTime" BO_ 163 0;
BA_ "GenMsgCycleTimeFast" BO_ 163 0;
BA_ "GenMsgSendType" BO_ 163 1;
BA_ "VFrameFormat" BO_ 163 14;
BA_ "CANFD_BRS" BO_ 163 1;
BA_ "GenMsgCycleTime" BO_ 163 0;
BA_ "GenMsgCycleTimeFast" BO_ 163 0;
BA_ "GenMsgSendType" BO_ 163 1;
BA_ "VFrameFormat" BO_ 163 14;
BA_ "CANFD_BRS" BO_ 163 1;
BA_ "GenMsgCycleTime" BO_ 163 0;
BA_ "GenMsgCycleTimeFast" BO_ 163 0;
BA_ "GenMsgSendType" BO_ 163 1;
BA_ "VFrameFormat" BO_ 163 14;
BA_ "CANFD_BRS" BO_ 163 1;
BA_ "GenMsgCycleTime" BO_ 163 0;
BA_ "GenMsgCycleTimeFast" BO_ 163 0;
BA_ "GenMsgSendType" BO_ 163 1;
BA_ "VFrameFormat" BO_ 163 14;
BA_ "CANFD_BRS" BO_ 163 1;
BA_ "GenMsgCycleTime" BO_ 163 0;
BA_ "GenMsgCycleTimeFast" BO_ 163 0;
BA_ "GenMsgSendType" BO_ 163 1;
BA_ "VFrameFormat" BO_ 163 14;
BA_ "CANFD_BRS" BO_ 163 1;
BA_ "GenMsgCycleTime" BO_ 163 0;
BA_ "GenMsgCycleTimeFast" BO_ 163 0;
BA_ "GenMsgSendType" BO_ 163 1;
BA_ "VFrameFormat" BO_ 163 14;
BA_ "CANFD_BRS" BO_ 163 1;
BA_ "GenMsgCycleTime" BO_ 163 0;
BA_ "GenMsgCycleTimeFast" BO_ 163 0;
BA_ "GenMsgSendType" BO_ 163 1;
BA_ "VFrameFormat" BO_ 163 14;
BA_ "CANFD_BRS" BO_ 163 1;
BA_ "GenMsgCycleTime" BO_ 163 0;
BA_ "GenMsgCycleTimeFast" BO_ 163 0;
BA_ "GenMsgSendType" BO_ 163 1;
BA_ "VFrameFormat" BO_ 163 14;
BA_ "CANFD_BRS" BO_ 163 1;
BA_ "GenMsgCycleTime" BO_ 163 0;
BA_ "GenMsgCycleTimeFast" BO_ 163 0;
BA_ "GenMsgSendType" BO_ 163 1;
BA_ "VFrameFormat" BO_ 163 14;
BA_ "CANFD_BRS" BO_ 163 1;
BA_ "GenMsgCycleTime" BO_ 163 0;
BA_ "GenMsgCycleTimeFast" BO_ 163 0;
BA_ "GenMsgSendType" BO_ 163 1;
BA_ "VFrameFormat" BO_ 163 14;
BA_ "CANFD_BRS" BO_ 163 1;
BA_ "GenMsgCycleTime" BO_ 163 0;
BA_ "GenMsgCycleTimeFast" BO_ 163 0;
BA_ "GenMsgSendType" BO_ 163 1;
BA_ "VFrameFormat" BO_ 163 14;
BA_ "CANFD_BRS" BO_ 163 1;
BA_ "GenMsgCycleTime" BO_ 163 0;
BA_ "GenMsgCycleTimeFast" BO_ 163 0;
BA_ "GenMsgSendType" BO_ 163 1;
BA_ "VFrameFormat" BO_ 163 14;
BA_ "CANFD_BRS" BO_ 163 1;
BA_ "GenMsgCycleTime" BO_ 163 0;
BA_ "GenMsgCycleTimeFast" BO_ 163 0;
BA_ "GenMsgSendType" BO_ 163 1;
BA_ "VFrameFormat" BO_ 163 14;
BA_ "CANFD_BRS" BO_ 163 1;
BA_ "GenMsgCycleTime" BO_ 163 0;
BA_ "GenMsgCycleTimeFast" BO_ 163 0;
BA_ "GenMsgSendType" BO_ 163 1;
BA_ "VFrameFormat" BO_ 163 14;
BA_ "CANFD_BRS" BO_ 163 1;
BA_ "GenMsgCycleTime" BO_ 163 0;
BA_ "GenMsgCycleTimeFast" BO_ 163 0;
BA_ "GenMsgSendType" BO_ 163 1;
BA_ "VFrameFormat" BO_ 163 14;
BA_ "CANFD_BRS" BO_ 163 1;
BA_ "GenMsgCycleTime" BO_ 163 0;
BA_ "GenMsgCycleTimeFast" BO_ 163 0;
BA_ "GenMsgSendType" BO_ 163 1;
BA_ "VFrameFormat" BO_ 163 14;
BA_ "CANFD_BRS" BO_ 163 1;
BA_ "GenMsgCycleTime" BO_ 163 0;
BA_ "GenMsgCycleTimeFast" BO_ 163 0;
BA_ "GenMsgSendType" BO_ 163 1;
BA_ "VFrameFormat" BO_ 163 14;
BA_ "CANFD_BRS" BO_ 163 1;
BA_ "GenMsgCycleTime" BO_ 163 0;
BA_ "GenMsgCycleTimeFast" BO_ 163 0;
BA_ "GenMsgSendType" BO_ 163 1;
BA_ "VFrameFormat" BO_ 163 14;
BA_ "CANFD_BRS" BO_ 163 1;
BA_ "GenMsgCycleTime" BO_ 163 0;
BA_ "GenMsgCycleTimeFast" BO_ 163 0;
BA_ "GenMsgSendType" BO_ 163 1;
BA_ "VFrameFormat" BO_ 163 14;
BA_ "CANFD_BRS" BO_ 163 1;
BA_ "GenMsgCycleTime" BO_ 163 0;
BA_ "GenMsgCycleTimeFast" BO_ 163 0;
BA_ "GenMsgSendType" BO_ 163 1;
BA_ "VFrameFormat" BO_ 163 14;
BA_ "CANFD_BRS" BO_ 163 1;
BA_ "GenMsgCycleTime" BO_ 163 0;
BA_ "GenMsgCycleTimeFast" BO_ 163 0;
BA_ "GenMsgSendType" BO_ 163 1;
BA_ "VFrameFormat" BO_ 163 14;
BA_ "CANFD_BRS" BO_ 163 1;
BA_ "GenMsgCycleTime" BO_ 163 0;
BA_ "GenMsgCycleTimeFast" BO_ 163 0;
BA_ "GenMsgSendType" BO_ 163 1;
BA_ "VFrameFormat" BO_ 163 14;
BA_ "CANFD_BRS" BO_ 163 1;
BA_ "GenMsgCycleTime" BO_ 780 100;
BA_ "GenMsgCycleTimeFast" BO_ 780 0;
BA_ "GenMsgSendType" BO_ 780 0;
BA_ "VFrameFormat" BO_ 780 14;
BA_ "CANFD_BRS" BO_ 780 1;
BA_ "GenMsgCycleTime" BO_ 780 100;
BA_ "GenMsgCycleTimeFast" BO_ 780 0;
BA_ "GenMsgSendType" BO_ 780 0;
BA_ "VFrameFormat" BO_ 780 14;
BA_ "CANFD_BRS" BO_ 780 1;
BA_ "GenMsgCycleTime" BO_ 780 100;
BA_ "GenMsgCycleTimeFast" BO_ 780 0;
BA_ "GenMsgSendType" BO_ 780 0;
BA_ "VFrameFormat" BO_ 780 14;
BA_ "CANFD_BRS" BO_ 780 1;
BA_ "GenMsgCycleTime" BO_ 780 100;
BA_ "GenMsgCycleTimeFast" BO_ 780 0;
BA_ "GenMsgSendType" BO_ 780 0;
BA_ "VFrameFormat" BO_ 780 14;
BA_ "CANFD_BRS" BO_ 780 1;
BA_ "GenMsgCycleTime" BO_ 780 100;
BA_ "GenMsgCycleTimeFast" BO_ 780 0;
BA_ "GenMsgSendType" BO_ 780 0;
BA_ "VFrameFormat" BO_ 780 14;
BA_ "CANFD_BRS" BO_ 780 1;
BA_ "GenMsgCycleTime" BO_ 780 100;
BA_ "GenMsgCycleTimeFast" BO_ 780 0;
BA_ "GenMsgSendType" BO_ 780 0;
BA_ "VFrameFormat" BO_ 780 14;
BA_ "CANFD_BRS" BO_ 780 1;
BA_ "GenMsgCycleTime" BO_ 780 100;
BA_ "GenMsgCycleTimeFast" BO_ 780 0;
BA_ "GenMsgSendType" BO_ 780 0;
BA_ "VFrameFormat" BO_ 780 14;
BA_ "CANFD_BRS" BO_ 780 1;
BA_ "GenMsgCycleTime" BO_ 780 100;
BA_ "GenMsgCycleTimeFast" BO_ 780 0;
BA_ "GenMsgSendType" BO_ 780 0;
BA_ "VFrameFormat" BO_ 780 14;
BA_ "CANFD_BRS" BO_ 780 1;
BA_ "GenMsgCycleTime" BO_ 780 100;
BA_ "GenMsgCycleTimeFast" BO_ 780 0;
BA_ "GenMsgSendType" BO_ 780 0;
BA_ "VFrameFormat" BO_ 780 14;
BA_ "CANFD_BRS" BO_ 780 1;
BA_ "GenMsgCycleTime" BO_ 780 100;
BA_ "GenMsgCycleTimeFast" BO_ 780 0;
BA_ "GenMsgSendType" BO_ 780 0;
BA_ "VFrameFormat" BO_ 780 14;
BA_ "CANFD_BRS" BO_ 780 1;
BA_ "GenMsgCycleTime" BO_ 780 100;
BA_ "GenMsgCycleTimeFast" BO_ 780 0;
BA_ "GenMsgSendType" BO_ 780 0;
BA_ "VFrameFormat" BO_ 780 14;
BA_ "CANFD_BRS" BO_ 780 1;
BA_ "GenMsgCycleTime" BO_ 780 100;
BA_ "GenMsgCycleTimeFast" BO_ 780 0;
BA_ "GenMsgSendType" BO_ 780 0;
BA_ "VFrameFormat" BO_ 780 14;
BA_ "CANFD_BRS" BO_ 780 1;
BA_ "GenMsgCycleTime" BO_ 780 100;
BA_ "GenMsgCycleTimeFast" BO_ 780 0;
BA_ "GenMsgSendType" BO_ 780 0;
BA_ "VFrameFormat" BO_ 780 14;
BA_ "CANFD_BRS" BO_ 780 1;
BA_ "GenMsgCycleTime" BO_ 780 100;
BA_ "GenMsgCycleTimeFast" BO_ 780 0;
BA_ "GenMsgSendType" BO_ 780 0;
BA_ "VFrameFormat" BO_ 780 14;
BA_ "CANFD_BRS" BO_ 780 1;
BA_ "GenMsgCycleTime" BO_ 780 100;
BA_ "GenMsgCycleTimeFast" BO_ 780 0;
BA_ "GenMsgSendType" BO_ 780 0;
BA_ "VFrameFormat" BO_ 780 14;
BA_ "CANFD_BRS" BO_ 780 1;
BA_ "GenMsgCycleTime" BO_ 780 100;
BA_ "GenMsgCycleTimeFast" BO_ 780 0;
BA_ "GenMsgSendType" BO_ 780 0;
BA_ "VFrameFormat" BO_ 780 14;
BA_ "CANFD_BRS" BO_ 780 1;
BA_ "GenMsgCycleTime" BO_ 967 200;
BA_ "GenMsgCycleTimeFast" BO_ 967 0;
BA_ "GenMsgSendType" BO_ 967 0;
BA_ "VFrameFormat" BO_ 967 14;
BA_ "CANFD_BRS" BO_ 967 1;
BA_ "GenMsgCycleTime" BO_ 967 200;
BA_ "GenMsgCycleTimeFast" BO_ 967 0;
BA_ "GenMsgSendType" BO_ 967 0;
BA_ "VFrameFormat" BO_ 967 14;
BA_ "CANFD_BRS" BO_ 967 1;
BA_ "GenMsgCycleTime" BO_ 967 200;
BA_ "GenMsgCycleTimeFast" BO_ 967 0;
BA_ "GenMsgSendType" BO_ 967 0;
BA_ "VFrameFormat" BO_ 967 14;
BA_ "CANFD_BRS" BO_ 967 1;
BA_ "GenMsgCycleTime" BO_ 967 200;
BA_ "GenMsgCycleTimeFast" BO_ 967 0;
BA_ "GenMsgSendType" BO_ 967 0;
BA_ "VFrameFormat" BO_ 967 14;
BA_ "CANFD_BRS" BO_ 967 1;
BA_ "GenMsgCycleTime" BO_ 967 200;
BA_ "GenMsgCycleTimeFast" BO_ 967 0;
BA_ "GenMsgSendType" BO_ 967 0;
BA_ "VFrameFormat" BO_ 967 14;
BA_ "CANFD_BRS" BO_ 967 1;
BA_ "GenMsgCycleTime" BO_ 967 200;
BA_ "GenMsgCycleTimeFast" BO_ 967 0;
BA_ "GenMsgSendType" BO_ 967 0;
BA_ "VFrameFormat" BO_ 967 14;
BA_ "CANFD_BRS" BO_ 967 1;
BA_ "GenMsgCycleTime" BO_ 967 200;
BA_ "GenMsgCycleTimeFast" BO_ 967 0;
BA_ "GenMsgSendType" BO_ 967 0;
BA_ "VFrameFormat" BO_ 967 14;
BA_ "CANFD_BRS" BO_ 967 1;
BA_ "GenMsgCycleTime" BO_ 967 200;
BA_ "GenMsgCycleTimeFast" BO_ 967 0;
BA_ "GenMsgSendType" BO_ 967 0;
BA_ "VFrameFormat" BO_ 967 14;
BA_ "CANFD_BRS" BO_ 967 1;
BA_ "GenMsgCycleTime" BO_ 967 200;
BA_ "GenMsgCycleTimeFast" BO_ 967 0;
BA_ "GenMsgSendType" BO_ 967 0;
BA_ "VFrameFormat" BO_ 967 14;
BA_ "CANFD_BRS" BO_ 967 1;
BA_ "GenMsgCycleTime" BO_ 967 200;
BA_ "GenMsgCycleTimeFast" BO_ 967 0;
BA_ "GenMsgSendType" BO_ 967 0;
BA_ "VFrameFormat" BO_ 967 14;
BA_ "CANFD_BRS" BO_ 967 1;
BA_ "GenMsgCycleTime" BO_ 967 200;
BA_ "GenMsgCycleTimeFast" BO_ 967 0;
BA_ "GenMsgSendType" BO_ 967 0;
BA_ "VFrameFormat" BO_ 967 14;
BA_ "CANFD_BRS" BO_ 967 1;
BA_ "GenMsgCycleTime" BO_ 967 200;
BA_ "GenMsgCycleTimeFast" BO_ 967 0;
BA_ "GenMsgSendType" BO_ 967 0;
BA_ "VFrameFormat" BO_ 967 14;
BA_ "CANFD_BRS" BO_ 967 1;
BA_ "GenMsgCycleTime" BO_ 967 200;
BA_ "GenMsgCycleTimeFast" BO_ 967 0;
BA_ "GenMsgSendType" BO_ 967 0;
BA_ "VFrameFormat" BO_ 967 14;
BA_ "CANFD_BRS" BO_ 967 1;
BA_ "GenMsgCycleTime" BO_ 967 200;
BA_ "GenMsgCycleTimeFast" BO_ 967 0;
BA_ "GenMsgSendType" BO_ 967 0;
BA_ "VFrameFormat" BO_ 967 14;
BA_ "CANFD_BRS" BO_ 967 1;
BA_ "GenMsgCycleTime" BO_ 967 200;
BA_ "GenMsgCycleTimeFast" BO_ 967 0;
BA_ "GenMsgSendType" BO_ 967 0;
BA_ "VFrameFormat" BO_ 967 14;
BA_ "CANFD_BRS" BO_ 967 1;
BA_ "GenMsgCycleTime" BO_ 967 200;
BA_ "GenMsgCycleTimeFast" BO_ 967 0;
BA_ "GenMsgSendType" BO_ 967 0;
BA_ "VFrameFormat" BO_ 967 14;
BA_ "CANFD_BRS" BO_ 967 1;
BA_ "GenMsgCycleTime" BO_ 967 200;
BA_ "GenMsgCycleTimeFast" BO_ 967 0;
BA_ "GenMsgSendType" BO_ 967 0;
BA_ "VFrameFormat" BO_ 967 14;
BA_ "CANFD_BRS" BO_ 967 1;
BA_ "GenMsgCycleTime" BO_ 967 200;
BA_ "GenMsgCycleTimeFast" BO_ 967 0;
BA_ "GenMsgSendType" BO_ 967 0;
BA_ "VFrameFormat" BO_ 967 14;
BA_ "CANFD_BRS" BO_ 967 1;
BA_ "GenMsgCycleTime" BO_ 967 200;
BA_ "GenMsgCycleTimeFast" BO_ 967 0;
BA_ "GenMsgSendType" BO_ 967 0;
BA_ "VFrameFormat" BO_ 967 14;
BA_ "CANFD_BRS" BO_ 967 1;
BA_ "GenMsgCycleTime" BO_ 400 20;
BA_ "GenMsgCycleTimeFast" BO_ 400 0;
BA_ "GenMsgSendType" BO_ 400 0;
BA_ "VFrameFormat" BO_ 400 14;
BA_ "CANFD_BRS" BO_ 400 1;
BA_ "GenMsgCycleTime" BO_ 400 20;
BA_ "GenMsgCycleTimeFast" BO_ 400 0;
BA_ "GenMsgSendType" BO_ 400 0;
BA_ "VFrameFormat" BO_ 400 14;
BA_ "CANFD_BRS" BO_ 400 1;
BA_ "GenMsgCycleTime" BO_ 400 20;
BA_ "GenMsgCycleTimeFast" BO_ 400 0;
BA_ "GenMsgSendType" BO_ 400 0;
BA_ "VFrameFormat" BO_ 400 14;
BA_ "CANFD_BRS" BO_ 400 1;
BA_ "GenMsgCycleTime" BO_ 400 20;
BA_ "GenMsgCycleTimeFast" BO_ 400 0;
BA_ "GenMsgSendType" BO_ 400 0;
BA_ "VFrameFormat" BO_ 400 14;
BA_ "CANFD_BRS" BO_ 400 1;
BA_ "GenMsgCycleTime" BO_ 400 20;
BA_ "GenMsgCycleTimeFast" BO_ 400 0;
BA_ "GenMsgSendType" BO_ 400 0;
BA_ "VFrameFormat" BO_ 400 14;
BA_ "CANFD_BRS" BO_ 400 1;
BA_ "GenMsgCycleTime" BO_ 400 20;
BA_ "GenMsgCycleTimeFast" BO_ 400 0;
BA_ "GenMsgSendType" BO_ 400 0;
BA_ "VFrameFormat" BO_ 400 14;
BA_ "CANFD_BRS" BO_ 400 1;
BA_ "GenMsgCycleTime" BO_ 400 20;
BA_ "GenMsgCycleTimeFast" BO_ 400 0;
BA_ "GenMsgSendType" BO_ 400 0;
BA_ "VFrameFormat" BO_ 400 14;
BA_ "CANFD_BRS" BO_ 400 1;
BA_ "GenMsgCycleTime" BO_ 400 20;
BA_ "GenMsgCycleTimeFast" BO_ 400 0;
BA_ "GenMsgSendType" BO_ 400 0;
BA_ "VFrameFormat" BO_ 400 14;
BA_ "CANFD_BRS" BO_ 400 1;
BA_ "GenMsgCycleTime" BO_ 400 20;
BA_ "GenMsgCycleTimeFast" BO_ 400 0;
BA_ "GenMsgSendType" BO_ 400 0;
BA_ "VFrameFormat" BO_ 400 14;
BA_ "CANFD_BRS" BO_ 400 1;
BA_ "GenMsgCycleTime" BO_ 400 20;
BA_ "GenMsgCycleTimeFast" BO_ 400 0;
BA_ "GenMsgSendType" BO_ 400 0;
BA_ "VFrameFormat" BO_ 400 14;
BA_ "CANFD_BRS" BO_ 400 1;
BA_ "GenMsgCycleTime" BO_ 400 20;
BA_ "GenMsgCycleTimeFast" BO_ 400 0;
BA_ "GenMsgSendType" BO_ 400 0;
BA_ "VFrameFormat" BO_ 400 14;
BA_ "CANFD_BRS" BO_ 400 1;
BA_ "GenMsgCycleTime" BO_ 400 20;
BA_ "GenMsgCycleTimeFast" BO_ 400 0;
BA_ "GenMsgSendType" BO_ 400 0;
BA_ "VFrameFormat" BO_ 400 14;
BA_ "CANFD_BRS" BO_ 400 1;
BA_ "GenMsgCycleTime" BO_ 400 20;
BA_ "GenMsgCycleTimeFast" BO_ 400 0;
BA_ "GenMsgSendType" BO_ 400 0;
BA_ "VFrameFormat" BO_ 400 14;
BA_ "CANFD_BRS" BO_ 400 1;
BA_ "GenMsgCycleTime" BO_ 400 20;
BA_ "GenMsgCycleTimeFast" BO_ 400 0;
BA_ "GenMsgSendType" BO_ 400 0;
BA_ "VFrameFormat" BO_ 400 14;
BA_ "CANFD_BRS" BO_ 400 1;
BA_ "GenMsgCycleTime" BO_ 400 20;
BA_ "GenMsgCycleTimeFast" BO_ 400 0;
BA_ "GenMsgSendType" BO_ 400 0;
BA_ "VFrameFormat" BO_ 400 14;
BA_ "CANFD_BRS" BO_ 400 1;
BA_ "GenMsgCycleTime" BO_ 400 20;
BA_ "GenMsgCycleTimeFast" BO_ 400 0;
BA_ "GenMsgSendType" BO_ 400 0;
BA_ "VFrameFormat" BO_ 400 14;
BA_ "CANFD_BRS" BO_ 400 1;
BA_ "GenMsgCycleTime" BO_ 400 20;
BA_ "GenMsgCycleTimeFast" BO_ 400 0;
BA_ "GenMsgSendType" BO_ 400 0;
BA_ "VFrameFormat" BO_ 400 14;
BA_ "CANFD_BRS" BO_ 400 1;
BA_ "GenMsgCycleTime" BO_ 400 20;
BA_ "GenMsgCycleTimeFast" BO_ 400 0;
BA_ "GenMsgSendType" BO_ 400 0;
BA_ "VFrameFormat" BO_ 400 14;
BA_ "CANFD_BRS" BO_ 400 1;
BA_ "GenMsgCycleTime" BO_ 400 20;
BA_ "GenMsgCycleTimeFast" BO_ 400 0;
BA_ "GenMsgSendType" BO_ 400 0;
BA_ "VFrameFormat" BO_ 400 14;
BA_ "CANFD_BRS" BO_ 400 1;
BA_ "GenMsgCycleTime" BO_ 400 20;
BA_ "GenMsgCycleTimeFast" BO_ 400 0;
BA_ "GenMsgSendType" BO_ 400 0;
BA_ "VFrameFormat" BO_ 400 14;
BA_ "CANFD_BRS" BO_ 400 1;
BA_ "GenMsgCycleTime" BO_ 400 20;
BA_ "GenMsgCycleTimeFast" BO_ 400 0;
BA_ "GenMsgSendType" BO_ 400 0;
BA_ "VFrameFormat" BO_ 400 14;
BA_ "CANFD_BRS" BO_ 400 1;
BA_ "EventCommandSignal" SG_ 909 LCK_HoodAjarSt 0;
BA_ "GatewayedSignals" SG_ 909 LCK_HoodAjarSt 0;
BA_ "GenSigInactiveValue" SG_ 909 LCK_HoodAjarSt 0;
BA_ "GenSigInvalidValue" SG_ 909 LCK_HoodAjarSt 0;
BA_ "GenSigSendType" SG_ 909 LCK_HoodAjarSt 0;
BA_ "GenSigStartValue" SG_ 909 LCK_HoodAjarSt 0;
BA_ "GenSigTimeoutValue" SG_ 909 LCK_HoodAjarSt 0;
BA_ "Remark" SG_ 909 LCK_HoodAjarSt "";
BA_ "EventCommandSignal" SG_ 909 LCK_FrontLeftDoorAjarSt 0;
BA_ "GatewayedSignals" SG_ 909 LCK_FrontLeftDoorAjarSt 0;
BA_ "GenSigInactiveValue" SG_ 909 LCK_FrontLeftDoorAjarSt 0;
BA_ "GenSigInvalidValue" SG_ 909 LCK_FrontLeftDoorAjarSt 0;
BA_ "GenSigSendType" SG_ 909 LCK_FrontLeftDoorAjarSt 0;
BA_ "GenSigStartValue" SG_ 909 LCK_FrontLeftDoorAjarSt 0;
BA_ "GenSigTimeoutValue" SG_ 909 LCK_FrontLeftDoorAjarSt 0;
BA_ "Remark" SG_ 909 LCK_FrontLeftDoorAjarSt "";
BA_ "EventCommandSignal" SG_ 909 LCK_FrontRightDoorAjarSt 0;
BA_ "GatewayedSignals" SG_ 909 LCK_FrontRightDoorAjarSt 0;
BA_ "GenSigInactiveValue" SG_ 909 LCK_FrontRightDoorAjarSt 0;
BA_ "GenSigInvalidValue" SG_ 909 LCK_FrontRightDoorAjarSt 0;
BA_ "GenSigSendType" SG_ 909 LCK_FrontRightDoorAjarSt 0;
BA_ "GenSigStartValue" SG_ 909 LCK_FrontRightDoorAjarSt 0;
BA_ "GenSigTimeoutValue" SG_ 909 LCK_FrontRightDoorAjarSt 0;
BA_ "Remark" SG_ 909 LCK_FrontRightDoorAjarSt "";
BA_ "EventCommandSignal" SG_ 909 LCK_RearLeftDoorAjarSt 0;
BA_ "GatewayedSignals" SG_ 909 LCK_RearLeftDoorAjarSt 0;
BA_ "GenSigInactiveValue" SG_ 909 LCK_RearLeftDoorAjarSt 0;
BA_ "GenSigInvalidValue" SG_ 909 LCK_RearLeftDoorAjarSt 0;
BA_ "GenSigSendType" SG_ 909 LCK_RearLeftDoorAjarSt 0;
BA_ "GenSigStartValue" SG_ 909 LCK_RearLeftDoorAjarSt 0;
BA_ "GenSigTimeoutValue" SG_ 909 LCK_RearLeftDoorAjarSt 0;
BA_ "Remark" SG_ 909 LCK_RearLeftDoorAjarSt "";
BA_ "EventCommandSignal" SG_ 909 LCK_RearRightDoorAjarSt 0;
BA_ "GatewayedSignals" SG_ 909 LCK_RearRightDoorAjarSt 0;
BA_ "GenSigInactiveValue" SG_ 909 LCK_RearRightDoorAjarSt 0;
BA_ "GenSigInvalidValue" SG_ 909 LCK_RearRightDoorAjarSt 0;
BA_ "GenSigSendType" SG_ 909 LCK_RearRightDoorAjarSt 0;
BA_ "GenSigStartValue" SG_ 909 LCK_RearRightDoorAjarSt 0;
BA_ "GenSigTimeoutValue" SG_ 909 LCK_RearRightDoorAjarSt 0;
BA_ "Remark" SG_ 909 LCK_RearRightDoorAjarSt "";
BA_ "EventCommandSignal" SG_ 909 LCK_TrunkAjarSt 0;
BA_ "GatewayedSignals" SG_ 909 LCK_TrunkAjarSt 0;
BA_ "GenSigInactiveValue" SG_ 909 LCK_TrunkAjarSt 0;
BA_ "GenSigInvalidValue" SG_ 909 LCK_TrunkAjarSt 0;
BA_ "GenSigSendType" SG_ 909 LCK_TrunkAjarSt 0;
BA_ "GenSigStartValue" SG_ 909 LCK_TrunkAjarSt 0;
BA_ "GenSigTimeoutValue" SG_ 909 LCK_TrunkAjarSt 0;
BA_ "Remark" SG_ 909 LCK_TrunkAjarSt "";
BA_ "EventCommandSignal" SG_ 909 LCK_FrontLeftDoorLockSt 0;
BA_ "GatewayedSignals" SG_ 909 LCK_FrontLeftDoorLockSt 0;
BA_ "GenSigInactiveValue" SG_ 909 LCK_FrontLeftDoorLockSt 0;
BA_ "GenSigInvalidValue" SG_ 909 LCK_FrontLeftDoorLockSt 0;
BA_ "GenSigSendType" SG_ 909 LCK_FrontLeftDoorLockSt 0;
BA_ "GenSigStartValue" SG_ 909 LCK_FrontLeftDoorLockSt 0;
BA_ "GenSigTimeoutValue" SG_ 909 LCK_FrontLeftDoorLockSt 0;
BA_ "Remark" SG_ 909 LCK_FrontLeftDoorLockSt "";
BA_ "EventCommandSignal" SG_ 909 LCK_FrontRightDoorLockSt 0;
BA_ "GatewayedSignals" SG_ 909 LCK_FrontRightDoorLockSt 0;
BA_ "GenSigInactiveValue" SG_ 909 LCK_FrontRightDoorLockSt 0;
BA_ "GenSigInvalidValue" SG_ 909 LCK_FrontRightDoorLockSt 0;
BA_ "GenSigSendType" SG_ 909 LCK_FrontRightDoorLockSt 0;
BA_ "GenSigStartValue" SG_ 909 LCK_FrontRightDoorLockSt 0;
BA_ "GenSigTimeoutValue" SG_ 909 LCK_FrontRightDoorLockSt 0;
BA_ "Remark" SG_ 909 LCK_FrontRightDoorLockSt "";
BA_ "EventCommandSignal" SG_ 909 LCK_RearLeftDoorLockSt 0;
BA_ "GatewayedSignals" SG_ 909 LCK_RearLeftDoorLockSt 0;
BA_ "GenSigInactiveValue" SG_ 909 LCK_RearLeftDoorLockSt 0;
BA_ "GenSigInvalidValue" SG_ 909 LCK_RearLeftDoorLockSt 0;
BA_ "GenSigSendType" SG_ 909 LCK_RearLeftDoorLockSt 0;
BA_ "GenSigStartValue" SG_ 909 LCK_RearLeftDoorLockSt 0;
BA_ "GenSigTimeoutValue" SG_ 909 LCK_RearLeftDoorLockSt 0;
BA_ "Remark" SG_ 909 LCK_RearLeftDoorLockSt "";
BA_ "EventCommandSignal" SG_ 909 LCK_RearRightDoorLockSt 0;
BA_ "GatewayedSignals" SG_ 909 LCK_RearRightDoorLockSt 0;
BA_ "GenSigInactiveValue" SG_ 909 LCK_RearRightDoorLockSt 0;
BA_ "GenSigInvalidValue" SG_ 909 LCK_RearRightDoorLockSt 0;
BA_ "GenSigSendType" SG_ 909 LCK_RearRightDoorLockSt 0;
BA_ "GenSigStartValue" SG_ 909 LCK_RearRightDoorLockSt 0;
BA_ "GenSigTimeoutValue" SG_ 909 LCK_RearRightDoorLockSt 0;
BA_ "Remark" SG_ 909 LCK_RearRightDoorLockSt "";
BA_ "EventCommandSignal" SG_ 909 LCK_RearLeftChildSaftyLockSt 0;
BA_ "GatewayedSignals" SG_ 909 LCK_RearLeftChildSaftyLockSt 0;
BA_ "GenSigInactiveValue" SG_ 909 LCK_RearLeftChildSaftyLockSt 0;
BA_ "GenSigInvalidValue" SG_ 909 LCK_RearLeftChildSaftyLockSt 0;
BA_ "GenSigSendType" SG_ 909 LCK_RearLeftChildSaftyLockSt 0;
BA_ "GenSigStartValue" SG_ 909 LCK_RearLeftChildSaftyLockSt 0;
BA_ "GenSigTimeoutValue" SG_ 909 LCK_RearLeftChildSaftyLockSt 0;
BA_ "Remark" SG_ 909 LCK_RearLeftChildSaftyLockSt "";
BA_ "EventCommandSignal" SG_ 909 LCK_RearRightChildSaftyLockSt 0;
BA_ "GatewayedSignals" SG_ 909 LCK_RearRightChildSaftyLockSt 0;
BA_ "GenSigInactiveValue" SG_ 909 LCK_RearRightChildSaftyLockSt 0;
BA_ "GenSigInvalidValue" SG_ 909 LCK_RearRightChildSaftyLockSt 0;
BA_ "GenSigSendType" SG_ 909 LCK_RearRightChildSaftyLockSt 0;
BA_ "GenSigStartValue" SG_ 909 LCK_RearRightChildSaftyLockSt 0;
BA_ "GenSigTimeoutValue" SG_ 909 LCK_RearRightChildSaftyLockSt 0;
BA_ "Remark" SG_ 909 LCK_RearRightChildSaftyLockSt "";
BA_ "EventCommandSignal" SG_ 909 LCK_FrontLeftDoorHandlePosition 0;
BA_ "GatewayedSignals" SG_ 909 LCK_FrontLeftDoorHandlePosition 0;
BA_ "GenSigInactiveValue" SG_ 909 LCK_FrontLeftDoorHandlePosition 0;
BA_ "GenSigInvalidValue" SG_ 909 LCK_FrontLeftDoorHandlePosition 255;
BA_ "GenSigSendType" SG_ 909 LCK_FrontLeftDoorHandlePosition 0;
BA_ "GenSigStartValue" SG_ 909 LCK_FrontLeftDoorHandlePosition 0;
BA_ "GenSigTimeoutValue" SG_ 909 LCK_FrontLeftDoorHandlePosition 0;
BA_ "Remark" SG_ 909 LCK_FrontLeftDoorHandlePosition "";
BA_ "EventCommandSignal" SG_ 909 LCK_FrontRightDoorHandlePosition 0;
BA_ "GatewayedSignals" SG_ 909 LCK_FrontRightDoorHandlePosition 0;
BA_ "GenSigInactiveValue" SG_ 909 LCK_FrontRightDoorHandlePosition 0;
BA_ "GenSigInvalidValue" SG_ 909 LCK_FrontRightDoorHandlePosition 255;
BA_ "GenSigSendType" SG_ 909 LCK_FrontRightDoorHandlePosition 0;
BA_ "GenSigStartValue" SG_ 909 LCK_FrontRightDoorHandlePosition 0;
BA_ "GenSigTimeoutValue" SG_ 909 LCK_FrontRightDoorHandlePosition 0;
BA_ "Remark" SG_ 909 LCK_FrontRightDoorHandlePosition "";
BA_ "EventCommandSignal" SG_ 909 LCK_RearLeftDoorHandlePosition 0;
BA_ "GatewayedSignals" SG_ 909 LCK_RearLeftDoorHandlePosition 0;
BA_ "GenSigInactiveValue" SG_ 909 LCK_RearLeftDoorHandlePosition 0;
BA_ "GenSigInvalidValue" SG_ 909 LCK_RearLeftDoorHandlePosition 255;
BA_ "GenSigSendType" SG_ 909 LCK_RearLeftDoorHandlePosition 0;
BA_ "GenSigStartValue" SG_ 909 LCK_RearLeftDoorHandlePosition 0;
BA_ "GenSigTimeoutValue" SG_ 909 LCK_RearLeftDoorHandlePosition 0;
BA_ "Remark" SG_ 909 LCK_RearLeftDoorHandlePosition "";
BA_ "EventCommandSignal" SG_ 909 LCK_RearRightDoorHandlePosition 0;
BA_ "GatewayedSignals" SG_ 909 LCK_RearRightDoorHandlePosition 0;
BA_ "GenSigInactiveValue" SG_ 909 LCK_RearRightDoorHandlePosition 0;
BA_ "GenSigInvalidValue" SG_ 909 LCK_RearRightDoorHandlePosition 255;
BA_ "GenSigSendType" SG_ 909 LCK_RearRightDoorHandlePosition 0;
BA_ "GenSigStartValue" SG_ 909 LCK_RearRightDoorHandlePosition 0;
BA_ "GenSigTimeoutValue" SG_ 909 LCK_RearRightDoorHandlePosition 0;
BA_ "Remark" SG_ 909 LCK_RearRightDoorHandlePosition "";
BA_ "EventCommandSignal" SG_ 909 LCK_FillerCapASt 0;
BA_ "GatewayedSignals" SG_ 909 LCK_FillerCapASt 0;
BA_ "GenSigInactiveValue" SG_ 909 LCK_FillerCapASt 0;
BA_ "GenSigInvalidValue" SG_ 909 LCK_FillerCapASt 0;
BA_ "GenSigSendType" SG_ 909 LCK_FillerCapASt 0;
BA_ "GenSigStartValue" SG_ 909 LCK_FillerCapASt 0;
BA_ "GenSigTimeoutValue" SG_ 909 LCK_FillerCapASt 0;
BA_ "Remark" SG_ 909 LCK_FillerCapASt "";
BA_ "EventCommandSignal" SG_ 909 LCK_FillerCapBSt 0;
BA_ "GatewayedSignals" SG_ 909 LCK_FillerCapBSt 0;
BA_ "GenSigInactiveValue" SG_ 909 LCK_FillerCapBSt 0;
BA_ "GenSigInvalidValue" SG_ 909 LCK_FillerCapBSt 0;
BA_ "GenSigSendType" SG_ 909 LCK_FillerCapBSt 0;
BA_ "GenSigStartValue" SG_ 909 LCK_FillerCapBSt 0;
BA_ "GenSigTimeoutValue" SG_ 909 LCK_FillerCapBSt 0;
BA_ "Remark" SG_ 909 LCK_FillerCapBSt "";
BA_ "EventCommandSignal" SG_ 909 MR_LeftMirrorFoldUnfoldSt 0;
BA_ "GatewayedSignals" SG_ 909 MR_LeftMirrorFoldUnfoldSt 0;
BA_ "GenSigInactiveValue" SG_ 909 MR_LeftMirrorFoldUnfoldSt 0;
BA_ "GenSigInvalidValue" SG_ 909 MR_LeftMirrorFoldUnfoldSt 0;
BA_ "GenSigSendType" SG_ 909 MR_LeftMirrorFoldUnfoldSt 1;
BA_ "GenSigStartValue" SG_ 909 MR_LeftMirrorFoldUnfoldSt 0;
BA_ "GenSigTimeoutValue" SG_ 909 MR_LeftMirrorFoldUnfoldSt 0;
BA_ "Remark" SG_ 909 MR_LeftMirrorFoldUnfoldSt "";
BA_ "EventCommandSignal" SG_ 909 SBM_SwapHvBattModeSt 0;
BA_ "GatewayedSignals" SG_ 909 SBM_SwapHvBattModeSt 0;
BA_ "GenSigInactiveValue" SG_ 909 SBM_SwapHvBattModeSt 0;
BA_ "GenSigInvalidValue" SG_ 909 SBM_SwapHvBattModeSt 0;
BA_ "GenSigSendType" SG_ 909 SBM_SwapHvBattModeSt 1;
BA_ "GenSigStartValue" SG_ 909 SBM_SwapHvBattModeSt 0;
BA_ "GenSigTimeoutValue" SG_ 909 SBM_SwapHvBattModeSt 0;
BA_ "Remark" SG_ 909 SBM_SwapHvBattModeSt "";
BA_ "EventCommandSignal" SG_ 909 SBM_SwapStaDiagCode 0;
BA_ "GatewayedSignals" SG_ 909 SBM_SwapStaDiagCode 0;
BA_ "GenSigInactiveValue" SG_ 909 SBM_SwapStaDiagCode 0;
BA_ "GenSigInvalidValue" SG_ 909 SBM_SwapStaDiagCode 0;
BA_ "GenSigSendType" SG_ 909 SBM_SwapStaDiagCode 1;
BA_ "GenSigStartValue" SG_ 909 SBM_SwapStaDiagCode 0;
BA_ "GenSigTimeoutValue" SG_ 909 SBM_SwapStaDiagCode 0;
BA_ "Remark" SG_ 909 SBM_SwapStaDiagCode "";
BA_ "EventCommandSignal" SG_ 909 SBM_SwapVehDiagCode 0;
BA_ "GatewayedSignals" SG_ 909 SBM_SwapVehDiagCode 0;
BA_ "GenSigInactiveValue" SG_ 909 SBM_SwapVehDiagCode 0;
BA_ "GenSigInvalidValue" SG_ 909 SBM_SwapVehDiagCode 0;
BA_ "GenSigSendType" SG_ 909 SBM_SwapVehDiagCode 1;
BA_ "GenSigStartValue" SG_ 909 SBM_SwapVehDiagCode 0;
BA_ "GenSigTimeoutValue" SG_ 909 SBM_SwapVehDiagCode 0;
BA_ "Remark" SG_ 909 SBM_SwapVehDiagCode "";
BA_ "EventCommandSignal" SG_ 909 SBM_SwapHvBattModeFaultSt 0;
BA_ "GatewayedSignals" SG_ 909 SBM_SwapHvBattModeFaultSt 0;
BA_ "GenSigInactiveValue" SG_ 909 SBM_SwapHvBattModeFaultSt 0;
BA_ "GenSigInvalidValue" SG_ 909 SBM_SwapHvBattModeFaultSt 0;
BA_ "GenSigSendType" SG_ 909 SBM_SwapHvBattModeFaultSt 1;
BA_ "GenSigStartValue" SG_ 909 SBM_SwapHvBattModeFaultSt 0;
BA_ "GenSigTimeoutValue" SG_ 909 SBM_SwapHvBattModeFaultSt 0;
BA_ "Remark" SG_ 909 SBM_SwapHvBattModeFaultSt "";
BA_ "EventCommandSignal" SG_ 909 POD_CurDoorPosFL 0;
BA_ "GatewayedSignals" SG_ 909 POD_CurDoorPosFL 0;
BA_ "GenSigInactiveValue" SG_ 909 POD_CurDoorPosFL 0;
BA_ "GenSigInvalidValue" SG_ 909 POD_CurDoorPosFL 0;
BA_ "GenSigSendType" SG_ 909 POD_CurDoorPosFL 1;
BA_ "GenSigStartValue" SG_ 909 POD_CurDoorPosFL 0;
BA_ "GenSigTimeoutValue" SG_ 909 POD_CurDoorPosFL 0;
BA_ "Remark" SG_ 909 POD_CurDoorPosFL "";
BA_ "EventCommandSignal" SG_ 909 IPDS_HDMapPowerSt 0;
BA_ "GatewayedSignals" SG_ 909 IPDS_HDMapPowerSt 0;
BA_ "GenSigInactiveValue" SG_ 909 IPDS_HDMapPowerSt 0;
BA_ "GenSigInvalidValue" SG_ 909 IPDS_HDMapPowerSt 0;
BA_ "GenSigSendType" SG_ 909 IPDS_HDMapPowerSt 1;
BA_ "GenSigStartValue" SG_ 909 IPDS_HDMapPowerSt 0;
BA_ "GenSigTimeoutValue" SG_ 909 IPDS_HDMapPowerSt 0;
BA_ "Remark" SG_ 909 IPDS_HDMapPowerSt "";
BA_ "EventCommandSignal" SG_ 909 IPDS_KL15L1PowerSt 0;
BA_ "GatewayedSignals" SG_ 909 IPDS_KL15L1PowerSt 0;
BA_ "GenSigInactiveValue" SG_ 909 IPDS_KL15L1PowerSt 0;
BA_ "GenSigInvalidValue" SG_ 909 IPDS_KL15L1PowerSt 0;
BA_ "GenSigSendType" SG_ 909 IPDS_KL15L1PowerSt 1;
BA_ "GenSigStartValue" SG_ 909 IPDS_KL15L1PowerSt 0;
BA_ "GenSigTimeoutValue" SG_ 909 IPDS_KL15L1PowerSt 0;
BA_ "Remark" SG_ 909 IPDS_KL15L1PowerSt "";
BA_ "EventCommandSignal" SG_ 909 IPDS_SRSECUPowerSt 0;
BA_ "GatewayedSignals" SG_ 909 IPDS_SRSECUPowerSt 0;
BA_ "GenSigInactiveValue" SG_ 909 IPDS_SRSECUPowerSt 0;
BA_ "GenSigInvalidValue" SG_ 909 IPDS_SRSECUPowerSt 0;
BA_ "GenSigSendType" SG_ 909 IPDS_SRSECUPowerSt 1;
BA_ "GenSigStartValue" SG_ 909 IPDS_SRSECUPowerSt 0;
BA_ "GenSigTimeoutValue" SG_ 909 IPDS_SRSECUPowerSt 0;
BA_ "Remark" SG_ 909 IPDS_SRSECUPowerSt "";
BA_ "EventCommandSignal" SG_ 909 IPDS_HODPowerSt 0;
BA_ "GatewayedSignals" SG_ 909 IPDS_HODPowerSt 0;
BA_ "GenSigInactiveValue" SG_ 909 IPDS_HODPowerSt 0;
BA_ "GenSigInvalidValue" SG_ 909 IPDS_HODPowerSt 0;
BA_ "GenSigSendType" SG_ 909 IPDS_HODPowerSt 1;
BA_ "GenSigStartValue" SG_ 909 IPDS_HODPowerSt 0;
BA_ "GenSigTimeoutValue" SG_ 909 IPDS_HODPowerSt 0;
BA_ "Remark" SG_ 909 IPDS_HODPowerSt "";
BA_ "EventCommandSignal" SG_ 909 KAE_BLEOption 0;
BA_ "GatewayedSignals" SG_ 909 KAE_BLEOption 0;
BA_ "GenSigInactiveValue" SG_ 909 KAE_BLEOption 0;
BA_ "GenSigInvalidValue" SG_ 909 KAE_BLEOption 0;
BA_ "GenSigSendType" SG_ 909 KAE_BLEOption 1;
BA_ "GenSigStartValue" SG_ 909 KAE_BLEOption 0;
BA_ "GenSigTimeoutValue" SG_ 909 KAE_BLEOption 0;
BA_ "Remark" SG_ 909 KAE_BLEOption "";
BA_ "EventCommandSignal" SG_ 909 KAE_UWBOption 0;
BA_ "GatewayedSignals" SG_ 909 KAE_UWBOption 0;
BA_ "GenSigInactiveValue" SG_ 909 KAE_UWBOption 0;
BA_ "GenSigInvalidValue" SG_ 909 KAE_UWBOption 0;
BA_ "GenSigSendType" SG_ 909 KAE_UWBOption 1;
BA_ "GenSigStartValue" SG_ 909 KAE_UWBOption 0;
BA_ "GenSigTimeoutValue" SG_ 909 KAE_UWBOption 0;
BA_ "Remark" SG_ 909 KAE_UWBOption "";
BA_ "EventCommandSignal" SG_ 909 WW_RWPMotorSt 0;
BA_ "GatewayedSignals" SG_ 909 WW_RWPMotorSt 0;
BA_ "GenSigInactiveValue" SG_ 909 WW_RWPMotorSt 0;
BA_ "GenSigInvalidValue" SG_ 909 WW_RWPMotorSt 0;
BA_ "GenSigSendType" SG_ 909 WW_RWPMotorSt 1;
BA_ "GenSigStartValue" SG_ 909 WW_RWPMotorSt 0;
BA_ "GenSigTimeoutValue" SG_ 909 WW_RWPMotorSt 0;
BA_ "Remark" SG_ 909 WW_RWPMotorSt "";
BA_ "EventCommandSignal" SG_ 909 ACEleclocksSt 0;
BA_ "GatewayedSignals" SG_ 909 ACEleclocksSt 0;
BA_ "GenSigInactiveValue" SG_ 909 ACEleclocksSt 0;
BA_ "GenSigInvalidValue" SG_ 909 ACEleclocksSt 0;
BA_ "GenSigSendType" SG_ 909 ACEleclocksSt 1;
BA_ "GenSigStartValue" SG_ 909 ACEleclocksSt 0;
BA_ "GenSigTimeoutValue" SG_ 909 ACEleclocksSt 0;
BA_ "Remark" SG_ 909 ACEleclocksSt "";
BA_ "EventCommandSignal" SG_ 909 WCM_Reminder 0;
BA_ "GatewayedSignals" SG_ 909 WCM_Reminder 0;
BA_ "GenSigInactiveValue" SG_ 909 WCM_Reminder 0;
BA_ "GenSigInvalidValue" SG_ 909 WCM_Reminder 0;
BA_ "GenSigSendType" SG_ 909 WCM_Reminder 1;
BA_ "GenSigStartValue" SG_ 909 WCM_Reminder 0;
BA_ "GenSigTimeoutValue" SG_ 909 WCM_Reminder 0;
BA_ "Remark" SG_ 909 WCM_Reminder "";
BA_ "EventCommandSignal" SG_ 909 WCM_ChargingSt 0;
BA_ "GatewayedSignals" SG_ 909 WCM_ChargingSt 0;
BA_ "GenSigInactiveValue" SG_ 909 WCM_ChargingSt 0;
BA_ "GenSigInvalidValue" SG_ 909 WCM_ChargingSt 0;
BA_ "GenSigSendType" SG_ 909 WCM_ChargingSt 1;
BA_ "GenSigStartValue" SG_ 909 WCM_ChargingSt 0;
BA_ "GenSigTimeoutValue" SG_ 909 WCM_ChargingSt 0;
BA_ "Remark" SG_ 909 WCM_ChargingSt "";
BA_ "EventCommandSignal" SG_ 909 AVAS_ActivatedSt 0;
BA_ "GatewayedSignals" SG_ 909 AVAS_ActivatedSt 0;
BA_ "GenSigInactiveValue" SG_ 909 AVAS_ActivatedSt 0;
BA_ "GenSigInvalidValue" SG_ 909 AVAS_ActivatedSt 0;
BA_ "GenSigSendType" SG_ 909 AVAS_ActivatedSt 1;
BA_ "GenSigStartValue" SG_ 909 AVAS_ActivatedSt 0;
BA_ "GenSigTimeoutValue" SG_ 909 AVAS_ActivatedSt 0;
BA_ "Remark" SG_ 909 AVAS_ActivatedSt "";
BA_ "EventCommandSignal" SG_ 909 PWL_WinCurrentPos_FLWinPst 0;
BA_ "GatewayedSignals" SG_ 909 PWL_WinCurrentPos_FLWinPst 0;
BA_ "GenSigInactiveValue" SG_ 909 PWL_WinCurrentPos_FLWinPst 0;
BA_ "GenSigInvalidValue" SG_ 909 PWL_WinCurrentPos_FLWinPst 0;
BA_ "GenSigSendType" SG_ 909 PWL_WinCurrentPos_FLWinPst 1;
BA_ "GenSigStartValue" SG_ 909 PWL_WinCurrentPos_FLWinPst 255;
BA_ "GenSigTimeoutValue" SG_ 909 PWL_WinCurrentPos_FLWinPst 0;
BA_ "Remark" SG_ 909 PWL_WinCurrentPos_FLWinPst "";
BA_ "EventCommandSignal" SG_ 909 UINM_FrontLeftPowerReleaseReq 0;
BA_ "GatewayedSignals" SG_ 909 UINM_FrontLeftPowerReleaseReq 0;
BA_ "GenSigInactiveValue" SG_ 909 UINM_FrontLeftPowerReleaseReq 0;
BA_ "GenSigInvalidValue" SG_ 909 UINM_FrontLeftPowerReleaseReq 0;
BA_ "GenSigSendType" SG_ 909 UINM_FrontLeftPowerReleaseReq 1;
BA_ "GenSigStartValue" SG_ 909 UINM_FrontLeftPowerReleaseReq 0;
BA_ "GenSigTimeoutValue" SG_ 909 UINM_FrontLeftPowerReleaseReq 0;
BA_ "Remark" SG_ 909 UINM_FrontLeftPowerReleaseReq "";
BA_ "EventCommandSignal" SG_ 909 UINM_FrontLeftPowerReleaseFaultSt 0;
BA_ "GatewayedSignals" SG_ 909 UINM_FrontLeftPowerReleaseFaultSt 0;
BA_ "GenSigInactiveValue" SG_ 909 UINM_FrontLeftPowerReleaseFaultSt 0;
BA_ "GenSigInvalidValue" SG_ 909 UINM_FrontLeftPowerReleaseFaultSt 0;
BA_ "GenSigSendType" SG_ 909 UINM_FrontLeftPowerReleaseFaultSt 1;
BA_ "GenSigStartValue" SG_ 909 UINM_FrontLeftPowerReleaseFaultSt 0;
BA_ "GenSigTimeoutValue" SG_ 909 UINM_FrontLeftPowerReleaseFaultSt 0;
BA_ "Remark" SG_ 909 UINM_FrontLeftPowerReleaseFaultSt "";
BA_ "EventCommandSignal" SG_ 909 UINM_FrontRightPowerReleaseReq 0;
BA_ "GatewayedSignals" SG_ 909 UINM_FrontRightPowerReleaseReq 0;
BA_ "GenSigInactiveValue" SG_ 909 UINM_FrontRightPowerReleaseReq 0;
BA_ "GenSigInvalidValue" SG_ 909 UINM_FrontRightPowerReleaseReq 0;
BA_ "GenSigSendType" SG_ 909 UINM_FrontRightPowerReleaseReq 1;
BA_ "GenSigStartValue" SG_ 909 UINM_FrontRightPowerReleaseReq 0;
BA_ "GenSigTimeoutValue" SG_ 909 UINM_FrontRightPowerReleaseReq 0;
BA_ "Remark" SG_ 909 UINM_FrontRightPowerReleaseReq "";
BA_ "EventCommandSignal" SG_ 909 UINM_FrontRightPowerReleaseFaultSt 0;
BA_ "GatewayedSignals" SG_ 909 UINM_FrontRightPowerReleaseFaultSt 0;
BA_ "GenSigInactiveValue" SG_ 909 UINM_FrontRightPowerReleaseFaultSt 0;
BA_ "GenSigInvalidValue" SG_ 909 UINM_FrontRightPowerReleaseFaultSt 0;
BA_ "GenSigSendType" SG_ 909 UINM_FrontRightPowerReleaseFaultSt 1;
BA_ "GenSigStartValue" SG_ 909 UINM_FrontRightPowerReleaseFaultSt 0;
BA_ "GenSigTimeoutValue" SG_ 909 UINM_FrontRightPowerReleaseFaultSt 0;
BA_ "Remark" SG_ 909 UINM_FrontRightPowerReleaseFaultSt "";
BA_ "EventCommandSignal" SG_ 909 UINM_RearLeftPowerReleaseFaultSt 0;
BA_ "GatewayedSignals" SG_ 909 UINM_RearLeftPowerReleaseFaultSt 0;
BA_ "GenSigInactiveValue" SG_ 909 UINM_RearLeftPowerReleaseFaultSt 0;
BA_ "GenSigInvalidValue" SG_ 909 UINM_RearLeftPowerReleaseFaultSt 0;
BA_ "GenSigSendType" SG_ 909 UINM_RearLeftPowerReleaseFaultSt 1;
BA_ "GenSigStartValue" SG_ 909 UINM_RearLeftPowerReleaseFaultSt 0;
BA_ "GenSigTimeoutValue" SG_ 909 UINM_RearLeftPowerReleaseFaultSt 0;
BA_ "Remark" SG_ 909 UINM_RearLeftPowerReleaseFaultSt "";
BA_ "EventCommandSignal" SG_ 909 UINM_RearLeftPowerReleaseReq 0;
BA_ "GatewayedSignals" SG_ 909 UINM_RearLeftPowerReleaseReq 0;
BA_ "GenSigInactiveValue" SG_ 909 UINM_RearLeftPowerReleaseReq 0;
BA_ "GenSigInvalidValue" SG_ 909 UINM_RearLeftPowerReleaseReq 0;
BA_ "GenSigSendType" SG_ 909 UINM_RearLeftPowerReleaseReq 1;
BA_ "GenSigStartValue" SG_ 909 UINM_RearLeftPowerReleaseReq 0;
BA_ "GenSigTimeoutValue" SG_ 909 UINM_RearLeftPowerReleaseReq 0;
BA_ "Remark" SG_ 909 UINM_RearLeftPowerReleaseReq "";
BA_ "EventCommandSignal" SG_ 909 UINM_RearRightPowerReleaseFaultSt 0;
BA_ "GatewayedSignals" SG_ 909 UINM_RearRightPowerReleaseFaultSt 0;
BA_ "GenSigInactiveValue" SG_ 909 UINM_RearRightPowerReleaseFaultSt 0;
BA_ "GenSigInvalidValue" SG_ 909 UINM_RearRightPowerReleaseFaultSt 0;
BA_ "GenSigSendType" SG_ 909 UINM_RearRightPowerReleaseFaultSt 1;
BA_ "GenSigStartValue" SG_ 909 UINM_RearRightPowerReleaseFaultSt 0;
BA_ "GenSigTimeoutValue" SG_ 909 UINM_RearRightPowerReleaseFaultSt 0;
BA_ "Remark" SG_ 909 UINM_RearRightPowerReleaseFaultSt "";
BA_ "EventCommandSignal" SG_ 909 UINM_RearRightPowerReleaseReq 0;
BA_ "GatewayedSignals" SG_ 909 UINM_RearRightPowerReleaseReq 0;
BA_ "GenSigInactiveValue" SG_ 909 UINM_RearRightPowerReleaseReq 0;
BA_ "GenSigInvalidValue" SG_ 909 UINM_RearRightPowerReleaseReq 0;
BA_ "GenSigSendType" SG_ 909 UINM_RearRightPowerReleaseReq 1;
BA_ "GenSigStartValue" SG_ 909 UINM_RearRightPowerReleaseReq 0;
BA_ "GenSigTimeoutValue" SG_ 909 UINM_RearRightPowerReleaseReq 0;
BA_ "Remark" SG_ 909 UINM_RearRightPowerReleaseReq "";
BA_ "EventCommandSignal" SG_ 909 PWL_WinCurrentPos_RRWinPst 0;
BA_ "GatewayedSignals" SG_ 909 PWL_WinCurrentPos_RRWinPst 0;
BA_ "GenSigInactiveValue" SG_ 909 PWL_WinCurrentPos_RRWinPst 0;
BA_ "GenSigInvalidValue" SG_ 909 PWL_WinCurrentPos_RRWinPst 0;
BA_ "GenSigSendType" SG_ 909 PWL_WinCurrentPos_RRWinPst 1;
BA_ "GenSigStartValue" SG_ 909 PWL_WinCurrentPos_RRWinPst 255;
BA_ "GenSigTimeoutValue" SG_ 909 PWL_WinCurrentPos_RRWinPst 0;
BA_ "Remark" SG_ 909 PWL_WinCurrentPos_RRWinPst "";
BA_ "EventCommandSignal" SG_ 909 PWL_WinCurrentPos_RLWinPst 0;
BA_ "GatewayedSignals" SG_ 909 PWL_WinCurrentPos_RLWinPst 0;
BA_ "GenSigInactiveValue" SG_ 909 PWL_WinCurrentPos_RLWinPst 0;
BA_ "GenSigInvalidValue" SG_ 909 PWL_WinCurrentPos_RLWinPst 0;
BA_ "GenSigSendType" SG_ 909 PWL_WinCurrentPos_RLWinPst 1;
BA_ "GenSigStartValue" SG_ 909 PWL_WinCurrentPos_RLWinPst 255;
BA_ "GenSigTimeoutValue" SG_ 909 PWL_WinCurrentPos_RLWinPst 0;
BA_ "Remark" SG_ 909 PWL_WinCurrentPos_RLWinPst "";
BA_ "EventCommandSignal" SG_ 334 CSM_RC_ViewExtvideo 0;
BA_ "GatewayedSignals" SG_ 334 CSM_RC_ViewExtvideo 0;
BA_ "GenSigInactiveValue" SG_ 334 CSM_RC_ViewExtvideo 0;
BA_ "GenSigInvalidValue" SG_ 334 CSM_RC_ViewExtvideo 65535;
BA_ "GenSigSendType" SG_ 334 CSM_RC_ViewExtvideo 1;
BA_ "GenSigStartValue" SG_ 334 CSM_RC_ViewExtvideo 0;
BA_ "GenSigTimeoutValue" SG_ 334 CSM_RC_ViewExtvideo 0;
BA_ "Remark" SG_ 334 CSM_RC_ViewExtvideo "";
BA_ "EventCommandSignal" SG_ 334 CSM_RC_ViewExtvideoReq 0;
BA_ "GatewayedSignals" SG_ 334 CSM_RC_ViewExtvideoReq 0;
BA_ "GenSigInactiveValue" SG_ 334 CSM_RC_ViewExtvideoReq 0;
BA_ "GenSigInvalidValue" SG_ 334 CSM_RC_ViewExtvideoReq 0;
BA_ "GenSigSendType" SG_ 334 CSM_RC_ViewExtvideoReq 1;
BA_ "GenSigStartValue" SG_ 334 CSM_RC_ViewExtvideoReq 0;
BA_ "GenSigTimeoutValue" SG_ 334 CSM_RC_ViewExtvideoReq 0;
BA_ "Remark" SG_ 334 CSM_RC_ViewExtvideoReq "";
BA_ "EventCommandSignal" SG_ 334 Theft_Auth_Status 1;
BA_ "GatewayedSignals" SG_ 334 Theft_Auth_Status 0;
BA_ "GenSigInactiveValue" SG_ 334 Theft_Auth_Status 0;
BA_ "GenSigInvalidValue" SG_ 334 Theft_Auth_Status 0;
BA_ "GenSigSendType" SG_ 334 Theft_Auth_Status 0;
BA_ "GenSigStartValue" SG_ 334 Theft_Auth_Status 0;
BA_ "GenSigTimeoutValue" SG_ 334 Theft_Auth_Status 0;
BA_ "Remark" SG_ 334 Theft_Auth_Status "";
BA_ "EventCommandSignal" SG_ 290 IPDS_Lidar1PowerSup 1;
BA_ "GatewayedSignals" SG_ 290 IPDS_Lidar1PowerSup 0;
BA_ "GenSigInactiveValue" SG_ 290 IPDS_Lidar1PowerSup 0;
BA_ "GenSigInvalidValue" SG_ 290 IPDS_Lidar1PowerSup 0;
BA_ "GenSigSendType" SG_ 290 IPDS_Lidar1PowerSup 0;
BA_ "GenSigStartValue" SG_ 290 IPDS_Lidar1PowerSup 3;
BA_ "GenSigTimeoutValue" SG_ 290 IPDS_Lidar1PowerSup 0;
BA_ "Remark" SG_ 290 IPDS_Lidar1PowerSup "";
BA_ "EventCommandSignal" SG_ 905 ICM_SetIACCSt 0;
BA_ "GatewayedSignals" SG_ 905 ICM_SetIACCSt 0;
BA_ "GenSigInactiveValue" SG_ 905 ICM_SetIACCSt 0;
BA_ "GenSigInvalidValue" SG_ 905 ICM_SetIACCSt 0;
BA_ "GenSigSendType" SG_ 905 ICM_SetIACCSt 1;
BA_ "GenSigStartValue" SG_ 905 ICM_SetIACCSt 0;
BA_ "GenSigTimeoutValue" SG_ 905 ICM_SetIACCSt 0;
BA_ "Remark" SG_ 905 ICM_SetIACCSt "";
BA_ "EventCommandSignal" SG_ 905 ICM_TotalOdometer 0;
BA_ "GatewayedSignals" SG_ 905 ICM_TotalOdometer 0;
BA_ "GenSigInactiveValue" SG_ 905 ICM_TotalOdometer 0;
BA_ "GenSigInvalidValue" SG_ 905 ICM_TotalOdometer 0;
BA_ "GenSigSendType" SG_ 905 ICM_TotalOdometer 1;
BA_ "GenSigStartValue" SG_ 905 ICM_TotalOdometer 0;
BA_ "EventCommandSignal" SG_ 905 ICM_VehInsSpd 0;
BA_ "GatewayedSignals" SG_ 905 ICM_VehInsSpd 0;
BA_ "GenSigInactiveValue" SG_ 905 ICM_VehInsSpd 0;
BA_ "GenSigInvalidValue" SG_ 905 ICM_VehInsSpd 255;
BA_ "GenSigSendType" SG_ 905 ICM_VehInsSpd 1;
BA_ "GenSigStartValue" SG_ 905 ICM_VehInsSpd 0;
BA_ "GenSigTimeoutValue" SG_ 905 ICM_VehInsSpd 0;
BA_ "Remark" SG_ 905 ICM_VehInsSpd "";
BA_ "EventCommandSignal" SG_ 905 ICM_VehInsSpd_accurate 0;
BA_ "GatewayedSignals" SG_ 905 ICM_VehInsSpd_accurate 0;
BA_ "GenSigInactiveValue" SG_ 905 ICM_VehInsSpd_accurate 0;
BA_ "GenSigInvalidValue" SG_ 905 ICM_VehInsSpd_accurate 2047;
BA_ "GenSigSendType" SG_ 905 ICM_VehInsSpd_accurate 1;
BA_ "GenSigStartValue" SG_ 905 ICM_VehInsSpd_accurate 0;
BA_ "GenSigTimeoutValue" SG_ 905 ICM_VehInsSpd_accurate 0;
BA_ "Remark" SG_ 905 ICM_VehInsSpd_accurate "";
BA_ "EventCommandSignal" SG_ 905 ICM_FuelAvaibleDriveDistance 0;
BA_ "GatewayedSignals" SG_ 905 ICM_FuelAvaibleDriveDistance 0;
BA_ "GenSigInactiveValue" SG_ 905 ICM_FuelAvaibleDriveDistance 0;
BA_ "GenSigInvalidValue" SG_ 905 ICM_FuelAvaibleDriveDistance 2047;
BA_ "GenSigSendType" SG_ 905 ICM_FuelAvaibleDriveDistance 1;
BA_ "GenSigStartValue" SG_ 905 ICM_FuelAvaibleDriveDistance 0;
BA_ "GenSigTimeoutValue" SG_ 905 ICM_FuelAvaibleDriveDistance 0;
BA_ "Remark" SG_ 905 ICM_FuelAvaibleDriveDistance "";
BA_ "EventCommandSignal" SG_ 905 ICM_TotalAvaibleDriveDistance 0;
BA_ "GatewayedSignals" SG_ 905 ICM_TotalAvaibleDriveDistance 0;
BA_ "GenSigInactiveValue" SG_ 905 ICM_TotalAvaibleDriveDistance 0;
BA_ "GenSigInvalidValue" SG_ 905 ICM_TotalAvaibleDriveDistance 2047;
BA_ "GenSigSendType" SG_ 905 ICM_TotalAvaibleDriveDistance 1;
BA_ "GenSigStartValue" SG_ 905 ICM_TotalAvaibleDriveDistance 0;
BA_ "GenSigTimeoutValue" SG_ 905 ICM_TotalAvaibleDriveDistance 0;
BA_ "Remark" SG_ 905 ICM_TotalAvaibleDriveDistance "";
BA_ "EventCommandSignal" SG_ 161 ACU_FaceID_Delete 1;
BA_ "GatewayedSignals" SG_ 161 ACU_FaceID_Delete 0;
BA_ "GenSigInactiveValue" SG_ 161 ACU_FaceID_Delete 0;
BA_ "GenSigInvalidValue" SG_ 161 ACU_FaceID_Delete 0;
BA_ "GenSigSendType" SG_ 161 ACU_FaceID_Delete 0;
BA_ "GenSigStartValue" SG_ 161 ACU_FaceID_Delete 0;
BA_ "GenSigTimeoutValue" SG_ 161 ACU_FaceID_Delete 0;
BA_ "Remark" SG_ 161 ACU_FaceID_Delete "";
BA_ "EventCommandSignal" SG_ 161 ACU_RegisterTriger 1;
BA_ "GatewayedSignals" SG_ 161 ACU_RegisterTriger 0;
BA_ "GenSigInactiveValue" SG_ 161 ACU_RegisterTriger 0;
BA_ "GenSigInvalidValue" SG_ 161 ACU_RegisterTriger 0;
BA_ "GenSigSendType" SG_ 161 ACU_RegisterTriger 0;
BA_ "GenSigStartValue" SG_ 161 ACU_RegisterTriger 0;
BA_ "GenSigTimeoutValue" SG_ 161 ACU_RegisterTriger 0;
BA_ "Remark" SG_ 161 ACU_RegisterTriger "";
BA_ "EventCommandSignal" SG_ 161 ACU_VerifyTriger 1;
BA_ "GatewayedSignals" SG_ 161 ACU_VerifyTriger 0;
BA_ "GenSigInactiveValue" SG_ 161 ACU_VerifyTriger 0;
BA_ "GenSigInvalidValue" SG_ 161 ACU_VerifyTriger 0;
BA_ "GenSigSendType" SG_ 161 ACU_VerifyTriger 0;
BA_ "GenSigStartValue" SG_ 161 ACU_VerifyTriger 0;
BA_ "GenSigTimeoutValue" SG_ 161 ACU_VerifyTriger 0;
BA_ "Remark" SG_ 161 ACU_VerifyTriger "";
BA_ "EventCommandSignal" SG_ 161 ACU_FaceIDQuit 1;
BA_ "GatewayedSignals" SG_ 161 ACU_FaceIDQuit 0;
BA_ "GenSigInactiveValue" SG_ 161 ACU_FaceIDQuit 0;
BA_ "GenSigInvalidValue" SG_ 161 ACU_FaceIDQuit 0;
BA_ "GenSigSendType" SG_ 161 ACU_FaceIDQuit 0;
BA_ "GenSigStartValue" SG_ 161 ACU_FaceIDQuit 0;
BA_ "GenSigTimeoutValue" SG_ 161 ACU_FaceIDQuit 0;
BA_ "Remark" SG_ 161 ACU_FaceIDQuit "";
BA_ "EventCommandSignal" SG_ 161 ACU_FaceIDSwitch 1;
BA_ "GatewayedSignals" SG_ 161 ACU_FaceIDSwitch 0;
BA_ "GenSigInactiveValue" SG_ 161 ACU_FaceIDSwitch 0;
BA_ "GenSigInvalidValue" SG_ 161 ACU_FaceIDSwitch 0;
BA_ "GenSigSendType" SG_ 161 ACU_FaceIDSwitch 0;
BA_ "GenSigStartValue" SG_ 161 ACU_FaceIDSwitch 0;
BA_ "GenSigTimeoutValue" SG_ 161 ACU_FaceIDSwitch 0;
BA_ "Remark" SG_ 161 ACU_FaceIDSwitch "";
BA_ "EventCommandSignal" SG_ 161 ACU_AVAS_SwitchCfgReq 1;
BA_ "GatewayedSignals" SG_ 161 ACU_AVAS_SwitchCfgReq 0;
BA_ "GenSigInactiveValue" SG_ 161 ACU_AVAS_SwitchCfgReq 0;
BA_ "GenSigInvalidValue" SG_ 161 ACU_AVAS_SwitchCfgReq 0;
BA_ "GenSigSendType" SG_ 161 ACU_AVAS_SwitchCfgReq 0;
BA_ "GenSigStartValue" SG_ 161 ACU_AVAS_SwitchCfgReq 0;
BA_ "GenSigTimeoutValue" SG_ 161 ACU_AVAS_SwitchCfgReq 0;
BA_ "Remark" SG_ 161 ACU_AVAS_SwitchCfgReq "";
BA_ "EventCommandSignal" SG_ 351 ACU_VirtualPowerOFFReq 1;
BA_ "GatewayedSignals" SG_ 351 ACU_VirtualPowerOFFReq 0;
BA_ "GenSigInactiveValue" SG_ 351 ACU_VirtualPowerOFFReq 0;
BA_ "GenSigInvalidValue" SG_ 351 ACU_VirtualPowerOFFReq 0;
BA_ "GenSigSendType" SG_ 351 ACU_VirtualPowerOFFReq 0;
BA_ "GenSigStartValue" SG_ 351 ACU_VirtualPowerOFFReq 0;
BA_ "GenSigTimeoutValue" SG_ 351 ACU_VirtualPowerOFFReq 0;
BA_ "Remark" SG_ 351 ACU_VirtualPowerOFFReq "";
BA_ "EventCommandSignal" SG_ 351 ACU_FactoryResetReq 1;
BA_ "GatewayedSignals" SG_ 351 ACU_FactoryResetReq 0;
BA_ "GenSigInactiveValue" SG_ 351 ACU_FactoryResetReq 0;
BA_ "GenSigInvalidValue" SG_ 351 ACU_FactoryResetReq 0;
BA_ "GenSigSendType" SG_ 351 ACU_FactoryResetReq 0;
BA_ "GenSigStartValue" SG_ 351 ACU_FactoryResetReq 0;
BA_ "GenSigTimeoutValue" SG_ 351 ACU_FactoryResetReq 0;
BA_ "Remark" SG_ 351 ACU_FactoryResetReq "";
BA_ "EventCommandSignal" SG_ 351 ACU_Account_Uld 1;
BA_ "GatewayedSignals" SG_ 351 ACU_Account_Uld 0;
BA_ "GenSigInactiveValue" SG_ 351 ACU_Account_Uld 0;
BA_ "GenSigInvalidValue" SG_ 351 ACU_Account_Uld 0;
BA_ "GenSigSendType" SG_ 351 ACU_Account_Uld 0;
BA_ "GenSigStartValue" SG_ 351 ACU_Account_Uld 0;
BA_ "GenSigTimeoutValue" SG_ 351 ACU_Account_Uld 0;
BA_ "Remark" SG_ 351 ACU_Account_Uld "";
BA_ "EventCommandSignal" SG_ 351 ACU_Account_Delete 1;
BA_ "GatewayedSignals" SG_ 351 ACU_Account_Delete 0;
BA_ "GenSigInactiveValue" SG_ 351 ACU_Account_Delete 0;
BA_ "GenSigInvalidValue" SG_ 351 ACU_Account_Delete 0;
BA_ "GenSigSendType" SG_ 351 ACU_Account_Delete 0;
BA_ "GenSigStartValue" SG_ 351 ACU_Account_Delete 0;
BA_ "GenSigTimeoutValue" SG_ 351 ACU_Account_Delete 0;
BA_ "Remark" SG_ 351 ACU_Account_Delete "";
BA_ "EventCommandSignal" SG_ 351 ACU_FrontWiperIntCfgVkReq 1;
BA_ "GatewayedSignals" SG_ 351 ACU_FrontWiperIntCfgVkReq 0;
BA_ "GenSigInactiveValue" SG_ 351 ACU_FrontWiperIntCfgVkReq 0;
BA_ "GenSigInvalidValue" SG_ 351 ACU_FrontWiperIntCfgVkReq 0;
BA_ "GenSigSendType" SG_ 351 ACU_FrontWiperIntCfgVkReq 0;
BA_ "GenSigStartValue" SG_ 351 ACU_FrontWiperIntCfgVkReq 0;
BA_ "GenSigTimeoutValue" SG_ 351 ACU_FrontWiperIntCfgVkReq 0;
BA_ "Remark" SG_ 351 ACU_FrontWiperIntCfgVkReq "";
BA_ "EventCommandSignal" SG_ 351 ACU_FrontWiperAutoCfgVkReq 1;
BA_ "GatewayedSignals" SG_ 351 ACU_FrontWiperAutoCfgVkReq 0;
BA_ "GenSigInactiveValue" SG_ 351 ACU_FrontWiperAutoCfgVkReq 0;
BA_ "GenSigInvalidValue" SG_ 351 ACU_FrontWiperAutoCfgVkReq 0;
BA_ "GenSigSendType" SG_ 351 ACU_FrontWiperAutoCfgVkReq 0;
BA_ "GenSigStartValue" SG_ 351 ACU_FrontWiperAutoCfgVkReq 0;
BA_ "GenSigTimeoutValue" SG_ 351 ACU_FrontWiperAutoCfgVkReq 0;
BA_ "Remark" SG_ 351 ACU_FrontWiperAutoCfgVkReq "";
BA_ "EventCommandSignal" SG_ 351 IDC_VoicePAAReq 1;
BA_ "GatewayedSignals" SG_ 351 IDC_VoicePAAReq 0;
BA_ "GenSigInactiveValue" SG_ 351 IDC_VoicePAAReq 0;
BA_ "GenSigInvalidValue" SG_ 351 IDC_VoicePAAReq 0;
BA_ "GenSigSendType" SG_ 351 IDC_VoicePAAReq 0;
BA_ "GenSigStartValue" SG_ 351 IDC_VoicePAAReq 0;
BA_ "GenSigTimeoutValue" SG_ 351 IDC_VoicePAAReq 0;
BA_ "Remark" SG_ 351 IDC_VoicePAAReq "";
BA_ "EventCommandSignal" SG_ 351 IDC_VoiceParkCheckReq 1;
BA_ "GatewayedSignals" SG_ 351 IDC_VoiceParkCheckReq 0;
BA_ "GenSigInactiveValue" SG_ 351 IDC_VoiceParkCheckReq 0;
BA_ "GenSigInvalidValue" SG_ 351 IDC_VoiceParkCheckReq 0;
BA_ "GenSigSendType" SG_ 351 IDC_VoiceParkCheckReq 0;
BA_ "GenSigStartValue" SG_ 351 IDC_VoiceParkCheckReq 0;
BA_ "GenSigTimeoutValue" SG_ 351 IDC_VoiceParkCheckReq 0;
BA_ "Remark" SG_ 351 IDC_VoiceParkCheckReq "";
BA_ "EventCommandSignal" SG_ 879 ACU_PCS_SVM_MODCmd 0;
BA_ "GatewayedSignals" SG_ 879 ACU_PCS_SVM_MODCmd 0;
BA_ "GenSigInactiveValue" SG_ 879 ACU_PCS_SVM_MODCmd 0;
BA_ "GenSigInvalidValue" SG_ 879 ACU_PCS_SVM_MODCmd 0;
BA_ "GenSigSendType" SG_ 879 ACU_PCS_SVM_MODCmd 1;
BA_ "GenSigStartValue" SG_ 879 ACU_PCS_SVM_MODCmd 0;
BA_ "GenSigTimeoutValue" SG_ 879 ACU_PCS_SVM_MODCmd 0;
BA_ "Remark" SG_ 879 ACU_PCS_SVM_MODCmd "";
BA_ "EventCommandSignal" SG_ 879 ACU_HeadLightVirtualSwSt 0;
BA_ "GatewayedSignals" SG_ 879 ACU_HeadLightVirtualSwSt 0;
BA_ "GenSigInactiveValue" SG_ 879 ACU_HeadLightVirtualSwSt 0;
BA_ "GenSigInvalidValue" SG_ 879 ACU_HeadLightVirtualSwSt 0;
BA_ "GenSigSendType" SG_ 879 ACU_HeadLightVirtualSwSt 1;
BA_ "GenSigStartValue" SG_ 879 ACU_HeadLightVirtualSwSt 0;
BA_ "GenSigTimeoutValue" SG_ 879 ACU_HeadLightVirtualSwSt 0;
BA_ "Remark" SG_ 879 ACU_HeadLightVirtualSwSt "";
BA_ "EventCommandSignal" SG_ 879 ACU_FrontFogLightVirtualSwSt 0;
BA_ "GatewayedSignals" SG_ 879 ACU_FrontFogLightVirtualSwSt 0;
BA_ "GenSigInactiveValue" SG_ 879 ACU_FrontFogLightVirtualSwSt 0;
BA_ "GenSigInvalidValue" SG_ 879 ACU_FrontFogLightVirtualSwSt 0;
BA_ "GenSigSendType" SG_ 879 ACU_FrontFogLightVirtualSwSt 1;
BA_ "GenSigStartValue" SG_ 879 ACU_FrontFogLightVirtualSwSt 0;
BA_ "GenSigTimeoutValue" SG_ 879 ACU_FrontFogLightVirtualSwSt 0;
BA_ "Remark" SG_ 879 ACU_FrontFogLightVirtualSwSt "";
BA_ "EventCommandSignal" SG_ 879 ACU_RearFogLightVirtualSwSt 0;
BA_ "GatewayedSignals" SG_ 879 ACU_RearFogLightVirtualSwSt 0;
BA_ "GenSigInactiveValue" SG_ 879 ACU_RearFogLightVirtualSwSt 0;
BA_ "GenSigInvalidValue" SG_ 879 ACU_RearFogLightVirtualSwSt 0;
BA_ "GenSigSendType" SG_ 879 ACU_RearFogLightVirtualSwSt 1;
BA_ "GenSigStartValue" SG_ 879 ACU_RearFogLightVirtualSwSt 0;
BA_ "GenSigTimeoutValue" SG_ 879 ACU_RearFogLightVirtualSwSt 0;
BA_ "Remark" SG_ 879 ACU_RearFogLightVirtualSwSt "";
BA_ "EventCommandSignal" SG_ 879 IDC_HPAParkingSpdsSw 0;
BA_ "GatewayedSignals" SG_ 879 IDC_HPAParkingSpdsSw 0;
BA_ "GenSigInactiveValue" SG_ 879 IDC_HPAParkingSpdsSw 0;
BA_ "GenSigInvalidValue" SG_ 879 IDC_HPAParkingSpdsSw 0;
BA_ "GenSigSendType" SG_ 879 IDC_HPAParkingSpdsSw 1;
BA_ "GenSigStartValue" SG_ 879 IDC_HPAParkingSpdsSw 0;
BA_ "GenSigTimeoutValue" SG_ 879 IDC_HPAParkingSpdsSw 0;
BA_ "Remark" SG_ 879 IDC_HPAParkingSpdsSw "";
BA_ "EventCommandSignal" SG_ 879 ACU_Account_Uid 0;
BA_ "GatewayedSignals" SG_ 879 ACU_Account_Uid 0;
BA_ "GenSigInactiveValue" SG_ 879 ACU_Account_Uid 0;
BA_ "GenSigInvalidValue" SG_ 879 ACU_Account_Uid 0;
BA_ "GenSigSendType" SG_ 879 ACU_Account_Uid 1;
BA_ "GenSigStartValue" SG_ 879 ACU_Account_Uid 0;
BA_ "GenSigTimeoutValue" SG_ 879 ACU_Account_Uid 0;
BA_ "Remark" SG_ 879 ACU_Account_Uid "";
BA_ "EventCommandSignal" SG_ 879 ACU_FCWWarnDistanceCfg 0;
BA_ "GatewayedSignals" SG_ 879 ACU_FCWWarnDistanceCfg 0;
BA_ "GenSigInactiveValue" SG_ 879 ACU_FCWWarnDistanceCfg 0;
BA_ "GenSigInvalidValue" SG_ 879 ACU_FCWWarnDistanceCfg 0;
BA_ "GenSigSendType" SG_ 879 ACU_FCWWarnDistanceCfg 1;
BA_ "GenSigStartValue" SG_ 879 ACU_FCWWarnDistanceCfg 0;
BA_ "GenSigTimeoutValue" SG_ 879 ACU_FCWWarnDistanceCfg 0;
BA_ "Remark" SG_ 879 ACU_FCWWarnDistanceCfg "Message ID will be changed in PT0";
BA_ "EventCommandSignal" SG_ 879 ACU_FCWCfg 0;
BA_ "GatewayedSignals" SG_ 879 ACU_FCWCfg 0;
BA_ "GenSigInactiveValue" SG_ 879 ACU_FCWCfg 0;
BA_ "GenSigInvalidValue" SG_ 879 ACU_FCWCfg 0;
BA_ "GenSigSendType" SG_ 879 ACU_FCWCfg 1;
BA_ "GenSigStartValue" SG_ 879 ACU_FCWCfg 0;
BA_ "GenSigTimeoutValue" SG_ 879 ACU_FCWCfg 0;
BA_ "Remark" SG_ 879 ACU_FCWCfg "";
BA_ "EventCommandSignal" SG_ 879 ACU_AEBOff 0;
BA_ "GatewayedSignals" SG_ 879 ACU_AEBOff 0;
BA_ "GenSigInactiveValue" SG_ 879 ACU_AEBOff 0;
BA_ "GenSigInvalidValue" SG_ 879 ACU_AEBOff 0;
BA_ "GenSigSendType" SG_ 879 ACU_AEBOff 1;
BA_ "GenSigStartValue" SG_ 879 ACU_AEBOff 0;
BA_ "GenSigTimeoutValue" SG_ 879 ACU_AEBOff 0;
BA_ "Remark" SG_ 879 ACU_AEBOff "";
BA_ "EventCommandSignal" SG_ 879 ACU_TSR_SwitchReq 0;
BA_ "GatewayedSignals" SG_ 879 ACU_TSR_SwitchReq 0;
BA_ "GenSigInactiveValue" SG_ 879 ACU_TSR_SwitchReq 0;
BA_ "GenSigInvalidValue" SG_ 879 ACU_TSR_SwitchReq 0;
BA_ "GenSigSendType" SG_ 879 ACU_TSR_SwitchReq 1;
BA_ "GenSigStartValue" SG_ 879 ACU_TSR_SwitchReq 0;
BA_ "GenSigTimeoutValue" SG_ 879 ACU_TSR_SwitchReq 0;
BA_ "Remark" SG_ 879 ACU_TSR_SwitchReq "";
BA_ "EventCommandSignal" SG_ 879 ACU_IHBC_SwitchReq 0;
BA_ "GatewayedSignals" SG_ 879 ACU_IHBC_SwitchReq 0;
BA_ "GenSigInactiveValue" SG_ 879 ACU_IHBC_SwitchReq 0;
BA_ "GenSigInvalidValue" SG_ 879 ACU_IHBC_SwitchReq 0;
BA_ "GenSigSendType" SG_ 879 ACU_IHBC_SwitchReq 1;
BA_ "GenSigStartValue" SG_ 879 ACU_IHBC_SwitchReq 0;
BA_ "GenSigTimeoutValue" SG_ 879 ACU_IHBC_SwitchReq 0;
BA_ "Remark" SG_ 879 ACU_IHBC_SwitchReq "";
BA_ "EventCommandSignal" SG_ 879 ACU_LDS_TypeReq 0;
BA_ "GatewayedSignals" SG_ 879 ACU_LDS_TypeReq 0;
BA_ "GenSigInactiveValue" SG_ 879 ACU_LDS_TypeReq 0;
BA_ "GenSigInvalidValue" SG_ 879 ACU_LDS_TypeReq 0;
BA_ "GenSigSendType" SG_ 879 ACU_LDS_TypeReq 1;
BA_ "GenSigStartValue" SG_ 879 ACU_LDS_TypeReq 0;
BA_ "GenSigTimeoutValue" SG_ 879 ACU_LDS_TypeReq 0;
BA_ "Remark" SG_ 879 ACU_LDS_TypeReq "";
BA_ "EventCommandSignal" SG_ 879 ACU_BSDCfg 0;
BA_ "GatewayedSignals" SG_ 879 ACU_BSDCfg 0;
BA_ "GenSigInactiveValue" SG_ 879 ACU_BSDCfg 0;
BA_ "GenSigInvalidValue" SG_ 879 ACU_BSDCfg 0;
BA_ "GenSigSendType" SG_ 879 ACU_BSDCfg 1;
BA_ "GenSigStartValue" SG_ 879 ACU_BSDCfg 0;
BA_ "GenSigTimeoutValue" SG_ 879 ACU_BSDCfg 0;
BA_ "Remark" SG_ 879 ACU_BSDCfg "";
BA_ "EventCommandSignal" SG_ 879 ACU_RCTACfg 0;
BA_ "GatewayedSignals" SG_ 879 ACU_RCTACfg 0;
BA_ "GenSigInactiveValue" SG_ 879 ACU_RCTACfg 0;
BA_ "GenSigInvalidValue" SG_ 879 ACU_RCTACfg 0;
BA_ "GenSigSendType" SG_ 879 ACU_RCTACfg 1;
BA_ "GenSigStartValue" SG_ 879 ACU_RCTACfg 0;
BA_ "GenSigTimeoutValue" SG_ 879 ACU_RCTACfg 0;
BA_ "Remark" SG_ 879 ACU_RCTACfg "";
BA_ "EventCommandSignal" SG_ 879 ACU_DOWCfg 0;
BA_ "GatewayedSignals" SG_ 879 ACU_DOWCfg 0;
BA_ "GenSigInactiveValue" SG_ 879 ACU_DOWCfg 0;
BA_ "GenSigInvalidValue" SG_ 879 ACU_DOWCfg 0;
BA_ "GenSigSendType" SG_ 879 ACU_DOWCfg 1;
BA_ "GenSigStartValue" SG_ 879 ACU_DOWCfg 0;
BA_ "GenSigTimeoutValue" SG_ 879 ACU_DOWCfg 0;
BA_ "Remark" SG_ 879 ACU_DOWCfg "";
BA_ "EventCommandSignal" SG_ 879 ACU_TSR_AudioWarnReq 0;
BA_ "GatewayedSignals" SG_ 879 ACU_TSR_AudioWarnReq 0;
BA_ "GenSigInactiveValue" SG_ 879 ACU_TSR_AudioWarnReq 0;
BA_ "GenSigInvalidValue" SG_ 879 ACU_TSR_AudioWarnReq 0;
BA_ "GenSigSendType" SG_ 879 ACU_TSR_AudioWarnReq 1;
BA_ "GenSigStartValue" SG_ 879 ACU_TSR_AudioWarnReq 0;
BA_ "GenSigTimeoutValue" SG_ 879 ACU_TSR_AudioWarnReq 0;
BA_ "Remark" SG_ 879 ACU_TSR_AudioWarnReq "";
BA_ "EventCommandSignal" SG_ 879 ACU_HWAHFCfg 0;
BA_ "GatewayedSignals" SG_ 879 ACU_HWAHFCfg 0;
BA_ "GenSigInactiveValue" SG_ 879 ACU_HWAHFCfg 0;
BA_ "GenSigInvalidValue" SG_ 879 ACU_HWAHFCfg 0;
BA_ "GenSigSendType" SG_ 879 ACU_HWAHFCfg 1;
BA_ "GenSigStartValue" SG_ 879 ACU_HWAHFCfg 0;
BA_ "GenSigTimeoutValue" SG_ 879 ACU_HWAHFCfg 0;
BA_ "Remark" SG_ 879 ACU_HWAHFCfg "";
BA_ "EventCommandSignal" SG_ 879 ACU_HWAHF_AudioWarningTypeCfg 0;
BA_ "GatewayedSignals" SG_ 879 ACU_HWAHF_AudioWarningTypeCfg 0;
BA_ "GenSigInactiveValue" SG_ 879 ACU_HWAHF_AudioWarningTypeCfg 0;
BA_ "GenSigInvalidValue" SG_ 879 ACU_HWAHF_AudioWarningTypeCfg 0;
BA_ "GenSigSendType" SG_ 879 ACU_HWAHF_AudioWarningTypeCfg 1;
BA_ "GenSigStartValue" SG_ 879 ACU_HWAHF_AudioWarningTypeCfg 0;
BA_ "GenSigTimeoutValue" SG_ 879 ACU_HWAHF_AudioWarningTypeCfg 0;
BA_ "Remark" SG_ 879 ACU_HWAHF_AudioWarningTypeCfg "";
BA_ "EventCommandSignal" SG_ 879 ACU_HWA_SwitchReq 0;
BA_ "GatewayedSignals" SG_ 879 ACU_HWA_SwitchReq 0;
BA_ "GenSigInactiveValue" SG_ 879 ACU_HWA_SwitchReq 0;
BA_ "GenSigInvalidValue" SG_ 879 ACU_HWA_SwitchReq 0;
BA_ "GenSigSendType" SG_ 879 ACU_HWA_SwitchReq 1;
BA_ "GenSigStartValue" SG_ 879 ACU_HWA_SwitchReq 0;
BA_ "GenSigTimeoutValue" SG_ 879 ACU_HWA_SwitchReq 0;
BA_ "Remark" SG_ 879 ACU_HWA_SwitchReq "";
BA_ "EventCommandSignal" SG_ 879 ACU_ELKCfg 0;
BA_ "GatewayedSignals" SG_ 879 ACU_ELKCfg 0;
BA_ "GenSigInactiveValue" SG_ 879 ACU_ELKCfg 0;
BA_ "GenSigInvalidValue" SG_ 879 ACU_ELKCfg 0;
BA_ "GenSigSendType" SG_ 879 ACU_ELKCfg 1;
BA_ "GenSigStartValue" SG_ 879 ACU_ELKCfg 0;
BA_ "GenSigTimeoutValue" SG_ 879 ACU_ELKCfg 0;
BA_ "Remark" SG_ 879 ACU_ELKCfg "";
BA_ "EventCommandSignal" SG_ 879 ACU_FCTACfg 0;
BA_ "GatewayedSignals" SG_ 879 ACU_FCTACfg 0;
BA_ "GenSigInactiveValue" SG_ 879 ACU_FCTACfg 0;
BA_ "GenSigInvalidValue" SG_ 879 ACU_FCTACfg 0;
BA_ "GenSigSendType" SG_ 879 ACU_FCTACfg 1;
BA_ "GenSigStartValue" SG_ 879 ACU_FCTACfg 0;
BA_ "GenSigTimeoutValue" SG_ 879 ACU_FCTACfg 0;
BA_ "Remark" SG_ 879 ACU_FCTACfg "";
BA_ "EventCommandSignal" SG_ 879 ACU_RAWCfg 0;
BA_ "GatewayedSignals" SG_ 879 ACU_RAWCfg 0;
BA_ "GenSigInactiveValue" SG_ 879 ACU_RAWCfg 0;
BA_ "GenSigInvalidValue" SG_ 879 ACU_RAWCfg 0;
BA_ "GenSigSendType" SG_ 879 ACU_RAWCfg 1;
BA_ "GenSigStartValue" SG_ 879 ACU_RAWCfg 0;
BA_ "GenSigTimeoutValue" SG_ 879 ACU_RAWCfg 0;
BA_ "Remark" SG_ 879 ACU_RAWCfg "";
BA_ "EventCommandSignal" SG_ 879 ACU_RCTA_TypeReqCfg 0;
BA_ "GatewayedSignals" SG_ 879 ACU_RCTA_TypeReqCfg 0;
BA_ "GenSigInactiveValue" SG_ 879 ACU_RCTA_TypeReqCfg 0;
BA_ "GenSigInvalidValue" SG_ 879 ACU_RCTA_TypeReqCfg 0;
BA_ "GenSigSendType" SG_ 879 ACU_RCTA_TypeReqCfg 1;
BA_ "GenSigStartValue" SG_ 879 ACU_RCTA_TypeReqCfg 0;
BA_ "GenSigTimeoutValue" SG_ 879 ACU_RCTA_TypeReqCfg 0;
BA_ "Remark" SG_ 879 ACU_RCTA_TypeReqCfg "";
BA_ "EventCommandSignal" SG_ 879 ACU_FCTA_TypeReqCfg 0;
BA_ "GatewayedSignals" SG_ 879 ACU_FCTA_TypeReqCfg 0;
BA_ "GenSigInactiveValue" SG_ 879 ACU_FCTA_TypeReqCfg 0;
BA_ "GenSigInvalidValue" SG_ 879 ACU_FCTA_TypeReqCfg 0;
BA_ "GenSigSendType" SG_ 879 ACU_FCTA_TypeReqCfg 1;
BA_ "GenSigStartValue" SG_ 879 ACU_FCTA_TypeReqCfg 0;
BA_ "GenSigTimeoutValue" SG_ 879 ACU_FCTA_TypeReqCfg 0;
BA_ "Remark" SG_ 879 ACU_FCTA_TypeReqCfg "";
BA_ "EventCommandSignal" SG_ 879 ACU_NDASwitchReq 0;
BA_ "GatewayedSignals" SG_ 879 ACU_NDASwitchReq 0;
BA_ "GenSigInactiveValue" SG_ 879 ACU_NDASwitchReq 0;
BA_ "GenSigInvalidValue" SG_ 879 ACU_NDASwitchReq 0;
BA_ "GenSigSendType" SG_ 879 ACU_NDASwitchReq 1;
BA_ "GenSigStartValue" SG_ 879 ACU_NDASwitchReq 0;
BA_ "GenSigTimeoutValue" SG_ 879 ACU_NDASwitchReq 0;
BA_ "Remark" SG_ 879 ACU_NDASwitchReq "";
BA_ "EventCommandSignal" SG_ 879 ACU_NDALCConSwitchReq 0;
BA_ "GatewayedSignals" SG_ 879 ACU_NDALCConSwitchReq 0;
BA_ "GenSigInactiveValue" SG_ 879 ACU_NDALCConSwitchReq 0;
BA_ "GenSigInvalidValue" SG_ 879 ACU_NDALCConSwitchReq 0;
BA_ "GenSigSendType" SG_ 879 ACU_NDALCConSwitchReq 1;
BA_ "GenSigStartValue" SG_ 879 ACU_NDALCConSwitchReq 0;
BA_ "GenSigTimeoutValue" SG_ 879 ACU_NDALCConSwitchReq 0;
BA_ "Remark" SG_ 879 ACU_NDALCConSwitchReq "";
BA_ "EventCommandSignal" SG_ 879 ACU_NDALCStySwitchReq 0;
BA_ "GatewayedSignals" SG_ 879 ACU_NDALCStySwitchReq 0;
BA_ "GenSigInactiveValue" SG_ 879 ACU_NDALCStySwitchReq 0;
BA_ "GenSigInvalidValue" SG_ 879 ACU_NDALCStySwitchReq 0;
BA_ "GenSigSendType" SG_ 879 ACU_NDALCStySwitchReq 1;
BA_ "GenSigStartValue" SG_ 879 ACU_NDALCStySwitchReq 0;
BA_ "GenSigTimeoutValue" SG_ 879 ACU_NDALCStySwitchReq 0;
BA_ "Remark" SG_ 879 ACU_NDALCStySwitchReq "";
BA_ "EventCommandSignal" SG_ 879 ACU_ADASWarnTypeSwitch 0;
BA_ "GatewayedSignals" SG_ 879 ACU_ADASWarnTypeSwitch 0;
BA_ "GenSigInactiveValue" SG_ 879 ACU_ADASWarnTypeSwitch 0;
BA_ "GenSigInvalidValue" SG_ 879 ACU_ADASWarnTypeSwitch 0;
BA_ "GenSigSendType" SG_ 879 ACU_ADASWarnTypeSwitch 1;
BA_ "GenSigStartValue" SG_ 879 ACU_ADASWarnTypeSwitch 0;
BA_ "GenSigTimeoutValue" SG_ 879 ACU_ADASWarnTypeSwitch 0;
BA_ "Remark" SG_ 879 ACU_ADASWarnTypeSwitch "";
BA_ "EventCommandSignal" SG_ 879 ACU_ESACfg 0;
BA_ "GatewayedSignals" SG_ 879 ACU_ESACfg 0;
BA_ "GenSigInactiveValue" SG_ 879 ACU_ESACfg 0;
BA_ "GenSigInvalidValue" SG_ 879 ACU_ESACfg 0;
BA_ "GenSigSendType" SG_ 879 ACU_ESACfg 1;
BA_ "GenSigStartValue" SG_ 879 ACU_ESACfg 1;
BA_ "GenSigTimeoutValue" SG_ 879 ACU_ESACfg 0;
BA_ "Remark" SG_ 879 ACU_ESACfg "";
BA_ "EventCommandSignal" SG_ 879 ACU_ILCCfg 0;
BA_ "GatewayedSignals" SG_ 879 ACU_ILCCfg 0;
BA_ "GenSigInactiveValue" SG_ 879 ACU_ILCCfg 0;
BA_ "GenSigInvalidValue" SG_ 879 ACU_ILCCfg 0;
BA_ "GenSigSendType" SG_ 879 ACU_ILCCfg 1;
BA_ "GenSigStartValue" SG_ 879 ACU_ILCCfg 2;
BA_ "GenSigTimeoutValue" SG_ 879 ACU_ILCCfg 0;
BA_ "Remark" SG_ 879 ACU_ILCCfg "";
BA_ "EventCommandSignal" SG_ 879 ACU_AESCfg 0;
BA_ "GatewayedSignals" SG_ 879 ACU_AESCfg 0;
BA_ "GenSigInactiveValue" SG_ 879 ACU_AESCfg 0;
BA_ "GenSigInvalidValue" SG_ 879 ACU_AESCfg 0;
BA_ "GenSigSendType" SG_ 879 ACU_AESCfg 1;
BA_ "GenSigStartValue" SG_ 879 ACU_AESCfg 3;
BA_ "GenSigTimeoutValue" SG_ 879 ACU_AESCfg 0;
BA_ "Remark" SG_ 879 ACU_AESCfg "";
BA_ "EventCommandSignal" SG_ 879 ACU_ILOACfg 0;
BA_ "GatewayedSignals" SG_ 879 ACU_ILOACfg 0;
BA_ "GenSigInactiveValue" SG_ 879 ACU_ILOACfg 0;
BA_ "GenSigInvalidValue" SG_ 879 ACU_ILOACfg 0;
BA_ "GenSigSendType" SG_ 879 ACU_ILOACfg 1;
BA_ "GenSigStartValue" SG_ 879 ACU_ILOACfg 3;
BA_ "GenSigTimeoutValue" SG_ 879 ACU_ILOACfg 0;
BA_ "Remark" SG_ 879 ACU_ILOACfg "";
BA_ "EventCommandSignal" SG_ 879 ACU_iACC_StyleConfirmSwitchReq 0;
BA_ "GatewayedSignals" SG_ 879 ACU_iACC_StyleConfirmSwitchReq 0;
BA_ "GenSigInactiveValue" SG_ 879 ACU_iACC_StyleConfirmSwitchReq 0;
BA_ "GenSigInvalidValue" SG_ 879 ACU_iACC_StyleConfirmSwitchReq 0;
BA_ "GenSigSendType" SG_ 879 ACU_iACC_StyleConfirmSwitchReq 1;
BA_ "GenSigStartValue" SG_ 879 ACU_iACC_StyleConfirmSwitchReq 3;
BA_ "GenSigTimeoutValue" SG_ 879 ACU_iACC_StyleConfirmSwitchReq 0;
BA_ "Remark" SG_ 879 ACU_iACC_StyleConfirmSwitchReq "";
BA_ "EventCommandSignal" SG_ 879 ACU_IFC_SpeedLimit 0;
BA_ "GatewayedSignals" SG_ 879 ACU_IFC_SpeedLimit 0;
BA_ "GenSigInactiveValue" SG_ 879 ACU_IFC_SpeedLimit 0;
BA_ "GenSigInvalidValue" SG_ 879 ACU_IFC_SpeedLimit 0;
BA_ "GenSigSendType" SG_ 879 ACU_IFC_SpeedLimit 1;
BA_ "GenSigStartValue" SG_ 879 ACU_IFC_SpeedLimit 0;
BA_ "GenSigTimeoutValue" SG_ 879 ACU_IFC_SpeedLimit 0;
BA_ "Remark" SG_ 879 ACU_IFC_SpeedLimit "";
BA_ "EventCommandSignal" SG_ 879 ACU_IFC_ISDRestOfdis 0;
BA_ "GatewayedSignals" SG_ 879 ACU_IFC_ISDRestOfdis 0;
BA_ "GenSigInactiveValue" SG_ 879 ACU_IFC_ISDRestOfdis 0;
BA_ "GenSigInvalidValue" SG_ 879 ACU_IFC_ISDRestOfdis 0;
BA_ "GenSigSendType" SG_ 879 ACU_IFC_ISDRestOfdis 1;
BA_ "GenSigStartValue" SG_ 879 ACU_IFC_ISDRestOfdis 0;
BA_ "GenSigTimeoutValue" SG_ 879 ACU_IFC_ISDRestOfdis 0;
BA_ "Remark" SG_ 879 ACU_IFC_ISDRestOfdis "";
BA_ "EventCommandSignal" SG_ 879 ACU_IFC_SpeedLimitUnit 0;
BA_ "GatewayedSignals" SG_ 879 ACU_IFC_SpeedLimitUnit 0;
BA_ "GenSigInactiveValue" SG_ 879 ACU_IFC_SpeedLimitUnit 0;
BA_ "GenSigInvalidValue" SG_ 879 ACU_IFC_SpeedLimitUnit 0;
BA_ "GenSigSendType" SG_ 879 ACU_IFC_SpeedLimitUnit 1;
BA_ "GenSigStartValue" SG_ 879 ACU_IFC_SpeedLimitUnit 0;
BA_ "GenSigTimeoutValue" SG_ 879 ACU_IFC_SpeedLimitUnit 1;
BA_ "Remark" SG_ 879 ACU_IFC_SpeedLimitUnit "";
BA_ "EventCommandSignal" SG_ 879 ACU_ThemeType 0;
BA_ "GatewayedSignals" SG_ 879 ACU_ThemeType 0;
BA_ "GenSigInactiveValue" SG_ 879 ACU_ThemeType 0;
BA_ "GenSigInvalidValue" SG_ 879 ACU_ThemeType 0;
BA_ "GenSigSendType" SG_ 879 ACU_ThemeType 1;
BA_ "GenSigStartValue" SG_ 879 ACU_ThemeType 0;
BA_ "GenSigTimeoutValue" SG_ 879 ACU_ThemeType 0;
BA_ "Remark" SG_ 879 ACU_ThemeType "";
BA_ "EventCommandSignal" SG_ 879 ACU_IFC_SpeedLimtType 0;
BA_ "GatewayedSignals" SG_ 879 ACU_IFC_SpeedLimtType 0;
BA_ "GenSigInactiveValue" SG_ 879 ACU_IFC_SpeedLimtType 0;
BA_ "GenSigInvalidValue" SG_ 879 ACU_IFC_SpeedLimtType 0;
BA_ "GenSigSendType" SG_ 879 ACU_IFC_SpeedLimtType 1;
BA_ "GenSigStartValue" SG_ 879 ACU_IFC_SpeedLimtType 0;
BA_ "GenSigTimeoutValue" SG_ 879 ACU_IFC_SpeedLimtType 0;
BA_ "Remark" SG_ 879 ACU_IFC_SpeedLimtType "";
BA_ "EventCommandSignal" SG_ 879 ACU_IFC_RoadType 0;
BA_ "GatewayedSignals" SG_ 879 ACU_IFC_RoadType 0;
BA_ "GenSigInactiveValue" SG_ 879 ACU_IFC_RoadType 0;
BA_ "GenSigInvalidValue" SG_ 879 ACU_IFC_RoadType 0;
BA_ "GenSigSendType" SG_ 879 ACU_IFC_RoadType 1;
BA_ "GenSigStartValue" SG_ 879 ACU_IFC_RoadType 0;
BA_ "GenSigTimeoutValue" SG_ 879 ACU_IFC_RoadType 0;
BA_ "Remark" SG_ 879 ACU_IFC_RoadType "";
BA_ "EventCommandSignal" SG_ 879 ACU_IFC_ZoneCode 0;
BA_ "GatewayedSignals" SG_ 879 ACU_IFC_ZoneCode 0;
BA_ "GenSigInactiveValue" SG_ 879 ACU_IFC_ZoneCode 0;
BA_ "GenSigInvalidValue" SG_ 879 ACU_IFC_ZoneCode 0;
BA_ "GenSigSendType" SG_ 879 ACU_IFC_ZoneCode 1;
BA_ "GenSigStartValue" SG_ 879 ACU_IFC_ZoneCode 0;
BA_ "GenSigTimeoutValue" SG_ 879 ACU_IFC_ZoneCode 1;
BA_ "Remark" SG_ 879 ACU_IFC_ZoneCode "";
BA_ "EventCommandSignal" SG_ 879 ACU_IFC_NaviSt 0;
BA_ "GatewayedSignals" SG_ 879 ACU_IFC_NaviSt 0;
BA_ "GenSigInactiveValue" SG_ 879 ACU_IFC_NaviSt 0;
BA_ "GenSigInvalidValue" SG_ 879 ACU_IFC_NaviSt 0;
BA_ "GenSigSendType" SG_ 879 ACU_IFC_NaviSt 1;
BA_ "GenSigStartValue" SG_ 879 ACU_IFC_NaviSt 0;
BA_ "GenSigTimeoutValue" SG_ 879 ACU_IFC_NaviSt 0;
BA_ "Remark" SG_ 879 ACU_IFC_NaviSt "";
BA_ "EventCommandSignal" SG_ 879 ACU_IFC_NaviCorp 0;
BA_ "GatewayedSignals" SG_ 879 ACU_IFC_NaviCorp 0;
BA_ "GenSigInactiveValue" SG_ 879 ACU_IFC_NaviCorp 0;
BA_ "GenSigInvalidValue" SG_ 879 ACU_IFC_NaviCorp 0;
BA_ "GenSigSendType" SG_ 879 ACU_IFC_NaviCorp 1;
BA_ "GenSigStartValue" SG_ 879 ACU_IFC_NaviCorp 0;
BA_ "GenSigTimeoutValue" SG_ 879 ACU_IFC_NaviCorp 0;
BA_ "Remark" SG_ 879 ACU_IFC_NaviCorp "";
BA_ "EventCommandSignal" SG_ 879 ACU_IFC_NaviNewIconDis 0;
BA_ "GatewayedSignals" SG_ 879 ACU_IFC_NaviNewIconDis 0;
BA_ "GenSigInactiveValue" SG_ 879 ACU_IFC_NaviNewIconDis 0;
BA_ "GenSigInvalidValue" SG_ 879 ACU_IFC_NaviNewIconDis 0;
BA_ "GenSigSendType" SG_ 879 ACU_IFC_NaviNewIconDis 1;
BA_ "GenSigStartValue" SG_ 879 ACU_IFC_NaviNewIconDis 0;
BA_ "GenSigTimeoutValue" SG_ 879 ACU_IFC_NaviNewIconDis 0;
BA_ "Remark" SG_ 879 ACU_IFC_NaviNewIconDis "";
BA_ "EventCommandSignal" SG_ 879 ACU_IFC_OfframpSt 0;
BA_ "GatewayedSignals" SG_ 879 ACU_IFC_OfframpSt 0;
BA_ "GenSigInactiveValue" SG_ 879 ACU_IFC_OfframpSt 0;
BA_ "GenSigInvalidValue" SG_ 879 ACU_IFC_OfframpSt 0;
BA_ "GenSigSendType" SG_ 879 ACU_IFC_OfframpSt 1;
BA_ "GenSigStartValue" SG_ 879 ACU_IFC_OfframpSt 0;
BA_ "GenSigTimeoutValue" SG_ 879 ACU_IFC_OfframpSt 0;
BA_ "Remark" SG_ 879 ACU_IFC_OfframpSt "";
BA_ "EventCommandSignal" SG_ 879 ACU_IFC_NaviNewIcon 0;
BA_ "GatewayedSignals" SG_ 879 ACU_IFC_NaviNewIcon 0;
BA_ "GenSigInactiveValue" SG_ 879 ACU_IFC_NaviNewIcon 0;
BA_ "GenSigInvalidValue" SG_ 879 ACU_IFC_NaviNewIcon 0;
BA_ "GenSigSendType" SG_ 879 ACU_IFC_NaviNewIcon 1;
BA_ "GenSigStartValue" SG_ 879 ACU_IFC_NaviNewIcon 0;
BA_ "GenSigTimeoutValue" SG_ 879 ACU_IFC_NaviNewIcon 0;
BA_ "Remark" SG_ 879 ACU_IFC_NaviNewIcon "";
BA_ "EventCommandSignal" SG_ 879 ACU_IFC_SLCAheadDis 0;
BA_ "GatewayedSignals" SG_ 879 ACU_IFC_SLCAheadDis 0;
BA_ "GenSigInactiveValue" SG_ 879 ACU_IFC_SLCAheadDis 0;
BA_ "GenSigInvalidValue" SG_ 879 ACU_IFC_SLCAheadDis 0;
BA_ "GenSigSendType" SG_ 879 ACU_IFC_SLCAheadDis 1;
BA_ "GenSigStartValue" SG_ 879 ACU_IFC_SLCAheadDis 0;
BA_ "GenSigTimeoutValue" SG_ 879 ACU_IFC_SLCAheadDis 0;
BA_ "Remark" SG_ 879 ACU_IFC_SLCAheadDis "";
BA_ "EventCommandSignal" SG_ 879 ACU_DVR_Switch 0;
BA_ "GatewayedSignals" SG_ 879 ACU_DVR_Switch 0;
BA_ "GenSigInactiveValue" SG_ 879 ACU_DVR_Switch 0;
BA_ "GenSigInvalidValue" SG_ 879 ACU_DVR_Switch 0;
BA_ "GenSigSendType" SG_ 879 ACU_DVR_Switch 1;
BA_ "GenSigStartValue" SG_ 879 ACU_DVR_Switch 0;
BA_ "GenSigTimeoutValue" SG_ 879 ACU_DVR_Switch 0;
BA_ "Remark" SG_ 879 ACU_DVR_Switch "";
BA_ "EventCommandSignal" SG_ 879 ACU_IFC_OfframpDis 0;
BA_ "GatewayedSignals" SG_ 879 ACU_IFC_OfframpDis 0;
BA_ "GenSigInactiveValue" SG_ 879 ACU_IFC_OfframpDis 0;
BA_ "GenSigInvalidValue" SG_ 879 ACU_IFC_OfframpDis 0;
BA_ "GenSigSendType" SG_ 879 ACU_IFC_OfframpDis 1;
BA_ "GenSigStartValue" SG_ 879 ACU_IFC_OfframpDis 254;
BA_ "GenSigTimeoutValue" SG_ 879 ACU_IFC_OfframpDis 254;
BA_ "Remark" SG_ 879 ACU_IFC_OfframpDis "";
BA_ "EventCommandSignal" SG_ 475 ACU_MirrSteeringAdjFlag 1;
BA_ "GatewayedSignals" SG_ 475 ACU_MirrSteeringAdjFlag 0;
BA_ "GenSigInactiveValue" SG_ 475 ACU_MirrSteeringAdjFlag 0;
BA_ "GenSigInvalidValue" SG_ 475 ACU_MirrSteeringAdjFlag 0;
BA_ "GenSigSendType" SG_ 475 ACU_MirrSteeringAdjFlag 0;
BA_ "GenSigStartValue" SG_ 475 ACU_MirrSteeringAdjFlag 0;
BA_ "GenSigTimeoutValue" SG_ 475 ACU_MirrSteeringAdjFlag 0;
BA_ "Remark" SG_ 475 ACU_MirrSteeringAdjFlag "";
BA_ "EventCommandSignal" SG_ 1045 ACU_Longitude 0;
BA_ "GatewayedSignals" SG_ 1045 ACU_Longitude 0;
BA_ "GenSigInactiveValue" SG_ 1045 ACU_Longitude 0;
BA_ "GenSigInvalidValue" SG_ 1045 ACU_Longitude 0;
BA_ "GenSigSendType" SG_ 1045 ACU_Longitude 1;
BA_ "GenSigStartValue" SG_ 1045 ACU_Longitude 0;
BA_ "GenSigTimeoutValue" SG_ 1045 ACU_Longitude 0;
BA_ "Remark" SG_ 1045 ACU_Longitude "";
BA_ "EventCommandSignal" SG_ 1045 ACU_Latitude 0;
BA_ "GatewayedSignals" SG_ 1045 ACU_Latitude 0;
BA_ "GenSigInactiveValue" SG_ 1045 ACU_Latitude 0;
BA_ "GenSigInvalidValue" SG_ 1045 ACU_Latitude 0;
BA_ "GenSigSendType" SG_ 1045 ACU_Latitude 1;
BA_ "GenSigStartValue" SG_ 1045 ACU_Latitude 0;
BA_ "GenSigTimeoutValue" SG_ 1045 ACU_Latitude 0;
BA_ "Remark" SG_ 1045 ACU_Latitude "";
BA_ "EventCommandSignal" SG_ 1045 ACU_CampingModeSt 0;
BA_ "GatewayedSignals" SG_ 1045 ACU_CampingModeSt 0;
BA_ "GenSigInactiveValue" SG_ 1045 ACU_CampingModeSt 0;
BA_ "GenSigInvalidValue" SG_ 1045 ACU_CampingModeSt 0;
BA_ "GenSigSendType" SG_ 1045 ACU_CampingModeSt 1;
BA_ "GenSigStartValue" SG_ 1045 ACU_CampingModeSt 0;
BA_ "GenSigTimeoutValue" SG_ 1045 ACU_CampingModeSt 0;
BA_ "Remark" SG_ 1045 ACU_CampingModeSt "";
BA_ "EventCommandSignal" SG_ 163 ACU_PAAMode 1;
BA_ "GatewayedSignals" SG_ 163 ACU_PAAMode 0;
BA_ "GenSigInactiveValue" SG_ 163 ACU_PAAMode 0;
BA_ "GenSigInvalidValue" SG_ 163 ACU_PAAMode 0;
BA_ "GenSigSendType" SG_ 163 ACU_PAAMode 0;
BA_ "GenSigStartValue" SG_ 163 ACU_PAAMode 0;
BA_ "GenSigTimeoutValue" SG_ 163 ACU_PAAMode 0;
BA_ "Remark" SG_ 163 ACU_PAAMode "";
BA_ "EventCommandSignal" SG_ 163 ACU_SVM_Button 1;
BA_ "GatewayedSignals" SG_ 163 ACU_SVM_Button 0;
BA_ "GenSigInactiveValue" SG_ 163 ACU_SVM_Button 0;
BA_ "GenSigInvalidValue" SG_ 163 ACU_SVM_Button 0;
BA_ "GenSigSendType" SG_ 163 ACU_SVM_Button 0;
BA_ "GenSigStartValue" SG_ 163 ACU_SVM_Button 0;
BA_ "GenSigTimeoutValue" SG_ 163 ACU_SVM_Button 0;
BA_ "Remark" SG_ 163 ACU_SVM_Button "";
BA_ "EventCommandSignal" SG_ 163 ACU_RAEBcfg 1;
BA_ "GatewayedSignals" SG_ 163 ACU_RAEBcfg 0;
BA_ "GenSigInactiveValue" SG_ 163 ACU_RAEBcfg 0;
BA_ "GenSigInvalidValue" SG_ 163 ACU_RAEBcfg 0;
BA_ "GenSigSendType" SG_ 163 ACU_RAEBcfg 0;
BA_ "GenSigStartValue" SG_ 163 ACU_RAEBcfg 0;
BA_ "GenSigTimeoutValue" SG_ 163 ACU_RAEBcfg 0;
BA_ "Remark" SG_ 163 ACU_RAEBcfg "";
BA_ "EventCommandSignal" SG_ 163 ACU_PCS_MirrorpagedownButtonST 1;
BA_ "GatewayedSignals" SG_ 163 ACU_PCS_MirrorpagedownButtonST 0;
BA_ "GenSigInactiveValue" SG_ 163 ACU_PCS_MirrorpagedownButtonST 0;
BA_ "GenSigInvalidValue" SG_ 163 ACU_PCS_MirrorpagedownButtonST 0;
BA_ "GenSigSendType" SG_ 163 ACU_PCS_MirrorpagedownButtonST 0;
BA_ "GenSigStartValue" SG_ 163 ACU_PCS_MirrorpagedownButtonST 0;
BA_ "GenSigTimeoutValue" SG_ 163 ACU_PCS_MirrorpagedownButtonST 0;
BA_ "Remark" SG_ 163 ACU_PCS_MirrorpagedownButtonST "";
BA_ "EventCommandSignal" SG_ 163 ACU_PCS_ScreenTouchSt 1;
BA_ "GatewayedSignals" SG_ 163 ACU_PCS_ScreenTouchSt 0;
BA_ "GenSigInactiveValue" SG_ 163 ACU_PCS_ScreenTouchSt 0;
BA_ "GenSigInvalidValue" SG_ 163 ACU_PCS_ScreenTouchSt 0;
BA_ "GenSigSendType" SG_ 163 ACU_PCS_ScreenTouchSt 0;
BA_ "GenSigStartValue" SG_ 163 ACU_PCS_ScreenTouchSt 0;
BA_ "GenSigTimeoutValue" SG_ 163 ACU_PCS_ScreenTouchSt 0;
BA_ "Remark" SG_ 163 ACU_PCS_ScreenTouchSt "";
BA_ "EventCommandSignal" SG_ 163 ACU_LanguageTypeSet 1;
BA_ "GatewayedSignals" SG_ 163 ACU_LanguageTypeSet 0;
BA_ "GenSigInactiveValue" SG_ 163 ACU_LanguageTypeSet 0;
BA_ "GenSigInvalidValue" SG_ 163 ACU_LanguageTypeSet 0;
BA_ "GenSigSendType" SG_ 163 ACU_LanguageTypeSet 0;
BA_ "GenSigStartValue" SG_ 163 ACU_LanguageTypeSet 0;
BA_ "GenSigTimeoutValue" SG_ 163 ACU_LanguageTypeSet 0;
BA_ "Remark" SG_ 163 ACU_LanguageTypeSet "";
BA_ "EventCommandSignal" SG_ 163 ACU_PCS_SVM_FunctionCmd 1;
BA_ "GatewayedSignals" SG_ 163 ACU_PCS_SVM_FunctionCmd 0;
BA_ "GenSigInactiveValue" SG_ 163 ACU_PCS_SVM_FunctionCmd 0;
BA_ "GenSigInvalidValue" SG_ 163 ACU_PCS_SVM_FunctionCmd 0;
BA_ "GenSigSendType" SG_ 163 ACU_PCS_SVM_FunctionCmd 0;
BA_ "GenSigStartValue" SG_ 163 ACU_PCS_SVM_FunctionCmd 0;
BA_ "GenSigTimeoutValue" SG_ 163 ACU_PCS_SVM_FunctionCmd 0;
BA_ "Remark" SG_ 163 ACU_PCS_SVM_FunctionCmd "";
BA_ "EventCommandSignal" SG_ 163 ACU_PCS_ScreenCoordY 1;
BA_ "GatewayedSignals" SG_ 163 ACU_PCS_ScreenCoordY 0;
BA_ "GenSigInactiveValue" SG_ 163 ACU_PCS_ScreenCoordY 0;
BA_ "GenSigInvalidValue" SG_ 163 ACU_PCS_ScreenCoordY 0;
BA_ "GenSigSendType" SG_ 163 ACU_PCS_ScreenCoordY 0;
BA_ "GenSigStartValue" SG_ 163 ACU_PCS_ScreenCoordY 0;
BA_ "GenSigTimeoutValue" SG_ 163 ACU_PCS_ScreenCoordY 0;
BA_ "Remark" SG_ 163 ACU_PCS_ScreenCoordY "";
BA_ "EventCommandSignal" SG_ 163 ACU_PCS_ScreenCoordX 1;
BA_ "GatewayedSignals" SG_ 163 ACU_PCS_ScreenCoordX 0;
BA_ "GenSigInactiveValue" SG_ 163 ACU_PCS_ScreenCoordX 0;
BA_ "GenSigInvalidValue" SG_ 163 ACU_PCS_ScreenCoordX 0;
BA_ "GenSigSendType" SG_ 163 ACU_PCS_ScreenCoordX 0;
BA_ "GenSigStartValue" SG_ 163 ACU_PCS_ScreenCoordX 0;
BA_ "GenSigTimeoutValue" SG_ 163 ACU_PCS_ScreenCoordX 0;
BA_ "Remark" SG_ 163 ACU_PCS_ScreenCoordX "";
BA_ "EventCommandSignal" SG_ 163 ACU_APAMessageSt 1;
BA_ "GatewayedSignals" SG_ 163 ACU_APAMessageSt 0;
BA_ "GenSigInactiveValue" SG_ 163 ACU_APAMessageSt 0;
BA_ "GenSigInvalidValue" SG_ 163 ACU_APAMessageSt 0;
BA_ "GenSigSendType" SG_ 163 ACU_APAMessageSt 0;
BA_ "GenSigStartValue" SG_ 163 ACU_APAMessageSt 0;
BA_ "GenSigTimeoutValue" SG_ 163 ACU_APAMessageSt 0;
BA_ "Remark" SG_ 163 ACU_APAMessageSt "";
BA_ "EventCommandSignal" SG_ 163 ACU_PAS_ButtonPress 1;
BA_ "GatewayedSignals" SG_ 163 ACU_PAS_ButtonPress 0;
BA_ "GenSigInactiveValue" SG_ 163 ACU_PAS_ButtonPress 0;
BA_ "GenSigInvalidValue" SG_ 163 ACU_PAS_ButtonPress 0;
BA_ "GenSigSendType" SG_ 163 ACU_PAS_ButtonPress 0;
BA_ "GenSigStartValue" SG_ 163 ACU_PAS_ButtonPress 0;
BA_ "GenSigTimeoutValue" SG_ 163 ACU_PAS_ButtonPress 0;
BA_ "Remark" SG_ 163 ACU_PAS_ButtonPress "";
BA_ "EventCommandSignal" SG_ 163 ACU_HPAMessageSt 1;
BA_ "GatewayedSignals" SG_ 163 ACU_HPAMessageSt 0;
BA_ "GenSigInactiveValue" SG_ 163 ACU_HPAMessageSt 0;
BA_ "GenSigInvalidValue" SG_ 163 ACU_HPAMessageSt 0;
BA_ "GenSigSendType" SG_ 163 ACU_HPAMessageSt 0;
BA_ "GenSigStartValue" SG_ 163 ACU_HPAMessageSt 0;
BA_ "GenSigTimeoutValue" SG_ 163 ACU_HPAMessageSt 0;
BA_ "Remark" SG_ 163 ACU_HPAMessageSt "";
BA_ "EventCommandSignal" SG_ 163 ACU_AVPMessageSt 1;
BA_ "GatewayedSignals" SG_ 163 ACU_AVPMessageSt 0;
BA_ "GenSigInactiveValue" SG_ 163 ACU_AVPMessageSt 0;
BA_ "GenSigInvalidValue" SG_ 163 ACU_AVPMessageSt 0;
BA_ "GenSigSendType" SG_ 163 ACU_AVPMessageSt 0;
BA_ "GenSigStartValue" SG_ 163 ACU_AVPMessageSt 0;
BA_ "GenSigTimeoutValue" SG_ 163 ACU_AVPMessageSt 0;
BA_ "Remark" SG_ 163 ACU_AVPMessageSt "";
BA_ "EventCommandSignal" SG_ 163 ACU_HPALearningSetParkLot 1;
BA_ "GatewayedSignals" SG_ 163 ACU_HPALearningSetParkLot 0;
BA_ "GenSigInactiveValue" SG_ 163 ACU_HPALearningSetParkLot 0;
BA_ "GenSigInvalidValue" SG_ 163 ACU_HPALearningSetParkLot 0;
BA_ "GenSigSendType" SG_ 163 ACU_HPALearningSetParkLot 0;
BA_ "GenSigStartValue" SG_ 163 ACU_HPALearningSetParkLot 0;
BA_ "GenSigTimeoutValue" SG_ 163 ACU_HPALearningSetParkLot 0;
BA_ "Remark" SG_ 163 ACU_HPALearningSetParkLot "";
BA_ "EventCommandSignal" SG_ 163 ACU_HPALearningProcessInfo 1;
BA_ "GatewayedSignals" SG_ 163 ACU_HPALearningProcessInfo 0;
BA_ "GenSigInactiveValue" SG_ 163 ACU_HPALearningProcessInfo 0;
BA_ "GenSigInvalidValue" SG_ 163 ACU_HPALearningProcessInfo 0;
BA_ "GenSigSendType" SG_ 163 ACU_HPALearningProcessInfo 0;
BA_ "GenSigStartValue" SG_ 163 ACU_HPALearningProcessInfo 0;
BA_ "GenSigTimeoutValue" SG_ 163 ACU_HPALearningProcessInfo 0;
BA_ "Remark" SG_ 163 ACU_HPALearningProcessInfo "";
BA_ "EventCommandSignal" SG_ 163 ACU_SDEnterParkingLot 1;
BA_ "GatewayedSignals" SG_ 163 ACU_SDEnterParkingLot 0;
BA_ "GenSigInactiveValue" SG_ 163 ACU_SDEnterParkingLot 0;
BA_ "GenSigInvalidValue" SG_ 163 ACU_SDEnterParkingLot 0;
BA_ "GenSigSendType" SG_ 163 ACU_SDEnterParkingLot 0;
BA_ "GenSigStartValue" SG_ 163 ACU_SDEnterParkingLot 0;
BA_ "GenSigTimeoutValue" SG_ 163 ACU_SDEnterParkingLot 0;
BA_ "Remark" SG_ 163 ACU_SDEnterParkingLot "";
BA_ "EventCommandSignal" SG_ 163 ACU_PCS_ER_QuitConfirm 1;
BA_ "GatewayedSignals" SG_ 163 ACU_PCS_ER_QuitConfirm 0;
BA_ "GenSigInactiveValue" SG_ 163 ACU_PCS_ER_QuitConfirm 0;
BA_ "GenSigInvalidValue" SG_ 163 ACU_PCS_ER_QuitConfirm 0;
BA_ "GenSigSendType" SG_ 163 ACU_PCS_ER_QuitConfirm 0;
BA_ "GenSigStartValue" SG_ 163 ACU_PCS_ER_QuitConfirm 0;
BA_ "GenSigTimeoutValue" SG_ 163 ACU_PCS_ER_QuitConfirm 0;
BA_ "Remark" SG_ 163 ACU_PCS_ER_QuitConfirm "";
BA_ "EventCommandSignal" SG_ 163 ACU_DisplayReq 1;
BA_ "GatewayedSignals" SG_ 163 ACU_DisplayReq 0;
BA_ "GenSigInactiveValue" SG_ 163 ACU_DisplayReq 0;
BA_ "GenSigInvalidValue" SG_ 163 ACU_DisplayReq 0;
BA_ "GenSigSendType" SG_ 163 ACU_DisplayReq 0;
BA_ "GenSigStartValue" SG_ 163 ACU_DisplayReq 0;
BA_ "GenSigTimeoutValue" SG_ 163 ACU_DisplayReq 0;
BA_ "Remark" SG_ 163 ACU_DisplayReq "";
BA_ "EventCommandSignal" SG_ 163 ACU_ER_FuncCfg 1;
BA_ "GatewayedSignals" SG_ 163 ACU_ER_FuncCfg 0;
BA_ "GenSigInactiveValue" SG_ 163 ACU_ER_FuncCfg 0;
BA_ "GenSigInvalidValue" SG_ 163 ACU_ER_FuncCfg 0;
BA_ "GenSigSendType" SG_ 163 ACU_ER_FuncCfg 0;
BA_ "GenSigStartValue" SG_ 163 ACU_ER_FuncCfg 0;
BA_ "GenSigTimeoutValue" SG_ 163 ACU_ER_FuncCfg 0;
BA_ "Remark" SG_ 163 ACU_ER_FuncCfg "";
BA_ "EventCommandSignal" SG_ 163 ACU_PCS_ER_EnterCmd 1;
BA_ "GatewayedSignals" SG_ 163 ACU_PCS_ER_EnterCmd 0;
BA_ "GenSigInactiveValue" SG_ 163 ACU_PCS_ER_EnterCmd 0;
BA_ "GenSigInvalidValue" SG_ 163 ACU_PCS_ER_EnterCmd 0;
BA_ "GenSigSendType" SG_ 163 ACU_PCS_ER_EnterCmd 0;
BA_ "GenSigStartValue" SG_ 163 ACU_PCS_ER_EnterCmd 0;
BA_ "GenSigTimeoutValue" SG_ 163 ACU_PCS_ER_EnterCmd 0;
BA_ "Remark" SG_ 163 ACU_PCS_ER_EnterCmd "";
BA_ "EventCommandSignal" SG_ 163 ACU_PCS_ScreenTouchSignal 1;
BA_ "GatewayedSignals" SG_ 163 ACU_PCS_ScreenTouchSignal 0;
BA_ "GenSigInactiveValue" SG_ 163 ACU_PCS_ScreenTouchSignal 0;
BA_ "GenSigInvalidValue" SG_ 163 ACU_PCS_ScreenTouchSignal 0;
BA_ "GenSigSendType" SG_ 163 ACU_PCS_ScreenTouchSignal 0;
BA_ "GenSigStartValue" SG_ 163 ACU_PCS_ScreenTouchSignal 0;
BA_ "GenSigTimeoutValue" SG_ 163 ACU_PCS_ScreenTouchSignal 0;
BA_ "Remark" SG_ 163 ACU_PCS_ScreenTouchSignal "";
BA_ "EventCommandSignal" SG_ 163 ACU_PCSModeSt_A 1;
BA_ "GatewayedSignals" SG_ 163 ACU_PCSModeSt_A 0;
BA_ "GenSigInactiveValue" SG_ 163 ACU_PCSModeSt_A 0;
BA_ "GenSigInvalidValue" SG_ 163 ACU_PCSModeSt_A 0;
BA_ "GenSigSendType" SG_ 163 ACU_PCSModeSt_A 0;
BA_ "GenSigStartValue" SG_ 163 ACU_PCSModeSt_A 0;
BA_ "GenSigTimeoutValue" SG_ 163 ACU_PCSModeSt_A 0;
BA_ "Remark" SG_ 163 ACU_PCSModeSt_A "";
BA_ "EventCommandSignal" SG_ 163 ACU_DPMessageSt 1;
BA_ "GatewayedSignals" SG_ 163 ACU_DPMessageSt 0;
BA_ "GenSigInactiveValue" SG_ 163 ACU_DPMessageSt 0;
BA_ "GenSigInvalidValue" SG_ 163 ACU_DPMessageSt 0;
BA_ "GenSigSendType" SG_ 163 ACU_DPMessageSt 0;
BA_ "GenSigStartValue" SG_ 163 ACU_DPMessageSt 0;
BA_ "GenSigTimeoutValue" SG_ 163 ACU_DPMessageSt 0;
BA_ "Remark" SG_ 163 ACU_DPMessageSt "";
BA_ "EventCommandSignal" SG_ 163 ACU_ParkingBoxMidX 1;
BA_ "GatewayedSignals" SG_ 163 ACU_ParkingBoxMidX 0;
BA_ "GenSigInactiveValue" SG_ 163 ACU_ParkingBoxMidX 0;
BA_ "GenSigInvalidValue" SG_ 163 ACU_ParkingBoxMidX 0;
BA_ "GenSigSendType" SG_ 163 ACU_ParkingBoxMidX 0;
BA_ "GenSigStartValue" SG_ 163 ACU_ParkingBoxMidX 0;
BA_ "GenSigTimeoutValue" SG_ 163 ACU_ParkingBoxMidX 0;
BA_ "Remark" SG_ 163 ACU_ParkingBoxMidX "";
BA_ "EventCommandSignal" SG_ 163 ACU_ParkingBoxMidY 1;
BA_ "GatewayedSignals" SG_ 163 ACU_ParkingBoxMidY 0;
BA_ "GenSigInactiveValue" SG_ 163 ACU_ParkingBoxMidY 0;
BA_ "GenSigInvalidValue" SG_ 163 ACU_ParkingBoxMidY 0;
BA_ "GenSigSendType" SG_ 163 ACU_ParkingBoxMidY 0;
BA_ "GenSigStartValue" SG_ 163 ACU_ParkingBoxMidY 0;
BA_ "GenSigTimeoutValue" SG_ 163 ACU_ParkingBoxMidY 0;
BA_ "Remark" SG_ 163 ACU_ParkingBoxMidY "";
BA_ "EventCommandSignal" SG_ 163 ACU_ParkingBoxAngle 1;
BA_ "GatewayedSignals" SG_ 163 ACU_ParkingBoxAngle 0;
BA_ "GenSigInactiveValue" SG_ 163 ACU_ParkingBoxAngle 0;
BA_ "GenSigInvalidValue" SG_ 163 ACU_ParkingBoxAngle 0;
BA_ "GenSigSendType" SG_ 163 ACU_ParkingBoxAngle 0;
BA_ "GenSigStartValue" SG_ 163 ACU_ParkingBoxAngle 0;
BA_ "GenSigTimeoutValue" SG_ 163 ACU_ParkingBoxAngle 0;
BA_ "Remark" SG_ 163 ACU_ParkingBoxAngle "";
BA_ "EventCommandSignal" SG_ 163 ACU_PCSModeSt 1;
BA_ "GatewayedSignals" SG_ 163 ACU_PCSModeSt 0;
BA_ "GenSigInactiveValue" SG_ 163 ACU_PCSModeSt 0;
BA_ "GenSigInvalidValue" SG_ 163 ACU_PCSModeSt 0;
BA_ "GenSigSendType" SG_ 163 ACU_PCSModeSt 0;
BA_ "GenSigStartValue" SG_ 163 ACU_PCSModeSt 0;
BA_ "GenSigTimeoutValue" SG_ 163 ACU_PCSModeSt 0;
BA_ "Remark" SG_ 163 ACU_PCSModeSt "";
BA_ "EventCommandSignal" SG_ 163 ACU_LowPowerConfig 1;
BA_ "GatewayedSignals" SG_ 163 ACU_LowPowerConfig 0;
BA_ "GenSigInactiveValue" SG_ 163 ACU_LowPowerConfig 0;
BA_ "GenSigInvalidValue" SG_ 163 ACU_LowPowerConfig 0;
BA_ "GenSigSendType" SG_ 163 ACU_LowPowerConfig 0;
BA_ "GenSigStartValue" SG_ 163 ACU_LowPowerConfig 0;
BA_ "GenSigTimeoutValue" SG_ 163 ACU_LowPowerConfig 0;
BA_ "Remark" SG_ 163 ACU_LowPowerConfig "";
BA_ "EventCommandSignal" SG_ 163 ACU_NDAVoicePromptTypeCfg 1;
BA_ "GatewayedSignals" SG_ 163 ACU_NDAVoicePromptTypeCfg 0;
BA_ "GenSigInactiveValue" SG_ 163 ACU_NDAVoicePromptTypeCfg 0;
BA_ "GenSigInvalidValue" SG_ 163 ACU_NDAVoicePromptTypeCfg 0;
BA_ "GenSigSendType" SG_ 163 ACU_NDAVoicePromptTypeCfg 0;
BA_ "GenSigStartValue" SG_ 163 ACU_NDAVoicePromptTypeCfg 0;
BA_ "GenSigTimeoutValue" SG_ 163 ACU_NDAVoicePromptTypeCfg 0;
BA_ "Remark" SG_ 163 ACU_NDAVoicePromptTypeCfg "";
BA_ "EventCommandSignal" SG_ 163 IDC_SenslesEtyParkingSwSt 1;
BA_ "GatewayedSignals" SG_ 163 IDC_SenslesEtyParkingSwSt 0;
BA_ "GenSigInactiveValue" SG_ 163 IDC_SenslesEtyParkingSwSt 0;
BA_ "GenSigInvalidValue" SG_ 163 IDC_SenslesEtyParkingSwSt 0;
BA_ "GenSigSendType" SG_ 163 IDC_SenslesEtyParkingSwSt 0;
BA_ "GenSigStartValue" SG_ 163 IDC_SenslesEtyParkingSwSt 0;
BA_ "GenSigTimeoutValue" SG_ 163 IDC_SenslesEtyParkingSwSt 0;
BA_ "Remark" SG_ 163 IDC_SenslesEtyParkingSwSt "";
BA_ "EventCommandSignal" SG_ 163 IDC_DskScreenOperationSt 1;
BA_ "GatewayedSignals" SG_ 163 IDC_DskScreenOperationSt 0;
BA_ "GenSigInactiveValue" SG_ 163 IDC_DskScreenOperationSt 0;
BA_ "GenSigInvalidValue" SG_ 163 IDC_DskScreenOperationSt 0;
BA_ "GenSigSendType" SG_ 163 IDC_DskScreenOperationSt 0;
BA_ "GenSigStartValue" SG_ 163 IDC_DskScreenOperationSt 0;
BA_ "GenSigTimeoutValue" SG_ 163 IDC_DskScreenOperationSt 0;
BA_ "Remark" SG_ 163 IDC_DskScreenOperationSt "";
BA_ "EventCommandSignal" SG_ 163 IDC_APAParkingSpdsSfg 1;
BA_ "GatewayedSignals" SG_ 163 IDC_APAParkingSpdsSfg 0;
BA_ "GenSigInactiveValue" SG_ 163 IDC_APAParkingSpdsSfg 0;
BA_ "GenSigInvalidValue" SG_ 163 IDC_APAParkingSpdsSfg 0;
BA_ "GenSigSendType" SG_ 163 IDC_APAParkingSpdsSfg 0;
BA_ "GenSigStartValue" SG_ 163 IDC_APAParkingSpdsSfg 0;
BA_ "GenSigTimeoutValue" SG_ 163 IDC_APAParkingSpdsSfg 0;
BA_ "Remark" SG_ 163 IDC_APAParkingSpdsSfg "";
BA_ "EventCommandSignal" SG_ 163 ACU_VR_APAControl 1;
BA_ "GatewayedSignals" SG_ 163 ACU_VR_APAControl 0;
BA_ "GenSigInactiveValue" SG_ 163 ACU_VR_APAControl 0;
BA_ "GenSigInvalidValue" SG_ 163 ACU_VR_APAControl 0;
BA_ "GenSigSendType" SG_ 163 ACU_VR_APAControl 0;
BA_ "GenSigStartValue" SG_ 163 ACU_VR_APAControl 0;
BA_ "GenSigTimeoutValue" SG_ 163 ACU_VR_APAControl 0;
BA_ "Remark" SG_ 163 ACU_VR_APAControl "";
BA_ "EventCommandSignal" SG_ 163 ACU_SteeringPrkgButton 1;
BA_ "GatewayedSignals" SG_ 163 ACU_SteeringPrkgButton 0;
BA_ "GenSigInactiveValue" SG_ 163 ACU_SteeringPrkgButton 0;
BA_ "GenSigInvalidValue" SG_ 163 ACU_SteeringPrkgButton 0;
BA_ "GenSigSendType" SG_ 163 ACU_SteeringPrkgButton 0;
BA_ "GenSigStartValue" SG_ 163 ACU_SteeringPrkgButton 0;
BA_ "GenSigTimeoutValue" SG_ 163 ACU_SteeringPrkgButton 0;
BA_ "Remark" SG_ 163 ACU_SteeringPrkgButton "";
BA_ "EventCommandSignal" SG_ 163 IDC_SenslesEtyParkingDskScene 1;
BA_ "GatewayedSignals" SG_ 163 IDC_SenslesEtyParkingDskScene 0;
BA_ "GenSigInactiveValue" SG_ 163 IDC_SenslesEtyParkingDskScene 0;
BA_ "GenSigInvalidValue" SG_ 163 IDC_SenslesEtyParkingDskScene 0;
BA_ "GenSigSendType" SG_ 163 IDC_SenslesEtyParkingDskScene 0;
BA_ "GenSigStartValue" SG_ 163 IDC_SenslesEtyParkingDskScene 0;
BA_ "GenSigTimeoutValue" SG_ 163 IDC_SenslesEtyParkingDskScene 0;
BA_ "Remark" SG_ 163 IDC_SenslesEtyParkingDskScene "";
BA_ "EventCommandSignal" SG_ 163 ACU_SVM_Button_A 1;
BA_ "GatewayedSignals" SG_ 163 ACU_SVM_Button_A 0;
BA_ "GenSigInactiveValue" SG_ 163 ACU_SVM_Button_A 0;
BA_ "GenSigInvalidValue" SG_ 163 ACU_SVM_Button_A 0;
BA_ "GenSigSendType" SG_ 163 ACU_SVM_Button_A 0;
BA_ "GenSigStartValue" SG_ 163 ACU_SVM_Button_A 0;
BA_ "GenSigTimeoutValue" SG_ 163 ACU_SVM_Button_A 0;
BA_ "Remark" SG_ 163 ACU_SVM_Button_A "";
BA_ "EventCommandSignal" SG_ 163 ACU_ActiveNDAMessageSt 1;
BA_ "GatewayedSignals" SG_ 163 ACU_ActiveNDAMessageSt 0;
BA_ "GenSigInactiveValue" SG_ 163 ACU_ActiveNDAMessageSt 0;
BA_ "GenSigInvalidValue" SG_ 163 ACU_ActiveNDAMessageSt 0;
BA_ "GenSigSendType" SG_ 163 ACU_ActiveNDAMessageSt 0;
BA_ "GenSigStartValue" SG_ 163 ACU_ActiveNDAMessageSt 0;
BA_ "GenSigTimeoutValue" SG_ 163 ACU_ActiveNDAMessageSt 0;
BA_ "Remark" SG_ 163 ACU_ActiveNDAMessageSt "";
BA_ "EventCommandSignal" SG_ 163 ACU_ActiveAVPMessageSt 1;
BA_ "GatewayedSignals" SG_ 163 ACU_ActiveAVPMessageSt 0;
BA_ "GenSigInactiveValue" SG_ 163 ACU_ActiveAVPMessageSt 0;
BA_ "GenSigInvalidValue" SG_ 163 ACU_ActiveAVPMessageSt 0;
BA_ "GenSigSendType" SG_ 163 ACU_ActiveAVPMessageSt 0;
BA_ "GenSigStartValue" SG_ 163 ACU_ActiveAVPMessageSt 0;
BA_ "GenSigTimeoutValue" SG_ 163 ACU_ActiveAVPMessageSt 0;
BA_ "Remark" SG_ 163 ACU_ActiveAVPMessageSt "";
BA_ "EventCommandSignal" SG_ 163 ACU_LeftLaneChangeMessageSt 1;
BA_ "GatewayedSignals" SG_ 163 ACU_LeftLaneChangeMessageSt 0;
BA_ "GenSigInactiveValue" SG_ 163 ACU_LeftLaneChangeMessageSt 0;
BA_ "GenSigInvalidValue" SG_ 163 ACU_LeftLaneChangeMessageSt 0;
BA_ "GenSigSendType" SG_ 163 ACU_LeftLaneChangeMessageSt 0;
BA_ "GenSigStartValue" SG_ 163 ACU_LeftLaneChangeMessageSt 0;
BA_ "GenSigTimeoutValue" SG_ 163 ACU_LeftLaneChangeMessageSt 0;
BA_ "Remark" SG_ 163 ACU_LeftLaneChangeMessageSt "";
BA_ "EventCommandSignal" SG_ 163 ACU_RigthLaneChangeMessageSt 1;
BA_ "GatewayedSignals" SG_ 163 ACU_RigthLaneChangeMessageSt 0;
BA_ "GenSigInactiveValue" SG_ 163 ACU_RigthLaneChangeMessageSt 0;
BA_ "GenSigInvalidValue" SG_ 163 ACU_RigthLaneChangeMessageSt 0;
BA_ "GenSigSendType" SG_ 163 ACU_RigthLaneChangeMessageSt 0;
BA_ "GenSigStartValue" SG_ 163 ACU_RigthLaneChangeMessageSt 0;
BA_ "GenSigTimeoutValue" SG_ 163 ACU_RigthLaneChangeMessageSt 0;
BA_ "Remark" SG_ 163 ACU_RigthLaneChangeMessageSt "";
BA_ "EventCommandSignal" SG_ 163 ACU_ICANDAIconMessageSt 1;
BA_ "GatewayedSignals" SG_ 163 ACU_ICANDAIconMessageSt 0;
BA_ "GenSigInactiveValue" SG_ 163 ACU_ICANDAIconMessageSt 0;
BA_ "GenSigInvalidValue" SG_ 163 ACU_ICANDAIconMessageSt 0;
BA_ "GenSigSendType" SG_ 163 ACU_ICANDAIconMessageSt 0;
BA_ "GenSigStartValue" SG_ 163 ACU_ICANDAIconMessageSt 0;
BA_ "GenSigTimeoutValue" SG_ 163 ACU_ICANDAIconMessageSt 0;
BA_ "Remark" SG_ 163 ACU_ICANDAIconMessageSt "";
BA_ "EventCommandSignal" SG_ 780 ACU_ISACountryID 0;
BA_ "GatewayedSignals" SG_ 780 ACU_ISACountryID 0;
BA_ "GenSigInactiveValue" SG_ 780 ACU_ISACountryID 0;
BA_ "GenSigInvalidValue" SG_ 780 ACU_ISACountryID 0;
BA_ "GenSigSendType" SG_ 780 ACU_ISACountryID 1;
BA_ "GenSigStartValue" SG_ 780 ACU_ISACountryID 0;
BA_ "GenSigTimeoutValue" SG_ 780 ACU_ISACountryID 0;
BA_ "Remark" SG_ 780 ACU_ISACountryID "";
BA_ "EventCommandSignal" SG_ 780 ACU_ISARoadTyp 0;
BA_ "GatewayedSignals" SG_ 780 ACU_ISARoadTyp 0;
BA_ "GenSigInactiveValue" SG_ 780 ACU_ISARoadTyp 0;
BA_ "GenSigInvalidValue" SG_ 780 ACU_ISARoadTyp 0;
BA_ "GenSigSendType" SG_ 780 ACU_ISARoadTyp 1;
BA_ "GenSigStartValue" SG_ 780 ACU_ISARoadTyp 0;
BA_ "GenSigTimeoutValue" SG_ 780 ACU_ISARoadTyp 0;
BA_ "Remark" SG_ 780 ACU_ISARoadTyp "";
BA_ "EventCommandSignal" SG_ 780 ACU_ISARoadSpdLimit 0;
BA_ "GatewayedSignals" SG_ 780 ACU_ISARoadSpdLimit 0;
BA_ "GenSigInactiveValue" SG_ 780 ACU_ISARoadSpdLimit 0;
BA_ "GenSigInvalidValue" SG_ 780 ACU_ISARoadSpdLimit 0;
BA_ "GenSigSendType" SG_ 780 ACU_ISARoadSpdLimit 1;
BA_ "GenSigStartValue" SG_ 780 ACU_ISARoadSpdLimit 0;
BA_ "GenSigTimeoutValue" SG_ 780 ACU_ISARoadSpdLimit 0;
BA_ "Remark" SG_ 780 ACU_ISARoadSpdLimit "";
BA_ "EventCommandSignal" SG_ 780 ACU_ISASpdLimitUnit 0;
BA_ "GatewayedSignals" SG_ 780 ACU_ISASpdLimitUnit 0;
BA_ "GenSigInactiveValue" SG_ 780 ACU_ISASpdLimitUnit 0;
BA_ "GenSigInvalidValue" SG_ 780 ACU_ISASpdLimitUnit 0;
BA_ "GenSigSendType" SG_ 780 ACU_ISASpdLimitUnit 1;
BA_ "GenSigStartValue" SG_ 780 ACU_ISASpdLimitUnit 0;
BA_ "GenSigTimeoutValue" SG_ 780 ACU_ISASpdLimitUnit 0;
BA_ "Remark" SG_ 780 ACU_ISASpdLimitUnit "";
BA_ "EventCommandSignal" SG_ 780 ACU_ISASpdLimitTyp 0;
BA_ "GatewayedSignals" SG_ 780 ACU_ISASpdLimitTyp 0;
BA_ "GenSigInactiveValue" SG_ 780 ACU_ISASpdLimitTyp 0;
BA_ "GenSigInvalidValue" SG_ 780 ACU_ISASpdLimitTyp 0;
BA_ "GenSigSendType" SG_ 780 ACU_ISASpdLimitTyp 1;
BA_ "GenSigStartValue" SG_ 780 ACU_ISASpdLimitTyp 0;
BA_ "GenSigTimeoutValue" SG_ 780 ACU_ISASpdLimitTyp 0;
BA_ "Remark" SG_ 780 ACU_ISASpdLimitTyp "";
BA_ "EventCommandSignal" SG_ 780 ACU_ISARampTyp 0;
BA_ "GatewayedSignals" SG_ 780 ACU_ISARampTyp 0;
BA_ "GenSigInactiveValue" SG_ 780 ACU_ISARampTyp 0;
BA_ "GenSigInvalidValue" SG_ 780 ACU_ISARampTyp 0;
BA_ "GenSigSendType" SG_ 780 ACU_ISARampTyp 1;
BA_ "GenSigStartValue" SG_ 780 ACU_ISARampTyp 0;
BA_ "GenSigTimeoutValue" SG_ 780 ACU_ISARampTyp 0;
BA_ "Remark" SG_ 780 ACU_ISARampTyp "";
BA_ "EventCommandSignal" SG_ 780 ACU_ISARampDist 0;
BA_ "GatewayedSignals" SG_ 780 ACU_ISARampDist 0;
BA_ "GenSigInactiveValue" SG_ 780 ACU_ISARampDist 0;
BA_ "GenSigInvalidValue" SG_ 780 ACU_ISARampDist 0;
BA_ "GenSigSendType" SG_ 780 ACU_ISARampDist 1;
BA_ "GenSigStartValue" SG_ 780 ACU_ISARampDist 0;
BA_ "GenSigTimeoutValue" SG_ 780 ACU_ISARampDist 0;
BA_ "Remark" SG_ 780 ACU_ISARampDist "";
BA_ "EventCommandSignal" SG_ 780 ACU_ISAJunctDist 0;
BA_ "GatewayedSignals" SG_ 780 ACU_ISAJunctDist 0;
BA_ "GenSigInactiveValue" SG_ 780 ACU_ISAJunctDist 0;
BA_ "GenSigInvalidValue" SG_ 780 ACU_ISAJunctDist 0;
BA_ "GenSigSendType" SG_ 780 ACU_ISAJunctDist 1;
BA_ "GenSigStartValue" SG_ 780 ACU_ISAJunctDist 0;
BA_ "GenSigTimeoutValue" SG_ 780 ACU_ISAJunctDist 0;
BA_ "Remark" SG_ 780 ACU_ISAJunctDist "";
BA_ "EventCommandSignal" SG_ 780 ACU_ISARDBDist 0;
BA_ "GatewayedSignals" SG_ 780 ACU_ISARDBDist 0;
BA_ "GenSigInactiveValue" SG_ 780 ACU_ISARDBDist 0;
BA_ "GenSigInvalidValue" SG_ 780 ACU_ISARDBDist 0;
BA_ "GenSigSendType" SG_ 780 ACU_ISARDBDist 1;
BA_ "GenSigStartValue" SG_ 780 ACU_ISARDBDist 0;
BA_ "GenSigTimeoutValue" SG_ 780 ACU_ISARDBDist 0;
BA_ "Remark" SG_ 780 ACU_ISARDBDist "";
BA_ "EventCommandSignal" SG_ 780 ACU_ISACondSpdLimit 0;
BA_ "GatewayedSignals" SG_ 780 ACU_ISACondSpdLimit 0;
BA_ "GenSigInactiveValue" SG_ 780 ACU_ISACondSpdLimit 0;
BA_ "GenSigInvalidValue" SG_ 780 ACU_ISACondSpdLimit 0;
BA_ "GenSigSendType" SG_ 780 ACU_ISACondSpdLimit 1;
BA_ "GenSigStartValue" SG_ 780 ACU_ISACondSpdLimit 0;
BA_ "GenSigTimeoutValue" SG_ 780 ACU_ISACondSpdLimit 0;
BA_ "Remark" SG_ 780 ACU_ISACondSpdLimit "";
BA_ "EventCommandSignal" SG_ 780 ACU_ISACondSpdLimitTyp 0;
BA_ "GatewayedSignals" SG_ 780 ACU_ISACondSpdLimitTyp 0;
BA_ "GenSigInactiveValue" SG_ 780 ACU_ISACondSpdLimitTyp 0;
BA_ "GenSigInvalidValue" SG_ 780 ACU_ISACondSpdLimitTyp 0;
BA_ "GenSigSendType" SG_ 780 ACU_ISACondSpdLimitTyp 1;
BA_ "GenSigStartValue" SG_ 780 ACU_ISACondSpdLimitTyp 0;
BA_ "GenSigTimeoutValue" SG_ 780 ACU_ISACondSpdLimitTyp 0;
BA_ "Remark" SG_ 780 ACU_ISACondSpdLimitTyp "";
BA_ "EventCommandSignal" SG_ 780 ACU_ISACondSpdLimitVd 0;
BA_ "GatewayedSignals" SG_ 780 ACU_ISACondSpdLimitVd 0;
BA_ "GenSigInactiveValue" SG_ 780 ACU_ISACondSpdLimitVd 0;
BA_ "GenSigInvalidValue" SG_ 780 ACU_ISACondSpdLimitVd 0;
BA_ "GenSigSendType" SG_ 780 ACU_ISACondSpdLimitVd 1;
BA_ "GenSigStartValue" SG_ 780 ACU_ISACondSpdLimitVd 0;
BA_ "GenSigTimeoutValue" SG_ 780 ACU_ISACondSpdLimitVd 0;
BA_ "Remark" SG_ 780 ACU_ISACondSpdLimitVd "";
BA_ "EventCommandSignal" SG_ 780 ACU_ISASupplierInfo 0;
BA_ "GatewayedSignals" SG_ 780 ACU_ISASupplierInfo 0;
BA_ "GenSigInactiveValue" SG_ 780 ACU_ISASupplierInfo 0;
BA_ "GenSigInvalidValue" SG_ 780 ACU_ISASupplierInfo 0;
BA_ "GenSigSendType" SG_ 780 ACU_ISASupplierInfo 1;
BA_ "GenSigStartValue" SG_ 780 ACU_ISASupplierInfo 0;
BA_ "GenSigTimeoutValue" SG_ 780 ACU_ISASupplierInfo 0;
BA_ "Remark" SG_ 780 ACU_ISASupplierInfo "";
BA_ "EventCommandSignal" SG_ 780 IDC_FuncReq_SentryModDetec 0;
BA_ "GatewayedSignals" SG_ 780 IDC_FuncReq_SentryModDetec 0;
BA_ "GenSigInactiveValue" SG_ 780 IDC_FuncReq_SentryModDetec 0;
BA_ "GenSigInvalidValue" SG_ 780 IDC_FuncReq_SentryModDetec 0;
BA_ "GenSigSendType" SG_ 780 IDC_FuncReq_SentryModDetec 1;
BA_ "GenSigStartValue" SG_ 780 IDC_FuncReq_SentryModDetec 0;
BA_ "GenSigTimeoutValue" SG_ 780 IDC_FuncReq_SentryModDetec 0;
BA_ "Remark" SG_ 780 IDC_FuncReq_SentryModDetec "";
BA_ "EventCommandSignal" SG_ 780 ACU_ISAServiceWorkSt 0;
BA_ "GatewayedSignals" SG_ 780 ACU_ISAServiceWorkSt 0;
BA_ "GenSigInactiveValue" SG_ 780 ACU_ISAServiceWorkSt 0;
BA_ "GenSigInvalidValue" SG_ 780 ACU_ISAServiceWorkSt 0;
BA_ "GenSigSendType" SG_ 780 ACU_ISAServiceWorkSt 1;
BA_ "GenSigStartValue" SG_ 780 ACU_ISAServiceWorkSt 0;
BA_ "GenSigTimeoutValue" SG_ 780 ACU_ISAServiceWorkSt 0;
BA_ "Remark" SG_ 780 ACU_ISAServiceWorkSt "";
BA_ "EventCommandSignal" SG_ 780 IDC_SentryModeVideoReq 0;
BA_ "GatewayedSignals" SG_ 780 IDC_SentryModeVideoReq 0;
BA_ "GenSigInactiveValue" SG_ 780 IDC_SentryModeVideoReq 0;
BA_ "GenSigInvalidValue" SG_ 780 IDC_SentryModeVideoReq 0;
BA_ "GenSigSendType" SG_ 780 IDC_SentryModeVideoReq 1;
BA_ "GenSigStartValue" SG_ 780 IDC_SentryModeVideoReq 0;
BA_ "GenSigTimeoutValue" SG_ 780 IDC_SentryModeVideoReq 0;
BA_ "Remark" SG_ 780 IDC_SentryModeVideoReq "";
BA_ "EventCommandSignal" SG_ 967 DMS_1_CRC 0;
BA_ "GatewayedSignals" SG_ 967 DMS_1_CRC 0;
BA_ "GenSigInactiveValue" SG_ 967 DMS_1_CRC 0;
BA_ "GenSigInvalidValue" SG_ 967 DMS_1_CRC 0;
BA_ "GenSigSendType" SG_ 967 DMS_1_CRC 1;
BA_ "GenSigStartValue" SG_ 967 DMS_1_CRC 0;
BA_ "GenSigTimeoutValue" SG_ 967 DMS_1_CRC 0;
BA_ "Remark" SG_ 967 DMS_1_CRC "";
BA_ "EventCommandSignal" SG_ 967 DMS_1_Counter 0;
BA_ "GatewayedSignals" SG_ 967 DMS_1_Counter 0;
BA_ "GenSigInactiveValue" SG_ 967 DMS_1_Counter 0;
BA_ "GenSigInvalidValue" SG_ 967 DMS_1_Counter 0;
BA_ "GenSigSendType" SG_ 967 DMS_1_Counter 1;
BA_ "GenSigStartValue" SG_ 967 DMS_1_Counter 0;
BA_ "GenSigTimeoutValue" SG_ 967 DMS_1_Counter 0;
BA_ "Remark" SG_ 967 DMS_1_Counter "";
BA_ "EventCommandSignal" SG_ 967 DMS_SysErrSt 0;
BA_ "GatewayedSignals" SG_ 967 DMS_SysErrSt 0;
BA_ "GenSigInactiveValue" SG_ 967 DMS_SysErrSt 0;
BA_ "GenSigInvalidValue" SG_ 967 DMS_SysErrSt 0;
BA_ "GenSigSendType" SG_ 967 DMS_SysErrSt 1;
BA_ "GenSigStartValue" SG_ 967 DMS_SysErrSt 0;
BA_ "GenSigTimeoutValue" SG_ 967 DMS_SysErrSt 0;
BA_ "Remark" SG_ 967 DMS_SysErrSt "";
BA_ "EventCommandSignal" SG_ 967 DMS_DrvrDetSts 0;
BA_ "GatewayedSignals" SG_ 967 DMS_DrvrDetSts 0;
BA_ "GenSigInactiveValue" SG_ 967 DMS_DrvrDetSts 0;
BA_ "GenSigInvalidValue" SG_ 967 DMS_DrvrDetSts 0;
BA_ "GenSigSendType" SG_ 967 DMS_DrvrDetSts 1;
BA_ "GenSigStartValue" SG_ 967 DMS_DrvrDetSts 0;
BA_ "GenSigTimeoutValue" SG_ 967 DMS_DrvrDetSts 0;
BA_ "Remark" SG_ 967 DMS_DrvrDetSts "";
BA_ "EventCommandSignal" SG_ 967 DMS_InterestsRegion 0;
BA_ "GatewayedSignals" SG_ 967 DMS_InterestsRegion 0;
BA_ "GenSigInactiveValue" SG_ 967 DMS_InterestsRegion 0;
BA_ "GenSigInvalidValue" SG_ 967 DMS_InterestsRegion 0;
BA_ "GenSigSendType" SG_ 967 DMS_InterestsRegion 1;
BA_ "GenSigStartValue" SG_ 967 DMS_InterestsRegion 0;
BA_ "GenSigTimeoutValue" SG_ 967 DMS_InterestsRegion 0;
BA_ "Remark" SG_ 967 DMS_InterestsRegion "";
BA_ "EventCommandSignal" SG_ 967 DMS_L3DriverDistractionSt 0;
BA_ "GatewayedSignals" SG_ 967 DMS_L3DriverDistractionSt 0;
BA_ "GenSigInactiveValue" SG_ 967 DMS_L3DriverDistractionSt 0;
BA_ "GenSigInvalidValue" SG_ 967 DMS_L3DriverDistractionSt 0;
BA_ "GenSigSendType" SG_ 967 DMS_L3DriverDistractionSt 1;
BA_ "GenSigStartValue" SG_ 967 DMS_L3DriverDistractionSt 0;
BA_ "GenSigTimeoutValue" SG_ 967 DMS_L3DriverDistractionSt 0;
BA_ "Remark" SG_ 967 DMS_L3DriverDistractionSt "";
BA_ "EventCommandSignal" SG_ 967 DMS_L3DriverFatigueSt 0;
BA_ "GatewayedSignals" SG_ 967 DMS_L3DriverFatigueSt 0;
BA_ "GenSigInactiveValue" SG_ 967 DMS_L3DriverFatigueSt 0;
BA_ "GenSigInvalidValue" SG_ 967 DMS_L3DriverFatigueSt 0;
BA_ "GenSigSendType" SG_ 967 DMS_L3DriverFatigueSt 1;
BA_ "GenSigStartValue" SG_ 967 DMS_L3DriverFatigueSt 0;
BA_ "GenSigTimeoutValue" SG_ 967 DMS_L3DriverFatigueSt 0;
BA_ "Remark" SG_ 967 DMS_L3DriverFatigueSt "";
BA_ "EventCommandSignal" SG_ 967 DMS_FaceIDStatus 0;
BA_ "GatewayedSignals" SG_ 967 DMS_FaceIDStatus 0;
BA_ "GenSigInactiveValue" SG_ 967 DMS_FaceIDStatus 0;
BA_ "GenSigInvalidValue" SG_ 967 DMS_FaceIDStatus 0;
BA_ "GenSigSendType" SG_ 967 DMS_FaceIDStatus 1;
BA_ "GenSigStartValue" SG_ 967 DMS_FaceIDStatus 0;
BA_ "GenSigTimeoutValue" SG_ 967 DMS_FaceIDStatus 0;
BA_ "Remark" SG_ 967 DMS_FaceIDStatus "";
BA_ "EventCommandSignal" SG_ 967 DMS_FaceID 0;
BA_ "GatewayedSignals" SG_ 967 DMS_FaceID 0;
BA_ "GenSigInactiveValue" SG_ 967 DMS_FaceID 0;
BA_ "GenSigInvalidValue" SG_ 967 DMS_FaceID 0;
BA_ "GenSigSendType" SG_ 967 DMS_FaceID 1;
BA_ "GenSigStartValue" SG_ 967 DMS_FaceID 0;
BA_ "GenSigTimeoutValue" SG_ 967 DMS_FaceID 0;
BA_ "Remark" SG_ 967 DMS_FaceID "";
BA_ "EventCommandSignal" SG_ 967 DMS_FaceIDVerifyResult 0;
BA_ "GatewayedSignals" SG_ 967 DMS_FaceIDVerifyResult 0;
BA_ "GenSigInactiveValue" SG_ 967 DMS_FaceIDVerifyResult 0;
BA_ "GenSigInvalidValue" SG_ 967 DMS_FaceIDVerifyResult 0;
BA_ "GenSigSendType" SG_ 967 DMS_FaceIDVerifyResult 1;
BA_ "GenSigStartValue" SG_ 967 DMS_FaceIDVerifyResult 0;
BA_ "GenSigTimeoutValue" SG_ 967 DMS_FaceIDVerifyResult 0;
BA_ "Remark" SG_ 967 DMS_FaceIDVerifyResult "";
BA_ "EventCommandSignal" SG_ 967 DMS_LeftEyeOpenSt 0;
BA_ "GatewayedSignals" SG_ 967 DMS_LeftEyeOpenSt 0;
BA_ "GenSigInactiveValue" SG_ 967 DMS_LeftEyeOpenSt 0;
BA_ "GenSigInvalidValue" SG_ 967 DMS_LeftEyeOpenSt 0;
BA_ "GenSigSendType" SG_ 967 DMS_LeftEyeOpenSt 1;
BA_ "GenSigStartValue" SG_ 967 DMS_LeftEyeOpenSt 0;
BA_ "GenSigTimeoutValue" SG_ 967 DMS_LeftEyeOpenSt 0;
BA_ "Remark" SG_ 967 DMS_LeftEyeOpenSt "";
BA_ "EventCommandSignal" SG_ 967 DMS_RightEyeOpenSt 0;
BA_ "GatewayedSignals" SG_ 967 DMS_RightEyeOpenSt 0;
BA_ "GenSigInactiveValue" SG_ 967 DMS_RightEyeOpenSt 0;
BA_ "GenSigInvalidValue" SG_ 967 DMS_RightEyeOpenSt 0;
BA_ "GenSigSendType" SG_ 967 DMS_RightEyeOpenSt 1;
BA_ "GenSigStartValue" SG_ 967 DMS_RightEyeOpenSt 0;
BA_ "GenSigTimeoutValue" SG_ 967 DMS_RightEyeOpenSt 0;
BA_ "Remark" SG_ 967 DMS_RightEyeOpenSt "";
BA_ "EventCommandSignal" SG_ 967 DMS_DriverSmokeSt 0;
BA_ "GatewayedSignals" SG_ 967 DMS_DriverSmokeSt 0;
BA_ "GenSigInactiveValue" SG_ 967 DMS_DriverSmokeSt 0;
BA_ "GenSigInvalidValue" SG_ 967 DMS_DriverSmokeSt 0;
BA_ "GenSigSendType" SG_ 967 DMS_DriverSmokeSt 1;
BA_ "GenSigStartValue" SG_ 967 DMS_DriverSmokeSt 0;
BA_ "GenSigTimeoutValue" SG_ 967 DMS_DriverSmokeSt 0;
BA_ "Remark" SG_ 967 DMS_DriverSmokeSt "";
BA_ "EventCommandSignal" SG_ 967 DMS_DriverTelephoneSt 0;
BA_ "GatewayedSignals" SG_ 967 DMS_DriverTelephoneSt 0;
BA_ "GenSigInactiveValue" SG_ 967 DMS_DriverTelephoneSt 0;
BA_ "GenSigInvalidValue" SG_ 967 DMS_DriverTelephoneSt 0;
BA_ "GenSigSendType" SG_ 967 DMS_DriverTelephoneSt 1;
BA_ "GenSigStartValue" SG_ 967 DMS_DriverTelephoneSt 0;
BA_ "GenSigTimeoutValue" SG_ 967 DMS_DriverTelephoneSt 0;
BA_ "Remark" SG_ 967 DMS_DriverTelephoneSt "";
BA_ "EventCommandSignal" SG_ 967 DMS_DriverHealthSt 0;
BA_ "GatewayedSignals" SG_ 967 DMS_DriverHealthSt 0;
BA_ "GenSigInactiveValue" SG_ 967 DMS_DriverHealthSt 0;
BA_ "GenSigInvalidValue" SG_ 967 DMS_DriverHealthSt 0;
BA_ "GenSigSendType" SG_ 967 DMS_DriverHealthSt 1;
BA_ "GenSigStartValue" SG_ 967 DMS_DriverHealthSt 0;
BA_ "GenSigTimeoutValue" SG_ 967 DMS_DriverHealthSt 0;
BA_ "Remark" SG_ 967 DMS_DriverHealthSt "";
BA_ "EventCommandSignal" SG_ 967 DMS_FatigWarnSt 0;
BA_ "GatewayedSignals" SG_ 967 DMS_FatigWarnSt 0;
BA_ "GenSigInactiveValue" SG_ 967 DMS_FatigWarnSt 0;
BA_ "GenSigInvalidValue" SG_ 967 DMS_FatigWarnSt 0;
BA_ "GenSigSendType" SG_ 967 DMS_FatigWarnSt 1;
BA_ "GenSigStartValue" SG_ 967 DMS_FatigWarnSt 0;
BA_ "GenSigTimeoutValue" SG_ 967 DMS_FatigWarnSt 0;
BA_ "Remark" SG_ 967 DMS_FatigWarnSt "";
BA_ "EventCommandSignal" SG_ 967 DMS_DistrWarnSt 0;
BA_ "GatewayedSignals" SG_ 967 DMS_DistrWarnSt 0;
BA_ "GenSigInactiveValue" SG_ 967 DMS_DistrWarnSt 0;
BA_ "GenSigInvalidValue" SG_ 967 DMS_DistrWarnSt 0;
BA_ "GenSigSendType" SG_ 967 DMS_DistrWarnSt 1;
BA_ "GenSigStartValue" SG_ 967 DMS_DistrWarnSt 0;
BA_ "GenSigTimeoutValue" SG_ 967 DMS_DistrWarnSt 0;
BA_ "Remark" SG_ 967 DMS_DistrWarnSt "";
BA_ "EventCommandSignal" SG_ 967 DMS_DriverExpressionSt 0;
BA_ "GatewayedSignals" SG_ 967 DMS_DriverExpressionSt 0;
BA_ "GenSigInactiveValue" SG_ 967 DMS_DriverExpressionSt 0;
BA_ "GenSigInvalidValue" SG_ 967 DMS_DriverExpressionSt 0;
BA_ "GenSigSendType" SG_ 967 DMS_DriverExpressionSt 1;
BA_ "GenSigStartValue" SG_ 967 DMS_DriverExpressionSt 0;
BA_ "GenSigTimeoutValue" SG_ 967 DMS_DriverExpressionSt 0;
BA_ "Remark" SG_ 967 DMS_DriverExpressionSt "";
BA_ "EventCommandSignal" SG_ 967 DMS_YawnSt 0;
BA_ "GatewayedSignals" SG_ 967 DMS_YawnSt 0;
BA_ "GenSigInactiveValue" SG_ 967 DMS_YawnSt 0;
BA_ "GenSigInvalidValue" SG_ 967 DMS_YawnSt 0;
BA_ "GenSigSendType" SG_ 967 DMS_YawnSt 1;
BA_ "GenSigStartValue" SG_ 967 DMS_YawnSt 0;
BA_ "GenSigTimeoutValue" SG_ 967 DMS_YawnSt 0;
BA_ "Remark" SG_ 967 DMS_YawnSt "";
BA_ "EventCommandSignal" SG_ 400 UINM_1_CRC 0;
BA_ "GatewayedSignals" SG_ 400 UINM_1_CRC 0;
BA_ "GenSigInactiveValue" SG_ 400 UINM_1_CRC 0;
BA_ "GenSigInvalidValue" SG_ 400 UINM_1_CRC 0;
BA_ "GenSigSendType" SG_ 400 UINM_1_CRC 1;
BA_ "GenSigStartValue" SG_ 400 UINM_1_CRC 0;
BA_ "GenSigTimeoutValue" SG_ 400 UINM_1_CRC 0;
BA_ "Remark" SG_ 400 UINM_1_CRC "";
BA_ "EventCommandSignal" SG_ 400 UINM_1_Counter 0;
BA_ "GatewayedSignals" SG_ 400 UINM_1_Counter 0;
BA_ "GenSigInactiveValue" SG_ 400 UINM_1_Counter 0;
BA_ "GenSigInvalidValue" SG_ 400 UINM_1_Counter 0;
BA_ "GenSigSendType" SG_ 400 UINM_1_Counter 1;
BA_ "GenSigStartValue" SG_ 400 UINM_1_Counter 0;
BA_ "GenSigTimeoutValue" SG_ 400 UINM_1_Counter 0;
BA_ "Remark" SG_ 400 UINM_1_Counter "";
BA_ "EventCommandSignal" SG_ 400 UINM_DrvReqShft 0;
BA_ "GatewayedSignals" SG_ 400 UINM_DrvReqShft 0;
BA_ "GenSigInactiveValue" SG_ 400 UINM_DrvReqShft 0;
BA_ "GenSigInvalidValue" SG_ 400 UINM_DrvReqShft 0;
BA_ "GenSigSendType" SG_ 400 UINM_DrvReqShft 1;
BA_ "GenSigStartValue" SG_ 400 UINM_DrvReqShft 5;
BA_ "GenSigTimeoutValue" SG_ 400 UINM_DrvReqShft 0;
BA_ "Remark" SG_ 400 UINM_DrvReqShft "";
BA_ "EventCommandSignal" SG_ 400 UINM_DrvReqShftInv 0;
BA_ "GatewayedSignals" SG_ 400 UINM_DrvReqShftInv 0;
BA_ "GenSigInactiveValue" SG_ 400 UINM_DrvReqShftInv 0;
BA_ "GenSigInvalidValue" SG_ 400 UINM_DrvReqShftInv 0;
BA_ "GenSigSendType" SG_ 400 UINM_DrvReqShftInv 1;
BA_ "GenSigStartValue" SG_ 400 UINM_DrvReqShftInv 10;
BA_ "GenSigTimeoutValue" SG_ 400 UINM_DrvReqShftInv 0;
BA_ "Remark" SG_ 400 UINM_DrvReqShftInv "";
BA_ "EventCommandSignal" SG_ 400 UINM_FuSaErrSt 0;
BA_ "GatewayedSignals" SG_ 400 UINM_FuSaErrSt 0;
BA_ "GenSigInactiveValue" SG_ 400 UINM_FuSaErrSt 0;
BA_ "GenSigInvalidValue" SG_ 400 UINM_FuSaErrSt 0;
BA_ "GenSigSendType" SG_ 400 UINM_FuSaErrSt 1;
BA_ "GenSigStartValue" SG_ 400 UINM_FuSaErrSt 0;
BA_ "GenSigTimeoutValue" SG_ 400 UINM_FuSaErrSt 0;
BA_ "Remark" SG_ 400 UINM_FuSaErrSt "";
BA_ "EventCommandSignal" SG_ 400 UINM_ShftFault 0;
BA_ "GatewayedSignals" SG_ 400 UINM_ShftFault 0;
BA_ "GenSigInactiveValue" SG_ 400 UINM_ShftFault 0;
BA_ "GenSigInvalidValue" SG_ 400 UINM_ShftFault 0;
BA_ "GenSigSendType" SG_ 400 UINM_ShftFault 1;
BA_ "GenSigStartValue" SG_ 400 UINM_ShftFault 0;
BA_ "GenSigTimeoutValue" SG_ 400 UINM_ShftFault 0;
BA_ "Remark" SG_ 400 UINM_ShftFault "";
BA_ "EventCommandSignal" SG_ 400 UINM_PositionLightSwSt 0;
BA_ "GatewayedSignals" SG_ 400 UINM_PositionLightSwSt 0;
BA_ "GenSigInactiveValue" SG_ 400 UINM_PositionLightSwSt 0;
BA_ "GenSigInvalidValue" SG_ 400 UINM_PositionLightSwSt 2;
BA_ "GenSigSendType" SG_ 400 UINM_PositionLightSwSt 1;
BA_ "GenSigStartValue" SG_ 400 UINM_PositionLightSwSt 0;
BA_ "GenSigTimeoutValue" SG_ 400 UINM_PositionLightSwSt 0;
BA_ "Remark" SG_ 400 UINM_PositionLightSwSt "";
BA_ "EventCommandSignal" SG_ 400 UINM_LowBeamSwSt 0;
BA_ "GatewayedSignals" SG_ 400 UINM_LowBeamSwSt 0;
BA_ "GenSigInactiveValue" SG_ 400 UINM_LowBeamSwSt 0;
BA_ "GenSigInvalidValue" SG_ 400 UINM_LowBeamSwSt 2;
BA_ "GenSigSendType" SG_ 400 UINM_LowBeamSwSt 1;
BA_ "GenSigStartValue" SG_ 400 UINM_LowBeamSwSt 0;
BA_ "GenSigTimeoutValue" SG_ 400 UINM_LowBeamSwSt 0;
BA_ "Remark" SG_ 400 UINM_LowBeamSwSt "";
BA_ "EventCommandSignal" SG_ 400 UINM_AutoLightSwSt 0;
BA_ "GatewayedSignals" SG_ 400 UINM_AutoLightSwSt 0;
BA_ "GenSigInactiveValue" SG_ 400 UINM_AutoLightSwSt 0;
BA_ "GenSigInvalidValue" SG_ 400 UINM_AutoLightSwSt 2;
BA_ "GenSigSendType" SG_ 400 UINM_AutoLightSwSt 1;
BA_ "GenSigStartValue" SG_ 400 UINM_AutoLightSwSt 0;
BA_ "GenSigTimeoutValue" SG_ 400 UINM_AutoLightSwSt 0;
BA_ "Remark" SG_ 400 UINM_AutoLightSwSt "";
BA_ "EventCommandSignal" SG_ 400 UINM_FrontFogLightSwSt 0;
BA_ "GatewayedSignals" SG_ 400 UINM_FrontFogLightSwSt 0;
BA_ "GenSigInactiveValue" SG_ 400 UINM_FrontFogLightSwSt 0;
BA_ "GenSigInvalidValue" SG_ 400 UINM_FrontFogLightSwSt 0;
BA_ "GenSigSendType" SG_ 400 UINM_FrontFogLightSwSt 1;
BA_ "GenSigStartValue" SG_ 400 UINM_FrontFogLightSwSt 0;
BA_ "GenSigTimeoutValue" SG_ 400 UINM_FrontFogLightSwSt 0;
BA_ "Remark" SG_ 400 UINM_FrontFogLightSwSt "";
BA_ "EventCommandSignal" SG_ 400 UINM_RearFogLightSwSt 0;
BA_ "GatewayedSignals" SG_ 400 UINM_RearFogLightSwSt 0;
BA_ "GenSigInactiveValue" SG_ 400 UINM_RearFogLightSwSt 0;
BA_ "GenSigInvalidValue" SG_ 400 UINM_RearFogLightSwSt 0;
BA_ "GenSigSendType" SG_ 400 UINM_RearFogLightSwSt 1;
BA_ "GenSigStartValue" SG_ 400 UINM_RearFogLightSwSt 0;
BA_ "GenSigTimeoutValue" SG_ 400 UINM_RearFogLightSwSt 0;
BA_ "Remark" SG_ 400 UINM_RearFogLightSwSt "";
BA_ "EventCommandSignal" SG_ 400 UINM_HighBeamSwSt 0;
BA_ "GatewayedSignals" SG_ 400 UINM_HighBeamSwSt 0;
BA_ "GenSigInactiveValue" SG_ 400 UINM_HighBeamSwSt 0;
BA_ "GenSigInvalidValue" SG_ 400 UINM_HighBeamSwSt 3;
BA_ "GenSigSendType" SG_ 400 UINM_HighBeamSwSt 1;
BA_ "GenSigStartValue" SG_ 400 UINM_HighBeamSwSt 0;
BA_ "GenSigTimeoutValue" SG_ 400 UINM_HighBeamSwSt 0;
BA_ "Remark" SG_ 400 UINM_HighBeamSwSt "";
BA_ "EventCommandSignal" SG_ 400 UINM_TurnLightSwSt 0;
BA_ "GatewayedSignals" SG_ 400 UINM_TurnLightSwSt 0;
BA_ "GenSigInactiveValue" SG_ 400 UINM_TurnLightSwSt 0;
BA_ "GenSigInvalidValue" SG_ 400 UINM_TurnLightSwSt 5;
BA_ "GenSigSendType" SG_ 400 UINM_TurnLightSwSt 1;
BA_ "GenSigStartValue" SG_ 400 UINM_TurnLightSwSt 0;
BA_ "GenSigTimeoutValue" SG_ 400 UINM_TurnLightSwSt 0;
BA_ "Remark" SG_ 400 UINM_TurnLightSwSt "";
BA_ "EventCommandSignal" SG_ 400 UINM_ButCtlMaskFlag 0;
BA_ "GatewayedSignals" SG_ 400 UINM_ButCtlMaskFlag 0;
BA_ "GenSigInactiveValue" SG_ 400 UINM_ButCtlMaskFlag 0;
BA_ "GenSigInvalidValue" SG_ 400 UINM_ButCtlMaskFlag 0;
BA_ "GenSigSendType" SG_ 400 UINM_ButCtlMaskFlag 1;
BA_ "GenSigStartValue" SG_ 400 UINM_ButCtlMaskFlag 0;
BA_ "GenSigTimeoutValue" SG_ 400 UINM_ButCtlMaskFlag 0;
BA_ "Remark" SG_ 400 UINM_ButCtlMaskFlag "";
BA_ "EventCommandSignal" SG_ 400 UINM_FrontWiperSwSt 0;
BA_ "GatewayedSignals" SG_ 400 UINM_FrontWiperSwSt 0;
BA_ "GenSigInactiveValue" SG_ 400 UINM_FrontWiperSwSt 0;
BA_ "GenSigInvalidValue" SG_ 400 UINM_FrontWiperSwSt 7;
BA_ "GenSigSendType" SG_ 400 UINM_FrontWiperSwSt 1;
BA_ "GenSigStartValue" SG_ 400 UINM_FrontWiperSwSt 0;
BA_ "GenSigTimeoutValue" SG_ 400 UINM_FrontWiperSwSt 0;
BA_ "Remark" SG_ 400 UINM_FrontWiperSwSt "";
BA_ "EventCommandSignal" SG_ 400 UINM_FrontWiperIntAdjSwSt 0;
BA_ "GatewayedSignals" SG_ 400 UINM_FrontWiperIntAdjSwSt 0;
BA_ "GenSigInactiveValue" SG_ 400 UINM_FrontWiperIntAdjSwSt 0;
BA_ "GenSigInvalidValue" SG_ 400 UINM_FrontWiperIntAdjSwSt 15;
BA_ "GenSigSendType" SG_ 400 UINM_FrontWiperIntAdjSwSt 1;
BA_ "GenSigStartValue" SG_ 400 UINM_FrontWiperIntAdjSwSt 0;
BA_ "GenSigTimeoutValue" SG_ 400 UINM_FrontWiperIntAdjSwSt 0;
BA_ "Remark" SG_ 400 UINM_FrontWiperIntAdjSwSt "";
BA_ "EventCommandSignal" SG_ 400 UINM_FrontWasherSwSt 0;
BA_ "GatewayedSignals" SG_ 400 UINM_FrontWasherSwSt 0;
BA_ "GenSigInactiveValue" SG_ 400 UINM_FrontWasherSwSt 0;
BA_ "GenSigInvalidValue" SG_ 400 UINM_FrontWasherSwSt 0;
BA_ "GenSigSendType" SG_ 400 UINM_FrontWasherSwSt 1;
BA_ "GenSigStartValue" SG_ 400 UINM_FrontWasherSwSt 0;
BA_ "GenSigTimeoutValue" SG_ 400 UINM_FrontWasherSwSt 0;
BA_ "Remark" SG_ 400 UINM_FrontWasherSwSt "";
BA_ "EventCommandSignal" SG_ 400 UINM_RearWiperSwSt 0;
BA_ "GatewayedSignals" SG_ 400 UINM_RearWiperSwSt 0;
BA_ "GenSigInactiveValue" SG_ 400 UINM_RearWiperSwSt 0;
BA_ "GenSigInvalidValue" SG_ 400 UINM_RearWiperSwSt 15;
BA_ "GenSigSendType" SG_ 400 UINM_RearWiperSwSt 1;
BA_ "GenSigStartValue" SG_ 400 UINM_RearWiperSwSt 0;
BA_ "GenSigTimeoutValue" SG_ 400 UINM_RearWiperSwSt 0;
BA_ "Remark" SG_ 400 UINM_RearWiperSwSt "";
BA_ "EventCommandSignal" SG_ 400 UINM_RearWiperIntAdjSwSt 0;
BA_ "GatewayedSignals" SG_ 400 UINM_RearWiperIntAdjSwSt 0;
BA_ "GenSigInactiveValue" SG_ 400 UINM_RearWiperIntAdjSwSt 0;
BA_ "GenSigInvalidValue" SG_ 400 UINM_RearWiperIntAdjSwSt 15;
BA_ "GenSigSendType" SG_ 400 UINM_RearWiperIntAdjSwSt 1;
BA_ "GenSigStartValue" SG_ 400 UINM_RearWiperIntAdjSwSt 0;
BA_ "GenSigTimeoutValue" SG_ 400 UINM_RearWiperIntAdjSwSt 0;
BA_ "Remark" SG_ 400 UINM_RearWiperIntAdjSwSt "";
BA_ "EventCommandSignal" SG_ 400 UINM_RearWasherSwSt 0;
BA_ "GatewayedSignals" SG_ 400 UINM_RearWasherSwSt 0;
BA_ "GenSigInactiveValue" SG_ 400 UINM_RearWasherSwSt 0;
BA_ "GenSigInvalidValue" SG_ 400 UINM_RearWasherSwSt 0;
BA_ "GenSigSendType" SG_ 400 UINM_RearWasherSwSt 1;
BA_ "GenSigStartValue" SG_ 400 UINM_RearWasherSwSt 0;
BA_ "GenSigTimeoutValue" SG_ 400 UINM_RearWasherSwSt 0;
BA_ "Remark" SG_ 400 UINM_RearWasherSwSt "";
BA_ "EventCommandSignal" SG_ 400 UINM_HeadLampWasherSwSt 0;
BA_ "GatewayedSignals" SG_ 400 UINM_HeadLampWasherSwSt 0;
BA_ "GenSigInactiveValue" SG_ 400 UINM_HeadLampWasherSwSt 0;
BA_ "GenSigInvalidValue" SG_ 400 UINM_HeadLampWasherSwSt 0;
BA_ "GenSigSendType" SG_ 400 UINM_HeadLampWasherSwSt 1;
BA_ "GenSigStartValue" SG_ 400 UINM_HeadLampWasherSwSt 0;
BA_ "GenSigTimeoutValue" SG_ 400 UINM_HeadLampWasherSwSt 0;
BA_ "Remark" SG_ 400 UINM_HeadLampWasherSwSt "";
VAL_ 909 LCK_HoodAjarSt 0 "Closed" 1 "Opened"  ;
VAL_ 909 LCK_FrontLeftDoorAjarSt 0 "Closed" 1 "Opened"  ;
VAL_ 909 LCK_FrontRightDoorAjarSt 0 "Closed" 1 "Opened"  ;
VAL_ 909 LCK_RearLeftDoorAjarSt 0 "Closed" 1 "Opened"  ;
VAL_ 909 LCK_RearRightDoorAjarSt 0 "Closed" 1 "Opened"  ;
VAL_ 909 LCK_TrunkAjarSt 0 "Closed" 1 "Opened"  ;
VAL_ 909 LCK_FrontLeftDoorLockSt 0 "Locked" 1 "Unlocked"  ;
VAL_ 909 LCK_FrontRightDoorLockSt 0 "Locked" 1 "Unlocked"  ;
VAL_ 909 LCK_RearLeftDoorLockSt 0 "Locked" 1 "Unlocked"  ;
VAL_ 909 LCK_RearRightDoorLockSt 0 "Locked" 1 "Unlocked"  ;
VAL_ 909 LCK_RearLeftChildSaftyLockSt 0 "Locked" 1 "Unlocked"  ;
VAL_ 909 LCK_RearRightChildSaftyLockSt 0 "Locked" 1 "Unlocked"  ;
VAL_ 909 LCK_FrontLeftDoorHandlePosition 00 "FullyClosed" 100 "FullyOpened" 254 "Uninitialized" 255 "Unknown"  ;
VAL_ 909 LCK_FrontRightDoorHandlePosition 00 "FullyClosed" 100 "FullyOpened" 254 "Uninitialized" 255 "Unknown"  ;
VAL_ 909 LCK_RearLeftDoorHandlePosition 00 "FullyClosed" 100 "FullyOpened" 254 "Uninitialized" 255 "Unknown"  ;
VAL_ 909 LCK_RearRightDoorHandlePosition 00 "FullyClosed" 100 "FullyOpened" 254 "Uninitialized" 255 "Unknown"  ;
VAL_ 909 LCK_FillerCapASt 0 "Closed" 1 "Opened"  ;
VAL_ 909 LCK_FillerCapBSt 0 "Closed" 1 "Opened"  ;
VAL_ 909 MR_LeftMirrorFoldUnfoldSt 0 "Unknown" 1 "Mirror fold" 2 "Mirror unfold" 3 "Reserved"  ;
VAL_ 909 SBM_SwapHvBattModeSt 0 "default" 1 "Station open the door for veichle go in" 2 "Station find Vehicle stop OK" 3 "Station prepare to swap" 4 "Station begin to swap" 5 "Station finish assembling" 6 "Station complete to swap" 7 "Station pause swapping" 8 "Station open the door for veichle go out"  ;
VAL_ 909 SBM_SwapStaDiagCode 0 "Normal" 1 "Fault,BT cominication error" 2 "Fault,SWAP station error" 3 "Fault,vehile error"  ;
VAL_ 909 SBM_SwapVehDiagCode 0 "No error;" 1 "SBM CAN bus off" 2 "SBM lose ZCU-R" 3 "Active discharge disable"  ;
VAL_ 909 SBM_SwapHvBattModeFaultSt 0 "default" 1 "Normal" 2 "Error,can recovery" 3 "Error,can not recover"  ;
VAL_ 909 POD_CurDoorPosFL 127 "Position unknown"  ;
VAL_ 909 IPDS_HDMapPowerSt 0 "Not Active" 1 "Active"  ;
VAL_ 909 IPDS_KL15L1PowerSt 0 "Not Active" 1 "Active"  ;
VAL_ 909 IPDS_SRSECUPowerSt 0 "Not Active" 1 "Active"  ;
VAL_ 909 IPDS_HODPowerSt 0 "Not Active" 1 "Active"  ;
VAL_ 909 KAE_BLEOption 0 "Not active" 1 "Active"  ;
VAL_ 909 KAE_UWBOption 0 "Not active" 1 "Active"  ;
VAL_ 909 WW_RWPMotorSt 0 "Off" 1 "Reserve" 2 "Stall protection" 3 "Failure" 4 "Low speed" 5 "High speed" 6 "Hard stopped" 7 "Interval delaying"  ;
VAL_ 909 ACEleclocksSt 0 "init" 1 "Uncloked" 2 "Locked" 3 "Bosh open" 4 "Error,bosh close"  ;
VAL_ 909 WCM_Reminder 0 "No warning" 1 "Phone left in car"  ;
VAL_ 909 WCM_ChargingSt 0 "Standby" 1 "Charging" 2 "Charging completed (available when Rx support)" 3 "Not standby"  ;
VAL_ 909 AVAS_ActivatedSt 0 "OFF" 1 "ON" 2 "Sound_AVAS" 3 "Sound_UnLock" 4 "Sound_Lock"  ;
VAL_ 909 PWL_WinCurrentPos_FLWinPst 255 "Undefined window position"  ;
VAL_ 909 UINM_FrontLeftPowerReleaseReq 0 "NoReq" 1 "Release"  ;
VAL_ 909 UINM_FrontLeftPowerReleaseFaultSt 0 "noraml" 1 "fault"  ;
VAL_ 909 UINM_FrontRightPowerReleaseReq 0 "NoReq" 1 "Release"  ;
VAL_ 909 UINM_FrontRightPowerReleaseFaultSt 0 "noraml" 1 "fault"  ;
VAL_ 909 UINM_RearLeftPowerReleaseFaultSt 0 "noraml" 1 "fault"  ;
VAL_ 909 UINM_RearLeftPowerReleaseReq 0 "NoReq" 1 "Release"  ;
VAL_ 909 UINM_RearRightPowerReleaseFaultSt 0 "noraml" 1 "fault"  ;
VAL_ 909 UINM_RearRightPowerReleaseReq 0 "NoReq" 1 "Release"  ;
VAL_ 909 PWL_WinCurrentPos_RRWinPst 255 "Undefined window position"  ;
VAL_ 909 PWL_WinCurrentPos_RLWinPst 255 "Undefined window position"  ;
VAL_ 334 CSM_RC_ViewExtvideo 65535 "invalid? 无效值"  ;
VAL_ 334 CSM_RC_ViewExtvideoReq 0 "No Request" 1 "Request"  ;
VAL_ 290 IPDS_Lidar1PowerSup 0 "Not Active" 1 "Active" 2 "PreOFF" 3 "Invalid"  ;
VAL_ 905 ICM_SetIACCSt 0 "Not active" 1 "Active"  ;
VAL_ 161 ACU_FaceID_Delete 0 "Default" 1 "Delete AUID1" 2 "Delete AUID2" 3 "Delete AUID3" 4 "Delete AUID4" 5 "Delete AUID5" 6 "Delete AUID6" 7 "Delete AUID7" 8 "Delete AUID8" 9 "Reserved" 10 "Reserved" 11 "Reserved" 12 "Reserved" 13 "Reserved" 14 "Reserved" 15 "Reserved"  ;
VAL_ 161 ACU_RegisterTriger 0 "Default" 1 "Register AUID1" 2 "Register AUID2" 3 "Register AUID3" 4 "Register AUID4" 5 "Register AUID5" 6 "Register AUID6" 7 "Register AUID7" 8 "Register AUID8" 9 "Reserved" 10 "Reserved" 11 "Reserved" 12 "Reserved" 13 "Reserved" 14 "Reserved" 15 "Reserved"  ;
VAL_ 161 ACU_VerifyTriger 0 "Default" 1 "Verify AUID1" 2 "Verify AUID2" 3 "Verify AUID3" 4 "Verify AUID4" 5 "Verify AUID5" 6 "Verify AUID6" 7 "Verify AUID7" 8 "Verify AUID8" 9 "Reserved" 10 "Reserved" 11 "Reserved" 12 "Reserved" 13 "Reserved" 14 "Reserved" 15 "Reserved"  ;
VAL_ 161 ACU_FaceIDQuit 0 "No command" 1 "Quit request"  ;
VAL_ 161 ACU_FaceIDSwitch 0 "No command" 1 "Off" 2 "On" 3 "Not used"  ;
VAL_ 161 ACU_AVAS_SwitchCfgReq 0 "No command" 1 "OFF" 2 "ON" 3 "Not used"  ;
VAL_ 351 ACU_VirtualPowerOFFReq 0 "No request" 1 "Request"  ;
VAL_ 351 ACU_FactoryResetReq 0 "No request" 1 "Request"  ;
VAL_ 351 ACU_Account_Uld 0 "No command" 1 "account 0" 2 "account 1" 3 "account 2" 4 "account 3" 5 "account 4" 6 "account 5" 7 "account 6" 8 "account 7" 9 "account 8" 10 "Not used" 11 "Not used" 12 "Not used" 13 "Not used" 14 "Not used" 15 "Not used"  ;
VAL_ 351 ACU_FrontWiperIntCfgVkReq 0 "No command"  ;
VAL_ 351 ACU_FrontWiperAutoCfgVkReq 0 "No command"  ;
VAL_ 351 IDC_VoicePAAReq 0 "No request" 1 "Request"  ;
VAL_ 351 IDC_VoiceParkCheckReq 0 "No request" 1 "Request"  ;
VAL_ 879 ACU_PCS_SVM_MODCmd 0 "Disable" 1 "Enalbe"  ;
VAL_ 879 ACU_HeadLightVirtualSwSt 0 "NotActive" 1 "PositionLight" 2 "LowBeam" 3 "AutoLight"  ;
VAL_ 879 ACU_FrontFogLightVirtualSwSt 0 "Not Active" 1 "Active"  ;
VAL_ 879 ACU_RearFogLightVirtualSwSt 0 "Not Active" 1 "Active"  ;
VAL_ 879 IDC_HPAParkingSpdsSw 0 "No Request;" 1 "SlowReq" 2 "MiddleReq" 3 "HighReq"  ;
VAL_ 879 ACU_Account_Uid 0 "No command" 1 "account 0" 2 "account 1" 3 "account 2" 4 "account 3" 5 "account 4" 6 "account 5" 7 "account 6" 8 "account 7" 9 "account 8" 10 "Not used" 11 "Not used" 12 "Not used" 13 "Not used" 14 "Not used" 15 "Not used"  ;
VAL_ 879 ACU_FCWWarnDistanceCfg 0 "No command" 1 "Normal" 2 "Close" 3 "Far"  ;
VAL_ 879 ACU_FCWCfg 0 "No command" 1 "Warning and brake" 2 "Warning only" 3 "Off"  ;
VAL_ 879 ACU_AEBOff 0 "No command" 1 "On" 2 "Off"  ;
VAL_ 879 ACU_TSR_SwitchReq 0 "No command" 1 "Not active" 2 "Active" 3 "Not used"  ;
VAL_ 879 ACU_IHBC_SwitchReq 0 "No command" 1 "Not active" 2 "Active" 3 "Not used"  ;
VAL_ 879 ACU_LDS_TypeReq 0 "No command" 1 "Disable" 2 "Warning" 3 "Steering and Warning"  ;
VAL_ 879 ACU_BSDCfg 0 "No Action" 1 "OFF Request" 2 "ON Request" 3 "Reserved"  ;
VAL_ 879 ACU_RCTACfg 0 "No Action" 1 "OFF Request" 2 "ON Request" 3 "Reserved"  ;
VAL_ 879 ACU_DOWCfg 0 "No Action" 1 "OFF Request" 2 "ON Request" 3 "Reserved"  ;
VAL_ 879 ACU_TSR_AudioWarnReq 0 "No command" 1 "Off" 2 "On" 3 "Not used"  ;
VAL_ 879 ACU_HWAHFCfg 0 "No command" 1 "Not active" 2 "Active" 3 "Not used"  ;
VAL_ 879 ACU_HWAHF_AudioWarningTypeCfg 0 "No command" 1 "Warning tone" 2 "Voice" 3 "Not used"  ;
VAL_ 879 ACU_HWA_SwitchReq 0 "No command" 1 "Off" 2 "On" 3 "Not used"  ;
VAL_ 879 ACU_ELKCfg 0 "No command" 1 "Not active" 2 "Active" 3 "Not used"  ;
VAL_ 879 ACU_FCTACfg 0 "No command" 1 "Not active" 2 "Active" 3 "Not used"  ;
VAL_ 879 ACU_RAWCfg 0 "No command" 1 "Not active" 2 "Active" 3 "Not used"  ;
VAL_ 879 ACU_RCTA_TypeReqCfg 0 "No command" 1 "brake" 2 "Warning" 3 "brake and Warning"  ;
VAL_ 879 ACU_FCTA_TypeReqCfg 0 "No command" 1 "brake" 2 "Warning" 3 "brake and Warning"  ;
VAL_ 879 ACU_NDASwitchReq 0 "No command" 1 "Not active" 2 "Active" 3 "Not used"  ;
VAL_ 879 ACU_NDALCConSwitchReq 0 "No command" 1 "Need confirm" 2 "No need confirm" 3 "Not used"  ;
VAL_ 879 ACU_NDALCStySwitchReq 0 "No command" 1 "Standard" 2 "Radical" 3 "Not used"  ;
VAL_ 879 ACU_ADASWarnTypeSwitch 0 "No command" 1 "Sound" 2 "Voice" 3 "Seat vibration"  ;
VAL_ 879 ACU_ESACfg 0 "No command" 1 "Not active" 2 "Active" 3 "Not used"  ;
VAL_ 879 ACU_ILCCfg 0 "No command" 1 "Not active" 2 "Active" 4 "Not used"  ;
VAL_ 879 ACU_AESCfg 0 "No command" 1 "Not active" 2 "Active" 5 "Not used"  ;
VAL_ 879 ACU_ILOACfg 0 "No command" 1 "Not active" 2 "Active" 6 "Not used"  ;
VAL_ 879 ACU_iACC_StyleConfirmSwitchReq 0 "No Command" 1 "Need confirm" 2 "No need confirm" 3 "OFF"  ;
VAL_ 879 ACU_IFC_ISDRestOfdis 0 "not in ISD" 251 "over 70km"  ;
VAL_ 879 ACU_IFC_SpeedLimitUnit 0 "Not used" 1 "Km/h" 2 "Miles/h" 3 "Not used"  ;
VAL_ 879 ACU_ThemeType 0 "Day mode" 1 "Night mode"  ;
VAL_ 879 ACU_IFC_SpeedLimtType 0 "Not specific" 1 "Speed limit camera detection" 2 "Interval speed detectionlimit"  ;
VAL_ 879 ACU_IFC_RoadType 0 "unknown" 1 "High way" 2 "National road" 3 "Provincial road" 4 "County road" 5 "Village road" 6 "City express way" 7 "Major urban road" 8 "Secondary urban road" 9 "Normal urban road" 10 "Non-Navigation Road" 11 "Ramp" 12 "Reserve" 13 "Reserve" 14 "Reserve" 15 "Reserve"  ;
VAL_ 879 ACU_IFC_ZoneCode 0 "Not used" 1 "China"  ;
VAL_ 879 ACU_IFC_NaviSt 0 "Unknown" 1 "Cruise" 2 "Navigate" 3 "Failure"  ;
VAL_ 879 ACU_IFC_NaviCorp 0 "unknown" 1 "Gaode Map" 2 "Tescent Map" 3 "Baidu Map" 4 "Ruitu Map"  ;
VAL_ 879 ACU_IFC_NaviNewIconDis 0 "no newIcon ahead" 21 "over 2.0km"  ;
VAL_ 879 ACU_IFC_OfframpSt 0 "Not off-ramp" 1 "Off-ramp"  ;
VAL_ 879 ACU_IFC_NaviNewIcon 0 "unknown" 1 "left" 2 "right" 3 "left front" 4 "right front" 5 "left rear" 6 "right rear" 7 "left u-turn" 8 "right u-turn" 9 "go straight" 10 "roundabout entrance" 11 "roundabout exit" 12 "service area" 13 "toll station" 14 "tunnel" 15 "not used"  ;
VAL_ 879 ACU_IFC_SLCAheadDis 251 "over 1.25km"  ;
VAL_ 879 ACU_DVR_Switch 0 "Off" 1 "On"  ;
VAL_ 879 ACU_IFC_OfframpDis 254 "over 2km"  ;
VAL_ 475 ACU_MirrSteeringAdjFlag 0 "Not active" 1 "Mirror adjust active" 2 "Steering adjust active" 3 "Steering learning guidance"  ;
VAL_ 1045 ACU_CampingModeSt 0 "inactive" 1 "off" 2 "CampingMode" 3 "Sleep mode of CampingMode"  ;
VAL_ 163 ACU_PAAMode 0 "No Request；" 1 "APA" 2 "RPA" 3 "HPA" 4 "AVP" 5 "RA" 6 "Customer Slot" 7 "PAA" 8 "APA OFF；" 9 "PAA OFF；" 10 "RA OFF；" 11 "DP" 12 "SteeringParkingButton"  ;
VAL_ 163 ACU_SVM_Button 0 "No request" 1 "Request"  ;
VAL_ 163 ACU_RAEBcfg 0 "No request" 1 "Off" 2 "On"  ;
VAL_ 163 ACU_PCS_MirrorpagedownButtonST 0 "Off" 1 "On"  ;
VAL_ 163 ACU_PCS_ScreenTouchSt 0 "No command" 1 "Press" 2 "Release" 3 "Slither"  ;
VAL_ 163 ACU_LanguageTypeSet 0 "Not used" 1 "Chinese" 2 "English" 3 "Russian" 4 "Arabic" 5 "Latin Spanish" 6 "Thai" 7 "Norwegian" 8 "HK" 9 "Indonesian" 10 "Melayu" 11 "Vietnamese" 12 "Deutsch" 13 "French" 14 "Italian" 15 "Spanish" 16 "Dutch" 17 "Swedish" 18 "Portuguese" 19 "Brazilian Portuguese" 20 "Hebrew (Israel)" 21 "Polish" 22 "Greek" 23 "Finnish" 24 "Danish" 25 "Turkish"  ;
VAL_ 163 ACU_PCS_SVM_FunctionCmd 0 "No command" 1 "HMI in transition(SVM)" 2 "Surround view and Front view(SVM)" 3 "Enlarge front view(SVM)" 4 "Surround view and Rear view(SVM)" 5 "Enlarge rear view(SVM)" 6 "Left blind spot view (SVM)" 7 "Right blind spot view(SVM)" 8 "Parking guidance view(SVM)" 9 "Parallel parking view(SVM)" 10 "Vertical parking view(SVM)" 11 "Rear view(RVM)" 12 "Parallel parking view(RVM)" 13 "Vertical parking view(RVM)" 14 "Not used" 15 "Request to cancel"  ;
VAL_ 163 ACU_PCS_ScreenCoordY 0 "No command"  ;
VAL_ 163 ACU_PCS_ScreenCoordX 0 "No command"  ;
VAL_ 163 ACU_APAMessageSt 0 "No Command" 1 "Show" 2 "Auto close" 3 "Maual close" 4 "Manual active"  ;
VAL_ 163 ACU_PAS_ButtonPress 0 "Not press" 1 "Press"  ;
VAL_ 163 ACU_HPAMessageSt 0 "None" 1 "Show" 2 "Auto close" 3 "Maual close" 4 "Maual Active"  ;
VAL_ 163 ACU_AVPMessageSt 0 "None" 1 "Show" 2 "Auto close" 3 "Maual close" 4 "Maual Active"  ;
VAL_ 163 ACU_HPALearningSetParkLot 0 "Invalid" 1 "Fixed parking lot" 2 "Random parking lot" 3 "Reserved"  ;
VAL_ 163 ACU_HPALearningProcessInfo 0 "No text" 1 "Set path starting point" 2 "Speed high" 3 "Starting point invalid" 4 "Continue driving" 5 "Distance limit" 6 "Exceed learning distance limit" 7 "Automatic parking in" 8 "Saving path" 9 "Learning path invalid_Reserved" 10 "Setting path name" 11 "Learning path valid_Reserved" 12 "Fixed or random parking lot" 13 "Learning finished" 14 "Keep drving to ending" 15 "Setting path ending" 15 "Setting path ending" 17 "Learning path failed" 18 "Speed higher than 15km/h" 19 "Speed higher than 20km/h and quit" 20 "Reserved" 21 "Reserved" 22 "Reserved" 23 "Reserved" 24 "Reserved" 25 "Reserved" 26 "Reserved" 27 "Reserved" 28 "Reserved" 29 "Reserved" 30 "Reserved" 31 "Reserved"  ;
VAL_ 163 ACU_SDEnterParkingLot 0 "No Request" 1 "Not enter" 2 "Entered" 3 "Unknown"  ;
VAL_ 163 ACU_PCS_ER_QuitConfirm 0 "No command" 1 "Command"  ;
VAL_ 163 ACU_DisplayReq 0 "No command" 1 "On" 2 "Off"  ;
VAL_ 163 ACU_ER_FuncCfg 0 "No command" 1 "On" 2 "Off"  ;
VAL_ 163 ACU_PCS_ER_EnterCmd 0 "No command" 1 "Command"  ;
VAL_ 163 ACU_PCS_ScreenTouchSignal 0 "No command" 1 "press" 2 "Release" 3 "Slither"  ;
VAL_ 163 ACU_PCSModeSt_A 0 "No command" 1 "Quick start mode" 2 "Normal mode"  ;
VAL_ 163 ACU_DPMessageSt 0 "No Command" 1 "Show" 2 "Auto close" 3 "Maual close" 4 "Manual active"  ;
VAL_ 163 ACU_ParkingBoxMidX 0 "No command"  ;
VAL_ 163 ACU_ParkingBoxMidY 0 "No command"  ;
VAL_ 163 ACU_ParkingBoxAngle 0 "No command"  ;
VAL_ 163 ACU_PCSModeSt 0 "Normal mode" 1 "Quick start mode;"  ;
VAL_ 163 ACU_LowPowerConfig 0 "No command" 1 "LowPower Mode Requst" 2 "Normal Mode Request" 3 "ModeChaging"  ;
VAL_ 163 ACU_NDAVoicePromptTypeCfg 0 "Not selected" 1 "simple" 2 "full" 3 "Not used"  ;
VAL_ 163 IDC_SenslesEtyParkingSwSt 0 "Not request" 1 "OFF" 2 "ON"  ;
VAL_ 163 IDC_DskScreenOperationSt 0 "Not Operating" 1 "Operating"  ;
VAL_ 163 IDC_APAParkingSpdsSfg 0 "No Request;" 1 "SlowReq" 2 "MiddleReq" 3 "HighReq"  ;
VAL_ 163 ACU_VR_APAControl 0 "No Request；" 1 "APA自动泊车功能；" 2 "RPA遥控泊车功能；" 3 "HPA记忆泊车功能；" 4 "AVP代客泊车功能；" 5 "RA倒车寻迹功能；" 6 "Customer Slot 自选车位功能；" 7 "AVM 全景影像；" 8 "OFF泊车关闭/退出；" 9 "StartParking开始/继续泊车；" 10 "Pause泊车暂停；"  ;
VAL_ 163 ACU_SteeringPrkgButton 0 "No Request；" 1 "APA自动泊车功能；" 2 "RPA遥控泊车功能；" 3 "HPA记忆泊车功能；" 4 "AVP代客泊车功能；" 5 "RA倒车寻迹功能；" 6 "Customer Slot 自选车位功能；" 7 "AVM 全景影像；"  ;
VAL_ 163 IDC_SenslesEtyParkingDskScene 0 "None;" 1 "VehicleModeScene" 2 "NaviScene" 3 "WallpaperScene" 7 "OthersScene"  ;
VAL_ 163 ACU_SVM_Button_A 0 "No request" 1 "Open SVM" 2 "Close SVM" 3 "Not used" 4 "Not used" 5 "Not used" 6 "Not used" 7 "Not used"  ;
VAL_ 163 ACU_ActiveNDAMessageSt 0 "No command" 1 "Active" 2 "Auto close" 3 "Manuel close" 4 "Manuel confirm"  ;
VAL_ 163 ACU_ActiveAVPMessageSt 0 "No command" 1 "Active" 2 "Auto close" 3 "Manuel close" 4 "Manuel confirm"  ;
VAL_ 163 ACU_LeftLaneChangeMessageSt 0 "No command" 1 "Active" 2 "Auto close" 3 "Manuel close" 4 "Manuel confirm"  ;
VAL_ 163 ACU_RigthLaneChangeMessageSt 0 "No command" 1 "Active" 2 "Auto close" 3 "Manuel close" 4 "Manuel confirm"  ;
VAL_ 163 ACU_ICANDAIconMessageSt 0 "No command" 1 "press"  ;
VAL_ 780 ACU_ISARoadTyp 0 "unknown" 1 "High way" 2 "National road" 3 "Provincial road" 4 "County road" 5 "Village road" 6 "City express way" 7 "Major urban road" 8 "Secondary urban road" 9 "Normal urban road" 10 "Non-Navigation Road" 11 "Ramp" 12 "Residential" 13 "Inter-Urban" 14 "Reserved" 15 "Reserved"  ;
VAL_ 780 ACU_ISARoadSpdLimit 0 "UnknownSPL" 1 "SPL5" 2 "SPL10" 3 "SPL15" 4 "SPL20" 29 "SPL145" 30 "SPL150" 255 "UnLimited"  ;
VAL_ 780 ACU_ISASpdLimitUnit 0 "Invalid" 1 "KPH" 2 "MPH" 3 "Reserved"  ;
VAL_ 780 ACU_ISASpdLimitTyp 0 "Invalid" 1 "Explicit" 2 "Implicit" 3 "Reserved"  ;
VAL_ 780 ACU_ISARampTyp 0 "Invalid" 1 "HW to HW" 2 "HW to NonHW" 3 "HW to ServiceArea"  ;
VAL_ 780 ACU_ISACondSpdLimit 0 "UnknownSPL" 1 "SPL5" 2 "SPL10" 3 "SPL15" 4 "SPL20" 29 "SPL145" 30 "SPL150" 255 "UnLimited"  ;
VAL_ 780 ACU_ISACondSpdLimitTyp 0 "Default" 1 "TIME" 2 "DISTANCE" 3 "RAIN" 4 "SNOW" 5 "FOG" 6 "VEHICLE" 7 "TRAILER" 8 "ARROW"  ;
VAL_ 780 ACU_ISACondSpdLimitVd 0 "Default" 1 "YES" 2 "NO" 3 "Reserved"  ;
VAL_ 780 ACU_ISASupplierInfo 0 "Default" 1 "高德" 2 "百度" 3 "腾讯" 4 "四维" 5 "Neusoft" 6 "泰为" 7 "梦擎" 8 "Here" 9 "Tomtom" 10 "Reserved" 11 "Reserved" 12 "Reserved" 13 "Reserved" 14 "Reserved" 15 "Reserved"  ;
VAL_ 780 IDC_FuncReq_SentryModDetec 0 "OFF" 1 "SentryModeKeep"  ;
VAL_ 780 ACU_ISAServiceWorkSt 0 "Not available" 1 "Normal" 2 "GPS week" 3 "No map data" 4 "ISA-APK Fault" 5 "Reserved" 6 "Reserved" 7 "Reserved"  ;
VAL_ 780 IDC_SentryModeVideoReq 0 "NoRequest" 1 "RequestVideo" 2 "Reserved" 3 "Reserved"  ;
VAL_ 967 DMS_SysErrSt 0 "Unavailable_Default value" 1 "DMS blocked by steeringwheel" 2 "DMS blocked" 3 "FF lose templates" 4 "IR-proof sunglass detected" 5 "DMS system error" 6 "Normal Running" 7 "reserved"  ;
VAL_ 967 DMS_DrvrDetSts 1 "Not detected--driver is not detected" 2 "Eye detected--driver's eye can be detected" 3 "Head detected--driver's head can be detected" 4 "Reserved" 5 "Reserved" 6 "Reserved" 7 "Reserved"  ;
VAL_ 967 DMS_InterestsRegion 0 "Unavailable-default value" 1 "Driver side window" 2 "Rear view mirror" 3 "Driver side windshield" 4 "Codriver side windshield" 5 "Instrument cluster" 6 "Infotaiment display" 7 "Driver side door panel" 8 "Driver side footwell" 9 "Codriver side footwell" 10 "Codriver side window" 11 "Left outer mirror" 12 "Right outer mirror" 13 "Gear" 14 "Driver side windshield  top" 15 "Codriver side windshield top" 16 "Other Area" 17 "Reserved" 18 "Reserved" 19 "Reserved" 20 "Reserved" 21 "Reserved" 22 "Reserved" 23 "Reserved" 24 "Reserved" 25 "Reserved" 26 "Reserved" 27 "Reserved" 28 "Reserved" 29 "Reserved" 30 "Reserved" 31 "Reserved"  ;
VAL_ 967 DMS_L3DriverDistractionSt 0 "Unavailable--default value" 21 "Unknown--can not determine the distraction level" 42 "Distractive--Looking at red area or yellow area and over the limit condition" 63 "Non-Distractive--Looking at green area or yellow area with limit condition"  ;
VAL_ 967 DMS_L3DriverFatigueSt 0 "unavailable" 585 "unknown" 1170 "alert" 1755 "fatigue" 2340 "highly fatigue" 2925 "suspected unresponsive" 3510 "confirmed unresponsive" 4095 "not used"  ;
VAL_ 967 DMS_FaceIDStatus 0 "Defoult" 1 "Registering" 2 "Recognizing" 3 "Erorr"  ;
VAL_ 967 DMS_FaceID 0 "Default" 1 "AUID 1" 2 "AUID 2" 3 "AUID 3" 4 "AUID 4" 5 "AUID 5" 6 "AUID 6" 7 "AUID 7" 8 "AUID 8" 9 "Other" 10 "Other" 11 "Other" 12 "Other" 13 "Other" 14 "Other" 15 "Other"  ;
VAL_ 967 DMS_FaceIDVerifyResult 0 "Default" 1 "Success" 2 "Fail" 3 "Timeout"  ;
VAL_ 967 DMS_LeftEyeOpenSt 0 "Unavailable-default value" 1 "open" 2 "closed" 3 "can not detected"  ;
VAL_ 967 DMS_RightEyeOpenSt 0 "Unavailable-default value" 1 "open" 2 "closed" 3 "can not detected"  ;
VAL_ 967 DMS_DriverSmokeSt 0 "Unavailable-default value" 1 "smoking" 2 "non-smoking" 3 "reserved"  ;
VAL_ 967 DMS_DriverTelephoneSt 0 "Unavailable-default value" 1 "phoning" 2 "non-phoning" 3 "reserved"  ;
VAL_ 967 DMS_DriverHealthSt 0 "Unavailable-default value" 1 "Heart rate" 2 "Heart rate variability" 3 "Blood oxygen saturation" 4 "Blood pressure" 5 "Respiratory rate"  ;
VAL_ 967 DMS_FatigWarnSt 0 "Unavailable--driver not detected or default value or Deactivated" 1 "Unknown--driver detected, but can't determine the" 2 "alert" 3 "Drowsiness" 4 "Mircosleep" 5 "Sleep" 6 "Unresponsive driver" 7 "Reserved"  ;
VAL_ 967 DMS_DistrWarnSt 0 "Unavailable--driver not detected or default value or Deactivated" 1 "Unknown--driver detected, but can't determine the" 2 "Long Distraction--During the driving,the driver is looking at the incorrect zones for 3min." 3 "Short Distraction--During the driving,the driver is repeated glances away from the forward road view" 4 "Special Long Distractive--During the driving,the driver is looking at the incorrect zones for 1min." 5 "Non-Distractive--During the driving,the driver is looking" 6 "Reserved" 7 "Reserved"  ;
VAL_ 967 DMS_DriverExpressionSt 0 "Default" 1 "Angry" 2 "Calm" 3 "Disgust" 4 "Happy" 5 "Sad" 6 "Scared" 7 "Supprise" 8 "Positive" 9 "Negative" 10 "Unclear" 11 "reserved" 12 "reserved" 13 "reserved" 14 "reserved" 15 "reserved"  ;
VAL_ 967 DMS_YawnSt 0 "Unavailable-default value" 1 "True" 2 "False" 3 "can not detected"  ;
VAL_ 400 UINM_DrvReqShft 0 "Shifter position O" 1 "Shifter position F1" 2 "Shifter position F2" 3 "Shifter position B1" 4 "Shifter position B2" 5 "Shifter not initialized / INIT" 6 "Signal not available / SNA (Double fault shifter sensor)"  ;
VAL_ 400 UINM_DrvReqShftInv 9 "Signal not available / SNA (Double fault shifter sensor)" 10 "Shifter not initialized / INIT" 11 "Shifter position B2" 12 "Shifter position B1" 13 "Shifter position F2" 14 "Shifter position F1" 15 "Shifter position O"  ;
VAL_ 400 UINM_FuSaErrSt 0 "No Error" 1 "Error"  ;
VAL_ 400 UINM_ShftFault 0 "E-shift Normal" 1 "E-shift fault"  ;
VAL_ 400 UINM_PositionLightSwSt 0 "Not Active" 1 "Active" 2 "fault" 3 "Reserved"  ;
VAL_ 400 UINM_LowBeamSwSt 0 "Not Active" 1 "Active" 2 "fault" 3 "Reserved"  ;
VAL_ 400 UINM_AutoLightSwSt 0 "Not Active" 1 "Active" 2 "fault" 3 "Reserved"  ;
VAL_ 400 UINM_FrontFogLightSwSt 0 "Not Active" 1 "Active"  ;
VAL_ 400 UINM_RearFogLightSwSt 0 "Not Active" 1 "Active"  ;
VAL_ 400 UINM_HighBeamSwSt 0 "Not active" 1 "Continue" 2 "Flash" 3 "fault"  ;
VAL_ 400 UINM_TurnLightSwSt 0 "Not active" 1 "Left turn" 2 "Right turn" 3 "Left change" 4 "Right change" 5 "Fault" 6 "Reserved" 7 "Reserved"  ;
VAL_ 400 UINM_ButCtlMaskFlag 0 "Inactive" 1 "Active"  ;
VAL_ 400 UINM_FrontWiperSwSt 0 "Off" 1 "Low speed" 2 "Int/Auto" 3 "High speed" 4 "mist" 7 "invaild"  ;
VAL_ 400 UINM_FrontWiperIntAdjSwSt 0 "No used" 15 "Invaild"  ;
VAL_ 400 UINM_FrontWasherSwSt 0 "Not Active" 1 "Active"  ;
VAL_ 400 UINM_RearWiperSwSt 0 "Off" 1 "Low speed" 2 "Int/Auto" 3 "High speed" 7 "invaild"  ;
VAL_ 400 UINM_RearWiperIntAdjSwSt 0 "No used" 15 "Invaild"  ;
VAL_ 400 UINM_RearWasherSwSt 0 "Inactive" 1 "Active"  ;
VAL_ 400 UINM_HeadLampWasherSwSt 0 "Inactive" 1 "Active"  ;
