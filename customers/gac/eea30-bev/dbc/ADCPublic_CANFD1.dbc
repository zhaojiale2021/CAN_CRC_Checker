VERSION "Version"

NS_ :

BS_:

BU_: CCU ADC FAPA IFC FLR FRR RRR RLR INU Tester CBM VIU SRS IDC PCS AMP IMR FIMR TBOX IBCS IXCU V2XOBU WHUD RLBMS CCURT2 RT2_C3 OTAWL ZCUF ZCUL ZCUR ZCUT IPS DCU NIDU RBM WACUFL IID CCURT1 RT1_C0 RT1_C1 AVAS FLLCM FRLCM RLLCMA RRLCMA RLLCMB RRLCMB LBMS LBMSAD MFS FCP IDU ITS BCB DCDC PCU EOP DCU2 BMS TMC EPS ECS CD PAS SBM WCM ETC TBOX2 DSM FLPDM FRPDM RLPDM RRPDM HVSMR SCMRL SCMRR EBU EPB VDC EVCC ADM PLGM FBLCM RLISD RRISD RCP RFR WCMFR SCMR TFOAR TROAR HVSPRL HVSPRR

BO_ 696 CCU_ZCUR_SBM_5: 64 CCU
 SG_ SBM_5_CRC : 7|16@0+ (1,0) [0|65535] ""  ADC,FAPA
 SG_ SBM_5_Counter : 23|8@0+ (1,0) [0|255] ""  ADC,FAPA
 SG_ KAE_EDK1UnlockBtnPressSt : 31|2@0+ (1,0) [0|3] ""  ADC,FAPA
 SG_ KAE_EDK1LockBtnPressSt : 29|2@0+ (1,0) [0|3] ""  ADC,FAPA
 SG_ KAE_EDK1RESBtnPressSt : 27|2@0+ (1,0) [0|3] ""  ADC,FAPA
 SG_ KAE_EDK1PSD_LBtnPressSt : 25|2@0+ (1,0) [0|3] ""  ADC,FAPA
 SG_ KAE_EDK1PSD_RBtnPressSt : 39|2@0+ (1,0) [0|3] ""  ADC,FAPA
 SG_ KAE_EDK1TrunkBtnPressSt : 37|2@0+ (1,0) [0|3] ""  ADC,FAPA
 SG_ KAE_EDK1PanicBtnPressSt : 35|2@0+ (1,0) [0|3] ""  ADC,FAPA
 SG_ KAE_EDK1User_definedBtnPressSt : 33|2@0+ (1,0) [0|3] ""  ADC,FAPA
 SG_ KAE_EDK2UnlockBtnPressSt : 47|2@0+ (1,0) [0|3] ""  ADC,FAPA
 SG_ KAE_EDK2LockBtnPressSt : 45|2@0+ (1,0) [0|3] ""  ADC,FAPA
 SG_ KAE_EDK2RESBtnPressSt : 43|2@0+ (1,0) [0|3] ""  ADC,FAPA
 SG_ KAE_EDK2PSD_LBtnPressSt : 41|2@0+ (1,0) [0|3] ""  ADC,FAPA
 SG_ KAE_EDK2PSD_RBtnPressSt : 55|2@0+ (1,0) [0|3] ""  ADC,FAPA
 SG_ KAE_EDK2TrunkBtnPressSt : 53|2@0+ (1,0) [0|3] ""  ADC,FAPA
 SG_ KAE_EDK2PanicBtnPressSt : 51|2@0+ (1,0) [0|3] ""  ADC,FAPA
 SG_ KAE_EDK2User_definedBtnPressSt : 49|2@0+ (1,0) [0|3] ""  ADC,FAPA
 SG_ KAE_EDK3UnlockBtnPressSt : 63|2@0+ (1,0) [0|3] ""  ADC,FAPA
 SG_ KAE_EDK3LockBtnPressSt : 61|2@0+ (1,0) [0|3] ""  ADC,FAPA
 SG_ KAE_EDK3RESBtnPressSt : 59|2@0+ (1,0) [0|3] ""  ADC,FAPA
 SG_ KAE_EDK3PSD_LBtnPressSt : 57|2@0+ (1,0) [0|3] ""  ADC,FAPA
 SG_ KAE_EDK3PSD_RBtnPressSt : 71|2@0+ (1,0) [0|3] ""  ADC,FAPA
 SG_ KAE_EDK3TrunkBtnPressSt : 69|2@0+ (1,0) [0|3] ""  ADC,FAPA
 SG_ KAE_EDK3PanicBtnPressSt : 67|2@0+ (1,0) [0|3] ""  ADC,FAPA
 SG_ KAE_EDK3User_definedBtnPressSt : 65|2@0+ (1,0) [0|3] ""  ADC,FAPA
 SG_ KAE_RPADirectionSel : 79|3@0+ (1,0) [0|7] ""  ADC,FAPA
 SG_ KAE_RPAmode : 76|2@0+ (1,0) [0|3] ""  ADC,FAPA
 SG_ KAE_RPADeviceSt : 74|3@0+ (1,0) [0|7] ""  ADC,FAPA
 SG_ KAE_PhoneBatt : 87|8@0+ (1,0) [0|100] "%"  ADC,FAPA
 SG_ KAE_RPACheckReq : 95|1@0+ (1,0) [0|1] ""  ADC,FAPA
 SG_ KAE_RPAKeyPstSt : 94|2@0+ (1,0) [0|3] ""  ADC,FAPA
 SG_ KAE_RPADeviceFailReason : 92|4@0+ (1,0) [0|15] ""  ADC,FAPA
 SG_ KAE_RPABtnSt : 88|1@0+ (1,0) [0|1] ""  ADC,FAPA
 SG_ KAE_ForRPAFailReason : 103|4@0+ (1,0) [0|15] ""  ADC,FAPA
 SG_ KAE_RPABtnStVD : 99|1@0+ (1,0) [0|1] ""  ADC,FAPA
 SG_ KAE_RPACancelBtnSt : 98|1@0+ (1,0) [0|1] ""  ADC,FAPA
 SG_ KAE_RPACancelBtnStVD : 97|1@0+ (1,0) [0|1] ""  ADC,FAPA
 SG_ KAE_ComSDKUBouncesSt : 96|1@0+ (1,0) [0|1] ""  ADC,FAPA
 SG_ KAE_HAVPCancelParking : 111|1@0+ (1,0) [0|1] ""  ADC,FAPA
 SG_ KAE_HAVPDisclaimerAgree : 110|2@0+ (1,0) [0|3] ""  ADC,FAPA
 SG_ KAE_HAVPPathSelect : 108|4@0+ (1,0) [0|15] ""  ADC,FAPA
 SG_ KAE_RPAResponse : 119|8@0+ (1,0) [0|255] ""  ADC,FAPA
 SG_ KAE_HAVPUWBZone : 127|4@0+ (1,0) [0|15] ""  ADC,FAPA
 SG_ KAE_HAVPUWBXPosition : 123|12@0+ (1,0) [0|4095] ""  ADC,FAPA
 SG_ KAE_HAVPUWBYPosition : 143|12@0+ (1,0) [0|4095] ""  ADC,FAPA
 SG_ KAE_UnlockDoorReq : 147|1@0+ (1,0) [0|1] ""  ADC,FAPA,IFC
 SG_ KAE_UnlockDoorReqVD : 146|1@0+ (1,0) [0|1] ""  ADC,FAPA,IFC
 SG_ KAE_LockDoorReq : 145|1@0+ (1,0) [0|1] ""  ADC,FAPA,IFC
 SG_ KAE_LockDoorReqVD : 144|1@0+ (1,0) [0|1] ""  ADC,FAPA,IFC
 SG_ KAE_WindowsCloseReq : 159|1@0+ (1,0) [0|1] ""  ADC,FAPA,IFC
 SG_ KAE_WindowsCloseReqVD : 158|1@0+ (1,0) [0|1] ""  ADC,FAPA,IFC
 SG_ KAE_WindowsOpenReq : 157|1@0+ (1,0) [0|1] ""  ADC,FAPA,IFC
 SG_ KAE_WindowsOpenReqVD : 156|1@0+ (1,0) [0|1] ""  ADC,FAPA,IFC
 SG_ KAE_TrunkUnlockReq : 155|1@0+ (1,0) [0|1] ""  ADC,FAPA,IFC
 SG_ KAE_TrunkUnlockReqVD : 154|1@0+ (1,0) [0|1] ""  ADC,FAPA,IFC
 SG_ KAE_HoodUnlockReq : 153|1@0+ (1,0) [0|1] ""  ADC,FAPA,IFC
 SG_ KAE_HoodUnlockReqVD : 152|1@0+ (1,0) [0|1] ""  ADC,FAPA,IFC
 SG_ KAE_PLGMOpenReq : 167|1@0+ (1,0) [0|1] ""  ADC,FAPA,IFC
 SG_ KAE_PLGMOpenReqVD : 166|1@0+ (1,0) [0|1] ""  ADC,FAPA,IFC
 SG_ KAE_PLGMCloseReq : 165|1@0+ (1,0) [0|1] ""  ADC,FAPA,IFC
 SG_ KAE_PLGMCloseReqVD : 164|1@0+ (1,0) [0|1] ""  ADC,FAPA,IFC
 SG_ KAE_SunRoofOpenReq : 163|1@0+ (1,0) [0|1] ""  ADC,FAPA,IFC
 SG_ KAE_SunRoofOpenReqVD : 162|1@0+ (1,0) [0|1] ""  ADC,FAPA,IFC
 SG_ KAE_SunRoofCloseReq : 161|1@0+ (1,0) [0|1] ""  ADC,FAPA,IFC
 SG_ KAE_SunRoofCloseReqVD : 160|1@0+ (1,0) [0|1] ""  ADC,FAPA,IFC
 SG_ KAE_AllCloseReq : 273|1@0+ (1,0) [0|1] ""  ADC,FAPA
 SG_ KAE_AllCloseReqVd : 272|1@0+ (1,0) [0|1] ""  ADC,FAPA
 SG_ KAE_PAAReq : 287|4@0+ (1,0) [0|15] ""  ADC,FAPA
 SG_ KAE_PAAReqVd : 283|1@0+ (1,0) [0|1] ""  ADC,FAPA
 SG_ KAE_EDK1UnlockBtnSt : 282|1@0+ (1,0) [0|1] ""  ADC,FAPA
 SG_ KAE_EDK1LockBtnSt : 281|1@0+ (1,0) [0|1] ""  ADC,FAPA
 SG_ KAE_EDK1RESBtnSt : 280|1@0+ (1,0) [0|1] ""  ADC,FAPA
 SG_ KAE_EDK1PSD_LBtnSt : 295|1@0+ (1,0) [0|1] ""  ADC,FAPA
 SG_ KAE_EDK1PSD_RBtnSt : 294|1@0+ (1,0) [0|1] ""  ADC,FAPA
 SG_ KAE_EDK1TrunkBtnSt : 293|1@0+ (1,0) [0|1] ""  ADC,FAPA
 SG_ KAE_EDK1PanicBtnSt : 292|1@0+ (1,0) [0|1] ""  ADC,FAPA
 SG_ KAE_EDK1User_definedBtnSt : 291|1@0+ (1,0) [0|1] ""  ADC,FAPA
 SG_ KAE_EDK2UnlockBtnSt : 290|1@0+ (1,0) [0|1] ""  ADC,FAPA
 SG_ KAE_EDK2LockBtnSt : 289|1@0+ (1,0) [0|1] ""  ADC,FAPA
 SG_ KAE_EDK2RESBtnSt : 288|1@0+ (1,0) [0|1] ""  ADC,FAPA
 SG_ KAE_EDK2PSD_LBtnSt : 303|1@0+ (1,0) [0|1] ""  ADC,FAPA
 SG_ KAE_EDK2PSD_RBtnSt : 302|1@0+ (1,0) [0|1] ""  ADC,FAPA
 SG_ KAE_EDK2TrunkBtnSt : 301|1@0+ (1,0) [0|1] ""  ADC,FAPA
 SG_ KAE_EDK2PanicBtnSt : 300|1@0+ (1,0) [0|1] ""  ADC,FAPA
 SG_ KAE_EDK2User_definedBtnSt : 299|1@0+ (1,0) [0|1] ""  ADC,FAPA
 SG_ KAE_EDK3UnlockBtnSt : 298|1@0+ (1,0) [0|1] ""  ADC,FAPA
 SG_ KAE_EDK3LockBtnSt : 297|1@0+ (1,0) [0|1] ""  ADC,FAPA
 SG_ KAE_EDK3RESBtnSt : 296|1@0+ (1,0) [0|1] ""  ADC,FAPA
 SG_ KAE_EDK3PSD_LBtnSt : 311|1@0+ (1,0) [0|1] ""  ADC,FAPA
 SG_ KAE_EDK3PSD_RBtnSt : 310|1@0+ (1,0) [0|1] ""  ADC,FAPA
 SG_ KAE_EDK3TrunkBtnSt : 309|1@0+ (1,0) [0|1] ""  ADC,FAPA
 SG_ KAE_EDK3PanicBtnSt : 308|1@0+ (1,0) [0|1] ""  ADC,FAPA
 SG_ KAE_EDK3User_definedBtnSt : 316|1@0+ (1,0) [0|1] ""  ADC,FAPA

BO_ 403 ADC_1: 64 ADC
 SG_ ADC_1_CRC : 7|16@0+ (1,0) [0|65535] ""  CCU,CCURT1,CCURT2,RBM,IBCS,IDC,FAPA
 SG_ ADC_1_Counter : 23|8@0+ (1,0) [0|255] ""  CCU,CCURT1,CCURT2,RBM,IBCS,IDC,FAPA
 SG_ NDA_Type : 27|3@0+ (1,0) [0|7] ""  CCU,CCURT1,CCURT2,FAPA
 SG_ ADC_ACCMode : 31|4@0+ (1,0) [0|15] ""  CCU,CCURT1,CCURT2,IDC,FAPA,TBOX
 SG_ ADAS_Related_System_Failure_St : 24|5@0+ (1,0) [0|31] ""  CCU,CCURT1,CCURT2,FAPA
 SG_ ADC_ISLC_ConfirmSt : 41|2@0+ (1,0) [0|3] ""  CCU,CCURT1,CCURT2,IDC,FAPA
 SG_ ADAS_System_Failure_St : 55|6@0+ (1,0) [0|63] ""  CCU,CCURT1,CCURT2,FAPA
 SG_ ADC_ACCFailureReason : 59|4@0+ (1,0) [0|15] ""  CCU,CCURT1,CCURT2,FAPA,TBOX
 SG_ ADC_ACCPassiveReason : 67|4@0+ (1,0) [0|15] ""  CCU,CCURT1,CCURT2,FAPA,TBOX
 SG_ ADC_ACC_SpeedLimitType : 71|4@0+ (1,0) [0|15] ""  CCU,CCURT1,CCURT2,IDC,FAPA
 SG_ ADC_TJP_St : 79|5@0+ (1,0) [0|31] ""  CCU,CCURT1,CCURT2,FAPA,IFC,TBOX
 SG_ ADC_TJPIconColor : 74|3@0+ (1,0) [0|7] ""  CCU,CCURT1,CCURT2,IDC,FAPA
 SG_ ADC_TimeGapSet : 87|3@0+ (1,0) [0|7] ""  CCU,CCURT1,CCURT2,IDC,FAPA,TBOX
 SG_ ADC_ICA_St : 84|5@0+ (1,0) [0|31] ""  CCU,CCURT1,CCURT2,FAPA,FLR,FRR,TBOX
 SG_ ADC_CruiseLatCtrlType : 95|4@0+ (1,0) [0|15] ""  CCU,CCURT1,CCURT2,FAPA,TBOX
 SG_ ADC_Cruise_SpeedLimitType : 91|4@0+ (1,0) [0|15] ""  CCU,CCURT1,CCURT2,FAPA,TBOX
 SG_ ADC_ILC_EnableSt : 103|1@0+ (1,0) [0|1] ""  CCU,CCURT1,CCURT2,IDC,FAPA,TBOX
 SG_ ADC_ILOA_EnableSt : 102|1@0+ (1,0) [0|1] ""  CCU,CCURT1,CCURT2,IDC,FAPA,TBOX
 SG_ ADC_ICA_TORReason : 101|3@0+ (1,0) [0|7] ""  CCU,CCURT1,CCURT2,FAPA,TBOX
 SG_ ADC_CruiseLat_TORWarn : 98|3@0+ (1,0) [0|7] ""  CCU,CCURT1,CCURT2,FAPA,TBOX
 SG_ ADC_ILOASt : 111|3@0+ (1,0) [0|7] ""  CCU,CCURT1,CCURT2,FAPA,TBOX
 SG_ ADC_ILOAType : 108|3@0+ (1,0) [0|7] ""  CCU,CCURT1,CCURT2,FAPA,TBOX
 SG_ ADC_ILOA_Actdirection : 105|2@0+ (1,0) [0|3] ""  CCU,CCURT1,CCURT2,FAPA,TBOX
 SG_ ADC_LaneChangeSt : 119|4@0+ (1,0) [0|15] ""  CCU,CCURT1,CCURT2,FAPA,IFC,TBOX
 SG_ ADC_LaneChange_RetreatReason : 115|4@0+ (1,0) [0|15] ""  CCU,CCURT1,CCURT2,FAPA,TBOX
 SG_ ADC_LaneChange_WaitReason : 127|4@0+ (1,0) [0|15] ""  CCU,CCURT1,CCURT2,FAPA,TBOX
 SG_ ADC_LaneChange_AbortReason : 123|4@0+ (1,0) [0|15] ""  CCU,CCURT1,CCURT2,FAPA,TBOX
 SG_ ADC_LaneChange_Actdirection : 135|2@0+ (1,0) [0|3] ""  CCU,CCURT1,CCURT2,FAPA,TBOX
 SG_ ADC_ICA_MRMReason : 133|3@0+ (1,0) [0|7] ""  CCU,CCURT1,CCURT2,FAPA,TBOX
 SG_ ADC_ICA_Mileage : 130|11@0+ (1,0) [0|2000] ""  CCU,CCURT1,CCURT2,FAPA,TBOX
 SG_ ADC_ICAMRMWarningLevel : 151|2@0+ (1,0) [0|3] ""  CCU,CCURT1,CCURT2,FAPA,TBOX
 SG_ ADC_ICA_PassiveReason : 149|6@0+ (1,0) [0|63] ""  CCU,CCURT1,CCURT2,FAPA,TBOX
 SG_ ADC_ICA_faultReason : 159|5@0+ (1,0) [0|31] ""  CCU,CCURT1,CCURT2,FAPA,TBOX
 SG_ ADC_HFIconColor : 154|3@0+ (1,0) [0|7] ""  CCU,CCURT1,CCURT2,IDC,FAPA
 SG_ ADC_AdsFucntionNotActive : 171|4@0+ (1,0) [0|15] ""  CCU,CCURT1,CCURT2,FAPA
 SG_ ADC_MRMNumber : 167|4@0+ (1,0) [0|15] ""  CCU,CCURT1,CCURT2,FAPA,TBOX
 SG_ ADC_MRCNumber : 163|4@0+ (1,0) [0|15] ""  CCU,CCURT1,CCURT2,FAPA,TBOX
 SG_ ADC_HandsOnSt : 175|2@0+ (1,0) [0|3] ""  CCU,CCURT1,CCURT2,FAPA,TBOX
 SG_ ADC_HandsOn_Warning : 173|2@0+ (1,0) [0|3] ""  CCU,CCURT1,CCURT2,FAPA,TBOX
 SG_ ADC_ICMADASFailureText : 183|8@0+ (1,0) [0|255] ""  CCU,CCURT1,CCURT2,IDC,FAPA,FLR,FRR
 SG_ ADC_ICMADASWarnText : 191|5@0+ (1,0) [0|31] ""  CCU,CCURT1,CCURT2,IDC,FAPA,FLR,FRR
 SG_ ADC_SpeedLimitIconSt : 186|3@0+ (1,0) [0|7] ""  CCU,CCURT1,CCURT2,IDC,FAPA
 SG_ ADC_ICMWarnCardSt : 199|5@0+ (1,0) [0|31] ""  CCU,CCURT1,CCURT2,IDC,FAPA
 SG_ ADC_ICAIconColor : 194|3@0+ (1,0) [0|7] ""  CCU,CCURT1,CCURT2,IDC,FAPA
 SG_ ADC_ICMPromptWarn : 207|5@0+ (1,0) [0|31] ""  CCU,CCURT1,CCURT2,IDC,FAPA,FLR,FRR
 SG_ ADC_NDAIconColor : 202|3@0+ (1,0) [0|7] ""  CCU,CCURT1,CCURT2,IDC,FAPA
 SG_ ADC_ACUVoiceWarn : 215|5@0+ (1,0) [0|31] ""  CCU,CCURT1,CCURT2,IDC,FAPA
 SG_ ADC_NDAStateIcon : 210|3@0+ (1,0) [0|7] ""  CCU,CCURT1,CCURT2,IDC,FAPA
 SG_ ADC_SpeedLimitIcon : 223|8@0+ (1,0) [0|255] "km/h"  CCU,CCURT1,CCURT2,IDC,FAPA
 SG_ ADC_ICANDAIconAngle : 231|8@0+ (2,-180) [-180|180] "degree"  CCU,CCURT1,CCURT2,IDC,FAPA
 SG_ ADC_ACCTargetSpeedCard : 239|8@0+ (1,0) [0|255] "km/h"  CCU,CCURT1,CCURT2,IDC,FAPA
 SG_ ADC_ACCIconColor : 247|3@0+ (1,0) [0|7] ""  CCU,CCURT1,CCURT2,IDC,FAPA
 SG_ ADC_ICMADASFailureLamp : 244|2@0+ (1,0) [0|3] ""  CCU,CCURT1,CCURT2,IDC,FAPA
 SG_ ADC_Pilot_VoiceWarn : 242|5@0+ (1,0) [0|31] ""  CCU,CCURT1,CCURT2,IDC,FAPA
 SG_ ADC_Pilot_PromptWarn : 253|5@0+ (1,0) [0|31] ""  CCU,CCURT1,CCURT2,IDC,FAPA
 SG_ ADC_Pilot_WarnText : 248|5@0+ (1,0) [0|31] ""  CCU,CCURT1,CCURT2,IDC,FAPA
 SG_ ADC_Pilot_WarnCardSt : 259|5@0+ (1,0) [0|31] ""  CCU,CCURT1,CCURT2,IDC,FAPA
 SG_ ADC_AdsFault : 266|3@0+ (1,0) [0|7] ""  CCU
 SG_ ADC_NicaReminderLEDVisual : 269|3@0+ (1,0) [0|7] ""  CCU
 SG_ ADC_NicaReminderAcoustic : 359|3@0+ (1,0) [0|7] ""  CCU
 SG_ ADC_AdsTakeoverID : 279|16@0+ (1,0) [0|65535] ""  CCU
 SG_ ADC_AdsTakeoverLevel : 339|3@0+ (1,0) [0|7] ""  CCU,CCURT1
 SG_ ADC_TORIDCorrespErrorID : 295|16@0+ (1,0) [0|65535] ""  CCU
 SG_ ADC_TakeoverExtended16bit : 311|16@0+ (1,0) [0|65535] "m"  CCU
 SG_ ADC_TakeoverExtended8bit : 327|8@0+ (1,0) [0|255] ""  CCU
 SG_ ADC_AvpFunctionStatus : 356|5@0+ (1,0) [0|31] ""  CCU,CCURT1
 SG_ ADC_CalibState : 331|4@0+ (1,0) [0|15] ""  CCU
 SG_ ADC_AccFunctionStatus : 335|4@0+ (1,0) [0|15] ""  CCU,CCURT1
 SG_ ADC_NicaFunctionStatus : 349|6@0+ (1,0) [0|63] ""  CCU,CCURT1
 SG_ ADC_AEBWaning : 343|4@0+ (1,0) [0|15] ""  CCU,CCURT1
 SG_ ADC_LKAWarning : 336|3@0+ (1,0) [0|7] ""  CCU,CCURT1
 SG_ ADC_LCCStateIcon : 367|3@0+ (1,0) [0|7] ""  CCU,CCURT1,CCURT2,IDC,FAPA
 SG_ Reserved1 : 440|1@0+ (1,0) [0|0] ""  CCU
 SG_ ADC_1_FreshnessValue : 455|16@0+ (1,0) [0|255] ""  CCU,CCURT1,IDC,FAPA
 SG_ ADC_1_MAC_Check : 471|48@0+ (1,0) [0|255] ""  CCU,CCURT1,IDC,FAPA

CM_ SG_ 696 SBM_5_CRC "E2E Profile 5 CRC";
CM_ SG_ 696 SBM_5_Counter "E2E Profile 5 Counter";
CM_ SG_ 696 KAE_EDK1UnlockBtnPressSt "EDK Unlock Button Pressed Status";
CM_ SG_ 696 KAE_EDK1LockBtnPressSt "EDK Lock Button Pressed Status";
CM_ SG_ 696 KAE_EDK1RESBtnPressSt "EDK RES Button Status";
CM_ SG_ 696 KAE_EDK1PSD_LBtnPressSt "EDK PSD_L Button Status";
CM_ SG_ 696 KAE_EDK1PSD_RBtnPressSt "EDK PSD_R Button Status";
CM_ SG_ 696 KAE_EDK1TrunkBtnPressSt "EDK Trunk Button Status";
CM_ SG_ 696 KAE_EDK1PanicBtnPressSt "EDK Panic Button Status";
CM_ SG_ 696 KAE_EDK1User_definedBtnPressSt "EDK User_defined Button Status";
CM_ SG_ 696 KAE_EDK2UnlockBtnPressSt "EDK Unlock Button Pressed Status";
CM_ SG_ 696 KAE_EDK2LockBtnPressSt "EDK Lock Button Pressed Status";
CM_ SG_ 696 KAE_EDK2RESBtnPressSt "EDK RES Button Status";
CM_ SG_ 696 KAE_EDK2PSD_LBtnPressSt "EDK PSD_L Button Status";
CM_ SG_ 696 KAE_EDK2PSD_RBtnPressSt "EDK PSD_R Button Status";
CM_ SG_ 696 KAE_EDK2TrunkBtnPressSt "EDK Trunk Button Status";
CM_ SG_ 696 KAE_EDK2PanicBtnPressSt "EDK Panic Button Status";
CM_ SG_ 696 KAE_EDK2User_definedBtnPressSt "EDK User_defined Button Status";
CM_ SG_ 696 KAE_EDK3UnlockBtnPressSt "EDK Unlock Button Pressed Status";
CM_ SG_ 696 KAE_EDK3LockBtnPressSt "EDK Lock Button Pressed Status";
CM_ SG_ 696 KAE_EDK3RESBtnPressSt "EDK RES Button Status";
CM_ SG_ 696 KAE_EDK3PSD_LBtnPressSt "EDK PSD_L Button Status";
CM_ SG_ 696 KAE_EDK3PSD_RBtnPressSt "EDK PSD_R Button Status";
CM_ SG_ 696 KAE_EDK3TrunkBtnPressSt "EDK Trunk Button Status";
CM_ SG_ 696 KAE_EDK3PanicBtnPressSt "EDK Panic Button Status";
CM_ SG_ 696 KAE_EDK3User_definedBtnPressSt "EDK User_defined Button Status";
CM_ SG_ 696 KAE_RPADirectionSel "RPA Direction Selection";
CM_ SG_ 696 KAE_RPAmode "SBM RPA mode";
CM_ SG_ 696 KAE_RPADeviceSt "RPA Device Status";
CM_ SG_ 696 KAE_PhoneBatt "SBM Phone batt";
CM_ SG_ 696 KAE_RPACheckReq "SBM RPA Checking Req";
CM_ SG_ 696 KAE_RPAKeyPstSt "RPA Key Position Status";
CM_ SG_ 696 KAE_RPADeviceFailReason "RPA Device Failure Reason";
CM_ SG_ 696 KAE_RPABtnSt "RPA Button Status";
CM_ SG_ 696 KAE_ForRPAFailReason "RPA and SBM failure reason";
CM_ SG_ 696 KAE_RPABtnStVD "RPA Button Status valid value";
CM_ SG_ 696 KAE_RPACancelBtnSt "RPA Cancal Button Status";
CM_ SG_ 696 KAE_RPACancelBtnStVD "RPA Button Statusvalid valid value";
CM_ SG_ 696 KAE_ComSDKUBouncesSt "Communication status between SBM and SDK,This signal bounces every time the SDK updates the data";
CM_ SG_ 696 KAE_HAVPCancelParking "HAVP User cancellation SBM";
CM_ SG_ 696 KAE_HAVPDisclaimerAgree "App HAVP Disclaimer confirm";
CM_ SG_ 696 KAE_HAVPPathSelect "HAVP User path selection SBM";
CM_ SG_ 696 KAE_RPAResponse "SBM Response RPA Challenge  Singal";
CM_ SG_ 696 KAE_HAVPUWBZone "SBM UWB HAVP Zone";
CM_ SG_ 696 KAE_HAVPUWBXPosition "SBM UWB HAVP X Position";
CM_ SG_ 696 KAE_HAVPUWBYPosition "SBM UWB HAVP Y Position";
CM_ SG_ 696 KAE_UnlockDoorReq "Virtual Key APP Unlock door request";
CM_ SG_ 696 KAE_UnlockDoorReqVD "KAE_UnlockDoorReq valid value";
CM_ SG_ 696 KAE_LockDoorReq "Virtual Key APP Lock door request";
CM_ SG_ 696 KAE_LockDoorReqVD "KAE_LockDoorReq valid value";
CM_ SG_ 696 KAE_WindowsCloseReq "Virtual Key APP close the windows request";
CM_ SG_ 696 KAE_WindowsCloseReqVD "KAE_WindowsCloseReq valid value";
CM_ SG_ 696 KAE_WindowsOpenReq "Virtual Key APP open the windows request";
CM_ SG_ 696 KAE_WindowsOpenReqVD "KAE_WindowsOpenReq valid value";
CM_ SG_ 696 KAE_TrunkUnlockReq "Virtual Key APP request unlock the trunck";
CM_ SG_ 696 KAE_TrunkUnlockReqVD "KAE_TrunkUnlockReq valid value";
CM_ SG_ 696 KAE_HoodUnlockReq "Virtual Key APP request unlock the hood";
CM_ SG_ 696 KAE_HoodUnlockReqVD "KAE_HoodeUnlockReq valid value";
CM_ SG_ 696 KAE_PLGMOpenReq "Virtual Key APP PLGM(Power Liftgate Module) open request";
CM_ SG_ 696 KAE_PLGMOpenReqVD "KAE_PLGMOpenReq valid value";
CM_ SG_ 696 KAE_PLGMCloseReq "Virtual Key APP PLGM(Power Liftgate Module) close request";
CM_ SG_ 696 KAE_PLGMCloseReqVD "KAE_PLGMCloseReq valid value";
CM_ SG_ 696 KAE_SunRoofOpenReq "Virtual Key APP sun roof open request";
CM_ SG_ 696 KAE_SunRoofOpenReqVD "KAE_SunRoofOpenReq valid value";
CM_ SG_ 696 KAE_SunRoofCloseReq "Virtual Key APP sun roof close request";
CM_ SG_ 696 KAE_SunRoofCloseReqVD "KAE_SunRoofCloseReq valid value";
CM_ SG_ 696 KAE_AllCloseReq "App all close  request";
CM_ SG_ 696 KAE_AllCloseReqVd "App all close  request valid value";
CM_ SG_ 696 KAE_PAAReq "KAE PAA request";
CM_ SG_ 696 KAE_PAAReqVd "KAE_PAA Req valid value";
CM_ SG_ 696 KAE_EDK1UnlockBtnSt "EDK1 Unlock Button current Status";
CM_ SG_ 696 KAE_EDK1LockBtnSt "EDK1 Lock Button current Status";
CM_ SG_ 696 KAE_EDK1RESBtnSt "EDK1 RES Button  current Status";
CM_ SG_ 696 KAE_EDK1PSD_LBtnSt "EDK1 PSD_L Button current Status";
CM_ SG_ 696 KAE_EDK1PSD_RBtnSt "EDK1 PSD_R Button current Status";
CM_ SG_ 696 KAE_EDK1TrunkBtnSt "EDK1 Trunk Button current Status";
CM_ SG_ 696 KAE_EDK1PanicBtnSt "EDK1 Panic Button current Status";
CM_ SG_ 696 KAE_EDK1User_definedBtnSt "EDK1 User_defined Button current Status";
CM_ SG_ 696 KAE_EDK2UnlockBtnSt "EDK2 Unlock Button current Status";
CM_ SG_ 696 KAE_EDK2LockBtnSt "EDK2 Lock Button current Status";
CM_ SG_ 696 KAE_EDK2RESBtnSt "EDK2 RES Button  current Status";
CM_ SG_ 696 KAE_EDK2PSD_LBtnSt "EDK2 PSD_L Button current Status";
CM_ SG_ 696 KAE_EDK2PSD_RBtnSt "EDK2 PSD_R Button current Status";
CM_ SG_ 696 KAE_EDK2TrunkBtnSt "EDK2 Trunk Button current Status";
CM_ SG_ 696 KAE_EDK2PanicBtnSt "EDK2 Panic Button current Status";
CM_ SG_ 696 KAE_EDK2User_definedBtnSt "EDK2 User_defined Button current Status";
CM_ SG_ 696 KAE_EDK3UnlockBtnSt "EDK3 Unlock Button current Status";
CM_ SG_ 696 KAE_EDK3LockBtnSt "EDK3 Lock Button current Status";
CM_ SG_ 696 KAE_EDK3RESBtnSt "EDK3 RES Button  current Status";
CM_ SG_ 696 KAE_EDK3PSD_LBtnSt "EDK3 PSD_L Button current Status";
CM_ SG_ 696 KAE_EDK3PSD_RBtnSt "EDK3 PSD_R Button current Status";
CM_ SG_ 696 KAE_EDK3TrunkBtnSt "EDK3 Trunk Button current Status";
CM_ SG_ 696 KAE_EDK3PanicBtnSt "EDK3 Panic Button current Status";
CM_ SG_ 696 KAE_EDK3User_definedBtnSt "EDK3 User_defined Button current Status";
CM_ SG_ 403 ADC_1_CRC "E2E Profile 5 CRC";
CM_ SG_ 403 ADC_1_Counter "E2E Profile 5 Counter";
CM_ SG_ 403 NDA_Type "NDA Type";
CM_ SG_ 403 ADC_ACCMode "This signal indicates ACC(Adaptive cruise control)status";
CM_ SG_ 403 ADAS_Related_System_Failure_St "ADAS Related system Failure State";
CM_ SG_ 403 ADC_ISLC_ConfirmSt "ISLC Style confirm Style";
CM_ SG_ 403 ADAS_System_Failure_St "ADAS System Failure State";
CM_ SG_ 403 ADC_ACCFailureReason " ACC failure reason";
CM_ SG_ 403 ADC_ACCPassiveReason " ACC Passive reason";
CM_ SG_ 403 ADC_ACC_SpeedLimitType "ACC Speed limit type";
CM_ SG_ 403 ADC_TJP_St "TJP/HWP state information";
CM_ SG_ 403 ADC_TJPIconColor "TJP Icon Color";
CM_ SG_ 403 ADC_TimeGapSet "The set timeGap from driver, should be displayed to driver and if the set value changes";
CM_ SG_ 403 ADC_ICA_St "ICA state information";
CM_ SG_ 403 ADC_CruiseLatCtrlType "cruise  Lateral control type";
CM_ SG_ 403 ADC_Cruise_SpeedLimitType "Cruise Speed Limit Type";
CM_ SG_ 403 ADC_ILC_EnableSt "ILC Enable State";
CM_ SG_ 403 ADC_ILOA_EnableSt "ILOA enable status";
CM_ SG_ 403 ADC_ICA_TORReason "ICA TOR reason";
CM_ SG_ 403 ADC_CruiseLat_TORWarn "Cruise lateral   TOR warn level";
CM_ SG_ 403 ADC_ILOASt "ILOA state";
CM_ SG_ 403 ADC_ILOAType "ILOA Type";
CM_ SG_ 403 ADC_ILOA_Actdirection "ILOA active direction";
CM_ SG_ 403 ADC_LaneChangeSt "Lane Change state";
CM_ SG_ 403 ADC_LaneChange_RetreatReason "Lane Change Retreat Reason";
CM_ SG_ 403 ADC_LaneChange_WaitReason "Lane Change Wait Reason";
CM_ SG_ 403 ADC_LaneChange_AbortReason "Lane Changeabort Reason";
CM_ SG_ 403 ADC_LaneChange_Actdirection "Lane change active direction";
CM_ SG_ 403 ADC_ICA_MRMReason "ICA MRM reason";
CM_ SG_ 403 ADC_ICA_Mileage "Number of times ICA is activated in the current ignition cycle";
CM_ SG_ 403 ADC_ICAMRMWarningLevel "ICA Minimum Risk Manuvel Warning Level";
CM_ SG_ 403 ADC_ICA_PassiveReason "ADAS passive reason,not only ICA";
CM_ SG_ 403 ADC_ICA_faultReason "ICA function fault reason";
CM_ SG_ 403 ADC_HFIconColor "HandFree Icon Color";
CM_ SG_ 403 ADC_AdsFucntionNotActive "ADS Function cannot Active Icon";
CM_ SG_ 403 ADC_MRMNumber "Number of times MRM is activated in the current ignition cycle";
CM_ SG_ 403 ADC_MRCNumber "Number of times MRC is activated in the current ignition cycle";
CM_ SG_ 403 ADC_HandsOnSt "ADAS Hands On state";
CM_ SG_ 403 ADC_HandsOn_Warning "ADAS Hands On Warning";
CM_ SG_ 403 ADC_ICMADASFailureText "ADAS Failure Text";
CM_ SG_ 403 ADC_ICMADASWarnText "ADAS Warn Text";
CM_ SG_ 403 ADC_SpeedLimitIconSt "Speed Limit Icon State";
CM_ SG_ 403 ADC_ICMWarnCardSt "Warn Card State";
CM_ SG_ 403 ADC_ICAIconColor "ICA Icon Color";
CM_ SG_ 403 ADC_ICMPromptWarn "Prompt Warn";
CM_ SG_ 403 ADC_NDAIconColor "NDA Icon Color";
CM_ SG_ 403 ADC_ACUVoiceWarn "Voice Warn";
CM_ SG_ 403 ADC_NDAStateIcon "NDA State Icon";
CM_ SG_ 403 ADC_SpeedLimitIcon "Speed Limit Icon";
CM_ SG_ 403 ADC_ICANDAIconAngle "ICA NDA Icon Angle";
CM_ SG_ 403 ADC_ACCTargetSpeedCard "ACC Target Speed Card";
CM_ SG_ 403 ADC_ACCIconColor "ACC Icon Color";
CM_ SG_ 403 ADC_ICMADASFailureLamp "ADAS Failure Indicator light, it turns on when more than two ADAS-systems fail";
CM_ SG_ 403 ADC_Pilot_VoiceWarn "Pilot Voice Warn";
CM_ SG_ 403 ADC_Pilot_PromptWarn "Pilot Prompt Warn";
CM_ SG_ 403 ADC_Pilot_WarnText "Pilot Warn Text";
CM_ SG_ 403 ADC_Pilot_WarnCardSt "Pilot Warn Card State";
CM_ SG_ 403 ADC_AdsFault "ADS System Failure Icon";
CM_ SG_ 403 ADC_NicaReminderLEDVisual "ADS TOR Warning Icon";
CM_ SG_ 403 ADC_NicaReminderAcoustic "ADS Warning Acoustic";
CM_ SG_ 403 ADC_AdsTakeoverID "ADS TOR Scenes Description Text";
CM_ SG_ 403 ADC_AdsTakeoverLevel "TORLevel, indicates the Warning Ways";
CM_ SG_ 403 ADC_TORIDCorrespErrorID "TOR error code ID (Reasons relate to TakeoverID)";
CM_ SG_ 403 ADC_TakeoverExtended16bit "TOR Extended Information (Value in Message)";
CM_ SG_ 403 ADC_TakeoverExtended8bit "TOR Extended Information (Text combined with Value)";
CM_ SG_ 403 ADC_AvpFunctionStatus "AVP Icon related to Function State";
CM_ SG_ 403 ADC_CalibState "ADC Calibration State Icon";
CM_ SG_ 403 ADC_AccFunctionStatus "ACC Function State Icon";
CM_ SG_ 403 ADC_NicaFunctionStatus "ICA/NCA Function State Icon";
CM_ SG_ 403 ADC_AEBWaning "AEB Warning State Effects";
CM_ SG_ 403 ADC_LKAWarning "LKA Warning State Effects";
CM_ SG_ 403 ADC_LCCStateIcon "LCC State Icon";
CM_ SG_ 403 ADC_1_FreshnessValue "Freshness value in SecOC security message";
CM_ SG_ 403 ADC_1_MAC_Check "MAC value in SecOC security message";

BA_DEF_ BO_  "GenMsgCycleTime" INT 0 0;
BA_DEF_ BO_  "GenMsgCycleTimeFast" INT 0 0;
BA_DEF_ BO_  "GenMsgSendType" ENUM  "Periodic","Event","IfActive","POE","PA","FixedPeriodic","Event","EnabledPeriodic","NotUsed","NotUsed","EventPeriodic","NotUsed","NotUsed","NoMsgSendType";
BA_DEF_ BO_  "VFrameFormat" ENUM  "StandardCAN","ExtendedCAN","reserved","reserved","reserved","reserved","reserved","reserved","reserved","reserved","reserved","reserved","reserved","reserved","StandardCAN_FD","ExtendedCAN_FD";
BA_DEF_ BO_  "CANFD_BRS" ENUM  "0","1";
BA_DEF_ SG_  "EventCommandSignal" ENUM  "No","Yes";
BA_DEF_ SG_  "GatewayedSignals" ENUM  "No","Yes";
BA_DEF_ SG_  "GenSigInactiveValue" HEX 0 0;
BA_DEF_ SG_  "GenSigInvalidValue" HEX 0 0;
BA_DEF_ SG_  "GenSigSendType" ENUM  "Trigger","Passive","Cyclic","OnWrite","OnWriteWithRepetition","OnChange","OnChangeWithRepetition","IfActive","IfActiveWithRepetition","NoSigSendType";
BA_DEF_ SG_  "GenSigStartValue" HEX 0 0;
BA_DEF_ SG_  "GenSigTimeoutValue" HEX 0 0;
BA_DEF_ SG_  "Remark" STRING ;
BA_ "GenMsgCycleTime" BO_ 696 40;
BA_ "GenMsgCycleTimeFast" BO_ 696 0;
BA_ "GenMsgSendType" BO_ 696 0;
BA_ "VFrameFormat" BO_ 696 14;
BA_ "CANFD_BRS" BO_ 696 1;
BA_ "GenMsgCycleTime" BO_ 696 40;
BA_ "GenMsgCycleTimeFast" BO_ 696 0;
BA_ "GenMsgSendType" BO_ 696 0;
BA_ "VFrameFormat" BO_ 696 14;
BA_ "CANFD_BRS" BO_ 696 1;
BA_ "GenMsgCycleTime" BO_ 696 40;
BA_ "GenMsgCycleTimeFast" BO_ 696 0;
BA_ "GenMsgSendType" BO_ 696 0;
BA_ "VFrameFormat" BO_ 696 14;
BA_ "CANFD_BRS" BO_ 696 1;
BA_ "GenMsgCycleTime" BO_ 696 40;
BA_ "GenMsgCycleTimeFast" BO_ 696 0;
BA_ "GenMsgSendType" BO_ 696 0;
BA_ "VFrameFormat" BO_ 696 14;
BA_ "CANFD_BRS" BO_ 696 1;
BA_ "GenMsgCycleTime" BO_ 696 40;
BA_ "GenMsgCycleTimeFast" BO_ 696 0;
BA_ "GenMsgSendType" BO_ 696 0;
BA_ "VFrameFormat" BO_ 696 14;
BA_ "CANFD_BRS" BO_ 696 1;
BA_ "GenMsgCycleTime" BO_ 696 40;
BA_ "GenMsgCycleTimeFast" BO_ 696 0;
BA_ "GenMsgSendType" BO_ 696 0;
BA_ "VFrameFormat" BO_ 696 14;
BA_ "CANFD_BRS" BO_ 696 1;
BA_ "GenMsgCycleTime" BO_ 696 40;
BA_ "GenMsgCycleTimeFast" BO_ 696 0;
BA_ "GenMsgSendType" BO_ 696 0;
BA_ "VFrameFormat" BO_ 696 14;
BA_ "CANFD_BRS" BO_ 696 1;
BA_ "GenMsgCycleTime" BO_ 696 40;
BA_ "GenMsgCycleTimeFast" BO_ 696 0;
BA_ "GenMsgSendType" BO_ 696 0;
BA_ "VFrameFormat" BO_ 696 14;
BA_ "CANFD_BRS" BO_ 696 1;
BA_ "GenMsgCycleTime" BO_ 696 40;
BA_ "GenMsgCycleTimeFast" BO_ 696 0;
BA_ "GenMsgSendType" BO_ 696 0;
BA_ "VFrameFormat" BO_ 696 14;
BA_ "CANFD_BRS" BO_ 696 1;
BA_ "GenMsgCycleTime" BO_ 696 40;
BA_ "GenMsgCycleTimeFast" BO_ 696 0;
BA_ "GenMsgSendType" BO_ 696 0;
BA_ "VFrameFormat" BO_ 696 14;
BA_ "CANFD_BRS" BO_ 696 1;
BA_ "GenMsgCycleTime" BO_ 696 40;
BA_ "GenMsgCycleTimeFast" BO_ 696 0;
BA_ "GenMsgSendType" BO_ 696 0;
BA_ "VFrameFormat" BO_ 696 14;
BA_ "CANFD_BRS" BO_ 696 1;
BA_ "GenMsgCycleTime" BO_ 696 40;
BA_ "GenMsgCycleTimeFast" BO_ 696 0;
BA_ "GenMsgSendType" BO_ 696 0;
BA_ "VFrameFormat" BO_ 696 14;
BA_ "CANFD_BRS" BO_ 696 1;
BA_ "GenMsgCycleTime" BO_ 696 40;
BA_ "GenMsgCycleTimeFast" BO_ 696 0;
BA_ "GenMsgSendType" BO_ 696 0;
BA_ "VFrameFormat" BO_ 696 14;
BA_ "CANFD_BRS" BO_ 696 1;
BA_ "GenMsgCycleTime" BO_ 696 40;
BA_ "GenMsgCycleTimeFast" BO_ 696 0;
BA_ "GenMsgSendType" BO_ 696 0;
BA_ "VFrameFormat" BO_ 696 14;
BA_ "CANFD_BRS" BO_ 696 1;
BA_ "GenMsgCycleTime" BO_ 696 40;
BA_ "GenMsgCycleTimeFast" BO_ 696 0;
BA_ "GenMsgSendType" BO_ 696 0;
BA_ "VFrameFormat" BO_ 696 14;
BA_ "CANFD_BRS" BO_ 696 1;
BA_ "GenMsgCycleTime" BO_ 696 40;
BA_ "GenMsgCycleTimeFast" BO_ 696 0;
BA_ "GenMsgSendType" BO_ 696 0;
BA_ "VFrameFormat" BO_ 696 14;
BA_ "CANFD_BRS" BO_ 696 1;
BA_ "GenMsgCycleTime" BO_ 696 40;
BA_ "GenMsgCycleTimeFast" BO_ 696 0;
BA_ "GenMsgSendType" BO_ 696 0;
BA_ "VFrameFormat" BO_ 696 14;
BA_ "CANFD_BRS" BO_ 696 1;
BA_ "GenMsgCycleTime" BO_ 696 40;
BA_ "GenMsgCycleTimeFast" BO_ 696 0;
BA_ "GenMsgSendType" BO_ 696 0;
BA_ "VFrameFormat" BO_ 696 14;
BA_ "CANFD_BRS" BO_ 696 1;
BA_ "GenMsgCycleTime" BO_ 696 40;
BA_ "GenMsgCycleTimeFast" BO_ 696 0;
BA_ "GenMsgSendType" BO_ 696 0;
BA_ "VFrameFormat" BO_ 696 14;
BA_ "CANFD_BRS" BO_ 696 1;
BA_ "GenMsgCycleTime" BO_ 696 40;
BA_ "GenMsgCycleTimeFast" BO_ 696 0;
BA_ "GenMsgSendType" BO_ 696 0;
BA_ "VFrameFormat" BO_ 696 14;
BA_ "CANFD_BRS" BO_ 696 1;
BA_ "GenMsgCycleTime" BO_ 696 40;
BA_ "GenMsgCycleTimeFast" BO_ 696 0;
BA_ "GenMsgSendType" BO_ 696 0;
BA_ "VFrameFormat" BO_ 696 14;
BA_ "CANFD_BRS" BO_ 696 1;
BA_ "GenMsgCycleTime" BO_ 696 40;
BA_ "GenMsgCycleTimeFast" BO_ 696 0;
BA_ "GenMsgSendType" BO_ 696 0;
BA_ "VFrameFormat" BO_ 696 14;
BA_ "CANFD_BRS" BO_ 696 1;
BA_ "GenMsgCycleTime" BO_ 696 40;
BA_ "GenMsgCycleTimeFast" BO_ 696 0;
BA_ "GenMsgSendType" BO_ 696 0;
BA_ "VFrameFormat" BO_ 696 14;
BA_ "CANFD_BRS" BO_ 696 1;
BA_ "GenMsgCycleTime" BO_ 696 40;
BA_ "GenMsgCycleTimeFast" BO_ 696 0;
BA_ "GenMsgSendType" BO_ 696 0;
BA_ "VFrameFormat" BO_ 696 14;
BA_ "CANFD_BRS" BO_ 696 1;
BA_ "GenMsgCycleTime" BO_ 696 40;
BA_ "GenMsgCycleTimeFast" BO_ 696 0;
BA_ "GenMsgSendType" BO_ 696 0;
BA_ "VFrameFormat" BO_ 696 14;
BA_ "CANFD_BRS" BO_ 696 1;
BA_ "GenMsgCycleTime" BO_ 696 40;
BA_ "GenMsgCycleTimeFast" BO_ 696 0;
BA_ "GenMsgSendType" BO_ 696 0;
BA_ "VFrameFormat" BO_ 696 14;
BA_ "CANFD_BRS" BO_ 696 1;
BA_ "GenMsgCycleTime" BO_ 696 40;
BA_ "GenMsgCycleTimeFast" BO_ 696 0;
BA_ "GenMsgSendType" BO_ 696 0;
BA_ "VFrameFormat" BO_ 696 14;
BA_ "CANFD_BRS" BO_ 696 1;
BA_ "GenMsgCycleTime" BO_ 696 40;
BA_ "GenMsgCycleTimeFast" BO_ 696 0;
BA_ "GenMsgSendType" BO_ 696 0;
BA_ "VFrameFormat" BO_ 696 14;
BA_ "CANFD_BRS" BO_ 696 1;
BA_ "GenMsgCycleTime" BO_ 696 40;
BA_ "GenMsgCycleTimeFast" BO_ 696 0;
BA_ "GenMsgSendType" BO_ 696 0;
BA_ "VFrameFormat" BO_ 696 14;
BA_ "CANFD_BRS" BO_ 696 1;
BA_ "GenMsgCycleTime" BO_ 696 40;
BA_ "GenMsgCycleTimeFast" BO_ 696 0;
BA_ "GenMsgSendType" BO_ 696 0;
BA_ "VFrameFormat" BO_ 696 14;
BA_ "CANFD_BRS" BO_ 696 1;
BA_ "GenMsgCycleTime" BO_ 696 40;
BA_ "GenMsgCycleTimeFast" BO_ 696 0;
BA_ "GenMsgSendType" BO_ 696 0;
BA_ "VFrameFormat" BO_ 696 14;
BA_ "CANFD_BRS" BO_ 696 1;
BA_ "GenMsgCycleTime" BO_ 696 40;
BA_ "GenMsgCycleTimeFast" BO_ 696 0;
BA_ "GenMsgSendType" BO_ 696 0;
BA_ "VFrameFormat" BO_ 696 14;
BA_ "CANFD_BRS" BO_ 696 1;
BA_ "GenMsgCycleTime" BO_ 696 40;
BA_ "GenMsgCycleTimeFast" BO_ 696 0;
BA_ "GenMsgSendType" BO_ 696 0;
BA_ "VFrameFormat" BO_ 696 14;
BA_ "CANFD_BRS" BO_ 696 1;
BA_ "GenMsgCycleTime" BO_ 696 40;
BA_ "GenMsgCycleTimeFast" BO_ 696 0;
BA_ "GenMsgSendType" BO_ 696 0;
BA_ "VFrameFormat" BO_ 696 14;
BA_ "CANFD_BRS" BO_ 696 1;
BA_ "GenMsgCycleTime" BO_ 696 40;
BA_ "GenMsgCycleTimeFast" BO_ 696 0;
BA_ "GenMsgSendType" BO_ 696 0;
BA_ "VFrameFormat" BO_ 696 14;
BA_ "CANFD_BRS" BO_ 696 1;
BA_ "GenMsgCycleTime" BO_ 696 40;
BA_ "GenMsgCycleTimeFast" BO_ 696 0;
BA_ "GenMsgSendType" BO_ 696 0;
BA_ "VFrameFormat" BO_ 696 14;
BA_ "CANFD_BRS" BO_ 696 1;
BA_ "GenMsgCycleTime" BO_ 696 40;
BA_ "GenMsgCycleTimeFast" BO_ 696 0;
BA_ "GenMsgSendType" BO_ 696 0;
BA_ "VFrameFormat" BO_ 696 14;
BA_ "CANFD_BRS" BO_ 696 1;
BA_ "GenMsgCycleTime" BO_ 696 40;
BA_ "GenMsgCycleTimeFast" BO_ 696 0;
BA_ "GenMsgSendType" BO_ 696 0;
BA_ "VFrameFormat" BO_ 696 14;
BA_ "CANFD_BRS" BO_ 696 1;
BA_ "GenMsgCycleTime" BO_ 696 40;
BA_ "GenMsgCycleTimeFast" BO_ 696 0;
BA_ "GenMsgSendType" BO_ 696 0;
BA_ "VFrameFormat" BO_ 696 14;
BA_ "CANFD_BRS" BO_ 696 1;
BA_ "GenMsgCycleTime" BO_ 696 40;
BA_ "GenMsgCycleTimeFast" BO_ 696 0;
BA_ "GenMsgSendType" BO_ 696 0;
BA_ "VFrameFormat" BO_ 696 14;
BA_ "CANFD_BRS" BO_ 696 1;
BA_ "GenMsgCycleTime" BO_ 696 40;
BA_ "GenMsgCycleTimeFast" BO_ 696 0;
BA_ "GenMsgSendType" BO_ 696 0;
BA_ "VFrameFormat" BO_ 696 14;
BA_ "CANFD_BRS" BO_ 696 1;
BA_ "GenMsgCycleTime" BO_ 696 40;
BA_ "GenMsgCycleTimeFast" BO_ 696 0;
BA_ "GenMsgSendType" BO_ 696 0;
BA_ "VFrameFormat" BO_ 696 14;
BA_ "CANFD_BRS" BO_ 696 1;
BA_ "GenMsgCycleTime" BO_ 696 40;
BA_ "GenMsgCycleTimeFast" BO_ 696 0;
BA_ "GenMsgSendType" BO_ 696 0;
BA_ "VFrameFormat" BO_ 696 14;
BA_ "CANFD_BRS" BO_ 696 1;
BA_ "GenMsgCycleTime" BO_ 696 40;
BA_ "GenMsgCycleTimeFast" BO_ 696 0;
BA_ "GenMsgSendType" BO_ 696 0;
BA_ "VFrameFormat" BO_ 696 14;
BA_ "CANFD_BRS" BO_ 696 1;
BA_ "GenMsgCycleTime" BO_ 696 40;
BA_ "GenMsgCycleTimeFast" BO_ 696 0;
BA_ "GenMsgSendType" BO_ 696 0;
BA_ "VFrameFormat" BO_ 696 14;
BA_ "CANFD_BRS" BO_ 696 1;
BA_ "GenMsgCycleTime" BO_ 696 40;
BA_ "GenMsgCycleTimeFast" BO_ 696 0;
BA_ "GenMsgSendType" BO_ 696 0;
BA_ "VFrameFormat" BO_ 696 14;
BA_ "CANFD_BRS" BO_ 696 1;
BA_ "GenMsgCycleTime" BO_ 696 40;
BA_ "GenMsgCycleTimeFast" BO_ 696 0;
BA_ "GenMsgSendType" BO_ 696 0;
BA_ "VFrameFormat" BO_ 696 14;
BA_ "CANFD_BRS" BO_ 696 1;
BA_ "GenMsgCycleTime" BO_ 696 40;
BA_ "GenMsgCycleTimeFast" BO_ 696 0;
BA_ "GenMsgSendType" BO_ 696 0;
BA_ "VFrameFormat" BO_ 696 14;
BA_ "CANFD_BRS" BO_ 696 1;
BA_ "GenMsgCycleTime" BO_ 696 40;
BA_ "GenMsgCycleTimeFast" BO_ 696 0;
BA_ "GenMsgSendType" BO_ 696 0;
BA_ "VFrameFormat" BO_ 696 14;
BA_ "CANFD_BRS" BO_ 696 1;
BA_ "GenMsgCycleTime" BO_ 696 40;
BA_ "GenMsgCycleTimeFast" BO_ 696 0;
BA_ "GenMsgSendType" BO_ 696 0;
BA_ "VFrameFormat" BO_ 696 14;
BA_ "CANFD_BRS" BO_ 696 1;
BA_ "GenMsgCycleTime" BO_ 696 40;
BA_ "GenMsgCycleTimeFast" BO_ 696 0;
BA_ "GenMsgSendType" BO_ 696 0;
BA_ "VFrameFormat" BO_ 696 14;
BA_ "CANFD_BRS" BO_ 696 1;
BA_ "GenMsgCycleTime" BO_ 696 40;
BA_ "GenMsgCycleTimeFast" BO_ 696 0;
BA_ "GenMsgSendType" BO_ 696 0;
BA_ "VFrameFormat" BO_ 696 14;
BA_ "CANFD_BRS" BO_ 696 1;
BA_ "GenMsgCycleTime" BO_ 696 40;
BA_ "GenMsgCycleTimeFast" BO_ 696 0;
BA_ "GenMsgSendType" BO_ 696 0;
BA_ "VFrameFormat" BO_ 696 14;
BA_ "CANFD_BRS" BO_ 696 1;
BA_ "GenMsgCycleTime" BO_ 696 40;
BA_ "GenMsgCycleTimeFast" BO_ 696 0;
BA_ "GenMsgSendType" BO_ 696 0;
BA_ "VFrameFormat" BO_ 696 14;
BA_ "CANFD_BRS" BO_ 696 1;
BA_ "GenMsgCycleTime" BO_ 696 40;
BA_ "GenMsgCycleTimeFast" BO_ 696 0;
BA_ "GenMsgSendType" BO_ 696 0;
BA_ "VFrameFormat" BO_ 696 14;
BA_ "CANFD_BRS" BO_ 696 1;
BA_ "GenMsgCycleTime" BO_ 696 40;
BA_ "GenMsgCycleTimeFast" BO_ 696 0;
BA_ "GenMsgSendType" BO_ 696 0;
BA_ "VFrameFormat" BO_ 696 14;
BA_ "CANFD_BRS" BO_ 696 1;
BA_ "GenMsgCycleTime" BO_ 696 40;
BA_ "GenMsgCycleTimeFast" BO_ 696 0;
BA_ "GenMsgSendType" BO_ 696 0;
BA_ "VFrameFormat" BO_ 696 14;
BA_ "CANFD_BRS" BO_ 696 1;
BA_ "GenMsgCycleTime" BO_ 696 40;
BA_ "GenMsgCycleTimeFast" BO_ 696 0;
BA_ "GenMsgSendType" BO_ 696 0;
BA_ "VFrameFormat" BO_ 696 14;
BA_ "CANFD_BRS" BO_ 696 1;
BA_ "GenMsgCycleTime" BO_ 696 40;
BA_ "GenMsgCycleTimeFast" BO_ 696 0;
BA_ "GenMsgSendType" BO_ 696 0;
BA_ "VFrameFormat" BO_ 696 14;
BA_ "CANFD_BRS" BO_ 696 1;
BA_ "GenMsgCycleTime" BO_ 696 40;
BA_ "GenMsgCycleTimeFast" BO_ 696 0;
BA_ "GenMsgSendType" BO_ 696 0;
BA_ "VFrameFormat" BO_ 696 14;
BA_ "CANFD_BRS" BO_ 696 1;
BA_ "GenMsgCycleTime" BO_ 696 40;
BA_ "GenMsgCycleTimeFast" BO_ 696 0;
BA_ "GenMsgSendType" BO_ 696 0;
BA_ "VFrameFormat" BO_ 696 14;
BA_ "CANFD_BRS" BO_ 696 1;
BA_ "GenMsgCycleTime" BO_ 696 40;
BA_ "GenMsgCycleTimeFast" BO_ 696 0;
BA_ "GenMsgSendType" BO_ 696 0;
BA_ "VFrameFormat" BO_ 696 14;
BA_ "CANFD_BRS" BO_ 696 1;
BA_ "GenMsgCycleTime" BO_ 696 40;
BA_ "GenMsgCycleTimeFast" BO_ 696 0;
BA_ "GenMsgSendType" BO_ 696 0;
BA_ "VFrameFormat" BO_ 696 14;
BA_ "CANFD_BRS" BO_ 696 1;
BA_ "GenMsgCycleTime" BO_ 696 40;
BA_ "GenMsgCycleTimeFast" BO_ 696 0;
BA_ "GenMsgSendType" BO_ 696 0;
BA_ "VFrameFormat" BO_ 696 14;
BA_ "CANFD_BRS" BO_ 696 1;
BA_ "GenMsgCycleTime" BO_ 696 40;
BA_ "GenMsgCycleTimeFast" BO_ 696 0;
BA_ "GenMsgSendType" BO_ 696 0;
BA_ "VFrameFormat" BO_ 696 14;
BA_ "CANFD_BRS" BO_ 696 1;
BA_ "GenMsgCycleTime" BO_ 696 40;
BA_ "GenMsgCycleTimeFast" BO_ 696 0;
BA_ "GenMsgSendType" BO_ 696 0;
BA_ "VFrameFormat" BO_ 696 14;
BA_ "CANFD_BRS" BO_ 696 1;
BA_ "GenMsgCycleTime" BO_ 696 40;
BA_ "GenMsgCycleTimeFast" BO_ 696 0;
BA_ "GenMsgSendType" BO_ 696 0;
BA_ "VFrameFormat" BO_ 696 14;
BA_ "CANFD_BRS" BO_ 696 1;
BA_ "GenMsgCycleTime" BO_ 696 40;
BA_ "GenMsgCycleTimeFast" BO_ 696 0;
BA_ "GenMsgSendType" BO_ 696 0;
BA_ "VFrameFormat" BO_ 696 14;
BA_ "CANFD_BRS" BO_ 696 1;
BA_ "GenMsgCycleTime" BO_ 696 40;
BA_ "GenMsgCycleTimeFast" BO_ 696 0;
BA_ "GenMsgSendType" BO_ 696 0;
BA_ "VFrameFormat" BO_ 696 14;
BA_ "CANFD_BRS" BO_ 696 1;
BA_ "GenMsgCycleTime" BO_ 696 40;
BA_ "GenMsgCycleTimeFast" BO_ 696 0;
BA_ "GenMsgSendType" BO_ 696 0;
BA_ "VFrameFormat" BO_ 696 14;
BA_ "CANFD_BRS" BO_ 696 1;
BA_ "GenMsgCycleTime" BO_ 696 40;
BA_ "GenMsgCycleTimeFast" BO_ 696 0;
BA_ "GenMsgSendType" BO_ 696 0;
BA_ "VFrameFormat" BO_ 696 14;
BA_ "CANFD_BRS" BO_ 696 1;
BA_ "GenMsgCycleTime" BO_ 696 40;
BA_ "GenMsgCycleTimeFast" BO_ 696 0;
BA_ "GenMsgSendType" BO_ 696 0;
BA_ "VFrameFormat" BO_ 696 14;
BA_ "CANFD_BRS" BO_ 696 1;
BA_ "GenMsgCycleTime" BO_ 696 40;
BA_ "GenMsgCycleTimeFast" BO_ 696 0;
BA_ "GenMsgSendType" BO_ 696 0;
BA_ "VFrameFormat" BO_ 696 14;
BA_ "CANFD_BRS" BO_ 696 1;
BA_ "GenMsgCycleTime" BO_ 696 40;
BA_ "GenMsgCycleTimeFast" BO_ 696 0;
BA_ "GenMsgSendType" BO_ 696 0;
BA_ "VFrameFormat" BO_ 696 14;
BA_ "CANFD_BRS" BO_ 696 1;
BA_ "GenMsgCycleTime" BO_ 696 40;
BA_ "GenMsgCycleTimeFast" BO_ 696 0;
BA_ "GenMsgSendType" BO_ 696 0;
BA_ "VFrameFormat" BO_ 696 14;
BA_ "CANFD_BRS" BO_ 696 1;
BA_ "GenMsgCycleTime" BO_ 696 40;
BA_ "GenMsgCycleTimeFast" BO_ 696 0;
BA_ "GenMsgSendType" BO_ 696 0;
BA_ "VFrameFormat" BO_ 696 14;
BA_ "CANFD_BRS" BO_ 696 1;
BA_ "GenMsgCycleTime" BO_ 696 40;
BA_ "GenMsgCycleTimeFast" BO_ 696 0;
BA_ "GenMsgSendType" BO_ 696 0;
BA_ "VFrameFormat" BO_ 696 14;
BA_ "CANFD_BRS" BO_ 696 1;
BA_ "GenMsgCycleTime" BO_ 696 40;
BA_ "GenMsgCycleTimeFast" BO_ 696 0;
BA_ "GenMsgSendType" BO_ 696 0;
BA_ "VFrameFormat" BO_ 696 14;
BA_ "CANFD_BRS" BO_ 696 1;
BA_ "GenMsgCycleTime" BO_ 696 40;
BA_ "GenMsgCycleTimeFast" BO_ 696 0;
BA_ "GenMsgSendType" BO_ 696 0;
BA_ "VFrameFormat" BO_ 696 14;
BA_ "CANFD_BRS" BO_ 696 1;
BA_ "GenMsgCycleTime" BO_ 696 40;
BA_ "GenMsgCycleTimeFast" BO_ 696 0;
BA_ "GenMsgSendType" BO_ 696 0;
BA_ "VFrameFormat" BO_ 696 14;
BA_ "CANFD_BRS" BO_ 696 1;
BA_ "GenMsgCycleTime" BO_ 696 40;
BA_ "GenMsgCycleTimeFast" BO_ 696 0;
BA_ "GenMsgSendType" BO_ 696 0;
BA_ "VFrameFormat" BO_ 696 14;
BA_ "CANFD_BRS" BO_ 696 1;
BA_ "GenMsgCycleTime" BO_ 696 40;
BA_ "GenMsgCycleTimeFast" BO_ 696 0;
BA_ "GenMsgSendType" BO_ 696 0;
BA_ "VFrameFormat" BO_ 696 14;
BA_ "CANFD_BRS" BO_ 696 1;
BA_ "GenMsgCycleTime" BO_ 696 40;
BA_ "GenMsgCycleTimeFast" BO_ 696 0;
BA_ "GenMsgSendType" BO_ 696 0;
BA_ "VFrameFormat" BO_ 696 14;
BA_ "CANFD_BRS" BO_ 696 1;
BA_ "GenMsgCycleTime" BO_ 696 40;
BA_ "GenMsgCycleTimeFast" BO_ 696 0;
BA_ "GenMsgSendType" BO_ 696 0;
BA_ "VFrameFormat" BO_ 696 14;
BA_ "CANFD_BRS" BO_ 696 1;
BA_ "GenMsgCycleTime" BO_ 696 40;
BA_ "GenMsgCycleTimeFast" BO_ 696 0;
BA_ "GenMsgSendType" BO_ 696 0;
BA_ "VFrameFormat" BO_ 696 14;
BA_ "CANFD_BRS" BO_ 696 1;
BA_ "GenMsgCycleTime" BO_ 696 40;
BA_ "GenMsgCycleTimeFast" BO_ 696 0;
BA_ "GenMsgSendType" BO_ 696 0;
BA_ "VFrameFormat" BO_ 696 14;
BA_ "CANFD_BRS" BO_ 696 1;
BA_ "GenMsgCycleTime" BO_ 696 40;
BA_ "GenMsgCycleTimeFast" BO_ 696 0;
BA_ "GenMsgSendType" BO_ 696 0;
BA_ "VFrameFormat" BO_ 696 14;
BA_ "CANFD_BRS" BO_ 696 1;
BA_ "GenMsgCycleTime" BO_ 696 40;
BA_ "GenMsgCycleTimeFast" BO_ 696 0;
BA_ "GenMsgSendType" BO_ 696 0;
BA_ "VFrameFormat" BO_ 696 14;
BA_ "CANFD_BRS" BO_ 696 1;
BA_ "GenMsgCycleTime" BO_ 696 40;
BA_ "GenMsgCycleTimeFast" BO_ 696 0;
BA_ "GenMsgSendType" BO_ 696 0;
BA_ "VFrameFormat" BO_ 696 14;
BA_ "CANFD_BRS" BO_ 696 1;
BA_ "GenMsgCycleTime" BO_ 696 40;
BA_ "GenMsgCycleTimeFast" BO_ 696 0;
BA_ "GenMsgSendType" BO_ 696 0;
BA_ "VFrameFormat" BO_ 696 14;
BA_ "CANFD_BRS" BO_ 696 1;
BA_ "GenMsgCycleTime" BO_ 696 40;
BA_ "GenMsgCycleTimeFast" BO_ 696 0;
BA_ "GenMsgSendType" BO_ 696 0;
BA_ "VFrameFormat" BO_ 696 14;
BA_ "CANFD_BRS" BO_ 696 1;
BA_ "GenMsgCycleTime" BO_ 696 40;
BA_ "GenMsgCycleTimeFast" BO_ 696 0;
BA_ "GenMsgSendType" BO_ 696 0;
BA_ "VFrameFormat" BO_ 696 14;
BA_ "CANFD_BRS" BO_ 696 1;
BA_ "GenMsgCycleTime" BO_ 696 40;
BA_ "GenMsgCycleTimeFast" BO_ 696 0;
BA_ "GenMsgSendType" BO_ 696 0;
BA_ "VFrameFormat" BO_ 696 14;
BA_ "CANFD_BRS" BO_ 696 1;
BA_ "GenMsgCycleTime" BO_ 696 40;
BA_ "GenMsgCycleTimeFast" BO_ 696 0;
BA_ "GenMsgSendType" BO_ 696 0;
BA_ "VFrameFormat" BO_ 696 14;
BA_ "CANFD_BRS" BO_ 696 1;
BA_ "GenMsgCycleTime" BO_ 403 20;
BA_ "GenMsgCycleTimeFast" BO_ 403 0;
BA_ "GenMsgSendType" BO_ 403 0;
BA_ "VFrameFormat" BO_ 403 14;
BA_ "CANFD_BRS" BO_ 403 1;
BA_ "GenMsgCycleTime" BO_ 403 20;
BA_ "GenMsgCycleTimeFast" BO_ 403 0;
BA_ "GenMsgSendType" BO_ 403 0;
BA_ "VFrameFormat" BO_ 403 14;
BA_ "CANFD_BRS" BO_ 403 1;
BA_ "GenMsgCycleTime" BO_ 403 20;
BA_ "GenMsgCycleTimeFast" BO_ 403 0;
BA_ "GenMsgSendType" BO_ 403 0;
BA_ "VFrameFormat" BO_ 403 14;
BA_ "CANFD_BRS" BO_ 403 1;
BA_ "GenMsgCycleTime" BO_ 403 20;
BA_ "GenMsgCycleTimeFast" BO_ 403 0;
BA_ "GenMsgSendType" BO_ 403 0;
BA_ "VFrameFormat" BO_ 403 14;
BA_ "CANFD_BRS" BO_ 403 1;
BA_ "GenMsgCycleTime" BO_ 403 20;
BA_ "GenMsgCycleTimeFast" BO_ 403 0;
BA_ "GenMsgSendType" BO_ 403 0;
BA_ "VFrameFormat" BO_ 403 14;
BA_ "CANFD_BRS" BO_ 403 1;
BA_ "GenMsgCycleTime" BO_ 403 20;
BA_ "GenMsgCycleTimeFast" BO_ 403 0;
BA_ "GenMsgSendType" BO_ 403 0;
BA_ "VFrameFormat" BO_ 403 14;
BA_ "CANFD_BRS" BO_ 403 1;
BA_ "GenMsgCycleTime" BO_ 403 20;
BA_ "GenMsgCycleTimeFast" BO_ 403 0;
BA_ "GenMsgSendType" BO_ 403 0;
BA_ "VFrameFormat" BO_ 403 14;
BA_ "CANFD_BRS" BO_ 403 1;
BA_ "GenMsgCycleTime" BO_ 403 20;
BA_ "GenMsgCycleTimeFast" BO_ 403 0;
BA_ "GenMsgSendType" BO_ 403 0;
BA_ "VFrameFormat" BO_ 403 14;
BA_ "CANFD_BRS" BO_ 403 1;
BA_ "GenMsgCycleTime" BO_ 403 20;
BA_ "GenMsgCycleTimeFast" BO_ 403 0;
BA_ "GenMsgSendType" BO_ 403 0;
BA_ "VFrameFormat" BO_ 403 14;
BA_ "CANFD_BRS" BO_ 403 1;
BA_ "GenMsgCycleTime" BO_ 403 20;
BA_ "GenMsgCycleTimeFast" BO_ 403 0;
BA_ "GenMsgSendType" BO_ 403 0;
BA_ "VFrameFormat" BO_ 403 14;
BA_ "CANFD_BRS" BO_ 403 1;
BA_ "GenMsgCycleTime" BO_ 403 20;
BA_ "GenMsgCycleTimeFast" BO_ 403 0;
BA_ "GenMsgSendType" BO_ 403 0;
BA_ "VFrameFormat" BO_ 403 14;
BA_ "CANFD_BRS" BO_ 403 1;
BA_ "GenMsgCycleTime" BO_ 403 20;
BA_ "GenMsgCycleTimeFast" BO_ 403 0;
BA_ "GenMsgSendType" BO_ 403 0;
BA_ "VFrameFormat" BO_ 403 14;
BA_ "CANFD_BRS" BO_ 403 1;
BA_ "GenMsgCycleTime" BO_ 403 20;
BA_ "GenMsgCycleTimeFast" BO_ 403 0;
BA_ "GenMsgSendType" BO_ 403 0;
BA_ "VFrameFormat" BO_ 403 14;
BA_ "CANFD_BRS" BO_ 403 1;
BA_ "GenMsgCycleTime" BO_ 403 20;
BA_ "GenMsgCycleTimeFast" BO_ 403 0;
BA_ "GenMsgSendType" BO_ 403 0;
BA_ "VFrameFormat" BO_ 403 14;
BA_ "CANFD_BRS" BO_ 403 1;
BA_ "GenMsgCycleTime" BO_ 403 20;
BA_ "GenMsgCycleTimeFast" BO_ 403 0;
BA_ "GenMsgSendType" BO_ 403 0;
BA_ "VFrameFormat" BO_ 403 14;
BA_ "CANFD_BRS" BO_ 403 1;
BA_ "GenMsgCycleTime" BO_ 403 20;
BA_ "GenMsgCycleTimeFast" BO_ 403 0;
BA_ "GenMsgSendType" BO_ 403 0;
BA_ "VFrameFormat" BO_ 403 14;
BA_ "CANFD_BRS" BO_ 403 1;
BA_ "GenMsgCycleTime" BO_ 403 20;
BA_ "GenMsgCycleTimeFast" BO_ 403 0;
BA_ "GenMsgSendType" BO_ 403 0;
BA_ "VFrameFormat" BO_ 403 14;
BA_ "CANFD_BRS" BO_ 403 1;
BA_ "GenMsgCycleTime" BO_ 403 20;
BA_ "GenMsgCycleTimeFast" BO_ 403 0;
BA_ "GenMsgSendType" BO_ 403 0;
BA_ "VFrameFormat" BO_ 403 14;
BA_ "CANFD_BRS" BO_ 403 1;
BA_ "GenMsgCycleTime" BO_ 403 20;
BA_ "GenMsgCycleTimeFast" BO_ 403 0;
BA_ "GenMsgSendType" BO_ 403 0;
BA_ "VFrameFormat" BO_ 403 14;
BA_ "CANFD_BRS" BO_ 403 1;
BA_ "GenMsgCycleTime" BO_ 403 20;
BA_ "GenMsgCycleTimeFast" BO_ 403 0;
BA_ "GenMsgSendType" BO_ 403 0;
BA_ "VFrameFormat" BO_ 403 14;
BA_ "CANFD_BRS" BO_ 403 1;
BA_ "GenMsgCycleTime" BO_ 403 20;
BA_ "GenMsgCycleTimeFast" BO_ 403 0;
BA_ "GenMsgSendType" BO_ 403 0;
BA_ "VFrameFormat" BO_ 403 14;
BA_ "CANFD_BRS" BO_ 403 1;
BA_ "GenMsgCycleTime" BO_ 403 20;
BA_ "GenMsgCycleTimeFast" BO_ 403 0;
BA_ "GenMsgSendType" BO_ 403 0;
BA_ "VFrameFormat" BO_ 403 14;
BA_ "CANFD_BRS" BO_ 403 1;
BA_ "GenMsgCycleTime" BO_ 403 20;
BA_ "GenMsgCycleTimeFast" BO_ 403 0;
BA_ "GenMsgSendType" BO_ 403 0;
BA_ "VFrameFormat" BO_ 403 14;
BA_ "CANFD_BRS" BO_ 403 1;
BA_ "GenMsgCycleTime" BO_ 403 20;
BA_ "GenMsgCycleTimeFast" BO_ 403 0;
BA_ "GenMsgSendType" BO_ 403 0;
BA_ "VFrameFormat" BO_ 403 14;
BA_ "CANFD_BRS" BO_ 403 1;
BA_ "GenMsgCycleTime" BO_ 403 20;
BA_ "GenMsgCycleTimeFast" BO_ 403 0;
BA_ "GenMsgSendType" BO_ 403 0;
BA_ "VFrameFormat" BO_ 403 14;
BA_ "CANFD_BRS" BO_ 403 1;
BA_ "GenMsgCycleTime" BO_ 403 20;
BA_ "GenMsgCycleTimeFast" BO_ 403 0;
BA_ "GenMsgSendType" BO_ 403 0;
BA_ "VFrameFormat" BO_ 403 14;
BA_ "CANFD_BRS" BO_ 403 1;
BA_ "GenMsgCycleTime" BO_ 403 20;
BA_ "GenMsgCycleTimeFast" BO_ 403 0;
BA_ "GenMsgSendType" BO_ 403 0;
BA_ "VFrameFormat" BO_ 403 14;
BA_ "CANFD_BRS" BO_ 403 1;
BA_ "GenMsgCycleTime" BO_ 403 20;
BA_ "GenMsgCycleTimeFast" BO_ 403 0;
BA_ "GenMsgSendType" BO_ 403 0;
BA_ "VFrameFormat" BO_ 403 14;
BA_ "CANFD_BRS" BO_ 403 1;
BA_ "GenMsgCycleTime" BO_ 403 20;
BA_ "GenMsgCycleTimeFast" BO_ 403 0;
BA_ "GenMsgSendType" BO_ 403 0;
BA_ "VFrameFormat" BO_ 403 14;
BA_ "CANFD_BRS" BO_ 403 1;
BA_ "GenMsgCycleTime" BO_ 403 20;
BA_ "GenMsgCycleTimeFast" BO_ 403 0;
BA_ "GenMsgSendType" BO_ 403 0;
BA_ "VFrameFormat" BO_ 403 14;
BA_ "CANFD_BRS" BO_ 403 1;
BA_ "GenMsgCycleTime" BO_ 403 20;
BA_ "GenMsgCycleTimeFast" BO_ 403 0;
BA_ "GenMsgSendType" BO_ 403 0;
BA_ "VFrameFormat" BO_ 403 14;
BA_ "CANFD_BRS" BO_ 403 1;
BA_ "GenMsgCycleTime" BO_ 403 20;
BA_ "GenMsgCycleTimeFast" BO_ 403 0;
BA_ "GenMsgSendType" BO_ 403 0;
BA_ "VFrameFormat" BO_ 403 14;
BA_ "CANFD_BRS" BO_ 403 1;
BA_ "GenMsgCycleTime" BO_ 403 20;
BA_ "GenMsgCycleTimeFast" BO_ 403 0;
BA_ "GenMsgSendType" BO_ 403 0;
BA_ "VFrameFormat" BO_ 403 14;
BA_ "CANFD_BRS" BO_ 403 1;
BA_ "GenMsgCycleTime" BO_ 403 20;
BA_ "GenMsgCycleTimeFast" BO_ 403 0;
BA_ "GenMsgSendType" BO_ 403 0;
BA_ "VFrameFormat" BO_ 403 14;
BA_ "CANFD_BRS" BO_ 403 1;
BA_ "GenMsgCycleTime" BO_ 403 20;
BA_ "GenMsgCycleTimeFast" BO_ 403 0;
BA_ "GenMsgSendType" BO_ 403 0;
BA_ "VFrameFormat" BO_ 403 14;
BA_ "CANFD_BRS" BO_ 403 1;
BA_ "GenMsgCycleTime" BO_ 403 20;
BA_ "GenMsgCycleTimeFast" BO_ 403 0;
BA_ "GenMsgSendType" BO_ 403 0;
BA_ "VFrameFormat" BO_ 403 14;
BA_ "CANFD_BRS" BO_ 403 1;
BA_ "GenMsgCycleTime" BO_ 403 20;
BA_ "GenMsgCycleTimeFast" BO_ 403 0;
BA_ "GenMsgSendType" BO_ 403 0;
BA_ "VFrameFormat" BO_ 403 14;
BA_ "CANFD_BRS" BO_ 403 1;
BA_ "GenMsgCycleTime" BO_ 403 20;
BA_ "GenMsgCycleTimeFast" BO_ 403 0;
BA_ "GenMsgSendType" BO_ 403 0;
BA_ "VFrameFormat" BO_ 403 14;
BA_ "CANFD_BRS" BO_ 403 1;
BA_ "GenMsgCycleTime" BO_ 403 20;
BA_ "GenMsgCycleTimeFast" BO_ 403 0;
BA_ "GenMsgSendType" BO_ 403 0;
BA_ "VFrameFormat" BO_ 403 14;
BA_ "CANFD_BRS" BO_ 403 1;
BA_ "GenMsgCycleTime" BO_ 403 20;
BA_ "GenMsgCycleTimeFast" BO_ 403 0;
BA_ "GenMsgSendType" BO_ 403 0;
BA_ "VFrameFormat" BO_ 403 14;
BA_ "CANFD_BRS" BO_ 403 1;
BA_ "GenMsgCycleTime" BO_ 403 20;
BA_ "GenMsgCycleTimeFast" BO_ 403 0;
BA_ "GenMsgSendType" BO_ 403 0;
BA_ "VFrameFormat" BO_ 403 14;
BA_ "CANFD_BRS" BO_ 403 1;
BA_ "GenMsgCycleTime" BO_ 403 20;
BA_ "GenMsgCycleTimeFast" BO_ 403 0;
BA_ "GenMsgSendType" BO_ 403 0;
BA_ "VFrameFormat" BO_ 403 14;
BA_ "CANFD_BRS" BO_ 403 1;
BA_ "GenMsgCycleTime" BO_ 403 20;
BA_ "GenMsgCycleTimeFast" BO_ 403 0;
BA_ "GenMsgSendType" BO_ 403 0;
BA_ "VFrameFormat" BO_ 403 14;
BA_ "CANFD_BRS" BO_ 403 1;
BA_ "GenMsgCycleTime" BO_ 403 20;
BA_ "GenMsgCycleTimeFast" BO_ 403 0;
BA_ "GenMsgSendType" BO_ 403 0;
BA_ "VFrameFormat" BO_ 403 14;
BA_ "CANFD_BRS" BO_ 403 1;
BA_ "GenMsgCycleTime" BO_ 403 20;
BA_ "GenMsgCycleTimeFast" BO_ 403 0;
BA_ "GenMsgSendType" BO_ 403 0;
BA_ "VFrameFormat" BO_ 403 14;
BA_ "CANFD_BRS" BO_ 403 1;
BA_ "GenMsgCycleTime" BO_ 403 20;
BA_ "GenMsgCycleTimeFast" BO_ 403 0;
BA_ "GenMsgSendType" BO_ 403 0;
BA_ "VFrameFormat" BO_ 403 14;
BA_ "CANFD_BRS" BO_ 403 1;
BA_ "GenMsgCycleTime" BO_ 403 20;
BA_ "GenMsgCycleTimeFast" BO_ 403 0;
BA_ "GenMsgSendType" BO_ 403 0;
BA_ "VFrameFormat" BO_ 403 14;
BA_ "CANFD_BRS" BO_ 403 1;
BA_ "GenMsgCycleTime" BO_ 403 20;
BA_ "GenMsgCycleTimeFast" BO_ 403 0;
BA_ "GenMsgSendType" BO_ 403 0;
BA_ "VFrameFormat" BO_ 403 14;
BA_ "CANFD_BRS" BO_ 403 1;
BA_ "GenMsgCycleTime" BO_ 403 20;
BA_ "GenMsgCycleTimeFast" BO_ 403 0;
BA_ "GenMsgSendType" BO_ 403 0;
BA_ "VFrameFormat" BO_ 403 14;
BA_ "CANFD_BRS" BO_ 403 1;
BA_ "GenMsgCycleTime" BO_ 403 20;
BA_ "GenMsgCycleTimeFast" BO_ 403 0;
BA_ "GenMsgSendType" BO_ 403 0;
BA_ "VFrameFormat" BO_ 403 14;
BA_ "CANFD_BRS" BO_ 403 1;
BA_ "GenMsgCycleTime" BO_ 403 20;
BA_ "GenMsgCycleTimeFast" BO_ 403 0;
BA_ "GenMsgSendType" BO_ 403 0;
BA_ "VFrameFormat" BO_ 403 14;
BA_ "CANFD_BRS" BO_ 403 1;
BA_ "GenMsgCycleTime" BO_ 403 20;
BA_ "GenMsgCycleTimeFast" BO_ 403 0;
BA_ "GenMsgSendType" BO_ 403 0;
BA_ "VFrameFormat" BO_ 403 14;
BA_ "CANFD_BRS" BO_ 403 1;
BA_ "GenMsgCycleTime" BO_ 403 20;
BA_ "GenMsgCycleTimeFast" BO_ 403 0;
BA_ "GenMsgSendType" BO_ 403 0;
BA_ "VFrameFormat" BO_ 403 14;
BA_ "CANFD_BRS" BO_ 403 1;
BA_ "GenMsgCycleTime" BO_ 403 20;
BA_ "GenMsgCycleTimeFast" BO_ 403 0;
BA_ "GenMsgSendType" BO_ 403 0;
BA_ "VFrameFormat" BO_ 403 14;
BA_ "CANFD_BRS" BO_ 403 1;
BA_ "GenMsgCycleTime" BO_ 403 20;
BA_ "GenMsgCycleTimeFast" BO_ 403 0;
BA_ "GenMsgSendType" BO_ 403 0;
BA_ "VFrameFormat" BO_ 403 14;
BA_ "CANFD_BRS" BO_ 403 1;
BA_ "GenMsgCycleTime" BO_ 403 20;
BA_ "GenMsgCycleTimeFast" BO_ 403 0;
BA_ "GenMsgSendType" BO_ 403 0;
BA_ "VFrameFormat" BO_ 403 14;
BA_ "CANFD_BRS" BO_ 403 1;
BA_ "GenMsgCycleTime" BO_ 403 20;
BA_ "GenMsgCycleTimeFast" BO_ 403 0;
BA_ "GenMsgSendType" BO_ 403 0;
BA_ "VFrameFormat" BO_ 403 14;
BA_ "CANFD_BRS" BO_ 403 1;
BA_ "GenMsgCycleTime" BO_ 403 20;
BA_ "GenMsgCycleTimeFast" BO_ 403 0;
BA_ "GenMsgSendType" BO_ 403 0;
BA_ "VFrameFormat" BO_ 403 14;
BA_ "CANFD_BRS" BO_ 403 1;
BA_ "GenMsgCycleTime" BO_ 403 20;
BA_ "GenMsgCycleTimeFast" BO_ 403 0;
BA_ "GenMsgSendType" BO_ 403 0;
BA_ "VFrameFormat" BO_ 403 14;
BA_ "CANFD_BRS" BO_ 403 1;
BA_ "GenMsgCycleTime" BO_ 403 20;
BA_ "GenMsgCycleTimeFast" BO_ 403 0;
BA_ "GenMsgSendType" BO_ 403 0;
BA_ "VFrameFormat" BO_ 403 14;
BA_ "CANFD_BRS" BO_ 403 1;
BA_ "GenMsgCycleTime" BO_ 403 20;
BA_ "GenMsgCycleTimeFast" BO_ 403 0;
BA_ "GenMsgSendType" BO_ 403 0;
BA_ "VFrameFormat" BO_ 403 14;
BA_ "CANFD_BRS" BO_ 403 1;
BA_ "GenMsgCycleTime" BO_ 403 20;
BA_ "GenMsgCycleTimeFast" BO_ 403 0;
BA_ "GenMsgSendType" BO_ 403 0;
BA_ "VFrameFormat" BO_ 403 14;
BA_ "CANFD_BRS" BO_ 403 1;
BA_ "GenMsgCycleTime" BO_ 403 20;
BA_ "GenMsgCycleTimeFast" BO_ 403 0;
BA_ "GenMsgSendType" BO_ 403 0;
BA_ "VFrameFormat" BO_ 403 14;
BA_ "CANFD_BRS" BO_ 403 1;
BA_ "GenMsgCycleTime" BO_ 403 20;
BA_ "GenMsgCycleTimeFast" BO_ 403 0;
BA_ "GenMsgSendType" BO_ 403 0;
BA_ "VFrameFormat" BO_ 403 14;
BA_ "CANFD_BRS" BO_ 403 1;
BA_ "GenMsgCycleTime" BO_ 403 20;
BA_ "GenMsgCycleTimeFast" BO_ 403 0;
BA_ "GenMsgSendType" BO_ 403 0;
BA_ "VFrameFormat" BO_ 403 14;
BA_ "CANFD_BRS" BO_ 403 1;
BA_ "GenMsgCycleTime" BO_ 403 20;
BA_ "GenMsgCycleTimeFast" BO_ 403 0;
BA_ "GenMsgSendType" BO_ 403 0;
BA_ "VFrameFormat" BO_ 403 14;
BA_ "CANFD_BRS" BO_ 403 1;
BA_ "GenMsgCycleTime" BO_ 403 20;
BA_ "GenMsgCycleTimeFast" BO_ 403 0;
BA_ "GenMsgSendType" BO_ 403 0;
BA_ "VFrameFormat" BO_ 403 14;
BA_ "CANFD_BRS" BO_ 403 1;
BA_ "GenMsgCycleTime" BO_ 403 20;
BA_ "GenMsgCycleTimeFast" BO_ 403 0;
BA_ "GenMsgSendType" BO_ 403 0;
BA_ "VFrameFormat" BO_ 403 14;
BA_ "CANFD_BRS" BO_ 403 1;
BA_ "GenMsgCycleTime" BO_ 403 20;
BA_ "GenMsgCycleTimeFast" BO_ 403 0;
BA_ "GenMsgSendType" BO_ 403 0;
BA_ "VFrameFormat" BO_ 403 14;
BA_ "CANFD_BRS" BO_ 403 1;
BA_ "GenMsgCycleTime" BO_ 403 20;
BA_ "GenMsgCycleTimeFast" BO_ 403 0;
BA_ "GenMsgSendType" BO_ 403 0;
BA_ "VFrameFormat" BO_ 403 14;
BA_ "CANFD_BRS" BO_ 403 1;
BA_ "GenMsgCycleTime" BO_ 403 20;
BA_ "GenMsgCycleTimeFast" BO_ 403 0;
BA_ "GenMsgSendType" BO_ 403 0;
BA_ "VFrameFormat" BO_ 403 14;
BA_ "CANFD_BRS" BO_ 403 1;
BA_ "GenMsgCycleTime" BO_ 403 20;
BA_ "GenMsgCycleTimeFast" BO_ 403 0;
BA_ "GenMsgSendType" BO_ 403 0;
BA_ "VFrameFormat" BO_ 403 14;
BA_ "CANFD_BRS" BO_ 403 1;
BA_ "GenMsgCycleTime" BO_ 403 20;
BA_ "GenMsgCycleTimeFast" BO_ 403 0;
BA_ "GenMsgSendType" BO_ 403 0;
BA_ "VFrameFormat" BO_ 403 14;
BA_ "CANFD_BRS" BO_ 403 1;
BA_ "GenMsgCycleTime" BO_ 403 20;
BA_ "GenMsgCycleTimeFast" BO_ 403 0;
BA_ "GenMsgSendType" BO_ 403 0;
BA_ "VFrameFormat" BO_ 403 14;
BA_ "CANFD_BRS" BO_ 403 1;
BA_ "GenMsgCycleTime" BO_ 403 20;
BA_ "GenMsgCycleTimeFast" BO_ 403 0;
BA_ "GenMsgSendType" BO_ 403 0;
BA_ "VFrameFormat" BO_ 403 14;
BA_ "CANFD_BRS" BO_ 403 1;
BA_ "EventCommandSignal" SG_ 696 SBM_5_CRC 0;
BA_ "GatewayedSignals" SG_ 696 SBM_5_CRC 0;
BA_ "GenSigInactiveValue" SG_ 696 SBM_5_CRC 0;
BA_ "GenSigInvalidValue" SG_ 696 SBM_5_CRC 0;
BA_ "GenSigSendType" SG_ 696 SBM_5_CRC 1;
BA_ "GenSigStartValue" SG_ 696 SBM_5_CRC 0;
BA_ "GenSigTimeoutValue" SG_ 696 SBM_5_CRC 0;
BA_ "Remark" SG_ 696 SBM_5_CRC "";
BA_ "EventCommandSignal" SG_ 696 SBM_5_Counter 0;
BA_ "GatewayedSignals" SG_ 696 SBM_5_Counter 0;
BA_ "GenSigInactiveValue" SG_ 696 SBM_5_Counter 0;
BA_ "GenSigInvalidValue" SG_ 696 SBM_5_Counter 0;
BA_ "GenSigSendType" SG_ 696 SBM_5_Counter 1;
BA_ "GenSigStartValue" SG_ 696 SBM_5_Counter 0;
BA_ "GenSigTimeoutValue" SG_ 696 SBM_5_Counter 0;
BA_ "Remark" SG_ 696 SBM_5_Counter "";
BA_ "EventCommandSignal" SG_ 696 KAE_EDK1UnlockBtnPressSt 0;
BA_ "GatewayedSignals" SG_ 696 KAE_EDK1UnlockBtnPressSt 0;
BA_ "GenSigInactiveValue" SG_ 696 KAE_EDK1UnlockBtnPressSt 0;
BA_ "GenSigInvalidValue" SG_ 696 KAE_EDK1UnlockBtnPressSt 0;
BA_ "GenSigSendType" SG_ 696 KAE_EDK1UnlockBtnPressSt 1;
BA_ "GenSigStartValue" SG_ 696 KAE_EDK1UnlockBtnPressSt 0;
BA_ "GenSigTimeoutValue" SG_ 696 KAE_EDK1UnlockBtnPressSt 0;
BA_ "Remark" SG_ 696 KAE_EDK1UnlockBtnPressSt "";
BA_ "EventCommandSignal" SG_ 696 KAE_EDK1LockBtnPressSt 0;
BA_ "GatewayedSignals" SG_ 696 KAE_EDK1LockBtnPressSt 0;
BA_ "GenSigInactiveValue" SG_ 696 KAE_EDK1LockBtnPressSt 0;
BA_ "GenSigInvalidValue" SG_ 696 KAE_EDK1LockBtnPressSt 0;
BA_ "GenSigSendType" SG_ 696 KAE_EDK1LockBtnPressSt 1;
BA_ "GenSigStartValue" SG_ 696 KAE_EDK1LockBtnPressSt 0;
BA_ "GenSigTimeoutValue" SG_ 696 KAE_EDK1LockBtnPressSt 0;
BA_ "Remark" SG_ 696 KAE_EDK1LockBtnPressSt "";
BA_ "EventCommandSignal" SG_ 696 KAE_EDK1RESBtnPressSt 0;
BA_ "GatewayedSignals" SG_ 696 KAE_EDK1RESBtnPressSt 0;
BA_ "GenSigInactiveValue" SG_ 696 KAE_EDK1RESBtnPressSt 0;
BA_ "GenSigInvalidValue" SG_ 696 KAE_EDK1RESBtnPressSt 0;
BA_ "GenSigSendType" SG_ 696 KAE_EDK1RESBtnPressSt 1;
BA_ "GenSigStartValue" SG_ 696 KAE_EDK1RESBtnPressSt 0;
BA_ "GenSigTimeoutValue" SG_ 696 KAE_EDK1RESBtnPressSt 0;
BA_ "Remark" SG_ 696 KAE_EDK1RESBtnPressSt "";
BA_ "EventCommandSignal" SG_ 696 KAE_EDK1PSD_LBtnPressSt 0;
BA_ "GatewayedSignals" SG_ 696 KAE_EDK1PSD_LBtnPressSt 0;
BA_ "GenSigInactiveValue" SG_ 696 KAE_EDK1PSD_LBtnPressSt 0;
BA_ "GenSigInvalidValue" SG_ 696 KAE_EDK1PSD_LBtnPressSt 0;
BA_ "GenSigSendType" SG_ 696 KAE_EDK1PSD_LBtnPressSt 1;
BA_ "GenSigStartValue" SG_ 696 KAE_EDK1PSD_LBtnPressSt 0;
BA_ "GenSigTimeoutValue" SG_ 696 KAE_EDK1PSD_LBtnPressSt 0;
BA_ "Remark" SG_ 696 KAE_EDK1PSD_LBtnPressSt "";
BA_ "EventCommandSignal" SG_ 696 KAE_EDK1PSD_RBtnPressSt 0;
BA_ "GatewayedSignals" SG_ 696 KAE_EDK1PSD_RBtnPressSt 0;
BA_ "GenSigInactiveValue" SG_ 696 KAE_EDK1PSD_RBtnPressSt 0;
BA_ "GenSigInvalidValue" SG_ 696 KAE_EDK1PSD_RBtnPressSt 0;
BA_ "GenSigSendType" SG_ 696 KAE_EDK1PSD_RBtnPressSt 1;
BA_ "GenSigStartValue" SG_ 696 KAE_EDK1PSD_RBtnPressSt 0;
BA_ "GenSigTimeoutValue" SG_ 696 KAE_EDK1PSD_RBtnPressSt 0;
BA_ "Remark" SG_ 696 KAE_EDK1PSD_RBtnPressSt "";
BA_ "EventCommandSignal" SG_ 696 KAE_EDK1TrunkBtnPressSt 0;
BA_ "GatewayedSignals" SG_ 696 KAE_EDK1TrunkBtnPressSt 0;
BA_ "GenSigInactiveValue" SG_ 696 KAE_EDK1TrunkBtnPressSt 0;
BA_ "GenSigInvalidValue" SG_ 696 KAE_EDK1TrunkBtnPressSt 0;
BA_ "GenSigSendType" SG_ 696 KAE_EDK1TrunkBtnPressSt 1;
BA_ "GenSigStartValue" SG_ 696 KAE_EDK1TrunkBtnPressSt 0;
BA_ "GenSigTimeoutValue" SG_ 696 KAE_EDK1TrunkBtnPressSt 0;
BA_ "Remark" SG_ 696 KAE_EDK1TrunkBtnPressSt "";
BA_ "EventCommandSignal" SG_ 696 KAE_EDK1PanicBtnPressSt 0;
BA_ "GatewayedSignals" SG_ 696 KAE_EDK1PanicBtnPressSt 0;
BA_ "GenSigInactiveValue" SG_ 696 KAE_EDK1PanicBtnPressSt 0;
BA_ "GenSigInvalidValue" SG_ 696 KAE_EDK1PanicBtnPressSt 0;
BA_ "GenSigSendType" SG_ 696 KAE_EDK1PanicBtnPressSt 1;
BA_ "GenSigStartValue" SG_ 696 KAE_EDK1PanicBtnPressSt 0;
BA_ "GenSigTimeoutValue" SG_ 696 KAE_EDK1PanicBtnPressSt 0;
BA_ "Remark" SG_ 696 KAE_EDK1PanicBtnPressSt "";
BA_ "EventCommandSignal" SG_ 696 KAE_EDK1User_definedBtnPressSt 0;
BA_ "GatewayedSignals" SG_ 696 KAE_EDK1User_definedBtnPressSt 0;
BA_ "GenSigInactiveValue" SG_ 696 KAE_EDK1User_definedBtnPressSt 0;
BA_ "GenSigInvalidValue" SG_ 696 KAE_EDK1User_definedBtnPressSt 0;
BA_ "GenSigSendType" SG_ 696 KAE_EDK1User_definedBtnPressSt 1;
BA_ "GenSigStartValue" SG_ 696 KAE_EDK1User_definedBtnPressSt 0;
BA_ "GenSigTimeoutValue" SG_ 696 KAE_EDK1User_definedBtnPressSt 0;
BA_ "Remark" SG_ 696 KAE_EDK1User_definedBtnPressSt "";
BA_ "EventCommandSignal" SG_ 696 KAE_EDK2UnlockBtnPressSt 0;
BA_ "GatewayedSignals" SG_ 696 KAE_EDK2UnlockBtnPressSt 0;
BA_ "GenSigInactiveValue" SG_ 696 KAE_EDK2UnlockBtnPressSt 0;
BA_ "GenSigInvalidValue" SG_ 696 KAE_EDK2UnlockBtnPressSt 0;
BA_ "GenSigSendType" SG_ 696 KAE_EDK2UnlockBtnPressSt 1;
BA_ "GenSigStartValue" SG_ 696 KAE_EDK2UnlockBtnPressSt 0;
BA_ "GenSigTimeoutValue" SG_ 696 KAE_EDK2UnlockBtnPressSt 0;
BA_ "Remark" SG_ 696 KAE_EDK2UnlockBtnPressSt "";
BA_ "EventCommandSignal" SG_ 696 KAE_EDK2LockBtnPressSt 0;
BA_ "GatewayedSignals" SG_ 696 KAE_EDK2LockBtnPressSt 0;
BA_ "GenSigInactiveValue" SG_ 696 KAE_EDK2LockBtnPressSt 0;
BA_ "GenSigInvalidValue" SG_ 696 KAE_EDK2LockBtnPressSt 0;
BA_ "GenSigSendType" SG_ 696 KAE_EDK2LockBtnPressSt 1;
BA_ "GenSigStartValue" SG_ 696 KAE_EDK2LockBtnPressSt 0;
BA_ "GenSigTimeoutValue" SG_ 696 KAE_EDK2LockBtnPressSt 0;
BA_ "Remark" SG_ 696 KAE_EDK2LockBtnPressSt "";
BA_ "EventCommandSignal" SG_ 696 KAE_EDK2RESBtnPressSt 0;
BA_ "GatewayedSignals" SG_ 696 KAE_EDK2RESBtnPressSt 0;
BA_ "GenSigInactiveValue" SG_ 696 KAE_EDK2RESBtnPressSt 0;
BA_ "GenSigInvalidValue" SG_ 696 KAE_EDK2RESBtnPressSt 0;
BA_ "GenSigSendType" SG_ 696 KAE_EDK2RESBtnPressSt 1;
BA_ "GenSigStartValue" SG_ 696 KAE_EDK2RESBtnPressSt 0;
BA_ "GenSigTimeoutValue" SG_ 696 KAE_EDK2RESBtnPressSt 0;
BA_ "Remark" SG_ 696 KAE_EDK2RESBtnPressSt "";
BA_ "EventCommandSignal" SG_ 696 KAE_EDK2PSD_LBtnPressSt 0;
BA_ "GatewayedSignals" SG_ 696 KAE_EDK2PSD_LBtnPressSt 0;
BA_ "GenSigInactiveValue" SG_ 696 KAE_EDK2PSD_LBtnPressSt 0;
BA_ "GenSigInvalidValue" SG_ 696 KAE_EDK2PSD_LBtnPressSt 0;
BA_ "GenSigSendType" SG_ 696 KAE_EDK2PSD_LBtnPressSt 1;
BA_ "GenSigStartValue" SG_ 696 KAE_EDK2PSD_LBtnPressSt 0;
BA_ "GenSigTimeoutValue" SG_ 696 KAE_EDK2PSD_LBtnPressSt 0;
BA_ "Remark" SG_ 696 KAE_EDK2PSD_LBtnPressSt "";
BA_ "EventCommandSignal" SG_ 696 KAE_EDK2PSD_RBtnPressSt 0;
BA_ "GatewayedSignals" SG_ 696 KAE_EDK2PSD_RBtnPressSt 0;
BA_ "GenSigInactiveValue" SG_ 696 KAE_EDK2PSD_RBtnPressSt 0;
BA_ "GenSigInvalidValue" SG_ 696 KAE_EDK2PSD_RBtnPressSt 0;
BA_ "GenSigSendType" SG_ 696 KAE_EDK2PSD_RBtnPressSt 1;
BA_ "GenSigStartValue" SG_ 696 KAE_EDK2PSD_RBtnPressSt 0;
BA_ "GenSigTimeoutValue" SG_ 696 KAE_EDK2PSD_RBtnPressSt 0;
BA_ "Remark" SG_ 696 KAE_EDK2PSD_RBtnPressSt "";
BA_ "EventCommandSignal" SG_ 696 KAE_EDK2TrunkBtnPressSt 0;
BA_ "GatewayedSignals" SG_ 696 KAE_EDK2TrunkBtnPressSt 0;
BA_ "GenSigInactiveValue" SG_ 696 KAE_EDK2TrunkBtnPressSt 0;
BA_ "GenSigInvalidValue" SG_ 696 KAE_EDK2TrunkBtnPressSt 0;
BA_ "GenSigSendType" SG_ 696 KAE_EDK2TrunkBtnPressSt 1;
BA_ "GenSigStartValue" SG_ 696 KAE_EDK2TrunkBtnPressSt 0;
BA_ "GenSigTimeoutValue" SG_ 696 KAE_EDK2TrunkBtnPressSt 0;
BA_ "Remark" SG_ 696 KAE_EDK2TrunkBtnPressSt "";
BA_ "EventCommandSignal" SG_ 696 KAE_EDK2PanicBtnPressSt 0;
BA_ "GatewayedSignals" SG_ 696 KAE_EDK2PanicBtnPressSt 0;
BA_ "GenSigInactiveValue" SG_ 696 KAE_EDK2PanicBtnPressSt 0;
BA_ "GenSigInvalidValue" SG_ 696 KAE_EDK2PanicBtnPressSt 0;
BA_ "GenSigSendType" SG_ 696 KAE_EDK2PanicBtnPressSt 1;
BA_ "GenSigStartValue" SG_ 696 KAE_EDK2PanicBtnPressSt 0;
BA_ "GenSigTimeoutValue" SG_ 696 KAE_EDK2PanicBtnPressSt 0;
BA_ "Remark" SG_ 696 KAE_EDK2PanicBtnPressSt "";
BA_ "EventCommandSignal" SG_ 696 KAE_EDK2User_definedBtnPressSt 0;
BA_ "GatewayedSignals" SG_ 696 KAE_EDK2User_definedBtnPressSt 0;
BA_ "GenSigInactiveValue" SG_ 696 KAE_EDK2User_definedBtnPressSt 0;
BA_ "GenSigInvalidValue" SG_ 696 KAE_EDK2User_definedBtnPressSt 0;
BA_ "GenSigSendType" SG_ 696 KAE_EDK2User_definedBtnPressSt 1;
BA_ "GenSigStartValue" SG_ 696 KAE_EDK2User_definedBtnPressSt 0;
BA_ "GenSigTimeoutValue" SG_ 696 KAE_EDK2User_definedBtnPressSt 0;
BA_ "Remark" SG_ 696 KAE_EDK2User_definedBtnPressSt "";
BA_ "EventCommandSignal" SG_ 696 KAE_EDK3UnlockBtnPressSt 0;
BA_ "GatewayedSignals" SG_ 696 KAE_EDK3UnlockBtnPressSt 0;
BA_ "GenSigInactiveValue" SG_ 696 KAE_EDK3UnlockBtnPressSt 0;
BA_ "GenSigInvalidValue" SG_ 696 KAE_EDK3UnlockBtnPressSt 0;
BA_ "GenSigSendType" SG_ 696 KAE_EDK3UnlockBtnPressSt 1;
BA_ "GenSigStartValue" SG_ 696 KAE_EDK3UnlockBtnPressSt 0;
BA_ "GenSigTimeoutValue" SG_ 696 KAE_EDK3UnlockBtnPressSt 0;
BA_ "Remark" SG_ 696 KAE_EDK3UnlockBtnPressSt "";
BA_ "EventCommandSignal" SG_ 696 KAE_EDK3LockBtnPressSt 0;
BA_ "GatewayedSignals" SG_ 696 KAE_EDK3LockBtnPressSt 0;
BA_ "GenSigInactiveValue" SG_ 696 KAE_EDK3LockBtnPressSt 0;
BA_ "GenSigInvalidValue" SG_ 696 KAE_EDK3LockBtnPressSt 0;
BA_ "GenSigSendType" SG_ 696 KAE_EDK3LockBtnPressSt 1;
BA_ "GenSigStartValue" SG_ 696 KAE_EDK3LockBtnPressSt 0;
BA_ "GenSigTimeoutValue" SG_ 696 KAE_EDK3LockBtnPressSt 0;
BA_ "Remark" SG_ 696 KAE_EDK3LockBtnPressSt "";
BA_ "EventCommandSignal" SG_ 696 KAE_EDK3RESBtnPressSt 0;
BA_ "GatewayedSignals" SG_ 696 KAE_EDK3RESBtnPressSt 0;
BA_ "GenSigInactiveValue" SG_ 696 KAE_EDK3RESBtnPressSt 0;
BA_ "GenSigInvalidValue" SG_ 696 KAE_EDK3RESBtnPressSt 0;
BA_ "GenSigSendType" SG_ 696 KAE_EDK3RESBtnPressSt 1;
BA_ "GenSigStartValue" SG_ 696 KAE_EDK3RESBtnPressSt 0;
BA_ "GenSigTimeoutValue" SG_ 696 KAE_EDK3RESBtnPressSt 0;
BA_ "Remark" SG_ 696 KAE_EDK3RESBtnPressSt "";
BA_ "EventCommandSignal" SG_ 696 KAE_EDK3PSD_LBtnPressSt 0;
BA_ "GatewayedSignals" SG_ 696 KAE_EDK3PSD_LBtnPressSt 0;
BA_ "GenSigInactiveValue" SG_ 696 KAE_EDK3PSD_LBtnPressSt 0;
BA_ "GenSigInvalidValue" SG_ 696 KAE_EDK3PSD_LBtnPressSt 0;
BA_ "GenSigSendType" SG_ 696 KAE_EDK3PSD_LBtnPressSt 1;
BA_ "GenSigStartValue" SG_ 696 KAE_EDK3PSD_LBtnPressSt 0;
BA_ "GenSigTimeoutValue" SG_ 696 KAE_EDK3PSD_LBtnPressSt 0;
BA_ "Remark" SG_ 696 KAE_EDK3PSD_LBtnPressSt "";
BA_ "EventCommandSignal" SG_ 696 KAE_EDK3PSD_RBtnPressSt 0;
BA_ "GatewayedSignals" SG_ 696 KAE_EDK3PSD_RBtnPressSt 0;
BA_ "GenSigInactiveValue" SG_ 696 KAE_EDK3PSD_RBtnPressSt 0;
BA_ "GenSigInvalidValue" SG_ 696 KAE_EDK3PSD_RBtnPressSt 0;
BA_ "GenSigSendType" SG_ 696 KAE_EDK3PSD_RBtnPressSt 1;
BA_ "GenSigStartValue" SG_ 696 KAE_EDK3PSD_RBtnPressSt 0;
BA_ "GenSigTimeoutValue" SG_ 696 KAE_EDK3PSD_RBtnPressSt 0;
BA_ "Remark" SG_ 696 KAE_EDK3PSD_RBtnPressSt "";
BA_ "EventCommandSignal" SG_ 696 KAE_EDK3TrunkBtnPressSt 0;
BA_ "GatewayedSignals" SG_ 696 KAE_EDK3TrunkBtnPressSt 0;
BA_ "GenSigInactiveValue" SG_ 696 KAE_EDK3TrunkBtnPressSt 0;
BA_ "GenSigInvalidValue" SG_ 696 KAE_EDK3TrunkBtnPressSt 0;
BA_ "GenSigSendType" SG_ 696 KAE_EDK3TrunkBtnPressSt 1;
BA_ "GenSigStartValue" SG_ 696 KAE_EDK3TrunkBtnPressSt 0;
BA_ "GenSigTimeoutValue" SG_ 696 KAE_EDK3TrunkBtnPressSt 0;
BA_ "Remark" SG_ 696 KAE_EDK3TrunkBtnPressSt "";
BA_ "EventCommandSignal" SG_ 696 KAE_EDK3PanicBtnPressSt 0;
BA_ "GatewayedSignals" SG_ 696 KAE_EDK3PanicBtnPressSt 0;
BA_ "GenSigInactiveValue" SG_ 696 KAE_EDK3PanicBtnPressSt 0;
BA_ "GenSigInvalidValue" SG_ 696 KAE_EDK3PanicBtnPressSt 0;
BA_ "GenSigSendType" SG_ 696 KAE_EDK3PanicBtnPressSt 1;
BA_ "GenSigStartValue" SG_ 696 KAE_EDK3PanicBtnPressSt 0;
BA_ "GenSigTimeoutValue" SG_ 696 KAE_EDK3PanicBtnPressSt 0;
BA_ "Remark" SG_ 696 KAE_EDK3PanicBtnPressSt "";
BA_ "EventCommandSignal" SG_ 696 KAE_EDK3User_definedBtnPressSt 0;
BA_ "GatewayedSignals" SG_ 696 KAE_EDK3User_definedBtnPressSt 0;
BA_ "GenSigInactiveValue" SG_ 696 KAE_EDK3User_definedBtnPressSt 0;
BA_ "GenSigInvalidValue" SG_ 696 KAE_EDK3User_definedBtnPressSt 0;
BA_ "GenSigSendType" SG_ 696 KAE_EDK3User_definedBtnPressSt 1;
BA_ "GenSigStartValue" SG_ 696 KAE_EDK3User_definedBtnPressSt 0;
BA_ "GenSigTimeoutValue" SG_ 696 KAE_EDK3User_definedBtnPressSt 0;
BA_ "Remark" SG_ 696 KAE_EDK3User_definedBtnPressSt "";
BA_ "EventCommandSignal" SG_ 696 KAE_RPADirectionSel 0;
BA_ "GatewayedSignals" SG_ 696 KAE_RPADirectionSel 0;
BA_ "GenSigInactiveValue" SG_ 696 KAE_RPADirectionSel 0;
BA_ "GenSigInvalidValue" SG_ 696 KAE_RPADirectionSel 0;
BA_ "GenSigSendType" SG_ 696 KAE_RPADirectionSel 1;
BA_ "GenSigStartValue" SG_ 696 KAE_RPADirectionSel 0;
BA_ "GenSigTimeoutValue" SG_ 696 KAE_RPADirectionSel 0;
BA_ "Remark" SG_ 696 KAE_RPADirectionSel "";
BA_ "EventCommandSignal" SG_ 696 KAE_RPAmode 0;
BA_ "GatewayedSignals" SG_ 696 KAE_RPAmode 0;
BA_ "GenSigInactiveValue" SG_ 696 KAE_RPAmode 0;
BA_ "GenSigInvalidValue" SG_ 696 KAE_RPAmode 0;
BA_ "GenSigSendType" SG_ 696 KAE_RPAmode 1;
BA_ "GenSigStartValue" SG_ 696 KAE_RPAmode 0;
BA_ "GenSigTimeoutValue" SG_ 696 KAE_RPAmode 0;
BA_ "Remark" SG_ 696 KAE_RPAmode "";
BA_ "EventCommandSignal" SG_ 696 KAE_RPADeviceSt 0;
BA_ "GatewayedSignals" SG_ 696 KAE_RPADeviceSt 0;
BA_ "GenSigInactiveValue" SG_ 696 KAE_RPADeviceSt 0;
BA_ "GenSigInvalidValue" SG_ 696 KAE_RPADeviceSt 0;
BA_ "GenSigSendType" SG_ 696 KAE_RPADeviceSt 1;
BA_ "GenSigStartValue" SG_ 696 KAE_RPADeviceSt 0;
BA_ "GenSigTimeoutValue" SG_ 696 KAE_RPADeviceSt 0;
BA_ "Remark" SG_ 696 KAE_RPADeviceSt "";
BA_ "EventCommandSignal" SG_ 696 KAE_PhoneBatt 0;
BA_ "GatewayedSignals" SG_ 696 KAE_PhoneBatt 0;
BA_ "GenSigInactiveValue" SG_ 696 KAE_PhoneBatt 0;
BA_ "GenSigInvalidValue" SG_ 696 KAE_PhoneBatt 0;
BA_ "GenSigSendType" SG_ 696 KAE_PhoneBatt 1;
BA_ "GenSigStartValue" SG_ 696 KAE_PhoneBatt 0;
BA_ "GenSigTimeoutValue" SG_ 696 KAE_PhoneBatt 0;
BA_ "Remark" SG_ 696 KAE_PhoneBatt "";
BA_ "EventCommandSignal" SG_ 696 KAE_RPACheckReq 0;
BA_ "GatewayedSignals" SG_ 696 KAE_RPACheckReq 0;
BA_ "GenSigInactiveValue" SG_ 696 KAE_RPACheckReq 0;
BA_ "GenSigInvalidValue" SG_ 696 KAE_RPACheckReq 0;
BA_ "GenSigSendType" SG_ 696 KAE_RPACheckReq 1;
BA_ "GenSigStartValue" SG_ 696 KAE_RPACheckReq 0;
BA_ "GenSigTimeoutValue" SG_ 696 KAE_RPACheckReq 0;
BA_ "Remark" SG_ 696 KAE_RPACheckReq "";
BA_ "EventCommandSignal" SG_ 696 KAE_RPAKeyPstSt 0;
BA_ "GatewayedSignals" SG_ 696 KAE_RPAKeyPstSt 0;
BA_ "GenSigInactiveValue" SG_ 696 KAE_RPAKeyPstSt 0;
BA_ "GenSigInvalidValue" SG_ 696 KAE_RPAKeyPstSt 0;
BA_ "GenSigSendType" SG_ 696 KAE_RPAKeyPstSt 1;
BA_ "GenSigStartValue" SG_ 696 KAE_RPAKeyPstSt 0;
BA_ "GenSigTimeoutValue" SG_ 696 KAE_RPAKeyPstSt 0;
BA_ "Remark" SG_ 696 KAE_RPAKeyPstSt "";
BA_ "EventCommandSignal" SG_ 696 KAE_RPADeviceFailReason 0;
BA_ "GatewayedSignals" SG_ 696 KAE_RPADeviceFailReason 0;
BA_ "GenSigInactiveValue" SG_ 696 KAE_RPADeviceFailReason 0;
BA_ "GenSigInvalidValue" SG_ 696 KAE_RPADeviceFailReason 0;
BA_ "GenSigSendType" SG_ 696 KAE_RPADeviceFailReason 1;
BA_ "GenSigStartValue" SG_ 696 KAE_RPADeviceFailReason 0;
BA_ "GenSigTimeoutValue" SG_ 696 KAE_RPADeviceFailReason 0;
BA_ "Remark" SG_ 696 KAE_RPADeviceFailReason "";
BA_ "EventCommandSignal" SG_ 696 KAE_RPABtnSt 0;
BA_ "GatewayedSignals" SG_ 696 KAE_RPABtnSt 0;
BA_ "GenSigInactiveValue" SG_ 696 KAE_RPABtnSt 0;
BA_ "GenSigInvalidValue" SG_ 696 KAE_RPABtnSt 0;
BA_ "GenSigSendType" SG_ 696 KAE_RPABtnSt 1;
BA_ "GenSigStartValue" SG_ 696 KAE_RPABtnSt 0;
BA_ "GenSigTimeoutValue" SG_ 696 KAE_RPABtnSt 0;
BA_ "Remark" SG_ 696 KAE_RPABtnSt "";
BA_ "EventCommandSignal" SG_ 696 KAE_ForRPAFailReason 0;
BA_ "GatewayedSignals" SG_ 696 KAE_ForRPAFailReason 0;
BA_ "GenSigInactiveValue" SG_ 696 KAE_ForRPAFailReason 0;
BA_ "GenSigInvalidValue" SG_ 696 KAE_ForRPAFailReason 0;
BA_ "GenSigSendType" SG_ 696 KAE_ForRPAFailReason 1;
BA_ "GenSigStartValue" SG_ 696 KAE_ForRPAFailReason 0;
BA_ "GenSigTimeoutValue" SG_ 696 KAE_ForRPAFailReason 0;
BA_ "Remark" SG_ 696 KAE_ForRPAFailReason "";
BA_ "EventCommandSignal" SG_ 696 KAE_RPABtnStVD 0;
BA_ "GatewayedSignals" SG_ 696 KAE_RPABtnStVD 0;
BA_ "GenSigInactiveValue" SG_ 696 KAE_RPABtnStVD 0;
BA_ "GenSigInvalidValue" SG_ 696 KAE_RPABtnStVD 0;
BA_ "GenSigSendType" SG_ 696 KAE_RPABtnStVD 1;
BA_ "GenSigStartValue" SG_ 696 KAE_RPABtnStVD 0;
BA_ "GenSigTimeoutValue" SG_ 696 KAE_RPABtnStVD 0;
BA_ "Remark" SG_ 696 KAE_RPABtnStVD "";
BA_ "EventCommandSignal" SG_ 696 KAE_RPACancelBtnSt 0;
BA_ "GatewayedSignals" SG_ 696 KAE_RPACancelBtnSt 0;
BA_ "GenSigInactiveValue" SG_ 696 KAE_RPACancelBtnSt 0;
BA_ "GenSigInvalidValue" SG_ 696 KAE_RPACancelBtnSt 0;
BA_ "GenSigSendType" SG_ 696 KAE_RPACancelBtnSt 1;
BA_ "GenSigStartValue" SG_ 696 KAE_RPACancelBtnSt 0;
BA_ "GenSigTimeoutValue" SG_ 696 KAE_RPACancelBtnSt 0;
BA_ "Remark" SG_ 696 KAE_RPACancelBtnSt "";
BA_ "EventCommandSignal" SG_ 696 KAE_RPACancelBtnStVD 0;
BA_ "GatewayedSignals" SG_ 696 KAE_RPACancelBtnStVD 0;
BA_ "GenSigInactiveValue" SG_ 696 KAE_RPACancelBtnStVD 0;
BA_ "GenSigInvalidValue" SG_ 696 KAE_RPACancelBtnStVD 0;
BA_ "GenSigSendType" SG_ 696 KAE_RPACancelBtnStVD 1;
BA_ "GenSigStartValue" SG_ 696 KAE_RPACancelBtnStVD 0;
BA_ "GenSigTimeoutValue" SG_ 696 KAE_RPACancelBtnStVD 0;
BA_ "Remark" SG_ 696 KAE_RPACancelBtnStVD "";
BA_ "EventCommandSignal" SG_ 696 KAE_ComSDKUBouncesSt 0;
BA_ "GatewayedSignals" SG_ 696 KAE_ComSDKUBouncesSt 0;
BA_ "GenSigInactiveValue" SG_ 696 KAE_ComSDKUBouncesSt 0;
BA_ "GenSigInvalidValue" SG_ 696 KAE_ComSDKUBouncesSt 0;
BA_ "GenSigSendType" SG_ 696 KAE_ComSDKUBouncesSt 1;
BA_ "GenSigStartValue" SG_ 696 KAE_ComSDKUBouncesSt 0;
BA_ "GenSigTimeoutValue" SG_ 696 KAE_ComSDKUBouncesSt 0;
BA_ "Remark" SG_ 696 KAE_ComSDKUBouncesSt "";
BA_ "EventCommandSignal" SG_ 696 KAE_HAVPCancelParking 0;
BA_ "GatewayedSignals" SG_ 696 KAE_HAVPCancelParking 0;
BA_ "GenSigInactiveValue" SG_ 696 KAE_HAVPCancelParking 0;
BA_ "GenSigInvalidValue" SG_ 696 KAE_HAVPCancelParking 0;
BA_ "GenSigSendType" SG_ 696 KAE_HAVPCancelParking 1;
BA_ "GenSigStartValue" SG_ 696 KAE_HAVPCancelParking 0;
BA_ "GenSigTimeoutValue" SG_ 696 KAE_HAVPCancelParking 0;
BA_ "Remark" SG_ 696 KAE_HAVPCancelParking "";
BA_ "EventCommandSignal" SG_ 696 KAE_HAVPDisclaimerAgree 0;
BA_ "GatewayedSignals" SG_ 696 KAE_HAVPDisclaimerAgree 0;
BA_ "GenSigInactiveValue" SG_ 696 KAE_HAVPDisclaimerAgree 0;
BA_ "GenSigInvalidValue" SG_ 696 KAE_HAVPDisclaimerAgree 0;
BA_ "GenSigSendType" SG_ 696 KAE_HAVPDisclaimerAgree 1;
BA_ "GenSigStartValue" SG_ 696 KAE_HAVPDisclaimerAgree 0;
BA_ "GenSigTimeoutValue" SG_ 696 KAE_HAVPDisclaimerAgree 0;
BA_ "Remark" SG_ 696 KAE_HAVPDisclaimerAgree "";
BA_ "EventCommandSignal" SG_ 696 KAE_HAVPPathSelect 0;
BA_ "GatewayedSignals" SG_ 696 KAE_HAVPPathSelect 0;
BA_ "GenSigInactiveValue" SG_ 696 KAE_HAVPPathSelect 0;
BA_ "GenSigInvalidValue" SG_ 696 KAE_HAVPPathSelect 0;
BA_ "GenSigSendType" SG_ 696 KAE_HAVPPathSelect 1;
BA_ "GenSigStartValue" SG_ 696 KAE_HAVPPathSelect 0;
BA_ "GenSigTimeoutValue" SG_ 696 KAE_HAVPPathSelect 0;
BA_ "Remark" SG_ 696 KAE_HAVPPathSelect "";
BA_ "EventCommandSignal" SG_ 696 KAE_RPAResponse 0;
BA_ "GatewayedSignals" SG_ 696 KAE_RPAResponse 0;
BA_ "GenSigInactiveValue" SG_ 696 KAE_RPAResponse 0;
BA_ "GenSigInvalidValue" SG_ 696 KAE_RPAResponse 0;
BA_ "GenSigSendType" SG_ 696 KAE_RPAResponse 1;
BA_ "GenSigStartValue" SG_ 696 KAE_RPAResponse 0;
BA_ "GenSigTimeoutValue" SG_ 696 KAE_RPAResponse 0;
BA_ "Remark" SG_ 696 KAE_RPAResponse "";
BA_ "EventCommandSignal" SG_ 696 KAE_HAVPUWBZone 0;
BA_ "GatewayedSignals" SG_ 696 KAE_HAVPUWBZone 0;
BA_ "GenSigInactiveValue" SG_ 696 KAE_HAVPUWBZone 0;
BA_ "GenSigInvalidValue" SG_ 696 KAE_HAVPUWBZone 0;
BA_ "GenSigSendType" SG_ 696 KAE_HAVPUWBZone 1;
BA_ "GenSigStartValue" SG_ 696 KAE_HAVPUWBZone 0;
BA_ "GenSigTimeoutValue" SG_ 696 KAE_HAVPUWBZone 0;
BA_ "Remark" SG_ 696 KAE_HAVPUWBZone "";
BA_ "EventCommandSignal" SG_ 696 KAE_HAVPUWBXPosition 0;
BA_ "GatewayedSignals" SG_ 696 KAE_HAVPUWBXPosition 0;
BA_ "GenSigInactiveValue" SG_ 696 KAE_HAVPUWBXPosition 0;
BA_ "GenSigInvalidValue" SG_ 696 KAE_HAVPUWBXPosition 0;
BA_ "GenSigSendType" SG_ 696 KAE_HAVPUWBXPosition 1;
BA_ "GenSigStartValue" SG_ 696 KAE_HAVPUWBXPosition 0;
BA_ "GenSigTimeoutValue" SG_ 696 KAE_HAVPUWBXPosition 0;
BA_ "Remark" SG_ 696 KAE_HAVPUWBXPosition "";
BA_ "EventCommandSignal" SG_ 696 KAE_HAVPUWBYPosition 0;
BA_ "GatewayedSignals" SG_ 696 KAE_HAVPUWBYPosition 0;
BA_ "GenSigInactiveValue" SG_ 696 KAE_HAVPUWBYPosition 0;
BA_ "GenSigInvalidValue" SG_ 696 KAE_HAVPUWBYPosition 0;
BA_ "GenSigSendType" SG_ 696 KAE_HAVPUWBYPosition 1;
BA_ "GenSigStartValue" SG_ 696 KAE_HAVPUWBYPosition 0;
BA_ "GenSigTimeoutValue" SG_ 696 KAE_HAVPUWBYPosition 0;
BA_ "Remark" SG_ 696 KAE_HAVPUWBYPosition "";
BA_ "EventCommandSignal" SG_ 696 KAE_UnlockDoorReq 0;
BA_ "GatewayedSignals" SG_ 696 KAE_UnlockDoorReq 0;
BA_ "GenSigInactiveValue" SG_ 696 KAE_UnlockDoorReq 0;
BA_ "GenSigInvalidValue" SG_ 696 KAE_UnlockDoorReq 0;
BA_ "GenSigSendType" SG_ 696 KAE_UnlockDoorReq 1;
BA_ "GenSigStartValue" SG_ 696 KAE_UnlockDoorReq 0;
BA_ "GenSigTimeoutValue" SG_ 696 KAE_UnlockDoorReq 0;
BA_ "Remark" SG_ 696 KAE_UnlockDoorReq "";
BA_ "EventCommandSignal" SG_ 696 KAE_UnlockDoorReqVD 0;
BA_ "GatewayedSignals" SG_ 696 KAE_UnlockDoorReqVD 0;
BA_ "GenSigInactiveValue" SG_ 696 KAE_UnlockDoorReqVD 0;
BA_ "GenSigInvalidValue" SG_ 696 KAE_UnlockDoorReqVD 0;
BA_ "GenSigSendType" SG_ 696 KAE_UnlockDoorReqVD 1;
BA_ "GenSigStartValue" SG_ 696 KAE_UnlockDoorReqVD 0;
BA_ "GenSigTimeoutValue" SG_ 696 KAE_UnlockDoorReqVD 0;
BA_ "Remark" SG_ 696 KAE_UnlockDoorReqVD "";
BA_ "EventCommandSignal" SG_ 696 KAE_LockDoorReq 0;
BA_ "GatewayedSignals" SG_ 696 KAE_LockDoorReq 0;
BA_ "GenSigInactiveValue" SG_ 696 KAE_LockDoorReq 0;
BA_ "GenSigInvalidValue" SG_ 696 KAE_LockDoorReq 0;
BA_ "GenSigSendType" SG_ 696 KAE_LockDoorReq 1;
BA_ "GenSigStartValue" SG_ 696 KAE_LockDoorReq 0;
BA_ "GenSigTimeoutValue" SG_ 696 KAE_LockDoorReq 0;
BA_ "Remark" SG_ 696 KAE_LockDoorReq "";
BA_ "EventCommandSignal" SG_ 696 KAE_LockDoorReqVD 0;
BA_ "GatewayedSignals" SG_ 696 KAE_LockDoorReqVD 0;
BA_ "GenSigInactiveValue" SG_ 696 KAE_LockDoorReqVD 0;
BA_ "GenSigInvalidValue" SG_ 696 KAE_LockDoorReqVD 0;
BA_ "GenSigSendType" SG_ 696 KAE_LockDoorReqVD 1;
BA_ "GenSigStartValue" SG_ 696 KAE_LockDoorReqVD 0;
BA_ "GenSigTimeoutValue" SG_ 696 KAE_LockDoorReqVD 0;
BA_ "Remark" SG_ 696 KAE_LockDoorReqVD "";
BA_ "EventCommandSignal" SG_ 696 KAE_WindowsCloseReq 0;
BA_ "GatewayedSignals" SG_ 696 KAE_WindowsCloseReq 0;
BA_ "GenSigInactiveValue" SG_ 696 KAE_WindowsCloseReq 0;
BA_ "GenSigInvalidValue" SG_ 696 KAE_WindowsCloseReq 0;
BA_ "GenSigSendType" SG_ 696 KAE_WindowsCloseReq 1;
BA_ "GenSigStartValue" SG_ 696 KAE_WindowsCloseReq 0;
BA_ "GenSigTimeoutValue" SG_ 696 KAE_WindowsCloseReq 0;
BA_ "Remark" SG_ 696 KAE_WindowsCloseReq "";
BA_ "EventCommandSignal" SG_ 696 KAE_WindowsCloseReqVD 0;
BA_ "GatewayedSignals" SG_ 696 KAE_WindowsCloseReqVD 0;
BA_ "GenSigInactiveValue" SG_ 696 KAE_WindowsCloseReqVD 0;
BA_ "GenSigInvalidValue" SG_ 696 KAE_WindowsCloseReqVD 0;
BA_ "GenSigSendType" SG_ 696 KAE_WindowsCloseReqVD 1;
BA_ "GenSigStartValue" SG_ 696 KAE_WindowsCloseReqVD 0;
BA_ "GenSigTimeoutValue" SG_ 696 KAE_WindowsCloseReqVD 0;
BA_ "Remark" SG_ 696 KAE_WindowsCloseReqVD "";
BA_ "EventCommandSignal" SG_ 696 KAE_WindowsOpenReq 0;
BA_ "GatewayedSignals" SG_ 696 KAE_WindowsOpenReq 0;
BA_ "GenSigInactiveValue" SG_ 696 KAE_WindowsOpenReq 0;
BA_ "GenSigInvalidValue" SG_ 696 KAE_WindowsOpenReq 0;
BA_ "GenSigSendType" SG_ 696 KAE_WindowsOpenReq 1;
BA_ "GenSigStartValue" SG_ 696 KAE_WindowsOpenReq 0;
BA_ "GenSigTimeoutValue" SG_ 696 KAE_WindowsOpenReq 0;
BA_ "Remark" SG_ 696 KAE_WindowsOpenReq "";
BA_ "EventCommandSignal" SG_ 696 KAE_WindowsOpenReqVD 0;
BA_ "GatewayedSignals" SG_ 696 KAE_WindowsOpenReqVD 0;
BA_ "GenSigInactiveValue" SG_ 696 KAE_WindowsOpenReqVD 0;
BA_ "GenSigInvalidValue" SG_ 696 KAE_WindowsOpenReqVD 0;
BA_ "GenSigSendType" SG_ 696 KAE_WindowsOpenReqVD 1;
BA_ "GenSigStartValue" SG_ 696 KAE_WindowsOpenReqVD 0;
BA_ "GenSigTimeoutValue" SG_ 696 KAE_WindowsOpenReqVD 0;
BA_ "Remark" SG_ 696 KAE_WindowsOpenReqVD "";
BA_ "EventCommandSignal" SG_ 696 KAE_TrunkUnlockReq 0;
BA_ "GatewayedSignals" SG_ 696 KAE_TrunkUnlockReq 0;
BA_ "GenSigInactiveValue" SG_ 696 KAE_TrunkUnlockReq 0;
BA_ "GenSigInvalidValue" SG_ 696 KAE_TrunkUnlockReq 0;
BA_ "GenSigSendType" SG_ 696 KAE_TrunkUnlockReq 1;
BA_ "GenSigStartValue" SG_ 696 KAE_TrunkUnlockReq 0;
BA_ "GenSigTimeoutValue" SG_ 696 KAE_TrunkUnlockReq 0;
BA_ "Remark" SG_ 696 KAE_TrunkUnlockReq "";
BA_ "EventCommandSignal" SG_ 696 KAE_TrunkUnlockReqVD 0;
BA_ "GatewayedSignals" SG_ 696 KAE_TrunkUnlockReqVD 0;
BA_ "GenSigInactiveValue" SG_ 696 KAE_TrunkUnlockReqVD 0;
BA_ "GenSigInvalidValue" SG_ 696 KAE_TrunkUnlockReqVD 0;
BA_ "GenSigSendType" SG_ 696 KAE_TrunkUnlockReqVD 1;
BA_ "GenSigStartValue" SG_ 696 KAE_TrunkUnlockReqVD 0;
BA_ "GenSigTimeoutValue" SG_ 696 KAE_TrunkUnlockReqVD 0;
BA_ "Remark" SG_ 696 KAE_TrunkUnlockReqVD "";
BA_ "EventCommandSignal" SG_ 696 KAE_HoodUnlockReq 0;
BA_ "GatewayedSignals" SG_ 696 KAE_HoodUnlockReq 0;
BA_ "GenSigInactiveValue" SG_ 696 KAE_HoodUnlockReq 0;
BA_ "GenSigInvalidValue" SG_ 696 KAE_HoodUnlockReq 0;
BA_ "GenSigSendType" SG_ 696 KAE_HoodUnlockReq 1;
BA_ "GenSigStartValue" SG_ 696 KAE_HoodUnlockReq 0;
BA_ "GenSigTimeoutValue" SG_ 696 KAE_HoodUnlockReq 0;
BA_ "Remark" SG_ 696 KAE_HoodUnlockReq "";
BA_ "EventCommandSignal" SG_ 696 KAE_HoodUnlockReqVD 0;
BA_ "GatewayedSignals" SG_ 696 KAE_HoodUnlockReqVD 0;
BA_ "GenSigInactiveValue" SG_ 696 KAE_HoodUnlockReqVD 0;
BA_ "GenSigInvalidValue" SG_ 696 KAE_HoodUnlockReqVD 0;
BA_ "GenSigSendType" SG_ 696 KAE_HoodUnlockReqVD 1;
BA_ "GenSigStartValue" SG_ 696 KAE_HoodUnlockReqVD 0;
BA_ "GenSigTimeoutValue" SG_ 696 KAE_HoodUnlockReqVD 0;
BA_ "Remark" SG_ 696 KAE_HoodUnlockReqVD "";
BA_ "EventCommandSignal" SG_ 696 KAE_PLGMOpenReq 0;
BA_ "GatewayedSignals" SG_ 696 KAE_PLGMOpenReq 0;
BA_ "GenSigInactiveValue" SG_ 696 KAE_PLGMOpenReq 0;
BA_ "GenSigInvalidValue" SG_ 696 KAE_PLGMOpenReq 0;
BA_ "GenSigSendType" SG_ 696 KAE_PLGMOpenReq 1;
BA_ "GenSigStartValue" SG_ 696 KAE_PLGMOpenReq 0;
BA_ "GenSigTimeoutValue" SG_ 696 KAE_PLGMOpenReq 0;
BA_ "Remark" SG_ 696 KAE_PLGMOpenReq "";
BA_ "EventCommandSignal" SG_ 696 KAE_PLGMOpenReqVD 0;
BA_ "GatewayedSignals" SG_ 696 KAE_PLGMOpenReqVD 0;
BA_ "GenSigInactiveValue" SG_ 696 KAE_PLGMOpenReqVD 0;
BA_ "GenSigInvalidValue" SG_ 696 KAE_PLGMOpenReqVD 0;
BA_ "GenSigSendType" SG_ 696 KAE_PLGMOpenReqVD 1;
BA_ "GenSigStartValue" SG_ 696 KAE_PLGMOpenReqVD 0;
BA_ "GenSigTimeoutValue" SG_ 696 KAE_PLGMOpenReqVD 0;
BA_ "Remark" SG_ 696 KAE_PLGMOpenReqVD "";
BA_ "EventCommandSignal" SG_ 696 KAE_PLGMCloseReq 0;
BA_ "GatewayedSignals" SG_ 696 KAE_PLGMCloseReq 0;
BA_ "GenSigInactiveValue" SG_ 696 KAE_PLGMCloseReq 0;
BA_ "GenSigInvalidValue" SG_ 696 KAE_PLGMCloseReq 0;
BA_ "GenSigSendType" SG_ 696 KAE_PLGMCloseReq 1;
BA_ "GenSigStartValue" SG_ 696 KAE_PLGMCloseReq 0;
BA_ "GenSigTimeoutValue" SG_ 696 KAE_PLGMCloseReq 0;
BA_ "Remark" SG_ 696 KAE_PLGMCloseReq "";
BA_ "EventCommandSignal" SG_ 696 KAE_PLGMCloseReqVD 0;
BA_ "GatewayedSignals" SG_ 696 KAE_PLGMCloseReqVD 0;
BA_ "GenSigInactiveValue" SG_ 696 KAE_PLGMCloseReqVD 0;
BA_ "GenSigInvalidValue" SG_ 696 KAE_PLGMCloseReqVD 0;
BA_ "GenSigSendType" SG_ 696 KAE_PLGMCloseReqVD 1;
BA_ "GenSigStartValue" SG_ 696 KAE_PLGMCloseReqVD 0;
BA_ "GenSigTimeoutValue" SG_ 696 KAE_PLGMCloseReqVD 0;
BA_ "Remark" SG_ 696 KAE_PLGMCloseReqVD "";
BA_ "EventCommandSignal" SG_ 696 KAE_SunRoofOpenReq 0;
BA_ "GatewayedSignals" SG_ 696 KAE_SunRoofOpenReq 0;
BA_ "GenSigInactiveValue" SG_ 696 KAE_SunRoofOpenReq 0;
BA_ "GenSigInvalidValue" SG_ 696 KAE_SunRoofOpenReq 0;
BA_ "GenSigSendType" SG_ 696 KAE_SunRoofOpenReq 1;
BA_ "GenSigStartValue" SG_ 696 KAE_SunRoofOpenReq 0;
BA_ "GenSigTimeoutValue" SG_ 696 KAE_SunRoofOpenReq 0;
BA_ "Remark" SG_ 696 KAE_SunRoofOpenReq "";
BA_ "EventCommandSignal" SG_ 696 KAE_SunRoofOpenReqVD 0;
BA_ "GatewayedSignals" SG_ 696 KAE_SunRoofOpenReqVD 0;
BA_ "GenSigInactiveValue" SG_ 696 KAE_SunRoofOpenReqVD 0;
BA_ "GenSigInvalidValue" SG_ 696 KAE_SunRoofOpenReqVD 0;
BA_ "GenSigSendType" SG_ 696 KAE_SunRoofOpenReqVD 1;
BA_ "GenSigStartValue" SG_ 696 KAE_SunRoofOpenReqVD 0;
BA_ "GenSigTimeoutValue" SG_ 696 KAE_SunRoofOpenReqVD 0;
BA_ "Remark" SG_ 696 KAE_SunRoofOpenReqVD "";
BA_ "EventCommandSignal" SG_ 696 KAE_SunRoofCloseReq 0;
BA_ "GatewayedSignals" SG_ 696 KAE_SunRoofCloseReq 0;
BA_ "GenSigInactiveValue" SG_ 696 KAE_SunRoofCloseReq 0;
BA_ "GenSigInvalidValue" SG_ 696 KAE_SunRoofCloseReq 0;
BA_ "GenSigSendType" SG_ 696 KAE_SunRoofCloseReq 1;
BA_ "GenSigStartValue" SG_ 696 KAE_SunRoofCloseReq 0;
BA_ "GenSigTimeoutValue" SG_ 696 KAE_SunRoofCloseReq 0;
BA_ "Remark" SG_ 696 KAE_SunRoofCloseReq "";
BA_ "EventCommandSignal" SG_ 696 KAE_SunRoofCloseReqVD 0;
BA_ "GatewayedSignals" SG_ 696 KAE_SunRoofCloseReqVD 0;
BA_ "GenSigInactiveValue" SG_ 696 KAE_SunRoofCloseReqVD 0;
BA_ "GenSigInvalidValue" SG_ 696 KAE_SunRoofCloseReqVD 0;
BA_ "GenSigSendType" SG_ 696 KAE_SunRoofCloseReqVD 1;
BA_ "GenSigStartValue" SG_ 696 KAE_SunRoofCloseReqVD 0;
BA_ "GenSigTimeoutValue" SG_ 696 KAE_SunRoofCloseReqVD 0;
BA_ "Remark" SG_ 696 KAE_SunRoofCloseReqVD "";
BA_ "EventCommandSignal" SG_ 696 KAE_AllCloseReq 0;
BA_ "GatewayedSignals" SG_ 696 KAE_AllCloseReq 0;
BA_ "GenSigInactiveValue" SG_ 696 KAE_AllCloseReq 0;
BA_ "GenSigInvalidValue" SG_ 696 KAE_AllCloseReq 0;
BA_ "GenSigSendType" SG_ 696 KAE_AllCloseReq 1;
BA_ "GenSigStartValue" SG_ 696 KAE_AllCloseReq 0;
BA_ "GenSigTimeoutValue" SG_ 696 KAE_AllCloseReq 0;
BA_ "Remark" SG_ 696 KAE_AllCloseReq "";
BA_ "EventCommandSignal" SG_ 696 KAE_AllCloseReqVd 0;
BA_ "GatewayedSignals" SG_ 696 KAE_AllCloseReqVd 0;
BA_ "GenSigInactiveValue" SG_ 696 KAE_AllCloseReqVd 0;
BA_ "GenSigInvalidValue" SG_ 696 KAE_AllCloseReqVd 0;
BA_ "GenSigSendType" SG_ 696 KAE_AllCloseReqVd 1;
BA_ "GenSigStartValue" SG_ 696 KAE_AllCloseReqVd 0;
BA_ "GenSigTimeoutValue" SG_ 696 KAE_AllCloseReqVd 0;
BA_ "Remark" SG_ 696 KAE_AllCloseReqVd "";
BA_ "EventCommandSignal" SG_ 696 KAE_PAAReq 0;
BA_ "GatewayedSignals" SG_ 696 KAE_PAAReq 0;
BA_ "GenSigInactiveValue" SG_ 696 KAE_PAAReq 0;
BA_ "GenSigInvalidValue" SG_ 696 KAE_PAAReq 0;
BA_ "GenSigSendType" SG_ 696 KAE_PAAReq 1;
BA_ "GenSigStartValue" SG_ 696 KAE_PAAReq 0;
BA_ "GenSigTimeoutValue" SG_ 696 KAE_PAAReq 0;
BA_ "Remark" SG_ 696 KAE_PAAReq "";
BA_ "EventCommandSignal" SG_ 696 KAE_PAAReqVd 0;
BA_ "GatewayedSignals" SG_ 696 KAE_PAAReqVd 0;
BA_ "GenSigInactiveValue" SG_ 696 KAE_PAAReqVd 0;
BA_ "GenSigInvalidValue" SG_ 696 KAE_PAAReqVd 0;
BA_ "GenSigSendType" SG_ 696 KAE_PAAReqVd 1;
BA_ "GenSigStartValue" SG_ 696 KAE_PAAReqVd 0;
BA_ "GenSigTimeoutValue" SG_ 696 KAE_PAAReqVd 0;
BA_ "Remark" SG_ 696 KAE_PAAReqVd "";
BA_ "EventCommandSignal" SG_ 696 KAE_EDK1UnlockBtnSt 0;
BA_ "GatewayedSignals" SG_ 696 KAE_EDK1UnlockBtnSt 0;
BA_ "GenSigInactiveValue" SG_ 696 KAE_EDK1UnlockBtnSt 0;
BA_ "GenSigInvalidValue" SG_ 696 KAE_EDK1UnlockBtnSt 0;
BA_ "GenSigSendType" SG_ 696 KAE_EDK1UnlockBtnSt 1;
BA_ "GenSigStartValue" SG_ 696 KAE_EDK1UnlockBtnSt 0;
BA_ "GenSigTimeoutValue" SG_ 696 KAE_EDK1UnlockBtnSt 0;
BA_ "Remark" SG_ 696 KAE_EDK1UnlockBtnSt "";
BA_ "EventCommandSignal" SG_ 696 KAE_EDK1LockBtnSt 0;
BA_ "GatewayedSignals" SG_ 696 KAE_EDK1LockBtnSt 0;
BA_ "GenSigInactiveValue" SG_ 696 KAE_EDK1LockBtnSt 0;
BA_ "GenSigInvalidValue" SG_ 696 KAE_EDK1LockBtnSt 0;
BA_ "GenSigSendType" SG_ 696 KAE_EDK1LockBtnSt 1;
BA_ "GenSigStartValue" SG_ 696 KAE_EDK1LockBtnSt 0;
BA_ "GenSigTimeoutValue" SG_ 696 KAE_EDK1LockBtnSt 0;
BA_ "Remark" SG_ 696 KAE_EDK1LockBtnSt "";
BA_ "EventCommandSignal" SG_ 696 KAE_EDK1RESBtnSt 0;
BA_ "GatewayedSignals" SG_ 696 KAE_EDK1RESBtnSt 0;
BA_ "GenSigInactiveValue" SG_ 696 KAE_EDK1RESBtnSt 0;
BA_ "GenSigInvalidValue" SG_ 696 KAE_EDK1RESBtnSt 0;
BA_ "GenSigSendType" SG_ 696 KAE_EDK1RESBtnSt 1;
BA_ "GenSigStartValue" SG_ 696 KAE_EDK1RESBtnSt 0;
BA_ "GenSigTimeoutValue" SG_ 696 KAE_EDK1RESBtnSt 0;
BA_ "Remark" SG_ 696 KAE_EDK1RESBtnSt "";
BA_ "EventCommandSignal" SG_ 696 KAE_EDK1PSD_LBtnSt 0;
BA_ "GatewayedSignals" SG_ 696 KAE_EDK1PSD_LBtnSt 0;
BA_ "GenSigInactiveValue" SG_ 696 KAE_EDK1PSD_LBtnSt 0;
BA_ "GenSigInvalidValue" SG_ 696 KAE_EDK1PSD_LBtnSt 0;
BA_ "GenSigSendType" SG_ 696 KAE_EDK1PSD_LBtnSt 1;
BA_ "GenSigStartValue" SG_ 696 KAE_EDK1PSD_LBtnSt 0;
BA_ "GenSigTimeoutValue" SG_ 696 KAE_EDK1PSD_LBtnSt 0;
BA_ "Remark" SG_ 696 KAE_EDK1PSD_LBtnSt "";
BA_ "EventCommandSignal" SG_ 696 KAE_EDK1PSD_RBtnSt 0;
BA_ "GatewayedSignals" SG_ 696 KAE_EDK1PSD_RBtnSt 0;
BA_ "GenSigInactiveValue" SG_ 696 KAE_EDK1PSD_RBtnSt 0;
BA_ "GenSigInvalidValue" SG_ 696 KAE_EDK1PSD_RBtnSt 0;
BA_ "GenSigSendType" SG_ 696 KAE_EDK1PSD_RBtnSt 1;
BA_ "GenSigStartValue" SG_ 696 KAE_EDK1PSD_RBtnSt 0;
BA_ "GenSigTimeoutValue" SG_ 696 KAE_EDK1PSD_RBtnSt 0;
BA_ "Remark" SG_ 696 KAE_EDK1PSD_RBtnSt "";
BA_ "EventCommandSignal" SG_ 696 KAE_EDK1TrunkBtnSt 0;
BA_ "GatewayedSignals" SG_ 696 KAE_EDK1TrunkBtnSt 0;
BA_ "GenSigInactiveValue" SG_ 696 KAE_EDK1TrunkBtnSt 0;
BA_ "GenSigInvalidValue" SG_ 696 KAE_EDK1TrunkBtnSt 0;
BA_ "GenSigSendType" SG_ 696 KAE_EDK1TrunkBtnSt 1;
BA_ "GenSigStartValue" SG_ 696 KAE_EDK1TrunkBtnSt 0;
BA_ "GenSigTimeoutValue" SG_ 696 KAE_EDK1TrunkBtnSt 0;
BA_ "Remark" SG_ 696 KAE_EDK1TrunkBtnSt "";
BA_ "EventCommandSignal" SG_ 696 KAE_EDK1PanicBtnSt 0;
BA_ "GatewayedSignals" SG_ 696 KAE_EDK1PanicBtnSt 0;
BA_ "GenSigInactiveValue" SG_ 696 KAE_EDK1PanicBtnSt 0;
BA_ "GenSigInvalidValue" SG_ 696 KAE_EDK1PanicBtnSt 0;
BA_ "GenSigSendType" SG_ 696 KAE_EDK1PanicBtnSt 1;
BA_ "GenSigStartValue" SG_ 696 KAE_EDK1PanicBtnSt 0;
BA_ "GenSigTimeoutValue" SG_ 696 KAE_EDK1PanicBtnSt 0;
BA_ "Remark" SG_ 696 KAE_EDK1PanicBtnSt "";
BA_ "EventCommandSignal" SG_ 696 KAE_EDK1User_definedBtnSt 0;
BA_ "GatewayedSignals" SG_ 696 KAE_EDK1User_definedBtnSt 0;
BA_ "GenSigInactiveValue" SG_ 696 KAE_EDK1User_definedBtnSt 0;
BA_ "GenSigInvalidValue" SG_ 696 KAE_EDK1User_definedBtnSt 0;
BA_ "GenSigSendType" SG_ 696 KAE_EDK1User_definedBtnSt 1;
BA_ "GenSigStartValue" SG_ 696 KAE_EDK1User_definedBtnSt 0;
BA_ "GenSigTimeoutValue" SG_ 696 KAE_EDK1User_definedBtnSt 0;
BA_ "Remark" SG_ 696 KAE_EDK1User_definedBtnSt "";
BA_ "EventCommandSignal" SG_ 696 KAE_EDK2UnlockBtnSt 0;
BA_ "GatewayedSignals" SG_ 696 KAE_EDK2UnlockBtnSt 0;
BA_ "GenSigInactiveValue" SG_ 696 KAE_EDK2UnlockBtnSt 0;
BA_ "GenSigInvalidValue" SG_ 696 KAE_EDK2UnlockBtnSt 0;
BA_ "GenSigSendType" SG_ 696 KAE_EDK2UnlockBtnSt 1;
BA_ "GenSigStartValue" SG_ 696 KAE_EDK2UnlockBtnSt 0;
BA_ "GenSigTimeoutValue" SG_ 696 KAE_EDK2UnlockBtnSt 0;
BA_ "Remark" SG_ 696 KAE_EDK2UnlockBtnSt "";
BA_ "EventCommandSignal" SG_ 696 KAE_EDK2LockBtnSt 0;
BA_ "GatewayedSignals" SG_ 696 KAE_EDK2LockBtnSt 0;
BA_ "GenSigInactiveValue" SG_ 696 KAE_EDK2LockBtnSt 0;
BA_ "GenSigInvalidValue" SG_ 696 KAE_EDK2LockBtnSt 0;
BA_ "GenSigSendType" SG_ 696 KAE_EDK2LockBtnSt 1;
BA_ "GenSigStartValue" SG_ 696 KAE_EDK2LockBtnSt 0;
BA_ "GenSigTimeoutValue" SG_ 696 KAE_EDK2LockBtnSt 0;
BA_ "Remark" SG_ 696 KAE_EDK2LockBtnSt "";
BA_ "EventCommandSignal" SG_ 696 KAE_EDK2RESBtnSt 0;
BA_ "GatewayedSignals" SG_ 696 KAE_EDK2RESBtnSt 0;
BA_ "GenSigInactiveValue" SG_ 696 KAE_EDK2RESBtnSt 0;
BA_ "GenSigInvalidValue" SG_ 696 KAE_EDK2RESBtnSt 0;
BA_ "GenSigSendType" SG_ 696 KAE_EDK2RESBtnSt 1;
BA_ "GenSigStartValue" SG_ 696 KAE_EDK2RESBtnSt 0;
BA_ "GenSigTimeoutValue" SG_ 696 KAE_EDK2RESBtnSt 0;
BA_ "Remark" SG_ 696 KAE_EDK2RESBtnSt "";
BA_ "EventCommandSignal" SG_ 696 KAE_EDK2PSD_LBtnSt 0;
BA_ "GatewayedSignals" SG_ 696 KAE_EDK2PSD_LBtnSt 0;
BA_ "GenSigInactiveValue" SG_ 696 KAE_EDK2PSD_LBtnSt 0;
BA_ "GenSigInvalidValue" SG_ 696 KAE_EDK2PSD_LBtnSt 0;
BA_ "GenSigSendType" SG_ 696 KAE_EDK2PSD_LBtnSt 1;
BA_ "GenSigStartValue" SG_ 696 KAE_EDK2PSD_LBtnSt 0;
BA_ "GenSigTimeoutValue" SG_ 696 KAE_EDK2PSD_LBtnSt 0;
BA_ "Remark" SG_ 696 KAE_EDK2PSD_LBtnSt "";
BA_ "EventCommandSignal" SG_ 696 KAE_EDK2PSD_RBtnSt 0;
BA_ "GatewayedSignals" SG_ 696 KAE_EDK2PSD_RBtnSt 0;
BA_ "GenSigInactiveValue" SG_ 696 KAE_EDK2PSD_RBtnSt 0;
BA_ "GenSigInvalidValue" SG_ 696 KAE_EDK2PSD_RBtnSt 0;
BA_ "GenSigSendType" SG_ 696 KAE_EDK2PSD_RBtnSt 1;
BA_ "GenSigStartValue" SG_ 696 KAE_EDK2PSD_RBtnSt 0;
BA_ "GenSigTimeoutValue" SG_ 696 KAE_EDK2PSD_RBtnSt 0;
BA_ "Remark" SG_ 696 KAE_EDK2PSD_RBtnSt "";
BA_ "EventCommandSignal" SG_ 696 KAE_EDK2TrunkBtnSt 0;
BA_ "GatewayedSignals" SG_ 696 KAE_EDK2TrunkBtnSt 0;
BA_ "GenSigInactiveValue" SG_ 696 KAE_EDK2TrunkBtnSt 0;
BA_ "GenSigInvalidValue" SG_ 696 KAE_EDK2TrunkBtnSt 0;
BA_ "GenSigSendType" SG_ 696 KAE_EDK2TrunkBtnSt 1;
BA_ "GenSigStartValue" SG_ 696 KAE_EDK2TrunkBtnSt 0;
BA_ "GenSigTimeoutValue" SG_ 696 KAE_EDK2TrunkBtnSt 0;
BA_ "Remark" SG_ 696 KAE_EDK2TrunkBtnSt "";
BA_ "EventCommandSignal" SG_ 696 KAE_EDK2PanicBtnSt 0;
BA_ "GatewayedSignals" SG_ 696 KAE_EDK2PanicBtnSt 0;
BA_ "GenSigInactiveValue" SG_ 696 KAE_EDK2PanicBtnSt 0;
BA_ "GenSigInvalidValue" SG_ 696 KAE_EDK2PanicBtnSt 0;
BA_ "GenSigSendType" SG_ 696 KAE_EDK2PanicBtnSt 1;
BA_ "GenSigStartValue" SG_ 696 KAE_EDK2PanicBtnSt 0;
BA_ "GenSigTimeoutValue" SG_ 696 KAE_EDK2PanicBtnSt 0;
BA_ "Remark" SG_ 696 KAE_EDK2PanicBtnSt "";
BA_ "EventCommandSignal" SG_ 696 KAE_EDK2User_definedBtnSt 0;
BA_ "GatewayedSignals" SG_ 696 KAE_EDK2User_definedBtnSt 0;
BA_ "GenSigInactiveValue" SG_ 696 KAE_EDK2User_definedBtnSt 0;
BA_ "GenSigInvalidValue" SG_ 696 KAE_EDK2User_definedBtnSt 0;
BA_ "GenSigSendType" SG_ 696 KAE_EDK2User_definedBtnSt 1;
BA_ "GenSigStartValue" SG_ 696 KAE_EDK2User_definedBtnSt 0;
BA_ "GenSigTimeoutValue" SG_ 696 KAE_EDK2User_definedBtnSt 0;
BA_ "Remark" SG_ 696 KAE_EDK2User_definedBtnSt "";
BA_ "EventCommandSignal" SG_ 696 KAE_EDK3UnlockBtnSt 0;
BA_ "GatewayedSignals" SG_ 696 KAE_EDK3UnlockBtnSt 0;
BA_ "GenSigInactiveValue" SG_ 696 KAE_EDK3UnlockBtnSt 0;
BA_ "GenSigInvalidValue" SG_ 696 KAE_EDK3UnlockBtnSt 0;
BA_ "GenSigSendType" SG_ 696 KAE_EDK3UnlockBtnSt 1;
BA_ "GenSigStartValue" SG_ 696 KAE_EDK3UnlockBtnSt 0;
BA_ "GenSigTimeoutValue" SG_ 696 KAE_EDK3UnlockBtnSt 0;
BA_ "Remark" SG_ 696 KAE_EDK3UnlockBtnSt "";
BA_ "EventCommandSignal" SG_ 696 KAE_EDK3LockBtnSt 0;
BA_ "GatewayedSignals" SG_ 696 KAE_EDK3LockBtnSt 0;
BA_ "GenSigInactiveValue" SG_ 696 KAE_EDK3LockBtnSt 0;
BA_ "GenSigInvalidValue" SG_ 696 KAE_EDK3LockBtnSt 0;
BA_ "GenSigSendType" SG_ 696 KAE_EDK3LockBtnSt 1;
BA_ "GenSigStartValue" SG_ 696 KAE_EDK3LockBtnSt 0;
BA_ "GenSigTimeoutValue" SG_ 696 KAE_EDK3LockBtnSt 0;
BA_ "Remark" SG_ 696 KAE_EDK3LockBtnSt "";
BA_ "EventCommandSignal" SG_ 696 KAE_EDK3RESBtnSt 0;
BA_ "GatewayedSignals" SG_ 696 KAE_EDK3RESBtnSt 0;
BA_ "GenSigInactiveValue" SG_ 696 KAE_EDK3RESBtnSt 0;
BA_ "GenSigInvalidValue" SG_ 696 KAE_EDK3RESBtnSt 0;
BA_ "GenSigSendType" SG_ 696 KAE_EDK3RESBtnSt 1;
BA_ "GenSigStartValue" SG_ 696 KAE_EDK3RESBtnSt 0;
BA_ "GenSigTimeoutValue" SG_ 696 KAE_EDK3RESBtnSt 0;
BA_ "Remark" SG_ 696 KAE_EDK3RESBtnSt "";
BA_ "EventCommandSignal" SG_ 696 KAE_EDK3PSD_LBtnSt 0;
BA_ "GatewayedSignals" SG_ 696 KAE_EDK3PSD_LBtnSt 0;
BA_ "GenSigInactiveValue" SG_ 696 KAE_EDK3PSD_LBtnSt 0;
BA_ "GenSigInvalidValue" SG_ 696 KAE_EDK3PSD_LBtnSt 0;
BA_ "GenSigSendType" SG_ 696 KAE_EDK3PSD_LBtnSt 1;
BA_ "GenSigStartValue" SG_ 696 KAE_EDK3PSD_LBtnSt 0;
BA_ "GenSigTimeoutValue" SG_ 696 KAE_EDK3PSD_LBtnSt 0;
BA_ "Remark" SG_ 696 KAE_EDK3PSD_LBtnSt "";
BA_ "EventCommandSignal" SG_ 696 KAE_EDK3PSD_RBtnSt 0;
BA_ "GatewayedSignals" SG_ 696 KAE_EDK3PSD_RBtnSt 0;
BA_ "GenSigInactiveValue" SG_ 696 KAE_EDK3PSD_RBtnSt 0;
BA_ "GenSigInvalidValue" SG_ 696 KAE_EDK3PSD_RBtnSt 0;
BA_ "GenSigSendType" SG_ 696 KAE_EDK3PSD_RBtnSt 1;
BA_ "GenSigStartValue" SG_ 696 KAE_EDK3PSD_RBtnSt 0;
BA_ "GenSigTimeoutValue" SG_ 696 KAE_EDK3PSD_RBtnSt 0;
BA_ "Remark" SG_ 696 KAE_EDK3PSD_RBtnSt "";
BA_ "EventCommandSignal" SG_ 696 KAE_EDK3TrunkBtnSt 0;
BA_ "GatewayedSignals" SG_ 696 KAE_EDK3TrunkBtnSt 0;
BA_ "GenSigInactiveValue" SG_ 696 KAE_EDK3TrunkBtnSt 0;
BA_ "GenSigInvalidValue" SG_ 696 KAE_EDK3TrunkBtnSt 0;
BA_ "GenSigSendType" SG_ 696 KAE_EDK3TrunkBtnSt 1;
BA_ "GenSigStartValue" SG_ 696 KAE_EDK3TrunkBtnSt 0;
BA_ "GenSigTimeoutValue" SG_ 696 KAE_EDK3TrunkBtnSt 0;
BA_ "Remark" SG_ 696 KAE_EDK3TrunkBtnSt "";
BA_ "EventCommandSignal" SG_ 696 KAE_EDK3PanicBtnSt 0;
BA_ "GatewayedSignals" SG_ 696 KAE_EDK3PanicBtnSt 0;
BA_ "GenSigInactiveValue" SG_ 696 KAE_EDK3PanicBtnSt 0;
BA_ "GenSigInvalidValue" SG_ 696 KAE_EDK3PanicBtnSt 0;
BA_ "GenSigSendType" SG_ 696 KAE_EDK3PanicBtnSt 1;
BA_ "GenSigStartValue" SG_ 696 KAE_EDK3PanicBtnSt 0;
BA_ "GenSigTimeoutValue" SG_ 696 KAE_EDK3PanicBtnSt 0;
BA_ "Remark" SG_ 696 KAE_EDK3PanicBtnSt "";
BA_ "EventCommandSignal" SG_ 696 KAE_EDK3User_definedBtnSt 0;
BA_ "GatewayedSignals" SG_ 696 KAE_EDK3User_definedBtnSt 0;
BA_ "GenSigInactiveValue" SG_ 696 KAE_EDK3User_definedBtnSt 0;
BA_ "GenSigInvalidValue" SG_ 696 KAE_EDK3User_definedBtnSt 0;
BA_ "GenSigSendType" SG_ 696 KAE_EDK3User_definedBtnSt 1;
BA_ "GenSigStartValue" SG_ 696 KAE_EDK3User_definedBtnSt 0;
BA_ "GenSigTimeoutValue" SG_ 696 KAE_EDK3User_definedBtnSt 0;
BA_ "Remark" SG_ 696 KAE_EDK3User_definedBtnSt "";
BA_ "EventCommandSignal" SG_ 403 ADC_1_CRC 0;
BA_ "GatewayedSignals" SG_ 403 ADC_1_CRC 0;
BA_ "GenSigInactiveValue" SG_ 403 ADC_1_CRC 0;
BA_ "GenSigInvalidValue" SG_ 403 ADC_1_CRC 0;
BA_ "GenSigSendType" SG_ 403 ADC_1_CRC 1;
BA_ "GenSigStartValue" SG_ 403 ADC_1_CRC 0;
BA_ "GenSigTimeoutValue" SG_ 403 ADC_1_CRC 0;
BA_ "Remark" SG_ 403 ADC_1_CRC "";
BA_ "EventCommandSignal" SG_ 403 ADC_1_Counter 0;
BA_ "GatewayedSignals" SG_ 403 ADC_1_Counter 0;
BA_ "GenSigInactiveValue" SG_ 403 ADC_1_Counter 0;
BA_ "GenSigInvalidValue" SG_ 403 ADC_1_Counter 0;
BA_ "GenSigSendType" SG_ 403 ADC_1_Counter 1;
BA_ "GenSigStartValue" SG_ 403 ADC_1_Counter 0;
BA_ "GenSigTimeoutValue" SG_ 403 ADC_1_Counter 0;
BA_ "Remark" SG_ 403 ADC_1_Counter "";
BA_ "EventCommandSignal" SG_ 403 NDA_Type 0;
BA_ "GatewayedSignals" SG_ 403 NDA_Type 0;
BA_ "GenSigInactiveValue" SG_ 403 NDA_Type 0;
BA_ "GenSigInvalidValue" SG_ 403 NDA_Type 0;
BA_ "GenSigSendType" SG_ 403 NDA_Type 1;
BA_ "GenSigStartValue" SG_ 403 NDA_Type 0;
BA_ "GenSigTimeoutValue" SG_ 403 NDA_Type 0;
BA_ "Remark" SG_ 403 NDA_Type "";
BA_ "EventCommandSignal" SG_ 403 ADC_ACCMode 0;
BA_ "GatewayedSignals" SG_ 403 ADC_ACCMode 0;
BA_ "GenSigInactiveValue" SG_ 403 ADC_ACCMode 0;
BA_ "GenSigInvalidValue" SG_ 403 ADC_ACCMode 0;
BA_ "GenSigSendType" SG_ 403 ADC_ACCMode 1;
BA_ "GenSigStartValue" SG_ 403 ADC_ACCMode 1;
BA_ "GenSigTimeoutValue" SG_ 403 ADC_ACCMode 0;
BA_ "Remark" SG_ 403 ADC_ACCMode "";
BA_ "EventCommandSignal" SG_ 403 ADAS_Related_System_Failure_St 0;
BA_ "GatewayedSignals" SG_ 403 ADAS_Related_System_Failure_St 0;
BA_ "GenSigInactiveValue" SG_ 403 ADAS_Related_System_Failure_St 0;
BA_ "GenSigInvalidValue" SG_ 403 ADAS_Related_System_Failure_St 0;
BA_ "GenSigSendType" SG_ 403 ADAS_Related_System_Failure_St 1;
BA_ "GenSigStartValue" SG_ 403 ADAS_Related_System_Failure_St 0;
BA_ "GenSigTimeoutValue" SG_ 403 ADAS_Related_System_Failure_St 0;
BA_ "Remark" SG_ 403 ADAS_Related_System_Failure_St "";
BA_ "EventCommandSignal" SG_ 403 ADC_ISLC_ConfirmSt 0;
BA_ "GatewayedSignals" SG_ 403 ADC_ISLC_ConfirmSt 0;
BA_ "GenSigInactiveValue" SG_ 403 ADC_ISLC_ConfirmSt 0;
BA_ "GenSigInvalidValue" SG_ 403 ADC_ISLC_ConfirmSt 3;
BA_ "GenSigSendType" SG_ 403 ADC_ISLC_ConfirmSt 1;
BA_ "GenSigStartValue" SG_ 403 ADC_ISLC_ConfirmSt 0;
BA_ "GenSigTimeoutValue" SG_ 403 ADC_ISLC_ConfirmSt 0;
BA_ "Remark" SG_ 403 ADC_ISLC_ConfirmSt "";
BA_ "EventCommandSignal" SG_ 403 ADAS_System_Failure_St 0;
BA_ "GatewayedSignals" SG_ 403 ADAS_System_Failure_St 0;
BA_ "GenSigInactiveValue" SG_ 403 ADAS_System_Failure_St 0;
BA_ "GenSigInvalidValue" SG_ 403 ADAS_System_Failure_St 0;
BA_ "GenSigSendType" SG_ 403 ADAS_System_Failure_St 1;
BA_ "GenSigStartValue" SG_ 403 ADAS_System_Failure_St 0;
BA_ "GenSigTimeoutValue" SG_ 403 ADAS_System_Failure_St 0;
BA_ "Remark" SG_ 403 ADAS_System_Failure_St "";
BA_ "EventCommandSignal" SG_ 403 ADC_ACCFailureReason 0;
BA_ "GatewayedSignals" SG_ 403 ADC_ACCFailureReason 0;
BA_ "GenSigInactiveValue" SG_ 403 ADC_ACCFailureReason 0;
BA_ "GenSigInvalidValue" SG_ 403 ADC_ACCFailureReason 0;
BA_ "GenSigSendType" SG_ 403 ADC_ACCFailureReason 1;
BA_ "GenSigStartValue" SG_ 403 ADC_ACCFailureReason 0;
BA_ "GenSigTimeoutValue" SG_ 403 ADC_ACCFailureReason 0;
BA_ "Remark" SG_ 403 ADC_ACCFailureReason "";
BA_ "EventCommandSignal" SG_ 403 ADC_ACCPassiveReason 0;
BA_ "GatewayedSignals" SG_ 403 ADC_ACCPassiveReason 0;
BA_ "GenSigInactiveValue" SG_ 403 ADC_ACCPassiveReason 0;
BA_ "GenSigInvalidValue" SG_ 403 ADC_ACCPassiveReason 0;
BA_ "GenSigSendType" SG_ 403 ADC_ACCPassiveReason 1;
BA_ "GenSigStartValue" SG_ 403 ADC_ACCPassiveReason 0;
BA_ "GenSigTimeoutValue" SG_ 403 ADC_ACCPassiveReason 0;
BA_ "Remark" SG_ 403 ADC_ACCPassiveReason "";
BA_ "EventCommandSignal" SG_ 403 ADC_ACC_SpeedLimitType 0;
BA_ "GatewayedSignals" SG_ 403 ADC_ACC_SpeedLimitType 0;
BA_ "GenSigInactiveValue" SG_ 403 ADC_ACC_SpeedLimitType 0;
BA_ "GenSigInvalidValue" SG_ 403 ADC_ACC_SpeedLimitType 0;
BA_ "GenSigSendType" SG_ 403 ADC_ACC_SpeedLimitType 1;
BA_ "GenSigStartValue" SG_ 403 ADC_ACC_SpeedLimitType 0;
BA_ "GenSigTimeoutValue" SG_ 403 ADC_ACC_SpeedLimitType 0;
BA_ "Remark" SG_ 403 ADC_ACC_SpeedLimitType "";
BA_ "EventCommandSignal" SG_ 403 ADC_TJP_St 0;
BA_ "GatewayedSignals" SG_ 403 ADC_TJP_St 0;
BA_ "GenSigInactiveValue" SG_ 403 ADC_TJP_St 0;
BA_ "GenSigInvalidValue" SG_ 403 ADC_TJP_St 0;
BA_ "GenSigSendType" SG_ 403 ADC_TJP_St 1;
BA_ "GenSigStartValue" SG_ 403 ADC_TJP_St 0;
BA_ "GenSigTimeoutValue" SG_ 403 ADC_TJP_St 0;
BA_ "Remark" SG_ 403 ADC_TJP_St "";
BA_ "EventCommandSignal" SG_ 403 ADC_TJPIconColor 0;
BA_ "GatewayedSignals" SG_ 403 ADC_TJPIconColor 0;
BA_ "GenSigInactiveValue" SG_ 403 ADC_TJPIconColor 0;
BA_ "GenSigInvalidValue" SG_ 403 ADC_TJPIconColor 0;
BA_ "GenSigSendType" SG_ 403 ADC_TJPIconColor 0;
BA_ "GenSigStartValue" SG_ 403 ADC_TJPIconColor 0;
BA_ "GenSigTimeoutValue" SG_ 403 ADC_TJPIconColor 4;
BA_ "Remark" SG_ 403 ADC_TJPIconColor "";
BA_ "EventCommandSignal" SG_ 403 ADC_TimeGapSet 0;
BA_ "GatewayedSignals" SG_ 403 ADC_TimeGapSet 0;
BA_ "GenSigInactiveValue" SG_ 403 ADC_TimeGapSet 0;
BA_ "GenSigInvalidValue" SG_ 403 ADC_TimeGapSet 0;
BA_ "GenSigSendType" SG_ 403 ADC_TimeGapSet 1;
BA_ "GenSigStartValue" SG_ 403 ADC_TimeGapSet 0;
BA_ "GenSigTimeoutValue" SG_ 403 ADC_TimeGapSet 0;
BA_ "Remark" SG_ 403 ADC_TimeGapSet "";
BA_ "EventCommandSignal" SG_ 403 ADC_ICA_St 0;
BA_ "GatewayedSignals" SG_ 403 ADC_ICA_St 0;
BA_ "GenSigInactiveValue" SG_ 403 ADC_ICA_St 0;
BA_ "GenSigInvalidValue" SG_ 403 ADC_ICA_St 0;
BA_ "GenSigSendType" SG_ 403 ADC_ICA_St 1;
BA_ "GenSigStartValue" SG_ 403 ADC_ICA_St 0;
BA_ "GenSigTimeoutValue" SG_ 403 ADC_ICA_St 0;
BA_ "Remark" SG_ 403 ADC_ICA_St "";
BA_ "EventCommandSignal" SG_ 403 ADC_CruiseLatCtrlType 0;
BA_ "GatewayedSignals" SG_ 403 ADC_CruiseLatCtrlType 0;
BA_ "GenSigInactiveValue" SG_ 403 ADC_CruiseLatCtrlType 0;
BA_ "GenSigInvalidValue" SG_ 403 ADC_CruiseLatCtrlType 0;
BA_ "GenSigSendType" SG_ 403 ADC_CruiseLatCtrlType 1;
BA_ "GenSigStartValue" SG_ 403 ADC_CruiseLatCtrlType 0;
BA_ "GenSigTimeoutValue" SG_ 403 ADC_CruiseLatCtrlType 0;
BA_ "Remark" SG_ 403 ADC_CruiseLatCtrlType "";
BA_ "EventCommandSignal" SG_ 403 ADC_Cruise_SpeedLimitType 0;
BA_ "GatewayedSignals" SG_ 403 ADC_Cruise_SpeedLimitType 0;
BA_ "GenSigInactiveValue" SG_ 403 ADC_Cruise_SpeedLimitType 0;
BA_ "GenSigInvalidValue" SG_ 403 ADC_Cruise_SpeedLimitType 0;
BA_ "GenSigSendType" SG_ 403 ADC_Cruise_SpeedLimitType 1;
BA_ "GenSigStartValue" SG_ 403 ADC_Cruise_SpeedLimitType 0;
BA_ "GenSigTimeoutValue" SG_ 403 ADC_Cruise_SpeedLimitType 0;
BA_ "Remark" SG_ 403 ADC_Cruise_SpeedLimitType "";
BA_ "EventCommandSignal" SG_ 403 ADC_ILC_EnableSt 0;
BA_ "GatewayedSignals" SG_ 403 ADC_ILC_EnableSt 0;
BA_ "GenSigInactiveValue" SG_ 403 ADC_ILC_EnableSt 0;
BA_ "GenSigInvalidValue" SG_ 403 ADC_ILC_EnableSt 0;
BA_ "GenSigSendType" SG_ 403 ADC_ILC_EnableSt 1;
BA_ "GenSigStartValue" SG_ 403 ADC_ILC_EnableSt 0;
BA_ "GenSigTimeoutValue" SG_ 403 ADC_ILC_EnableSt 0;
BA_ "Remark" SG_ 403 ADC_ILC_EnableSt "";
BA_ "EventCommandSignal" SG_ 403 ADC_ILOA_EnableSt 0;
BA_ "GatewayedSignals" SG_ 403 ADC_ILOA_EnableSt 0;
BA_ "GenSigInactiveValue" SG_ 403 ADC_ILOA_EnableSt 0;
BA_ "GenSigInvalidValue" SG_ 403 ADC_ILOA_EnableSt 0;
BA_ "GenSigSendType" SG_ 403 ADC_ILOA_EnableSt 1;
BA_ "GenSigStartValue" SG_ 403 ADC_ILOA_EnableSt 0;
BA_ "GenSigTimeoutValue" SG_ 403 ADC_ILOA_EnableSt 0;
BA_ "Remark" SG_ 403 ADC_ILOA_EnableSt "";
BA_ "EventCommandSignal" SG_ 403 ADC_ICA_TORReason 0;
BA_ "GatewayedSignals" SG_ 403 ADC_ICA_TORReason 0;
BA_ "GenSigInactiveValue" SG_ 403 ADC_ICA_TORReason 0;
BA_ "GenSigInvalidValue" SG_ 403 ADC_ICA_TORReason 0;
BA_ "GenSigSendType" SG_ 403 ADC_ICA_TORReason 1;
BA_ "GenSigStartValue" SG_ 403 ADC_ICA_TORReason 0;
BA_ "GenSigTimeoutValue" SG_ 403 ADC_ICA_TORReason 0;
BA_ "Remark" SG_ 403 ADC_ICA_TORReason "";
BA_ "EventCommandSignal" SG_ 403 ADC_CruiseLat_TORWarn 0;
BA_ "GatewayedSignals" SG_ 403 ADC_CruiseLat_TORWarn 0;
BA_ "GenSigInactiveValue" SG_ 403 ADC_CruiseLat_TORWarn 0;
BA_ "GenSigInvalidValue" SG_ 403 ADC_CruiseLat_TORWarn 0;
BA_ "GenSigSendType" SG_ 403 ADC_CruiseLat_TORWarn 1;
BA_ "GenSigStartValue" SG_ 403 ADC_CruiseLat_TORWarn 0;
BA_ "GenSigTimeoutValue" SG_ 403 ADC_CruiseLat_TORWarn 0;
BA_ "Remark" SG_ 403 ADC_CruiseLat_TORWarn "";
BA_ "EventCommandSignal" SG_ 403 ADC_ILOASt 0;
BA_ "GatewayedSignals" SG_ 403 ADC_ILOASt 0;
BA_ "GenSigInactiveValue" SG_ 403 ADC_ILOASt 0;
BA_ "GenSigInvalidValue" SG_ 403 ADC_ILOASt 0;
BA_ "GenSigSendType" SG_ 403 ADC_ILOASt 1;
BA_ "GenSigStartValue" SG_ 403 ADC_ILOASt 0;
BA_ "GenSigTimeoutValue" SG_ 403 ADC_ILOASt 0;
BA_ "Remark" SG_ 403 ADC_ILOASt "";
BA_ "EventCommandSignal" SG_ 403 ADC_ILOAType 0;
BA_ "GatewayedSignals" SG_ 403 ADC_ILOAType 0;
BA_ "GenSigInactiveValue" SG_ 403 ADC_ILOAType 0;
BA_ "GenSigInvalidValue" SG_ 403 ADC_ILOAType 0;
BA_ "GenSigSendType" SG_ 403 ADC_ILOAType 1;
BA_ "GenSigStartValue" SG_ 403 ADC_ILOAType 0;
BA_ "GenSigTimeoutValue" SG_ 403 ADC_ILOAType 0;
BA_ "Remark" SG_ 403 ADC_ILOAType "";
BA_ "EventCommandSignal" SG_ 403 ADC_ILOA_Actdirection 0;
BA_ "GatewayedSignals" SG_ 403 ADC_ILOA_Actdirection 0;
BA_ "GenSigInactiveValue" SG_ 403 ADC_ILOA_Actdirection 0;
BA_ "GenSigInvalidValue" SG_ 403 ADC_ILOA_Actdirection 0;
BA_ "GenSigSendType" SG_ 403 ADC_ILOA_Actdirection 1;
BA_ "GenSigStartValue" SG_ 403 ADC_ILOA_Actdirection 0;
BA_ "GenSigTimeoutValue" SG_ 403 ADC_ILOA_Actdirection 0;
BA_ "Remark" SG_ 403 ADC_ILOA_Actdirection "";
BA_ "EventCommandSignal" SG_ 403 ADC_LaneChangeSt 0;
BA_ "GatewayedSignals" SG_ 403 ADC_LaneChangeSt 0;
BA_ "GenSigInactiveValue" SG_ 403 ADC_LaneChangeSt 0;
BA_ "GenSigInvalidValue" SG_ 403 ADC_LaneChangeSt 0;
BA_ "GenSigSendType" SG_ 403 ADC_LaneChangeSt 1;
BA_ "GenSigStartValue" SG_ 403 ADC_LaneChangeSt 0;
BA_ "GenSigTimeoutValue" SG_ 403 ADC_LaneChangeSt 0;
BA_ "Remark" SG_ 403 ADC_LaneChangeSt "";
BA_ "EventCommandSignal" SG_ 403 ADC_LaneChange_RetreatReason 0;
BA_ "GatewayedSignals" SG_ 403 ADC_LaneChange_RetreatReason 0;
BA_ "GenSigInactiveValue" SG_ 403 ADC_LaneChange_RetreatReason 0;
BA_ "GenSigInvalidValue" SG_ 403 ADC_LaneChange_RetreatReason 0;
BA_ "GenSigSendType" SG_ 403 ADC_LaneChange_RetreatReason 1;
BA_ "GenSigStartValue" SG_ 403 ADC_LaneChange_RetreatReason 0;
BA_ "GenSigTimeoutValue" SG_ 403 ADC_LaneChange_RetreatReason 0;
BA_ "Remark" SG_ 403 ADC_LaneChange_RetreatReason "";
BA_ "EventCommandSignal" SG_ 403 ADC_LaneChange_WaitReason 0;
BA_ "GatewayedSignals" SG_ 403 ADC_LaneChange_WaitReason 0;
BA_ "GenSigInactiveValue" SG_ 403 ADC_LaneChange_WaitReason 0;
BA_ "GenSigInvalidValue" SG_ 403 ADC_LaneChange_WaitReason 0;
BA_ "GenSigSendType" SG_ 403 ADC_LaneChange_WaitReason 1;
BA_ "GenSigStartValue" SG_ 403 ADC_LaneChange_WaitReason 0;
BA_ "GenSigTimeoutValue" SG_ 403 ADC_LaneChange_WaitReason 0;
BA_ "Remark" SG_ 403 ADC_LaneChange_WaitReason "";
BA_ "EventCommandSignal" SG_ 403 ADC_LaneChange_AbortReason 0;
BA_ "GatewayedSignals" SG_ 403 ADC_LaneChange_AbortReason 0;
BA_ "GenSigInactiveValue" SG_ 403 ADC_LaneChange_AbortReason 0;
BA_ "GenSigInvalidValue" SG_ 403 ADC_LaneChange_AbortReason 0;
BA_ "GenSigSendType" SG_ 403 ADC_LaneChange_AbortReason 1;
BA_ "GenSigStartValue" SG_ 403 ADC_LaneChange_AbortReason 0;
BA_ "GenSigTimeoutValue" SG_ 403 ADC_LaneChange_AbortReason 0;
BA_ "Remark" SG_ 403 ADC_LaneChange_AbortReason "";
BA_ "EventCommandSignal" SG_ 403 ADC_LaneChange_Actdirection 0;
BA_ "GatewayedSignals" SG_ 403 ADC_LaneChange_Actdirection 0;
BA_ "GenSigInactiveValue" SG_ 403 ADC_LaneChange_Actdirection 0;
BA_ "GenSigInvalidValue" SG_ 403 ADC_LaneChange_Actdirection 0;
BA_ "GenSigSendType" SG_ 403 ADC_LaneChange_Actdirection 1;
BA_ "GenSigStartValue" SG_ 403 ADC_LaneChange_Actdirection 0;
BA_ "GenSigTimeoutValue" SG_ 403 ADC_LaneChange_Actdirection 0;
BA_ "Remark" SG_ 403 ADC_LaneChange_Actdirection "";
BA_ "EventCommandSignal" SG_ 403 ADC_ICA_MRMReason 0;
BA_ "GatewayedSignals" SG_ 403 ADC_ICA_MRMReason 0;
BA_ "GenSigInactiveValue" SG_ 403 ADC_ICA_MRMReason 0;
BA_ "GenSigInvalidValue" SG_ 403 ADC_ICA_MRMReason 0;
BA_ "GenSigSendType" SG_ 403 ADC_ICA_MRMReason 1;
BA_ "GenSigStartValue" SG_ 403 ADC_ICA_MRMReason 0;
BA_ "GenSigTimeoutValue" SG_ 403 ADC_ICA_MRMReason 0;
BA_ "Remark" SG_ 403 ADC_ICA_MRMReason "";
BA_ "EventCommandSignal" SG_ 403 ADC_ICA_Mileage 0;
BA_ "GatewayedSignals" SG_ 403 ADC_ICA_Mileage 0;
BA_ "GenSigInactiveValue" SG_ 403 ADC_ICA_Mileage 0;
BA_ "GenSigInvalidValue" SG_ 403 ADC_ICA_Mileage 2047;
BA_ "GenSigSendType" SG_ 403 ADC_ICA_Mileage 1;
BA_ "GenSigStartValue" SG_ 403 ADC_ICA_Mileage 0;
BA_ "GenSigTimeoutValue" SG_ 403 ADC_ICA_Mileage 0;
BA_ "Remark" SG_ 403 ADC_ICA_Mileage "";
BA_ "EventCommandSignal" SG_ 403 ADC_ICAMRMWarningLevel 0;
BA_ "GatewayedSignals" SG_ 403 ADC_ICAMRMWarningLevel 0;
BA_ "GenSigInactiveValue" SG_ 403 ADC_ICAMRMWarningLevel 0;
BA_ "GenSigInvalidValue" SG_ 403 ADC_ICAMRMWarningLevel 0;
BA_ "GenSigSendType" SG_ 403 ADC_ICAMRMWarningLevel 1;
BA_ "GenSigStartValue" SG_ 403 ADC_ICAMRMWarningLevel 0;
BA_ "GenSigTimeoutValue" SG_ 403 ADC_ICAMRMWarningLevel 0;
BA_ "Remark" SG_ 403 ADC_ICAMRMWarningLevel "";
BA_ "EventCommandSignal" SG_ 403 ADC_ICA_PassiveReason 0;
BA_ "GatewayedSignals" SG_ 403 ADC_ICA_PassiveReason 0;
BA_ "GenSigInactiveValue" SG_ 403 ADC_ICA_PassiveReason 0;
BA_ "GenSigInvalidValue" SG_ 403 ADC_ICA_PassiveReason 0;
BA_ "GenSigSendType" SG_ 403 ADC_ICA_PassiveReason 1;
BA_ "GenSigStartValue" SG_ 403 ADC_ICA_PassiveReason 0;
BA_ "GenSigTimeoutValue" SG_ 403 ADC_ICA_PassiveReason 0;
BA_ "Remark" SG_ 403 ADC_ICA_PassiveReason "";
BA_ "EventCommandSignal" SG_ 403 ADC_ICA_faultReason 0;
BA_ "GatewayedSignals" SG_ 403 ADC_ICA_faultReason 0;
BA_ "GenSigInactiveValue" SG_ 403 ADC_ICA_faultReason 0;
BA_ "GenSigInvalidValue" SG_ 403 ADC_ICA_faultReason 0;
BA_ "GenSigSendType" SG_ 403 ADC_ICA_faultReason 1;
BA_ "GenSigStartValue" SG_ 403 ADC_ICA_faultReason 0;
BA_ "GenSigTimeoutValue" SG_ 403 ADC_ICA_faultReason 0;
BA_ "Remark" SG_ 403 ADC_ICA_faultReason "";
BA_ "EventCommandSignal" SG_ 403 ADC_HFIconColor 0;
BA_ "GatewayedSignals" SG_ 403 ADC_HFIconColor 0;
BA_ "GenSigInactiveValue" SG_ 403 ADC_HFIconColor 0;
BA_ "GenSigInvalidValue" SG_ 403 ADC_HFIconColor 0;
BA_ "GenSigSendType" SG_ 403 ADC_HFIconColor 0;
BA_ "GenSigStartValue" SG_ 403 ADC_HFIconColor 0;
BA_ "GenSigTimeoutValue" SG_ 403 ADC_HFIconColor 4;
BA_ "Remark" SG_ 403 ADC_HFIconColor "";
BA_ "EventCommandSignal" SG_ 403 ADC_AdsFucntionNotActive 0;
BA_ "GatewayedSignals" SG_ 403 ADC_AdsFucntionNotActive 0;
BA_ "GenSigInactiveValue" SG_ 403 ADC_AdsFucntionNotActive 0;
BA_ "GenSigInvalidValue" SG_ 403 ADC_AdsFucntionNotActive 0;
BA_ "GenSigSendType" SG_ 403 ADC_AdsFucntionNotActive 1;
BA_ "GenSigStartValue" SG_ 403 ADC_AdsFucntionNotActive 0;
BA_ "GenSigTimeoutValue" SG_ 403 ADC_AdsFucntionNotActive 0;
BA_ "Remark" SG_ 403 ADC_AdsFucntionNotActive "";
BA_ "EventCommandSignal" SG_ 403 ADC_MRMNumber 0;
BA_ "GatewayedSignals" SG_ 403 ADC_MRMNumber 0;
BA_ "GenSigInactiveValue" SG_ 403 ADC_MRMNumber 0;
BA_ "GenSigInvalidValue" SG_ 403 ADC_MRMNumber 0;
BA_ "GenSigSendType" SG_ 403 ADC_MRMNumber 1;
BA_ "GenSigStartValue" SG_ 403 ADC_MRMNumber 0;
BA_ "GenSigTimeoutValue" SG_ 403 ADC_MRMNumber 0;
BA_ "Remark" SG_ 403 ADC_MRMNumber "";
BA_ "EventCommandSignal" SG_ 403 ADC_MRCNumber 0;
BA_ "GatewayedSignals" SG_ 403 ADC_MRCNumber 0;
BA_ "GenSigInactiveValue" SG_ 403 ADC_MRCNumber 0;
BA_ "GenSigInvalidValue" SG_ 403 ADC_MRCNumber 0;
BA_ "GenSigSendType" SG_ 403 ADC_MRCNumber 1;
BA_ "GenSigStartValue" SG_ 403 ADC_MRCNumber 0;
BA_ "GenSigTimeoutValue" SG_ 403 ADC_MRCNumber 0;
BA_ "Remark" SG_ 403 ADC_MRCNumber "";
BA_ "EventCommandSignal" SG_ 403 ADC_HandsOnSt 0;
BA_ "GatewayedSignals" SG_ 403 ADC_HandsOnSt 0;
BA_ "GenSigInactiveValue" SG_ 403 ADC_HandsOnSt 0;
BA_ "GenSigInvalidValue" SG_ 403 ADC_HandsOnSt 0;
BA_ "GenSigSendType" SG_ 403 ADC_HandsOnSt 1;
BA_ "GenSigStartValue" SG_ 403 ADC_HandsOnSt 0;
BA_ "GenSigTimeoutValue" SG_ 403 ADC_HandsOnSt 0;
BA_ "Remark" SG_ 403 ADC_HandsOnSt "";
BA_ "EventCommandSignal" SG_ 403 ADC_HandsOn_Warning 0;
BA_ "GatewayedSignals" SG_ 403 ADC_HandsOn_Warning 0;
BA_ "GenSigInactiveValue" SG_ 403 ADC_HandsOn_Warning 0;
BA_ "GenSigInvalidValue" SG_ 403 ADC_HandsOn_Warning 0;
BA_ "GenSigSendType" SG_ 403 ADC_HandsOn_Warning 1;
BA_ "GenSigStartValue" SG_ 403 ADC_HandsOn_Warning 0;
BA_ "GenSigTimeoutValue" SG_ 403 ADC_HandsOn_Warning 0;
BA_ "Remark" SG_ 403 ADC_HandsOn_Warning "";
BA_ "EventCommandSignal" SG_ 403 ADC_ICMADASFailureText 0;
BA_ "GatewayedSignals" SG_ 403 ADC_ICMADASFailureText 0;
BA_ "GenSigInactiveValue" SG_ 403 ADC_ICMADASFailureText 0;
BA_ "GenSigInvalidValue" SG_ 403 ADC_ICMADASFailureText 15;
BA_ "GenSigSendType" SG_ 403 ADC_ICMADASFailureText 0;
BA_ "GenSigStartValue" SG_ 403 ADC_ICMADASFailureText 0;
BA_ "GenSigTimeoutValue" SG_ 403 ADC_ICMADASFailureText 15;
BA_ "Remark" SG_ 403 ADC_ICMADASFailureText "";
BA_ "EventCommandSignal" SG_ 403 ADC_ICMADASWarnText 0;
BA_ "GatewayedSignals" SG_ 403 ADC_ICMADASWarnText 0;
BA_ "GenSigInactiveValue" SG_ 403 ADC_ICMADASWarnText 0;
BA_ "GenSigInvalidValue" SG_ 403 ADC_ICMADASWarnText 0;
BA_ "GenSigSendType" SG_ 403 ADC_ICMADASWarnText 0;
BA_ "GenSigStartValue" SG_ 403 ADC_ICMADASWarnText 0;
BA_ "GenSigTimeoutValue" SG_ 403 ADC_ICMADASWarnText 0;
BA_ "Remark" SG_ 403 ADC_ICMADASWarnText "";
BA_ "EventCommandSignal" SG_ 403 ADC_SpeedLimitIconSt 0;
BA_ "GatewayedSignals" SG_ 403 ADC_SpeedLimitIconSt 0;
BA_ "GenSigInactiveValue" SG_ 403 ADC_SpeedLimitIconSt 0;
BA_ "GenSigInvalidValue" SG_ 403 ADC_SpeedLimitIconSt 0;
BA_ "GenSigSendType" SG_ 403 ADC_SpeedLimitIconSt 0;
BA_ "GenSigStartValue" SG_ 403 ADC_SpeedLimitIconSt 0;
BA_ "GenSigTimeoutValue" SG_ 403 ADC_SpeedLimitIconSt 0;
BA_ "Remark" SG_ 403 ADC_SpeedLimitIconSt "";
BA_ "EventCommandSignal" SG_ 403 ADC_ICMWarnCardSt 0;
BA_ "GatewayedSignals" SG_ 403 ADC_ICMWarnCardSt 0;
BA_ "GenSigInactiveValue" SG_ 403 ADC_ICMWarnCardSt 0;
BA_ "GenSigInvalidValue" SG_ 403 ADC_ICMWarnCardSt 0;
BA_ "GenSigSendType" SG_ 403 ADC_ICMWarnCardSt 0;
BA_ "GenSigStartValue" SG_ 403 ADC_ICMWarnCardSt 0;
BA_ "GenSigTimeoutValue" SG_ 403 ADC_ICMWarnCardSt 0;
BA_ "Remark" SG_ 403 ADC_ICMWarnCardSt "";
BA_ "EventCommandSignal" SG_ 403 ADC_ICAIconColor 0;
BA_ "GatewayedSignals" SG_ 403 ADC_ICAIconColor 0;
BA_ "GenSigInactiveValue" SG_ 403 ADC_ICAIconColor 0;
BA_ "GenSigInvalidValue" SG_ 403 ADC_ICAIconColor 0;
BA_ "GenSigSendType" SG_ 403 ADC_ICAIconColor 0;
BA_ "GenSigStartValue" SG_ 403 ADC_ICAIconColor 0;
BA_ "GenSigTimeoutValue" SG_ 403 ADC_ICAIconColor 0;
BA_ "Remark" SG_ 403 ADC_ICAIconColor "";
BA_ "EventCommandSignal" SG_ 403 ADC_ICMPromptWarn 0;
BA_ "GatewayedSignals" SG_ 403 ADC_ICMPromptWarn 0;
BA_ "GenSigInactiveValue" SG_ 403 ADC_ICMPromptWarn 0;
BA_ "GenSigInvalidValue" SG_ 403 ADC_ICMPromptWarn 0;
BA_ "GenSigSendType" SG_ 403 ADC_ICMPromptWarn 0;
BA_ "GenSigStartValue" SG_ 403 ADC_ICMPromptWarn 0;
BA_ "GenSigTimeoutValue" SG_ 403 ADC_ICMPromptWarn 0;
BA_ "Remark" SG_ 403 ADC_ICMPromptWarn "";
BA_ "EventCommandSignal" SG_ 403 ADC_NDAIconColor 0;
BA_ "GatewayedSignals" SG_ 403 ADC_NDAIconColor 0;
BA_ "GenSigInactiveValue" SG_ 403 ADC_NDAIconColor 0;
BA_ "GenSigInvalidValue" SG_ 403 ADC_NDAIconColor 0;
BA_ "GenSigSendType" SG_ 403 ADC_NDAIconColor 0;
BA_ "GenSigStartValue" SG_ 403 ADC_NDAIconColor 0;
BA_ "GenSigTimeoutValue" SG_ 403 ADC_NDAIconColor 0;
BA_ "Remark" SG_ 403 ADC_NDAIconColor "";
BA_ "EventCommandSignal" SG_ 403 ADC_ACUVoiceWarn 0;
BA_ "GatewayedSignals" SG_ 403 ADC_ACUVoiceWarn 0;
BA_ "GenSigInactiveValue" SG_ 403 ADC_ACUVoiceWarn 0;
BA_ "GenSigInvalidValue" SG_ 403 ADC_ACUVoiceWarn 0;
BA_ "GenSigSendType" SG_ 403 ADC_ACUVoiceWarn 0;
BA_ "GenSigStartValue" SG_ 403 ADC_ACUVoiceWarn 0;
BA_ "GenSigTimeoutValue" SG_ 403 ADC_ACUVoiceWarn 0;
BA_ "Remark" SG_ 403 ADC_ACUVoiceWarn "";
BA_ "EventCommandSignal" SG_ 403 ADC_NDAStateIcon 0;
BA_ "GatewayedSignals" SG_ 403 ADC_NDAStateIcon 0;
BA_ "GenSigInactiveValue" SG_ 403 ADC_NDAStateIcon 0;
BA_ "GenSigInvalidValue" SG_ 403 ADC_NDAStateIcon 0;
BA_ "GenSigSendType" SG_ 403 ADC_NDAStateIcon 0;
BA_ "GenSigStartValue" SG_ 403 ADC_NDAStateIcon 0;
BA_ "GenSigTimeoutValue" SG_ 403 ADC_NDAStateIcon 0;
BA_ "Remark" SG_ 403 ADC_NDAStateIcon "";
BA_ "EventCommandSignal" SG_ 403 ADC_SpeedLimitIcon 0;
BA_ "GatewayedSignals" SG_ 403 ADC_SpeedLimitIcon 0;
BA_ "GenSigInactiveValue" SG_ 403 ADC_SpeedLimitIcon 0;
BA_ "GenSigInvalidValue" SG_ 403 ADC_SpeedLimitIcon 0;
BA_ "GenSigSendType" SG_ 403 ADC_SpeedLimitIcon 0;
BA_ "GenSigStartValue" SG_ 403 ADC_SpeedLimitIcon 255;
BA_ "GenSigTimeoutValue" SG_ 403 ADC_SpeedLimitIcon 255;
BA_ "Remark" SG_ 403 ADC_SpeedLimitIcon "";
BA_ "EventCommandSignal" SG_ 403 ADC_ICANDAIconAngle 0;
BA_ "GatewayedSignals" SG_ 403 ADC_ICANDAIconAngle 0;
BA_ "GenSigInactiveValue" SG_ 403 ADC_ICANDAIconAngle 0;
BA_ "GenSigInvalidValue" SG_ 403 ADC_ICANDAIconAngle 0;
BA_ "GenSigSendType" SG_ 403 ADC_ICANDAIconAngle 0;
BA_ "GenSigStartValue" SG_ 403 ADC_ICANDAIconAngle 0;
BA_ "GenSigTimeoutValue" SG_ 403 ADC_ICANDAIconAngle 0;
BA_ "Remark" SG_ 403 ADC_ICANDAIconAngle "";
BA_ "EventCommandSignal" SG_ 403 ADC_ACCTargetSpeedCard 0;
BA_ "GatewayedSignals" SG_ 403 ADC_ACCTargetSpeedCard 0;
BA_ "GenSigInactiveValue" SG_ 403 ADC_ACCTargetSpeedCard 0;
BA_ "GenSigInvalidValue" SG_ 403 ADC_ACCTargetSpeedCard 0;
BA_ "GenSigSendType" SG_ 403 ADC_ACCTargetSpeedCard 0;
BA_ "GenSigStartValue" SG_ 403 ADC_ACCTargetSpeedCard 255;
BA_ "GenSigTimeoutValue" SG_ 403 ADC_ACCTargetSpeedCard 255;
BA_ "Remark" SG_ 403 ADC_ACCTargetSpeedCard "";
BA_ "EventCommandSignal" SG_ 403 ADC_ACCIconColor 0;
BA_ "GatewayedSignals" SG_ 403 ADC_ACCIconColor 0;
BA_ "GenSigInactiveValue" SG_ 403 ADC_ACCIconColor 0;
BA_ "GenSigInvalidValue" SG_ 403 ADC_ACCIconColor 0;
BA_ "GenSigSendType" SG_ 403 ADC_ACCIconColor 0;
BA_ "GenSigStartValue" SG_ 403 ADC_ACCIconColor 0;
BA_ "GenSigTimeoutValue" SG_ 403 ADC_ACCIconColor 0;
BA_ "Remark" SG_ 403 ADC_ACCIconColor "";
BA_ "EventCommandSignal" SG_ 403 ADC_ICMADASFailureLamp 0;
BA_ "GatewayedSignals" SG_ 403 ADC_ICMADASFailureLamp 0;
BA_ "GenSigInactiveValue" SG_ 403 ADC_ICMADASFailureLamp 0;
BA_ "GenSigInvalidValue" SG_ 403 ADC_ICMADASFailureLamp 0;
BA_ "GenSigSendType" SG_ 403 ADC_ICMADASFailureLamp 1;
BA_ "GenSigStartValue" SG_ 403 ADC_ICMADASFailureLamp 0;
BA_ "GenSigTimeoutValue" SG_ 403 ADC_ICMADASFailureLamp 1;
BA_ "Remark" SG_ 403 ADC_ICMADASFailureLamp "";
BA_ "EventCommandSignal" SG_ 403 ADC_Pilot_VoiceWarn 0;
BA_ "GatewayedSignals" SG_ 403 ADC_Pilot_VoiceWarn 0;
BA_ "GenSigInactiveValue" SG_ 403 ADC_Pilot_VoiceWarn 0;
BA_ "GenSigInvalidValue" SG_ 403 ADC_Pilot_VoiceWarn 0;
BA_ "GenSigSendType" SG_ 403 ADC_Pilot_VoiceWarn 0;
BA_ "GenSigStartValue" SG_ 403 ADC_Pilot_VoiceWarn 0;
BA_ "GenSigTimeoutValue" SG_ 403 ADC_Pilot_VoiceWarn 0;
BA_ "Remark" SG_ 403 ADC_Pilot_VoiceWarn "";
BA_ "EventCommandSignal" SG_ 403 ADC_Pilot_PromptWarn 0;
BA_ "GatewayedSignals" SG_ 403 ADC_Pilot_PromptWarn 0;
BA_ "GenSigInactiveValue" SG_ 403 ADC_Pilot_PromptWarn 0;
BA_ "GenSigInvalidValue" SG_ 403 ADC_Pilot_PromptWarn 0;
BA_ "GenSigSendType" SG_ 403 ADC_Pilot_PromptWarn 0;
BA_ "GenSigStartValue" SG_ 403 ADC_Pilot_PromptWarn 0;
BA_ "GenSigTimeoutValue" SG_ 403 ADC_Pilot_PromptWarn 0;
BA_ "Remark" SG_ 403 ADC_Pilot_PromptWarn "";
BA_ "EventCommandSignal" SG_ 403 ADC_Pilot_WarnText 0;
BA_ "GatewayedSignals" SG_ 403 ADC_Pilot_WarnText 0;
BA_ "GenSigInactiveValue" SG_ 403 ADC_Pilot_WarnText 0;
BA_ "GenSigInvalidValue" SG_ 403 ADC_Pilot_WarnText 0;
BA_ "GenSigSendType" SG_ 403 ADC_Pilot_WarnText 0;
BA_ "GenSigStartValue" SG_ 403 ADC_Pilot_WarnText 0;
BA_ "GenSigTimeoutValue" SG_ 403 ADC_Pilot_WarnText 0;
BA_ "Remark" SG_ 403 ADC_Pilot_WarnText "";
BA_ "EventCommandSignal" SG_ 403 ADC_Pilot_WarnCardSt 0;
BA_ "GatewayedSignals" SG_ 403 ADC_Pilot_WarnCardSt 0;
BA_ "GenSigInactiveValue" SG_ 403 ADC_Pilot_WarnCardSt 0;
BA_ "GenSigInvalidValue" SG_ 403 ADC_Pilot_WarnCardSt 0;
BA_ "GenSigSendType" SG_ 403 ADC_Pilot_WarnCardSt 0;
BA_ "GenSigStartValue" SG_ 403 ADC_Pilot_WarnCardSt 0;
BA_ "GenSigTimeoutValue" SG_ 403 ADC_Pilot_WarnCardSt 0;
BA_ "Remark" SG_ 403 ADC_Pilot_WarnCardSt "";
BA_ "EventCommandSignal" SG_ 403 ADC_AdsFault 0;
BA_ "GatewayedSignals" SG_ 403 ADC_AdsFault 0;
BA_ "GenSigInactiveValue" SG_ 403 ADC_AdsFault 0;
BA_ "GenSigInvalidValue" SG_ 403 ADC_AdsFault 0;
BA_ "GenSigSendType" SG_ 403 ADC_AdsFault 1;
BA_ "GenSigStartValue" SG_ 403 ADC_AdsFault 0;
BA_ "GenSigTimeoutValue" SG_ 403 ADC_AdsFault 0;
BA_ "Remark" SG_ 403 ADC_AdsFault "";
BA_ "EventCommandSignal" SG_ 403 ADC_NicaReminderLEDVisual 0;
BA_ "GatewayedSignals" SG_ 403 ADC_NicaReminderLEDVisual 0;
BA_ "GenSigInactiveValue" SG_ 403 ADC_NicaReminderLEDVisual 0;
BA_ "GenSigInvalidValue" SG_ 403 ADC_NicaReminderLEDVisual 0;
BA_ "GenSigSendType" SG_ 403 ADC_NicaReminderLEDVisual 1;
BA_ "GenSigStartValue" SG_ 403 ADC_NicaReminderLEDVisual 0;
BA_ "GenSigTimeoutValue" SG_ 403 ADC_NicaReminderLEDVisual 0;
BA_ "Remark" SG_ 403 ADC_NicaReminderLEDVisual "";
BA_ "EventCommandSignal" SG_ 403 ADC_NicaReminderAcoustic 0;
BA_ "GatewayedSignals" SG_ 403 ADC_NicaReminderAcoustic 0;
BA_ "GenSigInactiveValue" SG_ 403 ADC_NicaReminderAcoustic 0;
BA_ "GenSigInvalidValue" SG_ 403 ADC_NicaReminderAcoustic 0;
BA_ "GenSigSendType" SG_ 403 ADC_NicaReminderAcoustic 1;
BA_ "GenSigStartValue" SG_ 403 ADC_NicaReminderAcoustic 0;
BA_ "GenSigTimeoutValue" SG_ 403 ADC_NicaReminderAcoustic 0;
BA_ "Remark" SG_ 403 ADC_NicaReminderAcoustic "";
BA_ "EventCommandSignal" SG_ 403 ADC_AdsTakeoverID 0;
BA_ "GatewayedSignals" SG_ 403 ADC_AdsTakeoverID 0;
BA_ "GenSigInactiveValue" SG_ 403 ADC_AdsTakeoverID 0;
BA_ "GenSigInvalidValue" SG_ 403 ADC_AdsTakeoverID 0;
BA_ "GenSigSendType" SG_ 403 ADC_AdsTakeoverID 1;
BA_ "GenSigStartValue" SG_ 403 ADC_AdsTakeoverID 0;
BA_ "GenSigTimeoutValue" SG_ 403 ADC_AdsTakeoverID 0;
BA_ "Remark" SG_ 403 ADC_AdsTakeoverID "";
BA_ "EventCommandSignal" SG_ 403 ADC_AdsTakeoverLevel 0;
BA_ "GatewayedSignals" SG_ 403 ADC_AdsTakeoverLevel 0;
BA_ "GenSigInactiveValue" SG_ 403 ADC_AdsTakeoverLevel 0;
BA_ "GenSigInvalidValue" SG_ 403 ADC_AdsTakeoverLevel 0;
BA_ "GenSigSendType" SG_ 403 ADC_AdsTakeoverLevel 1;
BA_ "GenSigStartValue" SG_ 403 ADC_AdsTakeoverLevel 0;
BA_ "GenSigTimeoutValue" SG_ 403 ADC_AdsTakeoverLevel 0;
BA_ "Remark" SG_ 403 ADC_AdsTakeoverLevel "";
BA_ "EventCommandSignal" SG_ 403 ADC_TORIDCorrespErrorID 0;
BA_ "GatewayedSignals" SG_ 403 ADC_TORIDCorrespErrorID 0;
BA_ "GenSigInactiveValue" SG_ 403 ADC_TORIDCorrespErrorID 0;
BA_ "GenSigInvalidValue" SG_ 403 ADC_TORIDCorrespErrorID 0;
BA_ "GenSigSendType" SG_ 403 ADC_TORIDCorrespErrorID 1;
BA_ "GenSigStartValue" SG_ 403 ADC_TORIDCorrespErrorID 0;
BA_ "GenSigTimeoutValue" SG_ 403 ADC_TORIDCorrespErrorID 0;
BA_ "Remark" SG_ 403 ADC_TORIDCorrespErrorID "";
BA_ "EventCommandSignal" SG_ 403 ADC_TakeoverExtended16bit 0;
BA_ "GatewayedSignals" SG_ 403 ADC_TakeoverExtended16bit 0;
BA_ "GenSigInactiveValue" SG_ 403 ADC_TakeoverExtended16bit 0;
BA_ "GenSigInvalidValue" SG_ 403 ADC_TakeoverExtended16bit 0;
BA_ "GenSigSendType" SG_ 403 ADC_TakeoverExtended16bit 1;
BA_ "GenSigStartValue" SG_ 403 ADC_TakeoverExtended16bit 0;
BA_ "GenSigTimeoutValue" SG_ 403 ADC_TakeoverExtended16bit 0;
BA_ "Remark" SG_ 403 ADC_TakeoverExtended16bit "";
BA_ "EventCommandSignal" SG_ 403 ADC_TakeoverExtended8bit 0;
BA_ "GatewayedSignals" SG_ 403 ADC_TakeoverExtended8bit 0;
BA_ "GenSigInactiveValue" SG_ 403 ADC_TakeoverExtended8bit 0;
BA_ "GenSigInvalidValue" SG_ 403 ADC_TakeoverExtended8bit 0;
BA_ "GenSigSendType" SG_ 403 ADC_TakeoverExtended8bit 1;
BA_ "GenSigStartValue" SG_ 403 ADC_TakeoverExtended8bit 0;
BA_ "GenSigTimeoutValue" SG_ 403 ADC_TakeoverExtended8bit 0;
BA_ "Remark" SG_ 403 ADC_TakeoverExtended8bit "";
BA_ "EventCommandSignal" SG_ 403 ADC_AvpFunctionStatus 0;
BA_ "GatewayedSignals" SG_ 403 ADC_AvpFunctionStatus 0;
BA_ "GenSigInactiveValue" SG_ 403 ADC_AvpFunctionStatus 0;
BA_ "GenSigInvalidValue" SG_ 403 ADC_AvpFunctionStatus 0;
BA_ "GenSigSendType" SG_ 403 ADC_AvpFunctionStatus 1;
BA_ "GenSigStartValue" SG_ 403 ADC_AvpFunctionStatus 0;
BA_ "GenSigTimeoutValue" SG_ 403 ADC_AvpFunctionStatus 0;
BA_ "Remark" SG_ 403 ADC_AvpFunctionStatus "";
BA_ "EventCommandSignal" SG_ 403 ADC_CalibState 0;
BA_ "GatewayedSignals" SG_ 403 ADC_CalibState 0;
BA_ "GenSigInactiveValue" SG_ 403 ADC_CalibState 0;
BA_ "GenSigInvalidValue" SG_ 403 ADC_CalibState 0;
BA_ "GenSigSendType" SG_ 403 ADC_CalibState 1;
BA_ "GenSigStartValue" SG_ 403 ADC_CalibState 0;
BA_ "GenSigTimeoutValue" SG_ 403 ADC_CalibState 0;
BA_ "Remark" SG_ 403 ADC_CalibState "";
BA_ "EventCommandSignal" SG_ 403 ADC_AccFunctionStatus 0;
BA_ "GatewayedSignals" SG_ 403 ADC_AccFunctionStatus 0;
BA_ "GenSigInactiveValue" SG_ 403 ADC_AccFunctionStatus 0;
BA_ "GenSigInvalidValue" SG_ 403 ADC_AccFunctionStatus 0;
BA_ "GenSigSendType" SG_ 403 ADC_AccFunctionStatus 1;
BA_ "GenSigStartValue" SG_ 403 ADC_AccFunctionStatus 0;
BA_ "GenSigTimeoutValue" SG_ 403 ADC_AccFunctionStatus 0;
BA_ "Remark" SG_ 403 ADC_AccFunctionStatus "";
BA_ "EventCommandSignal" SG_ 403 ADC_NicaFunctionStatus 0;
BA_ "GatewayedSignals" SG_ 403 ADC_NicaFunctionStatus 0;
BA_ "GenSigInactiveValue" SG_ 403 ADC_NicaFunctionStatus 0;
BA_ "GenSigInvalidValue" SG_ 403 ADC_NicaFunctionStatus 0;
BA_ "GenSigSendType" SG_ 403 ADC_NicaFunctionStatus 1;
BA_ "GenSigStartValue" SG_ 403 ADC_NicaFunctionStatus 0;
BA_ "GenSigTimeoutValue" SG_ 403 ADC_NicaFunctionStatus 0;
BA_ "Remark" SG_ 403 ADC_NicaFunctionStatus "";
BA_ "EventCommandSignal" SG_ 403 ADC_AEBWaning 0;
BA_ "GatewayedSignals" SG_ 403 ADC_AEBWaning 0;
BA_ "GenSigInactiveValue" SG_ 403 ADC_AEBWaning 0;
BA_ "GenSigInvalidValue" SG_ 403 ADC_AEBWaning 0;
BA_ "GenSigSendType" SG_ 403 ADC_AEBWaning 1;
BA_ "GenSigStartValue" SG_ 403 ADC_AEBWaning 0;
BA_ "GenSigTimeoutValue" SG_ 403 ADC_AEBWaning 0;
BA_ "Remark" SG_ 403 ADC_AEBWaning "";
BA_ "EventCommandSignal" SG_ 403 ADC_LKAWarning 0;
BA_ "GatewayedSignals" SG_ 403 ADC_LKAWarning 0;
BA_ "GenSigInactiveValue" SG_ 403 ADC_LKAWarning 0;
BA_ "GenSigInvalidValue" SG_ 403 ADC_LKAWarning 0;
BA_ "GenSigSendType" SG_ 403 ADC_LKAWarning 1;
BA_ "GenSigStartValue" SG_ 403 ADC_LKAWarning 0;
BA_ "GenSigTimeoutValue" SG_ 403 ADC_LKAWarning 0;
BA_ "Remark" SG_ 403 ADC_LKAWarning "";
BA_ "EventCommandSignal" SG_ 403 ADC_LCCStateIcon 0;
BA_ "GatewayedSignals" SG_ 403 ADC_LCCStateIcon 0;
BA_ "GenSigInactiveValue" SG_ 403 ADC_LCCStateIcon 0;
BA_ "GenSigInvalidValue" SG_ 403 ADC_LCCStateIcon 0;
BA_ "GenSigSendType" SG_ 403 ADC_LCCStateIcon 0;
BA_ "GenSigStartValue" SG_ 403 ADC_LCCStateIcon 0;
BA_ "GenSigTimeoutValue" SG_ 403 ADC_LCCStateIcon 0;
BA_ "Remark" SG_ 403 ADC_LCCStateIcon "";
BA_ "EventCommandSignal" SG_ 403 Reserved1 0;
BA_ "GatewayedSignals" SG_ 403 Reserved1 0;
BA_ "GenSigInactiveValue" SG_ 403 Reserved1 0;
BA_ "GenSigInvalidValue" SG_ 403 Reserved1 0;
BA_ "GenSigSendType" SG_ 403 Reserved1 1;
BA_ "GenSigStartValue" SG_ 403 Reserved1 0;
BA_ "GenSigTimeoutValue" SG_ 403 Reserved1 0;
BA_ "Remark" SG_ 403 Reserved1 "";
BA_ "EventCommandSignal" SG_ 403 ADC_1_FreshnessValue 0;
BA_ "GatewayedSignals" SG_ 403 ADC_1_FreshnessValue 0;
BA_ "GenSigInactiveValue" SG_ 403 ADC_1_FreshnessValue 0;
BA_ "GenSigInvalidValue" SG_ 403 ADC_1_FreshnessValue 0;
BA_ "GenSigSendType" SG_ 403 ADC_1_FreshnessValue 1;
BA_ "GenSigStartValue" SG_ 403 ADC_1_FreshnessValue 0;
BA_ "GenSigTimeoutValue" SG_ 403 ADC_1_FreshnessValue 0;
BA_ "Remark" SG_ 403 ADC_1_FreshnessValue "";
BA_ "EventCommandSignal" SG_ 403 ADC_1_MAC_Check 0;
BA_ "GatewayedSignals" SG_ 403 ADC_1_MAC_Check 0;
BA_ "GenSigInactiveValue" SG_ 403 ADC_1_MAC_Check 0;
BA_ "GenSigInvalidValue" SG_ 403 ADC_1_MAC_Check 0;
BA_ "GenSigSendType" SG_ 403 ADC_1_MAC_Check 1;
BA_ "GenSigStartValue" SG_ 403 ADC_1_MAC_Check 0;
BA_ "GenSigTimeoutValue" SG_ 403 ADC_1_MAC_Check 0;
BA_ "Remark" SG_ 403 ADC_1_MAC_Check "";
VAL_ 696 KAE_EDK1UnlockBtnPressSt 0 "Undifiend" 1 "Short press" 2 "Twice short press" 3 "Long press"  ;
VAL_ 696 KAE_EDK1LockBtnPressSt 0 "Undifiend" 1 "Short press" 2 "Twice short press" 3 "Long press"  ;
VAL_ 696 KAE_EDK1RESBtnPressSt 0 "Undifiend" 1 "Short press" 2 "Twice short press" 3 "Long press"  ;
VAL_ 696 KAE_EDK1PSD_LBtnPressSt 0 "Undifiend" 1 "Short press" 2 "Twice short press" 3 "Long press"  ;
VAL_ 696 KAE_EDK1PSD_RBtnPressSt 0 "Undifiend" 1 "Short press" 2 "Twice short press" 3 "Long press"  ;
VAL_ 696 KAE_EDK1TrunkBtnPressSt 0 "Undifiend" 1 "Short press" 2 "Twice short press" 3 "Long press"  ;
VAL_ 696 KAE_EDK1PanicBtnPressSt 0 "Undifiend" 1 "Short press" 2 "Twice short press" 3 "Long press"  ;
VAL_ 696 KAE_EDK1User_definedBtnPressSt 0 "Undifiend" 1 "Short press" 2 "Twice short press" 3 "Long press"  ;
VAL_ 696 KAE_EDK2UnlockBtnPressSt 0 "Undifiend" 1 "Short press" 2 "Twice short press" 3 "Long press"  ;
VAL_ 696 KAE_EDK2LockBtnPressSt 0 "Undifiend" 1 "Short press" 2 "Twice short press" 3 "Long press"  ;
VAL_ 696 KAE_EDK2RESBtnPressSt 0 "Undifiend" 1 "Short press" 2 "Twice short press" 3 "Long press"  ;
VAL_ 696 KAE_EDK2PSD_LBtnPressSt 0 "Undifiend" 1 "Short press" 2 "Twice short press" 3 "Long press"  ;
VAL_ 696 KAE_EDK2PSD_RBtnPressSt 0 "Undifiend" 1 "Short press" 2 "Twice short press" 3 "Long press"  ;
VAL_ 696 KAE_EDK2TrunkBtnPressSt 0 "Undifiend" 1 "Short press" 2 "Twice short press" 3 "Long press"  ;
VAL_ 696 KAE_EDK2PanicBtnPressSt 0 "Undifiend" 1 "Short press" 2 "Twice short press" 3 "Long press"  ;
VAL_ 696 KAE_EDK2User_definedBtnPressSt 0 "Undifiend" 1 "Short press" 2 "Twice short press" 3 "Long press"  ;
VAL_ 696 KAE_EDK3UnlockBtnPressSt 0 "Undifiend" 1 "Short press" 2 "Twice short press" 3 "Long press"  ;
VAL_ 696 KAE_EDK3LockBtnPressSt 0 "Undifiend" 1 "Short press" 2 "Twice short press" 3 "Long press"  ;
VAL_ 696 KAE_EDK3RESBtnPressSt 0 "Undifiend" 1 "Short press" 2 "Twice short press" 3 "Long press"  ;
VAL_ 696 KAE_EDK3PSD_LBtnPressSt 0 "Undifiend" 1 "Short press" 2 "Twice short press" 3 "Long press"  ;
VAL_ 696 KAE_EDK3PSD_RBtnPressSt 0 "Undifiend" 1 "Short press" 2 "Twice short press" 3 "Long press"  ;
VAL_ 696 KAE_EDK3TrunkBtnPressSt 0 "Undifiend" 1 "Short press" 2 "Twice short press" 3 "Long press"  ;
VAL_ 696 KAE_EDK3PanicBtnPressSt 0 "Undifiend" 1 "Short press" 2 "Twice short press" 3 "Long press"  ;
VAL_ 696 KAE_EDK3User_definedBtnPressSt 0 "Undifiend" 1 "Short press" 2 "Twice short press" 3 "Long press"  ;
VAL_ 696 KAE_RPADirectionSel 0 "No_ParkSlot" 1 "Cross Left Out" 2 "Parallel Left Out" 3 "Front Out" 4 "Cross Right Out" 5 "Parallel Right Out" 6 "Rear Out" 7 "Reserved"  ;
VAL_ 696 KAE_RPAmode 0 "RPA mode" 1 "AVP mode" 2 "Resered" 3 "Resered"  ;
VAL_ 696 KAE_RPADeviceSt 0 "RD_Inactive" 1 "RD_Ready" 2 "RD_Active" 3 "Reserved" 4 "Reserved" 5 "Reserved" 6 "Reserved" 7 "Reserved"  ;
VAL_ 696 KAE_RPACheckReq 0 "Not active" 1 "Requst"  ;
VAL_ 696 KAE_RPAKeyPstSt 0 "In the Car" 1 "Range Too Close" 2 "Normally Range" 3 "Range Too Far"  ;
VAL_ 696 KAE_RPADeviceFailReason 0 "RD_NoFailure" 1 "RD_Offline" 2 "RD_OutOfRange" 3 "RD_LowBatt" 4 "Other Failures" 5 "RD_UserExitParkingMode" 6 "CameraFail" 7 "Charg plug locked" 8 "Remote start fail" 9 "Reserved" 10 "Reserved" 11 "Reserved" 12 "Reserved" 13 "Reserved" 14 "Reserved" 15 "Reserved"  ;
VAL_ 696 KAE_RPABtnSt 0 "Not Pressed" 1 "Pressed"  ;
VAL_ 696 KAE_ForRPAFailReason 0 "SBM_NoFailure" 1 "SBM&RD_Offline" 2 "Not used" 3 "SBM&RPA_Offline" 4 "Other Failures" 5 "Reserved" 6 "Reserved" 7 "Reserved" 8 "Reserved" 9 "Reserved" 10 "Reserved" 11 "Reserved" 12 "Reserved" 13 "Reserved" 14 "Reserved" 15 "Reserved"  ;
VAL_ 696 KAE_RPABtnStVD 0 "Invalid" 1 "Valid"  ;
VAL_ 696 KAE_RPACancelBtnSt 0 "Not Pressed" 1 "Pressed"  ;
VAL_ 696 KAE_RPACancelBtnStVD 0 "Invalid" 1 "Valid"  ;
VAL_ 696 KAE_HAVPCancelParking 0 "No comment" 1 "Cancel"  ;
VAL_ 696 KAE_HAVPDisclaimerAgree 0 "No comment" 1 "Agree" 2 "Disagree" 3 "Reserved"  ;
VAL_ 696 KAE_HAVPUWBZone 0 "Not used" 1 "FL zone" 2 "Ahead zone" 3 "FR zone" 4 "Ahead right side zone" 5 "Back right side zone" 6 "RR zone" 7 "back zone" 8 "RL zone" 9 "Back left side zone" 10 "Ahead left side zone"  ;
VAL_ 696 KAE_UnlockDoorReq 0 "No request" 1 "Unlock"  ;
VAL_ 696 KAE_UnlockDoorReqVD 0 "Invalid" 1 "Valid"  ;
VAL_ 696 KAE_LockDoorReq 0 "No request" 1 "Lock"  ;
VAL_ 696 KAE_LockDoorReqVD 0 "Invalid" 1 "Valid"  ;
VAL_ 696 KAE_WindowsCloseReq 0 "No request" 1 "Close the windows"  ;
VAL_ 696 KAE_WindowsCloseReqVD 0 "Invalid" 1 "Valid"  ;
VAL_ 696 KAE_WindowsOpenReq 0 "No request" 1 "Open the windows"  ;
VAL_ 696 KAE_WindowsOpenReqVD 0 "Invalid" 1 "Valid"  ;
VAL_ 696 KAE_TrunkUnlockReq 0 "No request" 1 "Trunk unlock"  ;
VAL_ 696 KAE_TrunkUnlockReqVD 0 "Invalid" 1 "Valid"  ;
VAL_ 696 KAE_HoodUnlockReq 0 "No request" 1 "Hood unlock"  ;
VAL_ 696 KAE_HoodUnlockReqVD 0 "Invalid" 1 "Valid"  ;
VAL_ 696 KAE_PLGMOpenReq 0 "No request" 1 "PLGM open"  ;
VAL_ 696 KAE_PLGMOpenReqVD 0 "Invalid" 1 "valid"  ;
VAL_ 696 KAE_PLGMCloseReq 0 "No request" 1 "PLGM close"  ;
VAL_ 696 KAE_PLGMCloseReqVD 0 "Invalid" 1 "valid"  ;
VAL_ 696 KAE_SunRoofOpenReq 0 "No request" 1 "Sun roof open"  ;
VAL_ 696 KAE_SunRoofOpenReqVD 0 "Invalid" 1 "Valid"  ;
VAL_ 696 KAE_SunRoofCloseReq 0 "No request" 1 "Sun roof close"  ;
VAL_ 696 KAE_SunRoofCloseReqVD 0 "Invalid" 1 "Valid"  ;
VAL_ 696 KAE_AllCloseReq 0 "No request" 1 "request"  ;
VAL_ 696 KAE_AllCloseReqVd 0 "Invalid" 1 "Valid"  ;
VAL_ 696 KAE_PAAReq 0 "No request" 1 "RPA request" 2 "HPA request" 3 "EDK request" 4 "FOB request"  ;
VAL_ 696 KAE_PAAReqVd 0 "Invalid" 1 "Valid"  ;
VAL_ 696 KAE_EDK1UnlockBtnSt 0 "Not active" 1 "Active"  ;
VAL_ 696 KAE_EDK1LockBtnSt 0 "Not active" 1 "Active"  ;
VAL_ 696 KAE_EDK1RESBtnSt 0 "Not active" 1 "Active"  ;
VAL_ 696 KAE_EDK1PSD_LBtnSt 0 "Not active" 1 "Active"  ;
VAL_ 696 KAE_EDK1PSD_RBtnSt 0 "Not active" 1 "Active"  ;
VAL_ 696 KAE_EDK1TrunkBtnSt 0 "Not active" 1 "Active"  ;
VAL_ 696 KAE_EDK1PanicBtnSt 0 "Not active" 1 "Active"  ;
VAL_ 696 KAE_EDK1User_definedBtnSt 0 "Not active" 1 "Active"  ;
VAL_ 696 KAE_EDK2UnlockBtnSt 0 "Not active" 1 "Active"  ;
VAL_ 696 KAE_EDK2LockBtnSt 0 "Not active" 1 "Active"  ;
VAL_ 696 KAE_EDK2RESBtnSt 0 "Not active" 1 "Active"  ;
VAL_ 696 KAE_EDK2PSD_LBtnSt 0 "Not active" 1 "Active"  ;
VAL_ 696 KAE_EDK2PSD_RBtnSt 0 "Not active" 1 "Active"  ;
VAL_ 696 KAE_EDK2TrunkBtnSt 0 "Not active" 1 "Active"  ;
VAL_ 696 KAE_EDK2PanicBtnSt 0 "Not active" 1 "Active"  ;
VAL_ 696 KAE_EDK2User_definedBtnSt 0 "Not active" 1 "Active"  ;
VAL_ 696 KAE_EDK3UnlockBtnSt 0 "Not active" 1 "Active"  ;
VAL_ 696 KAE_EDK3LockBtnSt 0 "Not active" 1 "Active"  ;
VAL_ 696 KAE_EDK3RESBtnSt 0 "Not active" 1 "Active"  ;
VAL_ 696 KAE_EDK3PSD_LBtnSt 0 "Not active" 1 "Active"  ;
VAL_ 696 KAE_EDK3PSD_RBtnSt 0 "Not active" 1 "Active"  ;
VAL_ 696 KAE_EDK3TrunkBtnSt 0 "Not active" 1 "Active"  ;
VAL_ 696 KAE_EDK3PanicBtnSt 0 "Not active" 1 "Active"  ;
VAL_ 696 KAE_EDK3User_definedBtnSt 0 "Not active" 1 "Active"  ;
VAL_ 403 NDA_Type 0 "Not Active" 1 "HNDA" 2 "CNDA" 3 "AI Driving" 4 "Full Scenario"  ;
VAL_ 403 ADC_ACCMode 0 "Failure" 1 "Passive mode" 2 "Standby mode" 3 "Active control mode" 4 "Brake only mode" 5 "Override" 6 "Standwait" 7 "Standactive" 8 "No Request" 9 "Off" 10 "Not used" 11 "Not used" 12 "Not used" 13 "Not used" 14 "Not used" 15 "Not used"  ;
VAL_ 403 ADAS_Related_System_Failure_St 0 "No Failure" 1 "ESP failure" 2 "EPS failure" 3 "VCU and Relevate System Failure" 4 "EPB failure" 5 "CCU failure" 6 "PADS failure" 7 "IDC failure" 8 "SRS failure" 9 "SBM failure" 10 "DMS failure" 11 "Tbox failure" 12 "HOD failure" 13 "SD Map failure" 14 "Power System failure" 15 "ECS failure" 16 "Others"  ;
VAL_ 403 ADC_ISLC_ConfirmSt 0 "OFF" 1 "Need confirm" 2 "No need confirm" 3 "Not used"  ;
VAL_ 403 ADAS_System_Failure_St 0 "No Failure" 1 "Main ADC Failure" 2 "Redundant ADC Failure" 3 "Driving Function ASW failure" 4 "Parking Function ASW failure" 5 "Active safety Function ASW failure" 6 "FOV120 camera Failure" 7 "FOV30 camera Failure" 8 "Left front camera Failure" 9 "Left rear camera Failure" 10 "Right front camera Failure" 11 "Right rear camera Failure" 12 "Rear camera Failure" 13 "Front AVM camera Failure" 14 "Left AVM camera Failure" 15 "Right AVM camera Failure" 16 "Rear AVM camera Failure" 17 "INU failure" 18 "Front Radar Failure" 19 "Left Front Radar Failure" 20 "Left Rear Radar Failure" 21 "Right Front Radar Failure" 22 "Right  Rear Radar Failure" 23 "Rear Radar Failure（" 24 "Front Lidar Failure" 25 "Left Lidar Failure" 26 "Right Lidar Failure" 27 "Rear Lidar Failure" 28 "USS failure" 29 "ADAS Map Failure"  ;
VAL_ 403 ADC_ACCFailureReason 0 "Not failure reason" 1 "Brake failure" 2 "Sensor failure" 3 "ECU failure" 4 "Power failure" 5 "Steering failure" 6 "Power Supply failure" 7 "ICM failure" 8 "SRS failure" 9 "Reserved" 10 "Reserved" 11 "Reserved" 12 "Reserved" 13 "Reserved" 14 "Reserved" 15 "Other reason"  ;
VAL_ 403 ADC_ACCPassiveReason 0 "No passive reason" 1 "Function configurtion code close" 2 "Four door and two covers not closed" 3 "Not D gear" 4 "Not Forward direction" 5 "Seatbelt unfastened" 6 "SteeringAngle  or SteeringAngleSpd not statisfied" 7 "BrkPedal applied" 8 "Vehicle Speed not statisfied" 9 "EPB not released" 10 "Autohold actived" 11 "ESP not statisfied" 12 "Frontwiper in fast gear" 13 "Reserved" 14 "Reserved" 15 "Other reason"  ;
VAL_ 403 ADC_ACC_SpeedLimitType 0 "No speed SET(when ACC not active)" 1 "User Settings" 2 "ILSC" 3 "Laneline curvature" 4 "SteeringAngle" 5 "Stub or Ramp"  ;
VAL_ 403 ADC_TJP_St 0 "TJP disable" 1 "TJP passive" 2 "TJP standby" 3 "TJP activated-active-normal" 4 "TJP activated-active-standactive" 5 "TJP activated-Lng_override-accel_override" 6 "TJP activated-Lng_override-brake_override" 7 "TJP Lat-Override" 8 "TJP Lat & Lng Override" 9 "TJP SYS-Priority" 10 "TJP 预留" 11 "TJP TOR with Lat-control" 12 "TJP TOR with Lat&Lng-contro" 13 "BOM" 14 "TJP MRM Ego Lane comfortable with Lat-control" 15 "TJP MRM Ego Lane comfortable with Lat&Lng-control" 16 "TJP MRM Ego Lane emergency with Lat-control" 17 "TJP MRM Ego Lane emergency with Lat&Lng-control" 18 "TJP MRC" 19 "TJP failure" 20 "AD Transition Phase" 21 "Not used" 22 "Not used" 23 "Not used" 24 "Not used" 25 "Not used" 26 "Not used" 27 "Not used" 28 "Not used" 29 "Not used" 30 "Not used" 31 "Not used"  ;
VAL_ 403 ADC_TJPIconColor 0 "IconColor_None" 1 "IconColor_Gray" 2 "IconColor_Green" 3 "IconColor_Blue" 4 "IconClolor_Yellow" 5 "override flash（blue）" 6 "TOR_Red"  ;
VAL_ 403 ADC_TimeGapSet 0 "TimeGap 0" 1 "TTimeGap 1" 2 "TimeGap 2" 3 "TimeGap3" 4 "TimeGap 4" 5 "Auto" 6 "TimeGap 5 (Not for GAC-ADAS)" 7 "Not used"  ;
VAL_ 403 ADC_ICA_St 0 "ICA disable" 1 "ICA passive" 2 "ICA standby" 3 "ICA active-Hand On normal" 4 "ICA active-Hand On standwait" 5 "ICA active-Hand On standactive" 6 "ICA active-EPB phase in" 7 "ICA Lat-Override" 8 "ICA Lng-Override Hands On" 9 "ICA Lng-Override Hands Off" 10 "ICA Lat & Lng Override" 11 "ICA TOR with Lat-control" 12 "ICA TOR with Lat&Lng-contro" 13 "BOM" 14 "ICA MRM Ego Lane comfortable with Lat-control" 15 "ICA MRM Ego Lane comfortable with Lat&Lng-control" 16 "ICA MRM Ego Lane emergency with Lat-control" 17 "ICA MRM Ego Lane emergency with Lat&Lng-control" 18 "ICA MRC" 19 "ICA failure light" 20 "ICA failure no light" 21 "Not used" 22 "Not used" 23 "Not used" 24 "Not used" 25 "Not used" 26 "Not used" 27 "Not used" 28 "Not used" 29 "Not used" 30 "Not used" 31 "Not used"  ;
VAL_ 403 ADC_CruiseLatCtrlType 0 "No lateral control" 1 "Active by both line" 2 "Active by Single line" 3 "Active by Single line+Road edge" 4 "Active by Singlel Road edge" 5 "Active by both Road edge" 6 "Active by both Temporary driveway" 7 "Active by Singl Temporary driveway" 8 "Active by Single line+Temporary driveway" 9 "Active by Singlel Road edge+Temporary driveway" 10 "Active by target vehicle" 11 "Temporary Keep Active" 12 "Not used" 13 "Not used" 14 "Not used" 15 "Not used"  ;
VAL_ 403 ADC_Cruise_SpeedLimitType 0 "No speed SET" 1 "User Settings" 2 "heavy weather" 3 "curvature" 4 "lane width" 5 "Adjacent lane target" 6 "crossing" 7 "Lane type switching" 8 "TSR" 9 "TOR" 10 "SteeringAngle" 11 "Stub or Ramp" 12 "Not used" 13 "Not used" 14 "Not used" 15 "Not used"  ;
VAL_ 403 ADC_ILC_EnableSt 0 "Disable" 1 "Enable"  ;
VAL_ 403 ADC_ILOA_EnableSt 0 "Disable" 1 "Enable"  ;
VAL_ 403 ADC_ICA_TORReason 0 "Not TOR" 1 "CID abnormal" 2 "Diagnosis abnormal" 3 "IDC or ICM abnormal" 4 "I  CAN abnormal" 5 "Tire pressure abnormal"  ;
VAL_ 403 ADC_CruiseLat_TORWarn 0 "No warn" 1 "Level 1" 2 "Level 2" 3 "Level 3"  ;
VAL_ 403 ADC_ILOASt 0 "Disable" 1 "Passive" 2 "Stanby" 3 "avoid" 4 "Retreat" 5 "END" 6 "not used" 7 "not used"  ;
VAL_ 403 ADC_ILOAType 0 "no active" 1 "Avoid stationary obstacles" 2 "Avoid stationary vehicles" 3 "Avoid trucks in the next lane" 4 "Risk area avoidance" 5 "Crossing traffic" 6 "not used" 7 "not used"  ;
VAL_ 403 ADC_ILOA_Actdirection 0 "not active" 1 "left" 2 "right" 3 "both"  ;
VAL_ 403 ADC_LaneChangeSt 0 "No Lane Change" 1 "Prepare Lane Change Left" 2 "Prepare Lane Change Right" 3 "Lane Changing left" 4 "Lane Changing Right" 5 "Cancel Lane Changing Left" 6 "Cancel Lane Changing Right" 7 "Lane Change Finished" 8 "Not Used" 9 "Not Used" 10 "Not used" 11 "Not used" 12 "not used" 13 "not used" 14 "not used" 15 "not used"  ;
VAL_ 403 ADC_LaneChange_RetreatReason 0 "not active" 1 "Dashed lines are not satisfied" 2 "Driver cancellation" 3 "GAP front vehicles Sharp slowdown" 4 "GAP rear vehicles rapidly accelerate" 5 "There are Pedestrian in the GAP" 6 "There are stationary obstacles in the GAP" 7 "risk of collision with vehicles in adjacent lanes" 8 "Target lane width not satisfied" 9 "others" 10 "reserved" 11 "reserved" 12 "reserved" 13 "reserved" 14 "reserved" 15 "reserved"  ;
VAL_ 403 ADC_LaneChange_WaitReason 0 "no inhibit" 1 "overline type inhibit" 2 "overline width inhibit" 3 "overline length inhibit" 4 "ego lane width inhibit" 5 "target lane width inhibit" 6 "no GAP available in time" 7 "Higher priority LC inhibit" 8 "longitudinal overide inhibit" 9 "lateral overide inhibit" 10 "Curvature not satisfied" 11 "reserved" 12 "reserved" 13 "reserved" 14 "reserved" 15 "reserved"  ;
VAL_ 403 ADC_LaneChange_AbortReason 0 "no  abort" 1 "GAP front vehicles Sharp slowdown" 2 "GAP rear vehicles rapidly accelerate" 3 "There are Pedestrian in the GAP" 4 "There are stationary obstacles in the GAP" 5 "risk of collision with vehicles in adjacent lanes" 6 "Target lane width narrow" 7 "Origina lane width narrow" 8 "Driver Turn off function" 9 "Curvature not satisfied" 10 "Speed ODD not satisfied" 11 "Tigh priority function is triggered" 12 "others" 13 "reserved" 14 "reserved" 15 "reserved"  ;
VAL_ 403 ADC_LaneChange_Actdirection 0 "not active" 1 "left" 2 "right" 3 "Not used"  ;
VAL_ 403 ADC_ICA_MRMReason 0 "No request" 1 "Hands off overtime" 2 "Not used"  ;
VAL_ 403 ADC_ICAMRMWarningLevel 0 "No request" 1 "Level  1" 2 "Level  2" 3 "Level 3"  ;
VAL_ 403 ADC_ICA_PassiveReason 0 "No Passive State" 1 "Cruise Function Configuration Code Close" 2 "Driver Brake Pedal Pressed" 3 "Driver Steering Torque/Angle/AngleSpd not Satisfied" 4 "Driver Acc Pedal  Applied" 5 "Driver EPB Applied" 6 "Driver Not D gear" 7 "Vehicle Not Forward Direction" 8 "Vehicle Speed not Satisfied" 9 "ADAS System Failure" 10 "Event  Collision" 11 "Vehicle Ignition Off" 12 "High Priority System Activation" 13 "ABS or ESP active" 14 "Driver Cancle Button" 15 "Vehicle Four Doors and Two Covers? not Closed" 16 "Driver Seat Belt not Fastened" 17 "Vehicle Autohold Actived" 18 "Vehicle ADAS Related System Failure" 19 "IBCS Handshake Abnormal" 20 "VCU Handshake Abnormal" 21 "EPS Handshake Abnormal" 22 "Weather Rain not Satisfied（Frontwiper in Fast Gear etc）" 23 "Event Front Object Missing" 24 "Road Lane Topology Cause ACC Exit" 25 "Road and Lane Condotion to Cruise" 26 "Others Reasons Cause ACC Exit" 27 "Driver Hands off Too Long" 28 "VehicleTurn Lamp Light" 29 "Vehicle  Posture is not Satisfied" 30 "Hazard Lamp Light" 31 "Ride Line" 32 "Punish" 33 "Function Safety Condition Require" 34 "Eyes off" 35 "No Navgation" 36 "NDA Enbale Switch" 37 "NDA ODD not Satisfied" 38 "NDA Localization Abnormal" 39 "NDA Plan Abnormal"  ;
VAL_ 403 ADC_ICA_faultReason 0 "NO Function fault state" 1 "Sensor Failure" 2 "ADC Failure" 3 "ZCU failure or BCM  Failure" 4 "CCU failure" 5 "SRS failure" 6 "EPS failure" 7 "EBB failure" 8 ":ESC failure" 9 "VCU and relevate system failure" 10 "IDU failure OR IHU  failure" 11 "A-CAN? failure" 12 "P-CAN failure" 13 "I-CAN failure" 14 "Power abnormal" 15 "IMU failure" 16 "diagnose  abnormal" 17 "CID abnormal" 18 "Physical key failure" 19 "Tire pressure failure" 20 "Tire pressure abnormal" 21 "others"  ;
VAL_ 403 ADC_HFIconColor 0 "IconColor_None" 1 "IconColor_Gray" 2 "IconColor_Green" 3 "IconColor_Blue" 4 "IconClolor_Yellow" 5 "override flash（blue）" 6 "TOR_Red"  ;
VAL_ 403 ADC_AdsFucntionNotActive 0 "no request" 1 "OFF" 2 "ACC" 3 "ICA" 4 "NCA" 5 "AVP" 6 "Autonomous Driving" 7 "Reserved" 8 "Reserved" 9 "Reserved" 10 "Reserved" 11 "Reserved" 12 "Reserved" 13 "Reserved" 14 "Reserved" 15 "Invalid"  ;
VAL_ 403 ADC_HandsOnSt 0 "No request" 1 "Hands On" 2 "Hands Off" 3 "not used"  ;
VAL_ 403 ADC_HandsOn_Warning 0 "No request" 1 "Level  1" 2 "Level  2" 3 "Level 3"  ;
VAL_ 403 ADC_ICMADASFailureText 0 "No display" 1 "Adigo please clean AD sensor" 0 "No display" 1 "Adigo forwad safety function limited" 0 "No display" 1 "Backward safety function limited" 0 "No display" 1 "Adigo LKS function limited" 0 "No display" 1 "Adigo cruise assist function limited" 0 "No display" 1 "Adigo Cruise function can not be activated this ignition cycle" 0 "No display" 1 "Active safety function limited" 0 "No display" 1 "ICA can not be activated this ignition cycle"  ;
VAL_ 403 ADC_ICMADASWarnText 0 "No display" 1 "ACC driving does not meet the open condition" 2 "ICA driving does not meet the open condition" 3 "Synchronize target cruising speed to 20 km/h" 4 "Synchronize target cruising speed to 30 km/h" 5 "Synchronize target cruising speed to 40 km/h" 6 "Synchronize target cruising speed to 50 km/h" 7 "Synchronize target cruising speed to 60 km/h" 8 "Synchronize target cruising speed to 70 km/h" 9 "Synchronize target cruising speed to 80 km/h" 10 "Synchronize target cruising speed to 90 km/h" 11 "Synchronize target cruising speed to 100 km/h" 12 "Synchronize target cruising speed to 110 km/h" 13 "Synchronize target cruising speed to 120 km/h" 14 "Please press the accelerator lightly to resume cruising" 15 "Emergency braking" 16 "Assisting steering" 17 "Emergency turn in progress" 18 "Please pay attention to side and rear road conditions" 19 "Crusing waiting" 20 "Plz focus on road to resume cruise" 21 "Avoiding Now" 22 "Vehicle is now being controlled" 23 "Speed is now being controlled" 24 "Direction is now being controlled" 25 "Downgraded to ACC" 26 "Downgraded to ICA" 27 "Driven based on the Navigation now" 28 "Driven within the lane now" 29 "Please brake" 30 "PMA Activates please release the gaspedal" 31 "Text1"  ;
VAL_ 403 ADC_SpeedLimitIconSt 0 "SpeedLimitIconAction_None" 1 "SpeedLimitIconAction_Flash" 2 "SpeedLimitIconAction_Constant" 3 "SpeedLimitFault" 4 "SpeedLimitIconAction_Absolute" 5 "SpeedLimitIcon_NoDisplay" 6 "SpeedLimitIcon_OFF" 7 "Reserved"  ;
VAL_ 403 ADC_ICMWarnCardSt 0 "HORValue_None" 1 "HORValue_Level1_HOD" 2 "HORValue_Level2" 3 "HORValue_Level3" 4 "FORValue_Level1" 5 "FORValue_Level2" 6 "FORValue_Level3" 7 "TORValueLat_level1" 8 "TORValueLat_level2" 9 "TORValueLat_level3" 10 "TORValueLongLat_level1" 11 "TORValueLongLat_level2" 12 "TORValueLongLat_level3" 13 "TORValue_Stopping" 14 "TORValue_Stopped" 15 "HORValue_Level1" 16 "HORValue_Level2_HOD" 17 "HORValue_Level3_HOD" 18 "TOR_RoadBlockageAhead" 19 "TOR_CameraBlockageByWiper" 20 "TOR_LackOfLight" 21 "TOR_OverSpeed" 22 "TOR_LCCNoTurning" 23 "TOR_ADSEnded" 24 "Be about to arrive the TollStation, please take over" 25 "Be about to turn around, please take over" 26 "Be about to arrive the Roundabout, please take over" 27 "Be about to arrive the destination, please take over" 28 "TOR_BraketoTakeOver" 29 "TOR_PlzTakeoverCannotPassNarrowroad" 30 "TOR_PlzTakeoverSystemNotSupportU-Turn" 31 "TOR_Reserved"  ;
VAL_ 403 ADC_ICAIconColor 0 "IconColor_None" 1 "IconColor_Gray" 2 "IconColor_Green" 3 "IconColor_Blue" 4 "IconClolor_Yellow" 5 "override flash_blue" 6 "TOR_Red"  ;
VAL_ 403 ADC_ICMPromptWarn 0 "None" 1 "On-ramp successful/in-main successful" 2 "NDA exit" 3 "ACC open" 4 "ACC/ICA fails to be enabled" 5 "ACC stop & go" 6 "ACC exit" 7 "ICA open" 8 "ICA exit" 9 "Level 1 distraction alert/Level 1 hand alert/Level 1 take-over alert" 10 "Second and third level distraction reminder/second and third level hand reminder/second and third level take-over reminder" 11 "Level 4 take-over alert/Level 5 take-over alert" 12 "/FCTA left alarm /FCTA right alarm /RCTA left alarm /RCTA right alarm /DOW left alarm /DOW right alarm /LDW left deviation alarm /LDW right deviation alarm" 13 "Active braking alarm/collision avoidance steering auxiliary alarm/automatic collision avoidance steering alarm /FCTB left alarm /FCTB right alarm /RCTB left alarm /RCTB right alarm /ELKA left deviation alarm /ELKA right deviation alarm" 14 "TSR speeding alarm" 15 "Intelligent driving fault prompt tone" 16 "Failed to enable the cruise function" 17 "NDA open" 18 "Please change lane manually" 19 "HWA failed" 20 "TJP open" 21 "TJP exit" 22 "TJP overspeed'" 23 "The same as '0xC' , should play the prompt sound until stop request" 24 "PMA alarms" 25 "PromptWarn1" 26 "PromptWarn2"  ;
VAL_ 403 ADC_NDAIconColor 0 "IconColor_None" 1 "IconColor_Gray" 2 "IconColor_Green" 3 "IconColor_Blue" 4 "IconClolor_Yellow" 5 "override flash（blue）" 6 "TOR_Red"  ;
VAL_ 403 ADC_ACUVoiceWarn 0 "Default value" 1 "Navigation Assistance has been activated for you" 2 "Prepare left lane change" 3 "Prepare right lane change" 4 "Wait for lane change" 5 "Lane changes have been canceled" 6 "Please make a hand change to the right" 7 "Please make a hand change to the left" 8 "Be about to diverge" 9 "Complete Diverging, please drive carefully" 10 "Be about to merge" 11 "After 1 km it will leave the navigation driving section" 12 "After 200 meters the function will exit please prepare to take over" 13 "After 100 meters the function wil exit please take over immediately" 14 "Navigational Assistance has ended" 15 "Driver assistance has ended" 16 "Complex road conditions, drive carefully" 17 "Construction section, please drive carefully" 18 "Lane change along the navigation to the right" 19 "Lane change to the left for overtaking" 20 "Lane change along navigation to the left" 21 "Lane change to the right for overtaking" 22 "Driver has controlled the speed" 23 "Driver has controlled the direction" 24 "Pay attention to the still flashing blinker" 25 "ACC has been actived" 26 "NDA has been downgraded to ICA" 27 "NDA has been activated" 28 "NDA has been downgraded to ACC" 29 "ICA has been Actived"  ;
VAL_ 403 ADC_NDAStateIcon 0 "NDAStateIcon_None" 1 "NDAStateIcon_PreActive" 2 "NDAStateIcon_Active" 3 "NDAStateIcon_Override" 4 "NDAStateIcon_TurnLeft" 5 "NDAStateIcon_TurnRight"  ;
VAL_ 403 ADC_ACCIconColor 0 "IconColor_None" 1 "IconColor_Gray" 2 "IconColor_Green" 3 "IconColor_Blue" 4 "IconClolor_Yellow" 5 "IconAction_Blue_Appear_Speed_limit_synchronized" 6 "TOR_flash"  ;
VAL_ 403 ADC_ICMADASFailureLamp 0 "Light Off" 1 "Light On" 2 "Reserved" 3 "Reserved"  ;
VAL_ 403 ADC_Pilot_VoiceWarn 0 "No display" 1 "TJP has been activated" 2 "TJP has ended" 3 "Complex road conditions, drive carefully" 4 "Construction section, please drive carefully" 5 "Complex road conditions, please take over the Vehicle"  ;
VAL_ 403 ADC_Pilot_PromptWarn 0 "None" 1 "TJP open" 2 "TJP Exit" 3 "TJP fails to be enabled"  ;
VAL_ 403 ADC_Pilot_WarnText 0 "No display" 1 "TJP driving does not meet the open condition" 2 "TJP driving could be activated in this section" 3 "TJP has exited" 4 "Complex road conditions, please take over the Vehicle"  ;
VAL_ 403 ADC_Pilot_WarnCardSt 0 "HORValue_None" 1 "HORValue_Level1" 2 "HORValue_Level2" 3 "HORValue_Level3" 4 "FORValue_Level1" 5 "FORValue_Level2" 6 "FORValue_Level3" 7 "TORValueLong_level1" 8 "TORValueLong_level2" 9 "TORValueLong_level3" 10 "TORValueLat_level1" 11 "TORValueLat_level2" 12 "TORValueLat_level3" 13 "TORValue_Stopping" 14 "TORValue_Stopped"  ;
VAL_ 403 ADC_AdsFault 0 "no request" 1 "no fault" 2 "fault" 3 "reserved" 4 "reserved" 5 "reserved" 6 "reserved" 7 "Invalid"  ;
VAL_ 403 ADC_NicaReminderLEDVisual 0 "no request" 1 "turn on" 2 "turn off" 3 "reserved" 4 "reserved" 5 "reserved" 6 "reserved" 7 "Invalid"  ;
VAL_ 403 ADC_NicaReminderAcoustic 0 "no request" 1 "acoustic" 2 "no acoustic" 3 "torL1_acoustic" 4 "aeb_acoustic" 5 "reserved" 6 "reserved" 7 "Invalid"  ;
VAL_ 403 ADC_AdsTakeoverID 0 "no request"  ;
VAL_ 403 ADC_AdsTakeoverLevel 0 "no request" 1 "Level 1" 2 "Level 2" 3 "Level 3" 4 "Level 4" 5 "reserved" 6 "reserved" 7 "Invalid"  ;
VAL_ 403 ADC_TORIDCorrespErrorID 0 "no request"  ;
VAL_ 403 ADC_AvpFunctionStatus 0 "no request" 1 "AVP_STATE_OFF" 2 "AVP_STATE_STANDBY" 3 "AVP_STATE_LOGITUDINALOVERRIDE" 4 "AVP_STATE_ACTIVE" 5 "Reserved" 6 "Reserved" 7 "Reserved" 8 "Reserved" 9 "Reserved" 10 "Reserved" 11 "Reserved" 12 "Reserved" 13 "Reserved" 14 "Reserved" 15 "Reserved" 16 "Reserved" 17 "Reserved" 18 "Reserved" 19 "Reserved" 20 "Reserved" 21 "Reserved" 22 "Reserved" 23 "Reserved" 24 "Reserved" 25 "Reserved" 26 "Reserved" 27 "Reserved" 28 "Reserved" 29 "Reserved" 30 "Reserved" 31 "Invalid"  ;
VAL_ 403 ADC_CalibState 0 "no request" 1 "off" 2 "on" 3 "reserved" 4 "reserved" 5 "reserved" 6 "reserved"  ;
VAL_ 403 ADC_AccFunctionStatus 0 "No request" 1 "ACC_OFF" 2 "ACC_STANDBY" 3 "ACC_OVERRIDE" 4 "ACC_ACTIVE" 5 "ACC_STANDSTILL" 6 "Reserved" 7 "Reserved" 8 "Reserved" 9 "Reserved" 10 "Reserved" 11 "Reserved" 12 "Reserved" 13 "Reserved" 14 "Reserved" 15 "Invalid"  ;
VAL_ 403 ADC_NicaFunctionStatus 0 "no request" 1 "OFF" 2 "ICA_STANDBY" 3 "ICA_LATERAL_OVERRIDE" 4 "ICA_LONGITUDINAL_OVERRIDE" 5 "ICA_LAT_LONG_OVERRIDE" 6 "ICA_ACTIVE" 7 "NCA_STANDBY" 8 "NCA_LATERAL_OVERRIDE" 9 "NCA_LONGITUDINAL_OVERRIDE" 10 "NCA_LAT_LONG_OVERRIDE" 11 "NCA_ACTIVE" 12 "Reserved" 13 "Reserved" 14 "Reserved" 15 "Reserved" 16 "Reserved" 17 "Reserved" 18 "Reserved" 19 "Reserved" 20 "Reserved" 21 "Reserved" 22 "Reserved" 23 "Reserved" 24 "Reserved" 25 "Reserved" 26 "Reserved" 27 "Reserved" 28 "Reserved" 29 "Reserved" 30 "Reserved" 31 "Reserved" 32 "Reserved" 33 "Reserved" 34 "Reserved" 35 "Reserved" 36 "Reserved" 37 "Reserved" 38 "Reserved" 39 "Reserved" 40 "Reserved" 41 "Reserved" 42 "Reserved" 43 "Reserved" 44 "Reserved" 45 "Reserved" 46 "Reserved" 47 "Reserved" 48 "Reserved" 49 "Reserved" 50 "Reserved" 51 "Reserved" 52 "Reserved" 53 "Reserved" 54 "Reserved" 55 "Reserved" 56 "Reserved" 57 "Reserved" 58 "Reserved" 59 "Reserved" 60 "Reserved" 61 "Reserved" 62 "Reserved" 63 "Invalid"  ;
VAL_ 403 ADC_AEBWaning 0 "no request" 1 "Off" 2 "Active" 3 "IBA" 4 "Hold" 5 "Inactive (standby)" 6 "Nolicense" 7 "Reserved" 8 "Reserved" 9 "Reserved" 10 "Reserved" 11 "Reserved" 12 "Reserved" 13 "Reserved" 14 "Reserved" 15 "Invalid"  ;
VAL_ 403 ADC_LKAWarning 0 "no request" 1 "Off" 2 "Standby" 3 "Ready" 4 "Active_Left" 5 "Active_Right" 6 "Switchoff" 7 "Invalid"  ;
VAL_ 403 ADC_LCCStateIcon 0 "LCCStateIcon_None" 1 "LCCStateIcon_PreActive" 2 "LCCStateIcon_Active" 3 "LCCStateIcon_Override" 4 "LCCStateIcon_TurnLeft" 5 "LCCStateIcon_TurnRight" 6 "LCCStateIcon_1" 7 "LCCStateIcon_2"  ;
