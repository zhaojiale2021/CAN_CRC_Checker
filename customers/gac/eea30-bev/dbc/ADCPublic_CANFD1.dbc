VERSION "Version"

NS_ :

BS_:

BU_: CCU ADC FAPA IFC FLR FRR RRR RLR INU Tester CBM VIU SRS IDC PCS AMP IMR FIMR TBOX IBCS IXCU V2XOBU WHUD RLBMS CCURT2 RT2_C3 OTAWL ZCUF ZCUL ZCUR ZCUT IPS DCU NIDU RBM WACUFL IID CCURT1 RT1_C0 RT1_C1 AVAS FLLCM FRLCM RLLCMA RRLCMA RLLCMB RRLCMB LBMS LBMSAD MFS FCP IDU ITS BCB DCDC PCU EOP DCU2 BMS TMC EPS ECS CD PAS SBM WCM ETC TBOX2 DSM FLPDM FRPDM RLPDM RRPDM HVSMR SCMRL SCMRR EBU EPB VDC EVCC ADM PLGM FBLCM RLISD RRISD RCP RFR WCMFR SCMR TFOAR TROAR HVSPRL HVSPRR

BO_ 419 ADC_4: 64 ADC
 SG_ ADC_4_CRC : 7|16@0+ (1,0) [0|65535] ""  CCU,CCURT1,CCURT2,RT1_C1,RT2_C3,ZCUF,ZCUT,VDC,EPS,RBM,IBCS,FAPA,IFC
 SG_ ADC_4_Counter : 23|8@0+ (1,0) [0|255] ""  CCU,CCURT1,CCURT2,RT1_C1,RT2_C3,ZCUF,ZCUT,VDC,EPS,RBM,IBCS,FAPA,IFC
 SG_ ADC_AngReqSt_A : 31|2@0+ (1,0) [0|3] ""  CCU,CCURT1,CCURT2,EPS,FAPA,IFC
 SG_ ADC_AngReqFunction : 29|2@0+ (1,0) [0|3] ""  CCU,CCURT1,CCURT2,EPS,FAPA,IFC
 SG_ ADC_BrakeLightReq : 27|2@0+ (1,0) [0|3] ""  CCU,CCURT1,CCURT2,RT2_C3,FAPA
 SG_ ADC_StrAngleReq_A : 39|16@0+ (0.1,-780) [-780|780] "deg"  CCU,CCURT1,CCURT2,EPS,FAPA,IFC
 SG_ ADC_SACMotorTorLimExtMax_A : 55|8@0+ (0.02,0) [0|5.08] "Nm"  CCU,CCURT1,CCURT2,EPS,FAPA,IFC
 SG_ ADC_SACMotorTorLimExtMin_A : 63|8@0+ (0.02,-5.08) [-5.08|0] "Nm"  CCU,CCURT1,CCURT2,EPS,FAPA,IFC
 SG_ ADC_AssistParaSwitchReq : 71|1@0+ (1,0) [0|1] ""  CCU,CCURT1,CCURT2,EPS,IDC,FAPA,IFC
 SG_ ADC_AngReqRdntReq_A : 70|1@0+ (1,0) [0|1] ""  CCU,CCURT1,CCURT2,EPS,FAPA,IFC
 SG_ ADC_SteerGainReq : 69|1@0+ (1,0) [0|1] ""  CCU,CCURT1,CCURT2,EPS,FAPA,IFC
 SG_ ADC_StrgWhlVibrWarnLevel : 68|2@0+ (1,0) [0|3] ""  CCU,CCURT1,CCURT2,EPS,FAPA,IFC
 SG_ ADC_ActTrqReqEnable : 66|1@0+ (1,0) [0|1] ""  CCU,CCURT1,CCURT2,RT1_C1,VDC,FAPA,IFC,TBOX
 SG_ ADC_VLCSt : 65|2@0+ (1,0) [0|2] ""  CCU,CCURT1,CCURT2,RT1_C1,VDC,FAPA,IFC,TBOX
 SG_ ADC_SteerGainLevel : 79|8@0+ (1,0) [0|254] "%"  CCU,CCURT1,CCURT2,EPS,FAPA,IFC
 SG_ ADC_EvsSteerReq : 87|1@0+ (1,0) [0|1] ""  CCU,CCURT1,CCURT2,EPS,FAPA,IFC
 SG_ ADC_StrgWhlVibrWarnReq : 86|1@0+ (1,0) [0|1] ""  CCU,CCURT1,CCURT2,EPS,FAPA,IFC
 SG_ ADC_ActTrqReq : 85|14@0+ (1,-5000) [-5000|5000] "Nm"  CCU,CCURT1,CCURT2,RT1_C1,VDC,FAPA,IFC,TBOX
 SG_ ADC_PAA2ESPSpdLimit : 103|8@0+ (0.1,0) [0|25.5] "kmh"  CCU,CCURT1,CCURT2,FAPA
 SG_ IFC_DPTst : 122|3@0+ (1,0) [0|7] ""  CCU,FAPA
 SG_ ADC_DrvTarTqMod2EPB : 124|2@0+ (1,0) [0|3] ""  CCU,CCURT1,CCURT2,FAPA
 SG_ ADC_ADASLongCtrlFuncMode : 135|3@0+ (1,0) [0|7] ""  CCU,CCURT1,CCURT2,RT1_C1,VDC,RBM,IBCS,FAPA,IFC,TBOX
 SG_ ADC_LongCtrlAvailability : 132|1@0+ (1,0) [0|1] ""  CCU,CCURT1,CCURT2,RT1_C1,ZCUF,ZCUT,VDC,EPS,RBM,IBCS,FAPA,IFC
 SG_ ADC_LongCtrlModeForBrkSys : 131|3@0+ (1,0) [0|7] ""  CCU,CCURT1,CCURT2,RT1_C1,VDC,RBM,IBCS,FAPA,IFC,TBOX
 SG_ ADC_LongCtrlTargetAxReq : 128|1@0+ (1,0) [0|1] ""  CCU,CCURT1,CCURT2,RBM,IBCS,FAPA,IFC,TBOX
 SG_ ADC_LongCtrlTypReq : 143|1@0+ (1,0) [0|1] ""  CCU,CCURT1,CCURT2,RT1_C1,RBM,IBCS,FAPA,IFC,TBOX
 SG_ ADC_LongCtrlDecToStopReq : 142|1@0+ (1,0) [0|1] ""  CCU,CCURT1,CCURT2,RBM,IBCS,FAPA,IFC,TBOX
 SG_ ADC_LongCtrlDriveOff : 141|1@0+ (1,0) [0|1] ""  CCU,CCURT1,CCURT2,RBM,IBCS,FAPA,IFC,TBOX
 SG_ ADC_LongctrlSecureReq : 140|1@0+ (1,0) [0|1] ""  CCU,CCURT1,CCURT2,ZCUF,ZCUT,RBM,IBCS,FAPA,IFC,TBOX
 SG_ ADC_ShifttoAVHReq : 139|1@0+ (1,0) [0|1] ""  CCU,CCURT1,CCURT2,RBM,IBCS,FAPA,IFC,TBOX
 SG_ ADC_LongCtrlTargetAx : 138|11@0+ (0.01,-10) [-10|10] "m/s2"  CCU,CCURT1,CCURT2,RBM,IBCS,FAPA,IFC,TBOX
 SG_ ADC_TrkTargt0St : 159|1@0+ (1,0) [0|1] ""  CCU,CCURT1,CCURT2,RT1_C1,VDC,FAPA,IFC,TBOX
 SG_ ADC_TrkTargt0longPos : 158|10@0+ (0.2,0) [0|204.4] "m"  CCU,CCURT1,CCURT2,RT1_C1,VDC,FAPA,IFC,TBOX
 SG_ ADC_TrkTargt0latPos : 164|10@0+ (0.1,-51.2) [-51.2|51.1] "m"  CCU,CCURT1,CCURT2,RT1_C1,VDC,FAPA,IFC,TBOX
 SG_ ADC_TrkTargt0LatRelSpd : 170|9@0+ (0.1,-25.5) [-25.5|25.5] "m/s"  CCU,CCURT1,CCURT2,RT1_C1,VDC,FAPA,IFC,TBOX
 SG_ ADC_TrkTargt0LongRelSpd : 177|10@0+ (0.1,-51.2) [-51.2|51.1] "m/s"  CCU,CCURT1,CCURT2,RT1_C1,VDC,FAPA,IFC,TBOX
 SG_ ADC_AS_pauseReq : 199|1@0+ (1,0) [0|1] ""  CCU,CCURT1,CCURT2,FAPA
 SG_ ADC_AS_calibrationReq : 198|3@0+ (1,0) [0|5] ""  CCU,CCURT1,CCURT2,FAPA
 SG_ ADC_AS_exitcurrentlevelReq : 195|1@0+ (1,0) [0|1] ""  CCU,CCURT1,CCURT2,FAPA
 SG_ ADC_AS_ReqToadjust : 194|3@0+ (1,0) [0|5] ""  CCU,CCURT1,CCURT2,FAPA
 SG_ ADC_ASActiveSt : 206|1@0+ (1,0) [0|1] ""  CCU,CCURT1,CCURT2,RT1_C1,VDC,FAPA
 SG_ ADC_AS_UnsafelevelunableReq : 207|1@0+ (1,0) [0|1] ""  CCU,CCURT1,CCURT2,FAPA
 SG_ ADC_FcsActiveStatus : 205|1@0+ (1,0) [0|1] ""  CCU,CCURT1,CCURT2,RT1_C1,VDC,FAPA
 SG_ ADC_ComfstopReq : 244|1@0+ (1,0) [0|1] ""  CCU
 SG_ ADC_CSM_HoldReq : 245|1@0+ (1,0) [0|1] ""  CCU
 SG_ ADC_AEBTargetDecel : 243|12@0+ (0.008,-16) [-16|16] "m/s2"  CCU,CCURT1,CCURT2,IBCS,FAPA,FLR,FRR,IFC,TBOX
 SG_ ADC_AEBFaultSt : 263|1@0+ (1,0) [0|1] ""  CCU,CCURT1,CCURT2,RT1_C1,SRS,IDC,FAPA,IFC,TBOX
 SG_ ADC_AEBOffSt : 262|1@0+ (1,0) [0|1] ""  CCU,CCURT1,CCURT2,RT1_C1,SRS,IDC,FAPA,IFC,TBOX
 SG_ ADC_AEBInterventionSt : 261|1@0+ (1,0) [0|1] ""  CCU,CCURT1,CCURT2,RT1_C1,SRS,FAPA,IFC,TBOX
 SG_ ADC_AEBDecelCtrlReq : 260|1@0+ (1,0) [0|1] ""  CCU,CCURT1,CCURT2,RT1_C1,VDC,RBM,IBCS,FAPA,FLR,FRR,IFC,TBOX
 SG_ ADC_AEBLVehHoldReq : 259|1@0+ (1,0) [0|1] ""  CCU,CCURT1,CCURT2,RBM,IBCS,FAPA,IFC,TBOX
 SG_ ADC_ABAReq : 258|1@0+ (1,0) [0|1] ""  CCU,CCURT1,CCURT2,RBM,IBCS,FAPA,IFC,TBOX
 SG_ ADC_ABALevel : 257|2@0+ (1,0) [0|3] ""  CCU,CCURT1,CCURT2,RBM,IBCS,FAPA,IFC,TBOX
 SG_ ADC_AWBReq : 271|1@0+ (1,0) [0|1] ""  CCU,CCURT1,CCURT2,RBM,IBCS,FAPA,IFC,TBOX
 SG_ ADC_ABPReq : 270|1@0+ (1,0) [0|1] ""  CCU,CCURT1,CCURT2,RBM,IBCS,FAPA,IFC,TBOX
 SG_ ADC_AWBLevel : 269|3@0+ (1,0) [0|7] ""  CCU,CCURT1,CCURT2,RBM,IBCS,FAPA,IFC,TBOX
 SG_ ADC_AEBTarCalss : 266|3@0+ (1,0) [0|7] ""  CCU,CCURT1,CCURT2,RT1_C1,SRS,FAPA,IFC,TBOX
 SG_ ADC_AEBTarDetSensor : 277|2@0+ (1,0) [0|3] ""  CCU,CCURT1,CCURT2,RT1_C1,SRS,FAPA,IFC,TBOX
 SG_ ADC_TurnLightReq : 275|3@0+ (1,0) [0|7] ""  CCU,CCURT1,CCURT2,RT2_C3,SRS,FAPA,IFC
 SG_ ADC_PAA2ESPAxReqEnable : 272|1@0+ (1,0) [0|1] ""  CCU,CCURT1,CCURT2,ZCUF,ZCUT,IBCS,FAPA
 SG_ ADC_PAA2ESPBrakeFunctionMode : 287|3@0+ (1,0) [0|7] ""  CCU,CCURT1,CCURT2,RT1_C1,ZCUF,ZCUT,VDC,IBCS,FAPA
 SG_ ADC_PAA2ESPEpbReq : 284|2@0+ (1,0) [0|2] ""  CCU,CCURT1,CCURT2,IBCS,FAPA
 SG_ ADC_PAA2EPBEpbReq : 281|2@0+ (1,0) [0|2] ""  CCU,CCURT1,CCURT2,IBCS,FAPA
 SG_ ADC_PAA2ESPEpbReqSt : 282|1@0+ (1,0) [0|1] ""  CCU,CCURT1,CCURT2,FAPA
 SG_ ADC_PAA2ESPComfBrakeReq : 291|2@0+ (1,0) [0|3] ""  CCU,CCURT1,CCURT2,FAPA
 SG_ ADC_ESPSwitchReq : 295|1@0+ (1,0) [0|1] ""  CCU,CCURT1,CCURT2,RBM,IBCS,FAPA,IFC
 SG_ ADC_PAA2EPBEpbReqSt : 294|1@0+ (1,0) [0|1] ""  CCU,CCURT1,CCURT2,IBCS,FAPA
 SG_ ADC_PAA2EPBBrakeFunctionMode : 293|1@0+ (1,0) [0|1] ""  CCU,CCURT1,CCURT2,IBCS,FAPA
 SG_ ADC_PAA2ESPApEmgyBrkReq : 292|1@0+ (1,0) [0|1] ""  CCU,CCURT1,CCURT2,IBCS,FAPA
 SG_ ADC_PAA2ESPApDriveOffReq : 289|1@0+ (1,0) [0|1] ""  CCU,CCURT1,CCURT2,IBCS,FAPA
 SG_ ADC_AEBObjectTTC : 288|9@0+ (0.01,0) [0|5] "s"  CCU,CCURT1,CCURT2,RT1_C1,SRS,FAPA,IFC,TBOX
 SG_ ADC_PAA2ESPApStandstillReq : 311|1@0+ (1,0) [0|1] ""  CCU,CCURT1,CCURT2,IBCS,FAPA
 SG_ ADC_PAA2ESPApPrefillReq : 310|1@0+ (1,0) [0|1] ""  CCU,CCURT1,CCURT2,ZCUF,ZCUT,IBCS,FAPA
 SG_ ADC_AEBObjRelativeSpd : 304|9@0+ (0.1,0) [0|50] "m/s"  CCU,CCURT1,CCURT2,RT1_C1,SRS,FAPA,IFC,TBOX
 SG_ ADC_PAA2ESPAxReq : 327|14@0+ (0.001,-10) [-10|6] "m/s2"  CCU,CCURT1,CCURT2,ZCUF,ZCUT,IBCS,FAPA
 SG_ ADC_EPBReq : 329|1@0+ (1,0) [0|1] ""  CCU,CCURT1,CCURT2,FAPA,IFC
 SG_ ADC_ActTrqReqVD : 341|1@0+ (1,0) [0|1] ""  CCU,CCURT1,CCURT2,RT1_C1,VDC,FAPA
 SG_ ADC_TarGearReqVld : 342|1@0+ (1,0) [0|1] ""  CCU,CCURT1,CCURT2,RT1_C1,VDC,FAPA
 SG_ ADC_FctSts : 343|1@0+ (1,0) [0|1] ""  CCU,CCURT1,CCURT2,RT1_C1,VDC,FAPA
 SG_ ADC_PAA2ESPDistoStop : 339|12@0+ (1,0) [0|4095] "cm"  CCU,CCURT1,CCURT2,ZCUF,ZCUT,IBCS,FAPA
 SG_ ADC_PAA2ESPTarTorquePTDriveoff : 359|16@0+ (1,-30000) [-30000|30000] "Nm"  CCU,CCURT1,CCURT2,IBCS,FAPA
 SG_ ADC_VehTorqLimit : 375|16@0+ (1,-5000) [-5000|5000] "Nm"  CCU,CCURT1,CCURT2,RT1_C1,VDC,FAPA
 SG_ ADC_VehTorqReqValue : 391|16@0+ (1,-5000) [-5000|5000] "Nm"  CCU,CCURT1,CCURT2,RT1_C1,VDC,FAPA
 SG_ ADC_VehTorqLimitEnable : 407|1@0+ (1,0) [0|1] ""  CCU,CCURT1,CCURT2,RT1_C1,VDC,FAPA
 SG_ ADC_VehTorqReqEnable : 406|1@0+ (1,0) [0|1] ""  CCU,CCURT1,CCURT2,RT1_C1,VDC,FAPA
 SG_ ADC_PAAPwrModeReq : 405|1@0+ (1,0) [0|1] ""  CCU,CCURT1,CCURT2,RT1_C1,VDC,FAPA
 SG_ ADC_PAAGrarLvlReq : 404|3@0+ (1,0) [0|7] ""  CCU,CCURT1,CCURT2,RT1_C1,VDC,FAPA
 SG_ ADC_PAAGrarLvlReqEnable : 401|1@0+ (1,0) [0|1] ""  CCU,CCURT1,CCURT2,RT1_C1,VDC,FAPA
 SG_ ADC_ACCMode_C : 415|4@0+ (1,0) [0|15] ""  CCU,CCURT1,CCURT2,SRS,FAPA
 SG_ ADC_RCTBTargetDecel : 411|8@0+ (0.05,-10) [-10|2.75] "m/s2"  CCU,CCURT1,CCURT2,FAPA
 SG_ ADC_RCTBBrkReq : 419|1@0+ (1,0) [0|1] ""  CCU,CCURT1,CCURT2,FAPA
 SG_ ADC_BrkTarTqEna : 125|1@0+ (1,0) [0|1] ""  CCU,CCURT1,CCURT2,FAPA
 SG_ ADC_BrkTarTqMod : 25|2@0+ (1,0) [0|3] ""  CCU,CCURT1,CCURT2,FAPA
 SG_ ADC_AebBrkTarTq : 111|16@0+ (1,0) [0|65535] "Nm"  CCU,CCURT1,CCURT2,FAPA
 SG_ ADC_EpbModReqVld : 126|1@0+ (1,0) [0|1] ""  CCU,CCURT1,CCURT2,FAPA
 SG_ ADC_RWUEna : 127|1@0+ (1,0) [0|1] ""  CCU,CCURT1,CCURT2,FAPA
 SG_ ADC_BrkHoldReq : 279|2@0+ (1,0) [0|3] ""  CCU,CCURT1,CCURT2,FAPA
 SG_ ADC_AngReqAvl : 340|1@0+ (1,0) [0|1] ""  CCU,CCURT1,CCURT2,FAPA
 SG_ ADC_BrkTarTqVld : 328|1@0+ (1,0) [0|1] ""  CCU,CCURT1,CCURT2,FAPA
 SG_ ADC_AebBrkTarTqVld : 305|1@0+ (1,0) [0|1] ""  CCU,CCURT1,CCURT2,FAPA
 SG_ ADC_AebBrkTarTqEna : 306|1@0+ (1,0) [0|1] ""  CCU,CCURT1,CCURT2,FAPA
 SG_ ADC_ElecBrkFnSwitch : 307|1@0+ (1,0) [0|1] ""  CCU,CCURT1,CCURT2,RT1_C1,VDC,FAPA
 SG_ ADC_RWUVld : 400|1@0+ (1,0) [0|1] ""  CCU,CCURT1,CCURT2,FAPA
 SG_ ADC_DriverPresent : 309|2@0+ (1,0) [0|3] ""  CCU,CCURT1,CCURT2,RT2_C3,FAPA
 SG_ ADC_BrkTarTq : 439|16@0+ (1,0) [0|65535] "Nm"  CCU,CCURT1,CCURT2,FAPA
 SG_ ADC_4_FreshnessValue : 455|16@0+ (1,0) [0|255] ""  CCU,CCURT1,IDC,FAPA
 SG_ ADC_4_MAC_Check : 471|48@0+ (1,0) [0|255] ""  CCU,CCURT1,IDC,FAPA

BO_ 659 ADC_5: 64 ADC
 SG_ ADC_5_CRC : 7|16@0+ (1,0) [0|65535] ""  CCU,CCURT1,CCURT2,IFC,Tester
 SG_ ADC_5_Counter : 23|8@0+ (1,0) [0|255] ""  CCU,CCURT1,CCURT2,IFC,Tester
 SG_ ADC_NDASt : 31|6@0+ (1,0) [0|63] ""  CCU,CCURT1,CCURT2,RT1_C1,VDC,IFC,TBOX,Tester
 SG_ ADC_NDATORType : 39|4@0+ (1,0) [0|15] ""  CCU,CCURT1,CCURT2,Tester
 SG_ ADC_NDADecideResult : 35|5@0+ (1,0) [0|31] ""  CCU,CCURT1,CCURT2,IFC,Tester
 SG_ ADC_NDATargetLane : 46|3@0+ (1,0) [0|7] ""  CCU,CCURT1,CCURT2,IFC,Tester
 SG_ ADC_NDASplitSt : 43|3@0+ (1,0) [0|7] ""  CCU,CCURT1,CCURT2,Tester
 SG_ ADC_NDALaneChangeOverlineTOR : 40|1@0+ (1,0) [0|1] ""  CCU,CCURT1,CCURT2,Tester
 SG_ ADC_ALCSuspendReason : 55|4@0+ (1,0) [0|15] ""  CCU,CCURT1,CCURT2,Tester
 SG_ ADC_SplitSuspendReason : 51|4@0+ (1,0) [0|15] ""  CCU,CCURT1,CCURT2,Tester
 SG_ ADC_NDAEnableSt : 63|1@0+ (1,0) [0|1] ""  CCU,CCURT1,CCURT2,IDC
 SG_ ADC_NDAFailureReason : 62|6@0+ (1,0) [0|63] ""  CCU,CCURT1,CCURT2,Tester
 SG_ ADC_NDANotactivereason : 56|5@0+ (1,0) [0|31] ""  CCU,CCURT1,CCURT2,Tester
 SG_ ADC_NDAGeoFence : 67|2@0+ (1,0) [0|3] ""  CCU,CCURT1,CCURT2,Tester
 SG_ ADC_NDAODDnotMeetreason : 79|5@0+ (1,0) [0|31] ""  CCU,CCURT1,CCURT2,Tester
 SG_ ADC_RaebWarning : 92|3@0+ (1,0) [0|7] ""  CCU,CCURT1,CCURT2
 SG_ ADC_ICAAvailableState : 199|1@0+ (1,0) [0|1] ""  CCU,CCURT1,CCURT2
 SG_ ADC_ACCAvailableState : 198|1@0+ (1,0) [0|1] ""  CCU,CCURT1,CCURT2
 SG_ ADC_NDARouteReplanning : 197|1@0+ (1,0) [0|1] ""  CCU,CCURT1,CCURT2
 SG_ ADC_SpeedLimitConfirmRequest : 211|1@0+ (1,0) [0|1] ""  CCU,CCURT1,CCURT2,IDC
 SG_ ADC_LaneChangeType : 335|5@0+ (1,0) [0|31] ""  CCU,CCURT1,CCURT2
 SG_ ADC_LC_ZoneMatching : 330|2@0+ (1,0) [0|3] ""  CCU,CCURT1,CCURT2
 SG_ ADC_RoadMergeSplitType : 328|5@0+ (1,0) [0|31] ""  CCU,CCURT1,CCURT2
 SG_ ADC_LaneMergeSplitType : 339|4@0+ (1,0) [0|15] ""  CCU,CCURT1,CCURT2
 SG_ ADC_EyesOn_Warning : 367|3@0+ (1,0) [0|7] ""  CCU,CCURT1,CCURT2,IDC
 SG_ ADC_TakeOverType : 364|3@0+ (1,0) [0|7] ""  CCU,CCURT1,CCURT2,IDC
 SG_ ADC_TakeOverWarningLevel : 375|3@0+ (1,0) [0|7] ""  CCU,CCURT1,CCURT2,IDC
 SG_ ADC_NDAMRMWarningLevel : 372|3@0+ (1,0) [0|7] ""  CCU,CCURT1,CCURT2,IDC
 SG_ ADC_FuncReq_SentryModWarn : 379|1@0+ (1,0) [0|1] ""  CCU,CCURT1,CCURT2
 SG_ ADC_ADASTransitionType : 389|4@0+ (1,0) [0|15] ""  CCU,CCURT1,CCURT2
 SG_ ADC_TotalRefTorque_A : 423|16@0+ (1,-32768) [-32768|32767] "Nm"  CCU,CCURT1,CCURT2,RT1_C1,VDC
 SG_ ADC_TlaWarning : 232|3@0+ (1,0) [0|7] ""  CCU,CCURT1,CCURT2
 SG_ ADC_TlaFault : 25|2@0+ (1,0) [0|3] ""  CCU,CCURT1,CCURT2
 SG_ ADC_FcwWaning : 255|3@0+ (1,0) [0|7] ""  CCU,CCURT1,CCURT2
 SG_ ADC_AebFault : 74|2@0+ (1,0) [0|3] ""  CCU,CCURT1,CCURT2
 SG_ ADC_RaebFault : 83|2@0+ (1,0) [0|3] ""  CCU,CCURT1,CCURT2
 SG_ ADC_RcwFault : 85|2@0+ (1,0) [0|3] ""  CCU,CCURT1,CCURT2
 SG_ ADC_FctbLeftWarning : 89|3@0+ (1,0) [0|7] ""  CCU,CCURT1,CCURT2
 SG_ ADC_FctbRightWarning : 106|3@0+ (1,0) [0|7] ""  CCU,CCURT1,CCURT2
 SG_ ADC_RctaFault : 87|2@0+ (1,0) [0|3] ""  CCU,CCURT1,CCURT2
 SG_ ADC_RctbLeftWarning : 116|3@0+ (1,0) [0|7] ""  CCU,CCURT1,CCURT2
 SG_ ADC_RctbRightWarning : 119|3@0+ (1,0) [0|7] ""  CCU,CCURT1,CCURT2
 SG_ ADC_LdwFault : 361|2@0+ (1,0) [0|3] ""  CCU,CCURT1,CCURT2
 SG_ ADC_LkaFault : 369|2@0+ (1,0) [0|3] ""  CCU,CCURT1,CCURT2
 SG_ ADC_BsdFault : 381|2@0+ (1,0) [0|3] ""  CCU,CCURT1,CCURT2
 SG_ ADC_DowFault : 391|2@0+ (1,0) [0|3] ""  CCU,CCURT1,CCURT2
 SG_ ADC_TsrFault : 81|2@0+ (1,0) [0|3] ""  CCU,CCURT1,CCURT2
 SG_ ADC_ElkaWarning : 143|3@0+ (1,0) [0|7] ""  CCU,CCURT1,CCURT2
 SG_ ADC_ElkaFault : 383|2@0+ (1,0) [0|3] ""  CCU,CCURT1,CCURT2
 SG_ ADC_IMURollingCounter : 263|8@0+ (1,0) [0|255] ""  CCU,CCURT1,CCURT2
 SG_ ADC_IMUAccX : 151|16@0+ (0.002,-65.536) [-65.536|65.534] "m/s2"  CCU,CCURT1,CCURT2
 SG_ ADC_IMUAccY : 167|16@0+ (0.002,-65.536) [-65.536|65.534] "m/s2"  CCU,CCURT1,CCURT2
 SG_ ADC_IMUAccZ : 183|16@0+ (0.002,-65.536) [-65.536|65.534] "m/s2"  CCU,CCURT1,CCURT2
 SG_ ADC_IMUGyroX : 195|16@0+ (0.01,-327.68) [-327.68|327.67] "dps"  CCU,CCURT1,CCURT2
 SG_ ADC_IMUGyroY : 223|16@0+ (0.01,-327.68) [-327.68|327.67] "dps"  CCU,CCURT1,CCURT2
 SG_ ADC_IMUGyroZ : 351|16@0+ (0.01,-327.68) [-327.68|327.67] "dps"  CCU,CCURT1,CCURT2
 SG_ ADC_IMURoll : 407|16@0+ (0.01,-180) [-180|180] "degree"  CCU,CCURT1,CCURT2
 SG_ ADC_IMUPitch : 271|16@0+ (0.01,-180) [-180|180] "degree"  CCU,CCURT1,CCURT2
 SG_ ADC_IMUYaw : 287|16@0+ (0.01,0) [0|360] "degree"  CCU,CCURT1,CCURT2
 SG_ ADC_IMUTimestampVld : 136|1@0+ (1,0) [0|1] ""  CCU,CCURT1,CCURT2
 SG_ ADC_IMUAccVld : 137|1@0+ (1,0) [0|1] ""  CCU,CCURT1,CCURT2
 SG_ ADC_IMUGyroVld : 196|1@0+ (1,0) [0|1] ""  CCU,CCURT1,CCURT2
 SG_ ADC_IMUAttitudeVld : 235|1@0+ (1,0) [0|1] ""  CCU,CCURT1,CCURT2
 SG_ ADC_IMUPositionType : 239|4@0+ (1,0) [0|15] ""  CCU,CCURT1,CCURT2
 SG_ ADC_IMUTimestamp : 303|32@0+ (1,0) [0|4294967295] ""  CCU,CCURT1,CCURT2
 SG_ ADC_AbsoultwSpeedLimit : 439|16@0+ (1,0) [0|65535] "km/h"  CCU,CCURT1,CCURT2,RT2_C3

BO_ 923 ADC_6: 64 ADC
 SG_ ADC_6_CRC : 7|16@0+ (1,0) [0|65535] ""  CCU,CCURT1,CCURT2
 SG_ ADC_6_Counter : 23|8@0+ (1,0) [0|255] ""  CCU,CCURT1,CCURT2
 SG_ ADC_FrontWideCameraSt : 31|3@0+ (1,0) [0|7] ""  CCU,CCURT1,CCURT2
 SG_ ADC_FrontNarrowCameraSt : 28|3@0+ (1,0) [0|7] ""  CCU,CCURT1,CCURT2
 SG_ ADC_LeftFrontCameraSt : 39|3@0+ (1,0) [0|7] ""  CCU,CCURT1,CCURT2
 SG_ ADC_LeftRearCameraSt : 36|3@0+ (1,0) [0|7] ""  CCU,CCURT1,CCURT2
 SG_ ADC_RightFrontCameraSt : 47|3@0+ (1,0) [0|7] ""  CCU,CCURT1,CCURT2
 SG_ ADC_RightRearCameraSt : 44|3@0+ (1,0) [0|7] ""  CCU,CCURT1,CCURT2
 SG_ ADC_RearCameraSt : 55|3@0+ (1,0) [0|7] ""  CCU,CCURT1,CCURT2
 SG_ ADC_FrontRadarSt : 52|3@0+ (1,0) [0|7] ""  CCU,CCURT1,CCURT2
 SG_ ADC_LeftFrontRadarSt : 63|3@0+ (1,0) [0|7] ""  CCU,CCURT1,CCURT2
 SG_ ADC_LeftRearRadarSt : 60|3@0+ (1,0) [0|7] ""  CCU,CCURT1,CCURT2
 SG_ ADC_RightFrontRadarSt : 71|3@0+ (1,0) [0|7] ""  CCU,CCURT1,CCURT2
 SG_ ADC_RightRearRadarSt : 68|3@0+ (1,0) [0|7] ""  CCU,CCURT1,CCURT2
 SG_ ADC_RearRadarSt : 79|3@0+ (1,0) [0|7] ""  CCU,CCURT1,CCURT2
 SG_ ADC_FrontLidarSt : 76|3@0+ (1,0) [0|7] ""  CCU,CCURT1,CCURT2
 SG_ ADC_LeftLidarSt : 87|3@0+ (1,0) [0|7] ""  CCU,CCURT1,CCURT2
 SG_ ADC_RightLidarSt : 84|3@0+ (1,0) [0|7] ""  CCU,CCURT1,CCURT2
 SG_ ADC_SunroofOpenCloseReq : 25|2@0+ (1,0) [0|3] ""  CCU,CCURT1,CCURT2,RT2_C3
 SG_ ADC_SentryStatus : 57|2@0+ (1,0) [0|3] ""  CCU,CCURT1,CCURT2
 SG_ ADC_SOCWakeupHVReq : 65|1@0+ (1,0) [0|1] ""  CCU,CCURT1,CCURT2,RT1_C1,VDC
 SG_ ADC_SystemState : 236|4@0+ (1,0) [0|14] ""  CCU,CCURT1,CCURT2
 SG_ ADC_FuncReq_SentryModDetec : 232|1@0+ (1,0) [0|1] ""  CCU,CCURT1,CCURT2,RT2_C3
 SG_ ADC_HWFailureReason : 199|3@0+ (1,0) [0|7] ""  CCU,CCURT1,CCURT2,IFC
 SG_ ADC_SWFailureReason : 196|5@0+ (1,0) [0|31] ""  CCU,CCURT1,CCURT2,IFC
 SG_ mountAngleIndicator_az : 101|9@0+ (0.05,-12.8) [-12.8|12.75] "degree"  CCU,CCURT1,CCURT2
 SG_ mountAngleCurrent_az : 108|9@0+ (0.05,-12.8) [-12.8|12.75] "degree"  CCU,CCURT1,CCURT2
 SG_ mountAngleIndicator_el : 115|9@0+ (0.05,-12.8) [-12.8|12.75] "degree"  CCU,CCURT1,CCURT2
 SG_ mountAngleCurrent_el : 122|9@0+ (0.05,-12.8) [-12.8|12.75] "degree"  CCU,CCURT1,CCURT2
 SG_ malStablePosEl : 129|9@0+ (0.05,-12.8) [-12.8|12.75] "degree"  CCU,CCURT1,CCURT2
 SG_ malStablePosAz : 136|9@0+ (0.05,-12.8) [-12.8|12.75] "degree"  CCU,CCURT1,CCURT2
 SG_ AngleEMEIndicatorEl : 159|9@0+ (0.05,-12.8) [-12.8|12.75] "degree"  CCU,CCURT1,CCURT2
 SG_ AngleEMEIndicatorAz : 166|9@0+ (0.05,-12.8) [-12.8|12.75] "degree"  CCU,CCURT1,CCURT2
 SG_ highSpreadIndicator_el : 171|9@0+ (0.05,-12.8) [-12.8|12.75] "degree"  CCU,CCURT1,CCURT2
 SG_ highSpreadIndicator_az : 176|9@0+ (0.05,-12.8) [-12.8|12.75] "degree"  CCU,CCURT1,CCURT2
 SG_ Fault_MAL_HOR_ABS_EVENT : 204|1@0+ (1,0) [0|1] ""  CCU,CCURT1,CCURT2
 SG_ Fault_MAL_HOR_REL_EVENT : 205|1@0+ (1,0) [0|1] ""  CCU,CCURT1,CCURT2
 SG_ Fault_MAL_VER_ABS_EVENT : 206|1@0+ (1,0) [0|1] ""  CCU,CCURT1,CCURT2
 SG_ Fault_MAL_VER_REL_EVENT : 207|1@0+ (1,0) [0|1] ""  CCU,CCURT1,CCURT2
 SG_ FilteredPhiSpread : 231|11@0+ (0.1,-102.4) [-102.4|102.3] "Meter"  CCU,CCURT1,CCURT2
 SG_ elOutOfSpecCause : 201|2@0+ (1,0) [0|3] ""  CCU,CCURT1,CCURT2
 SG_ azOutOfSpecCause : 203|2@0+ (1,0) [0|3] ""  CCU,CCURT1,CCURT2
 SG_ azOutOfProfileCause : 215|8@0+ (1,0) [0|255] ""  CCU,CCURT1,CCURT2
 SG_ elOutOfProfileCause : 223|8@0+ (1,0) [0|255] ""  CCU,CCURT1,CCURT2
 SG_ Reserved1 : 440|1@0+ (1,0) [0|0] ""  CCU

CM_ SG_ 419 ADC_4_CRC "E2E Profile 5 CRC";
CM_ SG_ 419 ADC_4_Counter "E2E Profile 5 Counter";
CM_ SG_ 419 ADC_AngReqSt_A "Lateral control Function Request State";
CM_ SG_ 419 ADC_AngReqFunction "Indicates which function request angle control";
CM_ SG_ 419 ADC_BrakeLightReq "Brake Light Request?";
CM_ SG_ 419 ADC_StrAngleReq_A "Steering Angle Request Value";
CM_ SG_ 419 ADC_SACMotorTorLimExtMax_A "Maximum Motor External Torque Limitation of Angle Following";
CM_ SG_ 419 ADC_SACMotorTorLimExtMin_A "Minimum Motor External Torque Limitation of Angle Following";
CM_ SG_ 419 ADC_AssistParaSwitchReq "Request EPS Switch Assist Parameter to LKAmode";
CM_ SG_ 419 ADC_AngReqRdntReq_A "Angle following control redundancy request";
CM_ SG_ 419 ADC_SteerGainReq "Driver steering  gain request signal";
CM_ SG_ 419 ADC_StrgWhlVibrWarnLevel "Steering wheel vibratio Warn Frequency";
CM_ SG_ 419 ADC_ActTrqReqEnable "Enable flag for VCU for realization of target torque ActTrqReq";
CM_ SG_ 419 ADC_VLCSt "Vehicle Longitudinal Power Control status of ADAS to VCU/EMS";
CM_ SG_ 419 ADC_SteerGainLevel "Driver steering gain request value";
CM_ SG_ 419 ADC_EvsSteerReq "Emergency Collision avoidance steering mode request";
CM_ SG_ 419 ADC_StrgWhlVibrWarnReq "Steering wheel vibration Warn request";
CM_ SG_ 419 ADC_ActTrqReq "VLC Request Effective target torque on wheel level to VCU";
CM_ SG_ 419 ADC_PAA2ESPSpdLimit "inform ESP the velocity maximum";
CM_ SG_ 419 IFC_DPTst "IFC DPT status";
CM_ SG_ 419 ADC_DrvTarTqMod2EPB "Drive torque mode to EPB";
CM_ SG_ 419 ADC_ADASLongCtrlFuncMode "This signal indicates ADC Longitudinal Control acceleration belongs to which function (ACC or APA)";
CM_ SG_ 419 ADC_LongCtrlAvailability "Main ADC Vehicle motion control availability (The longitudinal controller will avoid to erroneously perform the requests from a ADC not indicated as available).";
CM_ SG_ 419 ADC_LongCtrlModeForBrkSys "Main ADC Longitudinal Control Mode For BrakeSys.Off mode: ADAS Not engage.L2 Active: ADAS working in L2 Function.L2++ Active: ADAS working in L2++ or Advance Cruise ,Brake system has a redundant actuator.";
CM_ SG_ 419 ADC_LongCtrlTargetAxReq "Main ADC Request from the Longitudinal Control acceleration to BrakeSys";
CM_ SG_ 419 ADC_LongCtrlTypReq "Main ADC  Longitudinal Control Brake type.Comfort Mode : The controller and brake system will consider NVH limitations, carefully reaction for good driving feeling, etc.Emergency Mode: the controller react fast and the brake system will achieve maximum performance (No limitations, eg. NVH limitations, HW protection).";
CM_ SG_ 419 ADC_LongCtrlDecToStopReq "Main ADC LongitudinalControl requires deceleration to stop";
CM_ SG_ 419 ADC_LongCtrlDriveOff "Main ADC LongitudinalControl requires driving off";
CM_ SG_ 419 ADC_LongctrlSecureReq "Main ADC L2++ system request secure the vehicle, such as use case: L2++ fail operation active, driver no take over, need to stop in emergency lane, request secure vehicle at standstill by EPB Applied.";
CM_ SG_ 419 ADC_ShifttoAVHReq "Request Brake System Change to AVH From ACC Standstill Hold State";
CM_ SG_ 419 ADC_LongCtrlTargetAx "Main ADC Longitudinal Control acceleration forBrakeSystem";
CM_ SG_ 419 ADC_TrkTargt0St "Front Track Target 0（Closest Same Lane）detection state";
CM_ SG_ 419 ADC_TrkTargt0longPos "Track Target 0（Closest Same Lane）Longitudinal Position";
CM_ SG_ 419 ADC_TrkTargt0latPos "Track Target 0（Closest Same Lane）Lateral Position";
CM_ SG_ 419 ADC_TrkTargt0LatRelSpd "Track Target 0（Closest Same Lane）Lateral Relative Speed";
CM_ SG_ 419 ADC_TrkTargt0LongRelSpd "Track Target 0（Closest Same Lane）Longitudinal Relative Speed";
CM_ SG_ 419 ADC_AS_pauseReq "Inhibit suspension adjustment requests";
CM_ SG_ 419 ADC_AS_calibrationReq "Suspension adjustment is requested during calibration";
CM_ SG_ 419 ADC_AS_exitcurrentlevelReq "Parking request air spring out of the current height Level signal";
CM_ SG_ 419 ADC_AS_ReqToadjust "For specific parking functions, the AS is requested to be adjusted to the specific suspension level";
CM_ SG_ 419 ADC_ASActiveSt "This signal indicates if the ActiveSafe Acitve torqure control for VCU/EMS";
CM_ SG_ 419 ADC_AS_UnsafelevelunableReq "Parking request no air spring into unsafe Level height signal";
CM_ SG_ 419 ADC_FcsActiveStatus "indicate ADS Fuction is Active for energe save mode";
CM_ SG_ 419 ADC_ComfstopReq "Comfort Stop function Switch require";
CM_ SG_ 419 ADC_CSM_HoldReq "CSM_Hold Require";
CM_ SG_ 419 ADC_AEBTargetDecel "Target deceleration value from AEB(Automatic Emergency Braking)/EBA(Emergence Braking Assist)";
CM_ SG_ 419 ADC_AEBFaultSt "This signal indicates the AEB(Auto Emerrgency Braking) fault status";
CM_ SG_ 419 ADC_AEBOffSt "This signal indicates if the AEB(Auto Emerrgency Braking) is deactivated";
CM_ SG_ 419 ADC_AEBInterventionSt "This signal indicates if the AEB(Auto Emerrgency Braking) intervents";
CM_ SG_ 419 ADC_AEBDecelCtrlReq "Request of the AEB/EBA/FCTB/RCTB deceleration control";
CM_ SG_ 419 ADC_AEBLVehHoldReq "Request ESP to hold vehilce if AEB active and vehilce stopped";
CM_ SG_ 419 ADC_ABAReq "Request of the ABA support from ESP";
CM_ SG_ 419 ADC_ABALevel "ABA(Adaptive Brake Assistance) level to the ESP HBA";
CM_ SG_ 419 ADC_AWBReq "Request of the brake jerk warning to ESP";
CM_ SG_ 419 ADC_ABPReq "Request of the Prefill to ESP";
CM_ SG_ 419 ADC_AWBLevel "Different level request of the brake jerk";
CM_ SG_ 419 ADC_AEBTarCalss "AEB Target Object Class";
CM_ SG_ 419 ADC_AEBTarDetSensor "AEB Target Property Detected by Sensor with Fusion or not.";
CM_ SG_ 419 ADC_TurnLightReq "Turn Lamp and Hazard Lamp Request?";
CM_ SG_ 419 ADC_PAA2ESPAxReqEnable "Target Ax value request enable";
CM_ SG_ 419 ADC_PAA2ESPBrakeFunctionMode "Indicate APA or RPA or AVP";
CM_ SG_ 419 ADC_PAA2ESPEpbReq "PAA to ESP to do EPB request";
CM_ SG_ 419 ADC_PAA2EPBEpbReq "PAA to EPB request  ";
CM_ SG_ 419 ADC_PAA2ESPEpbReqSt "PAA to ESP to do EPB request  status";
CM_ SG_ 419 ADC_PAA2ESPComfBrakeReq "comfort brake request";
CM_ SG_ 419 ADC_ESPSwitchReq "ADAS ESP Switch to full function Request";
CM_ SG_ 419 ADC_PAA2EPBEpbReqSt "PAA to EPB request  status";
CM_ SG_ 419 ADC_PAA2EPBBrakeFunctionMode "Brake Function Mode";
CM_ SG_ 419 ADC_PAA2ESPApEmgyBrkReq "Emergency brake request";
CM_ SG_ 419 ADC_PAA2ESPApDriveOffReq "Drive off request";
CM_ SG_ 419 ADC_AEBObjectTTC "Time-to-collision between ego vehicle and collision object, and the relative acceleration should be considered";
CM_ SG_ 419 ADC_PAA2ESPApStandstillReq "Vechile standstill request";
CM_ SG_ 419 ADC_PAA2ESPApPrefillReq "Prefill request";
CM_ SG_ 419 ADC_AEBObjRelativeSpd "Relative Speed between ego vehicle and collision object. Means Ego speed > collision object speed situation";
CM_ SG_ 419 ADC_PAA2ESPAxReq "Target Ax value";
CM_ SG_ 419 ADC_EPBReq "ADAS EPB Request";
CM_ SG_ 419 ADC_ActTrqReqVD "The validity of ADC torque request to VCU";
CM_ SG_ 419 ADC_TarGearReqVld "Gear lever request validity";
CM_ SG_ 419 ADC_FctSts "ADAS active status";
CM_ SG_ 419 ADC_PAA2ESPDistoStop "Distance to target stop point";
CM_ SG_ 419 ADC_PAA2ESPTarTorquePTDriveoff "target propulsive torque for drive off";
CM_ SG_ 419 ADC_VehTorqLimit "Torque limit to VCU";
CM_ SG_ 419 ADC_VehTorqReqValue "Torque request to VCU";
CM_ SG_ 419 ADC_VehTorqLimitEnable "Torque limit enable status to VCU";
CM_ SG_ 419 ADC_VehTorqReqEnable "Torque request enable status to VCU";
CM_ SG_ 419 ADC_PAAPwrModeReq "PAA Powertrain Request";
CM_ SG_ 419 ADC_PAAGrarLvlReq "Gear lever position request for the vehicle mo-tion control";
CM_ SG_ 419 ADC_PAAGrarLvlReqEnable "enable flag to control the gear box";
CM_ SG_ 419 ADC_ACCMode_C "This signal indicates ACC(Adaptive cruise control)status";
CM_ SG_ 419 ADC_RCTBTargetDecel "target deceleration value from RCTB";
CM_ SG_ 419 ADC_RCTBBrkReq "RCTB brake request";
CM_ SG_ 419 ADC_BrkTarTqEna "The enable status  of total target brake torque";
CM_ SG_ 419 ADC_BrkTarTqMod "This signal indicates which function the total target brake torque is used for，cruise or parking function.";
CM_ SG_ 419 ADC_AebBrkTarTq "Total taget brake torque of the AEB";
CM_ SG_ 419 ADC_EpbModReqVld "The validity of the  request from the ADAS/ADS to the  EPB";
CM_ SG_ 419 ADC_RWUEna "The enable status of the  RWU";
CM_ SG_ 419 ADC_BrkHoldReq "The AVH request from the ADAS/ADS to the ESP/IPB.Not active：AVH no activeActive：AVH active";
CM_ SG_ 419 ADC_AngReqAvl "Steering angle request avaliable state";
CM_ SG_ 419 ADC_BrkTarTqVld "The validity of total  target brake torque";
CM_ SG_ 419 ADC_AebBrkTarTqVld "The validity of total target brake torque of the AEB";
CM_ SG_ 419 ADC_AebBrkTarTqEna "The enable status  of total  target brake torque of the AEB";
CM_ SG_ 419 ADC_ElecBrkFnSwitch "The switch for regenerative brake and hydraulic brake。Off：The ESP/IPB can not assign regenerative brake torque to the VCU/DCU。On：The ESP/IPB can assign regenerative brake torque to the VCUDCU。";
CM_ SG_ 419 ADC_RWUVld "The validity  of the RWU";
CM_ SG_ 419 ADC_DriverPresent "It indicates whether someone is in the driver's seat.";
CM_ SG_ 419 ADC_BrkTarTq "Total target brake torque for cruise and parking function ";
CM_ SG_ 419 ADC_4_FreshnessValue "Freshness value in SecOC security message";
CM_ SG_ 419 ADC_4_MAC_Check "MAC value in SecOC security message";
CM_ SG_ 659 ADC_5_CRC "E2E Profile 5 CRC";
CM_ SG_ 659 ADC_5_Counter "E2E Profile 5 Counter";
CM_ SG_ 659 ADC_NDASt "NDA state information";
CM_ SG_ 659 ADC_NDATORType "NDA/Autonomous Driving System Driver TakeOver Type";
CM_ SG_ 659 ADC_NDADecideResult "ADC_NDA Decide Result";
CM_ SG_ 659 ADC_NDATargetLane "NDA Target Lane";
CM_ SG_ 659 ADC_NDASplitSt "NDA Split state";
CM_ SG_ 659 ADC_NDALaneChangeOverlineTOR "NDA Lane Change Overline TOR ";
CM_ SG_ 659 ADC_ALCSuspendReason "ADC_Lane Change suspend reason";
CM_ SG_ 659 ADC_SplitSuspendReason "ADC_Split suspend reason";
CM_ SG_ 659 ADC_NDAEnableSt "NDA Enable State";
CM_ SG_ 659 ADC_NDAFailureReason "NDA System Failure Reason";
CM_ SG_ 659 ADC_NDANotactivereason "NDA not active or degrade reason";
CM_ SG_ 659 ADC_NDAGeoFence "NDA Geo-fence";
CM_ SG_ 659 ADC_NDAODDnotMeetreason "NDA ODD not Meet reason";
CM_ SG_ 659 ADC_RaebWarning "RAEB Warning State Effects";
CM_ SG_ 659 ADC_ICAAvailableState "ICA Available State for NDA degrade";
CM_ SG_ 659 ADC_ACCAvailableState "ACC Available State  for NDA degrade";
CM_ SG_ 659 ADC_NDARouteReplanning "ADC_NDA Route Replanning";
CM_ SG_ 659 ADC_SpeedLimitConfirmRequest "Automatic Speed Limit Confirm Request";
CM_ SG_ 659 ADC_LaneChangeType "Lane Change Type";
CM_ SG_ 659 ADC_LC_ZoneMatching "Lane change Left Zone Matching";
CM_ SG_ 659 ADC_RoadMergeSplitType "ADC_Road Merge Split Type";
CM_ SG_ 659 ADC_LaneMergeSplitType "ADC_Lane Merge Split Type";
CM_ SG_ 659 ADC_EyesOn_Warning "ADAS_Eyes On_Warning";
CM_ SG_ 659 ADC_TakeOverType "ADAS_Take Over Type";
CM_ SG_ 659 ADC_TakeOverWarningLevel "ADAS_Take Over Warning Level";
CM_ SG_ 659 ADC_NDAMRMWarningLevel "NDA Minimum Risk Manuvel Warning Level";
CM_ SG_ 659 ADC_FuncReq_SentryModWarn "Sentry Mode Warn";
CM_ SG_ 659 ADC_ADASTransitionType "ADAS Function Transition Type";
CM_ SG_ 659 ADC_TotalRefTorque_A "ADAS total  torque request";
CM_ SG_ 659 ADC_TlaWarning "TLA Warning State for ICM";
CM_ SG_ 659 ADC_TlaFault "TLA Failure State";
CM_ SG_ 659 ADC_FcwWaning "FCW Warning State Effects";
CM_ SG_ 659 ADC_AebFault "AEB Fault State";
CM_ SG_ 659 ADC_RaebFault "RAEB Fault State";
CM_ SG_ 659 ADC_RcwFault "RCW Fault State";
CM_ SG_ 659 ADC_FctbLeftWarning "FCTB Left Warning State Effects";
CM_ SG_ 659 ADC_FctbRightWarning "FCTB Right Warning State Effects";
CM_ SG_ 659 ADC_RctaFault "RCTA Fault State";
CM_ SG_ 659 ADC_RctbLeftWarning "RCTB Left Warning State Effects";
CM_ SG_ 659 ADC_RctbRightWarning "RCTB Right Warning State Effects";
CM_ SG_ 659 ADC_LdwFault "LDW Fault State";
CM_ SG_ 659 ADC_LkaFault "LKA Fault State";
CM_ SG_ 659 ADC_BsdFault "BSD Fault State";
CM_ SG_ 659 ADC_DowFault "DOW Fault State";
CM_ SG_ 659 ADC_TsrFault "TSR Fault State";
CM_ SG_ 659 ADC_ElkaWarning "ELKA Warning State Effects";
CM_ SG_ 659 ADC_ElkaFault "ELKA Fault State";
CM_ SG_ 659 ADC_IMURollingCounter "IMU?Counter";
CM_ SG_ 659 ADC_IMUAccX "IMU?X-Axis?Acceleration?(Rear)";
CM_ SG_ 659 ADC_IMUAccY "IMU?Y-Axis?Acceleration?(Right)";
CM_ SG_ 659 ADC_IMUAccZ "IMU?Z-Axis?Acceleration?(Upper)";
CM_ SG_ 659 ADC_IMUGyroX "IMU?X-Axis?AngularVelocity?(Rear)";
CM_ SG_ 659 ADC_IMUGyroY "IMU?Y-Axis?AngularVelocity?(Right)";
CM_ SG_ 659 ADC_IMUGyroZ "IMU?Z-Axis?AngularVelocity?(Upper)";
CM_ SG_ 659 ADC_IMURoll "IMU?RollAngle";
CM_ SG_ 659 ADC_IMUPitch "IMU?PitchAngle";
CM_ SG_ 659 ADC_IMUYaw "IMU?YawAngle";
CM_ SG_ 659 ADC_IMUTimestampVld "IMU?TimeStamp?Valid";
CM_ SG_ 659 ADC_IMUAccVld "IMU?Acceleration?Valid";
CM_ SG_ 659 ADC_IMUGyroVld "IMU?AngularVelocity?Valid";
CM_ SG_ 659 ADC_IMUAttitudeVld "IMU?Attitude?Valid";
CM_ SG_ 659 ADC_IMUPositionType "IMU?Localization?State";
CM_ SG_ 659 ADC_IMUTimestamp "IMU?TimeStamp";
CM_ SG_ 659 ADC_AbsoultwSpeedLimit "Absolute Speed Limit Value set by Driver";
CM_ SG_ 923 ADC_6_CRC "E2E Profile 5 CRC";
CM_ SG_ 923 ADC_6_Counter "E2E Profile 5 Counter";
CM_ SG_ 923 ADC_FrontWideCameraSt "Front Wide Camera State ";
CM_ SG_ 923 ADC_FrontNarrowCameraSt "Front Narrow Camera State ";
CM_ SG_ 923 ADC_LeftFrontCameraSt "Left Front Camera State ";
CM_ SG_ 923 ADC_LeftRearCameraSt "Left Rear Camera State ";
CM_ SG_ 923 ADC_RightFrontCameraSt "Right Front Camera State ";
CM_ SG_ 923 ADC_RightRearCameraSt "Right Rear Camera State ";
CM_ SG_ 923 ADC_RearCameraSt "Rear Camera Failure ";
CM_ SG_ 923 ADC_FrontRadarSt "Front Radar State ";
CM_ SG_ 923 ADC_LeftFrontRadarSt "Left Front Radar State ";
CM_ SG_ 923 ADC_LeftRearRadarSt "Left Rear Radar State ";
CM_ SG_ 923 ADC_RightFrontRadarSt "Right Front Radar State ";
CM_ SG_ 923 ADC_RightRearRadarSt "Right Rear Radar State ";
CM_ SG_ 923 ADC_RearRadarSt "Rear Radar State ";
CM_ SG_ 923 ADC_FrontLidarSt "Front Lidar State";
CM_ SG_ 923 ADC_LeftLidarSt "Left Lidar State";
CM_ SG_ 923 ADC_RightLidarSt "Right Lidar State";
CM_ SG_ 923 ADC_SunroofOpenCloseReq "Sunroof control";
CM_ SG_ 923 ADC_SentryStatus "Sentinel mode state machine";
CM_ SG_ 923 ADC_SOCWakeupHVReq "ADC sends the signal to VCU when IGN is off, in order to request VCU to provide the DCDC for pre-start and post-run of ADC.";
CM_ SG_ 923 ADC_SystemState "The system status of ADS";
CM_ SG_ 923 ADC_FuncReq_SentryModDetec "Sentry Mode Keep HV";
CM_ SG_ 923 ADC_HWFailureReason "NDA_ADC HW Failure Reason";
CM_ SG_ 923 ADC_SWFailureReason "NDA_ADC SW Failure Reason";
CM_ SG_ 923 mountAngleIndicator_az "Horizontal fast Angle";
CM_ SG_ 923 mountAngleCurrent_az "Horizontal slow Angle";
CM_ SG_ 923 mountAngleIndicator_el "Vertical fast Angle";
CM_ SG_ 923 mountAngleCurrent_el "Vertical slow Angle";
CM_ SG_ 923 malStablePosEl "Vertical stable point";
CM_ SG_ 923 malStablePosAz "Horizontal stable point";
CM_ SG_ 923 AngleEMEIndicatorEl "Vertical EME fast Angle";
CM_ SG_ 923 AngleEMEIndicatorAz "Horizontal EME fast Angle";
CM_ SG_ 923 highSpreadIndicator_el "Vertical filterPhiSpread";
CM_ SG_ 923 highSpreadIndicator_az "Horizontal filterPhiSpread";
CM_ SG_ 923 Fault_MAL_HOR_ABS_EVENT "Horizontal Angle absolute overshoot ITC";
CM_ SG_ 923 Fault_MAL_HOR_REL_EVENT "Horizontal relative Angle overshoot ITC";
CM_ SG_ 923 Fault_MAL_VER_ABS_EVENT "Vertical Angle absolute overshoot ITC";
CM_ SG_ 923 Fault_MAL_VER_REL_EVENT "Vertical relative overshoot ITC";
CM_ SG_ 923 FilteredPhiSpread "FR_MAL_FilteredPhiSpread";
CM_ SG_ 923 elOutOfSpecCause "FR_MAL_elOutOfSpecCause";
CM_ SG_ 923 azOutOfSpecCause "FR_MAL_azOutOfSpecCause";
CM_ SG_ 923 azOutOfProfileCause "FR_MAL_azOutOfProfileCause";
CM_ SG_ 923 elOutOfProfileCause "FR_MAL_elOutOfProfileCause";

BA_DEF_ BO_  "GenMsgCycleTime" INT 0 0;
BA_DEF_ BO_  "GenMsgCycleTimeFast" INT 0 0;
BA_DEF_ BO_  "GenMsgSendType" ENUM  "Periodic","Event","IfActive","POE","PA","FixedPeriodic","Event","EnabledPeriodic","NotUsed","NotUsed","EventPeriodic","NotUsed","NotUsed","NoMsgSendType";
BA_DEF_ BO_  "VFrameFormat" ENUM  "StandardCAN","ExtendedCAN","reserved","reserved","reserved","reserved","reserved","reserved","reserved","reserved","reserved","reserved","reserved","reserved","StandardCAN_FD","ExtendedCAN_FD";
BA_DEF_ BO_  "CANFD_BRS" ENUM  "0","1";
BA_DEF_ SG_  "EventCommandSignal" ENUM  "No","Yes";
BA_DEF_ SG_  "GatewayedSignals" ENUM  "No","Yes";
BA_DEF_ SG_  "GenSigInactiveValue" HEX 0 0;
BA_DEF_ SG_  "GenSigInvalidValue" HEX 0 0;
BA_DEF_ SG_  "GenSigSendType" ENUM  "Trigger","Passive","Cyclic","OnWrite","OnWriteWithRepetition","OnChange","OnChangeWithRepetition","IfActive","IfActiveWithRepetition","NoSigSendType";
BA_DEF_ SG_  "GenSigStartValue" HEX 0 0;
BA_DEF_ SG_  "GenSigTimeoutValue" HEX 0 0;
BA_DEF_ SG_  "Remark" STRING ;
BA_ "GenMsgCycleTime" BO_ 419 10;
BA_ "GenMsgCycleTimeFast" BO_ 419 0;
BA_ "GenMsgSendType" BO_ 419 0;
BA_ "VFrameFormat" BO_ 419 14;
BA_ "CANFD_BRS" BO_ 419 1;
BA_ "GenMsgCycleTime" BO_ 419 10;
BA_ "GenMsgCycleTimeFast" BO_ 419 0;
BA_ "GenMsgSendType" BO_ 419 0;
BA_ "VFrameFormat" BO_ 419 14;
BA_ "CANFD_BRS" BO_ 419 1;
BA_ "GenMsgCycleTime" BO_ 419 10;
BA_ "GenMsgCycleTimeFast" BO_ 419 0;
BA_ "GenMsgSendType" BO_ 419 0;
BA_ "VFrameFormat" BO_ 419 14;
BA_ "CANFD_BRS" BO_ 419 1;
BA_ "GenMsgCycleTime" BO_ 419 10;
BA_ "GenMsgCycleTimeFast" BO_ 419 0;
BA_ "GenMsgSendType" BO_ 419 0;
BA_ "VFrameFormat" BO_ 419 14;
BA_ "CANFD_BRS" BO_ 419 1;
BA_ "GenMsgCycleTime" BO_ 419 10;
BA_ "GenMsgCycleTimeFast" BO_ 419 0;
BA_ "GenMsgSendType" BO_ 419 0;
BA_ "VFrameFormat" BO_ 419 14;
BA_ "CANFD_BRS" BO_ 419 1;
BA_ "GenMsgCycleTime" BO_ 419 10;
BA_ "GenMsgCycleTimeFast" BO_ 419 0;
BA_ "GenMsgSendType" BO_ 419 0;
BA_ "VFrameFormat" BO_ 419 14;
BA_ "CANFD_BRS" BO_ 419 1;
BA_ "GenMsgCycleTime" BO_ 419 10;
BA_ "GenMsgCycleTimeFast" BO_ 419 0;
BA_ "GenMsgSendType" BO_ 419 0;
BA_ "VFrameFormat" BO_ 419 14;
BA_ "CANFD_BRS" BO_ 419 1;
BA_ "GenMsgCycleTime" BO_ 419 10;
BA_ "GenMsgCycleTimeFast" BO_ 419 0;
BA_ "GenMsgSendType" BO_ 419 0;
BA_ "VFrameFormat" BO_ 419 14;
BA_ "CANFD_BRS" BO_ 419 1;
BA_ "GenMsgCycleTime" BO_ 419 10;
BA_ "GenMsgCycleTimeFast" BO_ 419 0;
BA_ "GenMsgSendType" BO_ 419 0;
BA_ "VFrameFormat" BO_ 419 14;
BA_ "CANFD_BRS" BO_ 419 1;
BA_ "GenMsgCycleTime" BO_ 419 10;
BA_ "GenMsgCycleTimeFast" BO_ 419 0;
BA_ "GenMsgSendType" BO_ 419 0;
BA_ "VFrameFormat" BO_ 419 14;
BA_ "CANFD_BRS" BO_ 419 1;
BA_ "GenMsgCycleTime" BO_ 419 10;
BA_ "GenMsgCycleTimeFast" BO_ 419 0;
BA_ "GenMsgSendType" BO_ 419 0;
BA_ "VFrameFormat" BO_ 419 14;
BA_ "CANFD_BRS" BO_ 419 1;
BA_ "GenMsgCycleTime" BO_ 419 10;
BA_ "GenMsgCycleTimeFast" BO_ 419 0;
BA_ "GenMsgSendType" BO_ 419 0;
BA_ "VFrameFormat" BO_ 419 14;
BA_ "CANFD_BRS" BO_ 419 1;
BA_ "GenMsgCycleTime" BO_ 419 10;
BA_ "GenMsgCycleTimeFast" BO_ 419 0;
BA_ "GenMsgSendType" BO_ 419 0;
BA_ "VFrameFormat" BO_ 419 14;
BA_ "CANFD_BRS" BO_ 419 1;
BA_ "GenMsgCycleTime" BO_ 419 10;
BA_ "GenMsgCycleTimeFast" BO_ 419 0;
BA_ "GenMsgSendType" BO_ 419 0;
BA_ "VFrameFormat" BO_ 419 14;
BA_ "CANFD_BRS" BO_ 419 1;
BA_ "GenMsgCycleTime" BO_ 419 10;
BA_ "GenMsgCycleTimeFast" BO_ 419 0;
BA_ "GenMsgSendType" BO_ 419 0;
BA_ "VFrameFormat" BO_ 419 14;
BA_ "CANFD_BRS" BO_ 419 1;
BA_ "GenMsgCycleTime" BO_ 419 10;
BA_ "GenMsgCycleTimeFast" BO_ 419 0;
BA_ "GenMsgSendType" BO_ 419 0;
BA_ "VFrameFormat" BO_ 419 14;
BA_ "CANFD_BRS" BO_ 419 1;
BA_ "GenMsgCycleTime" BO_ 419 10;
BA_ "GenMsgCycleTimeFast" BO_ 419 0;
BA_ "GenMsgSendType" BO_ 419 0;
BA_ "VFrameFormat" BO_ 419 14;
BA_ "CANFD_BRS" BO_ 419 1;
BA_ "GenMsgCycleTime" BO_ 419 10;
BA_ "GenMsgCycleTimeFast" BO_ 419 0;
BA_ "GenMsgSendType" BO_ 419 0;
BA_ "VFrameFormat" BO_ 419 14;
BA_ "CANFD_BRS" BO_ 419 1;
BA_ "GenMsgCycleTime" BO_ 419 10;
BA_ "GenMsgCycleTimeFast" BO_ 419 0;
BA_ "GenMsgSendType" BO_ 419 0;
BA_ "VFrameFormat" BO_ 419 14;
BA_ "CANFD_BRS" BO_ 419 1;
BA_ "GenMsgCycleTime" BO_ 419 10;
BA_ "GenMsgCycleTimeFast" BO_ 419 0;
BA_ "GenMsgSendType" BO_ 419 0;
BA_ "VFrameFormat" BO_ 419 14;
BA_ "CANFD_BRS" BO_ 419 1;
BA_ "GenMsgCycleTime" BO_ 419 10;
BA_ "GenMsgCycleTimeFast" BO_ 419 0;
BA_ "GenMsgSendType" BO_ 419 0;
BA_ "VFrameFormat" BO_ 419 14;
BA_ "CANFD_BRS" BO_ 419 1;
BA_ "GenMsgCycleTime" BO_ 419 10;
BA_ "GenMsgCycleTimeFast" BO_ 419 0;
BA_ "GenMsgSendType" BO_ 419 0;
BA_ "VFrameFormat" BO_ 419 14;
BA_ "CANFD_BRS" BO_ 419 1;
BA_ "GenMsgCycleTime" BO_ 419 10;
BA_ "GenMsgCycleTimeFast" BO_ 419 0;
BA_ "GenMsgSendType" BO_ 419 0;
BA_ "VFrameFormat" BO_ 419 14;
BA_ "CANFD_BRS" BO_ 419 1;
BA_ "GenMsgCycleTime" BO_ 419 10;
BA_ "GenMsgCycleTimeFast" BO_ 419 0;
BA_ "GenMsgSendType" BO_ 419 0;
BA_ "VFrameFormat" BO_ 419 14;
BA_ "CANFD_BRS" BO_ 419 1;
BA_ "GenMsgCycleTime" BO_ 419 10;
BA_ "GenMsgCycleTimeFast" BO_ 419 0;
BA_ "GenMsgSendType" BO_ 419 0;
BA_ "VFrameFormat" BO_ 419 14;
BA_ "CANFD_BRS" BO_ 419 1;
BA_ "GenMsgCycleTime" BO_ 419 10;
BA_ "GenMsgCycleTimeFast" BO_ 419 0;
BA_ "GenMsgSendType" BO_ 419 0;
BA_ "VFrameFormat" BO_ 419 14;
BA_ "CANFD_BRS" BO_ 419 1;
BA_ "GenMsgCycleTime" BO_ 419 10;
BA_ "GenMsgCycleTimeFast" BO_ 419 0;
BA_ "GenMsgSendType" BO_ 419 0;
BA_ "VFrameFormat" BO_ 419 14;
BA_ "CANFD_BRS" BO_ 419 1;
BA_ "GenMsgCycleTime" BO_ 419 10;
BA_ "GenMsgCycleTimeFast" BO_ 419 0;
BA_ "GenMsgSendType" BO_ 419 0;
BA_ "VFrameFormat" BO_ 419 14;
BA_ "CANFD_BRS" BO_ 419 1;
BA_ "GenMsgCycleTime" BO_ 419 10;
BA_ "GenMsgCycleTimeFast" BO_ 419 0;
BA_ "GenMsgSendType" BO_ 419 0;
BA_ "VFrameFormat" BO_ 419 14;
BA_ "CANFD_BRS" BO_ 419 1;
BA_ "GenMsgCycleTime" BO_ 419 10;
BA_ "GenMsgCycleTimeFast" BO_ 419 0;
BA_ "GenMsgSendType" BO_ 419 0;
BA_ "VFrameFormat" BO_ 419 14;
BA_ "CANFD_BRS" BO_ 419 1;
BA_ "GenMsgCycleTime" BO_ 419 10;
BA_ "GenMsgCycleTimeFast" BO_ 419 0;
BA_ "GenMsgSendType" BO_ 419 0;
BA_ "VFrameFormat" BO_ 419 14;
BA_ "CANFD_BRS" BO_ 419 1;
BA_ "GenMsgCycleTime" BO_ 419 10;
BA_ "GenMsgCycleTimeFast" BO_ 419 0;
BA_ "GenMsgSendType" BO_ 419 0;
BA_ "VFrameFormat" BO_ 419 14;
BA_ "CANFD_BRS" BO_ 419 1;
BA_ "GenMsgCycleTime" BO_ 419 10;
BA_ "GenMsgCycleTimeFast" BO_ 419 0;
BA_ "GenMsgSendType" BO_ 419 0;
BA_ "VFrameFormat" BO_ 419 14;
BA_ "CANFD_BRS" BO_ 419 1;
BA_ "GenMsgCycleTime" BO_ 419 10;
BA_ "GenMsgCycleTimeFast" BO_ 419 0;
BA_ "GenMsgSendType" BO_ 419 0;
BA_ "VFrameFormat" BO_ 419 14;
BA_ "CANFD_BRS" BO_ 419 1;
BA_ "GenMsgCycleTime" BO_ 419 10;
BA_ "GenMsgCycleTimeFast" BO_ 419 0;
BA_ "GenMsgSendType" BO_ 419 0;
BA_ "VFrameFormat" BO_ 419 14;
BA_ "CANFD_BRS" BO_ 419 1;
BA_ "GenMsgCycleTime" BO_ 419 10;
BA_ "GenMsgCycleTimeFast" BO_ 419 0;
BA_ "GenMsgSendType" BO_ 419 0;
BA_ "VFrameFormat" BO_ 419 14;
BA_ "CANFD_BRS" BO_ 419 1;
BA_ "GenMsgCycleTime" BO_ 419 10;
BA_ "GenMsgCycleTimeFast" BO_ 419 0;
BA_ "GenMsgSendType" BO_ 419 0;
BA_ "VFrameFormat" BO_ 419 14;
BA_ "CANFD_BRS" BO_ 419 1;
BA_ "GenMsgCycleTime" BO_ 419 10;
BA_ "GenMsgCycleTimeFast" BO_ 419 0;
BA_ "GenMsgSendType" BO_ 419 0;
BA_ "VFrameFormat" BO_ 419 14;
BA_ "CANFD_BRS" BO_ 419 1;
BA_ "GenMsgCycleTime" BO_ 419 10;
BA_ "GenMsgCycleTimeFast" BO_ 419 0;
BA_ "GenMsgSendType" BO_ 419 0;
BA_ "VFrameFormat" BO_ 419 14;
BA_ "CANFD_BRS" BO_ 419 1;
BA_ "GenMsgCycleTime" BO_ 419 10;
BA_ "GenMsgCycleTimeFast" BO_ 419 0;
BA_ "GenMsgSendType" BO_ 419 0;
BA_ "VFrameFormat" BO_ 419 14;
BA_ "CANFD_BRS" BO_ 419 1;
BA_ "GenMsgCycleTime" BO_ 419 10;
BA_ "GenMsgCycleTimeFast" BO_ 419 0;
BA_ "GenMsgSendType" BO_ 419 0;
BA_ "VFrameFormat" BO_ 419 14;
BA_ "CANFD_BRS" BO_ 419 1;
BA_ "GenMsgCycleTime" BO_ 419 10;
BA_ "GenMsgCycleTimeFast" BO_ 419 0;
BA_ "GenMsgSendType" BO_ 419 0;
BA_ "VFrameFormat" BO_ 419 14;
BA_ "CANFD_BRS" BO_ 419 1;
BA_ "GenMsgCycleTime" BO_ 419 10;
BA_ "GenMsgCycleTimeFast" BO_ 419 0;
BA_ "GenMsgSendType" BO_ 419 0;
BA_ "VFrameFormat" BO_ 419 14;
BA_ "CANFD_BRS" BO_ 419 1;
BA_ "GenMsgCycleTime" BO_ 419 10;
BA_ "GenMsgCycleTimeFast" BO_ 419 0;
BA_ "GenMsgSendType" BO_ 419 0;
BA_ "VFrameFormat" BO_ 419 14;
BA_ "CANFD_BRS" BO_ 419 1;
BA_ "GenMsgCycleTime" BO_ 419 10;
BA_ "GenMsgCycleTimeFast" BO_ 419 0;
BA_ "GenMsgSendType" BO_ 419 0;
BA_ "VFrameFormat" BO_ 419 14;
BA_ "CANFD_BRS" BO_ 419 1;
BA_ "GenMsgCycleTime" BO_ 419 10;
BA_ "GenMsgCycleTimeFast" BO_ 419 0;
BA_ "GenMsgSendType" BO_ 419 0;
BA_ "VFrameFormat" BO_ 419 14;
BA_ "CANFD_BRS" BO_ 419 1;
BA_ "GenMsgCycleTime" BO_ 419 10;
BA_ "GenMsgCycleTimeFast" BO_ 419 0;
BA_ "GenMsgSendType" BO_ 419 0;
BA_ "VFrameFormat" BO_ 419 14;
BA_ "CANFD_BRS" BO_ 419 1;
BA_ "GenMsgCycleTime" BO_ 419 10;
BA_ "GenMsgCycleTimeFast" BO_ 419 0;
BA_ "GenMsgSendType" BO_ 419 0;
BA_ "VFrameFormat" BO_ 419 14;
BA_ "CANFD_BRS" BO_ 419 1;
BA_ "GenMsgCycleTime" BO_ 419 10;
BA_ "GenMsgCycleTimeFast" BO_ 419 0;
BA_ "GenMsgSendType" BO_ 419 0;
BA_ "VFrameFormat" BO_ 419 14;
BA_ "CANFD_BRS" BO_ 419 1;
BA_ "GenMsgCycleTime" BO_ 419 10;
BA_ "GenMsgCycleTimeFast" BO_ 419 0;
BA_ "GenMsgSendType" BO_ 419 0;
BA_ "VFrameFormat" BO_ 419 14;
BA_ "CANFD_BRS" BO_ 419 1;
BA_ "GenMsgCycleTime" BO_ 419 10;
BA_ "GenMsgCycleTimeFast" BO_ 419 0;
BA_ "GenMsgSendType" BO_ 419 0;
BA_ "VFrameFormat" BO_ 419 14;
BA_ "CANFD_BRS" BO_ 419 1;
BA_ "GenMsgCycleTime" BO_ 419 10;
BA_ "GenMsgCycleTimeFast" BO_ 419 0;
BA_ "GenMsgSendType" BO_ 419 0;
BA_ "VFrameFormat" BO_ 419 14;
BA_ "CANFD_BRS" BO_ 419 1;
BA_ "GenMsgCycleTime" BO_ 419 10;
BA_ "GenMsgCycleTimeFast" BO_ 419 0;
BA_ "GenMsgSendType" BO_ 419 0;
BA_ "VFrameFormat" BO_ 419 14;
BA_ "CANFD_BRS" BO_ 419 1;
BA_ "GenMsgCycleTime" BO_ 419 10;
BA_ "GenMsgCycleTimeFast" BO_ 419 0;
BA_ "GenMsgSendType" BO_ 419 0;
BA_ "VFrameFormat" BO_ 419 14;
BA_ "CANFD_BRS" BO_ 419 1;
BA_ "GenMsgCycleTime" BO_ 419 10;
BA_ "GenMsgCycleTimeFast" BO_ 419 0;
BA_ "GenMsgSendType" BO_ 419 0;
BA_ "VFrameFormat" BO_ 419 14;
BA_ "CANFD_BRS" BO_ 419 1;
BA_ "GenMsgCycleTime" BO_ 419 10;
BA_ "GenMsgCycleTimeFast" BO_ 419 0;
BA_ "GenMsgSendType" BO_ 419 0;
BA_ "VFrameFormat" BO_ 419 14;
BA_ "CANFD_BRS" BO_ 419 1;
BA_ "GenMsgCycleTime" BO_ 419 10;
BA_ "GenMsgCycleTimeFast" BO_ 419 0;
BA_ "GenMsgSendType" BO_ 419 0;
BA_ "VFrameFormat" BO_ 419 14;
BA_ "CANFD_BRS" BO_ 419 1;
BA_ "GenMsgCycleTime" BO_ 419 10;
BA_ "GenMsgCycleTimeFast" BO_ 419 0;
BA_ "GenMsgSendType" BO_ 419 0;
BA_ "VFrameFormat" BO_ 419 14;
BA_ "CANFD_BRS" BO_ 419 1;
BA_ "GenMsgCycleTime" BO_ 419 10;
BA_ "GenMsgCycleTimeFast" BO_ 419 0;
BA_ "GenMsgSendType" BO_ 419 0;
BA_ "VFrameFormat" BO_ 419 14;
BA_ "CANFD_BRS" BO_ 419 1;
BA_ "GenMsgCycleTime" BO_ 419 10;
BA_ "GenMsgCycleTimeFast" BO_ 419 0;
BA_ "GenMsgSendType" BO_ 419 0;
BA_ "VFrameFormat" BO_ 419 14;
BA_ "CANFD_BRS" BO_ 419 1;
BA_ "GenMsgCycleTime" BO_ 419 10;
BA_ "GenMsgCycleTimeFast" BO_ 419 0;
BA_ "GenMsgSendType" BO_ 419 0;
BA_ "VFrameFormat" BO_ 419 14;
BA_ "CANFD_BRS" BO_ 419 1;
BA_ "GenMsgCycleTime" BO_ 419 10;
BA_ "GenMsgCycleTimeFast" BO_ 419 0;
BA_ "GenMsgSendType" BO_ 419 0;
BA_ "VFrameFormat" BO_ 419 14;
BA_ "CANFD_BRS" BO_ 419 1;
BA_ "GenMsgCycleTime" BO_ 419 10;
BA_ "GenMsgCycleTimeFast" BO_ 419 0;
BA_ "GenMsgSendType" BO_ 419 0;
BA_ "VFrameFormat" BO_ 419 14;
BA_ "CANFD_BRS" BO_ 419 1;
BA_ "GenMsgCycleTime" BO_ 419 10;
BA_ "GenMsgCycleTimeFast" BO_ 419 0;
BA_ "GenMsgSendType" BO_ 419 0;
BA_ "VFrameFormat" BO_ 419 14;
BA_ "CANFD_BRS" BO_ 419 1;
BA_ "GenMsgCycleTime" BO_ 419 10;
BA_ "GenMsgCycleTimeFast" BO_ 419 0;
BA_ "GenMsgSendType" BO_ 419 0;
BA_ "VFrameFormat" BO_ 419 14;
BA_ "CANFD_BRS" BO_ 419 1;
BA_ "GenMsgCycleTime" BO_ 419 10;
BA_ "GenMsgCycleTimeFast" BO_ 419 0;
BA_ "GenMsgSendType" BO_ 419 0;
BA_ "VFrameFormat" BO_ 419 14;
BA_ "CANFD_BRS" BO_ 419 1;
BA_ "GenMsgCycleTime" BO_ 419 10;
BA_ "GenMsgCycleTimeFast" BO_ 419 0;
BA_ "GenMsgSendType" BO_ 419 0;
BA_ "VFrameFormat" BO_ 419 14;
BA_ "CANFD_BRS" BO_ 419 1;
BA_ "GenMsgCycleTime" BO_ 419 10;
BA_ "GenMsgCycleTimeFast" BO_ 419 0;
BA_ "GenMsgSendType" BO_ 419 0;
BA_ "VFrameFormat" BO_ 419 14;
BA_ "CANFD_BRS" BO_ 419 1;
BA_ "GenMsgCycleTime" BO_ 419 10;
BA_ "GenMsgCycleTimeFast" BO_ 419 0;
BA_ "GenMsgSendType" BO_ 419 0;
BA_ "VFrameFormat" BO_ 419 14;
BA_ "CANFD_BRS" BO_ 419 1;
BA_ "GenMsgCycleTime" BO_ 419 10;
BA_ "GenMsgCycleTimeFast" BO_ 419 0;
BA_ "GenMsgSendType" BO_ 419 0;
BA_ "VFrameFormat" BO_ 419 14;
BA_ "CANFD_BRS" BO_ 419 1;
BA_ "GenMsgCycleTime" BO_ 419 10;
BA_ "GenMsgCycleTimeFast" BO_ 419 0;
BA_ "GenMsgSendType" BO_ 419 0;
BA_ "VFrameFormat" BO_ 419 14;
BA_ "CANFD_BRS" BO_ 419 1;
BA_ "GenMsgCycleTime" BO_ 419 10;
BA_ "GenMsgCycleTimeFast" BO_ 419 0;
BA_ "GenMsgSendType" BO_ 419 0;
BA_ "VFrameFormat" BO_ 419 14;
BA_ "CANFD_BRS" BO_ 419 1;
BA_ "GenMsgCycleTime" BO_ 419 10;
BA_ "GenMsgCycleTimeFast" BO_ 419 0;
BA_ "GenMsgSendType" BO_ 419 0;
BA_ "VFrameFormat" BO_ 419 14;
BA_ "CANFD_BRS" BO_ 419 1;
BA_ "GenMsgCycleTime" BO_ 419 10;
BA_ "GenMsgCycleTimeFast" BO_ 419 0;
BA_ "GenMsgSendType" BO_ 419 0;
BA_ "VFrameFormat" BO_ 419 14;
BA_ "CANFD_BRS" BO_ 419 1;
BA_ "GenMsgCycleTime" BO_ 419 10;
BA_ "GenMsgCycleTimeFast" BO_ 419 0;
BA_ "GenMsgSendType" BO_ 419 0;
BA_ "VFrameFormat" BO_ 419 14;
BA_ "CANFD_BRS" BO_ 419 1;
BA_ "GenMsgCycleTime" BO_ 419 10;
BA_ "GenMsgCycleTimeFast" BO_ 419 0;
BA_ "GenMsgSendType" BO_ 419 0;
BA_ "VFrameFormat" BO_ 419 14;
BA_ "CANFD_BRS" BO_ 419 1;
BA_ "GenMsgCycleTime" BO_ 419 10;
BA_ "GenMsgCycleTimeFast" BO_ 419 0;
BA_ "GenMsgSendType" BO_ 419 0;
BA_ "VFrameFormat" BO_ 419 14;
BA_ "CANFD_BRS" BO_ 419 1;
BA_ "GenMsgCycleTime" BO_ 419 10;
BA_ "GenMsgCycleTimeFast" BO_ 419 0;
BA_ "GenMsgSendType" BO_ 419 0;
BA_ "VFrameFormat" BO_ 419 14;
BA_ "CANFD_BRS" BO_ 419 1;
BA_ "GenMsgCycleTime" BO_ 419 10;
BA_ "GenMsgCycleTimeFast" BO_ 419 0;
BA_ "GenMsgSendType" BO_ 419 0;
BA_ "VFrameFormat" BO_ 419 14;
BA_ "CANFD_BRS" BO_ 419 1;
BA_ "GenMsgCycleTime" BO_ 419 10;
BA_ "GenMsgCycleTimeFast" BO_ 419 0;
BA_ "GenMsgSendType" BO_ 419 0;
BA_ "VFrameFormat" BO_ 419 14;
BA_ "CANFD_BRS" BO_ 419 1;
BA_ "GenMsgCycleTime" BO_ 419 10;
BA_ "GenMsgCycleTimeFast" BO_ 419 0;
BA_ "GenMsgSendType" BO_ 419 0;
BA_ "VFrameFormat" BO_ 419 14;
BA_ "CANFD_BRS" BO_ 419 1;
BA_ "GenMsgCycleTime" BO_ 419 10;
BA_ "GenMsgCycleTimeFast" BO_ 419 0;
BA_ "GenMsgSendType" BO_ 419 0;
BA_ "VFrameFormat" BO_ 419 14;
BA_ "CANFD_BRS" BO_ 419 1;
BA_ "GenMsgCycleTime" BO_ 419 10;
BA_ "GenMsgCycleTimeFast" BO_ 419 0;
BA_ "GenMsgSendType" BO_ 419 0;
BA_ "VFrameFormat" BO_ 419 14;
BA_ "CANFD_BRS" BO_ 419 1;
BA_ "GenMsgCycleTime" BO_ 419 10;
BA_ "GenMsgCycleTimeFast" BO_ 419 0;
BA_ "GenMsgSendType" BO_ 419 0;
BA_ "VFrameFormat" BO_ 419 14;
BA_ "CANFD_BRS" BO_ 419 1;
BA_ "GenMsgCycleTime" BO_ 419 10;
BA_ "GenMsgCycleTimeFast" BO_ 419 0;
BA_ "GenMsgSendType" BO_ 419 0;
BA_ "VFrameFormat" BO_ 419 14;
BA_ "CANFD_BRS" BO_ 419 1;
BA_ "GenMsgCycleTime" BO_ 419 10;
BA_ "GenMsgCycleTimeFast" BO_ 419 0;
BA_ "GenMsgSendType" BO_ 419 0;
BA_ "VFrameFormat" BO_ 419 14;
BA_ "CANFD_BRS" BO_ 419 1;
BA_ "GenMsgCycleTime" BO_ 419 10;
BA_ "GenMsgCycleTimeFast" BO_ 419 0;
BA_ "GenMsgSendType" BO_ 419 0;
BA_ "VFrameFormat" BO_ 419 14;
BA_ "CANFD_BRS" BO_ 419 1;
BA_ "GenMsgCycleTime" BO_ 419 10;
BA_ "GenMsgCycleTimeFast" BO_ 419 0;
BA_ "GenMsgSendType" BO_ 419 0;
BA_ "VFrameFormat" BO_ 419 14;
BA_ "CANFD_BRS" BO_ 419 1;
BA_ "GenMsgCycleTime" BO_ 419 10;
BA_ "GenMsgCycleTimeFast" BO_ 419 0;
BA_ "GenMsgSendType" BO_ 419 0;
BA_ "VFrameFormat" BO_ 419 14;
BA_ "CANFD_BRS" BO_ 419 1;
BA_ "GenMsgCycleTime" BO_ 419 10;
BA_ "GenMsgCycleTimeFast" BO_ 419 0;
BA_ "GenMsgSendType" BO_ 419 0;
BA_ "VFrameFormat" BO_ 419 14;
BA_ "CANFD_BRS" BO_ 419 1;
BA_ "GenMsgCycleTime" BO_ 419 10;
BA_ "GenMsgCycleTimeFast" BO_ 419 0;
BA_ "GenMsgSendType" BO_ 419 0;
BA_ "VFrameFormat" BO_ 419 14;
BA_ "CANFD_BRS" BO_ 419 1;
BA_ "GenMsgCycleTime" BO_ 419 10;
BA_ "GenMsgCycleTimeFast" BO_ 419 0;
BA_ "GenMsgSendType" BO_ 419 0;
BA_ "VFrameFormat" BO_ 419 14;
BA_ "CANFD_BRS" BO_ 419 1;
BA_ "GenMsgCycleTime" BO_ 419 10;
BA_ "GenMsgCycleTimeFast" BO_ 419 0;
BA_ "GenMsgSendType" BO_ 419 0;
BA_ "VFrameFormat" BO_ 419 14;
BA_ "CANFD_BRS" BO_ 419 1;
BA_ "GenMsgCycleTime" BO_ 419 10;
BA_ "GenMsgCycleTimeFast" BO_ 419 0;
BA_ "GenMsgSendType" BO_ 419 0;
BA_ "VFrameFormat" BO_ 419 14;
BA_ "CANFD_BRS" BO_ 419 1;
BA_ "GenMsgCycleTime" BO_ 419 10;
BA_ "GenMsgCycleTimeFast" BO_ 419 0;
BA_ "GenMsgSendType" BO_ 419 0;
BA_ "VFrameFormat" BO_ 419 14;
BA_ "CANFD_BRS" BO_ 419 1;
BA_ "GenMsgCycleTime" BO_ 419 10;
BA_ "GenMsgCycleTimeFast" BO_ 419 0;
BA_ "GenMsgSendType" BO_ 419 0;
BA_ "VFrameFormat" BO_ 419 14;
BA_ "CANFD_BRS" BO_ 419 1;
BA_ "GenMsgCycleTime" BO_ 419 10;
BA_ "GenMsgCycleTimeFast" BO_ 419 0;
BA_ "GenMsgSendType" BO_ 419 0;
BA_ "VFrameFormat" BO_ 419 14;
BA_ "CANFD_BRS" BO_ 419 1;
BA_ "GenMsgCycleTime" BO_ 419 10;
BA_ "GenMsgCycleTimeFast" BO_ 419 0;
BA_ "GenMsgSendType" BO_ 419 0;
BA_ "VFrameFormat" BO_ 419 14;
BA_ "CANFD_BRS" BO_ 419 1;
BA_ "GenMsgCycleTime" BO_ 419 10;
BA_ "GenMsgCycleTimeFast" BO_ 419 0;
BA_ "GenMsgSendType" BO_ 419 0;
BA_ "VFrameFormat" BO_ 419 14;
BA_ "CANFD_BRS" BO_ 419 1;
BA_ "GenMsgCycleTime" BO_ 419 10;
BA_ "GenMsgCycleTimeFast" BO_ 419 0;
BA_ "GenMsgSendType" BO_ 419 0;
BA_ "VFrameFormat" BO_ 419 14;
BA_ "CANFD_BRS" BO_ 419 1;
BA_ "GenMsgCycleTime" BO_ 419 10;
BA_ "GenMsgCycleTimeFast" BO_ 419 0;
BA_ "GenMsgSendType" BO_ 419 0;
BA_ "VFrameFormat" BO_ 419 14;
BA_ "CANFD_BRS" BO_ 419 1;
BA_ "GenMsgCycleTime" BO_ 419 10;
BA_ "GenMsgCycleTimeFast" BO_ 419 0;
BA_ "GenMsgSendType" BO_ 419 0;
BA_ "VFrameFormat" BO_ 419 14;
BA_ "CANFD_BRS" BO_ 419 1;
BA_ "GenMsgCycleTime" BO_ 419 10;
BA_ "GenMsgCycleTimeFast" BO_ 419 0;
BA_ "GenMsgSendType" BO_ 419 0;
BA_ "VFrameFormat" BO_ 419 14;
BA_ "CANFD_BRS" BO_ 419 1;
BA_ "GenMsgCycleTime" BO_ 419 10;
BA_ "GenMsgCycleTimeFast" BO_ 419 0;
BA_ "GenMsgSendType" BO_ 419 0;
BA_ "VFrameFormat" BO_ 419 14;
BA_ "CANFD_BRS" BO_ 419 1;
BA_ "GenMsgCycleTime" BO_ 419 10;
BA_ "GenMsgCycleTimeFast" BO_ 419 0;
BA_ "GenMsgSendType" BO_ 419 0;
BA_ "VFrameFormat" BO_ 419 14;
BA_ "CANFD_BRS" BO_ 419 1;
BA_ "GenMsgCycleTime" BO_ 419 10;
BA_ "GenMsgCycleTimeFast" BO_ 419 0;
BA_ "GenMsgSendType" BO_ 419 0;
BA_ "VFrameFormat" BO_ 419 14;
BA_ "CANFD_BRS" BO_ 419 1;
BA_ "GenMsgCycleTime" BO_ 419 10;
BA_ "GenMsgCycleTimeFast" BO_ 419 0;
BA_ "GenMsgSendType" BO_ 419 0;
BA_ "VFrameFormat" BO_ 419 14;
BA_ "CANFD_BRS" BO_ 419 1;
BA_ "GenMsgCycleTime" BO_ 659 20;
BA_ "GenMsgCycleTimeFast" BO_ 659 0;
BA_ "GenMsgSendType" BO_ 659 0;
BA_ "VFrameFormat" BO_ 659 14;
BA_ "CANFD_BRS" BO_ 659 1;
BA_ "GenMsgCycleTime" BO_ 659 20;
BA_ "GenMsgCycleTimeFast" BO_ 659 0;
BA_ "GenMsgSendType" BO_ 659 0;
BA_ "VFrameFormat" BO_ 659 14;
BA_ "CANFD_BRS" BO_ 659 1;
BA_ "GenMsgCycleTime" BO_ 659 20;
BA_ "GenMsgCycleTimeFast" BO_ 659 0;
BA_ "GenMsgSendType" BO_ 659 0;
BA_ "VFrameFormat" BO_ 659 14;
BA_ "CANFD_BRS" BO_ 659 1;
BA_ "GenMsgCycleTime" BO_ 659 20;
BA_ "GenMsgCycleTimeFast" BO_ 659 0;
BA_ "GenMsgSendType" BO_ 659 0;
BA_ "VFrameFormat" BO_ 659 14;
BA_ "CANFD_BRS" BO_ 659 1;
BA_ "GenMsgCycleTime" BO_ 659 20;
BA_ "GenMsgCycleTimeFast" BO_ 659 0;
BA_ "GenMsgSendType" BO_ 659 0;
BA_ "VFrameFormat" BO_ 659 14;
BA_ "CANFD_BRS" BO_ 659 1;
BA_ "GenMsgCycleTime" BO_ 659 20;
BA_ "GenMsgCycleTimeFast" BO_ 659 0;
BA_ "GenMsgSendType" BO_ 659 0;
BA_ "VFrameFormat" BO_ 659 14;
BA_ "CANFD_BRS" BO_ 659 1;
BA_ "GenMsgCycleTime" BO_ 659 20;
BA_ "GenMsgCycleTimeFast" BO_ 659 0;
BA_ "GenMsgSendType" BO_ 659 0;
BA_ "VFrameFormat" BO_ 659 14;
BA_ "CANFD_BRS" BO_ 659 1;
BA_ "GenMsgCycleTime" BO_ 659 20;
BA_ "GenMsgCycleTimeFast" BO_ 659 0;
BA_ "GenMsgSendType" BO_ 659 0;
BA_ "VFrameFormat" BO_ 659 14;
BA_ "CANFD_BRS" BO_ 659 1;
BA_ "GenMsgCycleTime" BO_ 659 20;
BA_ "GenMsgCycleTimeFast" BO_ 659 0;
BA_ "GenMsgSendType" BO_ 659 0;
BA_ "VFrameFormat" BO_ 659 14;
BA_ "CANFD_BRS" BO_ 659 1;
BA_ "GenMsgCycleTime" BO_ 659 20;
BA_ "GenMsgCycleTimeFast" BO_ 659 0;
BA_ "GenMsgSendType" BO_ 659 0;
BA_ "VFrameFormat" BO_ 659 14;
BA_ "CANFD_BRS" BO_ 659 1;
BA_ "GenMsgCycleTime" BO_ 659 20;
BA_ "GenMsgCycleTimeFast" BO_ 659 0;
BA_ "GenMsgSendType" BO_ 659 0;
BA_ "VFrameFormat" BO_ 659 14;
BA_ "CANFD_BRS" BO_ 659 1;
BA_ "GenMsgCycleTime" BO_ 659 20;
BA_ "GenMsgCycleTimeFast" BO_ 659 0;
BA_ "GenMsgSendType" BO_ 659 0;
BA_ "VFrameFormat" BO_ 659 14;
BA_ "CANFD_BRS" BO_ 659 1;
BA_ "GenMsgCycleTime" BO_ 659 20;
BA_ "GenMsgCycleTimeFast" BO_ 659 0;
BA_ "GenMsgSendType" BO_ 659 0;
BA_ "VFrameFormat" BO_ 659 14;
BA_ "CANFD_BRS" BO_ 659 1;
BA_ "GenMsgCycleTime" BO_ 659 20;
BA_ "GenMsgCycleTimeFast" BO_ 659 0;
BA_ "GenMsgSendType" BO_ 659 0;
BA_ "VFrameFormat" BO_ 659 14;
BA_ "CANFD_BRS" BO_ 659 1;
BA_ "GenMsgCycleTime" BO_ 659 20;
BA_ "GenMsgCycleTimeFast" BO_ 659 0;
BA_ "GenMsgSendType" BO_ 659 0;
BA_ "VFrameFormat" BO_ 659 14;
BA_ "CANFD_BRS" BO_ 659 1;
BA_ "GenMsgCycleTime" BO_ 659 20;
BA_ "GenMsgCycleTimeFast" BO_ 659 0;
BA_ "GenMsgSendType" BO_ 659 0;
BA_ "VFrameFormat" BO_ 659 14;
BA_ "CANFD_BRS" BO_ 659 1;
BA_ "GenMsgCycleTime" BO_ 659 20;
BA_ "GenMsgCycleTimeFast" BO_ 659 0;
BA_ "GenMsgSendType" BO_ 659 0;
BA_ "VFrameFormat" BO_ 659 14;
BA_ "CANFD_BRS" BO_ 659 1;
BA_ "GenMsgCycleTime" BO_ 659 20;
BA_ "GenMsgCycleTimeFast" BO_ 659 0;
BA_ "GenMsgSendType" BO_ 659 0;
BA_ "VFrameFormat" BO_ 659 14;
BA_ "CANFD_BRS" BO_ 659 1;
BA_ "GenMsgCycleTime" BO_ 659 20;
BA_ "GenMsgCycleTimeFast" BO_ 659 0;
BA_ "GenMsgSendType" BO_ 659 0;
BA_ "VFrameFormat" BO_ 659 14;
BA_ "CANFD_BRS" BO_ 659 1;
BA_ "GenMsgCycleTime" BO_ 659 20;
BA_ "GenMsgCycleTimeFast" BO_ 659 0;
BA_ "GenMsgSendType" BO_ 659 0;
BA_ "VFrameFormat" BO_ 659 14;
BA_ "CANFD_BRS" BO_ 659 1;
BA_ "GenMsgCycleTime" BO_ 659 20;
BA_ "GenMsgCycleTimeFast" BO_ 659 0;
BA_ "GenMsgSendType" BO_ 659 0;
BA_ "VFrameFormat" BO_ 659 14;
BA_ "CANFD_BRS" BO_ 659 1;
BA_ "GenMsgCycleTime" BO_ 659 20;
BA_ "GenMsgCycleTimeFast" BO_ 659 0;
BA_ "GenMsgSendType" BO_ 659 0;
BA_ "VFrameFormat" BO_ 659 14;
BA_ "CANFD_BRS" BO_ 659 1;
BA_ "GenMsgCycleTime" BO_ 659 20;
BA_ "GenMsgCycleTimeFast" BO_ 659 0;
BA_ "GenMsgSendType" BO_ 659 0;
BA_ "VFrameFormat" BO_ 659 14;
BA_ "CANFD_BRS" BO_ 659 1;
BA_ "GenMsgCycleTime" BO_ 659 20;
BA_ "GenMsgCycleTimeFast" BO_ 659 0;
BA_ "GenMsgSendType" BO_ 659 0;
BA_ "VFrameFormat" BO_ 659 14;
BA_ "CANFD_BRS" BO_ 659 1;
BA_ "GenMsgCycleTime" BO_ 659 20;
BA_ "GenMsgCycleTimeFast" BO_ 659 0;
BA_ "GenMsgSendType" BO_ 659 0;
BA_ "VFrameFormat" BO_ 659 14;
BA_ "CANFD_BRS" BO_ 659 1;
BA_ "GenMsgCycleTime" BO_ 659 20;
BA_ "GenMsgCycleTimeFast" BO_ 659 0;
BA_ "GenMsgSendType" BO_ 659 0;
BA_ "VFrameFormat" BO_ 659 14;
BA_ "CANFD_BRS" BO_ 659 1;
BA_ "GenMsgCycleTime" BO_ 659 20;
BA_ "GenMsgCycleTimeFast" BO_ 659 0;
BA_ "GenMsgSendType" BO_ 659 0;
BA_ "VFrameFormat" BO_ 659 14;
BA_ "CANFD_BRS" BO_ 659 1;
BA_ "GenMsgCycleTime" BO_ 659 20;
BA_ "GenMsgCycleTimeFast" BO_ 659 0;
BA_ "GenMsgSendType" BO_ 659 0;
BA_ "VFrameFormat" BO_ 659 14;
BA_ "CANFD_BRS" BO_ 659 1;
BA_ "GenMsgCycleTime" BO_ 659 20;
BA_ "GenMsgCycleTimeFast" BO_ 659 0;
BA_ "GenMsgSendType" BO_ 659 0;
BA_ "VFrameFormat" BO_ 659 14;
BA_ "CANFD_BRS" BO_ 659 1;
BA_ "GenMsgCycleTime" BO_ 659 20;
BA_ "GenMsgCycleTimeFast" BO_ 659 0;
BA_ "GenMsgSendType" BO_ 659 0;
BA_ "VFrameFormat" BO_ 659 14;
BA_ "CANFD_BRS" BO_ 659 1;
BA_ "GenMsgCycleTime" BO_ 659 20;
BA_ "GenMsgCycleTimeFast" BO_ 659 0;
BA_ "GenMsgSendType" BO_ 659 0;
BA_ "VFrameFormat" BO_ 659 14;
BA_ "CANFD_BRS" BO_ 659 1;
BA_ "GenMsgCycleTime" BO_ 659 20;
BA_ "GenMsgCycleTimeFast" BO_ 659 0;
BA_ "GenMsgSendType" BO_ 659 0;
BA_ "VFrameFormat" BO_ 659 14;
BA_ "CANFD_BRS" BO_ 659 1;
BA_ "GenMsgCycleTime" BO_ 659 20;
BA_ "GenMsgCycleTimeFast" BO_ 659 0;
BA_ "GenMsgSendType" BO_ 659 0;
BA_ "VFrameFormat" BO_ 659 14;
BA_ "CANFD_BRS" BO_ 659 1;
BA_ "GenMsgCycleTime" BO_ 659 20;
BA_ "GenMsgCycleTimeFast" BO_ 659 0;
BA_ "GenMsgSendType" BO_ 659 0;
BA_ "VFrameFormat" BO_ 659 14;
BA_ "CANFD_BRS" BO_ 659 1;
BA_ "GenMsgCycleTime" BO_ 659 20;
BA_ "GenMsgCycleTimeFast" BO_ 659 0;
BA_ "GenMsgSendType" BO_ 659 0;
BA_ "VFrameFormat" BO_ 659 14;
BA_ "CANFD_BRS" BO_ 659 1;
BA_ "GenMsgCycleTime" BO_ 659 20;
BA_ "GenMsgCycleTimeFast" BO_ 659 0;
BA_ "GenMsgSendType" BO_ 659 0;
BA_ "VFrameFormat" BO_ 659 14;
BA_ "CANFD_BRS" BO_ 659 1;
BA_ "GenMsgCycleTime" BO_ 659 20;
BA_ "GenMsgCycleTimeFast" BO_ 659 0;
BA_ "GenMsgSendType" BO_ 659 0;
BA_ "VFrameFormat" BO_ 659 14;
BA_ "CANFD_BRS" BO_ 659 1;
BA_ "GenMsgCycleTime" BO_ 659 20;
BA_ "GenMsgCycleTimeFast" BO_ 659 0;
BA_ "GenMsgSendType" BO_ 659 0;
BA_ "VFrameFormat" BO_ 659 14;
BA_ "CANFD_BRS" BO_ 659 1;
BA_ "GenMsgCycleTime" BO_ 659 20;
BA_ "GenMsgCycleTimeFast" BO_ 659 0;
BA_ "GenMsgSendType" BO_ 659 0;
BA_ "VFrameFormat" BO_ 659 14;
BA_ "CANFD_BRS" BO_ 659 1;
BA_ "GenMsgCycleTime" BO_ 659 20;
BA_ "GenMsgCycleTimeFast" BO_ 659 0;
BA_ "GenMsgSendType" BO_ 659 0;
BA_ "VFrameFormat" BO_ 659 14;
BA_ "CANFD_BRS" BO_ 659 1;
BA_ "GenMsgCycleTime" BO_ 659 20;
BA_ "GenMsgCycleTimeFast" BO_ 659 0;
BA_ "GenMsgSendType" BO_ 659 0;
BA_ "VFrameFormat" BO_ 659 14;
BA_ "CANFD_BRS" BO_ 659 1;
BA_ "GenMsgCycleTime" BO_ 659 20;
BA_ "GenMsgCycleTimeFast" BO_ 659 0;
BA_ "GenMsgSendType" BO_ 659 0;
BA_ "VFrameFormat" BO_ 659 14;
BA_ "CANFD_BRS" BO_ 659 1;
BA_ "GenMsgCycleTime" BO_ 659 20;
BA_ "GenMsgCycleTimeFast" BO_ 659 0;
BA_ "GenMsgSendType" BO_ 659 0;
BA_ "VFrameFormat" BO_ 659 14;
BA_ "CANFD_BRS" BO_ 659 1;
BA_ "GenMsgCycleTime" BO_ 659 20;
BA_ "GenMsgCycleTimeFast" BO_ 659 0;
BA_ "GenMsgSendType" BO_ 659 0;
BA_ "VFrameFormat" BO_ 659 14;
BA_ "CANFD_BRS" BO_ 659 1;
BA_ "GenMsgCycleTime" BO_ 659 20;
BA_ "GenMsgCycleTimeFast" BO_ 659 0;
BA_ "GenMsgSendType" BO_ 659 0;
BA_ "VFrameFormat" BO_ 659 14;
BA_ "CANFD_BRS" BO_ 659 1;
BA_ "GenMsgCycleTime" BO_ 659 20;
BA_ "GenMsgCycleTimeFast" BO_ 659 0;
BA_ "GenMsgSendType" BO_ 659 0;
BA_ "VFrameFormat" BO_ 659 14;
BA_ "CANFD_BRS" BO_ 659 1;
BA_ "GenMsgCycleTime" BO_ 659 20;
BA_ "GenMsgCycleTimeFast" BO_ 659 0;
BA_ "GenMsgSendType" BO_ 659 0;
BA_ "VFrameFormat" BO_ 659 14;
BA_ "CANFD_BRS" BO_ 659 1;
BA_ "GenMsgCycleTime" BO_ 659 20;
BA_ "GenMsgCycleTimeFast" BO_ 659 0;
BA_ "GenMsgSendType" BO_ 659 0;
BA_ "VFrameFormat" BO_ 659 14;
BA_ "CANFD_BRS" BO_ 659 1;
BA_ "GenMsgCycleTime" BO_ 659 20;
BA_ "GenMsgCycleTimeFast" BO_ 659 0;
BA_ "GenMsgSendType" BO_ 659 0;
BA_ "VFrameFormat" BO_ 659 14;
BA_ "CANFD_BRS" BO_ 659 1;
BA_ "GenMsgCycleTime" BO_ 659 20;
BA_ "GenMsgCycleTimeFast" BO_ 659 0;
BA_ "GenMsgSendType" BO_ 659 0;
BA_ "VFrameFormat" BO_ 659 14;
BA_ "CANFD_BRS" BO_ 659 1;
BA_ "GenMsgCycleTime" BO_ 659 20;
BA_ "GenMsgCycleTimeFast" BO_ 659 0;
BA_ "GenMsgSendType" BO_ 659 0;
BA_ "VFrameFormat" BO_ 659 14;
BA_ "CANFD_BRS" BO_ 659 1;
BA_ "GenMsgCycleTime" BO_ 659 20;
BA_ "GenMsgCycleTimeFast" BO_ 659 0;
BA_ "GenMsgSendType" BO_ 659 0;
BA_ "VFrameFormat" BO_ 659 14;
BA_ "CANFD_BRS" BO_ 659 1;
BA_ "GenMsgCycleTime" BO_ 659 20;
BA_ "GenMsgCycleTimeFast" BO_ 659 0;
BA_ "GenMsgSendType" BO_ 659 0;
BA_ "VFrameFormat" BO_ 659 14;
BA_ "CANFD_BRS" BO_ 659 1;
BA_ "GenMsgCycleTime" BO_ 659 20;
BA_ "GenMsgCycleTimeFast" BO_ 659 0;
BA_ "GenMsgSendType" BO_ 659 0;
BA_ "VFrameFormat" BO_ 659 14;
BA_ "CANFD_BRS" BO_ 659 1;
BA_ "GenMsgCycleTime" BO_ 659 20;
BA_ "GenMsgCycleTimeFast" BO_ 659 0;
BA_ "GenMsgSendType" BO_ 659 0;
BA_ "VFrameFormat" BO_ 659 14;
BA_ "CANFD_BRS" BO_ 659 1;
BA_ "GenMsgCycleTime" BO_ 659 20;
BA_ "GenMsgCycleTimeFast" BO_ 659 0;
BA_ "GenMsgSendType" BO_ 659 0;
BA_ "VFrameFormat" BO_ 659 14;
BA_ "CANFD_BRS" BO_ 659 1;
BA_ "GenMsgCycleTime" BO_ 659 20;
BA_ "GenMsgCycleTimeFast" BO_ 659 0;
BA_ "GenMsgSendType" BO_ 659 0;
BA_ "VFrameFormat" BO_ 659 14;
BA_ "CANFD_BRS" BO_ 659 1;
BA_ "GenMsgCycleTime" BO_ 659 20;
BA_ "GenMsgCycleTimeFast" BO_ 659 0;
BA_ "GenMsgSendType" BO_ 659 0;
BA_ "VFrameFormat" BO_ 659 14;
BA_ "CANFD_BRS" BO_ 659 1;
BA_ "GenMsgCycleTime" BO_ 659 20;
BA_ "GenMsgCycleTimeFast" BO_ 659 0;
BA_ "GenMsgSendType" BO_ 659 0;
BA_ "VFrameFormat" BO_ 659 14;
BA_ "CANFD_BRS" BO_ 659 1;
BA_ "GenMsgCycleTime" BO_ 659 20;
BA_ "GenMsgCycleTimeFast" BO_ 659 0;
BA_ "GenMsgSendType" BO_ 659 0;
BA_ "VFrameFormat" BO_ 659 14;
BA_ "CANFD_BRS" BO_ 659 1;
BA_ "GenMsgCycleTime" BO_ 659 20;
BA_ "GenMsgCycleTimeFast" BO_ 659 0;
BA_ "GenMsgSendType" BO_ 659 0;
BA_ "VFrameFormat" BO_ 659 14;
BA_ "CANFD_BRS" BO_ 659 1;
BA_ "GenMsgCycleTime" BO_ 659 20;
BA_ "GenMsgCycleTimeFast" BO_ 659 0;
BA_ "GenMsgSendType" BO_ 659 0;
BA_ "VFrameFormat" BO_ 659 14;
BA_ "CANFD_BRS" BO_ 659 1;
BA_ "GenMsgCycleTime" BO_ 659 20;
BA_ "GenMsgCycleTimeFast" BO_ 659 0;
BA_ "GenMsgSendType" BO_ 659 0;
BA_ "VFrameFormat" BO_ 659 14;
BA_ "CANFD_BRS" BO_ 659 1;
BA_ "GenMsgCycleTime" BO_ 659 20;
BA_ "GenMsgCycleTimeFast" BO_ 659 0;
BA_ "GenMsgSendType" BO_ 659 0;
BA_ "VFrameFormat" BO_ 659 14;
BA_ "CANFD_BRS" BO_ 659 1;
BA_ "GenMsgCycleTime" BO_ 659 20;
BA_ "GenMsgCycleTimeFast" BO_ 659 0;
BA_ "GenMsgSendType" BO_ 659 0;
BA_ "VFrameFormat" BO_ 659 14;
BA_ "CANFD_BRS" BO_ 659 1;
BA_ "GenMsgCycleTime" BO_ 659 20;
BA_ "GenMsgCycleTimeFast" BO_ 659 0;
BA_ "GenMsgSendType" BO_ 659 0;
BA_ "VFrameFormat" BO_ 659 14;
BA_ "CANFD_BRS" BO_ 659 1;
BA_ "GenMsgCycleTime" BO_ 923 100;
BA_ "GenMsgCycleTimeFast" BO_ 923 0;
BA_ "GenMsgSendType" BO_ 923 0;
BA_ "VFrameFormat" BO_ 923 14;
BA_ "CANFD_BRS" BO_ 923 1;
BA_ "GenMsgCycleTime" BO_ 923 100;
BA_ "GenMsgCycleTimeFast" BO_ 923 0;
BA_ "GenMsgSendType" BO_ 923 0;
BA_ "VFrameFormat" BO_ 923 14;
BA_ "CANFD_BRS" BO_ 923 1;
BA_ "GenMsgCycleTime" BO_ 923 100;
BA_ "GenMsgCycleTimeFast" BO_ 923 0;
BA_ "GenMsgSendType" BO_ 923 0;
BA_ "VFrameFormat" BO_ 923 14;
BA_ "CANFD_BRS" BO_ 923 1;
BA_ "GenMsgCycleTime" BO_ 923 100;
BA_ "GenMsgCycleTimeFast" BO_ 923 0;
BA_ "GenMsgSendType" BO_ 923 0;
BA_ "VFrameFormat" BO_ 923 14;
BA_ "CANFD_BRS" BO_ 923 1;
BA_ "GenMsgCycleTime" BO_ 923 100;
BA_ "GenMsgCycleTimeFast" BO_ 923 0;
BA_ "GenMsgSendType" BO_ 923 0;
BA_ "VFrameFormat" BO_ 923 14;
BA_ "CANFD_BRS" BO_ 923 1;
BA_ "GenMsgCycleTime" BO_ 923 100;
BA_ "GenMsgCycleTimeFast" BO_ 923 0;
BA_ "GenMsgSendType" BO_ 923 0;
BA_ "VFrameFormat" BO_ 923 14;
BA_ "CANFD_BRS" BO_ 923 1;
BA_ "GenMsgCycleTime" BO_ 923 100;
BA_ "GenMsgCycleTimeFast" BO_ 923 0;
BA_ "GenMsgSendType" BO_ 923 0;
BA_ "VFrameFormat" BO_ 923 14;
BA_ "CANFD_BRS" BO_ 923 1;
BA_ "GenMsgCycleTime" BO_ 923 100;
BA_ "GenMsgCycleTimeFast" BO_ 923 0;
BA_ "GenMsgSendType" BO_ 923 0;
BA_ "VFrameFormat" BO_ 923 14;
BA_ "CANFD_BRS" BO_ 923 1;
BA_ "GenMsgCycleTime" BO_ 923 100;
BA_ "GenMsgCycleTimeFast" BO_ 923 0;
BA_ "GenMsgSendType" BO_ 923 0;
BA_ "VFrameFormat" BO_ 923 14;
BA_ "CANFD_BRS" BO_ 923 1;
BA_ "GenMsgCycleTime" BO_ 923 100;
BA_ "GenMsgCycleTimeFast" BO_ 923 0;
BA_ "GenMsgSendType" BO_ 923 0;
BA_ "VFrameFormat" BO_ 923 14;
BA_ "CANFD_BRS" BO_ 923 1;
BA_ "GenMsgCycleTime" BO_ 923 100;
BA_ "GenMsgCycleTimeFast" BO_ 923 0;
BA_ "GenMsgSendType" BO_ 923 0;
BA_ "VFrameFormat" BO_ 923 14;
BA_ "CANFD_BRS" BO_ 923 1;
BA_ "GenMsgCycleTime" BO_ 923 100;
BA_ "GenMsgCycleTimeFast" BO_ 923 0;
BA_ "GenMsgSendType" BO_ 923 0;
BA_ "VFrameFormat" BO_ 923 14;
BA_ "CANFD_BRS" BO_ 923 1;
BA_ "GenMsgCycleTime" BO_ 923 100;
BA_ "GenMsgCycleTimeFast" BO_ 923 0;
BA_ "GenMsgSendType" BO_ 923 0;
BA_ "VFrameFormat" BO_ 923 14;
BA_ "CANFD_BRS" BO_ 923 1;
BA_ "GenMsgCycleTime" BO_ 923 100;
BA_ "GenMsgCycleTimeFast" BO_ 923 0;
BA_ "GenMsgSendType" BO_ 923 0;
BA_ "VFrameFormat" BO_ 923 14;
BA_ "CANFD_BRS" BO_ 923 1;
BA_ "GenMsgCycleTime" BO_ 923 100;
BA_ "GenMsgCycleTimeFast" BO_ 923 0;
BA_ "GenMsgSendType" BO_ 923 0;
BA_ "VFrameFormat" BO_ 923 14;
BA_ "CANFD_BRS" BO_ 923 1;
BA_ "GenMsgCycleTime" BO_ 923 100;
BA_ "GenMsgCycleTimeFast" BO_ 923 0;
BA_ "GenMsgSendType" BO_ 923 0;
BA_ "VFrameFormat" BO_ 923 14;
BA_ "CANFD_BRS" BO_ 923 1;
BA_ "GenMsgCycleTime" BO_ 923 100;
BA_ "GenMsgCycleTimeFast" BO_ 923 0;
BA_ "GenMsgSendType" BO_ 923 0;
BA_ "VFrameFormat" BO_ 923 14;
BA_ "CANFD_BRS" BO_ 923 1;
BA_ "GenMsgCycleTime" BO_ 923 100;
BA_ "GenMsgCycleTimeFast" BO_ 923 0;
BA_ "GenMsgSendType" BO_ 923 0;
BA_ "VFrameFormat" BO_ 923 14;
BA_ "CANFD_BRS" BO_ 923 1;
BA_ "GenMsgCycleTime" BO_ 923 100;
BA_ "GenMsgCycleTimeFast" BO_ 923 0;
BA_ "GenMsgSendType" BO_ 923 0;
BA_ "VFrameFormat" BO_ 923 14;
BA_ "CANFD_BRS" BO_ 923 1;
BA_ "GenMsgCycleTime" BO_ 923 100;
BA_ "GenMsgCycleTimeFast" BO_ 923 0;
BA_ "GenMsgSendType" BO_ 923 0;
BA_ "VFrameFormat" BO_ 923 14;
BA_ "CANFD_BRS" BO_ 923 1;
BA_ "GenMsgCycleTime" BO_ 923 100;
BA_ "GenMsgCycleTimeFast" BO_ 923 0;
BA_ "GenMsgSendType" BO_ 923 0;
BA_ "VFrameFormat" BO_ 923 14;
BA_ "CANFD_BRS" BO_ 923 1;
BA_ "GenMsgCycleTime" BO_ 923 100;
BA_ "GenMsgCycleTimeFast" BO_ 923 0;
BA_ "GenMsgSendType" BO_ 923 0;
BA_ "VFrameFormat" BO_ 923 14;
BA_ "CANFD_BRS" BO_ 923 1;
BA_ "GenMsgCycleTime" BO_ 923 100;
BA_ "GenMsgCycleTimeFast" BO_ 923 0;
BA_ "GenMsgSendType" BO_ 923 0;
BA_ "VFrameFormat" BO_ 923 14;
BA_ "CANFD_BRS" BO_ 923 1;
BA_ "GenMsgCycleTime" BO_ 923 100;
BA_ "GenMsgCycleTimeFast" BO_ 923 0;
BA_ "GenMsgSendType" BO_ 923 0;
BA_ "VFrameFormat" BO_ 923 14;
BA_ "CANFD_BRS" BO_ 923 1;
BA_ "GenMsgCycleTime" BO_ 923 100;
BA_ "GenMsgCycleTimeFast" BO_ 923 0;
BA_ "GenMsgSendType" BO_ 923 0;
BA_ "VFrameFormat" BO_ 923 14;
BA_ "CANFD_BRS" BO_ 923 1;
BA_ "GenMsgCycleTime" BO_ 923 100;
BA_ "GenMsgCycleTimeFast" BO_ 923 0;
BA_ "GenMsgSendType" BO_ 923 0;
BA_ "VFrameFormat" BO_ 923 14;
BA_ "CANFD_BRS" BO_ 923 1;
BA_ "GenMsgCycleTime" BO_ 923 100;
BA_ "GenMsgCycleTimeFast" BO_ 923 0;
BA_ "GenMsgSendType" BO_ 923 0;
BA_ "VFrameFormat" BO_ 923 14;
BA_ "CANFD_BRS" BO_ 923 1;
BA_ "GenMsgCycleTime" BO_ 923 100;
BA_ "GenMsgCycleTimeFast" BO_ 923 0;
BA_ "GenMsgSendType" BO_ 923 0;
BA_ "VFrameFormat" BO_ 923 14;
BA_ "CANFD_BRS" BO_ 923 1;
BA_ "GenMsgCycleTime" BO_ 923 100;
BA_ "GenMsgCycleTimeFast" BO_ 923 0;
BA_ "GenMsgSendType" BO_ 923 0;
BA_ "VFrameFormat" BO_ 923 14;
BA_ "CANFD_BRS" BO_ 923 1;
BA_ "GenMsgCycleTime" BO_ 923 100;
BA_ "GenMsgCycleTimeFast" BO_ 923 0;
BA_ "GenMsgSendType" BO_ 923 0;
BA_ "VFrameFormat" BO_ 923 14;
BA_ "CANFD_BRS" BO_ 923 1;
BA_ "GenMsgCycleTime" BO_ 923 100;
BA_ "GenMsgCycleTimeFast" BO_ 923 0;
BA_ "GenMsgSendType" BO_ 923 0;
BA_ "VFrameFormat" BO_ 923 14;
BA_ "CANFD_BRS" BO_ 923 1;
BA_ "GenMsgCycleTime" BO_ 923 100;
BA_ "GenMsgCycleTimeFast" BO_ 923 0;
BA_ "GenMsgSendType" BO_ 923 0;
BA_ "VFrameFormat" BO_ 923 14;
BA_ "CANFD_BRS" BO_ 923 1;
BA_ "GenMsgCycleTime" BO_ 923 100;
BA_ "GenMsgCycleTimeFast" BO_ 923 0;
BA_ "GenMsgSendType" BO_ 923 0;
BA_ "VFrameFormat" BO_ 923 14;
BA_ "CANFD_BRS" BO_ 923 1;
BA_ "GenMsgCycleTime" BO_ 923 100;
BA_ "GenMsgCycleTimeFast" BO_ 923 0;
BA_ "GenMsgSendType" BO_ 923 0;
BA_ "VFrameFormat" BO_ 923 14;
BA_ "CANFD_BRS" BO_ 923 1;
BA_ "GenMsgCycleTime" BO_ 923 100;
BA_ "GenMsgCycleTimeFast" BO_ 923 0;
BA_ "GenMsgSendType" BO_ 923 0;
BA_ "VFrameFormat" BO_ 923 14;
BA_ "CANFD_BRS" BO_ 923 1;
BA_ "GenMsgCycleTime" BO_ 923 100;
BA_ "GenMsgCycleTimeFast" BO_ 923 0;
BA_ "GenMsgSendType" BO_ 923 0;
BA_ "VFrameFormat" BO_ 923 14;
BA_ "CANFD_BRS" BO_ 923 1;
BA_ "GenMsgCycleTime" BO_ 923 100;
BA_ "GenMsgCycleTimeFast" BO_ 923 0;
BA_ "GenMsgSendType" BO_ 923 0;
BA_ "VFrameFormat" BO_ 923 14;
BA_ "CANFD_BRS" BO_ 923 1;
BA_ "GenMsgCycleTime" BO_ 923 100;
BA_ "GenMsgCycleTimeFast" BO_ 923 0;
BA_ "GenMsgSendType" BO_ 923 0;
BA_ "VFrameFormat" BO_ 923 14;
BA_ "CANFD_BRS" BO_ 923 1;
BA_ "GenMsgCycleTime" BO_ 923 100;
BA_ "GenMsgCycleTimeFast" BO_ 923 0;
BA_ "GenMsgSendType" BO_ 923 0;
BA_ "VFrameFormat" BO_ 923 14;
BA_ "CANFD_BRS" BO_ 923 1;
BA_ "GenMsgCycleTime" BO_ 923 100;
BA_ "GenMsgCycleTimeFast" BO_ 923 0;
BA_ "GenMsgSendType" BO_ 923 0;
BA_ "VFrameFormat" BO_ 923 14;
BA_ "CANFD_BRS" BO_ 923 1;
BA_ "GenMsgCycleTime" BO_ 923 100;
BA_ "GenMsgCycleTimeFast" BO_ 923 0;
BA_ "GenMsgSendType" BO_ 923 0;
BA_ "VFrameFormat" BO_ 923 14;
BA_ "CANFD_BRS" BO_ 923 1;
BA_ "GenMsgCycleTime" BO_ 923 100;
BA_ "GenMsgCycleTimeFast" BO_ 923 0;
BA_ "GenMsgSendType" BO_ 923 0;
BA_ "VFrameFormat" BO_ 923 14;
BA_ "CANFD_BRS" BO_ 923 1;
BA_ "GenMsgCycleTime" BO_ 923 100;
BA_ "GenMsgCycleTimeFast" BO_ 923 0;
BA_ "GenMsgSendType" BO_ 923 0;
BA_ "VFrameFormat" BO_ 923 14;
BA_ "CANFD_BRS" BO_ 923 1;
BA_ "GenMsgCycleTime" BO_ 923 100;
BA_ "GenMsgCycleTimeFast" BO_ 923 0;
BA_ "GenMsgSendType" BO_ 923 0;
BA_ "VFrameFormat" BO_ 923 14;
BA_ "CANFD_BRS" BO_ 923 1;
BA_ "GenMsgCycleTime" BO_ 923 100;
BA_ "GenMsgCycleTimeFast" BO_ 923 0;
BA_ "GenMsgSendType" BO_ 923 0;
BA_ "VFrameFormat" BO_ 923 14;
BA_ "CANFD_BRS" BO_ 923 1;
BA_ "EventCommandSignal" SG_ 419 ADC_4_CRC 0;
BA_ "GatewayedSignals" SG_ 419 ADC_4_CRC 0;
BA_ "GenSigInactiveValue" SG_ 419 ADC_4_CRC 0;
BA_ "GenSigInvalidValue" SG_ 419 ADC_4_CRC 0;
BA_ "GenSigSendType" SG_ 419 ADC_4_CRC 1;
BA_ "GenSigStartValue" SG_ 419 ADC_4_CRC 0;
BA_ "GenSigTimeoutValue" SG_ 419 ADC_4_CRC 0;
BA_ "Remark" SG_ 419 ADC_4_CRC "";
BA_ "EventCommandSignal" SG_ 419 ADC_4_Counter 0;
BA_ "GatewayedSignals" SG_ 419 ADC_4_Counter 0;
BA_ "GenSigInactiveValue" SG_ 419 ADC_4_Counter 0;
BA_ "GenSigInvalidValue" SG_ 419 ADC_4_Counter 0;
BA_ "GenSigSendType" SG_ 419 ADC_4_Counter 1;
BA_ "GenSigStartValue" SG_ 419 ADC_4_Counter 0;
BA_ "GenSigTimeoutValue" SG_ 419 ADC_4_Counter 0;
BA_ "Remark" SG_ 419 ADC_4_Counter "";
BA_ "EventCommandSignal" SG_ 419 ADC_AngReqSt_A 0;
BA_ "GatewayedSignals" SG_ 419 ADC_AngReqSt_A 0;
BA_ "GenSigInactiveValue" SG_ 419 ADC_AngReqSt_A 0;
BA_ "GenSigInvalidValue" SG_ 419 ADC_AngReqSt_A 0;
BA_ "GenSigSendType" SG_ 419 ADC_AngReqSt_A 1;
BA_ "GenSigStartValue" SG_ 419 ADC_AngReqSt_A 0;
BA_ "GenSigTimeoutValue" SG_ 419 ADC_AngReqSt_A 0;
BA_ "Remark" SG_ 419 ADC_AngReqSt_A "";
BA_ "EventCommandSignal" SG_ 419 ADC_AngReqFunction 0;
BA_ "GatewayedSignals" SG_ 419 ADC_AngReqFunction 0;
BA_ "GenSigInactiveValue" SG_ 419 ADC_AngReqFunction 0;
BA_ "GenSigInvalidValue" SG_ 419 ADC_AngReqFunction 0;
BA_ "GenSigSendType" SG_ 419 ADC_AngReqFunction 1;
BA_ "GenSigStartValue" SG_ 419 ADC_AngReqFunction 0;
BA_ "GenSigTimeoutValue" SG_ 419 ADC_AngReqFunction 0;
BA_ "Remark" SG_ 419 ADC_AngReqFunction "";
BA_ "EventCommandSignal" SG_ 419 ADC_BrakeLightReq 0;
BA_ "GatewayedSignals" SG_ 419 ADC_BrakeLightReq 0;
BA_ "GenSigInactiveValue" SG_ 419 ADC_BrakeLightReq 0;
BA_ "GenSigInvalidValue" SG_ 419 ADC_BrakeLightReq 0;
BA_ "GenSigSendType" SG_ 419 ADC_BrakeLightReq 1;
BA_ "GenSigStartValue" SG_ 419 ADC_BrakeLightReq 0;
BA_ "GenSigTimeoutValue" SG_ 419 ADC_BrakeLightReq 0;
BA_ "Remark" SG_ 419 ADC_BrakeLightReq "";
BA_ "EventCommandSignal" SG_ 419 ADC_StrAngleReq_A 0;
BA_ "GatewayedSignals" SG_ 419 ADC_StrAngleReq_A 0;
BA_ "GenSigInactiveValue" SG_ 419 ADC_StrAngleReq_A 0;
BA_ "GenSigInvalidValue" SG_ 419 ADC_StrAngleReq_A 65535;
BA_ "GenSigSendType" SG_ 419 ADC_StrAngleReq_A 1;
BA_ "GenSigStartValue" SG_ 419 ADC_StrAngleReq_A 7800;
BA_ "GenSigTimeoutValue" SG_ 419 ADC_StrAngleReq_A 65535;
BA_ "Remark" SG_ 419 ADC_StrAngleReq_A "";
BA_ "EventCommandSignal" SG_ 419 ADC_SACMotorTorLimExtMax_A 0;
BA_ "GatewayedSignals" SG_ 419 ADC_SACMotorTorLimExtMax_A 0;
BA_ "GenSigInactiveValue" SG_ 419 ADC_SACMotorTorLimExtMax_A 0;
BA_ "GenSigInvalidValue" SG_ 419 ADC_SACMotorTorLimExtMax_A 255;
BA_ "GenSigSendType" SG_ 419 ADC_SACMotorTorLimExtMax_A 1;
BA_ "GenSigStartValue" SG_ 419 ADC_SACMotorTorLimExtMax_A 254;
BA_ "GenSigTimeoutValue" SG_ 419 ADC_SACMotorTorLimExtMax_A 255;
BA_ "Remark" SG_ 419 ADC_SACMotorTorLimExtMax_A "";
BA_ "EventCommandSignal" SG_ 419 ADC_SACMotorTorLimExtMin_A 0;
BA_ "GatewayedSignals" SG_ 419 ADC_SACMotorTorLimExtMin_A 0;
BA_ "GenSigInactiveValue" SG_ 419 ADC_SACMotorTorLimExtMin_A 0;
BA_ "GenSigInvalidValue" SG_ 419 ADC_SACMotorTorLimExtMin_A 255;
BA_ "GenSigSendType" SG_ 419 ADC_SACMotorTorLimExtMin_A 1;
BA_ "GenSigStartValue" SG_ 419 ADC_SACMotorTorLimExtMin_A 0;
BA_ "GenSigTimeoutValue" SG_ 419 ADC_SACMotorTorLimExtMin_A 255;
BA_ "Remark" SG_ 419 ADC_SACMotorTorLimExtMin_A "";
BA_ "EventCommandSignal" SG_ 419 ADC_AssistParaSwitchReq 0;
BA_ "GatewayedSignals" SG_ 419 ADC_AssistParaSwitchReq 0;
BA_ "GenSigInactiveValue" SG_ 419 ADC_AssistParaSwitchReq 0;
BA_ "GenSigInvalidValue" SG_ 419 ADC_AssistParaSwitchReq 0;
BA_ "GenSigSendType" SG_ 419 ADC_AssistParaSwitchReq 1;
BA_ "GenSigStartValue" SG_ 419 ADC_AssistParaSwitchReq 0;
BA_ "GenSigTimeoutValue" SG_ 419 ADC_AssistParaSwitchReq 0;
BA_ "Remark" SG_ 419 ADC_AssistParaSwitchReq "";
BA_ "EventCommandSignal" SG_ 419 ADC_AngReqRdntReq_A 0;
BA_ "GatewayedSignals" SG_ 419 ADC_AngReqRdntReq_A 0;
BA_ "GenSigInactiveValue" SG_ 419 ADC_AngReqRdntReq_A 0;
BA_ "GenSigInvalidValue" SG_ 419 ADC_AngReqRdntReq_A 0;
BA_ "GenSigSendType" SG_ 419 ADC_AngReqRdntReq_A 1;
BA_ "GenSigStartValue" SG_ 419 ADC_AngReqRdntReq_A 0;
BA_ "GenSigTimeoutValue" SG_ 419 ADC_AngReqRdntReq_A 0;
BA_ "Remark" SG_ 419 ADC_AngReqRdntReq_A "";
BA_ "EventCommandSignal" SG_ 419 ADC_SteerGainReq 0;
BA_ "GatewayedSignals" SG_ 419 ADC_SteerGainReq 0;
BA_ "GenSigInactiveValue" SG_ 419 ADC_SteerGainReq 0;
BA_ "GenSigInvalidValue" SG_ 419 ADC_SteerGainReq 0;
BA_ "GenSigSendType" SG_ 419 ADC_SteerGainReq 1;
BA_ "GenSigStartValue" SG_ 419 ADC_SteerGainReq 0;
BA_ "GenSigTimeoutValue" SG_ 419 ADC_SteerGainReq 0;
BA_ "Remark" SG_ 419 ADC_SteerGainReq "";
BA_ "EventCommandSignal" SG_ 419 ADC_StrgWhlVibrWarnLevel 0;
BA_ "GatewayedSignals" SG_ 419 ADC_StrgWhlVibrWarnLevel 0;
BA_ "GenSigInactiveValue" SG_ 419 ADC_StrgWhlVibrWarnLevel 0;
BA_ "GenSigInvalidValue" SG_ 419 ADC_StrgWhlVibrWarnLevel 0;
BA_ "GenSigSendType" SG_ 419 ADC_StrgWhlVibrWarnLevel 1;
BA_ "GenSigStartValue" SG_ 419 ADC_StrgWhlVibrWarnLevel 0;
BA_ "GenSigTimeoutValue" SG_ 419 ADC_StrgWhlVibrWarnLevel 0;
BA_ "Remark" SG_ 419 ADC_StrgWhlVibrWarnLevel "";
BA_ "EventCommandSignal" SG_ 419 ADC_ActTrqReqEnable 0;
BA_ "GatewayedSignals" SG_ 419 ADC_ActTrqReqEnable 0;
BA_ "GenSigInactiveValue" SG_ 419 ADC_ActTrqReqEnable 0;
BA_ "GenSigInvalidValue" SG_ 419 ADC_ActTrqReqEnable 0;
BA_ "GenSigSendType" SG_ 419 ADC_ActTrqReqEnable 1;
BA_ "GenSigStartValue" SG_ 419 ADC_ActTrqReqEnable 0;
BA_ "GenSigTimeoutValue" SG_ 419 ADC_ActTrqReqEnable 0;
BA_ "Remark" SG_ 419 ADC_ActTrqReqEnable "";
BA_ "EventCommandSignal" SG_ 419 ADC_VLCSt 0;
BA_ "GatewayedSignals" SG_ 419 ADC_VLCSt 0;
BA_ "GenSigInactiveValue" SG_ 419 ADC_VLCSt 0;
BA_ "GenSigInvalidValue" SG_ 419 ADC_VLCSt 0;
BA_ "GenSigSendType" SG_ 419 ADC_VLCSt 1;
BA_ "GenSigStartValue" SG_ 419 ADC_VLCSt 0;
BA_ "GenSigTimeoutValue" SG_ 419 ADC_VLCSt 0;
BA_ "Remark" SG_ 419 ADC_VLCSt "";
BA_ "EventCommandSignal" SG_ 419 ADC_SteerGainLevel 0;
BA_ "GatewayedSignals" SG_ 419 ADC_SteerGainLevel 0;
BA_ "GenSigInactiveValue" SG_ 419 ADC_SteerGainLevel 0;
BA_ "GenSigInvalidValue" SG_ 419 ADC_SteerGainLevel 255;
BA_ "GenSigSendType" SG_ 419 ADC_SteerGainLevel 1;
BA_ "GenSigStartValue" SG_ 419 ADC_SteerGainLevel 0;
BA_ "GenSigTimeoutValue" SG_ 419 ADC_SteerGainLevel 100;
BA_ "Remark" SG_ 419 ADC_SteerGainLevel "";
BA_ "EventCommandSignal" SG_ 419 ADC_EvsSteerReq 0;
BA_ "GatewayedSignals" SG_ 419 ADC_EvsSteerReq 0;
BA_ "GenSigInactiveValue" SG_ 419 ADC_EvsSteerReq 0;
BA_ "GenSigInvalidValue" SG_ 419 ADC_EvsSteerReq 0;
BA_ "GenSigSendType" SG_ 419 ADC_EvsSteerReq 1;
BA_ "GenSigStartValue" SG_ 419 ADC_EvsSteerReq 0;
BA_ "GenSigTimeoutValue" SG_ 419 ADC_EvsSteerReq 0;
BA_ "Remark" SG_ 419 ADC_EvsSteerReq "";
BA_ "EventCommandSignal" SG_ 419 ADC_StrgWhlVibrWarnReq 0;
BA_ "GatewayedSignals" SG_ 419 ADC_StrgWhlVibrWarnReq 0;
BA_ "GenSigInactiveValue" SG_ 419 ADC_StrgWhlVibrWarnReq 0;
BA_ "GenSigInvalidValue" SG_ 419 ADC_StrgWhlVibrWarnReq 0;
BA_ "GenSigSendType" SG_ 419 ADC_StrgWhlVibrWarnReq 1;
BA_ "GenSigStartValue" SG_ 419 ADC_StrgWhlVibrWarnReq 0;
BA_ "GenSigTimeoutValue" SG_ 419 ADC_StrgWhlVibrWarnReq 0;
BA_ "Remark" SG_ 419 ADC_StrgWhlVibrWarnReq "";
BA_ "EventCommandSignal" SG_ 419 ADC_ActTrqReq 0;
BA_ "GatewayedSignals" SG_ 419 ADC_ActTrqReq 0;
BA_ "GenSigInactiveValue" SG_ 419 ADC_ActTrqReq 0;
BA_ "GenSigInvalidValue" SG_ 419 ADC_ActTrqReq 0;
BA_ "GenSigSendType" SG_ 419 ADC_ActTrqReq 1;
BA_ "GenSigStartValue" SG_ 419 ADC_ActTrqReq 0;
BA_ "GenSigTimeoutValue" SG_ 419 ADC_ActTrqReq 0;
BA_ "Remark" SG_ 419 ADC_ActTrqReq "";
BA_ "EventCommandSignal" SG_ 419 ADC_PAA2ESPSpdLimit 0;
BA_ "GatewayedSignals" SG_ 419 ADC_PAA2ESPSpdLimit 0;
BA_ "GenSigInactiveValue" SG_ 419 ADC_PAA2ESPSpdLimit 0;
BA_ "GenSigInvalidValue" SG_ 419 ADC_PAA2ESPSpdLimit 0;
BA_ "GenSigSendType" SG_ 419 ADC_PAA2ESPSpdLimit 1;
BA_ "GenSigStartValue" SG_ 419 ADC_PAA2ESPSpdLimit 0;
BA_ "GenSigTimeoutValue" SG_ 419 ADC_PAA2ESPSpdLimit 0;
BA_ "Remark" SG_ 419 ADC_PAA2ESPSpdLimit "";
BA_ "EventCommandSignal" SG_ 419 IFC_DPTst 0;
BA_ "GatewayedSignals" SG_ 419 IFC_DPTst 0;
BA_ "GenSigInactiveValue" SG_ 419 IFC_DPTst 0;
BA_ "GenSigInvalidValue" SG_ 419 IFC_DPTst 0;
BA_ "GenSigSendType" SG_ 419 IFC_DPTst 1;
BA_ "GenSigStartValue" SG_ 419 IFC_DPTst 0;
BA_ "GenSigTimeoutValue" SG_ 419 IFC_DPTst 0;
BA_ "Remark" SG_ 419 IFC_DPTst "";
BA_ "EventCommandSignal" SG_ 419 ADC_DrvTarTqMod2EPB 0;
BA_ "GatewayedSignals" SG_ 419 ADC_DrvTarTqMod2EPB 0;
BA_ "GenSigInactiveValue" SG_ 419 ADC_DrvTarTqMod2EPB 0;
BA_ "GenSigInvalidValue" SG_ 419 ADC_DrvTarTqMod2EPB 0;
BA_ "GenSigSendType" SG_ 419 ADC_DrvTarTqMod2EPB 1;
BA_ "GenSigStartValue" SG_ 419 ADC_DrvTarTqMod2EPB 0;
BA_ "GenSigTimeoutValue" SG_ 419 ADC_DrvTarTqMod2EPB 0;
BA_ "Remark" SG_ 419 ADC_DrvTarTqMod2EPB "";
BA_ "EventCommandSignal" SG_ 419 ADC_ADASLongCtrlFuncMode 0;
BA_ "GatewayedSignals" SG_ 419 ADC_ADASLongCtrlFuncMode 0;
BA_ "GenSigInactiveValue" SG_ 419 ADC_ADASLongCtrlFuncMode 0;
BA_ "GenSigInvalidValue" SG_ 419 ADC_ADASLongCtrlFuncMode 0;
BA_ "GenSigSendType" SG_ 419 ADC_ADASLongCtrlFuncMode 1;
BA_ "GenSigStartValue" SG_ 419 ADC_ADASLongCtrlFuncMode 0;
BA_ "GenSigTimeoutValue" SG_ 419 ADC_ADASLongCtrlFuncMode 0;
BA_ "Remark" SG_ 419 ADC_ADASLongCtrlFuncMode "";
BA_ "EventCommandSignal" SG_ 419 ADC_LongCtrlAvailability 0;
BA_ "GatewayedSignals" SG_ 419 ADC_LongCtrlAvailability 0;
BA_ "GenSigInactiveValue" SG_ 419 ADC_LongCtrlAvailability 0;
BA_ "GenSigInvalidValue" SG_ 419 ADC_LongCtrlAvailability 0;
BA_ "GenSigSendType" SG_ 419 ADC_LongCtrlAvailability 1;
BA_ "GenSigStartValue" SG_ 419 ADC_LongCtrlAvailability 0;
BA_ "GenSigTimeoutValue" SG_ 419 ADC_LongCtrlAvailability 0;
BA_ "Remark" SG_ 419 ADC_LongCtrlAvailability "";
BA_ "EventCommandSignal" SG_ 419 ADC_LongCtrlModeForBrkSys 0;
BA_ "GatewayedSignals" SG_ 419 ADC_LongCtrlModeForBrkSys 0;
BA_ "GenSigInactiveValue" SG_ 419 ADC_LongCtrlModeForBrkSys 0;
BA_ "GenSigInvalidValue" SG_ 419 ADC_LongCtrlModeForBrkSys 0;
BA_ "GenSigSendType" SG_ 419 ADC_LongCtrlModeForBrkSys 1;
BA_ "GenSigStartValue" SG_ 419 ADC_LongCtrlModeForBrkSys 0;
BA_ "GenSigTimeoutValue" SG_ 419 ADC_LongCtrlModeForBrkSys 0;
BA_ "Remark" SG_ 419 ADC_LongCtrlModeForBrkSys "";
BA_ "EventCommandSignal" SG_ 419 ADC_LongCtrlTargetAxReq 0;
BA_ "GatewayedSignals" SG_ 419 ADC_LongCtrlTargetAxReq 0;
BA_ "GenSigInactiveValue" SG_ 419 ADC_LongCtrlTargetAxReq 0;
BA_ "GenSigInvalidValue" SG_ 419 ADC_LongCtrlTargetAxReq 0;
BA_ "GenSigSendType" SG_ 419 ADC_LongCtrlTargetAxReq 1;
BA_ "GenSigStartValue" SG_ 419 ADC_LongCtrlTargetAxReq 0;
BA_ "GenSigTimeoutValue" SG_ 419 ADC_LongCtrlTargetAxReq 0;
BA_ "Remark" SG_ 419 ADC_LongCtrlTargetAxReq "";
BA_ "EventCommandSignal" SG_ 419 ADC_LongCtrlTypReq 0;
BA_ "GatewayedSignals" SG_ 419 ADC_LongCtrlTypReq 0;
BA_ "GenSigInactiveValue" SG_ 419 ADC_LongCtrlTypReq 0;
BA_ "GenSigInvalidValue" SG_ 419 ADC_LongCtrlTypReq 0;
BA_ "GenSigSendType" SG_ 419 ADC_LongCtrlTypReq 1;
BA_ "GenSigStartValue" SG_ 419 ADC_LongCtrlTypReq 0;
BA_ "GenSigTimeoutValue" SG_ 419 ADC_LongCtrlTypReq 0;
BA_ "Remark" SG_ 419 ADC_LongCtrlTypReq "";
BA_ "EventCommandSignal" SG_ 419 ADC_LongCtrlDecToStopReq 0;
BA_ "GatewayedSignals" SG_ 419 ADC_LongCtrlDecToStopReq 0;
BA_ "GenSigInactiveValue" SG_ 419 ADC_LongCtrlDecToStopReq 0;
BA_ "GenSigInvalidValue" SG_ 419 ADC_LongCtrlDecToStopReq 0;
BA_ "GenSigSendType" SG_ 419 ADC_LongCtrlDecToStopReq 1;
BA_ "GenSigStartValue" SG_ 419 ADC_LongCtrlDecToStopReq 0;
BA_ "GenSigTimeoutValue" SG_ 419 ADC_LongCtrlDecToStopReq 0;
BA_ "Remark" SG_ 419 ADC_LongCtrlDecToStopReq "";
BA_ "EventCommandSignal" SG_ 419 ADC_LongCtrlDriveOff 0;
BA_ "GatewayedSignals" SG_ 419 ADC_LongCtrlDriveOff 0;
BA_ "GenSigInactiveValue" SG_ 419 ADC_LongCtrlDriveOff 0;
BA_ "GenSigInvalidValue" SG_ 419 ADC_LongCtrlDriveOff 0;
BA_ "GenSigSendType" SG_ 419 ADC_LongCtrlDriveOff 1;
BA_ "GenSigStartValue" SG_ 419 ADC_LongCtrlDriveOff 0;
BA_ "GenSigTimeoutValue" SG_ 419 ADC_LongCtrlDriveOff 0;
BA_ "Remark" SG_ 419 ADC_LongCtrlDriveOff "";
BA_ "EventCommandSignal" SG_ 419 ADC_LongctrlSecureReq 0;
BA_ "GatewayedSignals" SG_ 419 ADC_LongctrlSecureReq 0;
BA_ "GenSigInactiveValue" SG_ 419 ADC_LongctrlSecureReq 0;
BA_ "GenSigInvalidValue" SG_ 419 ADC_LongctrlSecureReq 0;
BA_ "GenSigSendType" SG_ 419 ADC_LongctrlSecureReq 1;
BA_ "GenSigStartValue" SG_ 419 ADC_LongctrlSecureReq 0;
BA_ "GenSigTimeoutValue" SG_ 419 ADC_LongctrlSecureReq 0;
BA_ "Remark" SG_ 419 ADC_LongctrlSecureReq "";
BA_ "EventCommandSignal" SG_ 419 ADC_ShifttoAVHReq 0;
BA_ "GatewayedSignals" SG_ 419 ADC_ShifttoAVHReq 0;
BA_ "GenSigInactiveValue" SG_ 419 ADC_ShifttoAVHReq 0;
BA_ "GenSigInvalidValue" SG_ 419 ADC_ShifttoAVHReq 0;
BA_ "GenSigSendType" SG_ 419 ADC_ShifttoAVHReq 1;
BA_ "GenSigStartValue" SG_ 419 ADC_ShifttoAVHReq 0;
BA_ "GenSigTimeoutValue" SG_ 419 ADC_ShifttoAVHReq 0;
BA_ "Remark" SG_ 419 ADC_ShifttoAVHReq "";
BA_ "EventCommandSignal" SG_ 419 ADC_LongCtrlTargetAx 0;
BA_ "GatewayedSignals" SG_ 419 ADC_LongCtrlTargetAx 0;
BA_ "GenSigInactiveValue" SG_ 419 ADC_LongCtrlTargetAx 0;
BA_ "GenSigInvalidValue" SG_ 419 ADC_LongCtrlTargetAx 0;
BA_ "GenSigSendType" SG_ 419 ADC_LongCtrlTargetAx 1;
BA_ "GenSigStartValue" SG_ 419 ADC_LongCtrlTargetAx 0;
BA_ "GenSigTimeoutValue" SG_ 419 ADC_LongCtrlTargetAx 0;
BA_ "Remark" SG_ 419 ADC_LongCtrlTargetAx "";
BA_ "EventCommandSignal" SG_ 419 ADC_TrkTargt0St 0;
BA_ "GatewayedSignals" SG_ 419 ADC_TrkTargt0St 0;
BA_ "GenSigInactiveValue" SG_ 419 ADC_TrkTargt0St 0;
BA_ "GenSigInvalidValue" SG_ 419 ADC_TrkTargt0St 0;
BA_ "GenSigSendType" SG_ 419 ADC_TrkTargt0St 1;
BA_ "GenSigStartValue" SG_ 419 ADC_TrkTargt0St 0;
BA_ "GenSigTimeoutValue" SG_ 419 ADC_TrkTargt0St 0;
BA_ "Remark" SG_ 419 ADC_TrkTargt0St "";
BA_ "EventCommandSignal" SG_ 419 ADC_TrkTargt0longPos 0;
BA_ "GatewayedSignals" SG_ 419 ADC_TrkTargt0longPos 0;
BA_ "GenSigInactiveValue" SG_ 419 ADC_TrkTargt0longPos 0;
BA_ "GenSigInvalidValue" SG_ 419 ADC_TrkTargt0longPos 1023;
BA_ "GenSigSendType" SG_ 419 ADC_TrkTargt0longPos 1;
BA_ "GenSigStartValue" SG_ 419 ADC_TrkTargt0longPos 0;
BA_ "GenSigTimeoutValue" SG_ 419 ADC_TrkTargt0longPos 0;
BA_ "Remark" SG_ 419 ADC_TrkTargt0longPos "";
BA_ "EventCommandSignal" SG_ 419 ADC_TrkTargt0latPos 0;
BA_ "GatewayedSignals" SG_ 419 ADC_TrkTargt0latPos 0;
BA_ "GenSigInactiveValue" SG_ 419 ADC_TrkTargt0latPos 0;
BA_ "GenSigInvalidValue" SG_ 419 ADC_TrkTargt0latPos 0;
BA_ "GenSigSendType" SG_ 419 ADC_TrkTargt0latPos 1;
BA_ "GenSigStartValue" SG_ 419 ADC_TrkTargt0latPos 512;
BA_ "GenSigTimeoutValue" SG_ 419 ADC_TrkTargt0latPos 0;
BA_ "Remark" SG_ 419 ADC_TrkTargt0latPos "";
BA_ "EventCommandSignal" SG_ 419 ADC_TrkTargt0LatRelSpd 0;
BA_ "GatewayedSignals" SG_ 419 ADC_TrkTargt0LatRelSpd 0;
BA_ "GenSigInactiveValue" SG_ 419 ADC_TrkTargt0LatRelSpd 0;
BA_ "GenSigInvalidValue" SG_ 419 ADC_TrkTargt0LatRelSpd 511;
BA_ "GenSigSendType" SG_ 419 ADC_TrkTargt0LatRelSpd 1;
BA_ "GenSigStartValue" SG_ 419 ADC_TrkTargt0LatRelSpd 0;
BA_ "GenSigTimeoutValue" SG_ 419 ADC_TrkTargt0LatRelSpd 0;
BA_ "Remark" SG_ 419 ADC_TrkTargt0LatRelSpd "";
BA_ "EventCommandSignal" SG_ 419 ADC_TrkTargt0LongRelSpd 0;
BA_ "GatewayedSignals" SG_ 419 ADC_TrkTargt0LongRelSpd 0;
BA_ "GenSigInactiveValue" SG_ 419 ADC_TrkTargt0LongRelSpd 0;
BA_ "GenSigInvalidValue" SG_ 419 ADC_TrkTargt0LongRelSpd 0;
BA_ "GenSigSendType" SG_ 419 ADC_TrkTargt0LongRelSpd 1;
BA_ "GenSigStartValue" SG_ 419 ADC_TrkTargt0LongRelSpd 0;
BA_ "GenSigTimeoutValue" SG_ 419 ADC_TrkTargt0LongRelSpd 0;
BA_ "Remark" SG_ 419 ADC_TrkTargt0LongRelSpd "";
BA_ "EventCommandSignal" SG_ 419 ADC_AS_pauseReq 0;
BA_ "GatewayedSignals" SG_ 419 ADC_AS_pauseReq 0;
BA_ "GenSigInactiveValue" SG_ 419 ADC_AS_pauseReq 0;
BA_ "GenSigInvalidValue" SG_ 419 ADC_AS_pauseReq 0;
BA_ "GenSigSendType" SG_ 419 ADC_AS_pauseReq 1;
BA_ "GenSigStartValue" SG_ 419 ADC_AS_pauseReq 0;
BA_ "GenSigTimeoutValue" SG_ 419 ADC_AS_pauseReq 0;
BA_ "Remark" SG_ 419 ADC_AS_pauseReq "";
BA_ "EventCommandSignal" SG_ 419 ADC_AS_calibrationReq 0;
BA_ "GatewayedSignals" SG_ 419 ADC_AS_calibrationReq 0;
BA_ "GenSigInactiveValue" SG_ 419 ADC_AS_calibrationReq 0;
BA_ "GenSigInvalidValue" SG_ 419 ADC_AS_calibrationReq 0;
BA_ "GenSigSendType" SG_ 419 ADC_AS_calibrationReq 1;
BA_ "GenSigStartValue" SG_ 419 ADC_AS_calibrationReq 0;
BA_ "GenSigTimeoutValue" SG_ 419 ADC_AS_calibrationReq 0;
BA_ "Remark" SG_ 419 ADC_AS_calibrationReq "";
BA_ "EventCommandSignal" SG_ 419 ADC_AS_exitcurrentlevelReq 0;
BA_ "GatewayedSignals" SG_ 419 ADC_AS_exitcurrentlevelReq 0;
BA_ "GenSigInactiveValue" SG_ 419 ADC_AS_exitcurrentlevelReq 0;
BA_ "GenSigInvalidValue" SG_ 419 ADC_AS_exitcurrentlevelReq 0;
BA_ "GenSigSendType" SG_ 419 ADC_AS_exitcurrentlevelReq 1;
BA_ "GenSigStartValue" SG_ 419 ADC_AS_exitcurrentlevelReq 0;
BA_ "GenSigTimeoutValue" SG_ 419 ADC_AS_exitcurrentlevelReq 0;
BA_ "Remark" SG_ 419 ADC_AS_exitcurrentlevelReq "";
BA_ "EventCommandSignal" SG_ 419 ADC_AS_ReqToadjust 0;
BA_ "GatewayedSignals" SG_ 419 ADC_AS_ReqToadjust 0;
BA_ "GenSigInactiveValue" SG_ 419 ADC_AS_ReqToadjust 0;
BA_ "GenSigInvalidValue" SG_ 419 ADC_AS_ReqToadjust 0;
BA_ "GenSigSendType" SG_ 419 ADC_AS_ReqToadjust 1;
BA_ "GenSigStartValue" SG_ 419 ADC_AS_ReqToadjust 0;
BA_ "GenSigTimeoutValue" SG_ 419 ADC_AS_ReqToadjust 0;
BA_ "Remark" SG_ 419 ADC_AS_ReqToadjust "";
BA_ "EventCommandSignal" SG_ 419 ADC_ASActiveSt 0;
BA_ "GatewayedSignals" SG_ 419 ADC_ASActiveSt 0;
BA_ "GenSigInactiveValue" SG_ 419 ADC_ASActiveSt 0;
BA_ "GenSigInvalidValue" SG_ 419 ADC_ASActiveSt 0;
BA_ "GenSigSendType" SG_ 419 ADC_ASActiveSt 1;
BA_ "GenSigStartValue" SG_ 419 ADC_ASActiveSt 0;
BA_ "GenSigTimeoutValue" SG_ 419 ADC_ASActiveSt 0;
BA_ "Remark" SG_ 419 ADC_ASActiveSt "";
BA_ "EventCommandSignal" SG_ 419 ADC_AS_UnsafelevelunableReq 0;
BA_ "GatewayedSignals" SG_ 419 ADC_AS_UnsafelevelunableReq 0;
BA_ "GenSigInactiveValue" SG_ 419 ADC_AS_UnsafelevelunableReq 0;
BA_ "GenSigInvalidValue" SG_ 419 ADC_AS_UnsafelevelunableReq 0;
BA_ "GenSigSendType" SG_ 419 ADC_AS_UnsafelevelunableReq 1;
BA_ "GenSigStartValue" SG_ 419 ADC_AS_UnsafelevelunableReq 0;
BA_ "GenSigTimeoutValue" SG_ 419 ADC_AS_UnsafelevelunableReq 0;
BA_ "Remark" SG_ 419 ADC_AS_UnsafelevelunableReq "";
BA_ "EventCommandSignal" SG_ 419 ADC_FcsActiveStatus 0;
BA_ "GatewayedSignals" SG_ 419 ADC_FcsActiveStatus 0;
BA_ "GenSigInactiveValue" SG_ 419 ADC_FcsActiveStatus 0;
BA_ "GenSigInvalidValue" SG_ 419 ADC_FcsActiveStatus 0;
BA_ "GenSigSendType" SG_ 419 ADC_FcsActiveStatus 1;
BA_ "GenSigStartValue" SG_ 419 ADC_FcsActiveStatus 0;
BA_ "GenSigTimeoutValue" SG_ 419 ADC_FcsActiveStatus 0;
BA_ "Remark" SG_ 419 ADC_FcsActiveStatus "";
BA_ "EventCommandSignal" SG_ 419 ADC_ComfstopReq 0;
BA_ "GatewayedSignals" SG_ 419 ADC_ComfstopReq 0;
BA_ "GenSigInactiveValue" SG_ 419 ADC_ComfstopReq 0;
BA_ "GenSigInvalidValue" SG_ 419 ADC_ComfstopReq 0;
BA_ "GenSigSendType" SG_ 419 ADC_ComfstopReq 1;
BA_ "GenSigStartValue" SG_ 419 ADC_ComfstopReq 0;
BA_ "GenSigTimeoutValue" SG_ 419 ADC_ComfstopReq 0;
BA_ "Remark" SG_ 419 ADC_ComfstopReq "";
BA_ "EventCommandSignal" SG_ 419 ADC_CSM_HoldReq 0;
BA_ "GatewayedSignals" SG_ 419 ADC_CSM_HoldReq 0;
BA_ "GenSigInactiveValue" SG_ 419 ADC_CSM_HoldReq 0;
BA_ "GenSigInvalidValue" SG_ 419 ADC_CSM_HoldReq 0;
BA_ "GenSigSendType" SG_ 419 ADC_CSM_HoldReq 1;
BA_ "GenSigStartValue" SG_ 419 ADC_CSM_HoldReq 0;
BA_ "GenSigTimeoutValue" SG_ 419 ADC_CSM_HoldReq 0;
BA_ "Remark" SG_ 419 ADC_CSM_HoldReq "";
BA_ "EventCommandSignal" SG_ 419 ADC_AEBTargetDecel 0;
BA_ "GatewayedSignals" SG_ 419 ADC_AEBTargetDecel 0;
BA_ "GenSigInactiveValue" SG_ 419 ADC_AEBTargetDecel 0;
BA_ "GenSigInvalidValue" SG_ 419 ADC_AEBTargetDecel 0;
BA_ "GenSigSendType" SG_ 419 ADC_AEBTargetDecel 1;
BA_ "GenSigStartValue" SG_ 419 ADC_AEBTargetDecel 0;
BA_ "GenSigTimeoutValue" SG_ 419 ADC_AEBTargetDecel 0;
BA_ "Remark" SG_ 419 ADC_AEBTargetDecel "";
BA_ "EventCommandSignal" SG_ 419 ADC_AEBFaultSt 0;
BA_ "GatewayedSignals" SG_ 419 ADC_AEBFaultSt 0;
BA_ "GenSigInactiveValue" SG_ 419 ADC_AEBFaultSt 0;
BA_ "GenSigInvalidValue" SG_ 419 ADC_AEBFaultSt 0;
BA_ "GenSigSendType" SG_ 419 ADC_AEBFaultSt 1;
BA_ "GenSigStartValue" SG_ 419 ADC_AEBFaultSt 0;
BA_ "GenSigTimeoutValue" SG_ 419 ADC_AEBFaultSt 1;
BA_ "Remark" SG_ 419 ADC_AEBFaultSt "";
BA_ "EventCommandSignal" SG_ 419 ADC_AEBOffSt 0;
BA_ "GatewayedSignals" SG_ 419 ADC_AEBOffSt 0;
BA_ "GenSigInactiveValue" SG_ 419 ADC_AEBOffSt 0;
BA_ "GenSigInvalidValue" SG_ 419 ADC_AEBOffSt 0;
BA_ "GenSigSendType" SG_ 419 ADC_AEBOffSt 1;
BA_ "GenSigStartValue" SG_ 419 ADC_AEBOffSt 0;
BA_ "GenSigTimeoutValue" SG_ 419 ADC_AEBOffSt 1;
BA_ "Remark" SG_ 419 ADC_AEBOffSt "";
BA_ "EventCommandSignal" SG_ 419 ADC_AEBInterventionSt 0;
BA_ "GatewayedSignals" SG_ 419 ADC_AEBInterventionSt 0;
BA_ "GenSigInactiveValue" SG_ 419 ADC_AEBInterventionSt 0;
BA_ "GenSigInvalidValue" SG_ 419 ADC_AEBInterventionSt 0;
BA_ "GenSigSendType" SG_ 419 ADC_AEBInterventionSt 1;
BA_ "GenSigStartValue" SG_ 419 ADC_AEBInterventionSt 0;
BA_ "GenSigTimeoutValue" SG_ 419 ADC_AEBInterventionSt 0;
BA_ "Remark" SG_ 419 ADC_AEBInterventionSt "";
BA_ "EventCommandSignal" SG_ 419 ADC_AEBDecelCtrlReq 0;
BA_ "GatewayedSignals" SG_ 419 ADC_AEBDecelCtrlReq 0;
BA_ "GenSigInactiveValue" SG_ 419 ADC_AEBDecelCtrlReq 0;
BA_ "GenSigInvalidValue" SG_ 419 ADC_AEBDecelCtrlReq 0;
BA_ "GenSigSendType" SG_ 419 ADC_AEBDecelCtrlReq 1;
BA_ "GenSigStartValue" SG_ 419 ADC_AEBDecelCtrlReq 0;
BA_ "GenSigTimeoutValue" SG_ 419 ADC_AEBDecelCtrlReq 0;
BA_ "Remark" SG_ 419 ADC_AEBDecelCtrlReq "";
BA_ "EventCommandSignal" SG_ 419 ADC_AEBLVehHoldReq 0;
BA_ "GatewayedSignals" SG_ 419 ADC_AEBLVehHoldReq 0;
BA_ "GenSigInactiveValue" SG_ 419 ADC_AEBLVehHoldReq 0;
BA_ "GenSigInvalidValue" SG_ 419 ADC_AEBLVehHoldReq 0;
BA_ "GenSigSendType" SG_ 419 ADC_AEBLVehHoldReq 1;
BA_ "GenSigStartValue" SG_ 419 ADC_AEBLVehHoldReq 0;
BA_ "GenSigTimeoutValue" SG_ 419 ADC_AEBLVehHoldReq 0;
BA_ "Remark" SG_ 419 ADC_AEBLVehHoldReq "";
BA_ "EventCommandSignal" SG_ 419 ADC_ABAReq 0;
BA_ "GatewayedSignals" SG_ 419 ADC_ABAReq 0;
BA_ "GenSigInactiveValue" SG_ 419 ADC_ABAReq 0;
BA_ "GenSigInvalidValue" SG_ 419 ADC_ABAReq 0;
BA_ "GenSigSendType" SG_ 419 ADC_ABAReq 1;
BA_ "GenSigStartValue" SG_ 419 ADC_ABAReq 0;
BA_ "GenSigTimeoutValue" SG_ 419 ADC_ABAReq 0;
BA_ "Remark" SG_ 419 ADC_ABAReq "";
BA_ "EventCommandSignal" SG_ 419 ADC_ABALevel 0;
BA_ "GatewayedSignals" SG_ 419 ADC_ABALevel 0;
BA_ "GenSigInactiveValue" SG_ 419 ADC_ABALevel 0;
BA_ "GenSigInvalidValue" SG_ 419 ADC_ABALevel 0;
BA_ "GenSigSendType" SG_ 419 ADC_ABALevel 1;
BA_ "GenSigStartValue" SG_ 419 ADC_ABALevel 0;
BA_ "GenSigTimeoutValue" SG_ 419 ADC_ABALevel 0;
BA_ "Remark" SG_ 419 ADC_ABALevel "";
BA_ "EventCommandSignal" SG_ 419 ADC_AWBReq 0;
BA_ "GatewayedSignals" SG_ 419 ADC_AWBReq 0;
BA_ "GenSigInactiveValue" SG_ 419 ADC_AWBReq 0;
BA_ "GenSigInvalidValue" SG_ 419 ADC_AWBReq 0;
BA_ "GenSigSendType" SG_ 419 ADC_AWBReq 1;
BA_ "GenSigStartValue" SG_ 419 ADC_AWBReq 0;
BA_ "GenSigTimeoutValue" SG_ 419 ADC_AWBReq 0;
BA_ "Remark" SG_ 419 ADC_AWBReq "";
BA_ "EventCommandSignal" SG_ 419 ADC_ABPReq 0;
BA_ "GatewayedSignals" SG_ 419 ADC_ABPReq 0;
BA_ "GenSigInactiveValue" SG_ 419 ADC_ABPReq 0;
BA_ "GenSigInvalidValue" SG_ 419 ADC_ABPReq 0;
BA_ "GenSigSendType" SG_ 419 ADC_ABPReq 1;
BA_ "GenSigStartValue" SG_ 419 ADC_ABPReq 0;
BA_ "GenSigTimeoutValue" SG_ 419 ADC_ABPReq 0;
BA_ "Remark" SG_ 419 ADC_ABPReq "";
BA_ "EventCommandSignal" SG_ 419 ADC_AWBLevel 0;
BA_ "GatewayedSignals" SG_ 419 ADC_AWBLevel 0;
BA_ "GenSigInactiveValue" SG_ 419 ADC_AWBLevel 0;
BA_ "GenSigInvalidValue" SG_ 419 ADC_AWBLevel 0;
BA_ "GenSigSendType" SG_ 419 ADC_AWBLevel 1;
BA_ "GenSigStartValue" SG_ 419 ADC_AWBLevel 0;
BA_ "GenSigTimeoutValue" SG_ 419 ADC_AWBLevel 0;
BA_ "Remark" SG_ 419 ADC_AWBLevel "";
BA_ "EventCommandSignal" SG_ 419 ADC_AEBTarCalss 0;
BA_ "GatewayedSignals" SG_ 419 ADC_AEBTarCalss 0;
BA_ "GenSigInactiveValue" SG_ 419 ADC_AEBTarCalss 0;
BA_ "GenSigInvalidValue" SG_ 419 ADC_AEBTarCalss 0;
BA_ "GenSigSendType" SG_ 419 ADC_AEBTarCalss 1;
BA_ "GenSigStartValue" SG_ 419 ADC_AEBTarCalss 0;
BA_ "GenSigTimeoutValue" SG_ 419 ADC_AEBTarCalss 0;
BA_ "Remark" SG_ 419 ADC_AEBTarCalss "";
BA_ "EventCommandSignal" SG_ 419 ADC_AEBTarDetSensor 0;
BA_ "GatewayedSignals" SG_ 419 ADC_AEBTarDetSensor 0;
BA_ "GenSigInactiveValue" SG_ 419 ADC_AEBTarDetSensor 0;
BA_ "GenSigInvalidValue" SG_ 419 ADC_AEBTarDetSensor 0;
BA_ "GenSigSendType" SG_ 419 ADC_AEBTarDetSensor 1;
BA_ "GenSigStartValue" SG_ 419 ADC_AEBTarDetSensor 0;
BA_ "GenSigTimeoutValue" SG_ 419 ADC_AEBTarDetSensor 0;
BA_ "Remark" SG_ 419 ADC_AEBTarDetSensor "";
BA_ "EventCommandSignal" SG_ 419 ADC_TurnLightReq 0;
BA_ "GatewayedSignals" SG_ 419 ADC_TurnLightReq 0;
BA_ "GenSigInactiveValue" SG_ 419 ADC_TurnLightReq 0;
BA_ "GenSigInvalidValue" SG_ 419 ADC_TurnLightReq 0;
BA_ "GenSigSendType" SG_ 419 ADC_TurnLightReq 1;
BA_ "GenSigStartValue" SG_ 419 ADC_TurnLightReq 0;
BA_ "GenSigTimeoutValue" SG_ 419 ADC_TurnLightReq 0;
BA_ "Remark" SG_ 419 ADC_TurnLightReq "";
BA_ "EventCommandSignal" SG_ 419 ADC_PAA2ESPAxReqEnable 0;
BA_ "GatewayedSignals" SG_ 419 ADC_PAA2ESPAxReqEnable 0;
BA_ "GenSigInactiveValue" SG_ 419 ADC_PAA2ESPAxReqEnable 0;
BA_ "GenSigInvalidValue" SG_ 419 ADC_PAA2ESPAxReqEnable 0;
BA_ "GenSigSendType" SG_ 419 ADC_PAA2ESPAxReqEnable 1;
BA_ "GenSigStartValue" SG_ 419 ADC_PAA2ESPAxReqEnable 0;
BA_ "GenSigTimeoutValue" SG_ 419 ADC_PAA2ESPAxReqEnable 0;
BA_ "Remark" SG_ 419 ADC_PAA2ESPAxReqEnable "";
BA_ "EventCommandSignal" SG_ 419 ADC_PAA2ESPBrakeFunctionMode 0;
BA_ "GatewayedSignals" SG_ 419 ADC_PAA2ESPBrakeFunctionMode 0;
BA_ "GenSigInactiveValue" SG_ 419 ADC_PAA2ESPBrakeFunctionMode 0;
BA_ "GenSigInvalidValue" SG_ 419 ADC_PAA2ESPBrakeFunctionMode 0;
BA_ "GenSigSendType" SG_ 419 ADC_PAA2ESPBrakeFunctionMode 1;
BA_ "GenSigStartValue" SG_ 419 ADC_PAA2ESPBrakeFunctionMode 0;
BA_ "GenSigTimeoutValue" SG_ 419 ADC_PAA2ESPBrakeFunctionMode 0;
BA_ "Remark" SG_ 419 ADC_PAA2ESPBrakeFunctionMode "";
BA_ "EventCommandSignal" SG_ 419 ADC_PAA2ESPEpbReq 0;
BA_ "GatewayedSignals" SG_ 419 ADC_PAA2ESPEpbReq 0;
BA_ "GenSigInactiveValue" SG_ 419 ADC_PAA2ESPEpbReq 0;
BA_ "GenSigInvalidValue" SG_ 419 ADC_PAA2ESPEpbReq 0;
BA_ "GenSigSendType" SG_ 419 ADC_PAA2ESPEpbReq 1;
BA_ "GenSigStartValue" SG_ 419 ADC_PAA2ESPEpbReq 0;
BA_ "GenSigTimeoutValue" SG_ 419 ADC_PAA2ESPEpbReq 0;
BA_ "Remark" SG_ 419 ADC_PAA2ESPEpbReq "";
BA_ "EventCommandSignal" SG_ 419 ADC_PAA2EPBEpbReq 0;
BA_ "GatewayedSignals" SG_ 419 ADC_PAA2EPBEpbReq 0;
BA_ "GenSigInactiveValue" SG_ 419 ADC_PAA2EPBEpbReq 0;
BA_ "GenSigInvalidValue" SG_ 419 ADC_PAA2EPBEpbReq 0;
BA_ "GenSigSendType" SG_ 419 ADC_PAA2EPBEpbReq 1;
BA_ "GenSigStartValue" SG_ 419 ADC_PAA2EPBEpbReq 0;
BA_ "GenSigTimeoutValue" SG_ 419 ADC_PAA2EPBEpbReq 0;
BA_ "Remark" SG_ 419 ADC_PAA2EPBEpbReq "";
BA_ "EventCommandSignal" SG_ 419 ADC_PAA2ESPEpbReqSt 0;
BA_ "GatewayedSignals" SG_ 419 ADC_PAA2ESPEpbReqSt 0;
BA_ "GenSigInactiveValue" SG_ 419 ADC_PAA2ESPEpbReqSt 0;
BA_ "GenSigInvalidValue" SG_ 419 ADC_PAA2ESPEpbReqSt 0;
BA_ "GenSigSendType" SG_ 419 ADC_PAA2ESPEpbReqSt 1;
BA_ "GenSigStartValue" SG_ 419 ADC_PAA2ESPEpbReqSt 0;
BA_ "GenSigTimeoutValue" SG_ 419 ADC_PAA2ESPEpbReqSt 0;
BA_ "Remark" SG_ 419 ADC_PAA2ESPEpbReqSt "";
BA_ "EventCommandSignal" SG_ 419 ADC_PAA2ESPComfBrakeReq 0;
BA_ "GatewayedSignals" SG_ 419 ADC_PAA2ESPComfBrakeReq 0;
BA_ "GenSigInactiveValue" SG_ 419 ADC_PAA2ESPComfBrakeReq 0;
BA_ "GenSigInvalidValue" SG_ 419 ADC_PAA2ESPComfBrakeReq 0;
BA_ "GenSigSendType" SG_ 419 ADC_PAA2ESPComfBrakeReq 1;
BA_ "GenSigStartValue" SG_ 419 ADC_PAA2ESPComfBrakeReq 0;
BA_ "GenSigTimeoutValue" SG_ 419 ADC_PAA2ESPComfBrakeReq 0;
BA_ "Remark" SG_ 419 ADC_PAA2ESPComfBrakeReq "";
BA_ "EventCommandSignal" SG_ 419 ADC_ESPSwitchReq 0;
BA_ "GatewayedSignals" SG_ 419 ADC_ESPSwitchReq 0;
BA_ "GenSigInactiveValue" SG_ 419 ADC_ESPSwitchReq 0;
BA_ "GenSigInvalidValue" SG_ 419 ADC_ESPSwitchReq 0;
BA_ "GenSigSendType" SG_ 419 ADC_ESPSwitchReq 1;
BA_ "GenSigStartValue" SG_ 419 ADC_ESPSwitchReq 0;
BA_ "GenSigTimeoutValue" SG_ 419 ADC_ESPSwitchReq 0;
BA_ "Remark" SG_ 419 ADC_ESPSwitchReq "";
BA_ "EventCommandSignal" SG_ 419 ADC_PAA2EPBEpbReqSt 0;
BA_ "GatewayedSignals" SG_ 419 ADC_PAA2EPBEpbReqSt 0;
BA_ "GenSigInactiveValue" SG_ 419 ADC_PAA2EPBEpbReqSt 0;
BA_ "GenSigInvalidValue" SG_ 419 ADC_PAA2EPBEpbReqSt 0;
BA_ "GenSigSendType" SG_ 419 ADC_PAA2EPBEpbReqSt 1;
BA_ "GenSigStartValue" SG_ 419 ADC_PAA2EPBEpbReqSt 0;
BA_ "GenSigTimeoutValue" SG_ 419 ADC_PAA2EPBEpbReqSt 0;
BA_ "Remark" SG_ 419 ADC_PAA2EPBEpbReqSt "";
BA_ "EventCommandSignal" SG_ 419 ADC_PAA2EPBBrakeFunctionMode 0;
BA_ "GatewayedSignals" SG_ 419 ADC_PAA2EPBBrakeFunctionMode 0;
BA_ "GenSigInactiveValue" SG_ 419 ADC_PAA2EPBBrakeFunctionMode 0;
BA_ "GenSigInvalidValue" SG_ 419 ADC_PAA2EPBBrakeFunctionMode 0;
BA_ "GenSigSendType" SG_ 419 ADC_PAA2EPBBrakeFunctionMode 1;
BA_ "GenSigStartValue" SG_ 419 ADC_PAA2EPBBrakeFunctionMode 0;
BA_ "GenSigTimeoutValue" SG_ 419 ADC_PAA2EPBBrakeFunctionMode 0;
BA_ "Remark" SG_ 419 ADC_PAA2EPBBrakeFunctionMode "";
BA_ "EventCommandSignal" SG_ 419 ADC_PAA2ESPApEmgyBrkReq 0;
BA_ "GatewayedSignals" SG_ 419 ADC_PAA2ESPApEmgyBrkReq 0;
BA_ "GenSigInactiveValue" SG_ 419 ADC_PAA2ESPApEmgyBrkReq 0;
BA_ "GenSigInvalidValue" SG_ 419 ADC_PAA2ESPApEmgyBrkReq 0;
BA_ "GenSigSendType" SG_ 419 ADC_PAA2ESPApEmgyBrkReq 1;
BA_ "GenSigStartValue" SG_ 419 ADC_PAA2ESPApEmgyBrkReq 0;
BA_ "GenSigTimeoutValue" SG_ 419 ADC_PAA2ESPApEmgyBrkReq 0;
BA_ "Remark" SG_ 419 ADC_PAA2ESPApEmgyBrkReq "";
BA_ "EventCommandSignal" SG_ 419 ADC_PAA2ESPApDriveOffReq 0;
BA_ "GatewayedSignals" SG_ 419 ADC_PAA2ESPApDriveOffReq 0;
BA_ "GenSigInactiveValue" SG_ 419 ADC_PAA2ESPApDriveOffReq 0;
BA_ "GenSigInvalidValue" SG_ 419 ADC_PAA2ESPApDriveOffReq 0;
BA_ "GenSigSendType" SG_ 419 ADC_PAA2ESPApDriveOffReq 1;
BA_ "GenSigStartValue" SG_ 419 ADC_PAA2ESPApDriveOffReq 0;
BA_ "GenSigTimeoutValue" SG_ 419 ADC_PAA2ESPApDriveOffReq 0;
BA_ "Remark" SG_ 419 ADC_PAA2ESPApDriveOffReq "";
BA_ "EventCommandSignal" SG_ 419 ADC_AEBObjectTTC 0;
BA_ "GatewayedSignals" SG_ 419 ADC_AEBObjectTTC 0;
BA_ "GenSigInactiveValue" SG_ 419 ADC_AEBObjectTTC 0;
BA_ "GenSigInvalidValue" SG_ 419 ADC_AEBObjectTTC 510;
BA_ "GenSigSendType" SG_ 419 ADC_AEBObjectTTC 1;
BA_ "GenSigStartValue" SG_ 419 ADC_AEBObjectTTC 501;
BA_ "GenSigTimeoutValue" SG_ 419 ADC_AEBObjectTTC 510;
BA_ "Remark" SG_ 419 ADC_AEBObjectTTC "";
BA_ "EventCommandSignal" SG_ 419 ADC_PAA2ESPApStandstillReq 0;
BA_ "GatewayedSignals" SG_ 419 ADC_PAA2ESPApStandstillReq 0;
BA_ "GenSigInactiveValue" SG_ 419 ADC_PAA2ESPApStandstillReq 0;
BA_ "GenSigInvalidValue" SG_ 419 ADC_PAA2ESPApStandstillReq 0;
BA_ "GenSigSendType" SG_ 419 ADC_PAA2ESPApStandstillReq 1;
BA_ "GenSigStartValue" SG_ 419 ADC_PAA2ESPApStandstillReq 0;
BA_ "GenSigTimeoutValue" SG_ 419 ADC_PAA2ESPApStandstillReq 0;
BA_ "Remark" SG_ 419 ADC_PAA2ESPApStandstillReq "";
BA_ "EventCommandSignal" SG_ 419 ADC_PAA2ESPApPrefillReq 0;
BA_ "GatewayedSignals" SG_ 419 ADC_PAA2ESPApPrefillReq 0;
BA_ "GenSigInactiveValue" SG_ 419 ADC_PAA2ESPApPrefillReq 0;
BA_ "GenSigInvalidValue" SG_ 419 ADC_PAA2ESPApPrefillReq 0;
BA_ "GenSigSendType" SG_ 419 ADC_PAA2ESPApPrefillReq 1;
BA_ "GenSigStartValue" SG_ 419 ADC_PAA2ESPApPrefillReq 0;
BA_ "GenSigTimeoutValue" SG_ 419 ADC_PAA2ESPApPrefillReq 0;
BA_ "Remark" SG_ 419 ADC_PAA2ESPApPrefillReq "";
BA_ "EventCommandSignal" SG_ 419 ADC_AEBObjRelativeSpd 0;
BA_ "GatewayedSignals" SG_ 419 ADC_AEBObjRelativeSpd 0;
BA_ "GenSigInactiveValue" SG_ 419 ADC_AEBObjRelativeSpd 0;
BA_ "GenSigInvalidValue" SG_ 419 ADC_AEBObjRelativeSpd 510;
BA_ "GenSigSendType" SG_ 419 ADC_AEBObjRelativeSpd 1;
BA_ "GenSigStartValue" SG_ 419 ADC_AEBObjRelativeSpd 0;
BA_ "GenSigTimeoutValue" SG_ 419 ADC_AEBObjRelativeSpd 510;
BA_ "Remark" SG_ 419 ADC_AEBObjRelativeSpd "";
BA_ "EventCommandSignal" SG_ 419 ADC_PAA2ESPAxReq 0;
BA_ "GatewayedSignals" SG_ 419 ADC_PAA2ESPAxReq 0;
BA_ "GenSigInactiveValue" SG_ 419 ADC_PAA2ESPAxReq 0;
BA_ "GenSigInvalidValue" SG_ 419 ADC_PAA2ESPAxReq 0;
BA_ "GenSigSendType" SG_ 419 ADC_PAA2ESPAxReq 1;
BA_ "GenSigStartValue" SG_ 419 ADC_PAA2ESPAxReq 0;
BA_ "GenSigTimeoutValue" SG_ 419 ADC_PAA2ESPAxReq 0;
BA_ "Remark" SG_ 419 ADC_PAA2ESPAxReq "";
BA_ "EventCommandSignal" SG_ 419 ADC_EPBReq 0;
BA_ "GatewayedSignals" SG_ 419 ADC_EPBReq 0;
BA_ "GenSigInactiveValue" SG_ 419 ADC_EPBReq 0;
BA_ "GenSigInvalidValue" SG_ 419 ADC_EPBReq 0;
BA_ "GenSigSendType" SG_ 419 ADC_EPBReq 1;
BA_ "GenSigStartValue" SG_ 419 ADC_EPBReq 0;
BA_ "GenSigTimeoutValue" SG_ 419 ADC_EPBReq 0;
BA_ "Remark" SG_ 419 ADC_EPBReq "";
BA_ "EventCommandSignal" SG_ 419 ADC_ActTrqReqVD 0;
BA_ "GatewayedSignals" SG_ 419 ADC_ActTrqReqVD 0;
BA_ "GenSigInactiveValue" SG_ 419 ADC_ActTrqReqVD 0;
BA_ "GenSigInvalidValue" SG_ 419 ADC_ActTrqReqVD 0;
BA_ "GenSigSendType" SG_ 419 ADC_ActTrqReqVD 1;
BA_ "GenSigStartValue" SG_ 419 ADC_ActTrqReqVD 0;
BA_ "GenSigTimeoutValue" SG_ 419 ADC_ActTrqReqVD 0;
BA_ "Remark" SG_ 419 ADC_ActTrqReqVD "";
BA_ "EventCommandSignal" SG_ 419 ADC_TarGearReqVld 0;
BA_ "GatewayedSignals" SG_ 419 ADC_TarGearReqVld 0;
BA_ "GenSigInactiveValue" SG_ 419 ADC_TarGearReqVld 0;
BA_ "GenSigInvalidValue" SG_ 419 ADC_TarGearReqVld 0;
BA_ "GenSigSendType" SG_ 419 ADC_TarGearReqVld 1;
BA_ "GenSigStartValue" SG_ 419 ADC_TarGearReqVld 0;
BA_ "GenSigTimeoutValue" SG_ 419 ADC_TarGearReqVld 0;
BA_ "Remark" SG_ 419 ADC_TarGearReqVld "";
BA_ "EventCommandSignal" SG_ 419 ADC_FctSts 0;
BA_ "GatewayedSignals" SG_ 419 ADC_FctSts 0;
BA_ "GenSigInactiveValue" SG_ 419 ADC_FctSts 0;
BA_ "GenSigInvalidValue" SG_ 419 ADC_FctSts 0;
BA_ "GenSigSendType" SG_ 419 ADC_FctSts 1;
BA_ "GenSigStartValue" SG_ 419 ADC_FctSts 0;
BA_ "GenSigTimeoutValue" SG_ 419 ADC_FctSts 0;
BA_ "Remark" SG_ 419 ADC_FctSts "";
BA_ "EventCommandSignal" SG_ 419 ADC_PAA2ESPDistoStop 0;
BA_ "GatewayedSignals" SG_ 419 ADC_PAA2ESPDistoStop 0;
BA_ "GenSigInactiveValue" SG_ 419 ADC_PAA2ESPDistoStop 0;
BA_ "GenSigInvalidValue" SG_ 419 ADC_PAA2ESPDistoStop 0;
BA_ "GenSigSendType" SG_ 419 ADC_PAA2ESPDistoStop 1;
BA_ "GenSigStartValue" SG_ 419 ADC_PAA2ESPDistoStop 0;
BA_ "GenSigTimeoutValue" SG_ 419 ADC_PAA2ESPDistoStop 0;
BA_ "Remark" SG_ 419 ADC_PAA2ESPDistoStop "";
BA_ "EventCommandSignal" SG_ 419 ADC_PAA2ESPTarTorquePTDriveoff 0;
BA_ "GatewayedSignals" SG_ 419 ADC_PAA2ESPTarTorquePTDriveoff 0;
BA_ "GenSigInactiveValue" SG_ 419 ADC_PAA2ESPTarTorquePTDriveoff 0;
BA_ "GenSigInvalidValue" SG_ 419 ADC_PAA2ESPTarTorquePTDriveoff 0;
BA_ "GenSigSendType" SG_ 419 ADC_PAA2ESPTarTorquePTDriveoff 1;
BA_ "GenSigStartValue" SG_ 419 ADC_PAA2ESPTarTorquePTDriveoff 0;
BA_ "GenSigTimeoutValue" SG_ 419 ADC_PAA2ESPTarTorquePTDriveoff 0;
BA_ "Remark" SG_ 419 ADC_PAA2ESPTarTorquePTDriveoff "";
BA_ "EventCommandSignal" SG_ 419 ADC_VehTorqLimit 0;
BA_ "GatewayedSignals" SG_ 419 ADC_VehTorqLimit 0;
BA_ "GenSigInactiveValue" SG_ 419 ADC_VehTorqLimit 0;
BA_ "GenSigInvalidValue" SG_ 419 ADC_VehTorqLimit 0;
BA_ "GenSigSendType" SG_ 419 ADC_VehTorqLimit 1;
BA_ "GenSigStartValue" SG_ 419 ADC_VehTorqLimit 0;
BA_ "GenSigTimeoutValue" SG_ 419 ADC_VehTorqLimit 0;
BA_ "Remark" SG_ 419 ADC_VehTorqLimit "";
BA_ "EventCommandSignal" SG_ 419 ADC_VehTorqReqValue 0;
BA_ "GatewayedSignals" SG_ 419 ADC_VehTorqReqValue 0;
BA_ "GenSigInactiveValue" SG_ 419 ADC_VehTorqReqValue 0;
BA_ "GenSigInvalidValue" SG_ 419 ADC_VehTorqReqValue 0;
BA_ "GenSigSendType" SG_ 419 ADC_VehTorqReqValue 1;
BA_ "GenSigStartValue" SG_ 419 ADC_VehTorqReqValue 0;
BA_ "GenSigTimeoutValue" SG_ 419 ADC_VehTorqReqValue 0;
BA_ "Remark" SG_ 419 ADC_VehTorqReqValue "";
BA_ "EventCommandSignal" SG_ 419 ADC_VehTorqLimitEnable 0;
BA_ "GatewayedSignals" SG_ 419 ADC_VehTorqLimitEnable 0;
BA_ "GenSigInactiveValue" SG_ 419 ADC_VehTorqLimitEnable 0;
BA_ "GenSigInvalidValue" SG_ 419 ADC_VehTorqLimitEnable 0;
BA_ "GenSigSendType" SG_ 419 ADC_VehTorqLimitEnable 1;
BA_ "GenSigStartValue" SG_ 419 ADC_VehTorqLimitEnable 0;
BA_ "GenSigTimeoutValue" SG_ 419 ADC_VehTorqLimitEnable 0;
BA_ "Remark" SG_ 419 ADC_VehTorqLimitEnable "";
BA_ "EventCommandSignal" SG_ 419 ADC_VehTorqReqEnable 0;
BA_ "GatewayedSignals" SG_ 419 ADC_VehTorqReqEnable 0;
BA_ "GenSigInactiveValue" SG_ 419 ADC_VehTorqReqEnable 0;
BA_ "GenSigInvalidValue" SG_ 419 ADC_VehTorqReqEnable 0;
BA_ "GenSigSendType" SG_ 419 ADC_VehTorqReqEnable 1;
BA_ "GenSigStartValue" SG_ 419 ADC_VehTorqReqEnable 0;
BA_ "GenSigTimeoutValue" SG_ 419 ADC_VehTorqReqEnable 0;
BA_ "Remark" SG_ 419 ADC_VehTorqReqEnable "";
BA_ "EventCommandSignal" SG_ 419 ADC_PAAPwrModeReq 0;
BA_ "GatewayedSignals" SG_ 419 ADC_PAAPwrModeReq 0;
BA_ "GenSigInactiveValue" SG_ 419 ADC_PAAPwrModeReq 0;
BA_ "GenSigInvalidValue" SG_ 419 ADC_PAAPwrModeReq 0;
BA_ "GenSigSendType" SG_ 419 ADC_PAAPwrModeReq 1;
BA_ "GenSigStartValue" SG_ 419 ADC_PAAPwrModeReq 0;
BA_ "GenSigTimeoutValue" SG_ 419 ADC_PAAPwrModeReq 0;
BA_ "Remark" SG_ 419 ADC_PAAPwrModeReq "";
BA_ "EventCommandSignal" SG_ 419 ADC_PAAGrarLvlReq 0;
BA_ "GatewayedSignals" SG_ 419 ADC_PAAGrarLvlReq 0;
BA_ "GenSigInactiveValue" SG_ 419 ADC_PAAGrarLvlReq 0;
BA_ "GenSigInvalidValue" SG_ 419 ADC_PAAGrarLvlReq 0;
BA_ "GenSigSendType" SG_ 419 ADC_PAAGrarLvlReq 1;
BA_ "GenSigStartValue" SG_ 419 ADC_PAAGrarLvlReq 0;
BA_ "GenSigTimeoutValue" SG_ 419 ADC_PAAGrarLvlReq 0;
BA_ "Remark" SG_ 419 ADC_PAAGrarLvlReq "";
BA_ "EventCommandSignal" SG_ 419 ADC_PAAGrarLvlReqEnable 0;
BA_ "GatewayedSignals" SG_ 419 ADC_PAAGrarLvlReqEnable 0;
BA_ "GenSigInactiveValue" SG_ 419 ADC_PAAGrarLvlReqEnable 0;
BA_ "GenSigInvalidValue" SG_ 419 ADC_PAAGrarLvlReqEnable 0;
BA_ "GenSigSendType" SG_ 419 ADC_PAAGrarLvlReqEnable 1;
BA_ "GenSigStartValue" SG_ 419 ADC_PAAGrarLvlReqEnable 0;
BA_ "GenSigTimeoutValue" SG_ 419 ADC_PAAGrarLvlReqEnable 0;
BA_ "Remark" SG_ 419 ADC_PAAGrarLvlReqEnable "";
BA_ "EventCommandSignal" SG_ 419 ADC_ACCMode_C 0;
BA_ "GatewayedSignals" SG_ 419 ADC_ACCMode_C 0;
BA_ "GenSigInactiveValue" SG_ 419 ADC_ACCMode_C 0;
BA_ "GenSigInvalidValue" SG_ 419 ADC_ACCMode_C 0;
BA_ "GenSigSendType" SG_ 419 ADC_ACCMode_C 1;
BA_ "GenSigStartValue" SG_ 419 ADC_ACCMode_C 1;
BA_ "GenSigTimeoutValue" SG_ 419 ADC_ACCMode_C 0;
BA_ "Remark" SG_ 419 ADC_ACCMode_C "";
BA_ "EventCommandSignal" SG_ 419 ADC_RCTBTargetDecel 0;
BA_ "GatewayedSignals" SG_ 419 ADC_RCTBTargetDecel 0;
BA_ "GenSigInactiveValue" SG_ 419 ADC_RCTBTargetDecel 0;
BA_ "GenSigInvalidValue" SG_ 419 ADC_RCTBTargetDecel 0;
BA_ "GenSigSendType" SG_ 419 ADC_RCTBTargetDecel 1;
BA_ "GenSigStartValue" SG_ 419 ADC_RCTBTargetDecel 0;
BA_ "GenSigTimeoutValue" SG_ 419 ADC_RCTBTargetDecel 0;
BA_ "Remark" SG_ 419 ADC_RCTBTargetDecel "";
BA_ "EventCommandSignal" SG_ 419 ADC_RCTBBrkReq 0;
BA_ "GatewayedSignals" SG_ 419 ADC_RCTBBrkReq 0;
BA_ "GenSigInactiveValue" SG_ 419 ADC_RCTBBrkReq 0;
BA_ "GenSigInvalidValue" SG_ 419 ADC_RCTBBrkReq 0;
BA_ "GenSigSendType" SG_ 419 ADC_RCTBBrkReq 1;
BA_ "GenSigStartValue" SG_ 419 ADC_RCTBBrkReq 0;
BA_ "GenSigTimeoutValue" SG_ 419 ADC_RCTBBrkReq 0;
BA_ "Remark" SG_ 419 ADC_RCTBBrkReq "";
BA_ "EventCommandSignal" SG_ 419 ADC_BrkTarTqEna 0;
BA_ "GatewayedSignals" SG_ 419 ADC_BrkTarTqEna 0;
BA_ "GenSigInactiveValue" SG_ 419 ADC_BrkTarTqEna 0;
BA_ "GenSigInvalidValue" SG_ 419 ADC_BrkTarTqEna 0;
BA_ "GenSigSendType" SG_ 419 ADC_BrkTarTqEna 1;
BA_ "GenSigStartValue" SG_ 419 ADC_BrkTarTqEna 0;
BA_ "GenSigTimeoutValue" SG_ 419 ADC_BrkTarTqEna 0;
BA_ "Remark" SG_ 419 ADC_BrkTarTqEna "";
BA_ "EventCommandSignal" SG_ 419 ADC_BrkTarTqMod 0;
BA_ "GatewayedSignals" SG_ 419 ADC_BrkTarTqMod 0;
BA_ "GenSigInactiveValue" SG_ 419 ADC_BrkTarTqMod 0;
BA_ "GenSigInvalidValue" SG_ 419 ADC_BrkTarTqMod 0;
BA_ "GenSigSendType" SG_ 419 ADC_BrkTarTqMod 1;
BA_ "GenSigStartValue" SG_ 419 ADC_BrkTarTqMod 0;
BA_ "GenSigTimeoutValue" SG_ 419 ADC_BrkTarTqMod 0;
BA_ "Remark" SG_ 419 ADC_BrkTarTqMod "";
BA_ "EventCommandSignal" SG_ 419 ADC_AebBrkTarTq 0;
BA_ "GatewayedSignals" SG_ 419 ADC_AebBrkTarTq 0;
BA_ "GenSigInactiveValue" SG_ 419 ADC_AebBrkTarTq 0;
BA_ "GenSigInvalidValue" SG_ 419 ADC_AebBrkTarTq 0;
BA_ "GenSigSendType" SG_ 419 ADC_AebBrkTarTq 1;
BA_ "GenSigStartValue" SG_ 419 ADC_AebBrkTarTq 0;
BA_ "GenSigTimeoutValue" SG_ 419 ADC_AebBrkTarTq 0;
BA_ "Remark" SG_ 419 ADC_AebBrkTarTq "";
BA_ "EventCommandSignal" SG_ 419 ADC_EpbModReqVld 0;
BA_ "GatewayedSignals" SG_ 419 ADC_EpbModReqVld 0;
BA_ "GenSigInactiveValue" SG_ 419 ADC_EpbModReqVld 0;
BA_ "GenSigInvalidValue" SG_ 419 ADC_EpbModReqVld 0;
BA_ "GenSigSendType" SG_ 419 ADC_EpbModReqVld 1;
BA_ "GenSigStartValue" SG_ 419 ADC_EpbModReqVld 0;
BA_ "GenSigTimeoutValue" SG_ 419 ADC_EpbModReqVld 0;
BA_ "Remark" SG_ 419 ADC_EpbModReqVld "";
BA_ "EventCommandSignal" SG_ 419 ADC_RWUEna 0;
BA_ "GatewayedSignals" SG_ 419 ADC_RWUEna 0;
BA_ "GenSigInactiveValue" SG_ 419 ADC_RWUEna 0;
BA_ "GenSigInvalidValue" SG_ 419 ADC_RWUEna 0;
BA_ "GenSigSendType" SG_ 419 ADC_RWUEna 1;
BA_ "GenSigStartValue" SG_ 419 ADC_RWUEna 0;
BA_ "GenSigTimeoutValue" SG_ 419 ADC_RWUEna 0;
BA_ "Remark" SG_ 419 ADC_RWUEna "";
BA_ "EventCommandSignal" SG_ 419 ADC_BrkHoldReq 0;
BA_ "GatewayedSignals" SG_ 419 ADC_BrkHoldReq 0;
BA_ "GenSigInactiveValue" SG_ 419 ADC_BrkHoldReq 0;
BA_ "GenSigInvalidValue" SG_ 419 ADC_BrkHoldReq 0;
BA_ "GenSigSendType" SG_ 419 ADC_BrkHoldReq 1;
BA_ "GenSigStartValue" SG_ 419 ADC_BrkHoldReq 0;
BA_ "GenSigTimeoutValue" SG_ 419 ADC_BrkHoldReq 0;
BA_ "Remark" SG_ 419 ADC_BrkHoldReq "";
BA_ "EventCommandSignal" SG_ 419 ADC_AngReqAvl 0;
BA_ "GatewayedSignals" SG_ 419 ADC_AngReqAvl 0;
BA_ "GenSigInactiveValue" SG_ 419 ADC_AngReqAvl 0;
BA_ "GenSigInvalidValue" SG_ 419 ADC_AngReqAvl 0;
BA_ "GenSigSendType" SG_ 419 ADC_AngReqAvl 1;
BA_ "GenSigStartValue" SG_ 419 ADC_AngReqAvl 0;
BA_ "GenSigTimeoutValue" SG_ 419 ADC_AngReqAvl 0;
BA_ "Remark" SG_ 419 ADC_AngReqAvl "";
BA_ "EventCommandSignal" SG_ 419 ADC_BrkTarTqVld 0;
BA_ "GatewayedSignals" SG_ 419 ADC_BrkTarTqVld 0;
BA_ "GenSigInactiveValue" SG_ 419 ADC_BrkTarTqVld 0;
BA_ "GenSigInvalidValue" SG_ 419 ADC_BrkTarTqVld 0;
BA_ "GenSigSendType" SG_ 419 ADC_BrkTarTqVld 1;
BA_ "GenSigStartValue" SG_ 419 ADC_BrkTarTqVld 0;
BA_ "GenSigTimeoutValue" SG_ 419 ADC_BrkTarTqVld 0;
BA_ "Remark" SG_ 419 ADC_BrkTarTqVld "";
BA_ "EventCommandSignal" SG_ 419 ADC_AebBrkTarTqVld 0;
BA_ "GatewayedSignals" SG_ 419 ADC_AebBrkTarTqVld 0;
BA_ "GenSigInactiveValue" SG_ 419 ADC_AebBrkTarTqVld 0;
BA_ "GenSigInvalidValue" SG_ 419 ADC_AebBrkTarTqVld 0;
BA_ "GenSigSendType" SG_ 419 ADC_AebBrkTarTqVld 1;
BA_ "GenSigStartValue" SG_ 419 ADC_AebBrkTarTqVld 0;
BA_ "GenSigTimeoutValue" SG_ 419 ADC_AebBrkTarTqVld 0;
BA_ "Remark" SG_ 419 ADC_AebBrkTarTqVld "";
BA_ "EventCommandSignal" SG_ 419 ADC_AebBrkTarTqEna 0;
BA_ "GatewayedSignals" SG_ 419 ADC_AebBrkTarTqEna 0;
BA_ "GenSigInactiveValue" SG_ 419 ADC_AebBrkTarTqEna 0;
BA_ "GenSigInvalidValue" SG_ 419 ADC_AebBrkTarTqEna 0;
BA_ "GenSigSendType" SG_ 419 ADC_AebBrkTarTqEna 1;
BA_ "GenSigStartValue" SG_ 419 ADC_AebBrkTarTqEna 0;
BA_ "GenSigTimeoutValue" SG_ 419 ADC_AebBrkTarTqEna 0;
BA_ "Remark" SG_ 419 ADC_AebBrkTarTqEna "";
BA_ "EventCommandSignal" SG_ 419 ADC_ElecBrkFnSwitch 0;
BA_ "GatewayedSignals" SG_ 419 ADC_ElecBrkFnSwitch 0;
BA_ "GenSigInactiveValue" SG_ 419 ADC_ElecBrkFnSwitch 0;
BA_ "GenSigInvalidValue" SG_ 419 ADC_ElecBrkFnSwitch 0;
BA_ "GenSigSendType" SG_ 419 ADC_ElecBrkFnSwitch 1;
BA_ "GenSigStartValue" SG_ 419 ADC_ElecBrkFnSwitch 0;
BA_ "GenSigTimeoutValue" SG_ 419 ADC_ElecBrkFnSwitch 0;
BA_ "Remark" SG_ 419 ADC_ElecBrkFnSwitch "";
BA_ "EventCommandSignal" SG_ 419 ADC_RWUVld 0;
BA_ "GatewayedSignals" SG_ 419 ADC_RWUVld 0;
BA_ "GenSigInactiveValue" SG_ 419 ADC_RWUVld 0;
BA_ "GenSigInvalidValue" SG_ 419 ADC_RWUVld 0;
BA_ "GenSigSendType" SG_ 419 ADC_RWUVld 1;
BA_ "GenSigStartValue" SG_ 419 ADC_RWUVld 0;
BA_ "GenSigTimeoutValue" SG_ 419 ADC_RWUVld 0;
BA_ "Remark" SG_ 419 ADC_RWUVld "";
BA_ "EventCommandSignal" SG_ 419 ADC_DriverPresent 0;
BA_ "GatewayedSignals" SG_ 419 ADC_DriverPresent 0;
BA_ "GenSigInactiveValue" SG_ 419 ADC_DriverPresent 0;
BA_ "GenSigInvalidValue" SG_ 419 ADC_DriverPresent 0;
BA_ "GenSigSendType" SG_ 419 ADC_DriverPresent 1;
BA_ "GenSigStartValue" SG_ 419 ADC_DriverPresent 0;
BA_ "GenSigTimeoutValue" SG_ 419 ADC_DriverPresent 0;
BA_ "Remark" SG_ 419 ADC_DriverPresent "";
BA_ "EventCommandSignal" SG_ 419 ADC_BrkTarTq 0;
BA_ "GatewayedSignals" SG_ 419 ADC_BrkTarTq 0;
BA_ "GenSigInactiveValue" SG_ 419 ADC_BrkTarTq 0;
BA_ "GenSigInvalidValue" SG_ 419 ADC_BrkTarTq 0;
BA_ "GenSigSendType" SG_ 419 ADC_BrkTarTq 1;
BA_ "GenSigStartValue" SG_ 419 ADC_BrkTarTq 0;
BA_ "GenSigTimeoutValue" SG_ 419 ADC_BrkTarTq 0;
BA_ "Remark" SG_ 419 ADC_BrkTarTq "";
BA_ "EventCommandSignal" SG_ 419 ADC_4_FreshnessValue 0;
BA_ "GatewayedSignals" SG_ 419 ADC_4_FreshnessValue 0;
BA_ "GenSigInactiveValue" SG_ 419 ADC_4_FreshnessValue 0;
BA_ "GenSigInvalidValue" SG_ 419 ADC_4_FreshnessValue 0;
BA_ "GenSigSendType" SG_ 419 ADC_4_FreshnessValue 1;
BA_ "GenSigStartValue" SG_ 419 ADC_4_FreshnessValue 0;
BA_ "GenSigTimeoutValue" SG_ 419 ADC_4_FreshnessValue 0;
BA_ "Remark" SG_ 419 ADC_4_FreshnessValue "";
BA_ "EventCommandSignal" SG_ 419 ADC_4_MAC_Check 0;
BA_ "GatewayedSignals" SG_ 419 ADC_4_MAC_Check 0;
BA_ "GenSigInactiveValue" SG_ 419 ADC_4_MAC_Check 0;
BA_ "GenSigInvalidValue" SG_ 419 ADC_4_MAC_Check 0;
BA_ "GenSigSendType" SG_ 419 ADC_4_MAC_Check 1;
BA_ "GenSigStartValue" SG_ 419 ADC_4_MAC_Check 0;
BA_ "GenSigTimeoutValue" SG_ 419 ADC_4_MAC_Check 0;
BA_ "Remark" SG_ 419 ADC_4_MAC_Check "";
BA_ "EventCommandSignal" SG_ 659 ADC_5_CRC 0;
BA_ "GatewayedSignals" SG_ 659 ADC_5_CRC 0;
BA_ "GenSigInactiveValue" SG_ 659 ADC_5_CRC 0;
BA_ "GenSigInvalidValue" SG_ 659 ADC_5_CRC 0;
BA_ "GenSigSendType" SG_ 659 ADC_5_CRC 1;
BA_ "GenSigStartValue" SG_ 659 ADC_5_CRC 0;
BA_ "GenSigTimeoutValue" SG_ 659 ADC_5_CRC 0;
BA_ "Remark" SG_ 659 ADC_5_CRC "";
BA_ "EventCommandSignal" SG_ 659 ADC_5_Counter 0;
BA_ "GatewayedSignals" SG_ 659 ADC_5_Counter 0;
BA_ "GenSigInactiveValue" SG_ 659 ADC_5_Counter 0;
BA_ "GenSigInvalidValue" SG_ 659 ADC_5_Counter 0;
BA_ "GenSigSendType" SG_ 659 ADC_5_Counter 1;
BA_ "GenSigStartValue" SG_ 659 ADC_5_Counter 0;
BA_ "GenSigTimeoutValue" SG_ 659 ADC_5_Counter 0;
BA_ "Remark" SG_ 659 ADC_5_Counter "";
BA_ "EventCommandSignal" SG_ 659 ADC_NDASt 0;
BA_ "GatewayedSignals" SG_ 659 ADC_NDASt 0;
BA_ "GenSigInactiveValue" SG_ 659 ADC_NDASt 0;
BA_ "GenSigInvalidValue" SG_ 659 ADC_NDASt 0;
BA_ "GenSigSendType" SG_ 659 ADC_NDASt 1;
BA_ "GenSigStartValue" SG_ 659 ADC_NDASt 0;
BA_ "GenSigTimeoutValue" SG_ 659 ADC_NDASt 0;
BA_ "Remark" SG_ 659 ADC_NDASt "";
BA_ "EventCommandSignal" SG_ 659 ADC_NDATORType 0;
BA_ "GatewayedSignals" SG_ 659 ADC_NDATORType 0;
BA_ "GenSigInactiveValue" SG_ 659 ADC_NDATORType 0;
BA_ "GenSigInvalidValue" SG_ 659 ADC_NDATORType 0;
BA_ "GenSigSendType" SG_ 659 ADC_NDATORType 1;
BA_ "GenSigStartValue" SG_ 659 ADC_NDATORType 0;
BA_ "GenSigTimeoutValue" SG_ 659 ADC_NDATORType 0;
BA_ "Remark" SG_ 659 ADC_NDATORType "";
BA_ "EventCommandSignal" SG_ 659 ADC_NDADecideResult 0;
BA_ "GatewayedSignals" SG_ 659 ADC_NDADecideResult 0;
BA_ "GenSigInactiveValue" SG_ 659 ADC_NDADecideResult 0;
BA_ "GenSigInvalidValue" SG_ 659 ADC_NDADecideResult 0;
BA_ "GenSigSendType" SG_ 659 ADC_NDADecideResult 1;
BA_ "GenSigStartValue" SG_ 659 ADC_NDADecideResult 0;
BA_ "GenSigTimeoutValue" SG_ 659 ADC_NDADecideResult 0;
BA_ "Remark" SG_ 659 ADC_NDADecideResult "";
BA_ "EventCommandSignal" SG_ 659 ADC_NDATargetLane 0;
BA_ "GatewayedSignals" SG_ 659 ADC_NDATargetLane 0;
BA_ "GenSigInactiveValue" SG_ 659 ADC_NDATargetLane 0;
BA_ "GenSigInvalidValue" SG_ 659 ADC_NDATargetLane 0;
BA_ "GenSigSendType" SG_ 659 ADC_NDATargetLane 1;
BA_ "GenSigStartValue" SG_ 659 ADC_NDATargetLane 0;
BA_ "GenSigTimeoutValue" SG_ 659 ADC_NDATargetLane 0;
BA_ "Remark" SG_ 659 ADC_NDATargetLane "";
BA_ "EventCommandSignal" SG_ 659 ADC_NDASplitSt 0;
BA_ "GatewayedSignals" SG_ 659 ADC_NDASplitSt 0;
BA_ "GenSigInactiveValue" SG_ 659 ADC_NDASplitSt 0;
BA_ "GenSigInvalidValue" SG_ 659 ADC_NDASplitSt 0;
BA_ "GenSigSendType" SG_ 659 ADC_NDASplitSt 1;
BA_ "GenSigStartValue" SG_ 659 ADC_NDASplitSt 0;
BA_ "GenSigTimeoutValue" SG_ 659 ADC_NDASplitSt 0;
BA_ "Remark" SG_ 659 ADC_NDASplitSt "";
BA_ "EventCommandSignal" SG_ 659 ADC_NDALaneChangeOverlineTOR 0;
BA_ "GatewayedSignals" SG_ 659 ADC_NDALaneChangeOverlineTOR 0;
BA_ "GenSigInactiveValue" SG_ 659 ADC_NDALaneChangeOverlineTOR 0;
BA_ "GenSigInvalidValue" SG_ 659 ADC_NDALaneChangeOverlineTOR 0;
BA_ "GenSigSendType" SG_ 659 ADC_NDALaneChangeOverlineTOR 1;
BA_ "GenSigStartValue" SG_ 659 ADC_NDALaneChangeOverlineTOR 0;
BA_ "GenSigTimeoutValue" SG_ 659 ADC_NDALaneChangeOverlineTOR 0;
BA_ "Remark" SG_ 659 ADC_NDALaneChangeOverlineTOR "";
BA_ "EventCommandSignal" SG_ 659 ADC_ALCSuspendReason 0;
BA_ "GatewayedSignals" SG_ 659 ADC_ALCSuspendReason 0;
BA_ "GenSigInactiveValue" SG_ 659 ADC_ALCSuspendReason 0;
BA_ "GenSigInvalidValue" SG_ 659 ADC_ALCSuspendReason 0;
BA_ "GenSigSendType" SG_ 659 ADC_ALCSuspendReason 1;
BA_ "GenSigStartValue" SG_ 659 ADC_ALCSuspendReason 0;
BA_ "GenSigTimeoutValue" SG_ 659 ADC_ALCSuspendReason 0;
BA_ "Remark" SG_ 659 ADC_ALCSuspendReason "";
BA_ "EventCommandSignal" SG_ 659 ADC_SplitSuspendReason 0;
BA_ "GatewayedSignals" SG_ 659 ADC_SplitSuspendReason 0;
BA_ "GenSigInactiveValue" SG_ 659 ADC_SplitSuspendReason 0;
BA_ "GenSigInvalidValue" SG_ 659 ADC_SplitSuspendReason 0;
BA_ "GenSigSendType" SG_ 659 ADC_SplitSuspendReason 1;
BA_ "GenSigStartValue" SG_ 659 ADC_SplitSuspendReason 0;
BA_ "GenSigTimeoutValue" SG_ 659 ADC_SplitSuspendReason 0;
BA_ "Remark" SG_ 659 ADC_SplitSuspendReason "";
BA_ "EventCommandSignal" SG_ 659 ADC_NDAEnableSt 0;
BA_ "GatewayedSignals" SG_ 659 ADC_NDAEnableSt 0;
BA_ "GenSigInactiveValue" SG_ 659 ADC_NDAEnableSt 0;
BA_ "GenSigInvalidValue" SG_ 659 ADC_NDAEnableSt 0;
BA_ "GenSigSendType" SG_ 659 ADC_NDAEnableSt 1;
BA_ "GenSigStartValue" SG_ 659 ADC_NDAEnableSt 0;
BA_ "GenSigTimeoutValue" SG_ 659 ADC_NDAEnableSt 0;
BA_ "Remark" SG_ 659 ADC_NDAEnableSt "";
BA_ "EventCommandSignal" SG_ 659 ADC_NDAFailureReason 0;
BA_ "GatewayedSignals" SG_ 659 ADC_NDAFailureReason 0;
BA_ "GenSigInactiveValue" SG_ 659 ADC_NDAFailureReason 0;
BA_ "GenSigInvalidValue" SG_ 659 ADC_NDAFailureReason 0;
BA_ "GenSigSendType" SG_ 659 ADC_NDAFailureReason 1;
BA_ "GenSigStartValue" SG_ 659 ADC_NDAFailureReason 0;
BA_ "GenSigTimeoutValue" SG_ 659 ADC_NDAFailureReason 0;
BA_ "Remark" SG_ 659 ADC_NDAFailureReason "";
BA_ "EventCommandSignal" SG_ 659 ADC_NDANotactivereason 0;
BA_ "GatewayedSignals" SG_ 659 ADC_NDANotactivereason 0;
BA_ "GenSigInactiveValue" SG_ 659 ADC_NDANotactivereason 0;
BA_ "GenSigInvalidValue" SG_ 659 ADC_NDANotactivereason 0;
BA_ "GenSigSendType" SG_ 659 ADC_NDANotactivereason 1;
BA_ "GenSigStartValue" SG_ 659 ADC_NDANotactivereason 0;
BA_ "GenSigTimeoutValue" SG_ 659 ADC_NDANotactivereason 0;
BA_ "Remark" SG_ 659 ADC_NDANotactivereason "";
BA_ "EventCommandSignal" SG_ 659 ADC_NDAGeoFence 0;
BA_ "GatewayedSignals" SG_ 659 ADC_NDAGeoFence 0;
BA_ "GenSigInactiveValue" SG_ 659 ADC_NDAGeoFence 0;
BA_ "GenSigInvalidValue" SG_ 659 ADC_NDAGeoFence 0;
BA_ "GenSigSendType" SG_ 659 ADC_NDAGeoFence 1;
BA_ "GenSigStartValue" SG_ 659 ADC_NDAGeoFence 0;
BA_ "GenSigTimeoutValue" SG_ 659 ADC_NDAGeoFence 0;
BA_ "Remark" SG_ 659 ADC_NDAGeoFence "";
BA_ "EventCommandSignal" SG_ 659 ADC_NDAODDnotMeetreason 0;
BA_ "GatewayedSignals" SG_ 659 ADC_NDAODDnotMeetreason 0;
BA_ "GenSigInactiveValue" SG_ 659 ADC_NDAODDnotMeetreason 0;
BA_ "GenSigInvalidValue" SG_ 659 ADC_NDAODDnotMeetreason 0;
BA_ "GenSigSendType" SG_ 659 ADC_NDAODDnotMeetreason 1;
BA_ "GenSigStartValue" SG_ 659 ADC_NDAODDnotMeetreason 0;
BA_ "GenSigTimeoutValue" SG_ 659 ADC_NDAODDnotMeetreason 0;
BA_ "Remark" SG_ 659 ADC_NDAODDnotMeetreason "";
BA_ "EventCommandSignal" SG_ 659 ADC_RaebWarning 0;
BA_ "GatewayedSignals" SG_ 659 ADC_RaebWarning 0;
BA_ "GenSigInactiveValue" SG_ 659 ADC_RaebWarning 0;
BA_ "GenSigInvalidValue" SG_ 659 ADC_RaebWarning 0;
BA_ "GenSigSendType" SG_ 659 ADC_RaebWarning 1;
BA_ "GenSigStartValue" SG_ 659 ADC_RaebWarning 0;
BA_ "GenSigTimeoutValue" SG_ 659 ADC_RaebWarning 0;
BA_ "Remark" SG_ 659 ADC_RaebWarning "";
BA_ "EventCommandSignal" SG_ 659 ADC_ICAAvailableState 0;
BA_ "GatewayedSignals" SG_ 659 ADC_ICAAvailableState 0;
BA_ "GenSigInactiveValue" SG_ 659 ADC_ICAAvailableState 0;
BA_ "GenSigInvalidValue" SG_ 659 ADC_ICAAvailableState 0;
BA_ "GenSigSendType" SG_ 659 ADC_ICAAvailableState 1;
BA_ "GenSigStartValue" SG_ 659 ADC_ICAAvailableState 0;
BA_ "GenSigTimeoutValue" SG_ 659 ADC_ICAAvailableState 0;
BA_ "Remark" SG_ 659 ADC_ICAAvailableState "";
BA_ "EventCommandSignal" SG_ 659 ADC_ACCAvailableState 0;
BA_ "GatewayedSignals" SG_ 659 ADC_ACCAvailableState 0;
BA_ "GenSigInactiveValue" SG_ 659 ADC_ACCAvailableState 0;
BA_ "GenSigInvalidValue" SG_ 659 ADC_ACCAvailableState 0;
BA_ "GenSigSendType" SG_ 659 ADC_ACCAvailableState 1;
BA_ "GenSigStartValue" SG_ 659 ADC_ACCAvailableState 0;
BA_ "GenSigTimeoutValue" SG_ 659 ADC_ACCAvailableState 0;
BA_ "Remark" SG_ 659 ADC_ACCAvailableState "";
BA_ "EventCommandSignal" SG_ 659 ADC_NDARouteReplanning 0;
BA_ "GatewayedSignals" SG_ 659 ADC_NDARouteReplanning 0;
BA_ "GenSigInactiveValue" SG_ 659 ADC_NDARouteReplanning 0;
BA_ "GenSigInvalidValue" SG_ 659 ADC_NDARouteReplanning 0;
BA_ "GenSigSendType" SG_ 659 ADC_NDARouteReplanning 1;
BA_ "GenSigStartValue" SG_ 659 ADC_NDARouteReplanning 0;
BA_ "GenSigTimeoutValue" SG_ 659 ADC_NDARouteReplanning 0;
BA_ "Remark" SG_ 659 ADC_NDARouteReplanning "";
BA_ "EventCommandSignal" SG_ 659 ADC_SpeedLimitConfirmRequest 0;
BA_ "GatewayedSignals" SG_ 659 ADC_SpeedLimitConfirmRequest 0;
BA_ "GenSigInactiveValue" SG_ 659 ADC_SpeedLimitConfirmRequest 0;
BA_ "GenSigInvalidValue" SG_ 659 ADC_SpeedLimitConfirmRequest 0;
BA_ "GenSigSendType" SG_ 659 ADC_SpeedLimitConfirmRequest 1;
BA_ "GenSigStartValue" SG_ 659 ADC_SpeedLimitConfirmRequest 0;
BA_ "GenSigTimeoutValue" SG_ 659 ADC_SpeedLimitConfirmRequest 0;
BA_ "Remark" SG_ 659 ADC_SpeedLimitConfirmRequest "";
BA_ "EventCommandSignal" SG_ 659 ADC_LaneChangeType 0;
BA_ "GatewayedSignals" SG_ 659 ADC_LaneChangeType 0;
BA_ "GenSigInactiveValue" SG_ 659 ADC_LaneChangeType 0;
BA_ "GenSigInvalidValue" SG_ 659 ADC_LaneChangeType 0;
BA_ "GenSigSendType" SG_ 659 ADC_LaneChangeType 1;
BA_ "GenSigStartValue" SG_ 659 ADC_LaneChangeType 0;
BA_ "GenSigTimeoutValue" SG_ 659 ADC_LaneChangeType 0;
BA_ "Remark" SG_ 659 ADC_LaneChangeType "";
BA_ "EventCommandSignal" SG_ 659 ADC_LC_ZoneMatching 0;
BA_ "GatewayedSignals" SG_ 659 ADC_LC_ZoneMatching 0;
BA_ "GenSigInactiveValue" SG_ 659 ADC_LC_ZoneMatching 0;
BA_ "GenSigInvalidValue" SG_ 659 ADC_LC_ZoneMatching 0;
BA_ "GenSigSendType" SG_ 659 ADC_LC_ZoneMatching 1;
BA_ "GenSigStartValue" SG_ 659 ADC_LC_ZoneMatching 0;
BA_ "GenSigTimeoutValue" SG_ 659 ADC_LC_ZoneMatching 0;
BA_ "Remark" SG_ 659 ADC_LC_ZoneMatching "";
BA_ "EventCommandSignal" SG_ 659 ADC_RoadMergeSplitType 0;
BA_ "GatewayedSignals" SG_ 659 ADC_RoadMergeSplitType 0;
BA_ "GenSigInactiveValue" SG_ 659 ADC_RoadMergeSplitType 0;
BA_ "GenSigInvalidValue" SG_ 659 ADC_RoadMergeSplitType 0;
BA_ "GenSigSendType" SG_ 659 ADC_RoadMergeSplitType 1;
BA_ "GenSigStartValue" SG_ 659 ADC_RoadMergeSplitType 0;
BA_ "GenSigTimeoutValue" SG_ 659 ADC_RoadMergeSplitType 0;
BA_ "Remark" SG_ 659 ADC_RoadMergeSplitType "";
BA_ "EventCommandSignal" SG_ 659 ADC_LaneMergeSplitType 0;
BA_ "GatewayedSignals" SG_ 659 ADC_LaneMergeSplitType 0;
BA_ "GenSigInactiveValue" SG_ 659 ADC_LaneMergeSplitType 0;
BA_ "GenSigInvalidValue" SG_ 659 ADC_LaneMergeSplitType 0;
BA_ "GenSigSendType" SG_ 659 ADC_LaneMergeSplitType 1;
BA_ "GenSigStartValue" SG_ 659 ADC_LaneMergeSplitType 0;
BA_ "GenSigTimeoutValue" SG_ 659 ADC_LaneMergeSplitType 0;
BA_ "Remark" SG_ 659 ADC_LaneMergeSplitType "";
BA_ "EventCommandSignal" SG_ 659 ADC_EyesOn_Warning 0;
BA_ "GatewayedSignals" SG_ 659 ADC_EyesOn_Warning 0;
BA_ "GenSigInactiveValue" SG_ 659 ADC_EyesOn_Warning 0;
BA_ "GenSigInvalidValue" SG_ 659 ADC_EyesOn_Warning 0;
BA_ "GenSigSendType" SG_ 659 ADC_EyesOn_Warning 1;
BA_ "GenSigStartValue" SG_ 659 ADC_EyesOn_Warning 0;
BA_ "GenSigTimeoutValue" SG_ 659 ADC_EyesOn_Warning 0;
BA_ "Remark" SG_ 659 ADC_EyesOn_Warning "";
BA_ "EventCommandSignal" SG_ 659 ADC_TakeOverType 0;
BA_ "GatewayedSignals" SG_ 659 ADC_TakeOverType 0;
BA_ "GenSigInactiveValue" SG_ 659 ADC_TakeOverType 0;
BA_ "GenSigInvalidValue" SG_ 659 ADC_TakeOverType 0;
BA_ "GenSigSendType" SG_ 659 ADC_TakeOverType 1;
BA_ "GenSigStartValue" SG_ 659 ADC_TakeOverType 0;
BA_ "GenSigTimeoutValue" SG_ 659 ADC_TakeOverType 0;
BA_ "Remark" SG_ 659 ADC_TakeOverType "";
BA_ "EventCommandSignal" SG_ 659 ADC_TakeOverWarningLevel 0;
BA_ "GatewayedSignals" SG_ 659 ADC_TakeOverWarningLevel 0;
BA_ "GenSigInactiveValue" SG_ 659 ADC_TakeOverWarningLevel 0;
BA_ "GenSigInvalidValue" SG_ 659 ADC_TakeOverWarningLevel 0;
BA_ "GenSigSendType" SG_ 659 ADC_TakeOverWarningLevel 1;
BA_ "GenSigStartValue" SG_ 659 ADC_TakeOverWarningLevel 0;
BA_ "GenSigTimeoutValue" SG_ 659 ADC_TakeOverWarningLevel 0;
BA_ "Remark" SG_ 659 ADC_TakeOverWarningLevel "";
BA_ "EventCommandSignal" SG_ 659 ADC_NDAMRMWarningLevel 0;
BA_ "GatewayedSignals" SG_ 659 ADC_NDAMRMWarningLevel 0;
BA_ "GenSigInactiveValue" SG_ 659 ADC_NDAMRMWarningLevel 0;
BA_ "GenSigInvalidValue" SG_ 659 ADC_NDAMRMWarningLevel 0;
BA_ "GenSigSendType" SG_ 659 ADC_NDAMRMWarningLevel 1;
BA_ "GenSigStartValue" SG_ 659 ADC_NDAMRMWarningLevel 0;
BA_ "GenSigTimeoutValue" SG_ 659 ADC_NDAMRMWarningLevel 0;
BA_ "Remark" SG_ 659 ADC_NDAMRMWarningLevel "";
BA_ "EventCommandSignal" SG_ 659 ADC_FuncReq_SentryModWarn 0;
BA_ "GatewayedSignals" SG_ 659 ADC_FuncReq_SentryModWarn 0;
BA_ "GenSigInactiveValue" SG_ 659 ADC_FuncReq_SentryModWarn 0;
BA_ "GenSigInvalidValue" SG_ 659 ADC_FuncReq_SentryModWarn 0;
BA_ "GenSigSendType" SG_ 659 ADC_FuncReq_SentryModWarn 1;
BA_ "GenSigStartValue" SG_ 659 ADC_FuncReq_SentryModWarn 0;
BA_ "GenSigTimeoutValue" SG_ 659 ADC_FuncReq_SentryModWarn 0;
BA_ "Remark" SG_ 659 ADC_FuncReq_SentryModWarn "";
BA_ "EventCommandSignal" SG_ 659 ADC_ADASTransitionType 0;
BA_ "GatewayedSignals" SG_ 659 ADC_ADASTransitionType 0;
BA_ "GenSigInactiveValue" SG_ 659 ADC_ADASTransitionType 0;
BA_ "GenSigInvalidValue" SG_ 659 ADC_ADASTransitionType 0;
BA_ "GenSigSendType" SG_ 659 ADC_ADASTransitionType 1;
BA_ "GenSigStartValue" SG_ 659 ADC_ADASTransitionType 0;
BA_ "GenSigTimeoutValue" SG_ 659 ADC_ADASTransitionType 0;
BA_ "Remark" SG_ 659 ADC_ADASTransitionType "";
BA_ "EventCommandSignal" SG_ 659 ADC_TotalRefTorque_A 0;
BA_ "GatewayedSignals" SG_ 659 ADC_TotalRefTorque_A 0;
BA_ "GenSigInactiveValue" SG_ 659 ADC_TotalRefTorque_A 0;
BA_ "GenSigInvalidValue" SG_ 659 ADC_TotalRefTorque_A 0;
BA_ "GenSigSendType" SG_ 659 ADC_TotalRefTorque_A 1;
BA_ "GenSigStartValue" SG_ 659 ADC_TotalRefTorque_A 0;
BA_ "GenSigTimeoutValue" SG_ 659 ADC_TotalRefTorque_A 0;
BA_ "Remark" SG_ 659 ADC_TotalRefTorque_A "";
BA_ "EventCommandSignal" SG_ 659 ADC_TlaWarning 0;
BA_ "GatewayedSignals" SG_ 659 ADC_TlaWarning 0;
BA_ "GenSigInactiveValue" SG_ 659 ADC_TlaWarning 0;
BA_ "GenSigInvalidValue" SG_ 659 ADC_TlaWarning 0;
BA_ "GenSigSendType" SG_ 659 ADC_TlaWarning 1;
BA_ "GenSigStartValue" SG_ 659 ADC_TlaWarning 0;
BA_ "GenSigTimeoutValue" SG_ 659 ADC_TlaWarning 0;
BA_ "Remark" SG_ 659 ADC_TlaWarning "";
BA_ "EventCommandSignal" SG_ 659 ADC_TlaFault 0;
BA_ "GatewayedSignals" SG_ 659 ADC_TlaFault 0;
BA_ "GenSigInactiveValue" SG_ 659 ADC_TlaFault 0;
BA_ "GenSigInvalidValue" SG_ 659 ADC_TlaFault 0;
BA_ "GenSigSendType" SG_ 659 ADC_TlaFault 1;
BA_ "GenSigStartValue" SG_ 659 ADC_TlaFault 0;
BA_ "GenSigTimeoutValue" SG_ 659 ADC_TlaFault 0;
BA_ "Remark" SG_ 659 ADC_TlaFault "";
BA_ "EventCommandSignal" SG_ 659 ADC_FcwWaning 0;
BA_ "GatewayedSignals" SG_ 659 ADC_FcwWaning 0;
BA_ "GenSigInactiveValue" SG_ 659 ADC_FcwWaning 0;
BA_ "GenSigInvalidValue" SG_ 659 ADC_FcwWaning 0;
BA_ "GenSigSendType" SG_ 659 ADC_FcwWaning 1;
BA_ "GenSigStartValue" SG_ 659 ADC_FcwWaning 0;
BA_ "GenSigTimeoutValue" SG_ 659 ADC_FcwWaning 0;
BA_ "Remark" SG_ 659 ADC_FcwWaning "";
BA_ "EventCommandSignal" SG_ 659 ADC_AebFault 0;
BA_ "GatewayedSignals" SG_ 659 ADC_AebFault 0;
BA_ "GenSigInactiveValue" SG_ 659 ADC_AebFault 0;
BA_ "GenSigInvalidValue" SG_ 659 ADC_AebFault 0;
BA_ "GenSigSendType" SG_ 659 ADC_AebFault 1;
BA_ "GenSigStartValue" SG_ 659 ADC_AebFault 0;
BA_ "GenSigTimeoutValue" SG_ 659 ADC_AebFault 0;
BA_ "Remark" SG_ 659 ADC_AebFault "";
BA_ "EventCommandSignal" SG_ 659 ADC_RaebFault 0;
BA_ "GatewayedSignals" SG_ 659 ADC_RaebFault 0;
BA_ "GenSigInactiveValue" SG_ 659 ADC_RaebFault 0;
BA_ "GenSigInvalidValue" SG_ 659 ADC_RaebFault 0;
BA_ "GenSigSendType" SG_ 659 ADC_RaebFault 1;
BA_ "GenSigStartValue" SG_ 659 ADC_RaebFault 0;
BA_ "GenSigTimeoutValue" SG_ 659 ADC_RaebFault 0;
BA_ "Remark" SG_ 659 ADC_RaebFault "";
BA_ "EventCommandSignal" SG_ 659 ADC_RcwFault 0;
BA_ "GatewayedSignals" SG_ 659 ADC_RcwFault 0;
BA_ "GenSigInactiveValue" SG_ 659 ADC_RcwFault 0;
BA_ "GenSigInvalidValue" SG_ 659 ADC_RcwFault 0;
BA_ "GenSigSendType" SG_ 659 ADC_RcwFault 1;
BA_ "GenSigStartValue" SG_ 659 ADC_RcwFault 0;
BA_ "GenSigTimeoutValue" SG_ 659 ADC_RcwFault 0;
BA_ "Remark" SG_ 659 ADC_RcwFault "";
BA_ "EventCommandSignal" SG_ 659 ADC_FctbLeftWarning 0;
BA_ "GatewayedSignals" SG_ 659 ADC_FctbLeftWarning 0;
BA_ "GenSigInactiveValue" SG_ 659 ADC_FctbLeftWarning 0;
BA_ "GenSigInvalidValue" SG_ 659 ADC_FctbLeftWarning 0;
BA_ "GenSigSendType" SG_ 659 ADC_FctbLeftWarning 1;
BA_ "GenSigStartValue" SG_ 659 ADC_FctbLeftWarning 0;
BA_ "GenSigTimeoutValue" SG_ 659 ADC_FctbLeftWarning 0;
BA_ "Remark" SG_ 659 ADC_FctbLeftWarning "";
BA_ "EventCommandSignal" SG_ 659 ADC_FctbRightWarning 0;
BA_ "GatewayedSignals" SG_ 659 ADC_FctbRightWarning 0;
BA_ "GenSigInactiveValue" SG_ 659 ADC_FctbRightWarning 0;
BA_ "GenSigInvalidValue" SG_ 659 ADC_FctbRightWarning 0;
BA_ "GenSigSendType" SG_ 659 ADC_FctbRightWarning 1;
BA_ "GenSigStartValue" SG_ 659 ADC_FctbRightWarning 0;
BA_ "GenSigTimeoutValue" SG_ 659 ADC_FctbRightWarning 0;
BA_ "Remark" SG_ 659 ADC_FctbRightWarning "";
BA_ "EventCommandSignal" SG_ 659 ADC_RctaFault 0;
BA_ "GatewayedSignals" SG_ 659 ADC_RctaFault 0;
BA_ "GenSigInactiveValue" SG_ 659 ADC_RctaFault 0;
BA_ "GenSigInvalidValue" SG_ 659 ADC_RctaFault 0;
BA_ "GenSigSendType" SG_ 659 ADC_RctaFault 1;
BA_ "GenSigStartValue" SG_ 659 ADC_RctaFault 0;
BA_ "GenSigTimeoutValue" SG_ 659 ADC_RctaFault 0;
BA_ "Remark" SG_ 659 ADC_RctaFault "";
BA_ "EventCommandSignal" SG_ 659 ADC_RctbLeftWarning 0;
BA_ "GatewayedSignals" SG_ 659 ADC_RctbLeftWarning 0;
BA_ "GenSigInactiveValue" SG_ 659 ADC_RctbLeftWarning 0;
BA_ "GenSigInvalidValue" SG_ 659 ADC_RctbLeftWarning 0;
BA_ "GenSigSendType" SG_ 659 ADC_RctbLeftWarning 1;
BA_ "GenSigStartValue" SG_ 659 ADC_RctbLeftWarning 0;
BA_ "GenSigTimeoutValue" SG_ 659 ADC_RctbLeftWarning 0;
BA_ "Remark" SG_ 659 ADC_RctbLeftWarning "";
BA_ "EventCommandSignal" SG_ 659 ADC_RctbRightWarning 0;
BA_ "GatewayedSignals" SG_ 659 ADC_RctbRightWarning 0;
BA_ "GenSigInactiveValue" SG_ 659 ADC_RctbRightWarning 0;
BA_ "GenSigInvalidValue" SG_ 659 ADC_RctbRightWarning 0;
BA_ "GenSigSendType" SG_ 659 ADC_RctbRightWarning 1;
BA_ "GenSigStartValue" SG_ 659 ADC_RctbRightWarning 0;
BA_ "GenSigTimeoutValue" SG_ 659 ADC_RctbRightWarning 0;
BA_ "Remark" SG_ 659 ADC_RctbRightWarning "";
BA_ "EventCommandSignal" SG_ 659 ADC_LdwFault 0;
BA_ "GatewayedSignals" SG_ 659 ADC_LdwFault 0;
BA_ "GenSigInactiveValue" SG_ 659 ADC_LdwFault 0;
BA_ "GenSigInvalidValue" SG_ 659 ADC_LdwFault 0;
BA_ "GenSigSendType" SG_ 659 ADC_LdwFault 1;
BA_ "GenSigStartValue" SG_ 659 ADC_LdwFault 0;
BA_ "GenSigTimeoutValue" SG_ 659 ADC_LdwFault 0;
BA_ "Remark" SG_ 659 ADC_LdwFault "";
BA_ "EventCommandSignal" SG_ 659 ADC_LkaFault 0;
BA_ "GatewayedSignals" SG_ 659 ADC_LkaFault 0;
BA_ "GenSigInactiveValue" SG_ 659 ADC_LkaFault 0;
BA_ "GenSigInvalidValue" SG_ 659 ADC_LkaFault 0;
BA_ "GenSigSendType" SG_ 659 ADC_LkaFault 1;
BA_ "GenSigStartValue" SG_ 659 ADC_LkaFault 0;
BA_ "GenSigTimeoutValue" SG_ 659 ADC_LkaFault 0;
BA_ "Remark" SG_ 659 ADC_LkaFault "";
BA_ "EventCommandSignal" SG_ 659 ADC_BsdFault 0;
BA_ "GatewayedSignals" SG_ 659 ADC_BsdFault 0;
BA_ "GenSigInactiveValue" SG_ 659 ADC_BsdFault 0;
BA_ "GenSigInvalidValue" SG_ 659 ADC_BsdFault 0;
BA_ "GenSigSendType" SG_ 659 ADC_BsdFault 1;
BA_ "GenSigStartValue" SG_ 659 ADC_BsdFault 0;
BA_ "GenSigTimeoutValue" SG_ 659 ADC_BsdFault 0;
BA_ "Remark" SG_ 659 ADC_BsdFault "";
BA_ "EventCommandSignal" SG_ 659 ADC_DowFault 0;
BA_ "GatewayedSignals" SG_ 659 ADC_DowFault 0;
BA_ "GenSigInactiveValue" SG_ 659 ADC_DowFault 0;
BA_ "GenSigInvalidValue" SG_ 659 ADC_DowFault 0;
BA_ "GenSigSendType" SG_ 659 ADC_DowFault 1;
BA_ "GenSigStartValue" SG_ 659 ADC_DowFault 0;
BA_ "GenSigTimeoutValue" SG_ 659 ADC_DowFault 0;
BA_ "Remark" SG_ 659 ADC_DowFault "";
BA_ "EventCommandSignal" SG_ 659 ADC_TsrFault 0;
BA_ "GatewayedSignals" SG_ 659 ADC_TsrFault 0;
BA_ "GenSigInactiveValue" SG_ 659 ADC_TsrFault 0;
BA_ "GenSigInvalidValue" SG_ 659 ADC_TsrFault 0;
BA_ "GenSigSendType" SG_ 659 ADC_TsrFault 1;
BA_ "GenSigStartValue" SG_ 659 ADC_TsrFault 0;
BA_ "GenSigTimeoutValue" SG_ 659 ADC_TsrFault 0;
BA_ "Remark" SG_ 659 ADC_TsrFault "";
BA_ "EventCommandSignal" SG_ 659 ADC_ElkaWarning 0;
BA_ "GatewayedSignals" SG_ 659 ADC_ElkaWarning 0;
BA_ "GenSigInactiveValue" SG_ 659 ADC_ElkaWarning 0;
BA_ "GenSigInvalidValue" SG_ 659 ADC_ElkaWarning 0;
BA_ "GenSigSendType" SG_ 659 ADC_ElkaWarning 1;
BA_ "GenSigStartValue" SG_ 659 ADC_ElkaWarning 0;
BA_ "GenSigTimeoutValue" SG_ 659 ADC_ElkaWarning 0;
BA_ "Remark" SG_ 659 ADC_ElkaWarning "";
BA_ "EventCommandSignal" SG_ 659 ADC_ElkaFault 0;
BA_ "GatewayedSignals" SG_ 659 ADC_ElkaFault 0;
BA_ "GenSigInactiveValue" SG_ 659 ADC_ElkaFault 0;
BA_ "GenSigInvalidValue" SG_ 659 ADC_ElkaFault 0;
BA_ "GenSigSendType" SG_ 659 ADC_ElkaFault 1;
BA_ "GenSigStartValue" SG_ 659 ADC_ElkaFault 0;
BA_ "GenSigTimeoutValue" SG_ 659 ADC_ElkaFault 0;
BA_ "Remark" SG_ 659 ADC_ElkaFault "";
BA_ "EventCommandSignal" SG_ 659 ADC_IMURollingCounter 0;
BA_ "GatewayedSignals" SG_ 659 ADC_IMURollingCounter 0;
BA_ "GenSigInactiveValue" SG_ 659 ADC_IMURollingCounter 0;
BA_ "GenSigInvalidValue" SG_ 659 ADC_IMURollingCounter 0;
BA_ "GenSigSendType" SG_ 659 ADC_IMURollingCounter 1;
BA_ "GenSigStartValue" SG_ 659 ADC_IMURollingCounter 0;
BA_ "GenSigTimeoutValue" SG_ 659 ADC_IMURollingCounter 255;
BA_ "Remark" SG_ 659 ADC_IMURollingCounter "";
BA_ "EventCommandSignal" SG_ 659 ADC_IMUAccX 0;
BA_ "GatewayedSignals" SG_ 659 ADC_IMUAccX 0;
BA_ "GenSigInactiveValue" SG_ 659 ADC_IMUAccX 0;
BA_ "GenSigInvalidValue" SG_ 659 ADC_IMUAccX 0;
BA_ "GenSigSendType" SG_ 659 ADC_IMUAccX 1;
BA_ "GenSigStartValue" SG_ 659 ADC_IMUAccX 32768;
BA_ "GenSigTimeoutValue" SG_ 659 ADC_IMUAccX 65535;
BA_ "Remark" SG_ 659 ADC_IMUAccX "";
BA_ "EventCommandSignal" SG_ 659 ADC_IMUAccY 0;
BA_ "GatewayedSignals" SG_ 659 ADC_IMUAccY 0;
BA_ "GenSigInactiveValue" SG_ 659 ADC_IMUAccY 0;
BA_ "GenSigInvalidValue" SG_ 659 ADC_IMUAccY 0;
BA_ "GenSigSendType" SG_ 659 ADC_IMUAccY 1;
BA_ "GenSigStartValue" SG_ 659 ADC_IMUAccY 32768;
BA_ "GenSigTimeoutValue" SG_ 659 ADC_IMUAccY 65535;
BA_ "Remark" SG_ 659 ADC_IMUAccY "";
BA_ "EventCommandSignal" SG_ 659 ADC_IMUAccZ 0;
BA_ "GatewayedSignals" SG_ 659 ADC_IMUAccZ 0;
BA_ "GenSigInactiveValue" SG_ 659 ADC_IMUAccZ 0;
BA_ "GenSigInvalidValue" SG_ 659 ADC_IMUAccZ 0;
BA_ "GenSigSendType" SG_ 659 ADC_IMUAccZ 1;
BA_ "GenSigStartValue" SG_ 659 ADC_IMUAccZ 32768;
BA_ "GenSigTimeoutValue" SG_ 659 ADC_IMUAccZ 65535;
BA_ "Remark" SG_ 659 ADC_IMUAccZ "";
BA_ "EventCommandSignal" SG_ 659 ADC_IMUGyroX 0;
BA_ "GatewayedSignals" SG_ 659 ADC_IMUGyroX 0;
BA_ "GenSigInactiveValue" SG_ 659 ADC_IMUGyroX 0;
BA_ "GenSigInvalidValue" SG_ 659 ADC_IMUGyroX 0;
BA_ "GenSigSendType" SG_ 659 ADC_IMUGyroX 1;
BA_ "GenSigStartValue" SG_ 659 ADC_IMUGyroX 32768;
BA_ "GenSigTimeoutValue" SG_ 659 ADC_IMUGyroX 65535;
BA_ "Remark" SG_ 659 ADC_IMUGyroX "";
BA_ "EventCommandSignal" SG_ 659 ADC_IMUGyroY 0;
BA_ "GatewayedSignals" SG_ 659 ADC_IMUGyroY 0;
BA_ "GenSigInactiveValue" SG_ 659 ADC_IMUGyroY 0;
BA_ "GenSigInvalidValue" SG_ 659 ADC_IMUGyroY 0;
BA_ "GenSigSendType" SG_ 659 ADC_IMUGyroY 1;
BA_ "GenSigStartValue" SG_ 659 ADC_IMUGyroY 32768;
BA_ "GenSigTimeoutValue" SG_ 659 ADC_IMUGyroY 65535;
BA_ "Remark" SG_ 659 ADC_IMUGyroY "";
BA_ "EventCommandSignal" SG_ 659 ADC_IMUGyroZ 0;
BA_ "GatewayedSignals" SG_ 659 ADC_IMUGyroZ 0;
BA_ "GenSigInactiveValue" SG_ 659 ADC_IMUGyroZ 0;
BA_ "GenSigInvalidValue" SG_ 659 ADC_IMUGyroZ 0;
BA_ "GenSigSendType" SG_ 659 ADC_IMUGyroZ 1;
BA_ "GenSigStartValue" SG_ 659 ADC_IMUGyroZ 32768;
BA_ "GenSigTimeoutValue" SG_ 659 ADC_IMUGyroZ 65535;
BA_ "Remark" SG_ 659 ADC_IMUGyroZ "";
BA_ "EventCommandSignal" SG_ 659 ADC_IMURoll 0;
BA_ "GatewayedSignals" SG_ 659 ADC_IMURoll 0;
BA_ "GenSigInactiveValue" SG_ 659 ADC_IMURoll 0;
BA_ "GenSigInvalidValue" SG_ 659 ADC_IMURoll 0;
BA_ "GenSigSendType" SG_ 659 ADC_IMURoll 1;
BA_ "GenSigStartValue" SG_ 659 ADC_IMURoll 18000;
BA_ "GenSigTimeoutValue" SG_ 659 ADC_IMURoll 65535;
BA_ "Remark" SG_ 659 ADC_IMURoll "";
BA_ "EventCommandSignal" SG_ 659 ADC_IMUPitch 0;
BA_ "GatewayedSignals" SG_ 659 ADC_IMUPitch 0;
BA_ "GenSigInactiveValue" SG_ 659 ADC_IMUPitch 0;
BA_ "GenSigInvalidValue" SG_ 659 ADC_IMUPitch 0;
BA_ "GenSigSendType" SG_ 659 ADC_IMUPitch 1;
BA_ "GenSigStartValue" SG_ 659 ADC_IMUPitch 18000;
BA_ "GenSigTimeoutValue" SG_ 659 ADC_IMUPitch 65535;
BA_ "Remark" SG_ 659 ADC_IMUPitch "";
BA_ "EventCommandSignal" SG_ 659 ADC_IMUYaw 0;
BA_ "GatewayedSignals" SG_ 659 ADC_IMUYaw 0;
BA_ "GenSigInactiveValue" SG_ 659 ADC_IMUYaw 0;
BA_ "GenSigInvalidValue" SG_ 659 ADC_IMUYaw 0;
BA_ "GenSigSendType" SG_ 659 ADC_IMUYaw 1;
BA_ "GenSigStartValue" SG_ 659 ADC_IMUYaw 0;
BA_ "GenSigTimeoutValue" SG_ 659 ADC_IMUYaw 65535;
BA_ "Remark" SG_ 659 ADC_IMUYaw "";
BA_ "EventCommandSignal" SG_ 659 ADC_IMUTimestampVld 0;
BA_ "GatewayedSignals" SG_ 659 ADC_IMUTimestampVld 0;
BA_ "GenSigInactiveValue" SG_ 659 ADC_IMUTimestampVld 0;
BA_ "GenSigInvalidValue" SG_ 659 ADC_IMUTimestampVld 0;
BA_ "GenSigSendType" SG_ 659 ADC_IMUTimestampVld 1;
BA_ "GenSigStartValue" SG_ 659 ADC_IMUTimestampVld 0;
BA_ "GenSigTimeoutValue" SG_ 659 ADC_IMUTimestampVld 0;
BA_ "Remark" SG_ 659 ADC_IMUTimestampVld "";
BA_ "EventCommandSignal" SG_ 659 ADC_IMUAccVld 0;
BA_ "GatewayedSignals" SG_ 659 ADC_IMUAccVld 0;
BA_ "GenSigInactiveValue" SG_ 659 ADC_IMUAccVld 0;
BA_ "GenSigInvalidValue" SG_ 659 ADC_IMUAccVld 0;
BA_ "GenSigSendType" SG_ 659 ADC_IMUAccVld 1;
BA_ "GenSigStartValue" SG_ 659 ADC_IMUAccVld 0;
BA_ "GenSigTimeoutValue" SG_ 659 ADC_IMUAccVld 0;
BA_ "Remark" SG_ 659 ADC_IMUAccVld "";
BA_ "EventCommandSignal" SG_ 659 ADC_IMUGyroVld 0;
BA_ "GatewayedSignals" SG_ 659 ADC_IMUGyroVld 0;
BA_ "GenSigInactiveValue" SG_ 659 ADC_IMUGyroVld 0;
BA_ "GenSigInvalidValue" SG_ 659 ADC_IMUGyroVld 0;
BA_ "GenSigSendType" SG_ 659 ADC_IMUGyroVld 1;
BA_ "GenSigStartValue" SG_ 659 ADC_IMUGyroVld 0;
BA_ "GenSigTimeoutValue" SG_ 659 ADC_IMUGyroVld 0;
BA_ "Remark" SG_ 659 ADC_IMUGyroVld "";
BA_ "EventCommandSignal" SG_ 659 ADC_IMUAttitudeVld 0;
BA_ "GatewayedSignals" SG_ 659 ADC_IMUAttitudeVld 0;
BA_ "GenSigInactiveValue" SG_ 659 ADC_IMUAttitudeVld 0;
BA_ "GenSigInvalidValue" SG_ 659 ADC_IMUAttitudeVld 0;
BA_ "GenSigSendType" SG_ 659 ADC_IMUAttitudeVld 1;
BA_ "GenSigStartValue" SG_ 659 ADC_IMUAttitudeVld 0;
BA_ "GenSigTimeoutValue" SG_ 659 ADC_IMUAttitudeVld 0;
BA_ "Remark" SG_ 659 ADC_IMUAttitudeVld "";
BA_ "EventCommandSignal" SG_ 659 ADC_IMUPositionType 0;
BA_ "GatewayedSignals" SG_ 659 ADC_IMUPositionType 0;
BA_ "GenSigInactiveValue" SG_ 659 ADC_IMUPositionType 0;
BA_ "GenSigInvalidValue" SG_ 659 ADC_IMUPositionType 0;
BA_ "GenSigSendType" SG_ 659 ADC_IMUPositionType 1;
BA_ "GenSigStartValue" SG_ 659 ADC_IMUPositionType 0;
BA_ "GenSigTimeoutValue" SG_ 659 ADC_IMUPositionType 0;
BA_ "Remark" SG_ 659 ADC_IMUPositionType "";
BA_ "EventCommandSignal" SG_ 659 ADC_IMUTimestamp 0;
BA_ "GatewayedSignals" SG_ 659 ADC_IMUTimestamp 0;
BA_ "GenSigInactiveValue" SG_ 659 ADC_IMUTimestamp 0;
BA_ "GenSigInvalidValue" SG_ 659 ADC_IMUTimestamp 0;
BA_ "GenSigSendType" SG_ 659 ADC_IMUTimestamp 1;
BA_ "GenSigStartValue" SG_ 659 ADC_IMUTimestamp 0;
BA_ "GenSigTimeoutValue" SG_ 659 ADC_IMUTimestamp 4294967295;
BA_ "Remark" SG_ 659 ADC_IMUTimestamp "";
BA_ "EventCommandSignal" SG_ 659 ADC_AbsoultwSpeedLimit 0;
BA_ "GatewayedSignals" SG_ 659 ADC_AbsoultwSpeedLimit 0;
BA_ "GenSigInactiveValue" SG_ 659 ADC_AbsoultwSpeedLimit 0;
BA_ "GenSigInvalidValue" SG_ 659 ADC_AbsoultwSpeedLimit 0;
BA_ "GenSigSendType" SG_ 659 ADC_AbsoultwSpeedLimit 1;
BA_ "GenSigStartValue" SG_ 659 ADC_AbsoultwSpeedLimit 0;
BA_ "GenSigTimeoutValue" SG_ 659 ADC_AbsoultwSpeedLimit 0;
BA_ "Remark" SG_ 659 ADC_AbsoultwSpeedLimit "";
BA_ "EventCommandSignal" SG_ 923 ADC_6_CRC 0;
BA_ "GatewayedSignals" SG_ 923 ADC_6_CRC 0;
BA_ "GenSigInactiveValue" SG_ 923 ADC_6_CRC 0;
BA_ "GenSigInvalidValue" SG_ 923 ADC_6_CRC 0;
BA_ "GenSigSendType" SG_ 923 ADC_6_CRC 1;
BA_ "GenSigStartValue" SG_ 923 ADC_6_CRC 0;
BA_ "GenSigTimeoutValue" SG_ 923 ADC_6_CRC 0;
BA_ "Remark" SG_ 923 ADC_6_CRC "";
BA_ "EventCommandSignal" SG_ 923 ADC_6_Counter 0;
BA_ "GatewayedSignals" SG_ 923 ADC_6_Counter 0;
BA_ "GenSigInactiveValue" SG_ 923 ADC_6_Counter 0;
BA_ "GenSigInvalidValue" SG_ 923 ADC_6_Counter 0;
BA_ "GenSigSendType" SG_ 923 ADC_6_Counter 1;
BA_ "GenSigStartValue" SG_ 923 ADC_6_Counter 0;
BA_ "GenSigTimeoutValue" SG_ 923 ADC_6_Counter 0;
BA_ "Remark" SG_ 923 ADC_6_Counter "";
BA_ "EventCommandSignal" SG_ 923 ADC_FrontWideCameraSt 0;
BA_ "GatewayedSignals" SG_ 923 ADC_FrontWideCameraSt 0;
BA_ "GenSigInactiveValue" SG_ 923 ADC_FrontWideCameraSt 0;
BA_ "GenSigInvalidValue" SG_ 923 ADC_FrontWideCameraSt 0;
BA_ "GenSigSendType" SG_ 923 ADC_FrontWideCameraSt 1;
BA_ "GenSigStartValue" SG_ 923 ADC_FrontWideCameraSt 0;
BA_ "GenSigTimeoutValue" SG_ 923 ADC_FrontWideCameraSt 0;
BA_ "Remark" SG_ 923 ADC_FrontWideCameraSt "";
BA_ "EventCommandSignal" SG_ 923 ADC_FrontNarrowCameraSt 0;
BA_ "GatewayedSignals" SG_ 923 ADC_FrontNarrowCameraSt 0;
BA_ "GenSigInactiveValue" SG_ 923 ADC_FrontNarrowCameraSt 0;
BA_ "GenSigInvalidValue" SG_ 923 ADC_FrontNarrowCameraSt 0;
BA_ "GenSigSendType" SG_ 923 ADC_FrontNarrowCameraSt 1;
BA_ "GenSigStartValue" SG_ 923 ADC_FrontNarrowCameraSt 0;
BA_ "GenSigTimeoutValue" SG_ 923 ADC_FrontNarrowCameraSt 0;
BA_ "Remark" SG_ 923 ADC_FrontNarrowCameraSt "";
BA_ "EventCommandSignal" SG_ 923 ADC_LeftFrontCameraSt 0;
BA_ "GatewayedSignals" SG_ 923 ADC_LeftFrontCameraSt 0;
BA_ "GenSigInactiveValue" SG_ 923 ADC_LeftFrontCameraSt 0;
BA_ "GenSigInvalidValue" SG_ 923 ADC_LeftFrontCameraSt 0;
BA_ "GenSigSendType" SG_ 923 ADC_LeftFrontCameraSt 1;
BA_ "GenSigStartValue" SG_ 923 ADC_LeftFrontCameraSt 0;
BA_ "GenSigTimeoutValue" SG_ 923 ADC_LeftFrontCameraSt 0;
BA_ "Remark" SG_ 923 ADC_LeftFrontCameraSt "";
BA_ "EventCommandSignal" SG_ 923 ADC_LeftRearCameraSt 0;
BA_ "GatewayedSignals" SG_ 923 ADC_LeftRearCameraSt 0;
BA_ "GenSigInactiveValue" SG_ 923 ADC_LeftRearCameraSt 0;
BA_ "GenSigInvalidValue" SG_ 923 ADC_LeftRearCameraSt 0;
BA_ "GenSigSendType" SG_ 923 ADC_LeftRearCameraSt 1;
BA_ "GenSigStartValue" SG_ 923 ADC_LeftRearCameraSt 0;
BA_ "GenSigTimeoutValue" SG_ 923 ADC_LeftRearCameraSt 0;
BA_ "Remark" SG_ 923 ADC_LeftRearCameraSt "";
BA_ "EventCommandSignal" SG_ 923 ADC_RightFrontCameraSt 0;
BA_ "GatewayedSignals" SG_ 923 ADC_RightFrontCameraSt 0;
BA_ "GenSigInactiveValue" SG_ 923 ADC_RightFrontCameraSt 0;
BA_ "GenSigInvalidValue" SG_ 923 ADC_RightFrontCameraSt 0;
BA_ "GenSigSendType" SG_ 923 ADC_RightFrontCameraSt 1;
BA_ "GenSigStartValue" SG_ 923 ADC_RightFrontCameraSt 0;
BA_ "GenSigTimeoutValue" SG_ 923 ADC_RightFrontCameraSt 0;
BA_ "Remark" SG_ 923 ADC_RightFrontCameraSt "";
BA_ "EventCommandSignal" SG_ 923 ADC_RightRearCameraSt 0;
BA_ "GatewayedSignals" SG_ 923 ADC_RightRearCameraSt 0;
BA_ "GenSigInactiveValue" SG_ 923 ADC_RightRearCameraSt 0;
BA_ "GenSigInvalidValue" SG_ 923 ADC_RightRearCameraSt 0;
BA_ "GenSigSendType" SG_ 923 ADC_RightRearCameraSt 1;
BA_ "GenSigStartValue" SG_ 923 ADC_RightRearCameraSt 0;
BA_ "GenSigTimeoutValue" SG_ 923 ADC_RightRearCameraSt 0;
BA_ "Remark" SG_ 923 ADC_RightRearCameraSt "";
BA_ "EventCommandSignal" SG_ 923 ADC_RearCameraSt 0;
BA_ "GatewayedSignals" SG_ 923 ADC_RearCameraSt 0;
BA_ "GenSigInactiveValue" SG_ 923 ADC_RearCameraSt 0;
BA_ "GenSigInvalidValue" SG_ 923 ADC_RearCameraSt 0;
BA_ "GenSigSendType" SG_ 923 ADC_RearCameraSt 1;
BA_ "GenSigStartValue" SG_ 923 ADC_RearCameraSt 0;
BA_ "GenSigTimeoutValue" SG_ 923 ADC_RearCameraSt 0;
BA_ "Remark" SG_ 923 ADC_RearCameraSt "";
BA_ "EventCommandSignal" SG_ 923 ADC_FrontRadarSt 0;
BA_ "GatewayedSignals" SG_ 923 ADC_FrontRadarSt 0;
BA_ "GenSigInactiveValue" SG_ 923 ADC_FrontRadarSt 0;
BA_ "GenSigInvalidValue" SG_ 923 ADC_FrontRadarSt 0;
BA_ "GenSigSendType" SG_ 923 ADC_FrontRadarSt 1;
BA_ "GenSigStartValue" SG_ 923 ADC_FrontRadarSt 0;
BA_ "GenSigTimeoutValue" SG_ 923 ADC_FrontRadarSt 0;
BA_ "Remark" SG_ 923 ADC_FrontRadarSt "";
BA_ "EventCommandSignal" SG_ 923 ADC_LeftFrontRadarSt 0;
BA_ "GatewayedSignals" SG_ 923 ADC_LeftFrontRadarSt 0;
BA_ "GenSigInactiveValue" SG_ 923 ADC_LeftFrontRadarSt 0;
BA_ "GenSigInvalidValue" SG_ 923 ADC_LeftFrontRadarSt 0;
BA_ "GenSigSendType" SG_ 923 ADC_LeftFrontRadarSt 1;
BA_ "GenSigStartValue" SG_ 923 ADC_LeftFrontRadarSt 0;
BA_ "GenSigTimeoutValue" SG_ 923 ADC_LeftFrontRadarSt 0;
BA_ "Remark" SG_ 923 ADC_LeftFrontRadarSt "";
BA_ "EventCommandSignal" SG_ 923 ADC_LeftRearRadarSt 0;
BA_ "GatewayedSignals" SG_ 923 ADC_LeftRearRadarSt 0;
BA_ "GenSigInactiveValue" SG_ 923 ADC_LeftRearRadarSt 0;
BA_ "GenSigInvalidValue" SG_ 923 ADC_LeftRearRadarSt 0;
BA_ "GenSigSendType" SG_ 923 ADC_LeftRearRadarSt 1;
BA_ "GenSigStartValue" SG_ 923 ADC_LeftRearRadarSt 0;
BA_ "GenSigTimeoutValue" SG_ 923 ADC_LeftRearRadarSt 0;
BA_ "Remark" SG_ 923 ADC_LeftRearRadarSt "";
BA_ "EventCommandSignal" SG_ 923 ADC_RightFrontRadarSt 0;
BA_ "GatewayedSignals" SG_ 923 ADC_RightFrontRadarSt 0;
BA_ "GenSigInactiveValue" SG_ 923 ADC_RightFrontRadarSt 0;
BA_ "GenSigInvalidValue" SG_ 923 ADC_RightFrontRadarSt 0;
BA_ "GenSigSendType" SG_ 923 ADC_RightFrontRadarSt 1;
BA_ "GenSigStartValue" SG_ 923 ADC_RightFrontRadarSt 0;
BA_ "GenSigTimeoutValue" SG_ 923 ADC_RightFrontRadarSt 0;
BA_ "Remark" SG_ 923 ADC_RightFrontRadarSt "";
BA_ "EventCommandSignal" SG_ 923 ADC_RightRearRadarSt 0;
BA_ "GatewayedSignals" SG_ 923 ADC_RightRearRadarSt 0;
BA_ "GenSigInactiveValue" SG_ 923 ADC_RightRearRadarSt 0;
BA_ "GenSigInvalidValue" SG_ 923 ADC_RightRearRadarSt 0;
BA_ "GenSigSendType" SG_ 923 ADC_RightRearRadarSt 1;
BA_ "GenSigStartValue" SG_ 923 ADC_RightRearRadarSt 0;
BA_ "GenSigTimeoutValue" SG_ 923 ADC_RightRearRadarSt 0;
BA_ "Remark" SG_ 923 ADC_RightRearRadarSt "";
BA_ "EventCommandSignal" SG_ 923 ADC_RearRadarSt 0;
BA_ "GatewayedSignals" SG_ 923 ADC_RearRadarSt 0;
BA_ "GenSigInactiveValue" SG_ 923 ADC_RearRadarSt 0;
BA_ "GenSigInvalidValue" SG_ 923 ADC_RearRadarSt 0;
BA_ "GenSigSendType" SG_ 923 ADC_RearRadarSt 1;
BA_ "GenSigStartValue" SG_ 923 ADC_RearRadarSt 0;
BA_ "GenSigTimeoutValue" SG_ 923 ADC_RearRadarSt 0;
BA_ "Remark" SG_ 923 ADC_RearRadarSt "";
BA_ "EventCommandSignal" SG_ 923 ADC_FrontLidarSt 0;
BA_ "GatewayedSignals" SG_ 923 ADC_FrontLidarSt 0;
BA_ "GenSigInactiveValue" SG_ 923 ADC_FrontLidarSt 0;
BA_ "GenSigInvalidValue" SG_ 923 ADC_FrontLidarSt 0;
BA_ "GenSigSendType" SG_ 923 ADC_FrontLidarSt 1;
BA_ "GenSigStartValue" SG_ 923 ADC_FrontLidarSt 0;
BA_ "GenSigTimeoutValue" SG_ 923 ADC_FrontLidarSt 0;
BA_ "Remark" SG_ 923 ADC_FrontLidarSt "";
BA_ "EventCommandSignal" SG_ 923 ADC_LeftLidarSt 0;
BA_ "GatewayedSignals" SG_ 923 ADC_LeftLidarSt 0;
BA_ "GenSigInactiveValue" SG_ 923 ADC_LeftLidarSt 0;
BA_ "GenSigInvalidValue" SG_ 923 ADC_LeftLidarSt 0;
BA_ "GenSigSendType" SG_ 923 ADC_LeftLidarSt 1;
BA_ "GenSigStartValue" SG_ 923 ADC_LeftLidarSt 0;
BA_ "GenSigTimeoutValue" SG_ 923 ADC_LeftLidarSt 0;
BA_ "Remark" SG_ 923 ADC_LeftLidarSt "";
BA_ "EventCommandSignal" SG_ 923 ADC_RightLidarSt 0;
BA_ "GatewayedSignals" SG_ 923 ADC_RightLidarSt 0;
BA_ "GenSigInactiveValue" SG_ 923 ADC_RightLidarSt 0;
BA_ "GenSigInvalidValue" SG_ 923 ADC_RightLidarSt 0;
BA_ "GenSigSendType" SG_ 923 ADC_RightLidarSt 1;
BA_ "GenSigStartValue" SG_ 923 ADC_RightLidarSt 0;
BA_ "GenSigTimeoutValue" SG_ 923 ADC_RightLidarSt 0;
BA_ "Remark" SG_ 923 ADC_RightLidarSt "";
BA_ "EventCommandSignal" SG_ 923 ADC_SunroofOpenCloseReq 0;
BA_ "GatewayedSignals" SG_ 923 ADC_SunroofOpenCloseReq 0;
BA_ "GenSigInactiveValue" SG_ 923 ADC_SunroofOpenCloseReq 0;
BA_ "GenSigInvalidValue" SG_ 923 ADC_SunroofOpenCloseReq 0;
BA_ "GenSigSendType" SG_ 923 ADC_SunroofOpenCloseReq 1;
BA_ "GenSigStartValue" SG_ 923 ADC_SunroofOpenCloseReq 0;
BA_ "GenSigTimeoutValue" SG_ 923 ADC_SunroofOpenCloseReq 0;
BA_ "Remark" SG_ 923 ADC_SunroofOpenCloseReq "";
BA_ "EventCommandSignal" SG_ 923 ADC_SentryStatus 0;
BA_ "GatewayedSignals" SG_ 923 ADC_SentryStatus 0;
BA_ "GenSigInactiveValue" SG_ 923 ADC_SentryStatus 0;
BA_ "GenSigInvalidValue" SG_ 923 ADC_SentryStatus 0;
BA_ "GenSigSendType" SG_ 923 ADC_SentryStatus 1;
BA_ "GenSigStartValue" SG_ 923 ADC_SentryStatus 0;
BA_ "GenSigTimeoutValue" SG_ 923 ADC_SentryStatus 0;
BA_ "Remark" SG_ 923 ADC_SentryStatus "";
BA_ "EventCommandSignal" SG_ 923 ADC_SOCWakeupHVReq 0;
BA_ "GatewayedSignals" SG_ 923 ADC_SOCWakeupHVReq 0;
BA_ "GenSigInactiveValue" SG_ 923 ADC_SOCWakeupHVReq 0;
BA_ "GenSigInvalidValue" SG_ 923 ADC_SOCWakeupHVReq 0;
BA_ "GenSigSendType" SG_ 923 ADC_SOCWakeupHVReq 1;
BA_ "GenSigStartValue" SG_ 923 ADC_SOCWakeupHVReq 0;
BA_ "GenSigTimeoutValue" SG_ 923 ADC_SOCWakeupHVReq 0;
BA_ "Remark" SG_ 923 ADC_SOCWakeupHVReq "";
BA_ "EventCommandSignal" SG_ 923 ADC_SystemState 0;
BA_ "GatewayedSignals" SG_ 923 ADC_SystemState 0;
BA_ "GenSigInactiveValue" SG_ 923 ADC_SystemState 0;
BA_ "GenSigInvalidValue" SG_ 923 ADC_SystemState 15;
BA_ "GenSigSendType" SG_ 923 ADC_SystemState 1;
BA_ "GenSigStartValue" SG_ 923 ADC_SystemState 0;
BA_ "GenSigTimeoutValue" SG_ 923 ADC_SystemState 0;
BA_ "Remark" SG_ 923 ADC_SystemState "";
BA_ "EventCommandSignal" SG_ 923 ADC_FuncReq_SentryModDetec 0;
BA_ "GatewayedSignals" SG_ 923 ADC_FuncReq_SentryModDetec 0;
BA_ "GenSigInactiveValue" SG_ 923 ADC_FuncReq_SentryModDetec 0;
BA_ "GenSigInvalidValue" SG_ 923 ADC_FuncReq_SentryModDetec 0;
BA_ "GenSigSendType" SG_ 923 ADC_FuncReq_SentryModDetec 1;
BA_ "GenSigStartValue" SG_ 923 ADC_FuncReq_SentryModDetec 0;
BA_ "GenSigTimeoutValue" SG_ 923 ADC_FuncReq_SentryModDetec 0;
BA_ "Remark" SG_ 923 ADC_FuncReq_SentryModDetec "";
BA_ "EventCommandSignal" SG_ 923 ADC_HWFailureReason 0;
BA_ "GatewayedSignals" SG_ 923 ADC_HWFailureReason 0;
BA_ "GenSigInactiveValue" SG_ 923 ADC_HWFailureReason 0;
BA_ "GenSigInvalidValue" SG_ 923 ADC_HWFailureReason 0;
BA_ "GenSigSendType" SG_ 923 ADC_HWFailureReason 1;
BA_ "GenSigStartValue" SG_ 923 ADC_HWFailureReason 0;
BA_ "GenSigTimeoutValue" SG_ 923 ADC_HWFailureReason 0;
BA_ "Remark" SG_ 923 ADC_HWFailureReason "";
BA_ "EventCommandSignal" SG_ 923 ADC_SWFailureReason 0;
BA_ "GatewayedSignals" SG_ 923 ADC_SWFailureReason 0;
BA_ "GenSigInactiveValue" SG_ 923 ADC_SWFailureReason 0;
BA_ "GenSigInvalidValue" SG_ 923 ADC_SWFailureReason 0;
BA_ "GenSigSendType" SG_ 923 ADC_SWFailureReason 1;
BA_ "GenSigStartValue" SG_ 923 ADC_SWFailureReason 0;
BA_ "GenSigTimeoutValue" SG_ 923 ADC_SWFailureReason 0;
BA_ "Remark" SG_ 923 ADC_SWFailureReason "";
BA_ "EventCommandSignal" SG_ 923 mountAngleIndicator_az 0;
BA_ "GatewayedSignals" SG_ 923 mountAngleIndicator_az 0;
BA_ "GenSigInactiveValue" SG_ 923 mountAngleIndicator_az 0;
BA_ "GenSigInvalidValue" SG_ 923 mountAngleIndicator_az 0;
BA_ "GenSigSendType" SG_ 923 mountAngleIndicator_az 1;
BA_ "GenSigStartValue" SG_ 923 mountAngleIndicator_az 0;
BA_ "GenSigTimeoutValue" SG_ 923 mountAngleIndicator_az 0;
BA_ "Remark" SG_ 923 mountAngleIndicator_az "";
BA_ "EventCommandSignal" SG_ 923 mountAngleCurrent_az 0;
BA_ "GatewayedSignals" SG_ 923 mountAngleCurrent_az 0;
BA_ "GenSigInactiveValue" SG_ 923 mountAngleCurrent_az 0;
BA_ "GenSigInvalidValue" SG_ 923 mountAngleCurrent_az 0;
BA_ "GenSigSendType" SG_ 923 mountAngleCurrent_az 1;
BA_ "GenSigStartValue" SG_ 923 mountAngleCurrent_az 0;
BA_ "GenSigTimeoutValue" SG_ 923 mountAngleCurrent_az 0;
BA_ "Remark" SG_ 923 mountAngleCurrent_az "";
BA_ "EventCommandSignal" SG_ 923 mountAngleIndicator_el 0;
BA_ "GatewayedSignals" SG_ 923 mountAngleIndicator_el 0;
BA_ "GenSigInactiveValue" SG_ 923 mountAngleIndicator_el 0;
BA_ "GenSigInvalidValue" SG_ 923 mountAngleIndicator_el 0;
BA_ "GenSigSendType" SG_ 923 mountAngleIndicator_el 1;
BA_ "GenSigStartValue" SG_ 923 mountAngleIndicator_el 0;
BA_ "GenSigTimeoutValue" SG_ 923 mountAngleIndicator_el 0;
BA_ "Remark" SG_ 923 mountAngleIndicator_el "";
BA_ "EventCommandSignal" SG_ 923 mountAngleCurrent_el 0;
BA_ "GatewayedSignals" SG_ 923 mountAngleCurrent_el 0;
BA_ "GenSigInactiveValue" SG_ 923 mountAngleCurrent_el 0;
BA_ "GenSigInvalidValue" SG_ 923 mountAngleCurrent_el 0;
BA_ "GenSigSendType" SG_ 923 mountAngleCurrent_el 1;
BA_ "GenSigStartValue" SG_ 923 mountAngleCurrent_el 0;
BA_ "GenSigTimeoutValue" SG_ 923 mountAngleCurrent_el 0;
BA_ "Remark" SG_ 923 mountAngleCurrent_el "";
BA_ "EventCommandSignal" SG_ 923 malStablePosEl 0;
BA_ "GatewayedSignals" SG_ 923 malStablePosEl 0;
BA_ "GenSigInactiveValue" SG_ 923 malStablePosEl 0;
BA_ "GenSigInvalidValue" SG_ 923 malStablePosEl 0;
BA_ "GenSigSendType" SG_ 923 malStablePosEl 1;
BA_ "GenSigStartValue" SG_ 923 malStablePosEl 0;
BA_ "GenSigTimeoutValue" SG_ 923 malStablePosEl 0;
BA_ "Remark" SG_ 923 malStablePosEl "";
BA_ "EventCommandSignal" SG_ 923 malStablePosAz 0;
BA_ "GatewayedSignals" SG_ 923 malStablePosAz 0;
BA_ "GenSigInactiveValue" SG_ 923 malStablePosAz 0;
BA_ "GenSigInvalidValue" SG_ 923 malStablePosAz 0;
BA_ "GenSigSendType" SG_ 923 malStablePosAz 1;
BA_ "GenSigStartValue" SG_ 923 malStablePosAz 0;
BA_ "GenSigTimeoutValue" SG_ 923 malStablePosAz 0;
BA_ "Remark" SG_ 923 malStablePosAz "";
BA_ "EventCommandSignal" SG_ 923 AngleEMEIndicatorEl 0;
BA_ "GatewayedSignals" SG_ 923 AngleEMEIndicatorEl 0;
BA_ "GenSigInactiveValue" SG_ 923 AngleEMEIndicatorEl 0;
BA_ "GenSigInvalidValue" SG_ 923 AngleEMEIndicatorEl 0;
BA_ "GenSigSendType" SG_ 923 AngleEMEIndicatorEl 1;
BA_ "GenSigStartValue" SG_ 923 AngleEMEIndicatorEl 0;
BA_ "GenSigTimeoutValue" SG_ 923 AngleEMEIndicatorEl 0;
BA_ "Remark" SG_ 923 AngleEMEIndicatorEl "";
BA_ "EventCommandSignal" SG_ 923 AngleEMEIndicatorAz 0;
BA_ "GatewayedSignals" SG_ 923 AngleEMEIndicatorAz 0;
BA_ "GenSigInactiveValue" SG_ 923 AngleEMEIndicatorAz 0;
BA_ "GenSigInvalidValue" SG_ 923 AngleEMEIndicatorAz 0;
BA_ "GenSigSendType" SG_ 923 AngleEMEIndicatorAz 1;
BA_ "GenSigStartValue" SG_ 923 AngleEMEIndicatorAz 0;
BA_ "GenSigTimeoutValue" SG_ 923 AngleEMEIndicatorAz 0;
BA_ "Remark" SG_ 923 AngleEMEIndicatorAz "";
BA_ "EventCommandSignal" SG_ 923 highSpreadIndicator_el 0;
BA_ "GatewayedSignals" SG_ 923 highSpreadIndicator_el 0;
BA_ "GenSigInactiveValue" SG_ 923 highSpreadIndicator_el 0;
BA_ "GenSigInvalidValue" SG_ 923 highSpreadIndicator_el 0;
BA_ "GenSigSendType" SG_ 923 highSpreadIndicator_el 1;
BA_ "GenSigStartValue" SG_ 923 highSpreadIndicator_el 0;
BA_ "GenSigTimeoutValue" SG_ 923 highSpreadIndicator_el 0;
BA_ "Remark" SG_ 923 highSpreadIndicator_el "";
BA_ "EventCommandSignal" SG_ 923 highSpreadIndicator_az 0;
BA_ "GatewayedSignals" SG_ 923 highSpreadIndicator_az 0;
BA_ "GenSigInactiveValue" SG_ 923 highSpreadIndicator_az 0;
BA_ "GenSigInvalidValue" SG_ 923 highSpreadIndicator_az 0;
BA_ "GenSigSendType" SG_ 923 highSpreadIndicator_az 1;
BA_ "GenSigStartValue" SG_ 923 highSpreadIndicator_az 0;
BA_ "GenSigTimeoutValue" SG_ 923 highSpreadIndicator_az 0;
BA_ "Remark" SG_ 923 highSpreadIndicator_az "";
BA_ "EventCommandSignal" SG_ 923 Fault_MAL_HOR_ABS_EVENT 0;
BA_ "GatewayedSignals" SG_ 923 Fault_MAL_HOR_ABS_EVENT 0;
BA_ "GenSigInactiveValue" SG_ 923 Fault_MAL_HOR_ABS_EVENT 0;
BA_ "GenSigInvalidValue" SG_ 923 Fault_MAL_HOR_ABS_EVENT 0;
BA_ "GenSigSendType" SG_ 923 Fault_MAL_HOR_ABS_EVENT 1;
BA_ "GenSigStartValue" SG_ 923 Fault_MAL_HOR_ABS_EVENT 0;
BA_ "GenSigTimeoutValue" SG_ 923 Fault_MAL_HOR_ABS_EVENT 0;
BA_ "Remark" SG_ 923 Fault_MAL_HOR_ABS_EVENT "";
BA_ "EventCommandSignal" SG_ 923 Fault_MAL_HOR_REL_EVENT 0;
BA_ "GatewayedSignals" SG_ 923 Fault_MAL_HOR_REL_EVENT 0;
BA_ "GenSigInactiveValue" SG_ 923 Fault_MAL_HOR_REL_EVENT 0;
BA_ "GenSigInvalidValue" SG_ 923 Fault_MAL_HOR_REL_EVENT 0;
BA_ "GenSigSendType" SG_ 923 Fault_MAL_HOR_REL_EVENT 1;
BA_ "GenSigStartValue" SG_ 923 Fault_MAL_HOR_REL_EVENT 0;
BA_ "GenSigTimeoutValue" SG_ 923 Fault_MAL_HOR_REL_EVENT 0;
BA_ "Remark" SG_ 923 Fault_MAL_HOR_REL_EVENT "";
BA_ "EventCommandSignal" SG_ 923 Fault_MAL_VER_ABS_EVENT 0;
BA_ "GatewayedSignals" SG_ 923 Fault_MAL_VER_ABS_EVENT 0;
BA_ "GenSigInactiveValue" SG_ 923 Fault_MAL_VER_ABS_EVENT 0;
BA_ "GenSigInvalidValue" SG_ 923 Fault_MAL_VER_ABS_EVENT 0;
BA_ "GenSigSendType" SG_ 923 Fault_MAL_VER_ABS_EVENT 1;
BA_ "GenSigStartValue" SG_ 923 Fault_MAL_VER_ABS_EVENT 0;
BA_ "GenSigTimeoutValue" SG_ 923 Fault_MAL_VER_ABS_EVENT 0;
BA_ "Remark" SG_ 923 Fault_MAL_VER_ABS_EVENT "";
BA_ "EventCommandSignal" SG_ 923 Fault_MAL_VER_REL_EVENT 0;
BA_ "GatewayedSignals" SG_ 923 Fault_MAL_VER_REL_EVENT 0;
BA_ "GenSigInactiveValue" SG_ 923 Fault_MAL_VER_REL_EVENT 0;
BA_ "GenSigInvalidValue" SG_ 923 Fault_MAL_VER_REL_EVENT 0;
BA_ "GenSigSendType" SG_ 923 Fault_MAL_VER_REL_EVENT 1;
BA_ "GenSigStartValue" SG_ 923 Fault_MAL_VER_REL_EVENT 0;
BA_ "GenSigTimeoutValue" SG_ 923 Fault_MAL_VER_REL_EVENT 0;
BA_ "Remark" SG_ 923 Fault_MAL_VER_REL_EVENT "";
BA_ "EventCommandSignal" SG_ 923 FilteredPhiSpread 0;
BA_ "GatewayedSignals" SG_ 923 FilteredPhiSpread 0;
BA_ "GenSigInactiveValue" SG_ 923 FilteredPhiSpread 0;
BA_ "GenSigInvalidValue" SG_ 923 FilteredPhiSpread 0;
BA_ "GenSigSendType" SG_ 923 FilteredPhiSpread 1;
BA_ "GenSigStartValue" SG_ 923 FilteredPhiSpread 0;
BA_ "GenSigTimeoutValue" SG_ 923 FilteredPhiSpread 0;
BA_ "Remark" SG_ 923 FilteredPhiSpread "";
BA_ "EventCommandSignal" SG_ 923 elOutOfSpecCause 0;
BA_ "GatewayedSignals" SG_ 923 elOutOfSpecCause 0;
BA_ "GenSigInactiveValue" SG_ 923 elOutOfSpecCause 0;
BA_ "GenSigInvalidValue" SG_ 923 elOutOfSpecCause 0;
BA_ "GenSigSendType" SG_ 923 elOutOfSpecCause 1;
BA_ "GenSigStartValue" SG_ 923 elOutOfSpecCause 0;
BA_ "GenSigTimeoutValue" SG_ 923 elOutOfSpecCause 0;
BA_ "Remark" SG_ 923 elOutOfSpecCause "";
BA_ "EventCommandSignal" SG_ 923 azOutOfSpecCause 0;
BA_ "GatewayedSignals" SG_ 923 azOutOfSpecCause 0;
BA_ "GenSigInactiveValue" SG_ 923 azOutOfSpecCause 0;
BA_ "GenSigInvalidValue" SG_ 923 azOutOfSpecCause 0;
BA_ "GenSigSendType" SG_ 923 azOutOfSpecCause 1;
BA_ "GenSigStartValue" SG_ 923 azOutOfSpecCause 0;
BA_ "GenSigTimeoutValue" SG_ 923 azOutOfSpecCause 0;
BA_ "Remark" SG_ 923 azOutOfSpecCause "";
BA_ "EventCommandSignal" SG_ 923 azOutOfProfileCause 0;
BA_ "GatewayedSignals" SG_ 923 azOutOfProfileCause 0;
BA_ "GenSigInactiveValue" SG_ 923 azOutOfProfileCause 0;
BA_ "GenSigInvalidValue" SG_ 923 azOutOfProfileCause 0;
BA_ "GenSigSendType" SG_ 923 azOutOfProfileCause 1;
BA_ "GenSigStartValue" SG_ 923 azOutOfProfileCause 0;
BA_ "GenSigTimeoutValue" SG_ 923 azOutOfProfileCause 0;
BA_ "Remark" SG_ 923 azOutOfProfileCause "";
BA_ "EventCommandSignal" SG_ 923 elOutOfProfileCause 0;
BA_ "GatewayedSignals" SG_ 923 elOutOfProfileCause 0;
BA_ "GenSigInactiveValue" SG_ 923 elOutOfProfileCause 0;
BA_ "GenSigInvalidValue" SG_ 923 elOutOfProfileCause 0;
BA_ "GenSigSendType" SG_ 923 elOutOfProfileCause 1;
BA_ "GenSigStartValue" SG_ 923 elOutOfProfileCause 0;
BA_ "GenSigTimeoutValue" SG_ 923 elOutOfProfileCause 0;
BA_ "Remark" SG_ 923 elOutOfProfileCause "";
BA_ "EventCommandSignal" SG_ 923 Reserved1 0;
BA_ "GatewayedSignals" SG_ 923 Reserved1 0;
BA_ "GenSigInactiveValue" SG_ 923 Reserved1 0;
BA_ "GenSigInvalidValue" SG_ 923 Reserved1 0;
BA_ "GenSigSendType" SG_ 923 Reserved1 1;
BA_ "GenSigStartValue" SG_ 923 Reserved1 0;
BA_ "GenSigTimeoutValue" SG_ 923 Reserved1 0;
BA_ "Remark" SG_ 923 Reserved1 "";
VAL_ 419 ADC_AngReqSt_A 0 "Inhibited" 1 "Ready" 2 "Active" 3 "Failed"  ;
VAL_ 419 ADC_AngReqFunction 0 "No request" 1 "Request by LKAS" 2 "Request by PAS" 3 "Reserved"  ;
VAL_ 419 ADC_BrakeLightReq 0 "No Request" 1 "turn on" 2 "turn off"  ;
VAL_ 419 ADC_AssistParaSwitchReq 0 "No request" 1 "Request"  ;
VAL_ 419 ADC_AngReqRdntReq_A 0 "No request" 1 "Request"  ;
VAL_ 419 ADC_SteerGainReq 0 "No request" 1 "Request"  ;
VAL_ 419 ADC_StrgWhlVibrWarnLevel 0 "No request" 1 "Request level 1" 2 "Request level 2" 3 "Request level 3"  ;
VAL_ 419 ADC_ActTrqReqEnable 0 "Disable" 1 "Enable"  ;
VAL_ 419 ADC_VLCSt 0 "VLC not working" 1 "VLC Override possible" 2 "VLC Override impossible" 3 "Reserve"  ;
VAL_ 419 ADC_EvsSteerReq 0 "No request" 1 "Request"  ;
VAL_ 419 ADC_StrgWhlVibrWarnReq 0 "No request" 1 "Request"  ;
VAL_ 419 IFC_DPTst 0 "None" 1 "DrivingTransporting" 2 "ParkingTransporting" 3 "DrivingSignFailed" 4 "ParkingSignFailed" 5 "Failed"  ;
VAL_ 419 ADC_DrvTarTqMod2EPB 0 "Override mode" 1 "Inhibit mode" 2 "reserved" 3 "reserved"  ;
VAL_ 419 ADC_ADASLongCtrlFuncMode 0 "Cruise" 1 "APA" 2 "Reserve" 3 "Reserve" 4 "Reserve" 5 "Reserve" 6 "Reserve" 7 "Reserve"  ;
VAL_ 419 ADC_LongCtrlAvailability 0 "Not available" 1 "Available"  ;
VAL_ 419 ADC_LongCtrlModeForBrkSys 0 "Off mode" 1 "L2 Active" 2 "L2++ Active" 3 "Not used" 4 "Not used" 5 "Not used" 6 "Not used" 7 "Not used"  ;
VAL_ 419 ADC_LongCtrlTargetAxReq 0 "No request" 1 "Request"  ;
VAL_ 419 ADC_LongCtrlTypReq 0 "Comfort Mode" 1 "Emergency Mode"  ;
VAL_ 419 ADC_LongCtrlDecToStopReq 0 "No request" 1 "Request"  ;
VAL_ 419 ADC_LongCtrlDriveOff 0 "No request" 1 "Request"  ;
VAL_ 419 ADC_LongctrlSecureReq 0 "NoRequest" 1 "Request"  ;
VAL_ 419 ADC_ShifttoAVHReq 0 "Not active" 1 "Active"  ;
VAL_ 419 ADC_TrkTargt0St 0 "not dectected" 1 "dectected"  ;
VAL_ 419 ADC_AS_pauseReq 0 "No request" 1 "request"  ;
VAL_ 419 ADC_AS_calibrationReq 0 "Invalid" 1 "Request to Very high level" 2 "Request to High level" 3 "Request to Normal level" 4 "Request to Low level" 5 "Request to Very low level"  ;
VAL_ 419 ADC_AS_exitcurrentlevelReq 0 "No request" 1 "request"  ;
VAL_ 419 ADC_AS_ReqToadjust 0 "Invalid" 1 "PAS Request to Very high level" 2 "PAS Request to High level" 3 "PAS Request to Normal level" 4 "PAS Request to Low level" 5 "PAS Request to Very low level"  ;
VAL_ 419 ADC_ASActiveSt 0 "Not Active" 1 "Active"  ;
VAL_ 419 ADC_AS_UnsafelevelunableReq 0 "No request" 1 "request"  ;
VAL_ 419 ADC_FcsActiveStatus 0 "No Active" 1 "Active"  ;
VAL_ 419 ADC_ComfstopReq 0 "Turn Off" 1 "Turn On"  ;
VAL_ 419 ADC_CSM_HoldReq 0 "No request" 1 "Request"  ;
VAL_ 419 ADC_AEBFaultSt 0 "Not fault" 1 "Fault"  ;
VAL_ 419 ADC_AEBOffSt 0 "On" 1 "Off"  ;
VAL_ 419 ADC_AEBInterventionSt 0 "No intervention" 1 "Intervention"  ;
VAL_ 419 ADC_AEBDecelCtrlReq 0 "No request" 1 "Request"  ;
VAL_ 419 ADC_AEBLVehHoldReq 0 "No request" 1 "Request"  ;
VAL_ 419 ADC_ABAReq 0 "No request" 1 "Request"  ;
VAL_ 419 ADC_ABALevel 0 "Level 0" 1 "Level 1" 2 "Level 2" 3 "Level 3"  ;
VAL_ 419 ADC_AWBReq 0 "No request" 1 "Request"  ;
VAL_ 419 ADC_ABPReq 0 "No request" 1 "Request"  ;
VAL_ 419 ADC_AWBLevel 0 "No level" 1 "Level 1" 2 "Level 2" 3 "Level 3" 4 "Level 4" 5 "Not used" 6 "Not used" 7 "Not used"  ;
VAL_ 419 ADC_AEBTarCalss 0 "Not dectected" 1 "Car" 2 "Pedestrian" 3 "Two wheels" 4 "Motorcycle" 5 "Truck" 6 "Unknown" 7 "Reserve"  ;
VAL_ 419 ADC_AEBTarDetSensor 0 "Invalid" 1 "Not Fusion" 2 "Not used" 3 "Fusion"  ;
VAL_ 419 ADC_TurnLightReq 0 "No Request" 1 "turn off" 2 "turn on left turn lamp" 3 "turn on right turn lamp" 4 "turn on Hazard Lamp" 5 "turn on RCW Hazard Lamp(4HZ)"  ;
VAL_ 419 ADC_PAA2ESPAxReqEnable 0 "Flase" 1 "True"  ;
VAL_ 419 ADC_PAA2ESPBrakeFunctionMode 0 "None" 1 "APA" 2 "RPA" 3 "AVP" 4 "Dynamic AVP"  ;
VAL_ 419 ADC_PAA2ESPEpbReq 0 "None" 1 "ReleaseReq" 2 "ApplyReq"  ;
VAL_ 419 ADC_PAA2EPBEpbReq 0 "None" 1 "ReleaseReq" 2 "ApplyReq" 3 "RWUReq"  ;
VAL_ 419 ADC_PAA2ESPEpbReqSt 0 "No request" 1 "Request"  ;
VAL_ 419 ADC_PAA2ESPComfBrakeReq 0 "ComfBrakeReq_NoReq" 1 "ComfBrakeReq_Type1" 2 "ComfBrakeReq_Type2"  ;
VAL_ 419 ADC_ESPSwitchReq 0 "Not Request" 1 "Request"  ;
VAL_ 419 ADC_PAA2EPBEpbReqSt 0 "No request" 1 "Request"  ;
VAL_ 419 ADC_PAA2EPBBrakeFunctionMode 0 "Not active" 1 "Active"  ;
VAL_ 419 ADC_PAA2ESPApEmgyBrkReq 0 "Flase" 1 "True"  ;
VAL_ 419 ADC_PAA2ESPApDriveOffReq 0 "Flase" 1 "True"  ;
VAL_ 419 ADC_PAA2ESPApStandstillReq 0 "Flase" 1 "True"  ;
VAL_ 419 ADC_PAA2ESPApPrefillReq 0 "Flase" 1 "True"  ;
VAL_ 419 ADC_EPBReq 0 "Not Request" 1 "Request"  ;
VAL_ 419 ADC_ActTrqReqVD 0 "invalid" 1 "valid"  ;
VAL_ 419 ADC_TarGearReqVld 0 "Invalid" 1 "Valid"  ;
VAL_ 419 ADC_FctSts 0 "Off" 1 "On"  ;
VAL_ 419 ADC_VehTorqLimitEnable 0 "Not enable" 1 "Enable"  ;
VAL_ 419 ADC_VehTorqReqEnable 0 "Not enable" 1 "Enable"  ;
VAL_ 419 ADC_PAAPwrModeReq 0 "No Request" 1 "Power On Request (PTready)"  ;
VAL_ 419 ADC_PAAGrarLvlReq 0 "No Request" 1 "Park" 2 "Reversed" 3 "Neutral" 4 "Drive" 5 "Reversed" 6 "Reversed" 7 "Reversed"  ;
VAL_ 419 ADC_PAAGrarLvlReqEnable 0 "No request" 1 "Gear shift request"  ;
VAL_ 419 ADC_ACCMode_C 0 "Failure" 1 "Passive mode" 2 "Standby mode" 3 "Active control mode" 4 "Brake only mode" 5 "Override" 6 "Standwait" 7 "Standactive" 8 "Not used" 9 "Not used" 10 "Not used" 11 "Not used" 12 "Not used" 13 "Not used" 14 "Not used" 15 "Not used"  ;
VAL_ 419 ADC_RCTBBrkReq 0 "No request" 1 "Request"  ;
VAL_ 419 ADC_BrkTarTqEna 0 "disable" 1 "enable"  ;
VAL_ 419 ADC_BrkTarTqMod 0 "no request" 1 "Cruise function" 2 "Parking function" 3 "Reserved"  ;
VAL_ 419 ADC_EpbModReqVld 0 "Invalid" 1 "Valid"  ;
VAL_ 419 ADC_RWUEna 0 "disable" 1 "enable"  ;
VAL_ 419 ADC_BrkHoldReq 0 "No request" 1 "Not active" 2 "Active" 3 "Reserved"  ;
VAL_ 419 ADC_AngReqAvl 0 "Not available" 1 "Available"  ;
VAL_ 419 ADC_BrkTarTqVld 0 "Invalid" 1 "Valid"  ;
VAL_ 419 ADC_AebBrkTarTqVld 0 "Invalid" 1 "Valid"  ;
VAL_ 419 ADC_AebBrkTarTqEna 0 "disable" 1 "enable"  ;
VAL_ 419 ADC_ElecBrkFnSwitch 0 "ON" 1 "OFF"  ;
VAL_ 419 ADC_RWUVld 0 "Invalid" 1 "Valid"  ;
VAL_ 419 ADC_DriverPresent 0 "Undefined" 1 "Driver  Not Present" 2 "Driver  Present" 3 "Failure"  ;
VAL_ 659 ADC_NDASt 0 "NDA disable" 1 "NDA passive" 2 "NDA standby normal" 3 "Not used" 4 "NDA active normal" 5 "Not used" 6 "NDA active standwait" 7 "Not used" 8 "NDA active standactive" 9 "BOM" 10 "Not used" 11 "NDA Lat-Override" 12 "NDA Lng-Override" 13 "Not used" 14 "NDA Lat&Lng Override" 15 "Not used" 16 "Not used" 17 "Not used" 18 "NDA MRM Emergency Lane with Lat-control" 19 "NDA MRM Emergency Lane with Lat&Lng-control" 20 "NDA MRM Ego Lane  with Lat-control" 21 "NDA MRM Ego Lane  with Lat&Lng-control" 22 "Not used" 23 "Not used" 24 "NDA MRC" 25 "NDA failure light" 26 "Not used" 27 "Not used" 28 "Not used" 29 "Not used" 30 "Not used" 31 "Not used" 32 "Not used" 33 "Not used" 34 "Not used" 35 "Not used" 36 "Not used" 37 "Not used" 38 "Not used" 39 "Not used" 40 "Not used" 41 "Not used" 42 "Not used" 43 "Not used" 44 "Not used" 45 "Not used" 46 "Not used" 47 "Not used" 48 "Not used" 49 "Not used" 50 "Not used" 51 "Not used" 52 "Not used" 53 "Not used" 54 "Not used" 55 "Not used" 56 "Not used" 57 "Not used" 58 "Not used" 59 "Not used" 60 "Not used" 61 "Not used" 62 "Not used" 63 "Not used"  ;
VAL_ 659 ADC_NDATORType 0 "No TakeOver" 1 "Driver Brake" 2 "Driver Brake for long time" 3 "Driver Override Steering" 4 "Driver Alert and Override Accele" 5 "Driver fatiger hands on and Override Accele" 6 "Driver Alert and Hands On" 7 "Hands On and Override Accele" 8 "Hands On" 9 "Hands On and Brake" 10 "AD Normal Red Hand" 11 "AD Release Acc Pedal" 12 "AD Brake Pedal" 13 "AD MRM Red Hand" 14 "AD MRM Yellow Hand" 15 "Invalid"  ;
VAL_ 659 ADC_NDADecideResult 0 "No" 1 "Current Lane Cruise" 2 "Lane Bias" 3 "Lane End Lane Change" 4 "Static Obstacle Lane Change" 5 "Y Crossing Lane Change" 6 "Navigation LC to best merge lane" 7 "Navigation LC to best lane main road" 8 "Navigation LC to fast lane main road" 9 "Navigation LC to slow lane main road" 10 "Overtaking Lane Change" 11 "Tunnel not pass lane change" 12 "Enter Ramp Prepare Lane Change" 13 "Indicated Lane Change" 14 "Delta under 30 Defensive LC" 15 "Delta exceed 30 Defensive LC" 16 "Parallel Split" 17 "Direct Split" 18 "Parallel Merge" 19 "Direct Merge"  ;
VAL_ 659 ADC_NDATargetLane 0 "Ego Lane" 1 "ChangeLeft" 2 "ChangeRight" 3 "SplitLeft" 4 "SplitRight" 5 "MergeLeft" 6 "MergeRight" 7 "Not Used"  ;
VAL_ 659 ADC_NDASplitSt 0 "No Split/Merge" 1 "Split" 2 "Merge" 3 "Not used" 4 "Not used" 5 "Not used" 6 "Not used" 7 "Not used"  ;
VAL_ 659 ADC_NDALaneChangeOverlineTOR 0 "No request" 1 "Request"  ;
VAL_ 659 ADC_ALCSuspendReason 0 "No" 1 "Lane marking" 2 "Driver cancel by turn lever" 3 "Driver override" 4 "Target lane encounter high priority lane change" 5 "GAP not available" 6 "Safety Check" 7 "Not Used" 8 "Not Used" 9 "Not Used" 10 "Not Used" 11 "Not Used" 12 "Not Used" 13 "Not Used" 14 "Not Used" 15 "Not Used"  ;
VAL_ 659 ADC_SplitSuspendReason 0 "No" 1 "Lane marking" 2 "Driver trigger turn lever opposite" 3 "Driver override" 4 "Target lane encounter high priority lane change" 5 "GAP not available" 6 "Exceed the Terminal point" 7 "Safety Check" 8 "Not Used" 9 "Not Used" 10 "Not Used" 11 "Not Used" 12 "Not Used" 13 "Not Used" 14 "Not Used" 15 "Not Used"  ;
VAL_ 659 ADC_NDAEnableSt 0 "Disable" 1 "Enable"  ;
VAL_ 659 ADC_NDAFailureReason 0 "No Failure" 1 "NDA Sensor Failure" 2 "NDA IFC Failure" 3 "NDA ADC Failure" 4 "Parking Sensor Failure" 5 "CCU failure" 6 "IMU-6D failure" 7 "SRS failure" 8 "Tbox failure" 9 "EPS1 failure" 10 "EPS2 failure" 11 "EBB failure" 12 "ESC failure" 13 "VCU and relevate system failure" 14 "BCM failure" 15 "DMS failure" 16 "HOD failure" 17 "ICM failure" 18 "ACU failure" 19 "A-CAN failure" 20 "I-CAN failure" 21 "IMU-ETH failure" 22 "IHU-ETH failure" 23 "TBOX-ETH failure" 24 "Power Supply failure" 25 "Hard Button failure"  ;
VAL_ 659 ADC_NDANotactivereason 0 "Meet" 1 "NDA _System Failure" 2 "ODD not meet" 3 "Driver condition not meet" 4 "Vehicle condition not meet" 5 "Driver braking" 6 "Driver lng override" 7 "Driver lat override" 8 "Phase-in not meet" 9 "Collosion" 10 "Navigation" 11 "Software Switch" 12 "Hardware Switch" 13 "TSM deactive"  ;
VAL_ 659 ADC_NDAGeoFence 0 "Not in Geo-fence" 1 "Hands On Geo-fence" 2 "Hands Free Geo-fence" 3 "Not Used"  ;
VAL_ 659 ADC_NDAODDnotMeetreason 0 "Meet" 1 "Geo-fence" 2 "Road Condition" 3 "Weather condition" 4 "Light condition"  ;
VAL_ 659 ADC_RaebWarning 0 "no request" 1 "RAEB Warning" 2 "RAEB Brake Active" 3 "Hold" 4 "PMA Active" 5 "Reserved" 6 "Reserved" 7 "Reserved"  ;
VAL_ 659 ADC_ICAAvailableState 0 "Not Available" 1 "Available"  ;
VAL_ 659 ADC_ACCAvailableState 0 "Not Available" 1 "Available"  ;
VAL_ 659 ADC_NDARouteReplanning 0 "No" 1 "Replanning"  ;
VAL_ 659 ADC_SpeedLimitConfirmRequest 0 "No Request" 1 "Request"  ;
VAL_ 659 ADC_LaneChangeType 0 "No Lane Change" 1 "Lane_Lost Lane Change" 2 "Avoid Obstacle Lane Change" 3 "Driver_TurnLever Lane Change" 4 "Aviod Merge or Split Zone Lane Change" 5 "Other Lane Change Type" 6 "Not used" 7 "Effective Lane Change" 8 "Not used" 9 "Construction Zone Lane Change" 10 "Fast Lane Lane Change" 11 "Navigation LC" 12 "Not used" 13 "Not used" 14 "Not used" 15 "Not used" 16 "Not used" 17 "Not used" 18 "Not used" 19 "Not used" 20 "Not used" 21 "Not used" 22 "Not used" 23 "Not used" 24 "Not used" 25 "Not used" 26 "Not used" 27 "Not used" 28 "Not used" 29 "Not used" 30 "Not used" 31 "Not used"  ;
VAL_ 659 ADC_LC_ZoneMatching 0 "No display" 1 "Accelerate search" 2 "Decelerate search" 3 "Not used"  ;
VAL_ 659 ADC_RoadMergeSplitType 0 "No" 1 "Direct Spli" 2 "Parallel Split" 3 "Connect Split" 4 "Left Direct and Right Connect Split" 5 "Left Direct and Right Parallel Split" 6 "Left Parallel and Right Direct Split" 7 "Left Connect and Right Direct Split" 8 "Parallel Merge" 9 "Direct Merge" 10 "Connect Merge" 11 "Left and Right Direct Merge" 12 "Left Direct and Right Parallel Merge" 13 "Left Connect and Right Parallel Merge" 14 "Left and Right Connect Merge"  ;
VAL_ 659 ADC_LaneMergeSplitType 0 "No" 1 "Direct Spli" 2 "Parallel Split" 3 "Connect Split" 4 "Parallel Merge" 5 "Direct Merge" 6 "Connect Merge"  ;
VAL_ 659 ADC_EyesOn_Warning 0 "No request" 1 "Level  1" 2 "Level  2" 3 "Level 3" 4 "Not Used" 5 "Not Used" 6 "Not Used" 7 "Not Used"  ;
VAL_ 659 ADC_TakeOverType 0 "No request" 1 "STOR" 2 "LLTOR" 3 "Not Used" 4 "Not Used" 5 "Not Used" 6 "Not Used" 7 "Not Used"  ;
VAL_ 659 ADC_TakeOverWarningLevel 0 "No request" 1 "Level  1" 2 "Level  2" 3 "Level 3" 4 "Not Used" 5 "Not Used" 6 "Not Used" 7 "Not Used"  ;
VAL_ 659 ADC_NDAMRMWarningLevel 0 "No request" 1 "Level  1" 2 "Level  2" 3 "Level 3" 4 "Not Used" 5 "Not Used" 6 "Not Used" 7 "Not Used"  ;
VAL_ 659 ADC_FuncReq_SentryModWarn 0 "OFF" 1 "SentryModeWake"  ;
VAL_ 659 ADC_ADASTransitionType 0 "no" 1 "ACC to NDA" 2 "ACC to ICA" 3 "ICA to NDA" 4 "NDA to ACC" 5 "ICA to ACC" 6 "NDA to ICA"  ;
VAL_ 659 ADC_TlaWarning 0 "no request" 1 "No Warning" 2 "Red Light Warning" 3 "Start Warning" 4 "Reserved" 5 "Reserved" 6 "Reserved" 7 "Invalid"  ;
VAL_ 659 ADC_TlaFault 0 "no request" 1 "No fault" 2 "Fault" 3 "Invalid"  ;
VAL_ 659 ADC_FcwWaning 0 "no request" 1 "Off" 2 "Standby" 3 "Active_level1" 4 "Active_level2" 5 "Nolicense" 6 "Reserved" 7 "Invalid"  ;
VAL_ 659 ADC_AebFault 0 "no request" 1 "no fault" 2 "fault" 3 "Invalid"  ;
VAL_ 659 ADC_RaebFault 0 "no request" 1 "No fault" 2 "Fault" 3 "Invalid"  ;
VAL_ 659 ADC_RcwFault 0 "no request" 1 "No fault" 2 "Fault" 3 "Invalid"  ;
VAL_ 659 ADC_FctbLeftWarning 0 "no request" 1 "Off" 2 "Active_Left" 3 "IBA" 4 "Hold" 5 "inactive (standby)" 6 "Nolicense" 7 "Invalid"  ;
VAL_ 659 ADC_FctbRightWarning 0 "no request" 1 "Off" 2 "Active_Right" 3 "IBA" 4 "Hold" 5 "inactive (standby)" 6 "Nolicense" 7 "Invalid"  ;
VAL_ 659 ADC_RctaFault 0 "no request" 1 "No fault" 2 "Fault" 3 "Invalid"  ;
VAL_ 659 ADC_RctbLeftWarning 0 "no request" 1 "Off" 2 "Active_Left" 3 "Hold" 4 "Inactive (Standby)" 5 "Nolicense" 6 "Reserved" 7 "Invalid"  ;
VAL_ 659 ADC_RctbRightWarning 0 "no request" 1 "Off" 2 "Active_Right" 3 "Hold" 4 "Inactive (Standby)" 5 "Nolicense" 6 "Reserved" 7 "Invalid"  ;
VAL_ 659 ADC_LdwFault 0 "no request" 1 "No fault" 2 "Fault" 3 "Invalid"  ;
VAL_ 659 ADC_LkaFault 0 "no request" 1 "No fault" 2 "Fault" 3 "Invalid"  ;
VAL_ 659 ADC_BsdFault 0 "no request" 1 "No fault" 2 "Fault" 3 "Invalid"  ;
VAL_ 659 ADC_DowFault 0 "no request" 1 "No fault" 2 "Fault" 3 "Invalid"  ;
VAL_ 659 ADC_TsrFault 0 "no request" 1 "No fault" 2 "Fault" 3 "Invalid"  ;
VAL_ 659 ADC_ElkaWarning 0 "no request" 1 "Off" 2 "Standby" 3 "Ready" 4 "Active_Left" 5 "Active_Right" 6 "Switchoff" 7 "Invalid"  ;
VAL_ 659 ADC_ElkaFault 0 "no request" 1 "No fault" 2 "Fault" 3 "Invalid"  ;
VAL_ 659 ADC_IMUTimestampVld 0 "Invalid" 1 "Valid"  ;
VAL_ 659 ADC_IMUAccVld 0 "Invalid" 1 "Valid"  ;
VAL_ 659 ADC_IMUGyroVld 0 "Invalid" 1 "Valid"  ;
VAL_ 659 ADC_IMUAttitudeVld 0 "Invalid" 1 "Valid"  ;
VAL_ 659 ADC_IMUPositionType 0 "No?Solution" 1 "Gnss" 2 "RTK" 3 "Resersed" 4 "Resersed" 5 "Resersed" 6 "Resersed" 7 "Resersed" 8 "Resersed" 9 "Resersed" 10 "Resersed" 11 "Resersed" 12 "Resersed" 13 "Resersed" 14 "Resersed" 15 "Resersed"  ;
VAL_ 923 ADC_FrontWideCameraSt 0 "No Failure" 1 "Failure" 2 "Blockage" 3 "Calibration failed" 4 "Angle not meet"  ;
VAL_ 923 ADC_FrontNarrowCameraSt 0 "No Failure" 1 "Failure" 2 "Blockage" 3 "Calibration failed" 4 "Angle not meet"  ;
VAL_ 923 ADC_LeftFrontCameraSt 0 "No Failure" 1 "Failure" 2 "Blockage" 3 "Calibration failed" 4 "Angle not meet"  ;
VAL_ 923 ADC_LeftRearCameraSt 0 "No Failure" 1 "Failure" 2 "Blockage" 3 "Calibration failed" 4 "Angle not meet"  ;
VAL_ 923 ADC_RightFrontCameraSt 0 "No Failure" 1 "Failure" 2 "Blockage" 3 "Calibration failed" 4 "Angle not meet"  ;
VAL_ 923 ADC_RightRearCameraSt 0 "No Failure" 1 "Failure" 2 "Blockage" 3 "Calibration failed" 4 "Angle not meet"  ;
VAL_ 923 ADC_RearCameraSt 0 "No Failure" 1 "Failure" 2 "Blockage" 3 "Calibration failed" 4 "Angle not meet"  ;
VAL_ 923 ADC_FrontRadarSt 0 "No Failure" 1 "Failure" 2 "Blockage" 3 "Calibration failed" 4 "Angle not meet"  ;
VAL_ 923 ADC_LeftFrontRadarSt 0 "No Failure" 1 "Failure" 2 "Blockage" 3 "Calibration failed" 4 "Angle not meet"  ;
VAL_ 923 ADC_LeftRearRadarSt 0 "No Failure" 1 "Failure" 2 "Blockage" 3 "Calibration failed" 4 "Angle not meet"  ;
VAL_ 923 ADC_RightFrontRadarSt 0 "No Failure" 1 "Failure" 2 "Blockage" 3 "Calibration failed" 4 "Angle not meet"  ;
VAL_ 923 ADC_RightRearRadarSt 0 "No Failure" 1 "Failure" 2 "Blockage" 3 "Calibration failed" 4 "Angle not meet"  ;
VAL_ 923 ADC_RearRadarSt 0 "No Failure" 1 "Failure" 2 "Blockage" 3 "Calibration failed" 4 "Angle not meet"  ;
VAL_ 923 ADC_FrontLidarSt 0 "No Failure" 1 "Failure" 2 "Blockage" 3 "Calibration failed" 4 "Angle not meet"  ;
VAL_ 923 ADC_LeftLidarSt 0 "No Failure" 1 "Failure" 2 "Blockage" 3 "Calibration failed" 4 "Angle not meet"  ;
VAL_ 923 ADC_RightLidarSt 0 "No Failure" 1 "Failure" 2 "Blockage" 3 "Calibration failed" 4 "Angle not meet"  ;
VAL_ 923 ADC_SunroofOpenCloseReq 0 "No request" 1 "Request close sunroof" 2 "Request open sunroof" 3 "Not used"  ;
VAL_ 923 ADC_SentryStatus 0 "OFF" 1 "Standby" 2 "Warn" 3 "Alarm"  ;
VAL_ 923 ADC_SOCWakeupHVReq 0 "No Request" 1 "Request"  ;
VAL_ 923 ADC_SystemState 0 "DeepSleep" 1 "LightSleep" 2 "Active" 3 "PartialActive" 4 "Reserved" 5 "Reserved" 6 "Reserved" 7 "Reserved" 8 "Reserved" 9 "Reserved" 10 "Reserved" 11 "Reserved" 12 "Reserved" 13 "Reserved" 14 "Reserved" 15 "Invalid"  ;
VAL_ 923 ADC_FuncReq_SentryModDetec 0 "OFF" 1 "SentryModeKeep"  ;
VAL_ 923 ADC_HWFailureReason 0 "No Failure" 1 "SOC Failure" 2 "MCU Failure" 3 "Others Failure" 4 "Not Used" 5 "Not Used" 6 "Not Used" 7 "Not Used"  ;
VAL_ 923 ADC_SWFailureReason 0 "No Failure" 1 "perception failure" 2 "Localization Fusion" 3 "EHP" 4 "Control" 5 "Automation" 6 "OTA" 7 "Calibration module" 8 "Data module" 9 "TSM" 10 "CID" 11 "Not Used" 12 "Not Used" 13 "Not Used" 14 "Not Used" 15 "Not Used" 16 "Not Used" 17 "Not Used" 18 "Not Used" 19 "Not Used" 20 "Not Used" 21 "Not Used" 22 "Not Used" 23 "Not Used" 24 "Not Used" 25 "Not Used" 26 "Not Used" 27 "Not Used" 28 "Not Used" 29 "Not Used" 30 "Not Used" 31 "Not Used"  ;
VAL_ 923 Fault_MAL_HOR_ABS_EVENT 0 "Not Fault" 1 "Fault"  ;
VAL_ 923 Fault_MAL_HOR_REL_EVENT 0 "Not Fault" 1 "Fault"  ;
VAL_ 923 Fault_MAL_VER_ABS_EVENT 0 "Not Fault" 1 "Fault"  ;
VAL_ 923 Fault_MAL_VER_REL_EVENT 0 "Not Fault" 1 "Fault"  ;
VAL_ 923 elOutOfSpecCause 0 "No Out" 1 "Out" 0 "No Out" 1 "Out"  ;
VAL_ 923 azOutOfSpecCause 0 "No Out" 1 "Out" 0 "No Out" 1 "Out"  ;
VAL_ 923 azOutOfProfileCause 0 "No Out" 1 "Out"  ;
VAL_ 923 elOutOfProfileCause 0 "No Out" 1 "Out"  ;
