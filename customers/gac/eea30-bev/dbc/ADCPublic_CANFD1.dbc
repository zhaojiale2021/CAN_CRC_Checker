VERSION "Version"

NS_ :

BS_:

BU_: CCU ADC FAPA IFC FLR FRR RRR RLR INU Tester CBM VIU SRS IDC PCS AMP IMR FIMR TBOX IBCS IXCU V2XOBU WHUD RLBMS CCURT2 RT2_C3 OTAWL ZCUF ZCUL ZCUR ZCUT IPS DCU NIDU RBM WACUFL IID CCURT1 RT1_C0 RT1_C1 AVAS FLLCM FRLCM RLLCMA RRLCMA RLLCMB RRLCMB LBMS LBMSAD MFS FCP IDU ITS BCB DCDC PCU EOP DCU2 BMS TMC EPS ECS CD PAS SBM WCM ETC TBOX2 DSM FLPDM FRPDM RLPDM RRPDM HVSMR SCMRL SCMRR EBU EPB VDC EVCC ADM PLGM FBLCM RLISD RRISD RCP RFR WCMFR SCMR TFOAR TROAR HVSPRL HVSPRR

BO_ 970 ADC_15: 64 ADC
 SG_ ADC_ParkRelPos3_y4 : 377|10@0+ (0.1,-50) [-50|50] "m"  CCU
 SG_ ADC_ParkRelPos4_x1 : 399|10@0+ (0.1,-50) [-50|50] "m"  CCU
 SG_ ADC_ParkRelPos4_y1 : 405|10@0+ (0.1,-50) [-50|50] "m"  CCU
 SG_ ADC_ParkRelPos4_x2 : 411|10@0+ (0.1,-50) [-50|50] "m"  CCU
 SG_ ADC_ParkRelPos4_y2 : 417|10@0+ (0.1,-50) [-50|50] "m"  CCU
 SG_ ADC_ParkRelPos4_x3 : 439|10@0+ (0.1,-50) [-50|50] "m"  CCU
 SG_ ADC_ParkRelPos4_y3 : 445|10@0+ (0.1,-50) [-50|50] "m"  CCU
 SG_ ADC_ParkRelPos4_x4 : 451|10@0+ (0.1,-50) [-50|50] "m"  CCU
 SG_ ADC_ParkRelPos4_y4 : 457|10@0+ (0.1,-50) [-50|50] "m"  CCU

BO_ 971 ADC_16: 64 ADC
 SG_ ADC_MnvrOrintChng6 : 31|2@0+ (1,0) [0|3] ""  CCU
 SG_ ADC_TarParkSt_Posn6 : 29|3@0+ (1,0) [0|7] ""  CCU
 SG_ ADC_ParkChkSrc_Posn6 : 26|3@0+ (1,0) [0|3] ""  CCU
 SG_ ADC_ParkPosn7_ID : 39|4@0+ (1,0) [0|15] ""  CCU
 SG_ ADC_MnvrOrintChng7 : 35|2@0+ (1,0) [0|3] ""  CCU
 SG_ ADC_TarParkSt_Posn7 : 33|3@0+ (1,0) [0|7] ""  CCU
 SG_ ADC_ParkChkSrc_Posn7 : 46|3@0+ (1,0) [0|3] ""  CCU
 SG_ ADC_ParkPosn8_ID : 43|4@0+ (1,0) [0|15] ""  CCU
 SG_ ADC_MnvrOrintChng8 : 55|2@0+ (1,0) [0|3] ""  CCU
 SG_ ADC_TarParkSt_Posn8 : 53|3@0+ (1,0) [0|7] ""  CCU
 SG_ ADC_ParkChkSrc_Posn8 : 50|3@0+ (1,0) [0|3] ""  CCU
 SG_ ADC_ParkRelPos5_x1 : 63|10@0+ (0.1,-50) [-50|50] "m"  CCU
 SG_ ADC_ParkRelPos5_y1 : 69|10@0+ (0.1,-50) [-50|50] "m"  CCU
 SG_ ADC_ParkRelPos5_x2 : 75|10@0+ (0.1,-50) [-50|50] "m"  CCU
 SG_ ADC_ParkRelPos5_y2 : 81|10@0+ (0.1,-50) [-50|50] "m"  CCU
 SG_ ADC_ParkRelPos5_x3 : 103|10@0+ (0.1,-50) [-50|50] "m"  CCU
 SG_ ADC_ParkRelPos5_y3 : 109|10@0+ (0.1,-50) [-50|50] "m"  CCU
 SG_ ADC_ParkRelPos5_x4 : 115|10@0+ (0.1,-50) [-50|50] "m"  CCU
 SG_ ADC_ParkRelPos5_y4 : 121|10@0+ (0.1,-50) [-50|50] "m"  CCU
 SG_ ADC_ParkRelPos6_x1 : 143|10@0+ (0.1,-50) [-50|50] "m"  CCU
 SG_ ADC_ParkRelPos6_y1 : 149|10@0+ (0.1,-50) [-50|50] "m"  CCU
 SG_ ADC_ParkRelPos6_x2 : 155|10@0+ (0.1,-50) [-50|50] "m"  CCU
 SG_ ADC_ParkRelPos6_y2 : 161|10@0+ (0.1,-50) [-50|50] "m"  CCU
 SG_ ADC_ParkRelPos6_x3 : 183|10@0+ (0.1,-50) [-50|50] "m"  CCU
 SG_ ADC_ParkRelPos6_y3 : 189|10@0+ (0.1,-50) [-50|50] "m"  CCU
 SG_ ADC_ParkRelPos6_x4 : 195|10@0+ (0.1,-50) [-50|50] "m"  CCU
 SG_ ADC_ParkRelPos6_y4 : 201|10@0+ (0.1,-50) [-50|50] "m"  CCU
 SG_ ADC_ParkRelPos7_x1 : 223|10@0+ (0.1,-50) [-50|50] "m"  CCU
 SG_ ADC_ParkRelPos7_y1 : 229|10@0+ (0.1,-50) [-50|50] "m"  CCU
 SG_ ADC_ParkRelPos7_x2 : 235|10@0+ (0.1,-50) [-50|50] "m"  CCU
 SG_ ADC_ParkRelPos7_y2 : 241|10@0+ (0.1,-50) [-50|50] "m"  CCU
 SG_ ADC_ParkRelPos7_x3 : 263|10@0+ (0.1,-50) [-50|50] "m"  CCU
 SG_ ADC_ParkRelPos7_y3 : 269|10@0+ (0.1,-50) [-50|50] "m"  CCU
 SG_ ADC_ParkRelPos7_x4 : 275|10@0+ (0.1,-50) [-50|50] "m"  CCU
 SG_ ADC_ParkRelPos7_y4 : 281|10@0+ (0.1,-50) [-50|50] "m"  CCU
 SG_ ADC_ParkRelPos8_x1 : 303|10@0+ (0.1,-50) [-50|50] "m"  CCU
 SG_ ADC_ParkRelPos8_y1 : 309|10@0+ (0.1,-50) [-50|50] "m"  CCU
 SG_ ADC_ParkRelPos8_x2 : 315|10@0+ (0.1,-50) [-50|50] "m"  CCU
 SG_ ADC_ParkRelPos8_y2 : 321|10@0+ (0.1,-50) [-50|50] "m"  CCU
 SG_ ADC_ParkRelPos8_x3 : 343|10@0+ (0.1,-50) [-50|50] "m"  CCU
 SG_ ADC_ParkRelPos8_y3 : 349|10@0+ (0.1,-50) [-50|50] "m"  CCU
 SG_ ADC_ParkRelPos8_x4 : 355|10@0+ (0.1,-50) [-50|50] "m"  CCU
 SG_ ADC_ParkRelPos8_y4 : 361|10@0+ (0.1,-50) [-50|50] "m"  CCU
 SG_ ADC_ParkPosn5_ID : 383|4@0+ (1,0) [0|15] ""  CCU
 SG_ ADC_MnvrOrintChng5 : 379|2@0+ (1,0) [0|3] ""  CCU
 SG_ ADC_TarParkSt_Posn5 : 377|3@0+ (1,0) [0|7] ""  CCU
 SG_ ADC_ParkChkSrc_Posn5 : 390|3@0+ (1,0) [0|3] ""  CCU
 SG_ ADC_ParkPosn6_ID : 387|4@0+ (1,0) [0|15] ""  CCU

BO_ 134 CCU_VIM_ADCCode: 16 CCU
 SG_ Theft_Auth_ADCCode : 7|128@0+ (1,0) [0|3.40282366920938E+38] ""  CCURT1,RT1_C0,RT1_C1,VDC,ADC,FAPA,IFC

BO_ 135 ADC_VIMCode: 16 ADC
 SG_ ADC_VIMCode : 7|128@0+ (1,0) [0|3.40282366920938E+38] ""  CCU,CCURT1,CCURT2,RT1_C0,RT1_C1,VDC

BO_ 120 CCU_SECKEY: 32 CCU
 SG_ CCU_SEC_KEY_Defaultencoding : 7|256@0+ (1,0) [0|0] ""  ZCUF,ZCUL,ZCUR,ZCUT,IDC,ADC,FAPA,VIU

BO_ 121 ADC_SECKEY: 1 ADC
 SG_ ADC_SEC_KEY_Defaultencoding : 7|8@0+ (1,0) [0|255] ""  CCU,CCURT1,RT1_C0

BO_ 619 CCU_EPB_2: 32 CCU
 SG_ EPB_FailSt_L : 39|1@0+ (1,0) [0|1] ""  ZCUT,RBM,IBCS,ADC,FAPA,VIU
 SG_ EPB_ExtAvailable_L : 47|2@0+ (1,0) [0|3] ""  ZCUT,RBM,IBCS,ADC,FAPA,VIU
 SG_ EPB_ActuatorSt_L : 107|4@0+ (1,0) [0|15] ""  ZCUT,RBM,IBCS,ADC,FAPA,VIU

BO_ 1043 CCU_TBOX_GNSS: 64 CCU
 SG_ TEL_Time_Year : 263|8@0+ (1,2000) [2000|2255] "y"  IDC,ADC,FAPA,FLR,FRR,RLR,RRR,PAS,PCS
 SG_ TEL_Time_Month : 251|4@0+ (1,0) [1|12] "m"  IDC,ADC,FAPA,FLR,FRR,RLR,RRR,PAS,PCS
 SG_ TEL_Time_Hour : 271|5@0+ (1,0) [0|23] "h"  IDC,ADC,FAPA,FLR,FRR,RLR,RRR,PAS,PCS
 SG_ TEL_Time_Day : 281|5@0+ (1,0) [1|31] "d"  IDC,ADC,FAPA,FLR,FRR,RLR,RRR,PAS,PCS
 SG_ TEL_Time_Min : 278|6@0+ (1,0) [0|59] "min"  IDC,ADC,FAPA,FLR,FRR,RLR,RRR,PAS,PCS
 SG_ TEL_Time_Sec : 287|6@0+ (1,0) [0|59] "s"  IDC,ADC,FAPA,FLR,FRR,RLR,RRR,PAS,PCS
 SG_ TEL_TimeVD : 272|1@0+ (1,0) [0|1] ""  IDC,ADC,FAPA,FLR,FRR,RLR,RRR,PAS,PCS

BO_ 926 FLR_1: 32 FLR
 SG_ FLR_1_CRC : 7|16@0+ (1,0) [0|65535] ""  CCU,ADC,FAPA,FRR
 SG_ FLR_1_Counter : 23|8@0+ (1,0) [0|255] ""  CCU,ADC,FAPA,FRR
 SG_ FLR_MRRSt : 26|3@0+ (1,0) [0|7] ""  CCU,ADC,FAPA,FRR
 SG_ FLR_FCTAWarnLeft : 28|2@0+ (1,0) [0|3] ""  CCU,ADC,FAPA,FRR
 SG_ FLR_FCTASt : 30|2@0+ (1,0) [0|3] ""  CCU,ADC,FAPA,FRR
 SG_ FLR_FCTAAssistType : 47|2@0+ (1,0) [0|3] ""  CCU,ADC,FAPA,FRR
 SG_ FLR_FCTBTargetDecel : 39|8@0+ (0.05,-10) [-10|2.75] "m/s2"  CCU,ADC,FAPA,FRR
 SG_ FLR_FCTBBrkVD : 31|1@0+ (1,0) [0|1] ""  CCU,ADC,FAPA,FRR
 SG_ FLR_FCTBBrkReq : 45|1@0+ (1,0) [0|1] ""  CCU,ADC,FAPA,FRR

BO_ 927 FRR_1: 32 FRR
 SG_ FRR_1_CRC : 7|16@0+ (1,0) [0|65535] ""  CCU,ADC,FAPA,FLR
 SG_ FRR_1_Counter : 23|8@0+ (1,0) [0|255] ""  CCU,ADC,FAPA,FLR
 SG_ FRR_MRRSt : 26|3@0+ (1,0) [0|7] ""  CCU,ADC,FAPA,FLR
 SG_ FRR_FCTAWarnRight : 28|2@0+ (1,0) [0|3] ""  CCU,ADC,FAPA,FLR
 SG_ FRR_FCTASt : 30|2@0+ (1,0) [0|3] ""  CCU,ADC,FAPA,FLR
 SG_ FRR_FCTAAssistType : 47|2@0+ (1,0) [0|3] ""  CCU,ADC,FAPA,FLR
 SG_ FRR_FCTBTargetDecel : 39|8@0+ (0.05,-10) [-10|2.75] "m/s2"  CCU,ADC,FAPA,FLR
 SG_ FRR_FCTBBrkVD : 31|1@0+ (1,0) [0|1] ""  CCU,ADC,FAPA,FLR
 SG_ FRR_FCTBBrkReq : 45|1@0+ (1,0) [0|1] ""  CCU,ADC,FAPA,FLR

BO_ 932 RRR_1: 32 RRR
 SG_ RRR_1_CRC : 7|16@0+ (1,0) [0|65535] ""  ADC,FAPA
 SG_ RRR_1_Counter : 23|8@0+ (1,0) [0|255] ""  ADC,FAPA
 SG_ RRR_MRRSt : 31|3@0+ (1,0) [0|7] ""  ADC,FAPA
 SG_ RRR_ExMirLedWarnR : 28|2@0+ (1,0) [0|3] ""  ADC,FAPA
 SG_ RRR_LCASt : 26|2@0+ (1,0) [0|3] ""  ADC,FAPA
 SG_ RRR_LCAWarnRight : 24|2@0+ (1,0) [0|3] ""  ADC,FAPA
 SG_ RRR_ClusterLamp : 38|3@0+ (1,0) [0|7] ""  ADC,FAPA
 SG_ RRR_DOWWarnR : 35|2@0+ (1,0) [0|3] ""  ADC,FAPA
 SG_ RRR_DOWSt : 33|2@0+ (1,0) [0|3] ""  ADC,FAPA
 SG_ RRR_AudioWarnFR : 41|2@0+ (1,0) [0|3] ""  ADC,FAPA,IFC
 SG_ RRR_AudioWarnRR : 43|2@0+ (1,0) [0|3] ""  ADC,FAPA,IFC
 SG_ RRR_IALWarnFR : 45|2@0+ (1,0) [0|3] ""  ADC,FAPA
 SG_ RRR_IALWarnRR : 47|2@0+ (1,0) [0|3] ""  ADC,FAPA
 SG_ RRR_RCTASt : 49|2@0+ (1,0) [0|3] ""  ADC,FAPA
 SG_ RRR_RCTAWarnRight : 51|2@0+ (1,0) [0|3] ""  ADC,FAPA
 SG_ RRR_RCWSt : 53|2@0+ (1,0) [0|3] ""  ADC,FAPA
 SG_ RRR_RCWWarn : 55|2@0+ (1,0) [0|3] ""  ADC,FAPA
 SG_ RRR_RCTBTargetDecel : 63|8@0+ (0.05,-10) [-10|2.75] "m/s2"  ADC,FAPA
 SG_ RRR_RCTBBrkReq : 64|1@0+ (1,0) [0|1] ""  ADC,FAPA
 SG_ RRR_TargetLatDistR : 71|7@0+ (0.1,-12.7) [-12.7|0] "m"  ADC,FAPA
 SG_ RRR_RCTBBrkgVD : 83|1@0+ (1,0) [0|1] ""  ADC,FAPA
 SG_ RRR_TargetRVD : 85|2@0+ (1,0) [0|3] ""  ADC,FAPA
 SG_ RRR_TargetRelSpdR : 79|10@0+ (0.06225,-10) [-10|50] "m/s"  ADC,FAPA
 SG_ RRR_TargetDstR : 82|11@0+ (0.06225,-90) [-90|10] "m"  ADC,FAPA
 SG_ RRR_VibrWarnR : 101|1@0+ (1,0) [0|1] ""  ADC
 SG_ RRR_RCTAAssistType : 103|2@0+ (1,0) [0|3] ""  ADC,FAPA,IFC

BO_ 987 RLR_1: 32 RLR
 SG_ RLR_1_CRC : 7|16@0+ (1,0) [0|65535] ""  ADC,FAPA
 SG_ RLR_1_Counter : 23|8@0+ (1,0) [0|255] ""  ADC,FAPA
 SG_ RLR_MRRSt : 31|3@0+ (1,0) [0|7] ""  ADC,FAPA
 SG_ RLR_ExMirLedWarnL : 28|2@0+ (1,0) [0|3] ""  ADC,FAPA
 SG_ RLR_LCASt : 26|2@0+ (1,0) [0|3] ""  ADC,FAPA
 SG_ RLR_LCAWarnLeft : 24|2@0+ (1,0) [0|3] ""  ADC,FAPA
 SG_ RLR_ClusterLamp : 38|3@0+ (1,0) [0|7] ""  ADC,FAPA
 SG_ RLR_DOWWarnL : 35|2@0+ (1,0) [0|3] ""  ADC,FAPA
 SG_ RLR_DOWSt : 33|2@0+ (1,0) [0|3] ""  ADC,FAPA
 SG_ RLR_AudioWarnFL : 41|2@0+ (1,0) [0|3] ""  ADC,FAPA,IFC
 SG_ RLR_AudioWarnRL : 43|2@0+ (1,0) [0|3] ""  ADC,FAPA,IFC
 SG_ RLR_IALWarnFL : 45|2@0+ (1,0) [0|3] ""  ADC,FAPA
 SG_ RLR_IALWarnRL : 47|2@0+ (1,0) [0|3] ""  ADC,FAPA
 SG_ RLR_RCTAWarnLeft : 49|2@0+ (1,0) [0|3] ""  ADC,FAPA
 SG_ RLR_RCWSt : 51|2@0+ (1,0) [0|3] ""  ADC,FAPA
 SG_ RLR_RCWWarn : 53|2@0+ (1,0) [0|3] ""  ADC,FAPA
 SG_ RLR_RCTASt : 83|2@0+ (1,0) [0|3] ""  ADC,FAPA
 SG_ RLR_TargetLVD : 55|2@0+ (1,0) [0|3] ""  ADC,FAPA
 SG_ RLR_TargetRelSpdL : 63|10@0+ (0.06225,-10) [-10|50] "m/s"  ADC,FAPA
 SG_ RLR_TargetDstL : 69|11@0+ (0.06225,-90) [-90|10] "m"  ADC,FAPA
 SG_ RLR_RCTAAssistType : 81|2@0+ (1,0) [0|3] ""  ADC,FAPA,IFC
 SG_ RLR_TargetLatDistL : 74|7@0+ (0.1,0) [0|12.7] "m"  ADC,FAPA
 SG_ RLR_RCTBTargetDecel : 95|8@0+ (0.05,-10) [-10|2.75] "m/s2"  ADC,FAPA
 SG_ RLR_VibrWarnL : 100|1@0+ (1,0) [0|1] ""  ADC
 SG_ RLR_RCTAWarnL : 101|1@0+ (1,0) [0|1] ""  ADC
 SG_ RLR_RCTBBrkVD : 102|1@0+ (1,0) [0|1] ""  ADC
 SG_ RLR_RCTBBrkReq : 103|1@0+ (1,0) [0|1] ""  ADC,FAPA

BO_ 93 CCU_17: 8 CCU
 SG_ CCU_ADCSoCWakeupRequest : 7|3@0+ (1,0) [0|7] ""  ADC,FAPA

BO_ 766 CCU_PublicCANFD1_1: 16 CCU
 SG_ POD_DoorOptStFL : 7|2@0+ (1,0) [0|3] ""  ADC,FAPA,VIU
 SG_ POD_DoorOptStFR : 5|2@0+ (1,0) [0|3] ""  ADC,FAPA,VIU
 SG_ POD_DoorOptStRL : 3|2@0+ (1,0) [0|3] ""  ADC,FAPA,VIU
 SG_ POD_DoorOptStRR : 1|2@0+ (1,0) [0|3] ""  ADC,FAPA,VIU
 SG_ POD_CurDoorPosFL : 14|7@0+ (1,0) [0|100] "%"  ADC,FAPA,VIU
 SG_ POD_CurDoorPosFR : 23|7@0+ (1,0) [0|100] "%"  ADC,FAPA,VIU
 SG_ POD_DSMEmergencyStopFL : 16|1@0+ (1,0) [0|1] ""  ADC,FAPA,VIU
 SG_ POD_DSMOpenablePercentFL : 46|7@0+ (1,0) [0|127] "%"  ADC,FAPA,VIU
 SG_ POD_CurDoorPosRL : 55|7@0+ (1,0) [0|100] "%"  ADC,FAPA,VIU
 SG_ POD_DSMValidFL : 48|1@0+ (1,0) [0|1] ""  ADC,FAPA,VIU
 SG_ POD_DSMEmergencyStopFR : 63|1@0+ (1,0) [0|1] ""  ADC,FAPA,VIU
 SG_ POD_DSMOpenablePercentFR : 62|7@0+ (1,0) [0|127] "%"  ADC,FAPA,VIU
 SG_ POD_CurDoorPosRR : 71|7@0+ (1,0) [0|100] "%"  ADC,FAPA,VIU
 SG_ POD_DSMValidFR : 64|1@0+ (1,0) [0|1] ""  ADC,FAPA,VIU
 SG_ POD_DSMEmergencyStopRL : 79|1@0+ (1,0) [0|1] ""  ADC,FAPA,VIU
 SG_ POD_DSMOpenablePercentRL : 78|7@0+ (1,0) [0|127] "%"  ADC,FAPA,VIU
 SG_ POD_DSMObstacleDisRR : 87|8@0+ (1,0) [0|255] "cm"  ADC,FAPA,VIU
 SG_ POD_DSMValidRL : 103|1@0+ (1,0) [0|1] ""  ADC,FAPA,VIU
 SG_ POD_DSMOpenablePercentRR : 94|7@0+ (1,0) [0|127] "%"  ADC,FAPA,VIU
 SG_ POD_DSMEmergencyStopRR : 97|1@0+ (1,0) [0|1] ""  ADC,FAPA,VIU
 SG_ POD_DSMValidRR : 96|1@0+ (1,0) [0|1] ""  ADC,FAPA,VIU
 SG_ POD_DSMObstacleDisFL : 111|8@0+ (1,0) [0|255] "cm"  ADC,FAPA,VIU
 SG_ POD_DSMObstacleDisFR : 119|8@0+ (1,0) [0|255] "cm"  ADC,FAPA,VIU
 SG_ POD_DSMObstacleDisRL : 127|8@0+ (1,0) [0|255] "cm"  ADC,FAPA,VIU

BO_ 1007 IMU_1: 8 INU
 SG_ INS_Status : 7|16@0+ (1,0) [0|65535] ""  ADC,FAPA,IFC

BO_ 459 CCU_ECS_2: 64 CCU
 SG_ ECS_2_CRC : 7|16@0+ (1,0) [0|65535] ""  ADC,FAPA,IFC
 SG_ ECS_2_Counter : 23|8@0+ (1,0) [0|255] ""  ADC,FAPA,IFC
 SG_ AS_SuspHeightFL : 31|12@0+ (0.1,-150) [-150|150] "mm"  ADC,FAPA,IFC
 SG_ AS_SuspHeightFR : 35|12@0+ (0.1,-150) [-150|150] "mm"  ADC,FAPA,IFC
 SG_ AS_SuspHeightRL : 55|12@0+ (0.1,-150) [-150|150] "mm"  ADC,FAPA,IFC
 SG_ AS_SuspHeightRR : 59|12@0+ (0.1,-150) [-150|150] "mm"  ADC,FAPA,IFC
 SG_ AS_SuspHeightFLVD : 72|1@0+ (1,0) [0|1] ""  ADC,FAPA,IFC
 SG_ AS_SuspHeightFRVD : 73|1@0+ (1,0) [0|1] ""  ADC,FAPA,IFC
 SG_ AS_SuspHeightRLVD : 74|1@0+ (1,0) [0|1] ""  ADC,FAPA,IFC
 SG_ AS_SuspHeightRRVD : 75|1@0+ (1,0) [0|1] ""  ADC,FAPA,IFC
 SG_ AS_SuspHeightSensorFLSt : 76|1@0+ (1,0) [0|1] ""  ADC,FAPA,IFC
 SG_ AS_SuspHeightSensorFRSt : 77|1@0+ (1,0) [0|1] ""  ADC,FAPA,IFC
 SG_ AS_SuspHeightSensorRLSt : 78|1@0+ (1,0) [0|1] ""  ADC,FAPA,IFC
 SG_ AS_SuspHeightSensoRRSt : 79|1@0+ (1,0) [0|1] ""  ADC,FAPA,IFC
 SG_ AS_MaintanceModeSt : 97|2@0+ (1,0) [0|3] ""  ADC,FAPA,IFC
 SG_ ECS_AVDCReqModeAvailable : 113|1@0+ (1,0) [0|1] ""  ADC,FAPA,IFC
 SG_ ECS_AVDCReqMode : 116|3@0+ (1,0) [0|7] ""  ADC,FAPA,IFC
 SG_ AS_FrontAxleSuspSt : 112|2@0+ (1,0) [0|3] ""  ADC,FAPA,IFC
 SG_ AS_RearAxleSuspSt : 126|2@0+ (1,0) [0|3] ""  ADC,FAPA,IFC
 SG_ AS_HeightWarningSt : 124|3@0+ (1,0) [0|7] ""  ADC,FAPA,IFC
 SG_ AS_CurrentLevel : 131|4@0+ (1,0) [0|15] ""  ADC,FAPA,IFC
 SG_ AS_TargetLevel : 135|4@0+ (1,0) [0|15] ""  ADC,FAPA
 SG_ AS_ASMode : 138|3@0+ (1,0) [0|7] ""  ADC,FAPA,IFC
 SG_ AS_SysFaultSt : 141|3@0+ (1,0) [0|7] ""  ADC,FAPA,IFC
 SG_ AS_OverHeatingSt : 143|2@0+ (1,0) [0|3] ""  ADC,FAPA
 SG_ AS_SysOperationSt : 159|4@0+ (1,0) [0|15] ""  ADC,FAPA,IFC
 SG_ AS_OverLoadSt : 147|1@0+ (1,0) [0|1] ""  ADC,FAPA
 SG_ AS_OverTorsionSt : 148|1@0+ (1,0) [0|1] ""  ADC,FAPA
 SG_ AS_ManufacModeSt : 150|2@0+ (1,0) [0|3] ""  ADC,FAPA
 SG_ AS_ASIndividualMode : 155|3@0+ (1,0) [0|7] ""  ADC
 SG_ AS_ADCStfnCtrlAvl : 151|1@0+ (1,0) [0|1] ""  ADC,FAPA
 SG_ AS_ADCStfnState : 146|3@0+ (1,0) [0|7] ""  ADC,FAPA

CM_ SG_ 970 ADC_ParkRelPos3_y4 "ADC_ParkRelPos3_y4";
CM_ SG_ 970 ADC_ParkRelPos4_x1 "ADC_ParkRelPos4_x1";
CM_ SG_ 970 ADC_ParkRelPos4_y1 "ADC_ParkRelPos4_y1";
CM_ SG_ 970 ADC_ParkRelPos4_x2 "ADC_ParkRelPos4_x2";
CM_ SG_ 970 ADC_ParkRelPos4_y2 "ADC_ParkRelPos4_y2";
CM_ SG_ 970 ADC_ParkRelPos4_x3 "ADC_ParkRelPos4_x3";
CM_ SG_ 970 ADC_ParkRelPos4_y3 "ADC_ParkRelPos4_y3";
CM_ SG_ 970 ADC_ParkRelPos4_x4 "ADC_ParkRelPos4_x4";
CM_ SG_ 970 ADC_ParkRelPos4_y4 "ADC_ParkRelPos4_y4";
CM_ SG_ 971 ADC_MnvrOrintChng6 "ADC_MnvrOrintChng6";
CM_ SG_ 971 ADC_TarParkSt_Posn6 "ADC_TarParkSt_Posn6";
CM_ SG_ 971 ADC_ParkChkSrc_Posn6 "ADC_ParkChkSrc_Posn6";
CM_ SG_ 971 ADC_ParkPosn7_ID "ADC_ParkPosn7_ID";
CM_ SG_ 971 ADC_MnvrOrintChng7 "ADC_MnvrOrintChng7";
CM_ SG_ 971 ADC_TarParkSt_Posn7 "ADC_TarParkSt_Posn7";
CM_ SG_ 971 ADC_ParkChkSrc_Posn7 "ADC_ParkChkSrc_Posn7";
CM_ SG_ 971 ADC_ParkPosn8_ID "ADC_ParkPosn8_ID";
CM_ SG_ 971 ADC_MnvrOrintChng8 "ADC_MnvrOrintChng8";
CM_ SG_ 971 ADC_TarParkSt_Posn8 "ADC_TarParkSt_Posn8";
CM_ SG_ 971 ADC_ParkChkSrc_Posn8 "ADC_ParkChkSrc_Posn8";
CM_ SG_ 971 ADC_ParkRelPos5_x1 "ADC_ParkRelPos5_x1";
CM_ SG_ 971 ADC_ParkRelPos5_y1 "ADC_ParkRelPos5_y1";
CM_ SG_ 971 ADC_ParkRelPos5_x2 "ADC_ParkRelPos5_x2";
CM_ SG_ 971 ADC_ParkRelPos5_y2 "ADC_ParkRelPos5_y2";
CM_ SG_ 971 ADC_ParkRelPos5_x3 "ADC_ParkRelPos5_x3";
CM_ SG_ 971 ADC_ParkRelPos5_y3 "ADC_ParkRelPos5_y3";
CM_ SG_ 971 ADC_ParkRelPos5_x4 "ADC_ParkRelPos5_x4";
CM_ SG_ 971 ADC_ParkRelPos5_y4 "ADC_ParkRelPos5_y4";
CM_ SG_ 971 ADC_ParkRelPos6_x1 "ADC_ParkRelPos6_x1";
CM_ SG_ 971 ADC_ParkRelPos6_y1 "ADC_ParkRelPos6_y1";
CM_ SG_ 971 ADC_ParkRelPos6_x2 "ADC_ParkRelPos6_x2";
CM_ SG_ 971 ADC_ParkRelPos6_y2 "ADC_ParkRelPos6_y2";
CM_ SG_ 971 ADC_ParkRelPos6_x3 "ADC_ParkRelPos6_x3";
CM_ SG_ 971 ADC_ParkRelPos6_y3 "ADC_ParkRelPos6_y3";
CM_ SG_ 971 ADC_ParkRelPos6_x4 "ADC_ParkRelPos6_x4";
CM_ SG_ 971 ADC_ParkRelPos6_y4 "ADC_ParkRelPos6_y4";
CM_ SG_ 971 ADC_ParkRelPos7_x1 "ADC_ParkRelPos7_x1";
CM_ SG_ 971 ADC_ParkRelPos7_y1 "ADC_ParkRelPos7_y1";
CM_ SG_ 971 ADC_ParkRelPos7_x2 "ADC_ParkRelPos7_x2";
CM_ SG_ 971 ADC_ParkRelPos7_y2 "ADC_ParkRelPos7_y2";
CM_ SG_ 971 ADC_ParkRelPos7_x3 "ADC_ParkRelPos7_x3";
CM_ SG_ 971 ADC_ParkRelPos7_y3 "ADC_ParkRelPos7_y3";
CM_ SG_ 971 ADC_ParkRelPos7_x4 "ADC_ParkRelPos7_x4";
CM_ SG_ 971 ADC_ParkRelPos7_y4 "ADC_ParkRelPos7_y4";
CM_ SG_ 971 ADC_ParkRelPos8_x1 "ADC_ParkRelPos8_x1";
CM_ SG_ 971 ADC_ParkRelPos8_y1 "ADC_ParkRelPos8_y1";
CM_ SG_ 971 ADC_ParkRelPos8_x2 "ADC_ParkRelPos8_x2";
CM_ SG_ 971 ADC_ParkRelPos8_y2 "ADC_ParkRelPos8_y2";
CM_ SG_ 971 ADC_ParkRelPos8_x3 "ADC_ParkRelPos8_x3";
CM_ SG_ 971 ADC_ParkRelPos8_y3 "ADC_ParkRelPos8_y3";
CM_ SG_ 971 ADC_ParkRelPos8_x4 "ADC_ParkRelPos8_x4";
CM_ SG_ 971 ADC_ParkRelPos8_y4 "ADC_ParkRelPos8_y4";
CM_ SG_ 971 ADC_ParkPosn5_ID "ADC_ParkPosn5_ID";
CM_ SG_ 971 ADC_MnvrOrintChng5 "ADC_MnvrOrintChng5";
CM_ SG_ 971 ADC_TarParkSt_Posn5 "ADC_TarParkSt_Posn5";
CM_ SG_ 971 ADC_ParkChkSrc_Posn5 "ADC_ParkChkSrc_Posn5";
CM_ SG_ 971 ADC_ParkPosn6_ID "ADC_ParkPosn6_ID";
CM_ SG_ 134 Theft_Auth_ADCCode "Remote Control Random Code to ADC";
CM_ SG_ 135 ADC_VIMCode "ADC Code return to VIM";
CM_ SG_ 120 CCU_SEC_KEY_Defaultencoding "CCU distribute SecOC key and default_encoding";
CM_ SG_ 121 ADC_SEC_KEY_Defaultencoding "ADC feedback SecOC key and default_encoding results";
CM_ SG_ 619 EPB_FailSt_L "EPB fail status,to indicate wether EPB can response to external apply  request or not";
CM_ SG_ 619 EPB_ExtAvailable_L "EPB  status,to indicate wetherEPB can response to externalapply request or not";
CM_ SG_ 619 EPB_ActuatorSt_L "EPB left  actuator status";
CM_ SG_ 1043 TEL_Time_Year "Year number";
CM_ SG_ 1043 TEL_Time_Month "Month number";
CM_ SG_ 1043 TEL_Time_Hour "Hour number";
CM_ SG_ 1043 TEL_Time_Day "Day number";
CM_ SG_ 1043 TEL_Time_Min "Minute number";
CM_ SG_ 1043 TEL_Time_Sec "Second number";
CM_ SG_ 1043 TEL_TimeVD "TEL time valid value";
CM_ SG_ 926 FLR_1_CRC "E2E Profile 5 CRC";
CM_ SG_ 926 FLR_1_Counter "E2E Profile 5 Counter";
CM_ SG_ 926 FLR_MRRSt "MRR systems ON OFF andError Status";
CM_ SG_ 926 FLR_FCTAWarnLeft "the vehicle left warning in the FCTAfeature";
CM_ SG_ 926 FLR_FCTASt "FCTA Function status left";
CM_ SG_ 926 FLR_FCTAAssistType "FCTA assist type request";
CM_ SG_ 926 FLR_FCTBTargetDecel "target deceleration value from FCTB";
CM_ SG_ 926 FLR_FCTBBrkVD "FCTB brake request valid flag";
CM_ SG_ 926 FLR_FCTBBrkReq "FCTB brake request";
CM_ SG_ 927 FRR_1_CRC "E2E Profile 5 CRC";
CM_ SG_ 927 FRR_1_Counter "E2E Profile 5 Counter";
CM_ SG_ 927 FRR_MRRSt "MRR systems ON OFF andError Status";
CM_ SG_ 927 FRR_FCTAWarnRight "the vehicle Right warning in the FCTA feature";
CM_ SG_ 927 FRR_FCTASt "FCTA Function status left";
CM_ SG_ 927 FRR_FCTAAssistType "FCTA assist type request";
CM_ SG_ 927 FRR_FCTBTargetDecel "target deceleration value from FCTB";
CM_ SG_ 927 FRR_FCTBBrkVD "FCTB brake request valid flag";
CM_ SG_ 927 FRR_FCTBBrkReq "FCTB brake request";
CM_ SG_ 932 RRR_1_CRC "E2E Profile 5 CRC";
CM_ SG_ 932 RRR_1_Counter "E2E Profile 5 Counter";
CM_ SG_ 932 RRR_MRRSt "MRR systems ON OFF andError Status";
CM_ SG_ 932 RRR_ExMirLedWarnR "Exterior mirror LED warning right";
CM_ SG_ 932 RRR_LCASt "BSD-LCA Function status";
CM_ SG_ 932 RRR_LCAWarnRight " the vehicle right warning level in the LCA feature";
CM_ SG_ 932 RRR_ClusterLamp "Cluster lamp color status";
CM_ SG_ 932 RRR_DOWWarnR "DOW warning right";
CM_ SG_ 932 RRR_DOWSt "DOW function state  right";
CM_ SG_ 932 RRR_AudioWarnFR "Front right door speaker warning";
CM_ SG_ 932 RRR_AudioWarnRR "Rear right door speaker warning";
CM_ SG_ 932 RRR_IALWarnFR "Front right door light warning";
CM_ SG_ 932 RRR_IALWarnRR "Rear right door light warning";
CM_ SG_ 932 RRR_RCTASt "RCTA Function status";
CM_ SG_ 932 RRR_RCTAWarnRight "the vehicle right warning in the RCTAfeature";
CM_ SG_ 932 RRR_RCWSt "RCW(rear collision warning ) feature status";
CM_ SG_ 932 RRR_RCWWarn "the vehicle warning level in the RCWfeature";
CM_ SG_ 932 RRR_RCTBTargetDecel "target deceleration value from RCTB";
CM_ SG_ 932 RRR_RCTBBrkReq "RCTB brake request";
CM_ SG_ 932 RRR_TargetLatDistR "ELK right target lateral relative distance";
CM_ SG_ 932 RRR_RCTBBrkgVD "RCTB brake request valid flag";
CM_ SG_ 932 RRR_TargetRVD "ELK right target valid state";
CM_ SG_ 932 RRR_TargetRelSpdR "ELK right target relative speed";
CM_ SG_ 932 RRR_TargetDstR "ELK right target relative distance";
CM_ SG_ 932 RRR_VibrWarnR "Driver seat vibration warning right ";
CM_ SG_ 932 RRR_RCTAAssistType "RCTA assist type request";
CM_ SG_ 987 RLR_1_CRC "E2E Profile 5 CRC";
CM_ SG_ 987 RLR_1_Counter "E2E Profile 5 Counter";
CM_ SG_ 987 RLR_MRRSt "MRR systems ON OFF andError Status";
CM_ SG_ 987 RLR_ExMirLedWarnL "Exterior mirror LED warning left";
CM_ SG_ 987 RLR_LCASt "BSD-LCA Function status";
CM_ SG_ 987 RLR_LCAWarnLeft " the vehicle Left warning level in the LCA feature";
CM_ SG_ 987 RLR_ClusterLamp "Cluster lamp color status";
CM_ SG_ 987 RLR_DOWWarnL "DOW warning left";
CM_ SG_ 987 RLR_DOWSt "DOW function state left";
CM_ SG_ 987 RLR_AudioWarnFL "Front left door speaker warning";
CM_ SG_ 987 RLR_AudioWarnRL "Rear left door speaker warning";
CM_ SG_ 987 RLR_IALWarnFL "Front left door light warning";
CM_ SG_ 987 RLR_IALWarnRL "Rear left door light warning";
CM_ SG_ 987 RLR_RCTAWarnLeft "the vehicle left warning in the RCTAfeature";
CM_ SG_ 987 RLR_RCWSt "RCW(rear collision warning ) feature status";
CM_ SG_ 987 RLR_RCWWarn "the vehicle warning level in the RCWfeature";
CM_ SG_ 987 RLR_RCTASt "RCTA Function status left";
CM_ SG_ 987 RLR_TargetLVD "ELK left target valid state";
CM_ SG_ 987 RLR_TargetRelSpdL "ELK left target relative speed";
CM_ SG_ 987 RLR_TargetDstL "ELK left target relative distance";
CM_ SG_ 987 RLR_RCTAAssistType "RCTA assist type request";
CM_ SG_ 987 RLR_TargetLatDistL "ELK left target lateral relative distance ";
CM_ SG_ 987 RLR_RCTBTargetDecel "target deceleration value from RCTB";
CM_ SG_ 987 RLR_VibrWarnL "Driver seat vibration warning left ";
CM_ SG_ 987 RLR_RCTAWarnL "RCTA visual warning left ";
CM_ SG_ 987 RLR_RCTBBrkVD "RCTB brake request valid flag";
CM_ SG_ 987 RLR_RCTBBrkReq "RCTB brake request";
CM_ SG_ 93 CCU_ADCSoCWakeupRequest "CCU Wakeup ADC_Soc";
CM_ SG_ 766 POD_DoorOptStFL "The operation status of Power operation door";
CM_ SG_ 766 POD_DoorOptStFR "The operation status of Power operation door";
CM_ SG_ 766 POD_DoorOptStRL "The operation status of Power operation door";
CM_ SG_ 766 POD_DoorOptStRR "The operation status of Power operation door";
CM_ SG_ 766 POD_CurDoorPosFL "The current position of power operation door";
CM_ SG_ 766 POD_CurDoorPosFR "The current position of power operation door";
CM_ SG_ 766 POD_DSMEmergencyStopFL "Power operation door emergency stop flag";
CM_ SG_ 766 POD_DSMOpenablePercentFL "Power Operation Door openable angle";
CM_ SG_ 766 POD_CurDoorPosRL "The current position of power operation door";
CM_ SG_ 766 POD_DSMValidFL "Vaild Flag of DSM information";
CM_ SG_ 766 POD_DSMEmergencyStopFR "Power operation door emergency stop flag";
CM_ SG_ 766 POD_DSMOpenablePercentFR "Power Operation Door openable angle";
CM_ SG_ 766 POD_CurDoorPosRR "The current position of power operation door";
CM_ SG_ 766 POD_DSMValidFR "Vaild Flag of DSM information";
CM_ SG_ 766 POD_DSMEmergencyStopRL "Power operation door emergency stop flag";
CM_ SG_ 766 POD_DSMOpenablePercentRL "Power Operation Door openable angle";
CM_ SG_ 766 POD_DSMObstacleDisRR "The distance between RR door and obstacle";
CM_ SG_ 766 POD_DSMValidRL "Vaild Flag of DSM information";
CM_ SG_ 766 POD_DSMOpenablePercentRR "Power Operation Door openable angle";
CM_ SG_ 766 POD_DSMEmergencyStopRR "Power operation door emergency stop flag";
CM_ SG_ 766 POD_DSMValidRR "Vaild Flag of DSM information";
CM_ SG_ 766 POD_DSMObstacleDisFL "The distance between door and obstacle";
CM_ SG_ 766 POD_DSMObstacleDisFR "The distance between FR door and obstacle";
CM_ SG_ 766 POD_DSMObstacleDisRL "The distance between RL door and obstacle";
CM_ SG_ 1007 INS_Status "The status of INS";
CM_ SG_ 459 ECS_2_CRC "E2E Profile 5 CRC";
CM_ SG_ 459 ECS_2_Counter "E2E Profile 5 Counter";
CM_ SG_ 459 AS_SuspHeightFL "Height of front left wheel";
CM_ SG_ 459 AS_SuspHeightFR "Height of front right wheel";
CM_ SG_ 459 AS_SuspHeightRL "Height of rear left wheel";
CM_ SG_ 459 AS_SuspHeightRR "Height of rear right wheel";
CM_ SG_ 459 AS_SuspHeightFLVD "Height of front left wheel validity";
CM_ SG_ 459 AS_SuspHeightFRVD "Height of front right wheel validity";
CM_ SG_ 459 AS_SuspHeightRLVD "Height of rear left wheel validity";
CM_ SG_ 459 AS_SuspHeightRRVD "Height of rear right wheel validity";
CM_ SG_ 459 AS_SuspHeightSensorFLSt "Front left suspension height sensor fault status";
CM_ SG_ 459 AS_SuspHeightSensorFRSt "Front right suspension height sensor fault status";
CM_ SG_ 459 AS_SuspHeightSensorRLSt "Rear left suspension height sensor fault status";
CM_ SG_ 459 AS_SuspHeightSensoRRSt "Rear right suspension height sensor fault status";
CM_ SG_ 459 AS_MaintanceModeSt "Air spring maintance mode status";
CM_ SG_ 459 ECS_AVDCReqMode "Electronic control suspension internal mode for AVDC电子控制悬架AVDC执行状态";
CM_ SG_ 459 AS_FrontAxleSuspSt "Height adjustment of the front axle";
CM_ SG_ 459 AS_RearAxleSuspSt "Height adjustment status of rear axle";
CM_ SG_ 459 AS_HeightWarningSt "Vehicle height warning";
CM_ SG_ 459 AS_CurrentLevel "Vehicle current height level";
CM_ SG_ 459 AS_TargetLevel "Vehicle target height level";
CM_ SG_ 459 AS_ASMode "Air spring opreation mode";
CM_ SG_ 459 AS_SysFaultSt "Air Spring system fault";
CM_ SG_ 459 AS_OverHeatingSt "Pump overheating status";
CM_ SG_ 459 AS_SysOperationSt "Air Spring operation status";
CM_ SG_ 459 AS_OverLoadSt "Vehicle overload status";
CM_ SG_ 459 AS_OverTorsionSt "Vehicle over torsion parking status";
CM_ SG_ 459 AS_ManufacModeSt "Air spring Manufac mode status";
CM_ SG_ 459 AS_ASIndividualMode "Air spring Individual opreation mode";
CM_ SG_ 459 AS_ADCStfnCtrlAvl "Available signals for suspension stiffness control";
CM_ SG_ 459 AS_ADCStfnState "Suspension stiffness state feedback signal";

BA_DEF_ BO_  "GenMsgCycleTime" INT 0 0;
BA_DEF_ BO_  "GenMsgCycleTimeFast" INT 0 0;
BA_DEF_ BO_  "GenMsgSendType" ENUM  "Periodic","Event","IfActive","POE","PA","FixedPeriodic","Event","EnabledPeriodic","NotUsed","NotUsed","EventPeriodic","NotUsed","NotUsed","NoMsgSendType";
BA_DEF_ BO_  "VFrameFormat" ENUM  "StandardCAN","ExtendedCAN","reserved","reserved","reserved","reserved","reserved","reserved","reserved","reserved","reserved","reserved","reserved","reserved","StandardCAN_FD","ExtendedCAN_FD";
BA_DEF_ BO_  "CANFD_BRS" ENUM  "0","1";
BA_DEF_ SG_  "EventCommandSignal" ENUM  "No","Yes";
BA_DEF_ SG_  "GatewayedSignals" ENUM  "No","Yes";
BA_DEF_ SG_  "GenSigInactiveValue" HEX 0 0;
BA_DEF_ SG_  "GenSigInvalidValue" HEX 0 0;
BA_DEF_ SG_  "GenSigSendType" ENUM  "Trigger","Passive","Cyclic","OnWrite","OnWriteWithRepetition","OnChange","OnChangeWithRepetition","IfActive","IfActiveWithRepetition","NoSigSendType";
BA_DEF_ SG_  "GenSigStartValue" HEX 0 0;
BA_DEF_ SG_  "GenSigTimeoutValue" HEX 0 0;
BA_DEF_ SG_  "Remark" STRING ;
BA_ "GenMsgCycleTime" BO_ 971 100;
BA_ "GenMsgCycleTimeFast" BO_ 971 0;
BA_ "GenMsgSendType" BO_ 971 0;
BA_ "VFrameFormat" BO_ 971 14;
BA_ "CANFD_BRS" BO_ 971 1;
BA_ "GenMsgCycleTime" BO_ 971 100;
BA_ "GenMsgCycleTimeFast" BO_ 971 0;
BA_ "GenMsgSendType" BO_ 971 0;
BA_ "VFrameFormat" BO_ 971 14;
BA_ "CANFD_BRS" BO_ 971 1;
BA_ "GenMsgCycleTime" BO_ 971 100;
BA_ "GenMsgCycleTimeFast" BO_ 971 0;
BA_ "GenMsgSendType" BO_ 971 0;
BA_ "VFrameFormat" BO_ 971 14;
BA_ "CANFD_BRS" BO_ 971 1;
BA_ "GenMsgCycleTime" BO_ 971 100;
BA_ "GenMsgCycleTimeFast" BO_ 971 0;
BA_ "GenMsgSendType" BO_ 971 0;
BA_ "VFrameFormat" BO_ 971 14;
BA_ "CANFD_BRS" BO_ 971 1;
BA_ "GenMsgCycleTime" BO_ 971 100;
BA_ "GenMsgCycleTimeFast" BO_ 971 0;
BA_ "GenMsgSendType" BO_ 971 0;
BA_ "VFrameFormat" BO_ 971 14;
BA_ "CANFD_BRS" BO_ 971 1;
BA_ "GenMsgCycleTime" BO_ 971 100;
BA_ "GenMsgCycleTimeFast" BO_ 971 0;
BA_ "GenMsgSendType" BO_ 971 0;
BA_ "VFrameFormat" BO_ 971 14;
BA_ "CANFD_BRS" BO_ 971 1;
BA_ "GenMsgCycleTime" BO_ 971 100;
BA_ "GenMsgCycleTimeFast" BO_ 971 0;
BA_ "GenMsgSendType" BO_ 971 0;
BA_ "VFrameFormat" BO_ 971 14;
BA_ "CANFD_BRS" BO_ 971 1;
BA_ "GenMsgCycleTime" BO_ 971 100;
BA_ "GenMsgCycleTimeFast" BO_ 971 0;
BA_ "GenMsgSendType" BO_ 971 0;
BA_ "VFrameFormat" BO_ 971 14;
BA_ "CANFD_BRS" BO_ 971 1;
BA_ "GenMsgCycleTime" BO_ 971 100;
BA_ "GenMsgCycleTimeFast" BO_ 971 0;
BA_ "GenMsgSendType" BO_ 971 0;
BA_ "VFrameFormat" BO_ 971 14;
BA_ "CANFD_BRS" BO_ 971 1;
BA_ "GenMsgCycleTime" BO_ 971 100;
BA_ "GenMsgCycleTimeFast" BO_ 971 0;
BA_ "GenMsgSendType" BO_ 971 0;
BA_ "VFrameFormat" BO_ 971 14;
BA_ "CANFD_BRS" BO_ 971 1;
BA_ "GenMsgCycleTime" BO_ 971 100;
BA_ "GenMsgCycleTimeFast" BO_ 971 0;
BA_ "GenMsgSendType" BO_ 971 0;
BA_ "VFrameFormat" BO_ 971 14;
BA_ "CANFD_BRS" BO_ 971 1;
BA_ "GenMsgCycleTime" BO_ 971 100;
BA_ "GenMsgCycleTimeFast" BO_ 971 0;
BA_ "GenMsgSendType" BO_ 971 0;
BA_ "VFrameFormat" BO_ 971 14;
BA_ "CANFD_BRS" BO_ 971 1;
BA_ "GenMsgCycleTime" BO_ 971 100;
BA_ "GenMsgCycleTimeFast" BO_ 971 0;
BA_ "GenMsgSendType" BO_ 971 0;
BA_ "VFrameFormat" BO_ 971 14;
BA_ "CANFD_BRS" BO_ 971 1;
BA_ "GenMsgCycleTime" BO_ 971 100;
BA_ "GenMsgCycleTimeFast" BO_ 971 0;
BA_ "GenMsgSendType" BO_ 971 0;
BA_ "VFrameFormat" BO_ 971 14;
BA_ "CANFD_BRS" BO_ 971 1;
BA_ "GenMsgCycleTime" BO_ 971 100;
BA_ "GenMsgCycleTimeFast" BO_ 971 0;
BA_ "GenMsgSendType" BO_ 971 0;
BA_ "VFrameFormat" BO_ 971 14;
BA_ "CANFD_BRS" BO_ 971 1;
BA_ "GenMsgCycleTime" BO_ 971 100;
BA_ "GenMsgCycleTimeFast" BO_ 971 0;
BA_ "GenMsgSendType" BO_ 971 0;
BA_ "VFrameFormat" BO_ 971 14;
BA_ "CANFD_BRS" BO_ 971 1;
BA_ "GenMsgCycleTime" BO_ 971 100;
BA_ "GenMsgCycleTimeFast" BO_ 971 0;
BA_ "GenMsgSendType" BO_ 971 0;
BA_ "VFrameFormat" BO_ 971 14;
BA_ "CANFD_BRS" BO_ 971 1;
BA_ "GenMsgCycleTime" BO_ 971 100;
BA_ "GenMsgCycleTimeFast" BO_ 971 0;
BA_ "GenMsgSendType" BO_ 971 0;
BA_ "VFrameFormat" BO_ 971 14;
BA_ "CANFD_BRS" BO_ 971 1;
BA_ "GenMsgCycleTime" BO_ 971 100;
BA_ "GenMsgCycleTimeFast" BO_ 971 0;
BA_ "GenMsgSendType" BO_ 971 0;
BA_ "VFrameFormat" BO_ 971 14;
BA_ "CANFD_BRS" BO_ 971 1;
BA_ "GenMsgCycleTime" BO_ 971 100;
BA_ "GenMsgCycleTimeFast" BO_ 971 0;
BA_ "GenMsgSendType" BO_ 971 0;
BA_ "VFrameFormat" BO_ 971 14;
BA_ "CANFD_BRS" BO_ 971 1;
BA_ "GenMsgCycleTime" BO_ 971 100;
BA_ "GenMsgCycleTimeFast" BO_ 971 0;
BA_ "GenMsgSendType" BO_ 971 0;
BA_ "VFrameFormat" BO_ 971 14;
BA_ "CANFD_BRS" BO_ 971 1;
BA_ "GenMsgCycleTime" BO_ 971 100;
BA_ "GenMsgCycleTimeFast" BO_ 971 0;
BA_ "GenMsgSendType" BO_ 971 0;
BA_ "VFrameFormat" BO_ 971 14;
BA_ "CANFD_BRS" BO_ 971 1;
BA_ "GenMsgCycleTime" BO_ 971 100;
BA_ "GenMsgCycleTimeFast" BO_ 971 0;
BA_ "GenMsgSendType" BO_ 971 0;
BA_ "VFrameFormat" BO_ 971 14;
BA_ "CANFD_BRS" BO_ 971 1;
BA_ "GenMsgCycleTime" BO_ 971 100;
BA_ "GenMsgCycleTimeFast" BO_ 971 0;
BA_ "GenMsgSendType" BO_ 971 0;
BA_ "VFrameFormat" BO_ 971 14;
BA_ "CANFD_BRS" BO_ 971 1;
BA_ "GenMsgCycleTime" BO_ 971 100;
BA_ "GenMsgCycleTimeFast" BO_ 971 0;
BA_ "GenMsgSendType" BO_ 971 0;
BA_ "VFrameFormat" BO_ 971 14;
BA_ "CANFD_BRS" BO_ 971 1;
BA_ "GenMsgCycleTime" BO_ 971 100;
BA_ "GenMsgCycleTimeFast" BO_ 971 0;
BA_ "GenMsgSendType" BO_ 971 0;
BA_ "VFrameFormat" BO_ 971 14;
BA_ "CANFD_BRS" BO_ 971 1;
BA_ "GenMsgCycleTime" BO_ 971 100;
BA_ "GenMsgCycleTimeFast" BO_ 971 0;
BA_ "GenMsgSendType" BO_ 971 0;
BA_ "VFrameFormat" BO_ 971 14;
BA_ "CANFD_BRS" BO_ 971 1;
BA_ "GenMsgCycleTime" BO_ 971 100;
BA_ "GenMsgCycleTimeFast" BO_ 971 0;
BA_ "GenMsgSendType" BO_ 971 0;
BA_ "VFrameFormat" BO_ 971 14;
BA_ "CANFD_BRS" BO_ 971 1;
BA_ "GenMsgCycleTime" BO_ 971 100;
BA_ "GenMsgCycleTimeFast" BO_ 971 0;
BA_ "GenMsgSendType" BO_ 971 0;
BA_ "VFrameFormat" BO_ 971 14;
BA_ "CANFD_BRS" BO_ 971 1;
BA_ "GenMsgCycleTime" BO_ 971 100;
BA_ "GenMsgCycleTimeFast" BO_ 971 0;
BA_ "GenMsgSendType" BO_ 971 0;
BA_ "VFrameFormat" BO_ 971 14;
BA_ "CANFD_BRS" BO_ 971 1;
BA_ "GenMsgCycleTime" BO_ 971 100;
BA_ "GenMsgCycleTimeFast" BO_ 971 0;
BA_ "GenMsgSendType" BO_ 971 0;
BA_ "VFrameFormat" BO_ 971 14;
BA_ "CANFD_BRS" BO_ 971 1;
BA_ "GenMsgCycleTime" BO_ 971 100;
BA_ "GenMsgCycleTimeFast" BO_ 971 0;
BA_ "GenMsgSendType" BO_ 971 0;
BA_ "VFrameFormat" BO_ 971 14;
BA_ "CANFD_BRS" BO_ 971 1;
BA_ "GenMsgCycleTime" BO_ 971 100;
BA_ "GenMsgCycleTimeFast" BO_ 971 0;
BA_ "GenMsgSendType" BO_ 971 0;
BA_ "VFrameFormat" BO_ 971 14;
BA_ "CANFD_BRS" BO_ 971 1;
BA_ "GenMsgCycleTime" BO_ 971 100;
BA_ "GenMsgCycleTimeFast" BO_ 971 0;
BA_ "GenMsgSendType" BO_ 971 0;
BA_ "VFrameFormat" BO_ 971 14;
BA_ "CANFD_BRS" BO_ 971 1;
BA_ "GenMsgCycleTime" BO_ 971 100;
BA_ "GenMsgCycleTimeFast" BO_ 971 0;
BA_ "GenMsgSendType" BO_ 971 0;
BA_ "VFrameFormat" BO_ 971 14;
BA_ "CANFD_BRS" BO_ 971 1;
BA_ "GenMsgCycleTime" BO_ 971 100;
BA_ "GenMsgCycleTimeFast" BO_ 971 0;
BA_ "GenMsgSendType" BO_ 971 0;
BA_ "VFrameFormat" BO_ 971 14;
BA_ "CANFD_BRS" BO_ 971 1;
BA_ "GenMsgCycleTime" BO_ 971 100;
BA_ "GenMsgCycleTimeFast" BO_ 971 0;
BA_ "GenMsgSendType" BO_ 971 0;
BA_ "VFrameFormat" BO_ 971 14;
BA_ "CANFD_BRS" BO_ 971 1;
BA_ "GenMsgCycleTime" BO_ 971 100;
BA_ "GenMsgCycleTimeFast" BO_ 971 0;
BA_ "GenMsgSendType" BO_ 971 0;
BA_ "VFrameFormat" BO_ 971 14;
BA_ "CANFD_BRS" BO_ 971 1;
BA_ "GenMsgCycleTime" BO_ 971 100;
BA_ "GenMsgCycleTimeFast" BO_ 971 0;
BA_ "GenMsgSendType" BO_ 971 0;
BA_ "VFrameFormat" BO_ 971 14;
BA_ "CANFD_BRS" BO_ 971 1;
BA_ "GenMsgCycleTime" BO_ 971 100;
BA_ "GenMsgCycleTimeFast" BO_ 971 0;
BA_ "GenMsgSendType" BO_ 971 0;
BA_ "VFrameFormat" BO_ 971 14;
BA_ "CANFD_BRS" BO_ 971 1;
BA_ "GenMsgCycleTime" BO_ 971 100;
BA_ "GenMsgCycleTimeFast" BO_ 971 0;
BA_ "GenMsgSendType" BO_ 971 0;
BA_ "VFrameFormat" BO_ 971 14;
BA_ "CANFD_BRS" BO_ 971 1;
BA_ "GenMsgCycleTime" BO_ 971 100;
BA_ "GenMsgCycleTimeFast" BO_ 971 0;
BA_ "GenMsgSendType" BO_ 971 0;
BA_ "VFrameFormat" BO_ 971 14;
BA_ "CANFD_BRS" BO_ 971 1;
BA_ "GenMsgCycleTime" BO_ 971 100;
BA_ "GenMsgCycleTimeFast" BO_ 971 0;
BA_ "GenMsgSendType" BO_ 971 0;
BA_ "VFrameFormat" BO_ 971 14;
BA_ "CANFD_BRS" BO_ 971 1;
BA_ "GenMsgCycleTime" BO_ 971 100;
BA_ "GenMsgCycleTimeFast" BO_ 971 0;
BA_ "GenMsgSendType" BO_ 971 0;
BA_ "VFrameFormat" BO_ 971 14;
BA_ "CANFD_BRS" BO_ 971 1;
BA_ "GenMsgCycleTime" BO_ 971 100;
BA_ "GenMsgCycleTimeFast" BO_ 971 0;
BA_ "GenMsgSendType" BO_ 971 0;
BA_ "VFrameFormat" BO_ 971 14;
BA_ "CANFD_BRS" BO_ 971 1;
BA_ "GenMsgCycleTime" BO_ 971 100;
BA_ "GenMsgCycleTimeFast" BO_ 971 0;
BA_ "GenMsgSendType" BO_ 971 0;
BA_ "VFrameFormat" BO_ 971 14;
BA_ "CANFD_BRS" BO_ 971 1;
BA_ "GenMsgCycleTime" BO_ 971 100;
BA_ "GenMsgCycleTimeFast" BO_ 971 0;
BA_ "GenMsgSendType" BO_ 971 0;
BA_ "VFrameFormat" BO_ 971 14;
BA_ "CANFD_BRS" BO_ 971 1;
BA_ "GenMsgCycleTime" BO_ 971 100;
BA_ "GenMsgCycleTimeFast" BO_ 971 0;
BA_ "GenMsgSendType" BO_ 971 0;
BA_ "VFrameFormat" BO_ 971 14;
BA_ "CANFD_BRS" BO_ 971 1;
BA_ "GenMsgCycleTime" BO_ 134 0;
BA_ "GenMsgCycleTimeFast" BO_ 134 0;
BA_ "GenMsgSendType" BO_ 134 1;
BA_ "VFrameFormat" BO_ 134 14;
BA_ "CANFD_BRS" BO_ 134 1;
BA_ "GenMsgCycleTime" BO_ 135 0;
BA_ "GenMsgCycleTimeFast" BO_ 135 0;
BA_ "GenMsgSendType" BO_ 135 1;
BA_ "VFrameFormat" BO_ 135 14;
BA_ "CANFD_BRS" BO_ 135 1;
BA_ "GenMsgCycleTime" BO_ 120 0;
BA_ "GenMsgCycleTimeFast" BO_ 120 0;
BA_ "GenMsgSendType" BO_ 120 1;
BA_ "VFrameFormat" BO_ 120 14;
BA_ "CANFD_BRS" BO_ 120 1;
BA_ "GenMsgCycleTime" BO_ 121 0;
BA_ "GenMsgCycleTimeFast" BO_ 121 0;
BA_ "GenMsgSendType" BO_ 121 1;
BA_ "VFrameFormat" BO_ 121 14;
BA_ "CANFD_BRS" BO_ 121 1;
BA_ "GenMsgCycleTime" BO_ 619 20;
BA_ "GenMsgCycleTimeFast" BO_ 619 0;
BA_ "GenMsgSendType" BO_ 619 0;
BA_ "VFrameFormat" BO_ 619 14;
BA_ "CANFD_BRS" BO_ 619 1;
BA_ "GenMsgCycleTime" BO_ 619 20;
BA_ "GenMsgCycleTimeFast" BO_ 619 0;
BA_ "GenMsgSendType" BO_ 619 0;
BA_ "VFrameFormat" BO_ 619 14;
BA_ "CANFD_BRS" BO_ 619 1;
BA_ "GenMsgCycleTime" BO_ 619 20;
BA_ "GenMsgCycleTimeFast" BO_ 619 0;
BA_ "GenMsgSendType" BO_ 619 0;
BA_ "VFrameFormat" BO_ 619 14;
BA_ "CANFD_BRS" BO_ 619 1;
BA_ "GenMsgCycleTime" BO_ 1043 1000;
BA_ "GenMsgCycleTimeFast" BO_ 1043 0;
BA_ "GenMsgSendType" BO_ 1043 0;
BA_ "VFrameFormat" BO_ 1043 14;
BA_ "CANFD_BRS" BO_ 1043 1;
BA_ "GenMsgCycleTime" BO_ 1043 1000;
BA_ "GenMsgCycleTimeFast" BO_ 1043 0;
BA_ "GenMsgSendType" BO_ 1043 0;
BA_ "VFrameFormat" BO_ 1043 14;
BA_ "CANFD_BRS" BO_ 1043 1;
BA_ "GenMsgCycleTime" BO_ 1043 1000;
BA_ "GenMsgCycleTimeFast" BO_ 1043 0;
BA_ "GenMsgSendType" BO_ 1043 0;
BA_ "VFrameFormat" BO_ 1043 14;
BA_ "CANFD_BRS" BO_ 1043 1;
BA_ "GenMsgCycleTime" BO_ 1043 1000;
BA_ "GenMsgCycleTimeFast" BO_ 1043 0;
BA_ "GenMsgSendType" BO_ 1043 0;
BA_ "VFrameFormat" BO_ 1043 14;
BA_ "CANFD_BRS" BO_ 1043 1;
BA_ "GenMsgCycleTime" BO_ 1043 1000;
BA_ "GenMsgCycleTimeFast" BO_ 1043 0;
BA_ "GenMsgSendType" BO_ 1043 0;
BA_ "VFrameFormat" BO_ 1043 14;
BA_ "CANFD_BRS" BO_ 1043 1;
BA_ "GenMsgCycleTime" BO_ 1043 1000;
BA_ "GenMsgCycleTimeFast" BO_ 1043 0;
BA_ "GenMsgSendType" BO_ 1043 0;
BA_ "VFrameFormat" BO_ 1043 14;
BA_ "CANFD_BRS" BO_ 1043 1;
BA_ "GenMsgCycleTime" BO_ 1043 1000;
BA_ "GenMsgCycleTimeFast" BO_ 1043 0;
BA_ "GenMsgSendType" BO_ 1043 0;
BA_ "VFrameFormat" BO_ 1043 14;
BA_ "CANFD_BRS" BO_ 1043 1;
BA_ "GenMsgCycleTime" BO_ 926 50;
BA_ "GenMsgCycleTimeFast" BO_ 926 0;
BA_ "GenMsgSendType" BO_ 926 0;
BA_ "VFrameFormat" BO_ 926 14;
BA_ "CANFD_BRS" BO_ 926 1;
BA_ "GenMsgCycleTime" BO_ 926 50;
BA_ "GenMsgCycleTimeFast" BO_ 926 0;
BA_ "GenMsgSendType" BO_ 926 0;
BA_ "VFrameFormat" BO_ 926 14;
BA_ "CANFD_BRS" BO_ 926 1;
BA_ "GenMsgCycleTime" BO_ 926 50;
BA_ "GenMsgCycleTimeFast" BO_ 926 0;
BA_ "GenMsgSendType" BO_ 926 0;
BA_ "VFrameFormat" BO_ 926 14;
BA_ "CANFD_BRS" BO_ 926 1;
BA_ "GenMsgCycleTime" BO_ 926 50;
BA_ "GenMsgCycleTimeFast" BO_ 926 0;
BA_ "GenMsgSendType" BO_ 926 0;
BA_ "VFrameFormat" BO_ 926 14;
BA_ "CANFD_BRS" BO_ 926 1;
BA_ "GenMsgCycleTime" BO_ 926 50;
BA_ "GenMsgCycleTimeFast" BO_ 926 0;
BA_ "GenMsgSendType" BO_ 926 0;
BA_ "VFrameFormat" BO_ 926 14;
BA_ "CANFD_BRS" BO_ 926 1;
BA_ "GenMsgCycleTime" BO_ 926 50;
BA_ "GenMsgCycleTimeFast" BO_ 926 0;
BA_ "GenMsgSendType" BO_ 926 0;
BA_ "VFrameFormat" BO_ 926 14;
BA_ "CANFD_BRS" BO_ 926 1;
BA_ "GenMsgCycleTime" BO_ 926 50;
BA_ "GenMsgCycleTimeFast" BO_ 926 0;
BA_ "GenMsgSendType" BO_ 926 0;
BA_ "VFrameFormat" BO_ 926 14;
BA_ "CANFD_BRS" BO_ 926 1;
BA_ "GenMsgCycleTime" BO_ 926 50;
BA_ "GenMsgCycleTimeFast" BO_ 926 0;
BA_ "GenMsgSendType" BO_ 926 0;
BA_ "VFrameFormat" BO_ 926 14;
BA_ "CANFD_BRS" BO_ 926 1;
BA_ "GenMsgCycleTime" BO_ 926 50;
BA_ "GenMsgCycleTimeFast" BO_ 926 0;
BA_ "GenMsgSendType" BO_ 926 0;
BA_ "VFrameFormat" BO_ 926 14;
BA_ "CANFD_BRS" BO_ 926 1;
BA_ "GenMsgCycleTime" BO_ 927 50;
BA_ "GenMsgCycleTimeFast" BO_ 927 0;
BA_ "GenMsgSendType" BO_ 927 0;
BA_ "VFrameFormat" BO_ 927 14;
BA_ "CANFD_BRS" BO_ 927 1;
BA_ "GenMsgCycleTime" BO_ 927 50;
BA_ "GenMsgCycleTimeFast" BO_ 927 0;
BA_ "GenMsgSendType" BO_ 927 0;
BA_ "VFrameFormat" BO_ 927 14;
BA_ "CANFD_BRS" BO_ 927 1;
BA_ "GenMsgCycleTime" BO_ 927 50;
BA_ "GenMsgCycleTimeFast" BO_ 927 0;
BA_ "GenMsgSendType" BO_ 927 0;
BA_ "VFrameFormat" BO_ 927 14;
BA_ "CANFD_BRS" BO_ 927 1;
BA_ "GenMsgCycleTime" BO_ 927 50;
BA_ "GenMsgCycleTimeFast" BO_ 927 0;
BA_ "GenMsgSendType" BO_ 927 0;
BA_ "VFrameFormat" BO_ 927 14;
BA_ "CANFD_BRS" BO_ 927 1;
BA_ "GenMsgCycleTime" BO_ 927 50;
BA_ "GenMsgCycleTimeFast" BO_ 927 0;
BA_ "GenMsgSendType" BO_ 927 0;
BA_ "VFrameFormat" BO_ 927 14;
BA_ "CANFD_BRS" BO_ 927 1;
BA_ "GenMsgCycleTime" BO_ 927 50;
BA_ "GenMsgCycleTimeFast" BO_ 927 0;
BA_ "GenMsgSendType" BO_ 927 0;
BA_ "VFrameFormat" BO_ 927 14;
BA_ "CANFD_BRS" BO_ 927 1;
BA_ "GenMsgCycleTime" BO_ 927 50;
BA_ "GenMsgCycleTimeFast" BO_ 927 0;
BA_ "GenMsgSendType" BO_ 927 0;
BA_ "VFrameFormat" BO_ 927 14;
BA_ "CANFD_BRS" BO_ 927 1;
BA_ "GenMsgCycleTime" BO_ 927 50;
BA_ "GenMsgCycleTimeFast" BO_ 927 0;
BA_ "GenMsgSendType" BO_ 927 0;
BA_ "VFrameFormat" BO_ 927 14;
BA_ "CANFD_BRS" BO_ 927 1;
BA_ "GenMsgCycleTime" BO_ 927 50;
BA_ "GenMsgCycleTimeFast" BO_ 927 0;
BA_ "GenMsgSendType" BO_ 927 0;
BA_ "VFrameFormat" BO_ 927 14;
BA_ "CANFD_BRS" BO_ 927 1;
BA_ "GenMsgCycleTime" BO_ 932 50;
BA_ "GenMsgCycleTimeFast" BO_ 932 0;
BA_ "GenMsgSendType" BO_ 932 0;
BA_ "VFrameFormat" BO_ 932 14;
BA_ "CANFD_BRS" BO_ 932 1;
BA_ "GenMsgCycleTime" BO_ 932 50;
BA_ "GenMsgCycleTimeFast" BO_ 932 0;
BA_ "GenMsgSendType" BO_ 932 0;
BA_ "VFrameFormat" BO_ 932 14;
BA_ "CANFD_BRS" BO_ 932 1;
BA_ "GenMsgCycleTime" BO_ 932 50;
BA_ "GenMsgCycleTimeFast" BO_ 932 0;
BA_ "GenMsgSendType" BO_ 932 0;
BA_ "VFrameFormat" BO_ 932 14;
BA_ "CANFD_BRS" BO_ 932 1;
BA_ "GenMsgCycleTime" BO_ 932 50;
BA_ "GenMsgCycleTimeFast" BO_ 932 0;
BA_ "GenMsgSendType" BO_ 932 0;
BA_ "VFrameFormat" BO_ 932 14;
BA_ "CANFD_BRS" BO_ 932 1;
BA_ "GenMsgCycleTime" BO_ 932 50;
BA_ "GenMsgCycleTimeFast" BO_ 932 0;
BA_ "GenMsgSendType" BO_ 932 0;
BA_ "VFrameFormat" BO_ 932 14;
BA_ "CANFD_BRS" BO_ 932 1;
BA_ "GenMsgCycleTime" BO_ 932 50;
BA_ "GenMsgCycleTimeFast" BO_ 932 0;
BA_ "GenMsgSendType" BO_ 932 0;
BA_ "VFrameFormat" BO_ 932 14;
BA_ "CANFD_BRS" BO_ 932 1;
BA_ "GenMsgCycleTime" BO_ 932 50;
BA_ "GenMsgCycleTimeFast" BO_ 932 0;
BA_ "GenMsgSendType" BO_ 932 0;
BA_ "VFrameFormat" BO_ 932 14;
BA_ "CANFD_BRS" BO_ 932 1;
BA_ "GenMsgCycleTime" BO_ 932 50;
BA_ "GenMsgCycleTimeFast" BO_ 932 0;
BA_ "GenMsgSendType" BO_ 932 0;
BA_ "VFrameFormat" BO_ 932 14;
BA_ "CANFD_BRS" BO_ 932 1;
BA_ "GenMsgCycleTime" BO_ 932 50;
BA_ "GenMsgCycleTimeFast" BO_ 932 0;
BA_ "GenMsgSendType" BO_ 932 0;
BA_ "VFrameFormat" BO_ 932 14;
BA_ "CANFD_BRS" BO_ 932 1;
BA_ "GenMsgCycleTime" BO_ 932 50;
BA_ "GenMsgCycleTimeFast" BO_ 932 0;
BA_ "GenMsgSendType" BO_ 932 0;
BA_ "VFrameFormat" BO_ 932 14;
BA_ "CANFD_BRS" BO_ 932 1;
BA_ "GenMsgCycleTime" BO_ 932 50;
BA_ "GenMsgCycleTimeFast" BO_ 932 0;
BA_ "GenMsgSendType" BO_ 932 0;
BA_ "VFrameFormat" BO_ 932 14;
BA_ "CANFD_BRS" BO_ 932 1;
BA_ "GenMsgCycleTime" BO_ 932 50;
BA_ "GenMsgCycleTimeFast" BO_ 932 0;
BA_ "GenMsgSendType" BO_ 932 0;
BA_ "VFrameFormat" BO_ 932 14;
BA_ "CANFD_BRS" BO_ 932 1;
BA_ "GenMsgCycleTime" BO_ 932 50;
BA_ "GenMsgCycleTimeFast" BO_ 932 0;
BA_ "GenMsgSendType" BO_ 932 0;
BA_ "VFrameFormat" BO_ 932 14;
BA_ "CANFD_BRS" BO_ 932 1;
BA_ "GenMsgCycleTime" BO_ 932 50;
BA_ "GenMsgCycleTimeFast" BO_ 932 0;
BA_ "GenMsgSendType" BO_ 932 0;
BA_ "VFrameFormat" BO_ 932 14;
BA_ "CANFD_BRS" BO_ 932 1;
BA_ "GenMsgCycleTime" BO_ 932 50;
BA_ "GenMsgCycleTimeFast" BO_ 932 0;
BA_ "GenMsgSendType" BO_ 932 0;
BA_ "VFrameFormat" BO_ 932 14;
BA_ "CANFD_BRS" BO_ 932 1;
BA_ "GenMsgCycleTime" BO_ 932 50;
BA_ "GenMsgCycleTimeFast" BO_ 932 0;
BA_ "GenMsgSendType" BO_ 932 0;
BA_ "VFrameFormat" BO_ 932 14;
BA_ "CANFD_BRS" BO_ 932 1;
BA_ "GenMsgCycleTime" BO_ 932 50;
BA_ "GenMsgCycleTimeFast" BO_ 932 0;
BA_ "GenMsgSendType" BO_ 932 0;
BA_ "VFrameFormat" BO_ 932 14;
BA_ "CANFD_BRS" BO_ 932 1;
BA_ "GenMsgCycleTime" BO_ 932 50;
BA_ "GenMsgCycleTimeFast" BO_ 932 0;
BA_ "GenMsgSendType" BO_ 932 0;
BA_ "VFrameFormat" BO_ 932 14;
BA_ "CANFD_BRS" BO_ 932 1;
BA_ "GenMsgCycleTime" BO_ 932 50;
BA_ "GenMsgCycleTimeFast" BO_ 932 0;
BA_ "GenMsgSendType" BO_ 932 0;
BA_ "VFrameFormat" BO_ 932 14;
BA_ "CANFD_BRS" BO_ 932 1;
BA_ "GenMsgCycleTime" BO_ 932 50;
BA_ "GenMsgCycleTimeFast" BO_ 932 0;
BA_ "GenMsgSendType" BO_ 932 0;
BA_ "VFrameFormat" BO_ 932 14;
BA_ "CANFD_BRS" BO_ 932 1;
BA_ "GenMsgCycleTime" BO_ 932 50;
BA_ "GenMsgCycleTimeFast" BO_ 932 0;
BA_ "GenMsgSendType" BO_ 932 0;
BA_ "VFrameFormat" BO_ 932 14;
BA_ "CANFD_BRS" BO_ 932 1;
BA_ "GenMsgCycleTime" BO_ 932 50;
BA_ "GenMsgCycleTimeFast" BO_ 932 0;
BA_ "GenMsgSendType" BO_ 932 0;
BA_ "VFrameFormat" BO_ 932 14;
BA_ "CANFD_BRS" BO_ 932 1;
BA_ "GenMsgCycleTime" BO_ 932 50;
BA_ "GenMsgCycleTimeFast" BO_ 932 0;
BA_ "GenMsgSendType" BO_ 932 0;
BA_ "VFrameFormat" BO_ 932 14;
BA_ "CANFD_BRS" BO_ 932 1;
BA_ "GenMsgCycleTime" BO_ 932 50;
BA_ "GenMsgCycleTimeFast" BO_ 932 0;
BA_ "GenMsgSendType" BO_ 932 0;
BA_ "VFrameFormat" BO_ 932 14;
BA_ "CANFD_BRS" BO_ 932 1;
BA_ "GenMsgCycleTime" BO_ 932 50;
BA_ "GenMsgCycleTimeFast" BO_ 932 0;
BA_ "GenMsgSendType" BO_ 932 0;
BA_ "VFrameFormat" BO_ 932 14;
BA_ "CANFD_BRS" BO_ 932 1;
BA_ "GenMsgCycleTime" BO_ 932 50;
BA_ "GenMsgCycleTimeFast" BO_ 932 0;
BA_ "GenMsgSendType" BO_ 932 0;
BA_ "VFrameFormat" BO_ 932 14;
BA_ "CANFD_BRS" BO_ 932 1;
BA_ "GenMsgCycleTime" BO_ 987 50;
BA_ "GenMsgCycleTimeFast" BO_ 987 0;
BA_ "GenMsgSendType" BO_ 987 0;
BA_ "VFrameFormat" BO_ 987 14;
BA_ "CANFD_BRS" BO_ 987 1;
BA_ "GenMsgCycleTime" BO_ 987 50;
BA_ "GenMsgCycleTimeFast" BO_ 987 0;
BA_ "GenMsgSendType" BO_ 987 0;
BA_ "VFrameFormat" BO_ 987 14;
BA_ "CANFD_BRS" BO_ 987 1;
BA_ "GenMsgCycleTime" BO_ 987 50;
BA_ "GenMsgCycleTimeFast" BO_ 987 0;
BA_ "GenMsgSendType" BO_ 987 0;
BA_ "VFrameFormat" BO_ 987 14;
BA_ "CANFD_BRS" BO_ 987 1;
BA_ "GenMsgCycleTime" BO_ 987 50;
BA_ "GenMsgCycleTimeFast" BO_ 987 0;
BA_ "GenMsgSendType" BO_ 987 0;
BA_ "VFrameFormat" BO_ 987 14;
BA_ "CANFD_BRS" BO_ 987 1;
BA_ "GenMsgCycleTime" BO_ 987 50;
BA_ "GenMsgCycleTimeFast" BO_ 987 0;
BA_ "GenMsgSendType" BO_ 987 0;
BA_ "VFrameFormat" BO_ 987 14;
BA_ "CANFD_BRS" BO_ 987 1;
BA_ "GenMsgCycleTime" BO_ 987 50;
BA_ "GenMsgCycleTimeFast" BO_ 987 0;
BA_ "GenMsgSendType" BO_ 987 0;
BA_ "VFrameFormat" BO_ 987 14;
BA_ "CANFD_BRS" BO_ 987 1;
BA_ "GenMsgCycleTime" BO_ 987 50;
BA_ "GenMsgCycleTimeFast" BO_ 987 0;
BA_ "GenMsgSendType" BO_ 987 0;
BA_ "VFrameFormat" BO_ 987 14;
BA_ "CANFD_BRS" BO_ 987 1;
BA_ "GenMsgCycleTime" BO_ 987 50;
BA_ "GenMsgCycleTimeFast" BO_ 987 0;
BA_ "GenMsgSendType" BO_ 987 0;
BA_ "VFrameFormat" BO_ 987 14;
BA_ "CANFD_BRS" BO_ 987 1;
BA_ "GenMsgCycleTime" BO_ 987 50;
BA_ "GenMsgCycleTimeFast" BO_ 987 0;
BA_ "GenMsgSendType" BO_ 987 0;
BA_ "VFrameFormat" BO_ 987 14;
BA_ "CANFD_BRS" BO_ 987 1;
BA_ "GenMsgCycleTime" BO_ 987 50;
BA_ "GenMsgCycleTimeFast" BO_ 987 0;
BA_ "GenMsgSendType" BO_ 987 0;
BA_ "VFrameFormat" BO_ 987 14;
BA_ "CANFD_BRS" BO_ 987 1;
BA_ "GenMsgCycleTime" BO_ 987 50;
BA_ "GenMsgCycleTimeFast" BO_ 987 0;
BA_ "GenMsgSendType" BO_ 987 0;
BA_ "VFrameFormat" BO_ 987 14;
BA_ "CANFD_BRS" BO_ 987 1;
BA_ "GenMsgCycleTime" BO_ 987 50;
BA_ "GenMsgCycleTimeFast" BO_ 987 0;
BA_ "GenMsgSendType" BO_ 987 0;
BA_ "VFrameFormat" BO_ 987 14;
BA_ "CANFD_BRS" BO_ 987 1;
BA_ "GenMsgCycleTime" BO_ 987 50;
BA_ "GenMsgCycleTimeFast" BO_ 987 0;
BA_ "GenMsgSendType" BO_ 987 0;
BA_ "VFrameFormat" BO_ 987 14;
BA_ "CANFD_BRS" BO_ 987 1;
BA_ "GenMsgCycleTime" BO_ 987 50;
BA_ "GenMsgCycleTimeFast" BO_ 987 0;
BA_ "GenMsgSendType" BO_ 987 0;
BA_ "VFrameFormat" BO_ 987 14;
BA_ "CANFD_BRS" BO_ 987 1;
BA_ "GenMsgCycleTime" BO_ 987 50;
BA_ "GenMsgCycleTimeFast" BO_ 987 0;
BA_ "GenMsgSendType" BO_ 987 0;
BA_ "VFrameFormat" BO_ 987 14;
BA_ "CANFD_BRS" BO_ 987 1;
BA_ "GenMsgCycleTime" BO_ 987 50;
BA_ "GenMsgCycleTimeFast" BO_ 987 0;
BA_ "GenMsgSendType" BO_ 987 0;
BA_ "VFrameFormat" BO_ 987 14;
BA_ "CANFD_BRS" BO_ 987 1;
BA_ "GenMsgCycleTime" BO_ 987 50;
BA_ "GenMsgCycleTimeFast" BO_ 987 0;
BA_ "GenMsgSendType" BO_ 987 0;
BA_ "VFrameFormat" BO_ 987 14;
BA_ "CANFD_BRS" BO_ 987 1;
BA_ "GenMsgCycleTime" BO_ 987 50;
BA_ "GenMsgCycleTimeFast" BO_ 987 0;
BA_ "GenMsgSendType" BO_ 987 0;
BA_ "VFrameFormat" BO_ 987 14;
BA_ "CANFD_BRS" BO_ 987 1;
BA_ "GenMsgCycleTime" BO_ 987 50;
BA_ "GenMsgCycleTimeFast" BO_ 987 0;
BA_ "GenMsgSendType" BO_ 987 0;
BA_ "VFrameFormat" BO_ 987 14;
BA_ "CANFD_BRS" BO_ 987 1;
BA_ "GenMsgCycleTime" BO_ 987 50;
BA_ "GenMsgCycleTimeFast" BO_ 987 0;
BA_ "GenMsgSendType" BO_ 987 0;
BA_ "VFrameFormat" BO_ 987 14;
BA_ "CANFD_BRS" BO_ 987 1;
BA_ "GenMsgCycleTime" BO_ 987 50;
BA_ "GenMsgCycleTimeFast" BO_ 987 0;
BA_ "GenMsgSendType" BO_ 987 0;
BA_ "VFrameFormat" BO_ 987 14;
BA_ "CANFD_BRS" BO_ 987 1;
BA_ "GenMsgCycleTime" BO_ 987 50;
BA_ "GenMsgCycleTimeFast" BO_ 987 0;
BA_ "GenMsgSendType" BO_ 987 0;
BA_ "VFrameFormat" BO_ 987 14;
BA_ "CANFD_BRS" BO_ 987 1;
BA_ "GenMsgCycleTime" BO_ 987 50;
BA_ "GenMsgCycleTimeFast" BO_ 987 0;
BA_ "GenMsgSendType" BO_ 987 0;
BA_ "VFrameFormat" BO_ 987 14;
BA_ "CANFD_BRS" BO_ 987 1;
BA_ "GenMsgCycleTime" BO_ 987 50;
BA_ "GenMsgCycleTimeFast" BO_ 987 0;
BA_ "GenMsgSendType" BO_ 987 0;
BA_ "VFrameFormat" BO_ 987 14;
BA_ "CANFD_BRS" BO_ 987 1;
BA_ "GenMsgCycleTime" BO_ 987 50;
BA_ "GenMsgCycleTimeFast" BO_ 987 0;
BA_ "GenMsgSendType" BO_ 987 0;
BA_ "VFrameFormat" BO_ 987 14;
BA_ "CANFD_BRS" BO_ 987 1;
BA_ "GenMsgCycleTime" BO_ 987 50;
BA_ "GenMsgCycleTimeFast" BO_ 987 0;
BA_ "GenMsgSendType" BO_ 987 0;
BA_ "VFrameFormat" BO_ 987 14;
BA_ "CANFD_BRS" BO_ 987 1;
BA_ "GenMsgCycleTime" BO_ 987 50;
BA_ "GenMsgCycleTimeFast" BO_ 987 0;
BA_ "GenMsgSendType" BO_ 987 0;
BA_ "VFrameFormat" BO_ 987 14;
BA_ "CANFD_BRS" BO_ 987 1;
BA_ "GenMsgCycleTime" BO_ 93 0;
BA_ "GenMsgCycleTimeFast" BO_ 93 0;
BA_ "GenMsgSendType" BO_ 93 1;
BA_ "VFrameFormat" BO_ 93 14;
BA_ "CANFD_BRS" BO_ 93 1;
BA_ "GenMsgCycleTime" BO_ 766 50;
BA_ "GenMsgCycleTimeFast" BO_ 766 0;
BA_ "GenMsgSendType" BO_ 766 0;
BA_ "VFrameFormat" BO_ 766 14;
BA_ "CANFD_BRS" BO_ 766 1;
BA_ "GenMsgCycleTime" BO_ 766 50;
BA_ "GenMsgCycleTimeFast" BO_ 766 0;
BA_ "GenMsgSendType" BO_ 766 0;
BA_ "VFrameFormat" BO_ 766 14;
BA_ "CANFD_BRS" BO_ 766 1;
BA_ "GenMsgCycleTime" BO_ 766 50;
BA_ "GenMsgCycleTimeFast" BO_ 766 0;
BA_ "GenMsgSendType" BO_ 766 0;
BA_ "VFrameFormat" BO_ 766 14;
BA_ "CANFD_BRS" BO_ 766 1;
BA_ "GenMsgCycleTime" BO_ 766 50;
BA_ "GenMsgCycleTimeFast" BO_ 766 0;
BA_ "GenMsgSendType" BO_ 766 0;
BA_ "VFrameFormat" BO_ 766 14;
BA_ "CANFD_BRS" BO_ 766 1;
BA_ "GenMsgCycleTime" BO_ 766 50;
BA_ "GenMsgCycleTimeFast" BO_ 766 0;
BA_ "GenMsgSendType" BO_ 766 0;
BA_ "VFrameFormat" BO_ 766 14;
BA_ "CANFD_BRS" BO_ 766 1;
BA_ "GenMsgCycleTime" BO_ 766 50;
BA_ "GenMsgCycleTimeFast" BO_ 766 0;
BA_ "GenMsgSendType" BO_ 766 0;
BA_ "VFrameFormat" BO_ 766 14;
BA_ "CANFD_BRS" BO_ 766 1;
BA_ "GenMsgCycleTime" BO_ 766 50;
BA_ "GenMsgCycleTimeFast" BO_ 766 0;
BA_ "GenMsgSendType" BO_ 766 0;
BA_ "VFrameFormat" BO_ 766 14;
BA_ "CANFD_BRS" BO_ 766 1;
BA_ "GenMsgCycleTime" BO_ 766 50;
BA_ "GenMsgCycleTimeFast" BO_ 766 0;
BA_ "GenMsgSendType" BO_ 766 0;
BA_ "VFrameFormat" BO_ 766 14;
BA_ "CANFD_BRS" BO_ 766 1;
BA_ "GenMsgCycleTime" BO_ 766 50;
BA_ "GenMsgCycleTimeFast" BO_ 766 0;
BA_ "GenMsgSendType" BO_ 766 0;
BA_ "VFrameFormat" BO_ 766 14;
BA_ "CANFD_BRS" BO_ 766 1;
BA_ "GenMsgCycleTime" BO_ 766 50;
BA_ "GenMsgCycleTimeFast" BO_ 766 0;
BA_ "GenMsgSendType" BO_ 766 0;
BA_ "VFrameFormat" BO_ 766 14;
BA_ "CANFD_BRS" BO_ 766 1;
BA_ "GenMsgCycleTime" BO_ 766 50;
BA_ "GenMsgCycleTimeFast" BO_ 766 0;
BA_ "GenMsgSendType" BO_ 766 0;
BA_ "VFrameFormat" BO_ 766 14;
BA_ "CANFD_BRS" BO_ 766 1;
BA_ "GenMsgCycleTime" BO_ 766 50;
BA_ "GenMsgCycleTimeFast" BO_ 766 0;
BA_ "GenMsgSendType" BO_ 766 0;
BA_ "VFrameFormat" BO_ 766 14;
BA_ "CANFD_BRS" BO_ 766 1;
BA_ "GenMsgCycleTime" BO_ 766 50;
BA_ "GenMsgCycleTimeFast" BO_ 766 0;
BA_ "GenMsgSendType" BO_ 766 0;
BA_ "VFrameFormat" BO_ 766 14;
BA_ "CANFD_BRS" BO_ 766 1;
BA_ "GenMsgCycleTime" BO_ 766 50;
BA_ "GenMsgCycleTimeFast" BO_ 766 0;
BA_ "GenMsgSendType" BO_ 766 0;
BA_ "VFrameFormat" BO_ 766 14;
BA_ "CANFD_BRS" BO_ 766 1;
BA_ "GenMsgCycleTime" BO_ 766 50;
BA_ "GenMsgCycleTimeFast" BO_ 766 0;
BA_ "GenMsgSendType" BO_ 766 0;
BA_ "VFrameFormat" BO_ 766 14;
BA_ "CANFD_BRS" BO_ 766 1;
BA_ "GenMsgCycleTime" BO_ 766 50;
BA_ "GenMsgCycleTimeFast" BO_ 766 0;
BA_ "GenMsgSendType" BO_ 766 0;
BA_ "VFrameFormat" BO_ 766 14;
BA_ "CANFD_BRS" BO_ 766 1;
BA_ "GenMsgCycleTime" BO_ 766 50;
BA_ "GenMsgCycleTimeFast" BO_ 766 0;
BA_ "GenMsgSendType" BO_ 766 0;
BA_ "VFrameFormat" BO_ 766 14;
BA_ "CANFD_BRS" BO_ 766 1;
BA_ "GenMsgCycleTime" BO_ 766 50;
BA_ "GenMsgCycleTimeFast" BO_ 766 0;
BA_ "GenMsgSendType" BO_ 766 0;
BA_ "VFrameFormat" BO_ 766 14;
BA_ "CANFD_BRS" BO_ 766 1;
BA_ "GenMsgCycleTime" BO_ 766 50;
BA_ "GenMsgCycleTimeFast" BO_ 766 0;
BA_ "GenMsgSendType" BO_ 766 0;
BA_ "VFrameFormat" BO_ 766 14;
BA_ "CANFD_BRS" BO_ 766 1;
BA_ "GenMsgCycleTime" BO_ 766 50;
BA_ "GenMsgCycleTimeFast" BO_ 766 0;
BA_ "GenMsgSendType" BO_ 766 0;
BA_ "VFrameFormat" BO_ 766 14;
BA_ "CANFD_BRS" BO_ 766 1;
BA_ "GenMsgCycleTime" BO_ 766 50;
BA_ "GenMsgCycleTimeFast" BO_ 766 0;
BA_ "GenMsgSendType" BO_ 766 0;
BA_ "VFrameFormat" BO_ 766 14;
BA_ "CANFD_BRS" BO_ 766 1;
BA_ "GenMsgCycleTime" BO_ 766 50;
BA_ "GenMsgCycleTimeFast" BO_ 766 0;
BA_ "GenMsgSendType" BO_ 766 0;
BA_ "VFrameFormat" BO_ 766 14;
BA_ "CANFD_BRS" BO_ 766 1;
BA_ "GenMsgCycleTime" BO_ 766 50;
BA_ "GenMsgCycleTimeFast" BO_ 766 0;
BA_ "GenMsgSendType" BO_ 766 0;
BA_ "VFrameFormat" BO_ 766 14;
BA_ "CANFD_BRS" BO_ 766 1;
BA_ "GenMsgCycleTime" BO_ 766 50;
BA_ "GenMsgCycleTimeFast" BO_ 766 0;
BA_ "GenMsgSendType" BO_ 766 0;
BA_ "VFrameFormat" BO_ 766 14;
BA_ "CANFD_BRS" BO_ 766 1;
BA_ "GenMsgCycleTime" BO_ 1007 200;
BA_ "GenMsgCycleTimeFast" BO_ 1007 0;
BA_ "GenMsgSendType" BO_ 1007 0;
BA_ "VFrameFormat" BO_ 1007 14;
BA_ "CANFD_BRS" BO_ 1007 1;
BA_ "GenMsgCycleTime" BO_ 459 20;
BA_ "GenMsgCycleTimeFast" BO_ 459 0;
BA_ "GenMsgSendType" BO_ 459 0;
BA_ "VFrameFormat" BO_ 459 14;
BA_ "CANFD_BRS" BO_ 459 1;
BA_ "GenMsgCycleTime" BO_ 459 20;
BA_ "GenMsgCycleTimeFast" BO_ 459 0;
BA_ "GenMsgSendType" BO_ 459 0;
BA_ "VFrameFormat" BO_ 459 14;
BA_ "CANFD_BRS" BO_ 459 1;
BA_ "GenMsgCycleTime" BO_ 459 20;
BA_ "GenMsgCycleTimeFast" BO_ 459 0;
BA_ "GenMsgSendType" BO_ 459 0;
BA_ "VFrameFormat" BO_ 459 14;
BA_ "CANFD_BRS" BO_ 459 1;
BA_ "GenMsgCycleTime" BO_ 459 20;
BA_ "GenMsgCycleTimeFast" BO_ 459 0;
BA_ "GenMsgSendType" BO_ 459 0;
BA_ "VFrameFormat" BO_ 459 14;
BA_ "CANFD_BRS" BO_ 459 1;
BA_ "GenMsgCycleTime" BO_ 459 20;
BA_ "GenMsgCycleTimeFast" BO_ 459 0;
BA_ "GenMsgSendType" BO_ 459 0;
BA_ "VFrameFormat" BO_ 459 14;
BA_ "CANFD_BRS" BO_ 459 1;
BA_ "GenMsgCycleTime" BO_ 459 20;
BA_ "GenMsgCycleTimeFast" BO_ 459 0;
BA_ "GenMsgSendType" BO_ 459 0;
BA_ "VFrameFormat" BO_ 459 14;
BA_ "CANFD_BRS" BO_ 459 1;
BA_ "GenMsgCycleTime" BO_ 459 20;
BA_ "GenMsgCycleTimeFast" BO_ 459 0;
BA_ "GenMsgSendType" BO_ 459 0;
BA_ "VFrameFormat" BO_ 459 14;
BA_ "CANFD_BRS" BO_ 459 1;
BA_ "GenMsgCycleTime" BO_ 459 20;
BA_ "GenMsgCycleTimeFast" BO_ 459 0;
BA_ "GenMsgSendType" BO_ 459 0;
BA_ "VFrameFormat" BO_ 459 14;
BA_ "CANFD_BRS" BO_ 459 1;
BA_ "GenMsgCycleTime" BO_ 459 20;
BA_ "GenMsgCycleTimeFast" BO_ 459 0;
BA_ "GenMsgSendType" BO_ 459 0;
BA_ "VFrameFormat" BO_ 459 14;
BA_ "CANFD_BRS" BO_ 459 1;
BA_ "GenMsgCycleTime" BO_ 459 20;
BA_ "GenMsgCycleTimeFast" BO_ 459 0;
BA_ "GenMsgSendType" BO_ 459 0;
BA_ "VFrameFormat" BO_ 459 14;
BA_ "CANFD_BRS" BO_ 459 1;
BA_ "GenMsgCycleTime" BO_ 459 20;
BA_ "GenMsgCycleTimeFast" BO_ 459 0;
BA_ "GenMsgSendType" BO_ 459 0;
BA_ "VFrameFormat" BO_ 459 14;
BA_ "CANFD_BRS" BO_ 459 1;
BA_ "GenMsgCycleTime" BO_ 459 20;
BA_ "GenMsgCycleTimeFast" BO_ 459 0;
BA_ "GenMsgSendType" BO_ 459 0;
BA_ "VFrameFormat" BO_ 459 14;
BA_ "CANFD_BRS" BO_ 459 1;
BA_ "GenMsgCycleTime" BO_ 459 20;
BA_ "GenMsgCycleTimeFast" BO_ 459 0;
BA_ "GenMsgSendType" BO_ 459 0;
BA_ "VFrameFormat" BO_ 459 14;
BA_ "CANFD_BRS" BO_ 459 1;
BA_ "GenMsgCycleTime" BO_ 459 20;
BA_ "GenMsgCycleTimeFast" BO_ 459 0;
BA_ "GenMsgSendType" BO_ 459 0;
BA_ "VFrameFormat" BO_ 459 14;
BA_ "CANFD_BRS" BO_ 459 1;
BA_ "GenMsgCycleTime" BO_ 459 20;
BA_ "GenMsgCycleTimeFast" BO_ 459 0;
BA_ "GenMsgSendType" BO_ 459 0;
BA_ "VFrameFormat" BO_ 459 14;
BA_ "CANFD_BRS" BO_ 459 1;
BA_ "GenMsgCycleTime" BO_ 459 20;
BA_ "GenMsgCycleTimeFast" BO_ 459 0;
BA_ "GenMsgSendType" BO_ 459 0;
BA_ "VFrameFormat" BO_ 459 14;
BA_ "CANFD_BRS" BO_ 459 1;
BA_ "GenMsgCycleTime" BO_ 459 20;
BA_ "GenMsgCycleTimeFast" BO_ 459 0;
BA_ "GenMsgSendType" BO_ 459 0;
BA_ "VFrameFormat" BO_ 459 14;
BA_ "CANFD_BRS" BO_ 459 1;
BA_ "GenMsgCycleTime" BO_ 459 20;
BA_ "GenMsgCycleTimeFast" BO_ 459 0;
BA_ "GenMsgSendType" BO_ 459 0;
BA_ "VFrameFormat" BO_ 459 14;
BA_ "CANFD_BRS" BO_ 459 1;
BA_ "GenMsgCycleTime" BO_ 459 20;
BA_ "GenMsgCycleTimeFast" BO_ 459 0;
BA_ "GenMsgSendType" BO_ 459 0;
BA_ "VFrameFormat" BO_ 459 14;
BA_ "CANFD_BRS" BO_ 459 1;
BA_ "GenMsgCycleTime" BO_ 459 20;
BA_ "GenMsgCycleTimeFast" BO_ 459 0;
BA_ "GenMsgSendType" BO_ 459 0;
BA_ "VFrameFormat" BO_ 459 14;
BA_ "CANFD_BRS" BO_ 459 1;
BA_ "GenMsgCycleTime" BO_ 459 20;
BA_ "GenMsgCycleTimeFast" BO_ 459 0;
BA_ "GenMsgSendType" BO_ 459 0;
BA_ "VFrameFormat" BO_ 459 14;
BA_ "CANFD_BRS" BO_ 459 1;
BA_ "GenMsgCycleTime" BO_ 459 20;
BA_ "GenMsgCycleTimeFast" BO_ 459 0;
BA_ "GenMsgSendType" BO_ 459 0;
BA_ "VFrameFormat" BO_ 459 14;
BA_ "CANFD_BRS" BO_ 459 1;
BA_ "GenMsgCycleTime" BO_ 459 20;
BA_ "GenMsgCycleTimeFast" BO_ 459 0;
BA_ "GenMsgSendType" BO_ 459 0;
BA_ "VFrameFormat" BO_ 459 14;
BA_ "CANFD_BRS" BO_ 459 1;
BA_ "GenMsgCycleTime" BO_ 459 20;
BA_ "GenMsgCycleTimeFast" BO_ 459 0;
BA_ "GenMsgSendType" BO_ 459 0;
BA_ "VFrameFormat" BO_ 459 14;
BA_ "CANFD_BRS" BO_ 459 1;
BA_ "GenMsgCycleTime" BO_ 459 20;
BA_ "GenMsgCycleTimeFast" BO_ 459 0;
BA_ "GenMsgSendType" BO_ 459 0;
BA_ "VFrameFormat" BO_ 459 14;
BA_ "CANFD_BRS" BO_ 459 1;
BA_ "GenMsgCycleTime" BO_ 459 20;
BA_ "GenMsgCycleTimeFast" BO_ 459 0;
BA_ "GenMsgSendType" BO_ 459 0;
BA_ "VFrameFormat" BO_ 459 14;
BA_ "CANFD_BRS" BO_ 459 1;
BA_ "GenMsgCycleTime" BO_ 459 20;
BA_ "GenMsgCycleTimeFast" BO_ 459 0;
BA_ "GenMsgSendType" BO_ 459 0;
BA_ "VFrameFormat" BO_ 459 14;
BA_ "CANFD_BRS" BO_ 459 1;
BA_ "GenMsgCycleTime" BO_ 459 20;
BA_ "GenMsgCycleTimeFast" BO_ 459 0;
BA_ "GenMsgSendType" BO_ 459 0;
BA_ "VFrameFormat" BO_ 459 14;
BA_ "CANFD_BRS" BO_ 459 1;
BA_ "GenMsgCycleTime" BO_ 459 20;
BA_ "GenMsgCycleTimeFast" BO_ 459 0;
BA_ "GenMsgSendType" BO_ 459 0;
BA_ "VFrameFormat" BO_ 459 14;
BA_ "CANFD_BRS" BO_ 459 1;
BA_ "GenMsgCycleTime" BO_ 459 20;
BA_ "GenMsgCycleTimeFast" BO_ 459 0;
BA_ "GenMsgSendType" BO_ 459 0;
BA_ "VFrameFormat" BO_ 459 14;
BA_ "CANFD_BRS" BO_ 459 1;
BA_ "GenMsgCycleTime" BO_ 459 20;
BA_ "GenMsgCycleTimeFast" BO_ 459 0;
BA_ "GenMsgSendType" BO_ 459 0;
BA_ "VFrameFormat" BO_ 459 14;
BA_ "CANFD_BRS" BO_ 459 1;
BA_ "GenMsgCycleTime" BO_ 459 20;
BA_ "GenMsgCycleTimeFast" BO_ 459 0;
BA_ "GenMsgSendType" BO_ 459 0;
BA_ "VFrameFormat" BO_ 459 14;
BA_ "CANFD_BRS" BO_ 459 1;
BA_ "EventCommandSignal" SG_ 970 ADC_ParkRelPos3_y4 0;
BA_ "GatewayedSignals" SG_ 970 ADC_ParkRelPos3_y4 0;
BA_ "GenSigInactiveValue" SG_ 970 ADC_ParkRelPos3_y4 0;
BA_ "GenSigInvalidValue" SG_ 970 ADC_ParkRelPos3_y4 0;
BA_ "GenSigSendType" SG_ 970 ADC_ParkRelPos3_y4 1;
BA_ "GenSigStartValue" SG_ 970 ADC_ParkRelPos3_y4 0;
BA_ "GenSigTimeoutValue" SG_ 970 ADC_ParkRelPos3_y4 0;
BA_ "Remark" SG_ 970 ADC_ParkRelPos3_y4 "";
BA_ "EventCommandSignal" SG_ 970 ADC_ParkRelPos4_x1 0;
BA_ "GatewayedSignals" SG_ 970 ADC_ParkRelPos4_x1 0;
BA_ "GenSigInactiveValue" SG_ 970 ADC_ParkRelPos4_x1 0;
BA_ "GenSigInvalidValue" SG_ 970 ADC_ParkRelPos4_x1 0;
BA_ "GenSigSendType" SG_ 970 ADC_ParkRelPos4_x1 1;
BA_ "GenSigStartValue" SG_ 970 ADC_ParkRelPos4_x1 0;
BA_ "GenSigTimeoutValue" SG_ 970 ADC_ParkRelPos4_x1 0;
BA_ "Remark" SG_ 970 ADC_ParkRelPos4_x1 "";
BA_ "EventCommandSignal" SG_ 970 ADC_ParkRelPos4_y1 0;
BA_ "GatewayedSignals" SG_ 970 ADC_ParkRelPos4_y1 0;
BA_ "GenSigInactiveValue" SG_ 970 ADC_ParkRelPos4_y1 0;
BA_ "GenSigInvalidValue" SG_ 970 ADC_ParkRelPos4_y1 0;
BA_ "GenSigSendType" SG_ 970 ADC_ParkRelPos4_y1 1;
BA_ "GenSigStartValue" SG_ 970 ADC_ParkRelPos4_y1 0;
BA_ "GenSigTimeoutValue" SG_ 970 ADC_ParkRelPos4_y1 0;
BA_ "Remark" SG_ 970 ADC_ParkRelPos4_y1 "";
BA_ "EventCommandSignal" SG_ 970 ADC_ParkRelPos4_x2 0;
BA_ "GatewayedSignals" SG_ 970 ADC_ParkRelPos4_x2 0;
BA_ "GenSigInactiveValue" SG_ 970 ADC_ParkRelPos4_x2 0;
BA_ "GenSigInvalidValue" SG_ 970 ADC_ParkRelPos4_x2 0;
BA_ "GenSigSendType" SG_ 970 ADC_ParkRelPos4_x2 1;
BA_ "GenSigStartValue" SG_ 970 ADC_ParkRelPos4_x2 0;
BA_ "GenSigTimeoutValue" SG_ 970 ADC_ParkRelPos4_x2 0;
BA_ "Remark" SG_ 970 ADC_ParkRelPos4_x2 "";
BA_ "EventCommandSignal" SG_ 970 ADC_ParkRelPos4_y2 0;
BA_ "GatewayedSignals" SG_ 970 ADC_ParkRelPos4_y2 0;
BA_ "GenSigInactiveValue" SG_ 970 ADC_ParkRelPos4_y2 0;
BA_ "GenSigInvalidValue" SG_ 970 ADC_ParkRelPos4_y2 0;
BA_ "GenSigSendType" SG_ 970 ADC_ParkRelPos4_y2 1;
BA_ "GenSigStartValue" SG_ 970 ADC_ParkRelPos4_y2 0;
BA_ "GenSigTimeoutValue" SG_ 970 ADC_ParkRelPos4_y2 0;
BA_ "Remark" SG_ 970 ADC_ParkRelPos4_y2 "";
BA_ "EventCommandSignal" SG_ 970 ADC_ParkRelPos4_x3 0;
BA_ "GatewayedSignals" SG_ 970 ADC_ParkRelPos4_x3 0;
BA_ "GenSigInactiveValue" SG_ 970 ADC_ParkRelPos4_x3 0;
BA_ "GenSigInvalidValue" SG_ 970 ADC_ParkRelPos4_x3 0;
BA_ "GenSigSendType" SG_ 970 ADC_ParkRelPos4_x3 1;
BA_ "GenSigStartValue" SG_ 970 ADC_ParkRelPos4_x3 0;
BA_ "GenSigTimeoutValue" SG_ 970 ADC_ParkRelPos4_x3 0;
BA_ "Remark" SG_ 970 ADC_ParkRelPos4_x3 "";
BA_ "EventCommandSignal" SG_ 970 ADC_ParkRelPos4_y3 0;
BA_ "GatewayedSignals" SG_ 970 ADC_ParkRelPos4_y3 0;
BA_ "GenSigInactiveValue" SG_ 970 ADC_ParkRelPos4_y3 0;
BA_ "GenSigInvalidValue" SG_ 970 ADC_ParkRelPos4_y3 0;
BA_ "GenSigSendType" SG_ 970 ADC_ParkRelPos4_y3 1;
BA_ "GenSigStartValue" SG_ 970 ADC_ParkRelPos4_y3 0;
BA_ "GenSigTimeoutValue" SG_ 970 ADC_ParkRelPos4_y3 0;
BA_ "Remark" SG_ 970 ADC_ParkRelPos4_y3 "";
BA_ "EventCommandSignal" SG_ 970 ADC_ParkRelPos4_x4 0;
BA_ "GatewayedSignals" SG_ 970 ADC_ParkRelPos4_x4 0;
BA_ "GenSigInactiveValue" SG_ 970 ADC_ParkRelPos4_x4 0;
BA_ "GenSigInvalidValue" SG_ 970 ADC_ParkRelPos4_x4 0;
BA_ "GenSigSendType" SG_ 970 ADC_ParkRelPos4_x4 1;
BA_ "GenSigStartValue" SG_ 970 ADC_ParkRelPos4_x4 0;
BA_ "GenSigTimeoutValue" SG_ 970 ADC_ParkRelPos4_x4 0;
BA_ "Remark" SG_ 970 ADC_ParkRelPos4_x4 "";
BA_ "EventCommandSignal" SG_ 970 ADC_ParkRelPos4_y4 0;
BA_ "GatewayedSignals" SG_ 970 ADC_ParkRelPos4_y4 0;
BA_ "GenSigInactiveValue" SG_ 970 ADC_ParkRelPos4_y4 0;
BA_ "GenSigInvalidValue" SG_ 970 ADC_ParkRelPos4_y4 0;
BA_ "GenSigSendType" SG_ 970 ADC_ParkRelPos4_y4 1;
BA_ "GenSigStartValue" SG_ 970 ADC_ParkRelPos4_y4 0;
BA_ "GenSigTimeoutValue" SG_ 970 ADC_ParkRelPos4_y4 0;
BA_ "Remark" SG_ 970 ADC_ParkRelPos4_y4 "";
BA_ "EventCommandSignal" SG_ 971 ADC_MnvrOrintChng6 0;
BA_ "GatewayedSignals" SG_ 971 ADC_MnvrOrintChng6 0;
BA_ "GenSigInactiveValue" SG_ 971 ADC_MnvrOrintChng6 0;
BA_ "GenSigInvalidValue" SG_ 971 ADC_MnvrOrintChng6 0;
BA_ "GenSigSendType" SG_ 971 ADC_MnvrOrintChng6 1;
BA_ "GenSigStartValue" SG_ 971 ADC_MnvrOrintChng6 0;
BA_ "GenSigTimeoutValue" SG_ 971 ADC_MnvrOrintChng6 0;
BA_ "Remark" SG_ 971 ADC_MnvrOrintChng6 "";
BA_ "EventCommandSignal" SG_ 971 ADC_TarParkSt_Posn6 0;
BA_ "GatewayedSignals" SG_ 971 ADC_TarParkSt_Posn6 0;
BA_ "GenSigInactiveValue" SG_ 971 ADC_TarParkSt_Posn6 0;
BA_ "GenSigInvalidValue" SG_ 971 ADC_TarParkSt_Posn6 0;
BA_ "GenSigSendType" SG_ 971 ADC_TarParkSt_Posn6 1;
BA_ "GenSigStartValue" SG_ 971 ADC_TarParkSt_Posn6 0;
BA_ "GenSigTimeoutValue" SG_ 971 ADC_TarParkSt_Posn6 0;
BA_ "Remark" SG_ 971 ADC_TarParkSt_Posn6 "";
BA_ "EventCommandSignal" SG_ 971 ADC_ParkChkSrc_Posn6 0;
BA_ "GatewayedSignals" SG_ 971 ADC_ParkChkSrc_Posn6 0;
BA_ "GenSigInactiveValue" SG_ 971 ADC_ParkChkSrc_Posn6 0;
BA_ "GenSigInvalidValue" SG_ 971 ADC_ParkChkSrc_Posn6 0;
BA_ "GenSigSendType" SG_ 971 ADC_ParkChkSrc_Posn6 1;
BA_ "GenSigStartValue" SG_ 971 ADC_ParkChkSrc_Posn6 0;
BA_ "GenSigTimeoutValue" SG_ 971 ADC_ParkChkSrc_Posn6 0;
BA_ "Remark" SG_ 971 ADC_ParkChkSrc_Posn6 "";
BA_ "EventCommandSignal" SG_ 971 ADC_ParkPosn7_ID 0;
BA_ "GatewayedSignals" SG_ 971 ADC_ParkPosn7_ID 0;
BA_ "GenSigInactiveValue" SG_ 971 ADC_ParkPosn7_ID 0;
BA_ "GenSigInvalidValue" SG_ 971 ADC_ParkPosn7_ID 0;
BA_ "GenSigSendType" SG_ 971 ADC_ParkPosn7_ID 1;
BA_ "GenSigStartValue" SG_ 971 ADC_ParkPosn7_ID 0;
BA_ "GenSigTimeoutValue" SG_ 971 ADC_ParkPosn7_ID 0;
BA_ "Remark" SG_ 971 ADC_ParkPosn7_ID "";
BA_ "EventCommandSignal" SG_ 971 ADC_MnvrOrintChng7 0;
BA_ "GatewayedSignals" SG_ 971 ADC_MnvrOrintChng7 0;
BA_ "GenSigInactiveValue" SG_ 971 ADC_MnvrOrintChng7 0;
BA_ "GenSigInvalidValue" SG_ 971 ADC_MnvrOrintChng7 0;
BA_ "GenSigSendType" SG_ 971 ADC_MnvrOrintChng7 1;
BA_ "GenSigStartValue" SG_ 971 ADC_MnvrOrintChng7 0;
BA_ "GenSigTimeoutValue" SG_ 971 ADC_MnvrOrintChng7 0;
BA_ "Remark" SG_ 971 ADC_MnvrOrintChng7 "";
BA_ "EventCommandSignal" SG_ 971 ADC_TarParkSt_Posn7 0;
BA_ "GatewayedSignals" SG_ 971 ADC_TarParkSt_Posn7 0;
BA_ "GenSigInactiveValue" SG_ 971 ADC_TarParkSt_Posn7 0;
BA_ "GenSigInvalidValue" SG_ 971 ADC_TarParkSt_Posn7 0;
BA_ "GenSigSendType" SG_ 971 ADC_TarParkSt_Posn7 1;
BA_ "GenSigStartValue" SG_ 971 ADC_TarParkSt_Posn7 0;
BA_ "GenSigTimeoutValue" SG_ 971 ADC_TarParkSt_Posn7 0;
BA_ "Remark" SG_ 971 ADC_TarParkSt_Posn7 "";
BA_ "EventCommandSignal" SG_ 971 ADC_ParkChkSrc_Posn7 0;
BA_ "GatewayedSignals" SG_ 971 ADC_ParkChkSrc_Posn7 0;
BA_ "GenSigInactiveValue" SG_ 971 ADC_ParkChkSrc_Posn7 0;
BA_ "GenSigInvalidValue" SG_ 971 ADC_ParkChkSrc_Posn7 0;
BA_ "GenSigSendType" SG_ 971 ADC_ParkChkSrc_Posn7 1;
BA_ "GenSigStartValue" SG_ 971 ADC_ParkChkSrc_Posn7 0;
BA_ "GenSigTimeoutValue" SG_ 971 ADC_ParkChkSrc_Posn7 0;
BA_ "Remark" SG_ 971 ADC_ParkChkSrc_Posn7 "";
BA_ "EventCommandSignal" SG_ 971 ADC_ParkPosn8_ID 0;
BA_ "GatewayedSignals" SG_ 971 ADC_ParkPosn8_ID 0;
BA_ "GenSigInactiveValue" SG_ 971 ADC_ParkPosn8_ID 0;
BA_ "GenSigInvalidValue" SG_ 971 ADC_ParkPosn8_ID 0;
BA_ "GenSigSendType" SG_ 971 ADC_ParkPosn8_ID 1;
BA_ "GenSigStartValue" SG_ 971 ADC_ParkPosn8_ID 0;
BA_ "GenSigTimeoutValue" SG_ 971 ADC_ParkPosn8_ID 0;
BA_ "Remark" SG_ 971 ADC_ParkPosn8_ID "";
BA_ "EventCommandSignal" SG_ 971 ADC_MnvrOrintChng8 0;
BA_ "GatewayedSignals" SG_ 971 ADC_MnvrOrintChng8 0;
BA_ "GenSigInactiveValue" SG_ 971 ADC_MnvrOrintChng8 0;
BA_ "GenSigInvalidValue" SG_ 971 ADC_MnvrOrintChng8 0;
BA_ "GenSigSendType" SG_ 971 ADC_MnvrOrintChng8 1;
BA_ "GenSigStartValue" SG_ 971 ADC_MnvrOrintChng8 0;
BA_ "GenSigTimeoutValue" SG_ 971 ADC_MnvrOrintChng8 0;
BA_ "Remark" SG_ 971 ADC_MnvrOrintChng8 "";
BA_ "EventCommandSignal" SG_ 971 ADC_TarParkSt_Posn8 0;
BA_ "GatewayedSignals" SG_ 971 ADC_TarParkSt_Posn8 0;
BA_ "GenSigInactiveValue" SG_ 971 ADC_TarParkSt_Posn8 0;
BA_ "GenSigInvalidValue" SG_ 971 ADC_TarParkSt_Posn8 0;
BA_ "GenSigSendType" SG_ 971 ADC_TarParkSt_Posn8 1;
BA_ "GenSigStartValue" SG_ 971 ADC_TarParkSt_Posn8 0;
BA_ "GenSigTimeoutValue" SG_ 971 ADC_TarParkSt_Posn8 0;
BA_ "Remark" SG_ 971 ADC_TarParkSt_Posn8 "";
BA_ "EventCommandSignal" SG_ 971 ADC_ParkChkSrc_Posn8 0;
BA_ "GatewayedSignals" SG_ 971 ADC_ParkChkSrc_Posn8 0;
BA_ "GenSigInactiveValue" SG_ 971 ADC_ParkChkSrc_Posn8 0;
BA_ "GenSigInvalidValue" SG_ 971 ADC_ParkChkSrc_Posn8 0;
BA_ "GenSigSendType" SG_ 971 ADC_ParkChkSrc_Posn8 1;
BA_ "GenSigStartValue" SG_ 971 ADC_ParkChkSrc_Posn8 0;
BA_ "GenSigTimeoutValue" SG_ 971 ADC_ParkChkSrc_Posn8 0;
BA_ "Remark" SG_ 971 ADC_ParkChkSrc_Posn8 "";
BA_ "EventCommandSignal" SG_ 971 ADC_ParkRelPos5_x1 0;
BA_ "GatewayedSignals" SG_ 971 ADC_ParkRelPos5_x1 0;
BA_ "GenSigInactiveValue" SG_ 971 ADC_ParkRelPos5_x1 0;
BA_ "GenSigInvalidValue" SG_ 971 ADC_ParkRelPos5_x1 0;
BA_ "GenSigSendType" SG_ 971 ADC_ParkRelPos5_x1 1;
BA_ "GenSigStartValue" SG_ 971 ADC_ParkRelPos5_x1 0;
BA_ "GenSigTimeoutValue" SG_ 971 ADC_ParkRelPos5_x1 0;
BA_ "Remark" SG_ 971 ADC_ParkRelPos5_x1 "";
BA_ "EventCommandSignal" SG_ 971 ADC_ParkRelPos5_y1 0;
BA_ "GatewayedSignals" SG_ 971 ADC_ParkRelPos5_y1 0;
BA_ "GenSigInactiveValue" SG_ 971 ADC_ParkRelPos5_y1 0;
BA_ "GenSigInvalidValue" SG_ 971 ADC_ParkRelPos5_y1 0;
BA_ "GenSigSendType" SG_ 971 ADC_ParkRelPos5_y1 1;
BA_ "GenSigStartValue" SG_ 971 ADC_ParkRelPos5_y1 0;
BA_ "GenSigTimeoutValue" SG_ 971 ADC_ParkRelPos5_y1 0;
BA_ "Remark" SG_ 971 ADC_ParkRelPos5_y1 "";
BA_ "EventCommandSignal" SG_ 971 ADC_ParkRelPos5_x2 0;
BA_ "GatewayedSignals" SG_ 971 ADC_ParkRelPos5_x2 0;
BA_ "GenSigInactiveValue" SG_ 971 ADC_ParkRelPos5_x2 0;
BA_ "GenSigInvalidValue" SG_ 971 ADC_ParkRelPos5_x2 0;
BA_ "GenSigSendType" SG_ 971 ADC_ParkRelPos5_x2 1;
BA_ "GenSigStartValue" SG_ 971 ADC_ParkRelPos5_x2 0;
BA_ "GenSigTimeoutValue" SG_ 971 ADC_ParkRelPos5_x2 0;
BA_ "Remark" SG_ 971 ADC_ParkRelPos5_x2 "";
BA_ "EventCommandSignal" SG_ 971 ADC_ParkRelPos5_y2 0;
BA_ "GatewayedSignals" SG_ 971 ADC_ParkRelPos5_y2 0;
BA_ "GenSigInactiveValue" SG_ 971 ADC_ParkRelPos5_y2 0;
BA_ "GenSigInvalidValue" SG_ 971 ADC_ParkRelPos5_y2 0;
BA_ "GenSigSendType" SG_ 971 ADC_ParkRelPos5_y2 1;
BA_ "GenSigStartValue" SG_ 971 ADC_ParkRelPos5_y2 0;
BA_ "GenSigTimeoutValue" SG_ 971 ADC_ParkRelPos5_y2 0;
BA_ "Remark" SG_ 971 ADC_ParkRelPos5_y2 "";
BA_ "EventCommandSignal" SG_ 971 ADC_ParkRelPos5_x3 0;
BA_ "GatewayedSignals" SG_ 971 ADC_ParkRelPos5_x3 0;
BA_ "GenSigInactiveValue" SG_ 971 ADC_ParkRelPos5_x3 0;
BA_ "GenSigInvalidValue" SG_ 971 ADC_ParkRelPos5_x3 0;
BA_ "GenSigSendType" SG_ 971 ADC_ParkRelPos5_x3 1;
BA_ "GenSigStartValue" SG_ 971 ADC_ParkRelPos5_x3 0;
BA_ "GenSigTimeoutValue" SG_ 971 ADC_ParkRelPos5_x3 0;
BA_ "Remark" SG_ 971 ADC_ParkRelPos5_x3 "";
BA_ "EventCommandSignal" SG_ 971 ADC_ParkRelPos5_y3 0;
BA_ "GatewayedSignals" SG_ 971 ADC_ParkRelPos5_y3 0;
BA_ "GenSigInactiveValue" SG_ 971 ADC_ParkRelPos5_y3 0;
BA_ "GenSigInvalidValue" SG_ 971 ADC_ParkRelPos5_y3 0;
BA_ "GenSigSendType" SG_ 971 ADC_ParkRelPos5_y3 1;
BA_ "GenSigStartValue" SG_ 971 ADC_ParkRelPos5_y3 0;
BA_ "GenSigTimeoutValue" SG_ 971 ADC_ParkRelPos5_y3 0;
BA_ "Remark" SG_ 971 ADC_ParkRelPos5_y3 "";
BA_ "EventCommandSignal" SG_ 971 ADC_ParkRelPos5_x4 0;
BA_ "GatewayedSignals" SG_ 971 ADC_ParkRelPos5_x4 0;
BA_ "GenSigInactiveValue" SG_ 971 ADC_ParkRelPos5_x4 0;
BA_ "GenSigInvalidValue" SG_ 971 ADC_ParkRelPos5_x4 0;
BA_ "GenSigSendType" SG_ 971 ADC_ParkRelPos5_x4 1;
BA_ "GenSigStartValue" SG_ 971 ADC_ParkRelPos5_x4 0;
BA_ "GenSigTimeoutValue" SG_ 971 ADC_ParkRelPos5_x4 0;
BA_ "Remark" SG_ 971 ADC_ParkRelPos5_x4 "";
BA_ "EventCommandSignal" SG_ 971 ADC_ParkRelPos5_y4 0;
BA_ "GatewayedSignals" SG_ 971 ADC_ParkRelPos5_y4 0;
BA_ "GenSigInactiveValue" SG_ 971 ADC_ParkRelPos5_y4 0;
BA_ "GenSigInvalidValue" SG_ 971 ADC_ParkRelPos5_y4 0;
BA_ "GenSigSendType" SG_ 971 ADC_ParkRelPos5_y4 1;
BA_ "GenSigStartValue" SG_ 971 ADC_ParkRelPos5_y4 0;
BA_ "GenSigTimeoutValue" SG_ 971 ADC_ParkRelPos5_y4 0;
BA_ "Remark" SG_ 971 ADC_ParkRelPos5_y4 "";
BA_ "EventCommandSignal" SG_ 971 ADC_ParkRelPos6_x1 0;
BA_ "GatewayedSignals" SG_ 971 ADC_ParkRelPos6_x1 0;
BA_ "GenSigInactiveValue" SG_ 971 ADC_ParkRelPos6_x1 0;
BA_ "GenSigInvalidValue" SG_ 971 ADC_ParkRelPos6_x1 0;
BA_ "GenSigSendType" SG_ 971 ADC_ParkRelPos6_x1 1;
BA_ "GenSigStartValue" SG_ 971 ADC_ParkRelPos6_x1 0;
BA_ "GenSigTimeoutValue" SG_ 971 ADC_ParkRelPos6_x1 0;
BA_ "Remark" SG_ 971 ADC_ParkRelPos6_x1 "";
BA_ "EventCommandSignal" SG_ 971 ADC_ParkRelPos6_y1 0;
BA_ "GatewayedSignals" SG_ 971 ADC_ParkRelPos6_y1 0;
BA_ "GenSigInactiveValue" SG_ 971 ADC_ParkRelPos6_y1 0;
BA_ "GenSigInvalidValue" SG_ 971 ADC_ParkRelPos6_y1 0;
BA_ "GenSigSendType" SG_ 971 ADC_ParkRelPos6_y1 1;
BA_ "GenSigStartValue" SG_ 971 ADC_ParkRelPos6_y1 0;
BA_ "GenSigTimeoutValue" SG_ 971 ADC_ParkRelPos6_y1 0;
BA_ "Remark" SG_ 971 ADC_ParkRelPos6_y1 "";
BA_ "EventCommandSignal" SG_ 971 ADC_ParkRelPos6_x2 0;
BA_ "GatewayedSignals" SG_ 971 ADC_ParkRelPos6_x2 0;
BA_ "GenSigInactiveValue" SG_ 971 ADC_ParkRelPos6_x2 0;
BA_ "GenSigInvalidValue" SG_ 971 ADC_ParkRelPos6_x2 0;
BA_ "GenSigSendType" SG_ 971 ADC_ParkRelPos6_x2 1;
BA_ "GenSigStartValue" SG_ 971 ADC_ParkRelPos6_x2 0;
BA_ "GenSigTimeoutValue" SG_ 971 ADC_ParkRelPos6_x2 0;
BA_ "Remark" SG_ 971 ADC_ParkRelPos6_x2 "";
BA_ "EventCommandSignal" SG_ 971 ADC_ParkRelPos6_y2 0;
BA_ "GatewayedSignals" SG_ 971 ADC_ParkRelPos6_y2 0;
BA_ "GenSigInactiveValue" SG_ 971 ADC_ParkRelPos6_y2 0;
BA_ "GenSigInvalidValue" SG_ 971 ADC_ParkRelPos6_y2 0;
BA_ "GenSigSendType" SG_ 971 ADC_ParkRelPos6_y2 1;
BA_ "GenSigStartValue" SG_ 971 ADC_ParkRelPos6_y2 0;
BA_ "GenSigTimeoutValue" SG_ 971 ADC_ParkRelPos6_y2 0;
BA_ "Remark" SG_ 971 ADC_ParkRelPos6_y2 "";
BA_ "EventCommandSignal" SG_ 971 ADC_ParkRelPos6_x3 0;
BA_ "GatewayedSignals" SG_ 971 ADC_ParkRelPos6_x3 0;
BA_ "GenSigInactiveValue" SG_ 971 ADC_ParkRelPos6_x3 0;
BA_ "GenSigInvalidValue" SG_ 971 ADC_ParkRelPos6_x3 0;
BA_ "GenSigSendType" SG_ 971 ADC_ParkRelPos6_x3 1;
BA_ "GenSigStartValue" SG_ 971 ADC_ParkRelPos6_x3 0;
BA_ "GenSigTimeoutValue" SG_ 971 ADC_ParkRelPos6_x3 0;
BA_ "Remark" SG_ 971 ADC_ParkRelPos6_x3 "";
BA_ "EventCommandSignal" SG_ 971 ADC_ParkRelPos6_y3 0;
BA_ "GatewayedSignals" SG_ 971 ADC_ParkRelPos6_y3 0;
BA_ "GenSigInactiveValue" SG_ 971 ADC_ParkRelPos6_y3 0;
BA_ "GenSigInvalidValue" SG_ 971 ADC_ParkRelPos6_y3 0;
BA_ "GenSigSendType" SG_ 971 ADC_ParkRelPos6_y3 1;
BA_ "GenSigStartValue" SG_ 971 ADC_ParkRelPos6_y3 0;
BA_ "GenSigTimeoutValue" SG_ 971 ADC_ParkRelPos6_y3 0;
BA_ "Remark" SG_ 971 ADC_ParkRelPos6_y3 "";
BA_ "EventCommandSignal" SG_ 971 ADC_ParkRelPos6_x4 0;
BA_ "GatewayedSignals" SG_ 971 ADC_ParkRelPos6_x4 0;
BA_ "GenSigInactiveValue" SG_ 971 ADC_ParkRelPos6_x4 0;
BA_ "GenSigInvalidValue" SG_ 971 ADC_ParkRelPos6_x4 0;
BA_ "GenSigSendType" SG_ 971 ADC_ParkRelPos6_x4 1;
BA_ "GenSigStartValue" SG_ 971 ADC_ParkRelPos6_x4 0;
BA_ "GenSigTimeoutValue" SG_ 971 ADC_ParkRelPos6_x4 0;
BA_ "Remark" SG_ 971 ADC_ParkRelPos6_x4 "";
BA_ "EventCommandSignal" SG_ 971 ADC_ParkRelPos6_y4 0;
BA_ "GatewayedSignals" SG_ 971 ADC_ParkRelPos6_y4 0;
BA_ "GenSigInactiveValue" SG_ 971 ADC_ParkRelPos6_y4 0;
BA_ "GenSigInvalidValue" SG_ 971 ADC_ParkRelPos6_y4 0;
BA_ "GenSigSendType" SG_ 971 ADC_ParkRelPos6_y4 1;
BA_ "GenSigStartValue" SG_ 971 ADC_ParkRelPos6_y4 0;
BA_ "GenSigTimeoutValue" SG_ 971 ADC_ParkRelPos6_y4 0;
BA_ "Remark" SG_ 971 ADC_ParkRelPos6_y4 "";
BA_ "EventCommandSignal" SG_ 971 ADC_ParkRelPos7_x1 0;
BA_ "GatewayedSignals" SG_ 971 ADC_ParkRelPos7_x1 0;
BA_ "GenSigInactiveValue" SG_ 971 ADC_ParkRelPos7_x1 0;
BA_ "GenSigInvalidValue" SG_ 971 ADC_ParkRelPos7_x1 0;
BA_ "GenSigSendType" SG_ 971 ADC_ParkRelPos7_x1 1;
BA_ "GenSigStartValue" SG_ 971 ADC_ParkRelPos7_x1 0;
BA_ "GenSigTimeoutValue" SG_ 971 ADC_ParkRelPos7_x1 0;
BA_ "Remark" SG_ 971 ADC_ParkRelPos7_x1 "";
BA_ "EventCommandSignal" SG_ 971 ADC_ParkRelPos7_y1 0;
BA_ "GatewayedSignals" SG_ 971 ADC_ParkRelPos7_y1 0;
BA_ "GenSigInactiveValue" SG_ 971 ADC_ParkRelPos7_y1 0;
BA_ "GenSigInvalidValue" SG_ 971 ADC_ParkRelPos7_y1 0;
BA_ "GenSigSendType" SG_ 971 ADC_ParkRelPos7_y1 1;
BA_ "GenSigStartValue" SG_ 971 ADC_ParkRelPos7_y1 0;
BA_ "GenSigTimeoutValue" SG_ 971 ADC_ParkRelPos7_y1 0;
BA_ "Remark" SG_ 971 ADC_ParkRelPos7_y1 "";
BA_ "EventCommandSignal" SG_ 971 ADC_ParkRelPos7_x2 0;
BA_ "GatewayedSignals" SG_ 971 ADC_ParkRelPos7_x2 0;
BA_ "GenSigInactiveValue" SG_ 971 ADC_ParkRelPos7_x2 0;
BA_ "GenSigInvalidValue" SG_ 971 ADC_ParkRelPos7_x2 0;
BA_ "GenSigSendType" SG_ 971 ADC_ParkRelPos7_x2 1;
BA_ "GenSigStartValue" SG_ 971 ADC_ParkRelPos7_x2 0;
BA_ "GenSigTimeoutValue" SG_ 971 ADC_ParkRelPos7_x2 0;
BA_ "Remark" SG_ 971 ADC_ParkRelPos7_x2 "";
BA_ "EventCommandSignal" SG_ 971 ADC_ParkRelPos7_y2 0;
BA_ "GatewayedSignals" SG_ 971 ADC_ParkRelPos7_y2 0;
BA_ "GenSigInactiveValue" SG_ 971 ADC_ParkRelPos7_y2 0;
BA_ "GenSigInvalidValue" SG_ 971 ADC_ParkRelPos7_y2 0;
BA_ "GenSigSendType" SG_ 971 ADC_ParkRelPos7_y2 1;
BA_ "GenSigStartValue" SG_ 971 ADC_ParkRelPos7_y2 0;
BA_ "GenSigTimeoutValue" SG_ 971 ADC_ParkRelPos7_y2 0;
BA_ "Remark" SG_ 971 ADC_ParkRelPos7_y2 "";
BA_ "EventCommandSignal" SG_ 971 ADC_ParkRelPos7_x3 0;
BA_ "GatewayedSignals" SG_ 971 ADC_ParkRelPos7_x3 0;
BA_ "GenSigInactiveValue" SG_ 971 ADC_ParkRelPos7_x3 0;
BA_ "GenSigInvalidValue" SG_ 971 ADC_ParkRelPos7_x3 0;
BA_ "GenSigSendType" SG_ 971 ADC_ParkRelPos7_x3 1;
BA_ "GenSigStartValue" SG_ 971 ADC_ParkRelPos7_x3 0;
BA_ "GenSigTimeoutValue" SG_ 971 ADC_ParkRelPos7_x3 0;
BA_ "Remark" SG_ 971 ADC_ParkRelPos7_x3 "";
BA_ "EventCommandSignal" SG_ 971 ADC_ParkRelPos7_y3 0;
BA_ "GatewayedSignals" SG_ 971 ADC_ParkRelPos7_y3 0;
BA_ "GenSigInactiveValue" SG_ 971 ADC_ParkRelPos7_y3 0;
BA_ "GenSigInvalidValue" SG_ 971 ADC_ParkRelPos7_y3 0;
BA_ "GenSigSendType" SG_ 971 ADC_ParkRelPos7_y3 1;
BA_ "GenSigStartValue" SG_ 971 ADC_ParkRelPos7_y3 0;
BA_ "GenSigTimeoutValue" SG_ 971 ADC_ParkRelPos7_y3 0;
BA_ "Remark" SG_ 971 ADC_ParkRelPos7_y3 "";
BA_ "EventCommandSignal" SG_ 971 ADC_ParkRelPos7_x4 0;
BA_ "GatewayedSignals" SG_ 971 ADC_ParkRelPos7_x4 0;
BA_ "GenSigInactiveValue" SG_ 971 ADC_ParkRelPos7_x4 0;
BA_ "GenSigInvalidValue" SG_ 971 ADC_ParkRelPos7_x4 0;
BA_ "GenSigSendType" SG_ 971 ADC_ParkRelPos7_x4 1;
BA_ "GenSigStartValue" SG_ 971 ADC_ParkRelPos7_x4 0;
BA_ "GenSigTimeoutValue" SG_ 971 ADC_ParkRelPos7_x4 0;
BA_ "Remark" SG_ 971 ADC_ParkRelPos7_x4 "";
BA_ "EventCommandSignal" SG_ 971 ADC_ParkRelPos7_y4 0;
BA_ "GatewayedSignals" SG_ 971 ADC_ParkRelPos7_y4 0;
BA_ "GenSigInactiveValue" SG_ 971 ADC_ParkRelPos7_y4 0;
BA_ "GenSigInvalidValue" SG_ 971 ADC_ParkRelPos7_y4 0;
BA_ "GenSigSendType" SG_ 971 ADC_ParkRelPos7_y4 1;
BA_ "GenSigStartValue" SG_ 971 ADC_ParkRelPos7_y4 0;
BA_ "GenSigTimeoutValue" SG_ 971 ADC_ParkRelPos7_y4 0;
BA_ "Remark" SG_ 971 ADC_ParkRelPos7_y4 "";
BA_ "EventCommandSignal" SG_ 971 ADC_ParkRelPos8_x1 0;
BA_ "GatewayedSignals" SG_ 971 ADC_ParkRelPos8_x1 0;
BA_ "GenSigInactiveValue" SG_ 971 ADC_ParkRelPos8_x1 0;
BA_ "GenSigInvalidValue" SG_ 971 ADC_ParkRelPos8_x1 0;
BA_ "GenSigSendType" SG_ 971 ADC_ParkRelPos8_x1 1;
BA_ "GenSigStartValue" SG_ 971 ADC_ParkRelPos8_x1 0;
BA_ "GenSigTimeoutValue" SG_ 971 ADC_ParkRelPos8_x1 0;
BA_ "Remark" SG_ 971 ADC_ParkRelPos8_x1 "";
BA_ "EventCommandSignal" SG_ 971 ADC_ParkRelPos8_y1 0;
BA_ "GatewayedSignals" SG_ 971 ADC_ParkRelPos8_y1 0;
BA_ "GenSigInactiveValue" SG_ 971 ADC_ParkRelPos8_y1 0;
BA_ "GenSigInvalidValue" SG_ 971 ADC_ParkRelPos8_y1 0;
BA_ "GenSigSendType" SG_ 971 ADC_ParkRelPos8_y1 1;
BA_ "GenSigStartValue" SG_ 971 ADC_ParkRelPos8_y1 0;
BA_ "GenSigTimeoutValue" SG_ 971 ADC_ParkRelPos8_y1 0;
BA_ "Remark" SG_ 971 ADC_ParkRelPos8_y1 "";
BA_ "EventCommandSignal" SG_ 971 ADC_ParkRelPos8_x2 0;
BA_ "GatewayedSignals" SG_ 971 ADC_ParkRelPos8_x2 0;
BA_ "GenSigInactiveValue" SG_ 971 ADC_ParkRelPos8_x2 0;
BA_ "GenSigInvalidValue" SG_ 971 ADC_ParkRelPos8_x2 0;
BA_ "GenSigSendType" SG_ 971 ADC_ParkRelPos8_x2 1;
BA_ "GenSigStartValue" SG_ 971 ADC_ParkRelPos8_x2 0;
BA_ "GenSigTimeoutValue" SG_ 971 ADC_ParkRelPos8_x2 0;
BA_ "Remark" SG_ 971 ADC_ParkRelPos8_x2 "";
BA_ "EventCommandSignal" SG_ 971 ADC_ParkRelPos8_y2 0;
BA_ "GatewayedSignals" SG_ 971 ADC_ParkRelPos8_y2 0;
BA_ "GenSigInactiveValue" SG_ 971 ADC_ParkRelPos8_y2 0;
BA_ "GenSigInvalidValue" SG_ 971 ADC_ParkRelPos8_y2 0;
BA_ "GenSigSendType" SG_ 971 ADC_ParkRelPos8_y2 1;
BA_ "GenSigStartValue" SG_ 971 ADC_ParkRelPos8_y2 0;
BA_ "GenSigTimeoutValue" SG_ 971 ADC_ParkRelPos8_y2 0;
BA_ "Remark" SG_ 971 ADC_ParkRelPos8_y2 "";
BA_ "EventCommandSignal" SG_ 971 ADC_ParkRelPos8_x3 0;
BA_ "GatewayedSignals" SG_ 971 ADC_ParkRelPos8_x3 0;
BA_ "GenSigInactiveValue" SG_ 971 ADC_ParkRelPos8_x3 0;
BA_ "GenSigInvalidValue" SG_ 971 ADC_ParkRelPos8_x3 0;
BA_ "GenSigSendType" SG_ 971 ADC_ParkRelPos8_x3 1;
BA_ "GenSigStartValue" SG_ 971 ADC_ParkRelPos8_x3 0;
BA_ "GenSigTimeoutValue" SG_ 971 ADC_ParkRelPos8_x3 0;
BA_ "Remark" SG_ 971 ADC_ParkRelPos8_x3 "";
BA_ "EventCommandSignal" SG_ 971 ADC_ParkRelPos8_y3 0;
BA_ "GatewayedSignals" SG_ 971 ADC_ParkRelPos8_y3 0;
BA_ "GenSigInactiveValue" SG_ 971 ADC_ParkRelPos8_y3 0;
BA_ "GenSigInvalidValue" SG_ 971 ADC_ParkRelPos8_y3 0;
BA_ "GenSigSendType" SG_ 971 ADC_ParkRelPos8_y3 1;
BA_ "GenSigStartValue" SG_ 971 ADC_ParkRelPos8_y3 0;
BA_ "GenSigTimeoutValue" SG_ 971 ADC_ParkRelPos8_y3 0;
BA_ "Remark" SG_ 971 ADC_ParkRelPos8_y3 "";
BA_ "EventCommandSignal" SG_ 971 ADC_ParkRelPos8_x4 0;
BA_ "GatewayedSignals" SG_ 971 ADC_ParkRelPos8_x4 0;
BA_ "GenSigInactiveValue" SG_ 971 ADC_ParkRelPos8_x4 0;
BA_ "GenSigInvalidValue" SG_ 971 ADC_ParkRelPos8_x4 0;
BA_ "GenSigSendType" SG_ 971 ADC_ParkRelPos8_x4 1;
BA_ "GenSigStartValue" SG_ 971 ADC_ParkRelPos8_x4 0;
BA_ "GenSigTimeoutValue" SG_ 971 ADC_ParkRelPos8_x4 0;
BA_ "Remark" SG_ 971 ADC_ParkRelPos8_x4 "";
BA_ "EventCommandSignal" SG_ 971 ADC_ParkRelPos8_y4 0;
BA_ "GatewayedSignals" SG_ 971 ADC_ParkRelPos8_y4 0;
BA_ "GenSigInactiveValue" SG_ 971 ADC_ParkRelPos8_y4 0;
BA_ "GenSigInvalidValue" SG_ 971 ADC_ParkRelPos8_y4 0;
BA_ "GenSigSendType" SG_ 971 ADC_ParkRelPos8_y4 1;
BA_ "GenSigStartValue" SG_ 971 ADC_ParkRelPos8_y4 0;
BA_ "GenSigTimeoutValue" SG_ 971 ADC_ParkRelPos8_y4 0;
BA_ "Remark" SG_ 971 ADC_ParkRelPos8_y4 "";
BA_ "EventCommandSignal" SG_ 971 ADC_ParkPosn5_ID 0;
BA_ "GatewayedSignals" SG_ 971 ADC_ParkPosn5_ID 0;
BA_ "GenSigInactiveValue" SG_ 971 ADC_ParkPosn5_ID 0;
BA_ "GenSigInvalidValue" SG_ 971 ADC_ParkPosn5_ID 0;
BA_ "GenSigSendType" SG_ 971 ADC_ParkPosn5_ID 1;
BA_ "GenSigStartValue" SG_ 971 ADC_ParkPosn5_ID 0;
BA_ "GenSigTimeoutValue" SG_ 971 ADC_ParkPosn5_ID 0;
BA_ "Remark" SG_ 971 ADC_ParkPosn5_ID "";
BA_ "EventCommandSignal" SG_ 971 ADC_MnvrOrintChng5 0;
BA_ "GatewayedSignals" SG_ 971 ADC_MnvrOrintChng5 0;
BA_ "GenSigInactiveValue" SG_ 971 ADC_MnvrOrintChng5 0;
BA_ "GenSigInvalidValue" SG_ 971 ADC_MnvrOrintChng5 0;
BA_ "GenSigSendType" SG_ 971 ADC_MnvrOrintChng5 1;
BA_ "GenSigStartValue" SG_ 971 ADC_MnvrOrintChng5 0;
BA_ "GenSigTimeoutValue" SG_ 971 ADC_MnvrOrintChng5 0;
BA_ "Remark" SG_ 971 ADC_MnvrOrintChng5 "";
BA_ "EventCommandSignal" SG_ 971 ADC_TarParkSt_Posn5 0;
BA_ "GatewayedSignals" SG_ 971 ADC_TarParkSt_Posn5 0;
BA_ "GenSigInactiveValue" SG_ 971 ADC_TarParkSt_Posn5 0;
BA_ "GenSigInvalidValue" SG_ 971 ADC_TarParkSt_Posn5 0;
BA_ "GenSigSendType" SG_ 971 ADC_TarParkSt_Posn5 1;
BA_ "GenSigStartValue" SG_ 971 ADC_TarParkSt_Posn5 0;
BA_ "GenSigTimeoutValue" SG_ 971 ADC_TarParkSt_Posn5 0;
BA_ "Remark" SG_ 971 ADC_TarParkSt_Posn5 "";
BA_ "EventCommandSignal" SG_ 971 ADC_ParkChkSrc_Posn5 0;
BA_ "GatewayedSignals" SG_ 971 ADC_ParkChkSrc_Posn5 0;
BA_ "GenSigInactiveValue" SG_ 971 ADC_ParkChkSrc_Posn5 0;
BA_ "GenSigInvalidValue" SG_ 971 ADC_ParkChkSrc_Posn5 0;
BA_ "GenSigSendType" SG_ 971 ADC_ParkChkSrc_Posn5 1;
BA_ "GenSigStartValue" SG_ 971 ADC_ParkChkSrc_Posn5 0;
BA_ "GenSigTimeoutValue" SG_ 971 ADC_ParkChkSrc_Posn5 0;
BA_ "Remark" SG_ 971 ADC_ParkChkSrc_Posn5 "";
BA_ "EventCommandSignal" SG_ 971 ADC_ParkPosn6_ID 0;
BA_ "GatewayedSignals" SG_ 971 ADC_ParkPosn6_ID 0;
BA_ "GenSigInactiveValue" SG_ 971 ADC_ParkPosn6_ID 0;
BA_ "GenSigInvalidValue" SG_ 971 ADC_ParkPosn6_ID 0;
BA_ "GenSigSendType" SG_ 971 ADC_ParkPosn6_ID 1;
BA_ "GenSigStartValue" SG_ 971 ADC_ParkPosn6_ID 0;
BA_ "GenSigTimeoutValue" SG_ 971 ADC_ParkPosn6_ID 0;
BA_ "Remark" SG_ 971 ADC_ParkPosn6_ID "";
BA_ "EventCommandSignal" SG_ 134 Theft_Auth_ADCCode 1;
BA_ "GatewayedSignals" SG_ 134 Theft_Auth_ADCCode 0;
BA_ "GenSigInactiveValue" SG_ 134 Theft_Auth_ADCCode 0;
BA_ "GenSigInvalidValue" SG_ 134 Theft_Auth_ADCCode 0;
BA_ "GenSigSendType" SG_ 134 Theft_Auth_ADCCode 0;
BA_ "GenSigStartValue" SG_ 134 Theft_Auth_ADCCode 0;
BA_ "GenSigTimeoutValue" SG_ 134 Theft_Auth_ADCCode 0;
BA_ "Remark" SG_ 134 Theft_Auth_ADCCode "";
BA_ "EventCommandSignal" SG_ 135 ADC_VIMCode 1;
BA_ "GatewayedSignals" SG_ 135 ADC_VIMCode 0;
BA_ "GenSigInactiveValue" SG_ 135 ADC_VIMCode 0;
BA_ "GenSigInvalidValue" SG_ 135 ADC_VIMCode 0;
BA_ "GenSigSendType" SG_ 135 ADC_VIMCode 0;
BA_ "GenSigStartValue" SG_ 135 ADC_VIMCode 0;
BA_ "GenSigTimeoutValue" SG_ 135 ADC_VIMCode 0;
BA_ "Remark" SG_ 135 ADC_VIMCode "";
BA_ "EventCommandSignal" SG_ 120 CCU_SEC_KEY_Defaultencoding 1;
BA_ "GatewayedSignals" SG_ 120 CCU_SEC_KEY_Defaultencoding 0;
BA_ "GenSigInactiveValue" SG_ 120 CCU_SEC_KEY_Defaultencoding 0;
BA_ "GenSigInvalidValue" SG_ 120 CCU_SEC_KEY_Defaultencoding 0;
BA_ "GenSigSendType" SG_ 120 CCU_SEC_KEY_Defaultencoding 0;
BA_ "GenSigStartValue" SG_ 120 CCU_SEC_KEY_Defaultencoding 0;
BA_ "GenSigTimeoutValue" SG_ 120 CCU_SEC_KEY_Defaultencoding 0;
BA_ "Remark" SG_ 120 CCU_SEC_KEY_Defaultencoding "";
BA_ "EventCommandSignal" SG_ 121 ADC_SEC_KEY_Defaultencoding 1;
BA_ "GatewayedSignals" SG_ 121 ADC_SEC_KEY_Defaultencoding 0;
BA_ "GenSigInactiveValue" SG_ 121 ADC_SEC_KEY_Defaultencoding 0;
BA_ "GenSigInvalidValue" SG_ 121 ADC_SEC_KEY_Defaultencoding 0;
BA_ "GenSigSendType" SG_ 121 ADC_SEC_KEY_Defaultencoding 0;
BA_ "GenSigStartValue" SG_ 121 ADC_SEC_KEY_Defaultencoding 0;
BA_ "GenSigTimeoutValue" SG_ 121 ADC_SEC_KEY_Defaultencoding 0;
BA_ "Remark" SG_ 121 ADC_SEC_KEY_Defaultencoding "";
BA_ "EventCommandSignal" SG_ 619 EPB_FailSt_L 0;
BA_ "GatewayedSignals" SG_ 619 EPB_FailSt_L 0;
BA_ "GenSigInactiveValue" SG_ 619 EPB_FailSt_L 0;
BA_ "GenSigInvalidValue" SG_ 619 EPB_FailSt_L 0;
BA_ "GenSigSendType" SG_ 619 EPB_FailSt_L 1;
BA_ "GenSigStartValue" SG_ 619 EPB_FailSt_L 0;
BA_ "GenSigTimeoutValue" SG_ 619 EPB_FailSt_L 1;
BA_ "Remark" SG_ 619 EPB_FailSt_L "";
BA_ "EventCommandSignal" SG_ 619 EPB_ExtAvailable_L 0;
BA_ "GatewayedSignals" SG_ 619 EPB_ExtAvailable_L 0;
BA_ "GenSigInactiveValue" SG_ 619 EPB_ExtAvailable_L 0;
BA_ "GenSigInvalidValue" SG_ 619 EPB_ExtAvailable_L 0;
BA_ "GenSigSendType" SG_ 619 EPB_ExtAvailable_L 1;
BA_ "GenSigStartValue" SG_ 619 EPB_ExtAvailable_L 0;
BA_ "GenSigTimeoutValue" SG_ 619 EPB_ExtAvailable_L 0;
BA_ "Remark" SG_ 619 EPB_ExtAvailable_L "";
BA_ "EventCommandSignal" SG_ 619 EPB_ActuatorSt_L 0;
BA_ "GatewayedSignals" SG_ 619 EPB_ActuatorSt_L 0;
BA_ "GenSigInactiveValue" SG_ 619 EPB_ActuatorSt_L 0;
BA_ "GenSigInvalidValue" SG_ 619 EPB_ActuatorSt_L 0;
BA_ "GenSigSendType" SG_ 619 EPB_ActuatorSt_L 1;
BA_ "GenSigStartValue" SG_ 619 EPB_ActuatorSt_L 0;
BA_ "GenSigTimeoutValue" SG_ 619 EPB_ActuatorSt_L 0;
BA_ "Remark" SG_ 619 EPB_ActuatorSt_L "";
BA_ "EventCommandSignal" SG_ 1043 TEL_Time_Year 0;
BA_ "GatewayedSignals" SG_ 1043 TEL_Time_Year 0;
BA_ "GenSigInactiveValue" SG_ 1043 TEL_Time_Year 0;
BA_ "GenSigInvalidValue" SG_ 1043 TEL_Time_Year 0;
BA_ "GenSigSendType" SG_ 1043 TEL_Time_Year 1;
BA_ "GenSigStartValue" SG_ 1043 TEL_Time_Year 15;
BA_ "GenSigTimeoutValue" SG_ 1043 TEL_Time_Year 0;
BA_ "Remark" SG_ 1043 TEL_Time_Year "";
BA_ "EventCommandSignal" SG_ 1043 TEL_Time_Month 0;
BA_ "GatewayedSignals" SG_ 1043 TEL_Time_Month 0;
BA_ "GenSigInactiveValue" SG_ 1043 TEL_Time_Month 0;
BA_ "GenSigInvalidValue" SG_ 1043 TEL_Time_Month 0;
BA_ "GenSigSendType" SG_ 1043 TEL_Time_Month 1;
BA_ "GenSigStartValue" SG_ 1043 TEL_Time_Month 1;
BA_ "GenSigTimeoutValue" SG_ 1043 TEL_Time_Month 0;
BA_ "Remark" SG_ 1043 TEL_Time_Month "";
BA_ "EventCommandSignal" SG_ 1043 TEL_Time_Hour 0;
BA_ "GatewayedSignals" SG_ 1043 TEL_Time_Hour 0;
BA_ "GenSigInactiveValue" SG_ 1043 TEL_Time_Hour 0;
BA_ "GenSigInvalidValue" SG_ 1043 TEL_Time_Hour 0;
BA_ "GenSigSendType" SG_ 1043 TEL_Time_Hour 1;
BA_ "GenSigStartValue" SG_ 1043 TEL_Time_Hour 1;
BA_ "GenSigTimeoutValue" SG_ 1043 TEL_Time_Hour 0;
BA_ "Remark" SG_ 1043 TEL_Time_Hour "";
BA_ "EventCommandSignal" SG_ 1043 TEL_Time_Day 0;
BA_ "GatewayedSignals" SG_ 1043 TEL_Time_Day 0;
BA_ "GenSigInactiveValue" SG_ 1043 TEL_Time_Day 0;
BA_ "GenSigInvalidValue" SG_ 1043 TEL_Time_Day 0;
BA_ "GenSigSendType" SG_ 1043 TEL_Time_Day 1;
BA_ "GenSigStartValue" SG_ 1043 TEL_Time_Day 1;
BA_ "GenSigTimeoutValue" SG_ 1043 TEL_Time_Day 0;
BA_ "Remark" SG_ 1043 TEL_Time_Day "";
BA_ "EventCommandSignal" SG_ 1043 TEL_Time_Min 0;
BA_ "GatewayedSignals" SG_ 1043 TEL_Time_Min 0;
BA_ "GenSigInactiveValue" SG_ 1043 TEL_Time_Min 0;
BA_ "GenSigInvalidValue" SG_ 1043 TEL_Time_Min 0;
BA_ "GenSigSendType" SG_ 1043 TEL_Time_Min 1;
BA_ "GenSigStartValue" SG_ 1043 TEL_Time_Min 1;
BA_ "GenSigTimeoutValue" SG_ 1043 TEL_Time_Min 0;
BA_ "Remark" SG_ 1043 TEL_Time_Min "";
BA_ "EventCommandSignal" SG_ 1043 TEL_Time_Sec 0;
BA_ "GatewayedSignals" SG_ 1043 TEL_Time_Sec 0;
BA_ "GenSigInactiveValue" SG_ 1043 TEL_Time_Sec 0;
BA_ "GenSigInvalidValue" SG_ 1043 TEL_Time_Sec 0;
BA_ "GenSigSendType" SG_ 1043 TEL_Time_Sec 1;
BA_ "GenSigStartValue" SG_ 1043 TEL_Time_Sec 1;
BA_ "GenSigTimeoutValue" SG_ 1043 TEL_Time_Sec 0;
BA_ "Remark" SG_ 1043 TEL_Time_Sec "";
BA_ "EventCommandSignal" SG_ 1043 TEL_TimeVD 0;
BA_ "GatewayedSignals" SG_ 1043 TEL_TimeVD 0;
BA_ "GenSigInactiveValue" SG_ 1043 TEL_TimeVD 0;
BA_ "GenSigInvalidValue" SG_ 1043 TEL_TimeVD 0;
BA_ "GenSigSendType" SG_ 1043 TEL_TimeVD 1;
BA_ "GenSigStartValue" SG_ 1043 TEL_TimeVD 0;
BA_ "GenSigTimeoutValue" SG_ 1043 TEL_TimeVD 0;
BA_ "Remark" SG_ 1043 TEL_TimeVD "";
BA_ "EventCommandSignal" SG_ 926 FLR_1_CRC 0;
BA_ "GatewayedSignals" SG_ 926 FLR_1_CRC 0;
BA_ "GenSigInactiveValue" SG_ 926 FLR_1_CRC 0;
BA_ "GenSigInvalidValue" SG_ 926 FLR_1_CRC 0;
BA_ "GenSigSendType" SG_ 926 FLR_1_CRC 1;
BA_ "GenSigStartValue" SG_ 926 FLR_1_CRC 0;
BA_ "GenSigTimeoutValue" SG_ 926 FLR_1_CRC 0;
BA_ "Remark" SG_ 926 FLR_1_CRC "";
BA_ "EventCommandSignal" SG_ 926 FLR_1_Counter 0;
BA_ "GatewayedSignals" SG_ 926 FLR_1_Counter 0;
BA_ "GenSigInactiveValue" SG_ 926 FLR_1_Counter 0;
BA_ "GenSigInvalidValue" SG_ 926 FLR_1_Counter 0;
BA_ "GenSigSendType" SG_ 926 FLR_1_Counter 1;
BA_ "GenSigStartValue" SG_ 926 FLR_1_Counter 0;
BA_ "GenSigTimeoutValue" SG_ 926 FLR_1_Counter 0;
BA_ "Remark" SG_ 926 FLR_1_Counter "";
BA_ "EventCommandSignal" SG_ 926 FLR_MRRSt 0;
BA_ "GatewayedSignals" SG_ 926 FLR_MRRSt 0;
BA_ "GenSigInactiveValue" SG_ 926 FLR_MRRSt 0;
BA_ "GenSigInvalidValue" SG_ 926 FLR_MRRSt 0;
BA_ "GenSigSendType" SG_ 926 FLR_MRRSt 1;
BA_ "GenSigStartValue" SG_ 926 FLR_MRRSt 0;
BA_ "GenSigTimeoutValue" SG_ 926 FLR_MRRSt 2;
BA_ "Remark" SG_ 926 FLR_MRRSt "";
BA_ "EventCommandSignal" SG_ 926 FLR_FCTAWarnLeft 0;
BA_ "GatewayedSignals" SG_ 926 FLR_FCTAWarnLeft 0;
BA_ "GenSigInactiveValue" SG_ 926 FLR_FCTAWarnLeft 0;
BA_ "GenSigInvalidValue" SG_ 926 FLR_FCTAWarnLeft 0;
BA_ "GenSigSendType" SG_ 926 FLR_FCTAWarnLeft 1;
BA_ "GenSigStartValue" SG_ 926 FLR_FCTAWarnLeft 0;
BA_ "GenSigTimeoutValue" SG_ 926 FLR_FCTAWarnLeft 0;
BA_ "Remark" SG_ 926 FLR_FCTAWarnLeft "";
BA_ "EventCommandSignal" SG_ 926 FLR_FCTASt 0;
BA_ "GatewayedSignals" SG_ 926 FLR_FCTASt 0;
BA_ "GenSigInactiveValue" SG_ 926 FLR_FCTASt 0;
BA_ "GenSigInvalidValue" SG_ 926 FLR_FCTASt 0;
BA_ "GenSigSendType" SG_ 926 FLR_FCTASt 1;
BA_ "GenSigStartValue" SG_ 926 FLR_FCTASt 0;
BA_ "GenSigTimeoutValue" SG_ 926 FLR_FCTASt 0;
BA_ "Remark" SG_ 926 FLR_FCTASt "";
BA_ "EventCommandSignal" SG_ 926 FLR_FCTAAssistType 0;
BA_ "GatewayedSignals" SG_ 926 FLR_FCTAAssistType 0;
BA_ "GenSigInactiveValue" SG_ 926 FLR_FCTAAssistType 0;
BA_ "GenSigInvalidValue" SG_ 926 FLR_FCTAAssistType 0;
BA_ "GenSigSendType" SG_ 926 FLR_FCTAAssistType 1;
BA_ "GenSigStartValue" SG_ 926 FLR_FCTAAssistType 0;
BA_ "GenSigTimeoutValue" SG_ 926 FLR_FCTAAssistType 0;
BA_ "Remark" SG_ 926 FLR_FCTAAssistType "";
BA_ "EventCommandSignal" SG_ 926 FLR_FCTBTargetDecel 0;
BA_ "GatewayedSignals" SG_ 926 FLR_FCTBTargetDecel 0;
BA_ "GenSigInactiveValue" SG_ 926 FLR_FCTBTargetDecel 0;
BA_ "GenSigInvalidValue" SG_ 926 FLR_FCTBTargetDecel 0;
BA_ "GenSigSendType" SG_ 926 FLR_FCTBTargetDecel 1;
BA_ "GenSigStartValue" SG_ 926 FLR_FCTBTargetDecel 0;
BA_ "GenSigTimeoutValue" SG_ 926 FLR_FCTBTargetDecel 0;
BA_ "Remark" SG_ 926 FLR_FCTBTargetDecel "";
BA_ "EventCommandSignal" SG_ 926 FLR_FCTBBrkVD 0;
BA_ "GatewayedSignals" SG_ 926 FLR_FCTBBrkVD 0;
BA_ "GenSigInactiveValue" SG_ 926 FLR_FCTBBrkVD 0;
BA_ "GenSigInvalidValue" SG_ 926 FLR_FCTBBrkVD 0;
BA_ "GenSigSendType" SG_ 926 FLR_FCTBBrkVD 1;
BA_ "GenSigStartValue" SG_ 926 FLR_FCTBBrkVD 0;
BA_ "GenSigTimeoutValue" SG_ 926 FLR_FCTBBrkVD 1;
BA_ "Remark" SG_ 926 FLR_FCTBBrkVD "";
BA_ "EventCommandSignal" SG_ 926 FLR_FCTBBrkReq 0;
BA_ "GatewayedSignals" SG_ 926 FLR_FCTBBrkReq 0;
BA_ "GenSigInactiveValue" SG_ 926 FLR_FCTBBrkReq 0;
BA_ "GenSigInvalidValue" SG_ 926 FLR_FCTBBrkReq 0;
BA_ "GenSigSendType" SG_ 926 FLR_FCTBBrkReq 1;
BA_ "GenSigStartValue" SG_ 926 FLR_FCTBBrkReq 0;
BA_ "GenSigTimeoutValue" SG_ 926 FLR_FCTBBrkReq 0;
BA_ "Remark" SG_ 926 FLR_FCTBBrkReq "";
BA_ "EventCommandSignal" SG_ 927 FRR_1_CRC 0;
BA_ "GatewayedSignals" SG_ 927 FRR_1_CRC 0;
BA_ "GenSigInactiveValue" SG_ 927 FRR_1_CRC 0;
BA_ "GenSigInvalidValue" SG_ 927 FRR_1_CRC 0;
BA_ "GenSigSendType" SG_ 927 FRR_1_CRC 1;
BA_ "GenSigStartValue" SG_ 927 FRR_1_CRC 0;
BA_ "GenSigTimeoutValue" SG_ 927 FRR_1_CRC 0;
BA_ "Remark" SG_ 927 FRR_1_CRC "";
BA_ "EventCommandSignal" SG_ 927 FRR_1_Counter 0;
BA_ "GatewayedSignals" SG_ 927 FRR_1_Counter 0;
BA_ "GenSigInactiveValue" SG_ 927 FRR_1_Counter 0;
BA_ "GenSigInvalidValue" SG_ 927 FRR_1_Counter 0;
BA_ "GenSigSendType" SG_ 927 FRR_1_Counter 1;
BA_ "GenSigStartValue" SG_ 927 FRR_1_Counter 0;
BA_ "GenSigTimeoutValue" SG_ 927 FRR_1_Counter 0;
BA_ "Remark" SG_ 927 FRR_1_Counter "";
BA_ "EventCommandSignal" SG_ 927 FRR_MRRSt 0;
BA_ "GatewayedSignals" SG_ 927 FRR_MRRSt 0;
BA_ "GenSigInactiveValue" SG_ 927 FRR_MRRSt 0;
BA_ "GenSigInvalidValue" SG_ 927 FRR_MRRSt 0;
BA_ "GenSigSendType" SG_ 927 FRR_MRRSt 1;
BA_ "GenSigStartValue" SG_ 927 FRR_MRRSt 0;
BA_ "GenSigTimeoutValue" SG_ 927 FRR_MRRSt 2;
BA_ "Remark" SG_ 927 FRR_MRRSt "";
BA_ "EventCommandSignal" SG_ 927 FRR_FCTAWarnRight 0;
BA_ "GatewayedSignals" SG_ 927 FRR_FCTAWarnRight 0;
BA_ "GenSigInactiveValue" SG_ 927 FRR_FCTAWarnRight 0;
BA_ "GenSigInvalidValue" SG_ 927 FRR_FCTAWarnRight 0;
BA_ "GenSigSendType" SG_ 927 FRR_FCTAWarnRight 1;
BA_ "GenSigStartValue" SG_ 927 FRR_FCTAWarnRight 0;
BA_ "GenSigTimeoutValue" SG_ 927 FRR_FCTAWarnRight 0;
BA_ "Remark" SG_ 927 FRR_FCTAWarnRight "";
BA_ "EventCommandSignal" SG_ 927 FRR_FCTASt 0;
BA_ "GatewayedSignals" SG_ 927 FRR_FCTASt 0;
BA_ "GenSigInactiveValue" SG_ 927 FRR_FCTASt 0;
BA_ "GenSigInvalidValue" SG_ 927 FRR_FCTASt 0;
BA_ "GenSigSendType" SG_ 927 FRR_FCTASt 1;
BA_ "GenSigStartValue" SG_ 927 FRR_FCTASt 0;
BA_ "GenSigTimeoutValue" SG_ 927 FRR_FCTASt 0;
BA_ "Remark" SG_ 927 FRR_FCTASt "";
BA_ "EventCommandSignal" SG_ 927 FRR_FCTAAssistType 0;
BA_ "GatewayedSignals" SG_ 927 FRR_FCTAAssistType 0;
BA_ "GenSigInactiveValue" SG_ 927 FRR_FCTAAssistType 0;
BA_ "GenSigInvalidValue" SG_ 927 FRR_FCTAAssistType 0;
BA_ "GenSigSendType" SG_ 927 FRR_FCTAAssistType 1;
BA_ "GenSigStartValue" SG_ 927 FRR_FCTAAssistType 0;
BA_ "GenSigTimeoutValue" SG_ 927 FRR_FCTAAssistType 0;
BA_ "Remark" SG_ 927 FRR_FCTAAssistType "";
BA_ "EventCommandSignal" SG_ 927 FRR_FCTBTargetDecel 0;
BA_ "GatewayedSignals" SG_ 927 FRR_FCTBTargetDecel 0;
BA_ "GenSigInactiveValue" SG_ 927 FRR_FCTBTargetDecel 0;
BA_ "GenSigInvalidValue" SG_ 927 FRR_FCTBTargetDecel 0;
BA_ "GenSigSendType" SG_ 927 FRR_FCTBTargetDecel 1;
BA_ "GenSigStartValue" SG_ 927 FRR_FCTBTargetDecel 0;
BA_ "GenSigTimeoutValue" SG_ 927 FRR_FCTBTargetDecel 0;
BA_ "Remark" SG_ 927 FRR_FCTBTargetDecel "";
BA_ "EventCommandSignal" SG_ 927 FRR_FCTBBrkVD 0;
BA_ "GatewayedSignals" SG_ 927 FRR_FCTBBrkVD 0;
BA_ "GenSigInactiveValue" SG_ 927 FRR_FCTBBrkVD 0;
BA_ "GenSigInvalidValue" SG_ 927 FRR_FCTBBrkVD 0;
BA_ "GenSigSendType" SG_ 927 FRR_FCTBBrkVD 1;
BA_ "GenSigStartValue" SG_ 927 FRR_FCTBBrkVD 0;
BA_ "GenSigTimeoutValue" SG_ 927 FRR_FCTBBrkVD 1;
BA_ "Remark" SG_ 927 FRR_FCTBBrkVD "";
BA_ "EventCommandSignal" SG_ 927 FRR_FCTBBrkReq 0;
BA_ "GatewayedSignals" SG_ 927 FRR_FCTBBrkReq 0;
BA_ "GenSigInactiveValue" SG_ 927 FRR_FCTBBrkReq 0;
BA_ "GenSigInvalidValue" SG_ 927 FRR_FCTBBrkReq 0;
BA_ "GenSigSendType" SG_ 927 FRR_FCTBBrkReq 1;
BA_ "GenSigStartValue" SG_ 927 FRR_FCTBBrkReq 0;
BA_ "GenSigTimeoutValue" SG_ 927 FRR_FCTBBrkReq 0;
BA_ "Remark" SG_ 927 FRR_FCTBBrkReq "";
BA_ "EventCommandSignal" SG_ 932 RRR_1_CRC 0;
BA_ "GatewayedSignals" SG_ 932 RRR_1_CRC 0;
BA_ "GenSigInactiveValue" SG_ 932 RRR_1_CRC 0;
BA_ "GenSigInvalidValue" SG_ 932 RRR_1_CRC 0;
BA_ "GenSigSendType" SG_ 932 RRR_1_CRC 1;
BA_ "GenSigStartValue" SG_ 932 RRR_1_CRC 0;
BA_ "GenSigTimeoutValue" SG_ 932 RRR_1_CRC 0;
BA_ "Remark" SG_ 932 RRR_1_CRC "Only for 3R1V IFC Rx";
BA_ "EventCommandSignal" SG_ 932 RRR_1_Counter 0;
BA_ "GatewayedSignals" SG_ 932 RRR_1_Counter 0;
BA_ "GenSigInactiveValue" SG_ 932 RRR_1_Counter 0;
BA_ "GenSigInvalidValue" SG_ 932 RRR_1_Counter 0;
BA_ "GenSigSendType" SG_ 932 RRR_1_Counter 1;
BA_ "GenSigStartValue" SG_ 932 RRR_1_Counter 0;
BA_ "GenSigTimeoutValue" SG_ 932 RRR_1_Counter 0;
BA_ "Remark" SG_ 932 RRR_1_Counter "Only for 3R1V IFC Rx";
BA_ "EventCommandSignal" SG_ 932 RRR_MRRSt 0;
BA_ "GatewayedSignals" SG_ 932 RRR_MRRSt 0;
BA_ "GenSigInactiveValue" SG_ 932 RRR_MRRSt 0;
BA_ "GenSigInvalidValue" SG_ 932 RRR_MRRSt 0;
BA_ "GenSigSendType" SG_ 932 RRR_MRRSt 1;
BA_ "GenSigStartValue" SG_ 932 RRR_MRRSt 0;
BA_ "GenSigTimeoutValue" SG_ 932 RRR_MRRSt 2;
BA_ "Remark" SG_ 932 RRR_MRRSt "Only for 3R1V IFC Rx";
BA_ "EventCommandSignal" SG_ 932 RRR_ExMirLedWarnR 0;
BA_ "GatewayedSignals" SG_ 932 RRR_ExMirLedWarnR 0;
BA_ "GenSigInactiveValue" SG_ 932 RRR_ExMirLedWarnR 0;
BA_ "GenSigInvalidValue" SG_ 932 RRR_ExMirLedWarnR 0;
BA_ "GenSigSendType" SG_ 932 RRR_ExMirLedWarnR 1;
BA_ "GenSigStartValue" SG_ 932 RRR_ExMirLedWarnR 0;
BA_ "GenSigTimeoutValue" SG_ 932 RRR_ExMirLedWarnR 0;
BA_ "Remark" SG_ 932 RRR_ExMirLedWarnR "Only for 3R1V IFC Rx";
BA_ "EventCommandSignal" SG_ 932 RRR_LCASt 0;
BA_ "GatewayedSignals" SG_ 932 RRR_LCASt 0;
BA_ "GenSigInactiveValue" SG_ 932 RRR_LCASt 0;
BA_ "GenSigInvalidValue" SG_ 932 RRR_LCASt 0;
BA_ "GenSigSendType" SG_ 932 RRR_LCASt 1;
BA_ "GenSigStartValue" SG_ 932 RRR_LCASt 0;
BA_ "GenSigTimeoutValue" SG_ 932 RRR_LCASt 3;
BA_ "Remark" SG_ 932 RRR_LCASt "Only for 3R1V IFC Rx";
BA_ "EventCommandSignal" SG_ 932 RRR_LCAWarnRight 0;
BA_ "GatewayedSignals" SG_ 932 RRR_LCAWarnRight 0;
BA_ "GenSigInactiveValue" SG_ 932 RRR_LCAWarnRight 0;
BA_ "GenSigInvalidValue" SG_ 932 RRR_LCAWarnRight 0;
BA_ "GenSigSendType" SG_ 932 RRR_LCAWarnRight 1;
BA_ "GenSigStartValue" SG_ 932 RRR_LCAWarnRight 0;
BA_ "GenSigTimeoutValue" SG_ 932 RRR_LCAWarnRight 0;
BA_ "Remark" SG_ 932 RRR_LCAWarnRight "Only for 3R1V IFC Rx";
BA_ "EventCommandSignal" SG_ 932 RRR_ClusterLamp 0;
BA_ "GatewayedSignals" SG_ 932 RRR_ClusterLamp 0;
BA_ "GenSigInactiveValue" SG_ 932 RRR_ClusterLamp 0;
BA_ "GenSigInvalidValue" SG_ 932 RRR_ClusterLamp 0;
BA_ "GenSigSendType" SG_ 932 RRR_ClusterLamp 1;
BA_ "GenSigStartValue" SG_ 932 RRR_ClusterLamp 0;
BA_ "GenSigTimeoutValue" SG_ 932 RRR_ClusterLamp 1;
BA_ "Remark" SG_ 932 RRR_ClusterLamp "Only for 3R1V IFC Rx";
BA_ "EventCommandSignal" SG_ 932 RRR_DOWWarnR 0;
BA_ "GatewayedSignals" SG_ 932 RRR_DOWWarnR 0;
BA_ "GenSigInactiveValue" SG_ 932 RRR_DOWWarnR 0;
BA_ "GenSigInvalidValue" SG_ 932 RRR_DOWWarnR 0;
BA_ "GenSigSendType" SG_ 932 RRR_DOWWarnR 1;
BA_ "GenSigStartValue" SG_ 932 RRR_DOWWarnR 0;
BA_ "GenSigTimeoutValue" SG_ 932 RRR_DOWWarnR 0;
BA_ "Remark" SG_ 932 RRR_DOWWarnR "Only for 3R1V IFC Rx";
BA_ "EventCommandSignal" SG_ 932 RRR_DOWSt 0;
BA_ "GatewayedSignals" SG_ 932 RRR_DOWSt 0;
BA_ "GenSigInactiveValue" SG_ 932 RRR_DOWSt 0;
BA_ "GenSigInvalidValue" SG_ 932 RRR_DOWSt 0;
BA_ "GenSigSendType" SG_ 932 RRR_DOWSt 1;
BA_ "GenSigStartValue" SG_ 932 RRR_DOWSt 0;
BA_ "GenSigTimeoutValue" SG_ 932 RRR_DOWSt 0;
BA_ "Remark" SG_ 932 RRR_DOWSt "Only for 3R1V IFC Rx";
BA_ "EventCommandSignal" SG_ 932 RRR_AudioWarnFR 0;
BA_ "GatewayedSignals" SG_ 932 RRR_AudioWarnFR 0;
BA_ "GenSigInactiveValue" SG_ 932 RRR_AudioWarnFR 0;
BA_ "GenSigInvalidValue" SG_ 932 RRR_AudioWarnFR 0;
BA_ "GenSigSendType" SG_ 932 RRR_AudioWarnFR 1;
BA_ "GenSigStartValue" SG_ 932 RRR_AudioWarnFR 0;
BA_ "GenSigTimeoutValue" SG_ 932 RRR_AudioWarnFR 0;
BA_ "Remark" SG_ 932 RRR_AudioWarnFR "Only for 3R1V IFC Rx";
BA_ "EventCommandSignal" SG_ 932 RRR_AudioWarnRR 0;
BA_ "GatewayedSignals" SG_ 932 RRR_AudioWarnRR 0;
BA_ "GenSigInactiveValue" SG_ 932 RRR_AudioWarnRR 0;
BA_ "GenSigInvalidValue" SG_ 932 RRR_AudioWarnRR 0;
BA_ "GenSigSendType" SG_ 932 RRR_AudioWarnRR 1;
BA_ "GenSigStartValue" SG_ 932 RRR_AudioWarnRR 0;
BA_ "GenSigTimeoutValue" SG_ 932 RRR_AudioWarnRR 0;
BA_ "Remark" SG_ 932 RRR_AudioWarnRR "Only for 3R1V IFC Rx";
BA_ "EventCommandSignal" SG_ 932 RRR_IALWarnFR 0;
BA_ "GatewayedSignals" SG_ 932 RRR_IALWarnFR 0;
BA_ "GenSigInactiveValue" SG_ 932 RRR_IALWarnFR 0;
BA_ "GenSigInvalidValue" SG_ 932 RRR_IALWarnFR 0;
BA_ "GenSigSendType" SG_ 932 RRR_IALWarnFR 1;
BA_ "GenSigStartValue" SG_ 932 RRR_IALWarnFR 0;
BA_ "GenSigTimeoutValue" SG_ 932 RRR_IALWarnFR 0;
BA_ "Remark" SG_ 932 RRR_IALWarnFR "Only for 3R1V IFC Rx";
BA_ "EventCommandSignal" SG_ 932 RRR_IALWarnRR 0;
BA_ "GatewayedSignals" SG_ 932 RRR_IALWarnRR 0;
BA_ "GenSigInactiveValue" SG_ 932 RRR_IALWarnRR 0;
BA_ "GenSigInvalidValue" SG_ 932 RRR_IALWarnRR 0;
BA_ "GenSigSendType" SG_ 932 RRR_IALWarnRR 1;
BA_ "GenSigStartValue" SG_ 932 RRR_IALWarnRR 0;
BA_ "GenSigTimeoutValue" SG_ 932 RRR_IALWarnRR 0;
BA_ "Remark" SG_ 932 RRR_IALWarnRR "Only for 3R1V IFC Rx";
BA_ "EventCommandSignal" SG_ 932 RRR_RCTASt 0;
BA_ "GatewayedSignals" SG_ 932 RRR_RCTASt 0;
BA_ "GenSigInactiveValue" SG_ 932 RRR_RCTASt 0;
BA_ "GenSigInvalidValue" SG_ 932 RRR_RCTASt 0;
BA_ "GenSigSendType" SG_ 932 RRR_RCTASt 1;
BA_ "GenSigStartValue" SG_ 932 RRR_RCTASt 0;
BA_ "EventCommandSignal" SG_ 932 RRR_RCTAWarnRight 0;
BA_ "GatewayedSignals" SG_ 932 RRR_RCTAWarnRight 0;
BA_ "GenSigInactiveValue" SG_ 932 RRR_RCTAWarnRight 0;
BA_ "GenSigInvalidValue" SG_ 932 RRR_RCTAWarnRight 0;
BA_ "GenSigSendType" SG_ 932 RRR_RCTAWarnRight 1;
BA_ "GenSigStartValue" SG_ 932 RRR_RCTAWarnRight 0;
BA_ "GenSigTimeoutValue" SG_ 932 RRR_RCTAWarnRight 0;
BA_ "Remark" SG_ 932 RRR_RCTAWarnRight "Only for 3R1V IFC Rx";
BA_ "EventCommandSignal" SG_ 932 RRR_RCWSt 0;
BA_ "GatewayedSignals" SG_ 932 RRR_RCWSt 0;
BA_ "GenSigInactiveValue" SG_ 932 RRR_RCWSt 0;
BA_ "GenSigInvalidValue" SG_ 932 RRR_RCWSt 0;
BA_ "GenSigSendType" SG_ 932 RRR_RCWSt 1;
BA_ "GenSigStartValue" SG_ 932 RRR_RCWSt 0;
BA_ "GenSigTimeoutValue" SG_ 932 RRR_RCWSt 3;
BA_ "Remark" SG_ 932 RRR_RCWSt "Only for 3R1V IFC Rx";
BA_ "EventCommandSignal" SG_ 932 RRR_RCWWarn 0;
BA_ "GatewayedSignals" SG_ 932 RRR_RCWWarn 0;
BA_ "GenSigInactiveValue" SG_ 932 RRR_RCWWarn 0;
BA_ "GenSigInvalidValue" SG_ 932 RRR_RCWWarn 0;
BA_ "GenSigSendType" SG_ 932 RRR_RCWWarn 1;
BA_ "GenSigStartValue" SG_ 932 RRR_RCWWarn 0;
BA_ "GenSigTimeoutValue" SG_ 932 RRR_RCWWarn 0;
BA_ "Remark" SG_ 932 RRR_RCWWarn "Only for 3R1V IFC Rx";
BA_ "EventCommandSignal" SG_ 932 RRR_RCTBTargetDecel 0;
BA_ "GatewayedSignals" SG_ 932 RRR_RCTBTargetDecel 0;
BA_ "GenSigInactiveValue" SG_ 932 RRR_RCTBTargetDecel 0;
BA_ "GenSigInvalidValue" SG_ 932 RRR_RCTBTargetDecel 0;
BA_ "GenSigSendType" SG_ 932 RRR_RCTBTargetDecel 1;
BA_ "GenSigStartValue" SG_ 932 RRR_RCTBTargetDecel 0;
BA_ "GenSigTimeoutValue" SG_ 932 RRR_RCTBTargetDecel 0;
BA_ "Remark" SG_ 932 RRR_RCTBTargetDecel "Only for 3R1V IFC Rx";
BA_ "EventCommandSignal" SG_ 932 RRR_RCTBBrkReq 0;
BA_ "GatewayedSignals" SG_ 932 RRR_RCTBBrkReq 0;
BA_ "GenSigInactiveValue" SG_ 932 RRR_RCTBBrkReq 0;
BA_ "GenSigInvalidValue" SG_ 932 RRR_RCTBBrkReq 0;
BA_ "GenSigSendType" SG_ 932 RRR_RCTBBrkReq 1;
BA_ "GenSigStartValue" SG_ 932 RRR_RCTBBrkReq 0;
BA_ "GenSigTimeoutValue" SG_ 932 RRR_RCTBBrkReq 0;
BA_ "Remark" SG_ 932 RRR_RCTBBrkReq "Only for 3R1V IFC Rx";
BA_ "EventCommandSignal" SG_ 932 RRR_TargetLatDistR 0;
BA_ "GatewayedSignals" SG_ 932 RRR_TargetLatDistR 0;
BA_ "GenSigInactiveValue" SG_ 932 RRR_TargetLatDistR 0;
BA_ "GenSigInvalidValue" SG_ 932 RRR_TargetLatDistR 0;
BA_ "GenSigSendType" SG_ 932 RRR_TargetLatDistR 1;
BA_ "GenSigStartValue" SG_ 932 RRR_TargetLatDistR 0;
BA_ "GenSigTimeoutValue" SG_ 932 RRR_TargetLatDistR 0;
BA_ "Remark" SG_ 932 RRR_TargetLatDistR "Only for 3R1V IFC Rx";
BA_ "EventCommandSignal" SG_ 932 RRR_RCTBBrkgVD 0;
BA_ "GatewayedSignals" SG_ 932 RRR_RCTBBrkgVD 0;
BA_ "GenSigInactiveValue" SG_ 932 RRR_RCTBBrkgVD 0;
BA_ "GenSigInvalidValue" SG_ 932 RRR_RCTBBrkgVD 0;
BA_ "GenSigSendType" SG_ 932 RRR_RCTBBrkgVD 1;
BA_ "GenSigStartValue" SG_ 932 RRR_RCTBBrkgVD 0;
BA_ "GenSigTimeoutValue" SG_ 932 RRR_RCTBBrkgVD 1;
BA_ "Remark" SG_ 932 RRR_RCTBBrkgVD "Only for 3R1V IFC Rx";
BA_ "EventCommandSignal" SG_ 932 RRR_TargetRVD 0;
BA_ "GatewayedSignals" SG_ 932 RRR_TargetRVD 0;
BA_ "GenSigInactiveValue" SG_ 932 RRR_TargetRVD 0;
BA_ "GenSigInvalidValue" SG_ 932 RRR_TargetRVD 0;
BA_ "GenSigSendType" SG_ 932 RRR_TargetRVD 1;
BA_ "GenSigStartValue" SG_ 932 RRR_TargetRVD 0;
BA_ "GenSigTimeoutValue" SG_ 932 RRR_TargetRVD 0;
BA_ "Remark" SG_ 932 RRR_TargetRVD "Only for 3R1V IFC Rx";
BA_ "EventCommandSignal" SG_ 932 RRR_TargetRelSpdR 0;
BA_ "GatewayedSignals" SG_ 932 RRR_TargetRelSpdR 0;
BA_ "GenSigInactiveValue" SG_ 932 RRR_TargetRelSpdR 0;
BA_ "GenSigInvalidValue" SG_ 932 RRR_TargetRelSpdR 0;
BA_ "GenSigSendType" SG_ 932 RRR_TargetRelSpdR 1;
BA_ "GenSigStartValue" SG_ 932 RRR_TargetRelSpdR 0;
BA_ "GenSigTimeoutValue" SG_ 932 RRR_TargetRelSpdR 0;
BA_ "Remark" SG_ 932 RRR_TargetRelSpdR "Only for 3R1V IFC Rx";
BA_ "EventCommandSignal" SG_ 932 RRR_TargetDstR 0;
BA_ "GatewayedSignals" SG_ 932 RRR_TargetDstR 0;
BA_ "GenSigInactiveValue" SG_ 932 RRR_TargetDstR 0;
BA_ "GenSigInvalidValue" SG_ 932 RRR_TargetDstR 0;
BA_ "GenSigSendType" SG_ 932 RRR_TargetDstR 1;
BA_ "GenSigStartValue" SG_ 932 RRR_TargetDstR 0;
BA_ "GenSigTimeoutValue" SG_ 932 RRR_TargetDstR 0;
BA_ "Remark" SG_ 932 RRR_TargetDstR "Only for 3R1V IFC Rx";
BA_ "EventCommandSignal" SG_ 932 RRR_VibrWarnR 0;
BA_ "GatewayedSignals" SG_ 932 RRR_VibrWarnR 0;
BA_ "GenSigInactiveValue" SG_ 932 RRR_VibrWarnR 0;
BA_ "GenSigInvalidValue" SG_ 932 RRR_VibrWarnR 0;
BA_ "GenSigSendType" SG_ 932 RRR_VibrWarnR 1;
BA_ "GenSigStartValue" SG_ 932 RRR_VibrWarnR 0;
BA_ "GenSigTimeoutValue" SG_ 932 RRR_VibrWarnR 0;
BA_ "Remark" SG_ 932 RRR_VibrWarnR "Only for 3R1V IFC Rx";
BA_ "EventCommandSignal" SG_ 932 RRR_RCTAAssistType 0;
BA_ "GatewayedSignals" SG_ 932 RRR_RCTAAssistType 0;
BA_ "GenSigInactiveValue" SG_ 932 RRR_RCTAAssistType 0;
BA_ "GenSigInvalidValue" SG_ 932 RRR_RCTAAssistType 0;
BA_ "GenSigSendType" SG_ 932 RRR_RCTAAssistType 1;
BA_ "GenSigStartValue" SG_ 932 RRR_RCTAAssistType 0;
BA_ "GenSigTimeoutValue" SG_ 932 RRR_RCTAAssistType 0;
BA_ "Remark" SG_ 932 RRR_RCTAAssistType "Only for 3R1V IFC Rx";
BA_ "EventCommandSignal" SG_ 987 RLR_1_CRC 0;
BA_ "GatewayedSignals" SG_ 987 RLR_1_CRC 0;
BA_ "GenSigInactiveValue" SG_ 987 RLR_1_CRC 0;
BA_ "GenSigInvalidValue" SG_ 987 RLR_1_CRC 0;
BA_ "GenSigSendType" SG_ 987 RLR_1_CRC 1;
BA_ "GenSigStartValue" SG_ 987 RLR_1_CRC 0;
BA_ "GenSigTimeoutValue" SG_ 987 RLR_1_CRC 0;
BA_ "Remark" SG_ 987 RLR_1_CRC "Only for 3R1V IFC Rx";
BA_ "EventCommandSignal" SG_ 987 RLR_1_Counter 0;
BA_ "GatewayedSignals" SG_ 987 RLR_1_Counter 0;
BA_ "GenSigInactiveValue" SG_ 987 RLR_1_Counter 0;
BA_ "GenSigInvalidValue" SG_ 987 RLR_1_Counter 0;
BA_ "GenSigSendType" SG_ 987 RLR_1_Counter 1;
BA_ "GenSigStartValue" SG_ 987 RLR_1_Counter 0;
BA_ "GenSigTimeoutValue" SG_ 987 RLR_1_Counter 0;
BA_ "Remark" SG_ 987 RLR_1_Counter "Only for 3R1V IFC Rx";
BA_ "EventCommandSignal" SG_ 987 RLR_MRRSt 0;
BA_ "GatewayedSignals" SG_ 987 RLR_MRRSt 0;
BA_ "GenSigInactiveValue" SG_ 987 RLR_MRRSt 0;
BA_ "GenSigInvalidValue" SG_ 987 RLR_MRRSt 0;
BA_ "GenSigSendType" SG_ 987 RLR_MRRSt 1;
BA_ "GenSigStartValue" SG_ 987 RLR_MRRSt 0;
BA_ "GenSigTimeoutValue" SG_ 987 RLR_MRRSt 2;
BA_ "Remark" SG_ 987 RLR_MRRSt "Only for 3R1V IFC Rx";
BA_ "EventCommandSignal" SG_ 987 RLR_ExMirLedWarnL 0;
BA_ "GatewayedSignals" SG_ 987 RLR_ExMirLedWarnL 0;
BA_ "GenSigInactiveValue" SG_ 987 RLR_ExMirLedWarnL 0;
BA_ "GenSigInvalidValue" SG_ 987 RLR_ExMirLedWarnL 0;
BA_ "GenSigSendType" SG_ 987 RLR_ExMirLedWarnL 1;
BA_ "GenSigStartValue" SG_ 987 RLR_ExMirLedWarnL 0;
BA_ "GenSigTimeoutValue" SG_ 987 RLR_ExMirLedWarnL 0;
BA_ "Remark" SG_ 987 RLR_ExMirLedWarnL "Only for 3R1V IFC Rx";
BA_ "EventCommandSignal" SG_ 987 RLR_LCASt 0;
BA_ "GatewayedSignals" SG_ 987 RLR_LCASt 0;
BA_ "GenSigInactiveValue" SG_ 987 RLR_LCASt 0;
BA_ "GenSigInvalidValue" SG_ 987 RLR_LCASt 0;
BA_ "GenSigSendType" SG_ 987 RLR_LCASt 1;
BA_ "GenSigStartValue" SG_ 987 RLR_LCASt 0;
BA_ "GenSigTimeoutValue" SG_ 987 RLR_LCASt 3;
BA_ "Remark" SG_ 987 RLR_LCASt "Only for 3R1V IFC Rx";
BA_ "EventCommandSignal" SG_ 987 RLR_LCAWarnLeft 0;
BA_ "GatewayedSignals" SG_ 987 RLR_LCAWarnLeft 0;
BA_ "GenSigInactiveValue" SG_ 987 RLR_LCAWarnLeft 0;
BA_ "GenSigInvalidValue" SG_ 987 RLR_LCAWarnLeft 0;
BA_ "GenSigSendType" SG_ 987 RLR_LCAWarnLeft 1;
BA_ "GenSigStartValue" SG_ 987 RLR_LCAWarnLeft 0;
BA_ "GenSigTimeoutValue" SG_ 987 RLR_LCAWarnLeft 0;
BA_ "Remark" SG_ 987 RLR_LCAWarnLeft "Only for 3R1V IFC Rx";
BA_ "EventCommandSignal" SG_ 987 RLR_ClusterLamp 0;
BA_ "GatewayedSignals" SG_ 987 RLR_ClusterLamp 0;
BA_ "GenSigInactiveValue" SG_ 987 RLR_ClusterLamp 0;
BA_ "GenSigInvalidValue" SG_ 987 RLR_ClusterLamp 0;
BA_ "GenSigSendType" SG_ 987 RLR_ClusterLamp 1;
BA_ "GenSigStartValue" SG_ 987 RLR_ClusterLamp 0;
BA_ "GenSigTimeoutValue" SG_ 987 RLR_ClusterLamp 1;
BA_ "Remark" SG_ 987 RLR_ClusterLamp "Only for 3R1V IFC Rx";
BA_ "EventCommandSignal" SG_ 987 RLR_DOWWarnL 0;
BA_ "GatewayedSignals" SG_ 987 RLR_DOWWarnL 0;
BA_ "GenSigInactiveValue" SG_ 987 RLR_DOWWarnL 0;
BA_ "GenSigInvalidValue" SG_ 987 RLR_DOWWarnL 0;
BA_ "GenSigSendType" SG_ 987 RLR_DOWWarnL 1;
BA_ "GenSigStartValue" SG_ 987 RLR_DOWWarnL 0;
BA_ "GenSigTimeoutValue" SG_ 987 RLR_DOWWarnL 0;
BA_ "Remark" SG_ 987 RLR_DOWWarnL "Only for 3R1V IFC Rx";
BA_ "EventCommandSignal" SG_ 987 RLR_DOWSt 0;
BA_ "GatewayedSignals" SG_ 987 RLR_DOWSt 0;
BA_ "GenSigInactiveValue" SG_ 987 RLR_DOWSt 0;
BA_ "GenSigInvalidValue" SG_ 987 RLR_DOWSt 0;
BA_ "GenSigSendType" SG_ 987 RLR_DOWSt 1;
BA_ "GenSigStartValue" SG_ 987 RLR_DOWSt 0;
BA_ "GenSigTimeoutValue" SG_ 987 RLR_DOWSt 0;
BA_ "Remark" SG_ 987 RLR_DOWSt "Only for 3R1V IFC Rx";
BA_ "EventCommandSignal" SG_ 987 RLR_AudioWarnFL 0;
BA_ "GatewayedSignals" SG_ 987 RLR_AudioWarnFL 0;
BA_ "GenSigInactiveValue" SG_ 987 RLR_AudioWarnFL 0;
BA_ "GenSigInvalidValue" SG_ 987 RLR_AudioWarnFL 0;
BA_ "GenSigSendType" SG_ 987 RLR_AudioWarnFL 1;
BA_ "GenSigStartValue" SG_ 987 RLR_AudioWarnFL 0;
BA_ "GenSigTimeoutValue" SG_ 987 RLR_AudioWarnFL 0;
BA_ "Remark" SG_ 987 RLR_AudioWarnFL "Only for 3R1V IFC Rx";
BA_ "EventCommandSignal" SG_ 987 RLR_AudioWarnRL 0;
BA_ "GatewayedSignals" SG_ 987 RLR_AudioWarnRL 0;
BA_ "GenSigInactiveValue" SG_ 987 RLR_AudioWarnRL 0;
BA_ "GenSigInvalidValue" SG_ 987 RLR_AudioWarnRL 0;
BA_ "GenSigSendType" SG_ 987 RLR_AudioWarnRL 1;
BA_ "GenSigStartValue" SG_ 987 RLR_AudioWarnRL 0;
BA_ "GenSigTimeoutValue" SG_ 987 RLR_AudioWarnRL 0;
BA_ "Remark" SG_ 987 RLR_AudioWarnRL "Only for 3R1V IFC Rx";
BA_ "EventCommandSignal" SG_ 987 RLR_IALWarnFL 0;
BA_ "GatewayedSignals" SG_ 987 RLR_IALWarnFL 0;
BA_ "GenSigInactiveValue" SG_ 987 RLR_IALWarnFL 0;
BA_ "GenSigInvalidValue" SG_ 987 RLR_IALWarnFL 0;
BA_ "GenSigSendType" SG_ 987 RLR_IALWarnFL 1;
BA_ "GenSigStartValue" SG_ 987 RLR_IALWarnFL 0;
BA_ "GenSigTimeoutValue" SG_ 987 RLR_IALWarnFL 0;
BA_ "Remark" SG_ 987 RLR_IALWarnFL "Only for 3R1V IFC Rx";
BA_ "EventCommandSignal" SG_ 987 RLR_IALWarnRL 0;
BA_ "GatewayedSignals" SG_ 987 RLR_IALWarnRL 0;
BA_ "GenSigInactiveValue" SG_ 987 RLR_IALWarnRL 0;
BA_ "GenSigInvalidValue" SG_ 987 RLR_IALWarnRL 0;
BA_ "GenSigSendType" SG_ 987 RLR_IALWarnRL 1;
BA_ "GenSigStartValue" SG_ 987 RLR_IALWarnRL 0;
BA_ "GenSigTimeoutValue" SG_ 987 RLR_IALWarnRL 0;
BA_ "Remark" SG_ 987 RLR_IALWarnRL "Only for 3R1V IFC Rx";
BA_ "EventCommandSignal" SG_ 987 RLR_RCTAWarnLeft 0;
BA_ "GatewayedSignals" SG_ 987 RLR_RCTAWarnLeft 0;
BA_ "GenSigInactiveValue" SG_ 987 RLR_RCTAWarnLeft 0;
BA_ "GenSigInvalidValue" SG_ 987 RLR_RCTAWarnLeft 0;
BA_ "GenSigSendType" SG_ 987 RLR_RCTAWarnLeft 1;
BA_ "GenSigStartValue" SG_ 987 RLR_RCTAWarnLeft 0;
BA_ "GenSigTimeoutValue" SG_ 987 RLR_RCTAWarnLeft 0;
BA_ "Remark" SG_ 987 RLR_RCTAWarnLeft "Only for 3R1V IFC Rx";
BA_ "EventCommandSignal" SG_ 987 RLR_RCWSt 0;
BA_ "GatewayedSignals" SG_ 987 RLR_RCWSt 0;
BA_ "GenSigInactiveValue" SG_ 987 RLR_RCWSt 0;
BA_ "GenSigInvalidValue" SG_ 987 RLR_RCWSt 0;
BA_ "GenSigSendType" SG_ 987 RLR_RCWSt 1;
BA_ "GenSigStartValue" SG_ 987 RLR_RCWSt 0;
BA_ "GenSigTimeoutValue" SG_ 987 RLR_RCWSt 0;
BA_ "Remark" SG_ 987 RLR_RCWSt "Only for 3R1V IFC Rx";
BA_ "EventCommandSignal" SG_ 987 RLR_RCWWarn 0;
BA_ "GatewayedSignals" SG_ 987 RLR_RCWWarn 0;
BA_ "GenSigInactiveValue" SG_ 987 RLR_RCWWarn 0;
BA_ "GenSigInvalidValue" SG_ 987 RLR_RCWWarn 0;
BA_ "GenSigSendType" SG_ 987 RLR_RCWWarn 1;
BA_ "GenSigStartValue" SG_ 987 RLR_RCWWarn 0;
BA_ "GenSigTimeoutValue" SG_ 987 RLR_RCWWarn 0;
BA_ "Remark" SG_ 987 RLR_RCWWarn "Only for 3R1V IFC Rx";
BA_ "EventCommandSignal" SG_ 987 RLR_RCTASt 0;
BA_ "GatewayedSignals" SG_ 987 RLR_RCTASt 0;
BA_ "GenSigInactiveValue" SG_ 987 RLR_RCTASt 0;
BA_ "GenSigInvalidValue" SG_ 987 RLR_RCTASt 0;
BA_ "GenSigSendType" SG_ 987 RLR_RCTASt 1;
BA_ "GenSigStartValue" SG_ 987 RLR_RCTASt 0;
BA_ "GenSigTimeoutValue" SG_ 987 RLR_RCTASt 0;
BA_ "Remark" SG_ 987 RLR_RCTASt "Only for 3R1V IFC Rx";
BA_ "EventCommandSignal" SG_ 987 RLR_TargetLVD 0;
BA_ "GatewayedSignals" SG_ 987 RLR_TargetLVD 0;
BA_ "GenSigInactiveValue" SG_ 987 RLR_TargetLVD 0;
BA_ "GenSigInvalidValue" SG_ 987 RLR_TargetLVD 0;
BA_ "GenSigSendType" SG_ 987 RLR_TargetLVD 1;
BA_ "GenSigStartValue" SG_ 987 RLR_TargetLVD 0;
BA_ "GenSigTimeoutValue" SG_ 987 RLR_TargetLVD 0;
BA_ "Remark" SG_ 987 RLR_TargetLVD "Only for 3R1V IFC Rx";
BA_ "EventCommandSignal" SG_ 987 RLR_TargetRelSpdL 0;
BA_ "GatewayedSignals" SG_ 987 RLR_TargetRelSpdL 0;
BA_ "GenSigInactiveValue" SG_ 987 RLR_TargetRelSpdL 0;
BA_ "GenSigInvalidValue" SG_ 987 RLR_TargetRelSpdL 0;
BA_ "GenSigSendType" SG_ 987 RLR_TargetRelSpdL 1;
BA_ "GenSigStartValue" SG_ 987 RLR_TargetRelSpdL 0;
BA_ "GenSigTimeoutValue" SG_ 987 RLR_TargetRelSpdL 0;
BA_ "Remark" SG_ 987 RLR_TargetRelSpdL "Only for 3R1V IFC Rx";
BA_ "EventCommandSignal" SG_ 987 RLR_TargetDstL 0;
BA_ "GatewayedSignals" SG_ 987 RLR_TargetDstL 0;
BA_ "GenSigInactiveValue" SG_ 987 RLR_TargetDstL 0;
BA_ "GenSigInvalidValue" SG_ 987 RLR_TargetDstL 0;
BA_ "GenSigSendType" SG_ 987 RLR_TargetDstL 1;
BA_ "GenSigStartValue" SG_ 987 RLR_TargetDstL 0;
BA_ "GenSigTimeoutValue" SG_ 987 RLR_TargetDstL 0;
BA_ "Remark" SG_ 987 RLR_TargetDstL "Only for 3R1V IFC Rx";
BA_ "EventCommandSignal" SG_ 987 RLR_RCTAAssistType 0;
BA_ "GatewayedSignals" SG_ 987 RLR_RCTAAssistType 0;
BA_ "GenSigInactiveValue" SG_ 987 RLR_RCTAAssistType 0;
BA_ "GenSigInvalidValue" SG_ 987 RLR_RCTAAssistType 0;
BA_ "GenSigSendType" SG_ 987 RLR_RCTAAssistType 1;
BA_ "GenSigStartValue" SG_ 987 RLR_RCTAAssistType 0;
BA_ "GenSigTimeoutValue" SG_ 987 RLR_RCTAAssistType 0;
BA_ "Remark" SG_ 987 RLR_RCTAAssistType "Only for 3R1V IFC Rx";
BA_ "EventCommandSignal" SG_ 987 RLR_TargetLatDistL 0;
BA_ "GatewayedSignals" SG_ 987 RLR_TargetLatDistL 0;
BA_ "GenSigInactiveValue" SG_ 987 RLR_TargetLatDistL 0;
BA_ "GenSigInvalidValue" SG_ 987 RLR_TargetLatDistL 0;
BA_ "GenSigSendType" SG_ 987 RLR_TargetLatDistL 1;
BA_ "GenSigStartValue" SG_ 987 RLR_TargetLatDistL 0;
BA_ "GenSigTimeoutValue" SG_ 987 RLR_TargetLatDistL 0;
BA_ "Remark" SG_ 987 RLR_TargetLatDistL "Only for 3R1V IFC Rx";
BA_ "EventCommandSignal" SG_ 987 RLR_RCTBTargetDecel 0;
BA_ "GatewayedSignals" SG_ 987 RLR_RCTBTargetDecel 0;
BA_ "GenSigInactiveValue" SG_ 987 RLR_RCTBTargetDecel 0;
BA_ "GenSigInvalidValue" SG_ 987 RLR_RCTBTargetDecel 0;
BA_ "GenSigSendType" SG_ 987 RLR_RCTBTargetDecel 1;
BA_ "GenSigStartValue" SG_ 987 RLR_RCTBTargetDecel 0;
BA_ "GenSigTimeoutValue" SG_ 987 RLR_RCTBTargetDecel 0;
BA_ "Remark" SG_ 987 RLR_RCTBTargetDecel "Only for 3R1V IFC Rx";
BA_ "EventCommandSignal" SG_ 987 RLR_VibrWarnL 0;
BA_ "GatewayedSignals" SG_ 987 RLR_VibrWarnL 0;
BA_ "GenSigInactiveValue" SG_ 987 RLR_VibrWarnL 0;
BA_ "GenSigInvalidValue" SG_ 987 RLR_VibrWarnL 0;
BA_ "GenSigSendType" SG_ 987 RLR_VibrWarnL 1;
BA_ "GenSigStartValue" SG_ 987 RLR_VibrWarnL 0;
BA_ "GenSigTimeoutValue" SG_ 987 RLR_VibrWarnL 0;
BA_ "Remark" SG_ 987 RLR_VibrWarnL "Only for 3R1V IFC Rx";
BA_ "EventCommandSignal" SG_ 987 RLR_RCTAWarnL 0;
BA_ "GatewayedSignals" SG_ 987 RLR_RCTAWarnL 0;
BA_ "GenSigInactiveValue" SG_ 987 RLR_RCTAWarnL 0;
BA_ "GenSigInvalidValue" SG_ 987 RLR_RCTAWarnL 0;
BA_ "GenSigSendType" SG_ 987 RLR_RCTAWarnL 1;
BA_ "GenSigStartValue" SG_ 987 RLR_RCTAWarnL 0;
BA_ "EventCommandSignal" SG_ 987 RLR_RCTBBrkVD 0;
BA_ "GatewayedSignals" SG_ 987 RLR_RCTBBrkVD 0;
BA_ "GenSigInactiveValue" SG_ 987 RLR_RCTBBrkVD 0;
BA_ "GenSigInvalidValue" SG_ 987 RLR_RCTBBrkVD 0;
BA_ "GenSigSendType" SG_ 987 RLR_RCTBBrkVD 1;
BA_ "GenSigStartValue" SG_ 987 RLR_RCTBBrkVD 0;
BA_ "GenSigTimeoutValue" SG_ 987 RLR_RCTBBrkVD 1;
BA_ "Remark" SG_ 987 RLR_RCTBBrkVD "Only for 3R1V IFC Rx";
BA_ "EventCommandSignal" SG_ 987 RLR_RCTBBrkReq 0;
BA_ "GatewayedSignals" SG_ 987 RLR_RCTBBrkReq 0;
BA_ "GenSigInactiveValue" SG_ 987 RLR_RCTBBrkReq 0;
BA_ "GenSigInvalidValue" SG_ 987 RLR_RCTBBrkReq 0;
BA_ "GenSigSendType" SG_ 987 RLR_RCTBBrkReq 1;
BA_ "GenSigStartValue" SG_ 987 RLR_RCTBBrkReq 0;
BA_ "GenSigTimeoutValue" SG_ 987 RLR_RCTBBrkReq 0;
BA_ "Remark" SG_ 987 RLR_RCTBBrkReq "Only for 3R1V IFC Rx";
BA_ "EventCommandSignal" SG_ 93 CCU_ADCSoCWakeupRequest 1;
BA_ "GatewayedSignals" SG_ 93 CCU_ADCSoCWakeupRequest 0;
BA_ "GenSigInactiveValue" SG_ 93 CCU_ADCSoCWakeupRequest 0;
BA_ "GenSigInvalidValue" SG_ 93 CCU_ADCSoCWakeupRequest 0;
BA_ "GenSigSendType" SG_ 93 CCU_ADCSoCWakeupRequest 0;
BA_ "GenSigStartValue" SG_ 93 CCU_ADCSoCWakeupRequest 0;
BA_ "GenSigTimeoutValue" SG_ 93 CCU_ADCSoCWakeupRequest 0;
BA_ "Remark" SG_ 93 CCU_ADCSoCWakeupRequest "";
BA_ "EventCommandSignal" SG_ 766 POD_DoorOptStFL 0;
BA_ "GatewayedSignals" SG_ 766 POD_DoorOptStFL 0;
BA_ "GenSigInactiveValue" SG_ 766 POD_DoorOptStFL 0;
BA_ "GenSigInvalidValue" SG_ 766 POD_DoorOptStFL 0;
BA_ "GenSigSendType" SG_ 766 POD_DoorOptStFL 1;
BA_ "GenSigStartValue" SG_ 766 POD_DoorOptStFL 0;
BA_ "GenSigTimeoutValue" SG_ 766 POD_DoorOptStFL 0;
BA_ "Remark" SG_ 766 POD_DoorOptStFL "";
BA_ "EventCommandSignal" SG_ 766 POD_DoorOptStFR 0;
BA_ "GatewayedSignals" SG_ 766 POD_DoorOptStFR 0;
BA_ "GenSigInactiveValue" SG_ 766 POD_DoorOptStFR 0;
BA_ "GenSigInvalidValue" SG_ 766 POD_DoorOptStFR 0;
BA_ "GenSigSendType" SG_ 766 POD_DoorOptStFR 1;
BA_ "GenSigStartValue" SG_ 766 POD_DoorOptStFR 0;
BA_ "GenSigTimeoutValue" SG_ 766 POD_DoorOptStFR 0;
BA_ "Remark" SG_ 766 POD_DoorOptStFR "";
BA_ "EventCommandSignal" SG_ 766 POD_DoorOptStRL 0;
BA_ "GatewayedSignals" SG_ 766 POD_DoorOptStRL 0;
BA_ "GenSigInactiveValue" SG_ 766 POD_DoorOptStRL 0;
BA_ "GenSigInvalidValue" SG_ 766 POD_DoorOptStRL 0;
BA_ "GenSigSendType" SG_ 766 POD_DoorOptStRL 1;
BA_ "GenSigStartValue" SG_ 766 POD_DoorOptStRL 0;
BA_ "GenSigTimeoutValue" SG_ 766 POD_DoorOptStRL 0;
BA_ "Remark" SG_ 766 POD_DoorOptStRL "";
BA_ "EventCommandSignal" SG_ 766 POD_DoorOptStRR 0;
BA_ "GatewayedSignals" SG_ 766 POD_DoorOptStRR 0;
BA_ "GenSigInactiveValue" SG_ 766 POD_DoorOptStRR 0;
BA_ "GenSigInvalidValue" SG_ 766 POD_DoorOptStRR 0;
BA_ "GenSigSendType" SG_ 766 POD_DoorOptStRR 1;
BA_ "GenSigStartValue" SG_ 766 POD_DoorOptStRR 0;
BA_ "GenSigTimeoutValue" SG_ 766 POD_DoorOptStRR 0;
BA_ "Remark" SG_ 766 POD_DoorOptStRR "";
BA_ "EventCommandSignal" SG_ 766 POD_CurDoorPosFL 0;
BA_ "GatewayedSignals" SG_ 766 POD_CurDoorPosFL 0;
BA_ "GenSigInactiveValue" SG_ 766 POD_CurDoorPosFL 0;
BA_ "GenSigInvalidValue" SG_ 766 POD_CurDoorPosFL 0;
BA_ "GenSigSendType" SG_ 766 POD_CurDoorPosFL 1;
BA_ "GenSigStartValue" SG_ 766 POD_CurDoorPosFL 0;
BA_ "GenSigTimeoutValue" SG_ 766 POD_CurDoorPosFL 0;
BA_ "Remark" SG_ 766 POD_CurDoorPosFL "";
BA_ "EventCommandSignal" SG_ 766 POD_CurDoorPosFR 0;
BA_ "GatewayedSignals" SG_ 766 POD_CurDoorPosFR 0;
BA_ "GenSigInactiveValue" SG_ 766 POD_CurDoorPosFR 0;
BA_ "GenSigInvalidValue" SG_ 766 POD_CurDoorPosFR 0;
BA_ "GenSigSendType" SG_ 766 POD_CurDoorPosFR 1;
BA_ "GenSigStartValue" SG_ 766 POD_CurDoorPosFR 0;
BA_ "GenSigTimeoutValue" SG_ 766 POD_CurDoorPosFR 0;
BA_ "Remark" SG_ 766 POD_CurDoorPosFR "";
BA_ "EventCommandSignal" SG_ 766 POD_DSMEmergencyStopFL 0;
BA_ "GatewayedSignals" SG_ 766 POD_DSMEmergencyStopFL 0;
BA_ "GenSigInactiveValue" SG_ 766 POD_DSMEmergencyStopFL 0;
BA_ "GenSigInvalidValue" SG_ 766 POD_DSMEmergencyStopFL 0;
BA_ "GenSigSendType" SG_ 766 POD_DSMEmergencyStopFL 1;
BA_ "GenSigStartValue" SG_ 766 POD_DSMEmergencyStopFL 0;
BA_ "GenSigTimeoutValue" SG_ 766 POD_DSMEmergencyStopFL 0;
BA_ "Remark" SG_ 766 POD_DSMEmergencyStopFL "";
BA_ "EventCommandSignal" SG_ 766 POD_DSMOpenablePercentFL 0;
BA_ "GatewayedSignals" SG_ 766 POD_DSMOpenablePercentFL 0;
BA_ "GenSigInactiveValue" SG_ 766 POD_DSMOpenablePercentFL 0;
BA_ "GenSigInvalidValue" SG_ 766 POD_DSMOpenablePercentFL 0;
BA_ "GenSigSendType" SG_ 766 POD_DSMOpenablePercentFL 1;
BA_ "GenSigStartValue" SG_ 766 POD_DSMOpenablePercentFL 127;
BA_ "GenSigTimeoutValue" SG_ 766 POD_DSMOpenablePercentFL 0;
BA_ "Remark" SG_ 766 POD_DSMOpenablePercentFL "";
BA_ "EventCommandSignal" SG_ 766 POD_CurDoorPosRL 0;
BA_ "GatewayedSignals" SG_ 766 POD_CurDoorPosRL 0;
BA_ "GenSigInactiveValue" SG_ 766 POD_CurDoorPosRL 0;
BA_ "GenSigInvalidValue" SG_ 766 POD_CurDoorPosRL 0;
BA_ "GenSigSendType" SG_ 766 POD_CurDoorPosRL 1;
BA_ "GenSigStartValue" SG_ 766 POD_CurDoorPosRL 0;
BA_ "GenSigTimeoutValue" SG_ 766 POD_CurDoorPosRL 0;
BA_ "Remark" SG_ 766 POD_CurDoorPosRL "";
BA_ "EventCommandSignal" SG_ 766 POD_DSMValidFL 0;
BA_ "GatewayedSignals" SG_ 766 POD_DSMValidFL 0;
BA_ "GenSigInactiveValue" SG_ 766 POD_DSMValidFL 0;
BA_ "GenSigInvalidValue" SG_ 766 POD_DSMValidFL 0;
BA_ "GenSigSendType" SG_ 766 POD_DSMValidFL 1;
BA_ "GenSigStartValue" SG_ 766 POD_DSMValidFL 0;
BA_ "GenSigTimeoutValue" SG_ 766 POD_DSMValidFL 0;
BA_ "Remark" SG_ 766 POD_DSMValidFL "";
BA_ "EventCommandSignal" SG_ 766 POD_DSMEmergencyStopFR 0;
BA_ "GatewayedSignals" SG_ 766 POD_DSMEmergencyStopFR 0;
BA_ "GenSigInactiveValue" SG_ 766 POD_DSMEmergencyStopFR 0;
BA_ "GenSigInvalidValue" SG_ 766 POD_DSMEmergencyStopFR 0;
BA_ "GenSigSendType" SG_ 766 POD_DSMEmergencyStopFR 1;
BA_ "GenSigStartValue" SG_ 766 POD_DSMEmergencyStopFR 0;
BA_ "GenSigTimeoutValue" SG_ 766 POD_DSMEmergencyStopFR 0;
BA_ "Remark" SG_ 766 POD_DSMEmergencyStopFR "";
BA_ "EventCommandSignal" SG_ 766 POD_DSMOpenablePercentFR 0;
BA_ "GatewayedSignals" SG_ 766 POD_DSMOpenablePercentFR 0;
BA_ "GenSigInactiveValue" SG_ 766 POD_DSMOpenablePercentFR 0;
BA_ "GenSigInvalidValue" SG_ 766 POD_DSMOpenablePercentFR 0;
BA_ "GenSigSendType" SG_ 766 POD_DSMOpenablePercentFR 1;
BA_ "GenSigStartValue" SG_ 766 POD_DSMOpenablePercentFR 127;
BA_ "GenSigTimeoutValue" SG_ 766 POD_DSMOpenablePercentFR 0;
BA_ "Remark" SG_ 766 POD_DSMOpenablePercentFR "";
BA_ "EventCommandSignal" SG_ 766 POD_CurDoorPosRR 0;
BA_ "GatewayedSignals" SG_ 766 POD_CurDoorPosRR 0;
BA_ "GenSigInactiveValue" SG_ 766 POD_CurDoorPosRR 0;
BA_ "GenSigInvalidValue" SG_ 766 POD_CurDoorPosRR 0;
BA_ "GenSigSendType" SG_ 766 POD_CurDoorPosRR 1;
BA_ "GenSigStartValue" SG_ 766 POD_CurDoorPosRR 0;
BA_ "GenSigTimeoutValue" SG_ 766 POD_CurDoorPosRR 0;
BA_ "Remark" SG_ 766 POD_CurDoorPosRR "";
BA_ "EventCommandSignal" SG_ 766 POD_DSMValidFR 0;
BA_ "GatewayedSignals" SG_ 766 POD_DSMValidFR 0;
BA_ "GenSigInactiveValue" SG_ 766 POD_DSMValidFR 0;
BA_ "GenSigInvalidValue" SG_ 766 POD_DSMValidFR 0;
BA_ "GenSigSendType" SG_ 766 POD_DSMValidFR 1;
BA_ "GenSigStartValue" SG_ 766 POD_DSMValidFR 0;
BA_ "GenSigTimeoutValue" SG_ 766 POD_DSMValidFR 0;
BA_ "Remark" SG_ 766 POD_DSMValidFR "";
BA_ "EventCommandSignal" SG_ 766 POD_DSMEmergencyStopRL 0;
BA_ "GatewayedSignals" SG_ 766 POD_DSMEmergencyStopRL 0;
BA_ "GenSigInactiveValue" SG_ 766 POD_DSMEmergencyStopRL 0;
BA_ "GenSigInvalidValue" SG_ 766 POD_DSMEmergencyStopRL 0;
BA_ "GenSigSendType" SG_ 766 POD_DSMEmergencyStopRL 1;
BA_ "GenSigStartValue" SG_ 766 POD_DSMEmergencyStopRL 0;
BA_ "GenSigTimeoutValue" SG_ 766 POD_DSMEmergencyStopRL 0;
BA_ "Remark" SG_ 766 POD_DSMEmergencyStopRL "";
BA_ "EventCommandSignal" SG_ 766 POD_DSMOpenablePercentRL 0;
BA_ "GatewayedSignals" SG_ 766 POD_DSMOpenablePercentRL 0;
BA_ "GenSigInactiveValue" SG_ 766 POD_DSMOpenablePercentRL 0;
BA_ "GenSigInvalidValue" SG_ 766 POD_DSMOpenablePercentRL 0;
BA_ "GenSigSendType" SG_ 766 POD_DSMOpenablePercentRL 1;
BA_ "GenSigStartValue" SG_ 766 POD_DSMOpenablePercentRL 127;
BA_ "GenSigTimeoutValue" SG_ 766 POD_DSMOpenablePercentRL 0;
BA_ "Remark" SG_ 766 POD_DSMOpenablePercentRL "";
BA_ "EventCommandSignal" SG_ 766 POD_DSMObstacleDisRR 0;
BA_ "GatewayedSignals" SG_ 766 POD_DSMObstacleDisRR 0;
BA_ "GenSigInactiveValue" SG_ 766 POD_DSMObstacleDisRR 0;
BA_ "GenSigInvalidValue" SG_ 766 POD_DSMObstacleDisRR 0;
BA_ "GenSigSendType" SG_ 766 POD_DSMObstacleDisRR 1;
BA_ "GenSigStartValue" SG_ 766 POD_DSMObstacleDisRR 255;
BA_ "GenSigTimeoutValue" SG_ 766 POD_DSMObstacleDisRR 0;
BA_ "Remark" SG_ 766 POD_DSMObstacleDisRR "";
BA_ "EventCommandSignal" SG_ 766 POD_DSMValidRL 0;
BA_ "GatewayedSignals" SG_ 766 POD_DSMValidRL 0;
BA_ "GenSigInactiveValue" SG_ 766 POD_DSMValidRL 0;
BA_ "GenSigInvalidValue" SG_ 766 POD_DSMValidRL 0;
BA_ "GenSigSendType" SG_ 766 POD_DSMValidRL 1;
BA_ "GenSigStartValue" SG_ 766 POD_DSMValidRL 0;
BA_ "GenSigTimeoutValue" SG_ 766 POD_DSMValidRL 0;
BA_ "Remark" SG_ 766 POD_DSMValidRL "";
BA_ "EventCommandSignal" SG_ 766 POD_DSMOpenablePercentRR 0;
BA_ "GatewayedSignals" SG_ 766 POD_DSMOpenablePercentRR 0;
BA_ "GenSigInactiveValue" SG_ 766 POD_DSMOpenablePercentRR 0;
BA_ "GenSigInvalidValue" SG_ 766 POD_DSMOpenablePercentRR 0;
BA_ "GenSigSendType" SG_ 766 POD_DSMOpenablePercentRR 1;
BA_ "GenSigStartValue" SG_ 766 POD_DSMOpenablePercentRR 127;
BA_ "GenSigTimeoutValue" SG_ 766 POD_DSMOpenablePercentRR 0;
BA_ "Remark" SG_ 766 POD_DSMOpenablePercentRR "";
BA_ "EventCommandSignal" SG_ 766 POD_DSMEmergencyStopRR 0;
BA_ "GatewayedSignals" SG_ 766 POD_DSMEmergencyStopRR 0;
BA_ "GenSigInactiveValue" SG_ 766 POD_DSMEmergencyStopRR 0;
BA_ "GenSigInvalidValue" SG_ 766 POD_DSMEmergencyStopRR 0;
BA_ "GenSigSendType" SG_ 766 POD_DSMEmergencyStopRR 1;
BA_ "GenSigStartValue" SG_ 766 POD_DSMEmergencyStopRR 0;
BA_ "GenSigTimeoutValue" SG_ 766 POD_DSMEmergencyStopRR 0;
BA_ "Remark" SG_ 766 POD_DSMEmergencyStopRR "";
BA_ "EventCommandSignal" SG_ 766 POD_DSMValidRR 0;
BA_ "GatewayedSignals" SG_ 766 POD_DSMValidRR 0;
BA_ "GenSigInactiveValue" SG_ 766 POD_DSMValidRR 0;
BA_ "GenSigInvalidValue" SG_ 766 POD_DSMValidRR 0;
BA_ "GenSigSendType" SG_ 766 POD_DSMValidRR 1;
BA_ "GenSigStartValue" SG_ 766 POD_DSMValidRR 0;
BA_ "GenSigTimeoutValue" SG_ 766 POD_DSMValidRR 0;
BA_ "Remark" SG_ 766 POD_DSMValidRR "";
BA_ "EventCommandSignal" SG_ 766 POD_DSMObstacleDisFL 0;
BA_ "GatewayedSignals" SG_ 766 POD_DSMObstacleDisFL 0;
BA_ "GenSigInactiveValue" SG_ 766 POD_DSMObstacleDisFL 0;
BA_ "GenSigInvalidValue" SG_ 766 POD_DSMObstacleDisFL 0;
BA_ "GenSigSendType" SG_ 766 POD_DSMObstacleDisFL 1;
BA_ "GenSigStartValue" SG_ 766 POD_DSMObstacleDisFL 255;
BA_ "GenSigTimeoutValue" SG_ 766 POD_DSMObstacleDisFL 0;
BA_ "Remark" SG_ 766 POD_DSMObstacleDisFL "";
BA_ "EventCommandSignal" SG_ 766 POD_DSMObstacleDisFR 0;
BA_ "GatewayedSignals" SG_ 766 POD_DSMObstacleDisFR 0;
BA_ "GenSigInactiveValue" SG_ 766 POD_DSMObstacleDisFR 0;
BA_ "GenSigInvalidValue" SG_ 766 POD_DSMObstacleDisFR 0;
BA_ "GenSigSendType" SG_ 766 POD_DSMObstacleDisFR 1;
BA_ "GenSigStartValue" SG_ 766 POD_DSMObstacleDisFR 255;
BA_ "GenSigTimeoutValue" SG_ 766 POD_DSMObstacleDisFR 0;
BA_ "Remark" SG_ 766 POD_DSMObstacleDisFR "";
BA_ "EventCommandSignal" SG_ 766 POD_DSMObstacleDisRL 0;
BA_ "GatewayedSignals" SG_ 766 POD_DSMObstacleDisRL 0;
BA_ "GenSigInactiveValue" SG_ 766 POD_DSMObstacleDisRL 0;
BA_ "GenSigInvalidValue" SG_ 766 POD_DSMObstacleDisRL 0;
BA_ "GenSigSendType" SG_ 766 POD_DSMObstacleDisRL 1;
BA_ "GenSigStartValue" SG_ 766 POD_DSMObstacleDisRL 255;
BA_ "GenSigTimeoutValue" SG_ 766 POD_DSMObstacleDisRL 0;
BA_ "Remark" SG_ 766 POD_DSMObstacleDisRL "";
BA_ "EventCommandSignal" SG_ 1007 INS_Status 0;
BA_ "GatewayedSignals" SG_ 1007 INS_Status 0;
BA_ "GenSigInactiveValue" SG_ 1007 INS_Status 0;
BA_ "GenSigInvalidValue" SG_ 1007 INS_Status 0;
BA_ "GenSigSendType" SG_ 1007 INS_Status 1;
BA_ "GenSigStartValue" SG_ 1007 INS_Status 0;
BA_ "GenSigTimeoutValue" SG_ 1007 INS_Status 0;
BA_ "Remark" SG_ 1007 INS_Status "";
BA_ "EventCommandSignal" SG_ 459 ECS_2_CRC 0;
BA_ "GatewayedSignals" SG_ 459 ECS_2_CRC 0;
BA_ "GenSigInactiveValue" SG_ 459 ECS_2_CRC 0;
BA_ "GenSigInvalidValue" SG_ 459 ECS_2_CRC 0;
BA_ "GenSigSendType" SG_ 459 ECS_2_CRC 1;
BA_ "GenSigStartValue" SG_ 459 ECS_2_CRC 0;
BA_ "GenSigTimeoutValue" SG_ 459 ECS_2_CRC 0;
BA_ "Remark" SG_ 459 ECS_2_CRC "";
BA_ "EventCommandSignal" SG_ 459 ECS_2_Counter 0;
BA_ "GatewayedSignals" SG_ 459 ECS_2_Counter 0;
BA_ "GenSigInactiveValue" SG_ 459 ECS_2_Counter 0;
BA_ "GenSigInvalidValue" SG_ 459 ECS_2_Counter 0;
BA_ "GenSigSendType" SG_ 459 ECS_2_Counter 1;
BA_ "GenSigStartValue" SG_ 459 ECS_2_Counter 0;
BA_ "GenSigTimeoutValue" SG_ 459 ECS_2_Counter 0;
BA_ "Remark" SG_ 459 ECS_2_Counter "";
BA_ "EventCommandSignal" SG_ 459 AS_SuspHeightFL 0;
BA_ "GatewayedSignals" SG_ 459 AS_SuspHeightFL 0;
BA_ "GenSigInactiveValue" SG_ 459 AS_SuspHeightFL 0;
BA_ "GenSigInvalidValue" SG_ 459 AS_SuspHeightFL 4095;
BA_ "GenSigSendType" SG_ 459 AS_SuspHeightFL 1;
BA_ "GenSigStartValue" SG_ 459 AS_SuspHeightFL 0;
BA_ "GenSigTimeoutValue" SG_ 459 AS_SuspHeightFL 1500;
BA_ "Remark" SG_ 459 AS_SuspHeightFL "";
BA_ "EventCommandSignal" SG_ 459 AS_SuspHeightFR 0;
BA_ "GatewayedSignals" SG_ 459 AS_SuspHeightFR 0;
BA_ "GenSigInactiveValue" SG_ 459 AS_SuspHeightFR 0;
BA_ "GenSigInvalidValue" SG_ 459 AS_SuspHeightFR 4095;
BA_ "GenSigSendType" SG_ 459 AS_SuspHeightFR 1;
BA_ "GenSigStartValue" SG_ 459 AS_SuspHeightFR 0;
BA_ "GenSigTimeoutValue" SG_ 459 AS_SuspHeightFR 1500;
BA_ "Remark" SG_ 459 AS_SuspHeightFR "";
BA_ "EventCommandSignal" SG_ 459 AS_SuspHeightRL 0;
BA_ "GatewayedSignals" SG_ 459 AS_SuspHeightRL 0;
BA_ "GenSigInactiveValue" SG_ 459 AS_SuspHeightRL 0;
BA_ "GenSigInvalidValue" SG_ 459 AS_SuspHeightRL 4095;
BA_ "GenSigSendType" SG_ 459 AS_SuspHeightRL 1;
BA_ "GenSigStartValue" SG_ 459 AS_SuspHeightRL 0;
BA_ "GenSigTimeoutValue" SG_ 459 AS_SuspHeightRL 1500;
BA_ "Remark" SG_ 459 AS_SuspHeightRL "";
BA_ "EventCommandSignal" SG_ 459 AS_SuspHeightRR 0;
BA_ "GatewayedSignals" SG_ 459 AS_SuspHeightRR 0;
BA_ "GenSigInactiveValue" SG_ 459 AS_SuspHeightRR 0;
BA_ "GenSigInvalidValue" SG_ 459 AS_SuspHeightRR 4095;
BA_ "GenSigSendType" SG_ 459 AS_SuspHeightRR 1;
BA_ "GenSigStartValue" SG_ 459 AS_SuspHeightRR 0;
BA_ "GenSigTimeoutValue" SG_ 459 AS_SuspHeightRR 1500;
BA_ "Remark" SG_ 459 AS_SuspHeightRR "";
BA_ "EventCommandSignal" SG_ 459 AS_SuspHeightFLVD 0;
BA_ "GatewayedSignals" SG_ 459 AS_SuspHeightFLVD 0;
BA_ "GenSigInactiveValue" SG_ 459 AS_SuspHeightFLVD 0;
BA_ "GenSigInvalidValue" SG_ 459 AS_SuspHeightFLVD 0;
BA_ "GenSigSendType" SG_ 459 AS_SuspHeightFLVD 1;
BA_ "GenSigStartValue" SG_ 459 AS_SuspHeightFLVD 1;
BA_ "GenSigTimeoutValue" SG_ 459 AS_SuspHeightFLVD 0;
BA_ "Remark" SG_ 459 AS_SuspHeightFLVD "";
BA_ "EventCommandSignal" SG_ 459 AS_SuspHeightFRVD 0;
BA_ "GatewayedSignals" SG_ 459 AS_SuspHeightFRVD 0;
BA_ "GenSigInactiveValue" SG_ 459 AS_SuspHeightFRVD 0;
BA_ "GenSigInvalidValue" SG_ 459 AS_SuspHeightFRVD 0;
BA_ "GenSigSendType" SG_ 459 AS_SuspHeightFRVD 1;
BA_ "GenSigStartValue" SG_ 459 AS_SuspHeightFRVD 1;
BA_ "GenSigTimeoutValue" SG_ 459 AS_SuspHeightFRVD 0;
BA_ "Remark" SG_ 459 AS_SuspHeightFRVD "";
BA_ "EventCommandSignal" SG_ 459 AS_SuspHeightRLVD 0;
BA_ "GatewayedSignals" SG_ 459 AS_SuspHeightRLVD 0;
BA_ "GenSigInactiveValue" SG_ 459 AS_SuspHeightRLVD 0;
BA_ "GenSigInvalidValue" SG_ 459 AS_SuspHeightRLVD 0;
BA_ "GenSigSendType" SG_ 459 AS_SuspHeightRLVD 1;
BA_ "GenSigStartValue" SG_ 459 AS_SuspHeightRLVD 1;
BA_ "GenSigTimeoutValue" SG_ 459 AS_SuspHeightRLVD 0;
BA_ "Remark" SG_ 459 AS_SuspHeightRLVD "";
BA_ "EventCommandSignal" SG_ 459 AS_SuspHeightRRVD 0;
BA_ "GatewayedSignals" SG_ 459 AS_SuspHeightRRVD 0;
BA_ "GenSigInactiveValue" SG_ 459 AS_SuspHeightRRVD 0;
BA_ "GenSigInvalidValue" SG_ 459 AS_SuspHeightRRVD 0;
BA_ "GenSigSendType" SG_ 459 AS_SuspHeightRRVD 1;
BA_ "GenSigStartValue" SG_ 459 AS_SuspHeightRRVD 1;
BA_ "GenSigTimeoutValue" SG_ 459 AS_SuspHeightRRVD 0;
BA_ "Remark" SG_ 459 AS_SuspHeightRRVD "";
BA_ "EventCommandSignal" SG_ 459 AS_SuspHeightSensorFLSt 0;
BA_ "GatewayedSignals" SG_ 459 AS_SuspHeightSensorFLSt 0;
BA_ "GenSigInactiveValue" SG_ 459 AS_SuspHeightSensorFLSt 0;
BA_ "GenSigInvalidValue" SG_ 459 AS_SuspHeightSensorFLSt 0;
BA_ "GenSigSendType" SG_ 459 AS_SuspHeightSensorFLSt 1;
BA_ "GenSigStartValue" SG_ 459 AS_SuspHeightSensorFLSt 0;
BA_ "GenSigTimeoutValue" SG_ 459 AS_SuspHeightSensorFLSt 1;
BA_ "Remark" SG_ 459 AS_SuspHeightSensorFLSt "";
BA_ "EventCommandSignal" SG_ 459 AS_SuspHeightSensorFRSt 0;
BA_ "GatewayedSignals" SG_ 459 AS_SuspHeightSensorFRSt 0;
BA_ "GenSigInactiveValue" SG_ 459 AS_SuspHeightSensorFRSt 0;
BA_ "GenSigInvalidValue" SG_ 459 AS_SuspHeightSensorFRSt 0;
BA_ "GenSigSendType" SG_ 459 AS_SuspHeightSensorFRSt 1;
BA_ "GenSigStartValue" SG_ 459 AS_SuspHeightSensorFRSt 0;
BA_ "GenSigTimeoutValue" SG_ 459 AS_SuspHeightSensorFRSt 1;
BA_ "Remark" SG_ 459 AS_SuspHeightSensorFRSt "";
BA_ "EventCommandSignal" SG_ 459 AS_SuspHeightSensorRLSt 0;
BA_ "GatewayedSignals" SG_ 459 AS_SuspHeightSensorRLSt 0;
BA_ "GenSigInactiveValue" SG_ 459 AS_SuspHeightSensorRLSt 0;
BA_ "GenSigInvalidValue" SG_ 459 AS_SuspHeightSensorRLSt 0;
BA_ "GenSigSendType" SG_ 459 AS_SuspHeightSensorRLSt 1;
BA_ "GenSigStartValue" SG_ 459 AS_SuspHeightSensorRLSt 0;
BA_ "GenSigTimeoutValue" SG_ 459 AS_SuspHeightSensorRLSt 1;
BA_ "Remark" SG_ 459 AS_SuspHeightSensorRLSt "";
BA_ "EventCommandSignal" SG_ 459 AS_SuspHeightSensoRRSt 0;
BA_ "GatewayedSignals" SG_ 459 AS_SuspHeightSensoRRSt 0;
BA_ "GenSigInactiveValue" SG_ 459 AS_SuspHeightSensoRRSt 0;
BA_ "GenSigInvalidValue" SG_ 459 AS_SuspHeightSensoRRSt 0;
BA_ "GenSigSendType" SG_ 459 AS_SuspHeightSensoRRSt 1;
BA_ "GenSigStartValue" SG_ 459 AS_SuspHeightSensoRRSt 0;
BA_ "GenSigTimeoutValue" SG_ 459 AS_SuspHeightSensoRRSt 1;
BA_ "Remark" SG_ 459 AS_SuspHeightSensoRRSt "";
BA_ "EventCommandSignal" SG_ 459 AS_MaintanceModeSt 0;
BA_ "GatewayedSignals" SG_ 459 AS_MaintanceModeSt 0;
BA_ "GenSigInactiveValue" SG_ 459 AS_MaintanceModeSt 0;
BA_ "GenSigInvalidValue" SG_ 459 AS_MaintanceModeSt 0;
BA_ "GenSigSendType" SG_ 459 AS_MaintanceModeSt 1;
BA_ "GenSigStartValue" SG_ 459 AS_MaintanceModeSt 0;
BA_ "GenSigTimeoutValue" SG_ 459 AS_MaintanceModeSt 0;
BA_ "Remark" SG_ 459 AS_MaintanceModeSt "";
BA_ "EventCommandSignal" SG_ 459 ECS_AVDCReqModeAvailable 0;
BA_ "GatewayedSignals" SG_ 459 ECS_AVDCReqModeAvailable 0;
BA_ "GenSigInactiveValue" SG_ 459 ECS_AVDCReqModeAvailable 0;
BA_ "GenSigInvalidValue" SG_ 459 ECS_AVDCReqModeAvailable 0;
BA_ "GenSigSendType" SG_ 459 ECS_AVDCReqModeAvailable 1;
BA_ "GenSigStartValue" SG_ 459 ECS_AVDCReqModeAvailable 0;
BA_ "GenSigTimeoutValue" SG_ 459 ECS_AVDCReqModeAvailable 0;
BA_ "Remark" SG_ 459 ECS_AVDCReqModeAvailable "";
BA_ "EventCommandSignal" SG_ 459 ECS_AVDCReqMode 0;
BA_ "GatewayedSignals" SG_ 459 ECS_AVDCReqMode 0;
BA_ "GenSigInactiveValue" SG_ 459 ECS_AVDCReqMode 0;
BA_ "GenSigInvalidValue" SG_ 459 ECS_AVDCReqMode 0;
BA_ "GenSigSendType" SG_ 459 ECS_AVDCReqMode 1;
BA_ "GenSigStartValue" SG_ 459 ECS_AVDCReqMode 0;
BA_ "GenSigTimeoutValue" SG_ 459 ECS_AVDCReqMode 0;
BA_ "Remark" SG_ 459 ECS_AVDCReqMode "";
BA_ "EventCommandSignal" SG_ 459 AS_FrontAxleSuspSt 0;
BA_ "GatewayedSignals" SG_ 459 AS_FrontAxleSuspSt 0;
BA_ "GenSigInactiveValue" SG_ 459 AS_FrontAxleSuspSt 0;
BA_ "GenSigInvalidValue" SG_ 459 AS_FrontAxleSuspSt 0;
BA_ "GenSigSendType" SG_ 459 AS_FrontAxleSuspSt 1;
BA_ "GenSigStartValue" SG_ 459 AS_FrontAxleSuspSt 0;
BA_ "GenSigTimeoutValue" SG_ 459 AS_FrontAxleSuspSt 0;
BA_ "Remark" SG_ 459 AS_FrontAxleSuspSt "";
BA_ "EventCommandSignal" SG_ 459 AS_RearAxleSuspSt 0;
BA_ "GatewayedSignals" SG_ 459 AS_RearAxleSuspSt 0;
BA_ "GenSigInactiveValue" SG_ 459 AS_RearAxleSuspSt 0;
BA_ "GenSigInvalidValue" SG_ 459 AS_RearAxleSuspSt 0;
BA_ "GenSigSendType" SG_ 459 AS_RearAxleSuspSt 1;
BA_ "GenSigStartValue" SG_ 459 AS_RearAxleSuspSt 0;
BA_ "GenSigTimeoutValue" SG_ 459 AS_RearAxleSuspSt 0;
BA_ "Remark" SG_ 459 AS_RearAxleSuspSt "";
BA_ "EventCommandSignal" SG_ 459 AS_HeightWarningSt 0;
BA_ "GatewayedSignals" SG_ 459 AS_HeightWarningSt 0;
BA_ "GenSigInactiveValue" SG_ 459 AS_HeightWarningSt 0;
BA_ "GenSigInvalidValue" SG_ 459 AS_HeightWarningSt 0;
BA_ "GenSigSendType" SG_ 459 AS_HeightWarningSt 1;
BA_ "GenSigStartValue" SG_ 459 AS_HeightWarningSt 0;
BA_ "GenSigTimeoutValue" SG_ 459 AS_HeightWarningSt 0;
BA_ "Remark" SG_ 459 AS_HeightWarningSt "";
BA_ "EventCommandSignal" SG_ 459 AS_CurrentLevel 0;
BA_ "GatewayedSignals" SG_ 459 AS_CurrentLevel 0;
BA_ "GenSigInactiveValue" SG_ 459 AS_CurrentLevel 0;
BA_ "GenSigInvalidValue" SG_ 459 AS_CurrentLevel 0;
BA_ "GenSigSendType" SG_ 459 AS_CurrentLevel 1;
BA_ "GenSigStartValue" SG_ 459 AS_CurrentLevel 0;
BA_ "GenSigTimeoutValue" SG_ 459 AS_CurrentLevel 0;
BA_ "Remark" SG_ 459 AS_CurrentLevel "";
BA_ "EventCommandSignal" SG_ 459 AS_TargetLevel 0;
BA_ "GatewayedSignals" SG_ 459 AS_TargetLevel 0;
BA_ "GenSigInactiveValue" SG_ 459 AS_TargetLevel 0;
BA_ "GenSigInvalidValue" SG_ 459 AS_TargetLevel 0;
BA_ "GenSigSendType" SG_ 459 AS_TargetLevel 1;
BA_ "GenSigStartValue" SG_ 459 AS_TargetLevel 0;
BA_ "GenSigTimeoutValue" SG_ 459 AS_TargetLevel 0;
BA_ "Remark" SG_ 459 AS_TargetLevel "";
BA_ "EventCommandSignal" SG_ 459 AS_ASMode 0;
BA_ "GatewayedSignals" SG_ 459 AS_ASMode 0;
BA_ "GenSigInactiveValue" SG_ 459 AS_ASMode 0;
BA_ "GenSigInvalidValue" SG_ 459 AS_ASMode 0;
BA_ "GenSigSendType" SG_ 459 AS_ASMode 1;
BA_ "GenSigStartValue" SG_ 459 AS_ASMode 0;
BA_ "GenSigTimeoutValue" SG_ 459 AS_ASMode 0;
BA_ "Remark" SG_ 459 AS_ASMode "";
BA_ "EventCommandSignal" SG_ 459 AS_SysFaultSt 0;
BA_ "GatewayedSignals" SG_ 459 AS_SysFaultSt 0;
BA_ "GenSigInactiveValue" SG_ 459 AS_SysFaultSt 0;
BA_ "GenSigInvalidValue" SG_ 459 AS_SysFaultSt 0;
BA_ "GenSigSendType" SG_ 459 AS_SysFaultSt 1;
BA_ "GenSigStartValue" SG_ 459 AS_SysFaultSt 0;
BA_ "GenSigTimeoutValue" SG_ 459 AS_SysFaultSt 2;
BA_ "Remark" SG_ 459 AS_SysFaultSt "";
BA_ "EventCommandSignal" SG_ 459 AS_OverHeatingSt 0;
BA_ "GatewayedSignals" SG_ 459 AS_OverHeatingSt 0;
BA_ "GenSigInactiveValue" SG_ 459 AS_OverHeatingSt 0;
BA_ "GenSigInvalidValue" SG_ 459 AS_OverHeatingSt 0;
BA_ "GenSigSendType" SG_ 459 AS_OverHeatingSt 1;
BA_ "GenSigStartValue" SG_ 459 AS_OverHeatingSt 0;
BA_ "GenSigTimeoutValue" SG_ 459 AS_OverHeatingSt 0;
BA_ "Remark" SG_ 459 AS_OverHeatingSt "";
BA_ "EventCommandSignal" SG_ 459 AS_SysOperationSt 0;
BA_ "GatewayedSignals" SG_ 459 AS_SysOperationSt 0;
BA_ "GenSigInactiveValue" SG_ 459 AS_SysOperationSt 0;
BA_ "GenSigInvalidValue" SG_ 459 AS_SysOperationSt 0;
BA_ "GenSigSendType" SG_ 459 AS_SysOperationSt 1;
BA_ "GenSigStartValue" SG_ 459 AS_SysOperationSt 0;
BA_ "GenSigTimeoutValue" SG_ 459 AS_SysOperationSt 0;
BA_ "Remark" SG_ 459 AS_SysOperationSt "";
BA_ "EventCommandSignal" SG_ 459 AS_OverLoadSt 0;
BA_ "GatewayedSignals" SG_ 459 AS_OverLoadSt 0;
BA_ "GenSigInactiveValue" SG_ 459 AS_OverLoadSt 0;
BA_ "GenSigInvalidValue" SG_ 459 AS_OverLoadSt 0;
BA_ "GenSigSendType" SG_ 459 AS_OverLoadSt 1;
BA_ "GenSigStartValue" SG_ 459 AS_OverLoadSt 0;
BA_ "GenSigTimeoutValue" SG_ 459 AS_OverLoadSt 0;
BA_ "Remark" SG_ 459 AS_OverLoadSt "";
BA_ "EventCommandSignal" SG_ 459 AS_OverTorsionSt 0;
BA_ "GatewayedSignals" SG_ 459 AS_OverTorsionSt 0;
BA_ "GenSigInactiveValue" SG_ 459 AS_OverTorsionSt 0;
BA_ "GenSigInvalidValue" SG_ 459 AS_OverTorsionSt 0;
BA_ "GenSigSendType" SG_ 459 AS_OverTorsionSt 1;
BA_ "GenSigStartValue" SG_ 459 AS_OverTorsionSt 0;
BA_ "GenSigTimeoutValue" SG_ 459 AS_OverTorsionSt 0;
BA_ "Remark" SG_ 459 AS_OverTorsionSt "";
BA_ "EventCommandSignal" SG_ 459 AS_ManufacModeSt 0;
BA_ "GatewayedSignals" SG_ 459 AS_ManufacModeSt 0;
BA_ "GenSigInactiveValue" SG_ 459 AS_ManufacModeSt 0;
BA_ "GenSigInvalidValue" SG_ 459 AS_ManufacModeSt 0;
BA_ "GenSigSendType" SG_ 459 AS_ManufacModeSt 1;
BA_ "GenSigStartValue" SG_ 459 AS_ManufacModeSt 0;
BA_ "GenSigTimeoutValue" SG_ 459 AS_ManufacModeSt 0;
BA_ "Remark" SG_ 459 AS_ManufacModeSt "";
BA_ "EventCommandSignal" SG_ 459 AS_ASIndividualMode 0;
BA_ "GatewayedSignals" SG_ 459 AS_ASIndividualMode 0;
BA_ "GenSigInactiveValue" SG_ 459 AS_ASIndividualMode 0;
BA_ "GenSigInvalidValue" SG_ 459 AS_ASIndividualMode 0;
BA_ "GenSigSendType" SG_ 459 AS_ASIndividualMode 1;
BA_ "GenSigStartValue" SG_ 459 AS_ASIndividualMode 0;
BA_ "GenSigTimeoutValue" SG_ 459 AS_ASIndividualMode 0;
BA_ "Remark" SG_ 459 AS_ASIndividualMode "";
BA_ "EventCommandSignal" SG_ 459 AS_ADCStfnCtrlAvl 0;
BA_ "GatewayedSignals" SG_ 459 AS_ADCStfnCtrlAvl 0;
BA_ "GenSigInactiveValue" SG_ 459 AS_ADCStfnCtrlAvl 0;
BA_ "GenSigInvalidValue" SG_ 459 AS_ADCStfnCtrlAvl 0;
BA_ "GenSigSendType" SG_ 459 AS_ADCStfnCtrlAvl 1;
BA_ "GenSigStartValue" SG_ 459 AS_ADCStfnCtrlAvl 0;
BA_ "GenSigTimeoutValue" SG_ 459 AS_ADCStfnCtrlAvl 0;
BA_ "Remark" SG_ 459 AS_ADCStfnCtrlAvl "";
BA_ "EventCommandSignal" SG_ 459 AS_ADCStfnState 0;
BA_ "GatewayedSignals" SG_ 459 AS_ADCStfnState 0;
BA_ "GenSigInactiveValue" SG_ 459 AS_ADCStfnState 0;
BA_ "GenSigInvalidValue" SG_ 459 AS_ADCStfnState 0;
BA_ "GenSigSendType" SG_ 459 AS_ADCStfnState 1;
BA_ "GenSigStartValue" SG_ 459 AS_ADCStfnState 0;
BA_ "GenSigTimeoutValue" SG_ 459 AS_ADCStfnState 0;
BA_ "Remark" SG_ 459 AS_ADCStfnState "";
VAL_ 971 ADC_MnvrOrintChng6 0 "None" 1 "Parallel" 2 "Cross" 3 "Oblique"  ;
VAL_ 971 ADC_TarParkSt_Posn6 0 "None" 1 "Invalid" 2 "Valid" 3 "Selectable" 4 "Selected" 5 "Reserved" 6 "Reserved" 7 "Reserved"  ;
VAL_ 971 ADC_ParkChkSrc_Posn6 0 "None" 1 "camera" 2 "lidar" 3 "mixed" 4 "Reserved" 5 "Reserved" 6 "Reserved" 7 "Reserved"  ;
VAL_ 971 ADC_MnvrOrintChng7 0 "None" 1 "Parallel" 2 "Cross" 3 "Oblique"  ;
VAL_ 971 ADC_TarParkSt_Posn7 0 "None" 1 "Invalid" 2 "Valid" 3 "Selectable" 4 "Selected" 5 "Reserved" 6 "Reserved" 7 "Reserved"  ;
VAL_ 971 ADC_ParkChkSrc_Posn7 0 "None" 1 "camera" 2 "lidar" 3 "mixed" 4 "Reserved" 5 "Reserved" 6 "Reserved" 7 "Reserved"  ;
VAL_ 971 ADC_MnvrOrintChng8 0 "None" 1 "Parallel" 2 "Cross" 3 "Oblique"  ;
VAL_ 971 ADC_TarParkSt_Posn8 0 "None" 1 "Invalid" 2 "Valid" 3 "Selectable" 4 "Selected" 5 "Reserved" 6 "Reserved" 7 "Reserved"  ;
VAL_ 971 ADC_ParkChkSrc_Posn8 0 "None" 1 "camera" 2 "lidar" 3 "mixed" 4 "Reserved" 5 "Reserved" 6 "Reserved" 7 "Reserved"  ;
VAL_ 971 ADC_MnvrOrintChng5 0 "None" 1 "Parallel" 2 "Cross" 3 "Oblique"  ;
VAL_ 971 ADC_TarParkSt_Posn5 0 "None" 1 "Invalid" 2 "Valid" 3 "Selectable" 4 "Selected" 5 "Reserved" 6 "Reserved" 7 "Reserved"  ;
VAL_ 971 ADC_ParkChkSrc_Posn5 0 "None" 1 "camera" 2 "lidar" 3 "mixed" 4 "Reserved" 5 "Reserved" 6 "Reserved" 7 "Reserved"  ;
VAL_ 121 ADC_SEC_KEY_Defaultencoding 0 "Matching succeeded (saving key and default_encoding succeeded)" 1 "key save succeeded, default_encoding  save failed" 2 "key save failed, default_encoding  save succeeded" 3 "Matching failed（saving key and default_encoding failed）" 4 "reserved" 5 "reserved" 6 "reserved" 7 "reserved"  ;
VAL_ 619 EPB_FailSt_L 0 "No error" 1 "Error"  ;
VAL_ 619 EPB_ExtAvailable_L 0 "Apply and release" 1 "Only apply" 2 "Only release" 3 "None"  ;
VAL_ 619 EPB_ActuatorSt_L 0 "PbcActuatorState_Applied" 1 "PbcActuatorState_Released" 2 "PbcActuatorState_Applying" 3 "PbcActuatorState_Releasing" 4 "PbcActuatorState_Unknown" 5 "PbcActuatorState_HoldApplied" 6 "PbcActuatorState_CompletelyReleased" 7 "Not used" 8 "Not used" 9 "Not used" 10 "Not used" 11 "Not used" 12 "Not used" 13 "Not used" 14 "Not used" 15 "Not used"  ;
VAL_ 1043 TEL_TimeVD 0 "Not valid" 1 "Valid"  ;
VAL_ 926 FLR_MRRSt 0 "ON" 1 "Sensor Covered" 2 "System Error" 3 "Temporary Error" 4 "initializing"  ;
VAL_ 926 FLR_FCTAWarnLeft 0 "No warning" 1 "Warning level 1" 2 "Warning level 2" 3 "Not used"  ;
VAL_ 926 FLR_FCTASt 0 "OFF" 1 "Passive" 2 "Active" 3 "Failure"  ;
VAL_ 926 FLR_FCTAAssistType 0 "No Selected" 1 "Failure" 2 "Warning" 3 "brake and Warning"  ;
VAL_ 926 FLR_FCTBBrkVD 0 "Invalid" 1 "Valid"  ;
VAL_ 926 FLR_FCTBBrkReq 0 "No request" 1 "Request"  ;
VAL_ 927 FRR_MRRSt 0 "ON" 1 "Sensor Covered" 2 "System Error" 3 "Temporary Error" 4 "initializing"  ;
VAL_ 927 FRR_FCTAWarnRight 0 "No warning" 1 "Warning level 1" 2 "Warning level 2" 3 "Not used"  ;
VAL_ 927 FRR_FCTASt 0 "OFF" 1 "Passive" 2 "Active" 3 "Failure"  ;
VAL_ 927 FRR_FCTAAssistType 0 "No Selected" 1 "Failure" 2 "Warning" 3 "brake and Warning"  ;
VAL_ 927 FRR_FCTBBrkVD 0 "Invalid" 1 "Valid"  ;
VAL_ 927 FRR_FCTBBrkReq 0 "No request" 1 "Request"  ;
VAL_ 932 RRR_MRRSt 0 "ON" 1 "Sensor Covered" 2 "System Error" 3 "Temporary Error" 4 "initializing"  ;
VAL_ 932 RRR_ExMirLedWarnR 0 "OFF" 1 "Continue ON（Warning level 1）" 2 "Flashing（Warning level 2）" 3 "Reserved"  ;
VAL_ 932 RRR_LCASt 0 "OFF" 1 "Passive" 2 "Active" 3 "Failure"  ;
VAL_ 932 RRR_LCAWarnRight 0 "No warning" 1 "Warning level 1" 2 "Warning level 2" 3 "Not used"  ;
VAL_ 932 RRR_ClusterLamp 0 "OFF" 1 "Continue ON(Yellow)" 2 "Continue ON(Green)"  ;
VAL_ 932 RRR_DOWWarnR 0 "OFF" 1 "Warning level 1" 2 "Warning level 2" 3 "Reserved"  ;
VAL_ 932 RRR_DOWSt 0 "OFF" 1 "Passive" 2 "Active" 3 "Failure"  ;
VAL_ 932 RRR_AudioWarnFR 0 "No Warning" 1 "Warning"  ;
VAL_ 932 RRR_AudioWarnRR 0 "No Warning" 1 "Warning"  ;
VAL_ 932 RRR_IALWarnFR 0 "No Warning" 1 "Warning"  ;
VAL_ 932 RRR_IALWarnRR 0 "No Warning" 1 "Warning"  ;
VAL_ 932 RRR_RCTASt 0 "OFF" 1 "Passive" 2 "Active" 3 "Failure"  ;
VAL_ 932 RRR_RCTAWarnRight 0 "No warning" 1 "Warning level 1" 2 "Warning level 2" 3 "Not used"  ;
VAL_ 932 RRR_RCWSt 0 "Off" 1 "Passive/On/Inactive" 2 "Active" 3 "Failure"  ;
VAL_ 932 RRR_RCWWarn 0 "No warning" 1 "Warning level 1" 2 "Warning level 2" 3 "Not used"  ;
VAL_ 932 RRR_RCTBBrkReq 0 "No request" 1 "Request"  ;
VAL_ 932 RRR_RCTBBrkgVD 0 "Invalid" 1 "Valid"  ;
VAL_ 932 RRR_TargetRVD 0 "Target Invalid" 1 "Target Valid" 2 "No Target" 3 "reserved"  ;
VAL_ 932 RRR_VibrWarnR 0 "No Warning" 1 "Warning"  ;
VAL_ 932 RRR_RCTAAssistType 0 "OFF" 1 "fail" 2 "Warning" 3 "brake and Warning"  ;
VAL_ 987 RLR_MRRSt 0 "ON" 1 "Sensor Covered" 2 "System Error" 3 "Temporary Error" 4 "initializing"  ;
VAL_ 987 RLR_ExMirLedWarnL 0 "OFF" 1 "Continue ON（Warning level 1）" 2 "Flashing（Warning level 2）" 3 "Reserved"  ;
VAL_ 987 RLR_LCASt 0 "OFF" 1 "Passive" 2 "Active" 3 "Failure"  ;
VAL_ 987 RLR_LCAWarnLeft 0 "No warning" 1 "Warning level 1" 2 "Warning level 2" 3 "Not used"  ;
VAL_ 987 RLR_ClusterLamp 0 "OFF" 1 "Continue ON(Yellow)" 2 "Continue ON(Green)"  ;
VAL_ 987 RLR_DOWWarnL 0 "OFF" 1 "Warning level 1" 2 "Warning level 2" 3 "Reserved"  ;
VAL_ 987 RLR_DOWSt 0 "OFF" 1 "Passive" 2 "Active" 3 "Failure"  ;
VAL_ 987 RLR_AudioWarnFL 0 "No Warning" 1 "Warning"  ;
VAL_ 987 RLR_AudioWarnRL 0 "No Warning" 1 "Warning"  ;
VAL_ 987 RLR_IALWarnFL 0 "No Warning" 1 "Warning level 1" 2 "Warning level 2" 3 "Reserved"  ;
VAL_ 987 RLR_IALWarnRL 0 "No Warning" 1 "Warning level 1" 2 "Warning level 2" 3 "Reserved"  ;
VAL_ 987 RLR_RCTAWarnLeft 0 "No warning" 1 "Warning level 1" 2 "Warning level 2" 3 "Not used"  ;
VAL_ 987 RLR_RCWSt 0 "Off" 1 "Passive/On/Inactive" 2 "Active" 3 "Failure"  ;
VAL_ 987 RLR_RCWWarn 0 "No warning" 1 "Warning level 1" 2 "Warning level 2" 3 "Not used"  ;
VAL_ 987 RLR_RCTASt 0 "OFF" 1 "Passive" 2 "Active" 3 "Failure"  ;
VAL_ 987 RLR_TargetLVD 0 "Target Invalid" 1 "Target Valid" 2 "No Target" 3 "reserved"  ;
VAL_ 987 RLR_RCTAAssistType 0 "OFF" 1 "fail" 2 "Warning" 3 "brake and Warning"  ;
VAL_ 987 RLR_VibrWarnL 0 "No Warning" 1 "Warning"  ;
VAL_ 987 RLR_RCTAWarnL 0 "No Warning" 1 "Warning"  ;
VAL_ 987 RLR_RCTBBrkVD 0 "Invalid" 1 "Valid"  ;
VAL_ 987 RLR_RCTBBrkReq 0 "No request" 1 "Request"  ;
VAL_ 93 CCU_ADCSoCWakeupRequest 0 "No Request" 1 "Request" 2 "Reserved" 3 "Reserved" 4 "Reserved" 5 "Reserved" 6 "Reserved" 7 "Reserved"  ;
VAL_ 766 POD_DoorOptStFL 0 "Stop" 1 "Opening" 2 "Closing" 3 "Reserved"  ;
VAL_ 766 POD_DoorOptStFR 0 "Stop" 1 "Opening" 2 "Closing" 3 "Reserved"  ;
VAL_ 766 POD_DoorOptStRL 0 "Stop" 1 "Opening" 2 "Closing" 3 "Reserved"  ;
VAL_ 766 POD_DoorOptStRR 0 "Stop" 1 "Opening" 2 "Closing" 3 "Reserved"  ;
VAL_ 766 POD_CurDoorPosFL 127 "Position unknown"  ;
VAL_ 766 POD_CurDoorPosFR 127 "Position unknown"  ;
VAL_ 766 POD_DSMEmergencyStopFL 0 "Non-Emergency stop" 1 "Emergency stop"  ;
VAL_ 766 POD_DSMOpenablePercentFL 127 "To be detected"  ;
VAL_ 766 POD_CurDoorPosRL 127 "Position unknown"  ;
VAL_ 766 POD_DSMValidFL 0 "Invalid" 1 "Valid"  ;
VAL_ 766 POD_DSMEmergencyStopFR 0 "Non-Emergency stop" 1 "Emergency stop"  ;
VAL_ 766 POD_DSMOpenablePercentFR 127 "To be detected"  ;
VAL_ 766 POD_CurDoorPosRR 127 "Position unknown"  ;
VAL_ 766 POD_DSMValidFR 0 "Invalid" 1 "Valid"  ;
VAL_ 766 POD_DSMEmergencyStopRL 0 "Non-Emergency stop" 1 "Emergency stop"  ;
VAL_ 766 POD_DSMOpenablePercentRL 127 "To be detected"  ;
VAL_ 766 POD_DSMObstacleDisRR 255 "No obstacle detected;"  ;
VAL_ 766 POD_DSMValidRL 0 "Invalid" 1 "Valid"  ;
VAL_ 766 POD_DSMOpenablePercentRR 127 "To be detected"  ;
VAL_ 766 POD_DSMEmergencyStopRR 0 "Non-Emergency stop" 1 "Emergency stop"  ;
VAL_ 766 POD_DSMValidRR 0 "Invalid" 1 "Valid"  ;
VAL_ 766 POD_DSMObstacleDisFL 255 "No obstacle detected;"  ;
VAL_ 766 POD_DSMObstacleDisFR 255 "No obstacle detected;"  ;
VAL_ 766 POD_DSMObstacleDisRL 255 "No obstacle detected;"  ;
VAL_ 459 AS_SuspHeightFLVD 0 "Invalid" 1 "Valid"  ;
VAL_ 459 AS_SuspHeightFRVD 0 "Invalid" 1 "Valid"  ;
VAL_ 459 AS_SuspHeightRLVD 0 "Invalid" 1 "Valid"  ;
VAL_ 459 AS_SuspHeightRRVD 0 "Invalid" 1 "Valid"  ;
VAL_ 459 AS_SuspHeightSensorFLSt 0 "No fault" 1 "Fault"  ;
VAL_ 459 AS_SuspHeightSensorFRSt 0 "No fault" 1 "Fault"  ;
VAL_ 459 AS_SuspHeightSensorRLSt 0 "No fault" 1 "Fault"  ;
VAL_ 459 AS_SuspHeightSensoRRSt 0 "No fault" 1 "Fault"  ;
VAL_ 459 AS_MaintanceModeSt 0 "Disabled" 1 "Inactive" 2 "User activation" 3 "Automatically  activation"  ;
VAL_ 459 ECS_AVDCReqModeAvailable 0 "not available" 1 "available"  ;
VAL_ 459 ECS_AVDCReqMode 0 "inactive" 1 "Small Control" 2 "Middle Control(reserved)" 3 "Big Control"  ;
VAL_ 459 AS_FrontAxleSuspSt 0 "Standby" 1 "Up" 2 "Down" 3 "Reserved"  ;
VAL_ 459 AS_RearAxleSuspSt 0 "Standby" 1 "Up" 2 "Down" 3 "Reserved"  ;
VAL_ 459 AS_HeightWarningSt 0 "Initializing" 1 "Normal" 2 "Too High" 3 "Too Low" 4 "Invalid"  ;
VAL_ 459 AS_CurrentLevel 0 "Invalid" 1 "Very high level" 2 "Between very high and high level" 3 "High level" 4 "Between high and normal level" 5 "Normal level" 6 "Between normal and low level" 7 "Low level" 8 "Between low and very low level" 9 "Very low level" 10 "Between previous level to easy-loading level" 11 "Easy-loading  level" 12 "Between previous level to showrom level" 13 "Showrom level" 14 "Reserved" 15 "Reserved"  ;
VAL_ 459 AS_TargetLevel 0 "No requirement" 1 "Very high level" 2 "High level" 3 "Normal level" 4 "Low level" 5 "Very low level" 6 "Easy-loading  level" 7 "Showrom level" 8 "Reserved" 9 "Reserved" 10 "Reserved" 11 "Reserved" 12 "Reserved" 13 "Reserved" 14 "Reserved" 15 "Reserved"  ;
VAL_ 459 AS_ASMode 0 "Invalid" 1 "Very high base level (not used)" 2 "High level" 3 "Normal level" 4 "Low level" 5 "Very low  base level (not used)" 6 "Reserved" 7 "Reserved"  ;
VAL_ 459 AS_SysFaultSt 0 "No error" 1 "Fault Level1 (minor)" 2 "Fault Level 2 (seriously)" 3 "Fault Level 3 (Very seriously)" 4 "Reserved" 5 "Reserved" 6 "Reserved" 7 "Reserved"  ;
VAL_ 459 AS_OverHeatingSt 0 "No overheating" 1 "Overheating without notice (except 2)" 2 "Overheating with notice" 3 "Reserved"  ;
VAL_ 459 AS_SysOperationSt 0 "Invalid" 1 "Lifting" 2 "Lowering" 3 "Holding (current level" 4 "Prohibit adjusting (sub-function or external request prohibit adjusting or low pressure)" 5 "Shut down (overheating without enough pressure and system fault)" 6 "Easy-loading adjusting" 7 "Showrom adjusting" 8 "Reserved" 9 "Reserved" 10 "Reserved" 11 "Reserved" 12 "Reserved" 13 "Reserved" 14 "Reserved" 15 "Reserved"  ;
VAL_ 459 AS_OverLoadSt 0 "No overload" 1 "Overload"  ;
VAL_ 459 AS_OverTorsionSt 0 "No over torsion" 1 "Over torsion"  ;
VAL_ 459 AS_ManufacModeSt 0 "Disabled" 1 "Inactive" 2 "Active" 3 "Reserved"  ;
VAL_ 459 AS_ASIndividualMode 0 "Invalid" 1 "Very high base level (not used)" 2 "High level" 3 "Normal level" 4 "Low level" 5 "Very low  base level (not used)" 6 "Reserved" 7 "Reserved"  ;
VAL_ 459 AS_ADCStfnCtrlAvl 0 "Not available" 1 "Available"  ;
VAL_ 459 AS_ADCStfnState 0 "Initializing" 1 "Soft" 2 "Hard"  ;
