VERSION "Version"

NS_ :

BS_:

BU_: CCU ADC FAPA IFC FLR FRR RRR RLR INU Tester CBM VIU SRS IDC PCS AMP IMR FIMR TBOX IBCS IXCU V2XOBU WHUD RLBMS CCURT2 RT2_C3 OTAWL ZCUF ZCUL ZCUR ZCUT IPS DCU NIDU RBM WACUFL IID CCURT1 RT1_C0 RT1_C1 AVAS FLLCM FRLCM RLLCMA RRLCMA RLLCMB RRLCMB LBMS LBMSAD MFS FCP IDU ITS BCB DCDC PCU EOP DCU2 BMS TMC EPS ECS CD PAS SBM WCM ETC TBOX2 DSM FLPDM FRPDM RLPDM RRPDM HVSMR SCMRL SCMRR EBU EPB VDC EVCC ADM PLGM FBLCM RLISD RRISD RCP RFR WCMFR SCMR TFOAR TROAR HVSPRL HVSPRR

BO_ 430 CCU_SRS_1: 64 CCU
 SG_ SRS_1_CRC_1 : 7|16@0+ (1,0) [0|65535] ""  ZCUF,ZCUT,LBMS,IDU,ADC,FAPA,VIU,IFC,TBOX,TBOX2
 SG_ SRS_1_Counter_1 : 23|8@0+ (1,0) [0|255] ""  ZCUF,ZCUT,LBMS,IDU,ADC,FAPA,VIU,IFC,TBOX,TBOX2
 SG_ SRS_CrashOutputSt : 31|8@0+ (1,0) [0|160] ""  ZCUF,ZCUL,ZCUR,ZCUT,LBMS,IDU,ADC,FAPA,VIU,IFC,TBOX,TBOX2
 SG_ SRS_Front_CrashOutputSt : 39|1@0+ (1,0) [0|1] ""  ZCUF,ZCUL,ZCUR,ZCUT,IDC,ADC,FAPA,VIU,IFC,TBOX,TBOX2
 SG_ SRS_DriverSide_CrashOutputSt : 38|1@0+ (1,0) [0|1] ""  ZCUF,ZCUL,ZCUR,ZCUT,IDC,ADC,FAPA,VIU,IFC,TBOX,TBOX2
 SG_ SRS_PassengerSide_CrashOutputSt : 37|1@0+ (1,0) [0|1] ""  ZCUF,ZCUL,ZCUR,ZCUT,IDC,ADC,FAPA,VIU,IFC,TBOX,TBOX2
 SG_ SRS_Rear_CrashOutputSt : 36|1@0+ (1,0) [0|1] ""  ZCUF,ZCUL,ZCUR,ZCUT,IDU,IDC,ADC,FAPA,VIU,IFC,TBOX,TBOX2
 SG_ SRS_RolloverCrashOutputSt : 35|1@0+ (1,0) [0|1] ""  ZCUF,ZCUL,ZCUR,ZCUT,IDC,ADC,FAPA,VIU,IFC,TBOX,TBOX2
 SG_ SRS_NearCrashOutputSt : 34|1@0+ (1,0) [0|1] ""  ZCUF,ZCUL,ZCUR,ZCUT,IDC,ADC,FAPA,VIU,IFC,TBOX,TBOX2
 SG_ SRS_1_CRC_2 : 111|16@0+ (1,0) [0|65535] ""  ZCUF,ZCUT,EPS,EPB,ADC,FAPA,FLR,FRR,RLR,RRR,VIU,IFC
 SG_ SRS_1_Counter_2 : 127|8@0+ (1,0) [0|255] ""  ZCUF,ZCUT,EPS,EPB,ADC,FAPA,FLR,FRR,RLR,RRR,VIU,IFC
 SG_ SRS_YawSnsCalibSt : 135|1@0+ (1,0) [0|1] ""  ZCUL,ZCUR,ZCUT,ADC,FAPA,FLR,FRR,RLR,RRR,VIU,IFC
 SG_ SRS_VehLongAccelVD : 134|2@0+ (1,0) [0|3] ""  ZCUF,ZCUL,ZCUR,ZCUT,DCU,NIDU,EPS,EPB,IXCU,IDC,ADC,FAPA,FLR,FRR,RLR,RRR,VIU,IFC,PCS,TBOX,V2XOBU
 SG_ SRS_VehLatrlAccelVD : 132|2@0+ (1,0) [0|3] ""  ZCUL,ZCUR,ZCUT,DCU,NIDU,EPS,IXCU,IDC,ADC,FAPA,FLR,FRR,RLR,RRR,VIU,IFC,PCS,TBOX,V2XOBU
 SG_ SRS_YawRateVD : 130|2@0+ (1,0) [0|3] ""  ZCUL,ZCUR,ZCUT,DCU,NIDU,EPS,IXCU,ADC,FAPA,FLR,FRR,RLR,RRR,VIU,IFC,PCS,TBOX,V2XOBU
 SG_ SRS_VehLongAccel : 143|12@0+ (0.001,-2) [-2|2] "g"  ZCUF,ZCUL,ZCUR,ZCUT,DCU,NIDU,EPS,EPB,IXCU,IDC,ADC,FAPA,FLR,FRR,RLR,RRR,VIU,IFC,PCS,TBOX,V2XOBU
 SG_ SRS_VehLatrlAccel : 147|12@0+ (0.001,-2) [-2|2] "g"  ZCUL,ZCUR,ZCUT,DCU,NIDU,EPS,IXCU,IDC,ADC,FAPA,FLR,FRR,RLR,RRR,VIU,IFC,PCS,TBOX,V2XOBU
 SG_ SRS_YawRate : 167|16@0+ (0.01,-180) [-180|180] "deg/s"  ZCUL,ZCUR,ZCUT,DCU,NIDU,EPS,IXCU,IDC,ADC,FAPA,FLR,FRR,RLR,RRR,VIU,IFC,PCS,TBOX,V2XOBU

BO_ 939 CCU_SRS_2: 32 CCU
 SG_ SRS_PsngrSeatBeltSt : 31|2@0+ (1,0) [0|3] ""  IDC,ADC,FAPA,FLR,FRR,VIU,TBOX,TBOX2
 SG_ SRS_DriverSeatBeltSt : 29|2@0+ (1,0) [0|3] ""  ZCUF,ZCUT,EPB,IXCU,IDC,ADC,FAPA,FLR,FRR,VIU,TBOX,TBOX2
 SG_ SRS_RearLeftSeatBeltSt : 27|2@0+ (1,0) [0|3] ""  IDC,ADC,FAPA,VIU,TBOX,TBOX2
 SG_ SRS_AirbagFaultSt : 25|1@0+ (1,0) [0|1] ""  IDC,ADC,FAPA,VIU,IFC,TBOX,V2XOBU
 SG_ SRS_RearRightSeatBeltSt : 39|2@0+ (1,0) [0|3] ""  IDC,ADC,FAPA,VIU,TBOX,TBOX2
 SG_ SRS_RearMiddleSeatBeltSt : 37|2@0+ (1,0) [0|3] ""  IDC,ADC,FAPA,VIU,TBOX,TBOX2

BO_ 363 CCU_EPS_1_C: 64 CCU
 SG_ EPS_1_CRC : 7|16@0+ (1,0) [0|65535] ""  RBM,IBCS,ECS,ADC,FAPA,FLR,FRR,RLR,RRR,VIU,IFC
 SG_ EPS_1_Counter : 23|8@0+ (1,0) [0|255] ""  RBM,IBCS,ECS,ADC,FAPA,FLR,FRR,RLR,RRR,VIU,IFC
 SG_ EPS_StrngWhlTorqVD : 31|1@0+ (1,0) [0|1] ""  ADC,FAPA,FLR,FRR,RLR,RRR,VIU,IFC
 SG_ EPS_StrngWhlTorq : 30|12@0+ (0.01,-15) [-15|15] "Nm"  ADC,FAPA,FLR,FRR,RLR,RRR,VIU,IFC
 SG_ TAS_CalibratedSt : 34|1@0+ (1,0) [0|1] ""  SRS,RBM,IBCS,ADC,FAPA,FLR,FRR,RLR,RRR,VIU,IFC
 SG_ EPS_SteeringAngleSpdVD : 32|1@0+ (1,0) [0|1] ""  SRS,RBM,IBCS,ADC,FAPA,FLR,FRR,RLR,RRR,VIU,IFC
 SG_ EPS_SteeringAngleSpd : 47|8@0+ (4,0) [0|1016] "deg/sec"  SRS,RBM,IBCS,ADC,FAPA,FLR,FRR,RLR,RRR,VIU,IFC,PCS
 SG_ EPS_SteeringAngle : 55|16@0+ (0.1,-780) [-780|780] "deg"  SRS,RBM,IBCS,ADC,FAPA,FLR,FRR,RLR,RRR,VIU,IFC,PCS
 SG_ EPS_SteeringAngleVD : 71|1@0+ (1,0) [0|1] ""  SRS,RBM,IBCS,ADC,FAPA,FLR,FRR,RLR,RRR,VIU,IFC
 SG_ EPS_ThermalSt : 69|2@0+ (1,0) [0|3] ""  ADC,FAPA,FLR,FRR,RLR,RRR,VIU,IFC
 SG_ EPS_VMCErrFeedback : 84|4@0+ (1,0) [0|15] ""  ADC,FAPA,IFC
 SG_ EPS_PstOverlaySt_SideA : 95|2@0+ (1,0) [0|3] ""  ADC,FAPA,FLR,FRR,RLR,RRR,VIU,IFC
 SG_ EPS_PstOverlaySt_SideB : 93|2@0+ (1,0) [0|3] ""  ADC,FAPA,FLR,FRR,RLR,RRR,VIU,IFC
 SG_ EPS_HealthySt_SideA : 91|2@0+ (1,0) [0|3] ""  ADC,FAPA,FLR,FRR,RLR,RRR,VIU,IFC
 SG_ EPS_HealthySt_SideB : 89|2@0+ (1,0) [0|3] ""  ADC,FAPA,FLR,FRR,RLR,RRR,VIU,IFC
 SG_ EPS_PstOverlaySt : 103|3@0+ (1,0) [0|7] ""  ADC,FAPA,FLR,FRR,RLR,RRR,VIU,IFC
 SG_ EPS_HealthySt_DualSide : 100|2@0+ (1,0) [0|3] ""  ADC,FAPA,FLR,FRR,RLR,RRR,VIU,IFC
 SG_ EPS_PstOverLayRdntSt : 98|1@0+ (1,0) [0|1] ""  ADC,FAPA,FLR,FRR,RLR,RRR,VIU,IFC
 SG_ EPS_VibrationWarnSt_A : 97|2@0+ (1,0) [0|3] ""  ADC,FAPA,FLR,FRR,RLR,RRR,VIU,IFC
 SG_ SAC_ErrFeedback_SideA : 111|4@0+ (1,0) [0|15] ""  ADC,FAPA,FLR,FRR,RLR,RRR,VIU,IFC
 SG_ SAC_ErrFeedback_SideB : 107|4@0+ (1,0) [0|15] ""  ADC,FAPA,FLR,FRR,RLR,RRR,VIU,IFC
 SG_ EPS_ADASTargetAngle : 119|16@0+ (0.1,-780) [-780|780] "deg"  ADC,FAPA,FLR,FRR,RLR,RRR,VIU,IFC
 SG_ EPS_FunctionStyleSt : 135|2@0+ (1,0) [0|3] ""  IDC,ADC,FAPA,FLR,FRR,RLR,RRR,VIU,IFC
 SG_ EPS_SteeringModeSt : 133|2@0+ (1,0) [0|3] ""  IDC,ADC,FAPA,FLR,FRR,RLR,RRR,VIU,IFC
 SG_ EPS_ActEffectiveChannel : 143|3@0+ (1,0) [0|7] ""  ADC,FAPA,FLR,FRR,RLR,RRR,VIU,IFC
 SG_ EPS_ReqAngOverRange : 140|1@0+ (1,0) [0|1] ""  ADC,FAPA,FLR,FRR,RLR,RRR,VIU,IFC
 SG_ EPS_SACMotorTorAct : 139|12@0+ (0.01,-6) [-6|6] "Nm"  ADC,FAPA,FLR,FRR,RLR,RRR,VIU,IFC
 SG_ EPS_SACMotorTorLimInt : 159|11@0+ (0.01,0) [0|6] "Nm"  ADC,FAPA,FLR,FRR,RLR,RRR,VIU,IFC
 SG_ EPS_ReqAngSpdOverRange : 164|1@0+ (1,0) [0|1] ""  ADC,FAPA,FLR,FRR,RLR,RRR,VIU,IFC
 SG_ EPS_AssistPraSwitchToLKA : 163|1@0+ (1,0) [0|1] ""  ADC,FAPA,FLR,FRR,RLR,RRR,VIU,IFC
 SG_ EPS_SteerGainEnable : 162|1@0+ (1,0) [0|1] ""  ADC,FAPA,FLR,FRR,RLR,RRR,VIU,IFC
 SG_ EPS_EmSteerEnbale : 161|1@0+ (1,0) [0|1] ""  ADC,FAPA,FLR,FRR,RLR,RRR,VIU,IFC
 SG_ EPS_SG_ErrFeedback : 175|4@0+ (1,0) [0|15] ""  ADC,FAPA,FLR,FRR,RLR,RRR,VIU,IFC
 SG_ EPS_EM_ErrFeedback : 171|4@0+ (1,0) [0|15] ""  ADC,FAPA,FLR,FRR,RLR,RRR,VIU,IFC
 SG_ EPS_VW_ErrFeedback : 183|4@0+ (1,0) [0|15] ""  ADC,FAPA,FLR,FRR,RLR,RRR,VIU,IFC
 SG_ EPS_AngReqForIFCSt : 179|3@0+ (1,0) [0|7] ""  ADC,FAPA,FLR,FRR,RLR,RRR,VIU,IFC
 SG_ EPS_SACMotorTorActMot : 191|12@0+ (0.01,-6) [-6|6] "Nm"  ADC,FAPA,FLR,FRR,RLR,RRR,VIU,IFC
 SG_ EPS_SACMotorTorLimIntMot : 194|11@0+ (0.01,0) [0|6] "Nm"  ADC,FAPA,FLR,FRR,RLR,RRR,VIU,IFC
 SG_ EPS_SG_ActualLevel : 215|8@0+ (1,0) [0|254] "%"  ADC,FAPA,FLR,FRR,RLR,RRR,VIU,IFC
 SG_ EPS_MotorTorSum : 219|12@0+ (0.01,-6) [-6|6] "Nm"  ADC,FAPA,FLR,FRR,RLR,RRR,VIU
 SG_ EPS_WarnLamp : 242|2@0+ (1,0) [0|3] ""  IDC,ADC,FAPA,FLR,FRR,RLR,RRR,VIU,IFC
 SG_ EPS_AssistPercentage : 255|8@0+ (1,0) [0|255] "%"  ADC,FAPA,FLR,FRR,RLR,RRR,VIU,IFC
 SG_ EPS_AssistRatio : 263|8@0+ (1,0) [0|255] ""  ADC,FAPA,FLR,FRR,RLR,RRR,VIU,IFC
 SG_ EPS_SteeringWhlTorFlt : 271|12@0+ (0.01,-15) [-15|15] "Nm"  ADC,FAPA,FLR,FRR,RLR,RRR,VIU,IFC
 SG_ EPS_SteeringWhlTorFltVD : 275|2@0+ (1,0) [0|3] ""  ADC,FAPA,FLR,FRR,RLR,RRR,VIU,IFC
 SG_ EPS_SteeringAngleRate : 273|14@0+ (0.2,-1600) [-1600|1600] "deg/s"  ADC,FAPA,IFC
 SG_ EPS_TqCtrlSt : 291|2@0+ (1,0) [0|3] ""  ADC,FAPA,IFC
 SG_ EPS_MotorTorForDrv : 239|12@0+ (0.01,-20) [-20|20] "Nm"  IXCU,ADC,FAPA,IFC
 SG_ EPS_TqCtrlAvl : 221|2@0+ (1,0) [0|3] ""  ADC,FAPA,IFC
 SG_ EPS_AgCtrlAvl : 223|2@0+ (1,0) [0|3] ""  ADC,FAPA,IFC
 SG_ EPS_MotorTorSumVD : 243|1@0+ (1,0) [0|1] ""  ADC,FAPA,IFC
 SG_ EPS_DrvOveRideSt : 160|1@0+ (1,0) [0|1] ""  ADC,FAPA,IFC
 SG_ EPS_DrvOveRideVD : 176|1@0+ (1,0) [0|1] ""  ADC,FAPA,IFC
 SG_ EPS_SteerVibrlAvl : 195|1@0+ (1,0) [0|1] ""  ADC,FAPA,IFC
 SG_ EPS_HandsOffDetStVD : 240|1@0+ (1,0) [0|1] ""  ADC,FAPA,IFC
 SG_ EPS_HandsOffDetSt : 289|2@0+ (1,0) [0|3] ""  ADC,FAPA,IFC
 SG_ EPS_SteerMod : 303|3@0+ (1,0) [0|7] ""  ADC,FAPA,IFC
 SG_ EPS_EpsSelfChkSts : 344|1@0+ (1,0) [0|1] ""  ADC
 SG_ EPS_ThermProtnMax : 367|8@0+ (1,0) [0|200] ""  ADC

BO_ 704 CCU_IPS_1: 64 CCU
 SG_ IPS_1_CRC : 7|16@0+ (1,0) [0|65535] ""  ADC,FAPA,VIU
 SG_ IPS_1_Counter : 23|8@0+ (1,0) [0|255] ""  ADC,FAPA,VIU
 SG_ IPS_DCDCModeSt : 39|3@0+ (1,0) [0|7] ""  OTAWL,EBU,RLBMS,ADC,FAPA,VIU

BO_ 880 CCU_ITS_1: 64 CCU
 SG_ ITS_MotorPumpSt : 31|2@0+ (1,0) [0|3] ""  CCURT1,RT1_C1,DCU,NIDU,IXCU,IDC,ADC,FAPA
 SG_ ITS_MotorInletTempErr : 102|1@0+ (1,0) [0|1] ""  CCURT1,RT1_C1,DCU,NIDU,IXCU,IDC,ADC,FAPA,IFC
 SG_ ITS_MotorInletTemp : 111|16@0+ (0.1,-50) [-50|150] "degC"  CCURT1,RT1_C1,DCU,NIDU,IXCU,ADC,FAPA
 SG_ ITS_FanSt : 215|3@0+ (1,0) [0|7] ""  CCURT1,RT1_C1,ADC
 SG_ ITS_LIN_CommunicateErrCode : 209|2@0+ (1,0) [0|3] ""  ADC
 SG_ ITS_MotorPumpErrCode : 223|16@0+ (1,0) [0|65535] ""  DCU,NIDU,IXCU,ADC,FAPA,IFC
 SG_ ITS_TMS_CommDataAvail : 445|1@0+ (1,0) [0|1] ""  CCURT1,RT1_C1,ADC

BO_ 824 VCU_2: 64 CCU
 SG_ VCU_2_CRC : 7|16@0+ (1,0) [0|65535] ""  CCURT2,RT2_C3,ZCUF,ZCUT,DCU,DCU2,NIDU,BMS,IXCU,IDC,ADC,FAPA,FLR,FRR,RLR,RRR,VIU,IFC
 SG_ VCU_2_Counter : 23|8@0+ (1,0) [0|255] ""  CCURT2,RT2_C3,ZCUF,ZCUT,DCU,DCU2,NIDU,BMS,IXCU,IDC,ADC,FAPA,FLR,FRR,RLR,RRR,VIU,IFC
 SG_ VCU_GearLvlDisp : 53|4@0+ (1,0) [0|15] ""  CCURT2,RT2_C3,ZCUF,ZCUR,ZCUT,IDC,ADC,FAPA,VIU,PCS,SBM
 SG_ VCU_VehDrvMod : 223|3@0+ (1,0) [0|7] ""  CCURT2,RT2_C3,ZCUF,ZCUL,ZCUR,ZCUT,DCU,NIDU,BMS,SRS,RBM,IBCS,IXCU,IDC,AMP,ADC,FAPA,VIU,IFC,WCM
 SG_ VCU_VehRdySt : 217|1@0+ (1,0) [0|1] ""  CCURT2,RT2_C3,OTAWL,ZCUF,ZCUR,ZCUT,EPB,IDC,IID,ADC,FAPA,FLR,FRR,RLR,RRR,VIU,IFC,SBM,TBOX
 SG_ VCU_GearLvl : 247|4@0+ (1,0) [0|15] ""  CCURT1,CCURT2,RT1_C0,RT1_C1,RT2_C3,ZCUF,ZCUT,EPB,ADC,FAPA,FLR,FRR,RLR,RRR,VIU,IFC
 SG_ VCU_PlgConnSt : 256|1@0+ (1,0) [0|1] ""  CCURT2,RT2_C3,ZCUT,DCU,DCU2,NIDU,ECS,IXCU,IDC,ADC,FAPA,VIU
 SG_ VCU_SwapHvBattRdySt : 351|8@0+ (1,0) [0|255] ""  ZCUR,ADC,FAPA,VIU,SBM
 SG_ VCU_SwapHvBattCompSt : 359|3@0+ (1,0) [0|7] ""  ZCUR,ADC,FAPA,VIU,SBM
 SG_ VCU_SwapHvBattModeSt : 356|2@0+ (1,0) [0|3] ""  ZCUF,ZCUR,ZCUT,ITS,IPS,DCDC,EOP,DCU,NIDU,BMS,IXCU,IDC,AMP,ADC,FAPA,VIU,SBM,TBOX
 SG_ VCU_SwapHvBattModeStVD : 353|1@0+ (1,0) [0|1] ""  ZCUF,ZCUR,ZCUT,ITS,IPS,DCDC,EOP,DCU,NIDU,BMS,IXCU,IDC,AMP,ADC,FAPA,VIU,SBM,TBOX
 SG_ VCU_RoadMod : 352|3@0+ (1,0) [0|7] ""  EPS,IBCS,ECS,IDC,ADC

BO_ 952 VCU_3: 64 CCU
 SG_ VCU_3_CRC : 7|16@0+ (1,0) [0|65535] ""  ITS,DCU,DCU2,NIDU,BMS,IXCU,IDC,ADC,FAPA
 SG_ VCU_3_Counter : 23|8@0+ (1,0) [0|255] ""  ITS,DCU,DCU2,NIDU,BMS,IXCU,IDC,ADC,FAPA
 SG_ VCU_ErrNotice : 251|3@0+ (1,0) [0|7] ""  IDC,ADC
 SG_ VCU_ErrNoticeOperationFlag : 248|1@0+ (1,0) [0|1] ""  IDC,ADC
 SG_ VCU_Err2NoticeFlag : 263|1@0+ (1,0) [0|1] ""  IDC,ADC
 SG_ VCU_EcoPlusMod : 351|2@0+ (1,0) [0|3] ""  CCURT2,RT2_C3,DCU,NIDU,IXCU,IDC,WHUD,ADC,FAPA

BO_ 653 VCU_5: 64 CCU
 SG_ VCU_5_CRC : 7|16@0+ (1,0) [0|65535] ""  CCURT2,RT2_C3,ZCUF,ZCUT,RBM,IBCS,ECS,EBU,EPB,IXCU,WACUFL,ADC,FAPA,FLR,FRR,RLR,RRR,VIU,IFC,PAS,INU
 SG_ VCU_5_Counter : 23|8@0+ (1,0) [0|255] ""  CCURT2,RT2_C3,ZCUF,ZCUT,RBM,IBCS,ECS,EBU,EPB,IXCU,WACUFL,ADC,FAPA,FLR,FRR,RLR,RRR,VIU,IFC,PAS,INU
 SG_ VCU_AccButtInfo : 31|8@0+ (1,0) [0|255] ""  IDC,ADC,FAPA,VIU,IFC
 SG_ VCU_LateralAssistBtnInfo : 39|1@0+ (1,0) [0|1] ""  ADC,FAPA,VIU,IFC
 SG_ VCU_LateralAssistBtnInfoVD : 38|1@0+ (1,0) [0|1] ""  ADC,FAPA,VIU,IFC
 SG_ VCU_EMS_AccPedalActPst : 40|8@0+ (0.392,0) [0|99.96] "%"  CCURT2,RT2_C3,SRS,RBM,IBCS,ECS,EBU,IXCU,WACUFL,IDC,AMP,ADC,FAPA,VIU,IFC,TBOX
 SG_ VCU_EMS_BrkPedalSt : 63|1@0+ (1,0) [0|1] ""  CCURT2,RT2_C3,ZCUR,SRS,RBM,IBCS,ECS,IXCU,WACUFL,IDC,ADC,FAPA,VIU,IFC,SBM,TBOX
 SG_ VCU_EMS_BrkPedalStVD : 62|1@0+ (1,0) [0|1] ""  CCURT2,RT2_C3,ZCUR,SRS,RBM,IBCS,ECS,IXCU,WACUFL,ADC,FAPA,VIU,IFC,SBM
 SG_ VCU_EMS_AccPedalActPstVD : 61|1@0+ (1,0) [0|1] ""  CCURT2,RT2_C3,SRS,RBM,IBCS,ECS,EBU,IXCU,WACUFL,AMP,ADC,FAPA,VIU,IFC
 SG_ VCU_DCU_ActRotSpd : 60|16@0+ (1,-32767) [-32767|32766] "rpm"  CCURT1,CCURT2,RT1_C1,RT2_C3,ZCUF,ZCUT,VDC,TMC,SRS,RBM,IBCS,EBU,IXCU,WACUFL,AMP,ADC,FAPA,VIU
 SG_ VCU_BrkPedPstVD : 128|1@0+ (1,0) [0|1] ""  CCURT2,RT2_C3,SRS,RBM,IBCS,ECS,IXCU,WACUFL,IDC,ADC,FAPA,VIU,IFC
 SG_ VCU_CrntGearLvl : 143|3@0+ (1,0) [0|7] ""  CCURT2,RT2_C3,ZCUF,ZCUL,ZCUR,ZCUT,SRS,EPS,RBM,IBCS,ECS,EBU,EPB,IXCU,WACUFL,IDC,AMP,ADC,FAPA,FLR,FRR,RLR,RRR,VIU,IFC,PAS,INU,TBOX,V2XOBU
 SG_ VCU_BrkPedPst : 156|8@0+ (0.392,0) [0|99.96] "%"  CCURT2,RT2_C3,SRS,RBM,IBCS,ECS,IXCU,WACUFL,IDC,ADC,FAPA,VIU,IFC
 SG_ VCU_APAGasPedalIntv : 163|1@0+ (1,0) [0|1] ""  ADC,FAPA,VIU,IFC
 SG_ VCU_APAAvailable : 162|1@0+ (1,0) [0|1] ""  RBM,IBCS,IXCU,WACUFL,ADC,FAPA,VIU
 SG_ VCU_ACCMaxRecpDecel : 179|8@0+ (0.05,-5) [-5|7.75] "m/s2"  ADC,FAPA,VIU,IFC
 SG_ VCU_ACCLimitOperatingSt : 186|1@0+ (1,0) [0|1] ""  ADC,FAPA,VIU,IFC
 SG_ VCU_ACCMaxRecpDecelVD : 185|1@0+ (1,0) [0|1] ""  ADC,FAPA,VIU,IFC
 SG_ VCU_APA_Resp : 184|1@0+ (1,0) [0|1] ""  RBM,IBCS,IXCU,WACUFL,ADC,FAPA,VIU
 SG_ VCU_APAGearIntervern : 199|1@0+ (1,0) [0|1] ""  ADC,FAPA,VIU,IFC
 SG_ VCU_ActVehWheelTorq : 195|14@0+ (1,0) [0|10000] "Nm"  EPS,IBCS,ECS,IXCU,WACUFL,AMP,ADC,FAPA,VIU,IFC
 SG_ VCU_ACCmaxSpdLimit : 213|4@0+ (1,0) [0|15] ""  ADC,FAPA,VIU,IFC
 SG_ VCU_VehWheelTorqMax : 223|14@0+ (1,0) [0|10000] "Nm"  IBCS,ECS,IXCU,WACUFL,ADC,FAPA,VIU,IFC
 SG_ VCU_RecpTorqVD : 241|1@0+ (1,0) [0|1] ""  RBM,IBCS,IXCU,WACUFL,ADC,FAPA,VIU,IFC
 SG_ VCU_RecpTorq : 260|11@0+ (2,0) [0|4000] "Nm"  RBM,IBCS,IXCU,WACUFL,ADC,FAPA,VIU,IFC
 SG_ VCU_CrntGearLvlVD : 277|1@0+ (1,0) [0|1] ""  CCURT2,RT2_C3,AMP,ADC,FAPA,FLR,FRR,RLR,RRR,VIU,IFC,PAS,INU
 SG_ EMS_GasPedalActPstforMRRVD_D : 296|1@0+ (1,0) [0|1] ""  IDC,ADC

BO_ 644 VCU_7: 64 CCU
 SG_ VCU_7_CRC : 7|16@0+ (1,0) [0|65535] ""  CCURT2,RT2_C3,ZCUF,ZCUT,EPS,RBM,IBCS,EBU,EPB,IXCU,ADC,FAPA,VIU,IFC
 SG_ VCU_7_Counter : 23|8@0+ (1,0) [0|255] ""  CCURT2,RT2_C3,ZCUF,ZCUT,EPS,RBM,IBCS,EBU,EPB,IXCU,ADC,FAPA,VIU,IFC
 SG_ EMS_GasPedalActPstforMRRVD : 31|1@0+ (1,0) [0|1] ""  ZCUF,ZCUT,SRS,RBM,IBCS,EBU,EPB,IXCU,ADC,FAPA,FLR,VIU,IFC
 SG_ VCU_AccTMCFail : 29|1@0+ (1,0) [0|1] ""  RBM,IBCS,IXCU,ADC,FAPA,VIU,IFC
 SG_ VCU_AccElecECFail : 28|1@0+ (1,0) [0|1] ""  RBM,IBCS,IXCU,ADC,FAPA,VIU,IFC
 SG_ VCU_AccDriverOrvd : 27|1@0+ (1,0) [0|1] ""  ADC,FAPA,VIU,IFC
 SG_ EMS_GasPedalActPstforMRR : 26|8@0+ (0.392,0) [0|99.96] "%"  ZCUF,ZCUT,SRS,RBM,IBCS,EBU,EPB,IXCU,IDC,ADC,FAPA,FLR,VIU,IFC
 SG_ VCU_AccSpareCanError : 34|1@0+ (1,0) [0|1] ""  ADC,FAPA,VIU,IFC
 SG_ VCU_IFCFailureSt : 33|1@0+ (1,0) [0|1] ""  ADC,FAPA,VIU,IFC
 SG_ VCU_AccDriverOrvdVD : 47|1@0+ (1,0) [0|1] ""  RBM,IBCS,ADC,FAPA,IFC
 SG_ VCU_TorqDriverReq : 71|8@0+ (0.392,0) [0|99.96] "%"  RBM,IBCS,ECS,IXCU,ADC,FAPA,IFC

BO_ 393 VCU_9: 64 CCU
 SG_ VCU_9_CRC : 7|16@0+ (1,0) [0|65535] ""  IBCS,IXCU,ADC
 SG_ VCU_9_Counter : 23|8@0+ (1,0) [0|255] ""  IBCS,IXCU,ADC
 SG_ VCU_ErrorFb : 331|4@0+ (1,0) [0|15] ""  ADC
 SG_ VCU_VehWhlReqTqVld : 64|1@0+ (1,0) [0|1] ""  IBCS,IXCU,ADC
 SG_ VCU_MotorRegenTrqLmtlnDVaild : 65|1@0+ (1,0) [0|1] ""  ADC
 SG_ VCU_GearShiftAvl : 80|1@0+ (1,0) [0|1] ""  ADC
 SG_ VCU_PtTqAvl : 97|2@0+ (1,0) [0|3] ""  IBCS,IXCU,ADC
 SG_ VCU_PtTqActvSts : 81|1@0+ (1,0) [0|1] ""  IBCS,IXCU,ADC
 SG_ VCU_MotorRegenTorqueLmtlnD : 319|13@0+ (1,-8191) [-8191|0] "Nm"  ADC
 SG_ VCU_DriverTorqueDesired : 31|16@0+ (1,-32768) [-32768|32767] "Nm"  IBCS,IXCU,ADC
 SG_ VCU_VehWhlReqTq : 47|16@0+ (1,-32768) [-32768|32767] "Nm"  IBCS,IXCU,ADC
 SG_ VCU_TargetRecpTorqSt : 113|2@0+ (1,0) [0|3] ""  IBCS,IXCU,ADC
 SG_ VCU_TargetRecpTorqNm : 63|14@0+ (2,0) [0|16000] "Nm"  IBCS,IXCU,ADC
 SG_ VCU_TargetRecpTorqFA_Hyb : 79|14@0+ (1,0) [0|16000] "Nm"  IBCS,IXCU,ADC
 SG_ VCU_TargetRecpTorqRA_Hyb : 95|14@0+ (1,0) [0|16000] "Nm"  IBCS,IXCU,ADC
 SG_ VCU_TorqDriverReqFA_Hyb : 111|14@0+ (1,0) [0|16000] "Nm"  IBCS,IXCU,ADC
 SG_ VCU_TorqDriverReqRA_Hyb : 127|14@0+ (1,0) [0|16000] "Nm"  IBCS,IXCU,ADC
 SG_ VCU_VehActDrvTorqFA_Hyb : 143|14@0+ (1,0) [0|16000] "Nm"  IBCS,IXCU,ADC
 SG_ VCU_VehActDrvTorqRA_Hyb : 159|14@0+ (1,0) [0|16000] "Nm"  IBCS,IXCU,ADC
 SG_ VCU_TargetRecpTorqFAVD_Hyb : 128|1@0+ (1,0) [0|1] ""  IBCS,IXCU,ADC
 SG_ VCU_TargetRecpTorqRAVD_Hyb : 129|1@0+ (1,0) [0|1] ""  IBCS,IXCU,ADC
 SG_ VCU_TorqDriverReqFAVD : 144|1@0+ (1,0) [0|1] ""  IBCS,IXCU,ADC
 SG_ VCU_TorqDriverReqRAVD : 145|1@0+ (1,0) [0|1] ""  IBCS,IXCU,ADC
 SG_ VCU_VehActDrvTorqFAVD_Hyb : 160|1@0+ (1,0) [0|1] ""  IBCS,IXCU,ADC
 SG_ VCU_VehActDrvTorqRAVD_Hyb : 161|1@0+ (1,0) [0|1] ""  IBCS,IXCU,ADC
 SG_ VCU_BcsDecelReq : 335|4@0+ (0.066,-0.99) [-0.99|0] "m/s2"  IBCS,IXCU,ADC
 SG_ VCU_BcsDecelVD : 176|1@0+ (1,0) [0|1] ""  IBCS,IXCU,ADC
 SG_ VCU_BcsDecelEnable : 177|1@0+ (1,0) [0|1] ""  IBCS,IXCU,ADC
 SG_ VCU_CrntGearNoTrans : 322|3@0+ (1,0) [0|7] ""  ADC
 SG_ VCU_RecpTorqSt : 193|2@0+ (1,0) [0|3] ""  IBCS,IXCU,ADC
 SG_ VCU_RecpTorqNm : 175|14@0+ (1,0) [0|16000] "Nm"  IBCS,IXCU,ADC
 SG_ VCU_RecpTorqFAVD_Hyb : 208|1@0+ (1,0) [0|1] ""  IBCS,IXCU,ADC
 SG_ VCU_RecpTorqRAVD_Hyb : 209|1@0+ (1,0) [0|1] ""  IBCS,IXCU,ADC
 SG_ VCU_MaxRecpTorqFAVD_Hyb : 224|1@0+ (1,0) [0|1] ""  IBCS,IXCU,ADC
 SG_ VCU_MaxRecpTorqRAVD_Hyb : 225|1@0+ (1,0) [0|1] ""  IBCS,IXCU,ADC
 SG_ VCU_RecpTorqFA_Hyb : 191|14@0+ (1,0) [0|16000] "Nm"  IBCS,IXCU,ADC
 SG_ VCU_RecpTorqRA_Hyb : 207|14@0+ (1,0) [0|16000] "Nm"  IBCS,IXCU,ADC
 SG_ VCU_MaxRecpTorqFA_Hyb : 223|14@0+ (1,0) [0|16000] "Nm"  IBCS,IXCU,ADC
 SG_ VCU_MaxRecpTorqRA_Hyb : 239|14@0+ (1,0) [0|16000] "Nm"  IBCS,IXCU,ADC
 SG_ VCU_VehWheelTorqMinNm : 255|15@0+ (1,-16000) [-16000|16000] "Nm"  IBCS,IXCU,ADC
 SG_ VCU_VehWheelTorqMaxNmVD : 272|1@0+ (1,0) [0|1] ""  IBCS,IXCU,ADC
 SG_ VCU_VehWheelTorqMaxNm : 271|15@0+ (1,-16000) [-16000|16000] "Nm"  IBCS,IXCU,ADC
 SG_ VCU_ActVehWheelTorqNm : 287|15@0+ (1,-16000) [-16000|16000] "Nm"  CCURT1,RT1_C1,VDC,IBCS,IXCU,ADC
 SG_ VCU_APAWheelTorqDriverReqNm : 303|15@0+ (1,-16000) [-16000|16000] "Nm"  IBCS,IXCU,ADC

BO_ 512 CCU_ZCUR_SBM_2: 64 CCU
 SG_ KAE_BLE1Position : 31|3@0+ (1,0) [0|7] ""  IDC,ADC,FAPA,IFC
 SG_ KAE_BLE2Position : 28|3@0+ (1,0) [0|7] ""  IDC,ADC,FAPA,IFC
 SG_ KAE_BLE3Position : 39|3@0+ (1,0) [0|7] ""  IDC,ADC,FAPA,IFC
 SG_ KAE_BLE4Position : 36|3@0+ (1,0) [0|7] ""  IDC,ADC,FAPA,IFC
 SG_ KAE_BLE5Position : 47|3@0+ (1,0) [0|7] ""  IDC,ADC,FAPA,IFC
 SG_ KAE_BLE1AuthSt : 137|2@0+ (1,0) [0|3] ""  IDC,ADC,FAPA
 SG_ KAE_BLE2AuthSt : 151|2@0+ (1,0) [0|3] ""  IDC,ADC,FAPA
 SG_ KAE_BLE3AuthSt : 149|2@0+ (1,0) [0|3] ""  IDC,ADC,FAPA
 SG_ KAE_BLE4AuthSt : 147|2@0+ (1,0) [0|3] ""  ADC
 SG_ KAE_BLE5AuthSt : 145|2@0+ (1,0) [0|3] ""  ADC
 SG_ KAE_BLE1PKSPosition : 420|3@0+ (1,0) [0|7] ""  IDC,ADC
 SG_ KAE_BLE2PKSPosition : 423|3@0+ (1,0) [0|7] ""  IDC,ADC
 SG_ KAE_BLE3PKSPosition : 427|3@0+ (1,0) [0|7] ""  IDC,ADC
 SG_ KAE_BLE4PKSPosition : 430|3@0+ (1,0) [0|7] ""  IDC,ADC
 SG_ KAE_BLE5PKSPosition : 417|3@0+ (1,0) [0|7] ""  IDC,ADC

CM_ SG_ 430 SRS_1_CRC_1 "E2E Profile 5 CRC";
CM_ SG_ 430 SRS_1_Counter_1 "E2E Profile 5 Counter";
CM_ SG_ 430 SRS_CrashOutputSt "To inform there's crash event happened in last 2 seconds.After 2 seconds, the signal will turn to 0(crash here means any one of the 5 status defined below)";
CM_ SG_ 430 SRS_Front_CrashOutputSt "To inform there's front crash event happened in last 2 seconds. After 2 seconds, the signal will turn to 0.";
CM_ SG_ 430 SRS_DriverSide_CrashOutputSt "To inform there's driver side crash event happened in last 2 seconds. After 2 seconds, the signal will turn to 0.(Driver side is the left side for the left-hand-drive vehicle, the right side for the right-hand-drive one. )";
CM_ SG_ 430 SRS_PassengerSide_CrashOutputSt "To inform there's passenger side crash event happened in last 2 seconds. After 2 seconds, the signal will turn to 0.(Passenger side is the right side for the left-hand-drive vehicle, the left side for the right-hand-drive one. )";
CM_ SG_ 430 SRS_Rear_CrashOutputSt "To inform there's rear crash event happened in last 2 seconds. After 2 seconds, the signal will turn to 0.";
CM_ SG_ 430 SRS_RolloverCrashOutputSt "To inform there's rollover crash event happened in last 2 seconds. After 2 seconds, the signal will turn to 0.";
CM_ SG_ 430 SRS_NearCrashOutputSt "To inform there's near crash event happened in last 2 seconds.After 2 seconds, the signal will turn to 0";
CM_ SG_ 430 SRS_1_CRC_2 "E2E Profile 5 CRC";
CM_ SG_ 430 SRS_1_Counter_2 "E2E Profile 5 Counter";
CM_ SG_ 430 SRS_YawSnsCalibSt "To indicates  yaw sensor calibration state";
CM_ SG_ 430 SRS_VehLongAccelVD "To indicate vehicle longitudinal acceleration valid state";
CM_ SG_ 430 SRS_VehLatrlAccelVD "To indicate vehicle lateral acceleration valid state";
CM_ SG_ 430 SRS_YawRateVD "To indicate yaw rate valid state";
CM_ SG_ 430 SRS_VehLongAccel "To indicate vehicle longitudinal acceleration";
CM_ SG_ 430 SRS_VehLatrlAccel "To indicate vehicle lateral acceleration";
CM_ SG_ 430 SRS_YawRate "To indicate vehicle yaw rate";
CM_ SG_ 939 SRS_PsngrSeatBeltSt "To identify whether first row passenger seat belt is buckled.(Passenger side is the right side for the left-hand-drive vehicle, the left side for the right-hand-drive one. )";
CM_ SG_ 939 SRS_DriverSeatBeltSt "To identify whether first row driver seat belt is buckled.(Driver side is the left side for the left-hand-drive vehicle, the right side for the right-hand-drive one. )";
CM_ SG_ 939 SRS_RearLeftSeatBeltSt "To identify whetherRearLeftSeatBelt is buckled";
CM_ SG_ 939 SRS_AirbagFaultSt "To illuminate or turn off airbag warning indicator";
CM_ SG_ 939 SRS_RearRightSeatBeltSt "To identify  whetherRearRightSeatBelt is buckled";
CM_ SG_ 939 SRS_RearMiddleSeatBeltSt "To identify whetherRearMiddleSeatBelt is buckled";
CM_ SG_ 363 EPS_1_CRC "E2E Profile 5 CRC";
CM_ SG_ 363 EPS_1_Counter "E2E Profile 5 Counter";
CM_ SG_ 363 EPS_StrngWhlTorqVD "Steering Wheel Torque valid value";
CM_ SG_ 363 EPS_StrngWhlTorq "Steering wheel Torque ";
CM_ SG_ 363 TAS_CalibratedSt "The calibration information of steering angle sensor";
CM_ SG_ 363 EPS_SteeringAngleSpd "steering wheel angle speed";
CM_ SG_ 363 EPS_SteeringAngle "steering wheel angle";
CM_ SG_ 363 EPS_SteeringAngleVD "indicate that Angle VD";
CM_ SG_ 363 EPS_ThermalSt "EPS over thermal limit state";
CM_ SG_ 363 EPS_VMCErrFeedback "EPS Error reason feedback to VMC";
CM_ SG_ 363 EPS_PstOverlaySt_SideA "EPS_A Position Overlay Contrlo State";
CM_ SG_ 363 EPS_PstOverlaySt_SideB "EPS_B Position Overlay Contrlo State";
CM_ SG_ 363 EPS_HealthySt_SideA "EPS_A Healthy State";
CM_ SG_ 363 EPS_HealthySt_SideB "EPS_B Healthy State";
CM_ SG_ 363 EPS_PstOverlaySt "Overall EPS Position Overlay Control State";
CM_ SG_ 363 EPS_HealthySt_DualSide "Overall EPS Healthy States";
CM_ SG_ 363 EPS_PstOverLayRdntSt "EPS Position Overlay Control Redundant state";
CM_ SG_ 363 EPS_VibrationWarnSt_A "Vibration Warn State";
CM_ SG_ 363 SAC_ErrFeedback_SideA "EPS_A Errer Feedback";
CM_ SG_ 363 SAC_ErrFeedback_SideB "EPS_B Errer Feedback";
CM_ SG_ 363 EPS_ADASTargetAngle "EPS's target Angle after the safety limit";
CM_ SG_ 363 EPS_FunctionStyleSt "EPS function style state";
CM_ SG_ 363 EPS_SteeringModeSt "EPS steering mode status";
CM_ SG_ 363 EPS_ActEffectiveChannel "Which Channel is controlling EPS";
CM_ SG_ 363 EPS_ReqAngOverRange "target angle received from ADAS/IFC over the safety range";
CM_ SG_ 363 EPS_SACMotorTorAct "SAC Actural motor torque";
CM_ SG_ 363 EPS_SACMotorTorLimInt "EPS’s internal safety limit of SAC motor torque";
CM_ SG_ 363 EPS_ReqAngSpdOverRange "Angular speed of target angle received from ADAS/IFC over the safety range";
CM_ SG_ 363 EPS_AssistPraSwitchToLKA "Indicate EPS Swithinto fixed steering parameters";
CM_ SG_ 363 EPS_SteerGainEnable "Steering Gain Enable";
CM_ SG_ 363 EPS_EmSteerEnbale "Emergency Steering Enable";
CM_ SG_ 363 EPS_SG_ErrFeedback "Steering Gain Enable Error Feedback";
CM_ SG_ 363 EPS_EM_ErrFeedback "Emergency Steering Enable Feedback";
CM_ SG_ 363 EPS_VW_ErrFeedback "Vibration Warn Enable Feedback";
CM_ SG_ 363 EPS_AngReqForIFCSt "EPS Position Overlay Control response IFC";
CM_ SG_ 363 EPS_SACMotorTorActMot "SAC Actural motor torque";
CM_ SG_ 363 EPS_MotorTorSum "EPS Motor output Torque  (including SAC and driver steering) ";
CM_ SG_ 363 EPS_WarnLamp "Streering Warning Lamp";
CM_ SG_ 363 EPS_AssistPercentage "Current Assit divide the max desige assistant，for single ECU";
CM_ SG_ 363 EPS_AssistRatio "feedback to IDC the assist ratio ";
CM_ SG_ 363 EPS_SteeringWhlTorFlt "Steering wheel torque after Elfa filtering";
CM_ SG_ 363 EPS_SteeringWhlTorFltVD "indicate that EPS_SteeringWhlTorFlt Valid or not";
CM_ SG_ 363 EPS_SteeringAngleRate "steering wheel angle rate";
CM_ SG_ 363 EPS_TqCtrlSt "ESP response state for ADAS moter torque request";
CM_ SG_ 363 EPS_MotorTorForDrv "EPS motor Torque value for driver steering";
CM_ SG_ 363 EPS_TqCtrlAvl "EPS moter torque control available state for ADAS";
CM_ SG_ 363 EPS_AgCtrlAvl "EPS steer angle control available state for ADAS";
CM_ SG_ 363 EPS_MotorTorSumVD "EPS motor torque valid state of driver steering";
CM_ SG_ 363 EPS_DrvOveRideSt "Driver override detection state";
CM_ SG_ 363 EPS_DrvOveRideVD "Driver override detection valid state";
CM_ SG_ 363 EPS_SteerVibrlAvl "EPS steer vibration control available state for ADAS";
CM_ SG_ 363 EPS_HandsOffDetStVD "Hands Off Detected States valid value";
CM_ SG_ 363 EPS_HandsOffDetSt "Hands Off Detected States";
CM_ SG_ 363 EPS_SteerMod "EPS working mode";
CM_ SG_ 363 EPS_EpsSelfChkSts "EPS self check Status";
CM_ SG_ 363 EPS_ThermProtnMax "EPS overtemperature protection";
CM_ SG_ 704 IPS_1_CRC "E2E Profile 5 CRC";
CM_ SG_ 704 IPS_1_Counter "E2E Profile 5 Counter";
CM_ SG_ 704 IPS_DCDCModeSt "mode status of DCDC";
CM_ SG_ 880 ITS_MotorPumpSt "Indicate The motor pump State";
CM_ SG_ 880 ITS_MotorInletTempErr "Motor Loop Temperature sensor error";
CM_ SG_ 880 ITS_MotorInletTemp "Motor Loop Temperature";
CM_ SG_ 880 ITS_FanSt "Indicate the fan state of error";
CM_ SG_ 880 ITS_LIN_CommunicateErrCode "LIN Communicate error code(ITS diagnose)";
CM_ SG_ 880 ITS_MotorPumpErrCode "Its motor pump error code";
CM_ SG_ 880 ITS_TMS_CommDataAvail "Whether the TMS data that ITS receives is available or not.";
CM_ SG_ 824 VCU_2_CRC "E2E Profile 5 CRC";
CM_ SG_ 824 VCU_2_Counter "E2E Profile 5 Counter";
CM_ SG_ 824 VCU_GearLvlDisp "Gear lever for display";
CM_ SG_ 824 VCU_VehDrvMod "Drive mode for display";
CM_ SG_ 824 VCU_VehRdySt "HEV system ready status";
CM_ SG_ 824 VCU_GearLvl "Gear lever for PEPS";
CM_ SG_ 824 VCU_PlgConnSt "Charge connector? connected Status";
CM_ SG_ 824 VCU_SwapHvBattRdySt "VCU swap Hvbattery ready status(driver agree swap)";
CM_ SG_ 824 VCU_SwapHvBattCompSt "VCU judge swap Hvbattery complete.";
CM_ SG_ 824 VCU_SwapHvBattModeSt "VCU swap Hvbattery mode status";
CM_ SG_ 824 VCU_SwapHvBattModeStVD "VCU swap Hvbattery mode statue VD";
CM_ SG_ 824 VCU_RoadMod "Road mode for display";
CM_ SG_ 952 VCU_3_CRC "E2E Profile 5 CRC";
CM_ SG_ 952 VCU_3_Counter "E2E Profile 5 Counter";
CM_ SG_ 952 VCU_ErrNotice "VCU error notice";
CM_ SG_ 952 VCU_ErrNoticeOperationFlag "Operation flag for VCU error notice";
CM_ SG_ 952 VCU_Err2NoticeFlag "Lever2 Error for VCU Popup?flag";
CM_ SG_ 952 VCU_EcoPlusMod "EcoPlus mode is activated";
CM_ SG_ 653 VCU_5_CRC "E2E Profile 5 CRC";
CM_ SG_ 653 VCU_5_Counter "E2E Profile 5 Counter";
CM_ SG_ 653 VCU_AccButtInfo "ACC Button Information";
CM_ SG_ 653 VCU_LateralAssistBtnInfo "Lateral assist button Information";
CM_ SG_ 653 VCU_LateralAssistBtnInfoVD "Lateral assist button Information valid data";
CM_ SG_ 653 VCU_EMS_AccPedalActPst "Current accelerate pedal actual position";
CM_ SG_ 653 VCU_EMS_BrkPedalSt "Brake pedal status";
CM_ SG_ 653 VCU_EMS_BrkPedalStVD "VCU_EMS_BrakePedSt valid data";
CM_ SG_ 653 VCU_EMS_AccPedalActPstVD "Current accelerate pedal actual position validity";
CM_ SG_ 653 VCU_DCU_ActRotSpd "Actual rotation speed DCU";
CM_ SG_ 653 VCU_BrkPedPstVD "Current brake pedal position valid data";
CM_ SG_ 653 VCU_CrntGearLvl "VCU current carry out gear level";
CM_ SG_ 653 VCU_BrkPedPst "Current brake pedal position";
CM_ SG_ 653 VCU_APAGasPedalIntv "VCU judge if? the driver intervened base the accelerator pedal position";
CM_ SG_ 653 VCU_APAAvailable "Whether VCU is available for APA function";
CM_ SG_ 653 VCU_ACCMaxRecpDecel "Current maximum recuperation deceleration of generator";
CM_ SG_ 653 VCU_ACCLimitOperatingSt "Operation status of ACC Limit mode, When VCU Enter the power-saving mode，";
CM_ SG_ 653 VCU_ACCMaxRecpDecelVD "VCU_ACCMaxRecpDecel valid validity";
CM_ SG_ 653 VCU_APA_Resp "VCU response to APA if VCU is response the gear shif and torque request";
CM_ SG_ 653 VCU_APAGearIntervern "During parking, If there is a request from GSM to change the gearlevel, this signal will be set to 1:with intervention (GSM gearlevel invalid will also be regard as a gearlevel request)";
CM_ SG_ 653 VCU_ActVehWheelTorq "Actual effective engine torque on wheel level";
CM_ SG_ 653 VCU_ACCmaxSpdLimit "When VCU Enter the power-saving mode，the maximum ACC target speed limited by VCU";
CM_ SG_ 653 VCU_VehWheelTorqMax "Actual effective maximum adjustable torque on wheel level";
CM_ SG_ 653 VCU_RecpTorqVD "Status of recuperation torque of generator";
CM_ SG_ 653 VCU_RecpTorq "Current recuperation torque of generator";
CM_ SG_ 653 VCU_CrntGearLvlVD "Valid bit for ActualGearPosition.";
CM_ SG_ 653 EMS_GasPedalActPstforMRRVD_D "EMS_GasPedalActPstforMRR Valid Data";
CM_ SG_ 644 VCU_7_CRC "E2E Profile 5 CRC";
CM_ SG_ 644 VCU_7_Counter "E2E Profile 5 Counter";
CM_ SG_ 644 EMS_GasPedalActPstforMRRVD "EMS_GasPedalActPstforMRR Valid Data";
CM_ SG_ 644 VCU_AccTMCFail "Indicating VCU in limp-home (error) mode.";
CM_ SG_ 644 VCU_AccElecECFail "Indicate the error state of electronic engine control.";
CM_ SG_ 644 VCU_AccDriverOrvd "Indicating the torque demanded by the driver is higher than the torque demanded by ACC.";
CM_ SG_ 644 EMS_GasPedalActPstforMRR "EMS_GasPedalActPstforMRR";
CM_ SG_ 644 VCU_AccSpareCanError "ACC Space CAN Error";
CM_ SG_ 644 VCU_IFCFailureSt "IFC Failure Status";
CM_ SG_ 644 VCU_AccDriverOrvdVD "Indicating the torque demanded by the driver is higher than the torque demanded by ACC.";
CM_ SG_ 644 VCU_TorqDriverReq "the driver torque request";
CM_ SG_ 393 VCU_9_CRC "E2E Profile 5 CRC";
CM_ SG_ 393 VCU_9_Counter "E2E Profile 5 Counter";
CM_ SG_ 393 VCU_ErrorFb "Indicate the error state for VCU";
CM_ SG_ 393 VCU_VehWhlReqTqVld "Validity of Actual effective engine torque on wheel level";
CM_ SG_ 393 VCU_MotorRegenTrqLmtlnDVaild "整车最大允许制动能量回收扭矩轮端扭矩有效位";
CM_ SG_ 393 VCU_GearShiftAvl "档位切换可用状态";
CM_ SG_ 393 VCU_PtTqAvl "Indicate the available statusof Power system torque";
CM_ SG_ 393 VCU_PtTqActvSts "VCU扭矩响应状态";
CM_ SG_ 393 VCU_MotorRegenTorqueLmtlnD "Current maximum available recuperation torque of generator";
CM_ SG_ 393 VCU_DriverTorqueDesired "the driver torque request";
CM_ SG_ 393 VCU_VehWhlReqTq "Vehicle demand for wheel torque request";
CM_ SG_ 393 VCU_TargetRecpTorqSt "Status of  Target cuperation torque of generator";
CM_ SG_ 393 VCU_TargetRecpTorqNm "Current target recuperation torque of generator";
CM_ SG_ 393 VCU_TargetRecpTorqFA_Hyb "Target cuperation torque of generator for front axel";
CM_ SG_ 393 VCU_TargetRecpTorqRA_Hyb "Target cuperation torque of generator for rear axel";
CM_ SG_ 393 VCU_TorqDriverReqFA_Hyb "the driver torque request for front axel";
CM_ SG_ 393 VCU_TorqDriverReqRA_Hyb "the driver torque request for rear axel ";
CM_ SG_ 393 VCU_VehActDrvTorqFA_Hyb "Vehicle actual drive torque for front axel ";
CM_ SG_ 393 VCU_VehActDrvTorqRA_Hyb "Vehicle actual drive torque for rear axel ";
CM_ SG_ 393 VCU_TargetRecpTorqFAVD_Hyb "Status of Target cuperation torque of generator for front axel ";
CM_ SG_ 393 VCU_TargetRecpTorqRAVD_Hyb "Status of Target cuperation torque of generator for rear axel";
CM_ SG_ 393 VCU_TorqDriverReqFAVD "Status of the driver torque request for front axel";
CM_ SG_ 393 VCU_TorqDriverReqRAVD "Status of the driver torque request for rear axel";
CM_ SG_ 393 VCU_VehActDrvTorqFAVD_Hyb "Vehicle actual drive torque valid data for front axel ";
CM_ SG_ 393 VCU_VehActDrvTorqRAVD_Hyb "Vehicle actual drive torque valid data for rear axel ";
CM_ SG_ 393 VCU_BcsDecelReq "target deceleration to BCS by AVDC";
CM_ SG_ 393 VCU_BcsDecelVD "Quality/Fault of AVDC deceleration to BCS";
CM_ SG_ 393 VCU_BcsDecelEnable "AVDC deceleration to BCS enable";
CM_ SG_ 393 VCU_CrntGearNoTrans "VCU Gear Lever send to ADS without trans";
CM_ SG_ 393 VCU_RecpTorqSt "Status of recuperation torque of generator";
CM_ SG_ 393 VCU_RecpTorqNm "Current recuperation torque of generator";
CM_ SG_ 393 VCU_RecpTorqFAVD_Hyb "Status of front axel maximum recuperation torque of generator";
CM_ SG_ 393 VCU_RecpTorqRAVD_Hyb "Status of rear axel maximum recuperation torque of generator";
CM_ SG_ 393 VCU_MaxRecpTorqFAVD_Hyb "Status of front axel maximum recuperation torque of generator";
CM_ SG_ 393 VCU_MaxRecpTorqRAVD_Hyb "Status of front axel maximum recuperation torque of generator";
CM_ SG_ 393 VCU_RecpTorqFA_Hyb "Current recuperation torque of generator FA";
CM_ SG_ 393 VCU_RecpTorqRA_Hyb "Current recuperation torque of generator RA";
CM_ SG_ 393 VCU_MaxRecpTorqFA_Hyb "Current maximum available recuperation torque of generator FA";
CM_ SG_ 393 VCU_MaxRecpTorqRA_Hyb "Current maximum available recuperation torque of generator RA";
CM_ SG_ 393 VCU_VehWheelTorqMinNm "Actual effective minimum adjustable torque on wheel level";
CM_ SG_ 393 VCU_VehWheelTorqMaxNmVD "Actual effective maximum adjustable torque on wheel level validity";
CM_ SG_ 393 VCU_VehWheelTorqMaxNm "Actual effective maximum adjustable torque on wheel level";
CM_ SG_ 393 VCU_ActVehWheelTorqNm "Actual effective engine torque on wheel level";
CM_ SG_ 393 VCU_APAWheelTorqDriverReqNm "The driver torque on wheel request to APA";
CM_ SG_ 512 KAE_BLE1Position "BLE Channel1 Key Position";
CM_ SG_ 512 KAE_BLE2Position "BLE Channel2 Key Position ";
CM_ SG_ 512 KAE_BLE3Position "BLE Channel3 Key Position ";
CM_ SG_ 512 KAE_BLE4Position "BLE Channel4 Key Position";
CM_ SG_ 512 KAE_BLE5Position "BLE Channel5 Key Position ";
CM_ SG_ 512 KAE_BLE1AuthSt "BLE Channel1 Authentication Stauts";
CM_ SG_ 512 KAE_BLE2AuthSt "BLE Channel2 Authentication Stauts";
CM_ SG_ 512 KAE_BLE3AuthSt "BLE Channel3 Authentication Stauts";
CM_ SG_ 512 KAE_BLE4AuthSt "BLE Channel4 Authentication Stauts";
CM_ SG_ 512 KAE_BLE5AuthSt "BLE Channel5 Authentication Stauts";
CM_ SG_ 512 KAE_BLE1PKSPosition "BLE Channel1 Key PKS Position";
CM_ SG_ 512 KAE_BLE2PKSPosition "BLE Channel2 Key PKS Position";
CM_ SG_ 512 KAE_BLE3PKSPosition "BLE Channel3 Key PKS Position";
CM_ SG_ 512 KAE_BLE4PKSPosition "BLE Channel4 Key PKS Position";
CM_ SG_ 512 KAE_BLE5PKSPosition "BLE Channel5 Key PKS Position";

BA_DEF_ BO_  "GenMsgCycleTime" INT 0 0;
BA_DEF_ BO_  "GenMsgCycleTimeFast" INT 0 0;
BA_DEF_ BO_  "GenMsgSendType" ENUM  "Periodic","Event","IfActive","POE","PA","FixedPeriodic","Event","EnabledPeriodic","NotUsed","NotUsed","EventPeriodic","NotUsed","NotUsed","NoMsgSendType";
BA_DEF_ BO_  "VFrameFormat" ENUM  "StandardCAN","ExtendedCAN","reserved","reserved","reserved","reserved","reserved","reserved","reserved","reserved","reserved","reserved","reserved","reserved","StandardCAN_FD","ExtendedCAN_FD";
BA_DEF_ BO_  "CANFD_BRS" ENUM  "0","1";
BA_DEF_ SG_  "EventCommandSignal" ENUM  "No","Yes";
BA_DEF_ SG_  "GatewayedSignals" ENUM  "No","Yes";
BA_DEF_ SG_  "GenSigInactiveValue" HEX 0 0;
BA_DEF_ SG_  "GenSigInvalidValue" HEX 0 0;
BA_DEF_ SG_  "GenSigSendType" ENUM  "Trigger","Passive","Cyclic","OnWrite","OnWriteWithRepetition","OnChange","OnChangeWithRepetition","IfActive","IfActiveWithRepetition","NoSigSendType";
BA_DEF_ SG_  "GenSigStartValue" HEX 0 0;
BA_DEF_ SG_  "GenSigTimeoutValue" HEX 0 0;
BA_DEF_ SG_  "Remark" STRING ;
BA_ "GenMsgCycleTime" BO_ 430 20;
BA_ "GenMsgCycleTimeFast" BO_ 430 0;
BA_ "GenMsgSendType" BO_ 430 0;
BA_ "VFrameFormat" BO_ 430 14;
BA_ "CANFD_BRS" BO_ 430 1;
BA_ "GenMsgCycleTime" BO_ 430 20;
BA_ "GenMsgCycleTimeFast" BO_ 430 0;
BA_ "GenMsgSendType" BO_ 430 0;
BA_ "VFrameFormat" BO_ 430 14;
BA_ "CANFD_BRS" BO_ 430 1;
BA_ "GenMsgCycleTime" BO_ 430 20;
BA_ "GenMsgCycleTimeFast" BO_ 430 0;
BA_ "GenMsgSendType" BO_ 430 0;
BA_ "VFrameFormat" BO_ 430 14;
BA_ "CANFD_BRS" BO_ 430 1;
BA_ "GenMsgCycleTime" BO_ 430 20;
BA_ "GenMsgCycleTimeFast" BO_ 430 0;
BA_ "GenMsgSendType" BO_ 430 0;
BA_ "VFrameFormat" BO_ 430 14;
BA_ "CANFD_BRS" BO_ 430 1;
BA_ "GenMsgCycleTime" BO_ 430 20;
BA_ "GenMsgCycleTimeFast" BO_ 430 0;
BA_ "GenMsgSendType" BO_ 430 0;
BA_ "VFrameFormat" BO_ 430 14;
BA_ "CANFD_BRS" BO_ 430 1;
BA_ "GenMsgCycleTime" BO_ 430 20;
BA_ "GenMsgCycleTimeFast" BO_ 430 0;
BA_ "GenMsgSendType" BO_ 430 0;
BA_ "VFrameFormat" BO_ 430 14;
BA_ "CANFD_BRS" BO_ 430 1;
BA_ "GenMsgCycleTime" BO_ 430 20;
BA_ "GenMsgCycleTimeFast" BO_ 430 0;
BA_ "GenMsgSendType" BO_ 430 0;
BA_ "VFrameFormat" BO_ 430 14;
BA_ "CANFD_BRS" BO_ 430 1;
BA_ "GenMsgCycleTime" BO_ 430 20;
BA_ "GenMsgCycleTimeFast" BO_ 430 0;
BA_ "GenMsgSendType" BO_ 430 0;
BA_ "VFrameFormat" BO_ 430 14;
BA_ "CANFD_BRS" BO_ 430 1;
BA_ "GenMsgCycleTime" BO_ 430 20;
BA_ "GenMsgCycleTimeFast" BO_ 430 0;
BA_ "GenMsgSendType" BO_ 430 0;
BA_ "VFrameFormat" BO_ 430 14;
BA_ "CANFD_BRS" BO_ 430 1;
BA_ "GenMsgCycleTime" BO_ 430 20;
BA_ "GenMsgCycleTimeFast" BO_ 430 0;
BA_ "GenMsgSendType" BO_ 430 0;
BA_ "VFrameFormat" BO_ 430 14;
BA_ "CANFD_BRS" BO_ 430 1;
BA_ "GenMsgCycleTime" BO_ 430 20;
BA_ "GenMsgCycleTimeFast" BO_ 430 0;
BA_ "GenMsgSendType" BO_ 430 0;
BA_ "VFrameFormat" BO_ 430 14;
BA_ "CANFD_BRS" BO_ 430 1;
BA_ "GenMsgCycleTime" BO_ 430 20;
BA_ "GenMsgCycleTimeFast" BO_ 430 0;
BA_ "GenMsgSendType" BO_ 430 0;
BA_ "VFrameFormat" BO_ 430 14;
BA_ "CANFD_BRS" BO_ 430 1;
BA_ "GenMsgCycleTime" BO_ 430 20;
BA_ "GenMsgCycleTimeFast" BO_ 430 0;
BA_ "GenMsgSendType" BO_ 430 0;
BA_ "VFrameFormat" BO_ 430 14;
BA_ "CANFD_BRS" BO_ 430 1;
BA_ "GenMsgCycleTime" BO_ 430 20;
BA_ "GenMsgCycleTimeFast" BO_ 430 0;
BA_ "GenMsgSendType" BO_ 430 0;
BA_ "VFrameFormat" BO_ 430 14;
BA_ "CANFD_BRS" BO_ 430 1;
BA_ "GenMsgCycleTime" BO_ 430 20;
BA_ "GenMsgCycleTimeFast" BO_ 430 0;
BA_ "GenMsgSendType" BO_ 430 0;
BA_ "VFrameFormat" BO_ 430 14;
BA_ "CANFD_BRS" BO_ 430 1;
BA_ "GenMsgCycleTime" BO_ 430 20;
BA_ "GenMsgCycleTimeFast" BO_ 430 0;
BA_ "GenMsgSendType" BO_ 430 0;
BA_ "VFrameFormat" BO_ 430 14;
BA_ "CANFD_BRS" BO_ 430 1;
BA_ "GenMsgCycleTime" BO_ 430 20;
BA_ "GenMsgCycleTimeFast" BO_ 430 0;
BA_ "GenMsgSendType" BO_ 430 0;
BA_ "VFrameFormat" BO_ 430 14;
BA_ "CANFD_BRS" BO_ 430 1;
BA_ "GenMsgCycleTime" BO_ 430 20;
BA_ "GenMsgCycleTimeFast" BO_ 430 0;
BA_ "GenMsgSendType" BO_ 430 0;
BA_ "VFrameFormat" BO_ 430 14;
BA_ "CANFD_BRS" BO_ 430 1;
BA_ "GenMsgCycleTime" BO_ 939 100;
BA_ "GenMsgCycleTimeFast" BO_ 939 0;
BA_ "GenMsgSendType" BO_ 939 0;
BA_ "VFrameFormat" BO_ 939 14;
BA_ "CANFD_BRS" BO_ 939 1;
BA_ "GenMsgCycleTime" BO_ 939 100;
BA_ "GenMsgCycleTimeFast" BO_ 939 0;
BA_ "GenMsgSendType" BO_ 939 0;
BA_ "VFrameFormat" BO_ 939 14;
BA_ "CANFD_BRS" BO_ 939 1;
BA_ "GenMsgCycleTime" BO_ 939 100;
BA_ "GenMsgCycleTimeFast" BO_ 939 0;
BA_ "GenMsgSendType" BO_ 939 0;
BA_ "VFrameFormat" BO_ 939 14;
BA_ "CANFD_BRS" BO_ 939 1;
BA_ "GenMsgCycleTime" BO_ 939 100;
BA_ "GenMsgCycleTimeFast" BO_ 939 0;
BA_ "GenMsgSendType" BO_ 939 0;
BA_ "VFrameFormat" BO_ 939 14;
BA_ "CANFD_BRS" BO_ 939 1;
BA_ "GenMsgCycleTime" BO_ 939 100;
BA_ "GenMsgCycleTimeFast" BO_ 939 0;
BA_ "GenMsgSendType" BO_ 939 0;
BA_ "VFrameFormat" BO_ 939 14;
BA_ "CANFD_BRS" BO_ 939 1;
BA_ "GenMsgCycleTime" BO_ 939 100;
BA_ "GenMsgCycleTimeFast" BO_ 939 0;
BA_ "GenMsgSendType" BO_ 939 0;
BA_ "VFrameFormat" BO_ 939 14;
BA_ "CANFD_BRS" BO_ 939 1;
BA_ "GenMsgCycleTime" BO_ 363 10;
BA_ "GenMsgCycleTimeFast" BO_ 363 0;
BA_ "GenMsgSendType" BO_ 363 0;
BA_ "VFrameFormat" BO_ 363 14;
BA_ "CANFD_BRS" BO_ 363 1;
BA_ "GenMsgCycleTime" BO_ 363 10;
BA_ "GenMsgCycleTimeFast" BO_ 363 0;
BA_ "GenMsgSendType" BO_ 363 0;
BA_ "VFrameFormat" BO_ 363 14;
BA_ "CANFD_BRS" BO_ 363 1;
BA_ "GenMsgCycleTime" BO_ 363 10;
BA_ "GenMsgCycleTimeFast" BO_ 363 0;
BA_ "GenMsgSendType" BO_ 363 0;
BA_ "VFrameFormat" BO_ 363 14;
BA_ "CANFD_BRS" BO_ 363 1;
BA_ "GenMsgCycleTime" BO_ 363 10;
BA_ "GenMsgCycleTimeFast" BO_ 363 0;
BA_ "GenMsgSendType" BO_ 363 0;
BA_ "VFrameFormat" BO_ 363 14;
BA_ "CANFD_BRS" BO_ 363 1;
BA_ "GenMsgCycleTime" BO_ 363 10;
BA_ "GenMsgCycleTimeFast" BO_ 363 0;
BA_ "GenMsgSendType" BO_ 363 0;
BA_ "VFrameFormat" BO_ 363 14;
BA_ "CANFD_BRS" BO_ 363 1;
BA_ "GenMsgCycleTime" BO_ 363 10;
BA_ "GenMsgCycleTimeFast" BO_ 363 0;
BA_ "GenMsgSendType" BO_ 363 0;
BA_ "VFrameFormat" BO_ 363 14;
BA_ "CANFD_BRS" BO_ 363 1;
BA_ "GenMsgCycleTime" BO_ 363 10;
BA_ "GenMsgCycleTimeFast" BO_ 363 0;
BA_ "GenMsgSendType" BO_ 363 0;
BA_ "VFrameFormat" BO_ 363 14;
BA_ "CANFD_BRS" BO_ 363 1;
BA_ "GenMsgCycleTime" BO_ 363 10;
BA_ "GenMsgCycleTimeFast" BO_ 363 0;
BA_ "GenMsgSendType" BO_ 363 0;
BA_ "VFrameFormat" BO_ 363 14;
BA_ "CANFD_BRS" BO_ 363 1;
BA_ "GenMsgCycleTime" BO_ 363 10;
BA_ "GenMsgCycleTimeFast" BO_ 363 0;
BA_ "GenMsgSendType" BO_ 363 0;
BA_ "VFrameFormat" BO_ 363 14;
BA_ "CANFD_BRS" BO_ 363 1;
BA_ "GenMsgCycleTime" BO_ 363 10;
BA_ "GenMsgCycleTimeFast" BO_ 363 0;
BA_ "GenMsgSendType" BO_ 363 0;
BA_ "VFrameFormat" BO_ 363 14;
BA_ "CANFD_BRS" BO_ 363 1;
BA_ "GenMsgCycleTime" BO_ 363 10;
BA_ "GenMsgCycleTimeFast" BO_ 363 0;
BA_ "GenMsgSendType" BO_ 363 0;
BA_ "VFrameFormat" BO_ 363 14;
BA_ "CANFD_BRS" BO_ 363 1;
BA_ "GenMsgCycleTime" BO_ 363 10;
BA_ "GenMsgCycleTimeFast" BO_ 363 0;
BA_ "GenMsgSendType" BO_ 363 0;
BA_ "VFrameFormat" BO_ 363 14;
BA_ "CANFD_BRS" BO_ 363 1;
BA_ "GenMsgCycleTime" BO_ 363 10;
BA_ "GenMsgCycleTimeFast" BO_ 363 0;
BA_ "GenMsgSendType" BO_ 363 0;
BA_ "VFrameFormat" BO_ 363 14;
BA_ "CANFD_BRS" BO_ 363 1;
BA_ "GenMsgCycleTime" BO_ 363 10;
BA_ "GenMsgCycleTimeFast" BO_ 363 0;
BA_ "GenMsgSendType" BO_ 363 0;
BA_ "VFrameFormat" BO_ 363 14;
BA_ "CANFD_BRS" BO_ 363 1;
BA_ "GenMsgCycleTime" BO_ 363 10;
BA_ "GenMsgCycleTimeFast" BO_ 363 0;
BA_ "GenMsgSendType" BO_ 363 0;
BA_ "VFrameFormat" BO_ 363 14;
BA_ "CANFD_BRS" BO_ 363 1;
BA_ "GenMsgCycleTime" BO_ 363 10;
BA_ "GenMsgCycleTimeFast" BO_ 363 0;
BA_ "GenMsgSendType" BO_ 363 0;
BA_ "VFrameFormat" BO_ 363 14;
BA_ "CANFD_BRS" BO_ 363 1;
BA_ "GenMsgCycleTime" BO_ 363 10;
BA_ "GenMsgCycleTimeFast" BO_ 363 0;
BA_ "GenMsgSendType" BO_ 363 0;
BA_ "VFrameFormat" BO_ 363 14;
BA_ "CANFD_BRS" BO_ 363 1;
BA_ "GenMsgCycleTime" BO_ 363 10;
BA_ "GenMsgCycleTimeFast" BO_ 363 0;
BA_ "GenMsgSendType" BO_ 363 0;
BA_ "VFrameFormat" BO_ 363 14;
BA_ "CANFD_BRS" BO_ 363 1;
BA_ "GenMsgCycleTime" BO_ 363 10;
BA_ "GenMsgCycleTimeFast" BO_ 363 0;
BA_ "GenMsgSendType" BO_ 363 0;
BA_ "VFrameFormat" BO_ 363 14;
BA_ "CANFD_BRS" BO_ 363 1;
BA_ "GenMsgCycleTime" BO_ 363 10;
BA_ "GenMsgCycleTimeFast" BO_ 363 0;
BA_ "GenMsgSendType" BO_ 363 0;
BA_ "VFrameFormat" BO_ 363 14;
BA_ "CANFD_BRS" BO_ 363 1;
BA_ "GenMsgCycleTime" BO_ 363 10;
BA_ "GenMsgCycleTimeFast" BO_ 363 0;
BA_ "GenMsgSendType" BO_ 363 0;
BA_ "VFrameFormat" BO_ 363 14;
BA_ "CANFD_BRS" BO_ 363 1;
BA_ "GenMsgCycleTime" BO_ 363 10;
BA_ "GenMsgCycleTimeFast" BO_ 363 0;
BA_ "GenMsgSendType" BO_ 363 0;
BA_ "VFrameFormat" BO_ 363 14;
BA_ "CANFD_BRS" BO_ 363 1;
BA_ "GenMsgCycleTime" BO_ 363 10;
BA_ "GenMsgCycleTimeFast" BO_ 363 0;
BA_ "GenMsgSendType" BO_ 363 0;
BA_ "VFrameFormat" BO_ 363 14;
BA_ "CANFD_BRS" BO_ 363 1;
BA_ "GenMsgCycleTime" BO_ 363 10;
BA_ "GenMsgCycleTimeFast" BO_ 363 0;
BA_ "GenMsgSendType" BO_ 363 0;
BA_ "VFrameFormat" BO_ 363 14;
BA_ "CANFD_BRS" BO_ 363 1;
BA_ "GenMsgCycleTime" BO_ 363 10;
BA_ "GenMsgCycleTimeFast" BO_ 363 0;
BA_ "GenMsgSendType" BO_ 363 0;
BA_ "VFrameFormat" BO_ 363 14;
BA_ "CANFD_BRS" BO_ 363 1;
BA_ "GenMsgCycleTime" BO_ 363 10;
BA_ "GenMsgCycleTimeFast" BO_ 363 0;
BA_ "GenMsgSendType" BO_ 363 0;
BA_ "VFrameFormat" BO_ 363 14;
BA_ "CANFD_BRS" BO_ 363 1;
BA_ "GenMsgCycleTime" BO_ 363 10;
BA_ "GenMsgCycleTimeFast" BO_ 363 0;
BA_ "GenMsgSendType" BO_ 363 0;
BA_ "VFrameFormat" BO_ 363 14;
BA_ "CANFD_BRS" BO_ 363 1;
BA_ "GenMsgCycleTime" BO_ 363 10;
BA_ "GenMsgCycleTimeFast" BO_ 363 0;
BA_ "GenMsgSendType" BO_ 363 0;
BA_ "VFrameFormat" BO_ 363 14;
BA_ "CANFD_BRS" BO_ 363 1;
BA_ "GenMsgCycleTime" BO_ 363 10;
BA_ "GenMsgCycleTimeFast" BO_ 363 0;
BA_ "GenMsgSendType" BO_ 363 0;
BA_ "VFrameFormat" BO_ 363 14;
BA_ "CANFD_BRS" BO_ 363 1;
BA_ "GenMsgCycleTime" BO_ 363 10;
BA_ "GenMsgCycleTimeFast" BO_ 363 0;
BA_ "GenMsgSendType" BO_ 363 0;
BA_ "VFrameFormat" BO_ 363 14;
BA_ "CANFD_BRS" BO_ 363 1;
BA_ "GenMsgCycleTime" BO_ 363 10;
BA_ "GenMsgCycleTimeFast" BO_ 363 0;
BA_ "GenMsgSendType" BO_ 363 0;
BA_ "VFrameFormat" BO_ 363 14;
BA_ "CANFD_BRS" BO_ 363 1;
BA_ "GenMsgCycleTime" BO_ 363 10;
BA_ "GenMsgCycleTimeFast" BO_ 363 0;
BA_ "GenMsgSendType" BO_ 363 0;
BA_ "VFrameFormat" BO_ 363 14;
BA_ "CANFD_BRS" BO_ 363 1;
BA_ "GenMsgCycleTime" BO_ 363 10;
BA_ "GenMsgCycleTimeFast" BO_ 363 0;
BA_ "GenMsgSendType" BO_ 363 0;
BA_ "VFrameFormat" BO_ 363 14;
BA_ "CANFD_BRS" BO_ 363 1;
BA_ "GenMsgCycleTime" BO_ 363 10;
BA_ "GenMsgCycleTimeFast" BO_ 363 0;
BA_ "GenMsgSendType" BO_ 363 0;
BA_ "VFrameFormat" BO_ 363 14;
BA_ "CANFD_BRS" BO_ 363 1;
BA_ "GenMsgCycleTime" BO_ 363 10;
BA_ "GenMsgCycleTimeFast" BO_ 363 0;
BA_ "GenMsgSendType" BO_ 363 0;
BA_ "VFrameFormat" BO_ 363 14;
BA_ "CANFD_BRS" BO_ 363 1;
BA_ "GenMsgCycleTime" BO_ 363 10;
BA_ "GenMsgCycleTimeFast" BO_ 363 0;
BA_ "GenMsgSendType" BO_ 363 0;
BA_ "VFrameFormat" BO_ 363 14;
BA_ "CANFD_BRS" BO_ 363 1;
BA_ "GenMsgCycleTime" BO_ 363 10;
BA_ "GenMsgCycleTimeFast" BO_ 363 0;
BA_ "GenMsgSendType" BO_ 363 0;
BA_ "VFrameFormat" BO_ 363 14;
BA_ "CANFD_BRS" BO_ 363 1;
BA_ "GenMsgCycleTime" BO_ 363 10;
BA_ "GenMsgCycleTimeFast" BO_ 363 0;
BA_ "GenMsgSendType" BO_ 363 0;
BA_ "VFrameFormat" BO_ 363 14;
BA_ "CANFD_BRS" BO_ 363 1;
BA_ "GenMsgCycleTime" BO_ 363 10;
BA_ "GenMsgCycleTimeFast" BO_ 363 0;
BA_ "GenMsgSendType" BO_ 363 0;
BA_ "VFrameFormat" BO_ 363 14;
BA_ "CANFD_BRS" BO_ 363 1;
BA_ "GenMsgCycleTime" BO_ 363 10;
BA_ "GenMsgCycleTimeFast" BO_ 363 0;
BA_ "GenMsgSendType" BO_ 363 0;
BA_ "VFrameFormat" BO_ 363 14;
BA_ "CANFD_BRS" BO_ 363 1;
BA_ "GenMsgCycleTime" BO_ 363 10;
BA_ "GenMsgCycleTimeFast" BO_ 363 0;
BA_ "GenMsgSendType" BO_ 363 0;
BA_ "VFrameFormat" BO_ 363 14;
BA_ "CANFD_BRS" BO_ 363 1;
BA_ "GenMsgCycleTime" BO_ 363 10;
BA_ "GenMsgCycleTimeFast" BO_ 363 0;
BA_ "GenMsgSendType" BO_ 363 0;
BA_ "VFrameFormat" BO_ 363 14;
BA_ "CANFD_BRS" BO_ 363 1;
BA_ "GenMsgCycleTime" BO_ 363 10;
BA_ "GenMsgCycleTimeFast" BO_ 363 0;
BA_ "GenMsgSendType" BO_ 363 0;
BA_ "VFrameFormat" BO_ 363 14;
BA_ "CANFD_BRS" BO_ 363 1;
BA_ "GenMsgCycleTime" BO_ 363 10;
BA_ "GenMsgCycleTimeFast" BO_ 363 0;
BA_ "GenMsgSendType" BO_ 363 0;
BA_ "VFrameFormat" BO_ 363 14;
BA_ "CANFD_BRS" BO_ 363 1;
BA_ "GenMsgCycleTime" BO_ 363 10;
BA_ "GenMsgCycleTimeFast" BO_ 363 0;
BA_ "GenMsgSendType" BO_ 363 0;
BA_ "VFrameFormat" BO_ 363 14;
BA_ "CANFD_BRS" BO_ 363 1;
BA_ "GenMsgCycleTime" BO_ 363 10;
BA_ "GenMsgCycleTimeFast" BO_ 363 0;
BA_ "GenMsgSendType" BO_ 363 0;
BA_ "VFrameFormat" BO_ 363 14;
BA_ "CANFD_BRS" BO_ 363 1;
BA_ "GenMsgCycleTime" BO_ 363 10;
BA_ "GenMsgCycleTimeFast" BO_ 363 0;
BA_ "GenMsgSendType" BO_ 363 0;
BA_ "VFrameFormat" BO_ 363 14;
BA_ "CANFD_BRS" BO_ 363 1;
BA_ "GenMsgCycleTime" BO_ 363 10;
BA_ "GenMsgCycleTimeFast" BO_ 363 0;
BA_ "GenMsgSendType" BO_ 363 0;
BA_ "VFrameFormat" BO_ 363 14;
BA_ "CANFD_BRS" BO_ 363 1;
BA_ "GenMsgCycleTime" BO_ 363 10;
BA_ "GenMsgCycleTimeFast" BO_ 363 0;
BA_ "GenMsgSendType" BO_ 363 0;
BA_ "VFrameFormat" BO_ 363 14;
BA_ "CANFD_BRS" BO_ 363 1;
BA_ "GenMsgCycleTime" BO_ 363 10;
BA_ "GenMsgCycleTimeFast" BO_ 363 0;
BA_ "GenMsgSendType" BO_ 363 0;
BA_ "VFrameFormat" BO_ 363 14;
BA_ "CANFD_BRS" BO_ 363 1;
BA_ "GenMsgCycleTime" BO_ 363 10;
BA_ "GenMsgCycleTimeFast" BO_ 363 0;
BA_ "GenMsgSendType" BO_ 363 0;
BA_ "VFrameFormat" BO_ 363 14;
BA_ "CANFD_BRS" BO_ 363 1;
BA_ "GenMsgCycleTime" BO_ 363 10;
BA_ "GenMsgCycleTimeFast" BO_ 363 0;
BA_ "GenMsgSendType" BO_ 363 0;
BA_ "VFrameFormat" BO_ 363 14;
BA_ "CANFD_BRS" BO_ 363 1;
BA_ "GenMsgCycleTime" BO_ 363 10;
BA_ "GenMsgCycleTimeFast" BO_ 363 0;
BA_ "GenMsgSendType" BO_ 363 0;
BA_ "VFrameFormat" BO_ 363 14;
BA_ "CANFD_BRS" BO_ 363 1;
BA_ "GenMsgCycleTime" BO_ 363 10;
BA_ "GenMsgCycleTimeFast" BO_ 363 0;
BA_ "GenMsgSendType" BO_ 363 0;
BA_ "VFrameFormat" BO_ 363 14;
BA_ "CANFD_BRS" BO_ 363 1;
BA_ "GenMsgCycleTime" BO_ 363 10;
BA_ "GenMsgCycleTimeFast" BO_ 363 0;
BA_ "GenMsgSendType" BO_ 363 0;
BA_ "VFrameFormat" BO_ 363 14;
BA_ "CANFD_BRS" BO_ 363 1;
BA_ "GenMsgCycleTime" BO_ 363 10;
BA_ "GenMsgCycleTimeFast" BO_ 363 0;
BA_ "GenMsgSendType" BO_ 363 0;
BA_ "VFrameFormat" BO_ 363 14;
BA_ "CANFD_BRS" BO_ 363 1;
BA_ "GenMsgCycleTime" BO_ 363 10;
BA_ "GenMsgCycleTimeFast" BO_ 363 0;
BA_ "GenMsgSendType" BO_ 363 0;
BA_ "VFrameFormat" BO_ 363 14;
BA_ "CANFD_BRS" BO_ 363 1;
BA_ "GenMsgCycleTime" BO_ 363 10;
BA_ "GenMsgCycleTimeFast" BO_ 363 0;
BA_ "GenMsgSendType" BO_ 363 0;
BA_ "VFrameFormat" BO_ 363 14;
BA_ "CANFD_BRS" BO_ 363 1;
BA_ "GenMsgCycleTime" BO_ 363 10;
BA_ "GenMsgCycleTimeFast" BO_ 363 0;
BA_ "GenMsgSendType" BO_ 363 0;
BA_ "VFrameFormat" BO_ 363 14;
BA_ "CANFD_BRS" BO_ 363 1;
BA_ "GenMsgCycleTime" BO_ 704 200;
BA_ "GenMsgCycleTimeFast" BO_ 704 0;
BA_ "GenMsgSendType" BO_ 704 0;
BA_ "VFrameFormat" BO_ 704 14;
BA_ "CANFD_BRS" BO_ 704 1;
BA_ "GenMsgCycleTime" BO_ 704 200;
BA_ "GenMsgCycleTimeFast" BO_ 704 0;
BA_ "GenMsgSendType" BO_ 704 0;
BA_ "VFrameFormat" BO_ 704 14;
BA_ "CANFD_BRS" BO_ 704 1;
BA_ "GenMsgCycleTime" BO_ 704 200;
BA_ "GenMsgCycleTimeFast" BO_ 704 0;
BA_ "GenMsgSendType" BO_ 704 0;
BA_ "VFrameFormat" BO_ 704 14;
BA_ "CANFD_BRS" BO_ 704 1;
BA_ "GenMsgCycleTime" BO_ 880 200;
BA_ "GenMsgCycleTimeFast" BO_ 880 0;
BA_ "GenMsgSendType" BO_ 880 0;
BA_ "VFrameFormat" BO_ 880 14;
BA_ "CANFD_BRS" BO_ 880 1;
BA_ "GenMsgCycleTime" BO_ 880 200;
BA_ "GenMsgCycleTimeFast" BO_ 880 0;
BA_ "GenMsgSendType" BO_ 880 0;
BA_ "VFrameFormat" BO_ 880 14;
BA_ "CANFD_BRS" BO_ 880 1;
BA_ "GenMsgCycleTime" BO_ 880 200;
BA_ "GenMsgCycleTimeFast" BO_ 880 0;
BA_ "GenMsgSendType" BO_ 880 0;
BA_ "VFrameFormat" BO_ 880 14;
BA_ "CANFD_BRS" BO_ 880 1;
BA_ "GenMsgCycleTime" BO_ 880 200;
BA_ "GenMsgCycleTimeFast" BO_ 880 0;
BA_ "GenMsgSendType" BO_ 880 0;
BA_ "VFrameFormat" BO_ 880 14;
BA_ "CANFD_BRS" BO_ 880 1;
BA_ "GenMsgCycleTime" BO_ 880 200;
BA_ "GenMsgCycleTimeFast" BO_ 880 0;
BA_ "GenMsgSendType" BO_ 880 0;
BA_ "VFrameFormat" BO_ 880 14;
BA_ "CANFD_BRS" BO_ 880 1;
BA_ "GenMsgCycleTime" BO_ 880 200;
BA_ "GenMsgCycleTimeFast" BO_ 880 0;
BA_ "GenMsgSendType" BO_ 880 0;
BA_ "VFrameFormat" BO_ 880 14;
BA_ "CANFD_BRS" BO_ 880 1;
BA_ "GenMsgCycleTime" BO_ 880 200;
BA_ "GenMsgCycleTimeFast" BO_ 880 0;
BA_ "GenMsgSendType" BO_ 880 0;
BA_ "VFrameFormat" BO_ 880 14;
BA_ "CANFD_BRS" BO_ 880 1;
BA_ "GenMsgCycleTime" BO_ 824 100;
BA_ "GenMsgCycleTimeFast" BO_ 824 0;
BA_ "GenMsgSendType" BO_ 824 0;
BA_ "VFrameFormat" BO_ 824 14;
BA_ "CANFD_BRS" BO_ 824 1;
BA_ "GenMsgCycleTime" BO_ 824 100;
BA_ "GenMsgCycleTimeFast" BO_ 824 0;
BA_ "GenMsgSendType" BO_ 824 0;
BA_ "VFrameFormat" BO_ 824 14;
BA_ "CANFD_BRS" BO_ 824 1;
BA_ "GenMsgCycleTime" BO_ 824 100;
BA_ "GenMsgCycleTimeFast" BO_ 824 0;
BA_ "GenMsgSendType" BO_ 824 0;
BA_ "VFrameFormat" BO_ 824 14;
BA_ "CANFD_BRS" BO_ 824 1;
BA_ "GenMsgCycleTime" BO_ 824 100;
BA_ "GenMsgCycleTimeFast" BO_ 824 0;
BA_ "GenMsgSendType" BO_ 824 0;
BA_ "VFrameFormat" BO_ 824 14;
BA_ "CANFD_BRS" BO_ 824 1;
BA_ "GenMsgCycleTime" BO_ 824 100;
BA_ "GenMsgCycleTimeFast" BO_ 824 0;
BA_ "GenMsgSendType" BO_ 824 0;
BA_ "VFrameFormat" BO_ 824 14;
BA_ "CANFD_BRS" BO_ 824 1;
BA_ "GenMsgCycleTime" BO_ 824 100;
BA_ "GenMsgCycleTimeFast" BO_ 824 0;
BA_ "GenMsgSendType" BO_ 824 0;
BA_ "VFrameFormat" BO_ 824 14;
BA_ "CANFD_BRS" BO_ 824 1;
BA_ "GenMsgCycleTime" BO_ 824 100;
BA_ "GenMsgCycleTimeFast" BO_ 824 0;
BA_ "GenMsgSendType" BO_ 824 0;
BA_ "VFrameFormat" BO_ 824 14;
BA_ "CANFD_BRS" BO_ 824 1;
BA_ "GenMsgCycleTime" BO_ 824 100;
BA_ "GenMsgCycleTimeFast" BO_ 824 0;
BA_ "GenMsgSendType" BO_ 824 0;
BA_ "VFrameFormat" BO_ 824 14;
BA_ "CANFD_BRS" BO_ 824 1;
BA_ "GenMsgCycleTime" BO_ 824 100;
BA_ "GenMsgCycleTimeFast" BO_ 824 0;
BA_ "GenMsgSendType" BO_ 824 0;
BA_ "VFrameFormat" BO_ 824 14;
BA_ "CANFD_BRS" BO_ 824 1;
BA_ "GenMsgCycleTime" BO_ 824 100;
BA_ "GenMsgCycleTimeFast" BO_ 824 0;
BA_ "GenMsgSendType" BO_ 824 0;
BA_ "VFrameFormat" BO_ 824 14;
BA_ "CANFD_BRS" BO_ 824 1;
BA_ "GenMsgCycleTime" BO_ 824 100;
BA_ "GenMsgCycleTimeFast" BO_ 824 0;
BA_ "GenMsgSendType" BO_ 824 0;
BA_ "VFrameFormat" BO_ 824 14;
BA_ "CANFD_BRS" BO_ 824 1;
BA_ "GenMsgCycleTime" BO_ 824 100;
BA_ "GenMsgCycleTimeFast" BO_ 824 0;
BA_ "GenMsgSendType" BO_ 824 0;
BA_ "VFrameFormat" BO_ 824 14;
BA_ "CANFD_BRS" BO_ 824 1;
BA_ "GenMsgCycleTime" BO_ 952 200;
BA_ "GenMsgCycleTimeFast" BO_ 952 0;
BA_ "GenMsgSendType" BO_ 952 0;
BA_ "VFrameFormat" BO_ 952 14;
BA_ "CANFD_BRS" BO_ 952 1;
BA_ "GenMsgCycleTime" BO_ 952 200;
BA_ "GenMsgCycleTimeFast" BO_ 952 0;
BA_ "GenMsgSendType" BO_ 952 0;
BA_ "VFrameFormat" BO_ 952 14;
BA_ "CANFD_BRS" BO_ 952 1;
BA_ "GenMsgCycleTime" BO_ 952 200;
BA_ "GenMsgCycleTimeFast" BO_ 952 0;
BA_ "GenMsgSendType" BO_ 952 0;
BA_ "VFrameFormat" BO_ 952 14;
BA_ "CANFD_BRS" BO_ 952 1;
BA_ "GenMsgCycleTime" BO_ 952 200;
BA_ "GenMsgCycleTimeFast" BO_ 952 0;
BA_ "GenMsgSendType" BO_ 952 0;
BA_ "VFrameFormat" BO_ 952 14;
BA_ "CANFD_BRS" BO_ 952 1;
BA_ "GenMsgCycleTime" BO_ 952 200;
BA_ "GenMsgCycleTimeFast" BO_ 952 0;
BA_ "GenMsgSendType" BO_ 952 0;
BA_ "VFrameFormat" BO_ 952 14;
BA_ "CANFD_BRS" BO_ 952 1;
BA_ "GenMsgCycleTime" BO_ 952 200;
BA_ "GenMsgCycleTimeFast" BO_ 952 0;
BA_ "GenMsgSendType" BO_ 952 0;
BA_ "VFrameFormat" BO_ 952 14;
BA_ "CANFD_BRS" BO_ 952 1;
BA_ "GenMsgCycleTime" BO_ 653 20;
BA_ "GenMsgCycleTimeFast" BO_ 653 0;
BA_ "GenMsgSendType" BO_ 653 0;
BA_ "VFrameFormat" BO_ 653 14;
BA_ "CANFD_BRS" BO_ 653 1;
BA_ "GenMsgCycleTime" BO_ 653 20;
BA_ "GenMsgCycleTimeFast" BO_ 653 0;
BA_ "GenMsgSendType" BO_ 653 0;
BA_ "VFrameFormat" BO_ 653 14;
BA_ "CANFD_BRS" BO_ 653 1;
BA_ "GenMsgCycleTime" BO_ 653 20;
BA_ "GenMsgCycleTimeFast" BO_ 653 0;
BA_ "GenMsgSendType" BO_ 653 0;
BA_ "VFrameFormat" BO_ 653 14;
BA_ "CANFD_BRS" BO_ 653 1;
BA_ "GenMsgCycleTime" BO_ 653 20;
BA_ "GenMsgCycleTimeFast" BO_ 653 0;
BA_ "GenMsgSendType" BO_ 653 0;
BA_ "VFrameFormat" BO_ 653 14;
BA_ "CANFD_BRS" BO_ 653 1;
BA_ "GenMsgCycleTime" BO_ 653 20;
BA_ "GenMsgCycleTimeFast" BO_ 653 0;
BA_ "GenMsgSendType" BO_ 653 0;
BA_ "VFrameFormat" BO_ 653 14;
BA_ "CANFD_BRS" BO_ 653 1;
BA_ "GenMsgCycleTime" BO_ 653 20;
BA_ "GenMsgCycleTimeFast" BO_ 653 0;
BA_ "GenMsgSendType" BO_ 653 0;
BA_ "VFrameFormat" BO_ 653 14;
BA_ "CANFD_BRS" BO_ 653 1;
BA_ "GenMsgCycleTime" BO_ 653 20;
BA_ "GenMsgCycleTimeFast" BO_ 653 0;
BA_ "GenMsgSendType" BO_ 653 0;
BA_ "VFrameFormat" BO_ 653 14;
BA_ "CANFD_BRS" BO_ 653 1;
BA_ "GenMsgCycleTime" BO_ 653 20;
BA_ "GenMsgCycleTimeFast" BO_ 653 0;
BA_ "GenMsgSendType" BO_ 653 0;
BA_ "VFrameFormat" BO_ 653 14;
BA_ "CANFD_BRS" BO_ 653 1;
BA_ "GenMsgCycleTime" BO_ 653 20;
BA_ "GenMsgCycleTimeFast" BO_ 653 0;
BA_ "GenMsgSendType" BO_ 653 0;
BA_ "VFrameFormat" BO_ 653 14;
BA_ "CANFD_BRS" BO_ 653 1;
BA_ "GenMsgCycleTime" BO_ 653 20;
BA_ "GenMsgCycleTimeFast" BO_ 653 0;
BA_ "GenMsgSendType" BO_ 653 0;
BA_ "VFrameFormat" BO_ 653 14;
BA_ "CANFD_BRS" BO_ 653 1;
BA_ "GenMsgCycleTime" BO_ 653 20;
BA_ "GenMsgCycleTimeFast" BO_ 653 0;
BA_ "GenMsgSendType" BO_ 653 0;
BA_ "VFrameFormat" BO_ 653 14;
BA_ "CANFD_BRS" BO_ 653 1;
BA_ "GenMsgCycleTime" BO_ 653 20;
BA_ "GenMsgCycleTimeFast" BO_ 653 0;
BA_ "GenMsgSendType" BO_ 653 0;
BA_ "VFrameFormat" BO_ 653 14;
BA_ "CANFD_BRS" BO_ 653 1;
BA_ "GenMsgCycleTime" BO_ 653 20;
BA_ "GenMsgCycleTimeFast" BO_ 653 0;
BA_ "GenMsgSendType" BO_ 653 0;
BA_ "VFrameFormat" BO_ 653 14;
BA_ "CANFD_BRS" BO_ 653 1;
BA_ "GenMsgCycleTime" BO_ 653 20;
BA_ "GenMsgCycleTimeFast" BO_ 653 0;
BA_ "GenMsgSendType" BO_ 653 0;
BA_ "VFrameFormat" BO_ 653 14;
BA_ "CANFD_BRS" BO_ 653 1;
BA_ "GenMsgCycleTime" BO_ 653 20;
BA_ "GenMsgCycleTimeFast" BO_ 653 0;
BA_ "GenMsgSendType" BO_ 653 0;
BA_ "VFrameFormat" BO_ 653 14;
BA_ "CANFD_BRS" BO_ 653 1;
BA_ "GenMsgCycleTime" BO_ 653 20;
BA_ "GenMsgCycleTimeFast" BO_ 653 0;
BA_ "GenMsgSendType" BO_ 653 0;
BA_ "VFrameFormat" BO_ 653 14;
BA_ "CANFD_BRS" BO_ 653 1;
BA_ "GenMsgCycleTime" BO_ 653 20;
BA_ "GenMsgCycleTimeFast" BO_ 653 0;
BA_ "GenMsgSendType" BO_ 653 0;
BA_ "VFrameFormat" BO_ 653 14;
BA_ "CANFD_BRS" BO_ 653 1;
BA_ "GenMsgCycleTime" BO_ 653 20;
BA_ "GenMsgCycleTimeFast" BO_ 653 0;
BA_ "GenMsgSendType" BO_ 653 0;
BA_ "VFrameFormat" BO_ 653 14;
BA_ "CANFD_BRS" BO_ 653 1;
BA_ "GenMsgCycleTime" BO_ 653 20;
BA_ "GenMsgCycleTimeFast" BO_ 653 0;
BA_ "GenMsgSendType" BO_ 653 0;
BA_ "VFrameFormat" BO_ 653 14;
BA_ "CANFD_BRS" BO_ 653 1;
BA_ "GenMsgCycleTime" BO_ 653 20;
BA_ "GenMsgCycleTimeFast" BO_ 653 0;
BA_ "GenMsgSendType" BO_ 653 0;
BA_ "VFrameFormat" BO_ 653 14;
BA_ "CANFD_BRS" BO_ 653 1;
BA_ "GenMsgCycleTime" BO_ 653 20;
BA_ "GenMsgCycleTimeFast" BO_ 653 0;
BA_ "GenMsgSendType" BO_ 653 0;
BA_ "VFrameFormat" BO_ 653 14;
BA_ "CANFD_BRS" BO_ 653 1;
BA_ "GenMsgCycleTime" BO_ 653 20;
BA_ "GenMsgCycleTimeFast" BO_ 653 0;
BA_ "GenMsgSendType" BO_ 653 0;
BA_ "VFrameFormat" BO_ 653 14;
BA_ "CANFD_BRS" BO_ 653 1;
BA_ "GenMsgCycleTime" BO_ 653 20;
BA_ "GenMsgCycleTimeFast" BO_ 653 0;
BA_ "GenMsgSendType" BO_ 653 0;
BA_ "VFrameFormat" BO_ 653 14;
BA_ "CANFD_BRS" BO_ 653 1;
BA_ "GenMsgCycleTime" BO_ 653 20;
BA_ "GenMsgCycleTimeFast" BO_ 653 0;
BA_ "GenMsgSendType" BO_ 653 0;
BA_ "VFrameFormat" BO_ 653 14;
BA_ "CANFD_BRS" BO_ 653 1;
BA_ "GenMsgCycleTime" BO_ 653 20;
BA_ "GenMsgCycleTimeFast" BO_ 653 0;
BA_ "GenMsgSendType" BO_ 653 0;
BA_ "VFrameFormat" BO_ 653 14;
BA_ "CANFD_BRS" BO_ 653 1;
BA_ "GenMsgCycleTime" BO_ 653 20;
BA_ "GenMsgCycleTimeFast" BO_ 653 0;
BA_ "GenMsgSendType" BO_ 653 0;
BA_ "VFrameFormat" BO_ 653 14;
BA_ "CANFD_BRS" BO_ 653 1;
BA_ "GenMsgCycleTime" BO_ 653 20;
BA_ "GenMsgCycleTimeFast" BO_ 653 0;
BA_ "GenMsgSendType" BO_ 653 0;
BA_ "VFrameFormat" BO_ 653 14;
BA_ "CANFD_BRS" BO_ 653 1;
BA_ "GenMsgCycleTime" BO_ 644 10;
BA_ "GenMsgCycleTimeFast" BO_ 644 0;
BA_ "GenMsgSendType" BO_ 644 0;
BA_ "VFrameFormat" BO_ 644 14;
BA_ "CANFD_BRS" BO_ 644 1;
BA_ "GenMsgCycleTime" BO_ 644 10;
BA_ "GenMsgCycleTimeFast" BO_ 644 0;
BA_ "GenMsgSendType" BO_ 644 0;
BA_ "VFrameFormat" BO_ 644 14;
BA_ "CANFD_BRS" BO_ 644 1;
BA_ "GenMsgCycleTime" BO_ 644 10;
BA_ "GenMsgCycleTimeFast" BO_ 644 0;
BA_ "GenMsgSendType" BO_ 644 0;
BA_ "VFrameFormat" BO_ 644 14;
BA_ "CANFD_BRS" BO_ 644 1;
BA_ "GenMsgCycleTime" BO_ 644 10;
BA_ "GenMsgCycleTimeFast" BO_ 644 0;
BA_ "GenMsgSendType" BO_ 644 0;
BA_ "VFrameFormat" BO_ 644 14;
BA_ "CANFD_BRS" BO_ 644 1;
BA_ "GenMsgCycleTime" BO_ 644 10;
BA_ "GenMsgCycleTimeFast" BO_ 644 0;
BA_ "GenMsgSendType" BO_ 644 0;
BA_ "VFrameFormat" BO_ 644 14;
BA_ "CANFD_BRS" BO_ 644 1;
BA_ "GenMsgCycleTime" BO_ 644 10;
BA_ "GenMsgCycleTimeFast" BO_ 644 0;
BA_ "GenMsgSendType" BO_ 644 0;
BA_ "VFrameFormat" BO_ 644 14;
BA_ "CANFD_BRS" BO_ 644 1;
BA_ "GenMsgCycleTime" BO_ 644 10;
BA_ "GenMsgCycleTimeFast" BO_ 644 0;
BA_ "GenMsgSendType" BO_ 644 0;
BA_ "VFrameFormat" BO_ 644 14;
BA_ "CANFD_BRS" BO_ 644 1;
BA_ "GenMsgCycleTime" BO_ 644 10;
BA_ "GenMsgCycleTimeFast" BO_ 644 0;
BA_ "GenMsgSendType" BO_ 644 0;
BA_ "VFrameFormat" BO_ 644 14;
BA_ "CANFD_BRS" BO_ 644 1;
BA_ "GenMsgCycleTime" BO_ 644 10;
BA_ "GenMsgCycleTimeFast" BO_ 644 0;
BA_ "GenMsgSendType" BO_ 644 0;
BA_ "VFrameFormat" BO_ 644 14;
BA_ "CANFD_BRS" BO_ 644 1;
BA_ "GenMsgCycleTime" BO_ 644 10;
BA_ "GenMsgCycleTimeFast" BO_ 644 0;
BA_ "GenMsgSendType" BO_ 644 0;
BA_ "VFrameFormat" BO_ 644 14;
BA_ "CANFD_BRS" BO_ 644 1;
BA_ "GenMsgCycleTime" BO_ 644 10;
BA_ "GenMsgCycleTimeFast" BO_ 644 0;
BA_ "GenMsgSendType" BO_ 644 0;
BA_ "VFrameFormat" BO_ 644 14;
BA_ "CANFD_BRS" BO_ 644 1;
BA_ "GenMsgCycleTime" BO_ 393 10;
BA_ "GenMsgCycleTimeFast" BO_ 393 0;
BA_ "GenMsgSendType" BO_ 393 0;
BA_ "VFrameFormat" BO_ 393 14;
BA_ "CANFD_BRS" BO_ 393 1;
BA_ "GenMsgCycleTime" BO_ 393 10;
BA_ "GenMsgCycleTimeFast" BO_ 393 0;
BA_ "GenMsgSendType" BO_ 393 0;
BA_ "VFrameFormat" BO_ 393 14;
BA_ "CANFD_BRS" BO_ 393 1;
BA_ "GenMsgCycleTime" BO_ 393 10;
BA_ "GenMsgCycleTimeFast" BO_ 393 0;
BA_ "GenMsgSendType" BO_ 393 0;
BA_ "VFrameFormat" BO_ 393 14;
BA_ "CANFD_BRS" BO_ 393 1;
BA_ "GenMsgCycleTime" BO_ 393 10;
BA_ "GenMsgCycleTimeFast" BO_ 393 0;
BA_ "GenMsgSendType" BO_ 393 0;
BA_ "VFrameFormat" BO_ 393 14;
BA_ "CANFD_BRS" BO_ 393 1;
BA_ "GenMsgCycleTime" BO_ 393 10;
BA_ "GenMsgCycleTimeFast" BO_ 393 0;
BA_ "GenMsgSendType" BO_ 393 0;
BA_ "VFrameFormat" BO_ 393 14;
BA_ "CANFD_BRS" BO_ 393 1;
BA_ "GenMsgCycleTime" BO_ 393 10;
BA_ "GenMsgCycleTimeFast" BO_ 393 0;
BA_ "GenMsgSendType" BO_ 393 0;
BA_ "VFrameFormat" BO_ 393 14;
BA_ "CANFD_BRS" BO_ 393 1;
BA_ "GenMsgCycleTime" BO_ 393 10;
BA_ "GenMsgCycleTimeFast" BO_ 393 0;
BA_ "GenMsgSendType" BO_ 393 0;
BA_ "VFrameFormat" BO_ 393 14;
BA_ "CANFD_BRS" BO_ 393 1;
BA_ "GenMsgCycleTime" BO_ 393 10;
BA_ "GenMsgCycleTimeFast" BO_ 393 0;
BA_ "GenMsgSendType" BO_ 393 0;
BA_ "VFrameFormat" BO_ 393 14;
BA_ "CANFD_BRS" BO_ 393 1;
BA_ "GenMsgCycleTime" BO_ 393 10;
BA_ "GenMsgCycleTimeFast" BO_ 393 0;
BA_ "GenMsgSendType" BO_ 393 0;
BA_ "VFrameFormat" BO_ 393 14;
BA_ "CANFD_BRS" BO_ 393 1;
BA_ "GenMsgCycleTime" BO_ 393 10;
BA_ "GenMsgCycleTimeFast" BO_ 393 0;
BA_ "GenMsgSendType" BO_ 393 0;
BA_ "VFrameFormat" BO_ 393 14;
BA_ "CANFD_BRS" BO_ 393 1;
BA_ "GenMsgCycleTime" BO_ 393 10;
BA_ "GenMsgCycleTimeFast" BO_ 393 0;
BA_ "GenMsgSendType" BO_ 393 0;
BA_ "VFrameFormat" BO_ 393 14;
BA_ "CANFD_BRS" BO_ 393 1;
BA_ "GenMsgCycleTime" BO_ 393 10;
BA_ "GenMsgCycleTimeFast" BO_ 393 0;
BA_ "GenMsgSendType" BO_ 393 0;
BA_ "VFrameFormat" BO_ 393 14;
BA_ "CANFD_BRS" BO_ 393 1;
BA_ "GenMsgCycleTime" BO_ 393 10;
BA_ "GenMsgCycleTimeFast" BO_ 393 0;
BA_ "GenMsgSendType" BO_ 393 0;
BA_ "VFrameFormat" BO_ 393 14;
BA_ "CANFD_BRS" BO_ 393 1;
BA_ "GenMsgCycleTime" BO_ 393 10;
BA_ "GenMsgCycleTimeFast" BO_ 393 0;
BA_ "GenMsgSendType" BO_ 393 0;
BA_ "VFrameFormat" BO_ 393 14;
BA_ "CANFD_BRS" BO_ 393 1;
BA_ "GenMsgCycleTime" BO_ 393 10;
BA_ "GenMsgCycleTimeFast" BO_ 393 0;
BA_ "GenMsgSendType" BO_ 393 0;
BA_ "VFrameFormat" BO_ 393 14;
BA_ "CANFD_BRS" BO_ 393 1;
BA_ "GenMsgCycleTime" BO_ 393 10;
BA_ "GenMsgCycleTimeFast" BO_ 393 0;
BA_ "GenMsgSendType" BO_ 393 0;
BA_ "VFrameFormat" BO_ 393 14;
BA_ "CANFD_BRS" BO_ 393 1;
BA_ "GenMsgCycleTime" BO_ 393 10;
BA_ "GenMsgCycleTimeFast" BO_ 393 0;
BA_ "GenMsgSendType" BO_ 393 0;
BA_ "VFrameFormat" BO_ 393 14;
BA_ "CANFD_BRS" BO_ 393 1;
BA_ "GenMsgCycleTime" BO_ 393 10;
BA_ "GenMsgCycleTimeFast" BO_ 393 0;
BA_ "GenMsgSendType" BO_ 393 0;
BA_ "VFrameFormat" BO_ 393 14;
BA_ "CANFD_BRS" BO_ 393 1;
BA_ "GenMsgCycleTime" BO_ 393 10;
BA_ "GenMsgCycleTimeFast" BO_ 393 0;
BA_ "GenMsgSendType" BO_ 393 0;
BA_ "VFrameFormat" BO_ 393 14;
BA_ "CANFD_BRS" BO_ 393 1;
BA_ "GenMsgCycleTime" BO_ 393 10;
BA_ "GenMsgCycleTimeFast" BO_ 393 0;
BA_ "GenMsgSendType" BO_ 393 0;
BA_ "VFrameFormat" BO_ 393 14;
BA_ "CANFD_BRS" BO_ 393 1;
BA_ "GenMsgCycleTime" BO_ 393 10;
BA_ "GenMsgCycleTimeFast" BO_ 393 0;
BA_ "GenMsgSendType" BO_ 393 0;
BA_ "VFrameFormat" BO_ 393 14;
BA_ "CANFD_BRS" BO_ 393 1;
BA_ "GenMsgCycleTime" BO_ 393 10;
BA_ "GenMsgCycleTimeFast" BO_ 393 0;
BA_ "GenMsgSendType" BO_ 393 0;
BA_ "VFrameFormat" BO_ 393 14;
BA_ "CANFD_BRS" BO_ 393 1;
BA_ "GenMsgCycleTime" BO_ 393 10;
BA_ "GenMsgCycleTimeFast" BO_ 393 0;
BA_ "GenMsgSendType" BO_ 393 0;
BA_ "VFrameFormat" BO_ 393 14;
BA_ "CANFD_BRS" BO_ 393 1;
BA_ "GenMsgCycleTime" BO_ 393 10;
BA_ "GenMsgCycleTimeFast" BO_ 393 0;
BA_ "GenMsgSendType" BO_ 393 0;
BA_ "VFrameFormat" BO_ 393 14;
BA_ "CANFD_BRS" BO_ 393 1;
BA_ "GenMsgCycleTime" BO_ 393 10;
BA_ "GenMsgCycleTimeFast" BO_ 393 0;
BA_ "GenMsgSendType" BO_ 393 0;
BA_ "VFrameFormat" BO_ 393 14;
BA_ "CANFD_BRS" BO_ 393 1;
BA_ "GenMsgCycleTime" BO_ 393 10;
BA_ "GenMsgCycleTimeFast" BO_ 393 0;
BA_ "GenMsgSendType" BO_ 393 0;
BA_ "VFrameFormat" BO_ 393 14;
BA_ "CANFD_BRS" BO_ 393 1;
BA_ "GenMsgCycleTime" BO_ 393 10;
BA_ "GenMsgCycleTimeFast" BO_ 393 0;
BA_ "GenMsgSendType" BO_ 393 0;
BA_ "VFrameFormat" BO_ 393 14;
BA_ "CANFD_BRS" BO_ 393 1;
BA_ "GenMsgCycleTime" BO_ 393 10;
BA_ "GenMsgCycleTimeFast" BO_ 393 0;
BA_ "GenMsgSendType" BO_ 393 0;
BA_ "VFrameFormat" BO_ 393 14;
BA_ "CANFD_BRS" BO_ 393 1;
BA_ "GenMsgCycleTime" BO_ 393 10;
BA_ "GenMsgCycleTimeFast" BO_ 393 0;
BA_ "GenMsgSendType" BO_ 393 0;
BA_ "VFrameFormat" BO_ 393 14;
BA_ "CANFD_BRS" BO_ 393 1;
BA_ "GenMsgCycleTime" BO_ 393 10;
BA_ "GenMsgCycleTimeFast" BO_ 393 0;
BA_ "GenMsgSendType" BO_ 393 0;
BA_ "VFrameFormat" BO_ 393 14;
BA_ "CANFD_BRS" BO_ 393 1;
BA_ "GenMsgCycleTime" BO_ 393 10;
BA_ "GenMsgCycleTimeFast" BO_ 393 0;
BA_ "GenMsgSendType" BO_ 393 0;
BA_ "VFrameFormat" BO_ 393 14;
BA_ "CANFD_BRS" BO_ 393 1;
BA_ "GenMsgCycleTime" BO_ 393 10;
BA_ "GenMsgCycleTimeFast" BO_ 393 0;
BA_ "GenMsgSendType" BO_ 393 0;
BA_ "VFrameFormat" BO_ 393 14;
BA_ "CANFD_BRS" BO_ 393 1;
BA_ "GenMsgCycleTime" BO_ 393 10;
BA_ "GenMsgCycleTimeFast" BO_ 393 0;
BA_ "GenMsgSendType" BO_ 393 0;
BA_ "VFrameFormat" BO_ 393 14;
BA_ "CANFD_BRS" BO_ 393 1;
BA_ "GenMsgCycleTime" BO_ 393 10;
BA_ "GenMsgCycleTimeFast" BO_ 393 0;
BA_ "GenMsgSendType" BO_ 393 0;
BA_ "VFrameFormat" BO_ 393 14;
BA_ "CANFD_BRS" BO_ 393 1;
BA_ "GenMsgCycleTime" BO_ 393 10;
BA_ "GenMsgCycleTimeFast" BO_ 393 0;
BA_ "GenMsgSendType" BO_ 393 0;
BA_ "VFrameFormat" BO_ 393 14;
BA_ "CANFD_BRS" BO_ 393 1;
BA_ "GenMsgCycleTime" BO_ 393 10;
BA_ "GenMsgCycleTimeFast" BO_ 393 0;
BA_ "GenMsgSendType" BO_ 393 0;
BA_ "VFrameFormat" BO_ 393 14;
BA_ "CANFD_BRS" BO_ 393 1;
BA_ "GenMsgCycleTime" BO_ 393 10;
BA_ "GenMsgCycleTimeFast" BO_ 393 0;
BA_ "GenMsgSendType" BO_ 393 0;
BA_ "VFrameFormat" BO_ 393 14;
BA_ "CANFD_BRS" BO_ 393 1;
BA_ "GenMsgCycleTime" BO_ 393 10;
BA_ "GenMsgCycleTimeFast" BO_ 393 0;
BA_ "GenMsgSendType" BO_ 393 0;
BA_ "VFrameFormat" BO_ 393 14;
BA_ "CANFD_BRS" BO_ 393 1;
BA_ "GenMsgCycleTime" BO_ 393 10;
BA_ "GenMsgCycleTimeFast" BO_ 393 0;
BA_ "GenMsgSendType" BO_ 393 0;
BA_ "VFrameFormat" BO_ 393 14;
BA_ "CANFD_BRS" BO_ 393 1;
BA_ "GenMsgCycleTime" BO_ 393 10;
BA_ "GenMsgCycleTimeFast" BO_ 393 0;
BA_ "GenMsgSendType" BO_ 393 0;
BA_ "VFrameFormat" BO_ 393 14;
BA_ "CANFD_BRS" BO_ 393 1;
BA_ "GenMsgCycleTime" BO_ 393 10;
BA_ "GenMsgCycleTimeFast" BO_ 393 0;
BA_ "GenMsgSendType" BO_ 393 0;
BA_ "VFrameFormat" BO_ 393 14;
BA_ "CANFD_BRS" BO_ 393 1;
BA_ "GenMsgCycleTime" BO_ 393 10;
BA_ "GenMsgCycleTimeFast" BO_ 393 0;
BA_ "GenMsgSendType" BO_ 393 0;
BA_ "VFrameFormat" BO_ 393 14;
BA_ "CANFD_BRS" BO_ 393 1;
BA_ "GenMsgCycleTime" BO_ 393 10;
BA_ "GenMsgCycleTimeFast" BO_ 393 0;
BA_ "GenMsgSendType" BO_ 393 0;
BA_ "VFrameFormat" BO_ 393 14;
BA_ "CANFD_BRS" BO_ 393 1;
BA_ "GenMsgCycleTime" BO_ 393 10;
BA_ "GenMsgCycleTimeFast" BO_ 393 0;
BA_ "GenMsgSendType" BO_ 393 0;
BA_ "VFrameFormat" BO_ 393 14;
BA_ "CANFD_BRS" BO_ 393 1;
BA_ "GenMsgCycleTime" BO_ 512 500;
BA_ "GenMsgCycleTimeFast" BO_ 512 40;
BA_ "GenMsgSendType" BO_ 512 3;
BA_ "VFrameFormat" BO_ 512 14;
BA_ "CANFD_BRS" BO_ 512 1;
BA_ "GenMsgCycleTime" BO_ 512 500;
BA_ "GenMsgCycleTimeFast" BO_ 512 40;
BA_ "GenMsgSendType" BO_ 512 3;
BA_ "VFrameFormat" BO_ 512 14;
BA_ "CANFD_BRS" BO_ 512 1;
BA_ "GenMsgCycleTime" BO_ 512 500;
BA_ "GenMsgCycleTimeFast" BO_ 512 40;
BA_ "GenMsgSendType" BO_ 512 3;
BA_ "VFrameFormat" BO_ 512 14;
BA_ "CANFD_BRS" BO_ 512 1;
BA_ "GenMsgCycleTime" BO_ 512 500;
BA_ "GenMsgCycleTimeFast" BO_ 512 40;
BA_ "GenMsgSendType" BO_ 512 3;
BA_ "VFrameFormat" BO_ 512 14;
BA_ "CANFD_BRS" BO_ 512 1;
BA_ "GenMsgCycleTime" BO_ 512 500;
BA_ "GenMsgCycleTimeFast" BO_ 512 40;
BA_ "GenMsgSendType" BO_ 512 3;
BA_ "VFrameFormat" BO_ 512 14;
BA_ "CANFD_BRS" BO_ 512 1;
BA_ "GenMsgCycleTime" BO_ 512 500;
BA_ "GenMsgCycleTimeFast" BO_ 512 40;
BA_ "GenMsgSendType" BO_ 512 3;
BA_ "VFrameFormat" BO_ 512 14;
BA_ "CANFD_BRS" BO_ 512 1;
BA_ "GenMsgCycleTime" BO_ 512 500;
BA_ "GenMsgCycleTimeFast" BO_ 512 40;
BA_ "GenMsgSendType" BO_ 512 3;
BA_ "VFrameFormat" BO_ 512 14;
BA_ "CANFD_BRS" BO_ 512 1;
BA_ "GenMsgCycleTime" BO_ 512 500;
BA_ "GenMsgCycleTimeFast" BO_ 512 40;
BA_ "GenMsgSendType" BO_ 512 3;
BA_ "VFrameFormat" BO_ 512 14;
BA_ "CANFD_BRS" BO_ 512 1;
BA_ "GenMsgCycleTime" BO_ 512 500;
BA_ "GenMsgCycleTimeFast" BO_ 512 40;
BA_ "GenMsgSendType" BO_ 512 3;
BA_ "VFrameFormat" BO_ 512 14;
BA_ "CANFD_BRS" BO_ 512 1;
BA_ "GenMsgCycleTime" BO_ 512 500;
BA_ "GenMsgCycleTimeFast" BO_ 512 40;
BA_ "GenMsgSendType" BO_ 512 3;
BA_ "VFrameFormat" BO_ 512 14;
BA_ "CANFD_BRS" BO_ 512 1;
BA_ "GenMsgCycleTime" BO_ 512 500;
BA_ "GenMsgCycleTimeFast" BO_ 512 40;
BA_ "GenMsgSendType" BO_ 512 3;
BA_ "VFrameFormat" BO_ 512 14;
BA_ "CANFD_BRS" BO_ 512 1;
BA_ "GenMsgCycleTime" BO_ 512 500;
BA_ "GenMsgCycleTimeFast" BO_ 512 40;
BA_ "GenMsgSendType" BO_ 512 3;
BA_ "VFrameFormat" BO_ 512 14;
BA_ "CANFD_BRS" BO_ 512 1;
BA_ "GenMsgCycleTime" BO_ 512 500;
BA_ "GenMsgCycleTimeFast" BO_ 512 40;
BA_ "GenMsgSendType" BO_ 512 3;
BA_ "VFrameFormat" BO_ 512 14;
BA_ "CANFD_BRS" BO_ 512 1;
BA_ "GenMsgCycleTime" BO_ 512 500;
BA_ "GenMsgCycleTimeFast" BO_ 512 40;
BA_ "GenMsgSendType" BO_ 512 3;
BA_ "VFrameFormat" BO_ 512 14;
BA_ "CANFD_BRS" BO_ 512 1;
BA_ "GenMsgCycleTime" BO_ 512 500;
BA_ "GenMsgCycleTimeFast" BO_ 512 40;
BA_ "GenMsgSendType" BO_ 512 3;
BA_ "VFrameFormat" BO_ 512 14;
BA_ "CANFD_BRS" BO_ 512 1;
BA_ "EventCommandSignal" SG_ 430 SRS_1_CRC_1 0;
BA_ "GatewayedSignals" SG_ 430 SRS_1_CRC_1 0;
BA_ "GenSigInactiveValue" SG_ 430 SRS_1_CRC_1 0;
BA_ "GenSigInvalidValue" SG_ 430 SRS_1_CRC_1 0;
BA_ "GenSigSendType" SG_ 430 SRS_1_CRC_1 1;
BA_ "GenSigStartValue" SG_ 430 SRS_1_CRC_1 0;
BA_ "GenSigTimeoutValue" SG_ 430 SRS_1_CRC_1 0;
BA_ "Remark" SG_ 430 SRS_1_CRC_1 "";
BA_ "EventCommandSignal" SG_ 430 SRS_1_Counter_1 0;
BA_ "GatewayedSignals" SG_ 430 SRS_1_Counter_1 0;
BA_ "GenSigInactiveValue" SG_ 430 SRS_1_Counter_1 0;
BA_ "GenSigInvalidValue" SG_ 430 SRS_1_Counter_1 0;
BA_ "GenSigSendType" SG_ 430 SRS_1_Counter_1 1;
BA_ "GenSigStartValue" SG_ 430 SRS_1_Counter_1 0;
BA_ "GenSigTimeoutValue" SG_ 430 SRS_1_Counter_1 0;
BA_ "Remark" SG_ 430 SRS_1_Counter_1 "";
BA_ "EventCommandSignal" SG_ 430 SRS_CrashOutputSt 0;
BA_ "GatewayedSignals" SG_ 430 SRS_CrashOutputSt 0;
BA_ "GenSigInactiveValue" SG_ 430 SRS_CrashOutputSt 0;
BA_ "GenSigInvalidValue" SG_ 430 SRS_CrashOutputSt 0;
BA_ "GenSigSendType" SG_ 430 SRS_CrashOutputSt 0;
BA_ "GenSigStartValue" SG_ 430 SRS_CrashOutputSt 0;
BA_ "GenSigTimeoutValue" SG_ 430 SRS_CrashOutputSt 0;
BA_ "Remark" SG_ 430 SRS_CrashOutputSt "";
BA_ "EventCommandSignal" SG_ 430 SRS_Front_CrashOutputSt 0;
BA_ "GatewayedSignals" SG_ 430 SRS_Front_CrashOutputSt 0;
BA_ "GenSigInactiveValue" SG_ 430 SRS_Front_CrashOutputSt 0;
BA_ "GenSigInvalidValue" SG_ 430 SRS_Front_CrashOutputSt 0;
BA_ "GenSigSendType" SG_ 430 SRS_Front_CrashOutputSt 0;
BA_ "GenSigStartValue" SG_ 430 SRS_Front_CrashOutputSt 0;
BA_ "GenSigTimeoutValue" SG_ 430 SRS_Front_CrashOutputSt 0;
BA_ "Remark" SG_ 430 SRS_Front_CrashOutputSt "";
BA_ "EventCommandSignal" SG_ 430 SRS_DriverSide_CrashOutputSt 0;
BA_ "GatewayedSignals" SG_ 430 SRS_DriverSide_CrashOutputSt 0;
BA_ "GenSigInactiveValue" SG_ 430 SRS_DriverSide_CrashOutputSt 0;
BA_ "GenSigInvalidValue" SG_ 430 SRS_DriverSide_CrashOutputSt 0;
BA_ "GenSigSendType" SG_ 430 SRS_DriverSide_CrashOutputSt 0;
BA_ "GenSigStartValue" SG_ 430 SRS_DriverSide_CrashOutputSt 0;
BA_ "GenSigTimeoutValue" SG_ 430 SRS_DriverSide_CrashOutputSt 0;
BA_ "Remark" SG_ 430 SRS_DriverSide_CrashOutputSt "";
BA_ "EventCommandSignal" SG_ 430 SRS_PassengerSide_CrashOutputSt 0;
BA_ "GatewayedSignals" SG_ 430 SRS_PassengerSide_CrashOutputSt 0;
BA_ "GenSigInactiveValue" SG_ 430 SRS_PassengerSide_CrashOutputSt 0;
BA_ "GenSigInvalidValue" SG_ 430 SRS_PassengerSide_CrashOutputSt 0;
BA_ "GenSigSendType" SG_ 430 SRS_PassengerSide_CrashOutputSt 0;
BA_ "GenSigStartValue" SG_ 430 SRS_PassengerSide_CrashOutputSt 0;
BA_ "GenSigTimeoutValue" SG_ 430 SRS_PassengerSide_CrashOutputSt 0;
BA_ "Remark" SG_ 430 SRS_PassengerSide_CrashOutputSt "";
BA_ "EventCommandSignal" SG_ 430 SRS_Rear_CrashOutputSt 0;
BA_ "GatewayedSignals" SG_ 430 SRS_Rear_CrashOutputSt 0;
BA_ "GenSigInactiveValue" SG_ 430 SRS_Rear_CrashOutputSt 0;
BA_ "GenSigInvalidValue" SG_ 430 SRS_Rear_CrashOutputSt 0;
BA_ "GenSigSendType" SG_ 430 SRS_Rear_CrashOutputSt 0;
BA_ "GenSigStartValue" SG_ 430 SRS_Rear_CrashOutputSt 0;
BA_ "GenSigTimeoutValue" SG_ 430 SRS_Rear_CrashOutputSt 0;
BA_ "Remark" SG_ 430 SRS_Rear_CrashOutputSt "";
BA_ "EventCommandSignal" SG_ 430 SRS_RolloverCrashOutputSt 0;
BA_ "GatewayedSignals" SG_ 430 SRS_RolloverCrashOutputSt 0;
BA_ "GenSigInactiveValue" SG_ 430 SRS_RolloverCrashOutputSt 0;
BA_ "GenSigInvalidValue" SG_ 430 SRS_RolloverCrashOutputSt 0;
BA_ "GenSigSendType" SG_ 430 SRS_RolloverCrashOutputSt 0;
BA_ "GenSigStartValue" SG_ 430 SRS_RolloverCrashOutputSt 0;
BA_ "GenSigTimeoutValue" SG_ 430 SRS_RolloverCrashOutputSt 0;
BA_ "Remark" SG_ 430 SRS_RolloverCrashOutputSt "";
BA_ "EventCommandSignal" SG_ 430 SRS_NearCrashOutputSt 0;
BA_ "GatewayedSignals" SG_ 430 SRS_NearCrashOutputSt 0;
BA_ "GenSigInactiveValue" SG_ 430 SRS_NearCrashOutputSt 0;
BA_ "GenSigInvalidValue" SG_ 430 SRS_NearCrashOutputSt 0;
BA_ "GenSigSendType" SG_ 430 SRS_NearCrashOutputSt 0;
BA_ "GenSigStartValue" SG_ 430 SRS_NearCrashOutputSt 0;
BA_ "GenSigTimeoutValue" SG_ 430 SRS_NearCrashOutputSt 0;
BA_ "Remark" SG_ 430 SRS_NearCrashOutputSt "";
BA_ "EventCommandSignal" SG_ 430 SRS_1_CRC_2 0;
BA_ "GatewayedSignals" SG_ 430 SRS_1_CRC_2 0;
BA_ "GenSigInactiveValue" SG_ 430 SRS_1_CRC_2 0;
BA_ "GenSigInvalidValue" SG_ 430 SRS_1_CRC_2 0;
BA_ "GenSigSendType" SG_ 430 SRS_1_CRC_2 1;
BA_ "GenSigStartValue" SG_ 430 SRS_1_CRC_2 0;
BA_ "GenSigTimeoutValue" SG_ 430 SRS_1_CRC_2 0;
BA_ "Remark" SG_ 430 SRS_1_CRC_2 "";
BA_ "EventCommandSignal" SG_ 430 SRS_1_Counter_2 0;
BA_ "GatewayedSignals" SG_ 430 SRS_1_Counter_2 0;
BA_ "GenSigInactiveValue" SG_ 430 SRS_1_Counter_2 0;
BA_ "GenSigInvalidValue" SG_ 430 SRS_1_Counter_2 0;
BA_ "GenSigSendType" SG_ 430 SRS_1_Counter_2 1;
BA_ "GenSigStartValue" SG_ 430 SRS_1_Counter_2 0;
BA_ "GenSigTimeoutValue" SG_ 430 SRS_1_Counter_2 0;
BA_ "Remark" SG_ 430 SRS_1_Counter_2 "";
BA_ "EventCommandSignal" SG_ 430 SRS_YawSnsCalibSt 0;
BA_ "GatewayedSignals" SG_ 430 SRS_YawSnsCalibSt 0;
BA_ "GenSigInactiveValue" SG_ 430 SRS_YawSnsCalibSt 0;
BA_ "GenSigInvalidValue" SG_ 430 SRS_YawSnsCalibSt 0;
BA_ "GenSigSendType" SG_ 430 SRS_YawSnsCalibSt 1;
BA_ "GenSigStartValue" SG_ 430 SRS_YawSnsCalibSt 0;
BA_ "GenSigTimeoutValue" SG_ 430 SRS_YawSnsCalibSt 0;
BA_ "Remark" SG_ 430 SRS_YawSnsCalibSt "";
BA_ "EventCommandSignal" SG_ 430 SRS_VehLongAccelVD 0;
BA_ "GatewayedSignals" SG_ 430 SRS_VehLongAccelVD 0;
BA_ "GenSigInactiveValue" SG_ 430 SRS_VehLongAccelVD 0;
BA_ "GenSigInvalidValue" SG_ 430 SRS_VehLongAccelVD 0;
BA_ "GenSigSendType" SG_ 430 SRS_VehLongAccelVD 1;
BA_ "GenSigStartValue" SG_ 430 SRS_VehLongAccelVD 0;
BA_ "GenSigTimeoutValue" SG_ 430 SRS_VehLongAccelVD 2;
BA_ "Remark" SG_ 430 SRS_VehLongAccelVD "";
BA_ "EventCommandSignal" SG_ 430 SRS_VehLatrlAccelVD 0;
BA_ "GatewayedSignals" SG_ 430 SRS_VehLatrlAccelVD 0;
BA_ "GenSigInactiveValue" SG_ 430 SRS_VehLatrlAccelVD 0;
BA_ "GenSigInvalidValue" SG_ 430 SRS_VehLatrlAccelVD 0;
BA_ "GenSigSendType" SG_ 430 SRS_VehLatrlAccelVD 1;
BA_ "GenSigStartValue" SG_ 430 SRS_VehLatrlAccelVD 0;
BA_ "GenSigTimeoutValue" SG_ 430 SRS_VehLatrlAccelVD 2;
BA_ "Remark" SG_ 430 SRS_VehLatrlAccelVD "";
BA_ "EventCommandSignal" SG_ 430 SRS_YawRateVD 0;
BA_ "GatewayedSignals" SG_ 430 SRS_YawRateVD 0;
BA_ "GenSigInactiveValue" SG_ 430 SRS_YawRateVD 0;
BA_ "GenSigInvalidValue" SG_ 430 SRS_YawRateVD 0;
BA_ "GenSigSendType" SG_ 430 SRS_YawRateVD 1;
BA_ "GenSigStartValue" SG_ 430 SRS_YawRateVD 0;
BA_ "GenSigTimeoutValue" SG_ 430 SRS_YawRateVD 2;
BA_ "Remark" SG_ 430 SRS_YawRateVD "";
BA_ "EventCommandSignal" SG_ 430 SRS_VehLongAccel 0;
BA_ "GatewayedSignals" SG_ 430 SRS_VehLongAccel 0;
BA_ "GenSigInactiveValue" SG_ 430 SRS_VehLongAccel 0;
BA_ "EventCommandSignal" SG_ 430 SRS_VehLatrlAccel 0;
BA_ "GatewayedSignals" SG_ 430 SRS_VehLatrlAccel 0;
BA_ "GenSigInactiveValue" SG_ 430 SRS_VehLatrlAccel 0;
BA_ "EventCommandSignal" SG_ 430 SRS_YawRate 0;
BA_ "GatewayedSignals" SG_ 430 SRS_YawRate 0;
BA_ "GenSigInactiveValue" SG_ 430 SRS_YawRate 0;
BA_ "EventCommandSignal" SG_ 939 SRS_PsngrSeatBeltSt 0;
BA_ "GatewayedSignals" SG_ 939 SRS_PsngrSeatBeltSt 0;
BA_ "GenSigInactiveValue" SG_ 939 SRS_PsngrSeatBeltSt 0;
BA_ "GenSigInvalidValue" SG_ 939 SRS_PsngrSeatBeltSt 3;
BA_ "GenSigSendType" SG_ 939 SRS_PsngrSeatBeltSt 1;
BA_ "GenSigStartValue" SG_ 939 SRS_PsngrSeatBeltSt 0;
BA_ "GenSigTimeoutValue" SG_ 939 SRS_PsngrSeatBeltSt 3;
BA_ "Remark" SG_ 939 SRS_PsngrSeatBeltSt "";
BA_ "EventCommandSignal" SG_ 939 SRS_DriverSeatBeltSt 0;
BA_ "GatewayedSignals" SG_ 939 SRS_DriverSeatBeltSt 0;
BA_ "GenSigInactiveValue" SG_ 939 SRS_DriverSeatBeltSt 0;
BA_ "GenSigInvalidValue" SG_ 939 SRS_DriverSeatBeltSt 3;
BA_ "GenSigSendType" SG_ 939 SRS_DriverSeatBeltSt 1;
BA_ "GenSigStartValue" SG_ 939 SRS_DriverSeatBeltSt 0;
BA_ "GenSigTimeoutValue" SG_ 939 SRS_DriverSeatBeltSt 3;
BA_ "Remark" SG_ 939 SRS_DriverSeatBeltSt "";
BA_ "EventCommandSignal" SG_ 939 SRS_RearLeftSeatBeltSt 0;
BA_ "GatewayedSignals" SG_ 939 SRS_RearLeftSeatBeltSt 0;
BA_ "GenSigInactiveValue" SG_ 939 SRS_RearLeftSeatBeltSt 0;
BA_ "GenSigInvalidValue" SG_ 939 SRS_RearLeftSeatBeltSt 3;
BA_ "GenSigSendType" SG_ 939 SRS_RearLeftSeatBeltSt 1;
BA_ "GenSigStartValue" SG_ 939 SRS_RearLeftSeatBeltSt 0;
BA_ "GenSigTimeoutValue" SG_ 939 SRS_RearLeftSeatBeltSt 3;
BA_ "Remark" SG_ 939 SRS_RearLeftSeatBeltSt "";
BA_ "EventCommandSignal" SG_ 939 SRS_AirbagFaultSt 0;
BA_ "GatewayedSignals" SG_ 939 SRS_AirbagFaultSt 0;
BA_ "GenSigInactiveValue" SG_ 939 SRS_AirbagFaultSt 0;
BA_ "GenSigInvalidValue" SG_ 939 SRS_AirbagFaultSt 0;
BA_ "GenSigSendType" SG_ 939 SRS_AirbagFaultSt 1;
BA_ "GenSigStartValue" SG_ 939 SRS_AirbagFaultSt 0;
BA_ "GenSigTimeoutValue" SG_ 939 SRS_AirbagFaultSt 1;
BA_ "Remark" SG_ 939 SRS_AirbagFaultSt "";
BA_ "EventCommandSignal" SG_ 939 SRS_RearRightSeatBeltSt 0;
BA_ "GatewayedSignals" SG_ 939 SRS_RearRightSeatBeltSt 0;
BA_ "GenSigInactiveValue" SG_ 939 SRS_RearRightSeatBeltSt 0;
BA_ "GenSigInvalidValue" SG_ 939 SRS_RearRightSeatBeltSt 3;
BA_ "GenSigSendType" SG_ 939 SRS_RearRightSeatBeltSt 1;
BA_ "GenSigStartValue" SG_ 939 SRS_RearRightSeatBeltSt 0;
BA_ "GenSigTimeoutValue" SG_ 939 SRS_RearRightSeatBeltSt 3;
BA_ "Remark" SG_ 939 SRS_RearRightSeatBeltSt "";
BA_ "EventCommandSignal" SG_ 939 SRS_RearMiddleSeatBeltSt 0;
BA_ "GatewayedSignals" SG_ 939 SRS_RearMiddleSeatBeltSt 0;
BA_ "GenSigInactiveValue" SG_ 939 SRS_RearMiddleSeatBeltSt 0;
BA_ "GenSigInvalidValue" SG_ 939 SRS_RearMiddleSeatBeltSt 3;
BA_ "GenSigSendType" SG_ 939 SRS_RearMiddleSeatBeltSt 1;
BA_ "GenSigStartValue" SG_ 939 SRS_RearMiddleSeatBeltSt 0;
BA_ "GenSigTimeoutValue" SG_ 939 SRS_RearMiddleSeatBeltSt 3;
BA_ "Remark" SG_ 939 SRS_RearMiddleSeatBeltSt "";
BA_ "EventCommandSignal" SG_ 363 EPS_1_CRC 0;
BA_ "GatewayedSignals" SG_ 363 EPS_1_CRC 0;
BA_ "GenSigInactiveValue" SG_ 363 EPS_1_CRC 0;
BA_ "GenSigInvalidValue" SG_ 363 EPS_1_CRC 0;
BA_ "GenSigSendType" SG_ 363 EPS_1_CRC 1;
BA_ "GenSigStartValue" SG_ 363 EPS_1_CRC 0;
BA_ "GenSigTimeoutValue" SG_ 363 EPS_1_CRC 0;
BA_ "Remark" SG_ 363 EPS_1_CRC "";
BA_ "EventCommandSignal" SG_ 363 EPS_1_Counter 0;
BA_ "GatewayedSignals" SG_ 363 EPS_1_Counter 0;
BA_ "GenSigInactiveValue" SG_ 363 EPS_1_Counter 0;
BA_ "GenSigInvalidValue" SG_ 363 EPS_1_Counter 0;
BA_ "GenSigSendType" SG_ 363 EPS_1_Counter 1;
BA_ "GenSigStartValue" SG_ 363 EPS_1_Counter 0;
BA_ "GenSigTimeoutValue" SG_ 363 EPS_1_Counter 0;
BA_ "Remark" SG_ 363 EPS_1_Counter "";
BA_ "EventCommandSignal" SG_ 363 EPS_StrngWhlTorqVD 0;
BA_ "GatewayedSignals" SG_ 363 EPS_StrngWhlTorqVD 0;
BA_ "GenSigInactiveValue" SG_ 363 EPS_StrngWhlTorqVD 0;
BA_ "GenSigInvalidValue" SG_ 363 EPS_StrngWhlTorqVD 0;
BA_ "GenSigSendType" SG_ 363 EPS_StrngWhlTorqVD 1;
BA_ "GenSigStartValue" SG_ 363 EPS_StrngWhlTorqVD 0;
BA_ "GenSigTimeoutValue" SG_ 363 EPS_StrngWhlTorqVD 0;
BA_ "Remark" SG_ 363 EPS_StrngWhlTorqVD "";
BA_ "EventCommandSignal" SG_ 363 EPS_StrngWhlTorq 0;
BA_ "GatewayedSignals" SG_ 363 EPS_StrngWhlTorq 0;
BA_ "GenSigInactiveValue" SG_ 363 EPS_StrngWhlTorq 0;
BA_ "GenSigInvalidValue" SG_ 363 EPS_StrngWhlTorq 4095;
BA_ "GenSigSendType" SG_ 363 EPS_StrngWhlTorq 1;
BA_ "GenSigStartValue" SG_ 363 EPS_StrngWhlTorq 1500;
BA_ "GenSigTimeoutValue" SG_ 363 EPS_StrngWhlTorq 4095;
BA_ "Remark" SG_ 363 EPS_StrngWhlTorq "";
BA_ "EventCommandSignal" SG_ 363 TAS_CalibratedSt 0;
BA_ "GatewayedSignals" SG_ 363 TAS_CalibratedSt 0;
BA_ "GenSigInactiveValue" SG_ 363 TAS_CalibratedSt 0;
BA_ "GenSigInvalidValue" SG_ 363 TAS_CalibratedSt 0;
BA_ "GenSigSendType" SG_ 363 TAS_CalibratedSt 1;
BA_ "GenSigStartValue" SG_ 363 TAS_CalibratedSt 0;
BA_ "GenSigTimeoutValue" SG_ 363 TAS_CalibratedSt 0;
BA_ "Remark" SG_ 363 TAS_CalibratedSt "";
BA_ "EventCommandSignal" SG_ 363 EPS_SteeringAngleSpdVD 0;
BA_ "GatewayedSignals" SG_ 363 EPS_SteeringAngleSpdVD 0;
BA_ "GenSigInactiveValue" SG_ 363 EPS_SteeringAngleSpdVD 0;
BA_ "GenSigInvalidValue" SG_ 363 EPS_SteeringAngleSpdVD 0;
BA_ "GenSigSendType" SG_ 363 EPS_SteeringAngleSpdVD 1;
BA_ "GenSigStartValue" SG_ 363 EPS_SteeringAngleSpdVD 0;
BA_ "GenSigTimeoutValue" SG_ 363 EPS_SteeringAngleSpdVD 0;
BA_ "Remark" SG_ 363 EPS_SteeringAngleSpdVD "";
BA_ "EventCommandSignal" SG_ 363 EPS_SteeringAngleSpd 0;
BA_ "GatewayedSignals" SG_ 363 EPS_SteeringAngleSpd 0;
BA_ "GenSigInactiveValue" SG_ 363 EPS_SteeringAngleSpd 0;
BA_ "GenSigInvalidValue" SG_ 363 EPS_SteeringAngleSpd 255;
BA_ "GenSigSendType" SG_ 363 EPS_SteeringAngleSpd 1;
BA_ "GenSigStartValue" SG_ 363 EPS_SteeringAngleSpd 0;
BA_ "GenSigTimeoutValue" SG_ 363 EPS_SteeringAngleSpd 255;
BA_ "Remark" SG_ 363 EPS_SteeringAngleSpd "";
BA_ "EventCommandSignal" SG_ 363 EPS_SteeringAngle 0;
BA_ "GatewayedSignals" SG_ 363 EPS_SteeringAngle 0;
BA_ "GenSigInactiveValue" SG_ 363 EPS_SteeringAngle 0;
BA_ "GenSigInvalidValue" SG_ 363 EPS_SteeringAngle 65535;
BA_ "GenSigSendType" SG_ 363 EPS_SteeringAngle 1;
BA_ "GenSigStartValue" SG_ 363 EPS_SteeringAngle 7800;
BA_ "GenSigTimeoutValue" SG_ 363 EPS_SteeringAngle 65535;
BA_ "Remark" SG_ 363 EPS_SteeringAngle "";
BA_ "EventCommandSignal" SG_ 363 EPS_SteeringAngleVD 0;
BA_ "GatewayedSignals" SG_ 363 EPS_SteeringAngleVD 0;
BA_ "GenSigInactiveValue" SG_ 363 EPS_SteeringAngleVD 0;
BA_ "GenSigInvalidValue" SG_ 363 EPS_SteeringAngleVD 0;
BA_ "GenSigSendType" SG_ 363 EPS_SteeringAngleVD 1;
BA_ "GenSigStartValue" SG_ 363 EPS_SteeringAngleVD 0;
BA_ "GenSigTimeoutValue" SG_ 363 EPS_SteeringAngleVD 0;
BA_ "Remark" SG_ 363 EPS_SteeringAngleVD "";
BA_ "EventCommandSignal" SG_ 363 EPS_ThermalSt 0;
BA_ "GatewayedSignals" SG_ 363 EPS_ThermalSt 0;
BA_ "GenSigInactiveValue" SG_ 363 EPS_ThermalSt 0;
BA_ "GenSigInvalidValue" SG_ 363 EPS_ThermalSt 0;
BA_ "GenSigSendType" SG_ 363 EPS_ThermalSt 1;
BA_ "GenSigStartValue" SG_ 363 EPS_ThermalSt 0;
BA_ "GenSigTimeoutValue" SG_ 363 EPS_ThermalSt 0;
BA_ "Remark" SG_ 363 EPS_ThermalSt "";
BA_ "EventCommandSignal" SG_ 363 EPS_VMCErrFeedback 0;
BA_ "GatewayedSignals" SG_ 363 EPS_VMCErrFeedback 0;
BA_ "GenSigInactiveValue" SG_ 363 EPS_VMCErrFeedback 0;
BA_ "GenSigInvalidValue" SG_ 363 EPS_VMCErrFeedback 0;
BA_ "GenSigSendType" SG_ 363 EPS_VMCErrFeedback 1;
BA_ "GenSigStartValue" SG_ 363 EPS_VMCErrFeedback 0;
BA_ "GenSigTimeoutValue" SG_ 363 EPS_VMCErrFeedback 0;
BA_ "Remark" SG_ 363 EPS_VMCErrFeedback "";
BA_ "EventCommandSignal" SG_ 363 EPS_PstOverlaySt_SideA 0;
BA_ "GatewayedSignals" SG_ 363 EPS_PstOverlaySt_SideA 0;
BA_ "GenSigInactiveValue" SG_ 363 EPS_PstOverlaySt_SideA 0;
BA_ "GenSigInvalidValue" SG_ 363 EPS_PstOverlaySt_SideA 0;
BA_ "GenSigSendType" SG_ 363 EPS_PstOverlaySt_SideA 1;
BA_ "GenSigStartValue" SG_ 363 EPS_PstOverlaySt_SideA 0;
BA_ "GenSigTimeoutValue" SG_ 363 EPS_PstOverlaySt_SideA 0;
BA_ "Remark" SG_ 363 EPS_PstOverlaySt_SideA "";
BA_ "EventCommandSignal" SG_ 363 EPS_PstOverlaySt_SideB 0;
BA_ "GatewayedSignals" SG_ 363 EPS_PstOverlaySt_SideB 0;
BA_ "GenSigInactiveValue" SG_ 363 EPS_PstOverlaySt_SideB 0;
BA_ "GenSigInvalidValue" SG_ 363 EPS_PstOverlaySt_SideB 0;
BA_ "GenSigSendType" SG_ 363 EPS_PstOverlaySt_SideB 1;
BA_ "GenSigStartValue" SG_ 363 EPS_PstOverlaySt_SideB 0;
BA_ "GenSigTimeoutValue" SG_ 363 EPS_PstOverlaySt_SideB 0;
BA_ "Remark" SG_ 363 EPS_PstOverlaySt_SideB "";
BA_ "EventCommandSignal" SG_ 363 EPS_HealthySt_SideA 0;
BA_ "GatewayedSignals" SG_ 363 EPS_HealthySt_SideA 0;
BA_ "GenSigInactiveValue" SG_ 363 EPS_HealthySt_SideA 0;
BA_ "GenSigInvalidValue" SG_ 363 EPS_HealthySt_SideA 0;
BA_ "GenSigSendType" SG_ 363 EPS_HealthySt_SideA 1;
BA_ "GenSigStartValue" SG_ 363 EPS_HealthySt_SideA 0;
BA_ "GenSigTimeoutValue" SG_ 363 EPS_HealthySt_SideA 0;
BA_ "Remark" SG_ 363 EPS_HealthySt_SideA "";
BA_ "EventCommandSignal" SG_ 363 EPS_HealthySt_SideB 0;
BA_ "GatewayedSignals" SG_ 363 EPS_HealthySt_SideB 0;
BA_ "GenSigInactiveValue" SG_ 363 EPS_HealthySt_SideB 0;
BA_ "GenSigInvalidValue" SG_ 363 EPS_HealthySt_SideB 0;
BA_ "GenSigSendType" SG_ 363 EPS_HealthySt_SideB 1;
BA_ "GenSigStartValue" SG_ 363 EPS_HealthySt_SideB 0;
BA_ "GenSigTimeoutValue" SG_ 363 EPS_HealthySt_SideB 0;
BA_ "Remark" SG_ 363 EPS_HealthySt_SideB "";
BA_ "EventCommandSignal" SG_ 363 EPS_PstOverlaySt 0;
BA_ "GatewayedSignals" SG_ 363 EPS_PstOverlaySt 0;
BA_ "GenSigInactiveValue" SG_ 363 EPS_PstOverlaySt 0;
BA_ "GenSigInvalidValue" SG_ 363 EPS_PstOverlaySt 0;
BA_ "GenSigSendType" SG_ 363 EPS_PstOverlaySt 1;
BA_ "GenSigStartValue" SG_ 363 EPS_PstOverlaySt 0;
BA_ "GenSigTimeoutValue" SG_ 363 EPS_PstOverlaySt 0;
BA_ "Remark" SG_ 363 EPS_PstOverlaySt "";
BA_ "EventCommandSignal" SG_ 363 EPS_HealthySt_DualSide 0;
BA_ "GatewayedSignals" SG_ 363 EPS_HealthySt_DualSide 0;
BA_ "GenSigInactiveValue" SG_ 363 EPS_HealthySt_DualSide 0;
BA_ "GenSigInvalidValue" SG_ 363 EPS_HealthySt_DualSide 0;
BA_ "GenSigSendType" SG_ 363 EPS_HealthySt_DualSide 1;
BA_ "GenSigStartValue" SG_ 363 EPS_HealthySt_DualSide 0;
BA_ "GenSigTimeoutValue" SG_ 363 EPS_HealthySt_DualSide 0;
BA_ "Remark" SG_ 363 EPS_HealthySt_DualSide "";
BA_ "EventCommandSignal" SG_ 363 EPS_PstOverLayRdntSt 0;
BA_ "GatewayedSignals" SG_ 363 EPS_PstOverLayRdntSt 0;
BA_ "GenSigInactiveValue" SG_ 363 EPS_PstOverLayRdntSt 0;
BA_ "GenSigInvalidValue" SG_ 363 EPS_PstOverLayRdntSt 0;
BA_ "GenSigSendType" SG_ 363 EPS_PstOverLayRdntSt 1;
BA_ "GenSigStartValue" SG_ 363 EPS_PstOverLayRdntSt 0;
BA_ "GenSigTimeoutValue" SG_ 363 EPS_PstOverLayRdntSt 0;
BA_ "Remark" SG_ 363 EPS_PstOverLayRdntSt "";
BA_ "EventCommandSignal" SG_ 363 EPS_VibrationWarnSt_A 0;
BA_ "GatewayedSignals" SG_ 363 EPS_VibrationWarnSt_A 0;
BA_ "GenSigInactiveValue" SG_ 363 EPS_VibrationWarnSt_A 0;
BA_ "GenSigInvalidValue" SG_ 363 EPS_VibrationWarnSt_A 0;
BA_ "GenSigSendType" SG_ 363 EPS_VibrationWarnSt_A 1;
BA_ "GenSigStartValue" SG_ 363 EPS_VibrationWarnSt_A 0;
BA_ "GenSigTimeoutValue" SG_ 363 EPS_VibrationWarnSt_A 0;
BA_ "Remark" SG_ 363 EPS_VibrationWarnSt_A "";
BA_ "EventCommandSignal" SG_ 363 SAC_ErrFeedback_SideA 0;
BA_ "GatewayedSignals" SG_ 363 SAC_ErrFeedback_SideA 0;
BA_ "GenSigInactiveValue" SG_ 363 SAC_ErrFeedback_SideA 0;
BA_ "GenSigInvalidValue" SG_ 363 SAC_ErrFeedback_SideA 0;
BA_ "GenSigSendType" SG_ 363 SAC_ErrFeedback_SideA 1;
BA_ "GenSigStartValue" SG_ 363 SAC_ErrFeedback_SideA 0;
BA_ "GenSigTimeoutValue" SG_ 363 SAC_ErrFeedback_SideA 0;
BA_ "Remark" SG_ 363 SAC_ErrFeedback_SideA "";
BA_ "EventCommandSignal" SG_ 363 SAC_ErrFeedback_SideB 0;
BA_ "GatewayedSignals" SG_ 363 SAC_ErrFeedback_SideB 0;
BA_ "GenSigInactiveValue" SG_ 363 SAC_ErrFeedback_SideB 0;
BA_ "GenSigInvalidValue" SG_ 363 SAC_ErrFeedback_SideB 0;
BA_ "GenSigSendType" SG_ 363 SAC_ErrFeedback_SideB 1;
BA_ "GenSigStartValue" SG_ 363 SAC_ErrFeedback_SideB 0;
BA_ "GenSigTimeoutValue" SG_ 363 SAC_ErrFeedback_SideB 0;
BA_ "Remark" SG_ 363 SAC_ErrFeedback_SideB "";
BA_ "EventCommandSignal" SG_ 363 EPS_ADASTargetAngle 0;
BA_ "GatewayedSignals" SG_ 363 EPS_ADASTargetAngle 0;
BA_ "GenSigInactiveValue" SG_ 363 EPS_ADASTargetAngle 0;
BA_ "GenSigInvalidValue" SG_ 363 EPS_ADASTargetAngle 0;
BA_ "GenSigSendType" SG_ 363 EPS_ADASTargetAngle 1;
BA_ "GenSigStartValue" SG_ 363 EPS_ADASTargetAngle 7800;
BA_ "GenSigTimeoutValue" SG_ 363 EPS_ADASTargetAngle 7800;
BA_ "Remark" SG_ 363 EPS_ADASTargetAngle "";
BA_ "EventCommandSignal" SG_ 363 EPS_FunctionStyleSt 0;
BA_ "GatewayedSignals" SG_ 363 EPS_FunctionStyleSt 0;
BA_ "GenSigInactiveValue" SG_ 363 EPS_FunctionStyleSt 0;
BA_ "GenSigInvalidValue" SG_ 363 EPS_FunctionStyleSt 0;
BA_ "GenSigSendType" SG_ 363 EPS_FunctionStyleSt 1;
BA_ "GenSigStartValue" SG_ 363 EPS_FunctionStyleSt 0;
BA_ "GenSigTimeoutValue" SG_ 363 EPS_FunctionStyleSt 0;
BA_ "Remark" SG_ 363 EPS_FunctionStyleSt "";
BA_ "EventCommandSignal" SG_ 363 EPS_SteeringModeSt 0;
BA_ "GatewayedSignals" SG_ 363 EPS_SteeringModeSt 0;
BA_ "GenSigInactiveValue" SG_ 363 EPS_SteeringModeSt 0;
BA_ "GenSigInvalidValue" SG_ 363 EPS_SteeringModeSt 0;
BA_ "GenSigSendType" SG_ 363 EPS_SteeringModeSt 1;
BA_ "GenSigStartValue" SG_ 363 EPS_SteeringModeSt 0;
BA_ "GenSigTimeoutValue" SG_ 363 EPS_SteeringModeSt 0;
BA_ "Remark" SG_ 363 EPS_SteeringModeSt "";
BA_ "EventCommandSignal" SG_ 363 EPS_ActEffectiveChannel 0;
BA_ "GatewayedSignals" SG_ 363 EPS_ActEffectiveChannel 0;
BA_ "GenSigInactiveValue" SG_ 363 EPS_ActEffectiveChannel 0;
BA_ "GenSigInvalidValue" SG_ 363 EPS_ActEffectiveChannel 0;
BA_ "GenSigSendType" SG_ 363 EPS_ActEffectiveChannel 1;
BA_ "GenSigStartValue" SG_ 363 EPS_ActEffectiveChannel 0;
BA_ "GenSigTimeoutValue" SG_ 363 EPS_ActEffectiveChannel 0;
BA_ "Remark" SG_ 363 EPS_ActEffectiveChannel "";
BA_ "EventCommandSignal" SG_ 363 EPS_ReqAngOverRange 0;
BA_ "GatewayedSignals" SG_ 363 EPS_ReqAngOverRange 0;
BA_ "GenSigInactiveValue" SG_ 363 EPS_ReqAngOverRange 0;
BA_ "GenSigInvalidValue" SG_ 363 EPS_ReqAngOverRange 0;
BA_ "GenSigSendType" SG_ 363 EPS_ReqAngOverRange 1;
BA_ "GenSigStartValue" SG_ 363 EPS_ReqAngOverRange 0;
BA_ "GenSigTimeoutValue" SG_ 363 EPS_ReqAngOverRange 0;
BA_ "Remark" SG_ 363 EPS_ReqAngOverRange "";
BA_ "EventCommandSignal" SG_ 363 EPS_SACMotorTorAct 0;
BA_ "GatewayedSignals" SG_ 363 EPS_SACMotorTorAct 0;
BA_ "GenSigInactiveValue" SG_ 363 EPS_SACMotorTorAct 0;
BA_ "GenSigInvalidValue" SG_ 363 EPS_SACMotorTorAct 0;
BA_ "GenSigSendType" SG_ 363 EPS_SACMotorTorAct 1;
BA_ "GenSigStartValue" SG_ 363 EPS_SACMotorTorAct 600;
BA_ "GenSigTimeoutValue" SG_ 363 EPS_SACMotorTorAct 600;
BA_ "Remark" SG_ 363 EPS_SACMotorTorAct "";
BA_ "EventCommandSignal" SG_ 363 EPS_SACMotorTorLimInt 0;
BA_ "GatewayedSignals" SG_ 363 EPS_SACMotorTorLimInt 0;
BA_ "GenSigInactiveValue" SG_ 363 EPS_SACMotorTorLimInt 0;
BA_ "GenSigInvalidValue" SG_ 363 EPS_SACMotorTorLimInt 2047;
BA_ "GenSigSendType" SG_ 363 EPS_SACMotorTorLimInt 1;
BA_ "GenSigStartValue" SG_ 363 EPS_SACMotorTorLimInt 0;
BA_ "GenSigTimeoutValue" SG_ 363 EPS_SACMotorTorLimInt 2047;
BA_ "Remark" SG_ 363 EPS_SACMotorTorLimInt "";
BA_ "EventCommandSignal" SG_ 363 EPS_ReqAngSpdOverRange 0;
BA_ "GatewayedSignals" SG_ 363 EPS_ReqAngSpdOverRange 0;
BA_ "GenSigInactiveValue" SG_ 363 EPS_ReqAngSpdOverRange 0;
BA_ "GenSigInvalidValue" SG_ 363 EPS_ReqAngSpdOverRange 0;
BA_ "GenSigSendType" SG_ 363 EPS_ReqAngSpdOverRange 1;
BA_ "GenSigStartValue" SG_ 363 EPS_ReqAngSpdOverRange 0;
BA_ "GenSigTimeoutValue" SG_ 363 EPS_ReqAngSpdOverRange 0;
BA_ "Remark" SG_ 363 EPS_ReqAngSpdOverRange "";
BA_ "EventCommandSignal" SG_ 363 EPS_AssistPraSwitchToLKA 0;
BA_ "GatewayedSignals" SG_ 363 EPS_AssistPraSwitchToLKA 0;
BA_ "GenSigInactiveValue" SG_ 363 EPS_AssistPraSwitchToLKA 0;
BA_ "GenSigInvalidValue" SG_ 363 EPS_AssistPraSwitchToLKA 0;
BA_ "GenSigSendType" SG_ 363 EPS_AssistPraSwitchToLKA 1;
BA_ "GenSigStartValue" SG_ 363 EPS_AssistPraSwitchToLKA 0;
BA_ "GenSigTimeoutValue" SG_ 363 EPS_AssistPraSwitchToLKA 0;
BA_ "Remark" SG_ 363 EPS_AssistPraSwitchToLKA "";
BA_ "EventCommandSignal" SG_ 363 EPS_SteerGainEnable 0;
BA_ "GatewayedSignals" SG_ 363 EPS_SteerGainEnable 0;
BA_ "GenSigInactiveValue" SG_ 363 EPS_SteerGainEnable 0;
BA_ "GenSigInvalidValue" SG_ 363 EPS_SteerGainEnable 0;
BA_ "GenSigSendType" SG_ 363 EPS_SteerGainEnable 1;
BA_ "GenSigStartValue" SG_ 363 EPS_SteerGainEnable 0;
BA_ "GenSigTimeoutValue" SG_ 363 EPS_SteerGainEnable 0;
BA_ "Remark" SG_ 363 EPS_SteerGainEnable "";
BA_ "EventCommandSignal" SG_ 363 EPS_EmSteerEnbale 0;
BA_ "GatewayedSignals" SG_ 363 EPS_EmSteerEnbale 0;
BA_ "GenSigInactiveValue" SG_ 363 EPS_EmSteerEnbale 0;
BA_ "GenSigInvalidValue" SG_ 363 EPS_EmSteerEnbale 0;
BA_ "GenSigSendType" SG_ 363 EPS_EmSteerEnbale 1;
BA_ "GenSigStartValue" SG_ 363 EPS_EmSteerEnbale 0;
BA_ "GenSigTimeoutValue" SG_ 363 EPS_EmSteerEnbale 0;
BA_ "Remark" SG_ 363 EPS_EmSteerEnbale "";
BA_ "EventCommandSignal" SG_ 363 EPS_SG_ErrFeedback 0;
BA_ "GatewayedSignals" SG_ 363 EPS_SG_ErrFeedback 0;
BA_ "GenSigInactiveValue" SG_ 363 EPS_SG_ErrFeedback 0;
BA_ "GenSigInvalidValue" SG_ 363 EPS_SG_ErrFeedback 0;
BA_ "GenSigSendType" SG_ 363 EPS_SG_ErrFeedback 1;
BA_ "GenSigStartValue" SG_ 363 EPS_SG_ErrFeedback 0;
BA_ "GenSigTimeoutValue" SG_ 363 EPS_SG_ErrFeedback 0;
BA_ "Remark" SG_ 363 EPS_SG_ErrFeedback "";
BA_ "EventCommandSignal" SG_ 363 EPS_EM_ErrFeedback 0;
BA_ "GatewayedSignals" SG_ 363 EPS_EM_ErrFeedback 0;
BA_ "GenSigInactiveValue" SG_ 363 EPS_EM_ErrFeedback 0;
BA_ "GenSigInvalidValue" SG_ 363 EPS_EM_ErrFeedback 0;
BA_ "GenSigSendType" SG_ 363 EPS_EM_ErrFeedback 1;
BA_ "GenSigStartValue" SG_ 363 EPS_EM_ErrFeedback 0;
BA_ "GenSigTimeoutValue" SG_ 363 EPS_EM_ErrFeedback 0;
BA_ "Remark" SG_ 363 EPS_EM_ErrFeedback "";
BA_ "EventCommandSignal" SG_ 363 EPS_VW_ErrFeedback 0;
BA_ "GatewayedSignals" SG_ 363 EPS_VW_ErrFeedback 0;
BA_ "GenSigInactiveValue" SG_ 363 EPS_VW_ErrFeedback 0;
BA_ "GenSigInvalidValue" SG_ 363 EPS_VW_ErrFeedback 0;
BA_ "GenSigSendType" SG_ 363 EPS_VW_ErrFeedback 1;
BA_ "GenSigStartValue" SG_ 363 EPS_VW_ErrFeedback 0;
BA_ "GenSigTimeoutValue" SG_ 363 EPS_VW_ErrFeedback 0;
BA_ "Remark" SG_ 363 EPS_VW_ErrFeedback "";
BA_ "EventCommandSignal" SG_ 363 EPS_AngReqForIFCSt 0;
BA_ "GatewayedSignals" SG_ 363 EPS_AngReqForIFCSt 0;
BA_ "GenSigInactiveValue" SG_ 363 EPS_AngReqForIFCSt 0;
BA_ "GenSigInvalidValue" SG_ 363 EPS_AngReqForIFCSt 0;
BA_ "GenSigSendType" SG_ 363 EPS_AngReqForIFCSt 1;
BA_ "GenSigStartValue" SG_ 363 EPS_AngReqForIFCSt 0;
BA_ "GenSigTimeoutValue" SG_ 363 EPS_AngReqForIFCSt 0;
BA_ "Remark" SG_ 363 EPS_AngReqForIFCSt "";
BA_ "EventCommandSignal" SG_ 363 EPS_SACMotorTorActMot 0;
BA_ "GatewayedSignals" SG_ 363 EPS_SACMotorTorActMot 0;
BA_ "GenSigInactiveValue" SG_ 363 EPS_SACMotorTorActMot 0;
BA_ "GenSigInvalidValue" SG_ 363 EPS_SACMotorTorActMot 0;
BA_ "GenSigSendType" SG_ 363 EPS_SACMotorTorActMot 1;
BA_ "GenSigStartValue" SG_ 363 EPS_SACMotorTorActMot 600;
BA_ "GenSigTimeoutValue" SG_ 363 EPS_SACMotorTorActMot 600;
BA_ "Remark" SG_ 363 EPS_SACMotorTorActMot "";
BA_ "EventCommandSignal" SG_ 363 EPS_SACMotorTorLimIntMot 0;
BA_ "GatewayedSignals" SG_ 363 EPS_SACMotorTorLimIntMot 0;
BA_ "GenSigInactiveValue" SG_ 363 EPS_SACMotorTorLimIntMot 0;
BA_ "GenSigInvalidValue" SG_ 363 EPS_SACMotorTorLimIntMot 2047;
BA_ "GenSigSendType" SG_ 363 EPS_SACMotorTorLimIntMot 1;
BA_ "GenSigStartValue" SG_ 363 EPS_SACMotorTorLimIntMot 0;
BA_ "GenSigTimeoutValue" SG_ 363 EPS_SACMotorTorLimIntMot 2047;
BA_ "Remark" SG_ 363 EPS_SACMotorTorLimIntMot "";
BA_ "EventCommandSignal" SG_ 363 EPS_SG_ActualLevel 0;
BA_ "GatewayedSignals" SG_ 363 EPS_SG_ActualLevel 0;
BA_ "GenSigInactiveValue" SG_ 363 EPS_SG_ActualLevel 0;
BA_ "GenSigInvalidValue" SG_ 363 EPS_SG_ActualLevel 255;
BA_ "GenSigSendType" SG_ 363 EPS_SG_ActualLevel 1;
BA_ "GenSigStartValue" SG_ 363 EPS_SG_ActualLevel 100;
BA_ "GenSigTimeoutValue" SG_ 363 EPS_SG_ActualLevel 0;
BA_ "Remark" SG_ 363 EPS_SG_ActualLevel "";
BA_ "EventCommandSignal" SG_ 363 EPS_MotorTorSum 0;
BA_ "GatewayedSignals" SG_ 363 EPS_MotorTorSum 0;
BA_ "GenSigInactiveValue" SG_ 363 EPS_MotorTorSum 0;
BA_ "GenSigInvalidValue" SG_ 363 EPS_MotorTorSum 0;
BA_ "GenSigSendType" SG_ 363 EPS_MotorTorSum 1;
BA_ "GenSigStartValue" SG_ 363 EPS_MotorTorSum 600;
BA_ "GenSigTimeoutValue" SG_ 363 EPS_MotorTorSum 600;
BA_ "Remark" SG_ 363 EPS_MotorTorSum "";
BA_ "EventCommandSignal" SG_ 363 EPS_WarnLamp 0;
BA_ "GatewayedSignals" SG_ 363 EPS_WarnLamp 0;
BA_ "GenSigInactiveValue" SG_ 363 EPS_WarnLamp 0;
BA_ "GenSigInvalidValue" SG_ 363 EPS_WarnLamp 0;
BA_ "GenSigSendType" SG_ 363 EPS_WarnLamp 1;
BA_ "GenSigStartValue" SG_ 363 EPS_WarnLamp 0;
BA_ "GenSigTimeoutValue" SG_ 363 EPS_WarnLamp 2;
BA_ "Remark" SG_ 363 EPS_WarnLamp "";
BA_ "EventCommandSignal" SG_ 363 EPS_AssistPercentage 0;
BA_ "GatewayedSignals" SG_ 363 EPS_AssistPercentage 0;
BA_ "GenSigInactiveValue" SG_ 363 EPS_AssistPercentage 0;
BA_ "GenSigInvalidValue" SG_ 363 EPS_AssistPercentage 0;
BA_ "GenSigSendType" SG_ 363 EPS_AssistPercentage 1;
BA_ "GenSigStartValue" SG_ 363 EPS_AssistPercentage 0;
BA_ "GenSigTimeoutValue" SG_ 363 EPS_AssistPercentage 0;
BA_ "Remark" SG_ 363 EPS_AssistPercentage "";
BA_ "EventCommandSignal" SG_ 363 EPS_AssistRatio 0;
BA_ "GatewayedSignals" SG_ 363 EPS_AssistRatio 0;
BA_ "GenSigInactiveValue" SG_ 363 EPS_AssistRatio 0;
BA_ "GenSigInvalidValue" SG_ 363 EPS_AssistRatio 50;
BA_ "GenSigSendType" SG_ 363 EPS_AssistRatio 1;
BA_ "GenSigStartValue" SG_ 363 EPS_AssistRatio 50;
BA_ "GenSigTimeoutValue" SG_ 363 EPS_AssistRatio 0;
BA_ "Remark" SG_ 363 EPS_AssistRatio "AY项目不发";
BA_ "EventCommandSignal" SG_ 363 EPS_SteeringWhlTorFlt 0;
BA_ "GatewayedSignals" SG_ 363 EPS_SteeringWhlTorFlt 0;
BA_ "GenSigInactiveValue" SG_ 363 EPS_SteeringWhlTorFlt 0;
BA_ "GenSigInvalidValue" SG_ 363 EPS_SteeringWhlTorFlt 4095;
BA_ "GenSigSendType" SG_ 363 EPS_SteeringWhlTorFlt 1;
BA_ "GenSigStartValue" SG_ 363 EPS_SteeringWhlTorFlt 1500;
BA_ "GenSigTimeoutValue" SG_ 363 EPS_SteeringWhlTorFlt 4095;
BA_ "Remark" SG_ 363 EPS_SteeringWhlTorFlt "";
BA_ "EventCommandSignal" SG_ 363 EPS_SteeringWhlTorFltVD 0;
BA_ "GatewayedSignals" SG_ 363 EPS_SteeringWhlTorFltVD 0;
BA_ "GenSigInactiveValue" SG_ 363 EPS_SteeringWhlTorFltVD 0;
BA_ "GenSigInvalidValue" SG_ 363 EPS_SteeringWhlTorFltVD 0;
BA_ "GenSigSendType" SG_ 363 EPS_SteeringWhlTorFltVD 1;
BA_ "GenSigStartValue" SG_ 363 EPS_SteeringWhlTorFltVD 0;
BA_ "GenSigTimeoutValue" SG_ 363 EPS_SteeringWhlTorFltVD 0;
BA_ "Remark" SG_ 363 EPS_SteeringWhlTorFltVD "";
BA_ "EventCommandSignal" SG_ 363 EPS_SteeringAngleRate 0;
BA_ "GatewayedSignals" SG_ 363 EPS_SteeringAngleRate 0;
BA_ "GenSigInactiveValue" SG_ 363 EPS_SteeringAngleRate 0;
BA_ "GenSigInvalidValue" SG_ 363 EPS_SteeringAngleRate 0;
BA_ "GenSigSendType" SG_ 363 EPS_SteeringAngleRate 1;
BA_ "GenSigStartValue" SG_ 363 EPS_SteeringAngleRate 0;
BA_ "GenSigTimeoutValue" SG_ 363 EPS_SteeringAngleRate 0;
BA_ "Remark" SG_ 363 EPS_SteeringAngleRate "";
BA_ "EventCommandSignal" SG_ 363 EPS_TqCtrlSt 0;
BA_ "GatewayedSignals" SG_ 363 EPS_TqCtrlSt 0;
BA_ "GenSigInactiveValue" SG_ 363 EPS_TqCtrlSt 0;
BA_ "GenSigInvalidValue" SG_ 363 EPS_TqCtrlSt 0;
BA_ "GenSigSendType" SG_ 363 EPS_TqCtrlSt 1;
BA_ "GenSigStartValue" SG_ 363 EPS_TqCtrlSt 0;
BA_ "GenSigTimeoutValue" SG_ 363 EPS_TqCtrlSt 0;
BA_ "Remark" SG_ 363 EPS_TqCtrlSt "";
BA_ "EventCommandSignal" SG_ 363 EPS_MotorTorForDrv 0;
BA_ "GatewayedSignals" SG_ 363 EPS_MotorTorForDrv 0;
BA_ "GenSigInactiveValue" SG_ 363 EPS_MotorTorForDrv 0;
BA_ "GenSigInvalidValue" SG_ 363 EPS_MotorTorForDrv 4095;
BA_ "GenSigSendType" SG_ 363 EPS_MotorTorForDrv 1;
BA_ "GenSigStartValue" SG_ 363 EPS_MotorTorForDrv 2000;
BA_ "GenSigTimeoutValue" SG_ 363 EPS_MotorTorForDrv 4095;
BA_ "Remark" SG_ 363 EPS_MotorTorForDrv "";
BA_ "EventCommandSignal" SG_ 363 EPS_TqCtrlAvl 0;
BA_ "GatewayedSignals" SG_ 363 EPS_TqCtrlAvl 0;
BA_ "GenSigInactiveValue" SG_ 363 EPS_TqCtrlAvl 0;
BA_ "GenSigInvalidValue" SG_ 363 EPS_TqCtrlAvl 0;
BA_ "GenSigSendType" SG_ 363 EPS_TqCtrlAvl 1;
BA_ "GenSigStartValue" SG_ 363 EPS_TqCtrlAvl 0;
BA_ "GenSigTimeoutValue" SG_ 363 EPS_TqCtrlAvl 0;
BA_ "Remark" SG_ 363 EPS_TqCtrlAvl "";
BA_ "EventCommandSignal" SG_ 363 EPS_AgCtrlAvl 0;
BA_ "GatewayedSignals" SG_ 363 EPS_AgCtrlAvl 0;
BA_ "GenSigInactiveValue" SG_ 363 EPS_AgCtrlAvl 0;
BA_ "GenSigInvalidValue" SG_ 363 EPS_AgCtrlAvl 0;
BA_ "GenSigSendType" SG_ 363 EPS_AgCtrlAvl 1;
BA_ "GenSigStartValue" SG_ 363 EPS_AgCtrlAvl 0;
BA_ "GenSigTimeoutValue" SG_ 363 EPS_AgCtrlAvl 0;
BA_ "Remark" SG_ 363 EPS_AgCtrlAvl "";
BA_ "EventCommandSignal" SG_ 363 EPS_MotorTorSumVD 0;
BA_ "GatewayedSignals" SG_ 363 EPS_MotorTorSumVD 0;
BA_ "GenSigInactiveValue" SG_ 363 EPS_MotorTorSumVD 0;
BA_ "GenSigInvalidValue" SG_ 363 EPS_MotorTorSumVD 0;
BA_ "GenSigSendType" SG_ 363 EPS_MotorTorSumVD 1;
BA_ "GenSigStartValue" SG_ 363 EPS_MotorTorSumVD 0;
BA_ "GenSigTimeoutValue" SG_ 363 EPS_MotorTorSumVD 0;
BA_ "Remark" SG_ 363 EPS_MotorTorSumVD "";
BA_ "EventCommandSignal" SG_ 363 EPS_DrvOveRideSt 0;
BA_ "GatewayedSignals" SG_ 363 EPS_DrvOveRideSt 0;
BA_ "GenSigInactiveValue" SG_ 363 EPS_DrvOveRideSt 0;
BA_ "GenSigInvalidValue" SG_ 363 EPS_DrvOveRideSt 0;
BA_ "GenSigSendType" SG_ 363 EPS_DrvOveRideSt 1;
BA_ "GenSigStartValue" SG_ 363 EPS_DrvOveRideSt 0;
BA_ "GenSigTimeoutValue" SG_ 363 EPS_DrvOveRideSt 0;
BA_ "Remark" SG_ 363 EPS_DrvOveRideSt "";
BA_ "EventCommandSignal" SG_ 363 EPS_DrvOveRideVD 0;
BA_ "GatewayedSignals" SG_ 363 EPS_DrvOveRideVD 0;
BA_ "GenSigInactiveValue" SG_ 363 EPS_DrvOveRideVD 0;
BA_ "GenSigInvalidValue" SG_ 363 EPS_DrvOveRideVD 0;
BA_ "GenSigSendType" SG_ 363 EPS_DrvOveRideVD 1;
BA_ "GenSigStartValue" SG_ 363 EPS_DrvOveRideVD 0;
BA_ "GenSigTimeoutValue" SG_ 363 EPS_DrvOveRideVD 0;
BA_ "Remark" SG_ 363 EPS_DrvOveRideVD "";
BA_ "EventCommandSignal" SG_ 363 EPS_SteerVibrlAvl 0;
BA_ "GatewayedSignals" SG_ 363 EPS_SteerVibrlAvl 0;
BA_ "GenSigInactiveValue" SG_ 363 EPS_SteerVibrlAvl 0;
BA_ "GenSigInvalidValue" SG_ 363 EPS_SteerVibrlAvl 0;
BA_ "GenSigSendType" SG_ 363 EPS_SteerVibrlAvl 1;
BA_ "GenSigStartValue" SG_ 363 EPS_SteerVibrlAvl 0;
BA_ "GenSigTimeoutValue" SG_ 363 EPS_SteerVibrlAvl 0;
BA_ "Remark" SG_ 363 EPS_SteerVibrlAvl "";
BA_ "EventCommandSignal" SG_ 363 EPS_HandsOffDetStVD 0;
BA_ "GatewayedSignals" SG_ 363 EPS_HandsOffDetStVD 0;
BA_ "GenSigInactiveValue" SG_ 363 EPS_HandsOffDetStVD 0;
BA_ "GenSigInvalidValue" SG_ 363 EPS_HandsOffDetStVD 0;
BA_ "GenSigSendType" SG_ 363 EPS_HandsOffDetStVD 1;
BA_ "GenSigStartValue" SG_ 363 EPS_HandsOffDetStVD 0;
BA_ "GenSigTimeoutValue" SG_ 363 EPS_HandsOffDetStVD 0;
BA_ "Remark" SG_ 363 EPS_HandsOffDetStVD "";
BA_ "EventCommandSignal" SG_ 363 EPS_HandsOffDetSt 0;
BA_ "GatewayedSignals" SG_ 363 EPS_HandsOffDetSt 0;
BA_ "GenSigInactiveValue" SG_ 363 EPS_HandsOffDetSt 0;
BA_ "GenSigInvalidValue" SG_ 363 EPS_HandsOffDetSt 0;
BA_ "GenSigSendType" SG_ 363 EPS_HandsOffDetSt 1;
BA_ "GenSigStartValue" SG_ 363 EPS_HandsOffDetSt 0;
BA_ "GenSigTimeoutValue" SG_ 363 EPS_HandsOffDetSt 0;
BA_ "Remark" SG_ 363 EPS_HandsOffDetSt "";
BA_ "EventCommandSignal" SG_ 363 EPS_SteerMod 0;
BA_ "GatewayedSignals" SG_ 363 EPS_SteerMod 0;
BA_ "GenSigInactiveValue" SG_ 363 EPS_SteerMod 0;
BA_ "GenSigInvalidValue" SG_ 363 EPS_SteerMod 0;
BA_ "GenSigSendType" SG_ 363 EPS_SteerMod 1;
BA_ "GenSigStartValue" SG_ 363 EPS_SteerMod 0;
BA_ "GenSigTimeoutValue" SG_ 363 EPS_SteerMod 0;
BA_ "Remark" SG_ 363 EPS_SteerMod "";
BA_ "EventCommandSignal" SG_ 363 EPS_EpsSelfChkSts 0;
BA_ "GatewayedSignals" SG_ 363 EPS_EpsSelfChkSts 0;
BA_ "GenSigInactiveValue" SG_ 363 EPS_EpsSelfChkSts 0;
BA_ "GenSigInvalidValue" SG_ 363 EPS_EpsSelfChkSts 0;
BA_ "GenSigSendType" SG_ 363 EPS_EpsSelfChkSts 1;
BA_ "GenSigStartValue" SG_ 363 EPS_EpsSelfChkSts 0;
BA_ "GenSigTimeoutValue" SG_ 363 EPS_EpsSelfChkSts 0;
BA_ "Remark" SG_ 363 EPS_EpsSelfChkSts "";
BA_ "EventCommandSignal" SG_ 363 EPS_ThermProtnMax 0;
BA_ "GatewayedSignals" SG_ 363 EPS_ThermProtnMax 0;
BA_ "GenSigInactiveValue" SG_ 363 EPS_ThermProtnMax 0;
BA_ "GenSigInvalidValue" SG_ 363 EPS_ThermProtnMax 0;
BA_ "GenSigSendType" SG_ 363 EPS_ThermProtnMax 1;
BA_ "GenSigStartValue" SG_ 363 EPS_ThermProtnMax 200;
BA_ "GenSigTimeoutValue" SG_ 363 EPS_ThermProtnMax 0;
BA_ "Remark" SG_ 363 EPS_ThermProtnMax "";
BA_ "EventCommandSignal" SG_ 704 IPS_1_CRC 0;
BA_ "GatewayedSignals" SG_ 704 IPS_1_CRC 0;
BA_ "GenSigInactiveValue" SG_ 704 IPS_1_CRC 0;
BA_ "GenSigInvalidValue" SG_ 704 IPS_1_CRC 0;
BA_ "GenSigSendType" SG_ 704 IPS_1_CRC 1;
BA_ "GenSigStartValue" SG_ 704 IPS_1_CRC 0;
BA_ "GenSigTimeoutValue" SG_ 704 IPS_1_CRC 0;
BA_ "Remark" SG_ 704 IPS_1_CRC "源报文周期20ms，转发后报文周期200ms，转发后的counter值发送会不连续";
BA_ "EventCommandSignal" SG_ 704 IPS_1_Counter 0;
BA_ "GatewayedSignals" SG_ 704 IPS_1_Counter 0;
BA_ "GenSigInactiveValue" SG_ 704 IPS_1_Counter 0;
BA_ "GenSigInvalidValue" SG_ 704 IPS_1_Counter 0;
BA_ "GenSigSendType" SG_ 704 IPS_1_Counter 1;
BA_ "GenSigStartValue" SG_ 704 IPS_1_Counter 0;
BA_ "GenSigTimeoutValue" SG_ 704 IPS_1_Counter 0;
BA_ "Remark" SG_ 704 IPS_1_Counter "源报文周期20ms，转发后报文周期200ms，转发后的counter值发送会不连续";
BA_ "EventCommandSignal" SG_ 704 IPS_DCDCModeSt 0;
BA_ "GatewayedSignals" SG_ 704 IPS_DCDCModeSt 0;
BA_ "GenSigInactiveValue" SG_ 704 IPS_DCDCModeSt 0;
BA_ "GenSigInvalidValue" SG_ 704 IPS_DCDCModeSt 0;
BA_ "GenSigSendType" SG_ 704 IPS_DCDCModeSt 1;
BA_ "GenSigStartValue" SG_ 704 IPS_DCDCModeSt 0;
BA_ "GenSigTimeoutValue" SG_ 704 IPS_DCDCModeSt 0;
BA_ "Remark" SG_ 704 IPS_DCDCModeSt "源报文周期20ms，转发后报文周期200ms，转发后的counter值发送会不连续";
BA_ "EventCommandSignal" SG_ 880 ITS_MotorPumpSt 0;
BA_ "GatewayedSignals" SG_ 880 ITS_MotorPumpSt 0;
BA_ "GenSigInactiveValue" SG_ 880 ITS_MotorPumpSt 0;
BA_ "GenSigInvalidValue" SG_ 880 ITS_MotorPumpSt 0;
BA_ "GenSigSendType" SG_ 880 ITS_MotorPumpSt 1;
BA_ "GenSigStartValue" SG_ 880 ITS_MotorPumpSt 0;
BA_ "GenSigTimeoutValue" SG_ 880 ITS_MotorPumpSt 0;
BA_ "Remark" SG_ 880 ITS_MotorPumpSt "";
BA_ "EventCommandSignal" SG_ 880 ITS_MotorInletTempErr 0;
BA_ "GatewayedSignals" SG_ 880 ITS_MotorInletTempErr 0;
BA_ "GenSigInactiveValue" SG_ 880 ITS_MotorInletTempErr 0;
BA_ "GenSigInvalidValue" SG_ 880 ITS_MotorInletTempErr 0;
BA_ "GenSigSendType" SG_ 880 ITS_MotorInletTempErr 1;
BA_ "GenSigStartValue" SG_ 880 ITS_MotorInletTempErr 0;
BA_ "GenSigTimeoutValue" SG_ 880 ITS_MotorInletTempErr 0;
BA_ "Remark" SG_ 880 ITS_MotorInletTempErr "";
BA_ "EventCommandSignal" SG_ 880 ITS_MotorInletTemp 0;
BA_ "GatewayedSignals" SG_ 880 ITS_MotorInletTemp 0;
BA_ "GenSigInactiveValue" SG_ 880 ITS_MotorInletTemp 0;
BA_ "GenSigInvalidValue" SG_ 880 ITS_MotorInletTemp 0;
BA_ "GenSigSendType" SG_ 880 ITS_MotorInletTemp 1;
BA_ "GenSigStartValue" SG_ 880 ITS_MotorInletTemp 0;
BA_ "GenSigTimeoutValue" SG_ 880 ITS_MotorInletTemp 0;
BA_ "Remark" SG_ 880 ITS_MotorInletTemp "";
BA_ "EventCommandSignal" SG_ 880 ITS_FanSt 0;
BA_ "GatewayedSignals" SG_ 880 ITS_FanSt 0;
BA_ "GenSigInactiveValue" SG_ 880 ITS_FanSt 0;
BA_ "GenSigInvalidValue" SG_ 880 ITS_FanSt 0;
BA_ "GenSigSendType" SG_ 880 ITS_FanSt 1;
BA_ "GenSigStartValue" SG_ 880 ITS_FanSt 0;
BA_ "GenSigTimeoutValue" SG_ 880 ITS_FanSt 0;
BA_ "Remark" SG_ 880 ITS_FanSt "";
BA_ "EventCommandSignal" SG_ 880 ITS_LIN_CommunicateErrCode 0;
BA_ "GatewayedSignals" SG_ 880 ITS_LIN_CommunicateErrCode 0;
BA_ "GenSigInactiveValue" SG_ 880 ITS_LIN_CommunicateErrCode 0;
BA_ "GenSigInvalidValue" SG_ 880 ITS_LIN_CommunicateErrCode 0;
BA_ "GenSigSendType" SG_ 880 ITS_LIN_CommunicateErrCode 1;
BA_ "GenSigStartValue" SG_ 880 ITS_LIN_CommunicateErrCode 0;
BA_ "GenSigTimeoutValue" SG_ 880 ITS_LIN_CommunicateErrCode 0;
BA_ "Remark" SG_ 880 ITS_LIN_CommunicateErrCode "";
BA_ "EventCommandSignal" SG_ 880 ITS_MotorPumpErrCode 0;
BA_ "GatewayedSignals" SG_ 880 ITS_MotorPumpErrCode 0;
BA_ "GenSigInactiveValue" SG_ 880 ITS_MotorPumpErrCode 0;
BA_ "GenSigInvalidValue" SG_ 880 ITS_MotorPumpErrCode 0;
BA_ "GenSigSendType" SG_ 880 ITS_MotorPumpErrCode 1;
BA_ "GenSigStartValue" SG_ 880 ITS_MotorPumpErrCode 0;
BA_ "GenSigTimeoutValue" SG_ 880 ITS_MotorPumpErrCode 0;
BA_ "Remark" SG_ 880 ITS_MotorPumpErrCode "";
BA_ "EventCommandSignal" SG_ 880 ITS_TMS_CommDataAvail 0;
BA_ "GatewayedSignals" SG_ 880 ITS_TMS_CommDataAvail 0;
BA_ "GenSigInactiveValue" SG_ 880 ITS_TMS_CommDataAvail 0;
BA_ "GenSigInvalidValue" SG_ 880 ITS_TMS_CommDataAvail 0;
BA_ "GenSigSendType" SG_ 880 ITS_TMS_CommDataAvail 1;
BA_ "GenSigStartValue" SG_ 880 ITS_TMS_CommDataAvail 0;
BA_ "GenSigTimeoutValue" SG_ 880 ITS_TMS_CommDataAvail 0;
BA_ "Remark" SG_ 880 ITS_TMS_CommDataAvail "";
BA_ "EventCommandSignal" SG_ 824 VCU_2_CRC 0;
BA_ "GatewayedSignals" SG_ 824 VCU_2_CRC 0;
BA_ "GenSigInactiveValue" SG_ 824 VCU_2_CRC 0;
BA_ "GenSigInvalidValue" SG_ 824 VCU_2_CRC 0;
BA_ "GenSigSendType" SG_ 824 VCU_2_CRC 1;
BA_ "GenSigStartValue" SG_ 824 VCU_2_CRC 0;
BA_ "GenSigTimeoutValue" SG_ 824 VCU_2_CRC 0;
BA_ "Remark" SG_ 824 VCU_2_CRC "";
BA_ "EventCommandSignal" SG_ 824 VCU_2_Counter 0;
BA_ "GatewayedSignals" SG_ 824 VCU_2_Counter 0;
BA_ "GenSigInactiveValue" SG_ 824 VCU_2_Counter 0;
BA_ "GenSigInvalidValue" SG_ 824 VCU_2_Counter 0;
BA_ "GenSigSendType" SG_ 824 VCU_2_Counter 1;
BA_ "GenSigStartValue" SG_ 824 VCU_2_Counter 0;
BA_ "GenSigTimeoutValue" SG_ 824 VCU_2_Counter 0;
BA_ "Remark" SG_ 824 VCU_2_Counter "";
BA_ "EventCommandSignal" SG_ 824 VCU_GearLvlDisp 0;
BA_ "GatewayedSignals" SG_ 824 VCU_GearLvlDisp 0;
BA_ "GenSigInactiveValue" SG_ 824 VCU_GearLvlDisp 0;
BA_ "GenSigInvalidValue" SG_ 824 VCU_GearLvlDisp 0;
BA_ "GenSigSendType" SG_ 824 VCU_GearLvlDisp 1;
BA_ "GenSigStartValue" SG_ 824 VCU_GearLvlDisp 0;
BA_ "GenSigTimeoutValue" SG_ 824 VCU_GearLvlDisp 0;
BA_ "Remark" SG_ 824 VCU_GearLvlDisp "";
BA_ "EventCommandSignal" SG_ 824 VCU_VehDrvMod 0;
BA_ "GatewayedSignals" SG_ 824 VCU_VehDrvMod 0;
BA_ "GenSigInactiveValue" SG_ 824 VCU_VehDrvMod 0;
BA_ "GenSigInvalidValue" SG_ 824 VCU_VehDrvMod 0;
BA_ "GenSigSendType" SG_ 824 VCU_VehDrvMod 1;
BA_ "GenSigStartValue" SG_ 824 VCU_VehDrvMod 0;
BA_ "GenSigTimeoutValue" SG_ 824 VCU_VehDrvMod 0;
BA_ "Remark" SG_ 824 VCU_VehDrvMod "";
BA_ "EventCommandSignal" SG_ 824 VCU_VehRdySt 0;
BA_ "GatewayedSignals" SG_ 824 VCU_VehRdySt 0;
BA_ "GenSigInactiveValue" SG_ 824 VCU_VehRdySt 0;
BA_ "GenSigInvalidValue" SG_ 824 VCU_VehRdySt 0;
BA_ "GenSigSendType" SG_ 824 VCU_VehRdySt 1;
BA_ "GenSigStartValue" SG_ 824 VCU_VehRdySt 0;
BA_ "GenSigTimeoutValue" SG_ 824 VCU_VehRdySt 0;
BA_ "Remark" SG_ 824 VCU_VehRdySt "";
BA_ "EventCommandSignal" SG_ 824 VCU_GearLvl 0;
BA_ "GatewayedSignals" SG_ 824 VCU_GearLvl 0;
BA_ "GenSigInactiveValue" SG_ 824 VCU_GearLvl 0;
BA_ "GenSigInvalidValue" SG_ 824 VCU_GearLvl 0;
BA_ "GenSigSendType" SG_ 824 VCU_GearLvl 1;
BA_ "GenSigStartValue" SG_ 824 VCU_GearLvl 0;
BA_ "GenSigTimeoutValue" SG_ 824 VCU_GearLvl 0;
BA_ "Remark" SG_ 824 VCU_GearLvl "";
BA_ "EventCommandSignal" SG_ 824 VCU_PlgConnSt 0;
BA_ "GatewayedSignals" SG_ 824 VCU_PlgConnSt 0;
BA_ "GenSigInactiveValue" SG_ 824 VCU_PlgConnSt 0;
BA_ "GenSigInvalidValue" SG_ 824 VCU_PlgConnSt 0;
BA_ "GenSigSendType" SG_ 824 VCU_PlgConnSt 1;
BA_ "GenSigStartValue" SG_ 824 VCU_PlgConnSt 0;
BA_ "GenSigTimeoutValue" SG_ 824 VCU_PlgConnSt 0;
BA_ "Remark" SG_ 824 VCU_PlgConnSt "";
BA_ "EventCommandSignal" SG_ 824 VCU_SwapHvBattRdySt 0;
BA_ "GatewayedSignals" SG_ 824 VCU_SwapHvBattRdySt 0;
BA_ "GenSigInactiveValue" SG_ 824 VCU_SwapHvBattRdySt 0;
BA_ "GenSigInvalidValue" SG_ 824 VCU_SwapHvBattRdySt 0;
BA_ "GenSigSendType" SG_ 824 VCU_SwapHvBattRdySt 1;
BA_ "GenSigStartValue" SG_ 824 VCU_SwapHvBattRdySt 0;
BA_ "GenSigTimeoutValue" SG_ 824 VCU_SwapHvBattRdySt 0;
BA_ "Remark" SG_ 824 VCU_SwapHvBattRdySt "";
BA_ "EventCommandSignal" SG_ 824 VCU_SwapHvBattCompSt 0;
BA_ "GatewayedSignals" SG_ 824 VCU_SwapHvBattCompSt 0;
BA_ "GenSigInactiveValue" SG_ 824 VCU_SwapHvBattCompSt 0;
BA_ "GenSigInvalidValue" SG_ 824 VCU_SwapHvBattCompSt 0;
BA_ "GenSigSendType" SG_ 824 VCU_SwapHvBattCompSt 1;
BA_ "GenSigStartValue" SG_ 824 VCU_SwapHvBattCompSt 0;
BA_ "GenSigTimeoutValue" SG_ 824 VCU_SwapHvBattCompSt 0;
BA_ "Remark" SG_ 824 VCU_SwapHvBattCompSt "";
BA_ "EventCommandSignal" SG_ 824 VCU_SwapHvBattModeSt 0;
BA_ "GatewayedSignals" SG_ 824 VCU_SwapHvBattModeSt 0;
BA_ "GenSigInactiveValue" SG_ 824 VCU_SwapHvBattModeSt 0;
BA_ "GenSigInvalidValue" SG_ 824 VCU_SwapHvBattModeSt 0;
BA_ "GenSigSendType" SG_ 824 VCU_SwapHvBattModeSt 1;
BA_ "GenSigStartValue" SG_ 824 VCU_SwapHvBattModeSt 0;
BA_ "GenSigTimeoutValue" SG_ 824 VCU_SwapHvBattModeSt 0;
BA_ "Remark" SG_ 824 VCU_SwapHvBattModeSt "";
BA_ "EventCommandSignal" SG_ 824 VCU_SwapHvBattModeStVD 0;
BA_ "GatewayedSignals" SG_ 824 VCU_SwapHvBattModeStVD 0;
BA_ "GenSigInactiveValue" SG_ 824 VCU_SwapHvBattModeStVD 0;
BA_ "GenSigInvalidValue" SG_ 824 VCU_SwapHvBattModeStVD 0;
BA_ "GenSigSendType" SG_ 824 VCU_SwapHvBattModeStVD 1;
BA_ "GenSigStartValue" SG_ 824 VCU_SwapHvBattModeStVD 0;
BA_ "GenSigTimeoutValue" SG_ 824 VCU_SwapHvBattModeStVD 0;
BA_ "Remark" SG_ 824 VCU_SwapHvBattModeStVD "";
BA_ "EventCommandSignal" SG_ 824 VCU_RoadMod 0;
BA_ "GatewayedSignals" SG_ 824 VCU_RoadMod 0;
BA_ "GenSigInactiveValue" SG_ 824 VCU_RoadMod 0;
BA_ "GenSigInvalidValue" SG_ 824 VCU_RoadMod 0;
BA_ "GenSigSendType" SG_ 824 VCU_RoadMod 1;
BA_ "GenSigStartValue" SG_ 824 VCU_RoadMod 0;
BA_ "GenSigTimeoutValue" SG_ 824 VCU_RoadMod 0;
BA_ "Remark" SG_ 824 VCU_RoadMod "";
BA_ "EventCommandSignal" SG_ 952 VCU_3_CRC 0;
BA_ "GatewayedSignals" SG_ 952 VCU_3_CRC 0;
BA_ "GenSigInactiveValue" SG_ 952 VCU_3_CRC 0;
BA_ "GenSigInvalidValue" SG_ 952 VCU_3_CRC 0;
BA_ "GenSigSendType" SG_ 952 VCU_3_CRC 1;
BA_ "GenSigStartValue" SG_ 952 VCU_3_CRC 0;
BA_ "GenSigTimeoutValue" SG_ 952 VCU_3_CRC 0;
BA_ "Remark" SG_ 952 VCU_3_CRC "";
BA_ "EventCommandSignal" SG_ 952 VCU_3_Counter 0;
BA_ "GatewayedSignals" SG_ 952 VCU_3_Counter 0;
BA_ "GenSigInactiveValue" SG_ 952 VCU_3_Counter 0;
BA_ "GenSigInvalidValue" SG_ 952 VCU_3_Counter 0;
BA_ "GenSigSendType" SG_ 952 VCU_3_Counter 1;
BA_ "GenSigStartValue" SG_ 952 VCU_3_Counter 0;
BA_ "GenSigTimeoutValue" SG_ 952 VCU_3_Counter 0;
BA_ "Remark" SG_ 952 VCU_3_Counter "";
BA_ "EventCommandSignal" SG_ 952 VCU_ErrNotice 0;
BA_ "GatewayedSignals" SG_ 952 VCU_ErrNotice 0;
BA_ "GenSigInactiveValue" SG_ 952 VCU_ErrNotice 0;
BA_ "GenSigInvalidValue" SG_ 952 VCU_ErrNotice 0;
BA_ "GenSigSendType" SG_ 952 VCU_ErrNotice 1;
BA_ "GenSigStartValue" SG_ 952 VCU_ErrNotice 0;
BA_ "GenSigTimeoutValue" SG_ 952 VCU_ErrNotice 0;
BA_ "Remark" SG_ 952 VCU_ErrNotice "";
BA_ "EventCommandSignal" SG_ 952 VCU_ErrNoticeOperationFlag 0;
BA_ "GatewayedSignals" SG_ 952 VCU_ErrNoticeOperationFlag 0;
BA_ "GenSigInactiveValue" SG_ 952 VCU_ErrNoticeOperationFlag 0;
BA_ "GenSigInvalidValue" SG_ 952 VCU_ErrNoticeOperationFlag 0;
BA_ "GenSigSendType" SG_ 952 VCU_ErrNoticeOperationFlag 1;
BA_ "GenSigStartValue" SG_ 952 VCU_ErrNoticeOperationFlag 0;
BA_ "GenSigTimeoutValue" SG_ 952 VCU_ErrNoticeOperationFlag 0;
BA_ "Remark" SG_ 952 VCU_ErrNoticeOperationFlag "";
BA_ "EventCommandSignal" SG_ 952 VCU_Err2NoticeFlag 0;
BA_ "GatewayedSignals" SG_ 952 VCU_Err2NoticeFlag 0;
BA_ "GenSigInactiveValue" SG_ 952 VCU_Err2NoticeFlag 0;
BA_ "GenSigInvalidValue" SG_ 952 VCU_Err2NoticeFlag 0;
BA_ "GenSigSendType" SG_ 952 VCU_Err2NoticeFlag 1;
BA_ "GenSigStartValue" SG_ 952 VCU_Err2NoticeFlag 0;
BA_ "GenSigTimeoutValue" SG_ 952 VCU_Err2NoticeFlag 0;
BA_ "Remark" SG_ 952 VCU_Err2NoticeFlag "";
BA_ "EventCommandSignal" SG_ 952 VCU_EcoPlusMod 0;
BA_ "GatewayedSignals" SG_ 952 VCU_EcoPlusMod 0;
BA_ "GenSigInactiveValue" SG_ 952 VCU_EcoPlusMod 0;
BA_ "GenSigInvalidValue" SG_ 952 VCU_EcoPlusMod 0;
BA_ "GenSigSendType" SG_ 952 VCU_EcoPlusMod 1;
BA_ "GenSigStartValue" SG_ 952 VCU_EcoPlusMod 0;
BA_ "GenSigTimeoutValue" SG_ 952 VCU_EcoPlusMod 0;
BA_ "Remark" SG_ 952 VCU_EcoPlusMod "";
BA_ "EventCommandSignal" SG_ 653 VCU_5_CRC 0;
BA_ "GatewayedSignals" SG_ 653 VCU_5_CRC 0;
BA_ "GenSigInactiveValue" SG_ 653 VCU_5_CRC 0;
BA_ "GenSigInvalidValue" SG_ 653 VCU_5_CRC 0;
BA_ "GenSigSendType" SG_ 653 VCU_5_CRC 1;
BA_ "GenSigStartValue" SG_ 653 VCU_5_CRC 0;
BA_ "GenSigTimeoutValue" SG_ 653 VCU_5_CRC 0;
BA_ "Remark" SG_ 653 VCU_5_CRC "";
BA_ "EventCommandSignal" SG_ 653 VCU_5_Counter 0;
BA_ "GatewayedSignals" SG_ 653 VCU_5_Counter 0;
BA_ "GenSigInactiveValue" SG_ 653 VCU_5_Counter 0;
BA_ "GenSigInvalidValue" SG_ 653 VCU_5_Counter 0;
BA_ "GenSigSendType" SG_ 653 VCU_5_Counter 1;
BA_ "GenSigStartValue" SG_ 653 VCU_5_Counter 0;
BA_ "GenSigTimeoutValue" SG_ 653 VCU_5_Counter 0;
BA_ "Remark" SG_ 653 VCU_5_Counter "";
BA_ "EventCommandSignal" SG_ 653 VCU_AccButtInfo 0;
BA_ "GatewayedSignals" SG_ 653 VCU_AccButtInfo 0;
BA_ "GenSigInactiveValue" SG_ 653 VCU_AccButtInfo 0;
BA_ "GenSigInvalidValue" SG_ 653 VCU_AccButtInfo 0;
BA_ "GenSigSendType" SG_ 653 VCU_AccButtInfo 1;
BA_ "GenSigStartValue" SG_ 653 VCU_AccButtInfo 0;
BA_ "GenSigTimeoutValue" SG_ 653 VCU_AccButtInfo 0;
BA_ "Remark" SG_ 653 VCU_AccButtInfo "";
BA_ "EventCommandSignal" SG_ 653 VCU_LateralAssistBtnInfo 0;
BA_ "GatewayedSignals" SG_ 653 VCU_LateralAssistBtnInfo 0;
BA_ "GenSigInactiveValue" SG_ 653 VCU_LateralAssistBtnInfo 0;
BA_ "GenSigInvalidValue" SG_ 653 VCU_LateralAssistBtnInfo 0;
BA_ "GenSigSendType" SG_ 653 VCU_LateralAssistBtnInfo 1;
BA_ "GenSigStartValue" SG_ 653 VCU_LateralAssistBtnInfo 0;
BA_ "GenSigTimeoutValue" SG_ 653 VCU_LateralAssistBtnInfo 0;
BA_ "Remark" SG_ 653 VCU_LateralAssistBtnInfo "";
BA_ "EventCommandSignal" SG_ 653 VCU_LateralAssistBtnInfoVD 0;
BA_ "GatewayedSignals" SG_ 653 VCU_LateralAssistBtnInfoVD 0;
BA_ "GenSigInactiveValue" SG_ 653 VCU_LateralAssistBtnInfoVD 0;
BA_ "GenSigInvalidValue" SG_ 653 VCU_LateralAssistBtnInfoVD 0;
BA_ "GenSigSendType" SG_ 653 VCU_LateralAssistBtnInfoVD 1;
BA_ "GenSigStartValue" SG_ 653 VCU_LateralAssistBtnInfoVD 0;
BA_ "GenSigTimeoutValue" SG_ 653 VCU_LateralAssistBtnInfoVD 0;
BA_ "Remark" SG_ 653 VCU_LateralAssistBtnInfoVD "";
BA_ "EventCommandSignal" SG_ 653 VCU_EMS_AccPedalActPst 0;
BA_ "GatewayedSignals" SG_ 653 VCU_EMS_AccPedalActPst 0;
BA_ "GenSigInactiveValue" SG_ 653 VCU_EMS_AccPedalActPst 0;
BA_ "GenSigInvalidValue" SG_ 653 VCU_EMS_AccPedalActPst 0;
BA_ "GenSigSendType" SG_ 653 VCU_EMS_AccPedalActPst 1;
BA_ "GenSigStartValue" SG_ 653 VCU_EMS_AccPedalActPst 0;
BA_ "GenSigTimeoutValue" SG_ 653 VCU_EMS_AccPedalActPst 0;
BA_ "Remark" SG_ 653 VCU_EMS_AccPedalActPst "";
BA_ "EventCommandSignal" SG_ 653 VCU_EMS_BrkPedalSt 0;
BA_ "GatewayedSignals" SG_ 653 VCU_EMS_BrkPedalSt 0;
BA_ "GenSigInactiveValue" SG_ 653 VCU_EMS_BrkPedalSt 0;
BA_ "GenSigInvalidValue" SG_ 653 VCU_EMS_BrkPedalSt 0;
BA_ "GenSigSendType" SG_ 653 VCU_EMS_BrkPedalSt 1;
BA_ "GenSigStartValue" SG_ 653 VCU_EMS_BrkPedalSt 0;
BA_ "GenSigTimeoutValue" SG_ 653 VCU_EMS_BrkPedalSt 0;
BA_ "Remark" SG_ 653 VCU_EMS_BrkPedalSt "";
BA_ "EventCommandSignal" SG_ 653 VCU_EMS_BrkPedalStVD 0;
BA_ "GatewayedSignals" SG_ 653 VCU_EMS_BrkPedalStVD 0;
BA_ "GenSigInactiveValue" SG_ 653 VCU_EMS_BrkPedalStVD 0;
BA_ "GenSigInvalidValue" SG_ 653 VCU_EMS_BrkPedalStVD 0;
BA_ "GenSigSendType" SG_ 653 VCU_EMS_BrkPedalStVD 1;
BA_ "GenSigStartValue" SG_ 653 VCU_EMS_BrkPedalStVD 0;
BA_ "GenSigTimeoutValue" SG_ 653 VCU_EMS_BrkPedalStVD 0;
BA_ "Remark" SG_ 653 VCU_EMS_BrkPedalStVD "";
BA_ "EventCommandSignal" SG_ 653 VCU_EMS_AccPedalActPstVD 0;
BA_ "GatewayedSignals" SG_ 653 VCU_EMS_AccPedalActPstVD 0;
BA_ "GenSigInactiveValue" SG_ 653 VCU_EMS_AccPedalActPstVD 0;
BA_ "GenSigInvalidValue" SG_ 653 VCU_EMS_AccPedalActPstVD 0;
BA_ "GenSigSendType" SG_ 653 VCU_EMS_AccPedalActPstVD 1;
BA_ "GenSigStartValue" SG_ 653 VCU_EMS_AccPedalActPstVD 0;
BA_ "GenSigTimeoutValue" SG_ 653 VCU_EMS_AccPedalActPstVD 0;
BA_ "Remark" SG_ 653 VCU_EMS_AccPedalActPstVD "";
BA_ "EventCommandSignal" SG_ 653 VCU_DCU_ActRotSpd 0;
BA_ "GatewayedSignals" SG_ 653 VCU_DCU_ActRotSpd 0;
BA_ "GenSigInactiveValue" SG_ 653 VCU_DCU_ActRotSpd 0;
BA_ "GenSigInvalidValue" SG_ 653 VCU_DCU_ActRotSpd 65535;
BA_ "GenSigSendType" SG_ 653 VCU_DCU_ActRotSpd 1;
BA_ "GenSigStartValue" SG_ 653 VCU_DCU_ActRotSpd 65534;
BA_ "GenSigTimeoutValue" SG_ 653 VCU_DCU_ActRotSpd 0;
BA_ "Remark" SG_ 653 VCU_DCU_ActRotSpd "";
BA_ "EventCommandSignal" SG_ 653 VCU_BrkPedPstVD 0;
BA_ "GatewayedSignals" SG_ 653 VCU_BrkPedPstVD 0;
BA_ "GenSigInactiveValue" SG_ 653 VCU_BrkPedPstVD 0;
BA_ "GenSigInvalidValue" SG_ 653 VCU_BrkPedPstVD 0;
BA_ "GenSigSendType" SG_ 653 VCU_BrkPedPstVD 1;
BA_ "GenSigStartValue" SG_ 653 VCU_BrkPedPstVD 0;
BA_ "GenSigTimeoutValue" SG_ 653 VCU_BrkPedPstVD 0;
BA_ "Remark" SG_ 653 VCU_BrkPedPstVD "";
BA_ "EventCommandSignal" SG_ 653 VCU_CrntGearLvl 0;
BA_ "GatewayedSignals" SG_ 653 VCU_CrntGearLvl 0;
BA_ "GenSigInactiveValue" SG_ 653 VCU_CrntGearLvl 0;
BA_ "GenSigInvalidValue" SG_ 653 VCU_CrntGearLvl 0;
BA_ "GenSigSendType" SG_ 653 VCU_CrntGearLvl 1;
BA_ "GenSigStartValue" SG_ 653 VCU_CrntGearLvl 0;
BA_ "GenSigTimeoutValue" SG_ 653 VCU_CrntGearLvl 0;
BA_ "Remark" SG_ 653 VCU_CrntGearLvl "";
BA_ "EventCommandSignal" SG_ 653 VCU_BrkPedPst 0;
BA_ "GatewayedSignals" SG_ 653 VCU_BrkPedPst 0;
BA_ "GenSigInactiveValue" SG_ 653 VCU_BrkPedPst 0;
BA_ "GenSigInvalidValue" SG_ 653 VCU_BrkPedPst 0;
BA_ "GenSigSendType" SG_ 653 VCU_BrkPedPst 1;
BA_ "GenSigStartValue" SG_ 653 VCU_BrkPedPst 0;
BA_ "GenSigTimeoutValue" SG_ 653 VCU_BrkPedPst 0;
BA_ "Remark" SG_ 653 VCU_BrkPedPst "";
BA_ "EventCommandSignal" SG_ 653 VCU_APAGasPedalIntv 0;
BA_ "GatewayedSignals" SG_ 653 VCU_APAGasPedalIntv 0;
BA_ "GenSigInactiveValue" SG_ 653 VCU_APAGasPedalIntv 0;
BA_ "GenSigInvalidValue" SG_ 653 VCU_APAGasPedalIntv 0;
BA_ "GenSigSendType" SG_ 653 VCU_APAGasPedalIntv 1;
BA_ "GenSigStartValue" SG_ 653 VCU_APAGasPedalIntv 0;
BA_ "GenSigTimeoutValue" SG_ 653 VCU_APAGasPedalIntv 0;
BA_ "Remark" SG_ 653 VCU_APAGasPedalIntv "";
BA_ "EventCommandSignal" SG_ 653 VCU_APAAvailable 0;
BA_ "GatewayedSignals" SG_ 653 VCU_APAAvailable 0;
BA_ "GenSigInactiveValue" SG_ 653 VCU_APAAvailable 0;
BA_ "GenSigInvalidValue" SG_ 653 VCU_APAAvailable 0;
BA_ "GenSigSendType" SG_ 653 VCU_APAAvailable 1;
BA_ "GenSigStartValue" SG_ 653 VCU_APAAvailable 0;
BA_ "GenSigTimeoutValue" SG_ 653 VCU_APAAvailable 0;
BA_ "Remark" SG_ 653 VCU_APAAvailable "";
BA_ "EventCommandSignal" SG_ 653 VCU_ACCMaxRecpDecel 0;
BA_ "GatewayedSignals" SG_ 653 VCU_ACCMaxRecpDecel 0;
BA_ "GenSigInactiveValue" SG_ 653 VCU_ACCMaxRecpDecel 0;
BA_ "GenSigInvalidValue" SG_ 653 VCU_ACCMaxRecpDecel 0;
BA_ "GenSigSendType" SG_ 653 VCU_ACCMaxRecpDecel 1;
BA_ "GenSigStartValue" SG_ 653 VCU_ACCMaxRecpDecel 0;
BA_ "GenSigTimeoutValue" SG_ 653 VCU_ACCMaxRecpDecel 0;
BA_ "Remark" SG_ 653 VCU_ACCMaxRecpDecel "";
BA_ "EventCommandSignal" SG_ 653 VCU_ACCLimitOperatingSt 0;
BA_ "GatewayedSignals" SG_ 653 VCU_ACCLimitOperatingSt 0;
BA_ "GenSigInactiveValue" SG_ 653 VCU_ACCLimitOperatingSt 0;
BA_ "GenSigInvalidValue" SG_ 653 VCU_ACCLimitOperatingSt 0;
BA_ "GenSigSendType" SG_ 653 VCU_ACCLimitOperatingSt 1;
BA_ "GenSigStartValue" SG_ 653 VCU_ACCLimitOperatingSt 0;
BA_ "GenSigTimeoutValue" SG_ 653 VCU_ACCLimitOperatingSt 0;
BA_ "Remark" SG_ 653 VCU_ACCLimitOperatingSt "";
BA_ "EventCommandSignal" SG_ 653 VCU_ACCMaxRecpDecelVD 0;
BA_ "GatewayedSignals" SG_ 653 VCU_ACCMaxRecpDecelVD 0;
BA_ "GenSigInactiveValue" SG_ 653 VCU_ACCMaxRecpDecelVD 0;
BA_ "GenSigInvalidValue" SG_ 653 VCU_ACCMaxRecpDecelVD 0;
BA_ "GenSigSendType" SG_ 653 VCU_ACCMaxRecpDecelVD 1;
BA_ "GenSigStartValue" SG_ 653 VCU_ACCMaxRecpDecelVD 0;
BA_ "GenSigTimeoutValue" SG_ 653 VCU_ACCMaxRecpDecelVD 0;
BA_ "Remark" SG_ 653 VCU_ACCMaxRecpDecelVD "";
BA_ "EventCommandSignal" SG_ 653 VCU_APA_Resp 0;
BA_ "GatewayedSignals" SG_ 653 VCU_APA_Resp 0;
BA_ "GenSigInactiveValue" SG_ 653 VCU_APA_Resp 0;
BA_ "GenSigInvalidValue" SG_ 653 VCU_APA_Resp 0;
BA_ "GenSigSendType" SG_ 653 VCU_APA_Resp 1;
BA_ "GenSigStartValue" SG_ 653 VCU_APA_Resp 0;
BA_ "GenSigTimeoutValue" SG_ 653 VCU_APA_Resp 0;
BA_ "Remark" SG_ 653 VCU_APA_Resp "";
BA_ "EventCommandSignal" SG_ 653 VCU_APAGearIntervern 0;
BA_ "GatewayedSignals" SG_ 653 VCU_APAGearIntervern 0;
BA_ "GenSigInactiveValue" SG_ 653 VCU_APAGearIntervern 0;
BA_ "GenSigInvalidValue" SG_ 653 VCU_APAGearIntervern 0;
BA_ "GenSigSendType" SG_ 653 VCU_APAGearIntervern 1;
BA_ "GenSigStartValue" SG_ 653 VCU_APAGearIntervern 0;
BA_ "GenSigTimeoutValue" SG_ 653 VCU_APAGearIntervern 0;
BA_ "Remark" SG_ 653 VCU_APAGearIntervern "";
BA_ "EventCommandSignal" SG_ 653 VCU_ActVehWheelTorq 0;
BA_ "GatewayedSignals" SG_ 653 VCU_ActVehWheelTorq 0;
BA_ "GenSigInactiveValue" SG_ 653 VCU_ActVehWheelTorq 0;
BA_ "GenSigInvalidValue" SG_ 653 VCU_ActVehWheelTorq 0;
BA_ "GenSigSendType" SG_ 653 VCU_ActVehWheelTorq 1;
BA_ "GenSigStartValue" SG_ 653 VCU_ActVehWheelTorq 0;
BA_ "GenSigTimeoutValue" SG_ 653 VCU_ActVehWheelTorq 0;
BA_ "Remark" SG_ 653 VCU_ActVehWheelTorq "";
BA_ "EventCommandSignal" SG_ 653 VCU_ACCmaxSpdLimit 0;
BA_ "GatewayedSignals" SG_ 653 VCU_ACCmaxSpdLimit 0;
BA_ "GenSigInactiveValue" SG_ 653 VCU_ACCmaxSpdLimit 0;
BA_ "GenSigInvalidValue" SG_ 653 VCU_ACCmaxSpdLimit 0;
BA_ "GenSigSendType" SG_ 653 VCU_ACCmaxSpdLimit 1;
BA_ "GenSigStartValue" SG_ 653 VCU_ACCmaxSpdLimit 0;
BA_ "GenSigTimeoutValue" SG_ 653 VCU_ACCmaxSpdLimit 0;
BA_ "Remark" SG_ 653 VCU_ACCmaxSpdLimit "";
BA_ "EventCommandSignal" SG_ 653 VCU_VehWheelTorqMax 0;
BA_ "GatewayedSignals" SG_ 653 VCU_VehWheelTorqMax 0;
BA_ "GenSigInactiveValue" SG_ 653 VCU_VehWheelTorqMax 0;
BA_ "GenSigInvalidValue" SG_ 653 VCU_VehWheelTorqMax 0;
BA_ "GenSigSendType" SG_ 653 VCU_VehWheelTorqMax 1;
BA_ "GenSigStartValue" SG_ 653 VCU_VehWheelTorqMax 0;
BA_ "GenSigTimeoutValue" SG_ 653 VCU_VehWheelTorqMax 0;
BA_ "Remark" SG_ 653 VCU_VehWheelTorqMax "";
BA_ "EventCommandSignal" SG_ 653 VCU_RecpTorqVD 0;
BA_ "GatewayedSignals" SG_ 653 VCU_RecpTorqVD 0;
BA_ "GenSigInactiveValue" SG_ 653 VCU_RecpTorqVD 0;
BA_ "GenSigInvalidValue" SG_ 653 VCU_RecpTorqVD 0;
BA_ "GenSigSendType" SG_ 653 VCU_RecpTorqVD 1;
BA_ "GenSigStartValue" SG_ 653 VCU_RecpTorqVD 0;
BA_ "GenSigTimeoutValue" SG_ 653 VCU_RecpTorqVD 0;
BA_ "Remark" SG_ 653 VCU_RecpTorqVD "";
BA_ "EventCommandSignal" SG_ 653 VCU_RecpTorq 0;
BA_ "GatewayedSignals" SG_ 653 VCU_RecpTorq 0;
BA_ "GenSigInactiveValue" SG_ 653 VCU_RecpTorq 0;
BA_ "GenSigInvalidValue" SG_ 653 VCU_RecpTorq 0;
BA_ "GenSigSendType" SG_ 653 VCU_RecpTorq 1;
BA_ "GenSigStartValue" SG_ 653 VCU_RecpTorq 0;
BA_ "GenSigTimeoutValue" SG_ 653 VCU_RecpTorq 0;
BA_ "Remark" SG_ 653 VCU_RecpTorq "";
BA_ "EventCommandSignal" SG_ 653 VCU_CrntGearLvlVD 0;
BA_ "GatewayedSignals" SG_ 653 VCU_CrntGearLvlVD 0;
BA_ "GenSigInactiveValue" SG_ 653 VCU_CrntGearLvlVD 0;
BA_ "GenSigInvalidValue" SG_ 653 VCU_CrntGearLvlVD 0;
BA_ "GenSigSendType" SG_ 653 VCU_CrntGearLvlVD 1;
BA_ "GenSigStartValue" SG_ 653 VCU_CrntGearLvlVD 0;
BA_ "GenSigTimeoutValue" SG_ 653 VCU_CrntGearLvlVD 0;
BA_ "Remark" SG_ 653 VCU_CrntGearLvlVD "";
BA_ "EventCommandSignal" SG_ 653 EMS_GasPedalActPstforMRRVD_D 0;
BA_ "GatewayedSignals" SG_ 653 EMS_GasPedalActPstforMRRVD_D 0;
BA_ "GenSigInactiveValue" SG_ 653 EMS_GasPedalActPstforMRRVD_D 0;
BA_ "GenSigInvalidValue" SG_ 653 EMS_GasPedalActPstforMRRVD_D 0;
BA_ "GenSigSendType" SG_ 653 EMS_GasPedalActPstforMRRVD_D 1;
BA_ "GenSigStartValue" SG_ 653 EMS_GasPedalActPstforMRRVD_D 0;
BA_ "GenSigTimeoutValue" SG_ 653 EMS_GasPedalActPstforMRRVD_D 0;
BA_ "Remark" SG_ 653 EMS_GasPedalActPstforMRRVD_D "";
BA_ "EventCommandSignal" SG_ 644 VCU_7_CRC 0;
BA_ "GatewayedSignals" SG_ 644 VCU_7_CRC 0;
BA_ "GenSigInactiveValue" SG_ 644 VCU_7_CRC 0;
BA_ "GenSigInvalidValue" SG_ 644 VCU_7_CRC 0;
BA_ "GenSigSendType" SG_ 644 VCU_7_CRC 1;
BA_ "GenSigStartValue" SG_ 644 VCU_7_CRC 0;
BA_ "GenSigTimeoutValue" SG_ 644 VCU_7_CRC 0;
BA_ "Remark" SG_ 644 VCU_7_CRC "";
BA_ "EventCommandSignal" SG_ 644 VCU_7_Counter 0;
BA_ "GatewayedSignals" SG_ 644 VCU_7_Counter 0;
BA_ "GenSigInactiveValue" SG_ 644 VCU_7_Counter 0;
BA_ "GenSigInvalidValue" SG_ 644 VCU_7_Counter 0;
BA_ "GenSigSendType" SG_ 644 VCU_7_Counter 1;
BA_ "GenSigStartValue" SG_ 644 VCU_7_Counter 0;
BA_ "GenSigTimeoutValue" SG_ 644 VCU_7_Counter 0;
BA_ "Remark" SG_ 644 VCU_7_Counter "";
BA_ "EventCommandSignal" SG_ 644 EMS_GasPedalActPstforMRRVD 0;
BA_ "GatewayedSignals" SG_ 644 EMS_GasPedalActPstforMRRVD 0;
BA_ "GenSigInactiveValue" SG_ 644 EMS_GasPedalActPstforMRRVD 0;
BA_ "GenSigInvalidValue" SG_ 644 EMS_GasPedalActPstforMRRVD 0;
BA_ "GenSigSendType" SG_ 644 EMS_GasPedalActPstforMRRVD 1;
BA_ "GenSigStartValue" SG_ 644 EMS_GasPedalActPstforMRRVD 0;
BA_ "GenSigTimeoutValue" SG_ 644 EMS_GasPedalActPstforMRRVD 0;
BA_ "Remark" SG_ 644 EMS_GasPedalActPstforMRRVD "";
BA_ "EventCommandSignal" SG_ 644 VCU_AccTMCFail 0;
BA_ "GatewayedSignals" SG_ 644 VCU_AccTMCFail 0;
BA_ "GenSigInactiveValue" SG_ 644 VCU_AccTMCFail 0;
BA_ "GenSigInvalidValue" SG_ 644 VCU_AccTMCFail 0;
BA_ "GenSigSendType" SG_ 644 VCU_AccTMCFail 1;
BA_ "GenSigStartValue" SG_ 644 VCU_AccTMCFail 0;
BA_ "GenSigTimeoutValue" SG_ 644 VCU_AccTMCFail 0;
BA_ "Remark" SG_ 644 VCU_AccTMCFail "";
BA_ "EventCommandSignal" SG_ 644 VCU_AccElecECFail 0;
BA_ "GatewayedSignals" SG_ 644 VCU_AccElecECFail 0;
BA_ "GenSigInactiveValue" SG_ 644 VCU_AccElecECFail 0;
BA_ "GenSigInvalidValue" SG_ 644 VCU_AccElecECFail 0;
BA_ "GenSigSendType" SG_ 644 VCU_AccElecECFail 1;
BA_ "GenSigStartValue" SG_ 644 VCU_AccElecECFail 0;
BA_ "GenSigTimeoutValue" SG_ 644 VCU_AccElecECFail 0;
BA_ "Remark" SG_ 644 VCU_AccElecECFail "";
BA_ "EventCommandSignal" SG_ 644 VCU_AccDriverOrvd 0;
BA_ "GatewayedSignals" SG_ 644 VCU_AccDriverOrvd 0;
BA_ "GenSigInactiveValue" SG_ 644 VCU_AccDriverOrvd 0;
BA_ "GenSigInvalidValue" SG_ 644 VCU_AccDriverOrvd 0;
BA_ "GenSigSendType" SG_ 644 VCU_AccDriverOrvd 1;
BA_ "GenSigStartValue" SG_ 644 VCU_AccDriverOrvd 0;
BA_ "GenSigTimeoutValue" SG_ 644 VCU_AccDriverOrvd 0;
BA_ "Remark" SG_ 644 VCU_AccDriverOrvd "";
BA_ "EventCommandSignal" SG_ 644 EMS_GasPedalActPstforMRR 0;
BA_ "GatewayedSignals" SG_ 644 EMS_GasPedalActPstforMRR 0;
BA_ "GenSigInactiveValue" SG_ 644 EMS_GasPedalActPstforMRR 0;
BA_ "GenSigInvalidValue" SG_ 644 EMS_GasPedalActPstforMRR 0;
BA_ "GenSigSendType" SG_ 644 EMS_GasPedalActPstforMRR 1;
BA_ "GenSigStartValue" SG_ 644 EMS_GasPedalActPstforMRR 0;
BA_ "GenSigTimeoutValue" SG_ 644 EMS_GasPedalActPstforMRR 0;
BA_ "Remark" SG_ 644 EMS_GasPedalActPstforMRR "";
BA_ "EventCommandSignal" SG_ 644 VCU_AccSpareCanError 0;
BA_ "GatewayedSignals" SG_ 644 VCU_AccSpareCanError 0;
BA_ "GenSigInactiveValue" SG_ 644 VCU_AccSpareCanError 0;
BA_ "GenSigInvalidValue" SG_ 644 VCU_AccSpareCanError 0;
BA_ "GenSigSendType" SG_ 644 VCU_AccSpareCanError 1;
BA_ "GenSigStartValue" SG_ 644 VCU_AccSpareCanError 0;
BA_ "GenSigTimeoutValue" SG_ 644 VCU_AccSpareCanError 0;
BA_ "Remark" SG_ 644 VCU_AccSpareCanError "";
BA_ "EventCommandSignal" SG_ 644 VCU_IFCFailureSt 0;
BA_ "GatewayedSignals" SG_ 644 VCU_IFCFailureSt 0;
BA_ "GenSigInactiveValue" SG_ 644 VCU_IFCFailureSt 0;
BA_ "GenSigInvalidValue" SG_ 644 VCU_IFCFailureSt 0;
BA_ "GenSigSendType" SG_ 644 VCU_IFCFailureSt 1;
BA_ "GenSigStartValue" SG_ 644 VCU_IFCFailureSt 0;
BA_ "GenSigTimeoutValue" SG_ 644 VCU_IFCFailureSt 0;
BA_ "Remark" SG_ 644 VCU_IFCFailureSt "";
BA_ "EventCommandSignal" SG_ 644 VCU_AccDriverOrvdVD 0;
BA_ "GatewayedSignals" SG_ 644 VCU_AccDriverOrvdVD 0;
BA_ "GenSigInactiveValue" SG_ 644 VCU_AccDriverOrvdVD 0;
BA_ "GenSigInvalidValue" SG_ 644 VCU_AccDriverOrvdVD 0;
BA_ "GenSigSendType" SG_ 644 VCU_AccDriverOrvdVD 1;
BA_ "GenSigStartValue" SG_ 644 VCU_AccDriverOrvdVD 0;
BA_ "GenSigTimeoutValue" SG_ 644 VCU_AccDriverOrvdVD 0;
BA_ "Remark" SG_ 644 VCU_AccDriverOrvdVD "";
BA_ "EventCommandSignal" SG_ 644 VCU_TorqDriverReq 0;
BA_ "GatewayedSignals" SG_ 644 VCU_TorqDriverReq 0;
BA_ "GenSigInactiveValue" SG_ 644 VCU_TorqDriverReq 0;
BA_ "GenSigInvalidValue" SG_ 644 VCU_TorqDriverReq 0;
BA_ "GenSigSendType" SG_ 644 VCU_TorqDriverReq 1;
BA_ "GenSigStartValue" SG_ 644 VCU_TorqDriverReq 0;
BA_ "GenSigTimeoutValue" SG_ 644 VCU_TorqDriverReq 0;
BA_ "Remark" SG_ 644 VCU_TorqDriverReq "";
BA_ "EventCommandSignal" SG_ 393 VCU_9_CRC 0;
BA_ "GatewayedSignals" SG_ 393 VCU_9_CRC 0;
BA_ "GenSigInactiveValue" SG_ 393 VCU_9_CRC 0;
BA_ "GenSigInvalidValue" SG_ 393 VCU_9_CRC 0;
BA_ "GenSigSendType" SG_ 393 VCU_9_CRC 1;
BA_ "GenSigStartValue" SG_ 393 VCU_9_CRC 0;
BA_ "GenSigTimeoutValue" SG_ 393 VCU_9_CRC 0;
BA_ "Remark" SG_ 393 VCU_9_CRC "";
BA_ "EventCommandSignal" SG_ 393 VCU_9_Counter 0;
BA_ "GatewayedSignals" SG_ 393 VCU_9_Counter 0;
BA_ "GenSigInactiveValue" SG_ 393 VCU_9_Counter 0;
BA_ "GenSigInvalidValue" SG_ 393 VCU_9_Counter 0;
BA_ "GenSigSendType" SG_ 393 VCU_9_Counter 1;
BA_ "GenSigStartValue" SG_ 393 VCU_9_Counter 0;
BA_ "GenSigTimeoutValue" SG_ 393 VCU_9_Counter 0;
BA_ "Remark" SG_ 393 VCU_9_Counter "";
BA_ "EventCommandSignal" SG_ 393 VCU_ErrorFb 0;
BA_ "GatewayedSignals" SG_ 393 VCU_ErrorFb 0;
BA_ "GenSigInactiveValue" SG_ 393 VCU_ErrorFb 0;
BA_ "GenSigInvalidValue" SG_ 393 VCU_ErrorFb 0;
BA_ "GenSigSendType" SG_ 393 VCU_ErrorFb 1;
BA_ "GenSigStartValue" SG_ 393 VCU_ErrorFb 0;
BA_ "GenSigTimeoutValue" SG_ 393 VCU_ErrorFb 0;
BA_ "Remark" SG_ 393 VCU_ErrorFb "";
BA_ "EventCommandSignal" SG_ 393 VCU_VehWhlReqTqVld 0;
BA_ "GatewayedSignals" SG_ 393 VCU_VehWhlReqTqVld 0;
BA_ "GenSigInactiveValue" SG_ 393 VCU_VehWhlReqTqVld 0;
BA_ "GenSigInvalidValue" SG_ 393 VCU_VehWhlReqTqVld 0;
BA_ "GenSigSendType" SG_ 393 VCU_VehWhlReqTqVld 1;
BA_ "GenSigStartValue" SG_ 393 VCU_VehWhlReqTqVld 0;
BA_ "GenSigTimeoutValue" SG_ 393 VCU_VehWhlReqTqVld 0;
BA_ "Remark" SG_ 393 VCU_VehWhlReqTqVld "";
BA_ "EventCommandSignal" SG_ 393 VCU_MotorRegenTrqLmtlnDVaild 0;
BA_ "GatewayedSignals" SG_ 393 VCU_MotorRegenTrqLmtlnDVaild 0;
BA_ "GenSigInactiveValue" SG_ 393 VCU_MotorRegenTrqLmtlnDVaild 0;
BA_ "GenSigInvalidValue" SG_ 393 VCU_MotorRegenTrqLmtlnDVaild 0;
BA_ "GenSigSendType" SG_ 393 VCU_MotorRegenTrqLmtlnDVaild 1;
BA_ "GenSigStartValue" SG_ 393 VCU_MotorRegenTrqLmtlnDVaild 0;
BA_ "GenSigTimeoutValue" SG_ 393 VCU_MotorRegenTrqLmtlnDVaild 0;
BA_ "Remark" SG_ 393 VCU_MotorRegenTrqLmtlnDVaild "";
BA_ "EventCommandSignal" SG_ 393 VCU_GearShiftAvl 0;
BA_ "GatewayedSignals" SG_ 393 VCU_GearShiftAvl 0;
BA_ "GenSigInactiveValue" SG_ 393 VCU_GearShiftAvl 0;
BA_ "GenSigInvalidValue" SG_ 393 VCU_GearShiftAvl 0;
BA_ "GenSigSendType" SG_ 393 VCU_GearShiftAvl 1;
BA_ "GenSigStartValue" SG_ 393 VCU_GearShiftAvl 0;
BA_ "GenSigTimeoutValue" SG_ 393 VCU_GearShiftAvl 0;
BA_ "Remark" SG_ 393 VCU_GearShiftAvl "";
BA_ "EventCommandSignal" SG_ 393 VCU_PtTqAvl 0;
BA_ "GatewayedSignals" SG_ 393 VCU_PtTqAvl 0;
BA_ "GenSigInactiveValue" SG_ 393 VCU_PtTqAvl 0;
BA_ "GenSigInvalidValue" SG_ 393 VCU_PtTqAvl 0;
BA_ "GenSigSendType" SG_ 393 VCU_PtTqAvl 1;
BA_ "GenSigStartValue" SG_ 393 VCU_PtTqAvl 0;
BA_ "GenSigTimeoutValue" SG_ 393 VCU_PtTqAvl 0;
BA_ "Remark" SG_ 393 VCU_PtTqAvl "";
BA_ "EventCommandSignal" SG_ 393 VCU_PtTqActvSts 0;
BA_ "GatewayedSignals" SG_ 393 VCU_PtTqActvSts 0;
BA_ "GenSigInactiveValue" SG_ 393 VCU_PtTqActvSts 0;
BA_ "GenSigInvalidValue" SG_ 393 VCU_PtTqActvSts 0;
BA_ "GenSigSendType" SG_ 393 VCU_PtTqActvSts 1;
BA_ "GenSigStartValue" SG_ 393 VCU_PtTqActvSts 0;
BA_ "GenSigTimeoutValue" SG_ 393 VCU_PtTqActvSts 0;
BA_ "Remark" SG_ 393 VCU_PtTqActvSts "";
BA_ "EventCommandSignal" SG_ 393 VCU_MotorRegenTorqueLmtlnD 0;
BA_ "GatewayedSignals" SG_ 393 VCU_MotorRegenTorqueLmtlnD 0;
BA_ "GenSigInactiveValue" SG_ 393 VCU_MotorRegenTorqueLmtlnD 0;
BA_ "GenSigInvalidValue" SG_ 393 VCU_MotorRegenTorqueLmtlnD 0;
BA_ "GenSigSendType" SG_ 393 VCU_MotorRegenTorqueLmtlnD 1;
BA_ "GenSigStartValue" SG_ 393 VCU_MotorRegenTorqueLmtlnD 8191;
BA_ "GenSigTimeoutValue" SG_ 393 VCU_MotorRegenTorqueLmtlnD 0;
BA_ "Remark" SG_ 393 VCU_MotorRegenTorqueLmtlnD "";
BA_ "EventCommandSignal" SG_ 393 VCU_DriverTorqueDesired 0;
BA_ "GatewayedSignals" SG_ 393 VCU_DriverTorqueDesired 0;
BA_ "GenSigInactiveValue" SG_ 393 VCU_DriverTorqueDesired 0;
BA_ "GenSigInvalidValue" SG_ 393 VCU_DriverTorqueDesired 0;
BA_ "GenSigSendType" SG_ 393 VCU_DriverTorqueDesired 1;
BA_ "GenSigStartValue" SG_ 393 VCU_DriverTorqueDesired 32768;
BA_ "GenSigTimeoutValue" SG_ 393 VCU_DriverTorqueDesired 0;
BA_ "Remark" SG_ 393 VCU_DriverTorqueDesired "";
BA_ "EventCommandSignal" SG_ 393 VCU_VehWhlReqTq 0;
BA_ "GatewayedSignals" SG_ 393 VCU_VehWhlReqTq 0;
BA_ "GenSigInactiveValue" SG_ 393 VCU_VehWhlReqTq 0;
BA_ "GenSigInvalidValue" SG_ 393 VCU_VehWhlReqTq 0;
BA_ "GenSigSendType" SG_ 393 VCU_VehWhlReqTq 1;
BA_ "GenSigStartValue" SG_ 393 VCU_VehWhlReqTq 32768;
BA_ "GenSigTimeoutValue" SG_ 393 VCU_VehWhlReqTq 0;
BA_ "Remark" SG_ 393 VCU_VehWhlReqTq "";
BA_ "EventCommandSignal" SG_ 393 VCU_TargetRecpTorqSt 0;
BA_ "GatewayedSignals" SG_ 393 VCU_TargetRecpTorqSt 0;
BA_ "GenSigInactiveValue" SG_ 393 VCU_TargetRecpTorqSt 0;
BA_ "GenSigInvalidValue" SG_ 393 VCU_TargetRecpTorqSt 0;
BA_ "GenSigSendType" SG_ 393 VCU_TargetRecpTorqSt 1;
BA_ "GenSigStartValue" SG_ 393 VCU_TargetRecpTorqSt 0;
BA_ "GenSigTimeoutValue" SG_ 393 VCU_TargetRecpTorqSt 0;
BA_ "Remark" SG_ 393 VCU_TargetRecpTorqSt "";
BA_ "EventCommandSignal" SG_ 393 VCU_TargetRecpTorqNm 0;
BA_ "GatewayedSignals" SG_ 393 VCU_TargetRecpTorqNm 0;
BA_ "GenSigInactiveValue" SG_ 393 VCU_TargetRecpTorqNm 0;
BA_ "GenSigInvalidValue" SG_ 393 VCU_TargetRecpTorqNm 0;
BA_ "GenSigSendType" SG_ 393 VCU_TargetRecpTorqNm 1;
BA_ "GenSigStartValue" SG_ 393 VCU_TargetRecpTorqNm 0;
BA_ "GenSigTimeoutValue" SG_ 393 VCU_TargetRecpTorqNm 0;
BA_ "Remark" SG_ 393 VCU_TargetRecpTorqNm "";
BA_ "EventCommandSignal" SG_ 393 VCU_TargetRecpTorqFA_Hyb 0;
BA_ "GatewayedSignals" SG_ 393 VCU_TargetRecpTorqFA_Hyb 0;
BA_ "GenSigInactiveValue" SG_ 393 VCU_TargetRecpTorqFA_Hyb 0;
BA_ "GenSigInvalidValue" SG_ 393 VCU_TargetRecpTorqFA_Hyb 0;
BA_ "GenSigSendType" SG_ 393 VCU_TargetRecpTorqFA_Hyb 1;
BA_ "GenSigStartValue" SG_ 393 VCU_TargetRecpTorqFA_Hyb 0;
BA_ "GenSigTimeoutValue" SG_ 393 VCU_TargetRecpTorqFA_Hyb 0;
BA_ "Remark" SG_ 393 VCU_TargetRecpTorqFA_Hyb "";
BA_ "EventCommandSignal" SG_ 393 VCU_TargetRecpTorqRA_Hyb 0;
BA_ "GatewayedSignals" SG_ 393 VCU_TargetRecpTorqRA_Hyb 0;
BA_ "GenSigInactiveValue" SG_ 393 VCU_TargetRecpTorqRA_Hyb 0;
BA_ "GenSigInvalidValue" SG_ 393 VCU_TargetRecpTorqRA_Hyb 0;
BA_ "GenSigSendType" SG_ 393 VCU_TargetRecpTorqRA_Hyb 1;
BA_ "GenSigStartValue" SG_ 393 VCU_TargetRecpTorqRA_Hyb 0;
BA_ "GenSigTimeoutValue" SG_ 393 VCU_TargetRecpTorqRA_Hyb 0;
BA_ "Remark" SG_ 393 VCU_TargetRecpTorqRA_Hyb "";
BA_ "EventCommandSignal" SG_ 393 VCU_TorqDriverReqFA_Hyb 0;
BA_ "GatewayedSignals" SG_ 393 VCU_TorqDriverReqFA_Hyb 0;
BA_ "GenSigInactiveValue" SG_ 393 VCU_TorqDriverReqFA_Hyb 0;
BA_ "GenSigInvalidValue" SG_ 393 VCU_TorqDriverReqFA_Hyb 0;
BA_ "GenSigSendType" SG_ 393 VCU_TorqDriverReqFA_Hyb 1;
BA_ "GenSigStartValue" SG_ 393 VCU_TorqDriverReqFA_Hyb 0;
BA_ "GenSigTimeoutValue" SG_ 393 VCU_TorqDriverReqFA_Hyb 0;
BA_ "Remark" SG_ 393 VCU_TorqDriverReqFA_Hyb "";
BA_ "EventCommandSignal" SG_ 393 VCU_TorqDriverReqRA_Hyb 0;
BA_ "GatewayedSignals" SG_ 393 VCU_TorqDriverReqRA_Hyb 0;
BA_ "GenSigInactiveValue" SG_ 393 VCU_TorqDriverReqRA_Hyb 0;
BA_ "GenSigInvalidValue" SG_ 393 VCU_TorqDriverReqRA_Hyb 0;
BA_ "GenSigSendType" SG_ 393 VCU_TorqDriverReqRA_Hyb 1;
BA_ "GenSigStartValue" SG_ 393 VCU_TorqDriverReqRA_Hyb 0;
BA_ "GenSigTimeoutValue" SG_ 393 VCU_TorqDriverReqRA_Hyb 0;
BA_ "Remark" SG_ 393 VCU_TorqDriverReqRA_Hyb "";
BA_ "EventCommandSignal" SG_ 393 VCU_VehActDrvTorqFA_Hyb 0;
BA_ "GatewayedSignals" SG_ 393 VCU_VehActDrvTorqFA_Hyb 0;
BA_ "GenSigInactiveValue" SG_ 393 VCU_VehActDrvTorqFA_Hyb 0;
BA_ "GenSigInvalidValue" SG_ 393 VCU_VehActDrvTorqFA_Hyb 0;
BA_ "GenSigSendType" SG_ 393 VCU_VehActDrvTorqFA_Hyb 1;
BA_ "GenSigStartValue" SG_ 393 VCU_VehActDrvTorqFA_Hyb 0;
BA_ "GenSigTimeoutValue" SG_ 393 VCU_VehActDrvTorqFA_Hyb 0;
BA_ "Remark" SG_ 393 VCU_VehActDrvTorqFA_Hyb "";
BA_ "EventCommandSignal" SG_ 393 VCU_VehActDrvTorqRA_Hyb 0;
BA_ "GatewayedSignals" SG_ 393 VCU_VehActDrvTorqRA_Hyb 0;
BA_ "GenSigInactiveValue" SG_ 393 VCU_VehActDrvTorqRA_Hyb 0;
BA_ "GenSigInvalidValue" SG_ 393 VCU_VehActDrvTorqRA_Hyb 0;
BA_ "GenSigSendType" SG_ 393 VCU_VehActDrvTorqRA_Hyb 1;
BA_ "GenSigStartValue" SG_ 393 VCU_VehActDrvTorqRA_Hyb 0;
BA_ "GenSigTimeoutValue" SG_ 393 VCU_VehActDrvTorqRA_Hyb 0;
BA_ "Remark" SG_ 393 VCU_VehActDrvTorqRA_Hyb "";
BA_ "EventCommandSignal" SG_ 393 VCU_TargetRecpTorqFAVD_Hyb 0;
BA_ "GatewayedSignals" SG_ 393 VCU_TargetRecpTorqFAVD_Hyb 0;
BA_ "GenSigInactiveValue" SG_ 393 VCU_TargetRecpTorqFAVD_Hyb 0;
BA_ "GenSigInvalidValue" SG_ 393 VCU_TargetRecpTorqFAVD_Hyb 0;
BA_ "GenSigSendType" SG_ 393 VCU_TargetRecpTorqFAVD_Hyb 1;
BA_ "GenSigStartValue" SG_ 393 VCU_TargetRecpTorqFAVD_Hyb 0;
BA_ "GenSigTimeoutValue" SG_ 393 VCU_TargetRecpTorqFAVD_Hyb 0;
BA_ "Remark" SG_ 393 VCU_TargetRecpTorqFAVD_Hyb "";
BA_ "EventCommandSignal" SG_ 393 VCU_TargetRecpTorqRAVD_Hyb 0;
BA_ "GatewayedSignals" SG_ 393 VCU_TargetRecpTorqRAVD_Hyb 0;
BA_ "GenSigInactiveValue" SG_ 393 VCU_TargetRecpTorqRAVD_Hyb 0;
BA_ "GenSigInvalidValue" SG_ 393 VCU_TargetRecpTorqRAVD_Hyb 0;
BA_ "GenSigSendType" SG_ 393 VCU_TargetRecpTorqRAVD_Hyb 1;
BA_ "GenSigStartValue" SG_ 393 VCU_TargetRecpTorqRAVD_Hyb 0;
BA_ "GenSigTimeoutValue" SG_ 393 VCU_TargetRecpTorqRAVD_Hyb 0;
BA_ "Remark" SG_ 393 VCU_TargetRecpTorqRAVD_Hyb "";
BA_ "EventCommandSignal" SG_ 393 VCU_TorqDriverReqFAVD 0;
BA_ "GatewayedSignals" SG_ 393 VCU_TorqDriverReqFAVD 0;
BA_ "GenSigInactiveValue" SG_ 393 VCU_TorqDriverReqFAVD 0;
BA_ "GenSigInvalidValue" SG_ 393 VCU_TorqDriverReqFAVD 0;
BA_ "GenSigSendType" SG_ 393 VCU_TorqDriverReqFAVD 1;
BA_ "GenSigStartValue" SG_ 393 VCU_TorqDriverReqFAVD 0;
BA_ "GenSigTimeoutValue" SG_ 393 VCU_TorqDriverReqFAVD 0;
BA_ "Remark" SG_ 393 VCU_TorqDriverReqFAVD "";
BA_ "EventCommandSignal" SG_ 393 VCU_TorqDriverReqRAVD 0;
BA_ "GatewayedSignals" SG_ 393 VCU_TorqDriverReqRAVD 0;
BA_ "GenSigInactiveValue" SG_ 393 VCU_TorqDriverReqRAVD 0;
BA_ "GenSigInvalidValue" SG_ 393 VCU_TorqDriverReqRAVD 0;
BA_ "GenSigSendType" SG_ 393 VCU_TorqDriverReqRAVD 1;
BA_ "GenSigStartValue" SG_ 393 VCU_TorqDriverReqRAVD 0;
BA_ "GenSigTimeoutValue" SG_ 393 VCU_TorqDriverReqRAVD 0;
BA_ "Remark" SG_ 393 VCU_TorqDriverReqRAVD "";
BA_ "EventCommandSignal" SG_ 393 VCU_VehActDrvTorqFAVD_Hyb 0;
BA_ "GatewayedSignals" SG_ 393 VCU_VehActDrvTorqFAVD_Hyb 0;
BA_ "GenSigInactiveValue" SG_ 393 VCU_VehActDrvTorqFAVD_Hyb 0;
BA_ "GenSigInvalidValue" SG_ 393 VCU_VehActDrvTorqFAVD_Hyb 0;
BA_ "GenSigSendType" SG_ 393 VCU_VehActDrvTorqFAVD_Hyb 1;
BA_ "GenSigStartValue" SG_ 393 VCU_VehActDrvTorqFAVD_Hyb 0;
BA_ "GenSigTimeoutValue" SG_ 393 VCU_VehActDrvTorqFAVD_Hyb 0;
BA_ "Remark" SG_ 393 VCU_VehActDrvTorqFAVD_Hyb "";
BA_ "EventCommandSignal" SG_ 393 VCU_VehActDrvTorqRAVD_Hyb 0;
BA_ "GatewayedSignals" SG_ 393 VCU_VehActDrvTorqRAVD_Hyb 0;
BA_ "GenSigInactiveValue" SG_ 393 VCU_VehActDrvTorqRAVD_Hyb 0;
BA_ "GenSigInvalidValue" SG_ 393 VCU_VehActDrvTorqRAVD_Hyb 0;
BA_ "GenSigSendType" SG_ 393 VCU_VehActDrvTorqRAVD_Hyb 1;
BA_ "GenSigStartValue" SG_ 393 VCU_VehActDrvTorqRAVD_Hyb 0;
BA_ "GenSigTimeoutValue" SG_ 393 VCU_VehActDrvTorqRAVD_Hyb 0;
BA_ "Remark" SG_ 393 VCU_VehActDrvTorqRAVD_Hyb "";
BA_ "EventCommandSignal" SG_ 393 VCU_BcsDecelReq 0;
BA_ "GatewayedSignals" SG_ 393 VCU_BcsDecelReq 0;
BA_ "GenSigInactiveValue" SG_ 393 VCU_BcsDecelReq 0;
BA_ "GenSigInvalidValue" SG_ 393 VCU_BcsDecelReq 0;
BA_ "GenSigSendType" SG_ 393 VCU_BcsDecelReq 1;
BA_ "GenSigStartValue" SG_ 393 VCU_BcsDecelReq 15;
BA_ "GenSigTimeoutValue" SG_ 393 VCU_BcsDecelReq 0;
BA_ "Remark" SG_ 393 VCU_BcsDecelReq "";
BA_ "EventCommandSignal" SG_ 393 VCU_BcsDecelVD 0;
BA_ "GatewayedSignals" SG_ 393 VCU_BcsDecelVD 0;
BA_ "GenSigInactiveValue" SG_ 393 VCU_BcsDecelVD 0;
BA_ "GenSigInvalidValue" SG_ 393 VCU_BcsDecelVD 0;
BA_ "GenSigSendType" SG_ 393 VCU_BcsDecelVD 1;
BA_ "GenSigStartValue" SG_ 393 VCU_BcsDecelVD 0;
BA_ "GenSigTimeoutValue" SG_ 393 VCU_BcsDecelVD 0;
BA_ "Remark" SG_ 393 VCU_BcsDecelVD "";
BA_ "EventCommandSignal" SG_ 393 VCU_BcsDecelEnable 0;
BA_ "GatewayedSignals" SG_ 393 VCU_BcsDecelEnable 0;
BA_ "GenSigInactiveValue" SG_ 393 VCU_BcsDecelEnable 0;
BA_ "GenSigInvalidValue" SG_ 393 VCU_BcsDecelEnable 0;
BA_ "GenSigSendType" SG_ 393 VCU_BcsDecelEnable 1;
BA_ "GenSigStartValue" SG_ 393 VCU_BcsDecelEnable 0;
BA_ "GenSigTimeoutValue" SG_ 393 VCU_BcsDecelEnable 0;
BA_ "Remark" SG_ 393 VCU_BcsDecelEnable "";
BA_ "EventCommandSignal" SG_ 393 VCU_CrntGearNoTrans 0;
BA_ "GatewayedSignals" SG_ 393 VCU_CrntGearNoTrans 0;
BA_ "GenSigInactiveValue" SG_ 393 VCU_CrntGearNoTrans 0;
BA_ "GenSigInvalidValue" SG_ 393 VCU_CrntGearNoTrans 0;
BA_ "GenSigSendType" SG_ 393 VCU_CrntGearNoTrans 1;
BA_ "GenSigStartValue" SG_ 393 VCU_CrntGearNoTrans 0;
BA_ "GenSigTimeoutValue" SG_ 393 VCU_CrntGearNoTrans 0;
BA_ "Remark" SG_ 393 VCU_CrntGearNoTrans "";
BA_ "EventCommandSignal" SG_ 393 VCU_RecpTorqSt 0;
BA_ "GatewayedSignals" SG_ 393 VCU_RecpTorqSt 0;
BA_ "GenSigInactiveValue" SG_ 393 VCU_RecpTorqSt 0;
BA_ "GenSigInvalidValue" SG_ 393 VCU_RecpTorqSt 0;
BA_ "GenSigSendType" SG_ 393 VCU_RecpTorqSt 1;
BA_ "GenSigStartValue" SG_ 393 VCU_RecpTorqSt 0;
BA_ "GenSigTimeoutValue" SG_ 393 VCU_RecpTorqSt 0;
BA_ "Remark" SG_ 393 VCU_RecpTorqSt "";
BA_ "EventCommandSignal" SG_ 393 VCU_RecpTorqNm 0;
BA_ "GatewayedSignals" SG_ 393 VCU_RecpTorqNm 0;
BA_ "GenSigInactiveValue" SG_ 393 VCU_RecpTorqNm 0;
BA_ "GenSigInvalidValue" SG_ 393 VCU_RecpTorqNm 0;
BA_ "GenSigSendType" SG_ 393 VCU_RecpTorqNm 1;
BA_ "GenSigStartValue" SG_ 393 VCU_RecpTorqNm 0;
BA_ "GenSigTimeoutValue" SG_ 393 VCU_RecpTorqNm 0;
BA_ "Remark" SG_ 393 VCU_RecpTorqNm "";
BA_ "EventCommandSignal" SG_ 393 VCU_RecpTorqFAVD_Hyb 0;
BA_ "GatewayedSignals" SG_ 393 VCU_RecpTorqFAVD_Hyb 0;
BA_ "GenSigInactiveValue" SG_ 393 VCU_RecpTorqFAVD_Hyb 0;
BA_ "GenSigInvalidValue" SG_ 393 VCU_RecpTorqFAVD_Hyb 0;
BA_ "GenSigSendType" SG_ 393 VCU_RecpTorqFAVD_Hyb 1;
BA_ "GenSigStartValue" SG_ 393 VCU_RecpTorqFAVD_Hyb 0;
BA_ "GenSigTimeoutValue" SG_ 393 VCU_RecpTorqFAVD_Hyb 0;
BA_ "Remark" SG_ 393 VCU_RecpTorqFAVD_Hyb "";
BA_ "EventCommandSignal" SG_ 393 VCU_RecpTorqRAVD_Hyb 0;
BA_ "GatewayedSignals" SG_ 393 VCU_RecpTorqRAVD_Hyb 0;
BA_ "GenSigInactiveValue" SG_ 393 VCU_RecpTorqRAVD_Hyb 0;
BA_ "GenSigInvalidValue" SG_ 393 VCU_RecpTorqRAVD_Hyb 0;
BA_ "GenSigSendType" SG_ 393 VCU_RecpTorqRAVD_Hyb 1;
BA_ "GenSigStartValue" SG_ 393 VCU_RecpTorqRAVD_Hyb 0;
BA_ "GenSigTimeoutValue" SG_ 393 VCU_RecpTorqRAVD_Hyb 0;
BA_ "Remark" SG_ 393 VCU_RecpTorqRAVD_Hyb "";
BA_ "EventCommandSignal" SG_ 393 VCU_MaxRecpTorqFAVD_Hyb 0;
BA_ "GatewayedSignals" SG_ 393 VCU_MaxRecpTorqFAVD_Hyb 0;
BA_ "GenSigInactiveValue" SG_ 393 VCU_MaxRecpTorqFAVD_Hyb 0;
BA_ "GenSigInvalidValue" SG_ 393 VCU_MaxRecpTorqFAVD_Hyb 0;
BA_ "GenSigSendType" SG_ 393 VCU_MaxRecpTorqFAVD_Hyb 1;
BA_ "GenSigStartValue" SG_ 393 VCU_MaxRecpTorqFAVD_Hyb 0;
BA_ "GenSigTimeoutValue" SG_ 393 VCU_MaxRecpTorqFAVD_Hyb 0;
BA_ "Remark" SG_ 393 VCU_MaxRecpTorqFAVD_Hyb "";
BA_ "EventCommandSignal" SG_ 393 VCU_MaxRecpTorqRAVD_Hyb 0;
BA_ "GatewayedSignals" SG_ 393 VCU_MaxRecpTorqRAVD_Hyb 0;
BA_ "GenSigInactiveValue" SG_ 393 VCU_MaxRecpTorqRAVD_Hyb 0;
BA_ "GenSigInvalidValue" SG_ 393 VCU_MaxRecpTorqRAVD_Hyb 0;
BA_ "GenSigSendType" SG_ 393 VCU_MaxRecpTorqRAVD_Hyb 1;
BA_ "GenSigStartValue" SG_ 393 VCU_MaxRecpTorqRAVD_Hyb 0;
BA_ "GenSigTimeoutValue" SG_ 393 VCU_MaxRecpTorqRAVD_Hyb 0;
BA_ "Remark" SG_ 393 VCU_MaxRecpTorqRAVD_Hyb "";
BA_ "EventCommandSignal" SG_ 393 VCU_RecpTorqFA_Hyb 0;
BA_ "GatewayedSignals" SG_ 393 VCU_RecpTorqFA_Hyb 0;
BA_ "GenSigInactiveValue" SG_ 393 VCU_RecpTorqFA_Hyb 0;
BA_ "GenSigInvalidValue" SG_ 393 VCU_RecpTorqFA_Hyb 0;
BA_ "GenSigSendType" SG_ 393 VCU_RecpTorqFA_Hyb 1;
BA_ "GenSigStartValue" SG_ 393 VCU_RecpTorqFA_Hyb 0;
BA_ "GenSigTimeoutValue" SG_ 393 VCU_RecpTorqFA_Hyb 0;
BA_ "Remark" SG_ 393 VCU_RecpTorqFA_Hyb "";
BA_ "EventCommandSignal" SG_ 393 VCU_RecpTorqRA_Hyb 0;
BA_ "GatewayedSignals" SG_ 393 VCU_RecpTorqRA_Hyb 0;
BA_ "GenSigInactiveValue" SG_ 393 VCU_RecpTorqRA_Hyb 0;
BA_ "GenSigInvalidValue" SG_ 393 VCU_RecpTorqRA_Hyb 0;
BA_ "GenSigSendType" SG_ 393 VCU_RecpTorqRA_Hyb 1;
BA_ "GenSigStartValue" SG_ 393 VCU_RecpTorqRA_Hyb 0;
BA_ "GenSigTimeoutValue" SG_ 393 VCU_RecpTorqRA_Hyb 0;
BA_ "Remark" SG_ 393 VCU_RecpTorqRA_Hyb "";
BA_ "EventCommandSignal" SG_ 393 VCU_MaxRecpTorqFA_Hyb 0;
BA_ "GatewayedSignals" SG_ 393 VCU_MaxRecpTorqFA_Hyb 0;
BA_ "GenSigInactiveValue" SG_ 393 VCU_MaxRecpTorqFA_Hyb 0;
BA_ "GenSigInvalidValue" SG_ 393 VCU_MaxRecpTorqFA_Hyb 0;
BA_ "GenSigSendType" SG_ 393 VCU_MaxRecpTorqFA_Hyb 1;
BA_ "GenSigStartValue" SG_ 393 VCU_MaxRecpTorqFA_Hyb 0;
BA_ "GenSigTimeoutValue" SG_ 393 VCU_MaxRecpTorqFA_Hyb 0;
BA_ "Remark" SG_ 393 VCU_MaxRecpTorqFA_Hyb "";
BA_ "EventCommandSignal" SG_ 393 VCU_MaxRecpTorqRA_Hyb 0;
BA_ "GatewayedSignals" SG_ 393 VCU_MaxRecpTorqRA_Hyb 0;
BA_ "GenSigInactiveValue" SG_ 393 VCU_MaxRecpTorqRA_Hyb 0;
BA_ "GenSigInvalidValue" SG_ 393 VCU_MaxRecpTorqRA_Hyb 0;
BA_ "GenSigSendType" SG_ 393 VCU_MaxRecpTorqRA_Hyb 1;
BA_ "GenSigStartValue" SG_ 393 VCU_MaxRecpTorqRA_Hyb 0;
BA_ "GenSigTimeoutValue" SG_ 393 VCU_MaxRecpTorqRA_Hyb 0;
BA_ "Remark" SG_ 393 VCU_MaxRecpTorqRA_Hyb "";
BA_ "EventCommandSignal" SG_ 393 VCU_VehWheelTorqMinNm 0;
BA_ "GatewayedSignals" SG_ 393 VCU_VehWheelTorqMinNm 0;
BA_ "GenSigInactiveValue" SG_ 393 VCU_VehWheelTorqMinNm 0;
BA_ "GenSigInvalidValue" SG_ 393 VCU_VehWheelTorqMinNm 32767;
BA_ "GenSigSendType" SG_ 393 VCU_VehWheelTorqMinNm 1;
BA_ "GenSigStartValue" SG_ 393 VCU_VehWheelTorqMinNm 32766;
BA_ "GenSigTimeoutValue" SG_ 393 VCU_VehWheelTorqMinNm 0;
BA_ "Remark" SG_ 393 VCU_VehWheelTorqMinNm "";
BA_ "EventCommandSignal" SG_ 393 VCU_VehWheelTorqMaxNmVD 0;
BA_ "GatewayedSignals" SG_ 393 VCU_VehWheelTorqMaxNmVD 0;
BA_ "GenSigInactiveValue" SG_ 393 VCU_VehWheelTorqMaxNmVD 0;
BA_ "GenSigInvalidValue" SG_ 393 VCU_VehWheelTorqMaxNmVD 0;
BA_ "GenSigSendType" SG_ 393 VCU_VehWheelTorqMaxNmVD 1;
BA_ "GenSigStartValue" SG_ 393 VCU_VehWheelTorqMaxNmVD 0;
BA_ "GenSigTimeoutValue" SG_ 393 VCU_VehWheelTorqMaxNmVD 0;
BA_ "Remark" SG_ 393 VCU_VehWheelTorqMaxNmVD "";
BA_ "EventCommandSignal" SG_ 393 VCU_VehWheelTorqMaxNm 0;
BA_ "GatewayedSignals" SG_ 393 VCU_VehWheelTorqMaxNm 0;
BA_ "GenSigInactiveValue" SG_ 393 VCU_VehWheelTorqMaxNm 0;
BA_ "GenSigInvalidValue" SG_ 393 VCU_VehWheelTorqMaxNm 32767;
BA_ "GenSigSendType" SG_ 393 VCU_VehWheelTorqMaxNm 1;
BA_ "GenSigStartValue" SG_ 393 VCU_VehWheelTorqMaxNm 32766;
BA_ "GenSigTimeoutValue" SG_ 393 VCU_VehWheelTorqMaxNm 0;
BA_ "Remark" SG_ 393 VCU_VehWheelTorqMaxNm "";
BA_ "EventCommandSignal" SG_ 393 VCU_ActVehWheelTorqNm 0;
BA_ "GatewayedSignals" SG_ 393 VCU_ActVehWheelTorqNm 0;
BA_ "GenSigInactiveValue" SG_ 393 VCU_ActVehWheelTorqNm 0;
BA_ "GenSigInvalidValue" SG_ 393 VCU_ActVehWheelTorqNm 0;
BA_ "GenSigSendType" SG_ 393 VCU_ActVehWheelTorqNm 1;
BA_ "GenSigStartValue" SG_ 393 VCU_ActVehWheelTorqNm 32766;
BA_ "GenSigTimeoutValue" SG_ 393 VCU_ActVehWheelTorqNm 0;
BA_ "Remark" SG_ 393 VCU_ActVehWheelTorqNm "";
BA_ "EventCommandSignal" SG_ 393 VCU_APAWheelTorqDriverReqNm 0;
BA_ "GatewayedSignals" SG_ 393 VCU_APAWheelTorqDriverReqNm 0;
BA_ "GenSigInactiveValue" SG_ 393 VCU_APAWheelTorqDriverReqNm 0;
BA_ "GenSigInvalidValue" SG_ 393 VCU_APAWheelTorqDriverReqNm 32767;
BA_ "GenSigSendType" SG_ 393 VCU_APAWheelTorqDriverReqNm 1;
BA_ "GenSigStartValue" SG_ 393 VCU_APAWheelTorqDriverReqNm 32766;
BA_ "GenSigTimeoutValue" SG_ 393 VCU_APAWheelTorqDriverReqNm 0;
BA_ "Remark" SG_ 393 VCU_APAWheelTorqDriverReqNm "";
BA_ "EventCommandSignal" SG_ 512 KAE_BLE1Position 1;
BA_ "GatewayedSignals" SG_ 512 KAE_BLE1Position 0;
BA_ "GenSigInactiveValue" SG_ 512 KAE_BLE1Position 0;
BA_ "GenSigInvalidValue" SG_ 512 KAE_BLE1Position 0;
BA_ "GenSigSendType" SG_ 512 KAE_BLE1Position 0;
BA_ "GenSigStartValue" SG_ 512 KAE_BLE1Position 0;
BA_ "GenSigTimeoutValue" SG_ 512 KAE_BLE1Position 0;
BA_ "Remark" SG_ 512 KAE_BLE1Position "";
BA_ "EventCommandSignal" SG_ 512 KAE_BLE2Position 1;
BA_ "GatewayedSignals" SG_ 512 KAE_BLE2Position 0;
BA_ "GenSigInactiveValue" SG_ 512 KAE_BLE2Position 0;
BA_ "GenSigInvalidValue" SG_ 512 KAE_BLE2Position 0;
BA_ "GenSigSendType" SG_ 512 KAE_BLE2Position 0;
BA_ "GenSigStartValue" SG_ 512 KAE_BLE2Position 0;
BA_ "GenSigTimeoutValue" SG_ 512 KAE_BLE2Position 0;
BA_ "Remark" SG_ 512 KAE_BLE2Position "";
BA_ "EventCommandSignal" SG_ 512 KAE_BLE3Position 1;
BA_ "GatewayedSignals" SG_ 512 KAE_BLE3Position 0;
BA_ "GenSigInactiveValue" SG_ 512 KAE_BLE3Position 0;
BA_ "GenSigInvalidValue" SG_ 512 KAE_BLE3Position 0;
BA_ "GenSigSendType" SG_ 512 KAE_BLE3Position 0;
BA_ "GenSigStartValue" SG_ 512 KAE_BLE3Position 0;
BA_ "GenSigTimeoutValue" SG_ 512 KAE_BLE3Position 0;
BA_ "Remark" SG_ 512 KAE_BLE3Position "";
BA_ "EventCommandSignal" SG_ 512 KAE_BLE4Position 1;
BA_ "GatewayedSignals" SG_ 512 KAE_BLE4Position 0;
BA_ "GenSigInactiveValue" SG_ 512 KAE_BLE4Position 0;
BA_ "GenSigInvalidValue" SG_ 512 KAE_BLE4Position 0;
BA_ "GenSigSendType" SG_ 512 KAE_BLE4Position 0;
BA_ "GenSigStartValue" SG_ 512 KAE_BLE4Position 0;
BA_ "GenSigTimeoutValue" SG_ 512 KAE_BLE4Position 0;
BA_ "Remark" SG_ 512 KAE_BLE4Position "";
BA_ "EventCommandSignal" SG_ 512 KAE_BLE5Position 1;
BA_ "GatewayedSignals" SG_ 512 KAE_BLE5Position 0;
BA_ "GenSigInactiveValue" SG_ 512 KAE_BLE5Position 0;
BA_ "GenSigInvalidValue" SG_ 512 KAE_BLE5Position 0;
BA_ "GenSigSendType" SG_ 512 KAE_BLE5Position 0;
BA_ "GenSigStartValue" SG_ 512 KAE_BLE5Position 0;
BA_ "GenSigTimeoutValue" SG_ 512 KAE_BLE5Position 0;
BA_ "Remark" SG_ 512 KAE_BLE5Position "";
BA_ "EventCommandSignal" SG_ 512 KAE_BLE1AuthSt 1;
BA_ "GatewayedSignals" SG_ 512 KAE_BLE1AuthSt 0;
BA_ "GenSigInactiveValue" SG_ 512 KAE_BLE1AuthSt 0;
BA_ "GenSigInvalidValue" SG_ 512 KAE_BLE1AuthSt 0;
BA_ "GenSigSendType" SG_ 512 KAE_BLE1AuthSt 0;
BA_ "GenSigStartValue" SG_ 512 KAE_BLE1AuthSt 0;
BA_ "GenSigTimeoutValue" SG_ 512 KAE_BLE1AuthSt 0;
BA_ "Remark" SG_ 512 KAE_BLE1AuthSt "";
BA_ "EventCommandSignal" SG_ 512 KAE_BLE2AuthSt 1;
BA_ "GatewayedSignals" SG_ 512 KAE_BLE2AuthSt 0;
BA_ "GenSigInactiveValue" SG_ 512 KAE_BLE2AuthSt 0;
BA_ "GenSigInvalidValue" SG_ 512 KAE_BLE2AuthSt 0;
BA_ "GenSigSendType" SG_ 512 KAE_BLE2AuthSt 0;
BA_ "GenSigStartValue" SG_ 512 KAE_BLE2AuthSt 0;
BA_ "GenSigTimeoutValue" SG_ 512 KAE_BLE2AuthSt 0;
BA_ "Remark" SG_ 512 KAE_BLE2AuthSt "";
BA_ "EventCommandSignal" SG_ 512 KAE_BLE3AuthSt 1;
BA_ "GatewayedSignals" SG_ 512 KAE_BLE3AuthSt 0;
BA_ "GenSigInactiveValue" SG_ 512 KAE_BLE3AuthSt 0;
BA_ "GenSigInvalidValue" SG_ 512 KAE_BLE3AuthSt 0;
BA_ "GenSigSendType" SG_ 512 KAE_BLE3AuthSt 0;
BA_ "GenSigStartValue" SG_ 512 KAE_BLE3AuthSt 0;
BA_ "GenSigTimeoutValue" SG_ 512 KAE_BLE3AuthSt 0;
BA_ "Remark" SG_ 512 KAE_BLE3AuthSt "";
BA_ "EventCommandSignal" SG_ 512 KAE_BLE4AuthSt 1;
BA_ "GatewayedSignals" SG_ 512 KAE_BLE4AuthSt 0;
BA_ "GenSigInactiveValue" SG_ 512 KAE_BLE4AuthSt 0;
BA_ "GenSigInvalidValue" SG_ 512 KAE_BLE4AuthSt 0;
BA_ "GenSigSendType" SG_ 512 KAE_BLE4AuthSt 0;
BA_ "GenSigStartValue" SG_ 512 KAE_BLE4AuthSt 0;
BA_ "GenSigTimeoutValue" SG_ 512 KAE_BLE4AuthSt 0;
BA_ "Remark" SG_ 512 KAE_BLE4AuthSt "";
BA_ "EventCommandSignal" SG_ 512 KAE_BLE5AuthSt 1;
BA_ "GatewayedSignals" SG_ 512 KAE_BLE5AuthSt 0;
BA_ "GenSigInactiveValue" SG_ 512 KAE_BLE5AuthSt 0;
BA_ "GenSigInvalidValue" SG_ 512 KAE_BLE5AuthSt 0;
BA_ "GenSigSendType" SG_ 512 KAE_BLE5AuthSt 0;
BA_ "GenSigStartValue" SG_ 512 KAE_BLE5AuthSt 0;
BA_ "GenSigTimeoutValue" SG_ 512 KAE_BLE5AuthSt 0;
BA_ "Remark" SG_ 512 KAE_BLE5AuthSt "";
BA_ "EventCommandSignal" SG_ 512 KAE_BLE1PKSPosition 1;
BA_ "GatewayedSignals" SG_ 512 KAE_BLE1PKSPosition 0;
BA_ "GenSigInactiveValue" SG_ 512 KAE_BLE1PKSPosition 0;
BA_ "GenSigInvalidValue" SG_ 512 KAE_BLE1PKSPosition 0;
BA_ "GenSigSendType" SG_ 512 KAE_BLE1PKSPosition 0;
BA_ "GenSigStartValue" SG_ 512 KAE_BLE1PKSPosition 0;
BA_ "GenSigTimeoutValue" SG_ 512 KAE_BLE1PKSPosition 0;
BA_ "Remark" SG_ 512 KAE_BLE1PKSPosition "";
BA_ "EventCommandSignal" SG_ 512 KAE_BLE2PKSPosition 1;
BA_ "GatewayedSignals" SG_ 512 KAE_BLE2PKSPosition 0;
BA_ "GenSigInactiveValue" SG_ 512 KAE_BLE2PKSPosition 0;
BA_ "GenSigInvalidValue" SG_ 512 KAE_BLE2PKSPosition 0;
BA_ "GenSigSendType" SG_ 512 KAE_BLE2PKSPosition 0;
BA_ "GenSigStartValue" SG_ 512 KAE_BLE2PKSPosition 0;
BA_ "GenSigTimeoutValue" SG_ 512 KAE_BLE2PKSPosition 0;
BA_ "Remark" SG_ 512 KAE_BLE2PKSPosition "";
BA_ "EventCommandSignal" SG_ 512 KAE_BLE3PKSPosition 1;
BA_ "GatewayedSignals" SG_ 512 KAE_BLE3PKSPosition 0;
BA_ "GenSigInactiveValue" SG_ 512 KAE_BLE3PKSPosition 0;
BA_ "GenSigInvalidValue" SG_ 512 KAE_BLE3PKSPosition 0;
BA_ "GenSigSendType" SG_ 512 KAE_BLE3PKSPosition 0;
BA_ "GenSigStartValue" SG_ 512 KAE_BLE3PKSPosition 0;
BA_ "GenSigTimeoutValue" SG_ 512 KAE_BLE3PKSPosition 0;
BA_ "Remark" SG_ 512 KAE_BLE3PKSPosition "";
BA_ "EventCommandSignal" SG_ 512 KAE_BLE4PKSPosition 1;
BA_ "GatewayedSignals" SG_ 512 KAE_BLE4PKSPosition 0;
BA_ "GenSigInactiveValue" SG_ 512 KAE_BLE4PKSPosition 0;
BA_ "GenSigInvalidValue" SG_ 512 KAE_BLE4PKSPosition 0;
BA_ "GenSigSendType" SG_ 512 KAE_BLE4PKSPosition 0;
BA_ "GenSigStartValue" SG_ 512 KAE_BLE4PKSPosition 0;
BA_ "GenSigTimeoutValue" SG_ 512 KAE_BLE4PKSPosition 0;
BA_ "Remark" SG_ 512 KAE_BLE4PKSPosition "";
BA_ "EventCommandSignal" SG_ 512 KAE_BLE5PKSPosition 1;
BA_ "GatewayedSignals" SG_ 512 KAE_BLE5PKSPosition 0;
BA_ "GenSigInactiveValue" SG_ 512 KAE_BLE5PKSPosition 0;
BA_ "GenSigInvalidValue" SG_ 512 KAE_BLE5PKSPosition 0;
BA_ "GenSigSendType" SG_ 512 KAE_BLE5PKSPosition 0;
BA_ "GenSigStartValue" SG_ 512 KAE_BLE5PKSPosition 0;
BA_ "GenSigTimeoutValue" SG_ 512 KAE_BLE5PKSPosition 0;
BA_ "Remark" SG_ 512 KAE_BLE5PKSPosition "";
VAL_ 430 SRS_CrashOutputSt 0 "No crash,"  ;
VAL_ 430 SRS_Front_CrashOutputSt 0 "No crash," 1 "Crash happen in last 2 sec.(transition lasts for 2sec)"  ;
VAL_ 430 SRS_DriverSide_CrashOutputSt 0 "No crash," 1 "Crash happen in last 2 sec.(transition lasts for 2sec)"  ;
VAL_ 430 SRS_PassengerSide_CrashOutputSt 0 "No crash," 1 "Crash happen in last 2 sec. (transition lasts for 2sec)"  ;
VAL_ 430 SRS_Rear_CrashOutputSt 0 "No crash," 1 "Crash happen in last 2 sec.(transition lasts for 2sec)"  ;
VAL_ 430 SRS_RolloverCrashOutputSt 0 "No crash," 1 "Crash happen in last 2 sec.(transition lasts for 2sec)"  ;
VAL_ 430 SRS_NearCrashOutputSt 0 "No crash," 1 "Crash happen in last 2 sec.(transition lasts for 2sec)"  ;
VAL_ 430 SRS_YawSnsCalibSt 0 "Sensor Not Calibrated" 1 "Sensor Calibrated"  ;
VAL_ 430 SRS_VehLongAccelVD 0 "Initializing" 1 "Valid" 2 "Invalid" 3 "Reserved"  ;
VAL_ 430 SRS_VehLatrlAccelVD 0 "Initializing" 1 "Valid" 2 "Invalid" 3 "Reserved"  ;
VAL_ 430 SRS_YawRateVD 0 "Initializing" 1 "Valid" 2 "Invalid" 3 "Reserved"  ;
VAL_ 939 SRS_PsngrSeatBeltSt 0 "Fastened" 1 "Unfastened" 2 "Not used" 3 "Invalid"  ;
VAL_ 939 SRS_DriverSeatBeltSt 0 "Fastened" 1 "Unfastened" 2 "Not used" 3 "Invalid"  ;
VAL_ 939 SRS_RearLeftSeatBeltSt 0 "Fastened" 1 "Unfastened" 2 "Not used" 3 "Invalid"  ;
VAL_ 939 SRS_AirbagFaultSt 0 "Not fault" 1 "Fault"  ;
VAL_ 939 SRS_RearRightSeatBeltSt 0 "Fastened" 1 "Unfastened" 2 "Not used" 3 "Invalid"  ;
VAL_ 939 SRS_RearMiddleSeatBeltSt 0 "Fastened" 1 "Unfastened" 2 "Not used" 3 "Invalid"  ;
VAL_ 363 EPS_StrngWhlTorqVD 0 "Not valid" 1 "Valid"  ;
VAL_ 363 TAS_CalibratedSt 0 "Not calibrated" 1 "Calibrated"  ;
VAL_ 363 EPS_SteeringAngleSpdVD 0 "Not valid" 1 "Valid"  ;
VAL_ 363 EPS_SteeringAngleVD 0 "Not valid" 1 "Valid"  ;
VAL_ 363 EPS_VMCErrFeedback 0 "No interruption" 1 "LKA Interruption" 2 "APA Interruption" 3 "Vehicle Speed Invalid" 4 "VMC Activation request error" 5 "VMC ECU Signal error" 6 "EPS Temp error" 7 "Request Torque Slope over limit" 8 "Request Torque Value over limit" 9 "Failed Temp Time Over Limit" 10 "EPS Permanently error" 11 "VMC Triggered safety monitor module" 12 "Drive Override" 13 "Reserved" 14 "Reserved" 15 "Reserved"  ;
VAL_ 363 EPS_PstOverlaySt_SideA 0 "Not Ready" 1 "Ready" 2 "Active" 3 "Failed"  ;
VAL_ 363 EPS_PstOverlaySt_SideB 0 "Not Ready" 1 "Ready" 2 "Active" 3 "Failed"  ;
VAL_ 363 EPS_HealthySt_SideA 0 "Healthy;" 1 "Slightly failure;" 2 "Abnormal;" 3 "Shut off;"  ;
VAL_ 363 EPS_HealthySt_SideB 0 "Healthy;" 1 "Slightly failure;" 2 "Abnormal;" 3 "Shut off;"  ;
VAL_ 363 EPS_PstOverlaySt 0 "Not Ready;" 1 "Ready;" 2 "100% Active;" 3 "50% Active;" 4 "Failed;" 5 "Reserved" 6 "Reserved" 7 "Reserved"  ;
VAL_ 363 EPS_HealthySt_DualSide 0 "Healthy;" 1 "Slightly failure;" 2 "Abnormal;" 3 "Shut off;"  ;
VAL_ 363 EPS_PstOverLayRdntSt 0 "Not Reduntant" 1 "Redundant"  ;
VAL_ 363 EPS_VibrationWarnSt_A 0 "Not Acitve" 1 "Active level 1" 2 "Active level 2" 3 "Active level 3"  ;
VAL_ 363 SAC_ErrFeedback_SideA 0 "No  interruption；" 1 "ADAS TqRateReq Over rangenge" 2 "Driver Override" 3 "Vehicle Speed Invalid" 4 "Activation Requestrian Error" 5 "ADC Channel A signal Error" 6 "EPS Error" 7 "IFC Signal Error" 8 "ADAS AngleReq Over range" 9 "ADAS AngleSpdReq Over range" 10 "ADAS TqReq Over range" 11 "Both ADAS Channel Error" 12 "ADC Channel B signal Error；" 13 "Reserved；" 14 "Reserved；" 15 "Reserved；"  ;
VAL_ 363 SAC_ErrFeedback_SideB 0 "No  interruption；" 1 "Reserved" 2 "Driver Override" 3 "Vehicle Speed Invalid" 4 "Activation Requestrian Error" 5 "Adas Channel A signal Error" 6 "EPS Error" 7 "IFC Signal Error" 8 "Adas AngleReq Over range" 9 "Reserved；" 10 "Reserved；" 11 "Both ADAS Channel Error" 12 "ADAS Channel B signal Error；" 13 "Reserved；" 14 "Reserved；" 15 "Reserved；"  ;
VAL_ 363 EPS_FunctionStyleSt 0 "Unknow" 1 "light" 2 "Comfort" 3 "Sport"  ;
VAL_ 363 EPS_SteeringModeSt 0 "Not ready" 1 "Ready" 2 "In transition" 3 "Fault"  ;
VAL_ 363 EPS_ActEffectiveChannel 0 "None；" 1 "Channel A （main-Channel）from ADC" 2 "Channel B（Sub-Channel） from ADC" 3 "Channel C（main-Channel） from IFC" 4 "Reserved" 5 "Reserved" 6 "Reserved" 7 "Reserved"  ;
VAL_ 363 EPS_ReqAngOverRange 0 "Not Over Range；" 1 "Over range"  ;
VAL_ 363 EPS_ReqAngSpdOverRange 0 "Not Over Range；" 1 "Over range"  ;
VAL_ 363 EPS_AssistPraSwitchToLKA 0 "Not in LAK mode；" 1 "In LKA Mode；"  ;
VAL_ 363 EPS_SteerGainEnable 0 "Disable；" 1 "Enable；"  ;
VAL_ 363 EPS_EmSteerEnbale 0 "Disable；" 1 "Enable；"  ;
VAL_ 363 EPS_SG_ErrFeedback 0 "No  interruption；" 1 "Premise fun abort" 2 "Invalid request" 3 "Reserved" 4 "Reserved" 5 "Reserved" 6 "Reserved" 7 "Reserved" 8 "Reserved" 9 "Reserved" 10 "Reserved" 11 "Reserved" 12 "Reserved" 13 "Reserved" 14 "Reserved" 15 "Reserved"  ;
VAL_ 363 EPS_EM_ErrFeedback 0 "No interruption" 1 "Reserved" 2 "Reserved" 3 "Reserved" 4 "Reserved" 5 "ADAS Signal err" 6 "EPS error" 7 "Duration time over"  ;
VAL_ 363 EPS_VW_ErrFeedback 0 "No interruption" 1 "Reserved" 2 "Reserved" 3 "Reserved" 4 "Invalid request" 5 "ADC Signal err" 6 "EPS error"  ;
VAL_ 363 EPS_AngReqForIFCSt 0 "Not avaliable" 1 "Ready" 2 "Standby" 3 "Active" 4 "Failed" 5 "Reserved" 6 "Reserved" 7 "Reserved"  ;
VAL_ 363 EPS_WarnLamp 0 "No Fault" 1 "Slight Fault" 2 "Urgency Fault" 3 "Severity Urgency Fault"  ;
VAL_ 363 EPS_SteeringWhlTorFltVD 0 "No Valid" 1 "Valid with fault detected" 2 "Valid and healthy" 3 "Unkown"  ;
VAL_ 363 EPS_TqCtrlSt 0 "No active" 1 "Ready" 2 "Active" 3 "Failed"  ;
VAL_ 363 EPS_TqCtrlAvl 0 "Not available" 1 "Available" 2 "Available degraded" 3 "Reseved"  ;
VAL_ 363 EPS_AgCtrlAvl 0 "Not available" 1 "Available" 2 "Available degraded" 3 "Reseved"  ;
VAL_ 363 EPS_MotorTorSumVD 0 "Invalid" 1 "Valid"  ;
VAL_ 363 EPS_DrvOveRideSt 0 "Not override" 1 "Override"  ;
VAL_ 363 EPS_DrvOveRideVD 0 "Invalid" 1 "Valid"  ;
VAL_ 363 EPS_SteerVibrlAvl 0 "Not available" 1 "Available"  ;
VAL_ 363 EPS_HandsOffDetStVD 0 "Invalid" 1 "Valid"  ;
VAL_ 363 EPS_HandsOffDetSt 0 "Not detected" 1 "Hands off" 2 "Hands on" 3 "Reserved"  ;
VAL_ 363 EPS_SteerMod 0 "Initial" 1 "Power steer" 2 "Angle control(Normal）" 3 "Angle control(Emergency)" 4 "Torque control(Normal）" 5 "Torque control(Emergency)" 6 "Failure" 7 "Reserved"  ;
VAL_ 363 EPS_EpsSelfChkSts 0 "Not completed" 1 "completed"  ;
VAL_ 704 IPS_DCDCModeSt 7 "Failure;" 3 "Active - Buck Mode;" 2 "Connected (HV is active);" 1 "Disconnected;" 0 "Init;- others : reserved;"  ;
VAL_ 880 ITS_MotorInletTempErr 0 "No error;" 1 "Error;"  ;
VAL_ 880 ITS_MotorInletTemp 3050 "Invalid Value"  ;
VAL_ 880 ITS_FanSt 0 "Normal;" 1 "ITS receive the invalid data through LIN;" 2 "ITS lost communication with fan" 3 "IO error of fan relay" 4 "fan error"  ;
VAL_ 880 ITS_TMS_CommDataAvail 0 "Not available;" 1 "Available;"  ;
VAL_ 824 VCU_GearLvlDisp 4 "'P' Park gear;" 3 "'R' Reverse gear;" 2 "'N' Neutral gear;" 1 "'D' Drive gear;" 0 "Invalid;- others : reserved;"  ;
VAL_ 824 VCU_VehDrvMod 7 "Individual；" 6 "I-pedal Mode;" 5 "SPORT Mode;" 4 "Driving Mode;" 3 "Comfort Mode;" 2 "ECO Mode;" 1 "ECO+ Mode;" 0 "Invalid;"  ;
VAL_ 824 VCU_VehRdySt 1 "Ready;" 0 "Not ready;"  ;
VAL_ 824 VCU_GearLvl 4 "'P' Park gear;" 3 "'R' Reverse gear;" 2 "'N' Neutral gear;" 1 "'D' Drive gear;" 0 "Invalid;- others : reserved;"  ;
VAL_ 824 VCU_PlgConnSt 1 "Plug connector connected;" 0 "Not connected;"  ;
VAL_ 824 VCU_SwapHvBattCompSt 0 "Invalid,not in swap mode;" 1 "Swap not complete;" 2 "Swap Complete, vcu complete hv power up;" 3 "Swap Complete,but can not power up due to hv battery error" 4 "Swap Complete,but can not power up due to others error"  ;
VAL_ 824 VCU_SwapHvBattModeSt 0 "Invalid" 1 "Not Swap mode" 2 "Swap mode" 3 "Swap mode (Hv power down)"  ;
VAL_ 824 VCU_SwapHvBattModeStVD 0 "Not valid" 1 "Valid"  ;
VAL_ 824 VCU_RoadMod 7 "Off;" 5 "Slippery Mode;" 4 "Offroad Mode;" 3 "Sand Mode;" 2 "Snow Mode;" 1 "Mud Mode;" 0 "Invalid;"  ;
VAL_ 952 VCU_ErrNotice 0 "reseved" 1 "PwrLimitlevel1" 2 "PwrLimitlevel2" 3 "Limp,crash,Hvil& err caused by VCU" 4 "Vehicle system abnormal ，please contact check" 5 "System Fault  Light" 6 "reseved" 7 "reseved"  ;
VAL_ 952 VCU_ErrNoticeOperationFlag 0 "No prompt" 1 "Prompt"  ;
VAL_ 952 VCU_Err2NoticeFlag 0 "No prompt" 1 "Prompt"  ;
VAL_ 952 VCU_EcoPlusMod 2 "OFF;" 1 "ON;" 0 "No command;"  ;
VAL_ 653 VCU_AccButtInfo 0 "not press" 1 "press" 0 "not press" 1 "press" 0 "not press" 1 "press" 0 "not press" 1 "press" 0 "not press" 1 "press" 0 "Normal" 1 "Abnormal"  ;
VAL_ 653 VCU_LateralAssistBtnInfo 0 "Not pressed" 1 "Pressed"  ;
VAL_ 653 VCU_LateralAssistBtnInfoVD 0 "Invalid" 1 "Valid"  ;
VAL_ 653 VCU_EMS_BrkPedalSt 1 "Pressed;" 0 "Not pressed;"  ;
VAL_ 653 VCU_EMS_BrkPedalStVD 1 "Valid;" 0 "Not valid;"  ;
VAL_ 653 VCU_EMS_AccPedalActPstVD 1 "Valid;" 0 "Not valid;"  ;
VAL_ 653 VCU_BrkPedPstVD 1 "Valid;" 0 "Not valid;"  ;
VAL_ 653 VCU_CrntGearLvl 4 "'P' Park gear;" 3 "'R' Reverse gear;" 2 "'N' Neutral gear;" 1 "'D' Drive gear;" 0 "Invalid;- others : reserved;"  ;
VAL_ 653 VCU_APAGasPedalIntv 1 "With intervention;" 0 "With not intervention;"  ;
VAL_ 653 VCU_APAAvailable 1 "Available;" 0 "Not available;"  ;
VAL_ 653 VCU_ACCLimitOperatingSt 1 "active;" 0 "Not active;"  ;
VAL_ 653 VCU_ACCMaxRecpDecelVD 1 "Valid;" 0 "Not valid;"  ;
VAL_ 653 VCU_APA_Resp 1 "Yes;" 0 "No;"  ;
VAL_ 653 VCU_APAGearIntervern 1 "with intervention;" 0 "with not intervention;"  ;
VAL_ 653 VCU_ACCmaxSpdLimit 14 "140 Km/h;" 13 "130 Km/h;" 12 "120 Km/h;" 11 "110 Km/h;" 10 "100 Km/h;" 9 "90 Km/h;" 8 "80 Km/h;" 7 "70 Km/h;" 6 "60 Km/h;" 5 "50 Km/h;" 4 "40 Km/h;" 3 "30 Km/h;" 2 "20 Km/h;" 1 "10 Km/h;" 0 "No Limit;"  ;
VAL_ 653 VCU_RecpTorqVD 1 "Valid;" 0 "Invalid;"  ;
VAL_ 653 VCU_CrntGearLvlVD 1 "Valid;" 0 "Not valid;"  ;
VAL_ 653 EMS_GasPedalActPstforMRRVD_D 1 "Valid;" 0 "Invalid;"  ;
VAL_ 644 EMS_GasPedalActPstforMRRVD 1 "Valid;" 0 "Invalid;"  ;
VAL_ 644 VCU_AccTMCFail 1 "In limp-home mode;" 0 "Normal mode;"  ;
VAL_ 644 VCU_AccElecECFail 1 "Failure;" 0 "No failure;"  ;
VAL_ 644 VCU_AccDriverOrvd 1 "Driver override;" 0 "No override;"  ;
VAL_ 644 VCU_AccSpareCanError 0 "No Error" 1 "Error"  ;
VAL_ 644 VCU_IFCFailureSt 0 "Not Failure" 1 "Failure"  ;
VAL_ 644 VCU_AccDriverOrvdVD 0 "Invalid" 1 "Valid"  ;
VAL_ 393 VCU_ErrorFb 0 "No error" 1 "ADS request error" 2 "High Voltage Fault" 3 "MCU error" 4 "BMS error" 7 "ADS E2E error or time out"  ;
VAL_ 393 VCU_VehWhlReqTqVld 0 "Invalid" 1 "Valid"  ;
VAL_ 393 VCU_MotorRegenTrqLmtlnDVaild 0 "Invalid" 1 "Valid"  ;
VAL_ 393 VCU_GearShiftAvl 0 "not available" 1 "available"  ;
VAL_ 393 VCU_PtTqAvl 0 "not available" 1 "available" 2 "available degraded"  ;
VAL_ 393 VCU_PtTqActvSts 0 "Not response" 1 "Response"  ;
VAL_ 393 VCU_TargetRecpTorqSt 0 "NotIntialized" 1 "Normal" 2 "Faulty" 3 "Reserved"  ;
VAL_ 393 VCU_TargetRecpTorqFAVD_Hyb 1 "Valid;" 0 "Invalid;"  ;
VAL_ 393 VCU_TargetRecpTorqRAVD_Hyb 1 "Valid;" 0 "Invalid;"  ;
VAL_ 393 VCU_TorqDriverReqFAVD 1 "Valid;" 0 "Invalid;"  ;
VAL_ 393 VCU_TorqDriverReqRAVD 1 "Valid;" 0 "Invalid;"  ;
VAL_ 393 VCU_VehActDrvTorqFAVD_Hyb 1 "Valid;" 0 "Invalid;"  ;
VAL_ 393 VCU_VehActDrvTorqRAVD_Hyb 1 "Valid;" 0 "Invalid;"  ;
VAL_ 393 VCU_BcsDecelVD 0 "Invalid" 1 "Valid"  ;
VAL_ 393 VCU_BcsDecelEnable 0 "Not active" 1 "Active"  ;
VAL_ 393 VCU_CrntGearNoTrans 4 "'P' Park gear;" 3 "'R' Reverse gear;" 2 "'N' Neutral gear;" 1 "'D' Drive gear;" 0 "Invalid;"  ;
VAL_ 393 VCU_RecpTorqSt 0 "NotIntialized" 1 "Normal" 2 "Faulty" 3 "Reserved"  ;
VAL_ 393 VCU_RecpTorqFAVD_Hyb 1 "Valid;" 0 "Invalid;"  ;
VAL_ 393 VCU_RecpTorqRAVD_Hyb 1 "Valid;" 0 "Invalid;"  ;
VAL_ 393 VCU_MaxRecpTorqFAVD_Hyb 1 "Valid;" 0 "Not valid;"  ;
VAL_ 393 VCU_MaxRecpTorqRAVD_Hyb 1 "Valid;" 0 "Not valid;"  ;
VAL_ 393 VCU_VehWheelTorqMaxNmVD 0 "Not valid" 1 "Valid"  ;
VAL_ 512 KAE_BLE1Position 0 "Undefined" 1 "Passive start zone" 2 "Inside trunk zone" 3 "In  passive access left zone" 4 "In  paasive access right zone" 5 "In trunk passive access zone" 6 "In Passive start and paasive access zone"  ;
VAL_ 512 KAE_BLE2Position 0 "Undefined" 1 "Passive start zone" 2 "Inside trunk zone" 3 "In  passive access left zone" 4 "In  paasive access right zone" 5 "In trunk passive access zone" 6 "In Passive start and paasive access zone"  ;
VAL_ 512 KAE_BLE3Position 0 "Undefined" 1 "Passive start zone" 2 "Inside trunk zone" 3 "In  passive access left zone" 4 "In  paasive access right zone" 5 "In trunk passive access zone" 6 "In Passive start and paasive access zone"  ;
VAL_ 512 KAE_BLE4Position 0 "Undefined" 1 "Passive start zone" 2 "Inside trunk zone" 3 "In  passive access left zone" 4 "In  paasive access right zone" 5 "In trunk passive access zone" 6 "In Passive start and paasive access zone"  ;
VAL_ 512 KAE_BLE5Position 0 "Undefined" 1 "Passive start zone" 2 "Inside trunk zone" 3 "In  passive access left zone" 4 "In  paasive access right zone" 5 "In trunk passive access zone" 6 "In Passive start and paasive access zone"  ;
VAL_ 512 KAE_BLE1AuthSt 0 "Undefined" 1 "Failed" 2 "Pass" 3 "Busy"  ;
VAL_ 512 KAE_BLE2AuthSt 0 "Undefined" 1 "Failed" 2 "Pass" 3 "Busy"  ;
VAL_ 512 KAE_BLE3AuthSt 0 "Undefined" 1 "Failed" 2 "Pass" 3 "Busy"  ;
VAL_ 512 KAE_BLE4AuthSt 0 "Undefined" 1 "Failed" 2 "Pass" 3 "Busy"  ;
VAL_ 512 KAE_BLE5AuthSt 0 "Undefined" 1 "Failed" 2 "Pass" 3 "Busy"  ;
VAL_ 512 KAE_BLE1PKSPosition 0 "Undefined" 1 "Passive start zone" 2 "Inside trunk zone" 3 "In  passive access left zone" 4 "In  paasive access right zone" 5 "In trunk passive access zone" 6 "In Passive start and paasive access zone"  ;
VAL_ 512 KAE_BLE2PKSPosition 0 "Undefined" 1 "Passive start zone" 2 "Inside trunk zone" 3 "In  passive access left zone" 4 "In  paasive access right zone" 5 "In trunk passive access zone" 6 "In Passive start and paasive access zone"  ;
VAL_ 512 KAE_BLE3PKSPosition 0 "Undefined" 1 "Passive start zone" 2 "Inside trunk zone" 3 "In  passive access left zone" 4 "In  paasive access right zone" 5 "In trunk passive access zone" 6 "In Passive start and paasive access zone"  ;
VAL_ 512 KAE_BLE4PKSPosition 0 "Undefined" 1 "Passive start zone" 2 "Inside trunk zone" 3 "In  passive access left zone" 4 "In  paasive access right zone" 5 "In trunk passive access zone" 6 "In Passive start and paasive access zone"  ;
VAL_ 512 KAE_BLE5PKSPosition 0 "Undefined" 1 "Passive start zone" 2 "Inside trunk zone" 3 "In  passive access left zone" 4 "In  paasive access right zone" 5 "In trunk passive access zone" 6 "In Passive start and paasive access zone"  ;
