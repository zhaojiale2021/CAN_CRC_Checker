VERSION "Version"

NS_ :

BS_:

BU_: CCU ADC FAPA IFC FLR FRR RRR RLR INU Tester CBM VIU SRS IDC PCS AMP IMR FIMR TBOX IBCS IXCU V2XOBU WHUD RLBMS CCURT2 RT2_C3 OTAWL ZCUF ZCUL ZCUR ZCUT IPS DCU NIDU RBM WACUFL IID CCURT1 RT1_C0 RT1_C1 AVAS FLLCM FRLCM RLLCMA RRLCMA RLLCMB RRLCMB LBMS LBMSAD MFS FCP IDU ITS BCB DCDC PCU EOP DCU2 BMS TMC EPS ECS CD PAS SBM WCM ETC TBOX2 DSM FLPDM FRPDM RLPDM RRPDM HVSMR SCMRL SCMRR EBU EPB VDC EVCC ADM PLGM FBLCM RLISD RRISD RCP RFR WCMFR SCMR TFOAR TROAR HVSPRL HVSPRR

BO_ 667 ADC_7: 64 ADC
 SG_ ADC_7_CRC : 7|16@0+ (1,0) [0|65535] ""  CCU
 SG_ ADC_7_Counter : 23|8@0+ (1,0) [0|255] ""  CCU
 SG_ ADC_LatVMC_A0 : 31|11@0+ (0.01,-10.23) [-10.23|10.23] "m"  CCU,CCURT2
 SG_ ADC_LatVMC_A1 : 36|11@0+ (0.001,-1.023) [-1.023|1.023] "rad"  CCU
 SG_ ADC_LatVMC_A2 : 41|11@0+ (0.00001,-0.01023) [-0.01023|0.01023] "1/m"  CCU
 SG_ ADC_LatVMC_A3 : 62|11@0+ (0.0000001,-0.0001023) [-0.0001023|0.0001023] "1/(m^2)"  CCU
 SG_ ADC_LatVMC_conf : 78|7@0+ (1,0) [0|100] "%"  CCU
 SG_ ADC_LatVMC_Range : 87|8@0+ (1,0) [0|255] "m"  CCU
 SG_ ADC_LLnMrking_A0 : 95|11@0+ (0.01,-10.23) [-10.23|10.23] "m"  CCU
 SG_ ADC_LLnMrking_A1 : 100|11@0+ (0.001,-1.023) [-1.023|1.023] "rad"  CCU
 SG_ ADC_LLnMrking_A2 : 105|11@0+ (0.00001,-0.01023) [-0.01023|0.01023] "1/m"  CCU
 SG_ ADC_LLnMrking_conf : 126|6@0+ (2,0) [0|100] "%"  CCU
 SG_ ADC_LlnMrkingDispSt : 132|2@0+ (1,0) [0|3] ""  CCU
 SG_ ADC_LLnMrking_Range : 130|11@0+ (0.1,0) [0|204.7] "m"  CCU
 SG_ ADC_LLnMrking_Type : 150|4@0+ (1,0) [0|15] ""  CCU
 SG_ ADC_RLnMrking_A0 : 146|11@0+ (0.01,-10.23) [-10.23|10.23] "m"  CCU
 SG_ ADC_RLnMrking_A1 : 167|11@0+ (0.001,-1.023) [-1.023|1.023] "rad"  CCU
 SG_ ADC_RLnMrking_A2 : 172|11@0+ (0.00001,-0.01023) [-0.01023|0.01023] "1/m"  CCU
 SG_ ADC_RlnMrkingDispSt : 177|2@0+ (1,0) [0|3] ""  CCU
 SG_ ADC_RLnMrking_conf : 191|6@0+ (2,0) [0|100] "%"  CCU
 SG_ ADC_RLnMrking_Range : 185|11@0+ (0.1,0) [0|204.7] "m"  CCU
 SG_ ADC_RLnMrking_Type : 206|4@0+ (1,0) [0|15] ""  CCU
 SG_ ADC_AdjLLnMrking_A0 : 202|11@0+ (0.01,-10.23) [-10.23|10.23] "m"  CCU
 SG_ ADC_AdjLLnMrking_A1 : 223|11@0+ (0.001,-1.023) [-1.023|1.023] "rad"  CCU
 SG_ ADC_AdjLLnMrking_A2 : 228|11@0+ (0.00001,-0.01023) [-0.01023|0.01023] "1/m"  CCU
 SG_ ADC_AdjLLnMrking_conf : 233|6@0+ (2,0) [0|100] "%"  CCU
 SG_ ADC_AdjLLnMrking_Range : 243|11@0+ (0.1,0) [0|204.7] "m"  CCU
 SG_ ADC_AdjLlnMrkingDispSt : 248|1@0+ (1,0) [0|1] ""  CCU
 SG_ ADC_AdjLLnMrking_Type : 263|4@0+ (1,0) [0|15] ""  CCU
 SG_ ADC_AdjRLnMrking_A0 : 259|11@0+ (0.01,-10.23) [-10.23|10.23] "m"  CCU
 SG_ ADC_AdjRLnMrking_A1 : 264|11@0+ (0.001,-1.023) [-1.023|1.023] "rad"  CCU
 SG_ ADC_AdjRLnMrking_A2 : 285|11@0+ (0.00001,-0.01023) [-0.01023|0.01023] "1/m"  CCU
 SG_ ADC_AdjRLnMrking_Range : 290|11@0+ (0.1,0) [0|204.7] "m"  CCU
 SG_ ADC_AdjRLnMrking_conf : 311|6@0+ (2,0) [0|100] "%"  CCU
 SG_ ADC_AdjRlnMrkingDispSt : 305|1@0+ (1,0) [0|1] ""  CCU
 SG_ ADC_AdjRLnMrking_Type : 319|4@0+ (1,0) [0|15] ""  CCU

BO_ 947 ADC_8: 64 ADC
 SG_ ADC_8_CRC : 7|16@0+ (1,0) [0|65535] ""  CCU,CCURT2,RT2_C3,FAPA
 SG_ ADC_8_Counter : 23|8@0+ (1,0) [0|255] ""  CCU,CCURT2,RT1_C1,RT2_C3,FAPA
 SG_ ADC_LowBeamReq : 31|2@0+ (1,0) [0|3] ""  CCU,CCURT2,RT2_C3,FAPA
 SG_ ADC_IHBC_HighBeamReq : 29|1@0+ (1,0) [0|1] ""  CCU,CCURT2,RT2_C3,FAPA
 SG_ ADC_FlashReq : 28|2@0+ (1,0) [0|3] ""  CCU,CCURT2,RT2_C3,FAPA
 SG_ ADC_PositionLampReq : 26|2@0+ (1,0) [0|3] ""  CCU,CCURT2,RT2_C3,FAPA
 SG_ ADC_HVACCtrlReq : 39|1@0+ (1,0) [0|1] ""  CCU,FAPA
 SG_ ADC_FFogLightReq : 38|2@0+ (1,0) [0|3] ""  CCU,CCURT2,RT2_C3,FAPA
 SG_ ADC_RFogLightReq : 36|2@0+ (1,0) [0|3] ""  CCU,CCURT2,RT2_C3,FAPA
 SG_ ADC_HornReq : 34|3@0+ (1,0) [0|7] ""  CCU,CCURT2,RT2_C3,FAPA
 SG_ ADC_FWiperReq : 47|3@0+ (1,0) [0|7] ""  CCU,CCURT1,CCURT2,RT2_C3,FAPA
 SG_ ADC_RWiperReq : 44|3@0+ (1,0) [0|7] ""  CCU,CCURT2,RT1_C0,RT2_C3,FAPA
 SG_ ADC_FWaterSprayReq : 41|2@0+ (1,0) [0|3] ""  CCU,CCURT2,RT1_C0,RT2_C3,FAPA
 SG_ ADC_RWaterSprayReq : 55|2@0+ (1,0) [0|3] ""  CCU,CCURT2,RT1_C0,RT2_C3,FAPA
 SG_ ADC_CCUReqVD : 53|1@0+ (1,0) [0|1] ""  CCU,CCURT2,RT2_C3,FAPA
 SG_ ADC_WindowOpenReq : 50|1@0+ (1,0) [0|1] ""  CCU,CCURT1,CCURT2,FAPA
 SG_ ADC_WindowCloseReq : 49|1@0+ (1,0) [0|1] ""  CCU,CCURT1,CCURT2,FAPA
 SG_ ADC_PLGMOpenReq : 48|1@0+ (1,0) [0|1] ""  CCU,CCURT2,RT2_C3,FAPA
 SG_ ADC_PLGMCloseReq : 63|1@0+ (1,0) [0|1] ""  CCU,CCURT2,RT2_C3,FAPA
 SG_ ADC_FDemistReq : 60|2@0+ (1,0) [0|3] ""  CCU,FAPA
 SG_ ADC_RDemistReq : 58|2@0+ (1,0) [0|3] ""  CCU,FAPA
 SG_ ADC_ThmPostRun : 56|1@0+ (1,0) [0|1] ""  CCU,CCURT1,RT1_C1,VDC,FAPA
 SG_ ADC_DriverFaceWindReq : 71|2@0+ (1,0) [0|3] ""  CCU,FAPA
 SG_ ADC_EcallReq : 69|1@0+ (1,0) [0|1] ""  CCU,FAPA
 SG_ ADC_FlowReq : 68|5@0+ (1,0) [0|16] ""  CCU,CCURT1,RT1_C1,VDC,FAPA
 SG_ ADC_DriverSeatBeltPretightenReq : 79|1@0+ (1,0) [0|1] ""  CCU,RT1_C1,RT2_C3,FAPA
 SG_ ADC_LockReq : 78|3@0+ (1,0) [0|7] ""  CCU,CCURT2,RT2_C3,FAPA
 SG_ ADC_HoldLockReq : 75|2@0+ (1,0) [0|3] ""  CCU,CCURT2,RT2_C3,FAPA
 SG_ ADC_RearMirrorReq : 73|2@0+ (1,0) [0|3] ""  CCU,CCURT2,RT2_C3,FAPA
 SG_ ADC_HoldRearMirrorReq : 87|2@0+ (1,0) [0|3] ""  CCU,CCURT2,RT2_C3,FAPA
 SG_ ADC_ADSLightReq : 90|3@0+ (1,0) [0|7] ""  CCU,CCURT1,CCURT2,RT2_C3,FAPA
 SG_ ADC_ReqChargPortCapOpen : 85|1@0+ (1,0) [0|1] ""  CCU,CCURT1,CCURT2,FAPA
 SG_ ADC_ReqChargeDiscont : 84|1@0+ (1,0) [0|1] ""  CCU,CCURT1,CCURT2,FAPA
 SG_ ADC_DriverSeatBeltVibrWarnReq : 83|3@0+ (1,0) [0|7] ""  CCU,CCURT1,RT1_C1,RT2_C3,FAPA
 SG_ ADC_FrtWindshildHeatReq : 92|2@0+ (1,0) [0|3] ""  CCU,CCURT2,FAPA
 SG_ ADC_BeamSwReq : 94|2@0+ (1,0) [0|3] ""  CCU,CCURT2,RT2_C3,FAPA
 SG_ IFC_SysCalibrationSt : 80|2@0+ (1,0) [0|3] ""  CCU,FAPA
 SG_ ADC_ADBIHBCEnableReq : 99|2@0+ (1,0) [0|3] ""  CCU,CCURT1,CCURT2,RT2_C3,FAPA
 SG_ ADC_RearLeftChildSaftyLockReq : 101|2@0+ (1,0) [0|3] ""  CCU,CCURT2,RT2_C3
 SG_ ADC_RearRightChildSaftyLockReq : 103|2@0+ (1,0) [0|3] ""  CCU,CCURT2,RT2_C3
 SG_ ADC_LowPowerReq_A : 106|2@0+ (1,0) [0|3] ""  CCU,FAPA,INU
 SG_ ADC_LowPowerReqVD_A : 107|1@0+ (1,0) [0|1] ""  CCU,FAPA,INU
 SG_ ADC_MachineStatus : 124|3@0+ (1,0) [0|7] ""  CCU,CCURT1,RT1_C1,VDC,FAPA
 SG_ ADC_LowPowerFailReason : 127|3@0+ (1,0) [0|7] ""  CCU,CCURT1,RT1_C1,VDC,FAPA
 SG_ ADC_ChgPortControlReq : 129|2@0+ (1,0) [0|3] ""  CCU,CCURT1,CCURT2,FAPA
 SG_ ADC_ChgPortHoldControlReq : 131|2@0+ (1,0) [0|3] ""  CCU,CCURT1,CCURT2,FAPA
 SG_ ADC_LightbarReq : 135|4@0+ (1,0) [0|15] ""  CCU,CCURT2,RT2_C3,FAPA
 SG_ ADC_ChargHoldReq : 137|2@0+ (1,0) [0|3] ""  CCU,CCURT1,CCURT2,RT1_C1,VDC,FAPA
 SG_ ADC_ChargReq : 139|2@0+ (1,0) [0|3] ""  CCU,CCURT1,CCURT2,RT1_C1,VDC,FAPA
 SG_ ADC_ChargGunHoldReq : 141|2@0+ (1,0) [0|3] ""  CCU,CCURT1,CCURT2,RT1_C1,VDC,FAPA
 SG_ ADC_ChargGunReq : 143|2@0+ (1,0) [0|3] ""  CCU,CCURT1,CCURT2,RT1_C1,VDC,FAPA
 SG_ ADC_MCURTTemp : 151|8@0+ (1,-40) [-40|215] "℃"  CCU,CCURT1,RT1_C1,VDC
 SG_ ADC_SOCRTtemp : 159|8@0+ (1,-40) [-40|215] "℃"  CCU,CCURT1,RT1_C1,VDC
 SG_ ADC_InteractLightReq : 167|5@0+ (1,0) [0|31] ""  CCU,CCURT1,CCURT2,FAPA
 SG_ ADCState : 427|3@0+ (1,0) [0|7] ""  CCU,CCURT2,FAPA
 SG_ ADCtargetState : 424|3@0+ (1,0) [0|7] ""  CCU,CCURT2,FAPA
 SG_ Parking_System_State : 437|1@0+ (1,0) [0|1] ""  CCU,CCURT2,FAPA
 SG_ Driving_System_State : 436|1@0+ (1,0) [0|1] ""  CCU,CCURT2,FAPA
 SG_ subStandAlone : 435|1@0+ (1,0) [0|1] ""  CCU,CCURT2,FAPA
 SG_ platMode : 434|3@0+ (1,0) [0|7] ""  CCU,CCURT2,FAPA
 SG_ OTA_Target_ADS : 447|1@0+ (1,0) [0|1] ""  CCU,CCURT2,FAPA
 SG_ Fault_flg_to_Power_Down : 446|1@0+ (1,0) [0|1] ""  CCU,CCURT2,FAPA
 SG_ runOnce : 445|1@0+ (1,0) [0|1] ""  CCU,CCURT2,FAPA
 SG_ nmServiceHold : 444|1@0+ (1,0) [0|1] ""  CCU,CCURT2,FAPA
 SG_ nmServiceRelease : 443|1@0+ (1,0) [0|1] ""  CCU,CCURT2,FAPA
 SG_ lidarsPower : 442|2@0+ (1,0) [0|3] ""  CCU,CCURT2,FAPA

BO_ 374 FAPA_1: 24 FAPA
 SG_ FAPA_1_CRC : 7|16@0+ (1,0) [0|65535] ""  ADC,FAPA
 SG_ FAPA_1_Counter : 23|8@0+ (1,0) [0|255] ""  ADC,FAPA
 SG_ FAPA_ADC_AngReqAvl : 31|1@0+ (1,0) [0|1] ""  ADC,FAPA
 SG_ FAPA_ADC_ActTrqReqVD : 30|1@0+ (1,0) [0|1] ""  ADC,FAPA
 SG_ FAPA_ADC_ActTrqReqEnable : 29|1@0+ (1,0) [0|1] ""  ADC,FAPA
 SG_ FAPA_ADC_ActTrqReq : 55|14@0+ (1,-5000) [-5000|5000] "Nm"  ADC,FAPA
 SG_ FAPA_ADC_TotalRefTorque_A : 39|16@0+ (1,-32768) [-32768|32767] "Nm"  ADC,FAPA
 SG_ FAPA_ADC_FctSts : 28|1@0+ (1,0) [0|1] ""  ADC,FAPA
 SG_ FAPA_ADC_ElecBrkFnSwitch : 27|1@0+ (1,0) [0|1] ""  ADC,FAPA
 SG_ FAPA_ADC_TarGearReqVld : 26|1@0+ (1,0) [0|1] ""  ADC,FAPA
 SG_ FAPA_ADC_PAAGrarLvlReq : 71|3@0+ (1,0) [0|7] ""  ADC,FAPA
 SG_ FAPA_ADC_PAAGrarLvlReqEnable : 25|1@0+ (1,0) [0|1] ""  ADC,FAPA
 SG_ FAPA_ADC_BrkTarTqVld : 24|1@0+ (1,0) [0|1] ""  ADC,FAPA
 SG_ FAPA_ADC_BrkTarTqEna : 68|1@0+ (1,0) [0|1] ""  ADC,FAPA
 SG_ FAPA_ADC_BrkTarTqMod : 57|2@0+ (1,0) [0|3] ""  ADC,FAPA
 SG_ FAPA_ADC_BrkTarTq : 79|16@0+ (1,0) [0|65535] "Nm"  ADC,FAPA
 SG_ FAPA_ADC_LongCtrlTypReq : 67|1@0+ (1,0) [0|1] ""  ADC,FAPA
 SG_ FAPA_ADC_BrkHoldReq : 66|2@0+ (1,0) [0|3] ""  ADC,FAPA
 SG_ FAPA_ADC_DriverPresent : 95|2@0+ (1,0) [0|3] ""  ADC,FAPA
 SG_ FAPA_ADC_AngReqSt_A : 93|2@0+ (1,0) [0|3] ""  ADC,FAPA
 SG_ FAPA_ADC_StrAngleReq_A : 103|16@0+ (0.1,-780) [-780|779.9] "deg"  ADC,FAPA
 SG_ FAPA_ADC_SACMotorTorLimExtMax : 119|8@0+ (0.02,0) [0|5.08] "Nm"  ADC,FAPA
 SG_ FAPA_ADC_SACMotorTorLimExtMin : 127|8@0+ (0.02,-5.08) [-5.08|0] "Nm"  ADC,FAPA
 SG_ FAPA_ADC_AngReqFunction : 91|2@0+ (1,0) [0|3] ""  ADC,FAPA
 SG_ FAPA_ADC_EpbModReqVld : 64|1@0+ (1,0) [0|1] ""  ADC,FAPA
 SG_ FAPA_ADC_RWUEna : 89|1@0+ (1,0) [0|1] ""  ADC,FAPA
 SG_ FAPA_ADC_RWUVld : 88|1@0+ (1,0) [0|1] ""  ADC,FAPA
 SG_ FAPA_ADC_PAA2EPBEpbReq : 135|2@0+ (1,0) [0|2] ""  ADC,FAPA
 SG_ FAPA_ADC_PAA2EPBEpbReqSt : 133|1@0+ (1,0) [0|1] ""  ADC,FAPA
 SG_ FAPA_ADC_TurnLightReq : 132|3@0+ (1,0) [0|7] ""  ADC,FAPA
 SG_ FAPA_ADC_CCUReqVD : 129|1@0+ (1,0) [0|1] ""  ADC,FAPA
 SG_ FAPA_ReqIFCForward : 128|1@0+ (1,0) [0|1] ""  ADC,FAPA
 SG_ FAPA_ADC_RearMirrorReq : 143|2@0+ (1,0) [0|3] ""  ADC,FAPA
 SG_ ADC_LockReq : 139|3@0+ (1,0) [0|7] ""  ADC
 SG_ ADC_HoldLockReq : 141|2@0+ (1,0) [0|3] ""  ADC
 SG_ FAPA_ADC_DrvTarTqMod2EPB : 151|2@0+ (1,0) [0|3] ""  ADC

BO_ 437 IFC_1: 64 IFC
 SG_ IFC_1_CRC : 7|16@0+ (1,0) [0|65535] ""  CCU,CCURT1,CCURT2,RT1_C1,VDC,EPS,RBM,IBCS,IDC,ADC,FAPA
 SG_ IFC_1_Counter : 23|8@0+ (1,0) [0|255] ""  CCU,CCURT1,CCURT2,RT1_C1,VDC,EPS,RBM,IBCS,IDC,ADC,FAPA
 SG_ IFC_SysCalibrationSt : 31|2@0+ (1,0) [0|3] ""  CCU,CCURT1,CCURT2,ADC,FAPA
 SG_ IFC_CameraBlockageSt : 29|1@0+ (1,0) [0|1] ""  CCU,CCURT1,CCURT2,ADC,FAPA
 SG_ IFC_MRMAvailability : 28|1@0+ (1,0) [0|1] ""  CCU,CCURT1,CCURT2,RBM,IBCS,ADC,FAPA
 SG_ IFC_ICMWarnCardSt : 27|2@0+ (1,0) [0|3] ""  CCU,CCURT1,CCURT2,IDC,ADC,FAPA
 SG_ IFC_BrakeLightReq : 25|2@0+ (1,0) [0|3] ""  CCU,CCURT1,CCURT2,ADC,FAPA
 SG_ IFC_LongCtrlModeForBrkSys : 39|3@0+ (1,0) [0|7] ""  CCU,CCURT1,CCURT2,RT1_C1,VDC,RBM,IBCS,ADC,FAPA
 SG_ IFC_LongCtrlTargetAx : 36|11@0+ (0.01,-10) [-10|10] "m/s2"  CCU,CCURT1,CCURT2,RBM,IBCS,ADC,FAPA
 SG_ IFC_LongCtrlTargetAxReq : 41|1@0+ (1,0) [0|1] ""  CCU,CCURT1,CCURT2,RBM,IBCS,ADC,FAPA
 SG_ IFC_LongCtrlTypReq : 40|1@0+ (1,0) [0|1] ""  CCU,CCURT1,CCURT2,RBM,IBCS,ADC,FAPA
 SG_ IFC_LongCtrlDecToStopReq : 55|1@0+ (1,0) [0|1] ""  CCU,CCURT1,CCURT2,RBM,IBCS,ADC,FAPA
 SG_ IFC_ICMPromptWarn : 53|2@0+ (1,0) [0|3] ""  CCU,CCURT1,CCURT2,IDC,ADC,FAPA
 SG_ IFC_CCUReqVD : 51|1@0+ (1,0) [0|1] ""  CCU,CCURT1,CCURT2,ADC,FAPA
 SG_ IFC_TurnLightReq : 50|3@0+ (1,0) [0|7] ""  CCU,CCURT1,CCURT2,ADC,FAPA
 SG_ IFC_ActTrqReqEnable : 63|1@0+ (1,0) [0|1] ""  CCU,CCURT1,CCURT2,RT1_C1,VDC,ADC,FAPA
 SG_ IFC_ActTrqReq : 61|14@0+ (1,-5000) [-5000|5000] "Nm"  CCU,CCURT1,CCURT2,RT1_C1,VDC,ADC,FAPA
 SG_ IFC_VLCSt : 79|2@0+ (1,0) [0|2] ""  CCU,CCURT1,CCURT2,RT1_C1,VDC,ADC,FAPA
 SG_ IFC_ADCFailSt : 76|1@0+ (1,0) [0|1] ""  CCU,CCURT1,CCURT2,ADC,FAPA
 SG_ IFC_AngReqRdntSt : 74|1@0+ (1,0) [0|1] ""  CCU,CCURT1,CCURT2,EPS,ADC,FAPA
 SG_ IFC_AngReqSt : 73|2@0+ (1,0) [0|3] ""  CCU,CCURT1,CCURT2,EPS,ADC,FAPA
 SG_ IFC_StrAngleReq : 87|16@0+ (0.1,-780) [-780|779.9] "deg"  CCU,CCURT1,CCURT2,EPS,ADC,FAPA
 SG_ IFC_SACMotorTorLimExtMin : 103|8@0+ (0.02,-5.08) [-5.08|0] "Nm"  CCU,CCURT1,CCURT2,EPS,ADC,FAPA
 SG_ IFC_SACMotorTorLimExtMax : 111|8@0+ (0.02,0) [0|5.08] "Nm"  CCU,CCURT1,CCURT2,EPS,ADC,FAPA
 SG_ IFC_EcallReq : 202|1@0+ (1,0) [0|1] ""  CCU,CCURT1,CCURT2,ADC,FAPA,TBOX

BO_ 918 CCU_PADS_1: 32 CCU
 SG_ UINM_PADS_1_CRC : 7|8@0+ (1,0) [0|255] ""  ADC,FAPA,VIU
 SG_ UINM_PADS_1_Counter : 11|4@0+ (1,0) [0|14] ""  ADC,FAPA,VIU
 SG_ UINM_PADS_ResponseErr : 12|1@0+ (1,0) [0|1] ""  ADC,FAPA,VIU
 SG_ UINM_PADS_CustomSWSt : 25|1@0+ (1,0) [0|1] ""  IDC,ADC,FAPA,VIU,IFC,TBOX
 SG_ UINM_PADS_CustomSWStVD : 26|1@0+ (1,0) [0|1] ""  IDC,ADC,FAPA,VIU,IFC
 SG_ UINM_PADS_CustomSWstuck : 27|1@0+ (1,0) [0|1] ""  IDC,ADC,FAPA,VIU,IFC
 SG_ UINM_PADS_IDC_PlaySWSt : 42|1@0+ (1,0) [0|1] ""  IDC,ADC,FAPA,VIU,IFC
 SG_ UINM_PADS_IDC_PlaySWStVD : 43|1@0+ (1,0) [0|1] ""  IDC,ADC,FAPA,VIU,IFC
 SG_ UINM_PADS_CruSetSpeedRollerRotatedDir : 46|2@0+ (1,0) [0|3] ""  IDC,ADC,FAPA,VIU
 SG_ UINM_PADS_FolDistIncSWSt : 47|1@0+ (1,0) [0|1] ""  IDC,ADC,FAPA,VIU
 SG_ UINM_PADS_CruSetSpeedRollerSt : 53|6@0+ (1,0) [0|63] ""  IDC,ADC,FAPA,VIU
 SG_ UINM_PADS_FolDistIncSWStVD : 54|1@0+ (1,0) [0|1] ""  IDC,ADC,FAPA,VIU
 SG_ UINM_PADS_FolDistIncSWStuckSt : 55|1@0+ (1,0) [0|1] ""  IDC,ADC,FAPA,VIU
 SG_ UINM_PADS_FolDistDecSWStVD : 57|1@0+ (1,0) [0|1] ""  IDC,ADC,FAPA,VIU
 SG_ UINM_PADS_FolDistDecSWStuckSt : 58|1@0+ (1,0) [0|1] ""  IDC,ADC,FAPA,VIU
 SG_ UINM_PADS_OKSWSt : 59|1@0+ (1,0) [0|1] ""  IDC,ADC,FAPA,VIU
 SG_ UINM_PADS_OKSWStVD : 60|1@0+ (1,0) [0|1] ""  IDC,ADC,FAPA,VIU
 SG_ UINM_PADS_OKSWStuckSt : 61|1@0+ (1,0) [0|1] ""  IDC,ADC,FAPA,VIU
 SG_ UINM_PADS_CruSetSpeedRollerVD : 63|1@0+ (1,0) [0|1] ""  IDC,ADC,FAPA,VIU
 SG_ UINM_PADS_FolDistDecSWSt : 56|1@0+ (1,0) [0|1] ""  IDC,ADC,FAPA,VIU
 SG_ UINM_PADS_CruSWSt : 91|1@0+ (1,0) [0|1] ""  ADC
 SG_ UINM_PADS_CruSWStVD : 92|1@0+ (1,0) [0|1] ""  ADC
 SG_ UINM_PADS_CruSWStuckSt : 93|1@0+ (1,0) [0|1] ""  ADC
 SG_ UINM_PADS_CruSpeedDecSWSt : 94|1@0+ (1,0) [0|1] ""  ADC,FAPA,IFC
 SG_ UINM_PADS_CruSpeedDecSWStVD : 95|1@0+ (1,0) [0|1] ""  ADC,FAPA,IFC
 SG_ UINM_PADS_CruSpeedDecSWStuckSt : 96|1@0+ (1,0) [0|1] ""  ADC,FAPA,IFC
 SG_ UINM_PADS_CruResumeSpeedIncSWSt : 97|1@0+ (1,0) [0|1] ""  ADC,FAPA,IFC
 SG_ UINM_PADS_CruResumeSpeedIncSWStVD : 98|1@0+ (1,0) [0|1] ""  ADC,FAPA,IFC
 SG_ UINM_PADS_CruResumeSpeedIncSWStuckSt : 99|1@0+ (1,0) [0|1] ""  ADC,FAPA,IFC
 SG_ UINM_PADS_CruTJAICASWSt : 103|1@0+ (1,0) [0|1] ""  ADC
 SG_ UINM_PADS_CruTJAICASWStVD : 104|1@0+ (1,0) [0|1] ""  ADC
 SG_ UINM_PADS_CruTJAICASWStuckSt : 105|1@0+ (1,0) [0|1] ""  ADC
 SG_ UINM_PADS_Custom2SWSt : 109|1@0+ (1,0) [0|1] ""  IDC,ADC,FAPA,VIU
 SG_ UINM_PADS_Custom2SWStVD : 110|1@0+ (1,0) [0|1] ""  IDC,ADC,FAPA,VIU
 SG_ UINM_PADS_Custom2SWStuckSt : 111|1@0+ (1,0) [0|1] ""  IDC,ADC,FAPA,VIU
 SG_ UINM_PADS_ACCSWSt : 113|2@0+ (1,0) [0|3] ""  ADC,FAPA,VIU
 SG_ UINM_PADS_VoltageFaultSt : 115|2@0+ (1,0) [0|3] ""  ADC,FAPA,VIU

BO_ 1078 CCU_ZCUR_ETC_1: 16 CCU
 SG_ ETC_DismountSt : 31|2@0+ (1,0) [0|3] ""  IDC,ADC
 SG_ ETC_SelfcheckSt : 29|2@0+ (1,0) [0|3] ""  IDC,ADC
 SG_ ETC_GateProperty : 27|2@0+ (1,0) [0|3] ""  IDC,ADC
 SG_ ETC_TradeType : 25|2@0+ (1,0) [0|3] ""  IDC,ADC
 SG_ ETC_SystemSt : 39|1@0+ (1,0) [0|1] ""  IDC,ADC
 SG_ ETC_SysCfgst : 38|1@0+ (1,0) [0|1] ""  IDC,ADC
 SG_ ETC_ICMDisplayCfgst : 37|1@0+ (1,0) [0|1] ""  IDC,ADC
 SG_ ETC_BLEenableCfgst : 36|1@0+ (1,0) [0|1] ""  IDC,ADC
 SG_ ETC_ActivSt : 35|1@0+ (1,0) [0|1] ""  IDC,ADC
 SG_ ETC_TradeInfo : 47|32@0+ (0.01,0) [0|42949672.94] ""  IDC,ADC

BO_ 348 CCU_SECSYN: 16 CCU
 SG_ CCU_SecSynCounter : 7|24@0+ (1,0) [0|1] ""  ZCUF,ZCUL,ZCUR,ZCUT,IDC,ADC,FAPA,VIU
 SG_ CCU_SecSynResetCounter : 31|16@0+ (1,0) [0|1] ""  ZCUF,ZCUL,ZCUR,ZCUT,IDC,ADC,FAPA,VIU
 SG_ CCU_SecSynMAC_Check : 47|88@0+ (1,0) [0|1] ""  ZCUF,ZCUL,ZCUR,ZCUT,IDC,ADC,FAPA,VIU

BO_ 170 ADC_SecReq: 16 ADC
 SG_ ADC_SecReq : 7|128@0+ (1,0) [0|255] ""  CCU,CCURT1,RT1_C0

BO_ 343 CCU_13: 64 CCU
 SG_ POD_DSMObstDetcnFL : 95|2@0+ (1,0) [0|3] ""  OTAWL,ZCUL,ZCUT,ADC,FAPA,DSM
 SG_ POD_DSMObstDetcnFR : 93|2@0+ (1,0) [0|3] ""  OTAWL,ZCUL,ZCUT,ADC,FAPA,DSM
 SG_ POD_DSMObstDetcnRL : 91|2@0+ (1,0) [0|3] ""  OTAWL,ZCUL,ZCUT,ADC,FAPA,DSM
 SG_ POD_DSMObstDetcnRR : 89|2@0+ (1,0) [0|3] ""  OTAWL,ZCUL,ZCUT,ADC,FAPA,DSM

BO_ 1024 CCU_TimeSync: 16 CCU
 SG_ SYNC_FC_Type : 7|8@0+ (1,0) [0|255] ""  ZCUF,ZCUL,ZCUR,ZCUT,ADC,FAPA
 SG_ SYNC_FC_CRC : 15|8@0+ (1,0) [0|255] ""  ZCUF,ZCUL,ZCUR,ZCUT,ADC,FAPA
 SG_ SYNC_FC_Sequencecnt : 19|4@0+ (1,0) [0|15] ""  ZCUF,ZCUL,ZCUR,ZCUT,ADC,FAPA
 SG_ SYNC_FC_TimeDomain : 23|4@0+ (1,0) [0|15] ""  ZCUF,ZCUL,ZCUR,ZCUT,ADC,FAPA
 SG_ SYNC_FC_OVS : 25|2@0+ (1,0) [0|3] ""  ZCUF,ZCUL,ZCUR,ZCUT,ADC,FAPA
 SG_ SYNC_FC_SGW : 26|1@0+ (1,0) [0|1] ""  ZCUF,ZCUL,ZCUR,ZCUT,ADC,FAPA
 SG_ SYNC_FC_Reserved : 31|5@0+ (1,0) [0|31] ""  ZCUF,ZCUL,ZCUR,ZCUT,ADC,FAPA
 SG_ SYNC_FC_SyncTime : 39|32@0+ (1,0) [0|4294967295] ""  ZCUF,ZCUL,ZCUR,ZCUT,ADC,FAPA

CM_ SG_ 667 ADC_7_CRC "E2E Profile 5 CRC";
CM_ SG_ 667 ADC_7_Counter "E2E Profile 5 Counter";
CM_ SG_ 667 ADC_LatVMC_A0 "Lane Marking Polynomial Coefficient A0 used by VMC";
CM_ SG_ 667 ADC_LatVMC_A1 "Lane Marking Polynomial Coefficient A1 used by VMC";
CM_ SG_ 667 ADC_LatVMC_A2 "Lane Marking Polynomial Coefficient A2 used by VMC";
CM_ SG_ 667 ADC_LatVMC_A3 "Lane Marking Polynomial Coefficient A3 used by VMC";
CM_ SG_ 667 ADC_LatVMC_conf "comprehensive confidence used by VMC";
CM_ SG_ 667 ADC_LatVMC_Range "comprehensive confidence used by VMC";
CM_ SG_ 667 ADC_LLnMrking_A0 "Left Lane Marking Polynomial Coefficient A0, which stands for the lateral distance between lane marking and the middle of the eog vehicle.";
CM_ SG_ 667 ADC_LLnMrking_A1 "Left Lane Marking Polynomial Coefficient A1, which stands for the heading angle between the lane marking and the ego vehicle.";
CM_ SG_ 667 ADC_LLnMrking_A2 "Left Lane Marking Polynomial Coefficient A2, which stands for the curvature of the lane marking.";
CM_ SG_ 667 ADC_LLnMrking_conf "Left Lane Marking confidence";
CM_ SG_ 667 ADC_LlnMrkingDispSt "Display state of the left lane marking";
CM_ SG_ 667 ADC_LLnMrking_Range "Left Lane Marking range";
CM_ SG_ 667 ADC_LLnMrking_Type "Left side of lane marking indication type";
CM_ SG_ 667 ADC_RLnMrking_A0 "right Lane Marking Polynomial Coefficient A0, which stands for the lateral distance between lane marking and the middle of the eog vehicle.";
CM_ SG_ 667 ADC_RLnMrking_A1 "right Lane Marking Polynomial Coefficient A1, which stands for the heading angle between the lane marking and the ego vehicle.";
CM_ SG_ 667 ADC_RLnMrking_A2 "right Lane Marking Polynomial Coefficient A2, which stands for the curvature of the lane marking.";
CM_ SG_ 667 ADC_RlnMrkingDispSt "Display state of the right lane marking";
CM_ SG_ 667 ADC_RLnMrking_conf "right Lane Marking confidence";
CM_ SG_ 667 ADC_RLnMrking_Range "right Lane Marking range";
CM_ SG_ 667 ADC_RLnMrking_Type "right side of lane marking indication type";
CM_ SG_ 667 ADC_AdjLLnMrking_A0 "adjacent Left Lane Marking Polynomial Coefficient A0, which stands for the lateral distance between lane marking and the middle of the eog vehicle.";
CM_ SG_ 667 ADC_AdjLLnMrking_A1 "adjacent Left Lane Marking Polynomial Coefficient A1, which stands for the heading angle between the lane marking and the ego vehicle.";
CM_ SG_ 667 ADC_AdjLLnMrking_A2 "adjacent Left Lane Marking Polynomial Coefficient A2, which stands for the curvature of the lane marking.";
CM_ SG_ 667 ADC_AdjLLnMrking_conf "adjacent Left Lane Marking confidence";
CM_ SG_ 667 ADC_AdjLLnMrking_Range "adjacent Left Lane Marking range";
CM_ SG_ 667 ADC_AdjLlnMrkingDispSt "Display state of the adjacent left lane marking";
CM_ SG_ 667 ADC_AdjLLnMrking_Type "adjacent Left side of lane marking indication type";
CM_ SG_ 667 ADC_AdjRLnMrking_A0 "adjacent right Lane Marking Polynomial Coefficient A0, which stands for the lateral distance between lane marking and the middle of the eog vehicle.";
CM_ SG_ 667 ADC_AdjRLnMrking_A1 "adjacent right Lane Marking Polynomial Coefficient A1, which stands for the heading angle between the lane marking and the ego vehicle.";
CM_ SG_ 667 ADC_AdjRLnMrking_A2 "adjacent right Lane Marking Polynomial Coefficient A2, which stands for the curvature of the lane marking.";
CM_ SG_ 667 ADC_AdjRLnMrking_Range "adjacent right Lane Marking range";
CM_ SG_ 667 ADC_AdjRLnMrking_conf "adjacent right Lane Marking confidence";
CM_ SG_ 667 ADC_AdjRlnMrkingDispSt "Display state of the adjacent right lane marking";
CM_ SG_ 667 ADC_AdjRLnMrking_Type "adjacent right side of lane marking indication type";
CM_ SG_ 947 ADC_8_CRC "E2E Profile 5 CRC";
CM_ SG_ 947 ADC_8_Counter "E2E Profile 5 Counter";
CM_ SG_ 947 ADC_LowBeamReq "Low Beam Request?";
CM_ SG_ 947 ADC_IHBC_HighBeamReq "IHBC High Beam Request?";
CM_ SG_ 947 ADC_FlashReq "Flash High Beam Request?";
CM_ SG_ 947 ADC_PositionLampReq "Position Lamp Request?";
CM_ SG_ 947 ADC_HVACCtrlReq "Air conditioner request";
CM_ SG_ 947 ADC_FFogLightReq "Front Fog Light Request?";
CM_ SG_ 947 ADC_RFogLightReq "Rear Fog Light Request?";
CM_ SG_ 947 ADC_HornReq "Horn Request";
CM_ SG_ 947 ADC_FWiperReq "Front Wiper Request";
CM_ SG_ 947 ADC_RWiperReq "Rear Wiper Request";
CM_ SG_ 947 ADC_FWaterSprayReq "Front Water Spray Request";
CM_ SG_ 947 ADC_RWaterSprayReq "Rear Water Spray Request";
CM_ SG_ 947 ADC_CCUReqVD "CCU Request valid";
CM_ SG_ 947 ADC_WindowOpenReq "Window Open Request";
CM_ SG_ 947 ADC_WindowCloseReq "Window Close Request";
CM_ SG_ 947 ADC_PLGMOpenReq "PLGM Open Request";
CM_ SG_ 947 ADC_PLGMCloseReq "PLGM Close Request";
CM_ SG_ 947 ADC_FDemistReq "Front window Demist Active Request";
CM_ SG_ 947 ADC_RDemistReq "Rear window Demist Active Request";
CM_ SG_ 947 ADC_ThmPostRun "ADC cooling demand flag request";
CM_ SG_ 947 ADC_DriverFaceWindReq "Driver Face Wind Request";
CM_ SG_ 947 ADC_EcallReq "ADAS E-call Request";
CM_ SG_ 947 ADC_FlowReq "ADC cooling liquid flow rate request";
CM_ SG_ 947 ADC_DriverSeatBeltPretightenReq "Driver Seat Belt Pretighten Request";
CM_ SG_ 947 ADC_LockReq "Doors Lock/Unlock Request";
CM_ SG_ 947 ADC_HoldLockReq "Hold Doors Lock/Unlock Request";
CM_ SG_ 947 ADC_RearMirrorReq "Rear Mirror Fold/Unfold Request";
CM_ SG_ 947 ADC_HoldRearMirrorReq "Hold Rear Mirror Fold/Unfold Request";
CM_ SG_ 947 ADC_ADSLightReq "ADS light request";
CM_ SG_ 947 ADC_ReqChargPortCapOpen "ADC Request Charging Port Cap Open";
CM_ SG_ 947 ADC_ReqChargeDiscont "ADC Request Charge Connector Disconnected";
CM_ SG_ 947 ADC_DriverSeatBeltVibrWarnReq "ADAS active driver seat belt vibration warning request";
CM_ SG_ 947 ADC_FrtWindshildHeatReq "Front windshield heating wire control request";
CM_ SG_ 947 ADC_BeamSwReq "Head light switch control request（turn on automatic light）";
CM_ SG_ 947 IFC_SysCalibrationSt "IFC(Intelligent Front Camera) system calibration ststus";
CM_ SG_ 947 ADC_ADBIHBCEnableReq "ADB and IHBC enable request";
CM_ SG_ 947 ADC_RearLeftChildSaftyLockReq "RearLeftChildSaftyLockReq";
CM_ SG_ 947 ADC_RearRightChildSaftyLockReq "RearRightChildSaftyLockReq_Backup";
CM_ SG_ 947 ADC_MachineStatus "ADC Machine Status";
CM_ SG_ 947 ADC_LowPowerFailReason "The Reason why ADC  cannot change to LowPowerMode";
CM_ SG_ 947 ADC_ChgPortControlReq "Charging Port Close/Open Request";
CM_ SG_ 947 ADC_ChgPortHoldControlReq "Hold Charging Port Close/Open Request";
CM_ SG_ 947 ADC_LightbarReq "ADC’s Light bar request";
CM_ SG_ 947 ADC_ChargHoldReq "Hold Charging  Start/Stop Request";
CM_ SG_ 947 ADC_ChargReq "Charging  Start/Stop Request";
CM_ SG_ 947 ADC_ChargGunHoldReq "Hold Charging  Gun Close/Open Request";
CM_ SG_ 947 ADC_ChargGunReq "Charging  Gun Close/Open Request";
CM_ SG_ 947 ADC_MCURTTemp "Real-time Temperature of ADC MCU";
CM_ SG_ 947 ADC_SOCRTtemp "Real-time Temperature of ADC SOC";
CM_ SG_ 947 ADC_InteractLightReq "Interact light request";
CM_ SG_ 947 ADCState "MDC state currently(Bigdata)";
CM_ SG_ 947 ADCtargetState "ADCtargetState(Bigdata)";
CM_ SG_ 947 Parking_System_State "ParkingSystemState(Bigdata)";
CM_ SG_ 947 Driving_System_State "DrivingSystemState(Bigdata)";
CM_ SG_ 947 subStandAlone "subStandAlone(Bigdata)";
CM_ SG_ 947 platMode "platMode(Bigdata)";
CM_ SG_ 947 OTA_Target_ADS "is the OTA Target ADS or not(Bigdata)";
CM_ SG_ 947 Fault_flg_to_Power_Down "Power_DOWN_AFTER_EXTING(Bigdata)";
CM_ SG_ 947 runOnce "runOnce(Bigdata)";
CM_ SG_ 947 nmServiceHold "nmServiceHold(Bigdata)";
CM_ SG_ 947 nmServiceRelease "nmServiceRelease(Bigdata)";
CM_ SG_ 947 lidarsPower "lidarsPower(Bigdata)";
CM_ SG_ 374 FAPA_1_CRC "E2E Profile 5 CRC";
CM_ SG_ 374 FAPA_1_Counter "E2E Profile 5 Counter";
CM_ SG_ 374 FAPA_ADC_AngReqAvl "Steering angle request avaliable state";
CM_ SG_ 374 FAPA_ADC_ActTrqReqVD "The validity of ADC torque request to VCU";
CM_ SG_ 374 FAPA_ADC_ActTrqReqEnable "Enable flag for VCU for realization of target torque ActTrqReq";
CM_ SG_ 374 FAPA_ADC_ActTrqReq "VLC Request Effective target torque on wheel level to VCU";
CM_ SG_ 374 FAPA_ADC_TotalRefTorque_A "ADAS total torque request";
CM_ SG_ 374 FAPA_ADC_FctSts "ADAS active status";
CM_ SG_ 374 FAPA_ADC_ElecBrkFnSwitch "The switch for regenerative brake and hydraulic brake。Off：The ESP/IPB can not assign regenerative brake torque to the VCU/DCU。On：The ESP/IPB can assign regenerative brake torque to the VCUDCU。";
CM_ SG_ 374 FAPA_ADC_TarGearReqVld "Gear lever request validity";
CM_ SG_ 374 FAPA_ADC_PAAGrarLvlReq "Gear lever position request for the vehicle mo-tion control";
CM_ SG_ 374 FAPA_ADC_PAAGrarLvlReqEnable "enable flag to control the gear box";
CM_ SG_ 374 FAPA_ADC_BrkTarTqVld "The validity of total target brake torque";
CM_ SG_ 374 FAPA_ADC_BrkTarTqEna "The enable status of total target brake torque";
CM_ SG_ 374 FAPA_ADC_BrkTarTqMod "This signal indicates which function the total target brake torque is used for，cruise or parking function.";
CM_ SG_ 374 FAPA_ADC_BrkTarTq "Total target brake torque for cruise and parking function ";
CM_ SG_ 374 FAPA_ADC_LongCtrlTypReq "Main ADC Longitudinal Control Brake type. Comfort Mode : The controller and brake system will consider NVH limitations, carefully reaction for good driving feeling, etc. Emergency Mode: the controller react fast and the brake system will achieve maximum performance (No limitations, eg. NVH limitations, HW protection).";
CM_ SG_ 374 FAPA_ADC_BrkHoldReq "The AVH request from the ADAS/ADS to the ESP/IPB.  Not active：AVH no active Active：AVH active";
CM_ SG_ 374 FAPA_ADC_DriverPresent "It indicates whether someone is in the driver's seat.";
CM_ SG_ 374 FAPA_ADC_AngReqSt_A "Lateral control Function Request State";
CM_ SG_ 374 FAPA_ADC_StrAngleReq_A "Steering Angle Request Value";
CM_ SG_ 374 FAPA_ADC_SACMotorTorLimExtMax "Maximum Motor External Torque Limitation of Angle Following";
CM_ SG_ 374 FAPA_ADC_SACMotorTorLimExtMin "Minimum Motor External Torque Limitation of Angle Following";
CM_ SG_ 374 FAPA_ADC_AngReqFunction "Indicates which function request angle control";
CM_ SG_ 374 FAPA_ADC_EpbModReqVld "The validity of the request from the ADAS/ADS to the EPB";
CM_ SG_ 374 FAPA_ADC_RWUEna "The enable status of the RWU";
CM_ SG_ 374 FAPA_ADC_RWUVld "The validity of the RWU";
CM_ SG_ 374 FAPA_ADC_PAA2EPBEpbReq "PAA to EPB request  ";
CM_ SG_ 374 FAPA_ADC_PAA2EPBEpbReqSt "PAA to EPB request  status";
CM_ SG_ 374 FAPA_ADC_TurnLightReq "Turn Lamp and Hazard Lamp Request?";
CM_ SG_ 374 FAPA_ADC_CCUReqVD "CCU Request valid";
CM_ SG_ 374 FAPA_ReqIFCForward "FAPA request IFC forward ";
CM_ SG_ 374 FAPA_ADC_RearMirrorReq "Rear Mirror Fold/Unfold Request";
CM_ SG_ 374 ADC_LockReq "Doors Lock/Unlock Request";
CM_ SG_ 374 ADC_HoldLockReq "Hold Doors Lock/Unlock Request";
CM_ SG_ 374 FAPA_ADC_DrvTarTqMod2EPB "FAPA Drive torque mode to EPB";
CM_ SG_ 437 IFC_1_CRC "E2E Profile 5 CRC";
CM_ SG_ 437 IFC_1_Counter "E2E Profile 5 Counter";
CM_ SG_ 437 IFC_SysCalibrationSt "IFC(Intelligent Front Camera) systemcalibration status";
CM_ SG_ 437 IFC_CameraBlockageSt "IFC(Intelligent Front Camera) camerablockage status";
CM_ SG_ 437 IFC_MRMAvailability "Backup ADC Minimum Risk Manoeuvre availability";
CM_ SG_ 437 IFC_ICMWarnCardSt "IFC Warn Card State Request";
CM_ SG_ 437 IFC_BrakeLightReq "Brake Light Request?";
CM_ SG_ 437 IFC_LongCtrlModeForBrkSys "Backup ADC Longitudinal Control Mode For BrakeSys.Off mode: ADAS Not engage.L2++ Active:ADC Working in L2++ or Advance Cruise ,Brake system has a redundant actuator.";
CM_ SG_ 437 IFC_LongCtrlTargetAx "Backup ADC Longitudinal Control acceleration forBrakeSystem";
CM_ SG_ 437 IFC_LongCtrlTargetAxReq "Backup ADC Request from the Longitudinal Control acceleration to BrakeSys";
CM_ SG_ 437 IFC_LongCtrlTypReq "Backup ADC Comfort Mode : The controller and brake system will consider NVH limitations, carefully reaction for good driving feeling, etc.Emergency Mode: the controller react fast and the brake system will achieve maximum performance (No limitations, eg. NVH limitations, HW protection).";
CM_ SG_ 437 IFC_LongCtrlDecToStopReq "Backup ADC LongitudinalControl requires deceleration to stop";
CM_ SG_ 437 IFC_ICMPromptWarn "IFC Prompt Warn Request";
CM_ SG_ 437 IFC_CCUReqVD "CCU Request valid";
CM_ SG_ 437 IFC_TurnLightReq "Turn Lamp and Hazard Lamp";
CM_ SG_ 437 IFC_ActTrqReqEnable "Enable flag for VCU for realization of target torque ActTrqReq";
CM_ SG_ 437 IFC_ActTrqReq "VLC Request Effective target torque on wheel level to VCU";
CM_ SG_ 437 IFC_VLCSt "Vehicle Longitudinal Power Control status of ADAS to VCU/EMS";
CM_ SG_ 437 IFC_ADCFailSt "IFC take over lateral control while ADC failed";
CM_ SG_ 437 IFC_AngReqRdntSt "Angle following control redundancy state";
CM_ SG_ 437 IFC_AngReqSt "Lateral control Function Request State";
CM_ SG_ 437 IFC_StrAngleReq "Steering Angle Request Value";
CM_ SG_ 437 IFC_SACMotorTorLimExtMin "Minimum Motor External Torque Limitation of Angle Following";
CM_ SG_ 437 IFC_SACMotorTorLimExtMax "Maximum Motor External Torque Limitation of Angle Following";
CM_ SG_ 437 IFC_EcallReq "IFC E-call Request";
CM_ SG_ 918 UINM_PADS_1_CRC "E2E Profile Variant 1A CRC";
CM_ SG_ 918 UINM_PADS_1_Counter "E2E Profile Variant 1A Counter";
CM_ SG_ 918 UINM_PADS_ResponseErr "LIN response error";
CM_ SG_ 918 UINM_PADS_CustomSWSt "PADS Custom  swtich state";
CM_ SG_ 918 UINM_PADS_CustomSWStVD "PADS_CustomSWSt validity";
CM_ SG_ 918 UINM_PADS_CustomSWstuck "PADS Custom  swtich stuck state";
CM_ SG_ 918 UINM_PADS_IDC_PlaySWSt "Indicates PADS Play swtich state";
CM_ SG_ 918 UINM_PADS_IDC_PlaySWStVD "Indicates PADS_IDC_PlaySWSt validity";
CM_ SG_ 918 UINM_PADS_CruSetSpeedRollerRotatedDir "indicate PADS curise  roller rotating direction";
CM_ SG_ 918 UINM_PADS_FolDistIncSWSt "PADS Following distance level increase  swtich state";
CM_ SG_ 918 UINM_PADS_CruSetSpeedRollerSt "indicate PADS curise  roller rotating steps";
CM_ SG_ 918 UINM_PADS_FolDistIncSWStVD "Indicates PADS_FolDistIncSWSt validity";
CM_ SG_ 918 UINM_PADS_FolDistIncSWStuckSt "Indicates PADS's   distance level increase swtich stuck state";
CM_ SG_ 918 UINM_PADS_FolDistDecSWStVD "Indicates PADS_FolDistDecSWSt validity";
CM_ SG_ 918 UINM_PADS_FolDistDecSWStuckSt "Indicates PADS's   distance level decrease swtich stuck state";
CM_ SG_ 918 UINM_PADS_OKSWSt "PADS OK swtich state";
CM_ SG_ 918 UINM_PADS_OKSWStVD "Indicates PADS_OKSWSt validity";
CM_ SG_ 918 UINM_PADS_OKSWStuckSt "PADS OK swtich Stuck state";
CM_ SG_ 918 UINM_PADS_CruSetSpeedRollerVD "Indicates PADS's CruSetSpeed singal  validity";
CM_ SG_ 918 UINM_PADS_FolDistDecSWSt "PADS Following distance level decrease  swtich state";
CM_ SG_ 918 UINM_PADS_CruSWSt "Indicates PADS's Cruise On or Off swtich state";
CM_ SG_ 918 UINM_PADS_CruSWStVD "Indicates PADS_CruSWSt validity";
CM_ SG_ 918 UINM_PADS_CruSWStuckSt "Indicates PADS's Cruise On or Off swtich  stuck state";
CM_ SG_ 918 UINM_PADS_CruSpeedDecSWSt "Indicates PADS's Cruise Speed decrease swtich state";
CM_ SG_ 918 UINM_PADS_CruSpeedDecSWStVD "Indicates PADS_CruSpeedDecSWSt validity";
CM_ SG_ 918 UINM_PADS_CruSpeedDecSWStuckSt "Indicates PADS's Cruise Speed decrease swtich stcuk state";
CM_ SG_ 918 UINM_PADS_CruResumeSpeedIncSWSt "Indicates PADS's Cruise Resume&Speed increase or resume swtich state";
CM_ SG_ 918 UINM_PADS_CruResumeSpeedIncSWStVD "Indicates PADS_CruResumeSpeedIncSWSt validity";
CM_ SG_ 918 UINM_PADS_CruResumeSpeedIncSWStuckSt "Indicates PADS's Cruise Resume&Speed increase or resume swtich state";
CM_ SG_ 918 UINM_PADS_CruTJAICASWSt "Indicates PADS's Trafiic Jam Assist or Integrated Cruise Assit  swtich state";
CM_ SG_ 918 UINM_PADS_CruTJAICASWStVD "Indicates PADS_CruTJAICASWSt validity";
CM_ SG_ 918 UINM_PADS_CruTJAICASWStuckSt "Indicates PADS's Trafiic Jam Assist or Integrated Cruise Assit  swtich Stuck state";
CM_ SG_ 918 UINM_PADS_Custom2SWSt "PADS Custom2  swtich state";
CM_ SG_ 918 UINM_PADS_Custom2SWStVD "PADS_Custom2SWSt validity";
CM_ SG_ 918 UINM_PADS_Custom2SWStuckSt "PADS Custom2  swtich stuck state";
CM_ SG_ 918 UINM_PADS_ACCSWSt "Indicates PADS's ACC swtich state";
CM_ SG_ 918 UINM_PADS_VoltageFaultSt "Indicates PADS's Supply voltage fault state";
CM_ SG_ 1078 ETC_DismountSt "OBU dismount status";
CM_ SG_ 1078 ETC_SelfcheckSt "OBU Self check statue";
CM_ SG_ 1078 ETC_GateProperty "RSU gate property";
CM_ SG_ 1078 ETC_TradeType "RSU trade type";
CM_ SG_ 1078 ETC_SystemSt "OBU System status";
CM_ SG_ 1078 ETC_SysCfgst "ETC System Enable & Disable configuration status";
CM_ SG_ 1078 ETC_ICMDisplayCfgst "ETC infomation display on ICM function Enable & Disable configuration status";
CM_ SG_ 1078 ETC_BLEenableCfgst "ETC Bluetooth function Enable & Disable configuration status";
CM_ SG_ 1078 ETC_ActivSt "OBU Activate status";
CM_ SG_ 1078 ETC_TradeInfo "Trade infomation";
CM_ SG_ 348 CCU_SecSynCounter "Sync counter in CCU SecOCsync message";
CM_ SG_ 348 CCU_SecSynResetCounter "Reset counter in CCU  SecOCsync message";
CM_ SG_ 348 CCU_SecSynMAC_Check "MAC value in CCU  SecOCsync message";
CM_ SG_ 170 ADC_SecReq "ADC SecOC freshness value synchronisation request message ";
CM_ SG_ 343 POD_DSMObstDetcnFL "Radar detection command left front door";
CM_ SG_ 343 POD_DSMObstDetcnFR "Radar detection command right front door";
CM_ SG_ 343 POD_DSMObstDetcnRL "Radar detection command left rear door";
CM_ SG_ 343 POD_DSMObstDetcnRR "Radar detection command right rear door";
CM_ SG_ 1024 SYNC_FC_Type "Type=0x20:TsyncType=0x28:Tsync FUP";
CM_ SG_ 1024 SYNC_FC_CRC "CRC";
CM_ SG_ 1024 SYNC_FC_Sequencecnt "Sequence counter";
CM_ SG_ 1024 SYNC_FC_TimeDomain "Time Domain";
CM_ SG_ 1024 SYNC_FC_OVS "In FUP PDUOVS=Overflow of seconds";
CM_ SG_ 1024 SYNC_FC_SGW "In FUP PDUSyncToGTM=0SyncToSubDomain=1";
CM_ SG_ 1024 SYNC_FC_Reserved "In FUP PDUReserved default=0";
CM_ SG_ 1024 SYNC_FC_SyncTime "Tsync:SyncTimeSec=32bit LSB of the 48 bits seconds part timeTsync FUP:Sync TimeNSec=32 bit value in nanosconds";

BA_DEF_ BO_  "GenMsgCycleTime" INT 0 0;
BA_DEF_ BO_  "GenMsgCycleTimeFast" INT 0 0;
BA_DEF_ BO_  "GenMsgSendType" ENUM  "Periodic","Event","IfActive","POE","PA","FixedPeriodic","Event","EnabledPeriodic","NotUsed","NotUsed","EventPeriodic","NotUsed","NotUsed","NoMsgSendType";
BA_DEF_ BO_  "VFrameFormat" ENUM  "StandardCAN","ExtendedCAN","reserved","reserved","reserved","reserved","reserved","reserved","reserved","reserved","reserved","reserved","reserved","reserved","StandardCAN_FD","ExtendedCAN_FD";
BA_DEF_ BO_  "CANFD_BRS" ENUM  "0","1";
BA_DEF_ SG_  "EventCommandSignal" ENUM  "No","Yes";
BA_DEF_ SG_  "GatewayedSignals" ENUM  "No","Yes";
BA_DEF_ SG_  "GenSigInactiveValue" HEX 0 0;
BA_DEF_ SG_  "GenSigInvalidValue" HEX 0 0;
BA_DEF_ SG_  "GenSigSendType" ENUM  "Trigger","Passive","Cyclic","OnWrite","OnWriteWithRepetition","OnChange","OnChangeWithRepetition","IfActive","IfActiveWithRepetition","NoSigSendType";
BA_DEF_ SG_  "GenSigStartValue" HEX 0 0;
BA_DEF_ SG_  "GenSigTimeoutValue" HEX 0 0;
BA_DEF_ SG_  "Remark" STRING ;
BA_ "GenMsgCycleTime" BO_ 667 50;
BA_ "GenMsgCycleTimeFast" BO_ 667 0;
BA_ "GenMsgSendType" BO_ 667 0;
BA_ "VFrameFormat" BO_ 667 14;
BA_ "CANFD_BRS" BO_ 667 1;
BA_ "GenMsgCycleTime" BO_ 667 50;
BA_ "GenMsgCycleTimeFast" BO_ 667 0;
BA_ "GenMsgSendType" BO_ 667 0;
BA_ "VFrameFormat" BO_ 667 14;
BA_ "CANFD_BRS" BO_ 667 1;
BA_ "GenMsgCycleTime" BO_ 667 50;
BA_ "GenMsgCycleTimeFast" BO_ 667 0;
BA_ "GenMsgSendType" BO_ 667 0;
BA_ "VFrameFormat" BO_ 667 14;
BA_ "CANFD_BRS" BO_ 667 1;
BA_ "GenMsgCycleTime" BO_ 667 50;
BA_ "GenMsgCycleTimeFast" BO_ 667 0;
BA_ "GenMsgSendType" BO_ 667 0;
BA_ "VFrameFormat" BO_ 667 14;
BA_ "CANFD_BRS" BO_ 667 1;
BA_ "GenMsgCycleTime" BO_ 667 50;
BA_ "GenMsgCycleTimeFast" BO_ 667 0;
BA_ "GenMsgSendType" BO_ 667 0;
BA_ "VFrameFormat" BO_ 667 14;
BA_ "CANFD_BRS" BO_ 667 1;
BA_ "GenMsgCycleTime" BO_ 667 50;
BA_ "GenMsgCycleTimeFast" BO_ 667 0;
BA_ "GenMsgSendType" BO_ 667 0;
BA_ "VFrameFormat" BO_ 667 14;
BA_ "CANFD_BRS" BO_ 667 1;
BA_ "GenMsgCycleTime" BO_ 667 50;
BA_ "GenMsgCycleTimeFast" BO_ 667 0;
BA_ "GenMsgSendType" BO_ 667 0;
BA_ "VFrameFormat" BO_ 667 14;
BA_ "CANFD_BRS" BO_ 667 1;
BA_ "GenMsgCycleTime" BO_ 667 50;
BA_ "GenMsgCycleTimeFast" BO_ 667 0;
BA_ "GenMsgSendType" BO_ 667 0;
BA_ "VFrameFormat" BO_ 667 14;
BA_ "CANFD_BRS" BO_ 667 1;
BA_ "GenMsgCycleTime" BO_ 667 50;
BA_ "GenMsgCycleTimeFast" BO_ 667 0;
BA_ "GenMsgSendType" BO_ 667 0;
BA_ "VFrameFormat" BO_ 667 14;
BA_ "CANFD_BRS" BO_ 667 1;
BA_ "GenMsgCycleTime" BO_ 667 50;
BA_ "GenMsgCycleTimeFast" BO_ 667 0;
BA_ "GenMsgSendType" BO_ 667 0;
BA_ "VFrameFormat" BO_ 667 14;
BA_ "CANFD_BRS" BO_ 667 1;
BA_ "GenMsgCycleTime" BO_ 667 50;
BA_ "GenMsgCycleTimeFast" BO_ 667 0;
BA_ "GenMsgSendType" BO_ 667 0;
BA_ "VFrameFormat" BO_ 667 14;
BA_ "CANFD_BRS" BO_ 667 1;
BA_ "GenMsgCycleTime" BO_ 667 50;
BA_ "GenMsgCycleTimeFast" BO_ 667 0;
BA_ "GenMsgSendType" BO_ 667 0;
BA_ "VFrameFormat" BO_ 667 14;
BA_ "CANFD_BRS" BO_ 667 1;
BA_ "GenMsgCycleTime" BO_ 667 50;
BA_ "GenMsgCycleTimeFast" BO_ 667 0;
BA_ "GenMsgSendType" BO_ 667 0;
BA_ "VFrameFormat" BO_ 667 14;
BA_ "CANFD_BRS" BO_ 667 1;
BA_ "GenMsgCycleTime" BO_ 667 50;
BA_ "GenMsgCycleTimeFast" BO_ 667 0;
BA_ "GenMsgSendType" BO_ 667 0;
BA_ "VFrameFormat" BO_ 667 14;
BA_ "CANFD_BRS" BO_ 667 1;
BA_ "GenMsgCycleTime" BO_ 667 50;
BA_ "GenMsgCycleTimeFast" BO_ 667 0;
BA_ "GenMsgSendType" BO_ 667 0;
BA_ "VFrameFormat" BO_ 667 14;
BA_ "CANFD_BRS" BO_ 667 1;
BA_ "GenMsgCycleTime" BO_ 667 50;
BA_ "GenMsgCycleTimeFast" BO_ 667 0;
BA_ "GenMsgSendType" BO_ 667 0;
BA_ "VFrameFormat" BO_ 667 14;
BA_ "CANFD_BRS" BO_ 667 1;
BA_ "GenMsgCycleTime" BO_ 667 50;
BA_ "GenMsgCycleTimeFast" BO_ 667 0;
BA_ "GenMsgSendType" BO_ 667 0;
BA_ "VFrameFormat" BO_ 667 14;
BA_ "CANFD_BRS" BO_ 667 1;
BA_ "GenMsgCycleTime" BO_ 667 50;
BA_ "GenMsgCycleTimeFast" BO_ 667 0;
BA_ "GenMsgSendType" BO_ 667 0;
BA_ "VFrameFormat" BO_ 667 14;
BA_ "CANFD_BRS" BO_ 667 1;
BA_ "GenMsgCycleTime" BO_ 667 50;
BA_ "GenMsgCycleTimeFast" BO_ 667 0;
BA_ "GenMsgSendType" BO_ 667 0;
BA_ "VFrameFormat" BO_ 667 14;
BA_ "CANFD_BRS" BO_ 667 1;
BA_ "GenMsgCycleTime" BO_ 667 50;
BA_ "GenMsgCycleTimeFast" BO_ 667 0;
BA_ "GenMsgSendType" BO_ 667 0;
BA_ "VFrameFormat" BO_ 667 14;
BA_ "CANFD_BRS" BO_ 667 1;
BA_ "GenMsgCycleTime" BO_ 667 50;
BA_ "GenMsgCycleTimeFast" BO_ 667 0;
BA_ "GenMsgSendType" BO_ 667 0;
BA_ "VFrameFormat" BO_ 667 14;
BA_ "CANFD_BRS" BO_ 667 1;
BA_ "GenMsgCycleTime" BO_ 667 50;
BA_ "GenMsgCycleTimeFast" BO_ 667 0;
BA_ "GenMsgSendType" BO_ 667 0;
BA_ "VFrameFormat" BO_ 667 14;
BA_ "CANFD_BRS" BO_ 667 1;
BA_ "GenMsgCycleTime" BO_ 667 50;
BA_ "GenMsgCycleTimeFast" BO_ 667 0;
BA_ "GenMsgSendType" BO_ 667 0;
BA_ "VFrameFormat" BO_ 667 14;
BA_ "CANFD_BRS" BO_ 667 1;
BA_ "GenMsgCycleTime" BO_ 667 50;
BA_ "GenMsgCycleTimeFast" BO_ 667 0;
BA_ "GenMsgSendType" BO_ 667 0;
BA_ "VFrameFormat" BO_ 667 14;
BA_ "CANFD_BRS" BO_ 667 1;
BA_ "GenMsgCycleTime" BO_ 667 50;
BA_ "GenMsgCycleTimeFast" BO_ 667 0;
BA_ "GenMsgSendType" BO_ 667 0;
BA_ "VFrameFormat" BO_ 667 14;
BA_ "CANFD_BRS" BO_ 667 1;
BA_ "GenMsgCycleTime" BO_ 667 50;
BA_ "GenMsgCycleTimeFast" BO_ 667 0;
BA_ "GenMsgSendType" BO_ 667 0;
BA_ "VFrameFormat" BO_ 667 14;
BA_ "CANFD_BRS" BO_ 667 1;
BA_ "GenMsgCycleTime" BO_ 667 50;
BA_ "GenMsgCycleTimeFast" BO_ 667 0;
BA_ "GenMsgSendType" BO_ 667 0;
BA_ "VFrameFormat" BO_ 667 14;
BA_ "CANFD_BRS" BO_ 667 1;
BA_ "GenMsgCycleTime" BO_ 667 50;
BA_ "GenMsgCycleTimeFast" BO_ 667 0;
BA_ "GenMsgSendType" BO_ 667 0;
BA_ "VFrameFormat" BO_ 667 14;
BA_ "CANFD_BRS" BO_ 667 1;
BA_ "GenMsgCycleTime" BO_ 667 50;
BA_ "GenMsgCycleTimeFast" BO_ 667 0;
BA_ "GenMsgSendType" BO_ 667 0;
BA_ "VFrameFormat" BO_ 667 14;
BA_ "CANFD_BRS" BO_ 667 1;
BA_ "GenMsgCycleTime" BO_ 667 50;
BA_ "GenMsgCycleTimeFast" BO_ 667 0;
BA_ "GenMsgSendType" BO_ 667 0;
BA_ "VFrameFormat" BO_ 667 14;
BA_ "CANFD_BRS" BO_ 667 1;
BA_ "GenMsgCycleTime" BO_ 667 50;
BA_ "GenMsgCycleTimeFast" BO_ 667 0;
BA_ "GenMsgSendType" BO_ 667 0;
BA_ "VFrameFormat" BO_ 667 14;
BA_ "CANFD_BRS" BO_ 667 1;
BA_ "GenMsgCycleTime" BO_ 667 50;
BA_ "GenMsgCycleTimeFast" BO_ 667 0;
BA_ "GenMsgSendType" BO_ 667 0;
BA_ "VFrameFormat" BO_ 667 14;
BA_ "CANFD_BRS" BO_ 667 1;
BA_ "GenMsgCycleTime" BO_ 667 50;
BA_ "GenMsgCycleTimeFast" BO_ 667 0;
BA_ "GenMsgSendType" BO_ 667 0;
BA_ "VFrameFormat" BO_ 667 14;
BA_ "CANFD_BRS" BO_ 667 1;
BA_ "GenMsgCycleTime" BO_ 667 50;
BA_ "GenMsgCycleTimeFast" BO_ 667 0;
BA_ "GenMsgSendType" BO_ 667 0;
BA_ "VFrameFormat" BO_ 667 14;
BA_ "CANFD_BRS" BO_ 667 1;
BA_ "GenMsgCycleTime" BO_ 667 50;
BA_ "GenMsgCycleTimeFast" BO_ 667 0;
BA_ "GenMsgSendType" BO_ 667 0;
BA_ "VFrameFormat" BO_ 667 14;
BA_ "CANFD_BRS" BO_ 667 1;
BA_ "GenMsgCycleTime" BO_ 667 50;
BA_ "GenMsgCycleTimeFast" BO_ 667 0;
BA_ "GenMsgSendType" BO_ 667 0;
BA_ "VFrameFormat" BO_ 667 14;
BA_ "CANFD_BRS" BO_ 667 1;
BA_ "GenMsgCycleTime" BO_ 947 100;
BA_ "GenMsgCycleTimeFast" BO_ 947 0;
BA_ "GenMsgSendType" BO_ 947 0;
BA_ "VFrameFormat" BO_ 947 14;
BA_ "CANFD_BRS" BO_ 947 1;
BA_ "GenMsgCycleTime" BO_ 947 100;
BA_ "GenMsgCycleTimeFast" BO_ 947 0;
BA_ "GenMsgSendType" BO_ 947 0;
BA_ "VFrameFormat" BO_ 947 14;
BA_ "CANFD_BRS" BO_ 947 1;
BA_ "GenMsgCycleTime" BO_ 947 100;
BA_ "GenMsgCycleTimeFast" BO_ 947 0;
BA_ "GenMsgSendType" BO_ 947 0;
BA_ "VFrameFormat" BO_ 947 14;
BA_ "CANFD_BRS" BO_ 947 1;
BA_ "GenMsgCycleTime" BO_ 947 100;
BA_ "GenMsgCycleTimeFast" BO_ 947 0;
BA_ "GenMsgSendType" BO_ 947 0;
BA_ "VFrameFormat" BO_ 947 14;
BA_ "CANFD_BRS" BO_ 947 1;
BA_ "GenMsgCycleTime" BO_ 947 100;
BA_ "GenMsgCycleTimeFast" BO_ 947 0;
BA_ "GenMsgSendType" BO_ 947 0;
BA_ "VFrameFormat" BO_ 947 14;
BA_ "CANFD_BRS" BO_ 947 1;
BA_ "GenMsgCycleTime" BO_ 947 100;
BA_ "GenMsgCycleTimeFast" BO_ 947 0;
BA_ "GenMsgSendType" BO_ 947 0;
BA_ "VFrameFormat" BO_ 947 14;
BA_ "CANFD_BRS" BO_ 947 1;
BA_ "GenMsgCycleTime" BO_ 947 100;
BA_ "GenMsgCycleTimeFast" BO_ 947 0;
BA_ "GenMsgSendType" BO_ 947 0;
BA_ "VFrameFormat" BO_ 947 14;
BA_ "CANFD_BRS" BO_ 947 1;
BA_ "GenMsgCycleTime" BO_ 947 100;
BA_ "GenMsgCycleTimeFast" BO_ 947 0;
BA_ "GenMsgSendType" BO_ 947 0;
BA_ "VFrameFormat" BO_ 947 14;
BA_ "CANFD_BRS" BO_ 947 1;
BA_ "GenMsgCycleTime" BO_ 947 100;
BA_ "GenMsgCycleTimeFast" BO_ 947 0;
BA_ "GenMsgSendType" BO_ 947 0;
BA_ "VFrameFormat" BO_ 947 14;
BA_ "CANFD_BRS" BO_ 947 1;
BA_ "GenMsgCycleTime" BO_ 947 100;
BA_ "GenMsgCycleTimeFast" BO_ 947 0;
BA_ "GenMsgSendType" BO_ 947 0;
BA_ "VFrameFormat" BO_ 947 14;
BA_ "CANFD_BRS" BO_ 947 1;
BA_ "GenMsgCycleTime" BO_ 947 100;
BA_ "GenMsgCycleTimeFast" BO_ 947 0;
BA_ "GenMsgSendType" BO_ 947 0;
BA_ "VFrameFormat" BO_ 947 14;
BA_ "CANFD_BRS" BO_ 947 1;
BA_ "GenMsgCycleTime" BO_ 947 100;
BA_ "GenMsgCycleTimeFast" BO_ 947 0;
BA_ "GenMsgSendType" BO_ 947 0;
BA_ "VFrameFormat" BO_ 947 14;
BA_ "CANFD_BRS" BO_ 947 1;
BA_ "GenMsgCycleTime" BO_ 947 100;
BA_ "GenMsgCycleTimeFast" BO_ 947 0;
BA_ "GenMsgSendType" BO_ 947 0;
BA_ "VFrameFormat" BO_ 947 14;
BA_ "CANFD_BRS" BO_ 947 1;
BA_ "GenMsgCycleTime" BO_ 947 100;
BA_ "GenMsgCycleTimeFast" BO_ 947 0;
BA_ "GenMsgSendType" BO_ 947 0;
BA_ "VFrameFormat" BO_ 947 14;
BA_ "CANFD_BRS" BO_ 947 1;
BA_ "GenMsgCycleTime" BO_ 947 100;
BA_ "GenMsgCycleTimeFast" BO_ 947 0;
BA_ "GenMsgSendType" BO_ 947 0;
BA_ "VFrameFormat" BO_ 947 14;
BA_ "CANFD_BRS" BO_ 947 1;
BA_ "GenMsgCycleTime" BO_ 947 100;
BA_ "GenMsgCycleTimeFast" BO_ 947 0;
BA_ "GenMsgSendType" BO_ 947 0;
BA_ "VFrameFormat" BO_ 947 14;
BA_ "CANFD_BRS" BO_ 947 1;
BA_ "GenMsgCycleTime" BO_ 947 100;
BA_ "GenMsgCycleTimeFast" BO_ 947 0;
BA_ "GenMsgSendType" BO_ 947 0;
BA_ "VFrameFormat" BO_ 947 14;
BA_ "CANFD_BRS" BO_ 947 1;
BA_ "GenMsgCycleTime" BO_ 947 100;
BA_ "GenMsgCycleTimeFast" BO_ 947 0;
BA_ "GenMsgSendType" BO_ 947 0;
BA_ "VFrameFormat" BO_ 947 14;
BA_ "CANFD_BRS" BO_ 947 1;
BA_ "GenMsgCycleTime" BO_ 947 100;
BA_ "GenMsgCycleTimeFast" BO_ 947 0;
BA_ "GenMsgSendType" BO_ 947 0;
BA_ "VFrameFormat" BO_ 947 14;
BA_ "CANFD_BRS" BO_ 947 1;
BA_ "GenMsgCycleTime" BO_ 947 100;
BA_ "GenMsgCycleTimeFast" BO_ 947 0;
BA_ "GenMsgSendType" BO_ 947 0;
BA_ "VFrameFormat" BO_ 947 14;
BA_ "CANFD_BRS" BO_ 947 1;
BA_ "GenMsgCycleTime" BO_ 947 100;
BA_ "GenMsgCycleTimeFast" BO_ 947 0;
BA_ "GenMsgSendType" BO_ 947 0;
BA_ "VFrameFormat" BO_ 947 14;
BA_ "CANFD_BRS" BO_ 947 1;
BA_ "GenMsgCycleTime" BO_ 947 100;
BA_ "GenMsgCycleTimeFast" BO_ 947 0;
BA_ "GenMsgSendType" BO_ 947 0;
BA_ "VFrameFormat" BO_ 947 14;
BA_ "CANFD_BRS" BO_ 947 1;
BA_ "GenMsgCycleTime" BO_ 947 100;
BA_ "GenMsgCycleTimeFast" BO_ 947 0;
BA_ "GenMsgSendType" BO_ 947 0;
BA_ "VFrameFormat" BO_ 947 14;
BA_ "CANFD_BRS" BO_ 947 1;
BA_ "GenMsgCycleTime" BO_ 947 100;
BA_ "GenMsgCycleTimeFast" BO_ 947 0;
BA_ "GenMsgSendType" BO_ 947 0;
BA_ "VFrameFormat" BO_ 947 14;
BA_ "CANFD_BRS" BO_ 947 1;
BA_ "GenMsgCycleTime" BO_ 947 100;
BA_ "GenMsgCycleTimeFast" BO_ 947 0;
BA_ "GenMsgSendType" BO_ 947 0;
BA_ "VFrameFormat" BO_ 947 14;
BA_ "CANFD_BRS" BO_ 947 1;
BA_ "GenMsgCycleTime" BO_ 947 100;
BA_ "GenMsgCycleTimeFast" BO_ 947 0;
BA_ "GenMsgSendType" BO_ 947 0;
BA_ "VFrameFormat" BO_ 947 14;
BA_ "CANFD_BRS" BO_ 947 1;
BA_ "GenMsgCycleTime" BO_ 947 100;
BA_ "GenMsgCycleTimeFast" BO_ 947 0;
BA_ "GenMsgSendType" BO_ 947 0;
BA_ "VFrameFormat" BO_ 947 14;
BA_ "CANFD_BRS" BO_ 947 1;
BA_ "GenMsgCycleTime" BO_ 947 100;
BA_ "GenMsgCycleTimeFast" BO_ 947 0;
BA_ "GenMsgSendType" BO_ 947 0;
BA_ "VFrameFormat" BO_ 947 14;
BA_ "CANFD_BRS" BO_ 947 1;
BA_ "GenMsgCycleTime" BO_ 947 100;
BA_ "GenMsgCycleTimeFast" BO_ 947 0;
BA_ "GenMsgSendType" BO_ 947 0;
BA_ "VFrameFormat" BO_ 947 14;
BA_ "CANFD_BRS" BO_ 947 1;
BA_ "GenMsgCycleTime" BO_ 947 100;
BA_ "GenMsgCycleTimeFast" BO_ 947 0;
BA_ "GenMsgSendType" BO_ 947 0;
BA_ "VFrameFormat" BO_ 947 14;
BA_ "CANFD_BRS" BO_ 947 1;
BA_ "GenMsgCycleTime" BO_ 947 100;
BA_ "GenMsgCycleTimeFast" BO_ 947 0;
BA_ "GenMsgSendType" BO_ 947 0;
BA_ "VFrameFormat" BO_ 947 14;
BA_ "CANFD_BRS" BO_ 947 1;
BA_ "GenMsgCycleTime" BO_ 947 100;
BA_ "GenMsgCycleTimeFast" BO_ 947 0;
BA_ "GenMsgSendType" BO_ 947 0;
BA_ "VFrameFormat" BO_ 947 14;
BA_ "CANFD_BRS" BO_ 947 1;
BA_ "GenMsgCycleTime" BO_ 947 100;
BA_ "GenMsgCycleTimeFast" BO_ 947 0;
BA_ "GenMsgSendType" BO_ 947 0;
BA_ "VFrameFormat" BO_ 947 14;
BA_ "CANFD_BRS" BO_ 947 1;
BA_ "GenMsgCycleTime" BO_ 947 100;
BA_ "GenMsgCycleTimeFast" BO_ 947 0;
BA_ "GenMsgSendType" BO_ 947 0;
BA_ "VFrameFormat" BO_ 947 14;
BA_ "CANFD_BRS" BO_ 947 1;
BA_ "GenMsgCycleTime" BO_ 947 100;
BA_ "GenMsgCycleTimeFast" BO_ 947 0;
BA_ "GenMsgSendType" BO_ 947 0;
BA_ "VFrameFormat" BO_ 947 14;
BA_ "CANFD_BRS" BO_ 947 1;
BA_ "GenMsgCycleTime" BO_ 947 100;
BA_ "GenMsgCycleTimeFast" BO_ 947 0;
BA_ "GenMsgSendType" BO_ 947 0;
BA_ "VFrameFormat" BO_ 947 14;
BA_ "CANFD_BRS" BO_ 947 1;
BA_ "GenMsgCycleTime" BO_ 947 100;
BA_ "GenMsgCycleTimeFast" BO_ 947 0;
BA_ "GenMsgSendType" BO_ 947 0;
BA_ "VFrameFormat" BO_ 947 14;
BA_ "CANFD_BRS" BO_ 947 1;
BA_ "GenMsgCycleTime" BO_ 947 100;
BA_ "GenMsgCycleTimeFast" BO_ 947 0;
BA_ "GenMsgSendType" BO_ 947 0;
BA_ "VFrameFormat" BO_ 947 14;
BA_ "CANFD_BRS" BO_ 947 1;
BA_ "GenMsgCycleTime" BO_ 947 100;
BA_ "GenMsgCycleTimeFast" BO_ 947 0;
BA_ "GenMsgSendType" BO_ 947 0;
BA_ "VFrameFormat" BO_ 947 14;
BA_ "CANFD_BRS" BO_ 947 1;
BA_ "GenMsgCycleTime" BO_ 947 100;
BA_ "GenMsgCycleTimeFast" BO_ 947 0;
BA_ "GenMsgSendType" BO_ 947 0;
BA_ "VFrameFormat" BO_ 947 14;
BA_ "CANFD_BRS" BO_ 947 1;
BA_ "GenMsgCycleTime" BO_ 947 100;
BA_ "GenMsgCycleTimeFast" BO_ 947 0;
BA_ "GenMsgSendType" BO_ 947 0;
BA_ "VFrameFormat" BO_ 947 14;
BA_ "CANFD_BRS" BO_ 947 1;
BA_ "GenMsgCycleTime" BO_ 947 100;
BA_ "GenMsgCycleTimeFast" BO_ 947 0;
BA_ "GenMsgSendType" BO_ 947 0;
BA_ "VFrameFormat" BO_ 947 14;
BA_ "CANFD_BRS" BO_ 947 1;
BA_ "GenMsgCycleTime" BO_ 947 100;
BA_ "GenMsgCycleTimeFast" BO_ 947 0;
BA_ "GenMsgSendType" BO_ 947 0;
BA_ "VFrameFormat" BO_ 947 14;
BA_ "CANFD_BRS" BO_ 947 1;
BA_ "GenMsgCycleTime" BO_ 947 100;
BA_ "GenMsgCycleTimeFast" BO_ 947 0;
BA_ "GenMsgSendType" BO_ 947 0;
BA_ "VFrameFormat" BO_ 947 14;
BA_ "CANFD_BRS" BO_ 947 1;
BA_ "GenMsgCycleTime" BO_ 947 100;
BA_ "GenMsgCycleTimeFast" BO_ 947 0;
BA_ "GenMsgSendType" BO_ 947 0;
BA_ "VFrameFormat" BO_ 947 14;
BA_ "CANFD_BRS" BO_ 947 1;
BA_ "GenMsgCycleTime" BO_ 947 100;
BA_ "GenMsgCycleTimeFast" BO_ 947 0;
BA_ "GenMsgSendType" BO_ 947 0;
BA_ "VFrameFormat" BO_ 947 14;
BA_ "CANFD_BRS" BO_ 947 1;
BA_ "GenMsgCycleTime" BO_ 947 100;
BA_ "GenMsgCycleTimeFast" BO_ 947 0;
BA_ "GenMsgSendType" BO_ 947 0;
BA_ "VFrameFormat" BO_ 947 14;
BA_ "CANFD_BRS" BO_ 947 1;
BA_ "GenMsgCycleTime" BO_ 947 100;
BA_ "GenMsgCycleTimeFast" BO_ 947 0;
BA_ "GenMsgSendType" BO_ 947 0;
BA_ "VFrameFormat" BO_ 947 14;
BA_ "CANFD_BRS" BO_ 947 1;
BA_ "GenMsgCycleTime" BO_ 947 100;
BA_ "GenMsgCycleTimeFast" BO_ 947 0;
BA_ "GenMsgSendType" BO_ 947 0;
BA_ "VFrameFormat" BO_ 947 14;
BA_ "CANFD_BRS" BO_ 947 1;
BA_ "GenMsgCycleTime" BO_ 947 100;
BA_ "GenMsgCycleTimeFast" BO_ 947 0;
BA_ "GenMsgSendType" BO_ 947 0;
BA_ "VFrameFormat" BO_ 947 14;
BA_ "CANFD_BRS" BO_ 947 1;
BA_ "GenMsgCycleTime" BO_ 947 100;
BA_ "GenMsgCycleTimeFast" BO_ 947 0;
BA_ "GenMsgSendType" BO_ 947 0;
BA_ "VFrameFormat" BO_ 947 14;
BA_ "CANFD_BRS" BO_ 947 1;
BA_ "GenMsgCycleTime" BO_ 947 100;
BA_ "GenMsgCycleTimeFast" BO_ 947 0;
BA_ "GenMsgSendType" BO_ 947 0;
BA_ "VFrameFormat" BO_ 947 14;
BA_ "CANFD_BRS" BO_ 947 1;
BA_ "GenMsgCycleTime" BO_ 947 100;
BA_ "GenMsgCycleTimeFast" BO_ 947 0;
BA_ "GenMsgSendType" BO_ 947 0;
BA_ "VFrameFormat" BO_ 947 14;
BA_ "CANFD_BRS" BO_ 947 1;
BA_ "GenMsgCycleTime" BO_ 947 100;
BA_ "GenMsgCycleTimeFast" BO_ 947 0;
BA_ "GenMsgSendType" BO_ 947 0;
BA_ "VFrameFormat" BO_ 947 14;
BA_ "CANFD_BRS" BO_ 947 1;
BA_ "GenMsgCycleTime" BO_ 947 100;
BA_ "GenMsgCycleTimeFast" BO_ 947 0;
BA_ "GenMsgSendType" BO_ 947 0;
BA_ "VFrameFormat" BO_ 947 14;
BA_ "CANFD_BRS" BO_ 947 1;
BA_ "GenMsgCycleTime" BO_ 947 100;
BA_ "GenMsgCycleTimeFast" BO_ 947 0;
BA_ "GenMsgSendType" BO_ 947 0;
BA_ "VFrameFormat" BO_ 947 14;
BA_ "CANFD_BRS" BO_ 947 1;
BA_ "GenMsgCycleTime" BO_ 947 100;
BA_ "GenMsgCycleTimeFast" BO_ 947 0;
BA_ "GenMsgSendType" BO_ 947 0;
BA_ "VFrameFormat" BO_ 947 14;
BA_ "CANFD_BRS" BO_ 947 1;
BA_ "GenMsgCycleTime" BO_ 947 100;
BA_ "GenMsgCycleTimeFast" BO_ 947 0;
BA_ "GenMsgSendType" BO_ 947 0;
BA_ "VFrameFormat" BO_ 947 14;
BA_ "CANFD_BRS" BO_ 947 1;
BA_ "GenMsgCycleTime" BO_ 947 100;
BA_ "GenMsgCycleTimeFast" BO_ 947 0;
BA_ "GenMsgSendType" BO_ 947 0;
BA_ "VFrameFormat" BO_ 947 14;
BA_ "CANFD_BRS" BO_ 947 1;
BA_ "GenMsgCycleTime" BO_ 947 100;
BA_ "GenMsgCycleTimeFast" BO_ 947 0;
BA_ "GenMsgSendType" BO_ 947 0;
BA_ "VFrameFormat" BO_ 947 14;
BA_ "CANFD_BRS" BO_ 947 1;
BA_ "GenMsgCycleTime" BO_ 947 100;
BA_ "GenMsgCycleTimeFast" BO_ 947 0;
BA_ "GenMsgSendType" BO_ 947 0;
BA_ "VFrameFormat" BO_ 947 14;
BA_ "CANFD_BRS" BO_ 947 1;
BA_ "GenMsgCycleTime" BO_ 947 100;
BA_ "GenMsgCycleTimeFast" BO_ 947 0;
BA_ "GenMsgSendType" BO_ 947 0;
BA_ "VFrameFormat" BO_ 947 14;
BA_ "CANFD_BRS" BO_ 947 1;
BA_ "GenMsgCycleTime" BO_ 947 100;
BA_ "GenMsgCycleTimeFast" BO_ 947 0;
BA_ "GenMsgSendType" BO_ 947 0;
BA_ "VFrameFormat" BO_ 947 14;
BA_ "CANFD_BRS" BO_ 947 1;
BA_ "GenMsgCycleTime" BO_ 947 100;
BA_ "GenMsgCycleTimeFast" BO_ 947 0;
BA_ "GenMsgSendType" BO_ 947 0;
BA_ "VFrameFormat" BO_ 947 14;
BA_ "CANFD_BRS" BO_ 947 1;
BA_ "GenMsgCycleTime" BO_ 947 100;
BA_ "GenMsgCycleTimeFast" BO_ 947 0;
BA_ "GenMsgSendType" BO_ 947 0;
BA_ "VFrameFormat" BO_ 947 14;
BA_ "CANFD_BRS" BO_ 947 1;
BA_ "GenMsgCycleTime" BO_ 947 100;
BA_ "GenMsgCycleTimeFast" BO_ 947 0;
BA_ "GenMsgSendType" BO_ 947 0;
BA_ "VFrameFormat" BO_ 947 14;
BA_ "CANFD_BRS" BO_ 947 1;
BA_ "GenMsgCycleTime" BO_ 374 10;
BA_ "GenMsgCycleTimeFast" BO_ 374 0;
BA_ "GenMsgSendType" BO_ 374 0;
BA_ "VFrameFormat" BO_ 374 14;
BA_ "CANFD_BRS" BO_ 374 1;
BA_ "GenMsgCycleTime" BO_ 374 10;
BA_ "GenMsgCycleTimeFast" BO_ 374 0;
BA_ "GenMsgSendType" BO_ 374 0;
BA_ "VFrameFormat" BO_ 374 14;
BA_ "CANFD_BRS" BO_ 374 1;
BA_ "GenMsgCycleTime" BO_ 374 10;
BA_ "GenMsgCycleTimeFast" BO_ 374 0;
BA_ "GenMsgSendType" BO_ 374 0;
BA_ "VFrameFormat" BO_ 374 14;
BA_ "CANFD_BRS" BO_ 374 1;
BA_ "GenMsgCycleTime" BO_ 374 10;
BA_ "GenMsgCycleTimeFast" BO_ 374 0;
BA_ "GenMsgSendType" BO_ 374 0;
BA_ "VFrameFormat" BO_ 374 14;
BA_ "CANFD_BRS" BO_ 374 1;
BA_ "GenMsgCycleTime" BO_ 374 10;
BA_ "GenMsgCycleTimeFast" BO_ 374 0;
BA_ "GenMsgSendType" BO_ 374 0;
BA_ "VFrameFormat" BO_ 374 14;
BA_ "CANFD_BRS" BO_ 374 1;
BA_ "GenMsgCycleTime" BO_ 374 10;
BA_ "GenMsgCycleTimeFast" BO_ 374 0;
BA_ "GenMsgSendType" BO_ 374 0;
BA_ "VFrameFormat" BO_ 374 14;
BA_ "CANFD_BRS" BO_ 374 1;
BA_ "GenMsgCycleTime" BO_ 374 10;
BA_ "GenMsgCycleTimeFast" BO_ 374 0;
BA_ "GenMsgSendType" BO_ 374 0;
BA_ "VFrameFormat" BO_ 374 14;
BA_ "CANFD_BRS" BO_ 374 1;
BA_ "GenMsgCycleTime" BO_ 374 10;
BA_ "GenMsgCycleTimeFast" BO_ 374 0;
BA_ "GenMsgSendType" BO_ 374 0;
BA_ "VFrameFormat" BO_ 374 14;
BA_ "CANFD_BRS" BO_ 374 1;
BA_ "GenMsgCycleTime" BO_ 374 10;
BA_ "GenMsgCycleTimeFast" BO_ 374 0;
BA_ "GenMsgSendType" BO_ 374 0;
BA_ "VFrameFormat" BO_ 374 14;
BA_ "CANFD_BRS" BO_ 374 1;
BA_ "GenMsgCycleTime" BO_ 374 10;
BA_ "GenMsgCycleTimeFast" BO_ 374 0;
BA_ "GenMsgSendType" BO_ 374 0;
BA_ "VFrameFormat" BO_ 374 14;
BA_ "CANFD_BRS" BO_ 374 1;
BA_ "GenMsgCycleTime" BO_ 374 10;
BA_ "GenMsgCycleTimeFast" BO_ 374 0;
BA_ "GenMsgSendType" BO_ 374 0;
BA_ "VFrameFormat" BO_ 374 14;
BA_ "CANFD_BRS" BO_ 374 1;
BA_ "GenMsgCycleTime" BO_ 374 10;
BA_ "GenMsgCycleTimeFast" BO_ 374 0;
BA_ "GenMsgSendType" BO_ 374 0;
BA_ "VFrameFormat" BO_ 374 14;
BA_ "CANFD_BRS" BO_ 374 1;
BA_ "GenMsgCycleTime" BO_ 374 10;
BA_ "GenMsgCycleTimeFast" BO_ 374 0;
BA_ "GenMsgSendType" BO_ 374 0;
BA_ "VFrameFormat" BO_ 374 14;
BA_ "CANFD_BRS" BO_ 374 1;
BA_ "GenMsgCycleTime" BO_ 374 10;
BA_ "GenMsgCycleTimeFast" BO_ 374 0;
BA_ "GenMsgSendType" BO_ 374 0;
BA_ "VFrameFormat" BO_ 374 14;
BA_ "CANFD_BRS" BO_ 374 1;
BA_ "GenMsgCycleTime" BO_ 374 10;
BA_ "GenMsgCycleTimeFast" BO_ 374 0;
BA_ "GenMsgSendType" BO_ 374 0;
BA_ "VFrameFormat" BO_ 374 14;
BA_ "CANFD_BRS" BO_ 374 1;
BA_ "GenMsgCycleTime" BO_ 374 10;
BA_ "GenMsgCycleTimeFast" BO_ 374 0;
BA_ "GenMsgSendType" BO_ 374 0;
BA_ "VFrameFormat" BO_ 374 14;
BA_ "CANFD_BRS" BO_ 374 1;
BA_ "GenMsgCycleTime" BO_ 374 10;
BA_ "GenMsgCycleTimeFast" BO_ 374 0;
BA_ "GenMsgSendType" BO_ 374 0;
BA_ "VFrameFormat" BO_ 374 14;
BA_ "CANFD_BRS" BO_ 374 1;
BA_ "GenMsgCycleTime" BO_ 374 10;
BA_ "GenMsgCycleTimeFast" BO_ 374 0;
BA_ "GenMsgSendType" BO_ 374 0;
BA_ "VFrameFormat" BO_ 374 14;
BA_ "CANFD_BRS" BO_ 374 1;
BA_ "GenMsgCycleTime" BO_ 374 10;
BA_ "GenMsgCycleTimeFast" BO_ 374 0;
BA_ "GenMsgSendType" BO_ 374 0;
BA_ "VFrameFormat" BO_ 374 14;
BA_ "CANFD_BRS" BO_ 374 1;
BA_ "GenMsgCycleTime" BO_ 374 10;
BA_ "GenMsgCycleTimeFast" BO_ 374 0;
BA_ "GenMsgSendType" BO_ 374 0;
BA_ "VFrameFormat" BO_ 374 14;
BA_ "CANFD_BRS" BO_ 374 1;
BA_ "GenMsgCycleTime" BO_ 374 10;
BA_ "GenMsgCycleTimeFast" BO_ 374 0;
BA_ "GenMsgSendType" BO_ 374 0;
BA_ "VFrameFormat" BO_ 374 14;
BA_ "CANFD_BRS" BO_ 374 1;
BA_ "GenMsgCycleTime" BO_ 374 10;
BA_ "GenMsgCycleTimeFast" BO_ 374 0;
BA_ "GenMsgSendType" BO_ 374 0;
BA_ "VFrameFormat" BO_ 374 14;
BA_ "CANFD_BRS" BO_ 374 1;
BA_ "GenMsgCycleTime" BO_ 374 10;
BA_ "GenMsgCycleTimeFast" BO_ 374 0;
BA_ "GenMsgSendType" BO_ 374 0;
BA_ "VFrameFormat" BO_ 374 14;
BA_ "CANFD_BRS" BO_ 374 1;
BA_ "GenMsgCycleTime" BO_ 374 10;
BA_ "GenMsgCycleTimeFast" BO_ 374 0;
BA_ "GenMsgSendType" BO_ 374 0;
BA_ "VFrameFormat" BO_ 374 14;
BA_ "CANFD_BRS" BO_ 374 1;
BA_ "GenMsgCycleTime" BO_ 374 10;
BA_ "GenMsgCycleTimeFast" BO_ 374 0;
BA_ "GenMsgSendType" BO_ 374 0;
BA_ "VFrameFormat" BO_ 374 14;
BA_ "CANFD_BRS" BO_ 374 1;
BA_ "GenMsgCycleTime" BO_ 374 10;
BA_ "GenMsgCycleTimeFast" BO_ 374 0;
BA_ "GenMsgSendType" BO_ 374 0;
BA_ "VFrameFormat" BO_ 374 14;
BA_ "CANFD_BRS" BO_ 374 1;
BA_ "GenMsgCycleTime" BO_ 374 10;
BA_ "GenMsgCycleTimeFast" BO_ 374 0;
BA_ "GenMsgSendType" BO_ 374 0;
BA_ "VFrameFormat" BO_ 374 14;
BA_ "CANFD_BRS" BO_ 374 1;
BA_ "GenMsgCycleTime" BO_ 374 10;
BA_ "GenMsgCycleTimeFast" BO_ 374 0;
BA_ "GenMsgSendType" BO_ 374 0;
BA_ "VFrameFormat" BO_ 374 14;
BA_ "CANFD_BRS" BO_ 374 1;
BA_ "GenMsgCycleTime" BO_ 374 10;
BA_ "GenMsgCycleTimeFast" BO_ 374 0;
BA_ "GenMsgSendType" BO_ 374 0;
BA_ "VFrameFormat" BO_ 374 14;
BA_ "CANFD_BRS" BO_ 374 1;
BA_ "GenMsgCycleTime" BO_ 374 10;
BA_ "GenMsgCycleTimeFast" BO_ 374 0;
BA_ "GenMsgSendType" BO_ 374 0;
BA_ "VFrameFormat" BO_ 374 14;
BA_ "CANFD_BRS" BO_ 374 1;
BA_ "GenMsgCycleTime" BO_ 374 10;
BA_ "GenMsgCycleTimeFast" BO_ 374 0;
BA_ "GenMsgSendType" BO_ 374 0;
BA_ "VFrameFormat" BO_ 374 14;
BA_ "CANFD_BRS" BO_ 374 1;
BA_ "GenMsgCycleTime" BO_ 374 10;
BA_ "GenMsgCycleTimeFast" BO_ 374 0;
BA_ "GenMsgSendType" BO_ 374 0;
BA_ "VFrameFormat" BO_ 374 14;
BA_ "CANFD_BRS" BO_ 374 1;
BA_ "GenMsgCycleTime" BO_ 374 10;
BA_ "GenMsgCycleTimeFast" BO_ 374 0;
BA_ "GenMsgSendType" BO_ 374 0;
BA_ "VFrameFormat" BO_ 374 14;
BA_ "CANFD_BRS" BO_ 374 1;
BA_ "GenMsgCycleTime" BO_ 374 10;
BA_ "GenMsgCycleTimeFast" BO_ 374 0;
BA_ "GenMsgSendType" BO_ 374 0;
BA_ "VFrameFormat" BO_ 374 14;
BA_ "CANFD_BRS" BO_ 374 1;
BA_ "GenMsgCycleTime" BO_ 374 10;
BA_ "GenMsgCycleTimeFast" BO_ 374 0;
BA_ "GenMsgSendType" BO_ 374 0;
BA_ "VFrameFormat" BO_ 374 14;
BA_ "CANFD_BRS" BO_ 374 1;
BA_ "GenMsgCycleTime" BO_ 374 10;
BA_ "GenMsgCycleTimeFast" BO_ 374 0;
BA_ "GenMsgSendType" BO_ 374 0;
BA_ "VFrameFormat" BO_ 374 14;
BA_ "CANFD_BRS" BO_ 374 1;
BA_ "GenMsgCycleTime" BO_ 437 10;
BA_ "GenMsgCycleTimeFast" BO_ 437 0;
BA_ "GenMsgSendType" BO_ 437 0;
BA_ "VFrameFormat" BO_ 437 14;
BA_ "CANFD_BRS" BO_ 437 1;
BA_ "GenMsgCycleTime" BO_ 437 10;
BA_ "GenMsgCycleTimeFast" BO_ 437 0;
BA_ "GenMsgSendType" BO_ 437 0;
BA_ "VFrameFormat" BO_ 437 14;
BA_ "CANFD_BRS" BO_ 437 1;
BA_ "GenMsgCycleTime" BO_ 437 10;
BA_ "GenMsgCycleTimeFast" BO_ 437 0;
BA_ "GenMsgSendType" BO_ 437 0;
BA_ "VFrameFormat" BO_ 437 14;
BA_ "CANFD_BRS" BO_ 437 1;
BA_ "GenMsgCycleTime" BO_ 437 10;
BA_ "GenMsgCycleTimeFast" BO_ 437 0;
BA_ "GenMsgSendType" BO_ 437 0;
BA_ "VFrameFormat" BO_ 437 14;
BA_ "CANFD_BRS" BO_ 437 1;
BA_ "GenMsgCycleTime" BO_ 437 10;
BA_ "GenMsgCycleTimeFast" BO_ 437 0;
BA_ "GenMsgSendType" BO_ 437 0;
BA_ "VFrameFormat" BO_ 437 14;
BA_ "CANFD_BRS" BO_ 437 1;
BA_ "GenMsgCycleTime" BO_ 437 10;
BA_ "GenMsgCycleTimeFast" BO_ 437 0;
BA_ "GenMsgSendType" BO_ 437 0;
BA_ "VFrameFormat" BO_ 437 14;
BA_ "CANFD_BRS" BO_ 437 1;
BA_ "GenMsgCycleTime" BO_ 437 10;
BA_ "GenMsgCycleTimeFast" BO_ 437 0;
BA_ "GenMsgSendType" BO_ 437 0;
BA_ "VFrameFormat" BO_ 437 14;
BA_ "CANFD_BRS" BO_ 437 1;
BA_ "GenMsgCycleTime" BO_ 437 10;
BA_ "GenMsgCycleTimeFast" BO_ 437 0;
BA_ "GenMsgSendType" BO_ 437 0;
BA_ "VFrameFormat" BO_ 437 14;
BA_ "CANFD_BRS" BO_ 437 1;
BA_ "GenMsgCycleTime" BO_ 437 10;
BA_ "GenMsgCycleTimeFast" BO_ 437 0;
BA_ "GenMsgSendType" BO_ 437 0;
BA_ "VFrameFormat" BO_ 437 14;
BA_ "CANFD_BRS" BO_ 437 1;
BA_ "GenMsgCycleTime" BO_ 437 10;
BA_ "GenMsgCycleTimeFast" BO_ 437 0;
BA_ "GenMsgSendType" BO_ 437 0;
BA_ "VFrameFormat" BO_ 437 14;
BA_ "CANFD_BRS" BO_ 437 1;
BA_ "GenMsgCycleTime" BO_ 437 10;
BA_ "GenMsgCycleTimeFast" BO_ 437 0;
BA_ "GenMsgSendType" BO_ 437 0;
BA_ "VFrameFormat" BO_ 437 14;
BA_ "CANFD_BRS" BO_ 437 1;
BA_ "GenMsgCycleTime" BO_ 437 10;
BA_ "GenMsgCycleTimeFast" BO_ 437 0;
BA_ "GenMsgSendType" BO_ 437 0;
BA_ "VFrameFormat" BO_ 437 14;
BA_ "CANFD_BRS" BO_ 437 1;
BA_ "GenMsgCycleTime" BO_ 437 10;
BA_ "GenMsgCycleTimeFast" BO_ 437 0;
BA_ "GenMsgSendType" BO_ 437 0;
BA_ "VFrameFormat" BO_ 437 14;
BA_ "CANFD_BRS" BO_ 437 1;
BA_ "GenMsgCycleTime" BO_ 437 10;
BA_ "GenMsgCycleTimeFast" BO_ 437 0;
BA_ "GenMsgSendType" BO_ 437 0;
BA_ "VFrameFormat" BO_ 437 14;
BA_ "CANFD_BRS" BO_ 437 1;
BA_ "GenMsgCycleTime" BO_ 437 10;
BA_ "GenMsgCycleTimeFast" BO_ 437 0;
BA_ "GenMsgSendType" BO_ 437 0;
BA_ "VFrameFormat" BO_ 437 14;
BA_ "CANFD_BRS" BO_ 437 1;
BA_ "GenMsgCycleTime" BO_ 437 10;
BA_ "GenMsgCycleTimeFast" BO_ 437 0;
BA_ "GenMsgSendType" BO_ 437 0;
BA_ "VFrameFormat" BO_ 437 14;
BA_ "CANFD_BRS" BO_ 437 1;
BA_ "GenMsgCycleTime" BO_ 437 10;
BA_ "GenMsgCycleTimeFast" BO_ 437 0;
BA_ "GenMsgSendType" BO_ 437 0;
BA_ "VFrameFormat" BO_ 437 14;
BA_ "CANFD_BRS" BO_ 437 1;
BA_ "GenMsgCycleTime" BO_ 437 10;
BA_ "GenMsgCycleTimeFast" BO_ 437 0;
BA_ "GenMsgSendType" BO_ 437 0;
BA_ "VFrameFormat" BO_ 437 14;
BA_ "CANFD_BRS" BO_ 437 1;
BA_ "GenMsgCycleTime" BO_ 437 10;
BA_ "GenMsgCycleTimeFast" BO_ 437 0;
BA_ "GenMsgSendType" BO_ 437 0;
BA_ "VFrameFormat" BO_ 437 14;
BA_ "CANFD_BRS" BO_ 437 1;
BA_ "GenMsgCycleTime" BO_ 437 10;
BA_ "GenMsgCycleTimeFast" BO_ 437 0;
BA_ "GenMsgSendType" BO_ 437 0;
BA_ "VFrameFormat" BO_ 437 14;
BA_ "CANFD_BRS" BO_ 437 1;
BA_ "GenMsgCycleTime" BO_ 437 10;
BA_ "GenMsgCycleTimeFast" BO_ 437 0;
BA_ "GenMsgSendType" BO_ 437 0;
BA_ "VFrameFormat" BO_ 437 14;
BA_ "CANFD_BRS" BO_ 437 1;
BA_ "GenMsgCycleTime" BO_ 437 10;
BA_ "GenMsgCycleTimeFast" BO_ 437 0;
BA_ "GenMsgSendType" BO_ 437 0;
BA_ "VFrameFormat" BO_ 437 14;
BA_ "CANFD_BRS" BO_ 437 1;
BA_ "GenMsgCycleTime" BO_ 437 10;
BA_ "GenMsgCycleTimeFast" BO_ 437 0;
BA_ "GenMsgSendType" BO_ 437 0;
BA_ "VFrameFormat" BO_ 437 14;
BA_ "CANFD_BRS" BO_ 437 1;
BA_ "GenMsgCycleTime" BO_ 437 10;
BA_ "GenMsgCycleTimeFast" BO_ 437 0;
BA_ "GenMsgSendType" BO_ 437 0;
BA_ "VFrameFormat" BO_ 437 14;
BA_ "CANFD_BRS" BO_ 437 1;
BA_ "GenMsgCycleTime" BO_ 437 10;
BA_ "GenMsgCycleTimeFast" BO_ 437 0;
BA_ "GenMsgSendType" BO_ 437 0;
BA_ "VFrameFormat" BO_ 437 14;
BA_ "CANFD_BRS" BO_ 437 1;
BA_ "GenMsgCycleTime" BO_ 918 60;
BA_ "GenMsgCycleTimeFast" BO_ 918 0;
BA_ "GenMsgSendType" BO_ 918 0;
BA_ "VFrameFormat" BO_ 918 14;
BA_ "CANFD_BRS" BO_ 918 1;
BA_ "GenMsgCycleTime" BO_ 918 60;
BA_ "GenMsgCycleTimeFast" BO_ 918 0;
BA_ "GenMsgSendType" BO_ 918 0;
BA_ "VFrameFormat" BO_ 918 14;
BA_ "CANFD_BRS" BO_ 918 1;
BA_ "GenMsgCycleTime" BO_ 918 60;
BA_ "GenMsgCycleTimeFast" BO_ 918 0;
BA_ "GenMsgSendType" BO_ 918 0;
BA_ "VFrameFormat" BO_ 918 14;
BA_ "CANFD_BRS" BO_ 918 1;
BA_ "GenMsgCycleTime" BO_ 918 60;
BA_ "GenMsgCycleTimeFast" BO_ 918 0;
BA_ "GenMsgSendType" BO_ 918 0;
BA_ "VFrameFormat" BO_ 918 14;
BA_ "CANFD_BRS" BO_ 918 1;
BA_ "GenMsgCycleTime" BO_ 918 60;
BA_ "GenMsgCycleTimeFast" BO_ 918 0;
BA_ "GenMsgSendType" BO_ 918 0;
BA_ "VFrameFormat" BO_ 918 14;
BA_ "CANFD_BRS" BO_ 918 1;
BA_ "GenMsgCycleTime" BO_ 918 60;
BA_ "GenMsgCycleTimeFast" BO_ 918 0;
BA_ "GenMsgSendType" BO_ 918 0;
BA_ "VFrameFormat" BO_ 918 14;
BA_ "CANFD_BRS" BO_ 918 1;
BA_ "GenMsgCycleTime" BO_ 918 60;
BA_ "GenMsgCycleTimeFast" BO_ 918 0;
BA_ "GenMsgSendType" BO_ 918 0;
BA_ "VFrameFormat" BO_ 918 14;
BA_ "CANFD_BRS" BO_ 918 1;
BA_ "GenMsgCycleTime" BO_ 918 60;
BA_ "GenMsgCycleTimeFast" BO_ 918 0;
BA_ "GenMsgSendType" BO_ 918 0;
BA_ "VFrameFormat" BO_ 918 14;
BA_ "CANFD_BRS" BO_ 918 1;
BA_ "GenMsgCycleTime" BO_ 918 60;
BA_ "GenMsgCycleTimeFast" BO_ 918 0;
BA_ "GenMsgSendType" BO_ 918 0;
BA_ "VFrameFormat" BO_ 918 14;
BA_ "CANFD_BRS" BO_ 918 1;
BA_ "GenMsgCycleTime" BO_ 918 60;
BA_ "GenMsgCycleTimeFast" BO_ 918 0;
BA_ "GenMsgSendType" BO_ 918 0;
BA_ "VFrameFormat" BO_ 918 14;
BA_ "CANFD_BRS" BO_ 918 1;
BA_ "GenMsgCycleTime" BO_ 918 60;
BA_ "GenMsgCycleTimeFast" BO_ 918 0;
BA_ "GenMsgSendType" BO_ 918 0;
BA_ "VFrameFormat" BO_ 918 14;
BA_ "CANFD_BRS" BO_ 918 1;
BA_ "GenMsgCycleTime" BO_ 918 60;
BA_ "GenMsgCycleTimeFast" BO_ 918 0;
BA_ "GenMsgSendType" BO_ 918 0;
BA_ "VFrameFormat" BO_ 918 14;
BA_ "CANFD_BRS" BO_ 918 1;
BA_ "GenMsgCycleTime" BO_ 918 60;
BA_ "GenMsgCycleTimeFast" BO_ 918 0;
BA_ "GenMsgSendType" BO_ 918 0;
BA_ "VFrameFormat" BO_ 918 14;
BA_ "CANFD_BRS" BO_ 918 1;
BA_ "GenMsgCycleTime" BO_ 918 60;
BA_ "GenMsgCycleTimeFast" BO_ 918 0;
BA_ "GenMsgSendType" BO_ 918 0;
BA_ "VFrameFormat" BO_ 918 14;
BA_ "CANFD_BRS" BO_ 918 1;
BA_ "GenMsgCycleTime" BO_ 918 60;
BA_ "GenMsgCycleTimeFast" BO_ 918 0;
BA_ "GenMsgSendType" BO_ 918 0;
BA_ "VFrameFormat" BO_ 918 14;
BA_ "CANFD_BRS" BO_ 918 1;
BA_ "GenMsgCycleTime" BO_ 918 60;
BA_ "GenMsgCycleTimeFast" BO_ 918 0;
BA_ "GenMsgSendType" BO_ 918 0;
BA_ "VFrameFormat" BO_ 918 14;
BA_ "CANFD_BRS" BO_ 918 1;
BA_ "GenMsgCycleTime" BO_ 918 60;
BA_ "GenMsgCycleTimeFast" BO_ 918 0;
BA_ "GenMsgSendType" BO_ 918 0;
BA_ "VFrameFormat" BO_ 918 14;
BA_ "CANFD_BRS" BO_ 918 1;
BA_ "GenMsgCycleTime" BO_ 918 60;
BA_ "GenMsgCycleTimeFast" BO_ 918 0;
BA_ "GenMsgSendType" BO_ 918 0;
BA_ "VFrameFormat" BO_ 918 14;
BA_ "CANFD_BRS" BO_ 918 1;
BA_ "GenMsgCycleTime" BO_ 918 60;
BA_ "GenMsgCycleTimeFast" BO_ 918 0;
BA_ "GenMsgSendType" BO_ 918 0;
BA_ "VFrameFormat" BO_ 918 14;
BA_ "CANFD_BRS" BO_ 918 1;
BA_ "GenMsgCycleTime" BO_ 918 60;
BA_ "GenMsgCycleTimeFast" BO_ 918 0;
BA_ "GenMsgSendType" BO_ 918 0;
BA_ "VFrameFormat" BO_ 918 14;
BA_ "CANFD_BRS" BO_ 918 1;
BA_ "GenMsgCycleTime" BO_ 918 60;
BA_ "GenMsgCycleTimeFast" BO_ 918 0;
BA_ "GenMsgSendType" BO_ 918 0;
BA_ "VFrameFormat" BO_ 918 14;
BA_ "CANFD_BRS" BO_ 918 1;
BA_ "GenMsgCycleTime" BO_ 918 60;
BA_ "GenMsgCycleTimeFast" BO_ 918 0;
BA_ "GenMsgSendType" BO_ 918 0;
BA_ "VFrameFormat" BO_ 918 14;
BA_ "CANFD_BRS" BO_ 918 1;
BA_ "GenMsgCycleTime" BO_ 918 60;
BA_ "GenMsgCycleTimeFast" BO_ 918 0;
BA_ "GenMsgSendType" BO_ 918 0;
BA_ "VFrameFormat" BO_ 918 14;
BA_ "CANFD_BRS" BO_ 918 1;
BA_ "GenMsgCycleTime" BO_ 918 60;
BA_ "GenMsgCycleTimeFast" BO_ 918 0;
BA_ "GenMsgSendType" BO_ 918 0;
BA_ "VFrameFormat" BO_ 918 14;
BA_ "CANFD_BRS" BO_ 918 1;
BA_ "GenMsgCycleTime" BO_ 918 60;
BA_ "GenMsgCycleTimeFast" BO_ 918 0;
BA_ "GenMsgSendType" BO_ 918 0;
BA_ "VFrameFormat" BO_ 918 14;
BA_ "CANFD_BRS" BO_ 918 1;
BA_ "GenMsgCycleTime" BO_ 918 60;
BA_ "GenMsgCycleTimeFast" BO_ 918 0;
BA_ "GenMsgSendType" BO_ 918 0;
BA_ "VFrameFormat" BO_ 918 14;
BA_ "CANFD_BRS" BO_ 918 1;
BA_ "GenMsgCycleTime" BO_ 918 60;
BA_ "GenMsgCycleTimeFast" BO_ 918 0;
BA_ "GenMsgSendType" BO_ 918 0;
BA_ "VFrameFormat" BO_ 918 14;
BA_ "CANFD_BRS" BO_ 918 1;
BA_ "GenMsgCycleTime" BO_ 918 60;
BA_ "GenMsgCycleTimeFast" BO_ 918 0;
BA_ "GenMsgSendType" BO_ 918 0;
BA_ "VFrameFormat" BO_ 918 14;
BA_ "CANFD_BRS" BO_ 918 1;
BA_ "GenMsgCycleTime" BO_ 918 60;
BA_ "GenMsgCycleTimeFast" BO_ 918 0;
BA_ "GenMsgSendType" BO_ 918 0;
BA_ "VFrameFormat" BO_ 918 14;
BA_ "CANFD_BRS" BO_ 918 1;
BA_ "GenMsgCycleTime" BO_ 918 60;
BA_ "GenMsgCycleTimeFast" BO_ 918 0;
BA_ "GenMsgSendType" BO_ 918 0;
BA_ "VFrameFormat" BO_ 918 14;
BA_ "CANFD_BRS" BO_ 918 1;
BA_ "GenMsgCycleTime" BO_ 918 60;
BA_ "GenMsgCycleTimeFast" BO_ 918 0;
BA_ "GenMsgSendType" BO_ 918 0;
BA_ "VFrameFormat" BO_ 918 14;
BA_ "CANFD_BRS" BO_ 918 1;
BA_ "GenMsgCycleTime" BO_ 918 60;
BA_ "GenMsgCycleTimeFast" BO_ 918 0;
BA_ "GenMsgSendType" BO_ 918 0;
BA_ "VFrameFormat" BO_ 918 14;
BA_ "CANFD_BRS" BO_ 918 1;
BA_ "GenMsgCycleTime" BO_ 918 60;
BA_ "GenMsgCycleTimeFast" BO_ 918 0;
BA_ "GenMsgSendType" BO_ 918 0;
BA_ "VFrameFormat" BO_ 918 14;
BA_ "CANFD_BRS" BO_ 918 1;
BA_ "GenMsgCycleTime" BO_ 918 60;
BA_ "GenMsgCycleTimeFast" BO_ 918 0;
BA_ "GenMsgSendType" BO_ 918 0;
BA_ "VFrameFormat" BO_ 918 14;
BA_ "CANFD_BRS" BO_ 918 1;
BA_ "GenMsgCycleTime" BO_ 918 60;
BA_ "GenMsgCycleTimeFast" BO_ 918 0;
BA_ "GenMsgSendType" BO_ 918 0;
BA_ "VFrameFormat" BO_ 918 14;
BA_ "CANFD_BRS" BO_ 918 1;
BA_ "GenMsgCycleTime" BO_ 918 60;
BA_ "GenMsgCycleTimeFast" BO_ 918 0;
BA_ "GenMsgSendType" BO_ 918 0;
BA_ "VFrameFormat" BO_ 918 14;
BA_ "CANFD_BRS" BO_ 918 1;
BA_ "GenMsgCycleTime" BO_ 918 60;
BA_ "GenMsgCycleTimeFast" BO_ 918 0;
BA_ "GenMsgSendType" BO_ 918 0;
BA_ "VFrameFormat" BO_ 918 14;
BA_ "CANFD_BRS" BO_ 918 1;
BA_ "GenMsgCycleTime" BO_ 1078 500;
BA_ "GenMsgCycleTimeFast" BO_ 1078 40;
BA_ "GenMsgSendType" BO_ 1078 3;
BA_ "VFrameFormat" BO_ 1078 14;
BA_ "CANFD_BRS" BO_ 1078 1;
BA_ "GenMsgCycleTime" BO_ 1078 500;
BA_ "GenMsgCycleTimeFast" BO_ 1078 40;
BA_ "GenMsgSendType" BO_ 1078 3;
BA_ "VFrameFormat" BO_ 1078 14;
BA_ "CANFD_BRS" BO_ 1078 1;
BA_ "GenMsgCycleTime" BO_ 1078 500;
BA_ "GenMsgCycleTimeFast" BO_ 1078 40;
BA_ "GenMsgSendType" BO_ 1078 3;
BA_ "VFrameFormat" BO_ 1078 14;
BA_ "CANFD_BRS" BO_ 1078 1;
BA_ "GenMsgCycleTime" BO_ 1078 500;
BA_ "GenMsgCycleTimeFast" BO_ 1078 40;
BA_ "GenMsgSendType" BO_ 1078 3;
BA_ "VFrameFormat" BO_ 1078 14;
BA_ "CANFD_BRS" BO_ 1078 1;
BA_ "GenMsgCycleTime" BO_ 1078 500;
BA_ "GenMsgCycleTimeFast" BO_ 1078 40;
BA_ "GenMsgSendType" BO_ 1078 3;
BA_ "VFrameFormat" BO_ 1078 14;
BA_ "CANFD_BRS" BO_ 1078 1;
BA_ "GenMsgCycleTime" BO_ 1078 500;
BA_ "GenMsgCycleTimeFast" BO_ 1078 40;
BA_ "GenMsgSendType" BO_ 1078 3;
BA_ "VFrameFormat" BO_ 1078 14;
BA_ "CANFD_BRS" BO_ 1078 1;
BA_ "GenMsgCycleTime" BO_ 1078 500;
BA_ "GenMsgCycleTimeFast" BO_ 1078 40;
BA_ "GenMsgSendType" BO_ 1078 3;
BA_ "VFrameFormat" BO_ 1078 14;
BA_ "CANFD_BRS" BO_ 1078 1;
BA_ "GenMsgCycleTime" BO_ 1078 500;
BA_ "GenMsgCycleTimeFast" BO_ 1078 40;
BA_ "GenMsgSendType" BO_ 1078 3;
BA_ "VFrameFormat" BO_ 1078 14;
BA_ "CANFD_BRS" BO_ 1078 1;
BA_ "GenMsgCycleTime" BO_ 1078 500;
BA_ "GenMsgCycleTimeFast" BO_ 1078 40;
BA_ "GenMsgSendType" BO_ 1078 3;
BA_ "VFrameFormat" BO_ 1078 14;
BA_ "CANFD_BRS" BO_ 1078 1;
BA_ "GenMsgCycleTime" BO_ 1078 500;
BA_ "GenMsgCycleTimeFast" BO_ 1078 40;
BA_ "GenMsgSendType" BO_ 1078 3;
BA_ "VFrameFormat" BO_ 1078 14;
BA_ "CANFD_BRS" BO_ 1078 1;
BA_ "GenMsgCycleTime" BO_ 348 30000;
BA_ "GenMsgCycleTimeFast" BO_ 348 40;
BA_ "GenMsgSendType" BO_ 348 3;
BA_ "VFrameFormat" BO_ 348 14;
BA_ "CANFD_BRS" BO_ 348 1;
BA_ "GenMsgCycleTime" BO_ 348 30000;
BA_ "GenMsgCycleTimeFast" BO_ 348 40;
BA_ "GenMsgSendType" BO_ 348 3;
BA_ "VFrameFormat" BO_ 348 14;
BA_ "CANFD_BRS" BO_ 348 1;
BA_ "GenMsgCycleTime" BO_ 348 30000;
BA_ "GenMsgCycleTimeFast" BO_ 348 40;
BA_ "GenMsgSendType" BO_ 348 3;
BA_ "VFrameFormat" BO_ 348 14;
BA_ "CANFD_BRS" BO_ 348 1;
BA_ "GenMsgCycleTime" BO_ 170 0;
BA_ "GenMsgCycleTimeFast" BO_ 170 0;
BA_ "GenMsgSendType" BO_ 170 1;
BA_ "VFrameFormat" BO_ 170 14;
BA_ "CANFD_BRS" BO_ 170 1;
BA_ "GenMsgCycleTime" BO_ 343 500;
BA_ "GenMsgCycleTimeFast" BO_ 343 40;
BA_ "GenMsgSendType" BO_ 343 3;
BA_ "VFrameFormat" BO_ 343 14;
BA_ "CANFD_BRS" BO_ 343 1;
BA_ "GenMsgCycleTime" BO_ 343 500;
BA_ "GenMsgCycleTimeFast" BO_ 343 40;
BA_ "GenMsgSendType" BO_ 343 3;
BA_ "VFrameFormat" BO_ 343 14;
BA_ "CANFD_BRS" BO_ 343 1;
BA_ "GenMsgCycleTime" BO_ 343 500;
BA_ "GenMsgCycleTimeFast" BO_ 343 40;
BA_ "GenMsgSendType" BO_ 343 3;
BA_ "VFrameFormat" BO_ 343 14;
BA_ "CANFD_BRS" BO_ 343 1;
BA_ "GenMsgCycleTime" BO_ 343 500;
BA_ "GenMsgCycleTimeFast" BO_ 343 40;
BA_ "GenMsgSendType" BO_ 343 3;
BA_ "VFrameFormat" BO_ 343 14;
BA_ "CANFD_BRS" BO_ 343 1;
BA_ "GenMsgCycleTime" BO_ 1024 500;
BA_ "GenMsgCycleTimeFast" BO_ 1024 0;
BA_ "GenMsgSendType" BO_ 1024 0;
BA_ "VFrameFormat" BO_ 1024 14;
BA_ "CANFD_BRS" BO_ 1024 1;
BA_ "GenMsgCycleTime" BO_ 1024 500;
BA_ "GenMsgCycleTimeFast" BO_ 1024 0;
BA_ "GenMsgSendType" BO_ 1024 0;
BA_ "VFrameFormat" BO_ 1024 14;
BA_ "CANFD_BRS" BO_ 1024 1;
BA_ "GenMsgCycleTime" BO_ 1024 500;
BA_ "GenMsgCycleTimeFast" BO_ 1024 0;
BA_ "GenMsgSendType" BO_ 1024 0;
BA_ "VFrameFormat" BO_ 1024 14;
BA_ "CANFD_BRS" BO_ 1024 1;
BA_ "GenMsgCycleTime" BO_ 1024 500;
BA_ "GenMsgCycleTimeFast" BO_ 1024 0;
BA_ "GenMsgSendType" BO_ 1024 0;
BA_ "VFrameFormat" BO_ 1024 14;
BA_ "CANFD_BRS" BO_ 1024 1;
BA_ "GenMsgCycleTime" BO_ 1024 500;
BA_ "GenMsgCycleTimeFast" BO_ 1024 0;
BA_ "GenMsgSendType" BO_ 1024 0;
BA_ "VFrameFormat" BO_ 1024 14;
BA_ "CANFD_BRS" BO_ 1024 1;
BA_ "GenMsgCycleTime" BO_ 1024 500;
BA_ "GenMsgCycleTimeFast" BO_ 1024 0;
BA_ "GenMsgSendType" BO_ 1024 0;
BA_ "VFrameFormat" BO_ 1024 14;
BA_ "CANFD_BRS" BO_ 1024 1;
BA_ "GenMsgCycleTime" BO_ 1024 500;
BA_ "GenMsgCycleTimeFast" BO_ 1024 0;
BA_ "GenMsgSendType" BO_ 1024 0;
BA_ "VFrameFormat" BO_ 1024 14;
BA_ "CANFD_BRS" BO_ 1024 1;
BA_ "GenMsgCycleTime" BO_ 1024 500;
BA_ "GenMsgCycleTimeFast" BO_ 1024 0;
BA_ "GenMsgSendType" BO_ 1024 0;
BA_ "VFrameFormat" BO_ 1024 14;
BA_ "CANFD_BRS" BO_ 1024 1;
BA_ "EventCommandSignal" SG_ 667 ADC_7_CRC 0;
BA_ "GatewayedSignals" SG_ 667 ADC_7_CRC 0;
BA_ "GenSigInactiveValue" SG_ 667 ADC_7_CRC 0;
BA_ "GenSigInvalidValue" SG_ 667 ADC_7_CRC 0;
BA_ "GenSigSendType" SG_ 667 ADC_7_CRC 1;
BA_ "GenSigStartValue" SG_ 667 ADC_7_CRC 0;
BA_ "GenSigTimeoutValue" SG_ 667 ADC_7_CRC 0;
BA_ "Remark" SG_ 667 ADC_7_CRC "";
BA_ "EventCommandSignal" SG_ 667 ADC_7_Counter 0;
BA_ "GatewayedSignals" SG_ 667 ADC_7_Counter 0;
BA_ "GenSigInactiveValue" SG_ 667 ADC_7_Counter 0;
BA_ "GenSigInvalidValue" SG_ 667 ADC_7_Counter 0;
BA_ "GenSigSendType" SG_ 667 ADC_7_Counter 1;
BA_ "GenSigStartValue" SG_ 667 ADC_7_Counter 0;
BA_ "GenSigTimeoutValue" SG_ 667 ADC_7_Counter 0;
BA_ "Remark" SG_ 667 ADC_7_Counter "";
BA_ "EventCommandSignal" SG_ 667 ADC_LatVMC_A0 0;
BA_ "GatewayedSignals" SG_ 667 ADC_LatVMC_A0 0;
BA_ "GenSigInactiveValue" SG_ 667 ADC_LatVMC_A0 0;
BA_ "GenSigInvalidValue" SG_ 667 ADC_LatVMC_A0 2047;
BA_ "GenSigSendType" SG_ 667 ADC_LatVMC_A0 1;
BA_ "GenSigStartValue" SG_ 667 ADC_LatVMC_A0 1023;
BA_ "GenSigTimeoutValue" SG_ 667 ADC_LatVMC_A0 0;
BA_ "Remark" SG_ 667 ADC_LatVMC_A0 "";
BA_ "EventCommandSignal" SG_ 667 ADC_LatVMC_A1 0;
BA_ "GatewayedSignals" SG_ 667 ADC_LatVMC_A1 0;
BA_ "GenSigInactiveValue" SG_ 667 ADC_LatVMC_A1 0;
BA_ "GenSigInvalidValue" SG_ 667 ADC_LatVMC_A1 2047;
BA_ "GenSigSendType" SG_ 667 ADC_LatVMC_A1 1;
BA_ "GenSigStartValue" SG_ 667 ADC_LatVMC_A1 1023;
BA_ "GenSigTimeoutValue" SG_ 667 ADC_LatVMC_A1 0;
BA_ "Remark" SG_ 667 ADC_LatVMC_A1 "";
BA_ "EventCommandSignal" SG_ 667 ADC_LatVMC_A2 0;
BA_ "GatewayedSignals" SG_ 667 ADC_LatVMC_A2 0;
BA_ "GenSigInactiveValue" SG_ 667 ADC_LatVMC_A2 0;
BA_ "GenSigInvalidValue" SG_ 667 ADC_LatVMC_A2 2047;
BA_ "GenSigSendType" SG_ 667 ADC_LatVMC_A2 1;
BA_ "GenSigStartValue" SG_ 667 ADC_LatVMC_A2 1023;
BA_ "GenSigTimeoutValue" SG_ 667 ADC_LatVMC_A2 0;
BA_ "Remark" SG_ 667 ADC_LatVMC_A2 "";
BA_ "EventCommandSignal" SG_ 667 ADC_LatVMC_A3 0;
BA_ "GatewayedSignals" SG_ 667 ADC_LatVMC_A3 0;
BA_ "GenSigInactiveValue" SG_ 667 ADC_LatVMC_A3 0;
BA_ "GenSigInvalidValue" SG_ 667 ADC_LatVMC_A3 2047;
BA_ "GenSigSendType" SG_ 667 ADC_LatVMC_A3 1;
BA_ "GenSigStartValue" SG_ 667 ADC_LatVMC_A3 1023;
BA_ "GenSigTimeoutValue" SG_ 667 ADC_LatVMC_A3 0;
BA_ "Remark" SG_ 667 ADC_LatVMC_A3 "";
BA_ "EventCommandSignal" SG_ 667 ADC_LatVMC_conf 0;
BA_ "GatewayedSignals" SG_ 667 ADC_LatVMC_conf 0;
BA_ "GenSigInactiveValue" SG_ 667 ADC_LatVMC_conf 0;
BA_ "GenSigInvalidValue" SG_ 667 ADC_LatVMC_conf 0;
BA_ "GenSigSendType" SG_ 667 ADC_LatVMC_conf 1;
BA_ "GenSigStartValue" SG_ 667 ADC_LatVMC_conf 0;
BA_ "GenSigTimeoutValue" SG_ 667 ADC_LatVMC_conf 0;
BA_ "Remark" SG_ 667 ADC_LatVMC_conf "";
BA_ "EventCommandSignal" SG_ 667 ADC_LatVMC_Range 0;
BA_ "GatewayedSignals" SG_ 667 ADC_LatVMC_Range 0;
BA_ "GenSigInactiveValue" SG_ 667 ADC_LatVMC_Range 0;
BA_ "GenSigInvalidValue" SG_ 667 ADC_LatVMC_Range 0;
BA_ "GenSigSendType" SG_ 667 ADC_LatVMC_Range 1;
BA_ "GenSigStartValue" SG_ 667 ADC_LatVMC_Range 0;
BA_ "GenSigTimeoutValue" SG_ 667 ADC_LatVMC_Range 0;
BA_ "Remark" SG_ 667 ADC_LatVMC_Range "";
BA_ "EventCommandSignal" SG_ 667 ADC_LLnMrking_A0 0;
BA_ "GatewayedSignals" SG_ 667 ADC_LLnMrking_A0 0;
BA_ "GenSigInactiveValue" SG_ 667 ADC_LLnMrking_A0 0;
BA_ "GenSigInvalidValue" SG_ 667 ADC_LLnMrking_A0 2047;
BA_ "GenSigSendType" SG_ 667 ADC_LLnMrking_A0 1;
BA_ "GenSigStartValue" SG_ 667 ADC_LLnMrking_A0 1023;
BA_ "GenSigTimeoutValue" SG_ 667 ADC_LLnMrking_A0 0;
BA_ "Remark" SG_ 667 ADC_LLnMrking_A0 "";
BA_ "EventCommandSignal" SG_ 667 ADC_LLnMrking_A1 0;
BA_ "GatewayedSignals" SG_ 667 ADC_LLnMrking_A1 0;
BA_ "GenSigInactiveValue" SG_ 667 ADC_LLnMrking_A1 0;
BA_ "GenSigInvalidValue" SG_ 667 ADC_LLnMrking_A1 2047;
BA_ "GenSigSendType" SG_ 667 ADC_LLnMrking_A1 1;
BA_ "GenSigStartValue" SG_ 667 ADC_LLnMrking_A1 1023;
BA_ "GenSigTimeoutValue" SG_ 667 ADC_LLnMrking_A1 0;
BA_ "Remark" SG_ 667 ADC_LLnMrking_A1 "";
BA_ "EventCommandSignal" SG_ 667 ADC_LLnMrking_A2 0;
BA_ "GatewayedSignals" SG_ 667 ADC_LLnMrking_A2 0;
BA_ "GenSigInactiveValue" SG_ 667 ADC_LLnMrking_A2 0;
BA_ "GenSigInvalidValue" SG_ 667 ADC_LLnMrking_A2 2047;
BA_ "GenSigSendType" SG_ 667 ADC_LLnMrking_A2 1;
BA_ "GenSigStartValue" SG_ 667 ADC_LLnMrking_A2 1023;
BA_ "GenSigTimeoutValue" SG_ 667 ADC_LLnMrking_A2 0;
BA_ "Remark" SG_ 667 ADC_LLnMrking_A2 "";
BA_ "EventCommandSignal" SG_ 667 ADC_LLnMrking_conf 0;
BA_ "GatewayedSignals" SG_ 667 ADC_LLnMrking_conf 0;
BA_ "GenSigInactiveValue" SG_ 667 ADC_LLnMrking_conf 0;
BA_ "GenSigInvalidValue" SG_ 667 ADC_LLnMrking_conf 100;
BA_ "GenSigSendType" SG_ 667 ADC_LLnMrking_conf 1;
BA_ "GenSigStartValue" SG_ 667 ADC_LLnMrking_conf 0;
BA_ "GenSigTimeoutValue" SG_ 667 ADC_LLnMrking_conf 0;
BA_ "Remark" SG_ 667 ADC_LLnMrking_conf "";
BA_ "EventCommandSignal" SG_ 667 ADC_LlnMrkingDispSt 0;
BA_ "GatewayedSignals" SG_ 667 ADC_LlnMrkingDispSt 0;
BA_ "GenSigInactiveValue" SG_ 667 ADC_LlnMrkingDispSt 0;
BA_ "GenSigInvalidValue" SG_ 667 ADC_LlnMrkingDispSt 0;
BA_ "GenSigSendType" SG_ 667 ADC_LlnMrkingDispSt 1;
BA_ "GenSigStartValue" SG_ 667 ADC_LlnMrkingDispSt 0;
BA_ "GenSigTimeoutValue" SG_ 667 ADC_LlnMrkingDispSt 0;
BA_ "Remark" SG_ 667 ADC_LlnMrkingDispSt "";
BA_ "EventCommandSignal" SG_ 667 ADC_LLnMrking_Range 0;
BA_ "GatewayedSignals" SG_ 667 ADC_LLnMrking_Range 0;
BA_ "GenSigInactiveValue" SG_ 667 ADC_LLnMrking_Range 0;
BA_ "GenSigInvalidValue" SG_ 667 ADC_LLnMrking_Range 0;
BA_ "GenSigSendType" SG_ 667 ADC_LLnMrking_Range 1;
BA_ "GenSigStartValue" SG_ 667 ADC_LLnMrking_Range 0;
BA_ "GenSigTimeoutValue" SG_ 667 ADC_LLnMrking_Range 0;
BA_ "Remark" SG_ 667 ADC_LLnMrking_Range "";
BA_ "EventCommandSignal" SG_ 667 ADC_LLnMrking_Type 0;
BA_ "GatewayedSignals" SG_ 667 ADC_LLnMrking_Type 0;
BA_ "GenSigInactiveValue" SG_ 667 ADC_LLnMrking_Type 0;
BA_ "GenSigInvalidValue" SG_ 667 ADC_LLnMrking_Type 0;
BA_ "GenSigSendType" SG_ 667 ADC_LLnMrking_Type 1;
BA_ "GenSigStartValue" SG_ 667 ADC_LLnMrking_Type 0;
BA_ "GenSigTimeoutValue" SG_ 667 ADC_LLnMrking_Type 0;
BA_ "Remark" SG_ 667 ADC_LLnMrking_Type "";
BA_ "EventCommandSignal" SG_ 667 ADC_RLnMrking_A0 0;
BA_ "GatewayedSignals" SG_ 667 ADC_RLnMrking_A0 0;
BA_ "GenSigInactiveValue" SG_ 667 ADC_RLnMrking_A0 0;
BA_ "GenSigInvalidValue" SG_ 667 ADC_RLnMrking_A0 2047;
BA_ "GenSigSendType" SG_ 667 ADC_RLnMrking_A0 1;
BA_ "GenSigStartValue" SG_ 667 ADC_RLnMrking_A0 1023;
BA_ "GenSigTimeoutValue" SG_ 667 ADC_RLnMrking_A0 0;
BA_ "Remark" SG_ 667 ADC_RLnMrking_A0 "";
BA_ "EventCommandSignal" SG_ 667 ADC_RLnMrking_A1 0;
BA_ "GatewayedSignals" SG_ 667 ADC_RLnMrking_A1 0;
BA_ "GenSigInactiveValue" SG_ 667 ADC_RLnMrking_A1 0;
BA_ "GenSigInvalidValue" SG_ 667 ADC_RLnMrking_A1 2047;
BA_ "GenSigSendType" SG_ 667 ADC_RLnMrking_A1 1;
BA_ "GenSigStartValue" SG_ 667 ADC_RLnMrking_A1 1023;
BA_ "GenSigTimeoutValue" SG_ 667 ADC_RLnMrking_A1 0;
BA_ "Remark" SG_ 667 ADC_RLnMrking_A1 "";
BA_ "EventCommandSignal" SG_ 667 ADC_RLnMrking_A2 0;
BA_ "GatewayedSignals" SG_ 667 ADC_RLnMrking_A2 0;
BA_ "GenSigInactiveValue" SG_ 667 ADC_RLnMrking_A2 0;
BA_ "GenSigInvalidValue" SG_ 667 ADC_RLnMrking_A2 2047;
BA_ "GenSigSendType" SG_ 667 ADC_RLnMrking_A2 1;
BA_ "GenSigStartValue" SG_ 667 ADC_RLnMrking_A2 1023;
BA_ "GenSigTimeoutValue" SG_ 667 ADC_RLnMrking_A2 0;
BA_ "Remark" SG_ 667 ADC_RLnMrking_A2 "";
BA_ "EventCommandSignal" SG_ 667 ADC_RlnMrkingDispSt 0;
BA_ "GatewayedSignals" SG_ 667 ADC_RlnMrkingDispSt 0;
BA_ "GenSigInactiveValue" SG_ 667 ADC_RlnMrkingDispSt 0;
BA_ "GenSigInvalidValue" SG_ 667 ADC_RlnMrkingDispSt 0;
BA_ "GenSigSendType" SG_ 667 ADC_RlnMrkingDispSt 1;
BA_ "GenSigStartValue" SG_ 667 ADC_RlnMrkingDispSt 0;
BA_ "GenSigTimeoutValue" SG_ 667 ADC_RlnMrkingDispSt 0;
BA_ "Remark" SG_ 667 ADC_RlnMrkingDispSt "";
BA_ "EventCommandSignal" SG_ 667 ADC_RLnMrking_conf 0;
BA_ "GatewayedSignals" SG_ 667 ADC_RLnMrking_conf 0;
BA_ "GenSigInactiveValue" SG_ 667 ADC_RLnMrking_conf 0;
BA_ "GenSigInvalidValue" SG_ 667 ADC_RLnMrking_conf 100;
BA_ "GenSigSendType" SG_ 667 ADC_RLnMrking_conf 1;
BA_ "GenSigStartValue" SG_ 667 ADC_RLnMrking_conf 0;
BA_ "GenSigTimeoutValue" SG_ 667 ADC_RLnMrking_conf 0;
BA_ "Remark" SG_ 667 ADC_RLnMrking_conf "";
BA_ "EventCommandSignal" SG_ 667 ADC_RLnMrking_Range 0;
BA_ "GatewayedSignals" SG_ 667 ADC_RLnMrking_Range 0;
BA_ "GenSigInactiveValue" SG_ 667 ADC_RLnMrking_Range 0;
BA_ "GenSigInvalidValue" SG_ 667 ADC_RLnMrking_Range 0;
BA_ "GenSigSendType" SG_ 667 ADC_RLnMrking_Range 1;
BA_ "GenSigStartValue" SG_ 667 ADC_RLnMrking_Range 0;
BA_ "GenSigTimeoutValue" SG_ 667 ADC_RLnMrking_Range 0;
BA_ "Remark" SG_ 667 ADC_RLnMrking_Range "";
BA_ "EventCommandSignal" SG_ 667 ADC_RLnMrking_Type 0;
BA_ "GatewayedSignals" SG_ 667 ADC_RLnMrking_Type 0;
BA_ "GenSigInactiveValue" SG_ 667 ADC_RLnMrking_Type 0;
BA_ "GenSigInvalidValue" SG_ 667 ADC_RLnMrking_Type 0;
BA_ "GenSigSendType" SG_ 667 ADC_RLnMrking_Type 1;
BA_ "GenSigStartValue" SG_ 667 ADC_RLnMrking_Type 0;
BA_ "GenSigTimeoutValue" SG_ 667 ADC_RLnMrking_Type 0;
BA_ "Remark" SG_ 667 ADC_RLnMrking_Type "";
BA_ "EventCommandSignal" SG_ 667 ADC_AdjLLnMrking_A0 0;
BA_ "GatewayedSignals" SG_ 667 ADC_AdjLLnMrking_A0 0;
BA_ "GenSigInactiveValue" SG_ 667 ADC_AdjLLnMrking_A0 0;
BA_ "GenSigInvalidValue" SG_ 667 ADC_AdjLLnMrking_A0 2047;
BA_ "GenSigSendType" SG_ 667 ADC_AdjLLnMrking_A0 1;
BA_ "GenSigStartValue" SG_ 667 ADC_AdjLLnMrking_A0 1023;
BA_ "GenSigTimeoutValue" SG_ 667 ADC_AdjLLnMrking_A0 0;
BA_ "Remark" SG_ 667 ADC_AdjLLnMrking_A0 "";
BA_ "EventCommandSignal" SG_ 667 ADC_AdjLLnMrking_A1 0;
BA_ "GatewayedSignals" SG_ 667 ADC_AdjLLnMrking_A1 0;
BA_ "GenSigInactiveValue" SG_ 667 ADC_AdjLLnMrking_A1 0;
BA_ "GenSigInvalidValue" SG_ 667 ADC_AdjLLnMrking_A1 2047;
BA_ "GenSigSendType" SG_ 667 ADC_AdjLLnMrking_A1 1;
BA_ "GenSigStartValue" SG_ 667 ADC_AdjLLnMrking_A1 1023;
BA_ "GenSigTimeoutValue" SG_ 667 ADC_AdjLLnMrking_A1 0;
BA_ "Remark" SG_ 667 ADC_AdjLLnMrking_A1 "";
BA_ "EventCommandSignal" SG_ 667 ADC_AdjLLnMrking_A2 0;
BA_ "GatewayedSignals" SG_ 667 ADC_AdjLLnMrking_A2 0;
BA_ "GenSigInactiveValue" SG_ 667 ADC_AdjLLnMrking_A2 0;
BA_ "GenSigInvalidValue" SG_ 667 ADC_AdjLLnMrking_A2 2047;
BA_ "GenSigSendType" SG_ 667 ADC_AdjLLnMrking_A2 1;
BA_ "GenSigStartValue" SG_ 667 ADC_AdjLLnMrking_A2 1023;
BA_ "GenSigTimeoutValue" SG_ 667 ADC_AdjLLnMrking_A2 0;
BA_ "Remark" SG_ 667 ADC_AdjLLnMrking_A2 "";
BA_ "EventCommandSignal" SG_ 667 ADC_AdjLLnMrking_conf 0;
BA_ "GatewayedSignals" SG_ 667 ADC_AdjLLnMrking_conf 0;
BA_ "GenSigInactiveValue" SG_ 667 ADC_AdjLLnMrking_conf 0;
BA_ "GenSigInvalidValue" SG_ 667 ADC_AdjLLnMrking_conf 100;
BA_ "GenSigSendType" SG_ 667 ADC_AdjLLnMrking_conf 1;
BA_ "GenSigStartValue" SG_ 667 ADC_AdjLLnMrking_conf 0;
BA_ "GenSigTimeoutValue" SG_ 667 ADC_AdjLLnMrking_conf 0;
BA_ "Remark" SG_ 667 ADC_AdjLLnMrking_conf "";
BA_ "EventCommandSignal" SG_ 667 ADC_AdjLLnMrking_Range 0;
BA_ "GatewayedSignals" SG_ 667 ADC_AdjLLnMrking_Range 0;
BA_ "GenSigInactiveValue" SG_ 667 ADC_AdjLLnMrking_Range 0;
BA_ "GenSigInvalidValue" SG_ 667 ADC_AdjLLnMrking_Range 0;
BA_ "GenSigSendType" SG_ 667 ADC_AdjLLnMrking_Range 1;
BA_ "GenSigStartValue" SG_ 667 ADC_AdjLLnMrking_Range 0;
BA_ "GenSigTimeoutValue" SG_ 667 ADC_AdjLLnMrking_Range 0;
BA_ "Remark" SG_ 667 ADC_AdjLLnMrking_Range "";
BA_ "EventCommandSignal" SG_ 667 ADC_AdjLlnMrkingDispSt 0;
BA_ "GatewayedSignals" SG_ 667 ADC_AdjLlnMrkingDispSt 0;
BA_ "GenSigInactiveValue" SG_ 667 ADC_AdjLlnMrkingDispSt 0;
BA_ "GenSigInvalidValue" SG_ 667 ADC_AdjLlnMrkingDispSt 0;
BA_ "GenSigSendType" SG_ 667 ADC_AdjLlnMrkingDispSt 1;
BA_ "GenSigStartValue" SG_ 667 ADC_AdjLlnMrkingDispSt 0;
BA_ "GenSigTimeoutValue" SG_ 667 ADC_AdjLlnMrkingDispSt 0;
BA_ "Remark" SG_ 667 ADC_AdjLlnMrkingDispSt "";
BA_ "EventCommandSignal" SG_ 667 ADC_AdjLLnMrking_Type 0;
BA_ "GatewayedSignals" SG_ 667 ADC_AdjLLnMrking_Type 0;
BA_ "GenSigInactiveValue" SG_ 667 ADC_AdjLLnMrking_Type 0;
BA_ "GenSigInvalidValue" SG_ 667 ADC_AdjLLnMrking_Type 0;
BA_ "GenSigSendType" SG_ 667 ADC_AdjLLnMrking_Type 1;
BA_ "GenSigStartValue" SG_ 667 ADC_AdjLLnMrking_Type 0;
BA_ "GenSigTimeoutValue" SG_ 667 ADC_AdjLLnMrking_Type 0;
BA_ "Remark" SG_ 667 ADC_AdjLLnMrking_Type "";
BA_ "EventCommandSignal" SG_ 667 ADC_AdjRLnMrking_A0 0;
BA_ "GatewayedSignals" SG_ 667 ADC_AdjRLnMrking_A0 0;
BA_ "GenSigInactiveValue" SG_ 667 ADC_AdjRLnMrking_A0 0;
BA_ "GenSigInvalidValue" SG_ 667 ADC_AdjRLnMrking_A0 2047;
BA_ "GenSigSendType" SG_ 667 ADC_AdjRLnMrking_A0 1;
BA_ "GenSigStartValue" SG_ 667 ADC_AdjRLnMrking_A0 1023;
BA_ "GenSigTimeoutValue" SG_ 667 ADC_AdjRLnMrking_A0 0;
BA_ "Remark" SG_ 667 ADC_AdjRLnMrking_A0 "";
BA_ "EventCommandSignal" SG_ 667 ADC_AdjRLnMrking_A1 0;
BA_ "GatewayedSignals" SG_ 667 ADC_AdjRLnMrking_A1 0;
BA_ "GenSigInactiveValue" SG_ 667 ADC_AdjRLnMrking_A1 0;
BA_ "GenSigInvalidValue" SG_ 667 ADC_AdjRLnMrking_A1 2047;
BA_ "GenSigSendType" SG_ 667 ADC_AdjRLnMrking_A1 1;
BA_ "GenSigStartValue" SG_ 667 ADC_AdjRLnMrking_A1 1023;
BA_ "GenSigTimeoutValue" SG_ 667 ADC_AdjRLnMrking_A1 0;
BA_ "Remark" SG_ 667 ADC_AdjRLnMrking_A1 "";
BA_ "EventCommandSignal" SG_ 667 ADC_AdjRLnMrking_A2 0;
BA_ "GatewayedSignals" SG_ 667 ADC_AdjRLnMrking_A2 0;
BA_ "GenSigInactiveValue" SG_ 667 ADC_AdjRLnMrking_A2 0;
BA_ "GenSigInvalidValue" SG_ 667 ADC_AdjRLnMrking_A2 2047;
BA_ "GenSigSendType" SG_ 667 ADC_AdjRLnMrking_A2 1;
BA_ "GenSigStartValue" SG_ 667 ADC_AdjRLnMrking_A2 1023;
BA_ "GenSigTimeoutValue" SG_ 667 ADC_AdjRLnMrking_A2 0;
BA_ "Remark" SG_ 667 ADC_AdjRLnMrking_A2 "";
BA_ "EventCommandSignal" SG_ 667 ADC_AdjRLnMrking_Range 0;
BA_ "GatewayedSignals" SG_ 667 ADC_AdjRLnMrking_Range 0;
BA_ "GenSigInactiveValue" SG_ 667 ADC_AdjRLnMrking_Range 0;
BA_ "GenSigInvalidValue" SG_ 667 ADC_AdjRLnMrking_Range 0;
BA_ "GenSigSendType" SG_ 667 ADC_AdjRLnMrking_Range 1;
BA_ "GenSigStartValue" SG_ 667 ADC_AdjRLnMrking_Range 0;
BA_ "GenSigTimeoutValue" SG_ 667 ADC_AdjRLnMrking_Range 0;
BA_ "Remark" SG_ 667 ADC_AdjRLnMrking_Range "";
BA_ "EventCommandSignal" SG_ 667 ADC_AdjRLnMrking_conf 0;
BA_ "GatewayedSignals" SG_ 667 ADC_AdjRLnMrking_conf 0;
BA_ "GenSigInactiveValue" SG_ 667 ADC_AdjRLnMrking_conf 0;
BA_ "GenSigInvalidValue" SG_ 667 ADC_AdjRLnMrking_conf 100;
BA_ "GenSigSendType" SG_ 667 ADC_AdjRLnMrking_conf 1;
BA_ "GenSigStartValue" SG_ 667 ADC_AdjRLnMrking_conf 0;
BA_ "GenSigTimeoutValue" SG_ 667 ADC_AdjRLnMrking_conf 0;
BA_ "Remark" SG_ 667 ADC_AdjRLnMrking_conf "";
BA_ "EventCommandSignal" SG_ 667 ADC_AdjRlnMrkingDispSt 0;
BA_ "GatewayedSignals" SG_ 667 ADC_AdjRlnMrkingDispSt 0;
BA_ "GenSigInactiveValue" SG_ 667 ADC_AdjRlnMrkingDispSt 0;
BA_ "GenSigInvalidValue" SG_ 667 ADC_AdjRlnMrkingDispSt 0;
BA_ "GenSigSendType" SG_ 667 ADC_AdjRlnMrkingDispSt 1;
BA_ "GenSigStartValue" SG_ 667 ADC_AdjRlnMrkingDispSt 0;
BA_ "GenSigTimeoutValue" SG_ 667 ADC_AdjRlnMrkingDispSt 0;
BA_ "Remark" SG_ 667 ADC_AdjRlnMrkingDispSt "";
BA_ "EventCommandSignal" SG_ 667 ADC_AdjRLnMrking_Type 0;
BA_ "GatewayedSignals" SG_ 667 ADC_AdjRLnMrking_Type 0;
BA_ "GenSigInactiveValue" SG_ 667 ADC_AdjRLnMrking_Type 0;
BA_ "GenSigInvalidValue" SG_ 667 ADC_AdjRLnMrking_Type 0;
BA_ "GenSigSendType" SG_ 667 ADC_AdjRLnMrking_Type 1;
BA_ "GenSigStartValue" SG_ 667 ADC_AdjRLnMrking_Type 0;
BA_ "GenSigTimeoutValue" SG_ 667 ADC_AdjRLnMrking_Type 0;
BA_ "Remark" SG_ 667 ADC_AdjRLnMrking_Type "";
BA_ "EventCommandSignal" SG_ 947 ADC_8_CRC 0;
BA_ "GatewayedSignals" SG_ 947 ADC_8_CRC 0;
BA_ "GenSigInactiveValue" SG_ 947 ADC_8_CRC 0;
BA_ "GenSigInvalidValue" SG_ 947 ADC_8_CRC 0;
BA_ "GenSigSendType" SG_ 947 ADC_8_CRC 1;
BA_ "GenSigStartValue" SG_ 947 ADC_8_CRC 0;
BA_ "GenSigTimeoutValue" SG_ 947 ADC_8_CRC 0;
BA_ "Remark" SG_ 947 ADC_8_CRC "";
BA_ "EventCommandSignal" SG_ 947 ADC_8_Counter 0;
BA_ "GatewayedSignals" SG_ 947 ADC_8_Counter 0;
BA_ "GenSigInactiveValue" SG_ 947 ADC_8_Counter 0;
BA_ "GenSigInvalidValue" SG_ 947 ADC_8_Counter 0;
BA_ "GenSigSendType" SG_ 947 ADC_8_Counter 1;
BA_ "GenSigStartValue" SG_ 947 ADC_8_Counter 0;
BA_ "GenSigTimeoutValue" SG_ 947 ADC_8_Counter 0;
BA_ "Remark" SG_ 947 ADC_8_Counter "";
BA_ "EventCommandSignal" SG_ 947 ADC_LowBeamReq 0;
BA_ "GatewayedSignals" SG_ 947 ADC_LowBeamReq 0;
BA_ "GenSigInactiveValue" SG_ 947 ADC_LowBeamReq 0;
BA_ "GenSigInvalidValue" SG_ 947 ADC_LowBeamReq 0;
BA_ "GenSigSendType" SG_ 947 ADC_LowBeamReq 1;
BA_ "GenSigStartValue" SG_ 947 ADC_LowBeamReq 0;
BA_ "GenSigTimeoutValue" SG_ 947 ADC_LowBeamReq 0;
BA_ "Remark" SG_ 947 ADC_LowBeamReq "";
BA_ "EventCommandSignal" SG_ 947 ADC_IHBC_HighBeamReq 0;
BA_ "GatewayedSignals" SG_ 947 ADC_IHBC_HighBeamReq 0;
BA_ "GenSigInactiveValue" SG_ 947 ADC_IHBC_HighBeamReq 0;
BA_ "GenSigInvalidValue" SG_ 947 ADC_IHBC_HighBeamReq 0;
BA_ "GenSigSendType" SG_ 947 ADC_IHBC_HighBeamReq 1;
BA_ "GenSigStartValue" SG_ 947 ADC_IHBC_HighBeamReq 0;
BA_ "GenSigTimeoutValue" SG_ 947 ADC_IHBC_HighBeamReq 0;
BA_ "Remark" SG_ 947 ADC_IHBC_HighBeamReq "";
BA_ "EventCommandSignal" SG_ 947 ADC_FlashReq 0;
BA_ "GatewayedSignals" SG_ 947 ADC_FlashReq 0;
BA_ "GenSigInactiveValue" SG_ 947 ADC_FlashReq 0;
BA_ "GenSigInvalidValue" SG_ 947 ADC_FlashReq 0;
BA_ "GenSigSendType" SG_ 947 ADC_FlashReq 1;
BA_ "GenSigStartValue" SG_ 947 ADC_FlashReq 0;
BA_ "GenSigTimeoutValue" SG_ 947 ADC_FlashReq 0;
BA_ "Remark" SG_ 947 ADC_FlashReq "";
BA_ "EventCommandSignal" SG_ 947 ADC_PositionLampReq 0;
BA_ "GatewayedSignals" SG_ 947 ADC_PositionLampReq 0;
BA_ "GenSigInactiveValue" SG_ 947 ADC_PositionLampReq 0;
BA_ "GenSigInvalidValue" SG_ 947 ADC_PositionLampReq 0;
BA_ "GenSigSendType" SG_ 947 ADC_PositionLampReq 1;
BA_ "GenSigStartValue" SG_ 947 ADC_PositionLampReq 0;
BA_ "GenSigTimeoutValue" SG_ 947 ADC_PositionLampReq 0;
BA_ "Remark" SG_ 947 ADC_PositionLampReq "";
BA_ "EventCommandSignal" SG_ 947 ADC_HVACCtrlReq 0;
BA_ "GatewayedSignals" SG_ 947 ADC_HVACCtrlReq 0;
BA_ "GenSigInactiveValue" SG_ 947 ADC_HVACCtrlReq 0;
BA_ "GenSigInvalidValue" SG_ 947 ADC_HVACCtrlReq 0;
BA_ "GenSigSendType" SG_ 947 ADC_HVACCtrlReq 1;
BA_ "GenSigStartValue" SG_ 947 ADC_HVACCtrlReq 0;
BA_ "GenSigTimeoutValue" SG_ 947 ADC_HVACCtrlReq 0;
BA_ "Remark" SG_ 947 ADC_HVACCtrlReq "";
BA_ "EventCommandSignal" SG_ 947 ADC_FFogLightReq 0;
BA_ "GatewayedSignals" SG_ 947 ADC_FFogLightReq 0;
BA_ "GenSigInactiveValue" SG_ 947 ADC_FFogLightReq 0;
BA_ "GenSigInvalidValue" SG_ 947 ADC_FFogLightReq 0;
BA_ "GenSigSendType" SG_ 947 ADC_FFogLightReq 1;
BA_ "GenSigStartValue" SG_ 947 ADC_FFogLightReq 0;
BA_ "GenSigTimeoutValue" SG_ 947 ADC_FFogLightReq 0;
BA_ "Remark" SG_ 947 ADC_FFogLightReq "";
BA_ "EventCommandSignal" SG_ 947 ADC_RFogLightReq 0;
BA_ "GatewayedSignals" SG_ 947 ADC_RFogLightReq 0;
BA_ "GenSigInactiveValue" SG_ 947 ADC_RFogLightReq 0;
BA_ "GenSigInvalidValue" SG_ 947 ADC_RFogLightReq 0;
BA_ "GenSigSendType" SG_ 947 ADC_RFogLightReq 1;
BA_ "GenSigStartValue" SG_ 947 ADC_RFogLightReq 0;
BA_ "GenSigTimeoutValue" SG_ 947 ADC_RFogLightReq 0;
BA_ "Remark" SG_ 947 ADC_RFogLightReq "";
BA_ "EventCommandSignal" SG_ 947 ADC_HornReq 0;
BA_ "GatewayedSignals" SG_ 947 ADC_HornReq 0;
BA_ "GenSigInactiveValue" SG_ 947 ADC_HornReq 0;
BA_ "GenSigInvalidValue" SG_ 947 ADC_HornReq 0;
BA_ "GenSigSendType" SG_ 947 ADC_HornReq 1;
BA_ "GenSigStartValue" SG_ 947 ADC_HornReq 0;
BA_ "GenSigTimeoutValue" SG_ 947 ADC_HornReq 0;
BA_ "Remark" SG_ 947 ADC_HornReq "";
BA_ "EventCommandSignal" SG_ 947 ADC_FWiperReq 0;
BA_ "GatewayedSignals" SG_ 947 ADC_FWiperReq 0;
BA_ "GenSigInactiveValue" SG_ 947 ADC_FWiperReq 0;
BA_ "GenSigInvalidValue" SG_ 947 ADC_FWiperReq 0;
BA_ "GenSigSendType" SG_ 947 ADC_FWiperReq 1;
BA_ "GenSigStartValue" SG_ 947 ADC_FWiperReq 0;
BA_ "GenSigTimeoutValue" SG_ 947 ADC_FWiperReq 0;
BA_ "Remark" SG_ 947 ADC_FWiperReq "";
BA_ "EventCommandSignal" SG_ 947 ADC_RWiperReq 0;
BA_ "GatewayedSignals" SG_ 947 ADC_RWiperReq 0;
BA_ "GenSigInactiveValue" SG_ 947 ADC_RWiperReq 0;
BA_ "GenSigInvalidValue" SG_ 947 ADC_RWiperReq 0;
BA_ "GenSigSendType" SG_ 947 ADC_RWiperReq 1;
BA_ "GenSigStartValue" SG_ 947 ADC_RWiperReq 0;
BA_ "GenSigTimeoutValue" SG_ 947 ADC_RWiperReq 0;
BA_ "Remark" SG_ 947 ADC_RWiperReq "";
BA_ "EventCommandSignal" SG_ 947 ADC_FWaterSprayReq 0;
BA_ "GatewayedSignals" SG_ 947 ADC_FWaterSprayReq 0;
BA_ "GenSigInactiveValue" SG_ 947 ADC_FWaterSprayReq 0;
BA_ "GenSigInvalidValue" SG_ 947 ADC_FWaterSprayReq 0;
BA_ "GenSigSendType" SG_ 947 ADC_FWaterSprayReq 1;
BA_ "GenSigStartValue" SG_ 947 ADC_FWaterSprayReq 0;
BA_ "GenSigTimeoutValue" SG_ 947 ADC_FWaterSprayReq 0;
BA_ "Remark" SG_ 947 ADC_FWaterSprayReq "";
BA_ "EventCommandSignal" SG_ 947 ADC_RWaterSprayReq 0;
BA_ "GatewayedSignals" SG_ 947 ADC_RWaterSprayReq 0;
BA_ "GenSigInactiveValue" SG_ 947 ADC_RWaterSprayReq 0;
BA_ "GenSigInvalidValue" SG_ 947 ADC_RWaterSprayReq 0;
BA_ "GenSigSendType" SG_ 947 ADC_RWaterSprayReq 1;
BA_ "GenSigStartValue" SG_ 947 ADC_RWaterSprayReq 0;
BA_ "GenSigTimeoutValue" SG_ 947 ADC_RWaterSprayReq 0;
BA_ "Remark" SG_ 947 ADC_RWaterSprayReq "";
BA_ "EventCommandSignal" SG_ 947 ADC_CCUReqVD 0;
BA_ "GatewayedSignals" SG_ 947 ADC_CCUReqVD 0;
BA_ "GenSigInactiveValue" SG_ 947 ADC_CCUReqVD 0;
BA_ "GenSigInvalidValue" SG_ 947 ADC_CCUReqVD 0;
BA_ "GenSigSendType" SG_ 947 ADC_CCUReqVD 1;
BA_ "GenSigStartValue" SG_ 947 ADC_CCUReqVD 0;
BA_ "GenSigTimeoutValue" SG_ 947 ADC_CCUReqVD 0;
BA_ "Remark" SG_ 947 ADC_CCUReqVD "";
BA_ "EventCommandSignal" SG_ 947 ADC_WindowOpenReq 0;
BA_ "GatewayedSignals" SG_ 947 ADC_WindowOpenReq 0;
BA_ "GenSigInactiveValue" SG_ 947 ADC_WindowOpenReq 0;
BA_ "GenSigInvalidValue" SG_ 947 ADC_WindowOpenReq 0;
BA_ "GenSigSendType" SG_ 947 ADC_WindowOpenReq 1;
BA_ "GenSigStartValue" SG_ 947 ADC_WindowOpenReq 0;
BA_ "GenSigTimeoutValue" SG_ 947 ADC_WindowOpenReq 0;
BA_ "Remark" SG_ 947 ADC_WindowOpenReq "";
BA_ "EventCommandSignal" SG_ 947 ADC_WindowCloseReq 0;
BA_ "GatewayedSignals" SG_ 947 ADC_WindowCloseReq 0;
BA_ "GenSigInactiveValue" SG_ 947 ADC_WindowCloseReq 0;
BA_ "GenSigInvalidValue" SG_ 947 ADC_WindowCloseReq 0;
BA_ "GenSigSendType" SG_ 947 ADC_WindowCloseReq 1;
BA_ "GenSigStartValue" SG_ 947 ADC_WindowCloseReq 0;
BA_ "GenSigTimeoutValue" SG_ 947 ADC_WindowCloseReq 0;
BA_ "Remark" SG_ 947 ADC_WindowCloseReq "";
BA_ "EventCommandSignal" SG_ 947 ADC_PLGMOpenReq 0;
BA_ "GatewayedSignals" SG_ 947 ADC_PLGMOpenReq 0;
BA_ "GenSigInactiveValue" SG_ 947 ADC_PLGMOpenReq 0;
BA_ "GenSigInvalidValue" SG_ 947 ADC_PLGMOpenReq 0;
BA_ "GenSigSendType" SG_ 947 ADC_PLGMOpenReq 1;
BA_ "GenSigStartValue" SG_ 947 ADC_PLGMOpenReq 0;
BA_ "GenSigTimeoutValue" SG_ 947 ADC_PLGMOpenReq 0;
BA_ "Remark" SG_ 947 ADC_PLGMOpenReq "";
BA_ "EventCommandSignal" SG_ 947 ADC_PLGMCloseReq 0;
BA_ "GatewayedSignals" SG_ 947 ADC_PLGMCloseReq 0;
BA_ "GenSigInactiveValue" SG_ 947 ADC_PLGMCloseReq 0;
BA_ "GenSigInvalidValue" SG_ 947 ADC_PLGMCloseReq 0;
BA_ "GenSigSendType" SG_ 947 ADC_PLGMCloseReq 1;
BA_ "GenSigStartValue" SG_ 947 ADC_PLGMCloseReq 0;
BA_ "GenSigTimeoutValue" SG_ 947 ADC_PLGMCloseReq 0;
BA_ "Remark" SG_ 947 ADC_PLGMCloseReq "";
BA_ "EventCommandSignal" SG_ 947 ADC_FDemistReq 0;
BA_ "GatewayedSignals" SG_ 947 ADC_FDemistReq 0;
BA_ "GenSigInactiveValue" SG_ 947 ADC_FDemistReq 0;
BA_ "GenSigInvalidValue" SG_ 947 ADC_FDemistReq 0;
BA_ "GenSigSendType" SG_ 947 ADC_FDemistReq 1;
BA_ "GenSigStartValue" SG_ 947 ADC_FDemistReq 0;
BA_ "GenSigTimeoutValue" SG_ 947 ADC_FDemistReq 0;
BA_ "Remark" SG_ 947 ADC_FDemistReq "";
BA_ "EventCommandSignal" SG_ 947 ADC_RDemistReq 0;
BA_ "GatewayedSignals" SG_ 947 ADC_RDemistReq 0;
BA_ "GenSigInactiveValue" SG_ 947 ADC_RDemistReq 0;
BA_ "GenSigInvalidValue" SG_ 947 ADC_RDemistReq 0;
BA_ "GenSigSendType" SG_ 947 ADC_RDemistReq 1;
BA_ "GenSigStartValue" SG_ 947 ADC_RDemistReq 0;
BA_ "GenSigTimeoutValue" SG_ 947 ADC_RDemistReq 0;
BA_ "Remark" SG_ 947 ADC_RDemistReq "";
BA_ "EventCommandSignal" SG_ 947 ADC_ThmPostRun 0;
BA_ "GatewayedSignals" SG_ 947 ADC_ThmPostRun 0;
BA_ "GenSigInactiveValue" SG_ 947 ADC_ThmPostRun 0;
BA_ "GenSigInvalidValue" SG_ 947 ADC_ThmPostRun 0;
BA_ "GenSigSendType" SG_ 947 ADC_ThmPostRun 1;
BA_ "GenSigStartValue" SG_ 947 ADC_ThmPostRun 0;
BA_ "GenSigTimeoutValue" SG_ 947 ADC_ThmPostRun 1;
BA_ "Remark" SG_ 947 ADC_ThmPostRun "";
BA_ "EventCommandSignal" SG_ 947 ADC_DriverFaceWindReq 0;
BA_ "GatewayedSignals" SG_ 947 ADC_DriverFaceWindReq 0;
BA_ "GenSigInactiveValue" SG_ 947 ADC_DriverFaceWindReq 0;
BA_ "GenSigInvalidValue" SG_ 947 ADC_DriverFaceWindReq 0;
BA_ "GenSigSendType" SG_ 947 ADC_DriverFaceWindReq 1;
BA_ "GenSigStartValue" SG_ 947 ADC_DriverFaceWindReq 0;
BA_ "GenSigTimeoutValue" SG_ 947 ADC_DriverFaceWindReq 0;
BA_ "Remark" SG_ 947 ADC_DriverFaceWindReq "";
BA_ "EventCommandSignal" SG_ 947 ADC_EcallReq 0;
BA_ "GatewayedSignals" SG_ 947 ADC_EcallReq 0;
BA_ "GenSigInactiveValue" SG_ 947 ADC_EcallReq 0;
BA_ "GenSigInvalidValue" SG_ 947 ADC_EcallReq 0;
BA_ "GenSigSendType" SG_ 947 ADC_EcallReq 1;
BA_ "GenSigStartValue" SG_ 947 ADC_EcallReq 0;
BA_ "GenSigTimeoutValue" SG_ 947 ADC_EcallReq 0;
BA_ "Remark" SG_ 947 ADC_EcallReq "";
BA_ "EventCommandSignal" SG_ 947 ADC_FlowReq 0;
BA_ "GatewayedSignals" SG_ 947 ADC_FlowReq 0;
BA_ "GenSigInactiveValue" SG_ 947 ADC_FlowReq 0;
BA_ "GenSigInvalidValue" SG_ 947 ADC_FlowReq 255;
BA_ "GenSigSendType" SG_ 947 ADC_FlowReq 1;
BA_ "GenSigStartValue" SG_ 947 ADC_FlowReq 0;
BA_ "GenSigTimeoutValue" SG_ 947 ADC_FlowReq 12;
BA_ "Remark" SG_ 947 ADC_FlowReq "";
BA_ "EventCommandSignal" SG_ 947 ADC_DriverSeatBeltPretightenReq 0;
BA_ "GatewayedSignals" SG_ 947 ADC_DriverSeatBeltPretightenReq 0;
BA_ "GenSigInactiveValue" SG_ 947 ADC_DriverSeatBeltPretightenReq 0;
BA_ "GenSigInvalidValue" SG_ 947 ADC_DriverSeatBeltPretightenReq 0;
BA_ "GenSigSendType" SG_ 947 ADC_DriverSeatBeltPretightenReq 1;
BA_ "GenSigStartValue" SG_ 947 ADC_DriverSeatBeltPretightenReq 0;
BA_ "GenSigTimeoutValue" SG_ 947 ADC_DriverSeatBeltPretightenReq 0;
BA_ "Remark" SG_ 947 ADC_DriverSeatBeltPretightenReq "";
BA_ "EventCommandSignal" SG_ 947 ADC_LockReq 0;
BA_ "GatewayedSignals" SG_ 947 ADC_LockReq 0;
BA_ "GenSigInactiveValue" SG_ 947 ADC_LockReq 0;
BA_ "GenSigInvalidValue" SG_ 947 ADC_LockReq 0;
BA_ "GenSigSendType" SG_ 947 ADC_LockReq 1;
BA_ "GenSigStartValue" SG_ 947 ADC_LockReq 0;
BA_ "GenSigTimeoutValue" SG_ 947 ADC_LockReq 0;
BA_ "Remark" SG_ 947 ADC_LockReq "";
BA_ "EventCommandSignal" SG_ 947 ADC_HoldLockReq 0;
BA_ "GatewayedSignals" SG_ 947 ADC_HoldLockReq 0;
BA_ "GenSigInactiveValue" SG_ 947 ADC_HoldLockReq 0;
BA_ "GenSigInvalidValue" SG_ 947 ADC_HoldLockReq 0;
BA_ "GenSigSendType" SG_ 947 ADC_HoldLockReq 1;
BA_ "GenSigStartValue" SG_ 947 ADC_HoldLockReq 0;
BA_ "GenSigTimeoutValue" SG_ 947 ADC_HoldLockReq 0;
BA_ "Remark" SG_ 947 ADC_HoldLockReq "";
BA_ "EventCommandSignal" SG_ 947 ADC_RearMirrorReq 0;
BA_ "GatewayedSignals" SG_ 947 ADC_RearMirrorReq 0;
BA_ "GenSigInactiveValue" SG_ 947 ADC_RearMirrorReq 0;
BA_ "GenSigInvalidValue" SG_ 947 ADC_RearMirrorReq 0;
BA_ "GenSigSendType" SG_ 947 ADC_RearMirrorReq 1;
BA_ "GenSigStartValue" SG_ 947 ADC_RearMirrorReq 0;
BA_ "GenSigTimeoutValue" SG_ 947 ADC_RearMirrorReq 0;
BA_ "Remark" SG_ 947 ADC_RearMirrorReq "";
BA_ "EventCommandSignal" SG_ 947 ADC_HoldRearMirrorReq 0;
BA_ "GatewayedSignals" SG_ 947 ADC_HoldRearMirrorReq 0;
BA_ "GenSigInactiveValue" SG_ 947 ADC_HoldRearMirrorReq 0;
BA_ "GenSigInvalidValue" SG_ 947 ADC_HoldRearMirrorReq 0;
BA_ "GenSigSendType" SG_ 947 ADC_HoldRearMirrorReq 1;
BA_ "GenSigStartValue" SG_ 947 ADC_HoldRearMirrorReq 0;
BA_ "GenSigTimeoutValue" SG_ 947 ADC_HoldRearMirrorReq 0;
BA_ "Remark" SG_ 947 ADC_HoldRearMirrorReq "";
BA_ "EventCommandSignal" SG_ 947 ADC_ADSLightReq 0;
BA_ "GatewayedSignals" SG_ 947 ADC_ADSLightReq 0;
BA_ "GenSigInactiveValue" SG_ 947 ADC_ADSLightReq 0;
BA_ "GenSigInvalidValue" SG_ 947 ADC_ADSLightReq 0;
BA_ "GenSigSendType" SG_ 947 ADC_ADSLightReq 1;
BA_ "GenSigStartValue" SG_ 947 ADC_ADSLightReq 0;
BA_ "GenSigTimeoutValue" SG_ 947 ADC_ADSLightReq 0;
BA_ "Remark" SG_ 947 ADC_ADSLightReq "";
BA_ "EventCommandSignal" SG_ 947 ADC_ReqChargPortCapOpen 0;
BA_ "GatewayedSignals" SG_ 947 ADC_ReqChargPortCapOpen 0;
BA_ "GenSigInactiveValue" SG_ 947 ADC_ReqChargPortCapOpen 0;
BA_ "GenSigInvalidValue" SG_ 947 ADC_ReqChargPortCapOpen 0;
BA_ "GenSigSendType" SG_ 947 ADC_ReqChargPortCapOpen 1;
BA_ "GenSigStartValue" SG_ 947 ADC_ReqChargPortCapOpen 0;
BA_ "GenSigTimeoutValue" SG_ 947 ADC_ReqChargPortCapOpen 0;
BA_ "Remark" SG_ 947 ADC_ReqChargPortCapOpen "";
BA_ "EventCommandSignal" SG_ 947 ADC_ReqChargeDiscont 0;
BA_ "GatewayedSignals" SG_ 947 ADC_ReqChargeDiscont 0;
BA_ "GenSigInactiveValue" SG_ 947 ADC_ReqChargeDiscont 0;
BA_ "GenSigInvalidValue" SG_ 947 ADC_ReqChargeDiscont 0;
BA_ "GenSigSendType" SG_ 947 ADC_ReqChargeDiscont 1;
BA_ "GenSigStartValue" SG_ 947 ADC_ReqChargeDiscont 0;
BA_ "GenSigTimeoutValue" SG_ 947 ADC_ReqChargeDiscont 0;
BA_ "Remark" SG_ 947 ADC_ReqChargeDiscont "";
BA_ "EventCommandSignal" SG_ 947 ADC_DriverSeatBeltVibrWarnReq 0;
BA_ "GatewayedSignals" SG_ 947 ADC_DriverSeatBeltVibrWarnReq 0;
BA_ "GenSigInactiveValue" SG_ 947 ADC_DriverSeatBeltVibrWarnReq 0;
BA_ "GenSigInvalidValue" SG_ 947 ADC_DriverSeatBeltVibrWarnReq 0;
BA_ "GenSigSendType" SG_ 947 ADC_DriverSeatBeltVibrWarnReq 1;
BA_ "GenSigStartValue" SG_ 947 ADC_DriverSeatBeltVibrWarnReq 0;
BA_ "GenSigTimeoutValue" SG_ 947 ADC_DriverSeatBeltVibrWarnReq 0;
BA_ "Remark" SG_ 947 ADC_DriverSeatBeltVibrWarnReq "";
BA_ "EventCommandSignal" SG_ 947 ADC_FrtWindshildHeatReq 0;
BA_ "GatewayedSignals" SG_ 947 ADC_FrtWindshildHeatReq 0;
BA_ "GenSigInactiveValue" SG_ 947 ADC_FrtWindshildHeatReq 0;
BA_ "GenSigInvalidValue" SG_ 947 ADC_FrtWindshildHeatReq 0;
BA_ "GenSigSendType" SG_ 947 ADC_FrtWindshildHeatReq 1;
BA_ "GenSigStartValue" SG_ 947 ADC_FrtWindshildHeatReq 0;
BA_ "GenSigTimeoutValue" SG_ 947 ADC_FrtWindshildHeatReq 0;
BA_ "Remark" SG_ 947 ADC_FrtWindshildHeatReq "";
BA_ "EventCommandSignal" SG_ 947 ADC_BeamSwReq 0;
BA_ "GatewayedSignals" SG_ 947 ADC_BeamSwReq 0;
BA_ "GenSigInactiveValue" SG_ 947 ADC_BeamSwReq 0;
BA_ "GenSigInvalidValue" SG_ 947 ADC_BeamSwReq 0;
BA_ "GenSigSendType" SG_ 947 ADC_BeamSwReq 1;
BA_ "GenSigStartValue" SG_ 947 ADC_BeamSwReq 0;
BA_ "GenSigTimeoutValue" SG_ 947 ADC_BeamSwReq 0;
BA_ "Remark" SG_ 947 ADC_BeamSwReq "";
BA_ "EventCommandSignal" SG_ 947 IFC_SysCalibrationSt 0;
BA_ "GatewayedSignals" SG_ 947 IFC_SysCalibrationSt 0;
BA_ "GenSigInactiveValue" SG_ 947 IFC_SysCalibrationSt 0;
BA_ "GenSigInvalidValue" SG_ 947 IFC_SysCalibrationSt 0;
BA_ "GenSigSendType" SG_ 947 IFC_SysCalibrationSt 1;
BA_ "GenSigStartValue" SG_ 947 IFC_SysCalibrationSt 0;
BA_ "GenSigTimeoutValue" SG_ 947 IFC_SysCalibrationSt 0;
BA_ "Remark" SG_ 947 IFC_SysCalibrationSt "";
BA_ "EventCommandSignal" SG_ 947 ADC_ADBIHBCEnableReq 0;
BA_ "GatewayedSignals" SG_ 947 ADC_ADBIHBCEnableReq 0;
BA_ "GenSigInactiveValue" SG_ 947 ADC_ADBIHBCEnableReq 0;
BA_ "GenSigInvalidValue" SG_ 947 ADC_ADBIHBCEnableReq 0;
BA_ "GenSigSendType" SG_ 947 ADC_ADBIHBCEnableReq 1;
BA_ "GenSigStartValue" SG_ 947 ADC_ADBIHBCEnableReq 0;
BA_ "GenSigTimeoutValue" SG_ 947 ADC_ADBIHBCEnableReq 0;
BA_ "Remark" SG_ 947 ADC_ADBIHBCEnableReq "";
BA_ "EventCommandSignal" SG_ 947 ADC_RearLeftChildSaftyLockReq 0;
BA_ "GatewayedSignals" SG_ 947 ADC_RearLeftChildSaftyLockReq 0;
BA_ "GenSigInactiveValue" SG_ 947 ADC_RearLeftChildSaftyLockReq 0;
BA_ "GenSigInvalidValue" SG_ 947 ADC_RearLeftChildSaftyLockReq 0;
BA_ "GenSigSendType" SG_ 947 ADC_RearLeftChildSaftyLockReq 1;
BA_ "GenSigStartValue" SG_ 947 ADC_RearLeftChildSaftyLockReq 0;
BA_ "GenSigTimeoutValue" SG_ 947 ADC_RearLeftChildSaftyLockReq 0;
BA_ "Remark" SG_ 947 ADC_RearLeftChildSaftyLockReq "";
BA_ "EventCommandSignal" SG_ 947 ADC_RearRightChildSaftyLockReq 0;
BA_ "GatewayedSignals" SG_ 947 ADC_RearRightChildSaftyLockReq 0;
BA_ "GenSigInactiveValue" SG_ 947 ADC_RearRightChildSaftyLockReq 0;
BA_ "GenSigInvalidValue" SG_ 947 ADC_RearRightChildSaftyLockReq 0;
BA_ "GenSigSendType" SG_ 947 ADC_RearRightChildSaftyLockReq 1;
BA_ "GenSigStartValue" SG_ 947 ADC_RearRightChildSaftyLockReq 0;
BA_ "GenSigTimeoutValue" SG_ 947 ADC_RearRightChildSaftyLockReq 0;
BA_ "Remark" SG_ 947 ADC_RearRightChildSaftyLockReq "";
BA_ "EventCommandSignal" SG_ 947 ADC_LowPowerReq_A 0;
BA_ "GatewayedSignals" SG_ 947 ADC_LowPowerReq_A 0;
BA_ "GenSigInactiveValue" SG_ 947 ADC_LowPowerReq_A 0;
BA_ "GenSigInvalidValue" SG_ 947 ADC_LowPowerReq_A 0;
BA_ "GenSigSendType" SG_ 947 ADC_LowPowerReq_A 1;
BA_ "GenSigStartValue" SG_ 947 ADC_LowPowerReq_A 0;
BA_ "GenSigTimeoutValue" SG_ 947 ADC_LowPowerReq_A 0;
BA_ "Remark" SG_ 947 ADC_LowPowerReq_A "";
BA_ "EventCommandSignal" SG_ 947 ADC_LowPowerReqVD_A 0;
BA_ "GatewayedSignals" SG_ 947 ADC_LowPowerReqVD_A 0;
BA_ "GenSigInactiveValue" SG_ 947 ADC_LowPowerReqVD_A 0;
BA_ "GenSigInvalidValue" SG_ 947 ADC_LowPowerReqVD_A 0;
BA_ "GenSigSendType" SG_ 947 ADC_LowPowerReqVD_A 1;
BA_ "GenSigStartValue" SG_ 947 ADC_LowPowerReqVD_A 0;
BA_ "GenSigTimeoutValue" SG_ 947 ADC_LowPowerReqVD_A 0;
BA_ "Remark" SG_ 947 ADC_LowPowerReqVD_A "";
BA_ "EventCommandSignal" SG_ 947 ADC_MachineStatus 0;
BA_ "GatewayedSignals" SG_ 947 ADC_MachineStatus 0;
BA_ "GenSigInactiveValue" SG_ 947 ADC_MachineStatus 0;
BA_ "GenSigInvalidValue" SG_ 947 ADC_MachineStatus 0;
BA_ "GenSigSendType" SG_ 947 ADC_MachineStatus 1;
BA_ "GenSigStartValue" SG_ 947 ADC_MachineStatus 0;
BA_ "GenSigTimeoutValue" SG_ 947 ADC_MachineStatus 0;
BA_ "Remark" SG_ 947 ADC_MachineStatus "";
BA_ "EventCommandSignal" SG_ 947 ADC_LowPowerFailReason 0;
BA_ "GatewayedSignals" SG_ 947 ADC_LowPowerFailReason 0;
BA_ "GenSigInactiveValue" SG_ 947 ADC_LowPowerFailReason 0;
BA_ "GenSigInvalidValue" SG_ 947 ADC_LowPowerFailReason 0;
BA_ "GenSigSendType" SG_ 947 ADC_LowPowerFailReason 1;
BA_ "GenSigStartValue" SG_ 947 ADC_LowPowerFailReason 0;
BA_ "GenSigTimeoutValue" SG_ 947 ADC_LowPowerFailReason 0;
BA_ "Remark" SG_ 947 ADC_LowPowerFailReason "";
BA_ "EventCommandSignal" SG_ 947 ADC_ChgPortControlReq 0;
BA_ "GatewayedSignals" SG_ 947 ADC_ChgPortControlReq 0;
BA_ "GenSigInactiveValue" SG_ 947 ADC_ChgPortControlReq 0;
BA_ "GenSigInvalidValue" SG_ 947 ADC_ChgPortControlReq 0;
BA_ "GenSigSendType" SG_ 947 ADC_ChgPortControlReq 1;
BA_ "GenSigStartValue" SG_ 947 ADC_ChgPortControlReq 0;
BA_ "GenSigTimeoutValue" SG_ 947 ADC_ChgPortControlReq 0;
BA_ "Remark" SG_ 947 ADC_ChgPortControlReq "";
BA_ "EventCommandSignal" SG_ 947 ADC_ChgPortHoldControlReq 0;
BA_ "GatewayedSignals" SG_ 947 ADC_ChgPortHoldControlReq 0;
BA_ "GenSigInactiveValue" SG_ 947 ADC_ChgPortHoldControlReq 0;
BA_ "GenSigInvalidValue" SG_ 947 ADC_ChgPortHoldControlReq 0;
BA_ "GenSigSendType" SG_ 947 ADC_ChgPortHoldControlReq 1;
BA_ "GenSigStartValue" SG_ 947 ADC_ChgPortHoldControlReq 0;
BA_ "GenSigTimeoutValue" SG_ 947 ADC_ChgPortHoldControlReq 0;
BA_ "Remark" SG_ 947 ADC_ChgPortHoldControlReq "";
BA_ "EventCommandSignal" SG_ 947 ADC_LightbarReq 0;
BA_ "GatewayedSignals" SG_ 947 ADC_LightbarReq 0;
BA_ "GenSigInactiveValue" SG_ 947 ADC_LightbarReq 0;
BA_ "GenSigInvalidValue" SG_ 947 ADC_LightbarReq 0;
BA_ "GenSigSendType" SG_ 947 ADC_LightbarReq 1;
BA_ "GenSigStartValue" SG_ 947 ADC_LightbarReq 0;
BA_ "GenSigTimeoutValue" SG_ 947 ADC_LightbarReq 15;
BA_ "Remark" SG_ 947 ADC_LightbarReq "";
BA_ "EventCommandSignal" SG_ 947 ADC_ChargHoldReq 0;
BA_ "GatewayedSignals" SG_ 947 ADC_ChargHoldReq 0;
BA_ "GenSigInactiveValue" SG_ 947 ADC_ChargHoldReq 0;
BA_ "GenSigInvalidValue" SG_ 947 ADC_ChargHoldReq 0;
BA_ "GenSigSendType" SG_ 947 ADC_ChargHoldReq 1;
BA_ "GenSigStartValue" SG_ 947 ADC_ChargHoldReq 0;
BA_ "GenSigTimeoutValue" SG_ 947 ADC_ChargHoldReq 0;
BA_ "Remark" SG_ 947 ADC_ChargHoldReq "";
BA_ "EventCommandSignal" SG_ 947 ADC_ChargReq 0;
BA_ "GatewayedSignals" SG_ 947 ADC_ChargReq 0;
BA_ "GenSigInactiveValue" SG_ 947 ADC_ChargReq 0;
BA_ "GenSigInvalidValue" SG_ 947 ADC_ChargReq 0;
BA_ "GenSigSendType" SG_ 947 ADC_ChargReq 1;
BA_ "GenSigStartValue" SG_ 947 ADC_ChargReq 0;
BA_ "GenSigTimeoutValue" SG_ 947 ADC_ChargReq 0;
BA_ "Remark" SG_ 947 ADC_ChargReq "";
BA_ "EventCommandSignal" SG_ 947 ADC_ChargGunHoldReq 0;
BA_ "GatewayedSignals" SG_ 947 ADC_ChargGunHoldReq 0;
BA_ "GenSigInactiveValue" SG_ 947 ADC_ChargGunHoldReq 0;
BA_ "GenSigInvalidValue" SG_ 947 ADC_ChargGunHoldReq 0;
BA_ "GenSigSendType" SG_ 947 ADC_ChargGunHoldReq 1;
BA_ "GenSigStartValue" SG_ 947 ADC_ChargGunHoldReq 0;
BA_ "GenSigTimeoutValue" SG_ 947 ADC_ChargGunHoldReq 0;
BA_ "Remark" SG_ 947 ADC_ChargGunHoldReq "";
BA_ "EventCommandSignal" SG_ 947 ADC_ChargGunReq 0;
BA_ "GatewayedSignals" SG_ 947 ADC_ChargGunReq 0;
BA_ "GenSigInactiveValue" SG_ 947 ADC_ChargGunReq 0;
BA_ "GenSigInvalidValue" SG_ 947 ADC_ChargGunReq 0;
BA_ "GenSigSendType" SG_ 947 ADC_ChargGunReq 1;
BA_ "GenSigStartValue" SG_ 947 ADC_ChargGunReq 0;
BA_ "GenSigTimeoutValue" SG_ 947 ADC_ChargGunReq 0;
BA_ "Remark" SG_ 947 ADC_ChargGunReq "";
BA_ "EventCommandSignal" SG_ 947 ADC_MCURTTemp 0;
BA_ "GatewayedSignals" SG_ 947 ADC_MCURTTemp 0;
BA_ "GenSigInactiveValue" SG_ 947 ADC_MCURTTemp 0;
BA_ "GenSigInvalidValue" SG_ 947 ADC_MCURTTemp 0;
BA_ "GenSigSendType" SG_ 947 ADC_MCURTTemp 1;
BA_ "GenSigStartValue" SG_ 947 ADC_MCURTTemp 0;
BA_ "GenSigTimeoutValue" SG_ 947 ADC_MCURTTemp 0;
BA_ "Remark" SG_ 947 ADC_MCURTTemp "";
BA_ "EventCommandSignal" SG_ 947 ADC_SOCRTtemp 0;
BA_ "GatewayedSignals" SG_ 947 ADC_SOCRTtemp 0;
BA_ "GenSigInactiveValue" SG_ 947 ADC_SOCRTtemp 0;
BA_ "GenSigInvalidValue" SG_ 947 ADC_SOCRTtemp 0;
BA_ "GenSigSendType" SG_ 947 ADC_SOCRTtemp 1;
BA_ "GenSigStartValue" SG_ 947 ADC_SOCRTtemp 0;
BA_ "GenSigTimeoutValue" SG_ 947 ADC_SOCRTtemp 0;
BA_ "Remark" SG_ 947 ADC_SOCRTtemp "";
BA_ "EventCommandSignal" SG_ 947 ADC_InteractLightReq 0;
BA_ "GatewayedSignals" SG_ 947 ADC_InteractLightReq 0;
BA_ "GenSigInactiveValue" SG_ 947 ADC_InteractLightReq 0;
BA_ "GenSigInvalidValue" SG_ 947 ADC_InteractLightReq 0;
BA_ "GenSigSendType" SG_ 947 ADC_InteractLightReq 1;
BA_ "GenSigStartValue" SG_ 947 ADC_InteractLightReq 0;
BA_ "GenSigTimeoutValue" SG_ 947 ADC_InteractLightReq 0;
BA_ "Remark" SG_ 947 ADC_InteractLightReq "";
BA_ "EventCommandSignal" SG_ 947 ADCState 0;
BA_ "GatewayedSignals" SG_ 947 ADCState 0;
BA_ "GenSigInactiveValue" SG_ 947 ADCState 0;
BA_ "GenSigInvalidValue" SG_ 947 ADCState 0;
BA_ "GenSigSendType" SG_ 947 ADCState 1;
BA_ "GenSigStartValue" SG_ 947 ADCState 0;
BA_ "GenSigTimeoutValue" SG_ 947 ADCState 0;
BA_ "Remark" SG_ 947 ADCState "";
BA_ "EventCommandSignal" SG_ 947 ADCtargetState 0;
BA_ "GatewayedSignals" SG_ 947 ADCtargetState 0;
BA_ "GenSigInactiveValue" SG_ 947 ADCtargetState 0;
BA_ "GenSigInvalidValue" SG_ 947 ADCtargetState 0;
BA_ "GenSigSendType" SG_ 947 ADCtargetState 1;
BA_ "GenSigStartValue" SG_ 947 ADCtargetState 0;
BA_ "GenSigTimeoutValue" SG_ 947 ADCtargetState 0;
BA_ "Remark" SG_ 947 ADCtargetState "";
BA_ "EventCommandSignal" SG_ 947 Parking_System_State 0;
BA_ "GatewayedSignals" SG_ 947 Parking_System_State 0;
BA_ "GenSigInactiveValue" SG_ 947 Parking_System_State 0;
BA_ "GenSigInvalidValue" SG_ 947 Parking_System_State 0;
BA_ "GenSigSendType" SG_ 947 Parking_System_State 1;
BA_ "GenSigStartValue" SG_ 947 Parking_System_State 0;
BA_ "GenSigTimeoutValue" SG_ 947 Parking_System_State 0;
BA_ "Remark" SG_ 947 Parking_System_State "";
BA_ "EventCommandSignal" SG_ 947 Driving_System_State 0;
BA_ "GatewayedSignals" SG_ 947 Driving_System_State 0;
BA_ "GenSigInactiveValue" SG_ 947 Driving_System_State 0;
BA_ "GenSigInvalidValue" SG_ 947 Driving_System_State 0;
BA_ "GenSigSendType" SG_ 947 Driving_System_State 1;
BA_ "GenSigStartValue" SG_ 947 Driving_System_State 0;
BA_ "GenSigTimeoutValue" SG_ 947 Driving_System_State 0;
BA_ "Remark" SG_ 947 Driving_System_State "";
BA_ "EventCommandSignal" SG_ 947 subStandAlone 0;
BA_ "GatewayedSignals" SG_ 947 subStandAlone 0;
BA_ "GenSigInactiveValue" SG_ 947 subStandAlone 0;
BA_ "GenSigInvalidValue" SG_ 947 subStandAlone 0;
BA_ "GenSigSendType" SG_ 947 subStandAlone 1;
BA_ "GenSigStartValue" SG_ 947 subStandAlone 0;
BA_ "GenSigTimeoutValue" SG_ 947 subStandAlone 0;
BA_ "Remark" SG_ 947 subStandAlone "";
BA_ "EventCommandSignal" SG_ 947 platMode 0;
BA_ "GatewayedSignals" SG_ 947 platMode 0;
BA_ "GenSigInactiveValue" SG_ 947 platMode 0;
BA_ "GenSigInvalidValue" SG_ 947 platMode 0;
BA_ "GenSigSendType" SG_ 947 platMode 1;
BA_ "GenSigStartValue" SG_ 947 platMode 0;
BA_ "GenSigTimeoutValue" SG_ 947 platMode 0;
BA_ "Remark" SG_ 947 platMode "";
BA_ "EventCommandSignal" SG_ 947 OTA_Target_ADS 0;
BA_ "GatewayedSignals" SG_ 947 OTA_Target_ADS 0;
BA_ "GenSigInactiveValue" SG_ 947 OTA_Target_ADS 0;
BA_ "GenSigInvalidValue" SG_ 947 OTA_Target_ADS 0;
BA_ "GenSigSendType" SG_ 947 OTA_Target_ADS 1;
BA_ "GenSigStartValue" SG_ 947 OTA_Target_ADS 0;
BA_ "GenSigTimeoutValue" SG_ 947 OTA_Target_ADS 0;
BA_ "Remark" SG_ 947 OTA_Target_ADS "";
BA_ "EventCommandSignal" SG_ 947 Fault_flg_to_Power_Down 0;
BA_ "GatewayedSignals" SG_ 947 Fault_flg_to_Power_Down 0;
BA_ "GenSigInactiveValue" SG_ 947 Fault_flg_to_Power_Down 0;
BA_ "GenSigInvalidValue" SG_ 947 Fault_flg_to_Power_Down 0;
BA_ "GenSigSendType" SG_ 947 Fault_flg_to_Power_Down 1;
BA_ "GenSigStartValue" SG_ 947 Fault_flg_to_Power_Down 0;
BA_ "GenSigTimeoutValue" SG_ 947 Fault_flg_to_Power_Down 0;
BA_ "Remark" SG_ 947 Fault_flg_to_Power_Down "";
BA_ "EventCommandSignal" SG_ 947 runOnce 0;
BA_ "GatewayedSignals" SG_ 947 runOnce 0;
BA_ "GenSigInactiveValue" SG_ 947 runOnce 0;
BA_ "GenSigInvalidValue" SG_ 947 runOnce 0;
BA_ "GenSigSendType" SG_ 947 runOnce 1;
BA_ "GenSigStartValue" SG_ 947 runOnce 0;
BA_ "GenSigTimeoutValue" SG_ 947 runOnce 0;
BA_ "Remark" SG_ 947 runOnce "";
BA_ "EventCommandSignal" SG_ 947 nmServiceHold 0;
BA_ "GatewayedSignals" SG_ 947 nmServiceHold 0;
BA_ "GenSigInactiveValue" SG_ 947 nmServiceHold 0;
BA_ "GenSigInvalidValue" SG_ 947 nmServiceHold 0;
BA_ "GenSigSendType" SG_ 947 nmServiceHold 1;
BA_ "GenSigStartValue" SG_ 947 nmServiceHold 0;
BA_ "GenSigTimeoutValue" SG_ 947 nmServiceHold 0;
BA_ "Remark" SG_ 947 nmServiceHold "";
BA_ "EventCommandSignal" SG_ 947 nmServiceRelease 0;
BA_ "GatewayedSignals" SG_ 947 nmServiceRelease 0;
BA_ "GenSigInactiveValue" SG_ 947 nmServiceRelease 0;
BA_ "GenSigInvalidValue" SG_ 947 nmServiceRelease 0;
BA_ "GenSigSendType" SG_ 947 nmServiceRelease 1;
BA_ "GenSigStartValue" SG_ 947 nmServiceRelease 0;
BA_ "GenSigTimeoutValue" SG_ 947 nmServiceRelease 0;
BA_ "Remark" SG_ 947 nmServiceRelease "";
BA_ "EventCommandSignal" SG_ 947 lidarsPower 0;
BA_ "GatewayedSignals" SG_ 947 lidarsPower 0;
BA_ "GenSigInactiveValue" SG_ 947 lidarsPower 0;
BA_ "GenSigInvalidValue" SG_ 947 lidarsPower 0;
BA_ "GenSigSendType" SG_ 947 lidarsPower 1;
BA_ "GenSigStartValue" SG_ 947 lidarsPower 0;
BA_ "GenSigTimeoutValue" SG_ 947 lidarsPower 0;
BA_ "Remark" SG_ 947 lidarsPower "";
BA_ "EventCommandSignal" SG_ 374 FAPA_1_CRC 0;
BA_ "GatewayedSignals" SG_ 374 FAPA_1_CRC 0;
BA_ "GenSigInactiveValue" SG_ 374 FAPA_1_CRC 0;
BA_ "GenSigInvalidValue" SG_ 374 FAPA_1_CRC 0;
BA_ "GenSigSendType" SG_ 374 FAPA_1_CRC 1;
BA_ "GenSigStartValue" SG_ 374 FAPA_1_CRC 0;
BA_ "GenSigTimeoutValue" SG_ 374 FAPA_1_CRC 0;
BA_ "Remark" SG_ 374 FAPA_1_CRC "";
BA_ "EventCommandSignal" SG_ 374 FAPA_1_Counter 0;
BA_ "GatewayedSignals" SG_ 374 FAPA_1_Counter 0;
BA_ "GenSigInactiveValue" SG_ 374 FAPA_1_Counter 0;
BA_ "GenSigInvalidValue" SG_ 374 FAPA_1_Counter 0;
BA_ "GenSigSendType" SG_ 374 FAPA_1_Counter 1;
BA_ "GenSigStartValue" SG_ 374 FAPA_1_Counter 0;
BA_ "GenSigTimeoutValue" SG_ 374 FAPA_1_Counter 0;
BA_ "Remark" SG_ 374 FAPA_1_Counter "";
BA_ "EventCommandSignal" SG_ 374 FAPA_ADC_AngReqAvl 0;
BA_ "GatewayedSignals" SG_ 374 FAPA_ADC_AngReqAvl 0;
BA_ "GenSigInactiveValue" SG_ 374 FAPA_ADC_AngReqAvl 0;
BA_ "GenSigInvalidValue" SG_ 374 FAPA_ADC_AngReqAvl 0;
BA_ "GenSigSendType" SG_ 374 FAPA_ADC_AngReqAvl 1;
BA_ "GenSigStartValue" SG_ 374 FAPA_ADC_AngReqAvl 0;
BA_ "GenSigTimeoutValue" SG_ 374 FAPA_ADC_AngReqAvl 0;
BA_ "Remark" SG_ 374 FAPA_ADC_AngReqAvl "";
BA_ "EventCommandSignal" SG_ 374 FAPA_ADC_ActTrqReqVD 0;
BA_ "GatewayedSignals" SG_ 374 FAPA_ADC_ActTrqReqVD 0;
BA_ "GenSigInactiveValue" SG_ 374 FAPA_ADC_ActTrqReqVD 0;
BA_ "GenSigInvalidValue" SG_ 374 FAPA_ADC_ActTrqReqVD 0;
BA_ "GenSigSendType" SG_ 374 FAPA_ADC_ActTrqReqVD 1;
BA_ "GenSigStartValue" SG_ 374 FAPA_ADC_ActTrqReqVD 0;
BA_ "GenSigTimeoutValue" SG_ 374 FAPA_ADC_ActTrqReqVD 0;
BA_ "Remark" SG_ 374 FAPA_ADC_ActTrqReqVD "";
BA_ "EventCommandSignal" SG_ 374 FAPA_ADC_ActTrqReqEnable 0;
BA_ "GatewayedSignals" SG_ 374 FAPA_ADC_ActTrqReqEnable 0;
BA_ "GenSigInactiveValue" SG_ 374 FAPA_ADC_ActTrqReqEnable 0;
BA_ "GenSigInvalidValue" SG_ 374 FAPA_ADC_ActTrqReqEnable 0;
BA_ "GenSigSendType" SG_ 374 FAPA_ADC_ActTrqReqEnable 1;
BA_ "GenSigStartValue" SG_ 374 FAPA_ADC_ActTrqReqEnable 0;
BA_ "GenSigTimeoutValue" SG_ 374 FAPA_ADC_ActTrqReqEnable 0;
BA_ "Remark" SG_ 374 FAPA_ADC_ActTrqReqEnable "";
BA_ "EventCommandSignal" SG_ 374 FAPA_ADC_ActTrqReq 0;
BA_ "GatewayedSignals" SG_ 374 FAPA_ADC_ActTrqReq 0;
BA_ "GenSigInactiveValue" SG_ 374 FAPA_ADC_ActTrqReq 0;
BA_ "GenSigInvalidValue" SG_ 374 FAPA_ADC_ActTrqReq 0;
BA_ "GenSigSendType" SG_ 374 FAPA_ADC_ActTrqReq 1;
BA_ "GenSigStartValue" SG_ 374 FAPA_ADC_ActTrqReq 0;
BA_ "GenSigTimeoutValue" SG_ 374 FAPA_ADC_ActTrqReq 0;
BA_ "Remark" SG_ 374 FAPA_ADC_ActTrqReq "";
BA_ "EventCommandSignal" SG_ 374 FAPA_ADC_TotalRefTorque_A 0;
BA_ "GatewayedSignals" SG_ 374 FAPA_ADC_TotalRefTorque_A 0;
BA_ "GenSigInactiveValue" SG_ 374 FAPA_ADC_TotalRefTorque_A 0;
BA_ "GenSigInvalidValue" SG_ 374 FAPA_ADC_TotalRefTorque_A 0;
BA_ "GenSigSendType" SG_ 374 FAPA_ADC_TotalRefTorque_A 1;
BA_ "GenSigStartValue" SG_ 374 FAPA_ADC_TotalRefTorque_A 0;
BA_ "GenSigTimeoutValue" SG_ 374 FAPA_ADC_TotalRefTorque_A 0;
BA_ "Remark" SG_ 374 FAPA_ADC_TotalRefTorque_A "";
BA_ "EventCommandSignal" SG_ 374 FAPA_ADC_FctSts 0;
BA_ "GatewayedSignals" SG_ 374 FAPA_ADC_FctSts 0;
BA_ "GenSigInactiveValue" SG_ 374 FAPA_ADC_FctSts 0;
BA_ "GenSigInvalidValue" SG_ 374 FAPA_ADC_FctSts 0;
BA_ "GenSigSendType" SG_ 374 FAPA_ADC_FctSts 1;
BA_ "GenSigStartValue" SG_ 374 FAPA_ADC_FctSts 0;
BA_ "GenSigTimeoutValue" SG_ 374 FAPA_ADC_FctSts 0;
BA_ "Remark" SG_ 374 FAPA_ADC_FctSts "";
BA_ "EventCommandSignal" SG_ 374 FAPA_ADC_ElecBrkFnSwitch 0;
BA_ "GatewayedSignals" SG_ 374 FAPA_ADC_ElecBrkFnSwitch 0;
BA_ "GenSigInactiveValue" SG_ 374 FAPA_ADC_ElecBrkFnSwitch 0;
BA_ "GenSigInvalidValue" SG_ 374 FAPA_ADC_ElecBrkFnSwitch 0;
BA_ "GenSigSendType" SG_ 374 FAPA_ADC_ElecBrkFnSwitch 1;
BA_ "GenSigStartValue" SG_ 374 FAPA_ADC_ElecBrkFnSwitch 0;
BA_ "GenSigTimeoutValue" SG_ 374 FAPA_ADC_ElecBrkFnSwitch 0;
BA_ "Remark" SG_ 374 FAPA_ADC_ElecBrkFnSwitch "";
BA_ "EventCommandSignal" SG_ 374 FAPA_ADC_TarGearReqVld 0;
BA_ "GatewayedSignals" SG_ 374 FAPA_ADC_TarGearReqVld 0;
BA_ "GenSigInactiveValue" SG_ 374 FAPA_ADC_TarGearReqVld 0;
BA_ "GenSigInvalidValue" SG_ 374 FAPA_ADC_TarGearReqVld 0;
BA_ "GenSigSendType" SG_ 374 FAPA_ADC_TarGearReqVld 1;
BA_ "GenSigStartValue" SG_ 374 FAPA_ADC_TarGearReqVld 0;
BA_ "GenSigTimeoutValue" SG_ 374 FAPA_ADC_TarGearReqVld 0;
BA_ "Remark" SG_ 374 FAPA_ADC_TarGearReqVld "";
BA_ "EventCommandSignal" SG_ 374 FAPA_ADC_PAAGrarLvlReq 0;
BA_ "GatewayedSignals" SG_ 374 FAPA_ADC_PAAGrarLvlReq 0;
BA_ "GenSigInactiveValue" SG_ 374 FAPA_ADC_PAAGrarLvlReq 0;
BA_ "GenSigInvalidValue" SG_ 374 FAPA_ADC_PAAGrarLvlReq 0;
BA_ "GenSigSendType" SG_ 374 FAPA_ADC_PAAGrarLvlReq 1;
BA_ "GenSigStartValue" SG_ 374 FAPA_ADC_PAAGrarLvlReq 0;
BA_ "GenSigTimeoutValue" SG_ 374 FAPA_ADC_PAAGrarLvlReq 0;
BA_ "Remark" SG_ 374 FAPA_ADC_PAAGrarLvlReq "";
BA_ "EventCommandSignal" SG_ 374 FAPA_ADC_PAAGrarLvlReqEnable 0;
BA_ "GatewayedSignals" SG_ 374 FAPA_ADC_PAAGrarLvlReqEnable 0;
BA_ "GenSigInactiveValue" SG_ 374 FAPA_ADC_PAAGrarLvlReqEnable 0;
BA_ "GenSigInvalidValue" SG_ 374 FAPA_ADC_PAAGrarLvlReqEnable 0;
BA_ "GenSigSendType" SG_ 374 FAPA_ADC_PAAGrarLvlReqEnable 1;
BA_ "GenSigStartValue" SG_ 374 FAPA_ADC_PAAGrarLvlReqEnable 0;
BA_ "GenSigTimeoutValue" SG_ 374 FAPA_ADC_PAAGrarLvlReqEnable 0;
BA_ "Remark" SG_ 374 FAPA_ADC_PAAGrarLvlReqEnable "";
BA_ "EventCommandSignal" SG_ 374 FAPA_ADC_BrkTarTqVld 0;
BA_ "GatewayedSignals" SG_ 374 FAPA_ADC_BrkTarTqVld 0;
BA_ "GenSigInactiveValue" SG_ 374 FAPA_ADC_BrkTarTqVld 0;
BA_ "GenSigInvalidValue" SG_ 374 FAPA_ADC_BrkTarTqVld 0;
BA_ "GenSigSendType" SG_ 374 FAPA_ADC_BrkTarTqVld 1;
BA_ "GenSigStartValue" SG_ 374 FAPA_ADC_BrkTarTqVld 0;
BA_ "GenSigTimeoutValue" SG_ 374 FAPA_ADC_BrkTarTqVld 0;
BA_ "Remark" SG_ 374 FAPA_ADC_BrkTarTqVld "";
BA_ "EventCommandSignal" SG_ 374 FAPA_ADC_BrkTarTqEna 0;
BA_ "GatewayedSignals" SG_ 374 FAPA_ADC_BrkTarTqEna 0;
BA_ "GenSigInactiveValue" SG_ 374 FAPA_ADC_BrkTarTqEna 0;
BA_ "GenSigInvalidValue" SG_ 374 FAPA_ADC_BrkTarTqEna 0;
BA_ "GenSigSendType" SG_ 374 FAPA_ADC_BrkTarTqEna 1;
BA_ "GenSigStartValue" SG_ 374 FAPA_ADC_BrkTarTqEna 0;
BA_ "GenSigTimeoutValue" SG_ 374 FAPA_ADC_BrkTarTqEna 0;
BA_ "Remark" SG_ 374 FAPA_ADC_BrkTarTqEna "";
BA_ "EventCommandSignal" SG_ 374 FAPA_ADC_BrkTarTqMod 0;
BA_ "GatewayedSignals" SG_ 374 FAPA_ADC_BrkTarTqMod 0;
BA_ "GenSigInactiveValue" SG_ 374 FAPA_ADC_BrkTarTqMod 0;
BA_ "GenSigInvalidValue" SG_ 374 FAPA_ADC_BrkTarTqMod 0;
BA_ "GenSigSendType" SG_ 374 FAPA_ADC_BrkTarTqMod 1;
BA_ "GenSigStartValue" SG_ 374 FAPA_ADC_BrkTarTqMod 0;
BA_ "GenSigTimeoutValue" SG_ 374 FAPA_ADC_BrkTarTqMod 0;
BA_ "Remark" SG_ 374 FAPA_ADC_BrkTarTqMod "";
BA_ "EventCommandSignal" SG_ 374 FAPA_ADC_BrkTarTq 0;
BA_ "GatewayedSignals" SG_ 374 FAPA_ADC_BrkTarTq 0;
BA_ "GenSigInactiveValue" SG_ 374 FAPA_ADC_BrkTarTq 0;
BA_ "GenSigInvalidValue" SG_ 374 FAPA_ADC_BrkTarTq 0;
BA_ "GenSigSendType" SG_ 374 FAPA_ADC_BrkTarTq 1;
BA_ "GenSigStartValue" SG_ 374 FAPA_ADC_BrkTarTq 0;
BA_ "GenSigTimeoutValue" SG_ 374 FAPA_ADC_BrkTarTq 0;
BA_ "Remark" SG_ 374 FAPA_ADC_BrkTarTq "";
BA_ "EventCommandSignal" SG_ 374 FAPA_ADC_LongCtrlTypReq 0;
BA_ "GatewayedSignals" SG_ 374 FAPA_ADC_LongCtrlTypReq 0;
BA_ "GenSigInactiveValue" SG_ 374 FAPA_ADC_LongCtrlTypReq 0;
BA_ "GenSigInvalidValue" SG_ 374 FAPA_ADC_LongCtrlTypReq 0;
BA_ "GenSigSendType" SG_ 374 FAPA_ADC_LongCtrlTypReq 1;
BA_ "GenSigStartValue" SG_ 374 FAPA_ADC_LongCtrlTypReq 0;
BA_ "GenSigTimeoutValue" SG_ 374 FAPA_ADC_LongCtrlTypReq 0;
BA_ "Remark" SG_ 374 FAPA_ADC_LongCtrlTypReq "";
BA_ "EventCommandSignal" SG_ 374 FAPA_ADC_BrkHoldReq 0;
BA_ "GatewayedSignals" SG_ 374 FAPA_ADC_BrkHoldReq 0;
BA_ "GenSigInactiveValue" SG_ 374 FAPA_ADC_BrkHoldReq 0;
BA_ "GenSigInvalidValue" SG_ 374 FAPA_ADC_BrkHoldReq 0;
BA_ "GenSigSendType" SG_ 374 FAPA_ADC_BrkHoldReq 1;
BA_ "GenSigStartValue" SG_ 374 FAPA_ADC_BrkHoldReq 0;
BA_ "GenSigTimeoutValue" SG_ 374 FAPA_ADC_BrkHoldReq 0;
BA_ "Remark" SG_ 374 FAPA_ADC_BrkHoldReq "";
BA_ "EventCommandSignal" SG_ 374 FAPA_ADC_DriverPresent 0;
BA_ "GatewayedSignals" SG_ 374 FAPA_ADC_DriverPresent 0;
BA_ "GenSigInactiveValue" SG_ 374 FAPA_ADC_DriverPresent 0;
BA_ "GenSigInvalidValue" SG_ 374 FAPA_ADC_DriverPresent 0;
BA_ "GenSigSendType" SG_ 374 FAPA_ADC_DriverPresent 1;
BA_ "GenSigStartValue" SG_ 374 FAPA_ADC_DriverPresent 0;
BA_ "GenSigTimeoutValue" SG_ 374 FAPA_ADC_DriverPresent 0;
BA_ "Remark" SG_ 374 FAPA_ADC_DriverPresent "";
BA_ "EventCommandSignal" SG_ 374 FAPA_ADC_AngReqSt_A 0;
BA_ "GatewayedSignals" SG_ 374 FAPA_ADC_AngReqSt_A 0;
BA_ "GenSigInactiveValue" SG_ 374 FAPA_ADC_AngReqSt_A 0;
BA_ "GenSigInvalidValue" SG_ 374 FAPA_ADC_AngReqSt_A 0;
BA_ "GenSigSendType" SG_ 374 FAPA_ADC_AngReqSt_A 1;
BA_ "GenSigStartValue" SG_ 374 FAPA_ADC_AngReqSt_A 0;
BA_ "GenSigTimeoutValue" SG_ 374 FAPA_ADC_AngReqSt_A 0;
BA_ "Remark" SG_ 374 FAPA_ADC_AngReqSt_A "";
BA_ "EventCommandSignal" SG_ 374 FAPA_ADC_StrAngleReq_A 0;
BA_ "GatewayedSignals" SG_ 374 FAPA_ADC_StrAngleReq_A 0;
BA_ "GenSigInactiveValue" SG_ 374 FAPA_ADC_StrAngleReq_A 0;
BA_ "GenSigInvalidValue" SG_ 374 FAPA_ADC_StrAngleReq_A 0;
BA_ "GenSigSendType" SG_ 374 FAPA_ADC_StrAngleReq_A 1;
BA_ "GenSigStartValue" SG_ 374 FAPA_ADC_StrAngleReq_A 7800;
BA_ "GenSigTimeoutValue" SG_ 374 FAPA_ADC_StrAngleReq_A 65535;
BA_ "Remark" SG_ 374 FAPA_ADC_StrAngleReq_A "";
BA_ "EventCommandSignal" SG_ 374 FAPA_ADC_SACMotorTorLimExtMax 0;
BA_ "GatewayedSignals" SG_ 374 FAPA_ADC_SACMotorTorLimExtMax 0;
BA_ "GenSigInactiveValue" SG_ 374 FAPA_ADC_SACMotorTorLimExtMax 0;
BA_ "GenSigInvalidValue" SG_ 374 FAPA_ADC_SACMotorTorLimExtMax 0;
BA_ "GenSigSendType" SG_ 374 FAPA_ADC_SACMotorTorLimExtMax 1;
BA_ "GenSigStartValue" SG_ 374 FAPA_ADC_SACMotorTorLimExtMax 254;
BA_ "GenSigTimeoutValue" SG_ 374 FAPA_ADC_SACMotorTorLimExtMax 255;
BA_ "Remark" SG_ 374 FAPA_ADC_SACMotorTorLimExtMax "";
BA_ "EventCommandSignal" SG_ 374 FAPA_ADC_SACMotorTorLimExtMin 0;
BA_ "GatewayedSignals" SG_ 374 FAPA_ADC_SACMotorTorLimExtMin 0;
BA_ "GenSigInactiveValue" SG_ 374 FAPA_ADC_SACMotorTorLimExtMin 0;
BA_ "GenSigInvalidValue" SG_ 374 FAPA_ADC_SACMotorTorLimExtMin 0;
BA_ "GenSigSendType" SG_ 374 FAPA_ADC_SACMotorTorLimExtMin 1;
BA_ "GenSigStartValue" SG_ 374 FAPA_ADC_SACMotorTorLimExtMin 0;
BA_ "GenSigTimeoutValue" SG_ 374 FAPA_ADC_SACMotorTorLimExtMin 255;
BA_ "Remark" SG_ 374 FAPA_ADC_SACMotorTorLimExtMin "";
BA_ "EventCommandSignal" SG_ 374 FAPA_ADC_AngReqFunction 0;
BA_ "GatewayedSignals" SG_ 374 FAPA_ADC_AngReqFunction 0;
BA_ "GenSigInactiveValue" SG_ 374 FAPA_ADC_AngReqFunction 0;
BA_ "GenSigInvalidValue" SG_ 374 FAPA_ADC_AngReqFunction 0;
BA_ "GenSigSendType" SG_ 374 FAPA_ADC_AngReqFunction 1;
BA_ "GenSigStartValue" SG_ 374 FAPA_ADC_AngReqFunction 0;
BA_ "GenSigTimeoutValue" SG_ 374 FAPA_ADC_AngReqFunction 0;
BA_ "Remark" SG_ 374 FAPA_ADC_AngReqFunction "";
BA_ "EventCommandSignal" SG_ 374 FAPA_ADC_EpbModReqVld 0;
BA_ "GatewayedSignals" SG_ 374 FAPA_ADC_EpbModReqVld 0;
BA_ "GenSigInactiveValue" SG_ 374 FAPA_ADC_EpbModReqVld 0;
BA_ "GenSigInvalidValue" SG_ 374 FAPA_ADC_EpbModReqVld 0;
BA_ "GenSigSendType" SG_ 374 FAPA_ADC_EpbModReqVld 1;
BA_ "GenSigStartValue" SG_ 374 FAPA_ADC_EpbModReqVld 0;
BA_ "GenSigTimeoutValue" SG_ 374 FAPA_ADC_EpbModReqVld 0;
BA_ "Remark" SG_ 374 FAPA_ADC_EpbModReqVld "";
BA_ "EventCommandSignal" SG_ 374 FAPA_ADC_RWUEna 0;
BA_ "GatewayedSignals" SG_ 374 FAPA_ADC_RWUEna 0;
BA_ "GenSigInactiveValue" SG_ 374 FAPA_ADC_RWUEna 0;
BA_ "GenSigInvalidValue" SG_ 374 FAPA_ADC_RWUEna 0;
BA_ "GenSigSendType" SG_ 374 FAPA_ADC_RWUEna 1;
BA_ "GenSigStartValue" SG_ 374 FAPA_ADC_RWUEna 0;
BA_ "GenSigTimeoutValue" SG_ 374 FAPA_ADC_RWUEna 0;
BA_ "Remark" SG_ 374 FAPA_ADC_RWUEna "";
BA_ "EventCommandSignal" SG_ 374 FAPA_ADC_RWUVld 0;
BA_ "GatewayedSignals" SG_ 374 FAPA_ADC_RWUVld 0;
BA_ "GenSigInactiveValue" SG_ 374 FAPA_ADC_RWUVld 0;
BA_ "GenSigInvalidValue" SG_ 374 FAPA_ADC_RWUVld 0;
BA_ "GenSigSendType" SG_ 374 FAPA_ADC_RWUVld 1;
BA_ "GenSigStartValue" SG_ 374 FAPA_ADC_RWUVld 0;
BA_ "GenSigTimeoutValue" SG_ 374 FAPA_ADC_RWUVld 0;
BA_ "Remark" SG_ 374 FAPA_ADC_RWUVld "";
BA_ "EventCommandSignal" SG_ 374 FAPA_ADC_PAA2EPBEpbReq 0;
BA_ "GatewayedSignals" SG_ 374 FAPA_ADC_PAA2EPBEpbReq 0;
BA_ "GenSigInactiveValue" SG_ 374 FAPA_ADC_PAA2EPBEpbReq 0;
BA_ "GenSigInvalidValue" SG_ 374 FAPA_ADC_PAA2EPBEpbReq 0;
BA_ "GenSigSendType" SG_ 374 FAPA_ADC_PAA2EPBEpbReq 1;
BA_ "GenSigStartValue" SG_ 374 FAPA_ADC_PAA2EPBEpbReq 0;
BA_ "GenSigTimeoutValue" SG_ 374 FAPA_ADC_PAA2EPBEpbReq 0;
BA_ "Remark" SG_ 374 FAPA_ADC_PAA2EPBEpbReq "";
BA_ "EventCommandSignal" SG_ 374 FAPA_ADC_PAA2EPBEpbReqSt 0;
BA_ "GatewayedSignals" SG_ 374 FAPA_ADC_PAA2EPBEpbReqSt 0;
BA_ "GenSigInactiveValue" SG_ 374 FAPA_ADC_PAA2EPBEpbReqSt 0;
BA_ "GenSigInvalidValue" SG_ 374 FAPA_ADC_PAA2EPBEpbReqSt 0;
BA_ "GenSigSendType" SG_ 374 FAPA_ADC_PAA2EPBEpbReqSt 1;
BA_ "GenSigStartValue" SG_ 374 FAPA_ADC_PAA2EPBEpbReqSt 0;
BA_ "GenSigTimeoutValue" SG_ 374 FAPA_ADC_PAA2EPBEpbReqSt 0;
BA_ "Remark" SG_ 374 FAPA_ADC_PAA2EPBEpbReqSt "";
BA_ "EventCommandSignal" SG_ 374 FAPA_ADC_TurnLightReq 0;
BA_ "GatewayedSignals" SG_ 374 FAPA_ADC_TurnLightReq 0;
BA_ "GenSigInactiveValue" SG_ 374 FAPA_ADC_TurnLightReq 0;
BA_ "GenSigInvalidValue" SG_ 374 FAPA_ADC_TurnLightReq 0;
BA_ "GenSigSendType" SG_ 374 FAPA_ADC_TurnLightReq 1;
BA_ "GenSigStartValue" SG_ 374 FAPA_ADC_TurnLightReq 0;
BA_ "GenSigTimeoutValue" SG_ 374 FAPA_ADC_TurnLightReq 0;
BA_ "Remark" SG_ 374 FAPA_ADC_TurnLightReq "";
BA_ "EventCommandSignal" SG_ 374 FAPA_ADC_CCUReqVD 0;
BA_ "GatewayedSignals" SG_ 374 FAPA_ADC_CCUReqVD 0;
BA_ "GenSigInactiveValue" SG_ 374 FAPA_ADC_CCUReqVD 0;
BA_ "GenSigInvalidValue" SG_ 374 FAPA_ADC_CCUReqVD 0;
BA_ "GenSigSendType" SG_ 374 FAPA_ADC_CCUReqVD 1;
BA_ "GenSigStartValue" SG_ 374 FAPA_ADC_CCUReqVD 0;
BA_ "GenSigTimeoutValue" SG_ 374 FAPA_ADC_CCUReqVD 0;
BA_ "Remark" SG_ 374 FAPA_ADC_CCUReqVD "";
BA_ "EventCommandSignal" SG_ 374 FAPA_ReqIFCForward 0;
BA_ "GatewayedSignals" SG_ 374 FAPA_ReqIFCForward 0;
BA_ "GenSigInactiveValue" SG_ 374 FAPA_ReqIFCForward 0;
BA_ "GenSigInvalidValue" SG_ 374 FAPA_ReqIFCForward 0;
BA_ "GenSigSendType" SG_ 374 FAPA_ReqIFCForward 1;
BA_ "GenSigStartValue" SG_ 374 FAPA_ReqIFCForward 0;
BA_ "GenSigTimeoutValue" SG_ 374 FAPA_ReqIFCForward 0;
BA_ "Remark" SG_ 374 FAPA_ReqIFCForward "";
BA_ "EventCommandSignal" SG_ 374 FAPA_ADC_RearMirrorReq 0;
BA_ "GatewayedSignals" SG_ 374 FAPA_ADC_RearMirrorReq 0;
BA_ "GenSigInactiveValue" SG_ 374 FAPA_ADC_RearMirrorReq 0;
BA_ "GenSigInvalidValue" SG_ 374 FAPA_ADC_RearMirrorReq 0;
BA_ "GenSigSendType" SG_ 374 FAPA_ADC_RearMirrorReq 1;
BA_ "GenSigStartValue" SG_ 374 FAPA_ADC_RearMirrorReq 0;
BA_ "GenSigTimeoutValue" SG_ 374 FAPA_ADC_RearMirrorReq 0;
BA_ "Remark" SG_ 374 FAPA_ADC_RearMirrorReq "";
BA_ "EventCommandSignal" SG_ 374 ADC_LockReq 0;
BA_ "GatewayedSignals" SG_ 374 ADC_LockReq 0;
BA_ "GenSigInactiveValue" SG_ 374 ADC_LockReq 0;
BA_ "GenSigInvalidValue" SG_ 374 ADC_LockReq 0;
BA_ "GenSigSendType" SG_ 374 ADC_LockReq 1;
BA_ "GenSigStartValue" SG_ 374 ADC_LockReq 0;
BA_ "GenSigTimeoutValue" SG_ 374 ADC_LockReq 0;
BA_ "Remark" SG_ 374 ADC_LockReq "";
BA_ "EventCommandSignal" SG_ 374 ADC_HoldLockReq 0;
BA_ "GatewayedSignals" SG_ 374 ADC_HoldLockReq 0;
BA_ "GenSigInactiveValue" SG_ 374 ADC_HoldLockReq 0;
BA_ "GenSigInvalidValue" SG_ 374 ADC_HoldLockReq 0;
BA_ "GenSigSendType" SG_ 374 ADC_HoldLockReq 1;
BA_ "GenSigStartValue" SG_ 374 ADC_HoldLockReq 0;
BA_ "GenSigTimeoutValue" SG_ 374 ADC_HoldLockReq 0;
BA_ "Remark" SG_ 374 ADC_HoldLockReq "";
BA_ "EventCommandSignal" SG_ 374 FAPA_ADC_DrvTarTqMod2EPB 0;
BA_ "GatewayedSignals" SG_ 374 FAPA_ADC_DrvTarTqMod2EPB 0;
BA_ "GenSigInactiveValue" SG_ 374 FAPA_ADC_DrvTarTqMod2EPB 0;
BA_ "GenSigInvalidValue" SG_ 374 FAPA_ADC_DrvTarTqMod2EPB 0;
BA_ "GenSigSendType" SG_ 374 FAPA_ADC_DrvTarTqMod2EPB 1;
BA_ "GenSigStartValue" SG_ 374 FAPA_ADC_DrvTarTqMod2EPB 0;
BA_ "GenSigTimeoutValue" SG_ 374 FAPA_ADC_DrvTarTqMod2EPB 0;
BA_ "Remark" SG_ 374 FAPA_ADC_DrvTarTqMod2EPB "";
BA_ "EventCommandSignal" SG_ 437 IFC_1_CRC 0;
BA_ "GatewayedSignals" SG_ 437 IFC_1_CRC 0;
BA_ "GenSigInactiveValue" SG_ 437 IFC_1_CRC 0;
BA_ "GenSigInvalidValue" SG_ 437 IFC_1_CRC 0;
BA_ "GenSigSendType" SG_ 437 IFC_1_CRC 1;
BA_ "GenSigStartValue" SG_ 437 IFC_1_CRC 0;
BA_ "GenSigTimeoutValue" SG_ 437 IFC_1_CRC 0;
BA_ "Remark" SG_ 437 IFC_1_CRC "";
BA_ "EventCommandSignal" SG_ 437 IFC_1_Counter 0;
BA_ "GatewayedSignals" SG_ 437 IFC_1_Counter 0;
BA_ "GenSigInactiveValue" SG_ 437 IFC_1_Counter 0;
BA_ "GenSigInvalidValue" SG_ 437 IFC_1_Counter 0;
BA_ "GenSigSendType" SG_ 437 IFC_1_Counter 1;
BA_ "GenSigStartValue" SG_ 437 IFC_1_Counter 0;
BA_ "GenSigTimeoutValue" SG_ 437 IFC_1_Counter 0;
BA_ "Remark" SG_ 437 IFC_1_Counter "";
BA_ "EventCommandSignal" SG_ 437 IFC_SysCalibrationSt 0;
BA_ "GatewayedSignals" SG_ 437 IFC_SysCalibrationSt 0;
BA_ "GenSigInactiveValue" SG_ 437 IFC_SysCalibrationSt 0;
BA_ "GenSigInvalidValue" SG_ 437 IFC_SysCalibrationSt 0;
BA_ "GenSigSendType" SG_ 437 IFC_SysCalibrationSt 1;
BA_ "GenSigStartValue" SG_ 437 IFC_SysCalibrationSt 0;
BA_ "GenSigTimeoutValue" SG_ 437 IFC_SysCalibrationSt 0;
BA_ "Remark" SG_ 437 IFC_SysCalibrationSt "";
BA_ "EventCommandSignal" SG_ 437 IFC_CameraBlockageSt 0;
BA_ "GatewayedSignals" SG_ 437 IFC_CameraBlockageSt 0;
BA_ "GenSigInactiveValue" SG_ 437 IFC_CameraBlockageSt 0;
BA_ "GenSigInvalidValue" SG_ 437 IFC_CameraBlockageSt 0;
BA_ "GenSigSendType" SG_ 437 IFC_CameraBlockageSt 1;
BA_ "GenSigStartValue" SG_ 437 IFC_CameraBlockageSt 0;
BA_ "GenSigTimeoutValue" SG_ 437 IFC_CameraBlockageSt 0;
BA_ "Remark" SG_ 437 IFC_CameraBlockageSt "";
BA_ "EventCommandSignal" SG_ 437 IFC_MRMAvailability 0;
BA_ "GatewayedSignals" SG_ 437 IFC_MRMAvailability 0;
BA_ "GenSigInactiveValue" SG_ 437 IFC_MRMAvailability 0;
BA_ "GenSigInvalidValue" SG_ 437 IFC_MRMAvailability 0;
BA_ "GenSigSendType" SG_ 437 IFC_MRMAvailability 1;
BA_ "GenSigStartValue" SG_ 437 IFC_MRMAvailability 0;
BA_ "GenSigTimeoutValue" SG_ 437 IFC_MRMAvailability 0;
BA_ "Remark" SG_ 437 IFC_MRMAvailability "";
BA_ "EventCommandSignal" SG_ 437 IFC_ICMWarnCardSt 0;
BA_ "GatewayedSignals" SG_ 437 IFC_ICMWarnCardSt 0;
BA_ "GenSigInactiveValue" SG_ 437 IFC_ICMWarnCardSt 0;
BA_ "GenSigInvalidValue" SG_ 437 IFC_ICMWarnCardSt 0;
BA_ "GenSigSendType" SG_ 437 IFC_ICMWarnCardSt 1;
BA_ "GenSigStartValue" SG_ 437 IFC_ICMWarnCardSt 0;
BA_ "GenSigTimeoutValue" SG_ 437 IFC_ICMWarnCardSt 0;
BA_ "Remark" SG_ 437 IFC_ICMWarnCardSt "";
BA_ "EventCommandSignal" SG_ 437 IFC_BrakeLightReq 0;
BA_ "GatewayedSignals" SG_ 437 IFC_BrakeLightReq 0;
BA_ "GenSigInactiveValue" SG_ 437 IFC_BrakeLightReq 0;
BA_ "GenSigInvalidValue" SG_ 437 IFC_BrakeLightReq 0;
BA_ "GenSigSendType" SG_ 437 IFC_BrakeLightReq 1;
BA_ "GenSigStartValue" SG_ 437 IFC_BrakeLightReq 0;
BA_ "GenSigTimeoutValue" SG_ 437 IFC_BrakeLightReq 0;
BA_ "Remark" SG_ 437 IFC_BrakeLightReq "";
BA_ "EventCommandSignal" SG_ 437 IFC_LongCtrlModeForBrkSys 0;
BA_ "GatewayedSignals" SG_ 437 IFC_LongCtrlModeForBrkSys 0;
BA_ "GenSigInactiveValue" SG_ 437 IFC_LongCtrlModeForBrkSys 0;
BA_ "GenSigInvalidValue" SG_ 437 IFC_LongCtrlModeForBrkSys 0;
BA_ "GenSigSendType" SG_ 437 IFC_LongCtrlModeForBrkSys 1;
BA_ "GenSigStartValue" SG_ 437 IFC_LongCtrlModeForBrkSys 0;
BA_ "GenSigTimeoutValue" SG_ 437 IFC_LongCtrlModeForBrkSys 0;
BA_ "Remark" SG_ 437 IFC_LongCtrlModeForBrkSys "";
BA_ "EventCommandSignal" SG_ 437 IFC_LongCtrlTargetAx 0;
BA_ "GatewayedSignals" SG_ 437 IFC_LongCtrlTargetAx 0;
BA_ "GenSigInactiveValue" SG_ 437 IFC_LongCtrlTargetAx 0;
BA_ "GenSigInvalidValue" SG_ 437 IFC_LongCtrlTargetAx 0;
BA_ "GenSigSendType" SG_ 437 IFC_LongCtrlTargetAx 1;
BA_ "GenSigStartValue" SG_ 437 IFC_LongCtrlTargetAx 0;
BA_ "GenSigTimeoutValue" SG_ 437 IFC_LongCtrlTargetAx 0;
BA_ "Remark" SG_ 437 IFC_LongCtrlTargetAx "";
BA_ "EventCommandSignal" SG_ 437 IFC_LongCtrlTargetAxReq 0;
BA_ "GatewayedSignals" SG_ 437 IFC_LongCtrlTargetAxReq 0;
BA_ "GenSigInactiveValue" SG_ 437 IFC_LongCtrlTargetAxReq 0;
BA_ "GenSigInvalidValue" SG_ 437 IFC_LongCtrlTargetAxReq 0;
BA_ "GenSigSendType" SG_ 437 IFC_LongCtrlTargetAxReq 1;
BA_ "GenSigStartValue" SG_ 437 IFC_LongCtrlTargetAxReq 0;
BA_ "GenSigTimeoutValue" SG_ 437 IFC_LongCtrlTargetAxReq 0;
BA_ "Remark" SG_ 437 IFC_LongCtrlTargetAxReq "";
BA_ "EventCommandSignal" SG_ 437 IFC_LongCtrlTypReq 0;
BA_ "GatewayedSignals" SG_ 437 IFC_LongCtrlTypReq 0;
BA_ "GenSigInactiveValue" SG_ 437 IFC_LongCtrlTypReq 0;
BA_ "GenSigInvalidValue" SG_ 437 IFC_LongCtrlTypReq 0;
BA_ "GenSigSendType" SG_ 437 IFC_LongCtrlTypReq 1;
BA_ "GenSigStartValue" SG_ 437 IFC_LongCtrlTypReq 0;
BA_ "GenSigTimeoutValue" SG_ 437 IFC_LongCtrlTypReq 0;
BA_ "Remark" SG_ 437 IFC_LongCtrlTypReq "";
BA_ "EventCommandSignal" SG_ 437 IFC_LongCtrlDecToStopReq 0;
BA_ "GatewayedSignals" SG_ 437 IFC_LongCtrlDecToStopReq 0;
BA_ "GenSigInactiveValue" SG_ 437 IFC_LongCtrlDecToStopReq 0;
BA_ "GenSigInvalidValue" SG_ 437 IFC_LongCtrlDecToStopReq 0;
BA_ "GenSigSendType" SG_ 437 IFC_LongCtrlDecToStopReq 1;
BA_ "GenSigStartValue" SG_ 437 IFC_LongCtrlDecToStopReq 0;
BA_ "GenSigTimeoutValue" SG_ 437 IFC_LongCtrlDecToStopReq 0;
BA_ "Remark" SG_ 437 IFC_LongCtrlDecToStopReq "";
BA_ "EventCommandSignal" SG_ 437 IFC_ICMPromptWarn 0;
BA_ "GatewayedSignals" SG_ 437 IFC_ICMPromptWarn 0;
BA_ "GenSigInactiveValue" SG_ 437 IFC_ICMPromptWarn 0;
BA_ "GenSigInvalidValue" SG_ 437 IFC_ICMPromptWarn 0;
BA_ "GenSigSendType" SG_ 437 IFC_ICMPromptWarn 1;
BA_ "GenSigStartValue" SG_ 437 IFC_ICMPromptWarn 0;
BA_ "GenSigTimeoutValue" SG_ 437 IFC_ICMPromptWarn 0;
BA_ "Remark" SG_ 437 IFC_ICMPromptWarn "";
BA_ "EventCommandSignal" SG_ 437 IFC_CCUReqVD 0;
BA_ "GatewayedSignals" SG_ 437 IFC_CCUReqVD 0;
BA_ "GenSigInactiveValue" SG_ 437 IFC_CCUReqVD 0;
BA_ "GenSigInvalidValue" SG_ 437 IFC_CCUReqVD 0;
BA_ "GenSigSendType" SG_ 437 IFC_CCUReqVD 1;
BA_ "GenSigStartValue" SG_ 437 IFC_CCUReqVD 0;
BA_ "GenSigTimeoutValue" SG_ 437 IFC_CCUReqVD 0;
BA_ "Remark" SG_ 437 IFC_CCUReqVD "";
BA_ "EventCommandSignal" SG_ 437 IFC_TurnLightReq 0;
BA_ "GatewayedSignals" SG_ 437 IFC_TurnLightReq 0;
BA_ "GenSigInactiveValue" SG_ 437 IFC_TurnLightReq 0;
BA_ "GenSigInvalidValue" SG_ 437 IFC_TurnLightReq 0;
BA_ "GenSigSendType" SG_ 437 IFC_TurnLightReq 1;
BA_ "GenSigStartValue" SG_ 437 IFC_TurnLightReq 0;
BA_ "GenSigTimeoutValue" SG_ 437 IFC_TurnLightReq 0;
BA_ "Remark" SG_ 437 IFC_TurnLightReq "";
BA_ "EventCommandSignal" SG_ 437 IFC_ActTrqReqEnable 0;
BA_ "GatewayedSignals" SG_ 437 IFC_ActTrqReqEnable 0;
BA_ "GenSigInactiveValue" SG_ 437 IFC_ActTrqReqEnable 0;
BA_ "GenSigInvalidValue" SG_ 437 IFC_ActTrqReqEnable 0;
BA_ "GenSigSendType" SG_ 437 IFC_ActTrqReqEnable 1;
BA_ "GenSigStartValue" SG_ 437 IFC_ActTrqReqEnable 0;
BA_ "GenSigTimeoutValue" SG_ 437 IFC_ActTrqReqEnable 0;
BA_ "Remark" SG_ 437 IFC_ActTrqReqEnable "";
BA_ "EventCommandSignal" SG_ 437 IFC_ActTrqReq 0;
BA_ "GatewayedSignals" SG_ 437 IFC_ActTrqReq 0;
BA_ "GenSigInactiveValue" SG_ 437 IFC_ActTrqReq 0;
BA_ "GenSigInvalidValue" SG_ 437 IFC_ActTrqReq 0;
BA_ "GenSigSendType" SG_ 437 IFC_ActTrqReq 1;
BA_ "GenSigStartValue" SG_ 437 IFC_ActTrqReq 0;
BA_ "GenSigTimeoutValue" SG_ 437 IFC_ActTrqReq 0;
BA_ "Remark" SG_ 437 IFC_ActTrqReq "";
BA_ "EventCommandSignal" SG_ 437 IFC_VLCSt 0;
BA_ "GatewayedSignals" SG_ 437 IFC_VLCSt 0;
BA_ "GenSigInactiveValue" SG_ 437 IFC_VLCSt 0;
BA_ "GenSigInvalidValue" SG_ 437 IFC_VLCSt 0;
BA_ "GenSigSendType" SG_ 437 IFC_VLCSt 1;
BA_ "GenSigStartValue" SG_ 437 IFC_VLCSt 0;
BA_ "GenSigTimeoutValue" SG_ 437 IFC_VLCSt 0;
BA_ "Remark" SG_ 437 IFC_VLCSt "";
BA_ "EventCommandSignal" SG_ 437 IFC_ADCFailSt 0;
BA_ "GatewayedSignals" SG_ 437 IFC_ADCFailSt 0;
BA_ "GenSigInactiveValue" SG_ 437 IFC_ADCFailSt 0;
BA_ "GenSigInvalidValue" SG_ 437 IFC_ADCFailSt 0;
BA_ "GenSigSendType" SG_ 437 IFC_ADCFailSt 1;
BA_ "GenSigStartValue" SG_ 437 IFC_ADCFailSt 0;
BA_ "GenSigTimeoutValue" SG_ 437 IFC_ADCFailSt 0;
BA_ "Remark" SG_ 437 IFC_ADCFailSt "";
BA_ "EventCommandSignal" SG_ 437 IFC_AngReqRdntSt 0;
BA_ "GatewayedSignals" SG_ 437 IFC_AngReqRdntSt 0;
BA_ "GenSigInactiveValue" SG_ 437 IFC_AngReqRdntSt 0;
BA_ "GenSigInvalidValue" SG_ 437 IFC_AngReqRdntSt 0;
BA_ "GenSigSendType" SG_ 437 IFC_AngReqRdntSt 1;
BA_ "GenSigStartValue" SG_ 437 IFC_AngReqRdntSt 0;
BA_ "GenSigTimeoutValue" SG_ 437 IFC_AngReqRdntSt 0;
BA_ "Remark" SG_ 437 IFC_AngReqRdntSt "";
BA_ "EventCommandSignal" SG_ 437 IFC_AngReqSt 0;
BA_ "GatewayedSignals" SG_ 437 IFC_AngReqSt 0;
BA_ "GenSigInactiveValue" SG_ 437 IFC_AngReqSt 0;
BA_ "GenSigInvalidValue" SG_ 437 IFC_AngReqSt 0;
BA_ "GenSigSendType" SG_ 437 IFC_AngReqSt 1;
BA_ "GenSigStartValue" SG_ 437 IFC_AngReqSt 0;
BA_ "GenSigTimeoutValue" SG_ 437 IFC_AngReqSt 0;
BA_ "Remark" SG_ 437 IFC_AngReqSt "";
BA_ "EventCommandSignal" SG_ 437 IFC_StrAngleReq 0;
BA_ "GatewayedSignals" SG_ 437 IFC_StrAngleReq 0;
BA_ "GenSigInactiveValue" SG_ 437 IFC_StrAngleReq 0;
BA_ "EventCommandSignal" SG_ 437 IFC_SACMotorTorLimExtMin 0;
BA_ "GatewayedSignals" SG_ 437 IFC_SACMotorTorLimExtMin 0;
BA_ "GenSigInactiveValue" SG_ 437 IFC_SACMotorTorLimExtMin 0;
BA_ "GenSigInvalidValue" SG_ 437 IFC_SACMotorTorLimExtMin 255;
BA_ "GenSigSendType" SG_ 437 IFC_SACMotorTorLimExtMin 1;
BA_ "GenSigStartValue" SG_ 437 IFC_SACMotorTorLimExtMin 0;
BA_ "GenSigTimeoutValue" SG_ 437 IFC_SACMotorTorLimExtMin 255;
BA_ "Remark" SG_ 437 IFC_SACMotorTorLimExtMin "";
BA_ "EventCommandSignal" SG_ 437 IFC_SACMotorTorLimExtMax 0;
BA_ "GatewayedSignals" SG_ 437 IFC_SACMotorTorLimExtMax 0;
BA_ "GenSigInactiveValue" SG_ 437 IFC_SACMotorTorLimExtMax 0;
BA_ "GenSigInvalidValue" SG_ 437 IFC_SACMotorTorLimExtMax 255;
BA_ "GenSigSendType" SG_ 437 IFC_SACMotorTorLimExtMax 1;
BA_ "GenSigStartValue" SG_ 437 IFC_SACMotorTorLimExtMax 254;
BA_ "GenSigTimeoutValue" SG_ 437 IFC_SACMotorTorLimExtMax 255;
BA_ "Remark" SG_ 437 IFC_SACMotorTorLimExtMax "";
BA_ "EventCommandSignal" SG_ 437 IFC_EcallReq 0;
BA_ "GatewayedSignals" SG_ 437 IFC_EcallReq 0;
BA_ "GenSigInactiveValue" SG_ 437 IFC_EcallReq 0;
BA_ "GenSigInvalidValue" SG_ 437 IFC_EcallReq 0;
BA_ "GenSigSendType" SG_ 437 IFC_EcallReq 1;
BA_ "GenSigStartValue" SG_ 437 IFC_EcallReq 0;
BA_ "GenSigTimeoutValue" SG_ 437 IFC_EcallReq 0;
BA_ "Remark" SG_ 437 IFC_EcallReq "";
BA_ "EventCommandSignal" SG_ 918 UINM_PADS_1_CRC 0;
BA_ "GatewayedSignals" SG_ 918 UINM_PADS_1_CRC 0;
BA_ "GenSigInactiveValue" SG_ 918 UINM_PADS_1_CRC 0;
BA_ "GenSigInvalidValue" SG_ 918 UINM_PADS_1_CRC 0;
BA_ "GenSigSendType" SG_ 918 UINM_PADS_1_CRC 1;
BA_ "GenSigStartValue" SG_ 918 UINM_PADS_1_CRC 0;
BA_ "GenSigTimeoutValue" SG_ 918 UINM_PADS_1_CRC 0;
BA_ "Remark" SG_ 918 UINM_PADS_1_CRC "";
BA_ "EventCommandSignal" SG_ 918 UINM_PADS_1_Counter 0;
BA_ "GatewayedSignals" SG_ 918 UINM_PADS_1_Counter 0;
BA_ "GenSigInactiveValue" SG_ 918 UINM_PADS_1_Counter 0;
BA_ "GenSigInvalidValue" SG_ 918 UINM_PADS_1_Counter 0;
BA_ "GenSigSendType" SG_ 918 UINM_PADS_1_Counter 1;
BA_ "GenSigStartValue" SG_ 918 UINM_PADS_1_Counter 0;
BA_ "GenSigTimeoutValue" SG_ 918 UINM_PADS_1_Counter 0;
BA_ "Remark" SG_ 918 UINM_PADS_1_Counter "";
BA_ "EventCommandSignal" SG_ 918 UINM_PADS_ResponseErr 0;
BA_ "GatewayedSignals" SG_ 918 UINM_PADS_ResponseErr 0;
BA_ "GenSigInactiveValue" SG_ 918 UINM_PADS_ResponseErr 0;
BA_ "GenSigInvalidValue" SG_ 918 UINM_PADS_ResponseErr 0;
BA_ "GenSigSendType" SG_ 918 UINM_PADS_ResponseErr 1;
BA_ "GenSigStartValue" SG_ 918 UINM_PADS_ResponseErr 0;
BA_ "GenSigTimeoutValue" SG_ 918 UINM_PADS_ResponseErr 0;
BA_ "Remark" SG_ 918 UINM_PADS_ResponseErr "";
BA_ "EventCommandSignal" SG_ 918 UINM_PADS_CustomSWSt 0;
BA_ "GatewayedSignals" SG_ 918 UINM_PADS_CustomSWSt 0;
BA_ "GenSigInactiveValue" SG_ 918 UINM_PADS_CustomSWSt 0;
BA_ "GenSigInvalidValue" SG_ 918 UINM_PADS_CustomSWSt 0;
BA_ "GenSigSendType" SG_ 918 UINM_PADS_CustomSWSt 1;
BA_ "GenSigStartValue" SG_ 918 UINM_PADS_CustomSWSt 0;
BA_ "GenSigTimeoutValue" SG_ 918 UINM_PADS_CustomSWSt 0;
BA_ "Remark" SG_ 918 UINM_PADS_CustomSWSt "";
BA_ "EventCommandSignal" SG_ 918 UINM_PADS_CustomSWStVD 0;
BA_ "GatewayedSignals" SG_ 918 UINM_PADS_CustomSWStVD 0;
BA_ "GenSigInactiveValue" SG_ 918 UINM_PADS_CustomSWStVD 0;
BA_ "GenSigInvalidValue" SG_ 918 UINM_PADS_CustomSWStVD 0;
BA_ "GenSigSendType" SG_ 918 UINM_PADS_CustomSWStVD 1;
BA_ "GenSigStartValue" SG_ 918 UINM_PADS_CustomSWStVD 0;
BA_ "GenSigTimeoutValue" SG_ 918 UINM_PADS_CustomSWStVD 0;
BA_ "Remark" SG_ 918 UINM_PADS_CustomSWStVD "";
BA_ "EventCommandSignal" SG_ 918 UINM_PADS_CustomSWstuck 0;
BA_ "GatewayedSignals" SG_ 918 UINM_PADS_CustomSWstuck 0;
BA_ "GenSigInactiveValue" SG_ 918 UINM_PADS_CustomSWstuck 0;
BA_ "GenSigInvalidValue" SG_ 918 UINM_PADS_CustomSWstuck 0;
BA_ "GenSigSendType" SG_ 918 UINM_PADS_CustomSWstuck 1;
BA_ "GenSigStartValue" SG_ 918 UINM_PADS_CustomSWstuck 0;
BA_ "GenSigTimeoutValue" SG_ 918 UINM_PADS_CustomSWstuck 0;
BA_ "Remark" SG_ 918 UINM_PADS_CustomSWstuck "";
BA_ "EventCommandSignal" SG_ 918 UINM_PADS_IDC_PlaySWSt 0;
BA_ "GatewayedSignals" SG_ 918 UINM_PADS_IDC_PlaySWSt 0;
BA_ "GenSigInactiveValue" SG_ 918 UINM_PADS_IDC_PlaySWSt 0;
BA_ "GenSigInvalidValue" SG_ 918 UINM_PADS_IDC_PlaySWSt 0;
BA_ "GenSigSendType" SG_ 918 UINM_PADS_IDC_PlaySWSt 1;
BA_ "GenSigStartValue" SG_ 918 UINM_PADS_IDC_PlaySWSt 0;
BA_ "GenSigTimeoutValue" SG_ 918 UINM_PADS_IDC_PlaySWSt 0;
BA_ "Remark" SG_ 918 UINM_PADS_IDC_PlaySWSt "";
BA_ "EventCommandSignal" SG_ 918 UINM_PADS_IDC_PlaySWStVD 0;
BA_ "GatewayedSignals" SG_ 918 UINM_PADS_IDC_PlaySWStVD 0;
BA_ "GenSigInactiveValue" SG_ 918 UINM_PADS_IDC_PlaySWStVD 0;
BA_ "GenSigInvalidValue" SG_ 918 UINM_PADS_IDC_PlaySWStVD 0;
BA_ "GenSigSendType" SG_ 918 UINM_PADS_IDC_PlaySWStVD 1;
BA_ "GenSigStartValue" SG_ 918 UINM_PADS_IDC_PlaySWStVD 0;
BA_ "GenSigTimeoutValue" SG_ 918 UINM_PADS_IDC_PlaySWStVD 0;
BA_ "Remark" SG_ 918 UINM_PADS_IDC_PlaySWStVD "";
BA_ "EventCommandSignal" SG_ 918 UINM_PADS_CruSetSpeedRollerRotatedDir 0;
BA_ "GatewayedSignals" SG_ 918 UINM_PADS_CruSetSpeedRollerRotatedDir 0;
BA_ "GenSigInactiveValue" SG_ 918 UINM_PADS_CruSetSpeedRollerRotatedDir 0;
BA_ "GenSigInvalidValue" SG_ 918 UINM_PADS_CruSetSpeedRollerRotatedDir 0;
BA_ "GenSigSendType" SG_ 918 UINM_PADS_CruSetSpeedRollerRotatedDir 1;
BA_ "GenSigStartValue" SG_ 918 UINM_PADS_CruSetSpeedRollerRotatedDir 0;
BA_ "GenSigTimeoutValue" SG_ 918 UINM_PADS_CruSetSpeedRollerRotatedDir 0;
BA_ "Remark" SG_ 918 UINM_PADS_CruSetSpeedRollerRotatedDir "";
BA_ "EventCommandSignal" SG_ 918 UINM_PADS_FolDistIncSWSt 0;
BA_ "GatewayedSignals" SG_ 918 UINM_PADS_FolDistIncSWSt 0;
BA_ "GenSigInactiveValue" SG_ 918 UINM_PADS_FolDistIncSWSt 0;
BA_ "GenSigInvalidValue" SG_ 918 UINM_PADS_FolDistIncSWSt 0;
BA_ "GenSigSendType" SG_ 918 UINM_PADS_FolDistIncSWSt 1;
BA_ "GenSigStartValue" SG_ 918 UINM_PADS_FolDistIncSWSt 0;
BA_ "GenSigTimeoutValue" SG_ 918 UINM_PADS_FolDistIncSWSt 0;
BA_ "Remark" SG_ 918 UINM_PADS_FolDistIncSWSt "";
BA_ "EventCommandSignal" SG_ 918 UINM_PADS_CruSetSpeedRollerSt 0;
BA_ "GatewayedSignals" SG_ 918 UINM_PADS_CruSetSpeedRollerSt 0;
BA_ "GenSigInactiveValue" SG_ 918 UINM_PADS_CruSetSpeedRollerSt 0;
BA_ "GenSigInvalidValue" SG_ 918 UINM_PADS_CruSetSpeedRollerSt 0;
BA_ "GenSigSendType" SG_ 918 UINM_PADS_CruSetSpeedRollerSt 1;
BA_ "GenSigStartValue" SG_ 918 UINM_PADS_CruSetSpeedRollerSt 0;
BA_ "GenSigTimeoutValue" SG_ 918 UINM_PADS_CruSetSpeedRollerSt 0;
BA_ "Remark" SG_ 918 UINM_PADS_CruSetSpeedRollerSt "";
BA_ "EventCommandSignal" SG_ 918 UINM_PADS_FolDistIncSWStVD 0;
BA_ "GatewayedSignals" SG_ 918 UINM_PADS_FolDistIncSWStVD 0;
BA_ "GenSigInactiveValue" SG_ 918 UINM_PADS_FolDistIncSWStVD 0;
BA_ "GenSigInvalidValue" SG_ 918 UINM_PADS_FolDistIncSWStVD 0;
BA_ "GenSigSendType" SG_ 918 UINM_PADS_FolDistIncSWStVD 1;
BA_ "GenSigStartValue" SG_ 918 UINM_PADS_FolDistIncSWStVD 0;
BA_ "GenSigTimeoutValue" SG_ 918 UINM_PADS_FolDistIncSWStVD 0;
BA_ "Remark" SG_ 918 UINM_PADS_FolDistIncSWStVD "";
BA_ "EventCommandSignal" SG_ 918 UINM_PADS_FolDistIncSWStuckSt 0;
BA_ "GatewayedSignals" SG_ 918 UINM_PADS_FolDistIncSWStuckSt 0;
BA_ "GenSigInactiveValue" SG_ 918 UINM_PADS_FolDistIncSWStuckSt 0;
BA_ "GenSigInvalidValue" SG_ 918 UINM_PADS_FolDistIncSWStuckSt 0;
BA_ "GenSigSendType" SG_ 918 UINM_PADS_FolDistIncSWStuckSt 1;
BA_ "GenSigStartValue" SG_ 918 UINM_PADS_FolDistIncSWStuckSt 0;
BA_ "GenSigTimeoutValue" SG_ 918 UINM_PADS_FolDistIncSWStuckSt 0;
BA_ "Remark" SG_ 918 UINM_PADS_FolDistIncSWStuckSt "";
BA_ "EventCommandSignal" SG_ 918 UINM_PADS_FolDistDecSWStVD 0;
BA_ "GatewayedSignals" SG_ 918 UINM_PADS_FolDistDecSWStVD 0;
BA_ "GenSigInactiveValue" SG_ 918 UINM_PADS_FolDistDecSWStVD 0;
BA_ "GenSigInvalidValue" SG_ 918 UINM_PADS_FolDistDecSWStVD 0;
BA_ "GenSigSendType" SG_ 918 UINM_PADS_FolDistDecSWStVD 1;
BA_ "GenSigStartValue" SG_ 918 UINM_PADS_FolDistDecSWStVD 0;
BA_ "GenSigTimeoutValue" SG_ 918 UINM_PADS_FolDistDecSWStVD 0;
BA_ "Remark" SG_ 918 UINM_PADS_FolDistDecSWStVD "";
BA_ "EventCommandSignal" SG_ 918 UINM_PADS_FolDistDecSWStuckSt 0;
BA_ "GatewayedSignals" SG_ 918 UINM_PADS_FolDistDecSWStuckSt 0;
BA_ "GenSigInactiveValue" SG_ 918 UINM_PADS_FolDistDecSWStuckSt 0;
BA_ "GenSigInvalidValue" SG_ 918 UINM_PADS_FolDistDecSWStuckSt 0;
BA_ "GenSigSendType" SG_ 918 UINM_PADS_FolDistDecSWStuckSt 1;
BA_ "GenSigStartValue" SG_ 918 UINM_PADS_FolDistDecSWStuckSt 0;
BA_ "GenSigTimeoutValue" SG_ 918 UINM_PADS_FolDistDecSWStuckSt 0;
BA_ "Remark" SG_ 918 UINM_PADS_FolDistDecSWStuckSt "";
BA_ "EventCommandSignal" SG_ 918 UINM_PADS_OKSWSt 0;
BA_ "GatewayedSignals" SG_ 918 UINM_PADS_OKSWSt 0;
BA_ "GenSigInactiveValue" SG_ 918 UINM_PADS_OKSWSt 0;
BA_ "GenSigInvalidValue" SG_ 918 UINM_PADS_OKSWSt 0;
BA_ "GenSigSendType" SG_ 918 UINM_PADS_OKSWSt 1;
BA_ "GenSigStartValue" SG_ 918 UINM_PADS_OKSWSt 0;
BA_ "GenSigTimeoutValue" SG_ 918 UINM_PADS_OKSWSt 0;
BA_ "Remark" SG_ 918 UINM_PADS_OKSWSt "";
BA_ "EventCommandSignal" SG_ 918 UINM_PADS_OKSWStVD 0;
BA_ "GatewayedSignals" SG_ 918 UINM_PADS_OKSWStVD 0;
BA_ "GenSigInactiveValue" SG_ 918 UINM_PADS_OKSWStVD 0;
BA_ "GenSigInvalidValue" SG_ 918 UINM_PADS_OKSWStVD 0;
BA_ "GenSigSendType" SG_ 918 UINM_PADS_OKSWStVD 1;
BA_ "GenSigStartValue" SG_ 918 UINM_PADS_OKSWStVD 0;
BA_ "GenSigTimeoutValue" SG_ 918 UINM_PADS_OKSWStVD 0;
BA_ "Remark" SG_ 918 UINM_PADS_OKSWStVD "";
BA_ "EventCommandSignal" SG_ 918 UINM_PADS_OKSWStuckSt 0;
BA_ "GatewayedSignals" SG_ 918 UINM_PADS_OKSWStuckSt 0;
BA_ "GenSigInactiveValue" SG_ 918 UINM_PADS_OKSWStuckSt 0;
BA_ "GenSigInvalidValue" SG_ 918 UINM_PADS_OKSWStuckSt 0;
BA_ "GenSigSendType" SG_ 918 UINM_PADS_OKSWStuckSt 1;
BA_ "GenSigStartValue" SG_ 918 UINM_PADS_OKSWStuckSt 0;
BA_ "GenSigTimeoutValue" SG_ 918 UINM_PADS_OKSWStuckSt 0;
BA_ "Remark" SG_ 918 UINM_PADS_OKSWStuckSt "";
BA_ "EventCommandSignal" SG_ 918 UINM_PADS_CruSetSpeedRollerVD 0;
BA_ "GatewayedSignals" SG_ 918 UINM_PADS_CruSetSpeedRollerVD 0;
BA_ "GenSigInactiveValue" SG_ 918 UINM_PADS_CruSetSpeedRollerVD 0;
BA_ "GenSigInvalidValue" SG_ 918 UINM_PADS_CruSetSpeedRollerVD 0;
BA_ "GenSigSendType" SG_ 918 UINM_PADS_CruSetSpeedRollerVD 1;
BA_ "GenSigStartValue" SG_ 918 UINM_PADS_CruSetSpeedRollerVD 0;
BA_ "GenSigTimeoutValue" SG_ 918 UINM_PADS_CruSetSpeedRollerVD 0;
BA_ "Remark" SG_ 918 UINM_PADS_CruSetSpeedRollerVD "";
BA_ "EventCommandSignal" SG_ 918 UINM_PADS_FolDistDecSWSt 0;
BA_ "GatewayedSignals" SG_ 918 UINM_PADS_FolDistDecSWSt 0;
BA_ "GenSigInactiveValue" SG_ 918 UINM_PADS_FolDistDecSWSt 0;
BA_ "GenSigInvalidValue" SG_ 918 UINM_PADS_FolDistDecSWSt 0;
BA_ "GenSigSendType" SG_ 918 UINM_PADS_FolDistDecSWSt 1;
BA_ "GenSigStartValue" SG_ 918 UINM_PADS_FolDistDecSWSt 0;
BA_ "GenSigTimeoutValue" SG_ 918 UINM_PADS_FolDistDecSWSt 0;
BA_ "Remark" SG_ 918 UINM_PADS_FolDistDecSWSt "";
BA_ "EventCommandSignal" SG_ 918 UINM_PADS_CruSWSt 0;
BA_ "GatewayedSignals" SG_ 918 UINM_PADS_CruSWSt 0;
BA_ "GenSigInactiveValue" SG_ 918 UINM_PADS_CruSWSt 0;
BA_ "GenSigInvalidValue" SG_ 918 UINM_PADS_CruSWSt 0;
BA_ "GenSigSendType" SG_ 918 UINM_PADS_CruSWSt 1;
BA_ "GenSigStartValue" SG_ 918 UINM_PADS_CruSWSt 0;
BA_ "GenSigTimeoutValue" SG_ 918 UINM_PADS_CruSWSt 0;
BA_ "Remark" SG_ 918 UINM_PADS_CruSWSt "";
BA_ "EventCommandSignal" SG_ 918 UINM_PADS_CruSWStVD 0;
BA_ "GatewayedSignals" SG_ 918 UINM_PADS_CruSWStVD 0;
BA_ "GenSigInactiveValue" SG_ 918 UINM_PADS_CruSWStVD 0;
BA_ "GenSigInvalidValue" SG_ 918 UINM_PADS_CruSWStVD 0;
BA_ "GenSigSendType" SG_ 918 UINM_PADS_CruSWStVD 1;
BA_ "GenSigStartValue" SG_ 918 UINM_PADS_CruSWStVD 0;
BA_ "GenSigTimeoutValue" SG_ 918 UINM_PADS_CruSWStVD 0;
BA_ "Remark" SG_ 918 UINM_PADS_CruSWStVD "";
BA_ "EventCommandSignal" SG_ 918 UINM_PADS_CruSWStuckSt 0;
BA_ "GatewayedSignals" SG_ 918 UINM_PADS_CruSWStuckSt 0;
BA_ "GenSigInactiveValue" SG_ 918 UINM_PADS_CruSWStuckSt 0;
BA_ "GenSigInvalidValue" SG_ 918 UINM_PADS_CruSWStuckSt 0;
BA_ "GenSigSendType" SG_ 918 UINM_PADS_CruSWStuckSt 1;
BA_ "GenSigStartValue" SG_ 918 UINM_PADS_CruSWStuckSt 0;
BA_ "GenSigTimeoutValue" SG_ 918 UINM_PADS_CruSWStuckSt 0;
BA_ "Remark" SG_ 918 UINM_PADS_CruSWStuckSt "";
BA_ "EventCommandSignal" SG_ 918 UINM_PADS_CruSpeedDecSWSt 0;
BA_ "GatewayedSignals" SG_ 918 UINM_PADS_CruSpeedDecSWSt 0;
BA_ "GenSigInactiveValue" SG_ 918 UINM_PADS_CruSpeedDecSWSt 0;
BA_ "GenSigInvalidValue" SG_ 918 UINM_PADS_CruSpeedDecSWSt 0;
BA_ "GenSigSendType" SG_ 918 UINM_PADS_CruSpeedDecSWSt 1;
BA_ "GenSigStartValue" SG_ 918 UINM_PADS_CruSpeedDecSWSt 0;
BA_ "GenSigTimeoutValue" SG_ 918 UINM_PADS_CruSpeedDecSWSt 0;
BA_ "Remark" SG_ 918 UINM_PADS_CruSpeedDecSWSt "";
BA_ "EventCommandSignal" SG_ 918 UINM_PADS_CruSpeedDecSWStVD 0;
BA_ "GatewayedSignals" SG_ 918 UINM_PADS_CruSpeedDecSWStVD 0;
BA_ "GenSigInactiveValue" SG_ 918 UINM_PADS_CruSpeedDecSWStVD 0;
BA_ "GenSigInvalidValue" SG_ 918 UINM_PADS_CruSpeedDecSWStVD 0;
BA_ "GenSigSendType" SG_ 918 UINM_PADS_CruSpeedDecSWStVD 1;
BA_ "GenSigStartValue" SG_ 918 UINM_PADS_CruSpeedDecSWStVD 0;
BA_ "GenSigTimeoutValue" SG_ 918 UINM_PADS_CruSpeedDecSWStVD 0;
BA_ "Remark" SG_ 918 UINM_PADS_CruSpeedDecSWStVD "";
BA_ "EventCommandSignal" SG_ 918 UINM_PADS_CruSpeedDecSWStuckSt 0;
BA_ "GatewayedSignals" SG_ 918 UINM_PADS_CruSpeedDecSWStuckSt 0;
BA_ "GenSigInactiveValue" SG_ 918 UINM_PADS_CruSpeedDecSWStuckSt 0;
BA_ "GenSigInvalidValue" SG_ 918 UINM_PADS_CruSpeedDecSWStuckSt 0;
BA_ "GenSigSendType" SG_ 918 UINM_PADS_CruSpeedDecSWStuckSt 1;
BA_ "GenSigStartValue" SG_ 918 UINM_PADS_CruSpeedDecSWStuckSt 0;
BA_ "GenSigTimeoutValue" SG_ 918 UINM_PADS_CruSpeedDecSWStuckSt 0;
BA_ "Remark" SG_ 918 UINM_PADS_CruSpeedDecSWStuckSt "";
BA_ "EventCommandSignal" SG_ 918 UINM_PADS_CruResumeSpeedIncSWSt 0;
BA_ "GatewayedSignals" SG_ 918 UINM_PADS_CruResumeSpeedIncSWSt 0;
BA_ "GenSigInactiveValue" SG_ 918 UINM_PADS_CruResumeSpeedIncSWSt 0;
BA_ "GenSigInvalidValue" SG_ 918 UINM_PADS_CruResumeSpeedIncSWSt 0;
BA_ "GenSigSendType" SG_ 918 UINM_PADS_CruResumeSpeedIncSWSt 1;
BA_ "GenSigStartValue" SG_ 918 UINM_PADS_CruResumeSpeedIncSWSt 0;
BA_ "GenSigTimeoutValue" SG_ 918 UINM_PADS_CruResumeSpeedIncSWSt 0;
BA_ "Remark" SG_ 918 UINM_PADS_CruResumeSpeedIncSWSt "";
BA_ "EventCommandSignal" SG_ 918 UINM_PADS_CruResumeSpeedIncSWStVD 0;
BA_ "GatewayedSignals" SG_ 918 UINM_PADS_CruResumeSpeedIncSWStVD 0;
BA_ "GenSigInactiveValue" SG_ 918 UINM_PADS_CruResumeSpeedIncSWStVD 0;
BA_ "GenSigInvalidValue" SG_ 918 UINM_PADS_CruResumeSpeedIncSWStVD 0;
BA_ "GenSigSendType" SG_ 918 UINM_PADS_CruResumeSpeedIncSWStVD 1;
BA_ "GenSigStartValue" SG_ 918 UINM_PADS_CruResumeSpeedIncSWStVD 0;
BA_ "GenSigTimeoutValue" SG_ 918 UINM_PADS_CruResumeSpeedIncSWStVD 0;
BA_ "Remark" SG_ 918 UINM_PADS_CruResumeSpeedIncSWStVD "";
BA_ "EventCommandSignal" SG_ 918 UINM_PADS_CruResumeSpeedIncSWStuckSt 0;
BA_ "GatewayedSignals" SG_ 918 UINM_PADS_CruResumeSpeedIncSWStuckSt 0;
BA_ "GenSigInactiveValue" SG_ 918 UINM_PADS_CruResumeSpeedIncSWStuckSt 0;
BA_ "GenSigInvalidValue" SG_ 918 UINM_PADS_CruResumeSpeedIncSWStuckSt 0;
BA_ "GenSigSendType" SG_ 918 UINM_PADS_CruResumeSpeedIncSWStuckSt 1;
BA_ "GenSigStartValue" SG_ 918 UINM_PADS_CruResumeSpeedIncSWStuckSt 0;
BA_ "GenSigTimeoutValue" SG_ 918 UINM_PADS_CruResumeSpeedIncSWStuckSt 0;
BA_ "Remark" SG_ 918 UINM_PADS_CruResumeSpeedIncSWStuckSt "";
BA_ "EventCommandSignal" SG_ 918 UINM_PADS_CruTJAICASWSt 0;
BA_ "GatewayedSignals" SG_ 918 UINM_PADS_CruTJAICASWSt 0;
BA_ "GenSigInactiveValue" SG_ 918 UINM_PADS_CruTJAICASWSt 0;
BA_ "GenSigInvalidValue" SG_ 918 UINM_PADS_CruTJAICASWSt 0;
BA_ "GenSigSendType" SG_ 918 UINM_PADS_CruTJAICASWSt 1;
BA_ "GenSigStartValue" SG_ 918 UINM_PADS_CruTJAICASWSt 0;
BA_ "GenSigTimeoutValue" SG_ 918 UINM_PADS_CruTJAICASWSt 0;
BA_ "Remark" SG_ 918 UINM_PADS_CruTJAICASWSt "";
BA_ "EventCommandSignal" SG_ 918 UINM_PADS_CruTJAICASWStVD 0;
BA_ "GatewayedSignals" SG_ 918 UINM_PADS_CruTJAICASWStVD 0;
BA_ "GenSigInactiveValue" SG_ 918 UINM_PADS_CruTJAICASWStVD 0;
BA_ "GenSigInvalidValue" SG_ 918 UINM_PADS_CruTJAICASWStVD 0;
BA_ "GenSigSendType" SG_ 918 UINM_PADS_CruTJAICASWStVD 1;
BA_ "GenSigStartValue" SG_ 918 UINM_PADS_CruTJAICASWStVD 0;
BA_ "GenSigTimeoutValue" SG_ 918 UINM_PADS_CruTJAICASWStVD 0;
BA_ "Remark" SG_ 918 UINM_PADS_CruTJAICASWStVD "";
BA_ "EventCommandSignal" SG_ 918 UINM_PADS_CruTJAICASWStuckSt 0;
BA_ "GatewayedSignals" SG_ 918 UINM_PADS_CruTJAICASWStuckSt 0;
BA_ "GenSigInactiveValue" SG_ 918 UINM_PADS_CruTJAICASWStuckSt 0;
BA_ "GenSigInvalidValue" SG_ 918 UINM_PADS_CruTJAICASWStuckSt 0;
BA_ "GenSigSendType" SG_ 918 UINM_PADS_CruTJAICASWStuckSt 1;
BA_ "GenSigStartValue" SG_ 918 UINM_PADS_CruTJAICASWStuckSt 0;
BA_ "GenSigTimeoutValue" SG_ 918 UINM_PADS_CruTJAICASWStuckSt 0;
BA_ "Remark" SG_ 918 UINM_PADS_CruTJAICASWStuckSt "";
BA_ "EventCommandSignal" SG_ 918 UINM_PADS_Custom2SWSt 0;
BA_ "GatewayedSignals" SG_ 918 UINM_PADS_Custom2SWSt 0;
BA_ "GenSigInactiveValue" SG_ 918 UINM_PADS_Custom2SWSt 0;
BA_ "GenSigInvalidValue" SG_ 918 UINM_PADS_Custom2SWSt 0;
BA_ "GenSigSendType" SG_ 918 UINM_PADS_Custom2SWSt 1;
BA_ "GenSigStartValue" SG_ 918 UINM_PADS_Custom2SWSt 0;
BA_ "GenSigTimeoutValue" SG_ 918 UINM_PADS_Custom2SWSt 0;
BA_ "Remark" SG_ 918 UINM_PADS_Custom2SWSt "";
BA_ "EventCommandSignal" SG_ 918 UINM_PADS_Custom2SWStVD 0;
BA_ "GatewayedSignals" SG_ 918 UINM_PADS_Custom2SWStVD 0;
BA_ "GenSigInactiveValue" SG_ 918 UINM_PADS_Custom2SWStVD 0;
BA_ "GenSigInvalidValue" SG_ 918 UINM_PADS_Custom2SWStVD 0;
BA_ "GenSigSendType" SG_ 918 UINM_PADS_Custom2SWStVD 1;
BA_ "GenSigStartValue" SG_ 918 UINM_PADS_Custom2SWStVD 0;
BA_ "GenSigTimeoutValue" SG_ 918 UINM_PADS_Custom2SWStVD 0;
BA_ "Remark" SG_ 918 UINM_PADS_Custom2SWStVD "";
BA_ "EventCommandSignal" SG_ 918 UINM_PADS_Custom2SWStuckSt 0;
BA_ "GatewayedSignals" SG_ 918 UINM_PADS_Custom2SWStuckSt 0;
BA_ "GenSigInactiveValue" SG_ 918 UINM_PADS_Custom2SWStuckSt 0;
BA_ "GenSigInvalidValue" SG_ 918 UINM_PADS_Custom2SWStuckSt 0;
BA_ "GenSigSendType" SG_ 918 UINM_PADS_Custom2SWStuckSt 1;
BA_ "GenSigStartValue" SG_ 918 UINM_PADS_Custom2SWStuckSt 0;
BA_ "GenSigTimeoutValue" SG_ 918 UINM_PADS_Custom2SWStuckSt 0;
BA_ "Remark" SG_ 918 UINM_PADS_Custom2SWStuckSt "";
BA_ "EventCommandSignal" SG_ 918 UINM_PADS_ACCSWSt 0;
BA_ "GatewayedSignals" SG_ 918 UINM_PADS_ACCSWSt 0;
BA_ "GenSigInactiveValue" SG_ 918 UINM_PADS_ACCSWSt 0;
BA_ "GenSigInvalidValue" SG_ 918 UINM_PADS_ACCSWSt 0;
BA_ "GenSigSendType" SG_ 918 UINM_PADS_ACCSWSt 1;
BA_ "GenSigStartValue" SG_ 918 UINM_PADS_ACCSWSt 0;
BA_ "GenSigTimeoutValue" SG_ 918 UINM_PADS_ACCSWSt 0;
BA_ "Remark" SG_ 918 UINM_PADS_ACCSWSt "";
BA_ "EventCommandSignal" SG_ 918 UINM_PADS_VoltageFaultSt 0;
BA_ "GatewayedSignals" SG_ 918 UINM_PADS_VoltageFaultSt 0;
BA_ "GenSigInactiveValue" SG_ 918 UINM_PADS_VoltageFaultSt 0;
BA_ "GenSigInvalidValue" SG_ 918 UINM_PADS_VoltageFaultSt 0;
BA_ "GenSigSendType" SG_ 918 UINM_PADS_VoltageFaultSt 1;
BA_ "GenSigStartValue" SG_ 918 UINM_PADS_VoltageFaultSt 0;
BA_ "GenSigTimeoutValue" SG_ 918 UINM_PADS_VoltageFaultSt 0;
BA_ "Remark" SG_ 918 UINM_PADS_VoltageFaultSt "";
BA_ "EventCommandSignal" SG_ 1078 ETC_DismountSt 1;
BA_ "GatewayedSignals" SG_ 1078 ETC_DismountSt 0;
BA_ "GenSigInactiveValue" SG_ 1078 ETC_DismountSt 0;
BA_ "GenSigInvalidValue" SG_ 1078 ETC_DismountSt 0;
BA_ "GenSigSendType" SG_ 1078 ETC_DismountSt 0;
BA_ "GenSigStartValue" SG_ 1078 ETC_DismountSt 0;
BA_ "GenSigTimeoutValue" SG_ 1078 ETC_DismountSt 0;
BA_ "Remark" SG_ 1078 ETC_DismountSt "";
BA_ "EventCommandSignal" SG_ 1078 ETC_SelfcheckSt 1;
BA_ "GatewayedSignals" SG_ 1078 ETC_SelfcheckSt 0;
BA_ "GenSigInactiveValue" SG_ 1078 ETC_SelfcheckSt 0;
BA_ "GenSigInvalidValue" SG_ 1078 ETC_SelfcheckSt 0;
BA_ "GenSigSendType" SG_ 1078 ETC_SelfcheckSt 0;
BA_ "GenSigStartValue" SG_ 1078 ETC_SelfcheckSt 0;
BA_ "GenSigTimeoutValue" SG_ 1078 ETC_SelfcheckSt 0;
BA_ "Remark" SG_ 1078 ETC_SelfcheckSt "";
BA_ "EventCommandSignal" SG_ 1078 ETC_GateProperty 1;
BA_ "GatewayedSignals" SG_ 1078 ETC_GateProperty 0;
BA_ "GenSigInactiveValue" SG_ 1078 ETC_GateProperty 0;
BA_ "GenSigInvalidValue" SG_ 1078 ETC_GateProperty 0;
BA_ "GenSigSendType" SG_ 1078 ETC_GateProperty 0;
BA_ "GenSigStartValue" SG_ 1078 ETC_GateProperty 0;
BA_ "GenSigTimeoutValue" SG_ 1078 ETC_GateProperty 0;
BA_ "Remark" SG_ 1078 ETC_GateProperty "";
BA_ "EventCommandSignal" SG_ 1078 ETC_TradeType 1;
BA_ "GatewayedSignals" SG_ 1078 ETC_TradeType 0;
BA_ "GenSigInactiveValue" SG_ 1078 ETC_TradeType 0;
BA_ "GenSigInvalidValue" SG_ 1078 ETC_TradeType 0;
BA_ "GenSigSendType" SG_ 1078 ETC_TradeType 0;
BA_ "GenSigStartValue" SG_ 1078 ETC_TradeType 1;
BA_ "GenSigTimeoutValue" SG_ 1078 ETC_TradeType 0;
BA_ "Remark" SG_ 1078 ETC_TradeType "";
BA_ "EventCommandSignal" SG_ 1078 ETC_SystemSt 1;
BA_ "GatewayedSignals" SG_ 1078 ETC_SystemSt 0;
BA_ "GenSigInactiveValue" SG_ 1078 ETC_SystemSt 0;
BA_ "GenSigInvalidValue" SG_ 1078 ETC_SystemSt 0;
BA_ "GenSigSendType" SG_ 1078 ETC_SystemSt 0;
BA_ "GenSigStartValue" SG_ 1078 ETC_SystemSt 0;
BA_ "GenSigTimeoutValue" SG_ 1078 ETC_SystemSt 0;
BA_ "Remark" SG_ 1078 ETC_SystemSt "";
BA_ "EventCommandSignal" SG_ 1078 ETC_SysCfgst 1;
BA_ "GatewayedSignals" SG_ 1078 ETC_SysCfgst 0;
BA_ "GenSigInactiveValue" SG_ 1078 ETC_SysCfgst 0;
BA_ "GenSigInvalidValue" SG_ 1078 ETC_SysCfgst 0;
BA_ "GenSigSendType" SG_ 1078 ETC_SysCfgst 0;
BA_ "GenSigStartValue" SG_ 1078 ETC_SysCfgst 1;
BA_ "GenSigTimeoutValue" SG_ 1078 ETC_SysCfgst 0;
BA_ "Remark" SG_ 1078 ETC_SysCfgst "";
BA_ "EventCommandSignal" SG_ 1078 ETC_ICMDisplayCfgst 1;
BA_ "GatewayedSignals" SG_ 1078 ETC_ICMDisplayCfgst 0;
BA_ "GenSigInactiveValue" SG_ 1078 ETC_ICMDisplayCfgst 0;
BA_ "GenSigInvalidValue" SG_ 1078 ETC_ICMDisplayCfgst 0;
BA_ "GenSigSendType" SG_ 1078 ETC_ICMDisplayCfgst 0;
BA_ "GenSigStartValue" SG_ 1078 ETC_ICMDisplayCfgst 1;
BA_ "GenSigTimeoutValue" SG_ 1078 ETC_ICMDisplayCfgst 0;
BA_ "Remark" SG_ 1078 ETC_ICMDisplayCfgst "";
BA_ "EventCommandSignal" SG_ 1078 ETC_BLEenableCfgst 1;
BA_ "GatewayedSignals" SG_ 1078 ETC_BLEenableCfgst 0;
BA_ "GenSigInactiveValue" SG_ 1078 ETC_BLEenableCfgst 0;
BA_ "GenSigInvalidValue" SG_ 1078 ETC_BLEenableCfgst 0;
BA_ "GenSigSendType" SG_ 1078 ETC_BLEenableCfgst 0;
BA_ "GenSigStartValue" SG_ 1078 ETC_BLEenableCfgst 1;
BA_ "GenSigTimeoutValue" SG_ 1078 ETC_BLEenableCfgst 0;
BA_ "Remark" SG_ 1078 ETC_BLEenableCfgst "";
BA_ "EventCommandSignal" SG_ 1078 ETC_ActivSt 1;
BA_ "GatewayedSignals" SG_ 1078 ETC_ActivSt 0;
BA_ "GenSigInactiveValue" SG_ 1078 ETC_ActivSt 0;
BA_ "GenSigInvalidValue" SG_ 1078 ETC_ActivSt 0;
BA_ "GenSigSendType" SG_ 1078 ETC_ActivSt 0;
BA_ "GenSigStartValue" SG_ 1078 ETC_ActivSt 1;
BA_ "GenSigTimeoutValue" SG_ 1078 ETC_ActivSt 0;
BA_ "Remark" SG_ 1078 ETC_ActivSt "";
BA_ "EventCommandSignal" SG_ 1078 ETC_TradeInfo 1;
BA_ "GatewayedSignals" SG_ 1078 ETC_TradeInfo 0;
BA_ "GenSigInactiveValue" SG_ 1078 ETC_TradeInfo 0;
BA_ "GenSigInvalidValue" SG_ 1078 ETC_TradeInfo -1;
BA_ "GenSigSendType" SG_ 1078 ETC_TradeInfo 0;
BA_ "GenSigStartValue" SG_ 1078 ETC_TradeInfo 0;
BA_ "GenSigTimeoutValue" SG_ 1078 ETC_TradeInfo 0;
BA_ "Remark" SG_ 1078 ETC_TradeInfo "";
BA_ "EventCommandSignal" SG_ 348 CCU_SecSynCounter 1;
BA_ "GatewayedSignals" SG_ 348 CCU_SecSynCounter 0;
BA_ "GenSigInactiveValue" SG_ 348 CCU_SecSynCounter 0;
BA_ "GenSigInvalidValue" SG_ 348 CCU_SecSynCounter 0;
BA_ "GenSigSendType" SG_ 348 CCU_SecSynCounter 0;
BA_ "GenSigStartValue" SG_ 348 CCU_SecSynCounter 0;
BA_ "GenSigTimeoutValue" SG_ 348 CCU_SecSynCounter 0;
BA_ "Remark" SG_ 348 CCU_SecSynCounter "";
BA_ "EventCommandSignal" SG_ 348 CCU_SecSynResetCounter 1;
BA_ "GatewayedSignals" SG_ 348 CCU_SecSynResetCounter 0;
BA_ "GenSigInactiveValue" SG_ 348 CCU_SecSynResetCounter 0;
BA_ "GenSigInvalidValue" SG_ 348 CCU_SecSynResetCounter 0;
BA_ "GenSigSendType" SG_ 348 CCU_SecSynResetCounter 0;
BA_ "GenSigStartValue" SG_ 348 CCU_SecSynResetCounter 0;
BA_ "GenSigTimeoutValue" SG_ 348 CCU_SecSynResetCounter 0;
BA_ "Remark" SG_ 348 CCU_SecSynResetCounter "";
BA_ "EventCommandSignal" SG_ 348 CCU_SecSynMAC_Check 1;
BA_ "GatewayedSignals" SG_ 348 CCU_SecSynMAC_Check 0;
BA_ "GenSigInactiveValue" SG_ 348 CCU_SecSynMAC_Check 0;
BA_ "GenSigInvalidValue" SG_ 348 CCU_SecSynMAC_Check 0;
BA_ "GenSigSendType" SG_ 348 CCU_SecSynMAC_Check 0;
BA_ "GenSigStartValue" SG_ 348 CCU_SecSynMAC_Check 0;
BA_ "GenSigTimeoutValue" SG_ 348 CCU_SecSynMAC_Check 0;
BA_ "Remark" SG_ 348 CCU_SecSynMAC_Check "";
BA_ "EventCommandSignal" SG_ 170 ADC_SecReq 1;
BA_ "GatewayedSignals" SG_ 170 ADC_SecReq 0;
BA_ "GenSigInactiveValue" SG_ 170 ADC_SecReq 0;
BA_ "GenSigInvalidValue" SG_ 170 ADC_SecReq 0;
BA_ "GenSigSendType" SG_ 170 ADC_SecReq 0;
BA_ "GenSigStartValue" SG_ 170 ADC_SecReq 17;
BA_ "GenSigTimeoutValue" SG_ 170 ADC_SecReq 0;
BA_ "Remark" SG_ 170 ADC_SecReq "";
BA_ "EventCommandSignal" SG_ 343 POD_DSMObstDetcnFL 1;
BA_ "GatewayedSignals" SG_ 343 POD_DSMObstDetcnFL 0;
BA_ "GenSigInactiveValue" SG_ 343 POD_DSMObstDetcnFL 0;
BA_ "GenSigInvalidValue" SG_ 343 POD_DSMObstDetcnFL 0;
BA_ "GenSigSendType" SG_ 343 POD_DSMObstDetcnFL 0;
BA_ "GenSigStartValue" SG_ 343 POD_DSMObstDetcnFL 0;
BA_ "GenSigTimeoutValue" SG_ 343 POD_DSMObstDetcnFL 0;
BA_ "Remark" SG_ 343 POD_DSMObstDetcnFL "ADC需求视觉融合";
BA_ "EventCommandSignal" SG_ 343 POD_DSMObstDetcnFR 1;
BA_ "GatewayedSignals" SG_ 343 POD_DSMObstDetcnFR 0;
BA_ "GenSigInactiveValue" SG_ 343 POD_DSMObstDetcnFR 0;
BA_ "GenSigInvalidValue" SG_ 343 POD_DSMObstDetcnFR 0;
BA_ "GenSigSendType" SG_ 343 POD_DSMObstDetcnFR 0;
BA_ "GenSigStartValue" SG_ 343 POD_DSMObstDetcnFR 0;
BA_ "GenSigTimeoutValue" SG_ 343 POD_DSMObstDetcnFR 0;
BA_ "Remark" SG_ 343 POD_DSMObstDetcnFR "ADC需求视觉融合";
BA_ "EventCommandSignal" SG_ 343 POD_DSMObstDetcnRL 1;
BA_ "GatewayedSignals" SG_ 343 POD_DSMObstDetcnRL 0;
BA_ "GenSigInactiveValue" SG_ 343 POD_DSMObstDetcnRL 0;
BA_ "GenSigInvalidValue" SG_ 343 POD_DSMObstDetcnRL 0;
BA_ "GenSigSendType" SG_ 343 POD_DSMObstDetcnRL 0;
BA_ "GenSigStartValue" SG_ 343 POD_DSMObstDetcnRL 0;
BA_ "GenSigTimeoutValue" SG_ 343 POD_DSMObstDetcnRL 0;
BA_ "Remark" SG_ 343 POD_DSMObstDetcnRL "ADC需求视觉融合";
BA_ "EventCommandSignal" SG_ 343 POD_DSMObstDetcnRR 1;
BA_ "GatewayedSignals" SG_ 343 POD_DSMObstDetcnRR 0;
BA_ "GenSigInactiveValue" SG_ 343 POD_DSMObstDetcnRR 0;
BA_ "GenSigInvalidValue" SG_ 343 POD_DSMObstDetcnRR 0;
BA_ "GenSigSendType" SG_ 343 POD_DSMObstDetcnRR 0;
BA_ "GenSigStartValue" SG_ 343 POD_DSMObstDetcnRR 0;
BA_ "GenSigTimeoutValue" SG_ 343 POD_DSMObstDetcnRR 0;
BA_ "Remark" SG_ 343 POD_DSMObstDetcnRR "ADC需求视觉融合";
BA_ "EventCommandSignal" SG_ 1024 SYNC_FC_Type 0;
BA_ "GatewayedSignals" SG_ 1024 SYNC_FC_Type 0;
BA_ "GenSigInactiveValue" SG_ 1024 SYNC_FC_Type 0;
BA_ "GenSigInvalidValue" SG_ 1024 SYNC_FC_Type 0;
BA_ "GenSigSendType" SG_ 1024 SYNC_FC_Type 1;
BA_ "GenSigStartValue" SG_ 1024 SYNC_FC_Type 0;
BA_ "GenSigTimeoutValue" SG_ 1024 SYNC_FC_Type 0;
BA_ "Remark" SG_ 1024 SYNC_FC_Type "";
BA_ "EventCommandSignal" SG_ 1024 SYNC_FC_CRC 0;
BA_ "GatewayedSignals" SG_ 1024 SYNC_FC_CRC 0;
BA_ "GenSigInactiveValue" SG_ 1024 SYNC_FC_CRC 0;
BA_ "GenSigInvalidValue" SG_ 1024 SYNC_FC_CRC 0;
BA_ "GenSigSendType" SG_ 1024 SYNC_FC_CRC 1;
BA_ "GenSigStartValue" SG_ 1024 SYNC_FC_CRC 0;
BA_ "GenSigTimeoutValue" SG_ 1024 SYNC_FC_CRC 0;
BA_ "Remark" SG_ 1024 SYNC_FC_CRC "";
BA_ "EventCommandSignal" SG_ 1024 SYNC_FC_Sequencecnt 0;
BA_ "GatewayedSignals" SG_ 1024 SYNC_FC_Sequencecnt 0;
BA_ "GenSigInactiveValue" SG_ 1024 SYNC_FC_Sequencecnt 0;
BA_ "GenSigInvalidValue" SG_ 1024 SYNC_FC_Sequencecnt 0;
BA_ "GenSigSendType" SG_ 1024 SYNC_FC_Sequencecnt 1;
BA_ "GenSigStartValue" SG_ 1024 SYNC_FC_Sequencecnt 0;
BA_ "GenSigTimeoutValue" SG_ 1024 SYNC_FC_Sequencecnt 0;
BA_ "Remark" SG_ 1024 SYNC_FC_Sequencecnt "";
BA_ "EventCommandSignal" SG_ 1024 SYNC_FC_TimeDomain 0;
BA_ "GatewayedSignals" SG_ 1024 SYNC_FC_TimeDomain 0;
BA_ "GenSigInactiveValue" SG_ 1024 SYNC_FC_TimeDomain 0;
BA_ "GenSigInvalidValue" SG_ 1024 SYNC_FC_TimeDomain 0;
BA_ "GenSigSendType" SG_ 1024 SYNC_FC_TimeDomain 1;
BA_ "GenSigStartValue" SG_ 1024 SYNC_FC_TimeDomain 0;
BA_ "GenSigTimeoutValue" SG_ 1024 SYNC_FC_TimeDomain 0;
BA_ "Remark" SG_ 1024 SYNC_FC_TimeDomain "";
BA_ "EventCommandSignal" SG_ 1024 SYNC_FC_OVS 0;
BA_ "GatewayedSignals" SG_ 1024 SYNC_FC_OVS 0;
BA_ "GenSigInactiveValue" SG_ 1024 SYNC_FC_OVS 0;
BA_ "GenSigInvalidValue" SG_ 1024 SYNC_FC_OVS 0;
BA_ "GenSigSendType" SG_ 1024 SYNC_FC_OVS 1;
BA_ "GenSigStartValue" SG_ 1024 SYNC_FC_OVS 0;
BA_ "GenSigTimeoutValue" SG_ 1024 SYNC_FC_OVS 0;
BA_ "Remark" SG_ 1024 SYNC_FC_OVS "";
BA_ "EventCommandSignal" SG_ 1024 SYNC_FC_SGW 0;
BA_ "GatewayedSignals" SG_ 1024 SYNC_FC_SGW 0;
BA_ "GenSigInactiveValue" SG_ 1024 SYNC_FC_SGW 0;
BA_ "GenSigInvalidValue" SG_ 1024 SYNC_FC_SGW 0;
BA_ "GenSigSendType" SG_ 1024 SYNC_FC_SGW 1;
BA_ "GenSigStartValue" SG_ 1024 SYNC_FC_SGW 0;
BA_ "GenSigTimeoutValue" SG_ 1024 SYNC_FC_SGW 0;
BA_ "Remark" SG_ 1024 SYNC_FC_SGW "";
BA_ "EventCommandSignal" SG_ 1024 SYNC_FC_Reserved 0;
BA_ "GatewayedSignals" SG_ 1024 SYNC_FC_Reserved 0;
BA_ "GenSigInactiveValue" SG_ 1024 SYNC_FC_Reserved 0;
BA_ "GenSigInvalidValue" SG_ 1024 SYNC_FC_Reserved 0;
BA_ "GenSigSendType" SG_ 1024 SYNC_FC_Reserved 1;
BA_ "GenSigStartValue" SG_ 1024 SYNC_FC_Reserved 0;
BA_ "GenSigTimeoutValue" SG_ 1024 SYNC_FC_Reserved 0;
BA_ "Remark" SG_ 1024 SYNC_FC_Reserved "";
BA_ "EventCommandSignal" SG_ 1024 SYNC_FC_SyncTime 0;
BA_ "GatewayedSignals" SG_ 1024 SYNC_FC_SyncTime 0;
BA_ "GenSigInactiveValue" SG_ 1024 SYNC_FC_SyncTime 0;
BA_ "GenSigInvalidValue" SG_ 1024 SYNC_FC_SyncTime 0;
BA_ "GenSigSendType" SG_ 1024 SYNC_FC_SyncTime 1;
BA_ "GenSigStartValue" SG_ 1024 SYNC_FC_SyncTime 0;
BA_ "GenSigTimeoutValue" SG_ 1024 SYNC_FC_SyncTime 0;
BA_ "Remark" SG_ 1024 SYNC_FC_SyncTime "";
VAL_ 667 ADC_LlnMrkingDispSt 0 "No display" 1 "tracking" 2 "intervening" 3 "warning"  ;
VAL_ 667 ADC_LLnMrking_Type 0 "No display" 1 "dashed" 2 "solid" 3 "Fishbone deceleration line（dashed）" 4 "Fishbone deceleration line（solid）" 5 "road edge" 6 "curb" 7 "Cone barrel" 8 "Plastic fence" 9 "barrier" 10 "parking cars" 11 "not used" 12 "not used" 13 "not used" 14 "not used" 15 "not used"  ;
VAL_ 667 ADC_RlnMrkingDispSt 0 "No display" 1 "tracking" 2 "intervening" 3 "warning"  ;
VAL_ 667 ADC_RLnMrking_Type 0 "No display" 1 "dashed" 2 "solid" 3 "Fishbone deceleration line（dashed）" 4 "Fishbone deceleration line（solid）" 5 "road edge" 6 "curb" 7 "Cone barrel" 8 "Plastic fence" 9 "barrier" 10 "parking cars" 11 "not used" 12 "not used" 13 "not used" 14 "not used" 15 "not used"  ;
VAL_ 667 ADC_AdjLlnMrkingDispSt 0 "No display" 1 "display"  ;
VAL_ 667 ADC_AdjLLnMrking_Type 0 "No display" 1 "dashed" 2 "solid" 3 "Fishbone deceleration line（dashed）" 4 "Fishbone deceleration line（solid）" 5 "road edge" 6 "curb" 7 "Cone barrel" 8 "Plastic fence" 9 "barrier" 10 "parking cars" 11 "not used" 12 "not used" 13 "not used" 14 "not used" 15 "not used"  ;
VAL_ 667 ADC_AdjRlnMrkingDispSt 0 "No display" 1 "display"  ;
VAL_ 667 ADC_AdjRLnMrking_Type 0 "No display" 1 "dashed" 2 "solid" 3 "Fishbone deceleration line（dashed）" 4 "Fishbone deceleration line（solid）" 5 "road edge" 6 "curb" 7 "Cone barrel" 8 "Plastic fence" 9 "barrier" 10 "parking cars" 11 "not used" 12 "not used" 13 "not used" 14 "not used" 15 "not used"  ;
VAL_ 947 ADC_LowBeamReq 0 "No Request" 1 "turn on" 2 "turn off"  ;
VAL_ 947 ADC_IHBC_HighBeamReq 0 "No Request" 1 "Request"  ;
VAL_ 947 ADC_FlashReq 0 "No Request" 1 "turn on" 2 "turn off"  ;
VAL_ 947 ADC_PositionLampReq 0 "No Request" 1 "turn on" 2 "turn off"  ;
VAL_ 947 ADC_HVACCtrlReq 0 "No Requset" 1 "Requset Open"  ;
VAL_ 947 ADC_FFogLightReq 0 "No Request" 1 "turn on" 2 "turn off"  ;
VAL_ 947 ADC_RFogLightReq 0 "No Request" 1 "turn on" 2 "turn off"  ;
VAL_ 947 ADC_HornReq 0 "No Request" 1 "Continuous On 1" 2 "Continuous On 2" 3 "Off" 4 "Remind" 5 "Alarm"  ;
VAL_ 947 ADC_FWiperReq 0 "No Request" 1 "MIST" 2 "Continuous slow" 3 "Continuous fast" 4 "turn off Wiper" 5 "Auto Control"  ;
VAL_ 947 ADC_RWiperReq 0 "No Request" 1 "MIST" 2 "Continuous slow" 3 "Continuous fast" 4 "turn?off?Wiper"  ;
VAL_ 947 ADC_FWaterSprayReq 0 "No Request" 1 "On" 2 "Off"  ;
VAL_ 947 ADC_RWaterSprayReq 0 "No Request" 1 "On" 2 "Off"  ;
VAL_ 947 ADC_CCUReqVD 0 "not valid" 1 "valid"  ;
VAL_ 947 ADC_WindowOpenReq 0 "No request" 1 "Request open all windows"  ;
VAL_ 947 ADC_WindowCloseReq 0 "No request" 1 "Request Close all windows"  ;
VAL_ 947 ADC_PLGMOpenReq 0 "No request" 1 "Request"  ;
VAL_ 947 ADC_PLGMCloseReq 0 "No request" 1 "Request"  ;
VAL_ 947 ADC_FDemistReq 0 "No Request" 1 "On" 2 "Off"  ;
VAL_ 947 ADC_RDemistReq 0 "No Request" 1 "On" 2 "Off"  ;
VAL_ 947 ADC_ThmPostRun 0 "TMS is not required to respond to ADC cooling flow request" 1 "TMS is required to respind to ADC cooling flow request"  ;
VAL_ 947 ADC_DriverFaceWindReq 0 "No Request" 1 "On" 2 "Off"  ;
VAL_ 947 ADC_EcallReq 0 "Not Request" 1 "Request"  ;
VAL_ 947 ADC_FlowReq 0 "0      L/min" 1 "0.25 L/min" 2 "0.5   L/min" 3 "0.75 L/min" 4 "1      L/min" 5 "1.25 L/min" 6 "1.5   L/min" 7 "1.75 L/min" 8 "2      L/min" 9 "2.25 L/min" 10 "2.5   L/min" 11 "2.75 L/min" 12 "3      L/min" 13 "3.25 L/min" 14 "3.5   L/min" 15 "3.75  L/min" 16 "4      L/min"  ;
VAL_ 947 ADC_DriverSeatBeltPretightenReq 0 "Not Request" 1 "Request"  ;
VAL_ 947 ADC_LockReq 0 "No Request" 1 "Lock" 2 "Unlock" 3 "LockandArm" 4 "UnlockandDisarm" 5 "Reserved" 6 "Reserved" 7 "Reserved"  ;
VAL_ 947 ADC_HoldLockReq 0 "No Request" 1 "HoldLock" 2 "HoldUnlock" 3 "HoldShield"  ;
VAL_ 947 ADC_RearMirrorReq 0 "No?Request" 1 "Unfold" 2 "Fold" 3 "Reserved"  ;
VAL_ 947 ADC_HoldRearMirrorReq 0 "No?Request" 1 "Hold Unfold" 2 "Hold Fold" 3 "Reserved"  ;
VAL_ 947 ADC_ADSLightReq 0 "No request" 1 "Blue continue" 2 "Off" 3 "Reserved" 4 "Reserved" 5 "Reserved" 6 "Reserved" 7 "Reserved"  ;
VAL_ 947 ADC_ReqChargPortCapOpen 0 "No Request" 1 "Request Open"  ;
VAL_ 947 ADC_ReqChargeDiscont 0 "No Request" 1 "Request Disconnected"  ;
VAL_ 947 ADC_DriverSeatBeltVibrWarnReq 0 "No Request" 1 "Mode 1" 2 "Mode 2" 3 "Mode 3" 4 "Reserved" 5 "Reserved" 6 "Reserved" 7 "Reserved"  ;
VAL_ 947 ADC_FrtWindshildHeatReq 0 "No Request" 1 "On" 2 "Off" 3 "reserve"  ;
VAL_ 947 ADC_BeamSwReq 0 "No request" 1 "Auto_mode" 2 "Position_light (reserve)" 3 "Low_beam (reserve)"  ;
VAL_ 947 IFC_SysCalibrationSt 0 "Calibration Success" 1 "Calibration In Process" 2 "Calibration Failed" 3 "Not used"  ;
VAL_ 947 ADC_ADBIHBCEnableReq 0 "No Request" 1 "Turn on" 2 "Reserved" 3 "Reserved"  ;
VAL_ 947 ADC_RearLeftChildSaftyLockReq 0 "No Request" 1 "Lock" 2 "Unlock"  ;
VAL_ 947 ADC_RearRightChildSaftyLockReq 0 "No Request" 1 "Lock" 2 "Unlock"  ;
VAL_ 947 ADC_LowPowerReq_A 0 "Not Request" 1 "Low Power"  ;
VAL_ 947 ADC_LowPowerReqVD_A 0 "Not valid" 1 "Valid"  ;
VAL_ 947 ADC_MachineStatus 0 "default" 1 "Modechanging" 2 "Active Mode" 3 "PartialActive Mode" 7 "Invalid"  ;
VAL_ 947 ADC_LowPowerFailReason 0 "Default" 1 "ADS Function Active" 2 "Machine is not available" 3 "OTA"  ;
VAL_ 947 ADC_ChgPortControlReq 0 "No Request" 1 "Close" 2 "Open" 3 "Reserved"  ;
VAL_ 947 ADC_ChgPortHoldControlReq 0 "No Request" 1 "HoldClose" 2 "HoldOpen" 3 "HoldShield"  ;
VAL_ 947 ADC_LightbarReq 0 "No request;" 1 "White;" 2 "Blue;" 3 "Orange;" 4 "Red;" 5 "Effect_L2;" 6 "Reserved;" 7 "Reserved;" 8 "Reserved;" 9 "Reserved;" 10 "Reserved;" 11 "Reserved;" 12 "Reserved;" 13 "Reserved;" 14 "Reserved;" 15 "Invalid;"  ;
VAL_ 947 ADC_ChargHoldReq 0 "No Request" 1 "HoldStart" 2 "HoldStop" 3 "HoldShield"  ;
VAL_ 947 ADC_ChargReq 0 "No Request" 1 "Start" 2 "Stop" 3 "Reserved"  ;
VAL_ 947 ADC_ChargGunHoldReq 0 "No Request" 1 "HoldClose" 2 "HoldOpen" 3 "HoldShield"  ;
VAL_ 947 ADC_ChargGunReq 0 "No Request" 1 "Close" 2 "Open" 3 "Reserved"  ;
VAL_ 947 ADC_InteractLightReq 0 "norequest" 1 "Mode1" 2 "Mode2" 3 "Mode3" 4 "Mode4" 5 "Mode5" 6 "Mode6" 7 "Mode7" 8 "Mode8" 9 "Mode9" 10 "Mode10" 11 "Mode11" 12 "Mode12" 13 "Mode13" 14 "Mode14" 15 "Mode15" 16 "Mode16" 17 "Mode17" 18 "Mode18" 19 "Mode19" 20 "Mode20" 21 "Mode21" 22 "reserved" 23 "reserved" 24 "reserved" 25 "reserved" 26 "reserved" 27 "reserved" 28 "reserved" 29 "reserved" 30 "reserved" 31 "reserved"  ;
VAL_ 947 ADCState 0 "default" 1 "SM_WORKING" 2 "SM_UPGRADE" 3 "SM_STANDALONE" 4 "SM_RESET" 5 "SM_STANDBY" 6 "SM_SHUTDOWN" 7 "SM_OFF"  ;
VAL_ 947 ADCtargetState 0 "default" 1 "SM_WORKING" 2 "SM_UPGRADE" 3 "SM_STANDALONE" 4 "SM_RESET" 5 "SM_STANDBY" 6 "SM_SHUTDOWN" 7 "SM_OFF"  ;
VAL_ 947 Parking_System_State 0 "DPT_INACTIVE" 1 "DPT_ACTIVE"  ;
VAL_ 947 Driving_System_State 0 "DPT_INACTIVE" 1 "DPT_ACTIVE"  ;
VAL_ 947 subStandAlone 0 "SM_STANDBY" 1 "SM_SHUTDOWN"  ;
VAL_ 947 OTA_Target_ADS 0 "False" 1 "True"  ;
VAL_ 947 Fault_flg_to_Power_Down 0 "no fault" 1 "Fault and have to power down"  ;
VAL_ 947 runOnce 0 "call" 1 "no call"  ;
VAL_ 947 nmServiceHold 0 "no call" 1 "call"  ;
VAL_ 947 nmServiceRelease 0 "no call" 1 "call"  ;
VAL_ 947 lidarsPower 0 "no call" 1 "pull up" 2 "pull low" 3 "reserved"  ;
VAL_ 374 FAPA_ADC_AngReqAvl 0 "Not available" 1 "Available"  ;
VAL_ 374 FAPA_ADC_ActTrqReqVD 0 "invalid" 1 "valid"  ;
VAL_ 374 FAPA_ADC_ActTrqReqEnable 0 "Disable" 1 "Enable"  ;
VAL_ 374 FAPA_ADC_FctSts 0 "Off" 1 "On"  ;
VAL_ 374 FAPA_ADC_ElecBrkFnSwitch 0 "ON" 1 "OFF"  ;
VAL_ 374 FAPA_ADC_TarGearReqVld 0 "Invalid" 1 "Valid"  ;
VAL_ 374 FAPA_ADC_PAAGrarLvlReq 0 "No Request" 1 "Park" 2 "Reversed" 3 "Neutral" 4 "Drive" 5 "Reversed" 6 "Reversed" 7 "Reversed"  ;
VAL_ 374 FAPA_ADC_PAAGrarLvlReqEnable 0 "No request" 1 "Gear shift request"  ;
VAL_ 374 FAPA_ADC_BrkTarTqVld 0 "Invalid" 1 "Valid"  ;
VAL_ 374 FAPA_ADC_BrkTarTqEna 0 "disable" 1 "enable"  ;
VAL_ 374 FAPA_ADC_BrkTarTqMod 0 "no request" 1 "Cruise function" 2 "Parking function" 3 "Reserved"  ;
VAL_ 374 FAPA_ADC_LongCtrlTypReq 0 "Comfort Mode" 1 "Emergency Mode"  ;
VAL_ 374 FAPA_ADC_BrkHoldReq 0 "No request" 1 "Not active" 2 "Active" 3 "Reserved"  ;
VAL_ 374 FAPA_ADC_DriverPresent 0 "Undefined" 1 "Off" 2 "On" 3 "Failure"  ;
VAL_ 374 FAPA_ADC_AngReqSt_A 0 "Inhibited" 1 "Ready" 2 "Active" 3 "Failed"  ;
VAL_ 374 FAPA_ADC_AngReqFunction 0 "No request" 1 "Request by LKAS" 2 "Request by PAS" 3 "Reserved"  ;
VAL_ 374 FAPA_ADC_EpbModReqVld 0 "Invalid" 1 "Valid"  ;
VAL_ 374 FAPA_ADC_RWUEna 0 "disable" 1 "enable"  ;
VAL_ 374 FAPA_ADC_RWUVld 0 "Invalid" 1 "Valid"  ;
VAL_ 374 FAPA_ADC_PAA2EPBEpbReq 0 "None" 1 "ReleaseReq" 2 "ApplyReq"  ;
VAL_ 374 FAPA_ADC_PAA2EPBEpbReqSt 0 "No request" 1 "Request"  ;
VAL_ 374 FAPA_ADC_TurnLightReq 0 "No Request" 1 "turn off" 2 "turn on left turn lamp" 3 "turn on right turn lamp" 4 "turn on Hazard Lamp" 5 "turn on RCW Hazard Lamp(4HZ)"  ;
VAL_ 374 FAPA_ADC_CCUReqVD 0 "not valid" 1 "valid"  ;
VAL_ 374 FAPA_ReqIFCForward 0 "No Request" 1 "Request"  ;
VAL_ 374 FAPA_ADC_RearMirrorReq 0 "No?Request" 1 "Unfold" 2 "Fold" 3 "Reserved"  ;
VAL_ 374 ADC_LockReq 0 "No Request" 1 "Lock" 2 "Unlock" 3 "LockandArm" 4 "UnlockandDisarm" 5 "Reserved" 6 "Reserved" 7 "Reserved"  ;
VAL_ 374 ADC_HoldLockReq 0 "No Request" 1 "HoldLock" 2 "HoldUnlock" 3 "HoldShield"  ;
VAL_ 374 FAPA_ADC_DrvTarTqMod2EPB 0 "Override mode" 1 "Inhibit mode" 2 "reserved" 3 "reserved"  ;
VAL_ 437 IFC_SysCalibrationSt 0 "Calibration Success" 1 "Calibration In Process" 2 "Calibration Failed" 3 "Not used"  ;
VAL_ 437 IFC_CameraBlockageSt 0 "Not blocked" 1 "Blocked"  ;
VAL_ 437 IFC_MRMAvailability 0 "Not available" 1 "Available"  ;
VAL_ 437 IFC_ICMWarnCardSt 0 "No Request" 1 "TOR Request" 2 "SafeStopping" 3 "StafeStopped"  ;
VAL_ 437 IFC_BrakeLightReq 0 "No Request" 1 "turn on" 2 "turn off" 3 "not used"  ;
VAL_ 437 IFC_LongCtrlModeForBrkSys 0 "Off mode" 1 "L2++ Active"  ;
VAL_ 437 IFC_LongCtrlTargetAxReq 0 "No request" 1 "Request"  ;
VAL_ 437 IFC_LongCtrlTypReq 0 "Comfort Mode" 1 "Emergency Mode"  ;
VAL_ 437 IFC_LongCtrlDecToStopReq 0 "No request" 1 "Request"  ;
VAL_ 437 IFC_ICMPromptWarn 0 "No Request" 1 "TOR Request" 2 "SafeStopping" 3 "StafeStopped"  ;
VAL_ 437 IFC_CCUReqVD 0 "not valid" 1 "valid"  ;
VAL_ 437 IFC_TurnLightReq 0 "No Request" 1 "turn off" 2 "turn on left turn lamp" 3 "turn on right turn lamp" 4 "turn on Hazard Lamp" 5 "Reserved" 6 "Reserved" 7 "Reserved"  ;
VAL_ 437 IFC_ActTrqReqEnable 0 "Disable" 1 "Enable"  ;
VAL_ 437 IFC_VLCSt 0 "VLC not working" 1 "VLC Override possible" 2 "VLC Override impossible" 3 "Reserve"  ;
VAL_ 437 IFC_AngReqRdntSt 0 "Not redundant and mute" 1 "Redundant"  ;
VAL_ 437 IFC_AngReqSt 0 "Inhibited" 1 "Ready" 2 "Active" 3 "Failed"  ;
VAL_ 437 IFC_EcallReq 0 "Not Request" 1 "Request"  ;
VAL_ 918 UINM_PADS_ResponseErr 0 "No Error" 1 "Error"  ;
VAL_ 918 UINM_PADS_CustomSWSt 0 "not active;" 1 "active;"  ;
VAL_ 918 UINM_PADS_CustomSWStVD 0 "Not valid" 1 "Valid"  ;
VAL_ 918 UINM_PADS_CustomSWstuck 0 "Normal" 1 "stuck"  ;
VAL_ 918 UINM_PADS_IDC_PlaySWSt 0 "not active;" 1 "active;"  ;
VAL_ 918 UINM_PADS_IDC_PlaySWStVD 0 "Not valid" 1 "Valid"  ;
VAL_ 918 UINM_PADS_CruSetSpeedRollerRotatedDir 0 "Not rotated" 1 "Forward" 2 "Backward" 3 "Not used"  ;
VAL_ 918 UINM_PADS_FolDistIncSWSt 0 "not active;" 1 "active;"  ;
VAL_ 918 UINM_PADS_FolDistIncSWStVD 0 "Not valid" 1 "Valid"  ;
VAL_ 918 UINM_PADS_FolDistIncSWStuckSt 0 "Normal" 1 "stuck"  ;
VAL_ 918 UINM_PADS_FolDistDecSWStVD 0 "Not valid" 1 "Valid"  ;
VAL_ 918 UINM_PADS_FolDistDecSWStuckSt 0 "Normal" 1 "stuck"  ;
VAL_ 918 UINM_PADS_OKSWSt 0 "not active;" 1 "active;"  ;
VAL_ 918 UINM_PADS_OKSWStVD 0 "Not valid" 1 "Valid"  ;
VAL_ 918 UINM_PADS_OKSWStuckSt 0 "Normal" 1 "stuck"  ;
VAL_ 918 UINM_PADS_CruSetSpeedRollerVD 0 "Not valid" 1 "Valid"  ;
VAL_ 918 UINM_PADS_FolDistDecSWSt 0 "not active;" 1 "active;"  ;
VAL_ 918 UINM_PADS_CruSWSt 0 "not active;" 1 "active;"  ;
VAL_ 918 UINM_PADS_CruSWStVD 0 "Not valid" 1 "Valid"  ;
VAL_ 918 UINM_PADS_CruSWStuckSt 0 "Normal" 1 "stuck"  ;
VAL_ 918 UINM_PADS_CruSpeedDecSWSt 0 "not active;" 1 "active;"  ;
VAL_ 918 UINM_PADS_CruSpeedDecSWStVD 0 "Not valid" 1 "Valid"  ;
VAL_ 918 UINM_PADS_CruSpeedDecSWStuckSt 0 "Normal" 1 "stuck"  ;
VAL_ 918 UINM_PADS_CruResumeSpeedIncSWSt 0 "not active;" 1 "active;"  ;
VAL_ 918 UINM_PADS_CruResumeSpeedIncSWStVD 0 "Not valid" 1 "Valid"  ;
VAL_ 918 UINM_PADS_CruResumeSpeedIncSWStuckSt 0 "Normal" 1 "stuck"  ;
VAL_ 918 UINM_PADS_CruTJAICASWSt 0 "not active;" 1 "active;"  ;
VAL_ 918 UINM_PADS_CruTJAICASWStVD 0 "Not valid" 1 "Valid"  ;
VAL_ 918 UINM_PADS_CruTJAICASWStuckSt 0 "Normal" 1 "stuck"  ;
VAL_ 918 UINM_PADS_Custom2SWSt 0 "not active" 1 "active"  ;
VAL_ 918 UINM_PADS_Custom2SWStVD 0 "Not valid" 1 "Valid"  ;
VAL_ 918 UINM_PADS_Custom2SWStuckSt 0 "Normal" 1 "stuck"  ;
VAL_ 918 UINM_PADS_ACCSWSt 0 "not perssed" 1 "short pressed" 2 "long pressed" 3 "reserved"  ;
VAL_ 918 UINM_PADS_VoltageFaultSt 0 "No error" 1 "Low voltage" 2 "High voltage" 3 "Not used"  ;
VAL_ 1078 ETC_DismountSt 0 "normal" 1 "not active" 2 "active, but invalid" 3 "reserved"  ;
VAL_ 1078 ETC_SelfcheckSt 0 "normal" 1 "trade system failure" 2 "BLE system failure" 3 "trade and BLE system failure"  ;
VAL_ 1078 ETC_GateProperty 0 "reserved" 1 "entrance" 2 "exit" 3 "reserved"  ;
VAL_ 1078 ETC_TradeType 0 "highway unclose toll" 1 "highway close toll" 2 "other close toll"  ;
VAL_ 1078 ETC_SystemSt 0 "nomal" 1 "abnormal"  ;
VAL_ 1078 ETC_SysCfgst 0 "Disable" 1 "Enable"  ;
VAL_ 1078 ETC_ICMDisplayCfgst 0 "Disable" 1 "Enable"  ;
VAL_ 1078 ETC_BLEenableCfgst 0 "Disable" 1 "Enable"  ;
VAL_ 1078 ETC_ActivSt 0 "Normal" 1 "Abnormal"  ;
VAL_ 343 POD_DSMObstDetcnFL 0 "No command" 1 "Active" 2 "Inactive"  ;
VAL_ 343 POD_DSMObstDetcnFR 0 "No command" 1 "Active" 2 "Inactive"  ;
VAL_ 343 POD_DSMObstDetcnRL 0 "No command" 1 "Active" 2 "Inactive"  ;
VAL_ 343 POD_DSMObstDetcnRR 0 "No command" 1 "Active" 2 "Inactive"  ;
