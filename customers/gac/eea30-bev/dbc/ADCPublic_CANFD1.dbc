VERSION "Version"

NS_ :

BS_:

BU_: CCU ADC FAPA IFC FLR FRR RRR RLR INU Tester CBM VIU SRS IDC PCS AMP IMR FIMR TBOX IBCS IXCU V2XOBU WHUD RLBMS CCURT2 RT2_C3 OTAWL ZCUF ZCUL ZCUR ZCUT IPS DCU NIDU RBM WACUFL IID CCURT1 RT1_C0 RT1_C1 AVAS FLLCM FRLCM RLLCMA RRLCMA RLLCMB RRLCMB LBMS LBMSAD MFS FCP IDU ITS BCB DCDC PCU EOP DCU2 BMS TMC EPS ECS CD PAS SBM WCM ETC TBOX2 DSM FLPDM FRPDM RLPDM RRPDM HVSMR SCMRL SCMRR EBU EPB VDC EVCC ADM PLGM FBLCM RLISD RRISD RCP RFR WCMFR SCMR TFOAR TROAR HVSPRL HVSPRR

BO_ 777 CCU_ZCUR_4: 64 CCU
 SG_ ZCUR_4_CRC : 7|16@0+ (1,0) [0|65535] ""  CBM,ADC,FAPA,VIU
 SG_ ZCUR_4_Counter : 23|8@0+ (1,0) [0|255] ""  CBM,ADC,FAPA,VIU,IFC
 SG_ EL_MRADASLightSt : 113|2@0+ (1,0) [0|3] ""  ADC,FAPA
 SG_ MR_RightMirrorFoldUnfoldSt : 199|2@0+ (1,0) [0|3] ""  SRS,IDC,ADC,FAPA,VIU,PCS
 SG_ PWL_WinCurrentPos_FRWinPst : 303|8@0+ (0.5,0) [0|100] "%"  IDC,AMP,IMR,FIMR,ADC,FAPA,VIU,IFC
 SG_ EL_MRTurnLightSt : 325|2@0+ (1,0) [0|3] ""  SRS,IDC,ADC,FAPA,VIU,TBOX
 SG_ EL_MRTurnLightFaultSt : 323|1@0+ (1,0) [0|1] ""  SRS,IDC,ADC,FAPA,VIU
 SG_ EL_RightBSDIndicatorSt : 353|1@0+ (1,0) [0|1] ""  ADC,FAPA,FLR,FRR,VIU
 SG_ EL_RightBSDIndicatorFaultSt : 352|1@0+ (1,0) [0|1] ""  ADC,FAPA,FLR,FRR,VIU

BO_ 342 CCU_ZCUR_8: 64 CCU
 SG_ ZCUR_8_CRC : 7|16@0+ (1,0) [0|65535] ""  ADC,FAPA
 SG_ ZCUR_8_Counter : 23|8@0+ (1,0) [0|255] ""  ADC,FAPA
 SG_ KAE_FOB1Position : 111|4@0+ (1,0) [0|15] ""  IDC,ADC,FAPA,IFC
 SG_ KAE_FOB2Position : 107|4@0+ (1,0) [0|15] ""  IDC,ADC,FAPA,IFC
 SG_ KAE_FOB3Position : 119|4@0+ (1,0) [0|15] ""  IDC,ADC,FAPA,IFC
 SG_ KAE_FOB1UnlockBtnPressSt : 199|2@0+ (1,0) [0|3] ""  ADC,FAPA
 SG_ KAE_FOB1LockBtnPressSt : 197|2@0+ (1,0) [0|3] ""  ADC,FAPA
 SG_ KAE_FOB1RESBtnPressSt : 195|2@0+ (1,0) [0|3] ""  ADC,FAPA
 SG_ KAE_FOB1PSD_LBtnPressSt : 193|2@0+ (1,0) [0|3] ""  ADC,FAPA
 SG_ KAE_FOB1PSD_RBtnPressSt : 207|2@0+ (1,0) [0|3] ""  ADC,FAPA
 SG_ KAE_FOB1TrunkBtnPressSt : 205|2@0+ (1,0) [0|3] ""  ADC,FAPA
 SG_ KAE_FOB1PanicBtnPressSt : 203|2@0+ (1,0) [0|3] ""  ADC,FAPA
 SG_ KAE_FOB1User_definedBtnPressSt : 201|2@0+ (1,0) [0|3] ""  ADC,FAPA

BO_ 776 CCU_ZCUL_3: 64 CCU
 SG_ EL_MLADASLightSt : 211|2@0+ (1,0) [0|3] ""  ADC,FAPA

BO_ 957 CCU_ZCUL_HOD_1: 8 CCU
 SG_ HOD_1_CRC : 7|8@0+ (1,0) [0|255] ""  ADC,FAPA,IFC
 SG_ HOD_1_Counter : 11|4@0+ (1,0) [0|14] ""  ADC,FAPA,IFC
 SG_ HOD_St : 15|4@0+ (1,0) [0|15] ""  ADC,FAPA
 SG_ HOD_TouchZone1 : 16|1@0+ (1,0) [0|1] ""  ADC,FAPA,IFC
 SG_ HOD_TouchZone2 : 17|1@0+ (1,0) [0|1] ""  ADC,FAPA,IFC
 SG_ HOD_TouchZone3 : 18|1@0+ (1,0) [0|1] ""  ADC,FAPA,IFC
 SG_ HOD_HeatingSt : 20|2@0+ (1,0) [0|3] ""  ADC,FAPA
 SG_ HOD_CalibrationSt : 22|1@0+ (1,0) [0|1] ""  ADC,FAPA,IFC
 SG_ HOD_LINComFault : 23|1@0+ (1,0) [0|1] ""  ADC,FAPA,IFC
 SG_ HOD_FaultSt : 24|1@0+ (1,0) [0|1] ""  ADC,FAPA,IFC
 SG_ HOD_VBattOORFault : 25|1@0+ (1,0) [0|1] ""  ADC,FAPA,IFC
 SG_ HOD_HeatingOtherFaultSt : 26|1@0+ (1,0) [0|1] ""  ADC,FAPA
 SG_ HOD_HeatingOverUnderCurrentSt : 27|1@0+ (1,0) [0|1] ""  ADC,FAPA
 SG_ HOD_HeatingThermSt : 28|1@0+ (1,0) [0|1] ""  ADC,FAPA
 SG_ HOD_HeatingTempOutSt : 29|1@0+ (1,0) [0|1] ""  ADC,FAPA
 SG_ HOD_TouchIntensityZone1 : 39|8@0+ (1,0) [0|255] ""  ADC,FAPA
 SG_ HOD_TouchIntensityZone2 : 47|8@0+ (1,0) [0|255] ""  ADC,FAPA
 SG_ HOD_TouchIntensityZone3 : 55|8@0+ (1,0) [0|255] ""  ADC,FAPA
 SG_ HOD_SysErr : 58|2@0+ (1,0) [0|3] ""  ADC,FAPA
 SG_ HOD_Typ : 61|3@0+ (1,0) [0|7] ""  ADC,FAPA,IFC

BO_ 784 CCU_ZCUF_1: 64 CCU
 SG_ HVAC_PTCExterPwrSupplyFault : 293|1@0+ (1,0) [0|1] ""  ADC

BO_ 791 CCU_ZCUF_2: 64 CCU
 SG_ ZCUF_2_CRC : 7|16@0+ (1,0) [0|65535] ""  ADC,FAPA,VIU
 SG_ ZCUF_2_Counter : 23|8@0+ (1,0) [0|255] ""  ADC,FAPA,VIU
 SG_ WW_FWPMotorSt : 27|3@0+ (1,0) [0|7] ""  IBCS,IXCU,IDC,ADC,FAPA,VIU
 SG_ WW_FWSHMotorSt : 39|2@0+ (1,0) [0|3] ""  ADC,FAPA,VIU
 SG_ HRN_HornRunningSt : 45|2@0+ (1,0) [0|3] ""  ADC,FAPA,VIU
 SG_ HRN_HornWorkingTemplet : 43|4@0+ (1,0) [0|15] ""  ADC,FAPA,VIU
 SG_ EL_FLPositionLightSt : 71|1@0+ (1,0) [0|1] ""  IDC,ADC,FAPA,VIU,V2XOBU
 SG_ EL_FLPositionLightFaultSt : 70|1@0+ (1,0) [0|1] ""  IDC,ADC,FAPA,VIU
 SG_ EL_FRPositionLightSt : 69|1@0+ (1,0) [0|1] ""  IDC,ADC,FAPA,VIU,V2XOBU
 SG_ EL_FRPositionLightFaultSt : 68|1@0+ (1,0) [0|1] ""  IDC,ADC,FAPA,VIU
 SG_ EL_LeftLowBeamSt : 67|1@0+ (1,0) [0|1] ""  IDC,WHUD,ADC,FAPA,VIU,V2XOBU
 SG_ EL_LeftLowBeamFaultSt : 66|1@0+ (1,0) [0|1] ""  IDC,ADC,FAPA,VIU
 SG_ EL_RightLowBeamSt : 65|1@0+ (1,0) [0|1] ""  IDC,ADC,FAPA,VIU,V2XOBU
 SG_ EL_RightLowBeamFaultSt : 64|1@0+ (1,0) [0|1] ""  IDC,ADC,FAPA,VIU
 SG_ EL_LeftHighBeamSt : 79|1@0+ (1,0) [0|1] ""  IDC,ADC,FAPA,VIU,V2XOBU
 SG_ EL_LeftHighBeamFaultSt : 78|1@0+ (1,0) [0|1] ""  IDC,ADC,FAPA,VIU
 SG_ EL_RightHighBeamSt : 77|1@0+ (1,0) [0|1] ""  IDC,ADC,FAPA,VIU,V2XOBU
 SG_ EL_RightHighBeamFaultSt : 76|1@0+ (1,0) [0|1] ""  IDC,ADC,FAPA,VIU
 SG_ EL_FLFogLightSt : 75|1@0+ (1,0) [0|1] ""  IDC,ADC,FAPA,VIU
 SG_ EL_FLFogLightFaultSt : 74|1@0+ (1,0) [0|1] ""  IDC,ADC,FAPA,VIU
 SG_ EL_FRFogLightSt : 73|1@0+ (1,0) [0|1] ""  IDC,ADC,FAPA,VIU
 SG_ EL_FRFogLightFaultSt : 72|1@0+ (1,0) [0|1] ""  IDC,ADC,FAPA,VIU
 SG_ EL_LeftDRLSt : 87|1@0+ (1,0) [0|1] ""  ADC,FAPA,VIU,PCS
 SG_ EL_LeftDRLFaultSt : 86|1@0+ (1,0) [0|1] ""  IDC,ADC,FAPA,VIU
 SG_ EL_RightDRLSt : 85|1@0+ (1,0) [0|1] ""  ADC,FAPA,VIU,PCS
 SG_ EL_RightDRLFaultSt : 84|1@0+ (1,0) [0|1] ""  IDC,ADC,FAPA,VIU
 SG_ EL_FLTurnLightSt : 95|2@0+ (1,0) [0|3] ""  SRS,IDC,ADC,FAPA,RLR,RRR,VIU,TBOX,V2XOBU
 SG_ EL_FLTurnLightFaultSt : 93|1@0+ (1,0) [0|1] ""  SRS,IDC,ADC,FAPA,VIU
 SG_ EL_FRTurnLightSt : 92|2@0+ (1,0) [0|3] ""  SRS,IDC,ADC,FAPA,RLR,RRR,VIU,TBOX,V2XOBU
 SG_ EL_FRTurnLightFaultSt : 90|1@0+ (1,0) [0|1] ""  SRS,IDC,ADC,FAPA,VIU
 SG_ WW_RWSHMotorSt : 103|2@0+ (1,0) [0|3] ""  ADC,FAPA,VIU
 SG_ EL_FADASLightSt : 127|2@0+ (1,0) [0|3] ""  ADC,FAPA
 SG_ EBSF_BattVolt : 199|14@0+ (0.0009765625,3) [3|18] "V"  RLBMS,IDC,ADC,FAPA,VIU,IFC
 SG_ EBSF_CurrentRange : 201|2@0+ (1,0) [0|3] ""  ADC,FAPA,IFC
 SG_ EBSF_BattCurrent : 215|16@0+ (1,0) [-1500|1500] "A"  ADC,FAPA,VIU,IFC

BO_ 792 CCU_ZCUT_2: 64 CCU
 SG_ ZCUT_2_CRC : 7|16@0+ (1,0) [0|65535] ""  CBM,ADC,FAPA,VIU
 SG_ ZCUT_2_Counter : 23|8@0+ (1,0) [0|255] ""  CBM,ADC,FAPA,VIU
 SG_ UMM_SecondLHSeatSt : 39|2@0+ (1,0) [0|3] ""  CCURT2,RT2_C3,SRS,IDC,ADC,FAPA,VIU
 SG_ UMM_SecondRHSeatSt : 37|2@0+ (1,0) [0|3] ""  CCURT2,RT2_C3,SRS,IDC,ADC,FAPA,VIU
 SG_ UMM_SecondMIDSeatSt : 35|2@0+ (1,0) [0|3] ""  CCURT2,RT2_C3,SRS,IDC,ADC,FAPA,VIU
 SG_ LCK_PowerFillerCapAngle : 103|8@0+ (1,0) [0|255] "deg"  IDC,ADC,FAPA
 SG_ EL_ReverseLightSt : 111|1@0+ (1,0) [0|1] ""  IDC,ADC,FAPA,VIU,PCS,V2XOBU
 SG_ EL_ReverseLightFaultSt : 110|1@0+ (1,0) [0|1] ""  IDC,ADC,FAPA,VIU
 SG_ EL_SideBrkLightSt : 109|1@0+ (1,0) [0|1] ""  IDC,ADC,FAPA,VIU,V2XOBU
 SG_ EL_SideBrkLightFaultSt : 108|1@0+ (1,0) [0|1] ""  IDC,ADC,FAPA,VIU
 SG_ EL_CHMSLSt : 107|1@0+ (1,0) [0|1] ""  IDC,ADC,FAPA,VIU,V2XOBU
 SG_ EL_CHMSLFaultSt : 106|1@0+ (1,0) [0|1] ""  IDC,ADC,FAPA,VIU
 SG_ EL_RLPositionLightSt : 105|1@0+ (1,0) [0|1] ""  IDC,ADC,FAPA,VIU,V2XOBU
 SG_ EL_RLPositionLightFaultSt : 104|1@0+ (1,0) [0|1] ""  IDC,ADC,FAPA,VIU
 SG_ EL_RRPositionLightSt : 119|1@0+ (1,0) [0|1] ""  IDC,ADC,FAPA,VIU,V2XOBU
 SG_ EL_RRPositionLightFaultSt : 118|1@0+ (1,0) [0|1] ""  IDC,ADC,FAPA,VIU
 SG_ EL_RearFogLightSt : 117|1@0+ (1,0) [0|1] ""  IDC,ADC,FAPA,VIU
 SG_ EL_RearFogLightFaultSt : 116|1@0+ (1,0) [0|1] ""  IDC,ADC,FAPA,VIU
 SG_ EL_RLTurnLightSt : 113|2@0+ (1,0) [0|3] ""  SRS,IDC,ADC,FAPA,VIU,TBOX,V2XOBU
 SG_ EL_RLTurnLightFaultSt : 127|1@0+ (1,0) [0|1] ""  SRS,IDC,ADC,FAPA,VIU,PCS
 SG_ EL_RRTurnLightSt : 126|2@0+ (1,0) [0|3] ""  SRS,IDC,ADC,FAPA,VIU,TBOX,V2XOBU
 SG_ EL_RRTurnLightFaultSt : 124|1@0+ (1,0) [0|1] ""  SRS,IDC,ADC,FAPA,VIU,PCS
 SG_ EL_RADASLightSt : 396|2@0+ (1,0) [0|3] ""  ADC,FAPA

BO_ 616 CCU_1: 64 CCU
 SG_ CCU_1_CRC : 7|16@0+ (1,0) [0|65535] ""  CCURT2,RT2_C3,OTAWL,ZCUF,ZCUL,ZCUR,ZCUT,IPS,DCU,NIDU,RBM,IBCS,RLBMS,CBM,IXCU,WACUFL,IDC,IID,ADC,VIU
 SG_ CCU_1_Counter : 23|8@0+ (1,0) [0|255] ""  CCURT2,RT2_C3,OTAWL,ZCUF,ZCUL,ZCUR,ZCUT,IPS,DCU,NIDU,RBM,IBCS,RLBMS,CBM,IXCU,WACUFL,IDC,IID,ADC,VIU
 SG_ UMM_UsageModeSt : 26|3@0+ (1,0) [0|7] ""  CCURT1,CCURT2,RT1_C0,RT1_C1,RT2_C3,OTAWL,ZCUF,ZCUL,ZCUR,ZCUT,AVAS,FLLCM,FRLCM,RLLCMA,RRLCMA,RLLCMB,RRLCMB,LBMS,LBMSAD,MFS,FCP,IDU,ITS,BCB,IPS,DCDC,PCU,EOP,DCU,DCU2,NIDU,BMS,TMC,SRS,EPS,RBM,IBCS,ECS,RLBMS,CBM,IXCU,WACUFL,IDC,IID,CD,AMP,WHUD,IMR,FIMR,ADC,FAPA,FLR,FRR,RLR,RRR,VIU,IFC,PAS,INU,SBM,WCM,ETC,TBOX,TBOX2,DSM,FLPDM,FRPDM,RLPDM,RRPDM
 SG_ OTA_FuncReq_ADCWakeup : 45|3@0+ (1,0) [0|7] ""  ADC,FAPA
 SG_ UMM_DriverSeatSt : 59|2@0+ (1,0) [0|3] ""  CCURT2,RT2_C3,ZCUR,SRS,IBCS,IDC,ADC,FAPA,FLR,FRR,RLR,RRR,VIU,IFC
 SG_ UMM_FrontPassengerSeatSt : 57|2@0+ (1,0) [0|3] ""  CCURT2,RT2_C3,OTAWL,SRS,IDC,ADC,FAPA,FLR,FRR,RLR,RRR,VIU
 SG_ VMM_VehModeSt : 159|4@0+ (1,0) [0|15] ""  CCURT1,CCURT2,RT1_C0,RT1_C1,RT2_C3,OTAWL,ZCUF,ZCUL,ZCUR,ZCUT,AVAS,FLLCM,FRLCM,RLLCMA,RRLCMA,RLLCMB,RRLCMB,LBMS,LBMSAD,MFS,FCP,IDU,ITS,BCB,IPS,DCDC,PCU,EOP,DCU,DCU2,NIDU,BMS,SRS,EPS,RBM,IBCS,ECS,RLBMS,IXCU,WACUFL,IDC,AMP,WHUD,IMR,FIMR,ADC,FAPA,FLR,FRR,RLR,RRR,VIU,IFC,SBM,WCM,ETC,TBOX,TBOX2,DSM,FLPDM,FRPDM,RLPDM,RRPDM,HVSMR,SCMRL,SCMRR
 SG_ VMM_LastVehModeSt : 155|4@0+ (1,0) [0|15] ""  CCURT1,RT1_C1,ZCUF,ZCUL,ZCUR,ZCUT,AVAS,FLLCM,FRLCM,RLLCMA,RRLCMA,RLLCMB,RRLCMB,MFS,FCP,ITS,IPS,DCDC,PCU,EOP,DCU,NIDU,BMS,SRS,EPS,RBM,IBCS,IXCU,WACUFL,IDC,AMP,WHUD,ADC,FAPA,VIU,IFC,SBM,WCM,ETC,TBOX,DSM,FLPDM,FRPDM,RLPDM,RRPDM,HVSMR,SCMRL,SCMRR
 SG_ VMM_OTAModeSt : 167|2@0+ (1,0) [0|3] ""  CCURT1,CCURT2,RT1_C0,RT1_C1,RT2_C3,OTAWL,ZCUF,ZCUL,ZCUR,ZCUT,AVAS,FLLCM,FRLCM,RLLCMA,RRLCMA,RLLCMB,RRLCMB,LBMS,LBMSAD,MFS,FCP,IDU,ITS,BCB,IPS,DCDC,PCU,EOP,DCU,DCU2,NIDU,BMS,SRS,EPS,RBM,IBCS,ECS,RLBMS,IXCU,WACUFL,IDC,IID,AMP,WHUD,ADC,FAPA,FLR,FRR,RLR,RRR,VIU,IFC,SBM,WCM,ETC,TBOX,DSM,FLPDM,FRPDM,RLPDM,RRPDM,HVSMR,SCMRL,SCMRR
 SG_ CCU_DstFlag : 272|1@0+ (1,0) [0|1] ""  ZCUF,ZCUL,ZCUR,ZCUT,ADC,FAPA,VIU
 SG_ CSM_RC_PAARequest : 287|4@0+ (1,0) [0|15] ""  ADC,FAPA,FLR,FRR,RLR,RRR,VIU
 SG_ CSM_RC_AuthSt : 295|2@0+ (1,0) [0|3] ""  ADC,FAPA,VIU
 SG_ IPDS_EnablePowerSup : 327|2@0+ (1,0) [0|3] ""  ZCUF,ZCUR,ZCUT,BMS,SRS,RBM,IBCS,ECS,EBU,RLBMS,EPB,IXCU,WACUFL,IDC,IID,ADC,FAPA,VIU,TBOX
 SG_ Time_Year : 343|8@0+ (1,2000) [2000|2255] "y"  CCURT1,CCURT2,RT1_C0,RT1_C1,RT2_C3,ZCUF,ZCUL,ZCUR,ZCUT,LBMS,LBMSAD,MFS,FCP,IDU,ITS,IPS,PCU,EOP,DCU,DCU2,NIDU,BMS,TMC,SRS,EPS,RBM,IBCS,ECS,EBU,RLBMS,CBM,EPB,IXCU,WACUFL,AMP,WHUD,IMR,FIMR,ADC,FAPA,FLR,FRR,RLR,RRR,VIU,IFC,PAS,PCS,INU
 SG_ Time_Month : 351|4@0+ (1,0) [1|12] "m"  CCURT1,CCURT2,RT1_C0,RT1_C1,RT2_C3,ZCUF,ZCUL,ZCUR,ZCUT,LBMS,LBMSAD,MFS,FCP,IDU,ITS,IPS,PCU,EOP,DCU,DCU2,NIDU,BMS,TMC,SRS,EPS,RBM,IBCS,ECS,EBU,RLBMS,CBM,EPB,IXCU,WACUFL,AMP,WHUD,IMR,FIMR,ADC,FAPA,FLR,FRR,RLR,RRR,VIU,IFC,PAS,PCS,INU
 SG_ Time_Day : 347|5@0+ (1,0) [1|31] "d"  CCURT1,CCURT2,RT1_C0,RT1_C1,RT2_C3,ZCUF,ZCUL,ZCUR,ZCUT,LBMS,LBMSAD,MFS,FCP,IDU,ITS,IPS,PCU,EOP,DCU,DCU2,NIDU,BMS,TMC,SRS,EPS,RBM,IBCS,ECS,EBU,RLBMS,CBM,EPB,IXCU,WACUFL,AMP,WHUD,IMR,FIMR,ADC,FAPA,FLR,FRR,RLR,RRR,VIU,IFC,PAS,PCS,INU
 SG_ Time_Hour : 358|5@0+ (1,0) [0|23] "h"  CCURT1,CCURT2,RT1_C0,RT1_C1,RT2_C3,ZCUF,ZCUL,ZCUR,ZCUT,LBMS,LBMSAD,MFS,FCP,IDU,ITS,IPS,PCU,EOP,DCU,DCU2,NIDU,BMS,TMC,SRS,EPS,RBM,IBCS,ECS,EBU,RLBMS,CBM,EPB,IXCU,WACUFL,AMP,WHUD,IMR,FIMR,ADC,FAPA,FLR,FRR,RLR,RRR,VIU,IFC,PAS,PCS,INU
 SG_ Time_Min : 353|6@0+ (1,0) [0|59] "min"  CCURT1,CCURT2,RT1_C0,RT1_C1,RT2_C3,ZCUF,ZCUL,ZCUR,ZCUT,LBMS,LBMSAD,MFS,FCP,IDU,ITS,IPS,PCU,EOP,DCU,DCU2,NIDU,BMS,TMC,SRS,EPS,RBM,IBCS,ECS,EBU,RLBMS,CBM,EPB,IXCU,WACUFL,AMP,WHUD,IMR,FIMR,ADC,FAPA,FLR,FRR,RLR,RRR,VIU,IFC,PAS,PCS,INU
 SG_ Time_Sec : 363|6@0+ (1,0) [0|59] "s"  CCURT1,CCURT2,RT1_C0,RT1_C1,RT2_C3,ZCUF,ZCUL,ZCUR,ZCUT,LBMS,LBMSAD,MFS,FCP,IDU,ITS,IPS,PCU,EOP,DCU,DCU2,NIDU,BMS,TMC,SRS,EPS,RBM,IBCS,ECS,EBU,RLBMS,CBM,EPB,IXCU,WACUFL,AMP,WHUD,IMR,FIMR,ADC,FAPA,FLR,FRR,RLR,RRR,VIU,IFC,PAS,PCS,INU
 SG_ ASB_DriverActiveBeltFaultSt : 420|1@0+ (1,0) [0|1] ""  IDC,ADC

BO_ 818 TMS_1: 64 CCU
 SG_ HVAC_SysErrSt : 469|2@0+ (1,0) [0|3] ""  ADC
 SG_ HVAC_RefLeakFault : 471|2@0+ (1,0) [0|3] ""  ADC

BO_ 816 CCU_2: 64 CCU
 SG_ HVAC_WindExitMode : 37|3@0+ (1,0) [0|7] ""  CCURT1,RT1_C1,ZCUL,ZCUR,IDC,ADC,FAPA,VIU
 SG_ HVAC_DriverTempSelect : 54|5@0+ (0.5,18) [18|32] "degC"  CCURT1,RT1_C0,RT1_C1,ZCUL,ZCUR,VDC,IDC,ADC,SBM
 SG_ HVAC_PsnTempSelect : 87|5@0+ (0.5,18) [18|31] "degC"  CCURT1,RT1_C0,RT1_C1,ZCUL,ZCUR,IDC,ADC,SBM

BO_ 960 TMS_4: 64 CCU
 SG_ TMS_4_CRC : 7|16@0+ (1,0) [0|65535] ""  ADC
 SG_ TMS_4_Counter : 23|8@0+ (1,0) [0|255] ""  ADC
 SG_ HVAC_AutoFogFlt : 298|1@0+ (1,0) [0|1] ""  ADC
 SG_ HVAC_AutoFogSts : 403|1@0+ (1,0) [0|1] ""  ADC

BO_ 825 CCU_5: 64 CCU
 SG_ CCU_FuncReq_SentryMod : 146|1@0+ (1,0) [0|1] ""  ZCUF,IDC,ADC,FAPA,IFC

BO_ 291 CCU_6: 64 CCU
 SG_ CCU_6_CRC : 7|16@0+ (1,0) [0|65535] ""  ZCUF,ADC,VIU
 SG_ CCU_6_Counter : 23|8@0+ (1,0) [0|255] ""  ZCUF,ADC,VIU
 SG_ ATWS_ATWSAlarmReq : 31|2@0+ (1,0) [0|3] ""  CCURT1,RT1_C1,VDC,IDC,ADC,FAPA,VIU
 SG_ ATWS_ATWSSt : 26|3@0+ (1,0) [0|7] ""  CCURT1,RT1_C0,RT1_C1,OTAWL,ZCUR,VDC,IDC,ADC,FAPA,FLR,FRR,RLR,RRR,VIU
 SG_ WW_FrontWasherCmd : 39|2@0+ (1,0) [0|3] ""  ZCUF,ADC,FAPA,VIU
 SG_ WW_FrontWiperCmd_Speed : 85|2@0+ (1,0) [0|3] ""  ZCUF,ADC,FAPA,VIU,IFC
 SG_ WW_FrontWiperCtrlSt : 111|3@0+ (1,0) [0|7] ""  CCURT1,RT1_C1,ZCUF,ZCUT,VDC,IDC,ADC,FAPA,VIU,IFC,TBOX,V2XOBU
 SG_ WW_RearWiperCtrlSt : 107|3@0+ (1,0) [0|7] ""  ZCUF,ZCUT,IDC,ADC,FAPA,VIU
 SG_ WW_FrontWiperCtrlSrc : 115|3@0+ (1,0) [0|7] ""  ZCUF,ZCUT,IDC,ADC,FAPA,VIU
 SG_ WW_RearWiperCtrlSrc : 112|3@0+ (1,0) [0|7] ""  ZCUF,ZCUT,IDC,ADC,FAPA,VIU
 SG_ WW_RearCamWasherVKResp : 125|2@0+ (1,0) [0|3] ""  IDC,ADC,FAPA,VIU
 SG_ WW_RearCamWasherVRResp : 123|2@0+ (1,0) [0|3] ""  IDC,ADC,FAPA,VIU

BO_ 865 CCU_7: 64 CCU
 SG_ EL_ReverseLightCtrlCmd : 30|1@0+ (1,0) [0|1] ""  ZCUT,ADC,FAPA,VIU
 SG_ EL_SideBrkLightCtrlCmd : 29|1@0+ (1,0) [0|1] ""  CCURT1,RT1_C1,ZCUF,ZCUT,VDC,IDC,ADC,FAPA,VIU,PCS
 SG_ EL_LeftLowBeamCtrlCmd : 36|1@0+ (1,0) [0|1] ""  ZCUF,ADC,FAPA,VIU
 SG_ EL_RightLowBeamCtrlCmd : 35|1@0+ (1,0) [0|1] ""  ZCUF,ADC,FAPA,VIU
 SG_ EL_PositionLightCtrlSource : 34|3@0+ (1,0) [0|7] ""  ZCUF,ZCUL,ZCUR,ZCUT,MFS,FCP,IDC,ADC,FAPA,VIU,TBOX
 SG_ EL_LeftHighBeamCtrlCmd : 55|1@0+ (1,0) [0|1] ""  ZCUF,ADC,FAPA,VIU
 SG_ EL_RightHighBeamCtrlCmd : 54|1@0+ (1,0) [0|1] ""  ZCUF,ADC,FAPA,VIU
 SG_ EL_LowBeamCtrlSource : 53|3@0+ (1,0) [0|7] ""  ZCUF,ZCUT,ADC,FAPA,VIU,IFC
 SG_ EL_RearFogLightCtrlSource : 50|3@0+ (1,0) [0|7] ""  ZCUT,ADC,FAPA,VIU,IFC
 SG_ EL_HighBeamCtrlSource : 61|3@0+ (1,0) [0|7] ""  ZCUF,ADC,FAPA,VIU
 SG_ EL_FrontFogLightCtrlSource : 71|3@0+ (1,0) [0|7] ""  ZCUF,ZCUT,ADC,FAPA,VIU,IFC
 SG_ EL_LicencePlateLightCtrlSource : 84|3@0+ (1,0) [0|7] ""  ZCUT,ADC,FAPA,VIU,TBOX
 SG_ EL_FlasherCtrlSource : 95|4@0+ (1,0) [0|15] ""  CCURT1,RT1_C0,ZCUF,ZCUL,ZCUR,ZCUT,SRS,ADC,FAPA,VIU,SBM,TBOX,V2XOBU
 SG_ EL_FADASLightCtrlCmd : 130|1@0+ (1,0) [0|1] ""  ZCUF,ZCUL,ZCUR,ZCUT,ADC,FAPA
 SG_ EL_RADASLightCtrlCmd : 131|1@0+ (1,0) [0|1] ""  ZCUF,ZCUL,ZCUR,ZCUT,ADC,FAPA
 SG_ EL_IHBColourSt : 155|2@0+ (1,0) [0|3] ""  IDC,ADC,FAPA
 SG_ EL_AutoHighBeamCtrlSt : 128|1@0+ (1,0) [0|1] ""  ADC,FAPA,VIU,IFC
 SG_ EL_ADC_2_VERFailFlag : 175|1@0+ (1,0) [0|1] ""  ADC,FAPA
 SG_ EL_ADC_4_New_VERFailFlag : 174|1@0+ (1,0) [0|1] ""  ADC,FAPA
 SG_ EL_ADC_8_VERFailFlag : 173|1@0+ (1,0) [0|1] ""  ADC,FAPA
 SG_ EL_ADBEnable : 252|1@0+ (1,0) [0|1] ""  IDC,ADC,FAPA
 SG_ EL_HeadLightLevelingSWSt : 467|4@0+ (1,0) [0|15] ""  IDC,ADC,FAPA,IFC
 SG_ EL_LeftTurnLightStForDisp : 478|1@0+ (1,0) [0|1] ""  IDC,IID,ADC,FAPA,FLR,FRR,RLR,RRR,VIU,IFC,PCS,TBOX
 SG_ EL_RightTurnLightStForDisp : 477|1@0+ (1,0) [0|1] ""  IDC,IID,ADC,FAPA,FLR,FRR,RLR,RRR,VIU,IFC,PCS,TBOX
 SG_ EL_PositionLightStForDisp : 476|1@0+ (1,0) [0|1] ""  CCURT1,RT1_C1,ZCUL,MFS,FCP,VDC,IDC,IID,WHUD,ADC,FAPA,VIU,IFC,PCS
 SG_ EL_FrontFogLightStForDisp : 475|1@0+ (1,0) [0|1] ""  IDC,ADC,FAPA,VIU,IFC,PCS,TBOX
 SG_ EL_RearFogLightStForDisp : 474|1@0+ (1,0) [0|1] ""  ZCUR,ZCUT,IDC,ADC,FAPA,VIU,IFC,PCS,TBOX
 SG_ EL_LowBeamStForDisp : 473|1@0+ (1,0) [0|1] ""  CCURT1,RT1_C1,VDC,IDC,ADC,FAPA,VIU,IFC,PCS,TBOX
 SG_ EL_HighBeamStForDisp : 472|1@0+ (1,0) [0|1] ""  CCURT1,RT1_C1,VDC,IDC,IID,ADC,FAPA,VIU,IFC,PCS,TBOX
 SG_ EL_HeadLightSWSt : 510|2@0+ (1,0) [0|3] ""  IDC,ADC,FAPA,IFC

BO_ 293 CCU_8: 64 CCU
 SG_ TPMS_FrontLeftTireBlowout : 193|2@0+ (1,0) [0|3] ""  ADC
 SG_ TPMS_FrontRightTireBlowout : 195|2@0+ (1,0) [0|3] ""  ADC
 SG_ TPMS_RearRightTireBlowout : 197|2@0+ (1,0) [0|3] ""  ADC
 SG_ TPMS_RearLeftTireBlowout : 199|2@0+ (1,0) [0|3] ""  ADC
 SG_ TPMS_FrontLeftTirePressure : 207|8@0+ (1.373,0) [0|350.115] "kpa"  CCURT1,RT1_C0,RT1_C1,IDC,ADC,FAPA,VIU,IFC
 SG_ TPMS_FrontRightTirePressure : 215|8@0+ (1.373,0) [0|350.115] "kpa"  CCURT1,RT1_C0,RT1_C1,IDC,ADC,FAPA,VIU,IFC
 SG_ TPMS_RearRightTirePressure : 223|8@0+ (1.373,0) [0|350.115] "kpa"  CCURT1,RT1_C0,RT1_C1,IDC,ADC,FAPA,VIU,IFC
 SG_ TPMS_RearLeftTirePressure : 231|8@0+ (1.373,0) [0|350.115] "kpa"  CCURT1,RT1_C0,RT1_C1,IDC,ADC,FAPA,VIU,IFC
 SG_ TPMS_TireWarningLamp : 295|1@0+ (1,0) [0|1] ""  CCURT1,RT1_C0,RT1_C1,SRS,IDC,IID,ADC,FAPA,VIU,V2XOBU
 SG_ TPMS_SystemWarningLamp : 310|1@0+ (1,0) [0|1] ""  CCURT1,RT1_C0,RT1_C1,SRS,IDC,IID,ADC,FAPA,VIU,V2XOBU

BO_ 294 CCU_9: 64 CCU
 SG_ LCK_DriverDoorAjarSt : 31|1@0+ (1,0) [0|1] ""  CCURT1,RT1_C0,RT1_C1,OTAWL,ZCUF,ZCUL,ZCUR,ZCUT,VDC,IBCS,ECS,IXCU,IDC,IMR,ADC,FAPA,VIU,IFC,PCS
 SG_ LCK_PassengerDoorAjarSt : 30|1@0+ (1,0) [0|1] ""  CCURT1,RT1_C0,RT1_C1,OTAWL,ZCUF,ZCUL,ZCUR,ZCUT,IBCS,ECS,IXCU,IDC,IMR,ADC,FAPA,VIU,IFC,PCS
 SG_ LCK_DriverDoorLockSt : 29|1@0+ (1,0) [0|1] ""  CCURT1,RT1_C0,RT1_C1,OTAWL,ZCUR,ZCUT,IBCS,ECS,IXCU,IDC,ADC,FAPA,VIU,IFC
 SG_ LCK_PassengerDoorLockSt : 28|1@0+ (1,0) [0|1] ""  CCURT1,RT1_C0,RT1_C1,OTAWL,ZCUR,ZCUT,ECS,IDC,ADC,FAPA,VIU,IFC
 SG_ LCK_VehicleDoorAjarSt : 27|2@0+ (1,0) [0|3] ""  CCURT1,RT1_C1,OTAWL,ZCUL,ZCUR,IDC,IMR,ADC,FAPA,VIU,IFC
 SG_ LCK_VehicleDoorLockSt : 25|2@0+ (1,0) [0|3] ""  CCURT1,RT1_C0,RT1_C1,OTAWL,ZCUF,ZCUL,ZCUR,ZCUT,IDC,ADC,FAPA,VIU,IFC
 SG_ LCK_VehicleChildSaftyLockSt : 39|1@0+ (1,0) [0|1] ""  IDC,ADC,FAPA,VIU,IFC
 SG_ LCK_VehicleChildSaftyLockedIndicate : 38|1@0+ (1,0) [0|1] ""  ZCUL,IDC,ADC,FAPA,VIU,IFC
 SG_ LCK_PowerFillerCapSt : 55|1@0+ (1,0) [0|1] ""  CCURT1,RT1_C0,RT1_C1,OTAWL,ZCUR,ZCUT,VDC,IBCS,IXCU,IDC,ADC,SBM
 SG_ KAE_UserDefinedCfgSt : 95|8@0+ (1,0) [0|255] ""  OTAWL,ZCUR,IDC,ADC,FAPA,VIU,SBM
 SG_ CCU_9_FreshnessValue : 455|16@0+ (1,0) [0|255] ""  OTAWL,ZCUF,ZCUL,ZCUR,ZCUT,IDC,ADC,FAPA,VIU
 SG_ CCU_9_MAC_Check : 471|48@0+ (1,0) [0|255] ""  OTAWL,ZCUF,ZCUL,ZCUR,ZCUT,IDC,ADC,FAPA,VIU

CM_ SG_ 777 ZCUR_4_CRC "E2E Profile 5 CRC";
CM_ SG_ 777 ZCUR_4_Counter "E2E Profile 5 Counter";
CM_ SG_ 777 EL_MRADASLightSt "Middle right ADAS light status";
CM_ SG_ 777 MR_RightMirrorFoldUnfoldSt "Right Mirror Fold Unfold Status";
CM_ SG_ 777 PWL_WinCurrentPos_FRWinPst "Front Right Window Current Position";
CM_ SG_ 777 EL_MRTurnLightSt "Middle right turn light status";
CM_ SG_ 777 EL_MRTurnLightFaultSt "Middle right turn light fault status";
CM_ SG_ 777 EL_RightBSDIndicatorSt "Right BSD indicator status";
CM_ SG_ 777 EL_RightBSDIndicatorFaultSt "Right BSD indicator fault status";
CM_ SG_ 342 ZCUR_8_CRC "E2E Profile 5 CRC";
CM_ SG_ 342 ZCUR_8_Counter "E2E Profile 5 Counter";
CM_ SG_ 342 KAE_FOB1Position " FOB1 Position";
CM_ SG_ 342 KAE_FOB2Position " FOB2 Position";
CM_ SG_ 342 KAE_FOB3Position " FOB3 Position";
CM_ SG_ 342 KAE_FOB1UnlockBtnPressSt "FOB1 Unlock Button Pressed Status";
CM_ SG_ 342 KAE_FOB1LockBtnPressSt "FOB1 Lock Button Pressed Status";
CM_ SG_ 342 KAE_FOB1RESBtnPressSt "FOB1 RES Button Status";
CM_ SG_ 342 KAE_FOB1PSD_LBtnPressSt "FOB1 PSD_L Button Status";
CM_ SG_ 342 KAE_FOB1PSD_RBtnPressSt "FOB1 PSD_R Button Status";
CM_ SG_ 342 KAE_FOB1TrunkBtnPressSt "FOB1 Trunk Button Status";
CM_ SG_ 342 KAE_FOB1PanicBtnPressSt "FOB1 Panic Button Status";
CM_ SG_ 342 KAE_FOB1User_definedBtnPressSt "FOB1 User_defined Button Status";
CM_ SG_ 776 EL_MLADASLightSt "Middle left ADAS light status";
CM_ SG_ 957 HOD_1_CRC "E2E Profile 1 CRC";
CM_ SG_ 957 HOD_1_Counter "E2E Profile 1 Counter";
CM_ SG_ 957 HOD_St "Indicating the working status of HOD function.";
CM_ SG_ 957 HOD_TouchZone1 "Indicating Zone 1 touch status";
CM_ SG_ 957 HOD_TouchZone2 "Indicating Zone 2 touch status";
CM_ SG_ 957 HOD_TouchZone3 "Indicating Zone 3 touch status";
CM_ SG_ 957 HOD_HeatingSt "Indicating the working status of steering heating function.";
CM_ SG_ 957 HOD_CalibrationSt "Open Wheel Recalibration Status";
CM_ SG_ 957 HOD_LINComFault "J2602 LIN Communication Status";
CM_ SG_ 957 HOD_FaultSt "Indicating ECU SW or HW fault or Capacity sensor Fault status";
CM_ SG_ 957 HOD_VBattOORFault "Indicating Battery Voltage Out of Range Fault";
CM_ SG_ 957 HOD_HeatingOtherFaultSt "Indicating  other Heating  Fault status";
CM_ SG_ 957 HOD_HeatingOverUnderCurrentSt "Indicating Heating over current or under current fault status";
CM_ SG_ 957 HOD_HeatingThermSt "Indicating Heating thermistor fault";
CM_ SG_ 957 HOD_HeatingTempOutSt "indaicating the set temperature is not reached within the specified time";
CM_ SG_ 957 HOD_TouchIntensityZone1 " intensity of Zone1 0x0~0xFA: Intensity";
CM_ SG_ 957 HOD_TouchIntensityZone2 " intensity of Zone20x0~0xFA: Intensity";
CM_ SG_ 957 HOD_TouchIntensityZone3 " intensity of Zone30x0~0xFA: Intensity";
CM_ SG_ 957 HOD_SysErr "HOD Error information";
CM_ SG_ 957 HOD_Typ "Indicating HOD zone type";
CM_ SG_ 784 HVAC_PTCExterPwrSupplyFault "External power supply failure";
CM_ SG_ 791 ZCUF_2_CRC "E2E Profile 5 CRC";
CM_ SG_ 791 ZCUF_2_Counter "E2E Profile 5 Counter";
CM_ SG_ 791 WW_FWPMotorSt "FrontWiper Motor status";
CM_ SG_ 791 WW_FWSHMotorSt "FrontWasher motor status";
CM_ SG_ 791 HRN_HornRunningSt "Horn Running status";
CM_ SG_ 791 HRN_HornWorkingTemplet "Horn Working Templet";
CM_ SG_ 791 EL_FLPositionLightSt "Front left position light status";
CM_ SG_ 791 EL_FLPositionLightFaultSt "Front left position light fault status";
CM_ SG_ 791 EL_FRPositionLightSt "Front Right position light status";
CM_ SG_ 791 EL_FRPositionLightFaultSt "Front Right position light fault status";
CM_ SG_ 791 EL_LeftLowBeamSt "Left low beam status";
CM_ SG_ 791 EL_LeftLowBeamFaultSt "Left low beam fault status";
CM_ SG_ 791 EL_RightLowBeamSt "Right low beam status";
CM_ SG_ 791 EL_RightLowBeamFaultSt "Right low beam fault status";
CM_ SG_ 791 EL_LeftHighBeamSt "Left high beam status";
CM_ SG_ 791 EL_LeftHighBeamFaultSt "Left high beam fault status";
CM_ SG_ 791 EL_RightHighBeamSt "Right high beam status";
CM_ SG_ 791 EL_RightHighBeamFaultSt "Right high beam fault status";
CM_ SG_ 791 EL_FLFogLightSt "Front left fog light status";
CM_ SG_ 791 EL_FLFogLightFaultSt "Front left fog light fault status";
CM_ SG_ 791 EL_FRFogLightSt "Front right fog light status";
CM_ SG_ 791 EL_FRFogLightFaultSt "Front right fog light fault status";
CM_ SG_ 791 EL_LeftDRLSt "Left day time running light status";
CM_ SG_ 791 EL_LeftDRLFaultSt "Left day time running light fault status";
CM_ SG_ 791 EL_RightDRLSt "Right day time running light status";
CM_ SG_ 791 EL_RightDRLFaultSt "Right day time running light fault status";
CM_ SG_ 791 EL_FLTurnLightSt "Front left turn light status";
CM_ SG_ 791 EL_FLTurnLightFaultSt "Front left turn light fault status";
CM_ SG_ 791 EL_FRTurnLightSt "Front right turn light status";
CM_ SG_ 791 EL_FRTurnLightFaultSt "Front right turn light fault status";
CM_ SG_ 791 WW_RWSHMotorSt "Rear washer motor status";
CM_ SG_ 791 EL_FADASLightSt "Front ADAS light status";
CM_ SG_ 791 EBSF_BattVolt "Battery voltage";
CM_ SG_ 791 EBSF_CurrentRange "Battery current range";
CM_ SG_ 791 EBSF_BattCurrent "Battery current ";
CM_ SG_ 792 ZCUT_2_CRC "E2E Profile 5 CRC";
CM_ SG_ 792 ZCUT_2_Counter "E2E Profile 5 Counter";
CM_ SG_ 792 UMM_SecondLHSeatSt "Second Left Seat Sensor Status";
CM_ SG_ 792 UMM_SecondRHSeatSt "Second Right Seat Sensor Status";
CM_ SG_ 792 UMM_SecondMIDSeatSt "Second Middle Seat Sensor Status";
CM_ SG_ 792 LCK_PowerFillerCapAngle "PowerFillerCapOpenAngle";
CM_ SG_ 792 EL_ReverseLightSt "Reverse light status";
CM_ SG_ 792 EL_ReverseLightFaultSt "Reverse light fault status";
CM_ SG_ 792 EL_SideBrkLightSt "Side brake light status";
CM_ SG_ 792 EL_SideBrkLightFaultSt "Side brake light fault status";
CM_ SG_ 792 EL_CHMSLSt "Centre high mounted stop lamp status";
CM_ SG_ 792 EL_CHMSLFaultSt "Centre high mounted stop lamp fault status";
CM_ SG_ 792 EL_RLPositionLightSt "Rear left position light status";
CM_ SG_ 792 EL_RLPositionLightFaultSt "Rear left position light fault status";
CM_ SG_ 792 EL_RRPositionLightSt "Rear right position light status";
CM_ SG_ 792 EL_RRPositionLightFaultSt "Rear right position light fault status";
CM_ SG_ 792 EL_RearFogLightSt "Rear fog light status";
CM_ SG_ 792 EL_RearFogLightFaultSt "Rear fog light fault status";
CM_ SG_ 792 EL_RLTurnLightSt "Rear left turn light status";
CM_ SG_ 792 EL_RLTurnLightFaultSt "Rear left turn light fault status";
CM_ SG_ 792 EL_RRTurnLightSt "Rear right turn light status";
CM_ SG_ 792 EL_RRTurnLightFaultSt "Rear right turn light fault status";
CM_ SG_ 792 EL_RADASLightSt "Rear ADAS light status";
CM_ SG_ 616 CCU_1_CRC "E2E Profile 5 CRC";
CM_ SG_ 616 CCU_1_Counter "E2E Profile 5 Counter";
CM_ SG_ 616 UMM_UsageModeSt "Usage mode state";
CM_ SG_ 616 OTA_FuncReq_ADCWakeup "OTA Requset ADC to Wakeup";
CM_ SG_ 616 UMM_DriverSeatSt "Front Left Seat Sensor Status";
CM_ SG_ 616 UMM_FrontPassengerSeatSt "Front Right Seat Sensor Status";
CM_ SG_ 616 VMM_VehModeSt "Vehicle mode state";
CM_ SG_ 616 VMM_LastVehModeSt "Last time vehicle mode";
CM_ SG_ 616 VMM_OTAModeSt "OTA Mode state";
CM_ SG_ 616 CCU_DstFlag "Daylight Saving Time Flag";
CM_ SG_ 616 CSM_RC_PAARequest "CSM_RC_Park request";
CM_ SG_ 616 CSM_RC_AuthSt "Auth Result with SBM/TBOX/KAE";
CM_ SG_ 616 IPDS_EnablePowerSup "Enable power supply";
CM_ SG_ 616 Time_Year "Year number";
CM_ SG_ 616 Time_Month "Month number";
CM_ SG_ 616 Time_Day "Day number";
CM_ SG_ 616 Time_Hour "Hour number";
CM_ SG_ 616 Time_Min "Minute number";
CM_ SG_ 616 Time_Sec "Second number";
CM_ SG_ 616 ASB_DriverActiveBeltFaultSt "Driver Side Active Seat Belt Fault State";
CM_ SG_ 818 HVAC_SysErrSt "HVAC system error  state";
CM_ SG_ 818 HVAC_RefLeakFault "HVAC Serious leakage of Refrigerant";
CM_ SG_ 816 HVAC_WindExitMode "The wind exit mode";
CM_ SG_ 816 HVAC_DriverTempSelect "The selected temperature of Driver side";
CM_ SG_ 816 HVAC_PsnTempSelect "The selected temperature of passenger side";
CM_ SG_ 960 TMS_4_CRC "E2E Profile 5 CRC";
CM_ SG_ 960 TMS_4_Counter "E2E Profile 5 Counter";
CM_ SG_ 960 HVAC_AutoFogFlt "Auto Fog Function Fault Flag";
CM_ SG_ 960 HVAC_AutoFogSts "Auto Fog Function Status";
CM_ SG_ 825 CCU_FuncReq_SentryMod "Sentry Mode Wake SOC of MDC";
CM_ SG_ 291 CCU_6_CRC "E2E Profile 5 CRC";
CM_ SG_ 291 CCU_6_Counter "E2E Profile 5 Counter";
CM_ SG_ 291 ATWS_ATWSAlarmReq "ATWS Alarm Request";
CM_ SG_ 291 ATWS_ATWSSt "ATWS status";
CM_ SG_ 291 WW_FrontWasherCmd "Front Washer driver command";
CM_ SG_ 291 WW_FrontWiperCmd_Speed "front wiper speed command";
CM_ SG_ 291 WW_FrontWiperCtrlSt "Front wiper control status";
CM_ SG_ 291 WW_RearWiperCtrlSt "Rear wiper control status";
CM_ SG_ 291 WW_FrontWiperCtrlSrc "Front wiper control source";
CM_ SG_ 291 WW_RearWiperCtrlSrc "Rear wiper control source";
CM_ SG_ 291 WW_RearCamWasherVKResp "Rear Camera Washer Request";
CM_ SG_ 291 WW_RearCamWasherVRResp "Rear Camera Washer Request";
CM_ SG_ 865 EL_ReverseLightCtrlCmd "Reverse light control command";
CM_ SG_ 865 EL_SideBrkLightCtrlCmd "Side brake light control command";
CM_ SG_ 865 EL_LeftLowBeamCtrlCmd "Left low beam control command";
CM_ SG_ 865 EL_RightLowBeamCtrlCmd "Right low beam control command";
CM_ SG_ 865 EL_PositionLightCtrlSource "Position light control source";
CM_ SG_ 865 EL_LeftHighBeamCtrlCmd "Left high beam control command";
CM_ SG_ 865 EL_RightHighBeamCtrlCmd "Right high beam control command";
CM_ SG_ 865 EL_LowBeamCtrlSource "Low beam control source";
CM_ SG_ 865 EL_RearFogLightCtrlSource "Rear fog light control source";
CM_ SG_ 865 EL_HighBeamCtrlSource "High beam control source";
CM_ SG_ 865 EL_FrontFogLightCtrlSource "Front fog lgiht control source";
CM_ SG_ 865 EL_LicencePlateLightCtrlSource "Licence plate light control source";
CM_ SG_ 865 EL_FlasherCtrlSource "Flasher control source";
CM_ SG_ 865 EL_FADASLightCtrlCmd "Front ADAS light control command";
CM_ SG_ 865 EL_RADASLightCtrlCmd "Rear ADAS light control command";
CM_ SG_ 865 EL_IHBColourSt "Intelligent high beam colour status";
CM_ SG_ 865 EL_ADC_2_VERFailFlag "ADC_2 Message Verification Fail Flag";
CM_ SG_ 865 EL_ADC_4_New_VERFailFlag "ADC_4_X Message Verification Fail Flag";
CM_ SG_ 865 EL_ADC_8_VERFailFlag "ADC_8 Message Verification Fail Flag";
CM_ SG_ 865 EL_ADBEnable "ADB enable";
CM_ SG_ 865 EL_HeadLightLevelingSWSt "Head light leveling manul adjust switch status";
CM_ SG_ 865 EL_LeftTurnLightStForDisp "Left turn light status";
CM_ SG_ 865 EL_RightTurnLightStForDisp "Right turn light status";
CM_ SG_ 865 EL_PositionLightStForDisp "Position light status";
CM_ SG_ 865 EL_FrontFogLightStForDisp "Front fog light status";
CM_ SG_ 865 EL_RearFogLightStForDisp "Rear fog light status";
CM_ SG_ 865 EL_LowBeamStForDisp "Low beam status";
CM_ SG_ 865 EL_HighBeamStForDisp "High beam status";
CM_ SG_ 865 EL_HeadLightSWSt "Headlight switch status";
CM_ SG_ 293 TPMS_FrontLeftTireBlowout "Front Left Tire Blow Out State";
CM_ SG_ 293 TPMS_FrontRightTireBlowout "Front Right Tire Blow Out State";
CM_ SG_ 293 TPMS_RearRightTireBlowout "Rear Right Tire Blow Out State";
CM_ SG_ 293 TPMS_RearLeftTireBlowout "Rear Left Tire Blow Out State";
CM_ SG_ 293 TPMS_FrontLeftTirePressure "FrontLeftTirePressure";
CM_ SG_ 293 TPMS_FrontRightTirePressure "FrontRightTirePressure";
CM_ SG_ 293 TPMS_RearRightTirePressure "RearRightTirePressure";
CM_ SG_ 293 TPMS_RearLeftTirePressure "RearLeftTirePressure";
CM_ SG_ 293 TPMS_TireWarningLamp "TireWarningLamp";
CM_ SG_ 293 TPMS_SystemWarningLamp "SystemWarningLamp";
CM_ SG_ 294 LCK_DriverDoorAjarSt "DriverDoorAjarST ";
CM_ SG_ 294 LCK_PassengerDoorAjarSt "PassengerDoorAjarST";
CM_ SG_ 294 LCK_DriverDoorLockSt "DriverDoorLockSt";
CM_ SG_ 294 LCK_PassengerDoorLockSt "PassengerDoorLockSt";
CM_ SG_ 294 LCK_VehicleDoorAjarSt "VehicleDoorAjarSt";
CM_ SG_ 294 LCK_VehicleDoorLockSt "VehicleDoorLockSt";
CM_ SG_ 294 LCK_VehicleChildSaftyLockSt "VehicleChildSaftyLockSt";
CM_ SG_ 294 LCK_VehicleChildSaftyLockedIndicate "VehicleChildSaftyLockedIndicate";
CM_ SG_ 294 LCK_PowerFillerCapSt "PowerFillerCapSt";
CM_ SG_ 294 KAE_UserDefinedCfgSt "User_defined Configuration Statusbit0~bit7=corresponding bit , 1 means active , 0 means not active";
CM_ SG_ 294 CCU_9_FreshnessValue "Freshness value in SecOC security message";
CM_ SG_ 294 CCU_9_MAC_Check "MAC value in SecOC security message";

BA_DEF_ BO_  "GenMsgCycleTime" INT 0 0;
BA_DEF_ BO_  "GenMsgCycleTimeFast" INT 0 0;
BA_DEF_ BO_  "GenMsgSendType" ENUM  "Periodic","Event","IfActive","POE","PA","FixedPeriodic","Event","EnabledPeriodic","NotUsed","NotUsed","EventPeriodic","NotUsed","NotUsed","NoMsgSendType";
BA_DEF_ BO_  "VFrameFormat" ENUM  "StandardCAN","ExtendedCAN","reserved","reserved","reserved","reserved","reserved","reserved","reserved","reserved","reserved","reserved","reserved","reserved","StandardCAN_FD","ExtendedCAN_FD";
BA_DEF_ BO_  "CANFD_BRS" ENUM  "0","1";
BA_DEF_ SG_  "EventCommandSignal" ENUM  "No","Yes";
BA_DEF_ SG_  "GatewayedSignals" ENUM  "No","Yes";
BA_DEF_ SG_  "GenSigInactiveValue" HEX 0 0;
BA_DEF_ SG_  "GenSigInvalidValue" HEX 0 0;
BA_DEF_ SG_  "GenSigSendType" ENUM  "Trigger","Passive","Cyclic","OnWrite","OnWriteWithRepetition","OnChange","OnChangeWithRepetition","IfActive","IfActiveWithRepetition","NoSigSendType";
BA_DEF_ SG_  "GenSigStartValue" HEX 0 0;
BA_DEF_ SG_  "GenSigTimeoutValue" HEX 0 0;
BA_DEF_ SG_  "Remark" STRING ;
BA_DEF_  "Manufacturer" STRING ;
BA_DEF_  "Project" STRING ;
BA_DEF_  "Version" STRING ;
BA_DEF_  "Date" STRING ;
BA_DEF_  "Author" STRING ;
BA_DEF_  "DBName" STRING ;
BA_DEF_  "BusType" STRING ;
BA_DEF_  "Checker" STRING ;
BA_DEF_  "Approver" STRING ;
BA_ "Manufacturer" "GACRND";
BA_ "Project" "A88";
BA_ "Version" "0.1";
BA_ "Date" "2026-7-8 10:31:28";
BA_ "Author" "LeoFeng";
BA_ "DBName" "ADCPublic_CANFD1";
BA_ "BusType" "CAN FD";
BA_ "Checker" "Miss Fan";
BA_ "Approver" "Mr Hu";

BA_ "GenMsgCycleTime" BO_ 777 100;
BA_ "GenMsgCycleTimeFast" BO_ 777 0;
BA_ "GenMsgSendType" BO_ 777 0;
BA_ "VFrameFormat" BO_ 777 14;
BA_ "CANFD_BRS" BO_ 777 1;
BA_ "GenMsgCycleTime" BO_ 777 100;
BA_ "GenMsgCycleTimeFast" BO_ 777 0;
BA_ "GenMsgSendType" BO_ 777 0;
BA_ "VFrameFormat" BO_ 777 14;
BA_ "CANFD_BRS" BO_ 777 1;
BA_ "GenMsgCycleTime" BO_ 777 100;
BA_ "GenMsgCycleTimeFast" BO_ 777 0;
BA_ "GenMsgSendType" BO_ 777 0;
BA_ "VFrameFormat" BO_ 777 14;
BA_ "CANFD_BRS" BO_ 777 1;
BA_ "GenMsgCycleTime" BO_ 777 100;
BA_ "GenMsgCycleTimeFast" BO_ 777 0;
BA_ "GenMsgSendType" BO_ 777 0;
BA_ "VFrameFormat" BO_ 777 14;
BA_ "CANFD_BRS" BO_ 777 1;
BA_ "GenMsgCycleTime" BO_ 777 100;
BA_ "GenMsgCycleTimeFast" BO_ 777 0;
BA_ "GenMsgSendType" BO_ 777 0;
BA_ "VFrameFormat" BO_ 777 14;
BA_ "CANFD_BRS" BO_ 777 1;
BA_ "GenMsgCycleTime" BO_ 777 100;
BA_ "GenMsgCycleTimeFast" BO_ 777 0;
BA_ "GenMsgSendType" BO_ 777 0;
BA_ "VFrameFormat" BO_ 777 14;
BA_ "CANFD_BRS" BO_ 777 1;
BA_ "GenMsgCycleTime" BO_ 777 100;
BA_ "GenMsgCycleTimeFast" BO_ 777 0;
BA_ "GenMsgSendType" BO_ 777 0;
BA_ "VFrameFormat" BO_ 777 14;
BA_ "CANFD_BRS" BO_ 777 1;
BA_ "GenMsgCycleTime" BO_ 777 100;
BA_ "GenMsgCycleTimeFast" BO_ 777 0;
BA_ "GenMsgSendType" BO_ 777 0;
BA_ "VFrameFormat" BO_ 777 14;
BA_ "CANFD_BRS" BO_ 777 1;
BA_ "GenMsgCycleTime" BO_ 777 100;
BA_ "GenMsgCycleTimeFast" BO_ 777 0;
BA_ "GenMsgSendType" BO_ 777 0;
BA_ "VFrameFormat" BO_ 777 14;
BA_ "CANFD_BRS" BO_ 777 1;
BA_ "GenMsgCycleTime" BO_ 342 40;
BA_ "GenMsgCycleTimeFast" BO_ 342 0;
BA_ "GenMsgSendType" BO_ 342 0;
BA_ "VFrameFormat" BO_ 342 14;
BA_ "CANFD_BRS" BO_ 342 1;
BA_ "GenMsgCycleTime" BO_ 342 40;
BA_ "GenMsgCycleTimeFast" BO_ 342 0;
BA_ "GenMsgSendType" BO_ 342 0;
BA_ "VFrameFormat" BO_ 342 14;
BA_ "CANFD_BRS" BO_ 342 1;
BA_ "GenMsgCycleTime" BO_ 342 40;
BA_ "GenMsgCycleTimeFast" BO_ 342 0;
BA_ "GenMsgSendType" BO_ 342 0;
BA_ "VFrameFormat" BO_ 342 14;
BA_ "CANFD_BRS" BO_ 342 1;
BA_ "GenMsgCycleTime" BO_ 342 40;
BA_ "GenMsgCycleTimeFast" BO_ 342 0;
BA_ "GenMsgSendType" BO_ 342 0;
BA_ "VFrameFormat" BO_ 342 14;
BA_ "CANFD_BRS" BO_ 342 1;
BA_ "GenMsgCycleTime" BO_ 342 40;
BA_ "GenMsgCycleTimeFast" BO_ 342 0;
BA_ "GenMsgSendType" BO_ 342 0;
BA_ "VFrameFormat" BO_ 342 14;
BA_ "CANFD_BRS" BO_ 342 1;
BA_ "GenMsgCycleTime" BO_ 342 40;
BA_ "GenMsgCycleTimeFast" BO_ 342 0;
BA_ "GenMsgSendType" BO_ 342 0;
BA_ "VFrameFormat" BO_ 342 14;
BA_ "CANFD_BRS" BO_ 342 1;
BA_ "GenMsgCycleTime" BO_ 342 40;
BA_ "GenMsgCycleTimeFast" BO_ 342 0;
BA_ "GenMsgSendType" BO_ 342 0;
BA_ "VFrameFormat" BO_ 342 14;
BA_ "CANFD_BRS" BO_ 342 1;
BA_ "GenMsgCycleTime" BO_ 342 40;
BA_ "GenMsgCycleTimeFast" BO_ 342 0;
BA_ "GenMsgSendType" BO_ 342 0;
BA_ "VFrameFormat" BO_ 342 14;
BA_ "CANFD_BRS" BO_ 342 1;
BA_ "GenMsgCycleTime" BO_ 342 40;
BA_ "GenMsgCycleTimeFast" BO_ 342 0;
BA_ "GenMsgSendType" BO_ 342 0;
BA_ "VFrameFormat" BO_ 342 14;
BA_ "CANFD_BRS" BO_ 342 1;
BA_ "GenMsgCycleTime" BO_ 342 40;
BA_ "GenMsgCycleTimeFast" BO_ 342 0;
BA_ "GenMsgSendType" BO_ 342 0;
BA_ "VFrameFormat" BO_ 342 14;
BA_ "CANFD_BRS" BO_ 342 1;
BA_ "GenMsgCycleTime" BO_ 342 40;
BA_ "GenMsgCycleTimeFast" BO_ 342 0;
BA_ "GenMsgSendType" BO_ 342 0;
BA_ "VFrameFormat" BO_ 342 14;
BA_ "CANFD_BRS" BO_ 342 1;
BA_ "GenMsgCycleTime" BO_ 342 40;
BA_ "GenMsgCycleTimeFast" BO_ 342 0;
BA_ "GenMsgSendType" BO_ 342 0;
BA_ "VFrameFormat" BO_ 342 14;
BA_ "CANFD_BRS" BO_ 342 1;
BA_ "GenMsgCycleTime" BO_ 342 40;
BA_ "GenMsgCycleTimeFast" BO_ 342 0;
BA_ "GenMsgSendType" BO_ 342 0;
BA_ "VFrameFormat" BO_ 342 14;
BA_ "CANFD_BRS" BO_ 342 1;
BA_ "GenMsgCycleTime" BO_ 776 100;
BA_ "GenMsgCycleTimeFast" BO_ 776 0;
BA_ "GenMsgSendType" BO_ 776 0;
BA_ "VFrameFormat" BO_ 776 14;
BA_ "CANFD_BRS" BO_ 776 1;
BA_ "GenMsgCycleTime" BO_ 957 90;
BA_ "GenMsgCycleTimeFast" BO_ 957 0;
BA_ "GenMsgSendType" BO_ 957 0;
BA_ "VFrameFormat" BO_ 957 14;
BA_ "CANFD_BRS" BO_ 957 1;
BA_ "GenMsgCycleTime" BO_ 957 90;
BA_ "GenMsgCycleTimeFast" BO_ 957 0;
BA_ "GenMsgSendType" BO_ 957 0;
BA_ "VFrameFormat" BO_ 957 14;
BA_ "CANFD_BRS" BO_ 957 1;
BA_ "GenMsgCycleTime" BO_ 957 90;
BA_ "GenMsgCycleTimeFast" BO_ 957 0;
BA_ "GenMsgSendType" BO_ 957 0;
BA_ "VFrameFormat" BO_ 957 14;
BA_ "CANFD_BRS" BO_ 957 1;
BA_ "GenMsgCycleTime" BO_ 957 90;
BA_ "GenMsgCycleTimeFast" BO_ 957 0;
BA_ "GenMsgSendType" BO_ 957 0;
BA_ "VFrameFormat" BO_ 957 14;
BA_ "CANFD_BRS" BO_ 957 1;
BA_ "GenMsgCycleTime" BO_ 957 90;
BA_ "GenMsgCycleTimeFast" BO_ 957 0;
BA_ "GenMsgSendType" BO_ 957 0;
BA_ "VFrameFormat" BO_ 957 14;
BA_ "CANFD_BRS" BO_ 957 1;
BA_ "GenMsgCycleTime" BO_ 957 90;
BA_ "GenMsgCycleTimeFast" BO_ 957 0;
BA_ "GenMsgSendType" BO_ 957 0;
BA_ "VFrameFormat" BO_ 957 14;
BA_ "CANFD_BRS" BO_ 957 1;
BA_ "GenMsgCycleTime" BO_ 957 90;
BA_ "GenMsgCycleTimeFast" BO_ 957 0;
BA_ "GenMsgSendType" BO_ 957 0;
BA_ "VFrameFormat" BO_ 957 14;
BA_ "CANFD_BRS" BO_ 957 1;
BA_ "GenMsgCycleTime" BO_ 957 90;
BA_ "GenMsgCycleTimeFast" BO_ 957 0;
BA_ "GenMsgSendType" BO_ 957 0;
BA_ "VFrameFormat" BO_ 957 14;
BA_ "CANFD_BRS" BO_ 957 1;
BA_ "GenMsgCycleTime" BO_ 957 90;
BA_ "GenMsgCycleTimeFast" BO_ 957 0;
BA_ "GenMsgSendType" BO_ 957 0;
BA_ "VFrameFormat" BO_ 957 14;
BA_ "CANFD_BRS" BO_ 957 1;
BA_ "GenMsgCycleTime" BO_ 957 90;
BA_ "GenMsgCycleTimeFast" BO_ 957 0;
BA_ "GenMsgSendType" BO_ 957 0;
BA_ "VFrameFormat" BO_ 957 14;
BA_ "CANFD_BRS" BO_ 957 1;
BA_ "GenMsgCycleTime" BO_ 957 90;
BA_ "GenMsgCycleTimeFast" BO_ 957 0;
BA_ "GenMsgSendType" BO_ 957 0;
BA_ "VFrameFormat" BO_ 957 14;
BA_ "CANFD_BRS" BO_ 957 1;
BA_ "GenMsgCycleTime" BO_ 957 90;
BA_ "GenMsgCycleTimeFast" BO_ 957 0;
BA_ "GenMsgSendType" BO_ 957 0;
BA_ "VFrameFormat" BO_ 957 14;
BA_ "CANFD_BRS" BO_ 957 1;
BA_ "GenMsgCycleTime" BO_ 957 90;
BA_ "GenMsgCycleTimeFast" BO_ 957 0;
BA_ "GenMsgSendType" BO_ 957 0;
BA_ "VFrameFormat" BO_ 957 14;
BA_ "CANFD_BRS" BO_ 957 1;
BA_ "GenMsgCycleTime" BO_ 957 90;
BA_ "GenMsgCycleTimeFast" BO_ 957 0;
BA_ "GenMsgSendType" BO_ 957 0;
BA_ "VFrameFormat" BO_ 957 14;
BA_ "CANFD_BRS" BO_ 957 1;
BA_ "GenMsgCycleTime" BO_ 957 90;
BA_ "GenMsgCycleTimeFast" BO_ 957 0;
BA_ "GenMsgSendType" BO_ 957 0;
BA_ "VFrameFormat" BO_ 957 14;
BA_ "CANFD_BRS" BO_ 957 1;
BA_ "GenMsgCycleTime" BO_ 957 90;
BA_ "GenMsgCycleTimeFast" BO_ 957 0;
BA_ "GenMsgSendType" BO_ 957 0;
BA_ "VFrameFormat" BO_ 957 14;
BA_ "CANFD_BRS" BO_ 957 1;
BA_ "GenMsgCycleTime" BO_ 957 90;
BA_ "GenMsgCycleTimeFast" BO_ 957 0;
BA_ "GenMsgSendType" BO_ 957 0;
BA_ "VFrameFormat" BO_ 957 14;
BA_ "CANFD_BRS" BO_ 957 1;
BA_ "GenMsgCycleTime" BO_ 957 90;
BA_ "GenMsgCycleTimeFast" BO_ 957 0;
BA_ "GenMsgSendType" BO_ 957 0;
BA_ "VFrameFormat" BO_ 957 14;
BA_ "CANFD_BRS" BO_ 957 1;
BA_ "GenMsgCycleTime" BO_ 957 90;
BA_ "GenMsgCycleTimeFast" BO_ 957 0;
BA_ "GenMsgSendType" BO_ 957 0;
BA_ "VFrameFormat" BO_ 957 14;
BA_ "CANFD_BRS" BO_ 957 1;
BA_ "GenMsgCycleTime" BO_ 957 90;
BA_ "GenMsgCycleTimeFast" BO_ 957 0;
BA_ "GenMsgSendType" BO_ 957 0;
BA_ "VFrameFormat" BO_ 957 14;
BA_ "CANFD_BRS" BO_ 957 1;
BA_ "GenMsgCycleTime" BO_ 784 100;
BA_ "GenMsgCycleTimeFast" BO_ 784 0;
BA_ "GenMsgSendType" BO_ 784 0;
BA_ "VFrameFormat" BO_ 784 14;
BA_ "CANFD_BRS" BO_ 784 1;
BA_ "GenMsgCycleTime" BO_ 791 100;
BA_ "GenMsgCycleTimeFast" BO_ 791 0;
BA_ "GenMsgSendType" BO_ 791 0;
BA_ "VFrameFormat" BO_ 791 14;
BA_ "CANFD_BRS" BO_ 791 1;
BA_ "GenMsgCycleTime" BO_ 791 100;
BA_ "GenMsgCycleTimeFast" BO_ 791 0;
BA_ "GenMsgSendType" BO_ 791 0;
BA_ "VFrameFormat" BO_ 791 14;
BA_ "CANFD_BRS" BO_ 791 1;
BA_ "GenMsgCycleTime" BO_ 791 100;
BA_ "GenMsgCycleTimeFast" BO_ 791 0;
BA_ "GenMsgSendType" BO_ 791 0;
BA_ "VFrameFormat" BO_ 791 14;
BA_ "CANFD_BRS" BO_ 791 1;
BA_ "GenMsgCycleTime" BO_ 791 100;
BA_ "GenMsgCycleTimeFast" BO_ 791 0;
BA_ "GenMsgSendType" BO_ 791 0;
BA_ "VFrameFormat" BO_ 791 14;
BA_ "CANFD_BRS" BO_ 791 1;
BA_ "GenMsgCycleTime" BO_ 791 100;
BA_ "GenMsgCycleTimeFast" BO_ 791 0;
BA_ "GenMsgSendType" BO_ 791 0;
BA_ "VFrameFormat" BO_ 791 14;
BA_ "CANFD_BRS" BO_ 791 1;
BA_ "GenMsgCycleTime" BO_ 791 100;
BA_ "GenMsgCycleTimeFast" BO_ 791 0;
BA_ "GenMsgSendType" BO_ 791 0;
BA_ "VFrameFormat" BO_ 791 14;
BA_ "CANFD_BRS" BO_ 791 1;
BA_ "GenMsgCycleTime" BO_ 791 100;
BA_ "GenMsgCycleTimeFast" BO_ 791 0;
BA_ "GenMsgSendType" BO_ 791 0;
BA_ "VFrameFormat" BO_ 791 14;
BA_ "CANFD_BRS" BO_ 791 1;
BA_ "GenMsgCycleTime" BO_ 791 100;
BA_ "GenMsgCycleTimeFast" BO_ 791 0;
BA_ "GenMsgSendType" BO_ 791 0;
BA_ "VFrameFormat" BO_ 791 14;
BA_ "CANFD_BRS" BO_ 791 1;
BA_ "GenMsgCycleTime" BO_ 791 100;
BA_ "GenMsgCycleTimeFast" BO_ 791 0;
BA_ "GenMsgSendType" BO_ 791 0;
BA_ "VFrameFormat" BO_ 791 14;
BA_ "CANFD_BRS" BO_ 791 1;
BA_ "GenMsgCycleTime" BO_ 791 100;
BA_ "GenMsgCycleTimeFast" BO_ 791 0;
BA_ "GenMsgSendType" BO_ 791 0;
BA_ "VFrameFormat" BO_ 791 14;
BA_ "CANFD_BRS" BO_ 791 1;
BA_ "GenMsgCycleTime" BO_ 791 100;
BA_ "GenMsgCycleTimeFast" BO_ 791 0;
BA_ "GenMsgSendType" BO_ 791 0;
BA_ "VFrameFormat" BO_ 791 14;
BA_ "CANFD_BRS" BO_ 791 1;
BA_ "GenMsgCycleTime" BO_ 791 100;
BA_ "GenMsgCycleTimeFast" BO_ 791 0;
BA_ "GenMsgSendType" BO_ 791 0;
BA_ "VFrameFormat" BO_ 791 14;
BA_ "CANFD_BRS" BO_ 791 1;
BA_ "GenMsgCycleTime" BO_ 791 100;
BA_ "GenMsgCycleTimeFast" BO_ 791 0;
BA_ "GenMsgSendType" BO_ 791 0;
BA_ "VFrameFormat" BO_ 791 14;
BA_ "CANFD_BRS" BO_ 791 1;
BA_ "GenMsgCycleTime" BO_ 791 100;
BA_ "GenMsgCycleTimeFast" BO_ 791 0;
BA_ "GenMsgSendType" BO_ 791 0;
BA_ "VFrameFormat" BO_ 791 14;
BA_ "CANFD_BRS" BO_ 791 1;
BA_ "GenMsgCycleTime" BO_ 791 100;
BA_ "GenMsgCycleTimeFast" BO_ 791 0;
BA_ "GenMsgSendType" BO_ 791 0;
BA_ "VFrameFormat" BO_ 791 14;
BA_ "CANFD_BRS" BO_ 791 1;
BA_ "GenMsgCycleTime" BO_ 791 100;
BA_ "GenMsgCycleTimeFast" BO_ 791 0;
BA_ "GenMsgSendType" BO_ 791 0;
BA_ "VFrameFormat" BO_ 791 14;
BA_ "CANFD_BRS" BO_ 791 1;
BA_ "GenMsgCycleTime" BO_ 791 100;
BA_ "GenMsgCycleTimeFast" BO_ 791 0;
BA_ "GenMsgSendType" BO_ 791 0;
BA_ "VFrameFormat" BO_ 791 14;
BA_ "CANFD_BRS" BO_ 791 1;
BA_ "GenMsgCycleTime" BO_ 791 100;
BA_ "GenMsgCycleTimeFast" BO_ 791 0;
BA_ "GenMsgSendType" BO_ 791 0;
BA_ "VFrameFormat" BO_ 791 14;
BA_ "CANFD_BRS" BO_ 791 1;
BA_ "GenMsgCycleTime" BO_ 791 100;
BA_ "GenMsgCycleTimeFast" BO_ 791 0;
BA_ "GenMsgSendType" BO_ 791 0;
BA_ "VFrameFormat" BO_ 791 14;
BA_ "CANFD_BRS" BO_ 791 1;
BA_ "GenMsgCycleTime" BO_ 791 100;
BA_ "GenMsgCycleTimeFast" BO_ 791 0;
BA_ "GenMsgSendType" BO_ 791 0;
BA_ "VFrameFormat" BO_ 791 14;
BA_ "CANFD_BRS" BO_ 791 1;
BA_ "GenMsgCycleTime" BO_ 791 100;
BA_ "GenMsgCycleTimeFast" BO_ 791 0;
BA_ "GenMsgSendType" BO_ 791 0;
BA_ "VFrameFormat" BO_ 791 14;
BA_ "CANFD_BRS" BO_ 791 1;
BA_ "GenMsgCycleTime" BO_ 791 100;
BA_ "GenMsgCycleTimeFast" BO_ 791 0;
BA_ "GenMsgSendType" BO_ 791 0;
BA_ "VFrameFormat" BO_ 791 14;
BA_ "CANFD_BRS" BO_ 791 1;
BA_ "GenMsgCycleTime" BO_ 791 100;
BA_ "GenMsgCycleTimeFast" BO_ 791 0;
BA_ "GenMsgSendType" BO_ 791 0;
BA_ "VFrameFormat" BO_ 791 14;
BA_ "CANFD_BRS" BO_ 791 1;
BA_ "GenMsgCycleTime" BO_ 791 100;
BA_ "GenMsgCycleTimeFast" BO_ 791 0;
BA_ "GenMsgSendType" BO_ 791 0;
BA_ "VFrameFormat" BO_ 791 14;
BA_ "CANFD_BRS" BO_ 791 1;
BA_ "GenMsgCycleTime" BO_ 791 100;
BA_ "GenMsgCycleTimeFast" BO_ 791 0;
BA_ "GenMsgSendType" BO_ 791 0;
BA_ "VFrameFormat" BO_ 791 14;
BA_ "CANFD_BRS" BO_ 791 1;
BA_ "GenMsgCycleTime" BO_ 791 100;
BA_ "GenMsgCycleTimeFast" BO_ 791 0;
BA_ "GenMsgSendType" BO_ 791 0;
BA_ "VFrameFormat" BO_ 791 14;
BA_ "CANFD_BRS" BO_ 791 1;
BA_ "GenMsgCycleTime" BO_ 791 100;
BA_ "GenMsgCycleTimeFast" BO_ 791 0;
BA_ "GenMsgSendType" BO_ 791 0;
BA_ "VFrameFormat" BO_ 791 14;
BA_ "CANFD_BRS" BO_ 791 1;
BA_ "GenMsgCycleTime" BO_ 791 100;
BA_ "GenMsgCycleTimeFast" BO_ 791 0;
BA_ "GenMsgSendType" BO_ 791 0;
BA_ "VFrameFormat" BO_ 791 14;
BA_ "CANFD_BRS" BO_ 791 1;
BA_ "GenMsgCycleTime" BO_ 791 100;
BA_ "GenMsgCycleTimeFast" BO_ 791 0;
BA_ "GenMsgSendType" BO_ 791 0;
BA_ "VFrameFormat" BO_ 791 14;
BA_ "CANFD_BRS" BO_ 791 1;
BA_ "GenMsgCycleTime" BO_ 791 100;
BA_ "GenMsgCycleTimeFast" BO_ 791 0;
BA_ "GenMsgSendType" BO_ 791 0;
BA_ "VFrameFormat" BO_ 791 14;
BA_ "CANFD_BRS" BO_ 791 1;
BA_ "GenMsgCycleTime" BO_ 791 100;
BA_ "GenMsgCycleTimeFast" BO_ 791 0;
BA_ "GenMsgSendType" BO_ 791 0;
BA_ "VFrameFormat" BO_ 791 14;
BA_ "CANFD_BRS" BO_ 791 1;
BA_ "GenMsgCycleTime" BO_ 791 100;
BA_ "GenMsgCycleTimeFast" BO_ 791 0;
BA_ "GenMsgSendType" BO_ 791 0;
BA_ "VFrameFormat" BO_ 791 14;
BA_ "CANFD_BRS" BO_ 791 1;
BA_ "GenMsgCycleTime" BO_ 791 100;
BA_ "GenMsgCycleTimeFast" BO_ 791 0;
BA_ "GenMsgSendType" BO_ 791 0;
BA_ "VFrameFormat" BO_ 791 14;
BA_ "CANFD_BRS" BO_ 791 1;
BA_ "GenMsgCycleTime" BO_ 791 100;
BA_ "GenMsgCycleTimeFast" BO_ 791 0;
BA_ "GenMsgSendType" BO_ 791 0;
BA_ "VFrameFormat" BO_ 791 14;
BA_ "CANFD_BRS" BO_ 791 1;
BA_ "GenMsgCycleTime" BO_ 791 100;
BA_ "GenMsgCycleTimeFast" BO_ 791 0;
BA_ "GenMsgSendType" BO_ 791 0;
BA_ "VFrameFormat" BO_ 791 14;
BA_ "CANFD_BRS" BO_ 791 1;
BA_ "GenMsgCycleTime" BO_ 792 100;
BA_ "GenMsgCycleTimeFast" BO_ 792 0;
BA_ "GenMsgSendType" BO_ 792 0;
BA_ "VFrameFormat" BO_ 792 14;
BA_ "CANFD_BRS" BO_ 792 1;
BA_ "GenMsgCycleTime" BO_ 792 100;
BA_ "GenMsgCycleTimeFast" BO_ 792 0;
BA_ "GenMsgSendType" BO_ 792 0;
BA_ "VFrameFormat" BO_ 792 14;
BA_ "CANFD_BRS" BO_ 792 1;
BA_ "GenMsgCycleTime" BO_ 792 100;
BA_ "GenMsgCycleTimeFast" BO_ 792 0;
BA_ "GenMsgSendType" BO_ 792 0;
BA_ "VFrameFormat" BO_ 792 14;
BA_ "CANFD_BRS" BO_ 792 1;
BA_ "GenMsgCycleTime" BO_ 792 100;
BA_ "GenMsgCycleTimeFast" BO_ 792 0;
BA_ "GenMsgSendType" BO_ 792 0;
BA_ "VFrameFormat" BO_ 792 14;
BA_ "CANFD_BRS" BO_ 792 1;
BA_ "GenMsgCycleTime" BO_ 792 100;
BA_ "GenMsgCycleTimeFast" BO_ 792 0;
BA_ "GenMsgSendType" BO_ 792 0;
BA_ "VFrameFormat" BO_ 792 14;
BA_ "CANFD_BRS" BO_ 792 1;
BA_ "GenMsgCycleTime" BO_ 792 100;
BA_ "GenMsgCycleTimeFast" BO_ 792 0;
BA_ "GenMsgSendType" BO_ 792 0;
BA_ "VFrameFormat" BO_ 792 14;
BA_ "CANFD_BRS" BO_ 792 1;
BA_ "GenMsgCycleTime" BO_ 792 100;
BA_ "GenMsgCycleTimeFast" BO_ 792 0;
BA_ "GenMsgSendType" BO_ 792 0;
BA_ "VFrameFormat" BO_ 792 14;
BA_ "CANFD_BRS" BO_ 792 1;
BA_ "GenMsgCycleTime" BO_ 792 100;
BA_ "GenMsgCycleTimeFast" BO_ 792 0;
BA_ "GenMsgSendType" BO_ 792 0;
BA_ "VFrameFormat" BO_ 792 14;
BA_ "CANFD_BRS" BO_ 792 1;
BA_ "GenMsgCycleTime" BO_ 792 100;
BA_ "GenMsgCycleTimeFast" BO_ 792 0;
BA_ "GenMsgSendType" BO_ 792 0;
BA_ "VFrameFormat" BO_ 792 14;
BA_ "CANFD_BRS" BO_ 792 1;
BA_ "GenMsgCycleTime" BO_ 792 100;
BA_ "GenMsgCycleTimeFast" BO_ 792 0;
BA_ "GenMsgSendType" BO_ 792 0;
BA_ "VFrameFormat" BO_ 792 14;
BA_ "CANFD_BRS" BO_ 792 1;
BA_ "GenMsgCycleTime" BO_ 792 100;
BA_ "GenMsgCycleTimeFast" BO_ 792 0;
BA_ "GenMsgSendType" BO_ 792 0;
BA_ "VFrameFormat" BO_ 792 14;
BA_ "CANFD_BRS" BO_ 792 1;
BA_ "GenMsgCycleTime" BO_ 792 100;
BA_ "GenMsgCycleTimeFast" BO_ 792 0;
BA_ "GenMsgSendType" BO_ 792 0;
BA_ "VFrameFormat" BO_ 792 14;
BA_ "CANFD_BRS" BO_ 792 1;
BA_ "GenMsgCycleTime" BO_ 792 100;
BA_ "GenMsgCycleTimeFast" BO_ 792 0;
BA_ "GenMsgSendType" BO_ 792 0;
BA_ "VFrameFormat" BO_ 792 14;
BA_ "CANFD_BRS" BO_ 792 1;
BA_ "GenMsgCycleTime" BO_ 792 100;
BA_ "GenMsgCycleTimeFast" BO_ 792 0;
BA_ "GenMsgSendType" BO_ 792 0;
BA_ "VFrameFormat" BO_ 792 14;
BA_ "CANFD_BRS" BO_ 792 1;
BA_ "GenMsgCycleTime" BO_ 792 100;
BA_ "GenMsgCycleTimeFast" BO_ 792 0;
BA_ "GenMsgSendType" BO_ 792 0;
BA_ "VFrameFormat" BO_ 792 14;
BA_ "CANFD_BRS" BO_ 792 1;
BA_ "GenMsgCycleTime" BO_ 792 100;
BA_ "GenMsgCycleTimeFast" BO_ 792 0;
BA_ "GenMsgSendType" BO_ 792 0;
BA_ "VFrameFormat" BO_ 792 14;
BA_ "CANFD_BRS" BO_ 792 1;
BA_ "GenMsgCycleTime" BO_ 792 100;
BA_ "GenMsgCycleTimeFast" BO_ 792 0;
BA_ "GenMsgSendType" BO_ 792 0;
BA_ "VFrameFormat" BO_ 792 14;
BA_ "CANFD_BRS" BO_ 792 1;
BA_ "GenMsgCycleTime" BO_ 792 100;
BA_ "GenMsgCycleTimeFast" BO_ 792 0;
BA_ "GenMsgSendType" BO_ 792 0;
BA_ "VFrameFormat" BO_ 792 14;
BA_ "CANFD_BRS" BO_ 792 1;
BA_ "GenMsgCycleTime" BO_ 792 100;
BA_ "GenMsgCycleTimeFast" BO_ 792 0;
BA_ "GenMsgSendType" BO_ 792 0;
BA_ "VFrameFormat" BO_ 792 14;
BA_ "CANFD_BRS" BO_ 792 1;
BA_ "GenMsgCycleTime" BO_ 792 100;
BA_ "GenMsgCycleTimeFast" BO_ 792 0;
BA_ "GenMsgSendType" BO_ 792 0;
BA_ "VFrameFormat" BO_ 792 14;
BA_ "CANFD_BRS" BO_ 792 1;
BA_ "GenMsgCycleTime" BO_ 792 100;
BA_ "GenMsgCycleTimeFast" BO_ 792 0;
BA_ "GenMsgSendType" BO_ 792 0;
BA_ "VFrameFormat" BO_ 792 14;
BA_ "CANFD_BRS" BO_ 792 1;
BA_ "GenMsgCycleTime" BO_ 792 100;
BA_ "GenMsgCycleTimeFast" BO_ 792 0;
BA_ "GenMsgSendType" BO_ 792 0;
BA_ "VFrameFormat" BO_ 792 14;
BA_ "CANFD_BRS" BO_ 792 1;
BA_ "GenMsgCycleTime" BO_ 792 100;
BA_ "GenMsgCycleTimeFast" BO_ 792 0;
BA_ "GenMsgSendType" BO_ 792 0;
BA_ "VFrameFormat" BO_ 792 14;
BA_ "CANFD_BRS" BO_ 792 1;
BA_ "GenMsgCycleTime" BO_ 616 20;
BA_ "GenMsgCycleTimeFast" BO_ 616 0;
BA_ "GenMsgSendType" BO_ 616 0;
BA_ "VFrameFormat" BO_ 616 14;
BA_ "CANFD_BRS" BO_ 616 1;
BA_ "GenMsgCycleTime" BO_ 616 20;
BA_ "GenMsgCycleTimeFast" BO_ 616 0;
BA_ "GenMsgSendType" BO_ 616 0;
BA_ "VFrameFormat" BO_ 616 14;
BA_ "CANFD_BRS" BO_ 616 1;
BA_ "GenMsgCycleTime" BO_ 616 20;
BA_ "GenMsgCycleTimeFast" BO_ 616 0;
BA_ "GenMsgSendType" BO_ 616 0;
BA_ "VFrameFormat" BO_ 616 14;
BA_ "CANFD_BRS" BO_ 616 1;
BA_ "GenMsgCycleTime" BO_ 616 20;
BA_ "GenMsgCycleTimeFast" BO_ 616 0;
BA_ "GenMsgSendType" BO_ 616 0;
BA_ "VFrameFormat" BO_ 616 14;
BA_ "CANFD_BRS" BO_ 616 1;
BA_ "GenMsgCycleTime" BO_ 616 20;
BA_ "GenMsgCycleTimeFast" BO_ 616 0;
BA_ "GenMsgSendType" BO_ 616 0;
BA_ "VFrameFormat" BO_ 616 14;
BA_ "CANFD_BRS" BO_ 616 1;
BA_ "GenMsgCycleTime" BO_ 616 20;
BA_ "GenMsgCycleTimeFast" BO_ 616 0;
BA_ "GenMsgSendType" BO_ 616 0;
BA_ "VFrameFormat" BO_ 616 14;
BA_ "CANFD_BRS" BO_ 616 1;
BA_ "GenMsgCycleTime" BO_ 616 20;
BA_ "GenMsgCycleTimeFast" BO_ 616 0;
BA_ "GenMsgSendType" BO_ 616 0;
BA_ "VFrameFormat" BO_ 616 14;
BA_ "CANFD_BRS" BO_ 616 1;
BA_ "GenMsgCycleTime" BO_ 616 20;
BA_ "GenMsgCycleTimeFast" BO_ 616 0;
BA_ "GenMsgSendType" BO_ 616 0;
BA_ "VFrameFormat" BO_ 616 14;
BA_ "CANFD_BRS" BO_ 616 1;
BA_ "GenMsgCycleTime" BO_ 616 20;
BA_ "GenMsgCycleTimeFast" BO_ 616 0;
BA_ "GenMsgSendType" BO_ 616 0;
BA_ "VFrameFormat" BO_ 616 14;
BA_ "CANFD_BRS" BO_ 616 1;
BA_ "GenMsgCycleTime" BO_ 616 20;
BA_ "GenMsgCycleTimeFast" BO_ 616 0;
BA_ "GenMsgSendType" BO_ 616 0;
BA_ "VFrameFormat" BO_ 616 14;
BA_ "CANFD_BRS" BO_ 616 1;
BA_ "GenMsgCycleTime" BO_ 616 20;
BA_ "GenMsgCycleTimeFast" BO_ 616 0;
BA_ "GenMsgSendType" BO_ 616 0;
BA_ "VFrameFormat" BO_ 616 14;
BA_ "CANFD_BRS" BO_ 616 1;
BA_ "GenMsgCycleTime" BO_ 616 20;
BA_ "GenMsgCycleTimeFast" BO_ 616 0;
BA_ "GenMsgSendType" BO_ 616 0;
BA_ "VFrameFormat" BO_ 616 14;
BA_ "CANFD_BRS" BO_ 616 1;
BA_ "GenMsgCycleTime" BO_ 616 20;
BA_ "GenMsgCycleTimeFast" BO_ 616 0;
BA_ "GenMsgSendType" BO_ 616 0;
BA_ "VFrameFormat" BO_ 616 14;
BA_ "CANFD_BRS" BO_ 616 1;
BA_ "GenMsgCycleTime" BO_ 616 20;
BA_ "GenMsgCycleTimeFast" BO_ 616 0;
BA_ "GenMsgSendType" BO_ 616 0;
BA_ "VFrameFormat" BO_ 616 14;
BA_ "CANFD_BRS" BO_ 616 1;
BA_ "GenMsgCycleTime" BO_ 616 20;
BA_ "GenMsgCycleTimeFast" BO_ 616 0;
BA_ "GenMsgSendType" BO_ 616 0;
BA_ "VFrameFormat" BO_ 616 14;
BA_ "CANFD_BRS" BO_ 616 1;
BA_ "GenMsgCycleTime" BO_ 616 20;
BA_ "GenMsgCycleTimeFast" BO_ 616 0;
BA_ "GenMsgSendType" BO_ 616 0;
BA_ "VFrameFormat" BO_ 616 14;
BA_ "CANFD_BRS" BO_ 616 1;
BA_ "GenMsgCycleTime" BO_ 616 20;
BA_ "GenMsgCycleTimeFast" BO_ 616 0;
BA_ "GenMsgSendType" BO_ 616 0;
BA_ "VFrameFormat" BO_ 616 14;
BA_ "CANFD_BRS" BO_ 616 1;
BA_ "GenMsgCycleTime" BO_ 616 20;
BA_ "GenMsgCycleTimeFast" BO_ 616 0;
BA_ "GenMsgSendType" BO_ 616 0;
BA_ "VFrameFormat" BO_ 616 14;
BA_ "CANFD_BRS" BO_ 616 1;
BA_ "GenMsgCycleTime" BO_ 616 20;
BA_ "GenMsgCycleTimeFast" BO_ 616 0;
BA_ "GenMsgSendType" BO_ 616 0;
BA_ "VFrameFormat" BO_ 616 14;
BA_ "CANFD_BRS" BO_ 616 1;
BA_ "GenMsgCycleTime" BO_ 616 20;
BA_ "GenMsgCycleTimeFast" BO_ 616 0;
BA_ "GenMsgSendType" BO_ 616 0;
BA_ "VFrameFormat" BO_ 616 14;
BA_ "CANFD_BRS" BO_ 616 1;
BA_ "GenMsgCycleTime" BO_ 818 100;
BA_ "GenMsgCycleTimeFast" BO_ 818 0;
BA_ "GenMsgSendType" BO_ 818 0;
BA_ "VFrameFormat" BO_ 818 14;
BA_ "CANFD_BRS" BO_ 818 1;
BA_ "GenMsgCycleTime" BO_ 818 100;
BA_ "GenMsgCycleTimeFast" BO_ 818 0;
BA_ "GenMsgSendType" BO_ 818 0;
BA_ "VFrameFormat" BO_ 818 14;
BA_ "CANFD_BRS" BO_ 818 1;
BA_ "GenMsgCycleTime" BO_ 816 100;
BA_ "GenMsgCycleTimeFast" BO_ 816 0;
BA_ "GenMsgSendType" BO_ 816 0;
BA_ "VFrameFormat" BO_ 816 14;
BA_ "CANFD_BRS" BO_ 816 1;
BA_ "GenMsgCycleTime" BO_ 816 100;
BA_ "GenMsgCycleTimeFast" BO_ 816 0;
BA_ "GenMsgSendType" BO_ 816 0;
BA_ "VFrameFormat" BO_ 816 14;
BA_ "CANFD_BRS" BO_ 816 1;
BA_ "GenMsgCycleTime" BO_ 816 100;
BA_ "GenMsgCycleTimeFast" BO_ 816 0;
BA_ "GenMsgSendType" BO_ 816 0;
BA_ "VFrameFormat" BO_ 816 14;
BA_ "CANFD_BRS" BO_ 816 1;
BA_ "GenMsgCycleTime" BO_ 960 400;
BA_ "GenMsgCycleTimeFast" BO_ 960 0;
BA_ "GenMsgSendType" BO_ 960 0;
BA_ "VFrameFormat" BO_ 960 14;
BA_ "CANFD_BRS" BO_ 960 1;
BA_ "GenMsgCycleTime" BO_ 960 400;
BA_ "GenMsgCycleTimeFast" BO_ 960 0;
BA_ "GenMsgSendType" BO_ 960 0;
BA_ "VFrameFormat" BO_ 960 14;
BA_ "CANFD_BRS" BO_ 960 1;
BA_ "GenMsgCycleTime" BO_ 960 400;
BA_ "GenMsgCycleTimeFast" BO_ 960 0;
BA_ "GenMsgSendType" BO_ 960 0;
BA_ "VFrameFormat" BO_ 960 14;
BA_ "CANFD_BRS" BO_ 960 1;
BA_ "GenMsgCycleTime" BO_ 960 400;
BA_ "GenMsgCycleTimeFast" BO_ 960 0;
BA_ "GenMsgSendType" BO_ 960 0;
BA_ "VFrameFormat" BO_ 960 14;
BA_ "CANFD_BRS" BO_ 960 1;
BA_ "GenMsgCycleTime" BO_ 825 100;
BA_ "GenMsgCycleTimeFast" BO_ 825 0;
BA_ "GenMsgSendType" BO_ 825 0;
BA_ "VFrameFormat" BO_ 825 14;
BA_ "CANFD_BRS" BO_ 825 1;
BA_ "GenMsgCycleTime" BO_ 291 40;
BA_ "GenMsgCycleTimeFast" BO_ 291 0;
BA_ "GenMsgSendType" BO_ 291 0;
BA_ "VFrameFormat" BO_ 291 14;
BA_ "CANFD_BRS" BO_ 291 1;
BA_ "GenMsgCycleTime" BO_ 291 40;
BA_ "GenMsgCycleTimeFast" BO_ 291 0;
BA_ "GenMsgSendType" BO_ 291 0;
BA_ "VFrameFormat" BO_ 291 14;
BA_ "CANFD_BRS" BO_ 291 1;
BA_ "GenMsgCycleTime" BO_ 291 40;
BA_ "GenMsgCycleTimeFast" BO_ 291 0;
BA_ "GenMsgSendType" BO_ 291 0;
BA_ "VFrameFormat" BO_ 291 14;
BA_ "CANFD_BRS" BO_ 291 1;
BA_ "GenMsgCycleTime" BO_ 291 40;
BA_ "GenMsgCycleTimeFast" BO_ 291 0;
BA_ "GenMsgSendType" BO_ 291 0;
BA_ "VFrameFormat" BO_ 291 14;
BA_ "CANFD_BRS" BO_ 291 1;
BA_ "GenMsgCycleTime" BO_ 291 40;
BA_ "GenMsgCycleTimeFast" BO_ 291 0;
BA_ "GenMsgSendType" BO_ 291 0;
BA_ "VFrameFormat" BO_ 291 14;
BA_ "CANFD_BRS" BO_ 291 1;
BA_ "GenMsgCycleTime" BO_ 291 40;
BA_ "GenMsgCycleTimeFast" BO_ 291 0;
BA_ "GenMsgSendType" BO_ 291 0;
BA_ "VFrameFormat" BO_ 291 14;
BA_ "CANFD_BRS" BO_ 291 1;
BA_ "GenMsgCycleTime" BO_ 291 40;
BA_ "GenMsgCycleTimeFast" BO_ 291 0;
BA_ "GenMsgSendType" BO_ 291 0;
BA_ "VFrameFormat" BO_ 291 14;
BA_ "CANFD_BRS" BO_ 291 1;
BA_ "GenMsgCycleTime" BO_ 291 40;
BA_ "GenMsgCycleTimeFast" BO_ 291 0;
BA_ "GenMsgSendType" BO_ 291 0;
BA_ "VFrameFormat" BO_ 291 14;
BA_ "CANFD_BRS" BO_ 291 1;
BA_ "GenMsgCycleTime" BO_ 291 40;
BA_ "GenMsgCycleTimeFast" BO_ 291 0;
BA_ "GenMsgSendType" BO_ 291 0;
BA_ "VFrameFormat" BO_ 291 14;
BA_ "CANFD_BRS" BO_ 291 1;
BA_ "GenMsgCycleTime" BO_ 291 40;
BA_ "GenMsgCycleTimeFast" BO_ 291 0;
BA_ "GenMsgSendType" BO_ 291 0;
BA_ "VFrameFormat" BO_ 291 14;
BA_ "CANFD_BRS" BO_ 291 1;
BA_ "GenMsgCycleTime" BO_ 291 40;
BA_ "GenMsgCycleTimeFast" BO_ 291 0;
BA_ "GenMsgSendType" BO_ 291 0;
BA_ "VFrameFormat" BO_ 291 14;
BA_ "CANFD_BRS" BO_ 291 1;
BA_ "GenMsgCycleTime" BO_ 291 40;
BA_ "GenMsgCycleTimeFast" BO_ 291 0;
BA_ "GenMsgSendType" BO_ 291 0;
BA_ "VFrameFormat" BO_ 291 14;
BA_ "CANFD_BRS" BO_ 291 1;
BA_ "GenMsgCycleTime" BO_ 865 40;
BA_ "GenMsgCycleTimeFast" BO_ 865 0;
BA_ "GenMsgSendType" BO_ 865 0;
BA_ "VFrameFormat" BO_ 865 14;
BA_ "CANFD_BRS" BO_ 865 1;
BA_ "GenMsgCycleTime" BO_ 865 40;
BA_ "GenMsgCycleTimeFast" BO_ 865 0;
BA_ "GenMsgSendType" BO_ 865 0;
BA_ "VFrameFormat" BO_ 865 14;
BA_ "CANFD_BRS" BO_ 865 1;
BA_ "GenMsgCycleTime" BO_ 865 40;
BA_ "GenMsgCycleTimeFast" BO_ 865 0;
BA_ "GenMsgSendType" BO_ 865 0;
BA_ "VFrameFormat" BO_ 865 14;
BA_ "CANFD_BRS" BO_ 865 1;
BA_ "GenMsgCycleTime" BO_ 865 40;
BA_ "GenMsgCycleTimeFast" BO_ 865 0;
BA_ "GenMsgSendType" BO_ 865 0;
BA_ "VFrameFormat" BO_ 865 14;
BA_ "CANFD_BRS" BO_ 865 1;
BA_ "GenMsgCycleTime" BO_ 865 40;
BA_ "GenMsgCycleTimeFast" BO_ 865 0;
BA_ "GenMsgSendType" BO_ 865 0;
BA_ "VFrameFormat" BO_ 865 14;
BA_ "CANFD_BRS" BO_ 865 1;
BA_ "GenMsgCycleTime" BO_ 865 40;
BA_ "GenMsgCycleTimeFast" BO_ 865 0;
BA_ "GenMsgSendType" BO_ 865 0;
BA_ "VFrameFormat" BO_ 865 14;
BA_ "CANFD_BRS" BO_ 865 1;
BA_ "GenMsgCycleTime" BO_ 865 40;
BA_ "GenMsgCycleTimeFast" BO_ 865 0;
BA_ "GenMsgSendType" BO_ 865 0;
BA_ "VFrameFormat" BO_ 865 14;
BA_ "CANFD_BRS" BO_ 865 1;
BA_ "GenMsgCycleTime" BO_ 865 40;
BA_ "GenMsgCycleTimeFast" BO_ 865 0;
BA_ "GenMsgSendType" BO_ 865 0;
BA_ "VFrameFormat" BO_ 865 14;
BA_ "CANFD_BRS" BO_ 865 1;
BA_ "GenMsgCycleTime" BO_ 865 40;
BA_ "GenMsgCycleTimeFast" BO_ 865 0;
BA_ "GenMsgSendType" BO_ 865 0;
BA_ "VFrameFormat" BO_ 865 14;
BA_ "CANFD_BRS" BO_ 865 1;
BA_ "GenMsgCycleTime" BO_ 865 40;
BA_ "GenMsgCycleTimeFast" BO_ 865 0;
BA_ "GenMsgSendType" BO_ 865 0;
BA_ "VFrameFormat" BO_ 865 14;
BA_ "CANFD_BRS" BO_ 865 1;
BA_ "GenMsgCycleTime" BO_ 865 40;
BA_ "GenMsgCycleTimeFast" BO_ 865 0;
BA_ "GenMsgSendType" BO_ 865 0;
BA_ "VFrameFormat" BO_ 865 14;
BA_ "CANFD_BRS" BO_ 865 1;
BA_ "GenMsgCycleTime" BO_ 865 40;
BA_ "GenMsgCycleTimeFast" BO_ 865 0;
BA_ "GenMsgSendType" BO_ 865 0;
BA_ "VFrameFormat" BO_ 865 14;
BA_ "CANFD_BRS" BO_ 865 1;
BA_ "GenMsgCycleTime" BO_ 865 40;
BA_ "GenMsgCycleTimeFast" BO_ 865 0;
BA_ "GenMsgSendType" BO_ 865 0;
BA_ "VFrameFormat" BO_ 865 14;
BA_ "CANFD_BRS" BO_ 865 1;
BA_ "GenMsgCycleTime" BO_ 865 40;
BA_ "GenMsgCycleTimeFast" BO_ 865 0;
BA_ "GenMsgSendType" BO_ 865 0;
BA_ "VFrameFormat" BO_ 865 14;
BA_ "CANFD_BRS" BO_ 865 1;
BA_ "GenMsgCycleTime" BO_ 865 40;
BA_ "GenMsgCycleTimeFast" BO_ 865 0;
BA_ "GenMsgSendType" BO_ 865 0;
BA_ "VFrameFormat" BO_ 865 14;
BA_ "CANFD_BRS" BO_ 865 1;
BA_ "GenMsgCycleTime" BO_ 865 40;
BA_ "GenMsgCycleTimeFast" BO_ 865 0;
BA_ "GenMsgSendType" BO_ 865 0;
BA_ "VFrameFormat" BO_ 865 14;
BA_ "CANFD_BRS" BO_ 865 1;
BA_ "GenMsgCycleTime" BO_ 865 40;
BA_ "GenMsgCycleTimeFast" BO_ 865 0;
BA_ "GenMsgSendType" BO_ 865 0;
BA_ "VFrameFormat" BO_ 865 14;
BA_ "CANFD_BRS" BO_ 865 1;
BA_ "GenMsgCycleTime" BO_ 865 40;
BA_ "GenMsgCycleTimeFast" BO_ 865 0;
BA_ "GenMsgSendType" BO_ 865 0;
BA_ "VFrameFormat" BO_ 865 14;
BA_ "CANFD_BRS" BO_ 865 1;
BA_ "GenMsgCycleTime" BO_ 865 40;
BA_ "GenMsgCycleTimeFast" BO_ 865 0;
BA_ "GenMsgSendType" BO_ 865 0;
BA_ "VFrameFormat" BO_ 865 14;
BA_ "CANFD_BRS" BO_ 865 1;
BA_ "GenMsgCycleTime" BO_ 865 40;
BA_ "GenMsgCycleTimeFast" BO_ 865 0;
BA_ "GenMsgSendType" BO_ 865 0;
BA_ "VFrameFormat" BO_ 865 14;
BA_ "CANFD_BRS" BO_ 865 1;
BA_ "GenMsgCycleTime" BO_ 865 40;
BA_ "GenMsgCycleTimeFast" BO_ 865 0;
BA_ "GenMsgSendType" BO_ 865 0;
BA_ "VFrameFormat" BO_ 865 14;
BA_ "CANFD_BRS" BO_ 865 1;
BA_ "GenMsgCycleTime" BO_ 865 40;
BA_ "GenMsgCycleTimeFast" BO_ 865 0;
BA_ "GenMsgSendType" BO_ 865 0;
BA_ "VFrameFormat" BO_ 865 14;
BA_ "CANFD_BRS" BO_ 865 1;
BA_ "GenMsgCycleTime" BO_ 865 40;
BA_ "GenMsgCycleTimeFast" BO_ 865 0;
BA_ "GenMsgSendType" BO_ 865 0;
BA_ "VFrameFormat" BO_ 865 14;
BA_ "CANFD_BRS" BO_ 865 1;
BA_ "GenMsgCycleTime" BO_ 865 40;
BA_ "GenMsgCycleTimeFast" BO_ 865 0;
BA_ "GenMsgSendType" BO_ 865 0;
BA_ "VFrameFormat" BO_ 865 14;
BA_ "CANFD_BRS" BO_ 865 1;
BA_ "GenMsgCycleTime" BO_ 865 40;
BA_ "GenMsgCycleTimeFast" BO_ 865 0;
BA_ "GenMsgSendType" BO_ 865 0;
BA_ "VFrameFormat" BO_ 865 14;
BA_ "CANFD_BRS" BO_ 865 1;
BA_ "GenMsgCycleTime" BO_ 865 40;
BA_ "GenMsgCycleTimeFast" BO_ 865 0;
BA_ "GenMsgSendType" BO_ 865 0;
BA_ "VFrameFormat" BO_ 865 14;
BA_ "CANFD_BRS" BO_ 865 1;
BA_ "GenMsgCycleTime" BO_ 865 40;
BA_ "GenMsgCycleTimeFast" BO_ 865 0;
BA_ "GenMsgSendType" BO_ 865 0;
BA_ "VFrameFormat" BO_ 865 14;
BA_ "CANFD_BRS" BO_ 865 1;
BA_ "GenMsgCycleTime" BO_ 865 40;
BA_ "GenMsgCycleTimeFast" BO_ 865 0;
BA_ "GenMsgSendType" BO_ 865 0;
BA_ "VFrameFormat" BO_ 865 14;
BA_ "CANFD_BRS" BO_ 865 1;
BA_ "GenMsgCycleTime" BO_ 865 40;
BA_ "GenMsgCycleTimeFast" BO_ 865 0;
BA_ "GenMsgSendType" BO_ 865 0;
BA_ "VFrameFormat" BO_ 865 14;
BA_ "CANFD_BRS" BO_ 865 1;
BA_ "GenMsgCycleTime" BO_ 865 40;
BA_ "GenMsgCycleTimeFast" BO_ 865 0;
BA_ "GenMsgSendType" BO_ 865 0;
BA_ "VFrameFormat" BO_ 865 14;
BA_ "CANFD_BRS" BO_ 865 1;
BA_ "GenMsgCycleTime" BO_ 293 500;
BA_ "GenMsgCycleTimeFast" BO_ 293 40;
BA_ "GenMsgSendType" BO_ 293 3;
BA_ "VFrameFormat" BO_ 293 14;
BA_ "CANFD_BRS" BO_ 293 1;
BA_ "GenMsgCycleTime" BO_ 293 500;
BA_ "GenMsgCycleTimeFast" BO_ 293 40;
BA_ "GenMsgSendType" BO_ 293 3;
BA_ "VFrameFormat" BO_ 293 14;
BA_ "CANFD_BRS" BO_ 293 1;
BA_ "GenMsgCycleTime" BO_ 293 500;
BA_ "GenMsgCycleTimeFast" BO_ 293 40;
BA_ "GenMsgSendType" BO_ 293 3;
BA_ "VFrameFormat" BO_ 293 14;
BA_ "CANFD_BRS" BO_ 293 1;
BA_ "GenMsgCycleTime" BO_ 293 500;
BA_ "GenMsgCycleTimeFast" BO_ 293 40;
BA_ "GenMsgSendType" BO_ 293 3;
BA_ "VFrameFormat" BO_ 293 14;
BA_ "CANFD_BRS" BO_ 293 1;
BA_ "GenMsgCycleTime" BO_ 293 500;
BA_ "GenMsgCycleTimeFast" BO_ 293 40;
BA_ "GenMsgSendType" BO_ 293 3;
BA_ "VFrameFormat" BO_ 293 14;
BA_ "CANFD_BRS" BO_ 293 1;
BA_ "GenMsgCycleTime" BO_ 293 500;
BA_ "GenMsgCycleTimeFast" BO_ 293 40;
BA_ "GenMsgSendType" BO_ 293 3;
BA_ "VFrameFormat" BO_ 293 14;
BA_ "CANFD_BRS" BO_ 293 1;
BA_ "GenMsgCycleTime" BO_ 293 500;
BA_ "GenMsgCycleTimeFast" BO_ 293 40;
BA_ "GenMsgSendType" BO_ 293 3;
BA_ "VFrameFormat" BO_ 293 14;
BA_ "CANFD_BRS" BO_ 293 1;
BA_ "GenMsgCycleTime" BO_ 293 500;
BA_ "GenMsgCycleTimeFast" BO_ 293 40;
BA_ "GenMsgSendType" BO_ 293 3;
BA_ "VFrameFormat" BO_ 293 14;
BA_ "CANFD_BRS" BO_ 293 1;
BA_ "GenMsgCycleTime" BO_ 293 500;
BA_ "GenMsgCycleTimeFast" BO_ 293 40;
BA_ "GenMsgSendType" BO_ 293 3;
BA_ "VFrameFormat" BO_ 293 14;
BA_ "CANFD_BRS" BO_ 293 1;
BA_ "GenMsgCycleTime" BO_ 293 500;
BA_ "GenMsgCycleTimeFast" BO_ 293 40;
BA_ "GenMsgSendType" BO_ 293 3;
BA_ "VFrameFormat" BO_ 293 14;
BA_ "CANFD_BRS" BO_ 293 1;
BA_ "GenMsgCycleTime" BO_ 294 500;
BA_ "GenMsgCycleTimeFast" BO_ 294 40;
BA_ "GenMsgSendType" BO_ 294 3;
BA_ "VFrameFormat" BO_ 294 14;
BA_ "CANFD_BRS" BO_ 294 1;
BA_ "GenMsgCycleTime" BO_ 294 500;
BA_ "GenMsgCycleTimeFast" BO_ 294 40;
BA_ "GenMsgSendType" BO_ 294 3;
BA_ "VFrameFormat" BO_ 294 14;
BA_ "CANFD_BRS" BO_ 294 1;
BA_ "GenMsgCycleTime" BO_ 294 500;
BA_ "GenMsgCycleTimeFast" BO_ 294 40;
BA_ "GenMsgSendType" BO_ 294 3;
BA_ "VFrameFormat" BO_ 294 14;
BA_ "CANFD_BRS" BO_ 294 1;
BA_ "GenMsgCycleTime" BO_ 294 500;
BA_ "GenMsgCycleTimeFast" BO_ 294 40;
BA_ "GenMsgSendType" BO_ 294 3;
BA_ "VFrameFormat" BO_ 294 14;
BA_ "CANFD_BRS" BO_ 294 1;
BA_ "GenMsgCycleTime" BO_ 294 500;
BA_ "GenMsgCycleTimeFast" BO_ 294 40;
BA_ "GenMsgSendType" BO_ 294 3;
BA_ "VFrameFormat" BO_ 294 14;
BA_ "CANFD_BRS" BO_ 294 1;
BA_ "GenMsgCycleTime" BO_ 294 500;
BA_ "GenMsgCycleTimeFast" BO_ 294 40;
BA_ "GenMsgSendType" BO_ 294 3;
BA_ "VFrameFormat" BO_ 294 14;
BA_ "CANFD_BRS" BO_ 294 1;
BA_ "GenMsgCycleTime" BO_ 294 500;
BA_ "GenMsgCycleTimeFast" BO_ 294 40;
BA_ "GenMsgSendType" BO_ 294 3;
BA_ "VFrameFormat" BO_ 294 14;
BA_ "CANFD_BRS" BO_ 294 1;
BA_ "GenMsgCycleTime" BO_ 294 500;
BA_ "GenMsgCycleTimeFast" BO_ 294 40;
BA_ "GenMsgSendType" BO_ 294 3;
BA_ "VFrameFormat" BO_ 294 14;
BA_ "CANFD_BRS" BO_ 294 1;
BA_ "GenMsgCycleTime" BO_ 294 500;
BA_ "GenMsgCycleTimeFast" BO_ 294 40;
BA_ "GenMsgSendType" BO_ 294 3;
BA_ "VFrameFormat" BO_ 294 14;
BA_ "CANFD_BRS" BO_ 294 1;
BA_ "GenMsgCycleTime" BO_ 294 500;
BA_ "GenMsgCycleTimeFast" BO_ 294 40;
BA_ "GenMsgSendType" BO_ 294 3;
BA_ "VFrameFormat" BO_ 294 14;
BA_ "CANFD_BRS" BO_ 294 1;
BA_ "GenMsgCycleTime" BO_ 294 500;
BA_ "GenMsgCycleTimeFast" BO_ 294 40;
BA_ "GenMsgSendType" BO_ 294 3;
BA_ "VFrameFormat" BO_ 294 14;
BA_ "CANFD_BRS" BO_ 294 1;
BA_ "GenMsgCycleTime" BO_ 294 500;
BA_ "GenMsgCycleTimeFast" BO_ 294 40;
BA_ "GenMsgSendType" BO_ 294 3;
BA_ "VFrameFormat" BO_ 294 14;
BA_ "CANFD_BRS" BO_ 294 1;

BA_ "EventCommandSignal" SG_ 777 ZCUR_4_CRC 0;
BA_ "GatewayedSignals" SG_ 777 ZCUR_4_CRC 0;
BA_ "GenSigInactiveValue" SG_ 777 ZCUR_4_CRC 0;
BA_ "GenSigInvalidValue" SG_ 777 ZCUR_4_CRC 0;
BA_ "GenSigSendType" SG_ 777 ZCUR_4_CRC 1;
BA_ "GenSigStartValue" SG_ 777 ZCUR_4_CRC 0;
BA_ "GenSigTimeoutValue" SG_ 777 ZCUR_4_CRC 0;
BA_ "Remark" SG_ 777 ZCUR_4_CRC "源报文周期20ms，转发后报文周期为100ms";
BA_ "EventCommandSignal" SG_ 777 ZCUR_4_Counter 0;
BA_ "GatewayedSignals" SG_ 777 ZCUR_4_Counter 0;
BA_ "GenSigInactiveValue" SG_ 777 ZCUR_4_Counter 0;
BA_ "GenSigInvalidValue" SG_ 777 ZCUR_4_Counter 0;
BA_ "GenSigSendType" SG_ 777 ZCUR_4_Counter 1;
BA_ "GenSigStartValue" SG_ 777 ZCUR_4_Counter 0;
BA_ "GenSigTimeoutValue" SG_ 777 ZCUR_4_Counter 0;
BA_ "Remark" SG_ 777 ZCUR_4_Counter "源报文周期20ms，转发后报文周期为100ms，转发后的counter值发送会不连续";
BA_ "EventCommandSignal" SG_ 777 EL_MRADASLightSt 0;
BA_ "GatewayedSignals" SG_ 777 EL_MRADASLightSt 0;
BA_ "GenSigInactiveValue" SG_ 777 EL_MRADASLightSt 0;
BA_ "GenSigInvalidValue" SG_ 777 EL_MRADASLightSt 0;
BA_ "GenSigSendType" SG_ 777 EL_MRADASLightSt 1;
BA_ "GenSigStartValue" SG_ 777 EL_MRADASLightSt 0;
BA_ "GenSigTimeoutValue" SG_ 777 EL_MRADASLightSt 0;
BA_ "Remark" SG_ 777 EL_MRADASLightSt "源报文周期20ms，转发后报文周期为100ms，转发后的counter值发送会不连续";
BA_ "EventCommandSignal" SG_ 777 MR_RightMirrorFoldUnfoldSt 0;
BA_ "GatewayedSignals" SG_ 777 MR_RightMirrorFoldUnfoldSt 0;
BA_ "GenSigInactiveValue" SG_ 777 MR_RightMirrorFoldUnfoldSt 0;
BA_ "GenSigInvalidValue" SG_ 777 MR_RightMirrorFoldUnfoldSt 0;
BA_ "GenSigSendType" SG_ 777 MR_RightMirrorFoldUnfoldSt 1;
BA_ "GenSigStartValue" SG_ 777 MR_RightMirrorFoldUnfoldSt 0;
BA_ "GenSigTimeoutValue" SG_ 777 MR_RightMirrorFoldUnfoldSt 0;
BA_ "Remark" SG_ 777 MR_RightMirrorFoldUnfoldSt "源报文周期20ms，转发后报文周期为100ms，转发后的counter值发送会不连续";
BA_ "EventCommandSignal" SG_ 777 PWL_WinCurrentPos_FRWinPst 0;
BA_ "GatewayedSignals" SG_ 777 PWL_WinCurrentPos_FRWinPst 0;
BA_ "GenSigInactiveValue" SG_ 777 PWL_WinCurrentPos_FRWinPst 0;
BA_ "GenSigInvalidValue" SG_ 777 PWL_WinCurrentPos_FRWinPst 0;
BA_ "GenSigSendType" SG_ 777 PWL_WinCurrentPos_FRWinPst 1;
BA_ "GenSigStartValue" SG_ 777 PWL_WinCurrentPos_FRWinPst 255;
BA_ "GenSigTimeoutValue" SG_ 777 PWL_WinCurrentPos_FRWinPst 0;
BA_ "Remark" SG_ 777 PWL_WinCurrentPos_FRWinPst "源报文周期20ms，转发后报文周期为100ms";
BA_ "EventCommandSignal" SG_ 777 EL_MRTurnLightSt 0;
BA_ "GatewayedSignals" SG_ 777 EL_MRTurnLightSt 0;
BA_ "GenSigInactiveValue" SG_ 777 EL_MRTurnLightSt 0;
BA_ "GenSigInvalidValue" SG_ 777 EL_MRTurnLightSt 0;
BA_ "GenSigSendType" SG_ 777 EL_MRTurnLightSt 1;
BA_ "GenSigStartValue" SG_ 777 EL_MRTurnLightSt 0;
BA_ "GenSigTimeoutValue" SG_ 777 EL_MRTurnLightSt 0;
BA_ "Remark" SG_ 777 EL_MRTurnLightSt "源报文周期20ms，转发后报文周期为100ms";
BA_ "EventCommandSignal" SG_ 777 EL_MRTurnLightFaultSt 0;
BA_ "GatewayedSignals" SG_ 777 EL_MRTurnLightFaultSt 0;
BA_ "GenSigInactiveValue" SG_ 777 EL_MRTurnLightFaultSt 0;
BA_ "GenSigInvalidValue" SG_ 777 EL_MRTurnLightFaultSt 0;
BA_ "GenSigSendType" SG_ 777 EL_MRTurnLightFaultSt 1;
BA_ "GenSigStartValue" SG_ 777 EL_MRTurnLightFaultSt 0;
BA_ "GenSigTimeoutValue" SG_ 777 EL_MRTurnLightFaultSt 0;
BA_ "Remark" SG_ 777 EL_MRTurnLightFaultSt "源报文周期20ms，转发后报文周期为100ms，转发后的counter值发送会不连续";
BA_ "EventCommandSignal" SG_ 777 EL_RightBSDIndicatorSt 0;
BA_ "GatewayedSignals" SG_ 777 EL_RightBSDIndicatorSt 0;
BA_ "GenSigInactiveValue" SG_ 777 EL_RightBSDIndicatorSt 0;
BA_ "GenSigInvalidValue" SG_ 777 EL_RightBSDIndicatorSt 0;
BA_ "GenSigSendType" SG_ 777 EL_RightBSDIndicatorSt 1;
BA_ "GenSigStartValue" SG_ 777 EL_RightBSDIndicatorSt 0;
BA_ "GenSigTimeoutValue" SG_ 777 EL_RightBSDIndicatorSt 0;
BA_ "Remark" SG_ 777 EL_RightBSDIndicatorSt "源报文周期20ms，转发后报文周期为100ms，转发后的counter值发送会不连续";
BA_ "EventCommandSignal" SG_ 777 EL_RightBSDIndicatorFaultSt 0;
BA_ "GatewayedSignals" SG_ 777 EL_RightBSDIndicatorFaultSt 0;
BA_ "GenSigInactiveValue" SG_ 777 EL_RightBSDIndicatorFaultSt 0;
BA_ "GenSigInvalidValue" SG_ 777 EL_RightBSDIndicatorFaultSt 0;
BA_ "GenSigSendType" SG_ 777 EL_RightBSDIndicatorFaultSt 1;
BA_ "GenSigStartValue" SG_ 777 EL_RightBSDIndicatorFaultSt 0;
BA_ "GenSigTimeoutValue" SG_ 777 EL_RightBSDIndicatorFaultSt 0;
BA_ "Remark" SG_ 777 EL_RightBSDIndicatorFaultSt "源报文周期20ms，转发后报文周期为100ms";
BA_ "EventCommandSignal" SG_ 342 ZCUR_8_CRC 0;
BA_ "GatewayedSignals" SG_ 342 ZCUR_8_CRC 0;
BA_ "GenSigInactiveValue" SG_ 342 ZCUR_8_CRC 0;
BA_ "GenSigInvalidValue" SG_ 342 ZCUR_8_CRC 0;
BA_ "GenSigSendType" SG_ 342 ZCUR_8_CRC 1;
BA_ "GenSigStartValue" SG_ 342 ZCUR_8_CRC 0;
BA_ "GenSigTimeoutValue" SG_ 342 ZCUR_8_CRC 0;
BA_ "Remark" SG_ 342 ZCUR_8_CRC "";
BA_ "EventCommandSignal" SG_ 342 ZCUR_8_Counter 0;
BA_ "GatewayedSignals" SG_ 342 ZCUR_8_Counter 0;
BA_ "GenSigInactiveValue" SG_ 342 ZCUR_8_Counter 0;
BA_ "GenSigInvalidValue" SG_ 342 ZCUR_8_Counter 0;
BA_ "GenSigSendType" SG_ 342 ZCUR_8_Counter 1;
BA_ "GenSigStartValue" SG_ 342 ZCUR_8_Counter 0;
BA_ "GenSigTimeoutValue" SG_ 342 ZCUR_8_Counter 0;
BA_ "Remark" SG_ 342 ZCUR_8_Counter "";
BA_ "EventCommandSignal" SG_ 342 KAE_FOB1Position 0;
BA_ "GatewayedSignals" SG_ 342 KAE_FOB1Position 0;
BA_ "GenSigInactiveValue" SG_ 342 KAE_FOB1Position 0;
BA_ "GenSigInvalidValue" SG_ 342 KAE_FOB1Position 0;
BA_ "GenSigSendType" SG_ 342 KAE_FOB1Position 1;
BA_ "GenSigStartValue" SG_ 342 KAE_FOB1Position 0;
BA_ "GenSigTimeoutValue" SG_ 342 KAE_FOB1Position 0;
BA_ "Remark" SG_ 342 KAE_FOB1Position "";
BA_ "EventCommandSignal" SG_ 342 KAE_FOB2Position 0;
BA_ "GatewayedSignals" SG_ 342 KAE_FOB2Position 0;
BA_ "GenSigInactiveValue" SG_ 342 KAE_FOB2Position 0;
BA_ "GenSigInvalidValue" SG_ 342 KAE_FOB2Position 0;
BA_ "GenSigSendType" SG_ 342 KAE_FOB2Position 1;
BA_ "GenSigStartValue" SG_ 342 KAE_FOB2Position 0;
BA_ "GenSigTimeoutValue" SG_ 342 KAE_FOB2Position 0;
BA_ "Remark" SG_ 342 KAE_FOB2Position "";
BA_ "EventCommandSignal" SG_ 342 KAE_FOB3Position 0;
BA_ "GatewayedSignals" SG_ 342 KAE_FOB3Position 0;
BA_ "GenSigInactiveValue" SG_ 342 KAE_FOB3Position 0;
BA_ "GenSigInvalidValue" SG_ 342 KAE_FOB3Position 0;
BA_ "GenSigSendType" SG_ 342 KAE_FOB3Position 1;
BA_ "GenSigStartValue" SG_ 342 KAE_FOB3Position 0;
BA_ "GenSigTimeoutValue" SG_ 342 KAE_FOB3Position 0;
BA_ "Remark" SG_ 342 KAE_FOB3Position "";
BA_ "EventCommandSignal" SG_ 342 KAE_FOB1UnlockBtnPressSt 0;
BA_ "GatewayedSignals" SG_ 342 KAE_FOB1UnlockBtnPressSt 0;
BA_ "GenSigInactiveValue" SG_ 342 KAE_FOB1UnlockBtnPressSt 0;
BA_ "GenSigInvalidValue" SG_ 342 KAE_FOB1UnlockBtnPressSt 0;
BA_ "GenSigSendType" SG_ 342 KAE_FOB1UnlockBtnPressSt 1;
BA_ "GenSigStartValue" SG_ 342 KAE_FOB1UnlockBtnPressSt 0;
BA_ "GenSigTimeoutValue" SG_ 342 KAE_FOB1UnlockBtnPressSt 0;
BA_ "Remark" SG_ 342 KAE_FOB1UnlockBtnPressSt "";
BA_ "EventCommandSignal" SG_ 342 KAE_FOB1LockBtnPressSt 0;
BA_ "GatewayedSignals" SG_ 342 KAE_FOB1LockBtnPressSt 0;
BA_ "GenSigInactiveValue" SG_ 342 KAE_FOB1LockBtnPressSt 0;
BA_ "GenSigInvalidValue" SG_ 342 KAE_FOB1LockBtnPressSt 0;
BA_ "GenSigSendType" SG_ 342 KAE_FOB1LockBtnPressSt 1;
BA_ "GenSigStartValue" SG_ 342 KAE_FOB1LockBtnPressSt 0;
BA_ "GenSigTimeoutValue" SG_ 342 KAE_FOB1LockBtnPressSt 0;
BA_ "Remark" SG_ 342 KAE_FOB1LockBtnPressSt "";
BA_ "EventCommandSignal" SG_ 342 KAE_FOB1RESBtnPressSt 0;
BA_ "GatewayedSignals" SG_ 342 KAE_FOB1RESBtnPressSt 0;
BA_ "GenSigInactiveValue" SG_ 342 KAE_FOB1RESBtnPressSt 0;
BA_ "GenSigInvalidValue" SG_ 342 KAE_FOB1RESBtnPressSt 0;
BA_ "GenSigSendType" SG_ 342 KAE_FOB1RESBtnPressSt 1;
BA_ "GenSigStartValue" SG_ 342 KAE_FOB1RESBtnPressSt 0;
BA_ "GenSigTimeoutValue" SG_ 342 KAE_FOB1RESBtnPressSt 0;
BA_ "Remark" SG_ 342 KAE_FOB1RESBtnPressSt "";
BA_ "EventCommandSignal" SG_ 342 KAE_FOB1PSD_LBtnPressSt 0;
BA_ "GatewayedSignals" SG_ 342 KAE_FOB1PSD_LBtnPressSt 0;
BA_ "GenSigInactiveValue" SG_ 342 KAE_FOB1PSD_LBtnPressSt 0;
BA_ "GenSigInvalidValue" SG_ 342 KAE_FOB1PSD_LBtnPressSt 0;
BA_ "GenSigSendType" SG_ 342 KAE_FOB1PSD_LBtnPressSt 1;
BA_ "GenSigStartValue" SG_ 342 KAE_FOB1PSD_LBtnPressSt 0;
BA_ "GenSigTimeoutValue" SG_ 342 KAE_FOB1PSD_LBtnPressSt 0;
BA_ "Remark" SG_ 342 KAE_FOB1PSD_LBtnPressSt "";
BA_ "EventCommandSignal" SG_ 342 KAE_FOB1PSD_RBtnPressSt 0;
BA_ "GatewayedSignals" SG_ 342 KAE_FOB1PSD_RBtnPressSt 0;
BA_ "GenSigInactiveValue" SG_ 342 KAE_FOB1PSD_RBtnPressSt 0;
BA_ "GenSigInvalidValue" SG_ 342 KAE_FOB1PSD_RBtnPressSt 0;
BA_ "GenSigSendType" SG_ 342 KAE_FOB1PSD_RBtnPressSt 1;
BA_ "GenSigStartValue" SG_ 342 KAE_FOB1PSD_RBtnPressSt 0;
BA_ "GenSigTimeoutValue" SG_ 342 KAE_FOB1PSD_RBtnPressSt 0;
BA_ "Remark" SG_ 342 KAE_FOB1PSD_RBtnPressSt "";
BA_ "EventCommandSignal" SG_ 342 KAE_FOB1TrunkBtnPressSt 0;
BA_ "GatewayedSignals" SG_ 342 KAE_FOB1TrunkBtnPressSt 0;
BA_ "GenSigInactiveValue" SG_ 342 KAE_FOB1TrunkBtnPressSt 0;
BA_ "GenSigInvalidValue" SG_ 342 KAE_FOB1TrunkBtnPressSt 0;
BA_ "GenSigSendType" SG_ 342 KAE_FOB1TrunkBtnPressSt 1;
BA_ "GenSigStartValue" SG_ 342 KAE_FOB1TrunkBtnPressSt 0;
BA_ "GenSigTimeoutValue" SG_ 342 KAE_FOB1TrunkBtnPressSt 0;
BA_ "Remark" SG_ 342 KAE_FOB1TrunkBtnPressSt "";
BA_ "EventCommandSignal" SG_ 342 KAE_FOB1PanicBtnPressSt 0;
BA_ "GatewayedSignals" SG_ 342 KAE_FOB1PanicBtnPressSt 0;
BA_ "GenSigInactiveValue" SG_ 342 KAE_FOB1PanicBtnPressSt 0;
BA_ "GenSigInvalidValue" SG_ 342 KAE_FOB1PanicBtnPressSt 0;
BA_ "GenSigSendType" SG_ 342 KAE_FOB1PanicBtnPressSt 1;
BA_ "GenSigStartValue" SG_ 342 KAE_FOB1PanicBtnPressSt 0;
BA_ "GenSigTimeoutValue" SG_ 342 KAE_FOB1PanicBtnPressSt 0;
BA_ "Remark" SG_ 342 KAE_FOB1PanicBtnPressSt "";
BA_ "EventCommandSignal" SG_ 342 KAE_FOB1User_definedBtnPressSt 0;
BA_ "GatewayedSignals" SG_ 342 KAE_FOB1User_definedBtnPressSt 0;
BA_ "GenSigInactiveValue" SG_ 342 KAE_FOB1User_definedBtnPressSt 0;
BA_ "GenSigInvalidValue" SG_ 342 KAE_FOB1User_definedBtnPressSt 0;
BA_ "GenSigSendType" SG_ 342 KAE_FOB1User_definedBtnPressSt 1;
BA_ "GenSigStartValue" SG_ 342 KAE_FOB1User_definedBtnPressSt 0;
BA_ "GenSigTimeoutValue" SG_ 342 KAE_FOB1User_definedBtnPressSt 0;
BA_ "Remark" SG_ 342 KAE_FOB1User_definedBtnPressSt "";
BA_ "EventCommandSignal" SG_ 776 EL_MLADASLightSt 0;
BA_ "GatewayedSignals" SG_ 776 EL_MLADASLightSt 0;
BA_ "GenSigInactiveValue" SG_ 776 EL_MLADASLightSt 0;
BA_ "GenSigInvalidValue" SG_ 776 EL_MLADASLightSt 0;
BA_ "GenSigSendType" SG_ 776 EL_MLADASLightSt 1;
BA_ "GenSigStartValue" SG_ 776 EL_MLADASLightSt 0;
BA_ "GenSigTimeoutValue" SG_ 776 EL_MLADASLightSt 0;
BA_ "Remark" SG_ 776 EL_MLADASLightSt "";
BA_ "EventCommandSignal" SG_ 957 HOD_1_CRC 0;
BA_ "GatewayedSignals" SG_ 957 HOD_1_CRC 0;
BA_ "GenSigInactiveValue" SG_ 957 HOD_1_CRC 0;
BA_ "GenSigInvalidValue" SG_ 957 HOD_1_CRC 0;
BA_ "GenSigSendType" SG_ 957 HOD_1_CRC 1;
BA_ "GenSigStartValue" SG_ 957 HOD_1_CRC 0;
BA_ "GenSigTimeoutValue" SG_ 957 HOD_1_CRC 0;
BA_ "Remark" SG_ 957 HOD_1_CRC "";
BA_ "EventCommandSignal" SG_ 957 HOD_1_Counter 0;
BA_ "GatewayedSignals" SG_ 957 HOD_1_Counter 0;
BA_ "GenSigInactiveValue" SG_ 957 HOD_1_Counter 0;
BA_ "GenSigInvalidValue" SG_ 957 HOD_1_Counter 0;
BA_ "GenSigSendType" SG_ 957 HOD_1_Counter 1;
BA_ "GenSigStartValue" SG_ 957 HOD_1_Counter 0;
BA_ "GenSigTimeoutValue" SG_ 957 HOD_1_Counter 0;
BA_ "Remark" SG_ 957 HOD_1_Counter "";
BA_ "EventCommandSignal" SG_ 957 HOD_St 0;
BA_ "GatewayedSignals" SG_ 957 HOD_St 0;
BA_ "GenSigInactiveValue" SG_ 957 HOD_St 0;
BA_ "GenSigInvalidValue" SG_ 957 HOD_St 0;
BA_ "GenSigSendType" SG_ 957 HOD_St 1;
BA_ "GenSigStartValue" SG_ 957 HOD_St 0;
BA_ "GenSigTimeoutValue" SG_ 957 HOD_St 0;
BA_ "Remark" SG_ 957 HOD_St "";
BA_ "EventCommandSignal" SG_ 957 HOD_TouchZone1 0;
BA_ "GatewayedSignals" SG_ 957 HOD_TouchZone1 0;
BA_ "GenSigInactiveValue" SG_ 957 HOD_TouchZone1 0;
BA_ "GenSigInvalidValue" SG_ 957 HOD_TouchZone1 0;
BA_ "GenSigSendType" SG_ 957 HOD_TouchZone1 1;
BA_ "GenSigStartValue" SG_ 957 HOD_TouchZone1 0;
BA_ "GenSigTimeoutValue" SG_ 957 HOD_TouchZone1 0;
BA_ "Remark" SG_ 957 HOD_TouchZone1 "";
BA_ "EventCommandSignal" SG_ 957 HOD_TouchZone2 0;
BA_ "GatewayedSignals" SG_ 957 HOD_TouchZone2 0;
BA_ "GenSigInactiveValue" SG_ 957 HOD_TouchZone2 0;
BA_ "GenSigInvalidValue" SG_ 957 HOD_TouchZone2 0;
BA_ "GenSigSendType" SG_ 957 HOD_TouchZone2 1;
BA_ "GenSigStartValue" SG_ 957 HOD_TouchZone2 0;
BA_ "GenSigTimeoutValue" SG_ 957 HOD_TouchZone2 0;
BA_ "Remark" SG_ 957 HOD_TouchZone2 "";
BA_ "EventCommandSignal" SG_ 957 HOD_TouchZone3 0;
BA_ "GatewayedSignals" SG_ 957 HOD_TouchZone3 0;
BA_ "GenSigInactiveValue" SG_ 957 HOD_TouchZone3 0;
BA_ "GenSigInvalidValue" SG_ 957 HOD_TouchZone3 0;
BA_ "GenSigSendType" SG_ 957 HOD_TouchZone3 1;
BA_ "GenSigStartValue" SG_ 957 HOD_TouchZone3 0;
BA_ "GenSigTimeoutValue" SG_ 957 HOD_TouchZone3 0;
BA_ "Remark" SG_ 957 HOD_TouchZone3 "";
BA_ "EventCommandSignal" SG_ 957 HOD_HeatingSt 0;
BA_ "GatewayedSignals" SG_ 957 HOD_HeatingSt 0;
BA_ "GenSigInactiveValue" SG_ 957 HOD_HeatingSt 0;
BA_ "GenSigInvalidValue" SG_ 957 HOD_HeatingSt 0;
BA_ "GenSigSendType" SG_ 957 HOD_HeatingSt 1;
BA_ "GenSigStartValue" SG_ 957 HOD_HeatingSt 0;
BA_ "GenSigTimeoutValue" SG_ 957 HOD_HeatingSt 0;
BA_ "Remark" SG_ 957 HOD_HeatingSt "";
BA_ "EventCommandSignal" SG_ 957 HOD_CalibrationSt 0;
BA_ "GatewayedSignals" SG_ 957 HOD_CalibrationSt 0;
BA_ "GenSigInactiveValue" SG_ 957 HOD_CalibrationSt 0;
BA_ "GenSigInvalidValue" SG_ 957 HOD_CalibrationSt 0;
BA_ "GenSigSendType" SG_ 957 HOD_CalibrationSt 1;
BA_ "GenSigStartValue" SG_ 957 HOD_CalibrationSt 0;
BA_ "GenSigTimeoutValue" SG_ 957 HOD_CalibrationSt 0;
BA_ "Remark" SG_ 957 HOD_CalibrationSt "";
BA_ "EventCommandSignal" SG_ 957 HOD_LINComFault 0;
BA_ "GatewayedSignals" SG_ 957 HOD_LINComFault 0;
BA_ "GenSigInactiveValue" SG_ 957 HOD_LINComFault 0;
BA_ "GenSigInvalidValue" SG_ 957 HOD_LINComFault 0;
BA_ "GenSigSendType" SG_ 957 HOD_LINComFault 1;
BA_ "GenSigStartValue" SG_ 957 HOD_LINComFault 0;
BA_ "GenSigTimeoutValue" SG_ 957 HOD_LINComFault 0;
BA_ "Remark" SG_ 957 HOD_LINComFault "";
BA_ "EventCommandSignal" SG_ 957 HOD_FaultSt 0;
BA_ "GatewayedSignals" SG_ 957 HOD_FaultSt 0;
BA_ "GenSigInactiveValue" SG_ 957 HOD_FaultSt 0;
BA_ "GenSigInvalidValue" SG_ 957 HOD_FaultSt 0;
BA_ "GenSigSendType" SG_ 957 HOD_FaultSt 1;
BA_ "GenSigStartValue" SG_ 957 HOD_FaultSt 0;
BA_ "GenSigTimeoutValue" SG_ 957 HOD_FaultSt 0;
BA_ "Remark" SG_ 957 HOD_FaultSt "";
BA_ "EventCommandSignal" SG_ 957 HOD_VBattOORFault 0;
BA_ "GatewayedSignals" SG_ 957 HOD_VBattOORFault 0;
BA_ "GenSigInactiveValue" SG_ 957 HOD_VBattOORFault 0;
BA_ "GenSigInvalidValue" SG_ 957 HOD_VBattOORFault 0;
BA_ "GenSigSendType" SG_ 957 HOD_VBattOORFault 1;
BA_ "GenSigStartValue" SG_ 957 HOD_VBattOORFault 0;
BA_ "GenSigTimeoutValue" SG_ 957 HOD_VBattOORFault 0;
BA_ "Remark" SG_ 957 HOD_VBattOORFault "";
BA_ "EventCommandSignal" SG_ 957 HOD_HeatingOtherFaultSt 0;
BA_ "GatewayedSignals" SG_ 957 HOD_HeatingOtherFaultSt 0;
BA_ "GenSigInactiveValue" SG_ 957 HOD_HeatingOtherFaultSt 0;
BA_ "GenSigInvalidValue" SG_ 957 HOD_HeatingOtherFaultSt 0;
BA_ "GenSigSendType" SG_ 957 HOD_HeatingOtherFaultSt 1;
BA_ "GenSigStartValue" SG_ 957 HOD_HeatingOtherFaultSt 0;
BA_ "GenSigTimeoutValue" SG_ 957 HOD_HeatingOtherFaultSt 0;
BA_ "Remark" SG_ 957 HOD_HeatingOtherFaultSt "";
BA_ "EventCommandSignal" SG_ 957 HOD_HeatingOverUnderCurrentSt 0;
BA_ "GatewayedSignals" SG_ 957 HOD_HeatingOverUnderCurrentSt 0;
BA_ "GenSigInactiveValue" SG_ 957 HOD_HeatingOverUnderCurrentSt 0;
BA_ "GenSigInvalidValue" SG_ 957 HOD_HeatingOverUnderCurrentSt 0;
BA_ "GenSigSendType" SG_ 957 HOD_HeatingOverUnderCurrentSt 1;
BA_ "GenSigStartValue" SG_ 957 HOD_HeatingOverUnderCurrentSt 0;
BA_ "GenSigTimeoutValue" SG_ 957 HOD_HeatingOverUnderCurrentSt 0;
BA_ "Remark" SG_ 957 HOD_HeatingOverUnderCurrentSt "";
BA_ "EventCommandSignal" SG_ 957 HOD_HeatingThermSt 0;
BA_ "GatewayedSignals" SG_ 957 HOD_HeatingThermSt 0;
BA_ "GenSigInactiveValue" SG_ 957 HOD_HeatingThermSt 0;
BA_ "GenSigInvalidValue" SG_ 957 HOD_HeatingThermSt 0;
BA_ "GenSigSendType" SG_ 957 HOD_HeatingThermSt 1;
BA_ "GenSigStartValue" SG_ 957 HOD_HeatingThermSt 0;
BA_ "GenSigTimeoutValue" SG_ 957 HOD_HeatingThermSt 0;
BA_ "Remark" SG_ 957 HOD_HeatingThermSt "";
BA_ "EventCommandSignal" SG_ 957 HOD_HeatingTempOutSt 0;
BA_ "GatewayedSignals" SG_ 957 HOD_HeatingTempOutSt 0;
BA_ "GenSigInactiveValue" SG_ 957 HOD_HeatingTempOutSt 0;
BA_ "GenSigInvalidValue" SG_ 957 HOD_HeatingTempOutSt 0;
BA_ "GenSigSendType" SG_ 957 HOD_HeatingTempOutSt 1;
BA_ "GenSigStartValue" SG_ 957 HOD_HeatingTempOutSt 0;
BA_ "GenSigTimeoutValue" SG_ 957 HOD_HeatingTempOutSt 0;
BA_ "Remark" SG_ 957 HOD_HeatingTempOutSt "";
BA_ "EventCommandSignal" SG_ 957 HOD_TouchIntensityZone1 0;
BA_ "GatewayedSignals" SG_ 957 HOD_TouchIntensityZone1 0;
BA_ "GenSigInactiveValue" SG_ 957 HOD_TouchIntensityZone1 0;
BA_ "GenSigInvalidValue" SG_ 957 HOD_TouchIntensityZone1 0;
BA_ "GenSigSendType" SG_ 957 HOD_TouchIntensityZone1 1;
BA_ "GenSigStartValue" SG_ 957 HOD_TouchIntensityZone1 0;
BA_ "GenSigTimeoutValue" SG_ 957 HOD_TouchIntensityZone1 0;
BA_ "Remark" SG_ 957 HOD_TouchIntensityZone1 "";
BA_ "EventCommandSignal" SG_ 957 HOD_TouchIntensityZone2 0;
BA_ "GatewayedSignals" SG_ 957 HOD_TouchIntensityZone2 0;
BA_ "GenSigInactiveValue" SG_ 957 HOD_TouchIntensityZone2 0;
BA_ "GenSigInvalidValue" SG_ 957 HOD_TouchIntensityZone2 0;
BA_ "GenSigSendType" SG_ 957 HOD_TouchIntensityZone2 1;
BA_ "GenSigStartValue" SG_ 957 HOD_TouchIntensityZone2 0;
BA_ "GenSigTimeoutValue" SG_ 957 HOD_TouchIntensityZone2 0;
BA_ "Remark" SG_ 957 HOD_TouchIntensityZone2 "";
BA_ "EventCommandSignal" SG_ 957 HOD_TouchIntensityZone3 0;
BA_ "GatewayedSignals" SG_ 957 HOD_TouchIntensityZone3 0;
BA_ "GenSigInactiveValue" SG_ 957 HOD_TouchIntensityZone3 0;
BA_ "GenSigInvalidValue" SG_ 957 HOD_TouchIntensityZone3 0;
BA_ "GenSigSendType" SG_ 957 HOD_TouchIntensityZone3 1;
BA_ "GenSigStartValue" SG_ 957 HOD_TouchIntensityZone3 0;
BA_ "GenSigTimeoutValue" SG_ 957 HOD_TouchIntensityZone3 0;
BA_ "Remark" SG_ 957 HOD_TouchIntensityZone3 "";
BA_ "EventCommandSignal" SG_ 957 HOD_SysErr 0;
BA_ "GatewayedSignals" SG_ 957 HOD_SysErr 0;
BA_ "GenSigInactiveValue" SG_ 957 HOD_SysErr 0;
BA_ "GenSigInvalidValue" SG_ 957 HOD_SysErr 0;
BA_ "GenSigSendType" SG_ 957 HOD_SysErr 1;
BA_ "GenSigStartValue" SG_ 957 HOD_SysErr 0;
BA_ "GenSigTimeoutValue" SG_ 957 HOD_SysErr 0;
BA_ "Remark" SG_ 957 HOD_SysErr "";
BA_ "EventCommandSignal" SG_ 957 HOD_Typ 0;
BA_ "GatewayedSignals" SG_ 957 HOD_Typ 0;
BA_ "GenSigInactiveValue" SG_ 957 HOD_Typ 0;
BA_ "GenSigInvalidValue" SG_ 957 HOD_Typ 0;
BA_ "GenSigSendType" SG_ 957 HOD_Typ 1;
BA_ "GenSigStartValue" SG_ 957 HOD_Typ 0;
BA_ "GenSigTimeoutValue" SG_ 957 HOD_Typ 0;
BA_ "Remark" SG_ 957 HOD_Typ "";
BA_ "EventCommandSignal" SG_ 784 HVAC_PTCExterPwrSupplyFault 0;
BA_ "GatewayedSignals" SG_ 784 HVAC_PTCExterPwrSupplyFault 0;
BA_ "GenSigInactiveValue" SG_ 784 HVAC_PTCExterPwrSupplyFault 0;
BA_ "GenSigInvalidValue" SG_ 784 HVAC_PTCExterPwrSupplyFault 0;
BA_ "GenSigSendType" SG_ 784 HVAC_PTCExterPwrSupplyFault 1;
BA_ "GenSigStartValue" SG_ 784 HVAC_PTCExterPwrSupplyFault 0;
BA_ "GenSigTimeoutValue" SG_ 784 HVAC_PTCExterPwrSupplyFault 0;
BA_ "Remark" SG_ 784 HVAC_PTCExterPwrSupplyFault "";
BA_ "EventCommandSignal" SG_ 791 ZCUF_2_CRC 0;
BA_ "GatewayedSignals" SG_ 791 ZCUF_2_CRC 0;
BA_ "GenSigInactiveValue" SG_ 791 ZCUF_2_CRC 0;
BA_ "GenSigInvalidValue" SG_ 791 ZCUF_2_CRC 0;
BA_ "GenSigSendType" SG_ 791 ZCUF_2_CRC 1;
BA_ "GenSigStartValue" SG_ 791 ZCUF_2_CRC 0;
BA_ "GenSigTimeoutValue" SG_ 791 ZCUF_2_CRC 0;
BA_ "Remark" SG_ 791 ZCUF_2_CRC "";
BA_ "EventCommandSignal" SG_ 791 ZCUF_2_Counter 0;
BA_ "GatewayedSignals" SG_ 791 ZCUF_2_Counter 0;
BA_ "GenSigInactiveValue" SG_ 791 ZCUF_2_Counter 0;
BA_ "GenSigInvalidValue" SG_ 791 ZCUF_2_Counter 0;
BA_ "GenSigSendType" SG_ 791 ZCUF_2_Counter 1;
BA_ "GenSigStartValue" SG_ 791 ZCUF_2_Counter 0;
BA_ "GenSigTimeoutValue" SG_ 791 ZCUF_2_Counter 0;
BA_ "Remark" SG_ 791 ZCUF_2_Counter "";
BA_ "EventCommandSignal" SG_ 791 WW_FWPMotorSt 0;
BA_ "GatewayedSignals" SG_ 791 WW_FWPMotorSt 0;
BA_ "GenSigInactiveValue" SG_ 791 WW_FWPMotorSt 0;
BA_ "GenSigInvalidValue" SG_ 791 WW_FWPMotorSt 0;
BA_ "GenSigSendType" SG_ 791 WW_FWPMotorSt 1;
BA_ "GenSigStartValue" SG_ 791 WW_FWPMotorSt 0;
BA_ "GenSigTimeoutValue" SG_ 791 WW_FWPMotorSt 0;
BA_ "Remark" SG_ 791 WW_FWPMotorSt "";
BA_ "EventCommandSignal" SG_ 791 WW_FWSHMotorSt 0;
BA_ "GatewayedSignals" SG_ 791 WW_FWSHMotorSt 0;
BA_ "GenSigInactiveValue" SG_ 791 WW_FWSHMotorSt 0;
BA_ "GenSigInvalidValue" SG_ 791 WW_FWSHMotorSt 0;
BA_ "GenSigSendType" SG_ 791 WW_FWSHMotorSt 1;
BA_ "GenSigStartValue" SG_ 791 WW_FWSHMotorSt 0;
BA_ "GenSigTimeoutValue" SG_ 791 WW_FWSHMotorSt 0;
BA_ "Remark" SG_ 791 WW_FWSHMotorSt "";
BA_ "EventCommandSignal" SG_ 791 HRN_HornRunningSt 0;
BA_ "GatewayedSignals" SG_ 791 HRN_HornRunningSt 0;
BA_ "GenSigInactiveValue" SG_ 791 HRN_HornRunningSt 0;
BA_ "GenSigInvalidValue" SG_ 791 HRN_HornRunningSt 0;
BA_ "GenSigSendType" SG_ 791 HRN_HornRunningSt 1;
BA_ "GenSigStartValue" SG_ 791 HRN_HornRunningSt 0;
BA_ "GenSigTimeoutValue" SG_ 791 HRN_HornRunningSt 0;
BA_ "Remark" SG_ 791 HRN_HornRunningSt "";
BA_ "EventCommandSignal" SG_ 791 HRN_HornWorkingTemplet 0;
BA_ "GatewayedSignals" SG_ 791 HRN_HornWorkingTemplet 0;
BA_ "GenSigInactiveValue" SG_ 791 HRN_HornWorkingTemplet 0;
BA_ "GenSigInvalidValue" SG_ 791 HRN_HornWorkingTemplet 0;
BA_ "GenSigSendType" SG_ 791 HRN_HornWorkingTemplet 1;
BA_ "GenSigStartValue" SG_ 791 HRN_HornWorkingTemplet 0;
BA_ "GenSigTimeoutValue" SG_ 791 HRN_HornWorkingTemplet 0;
BA_ "Remark" SG_ 791 HRN_HornWorkingTemplet "";
BA_ "EventCommandSignal" SG_ 791 EL_FLPositionLightSt 0;
BA_ "GatewayedSignals" SG_ 791 EL_FLPositionLightSt 0;
BA_ "GenSigInactiveValue" SG_ 791 EL_FLPositionLightSt 0;
BA_ "GenSigInvalidValue" SG_ 791 EL_FLPositionLightSt 0;
BA_ "GenSigSendType" SG_ 791 EL_FLPositionLightSt 1;
BA_ "GenSigStartValue" SG_ 791 EL_FLPositionLightSt 0;
BA_ "GenSigTimeoutValue" SG_ 791 EL_FLPositionLightSt 0;
BA_ "Remark" SG_ 791 EL_FLPositionLightSt "";
BA_ "EventCommandSignal" SG_ 791 EL_FLPositionLightFaultSt 0;
BA_ "GatewayedSignals" SG_ 791 EL_FLPositionLightFaultSt 0;
BA_ "GenSigInactiveValue" SG_ 791 EL_FLPositionLightFaultSt 0;
BA_ "GenSigInvalidValue" SG_ 791 EL_FLPositionLightFaultSt 0;
BA_ "GenSigSendType" SG_ 791 EL_FLPositionLightFaultSt 1;
BA_ "GenSigStartValue" SG_ 791 EL_FLPositionLightFaultSt 0;
BA_ "GenSigTimeoutValue" SG_ 791 EL_FLPositionLightFaultSt 0;
BA_ "Remark" SG_ 791 EL_FLPositionLightFaultSt "";
BA_ "EventCommandSignal" SG_ 791 EL_FRPositionLightSt 0;
BA_ "GatewayedSignals" SG_ 791 EL_FRPositionLightSt 0;
BA_ "GenSigInactiveValue" SG_ 791 EL_FRPositionLightSt 0;
BA_ "GenSigInvalidValue" SG_ 791 EL_FRPositionLightSt 0;
BA_ "GenSigSendType" SG_ 791 EL_FRPositionLightSt 1;
BA_ "GenSigStartValue" SG_ 791 EL_FRPositionLightSt 0;
BA_ "GenSigTimeoutValue" SG_ 791 EL_FRPositionLightSt 0;
BA_ "Remark" SG_ 791 EL_FRPositionLightSt "";
BA_ "EventCommandSignal" SG_ 791 EL_FRPositionLightFaultSt 0;
BA_ "GatewayedSignals" SG_ 791 EL_FRPositionLightFaultSt 0;
BA_ "GenSigInactiveValue" SG_ 791 EL_FRPositionLightFaultSt 0;
BA_ "GenSigInvalidValue" SG_ 791 EL_FRPositionLightFaultSt 0;
BA_ "GenSigSendType" SG_ 791 EL_FRPositionLightFaultSt 1;
BA_ "GenSigStartValue" SG_ 791 EL_FRPositionLightFaultSt 0;
BA_ "GenSigTimeoutValue" SG_ 791 EL_FRPositionLightFaultSt 0;
BA_ "Remark" SG_ 791 EL_FRPositionLightFaultSt "";
BA_ "EventCommandSignal" SG_ 791 EL_LeftLowBeamSt 0;
BA_ "GatewayedSignals" SG_ 791 EL_LeftLowBeamSt 0;
BA_ "GenSigInactiveValue" SG_ 791 EL_LeftLowBeamSt 0;
BA_ "GenSigInvalidValue" SG_ 791 EL_LeftLowBeamSt 0;
BA_ "GenSigSendType" SG_ 791 EL_LeftLowBeamSt 1;
BA_ "GenSigStartValue" SG_ 791 EL_LeftLowBeamSt 0;
BA_ "GenSigTimeoutValue" SG_ 791 EL_LeftLowBeamSt 0;
BA_ "Remark" SG_ 791 EL_LeftLowBeamSt "";
BA_ "EventCommandSignal" SG_ 791 EL_LeftLowBeamFaultSt 0;
BA_ "GatewayedSignals" SG_ 791 EL_LeftLowBeamFaultSt 0;
BA_ "GenSigInactiveValue" SG_ 791 EL_LeftLowBeamFaultSt 0;
BA_ "GenSigInvalidValue" SG_ 791 EL_LeftLowBeamFaultSt 0;
BA_ "GenSigSendType" SG_ 791 EL_LeftLowBeamFaultSt 1;
BA_ "GenSigStartValue" SG_ 791 EL_LeftLowBeamFaultSt 0;
BA_ "GenSigTimeoutValue" SG_ 791 EL_LeftLowBeamFaultSt 0;
BA_ "Remark" SG_ 791 EL_LeftLowBeamFaultSt "";
BA_ "EventCommandSignal" SG_ 791 EL_RightLowBeamSt 0;
BA_ "GatewayedSignals" SG_ 791 EL_RightLowBeamSt 0;
BA_ "GenSigInactiveValue" SG_ 791 EL_RightLowBeamSt 0;
BA_ "GenSigInvalidValue" SG_ 791 EL_RightLowBeamSt 0;
BA_ "GenSigSendType" SG_ 791 EL_RightLowBeamSt 1;
BA_ "GenSigStartValue" SG_ 791 EL_RightLowBeamSt 0;
BA_ "GenSigTimeoutValue" SG_ 791 EL_RightLowBeamSt 0;
BA_ "Remark" SG_ 791 EL_RightLowBeamSt "";
BA_ "EventCommandSignal" SG_ 791 EL_RightLowBeamFaultSt 0;
BA_ "GatewayedSignals" SG_ 791 EL_RightLowBeamFaultSt 0;
BA_ "GenSigInactiveValue" SG_ 791 EL_RightLowBeamFaultSt 0;
BA_ "GenSigInvalidValue" SG_ 791 EL_RightLowBeamFaultSt 0;
BA_ "GenSigSendType" SG_ 791 EL_RightLowBeamFaultSt 1;
BA_ "GenSigStartValue" SG_ 791 EL_RightLowBeamFaultSt 0;
BA_ "GenSigTimeoutValue" SG_ 791 EL_RightLowBeamFaultSt 0;
BA_ "Remark" SG_ 791 EL_RightLowBeamFaultSt "";
BA_ "EventCommandSignal" SG_ 791 EL_LeftHighBeamSt 0;
BA_ "GatewayedSignals" SG_ 791 EL_LeftHighBeamSt 0;
BA_ "GenSigInactiveValue" SG_ 791 EL_LeftHighBeamSt 0;
BA_ "GenSigInvalidValue" SG_ 791 EL_LeftHighBeamSt 0;
BA_ "GenSigSendType" SG_ 791 EL_LeftHighBeamSt 1;
BA_ "GenSigStartValue" SG_ 791 EL_LeftHighBeamSt 0;
BA_ "GenSigTimeoutValue" SG_ 791 EL_LeftHighBeamSt 0;
BA_ "Remark" SG_ 791 EL_LeftHighBeamSt "";
BA_ "EventCommandSignal" SG_ 791 EL_LeftHighBeamFaultSt 0;
BA_ "GatewayedSignals" SG_ 791 EL_LeftHighBeamFaultSt 0;
BA_ "GenSigInactiveValue" SG_ 791 EL_LeftHighBeamFaultSt 0;
BA_ "GenSigInvalidValue" SG_ 791 EL_LeftHighBeamFaultSt 0;
BA_ "GenSigSendType" SG_ 791 EL_LeftHighBeamFaultSt 1;
BA_ "GenSigStartValue" SG_ 791 EL_LeftHighBeamFaultSt 0;
BA_ "GenSigTimeoutValue" SG_ 791 EL_LeftHighBeamFaultSt 0;
BA_ "Remark" SG_ 791 EL_LeftHighBeamFaultSt "";
BA_ "EventCommandSignal" SG_ 791 EL_RightHighBeamSt 0;
BA_ "GatewayedSignals" SG_ 791 EL_RightHighBeamSt 0;
BA_ "GenSigInactiveValue" SG_ 791 EL_RightHighBeamSt 0;
BA_ "GenSigInvalidValue" SG_ 791 EL_RightHighBeamSt 0;
BA_ "GenSigSendType" SG_ 791 EL_RightHighBeamSt 1;
BA_ "GenSigStartValue" SG_ 791 EL_RightHighBeamSt 0;
BA_ "GenSigTimeoutValue" SG_ 791 EL_RightHighBeamSt 0;
BA_ "Remark" SG_ 791 EL_RightHighBeamSt "";
BA_ "EventCommandSignal" SG_ 791 EL_RightHighBeamFaultSt 0;
BA_ "GatewayedSignals" SG_ 791 EL_RightHighBeamFaultSt 0;
BA_ "GenSigInactiveValue" SG_ 791 EL_RightHighBeamFaultSt 0;
BA_ "GenSigInvalidValue" SG_ 791 EL_RightHighBeamFaultSt 0;
BA_ "GenSigSendType" SG_ 791 EL_RightHighBeamFaultSt 1;
BA_ "GenSigStartValue" SG_ 791 EL_RightHighBeamFaultSt 0;
BA_ "GenSigTimeoutValue" SG_ 791 EL_RightHighBeamFaultSt 0;
BA_ "Remark" SG_ 791 EL_RightHighBeamFaultSt "";
BA_ "EventCommandSignal" SG_ 791 EL_FLFogLightSt 0;
BA_ "GatewayedSignals" SG_ 791 EL_FLFogLightSt 0;
BA_ "GenSigInactiveValue" SG_ 791 EL_FLFogLightSt 0;
BA_ "GenSigInvalidValue" SG_ 791 EL_FLFogLightSt 0;
BA_ "GenSigSendType" SG_ 791 EL_FLFogLightSt 1;
BA_ "GenSigStartValue" SG_ 791 EL_FLFogLightSt 0;
BA_ "GenSigTimeoutValue" SG_ 791 EL_FLFogLightSt 0;
BA_ "Remark" SG_ 791 EL_FLFogLightSt "";
BA_ "EventCommandSignal" SG_ 791 EL_FLFogLightFaultSt 0;
BA_ "GatewayedSignals" SG_ 791 EL_FLFogLightFaultSt 0;
BA_ "GenSigInactiveValue" SG_ 791 EL_FLFogLightFaultSt 0;
BA_ "GenSigInvalidValue" SG_ 791 EL_FLFogLightFaultSt 0;
BA_ "GenSigSendType" SG_ 791 EL_FLFogLightFaultSt 1;
BA_ "GenSigStartValue" SG_ 791 EL_FLFogLightFaultSt 0;
BA_ "GenSigTimeoutValue" SG_ 791 EL_FLFogLightFaultSt 0;
BA_ "Remark" SG_ 791 EL_FLFogLightFaultSt "";
BA_ "EventCommandSignal" SG_ 791 EL_FRFogLightSt 0;
BA_ "GatewayedSignals" SG_ 791 EL_FRFogLightSt 0;
BA_ "GenSigInactiveValue" SG_ 791 EL_FRFogLightSt 0;
BA_ "GenSigInvalidValue" SG_ 791 EL_FRFogLightSt 0;
BA_ "GenSigSendType" SG_ 791 EL_FRFogLightSt 1;
BA_ "GenSigStartValue" SG_ 791 EL_FRFogLightSt 0;
BA_ "GenSigTimeoutValue" SG_ 791 EL_FRFogLightSt 0;
BA_ "Remark" SG_ 791 EL_FRFogLightSt "";
BA_ "EventCommandSignal" SG_ 791 EL_FRFogLightFaultSt 0;
BA_ "GatewayedSignals" SG_ 791 EL_FRFogLightFaultSt 0;
BA_ "GenSigInactiveValue" SG_ 791 EL_FRFogLightFaultSt 0;
BA_ "GenSigInvalidValue" SG_ 791 EL_FRFogLightFaultSt 0;
BA_ "GenSigSendType" SG_ 791 EL_FRFogLightFaultSt 1;
BA_ "GenSigStartValue" SG_ 791 EL_FRFogLightFaultSt 0;
BA_ "GenSigTimeoutValue" SG_ 791 EL_FRFogLightFaultSt 0;
BA_ "Remark" SG_ 791 EL_FRFogLightFaultSt "";
BA_ "EventCommandSignal" SG_ 791 EL_LeftDRLSt 0;
BA_ "GatewayedSignals" SG_ 791 EL_LeftDRLSt 0;
BA_ "GenSigInactiveValue" SG_ 791 EL_LeftDRLSt 0;
BA_ "GenSigInvalidValue" SG_ 791 EL_LeftDRLSt 0;
BA_ "GenSigSendType" SG_ 791 EL_LeftDRLSt 1;
BA_ "GenSigStartValue" SG_ 791 EL_LeftDRLSt 0;
BA_ "GenSigTimeoutValue" SG_ 791 EL_LeftDRLSt 0;
BA_ "Remark" SG_ 791 EL_LeftDRLSt "";
BA_ "EventCommandSignal" SG_ 791 EL_LeftDRLFaultSt 0;
BA_ "GatewayedSignals" SG_ 791 EL_LeftDRLFaultSt 0;
BA_ "GenSigInactiveValue" SG_ 791 EL_LeftDRLFaultSt 0;
BA_ "GenSigInvalidValue" SG_ 791 EL_LeftDRLFaultSt 0;
BA_ "GenSigSendType" SG_ 791 EL_LeftDRLFaultSt 1;
BA_ "GenSigStartValue" SG_ 791 EL_LeftDRLFaultSt 0;
BA_ "GenSigTimeoutValue" SG_ 791 EL_LeftDRLFaultSt 0;
BA_ "Remark" SG_ 791 EL_LeftDRLFaultSt "";
BA_ "EventCommandSignal" SG_ 791 EL_RightDRLSt 0;
BA_ "GatewayedSignals" SG_ 791 EL_RightDRLSt 0;
BA_ "GenSigInactiveValue" SG_ 791 EL_RightDRLSt 0;
BA_ "GenSigInvalidValue" SG_ 791 EL_RightDRLSt 0;
BA_ "GenSigSendType" SG_ 791 EL_RightDRLSt 1;
BA_ "GenSigStartValue" SG_ 791 EL_RightDRLSt 0;
BA_ "GenSigTimeoutValue" SG_ 791 EL_RightDRLSt 0;
BA_ "Remark" SG_ 791 EL_RightDRLSt "";
BA_ "EventCommandSignal" SG_ 791 EL_RightDRLFaultSt 0;
BA_ "GatewayedSignals" SG_ 791 EL_RightDRLFaultSt 0;
BA_ "GenSigInactiveValue" SG_ 791 EL_RightDRLFaultSt 0;
BA_ "GenSigInvalidValue" SG_ 791 EL_RightDRLFaultSt 0;
BA_ "GenSigSendType" SG_ 791 EL_RightDRLFaultSt 1;
BA_ "GenSigStartValue" SG_ 791 EL_RightDRLFaultSt 0;
BA_ "GenSigTimeoutValue" SG_ 791 EL_RightDRLFaultSt 0;
BA_ "Remark" SG_ 791 EL_RightDRLFaultSt "";
BA_ "EventCommandSignal" SG_ 791 EL_FLTurnLightSt 0;
BA_ "GatewayedSignals" SG_ 791 EL_FLTurnLightSt 0;
BA_ "GenSigInactiveValue" SG_ 791 EL_FLTurnLightSt 0;
BA_ "GenSigInvalidValue" SG_ 791 EL_FLTurnLightSt 0;
BA_ "GenSigSendType" SG_ 791 EL_FLTurnLightSt 1;
BA_ "GenSigStartValue" SG_ 791 EL_FLTurnLightSt 0;
BA_ "GenSigTimeoutValue" SG_ 791 EL_FLTurnLightSt 0;
BA_ "Remark" SG_ 791 EL_FLTurnLightSt "";
BA_ "EventCommandSignal" SG_ 791 EL_FLTurnLightFaultSt 0;
BA_ "GatewayedSignals" SG_ 791 EL_FLTurnLightFaultSt 0;
BA_ "GenSigInactiveValue" SG_ 791 EL_FLTurnLightFaultSt 0;
BA_ "GenSigInvalidValue" SG_ 791 EL_FLTurnLightFaultSt 0;
BA_ "GenSigSendType" SG_ 791 EL_FLTurnLightFaultSt 1;
BA_ "GenSigStartValue" SG_ 791 EL_FLTurnLightFaultSt 0;
BA_ "GenSigTimeoutValue" SG_ 791 EL_FLTurnLightFaultSt 0;
BA_ "Remark" SG_ 791 EL_FLTurnLightFaultSt "";
BA_ "EventCommandSignal" SG_ 791 EL_FRTurnLightSt 0;
BA_ "GatewayedSignals" SG_ 791 EL_FRTurnLightSt 0;
BA_ "GenSigInactiveValue" SG_ 791 EL_FRTurnLightSt 0;
BA_ "GenSigInvalidValue" SG_ 791 EL_FRTurnLightSt 0;
BA_ "GenSigSendType" SG_ 791 EL_FRTurnLightSt 1;
BA_ "GenSigStartValue" SG_ 791 EL_FRTurnLightSt 0;
BA_ "GenSigTimeoutValue" SG_ 791 EL_FRTurnLightSt 0;
BA_ "Remark" SG_ 791 EL_FRTurnLightSt "";
BA_ "EventCommandSignal" SG_ 791 EL_FRTurnLightFaultSt 0;
BA_ "GatewayedSignals" SG_ 791 EL_FRTurnLightFaultSt 0;
BA_ "GenSigInactiveValue" SG_ 791 EL_FRTurnLightFaultSt 0;
BA_ "GenSigInvalidValue" SG_ 791 EL_FRTurnLightFaultSt 0;
BA_ "GenSigSendType" SG_ 791 EL_FRTurnLightFaultSt 1;
BA_ "GenSigStartValue" SG_ 791 EL_FRTurnLightFaultSt 0;
BA_ "GenSigTimeoutValue" SG_ 791 EL_FRTurnLightFaultSt 0;
BA_ "Remark" SG_ 791 EL_FRTurnLightFaultSt "";
BA_ "EventCommandSignal" SG_ 791 WW_RWSHMotorSt 0;
BA_ "GatewayedSignals" SG_ 791 WW_RWSHMotorSt 0;
BA_ "GenSigInactiveValue" SG_ 791 WW_RWSHMotorSt 0;
BA_ "GenSigInvalidValue" SG_ 791 WW_RWSHMotorSt 0;
BA_ "GenSigSendType" SG_ 791 WW_RWSHMotorSt 1;
BA_ "GenSigStartValue" SG_ 791 WW_RWSHMotorSt 0;
BA_ "GenSigTimeoutValue" SG_ 791 WW_RWSHMotorSt 0;
BA_ "Remark" SG_ 791 WW_RWSHMotorSt "";
BA_ "EventCommandSignal" SG_ 791 EL_FADASLightSt 0;
BA_ "GatewayedSignals" SG_ 791 EL_FADASLightSt 0;
BA_ "GenSigInactiveValue" SG_ 791 EL_FADASLightSt 0;
BA_ "GenSigInvalidValue" SG_ 791 EL_FADASLightSt 0;
BA_ "GenSigSendType" SG_ 791 EL_FADASLightSt 1;
BA_ "GenSigStartValue" SG_ 791 EL_FADASLightSt 0;
BA_ "GenSigTimeoutValue" SG_ 791 EL_FADASLightSt 0;
BA_ "Remark" SG_ 791 EL_FADASLightSt "";
BA_ "EventCommandSignal" SG_ 791 EBSF_BattVolt 0;
BA_ "GatewayedSignals" SG_ 791 EBSF_BattVolt 0;
BA_ "GenSigInactiveValue" SG_ 791 EBSF_BattVolt 0;
BA_ "GenSigInvalidValue" SG_ 791 EBSF_BattVolt 0;
BA_ "GenSigSendType" SG_ 791 EBSF_BattVolt 1;
BA_ "GenSigStartValue" SG_ 791 EBSF_BattVolt 16383;
BA_ "GenSigTimeoutValue" SG_ 791 EBSF_BattVolt 0;
BA_ "Remark" SG_ 791 EBSF_BattVolt "";
BA_ "EventCommandSignal" SG_ 791 EBSF_CurrentRange 0;
BA_ "GatewayedSignals" SG_ 791 EBSF_CurrentRange 0;
BA_ "GenSigInactiveValue" SG_ 791 EBSF_CurrentRange 0;
BA_ "GenSigInvalidValue" SG_ 791 EBSF_CurrentRange 0;
BA_ "GenSigSendType" SG_ 791 EBSF_CurrentRange 1;
BA_ "GenSigStartValue" SG_ 791 EBSF_CurrentRange 3;
BA_ "GenSigTimeoutValue" SG_ 791 EBSF_CurrentRange 0;
BA_ "Remark" SG_ 791 EBSF_CurrentRange "";
BA_ "EventCommandSignal" SG_ 791 EBSF_BattCurrent 0;
BA_ "GatewayedSignals" SG_ 791 EBSF_BattCurrent 0;
BA_ "GenSigInactiveValue" SG_ 791 EBSF_BattCurrent 0;
BA_ "GenSigInvalidValue" SG_ 791 EBSF_BattCurrent 0;
BA_ "GenSigSendType" SG_ 791 EBSF_BattCurrent 1;
BA_ "GenSigStartValue" SG_ 791 EBSF_BattCurrent 65535;
BA_ "GenSigTimeoutValue" SG_ 791 EBSF_BattCurrent 0;
BA_ "Remark" SG_ 791 EBSF_BattCurrent "";
BA_ "EventCommandSignal" SG_ 792 ZCUT_2_CRC 0;
BA_ "GatewayedSignals" SG_ 792 ZCUT_2_CRC 0;
BA_ "GenSigInactiveValue" SG_ 792 ZCUT_2_CRC 0;
BA_ "GenSigInvalidValue" SG_ 792 ZCUT_2_CRC 0;
BA_ "GenSigSendType" SG_ 792 ZCUT_2_CRC 1;
BA_ "GenSigStartValue" SG_ 792 ZCUT_2_CRC 0;
BA_ "GenSigTimeoutValue" SG_ 792 ZCUT_2_CRC 0;
BA_ "Remark" SG_ 792 ZCUT_2_CRC "";
BA_ "EventCommandSignal" SG_ 792 ZCUT_2_Counter 0;
BA_ "GatewayedSignals" SG_ 792 ZCUT_2_Counter 0;
BA_ "GenSigInactiveValue" SG_ 792 ZCUT_2_Counter 0;
BA_ "GenSigInvalidValue" SG_ 792 ZCUT_2_Counter 0;
BA_ "GenSigSendType" SG_ 792 ZCUT_2_Counter 1;
BA_ "GenSigStartValue" SG_ 792 ZCUT_2_Counter 0;
BA_ "GenSigTimeoutValue" SG_ 792 ZCUT_2_Counter 0;
BA_ "Remark" SG_ 792 ZCUT_2_Counter "";
BA_ "EventCommandSignal" SG_ 792 UMM_SecondLHSeatSt 0;
BA_ "GatewayedSignals" SG_ 792 UMM_SecondLHSeatSt 0;
BA_ "GenSigInactiveValue" SG_ 792 UMM_SecondLHSeatSt 0;
BA_ "GenSigInvalidValue" SG_ 792 UMM_SecondLHSeatSt 0;
BA_ "GenSigSendType" SG_ 792 UMM_SecondLHSeatSt 1;
BA_ "GenSigStartValue" SG_ 792 UMM_SecondLHSeatSt 0;
BA_ "GenSigTimeoutValue" SG_ 792 UMM_SecondLHSeatSt 0;
BA_ "Remark" SG_ 792 UMM_SecondLHSeatSt "";
BA_ "EventCommandSignal" SG_ 792 UMM_SecondRHSeatSt 0;
BA_ "GatewayedSignals" SG_ 792 UMM_SecondRHSeatSt 0;
BA_ "GenSigInactiveValue" SG_ 792 UMM_SecondRHSeatSt 0;
BA_ "GenSigInvalidValue" SG_ 792 UMM_SecondRHSeatSt 0;
BA_ "GenSigSendType" SG_ 792 UMM_SecondRHSeatSt 1;
BA_ "GenSigStartValue" SG_ 792 UMM_SecondRHSeatSt 0;
BA_ "GenSigTimeoutValue" SG_ 792 UMM_SecondRHSeatSt 0;
BA_ "Remark" SG_ 792 UMM_SecondRHSeatSt "";
BA_ "EventCommandSignal" SG_ 792 UMM_SecondMIDSeatSt 0;
BA_ "GatewayedSignals" SG_ 792 UMM_SecondMIDSeatSt 0;
BA_ "GenSigInactiveValue" SG_ 792 UMM_SecondMIDSeatSt 0;
BA_ "GenSigInvalidValue" SG_ 792 UMM_SecondMIDSeatSt 0;
BA_ "GenSigSendType" SG_ 792 UMM_SecondMIDSeatSt 1;
BA_ "GenSigStartValue" SG_ 792 UMM_SecondMIDSeatSt 0;
BA_ "GenSigTimeoutValue" SG_ 792 UMM_SecondMIDSeatSt 0;
BA_ "Remark" SG_ 792 UMM_SecondMIDSeatSt "";
BA_ "EventCommandSignal" SG_ 792 LCK_PowerFillerCapAngle 0;
BA_ "GatewayedSignals" SG_ 792 LCK_PowerFillerCapAngle 0;
BA_ "GenSigInactiveValue" SG_ 792 LCK_PowerFillerCapAngle 0;
BA_ "GenSigInvalidValue" SG_ 792 LCK_PowerFillerCapAngle 0;
BA_ "GenSigSendType" SG_ 792 LCK_PowerFillerCapAngle 1;
BA_ "GenSigStartValue" SG_ 792 LCK_PowerFillerCapAngle 0;
BA_ "GenSigTimeoutValue" SG_ 792 LCK_PowerFillerCapAngle 0;
BA_ "Remark" SG_ 792 LCK_PowerFillerCapAngle "";
BA_ "EventCommandSignal" SG_ 792 EL_ReverseLightSt 0;
BA_ "GatewayedSignals" SG_ 792 EL_ReverseLightSt 0;
BA_ "GenSigInactiveValue" SG_ 792 EL_ReverseLightSt 0;
BA_ "GenSigInvalidValue" SG_ 792 EL_ReverseLightSt 0;
BA_ "GenSigSendType" SG_ 792 EL_ReverseLightSt 1;
BA_ "GenSigStartValue" SG_ 792 EL_ReverseLightSt 0;
BA_ "GenSigTimeoutValue" SG_ 792 EL_ReverseLightSt 0;
BA_ "Remark" SG_ 792 EL_ReverseLightSt "";
BA_ "EventCommandSignal" SG_ 792 EL_ReverseLightFaultSt 0;
BA_ "GatewayedSignals" SG_ 792 EL_ReverseLightFaultSt 0;
BA_ "GenSigInactiveValue" SG_ 792 EL_ReverseLightFaultSt 0;
BA_ "GenSigInvalidValue" SG_ 792 EL_ReverseLightFaultSt 0;
BA_ "GenSigSendType" SG_ 792 EL_ReverseLightFaultSt 1;
BA_ "GenSigStartValue" SG_ 792 EL_ReverseLightFaultSt 0;
BA_ "GenSigTimeoutValue" SG_ 792 EL_ReverseLightFaultSt 0;
BA_ "Remark" SG_ 792 EL_ReverseLightFaultSt "";
BA_ "EventCommandSignal" SG_ 792 EL_SideBrkLightSt 0;
BA_ "GatewayedSignals" SG_ 792 EL_SideBrkLightSt 0;
BA_ "GenSigInactiveValue" SG_ 792 EL_SideBrkLightSt 0;
BA_ "GenSigInvalidValue" SG_ 792 EL_SideBrkLightSt 0;
BA_ "GenSigSendType" SG_ 792 EL_SideBrkLightSt 1;
BA_ "GenSigStartValue" SG_ 792 EL_SideBrkLightSt 0;
BA_ "GenSigTimeoutValue" SG_ 792 EL_SideBrkLightSt 0;
BA_ "Remark" SG_ 792 EL_SideBrkLightSt "";
BA_ "EventCommandSignal" SG_ 792 EL_SideBrkLightFaultSt 0;
BA_ "GatewayedSignals" SG_ 792 EL_SideBrkLightFaultSt 0;
BA_ "GenSigInactiveValue" SG_ 792 EL_SideBrkLightFaultSt 0;
BA_ "GenSigInvalidValue" SG_ 792 EL_SideBrkLightFaultSt 0;
BA_ "GenSigSendType" SG_ 792 EL_SideBrkLightFaultSt 1;
BA_ "GenSigStartValue" SG_ 792 EL_SideBrkLightFaultSt 0;
BA_ "GenSigTimeoutValue" SG_ 792 EL_SideBrkLightFaultSt 0;
BA_ "Remark" SG_ 792 EL_SideBrkLightFaultSt "";
BA_ "EventCommandSignal" SG_ 792 EL_CHMSLSt 0;
BA_ "GatewayedSignals" SG_ 792 EL_CHMSLSt 0;
BA_ "GenSigInactiveValue" SG_ 792 EL_CHMSLSt 0;
BA_ "GenSigInvalidValue" SG_ 792 EL_CHMSLSt 0;
BA_ "GenSigSendType" SG_ 792 EL_CHMSLSt 1;
BA_ "GenSigStartValue" SG_ 792 EL_CHMSLSt 0;
BA_ "GenSigTimeoutValue" SG_ 792 EL_CHMSLSt 0;
BA_ "Remark" SG_ 792 EL_CHMSLSt "";
BA_ "EventCommandSignal" SG_ 792 EL_CHMSLFaultSt 0;
BA_ "GatewayedSignals" SG_ 792 EL_CHMSLFaultSt 0;
BA_ "GenSigInactiveValue" SG_ 792 EL_CHMSLFaultSt 0;
BA_ "GenSigInvalidValue" SG_ 792 EL_CHMSLFaultSt 0;
BA_ "GenSigSendType" SG_ 792 EL_CHMSLFaultSt 1;
BA_ "GenSigStartValue" SG_ 792 EL_CHMSLFaultSt 0;
BA_ "GenSigTimeoutValue" SG_ 792 EL_CHMSLFaultSt 0;
BA_ "Remark" SG_ 792 EL_CHMSLFaultSt "";
BA_ "EventCommandSignal" SG_ 792 EL_RLPositionLightSt 0;
BA_ "GatewayedSignals" SG_ 792 EL_RLPositionLightSt 0;
BA_ "GenSigInactiveValue" SG_ 792 EL_RLPositionLightSt 0;
BA_ "GenSigInvalidValue" SG_ 792 EL_RLPositionLightSt 0;
BA_ "GenSigSendType" SG_ 792 EL_RLPositionLightSt 1;
BA_ "GenSigStartValue" SG_ 792 EL_RLPositionLightSt 0;
BA_ "GenSigTimeoutValue" SG_ 792 EL_RLPositionLightSt 0;
BA_ "Remark" SG_ 792 EL_RLPositionLightSt "";
BA_ "EventCommandSignal" SG_ 792 EL_RLPositionLightFaultSt 0;
BA_ "GatewayedSignals" SG_ 792 EL_RLPositionLightFaultSt 0;
BA_ "GenSigInactiveValue" SG_ 792 EL_RLPositionLightFaultSt 0;
BA_ "GenSigInvalidValue" SG_ 792 EL_RLPositionLightFaultSt 0;
BA_ "GenSigSendType" SG_ 792 EL_RLPositionLightFaultSt 1;
BA_ "GenSigStartValue" SG_ 792 EL_RLPositionLightFaultSt 0;
BA_ "GenSigTimeoutValue" SG_ 792 EL_RLPositionLightFaultSt 0;
BA_ "Remark" SG_ 792 EL_RLPositionLightFaultSt "";
BA_ "EventCommandSignal" SG_ 792 EL_RRPositionLightSt 0;
BA_ "GatewayedSignals" SG_ 792 EL_RRPositionLightSt 0;
BA_ "GenSigInactiveValue" SG_ 792 EL_RRPositionLightSt 0;
BA_ "GenSigInvalidValue" SG_ 792 EL_RRPositionLightSt 0;
BA_ "GenSigSendType" SG_ 792 EL_RRPositionLightSt 1;
BA_ "GenSigStartValue" SG_ 792 EL_RRPositionLightSt 0;
BA_ "GenSigTimeoutValue" SG_ 792 EL_RRPositionLightSt 0;
BA_ "Remark" SG_ 792 EL_RRPositionLightSt "";
BA_ "EventCommandSignal" SG_ 792 EL_RRPositionLightFaultSt 0;
BA_ "GatewayedSignals" SG_ 792 EL_RRPositionLightFaultSt 0;
BA_ "GenSigInactiveValue" SG_ 792 EL_RRPositionLightFaultSt 0;
BA_ "GenSigInvalidValue" SG_ 792 EL_RRPositionLightFaultSt 0;
BA_ "GenSigSendType" SG_ 792 EL_RRPositionLightFaultSt 1;
BA_ "GenSigStartValue" SG_ 792 EL_RRPositionLightFaultSt 0;
BA_ "GenSigTimeoutValue" SG_ 792 EL_RRPositionLightFaultSt 0;
BA_ "Remark" SG_ 792 EL_RRPositionLightFaultSt "";
BA_ "EventCommandSignal" SG_ 792 EL_RearFogLightSt 0;
BA_ "GatewayedSignals" SG_ 792 EL_RearFogLightSt 0;
BA_ "GenSigInactiveValue" SG_ 792 EL_RearFogLightSt 0;
BA_ "GenSigInvalidValue" SG_ 792 EL_RearFogLightSt 0;
BA_ "GenSigSendType" SG_ 792 EL_RearFogLightSt 1;
BA_ "GenSigStartValue" SG_ 792 EL_RearFogLightSt 0;
BA_ "GenSigTimeoutValue" SG_ 792 EL_RearFogLightSt 0;
BA_ "Remark" SG_ 792 EL_RearFogLightSt "";
BA_ "EventCommandSignal" SG_ 792 EL_RearFogLightFaultSt 0;
BA_ "GatewayedSignals" SG_ 792 EL_RearFogLightFaultSt 0;
BA_ "GenSigInactiveValue" SG_ 792 EL_RearFogLightFaultSt 0;
BA_ "GenSigInvalidValue" SG_ 792 EL_RearFogLightFaultSt 0;
BA_ "GenSigSendType" SG_ 792 EL_RearFogLightFaultSt 1;
BA_ "GenSigStartValue" SG_ 792 EL_RearFogLightFaultSt 0;
BA_ "GenSigTimeoutValue" SG_ 792 EL_RearFogLightFaultSt 0;
BA_ "Remark" SG_ 792 EL_RearFogLightFaultSt "";
BA_ "EventCommandSignal" SG_ 792 EL_RLTurnLightSt 0;
BA_ "GatewayedSignals" SG_ 792 EL_RLTurnLightSt 0;
BA_ "GenSigInactiveValue" SG_ 792 EL_RLTurnLightSt 0;
BA_ "GenSigInvalidValue" SG_ 792 EL_RLTurnLightSt 0;
BA_ "GenSigSendType" SG_ 792 EL_RLTurnLightSt 1;
BA_ "GenSigStartValue" SG_ 792 EL_RLTurnLightSt 0;
BA_ "GenSigTimeoutValue" SG_ 792 EL_RLTurnLightSt 0;
BA_ "Remark" SG_ 792 EL_RLTurnLightSt "";
BA_ "EventCommandSignal" SG_ 792 EL_RLTurnLightFaultSt 0;
BA_ "GatewayedSignals" SG_ 792 EL_RLTurnLightFaultSt 0;
BA_ "GenSigInactiveValue" SG_ 792 EL_RLTurnLightFaultSt 0;
BA_ "GenSigInvalidValue" SG_ 792 EL_RLTurnLightFaultSt 0;
BA_ "GenSigSendType" SG_ 792 EL_RLTurnLightFaultSt 1;
BA_ "GenSigStartValue" SG_ 792 EL_RLTurnLightFaultSt 0;
BA_ "GenSigTimeoutValue" SG_ 792 EL_RLTurnLightFaultSt 0;
BA_ "Remark" SG_ 792 EL_RLTurnLightFaultSt "";
BA_ "EventCommandSignal" SG_ 792 EL_RRTurnLightSt 0;
BA_ "GatewayedSignals" SG_ 792 EL_RRTurnLightSt 0;
BA_ "GenSigInactiveValue" SG_ 792 EL_RRTurnLightSt 0;
BA_ "GenSigInvalidValue" SG_ 792 EL_RRTurnLightSt 0;
BA_ "GenSigSendType" SG_ 792 EL_RRTurnLightSt 1;
BA_ "GenSigStartValue" SG_ 792 EL_RRTurnLightSt 0;
BA_ "GenSigTimeoutValue" SG_ 792 EL_RRTurnLightSt 0;
BA_ "Remark" SG_ 792 EL_RRTurnLightSt "";
BA_ "EventCommandSignal" SG_ 792 EL_RRTurnLightFaultSt 0;
BA_ "GatewayedSignals" SG_ 792 EL_RRTurnLightFaultSt 0;
BA_ "GenSigInactiveValue" SG_ 792 EL_RRTurnLightFaultSt 0;
BA_ "GenSigInvalidValue" SG_ 792 EL_RRTurnLightFaultSt 0;
BA_ "GenSigSendType" SG_ 792 EL_RRTurnLightFaultSt 1;
BA_ "GenSigStartValue" SG_ 792 EL_RRTurnLightFaultSt 0;
BA_ "GenSigTimeoutValue" SG_ 792 EL_RRTurnLightFaultSt 0;
BA_ "Remark" SG_ 792 EL_RRTurnLightFaultSt "";
BA_ "EventCommandSignal" SG_ 792 EL_RADASLightSt 0;
BA_ "GatewayedSignals" SG_ 792 EL_RADASLightSt 0;
BA_ "GenSigInactiveValue" SG_ 792 EL_RADASLightSt 0;
BA_ "GenSigInvalidValue" SG_ 792 EL_RADASLightSt 0;
BA_ "GenSigSendType" SG_ 792 EL_RADASLightSt 1;
BA_ "GenSigStartValue" SG_ 792 EL_RADASLightSt 0;
BA_ "GenSigTimeoutValue" SG_ 792 EL_RADASLightSt 0;
BA_ "Remark" SG_ 792 EL_RADASLightSt "";
BA_ "EventCommandSignal" SG_ 616 CCU_1_CRC 0;
BA_ "GatewayedSignals" SG_ 616 CCU_1_CRC 0;
BA_ "GenSigInactiveValue" SG_ 616 CCU_1_CRC 0;
BA_ "GenSigInvalidValue" SG_ 616 CCU_1_CRC 0;
BA_ "GenSigSendType" SG_ 616 CCU_1_CRC 1;
BA_ "GenSigStartValue" SG_ 616 CCU_1_CRC 0;
BA_ "GenSigTimeoutValue" SG_ 616 CCU_1_CRC 0;
BA_ "Remark" SG_ 616 CCU_1_CRC "";
BA_ "EventCommandSignal" SG_ 616 CCU_1_Counter 0;
BA_ "GatewayedSignals" SG_ 616 CCU_1_Counter 0;
BA_ "GenSigInactiveValue" SG_ 616 CCU_1_Counter 0;
BA_ "GenSigInvalidValue" SG_ 616 CCU_1_Counter 0;
BA_ "GenSigSendType" SG_ 616 CCU_1_Counter 1;
BA_ "GenSigStartValue" SG_ 616 CCU_1_Counter 0;
BA_ "GenSigTimeoutValue" SG_ 616 CCU_1_Counter 0;
BA_ "Remark" SG_ 616 CCU_1_Counter "";
BA_ "EventCommandSignal" SG_ 616 UMM_UsageModeSt 0;
BA_ "GatewayedSignals" SG_ 616 UMM_UsageModeSt 0;
BA_ "GenSigInactiveValue" SG_ 616 UMM_UsageModeSt 0;
BA_ "GenSigInvalidValue" SG_ 616 UMM_UsageModeSt 0;
BA_ "GenSigSendType" SG_ 616 UMM_UsageModeSt 1;
BA_ "GenSigStartValue" SG_ 616 UMM_UsageModeSt 7;
BA_ "GenSigTimeoutValue" SG_ 616 UMM_UsageModeSt 0;
BA_ "Remark" SG_ 616 UMM_UsageModeSt "";
BA_ "EventCommandSignal" SG_ 616 OTA_FuncReq_ADCWakeup 0;
BA_ "GatewayedSignals" SG_ 616 OTA_FuncReq_ADCWakeup 0;
BA_ "GenSigInactiveValue" SG_ 616 OTA_FuncReq_ADCWakeup 0;
BA_ "GenSigInvalidValue" SG_ 616 OTA_FuncReq_ADCWakeup 0;
BA_ "GenSigSendType" SG_ 616 OTA_FuncReq_ADCWakeup 1;
BA_ "GenSigStartValue" SG_ 616 OTA_FuncReq_ADCWakeup 0;
BA_ "GenSigTimeoutValue" SG_ 616 OTA_FuncReq_ADCWakeup 0;
BA_ "Remark" SG_ 616 OTA_FuncReq_ADCWakeup "";
BA_ "EventCommandSignal" SG_ 616 UMM_DriverSeatSt 0;
BA_ "GatewayedSignals" SG_ 616 UMM_DriverSeatSt 0;
BA_ "GenSigInactiveValue" SG_ 616 UMM_DriverSeatSt 0;
BA_ "GenSigInvalidValue" SG_ 616 UMM_DriverSeatSt 0;
BA_ "GenSigSendType" SG_ 616 UMM_DriverSeatSt 1;
BA_ "GenSigStartValue" SG_ 616 UMM_DriverSeatSt 0;
BA_ "GenSigTimeoutValue" SG_ 616 UMM_DriverSeatSt 0;
BA_ "Remark" SG_ 616 UMM_DriverSeatSt "";
BA_ "EventCommandSignal" SG_ 616 UMM_FrontPassengerSeatSt 0;
BA_ "GatewayedSignals" SG_ 616 UMM_FrontPassengerSeatSt 0;
BA_ "GenSigInactiveValue" SG_ 616 UMM_FrontPassengerSeatSt 0;
BA_ "GenSigInvalidValue" SG_ 616 UMM_FrontPassengerSeatSt 0;
BA_ "GenSigSendType" SG_ 616 UMM_FrontPassengerSeatSt 1;
BA_ "GenSigStartValue" SG_ 616 UMM_FrontPassengerSeatSt 0;
BA_ "GenSigTimeoutValue" SG_ 616 UMM_FrontPassengerSeatSt 0;
BA_ "Remark" SG_ 616 UMM_FrontPassengerSeatSt "";
BA_ "EventCommandSignal" SG_ 616 VMM_VehModeSt 0;
BA_ "GatewayedSignals" SG_ 616 VMM_VehModeSt 0;
BA_ "GenSigInactiveValue" SG_ 616 VMM_VehModeSt 0;
BA_ "GenSigInvalidValue" SG_ 616 VMM_VehModeSt 15;
BA_ "GenSigSendType" SG_ 616 VMM_VehModeSt 1;
BA_ "GenSigStartValue" SG_ 616 VMM_VehModeSt 15;
BA_ "GenSigTimeoutValue" SG_ 616 VMM_VehModeSt 15;
BA_ "Remark" SG_ 616 VMM_VehModeSt "";
BA_ "EventCommandSignal" SG_ 616 VMM_LastVehModeSt 0;
BA_ "GatewayedSignals" SG_ 616 VMM_LastVehModeSt 0;
BA_ "GenSigInactiveValue" SG_ 616 VMM_LastVehModeSt 0;
BA_ "GenSigInvalidValue" SG_ 616 VMM_LastVehModeSt 15;
BA_ "GenSigSendType" SG_ 616 VMM_LastVehModeSt 1;
BA_ "GenSigStartValue" SG_ 616 VMM_LastVehModeSt 15;
BA_ "GenSigTimeoutValue" SG_ 616 VMM_LastVehModeSt 15;
BA_ "Remark" SG_ 616 VMM_LastVehModeSt "";
BA_ "EventCommandSignal" SG_ 616 VMM_OTAModeSt 0;
BA_ "GatewayedSignals" SG_ 616 VMM_OTAModeSt 0;
BA_ "GenSigInactiveValue" SG_ 616 VMM_OTAModeSt 0;
BA_ "GenSigInvalidValue" SG_ 616 VMM_OTAModeSt 2;
BA_ "GenSigSendType" SG_ 616 VMM_OTAModeSt 1;
BA_ "GenSigStartValue" SG_ 616 VMM_OTAModeSt 0;
BA_ "GenSigTimeoutValue" SG_ 616 VMM_OTAModeSt 0;
BA_ "Remark" SG_ 616 VMM_OTAModeSt "";
BA_ "EventCommandSignal" SG_ 616 CCU_DstFlag 0;
BA_ "GatewayedSignals" SG_ 616 CCU_DstFlag 0;
BA_ "GenSigInactiveValue" SG_ 616 CCU_DstFlag 0;
BA_ "GenSigInvalidValue" SG_ 616 CCU_DstFlag 0;
BA_ "GenSigSendType" SG_ 616 CCU_DstFlag 1;
BA_ "GenSigStartValue" SG_ 616 CCU_DstFlag 0;
BA_ "GenSigTimeoutValue" SG_ 616 CCU_DstFlag 0;
BA_ "Remark" SG_ 616 CCU_DstFlag "";
BA_ "EventCommandSignal" SG_ 616 CSM_RC_PAARequest 0;
BA_ "GatewayedSignals" SG_ 616 CSM_RC_PAARequest 0;
BA_ "GenSigInactiveValue" SG_ 616 CSM_RC_PAARequest 0;
BA_ "GenSigInvalidValue" SG_ 616 CSM_RC_PAARequest 0;
BA_ "GenSigSendType" SG_ 616 CSM_RC_PAARequest 1;
BA_ "GenSigStartValue" SG_ 616 CSM_RC_PAARequest 0;
BA_ "GenSigTimeoutValue" SG_ 616 CSM_RC_PAARequest 0;
BA_ "Remark" SG_ 616 CSM_RC_PAARequest "";
BA_ "EventCommandSignal" SG_ 616 CSM_RC_AuthSt 0;
BA_ "GatewayedSignals" SG_ 616 CSM_RC_AuthSt 0;
BA_ "GenSigInactiveValue" SG_ 616 CSM_RC_AuthSt 0;
BA_ "GenSigInvalidValue" SG_ 616 CSM_RC_AuthSt 0;
BA_ "GenSigSendType" SG_ 616 CSM_RC_AuthSt 1;
BA_ "GenSigStartValue" SG_ 616 CSM_RC_AuthSt 0;
BA_ "GenSigTimeoutValue" SG_ 616 CSM_RC_AuthSt 0;
BA_ "Remark" SG_ 616 CSM_RC_AuthSt "";
BA_ "EventCommandSignal" SG_ 616 IPDS_EnablePowerSup 0;
BA_ "GatewayedSignals" SG_ 616 IPDS_EnablePowerSup 0;
BA_ "GenSigInactiveValue" SG_ 616 IPDS_EnablePowerSup 0;
BA_ "GenSigInvalidValue" SG_ 616 IPDS_EnablePowerSup 0;
BA_ "GenSigSendType" SG_ 616 IPDS_EnablePowerSup 1;
BA_ "GenSigStartValue" SG_ 616 IPDS_EnablePowerSup 0;
BA_ "GenSigTimeoutValue" SG_ 616 IPDS_EnablePowerSup 0;
BA_ "Remark" SG_ 616 IPDS_EnablePowerSup "";
BA_ "EventCommandSignal" SG_ 616 Time_Year 0;
BA_ "GatewayedSignals" SG_ 616 Time_Year 0;
BA_ "GenSigInactiveValue" SG_ 616 Time_Year 0;
BA_ "GenSigInvalidValue" SG_ 616 Time_Year 0;
BA_ "GenSigSendType" SG_ 616 Time_Year 1;
BA_ "GenSigStartValue" SG_ 616 Time_Year 0;
BA_ "GenSigTimeoutValue" SG_ 616 Time_Year 0;
BA_ "Remark" SG_ 616 Time_Year "";
BA_ "EventCommandSignal" SG_ 616 Time_Month 0;
BA_ "GatewayedSignals" SG_ 616 Time_Month 0;
BA_ "GenSigInactiveValue" SG_ 616 Time_Month 0;
BA_ "GenSigInvalidValue" SG_ 616 Time_Month 0;
BA_ "GenSigSendType" SG_ 616 Time_Month 1;
BA_ "GenSigStartValue" SG_ 616 Time_Month 0;
BA_ "GenSigTimeoutValue" SG_ 616 Time_Month 0;
BA_ "Remark" SG_ 616 Time_Month "";
BA_ "EventCommandSignal" SG_ 616 Time_Day 0;
BA_ "GatewayedSignals" SG_ 616 Time_Day 0;
BA_ "GenSigInactiveValue" SG_ 616 Time_Day 0;
BA_ "GenSigInvalidValue" SG_ 616 Time_Day 0;
BA_ "GenSigSendType" SG_ 616 Time_Day 1;
BA_ "GenSigStartValue" SG_ 616 Time_Day 1;
BA_ "GenSigTimeoutValue" SG_ 616 Time_Day 0;
BA_ "Remark" SG_ 616 Time_Day "";
BA_ "EventCommandSignal" SG_ 616 Time_Hour 0;
BA_ "GatewayedSignals" SG_ 616 Time_Hour 0;
BA_ "GenSigInactiveValue" SG_ 616 Time_Hour 0;
BA_ "GenSigInvalidValue" SG_ 616 Time_Hour 0;
BA_ "GenSigSendType" SG_ 616 Time_Hour 1;
BA_ "GenSigStartValue" SG_ 616 Time_Hour 1;
BA_ "GenSigTimeoutValue" SG_ 616 Time_Hour 0;
BA_ "Remark" SG_ 616 Time_Hour "";
BA_ "EventCommandSignal" SG_ 616 Time_Min 0;
BA_ "GatewayedSignals" SG_ 616 Time_Min 0;
BA_ "GenSigInactiveValue" SG_ 616 Time_Min 0;
BA_ "GenSigInvalidValue" SG_ 616 Time_Min 0;
BA_ "GenSigSendType" SG_ 616 Time_Min 1;
BA_ "GenSigStartValue" SG_ 616 Time_Min 1;
BA_ "GenSigTimeoutValue" SG_ 616 Time_Min 0;
BA_ "Remark" SG_ 616 Time_Min "";
BA_ "EventCommandSignal" SG_ 616 Time_Sec 0;
BA_ "GatewayedSignals" SG_ 616 Time_Sec 0;
BA_ "GenSigInactiveValue" SG_ 616 Time_Sec 0;
BA_ "GenSigInvalidValue" SG_ 616 Time_Sec 0;
BA_ "GenSigSendType" SG_ 616 Time_Sec 1;
BA_ "GenSigStartValue" SG_ 616 Time_Sec 1;
BA_ "GenSigTimeoutValue" SG_ 616 Time_Sec 0;
BA_ "Remark" SG_ 616 Time_Sec "";
BA_ "EventCommandSignal" SG_ 616 ASB_DriverActiveBeltFaultSt 0;
BA_ "GatewayedSignals" SG_ 616 ASB_DriverActiveBeltFaultSt 0;
BA_ "GenSigInactiveValue" SG_ 616 ASB_DriverActiveBeltFaultSt 0;
BA_ "GenSigInvalidValue" SG_ 616 ASB_DriverActiveBeltFaultSt 0;
BA_ "GenSigSendType" SG_ 616 ASB_DriverActiveBeltFaultSt 1;
BA_ "GenSigStartValue" SG_ 616 ASB_DriverActiveBeltFaultSt 0;
BA_ "GenSigTimeoutValue" SG_ 616 ASB_DriverActiveBeltFaultSt 1;
BA_ "Remark" SG_ 616 ASB_DriverActiveBeltFaultSt "";
BA_ "EventCommandSignal" SG_ 818 HVAC_SysErrSt 0;
BA_ "GatewayedSignals" SG_ 818 HVAC_SysErrSt 0;
BA_ "GenSigInactiveValue" SG_ 818 HVAC_SysErrSt 0;
BA_ "GenSigInvalidValue" SG_ 818 HVAC_SysErrSt 0;
BA_ "GenSigSendType" SG_ 818 HVAC_SysErrSt 1;
BA_ "GenSigStartValue" SG_ 818 HVAC_SysErrSt 0;
BA_ "GenSigTimeoutValue" SG_ 818 HVAC_SysErrSt 0;
BA_ "Remark" SG_ 818 HVAC_SysErrSt "";
BA_ "EventCommandSignal" SG_ 818 HVAC_RefLeakFault 0;
BA_ "GatewayedSignals" SG_ 818 HVAC_RefLeakFault 0;
BA_ "GenSigInactiveValue" SG_ 818 HVAC_RefLeakFault 0;
BA_ "GenSigInvalidValue" SG_ 818 HVAC_RefLeakFault 0;
BA_ "GenSigSendType" SG_ 818 HVAC_RefLeakFault 1;
BA_ "GenSigStartValue" SG_ 818 HVAC_RefLeakFault 0;
BA_ "GenSigTimeoutValue" SG_ 818 HVAC_RefLeakFault 0;
BA_ "Remark" SG_ 818 HVAC_RefLeakFault "";
BA_ "EventCommandSignal" SG_ 816 HVAC_WindExitMode 0;
BA_ "GatewayedSignals" SG_ 816 HVAC_WindExitMode 0;
BA_ "GenSigInactiveValue" SG_ 816 HVAC_WindExitMode 0;
BA_ "GenSigInvalidValue" SG_ 816 HVAC_WindExitMode 0;
BA_ "GenSigSendType" SG_ 816 HVAC_WindExitMode 1;
BA_ "GenSigStartValue" SG_ 816 HVAC_WindExitMode 0;
BA_ "GenSigTimeoutValue" SG_ 816 HVAC_WindExitMode 0;
BA_ "Remark" SG_ 816 HVAC_WindExitMode "";
BA_ "EventCommandSignal" SG_ 816 HVAC_DriverTempSelect 0;
BA_ "GatewayedSignals" SG_ 816 HVAC_DriverTempSelect 0;
BA_ "GenSigInactiveValue" SG_ 816 HVAC_DriverTempSelect 0;
BA_ "GenSigInvalidValue" SG_ 816 HVAC_DriverTempSelect 0;
BA_ "GenSigSendType" SG_ 816 HVAC_DriverTempSelect 1;
BA_ "GenSigStartValue" SG_ 816 HVAC_DriverTempSelect 31;
BA_ "GenSigTimeoutValue" SG_ 816 HVAC_DriverTempSelect 0;
BA_ "Remark" SG_ 816 HVAC_DriverTempSelect "";
BA_ "EventCommandSignal" SG_ 816 HVAC_PsnTempSelect 0;
BA_ "GatewayedSignals" SG_ 816 HVAC_PsnTempSelect 0;
BA_ "GenSigInactiveValue" SG_ 816 HVAC_PsnTempSelect 0;
BA_ "GenSigInvalidValue" SG_ 816 HVAC_PsnTempSelect 0;
BA_ "GenSigSendType" SG_ 816 HVAC_PsnTempSelect 1;
BA_ "GenSigStartValue" SG_ 816 HVAC_PsnTempSelect 31;
BA_ "GenSigTimeoutValue" SG_ 816 HVAC_PsnTempSelect 0;
BA_ "Remark" SG_ 816 HVAC_PsnTempSelect "";
BA_ "EventCommandSignal" SG_ 960 TMS_4_CRC 0;
BA_ "GatewayedSignals" SG_ 960 TMS_4_CRC 0;
BA_ "GenSigInactiveValue" SG_ 960 TMS_4_CRC 0;
BA_ "GenSigInvalidValue" SG_ 960 TMS_4_CRC 0;
BA_ "GenSigSendType" SG_ 960 TMS_4_CRC 1;
BA_ "GenSigStartValue" SG_ 960 TMS_4_CRC 0;
BA_ "GenSigTimeoutValue" SG_ 960 TMS_4_CRC 0;
BA_ "Remark" SG_ 960 TMS_4_CRC "";
BA_ "EventCommandSignal" SG_ 960 TMS_4_Counter 0;
BA_ "GatewayedSignals" SG_ 960 TMS_4_Counter 0;
BA_ "GenSigInactiveValue" SG_ 960 TMS_4_Counter 0;
BA_ "GenSigInvalidValue" SG_ 960 TMS_4_Counter 0;
BA_ "GenSigSendType" SG_ 960 TMS_4_Counter 1;
BA_ "GenSigStartValue" SG_ 960 TMS_4_Counter 0;
BA_ "GenSigTimeoutValue" SG_ 960 TMS_4_Counter 0;
BA_ "Remark" SG_ 960 TMS_4_Counter "";
BA_ "EventCommandSignal" SG_ 960 HVAC_AutoFogFlt 0;
BA_ "GatewayedSignals" SG_ 960 HVAC_AutoFogFlt 0;
BA_ "GenSigInactiveValue" SG_ 960 HVAC_AutoFogFlt 0;
BA_ "GenSigInvalidValue" SG_ 960 HVAC_AutoFogFlt 0;
BA_ "GenSigSendType" SG_ 960 HVAC_AutoFogFlt 1;
BA_ "GenSigStartValue" SG_ 960 HVAC_AutoFogFlt 0;
BA_ "GenSigTimeoutValue" SG_ 960 HVAC_AutoFogFlt 0;
BA_ "Remark" SG_ 960 HVAC_AutoFogFlt "";
BA_ "EventCommandSignal" SG_ 960 HVAC_AutoFogSts 0;
BA_ "GatewayedSignals" SG_ 960 HVAC_AutoFogSts 0;
BA_ "GenSigInactiveValue" SG_ 960 HVAC_AutoFogSts 0;
BA_ "GenSigInvalidValue" SG_ 960 HVAC_AutoFogSts 0;
BA_ "GenSigSendType" SG_ 960 HVAC_AutoFogSts 1;
BA_ "GenSigStartValue" SG_ 960 HVAC_AutoFogSts 0;
BA_ "GenSigTimeoutValue" SG_ 960 HVAC_AutoFogSts 0;
BA_ "Remark" SG_ 960 HVAC_AutoFogSts "";
BA_ "EventCommandSignal" SG_ 825 CCU_FuncReq_SentryMod 0;
BA_ "GatewayedSignals" SG_ 825 CCU_FuncReq_SentryMod 0;
BA_ "GenSigInactiveValue" SG_ 825 CCU_FuncReq_SentryMod 0;
BA_ "GenSigInvalidValue" SG_ 825 CCU_FuncReq_SentryMod 0;
BA_ "GenSigSendType" SG_ 825 CCU_FuncReq_SentryMod 1;
BA_ "GenSigStartValue" SG_ 825 CCU_FuncReq_SentryMod 0;
BA_ "GenSigTimeoutValue" SG_ 825 CCU_FuncReq_SentryMod 0;
BA_ "Remark" SG_ 825 CCU_FuncReq_SentryMod "";
BA_ "EventCommandSignal" SG_ 291 CCU_6_CRC 0;
BA_ "GatewayedSignals" SG_ 291 CCU_6_CRC 0;
BA_ "GenSigInactiveValue" SG_ 291 CCU_6_CRC 0;
BA_ "GenSigInvalidValue" SG_ 291 CCU_6_CRC 0;
BA_ "GenSigSendType" SG_ 291 CCU_6_CRC 1;
BA_ "GenSigStartValue" SG_ 291 CCU_6_CRC 0;
BA_ "GenSigTimeoutValue" SG_ 291 CCU_6_CRC 0;
BA_ "Remark" SG_ 291 CCU_6_CRC "";
BA_ "EventCommandSignal" SG_ 291 CCU_6_Counter 0;
BA_ "GatewayedSignals" SG_ 291 CCU_6_Counter 0;
BA_ "GenSigInactiveValue" SG_ 291 CCU_6_Counter 0;
BA_ "GenSigInvalidValue" SG_ 291 CCU_6_Counter 0;
BA_ "GenSigSendType" SG_ 291 CCU_6_Counter 1;
BA_ "GenSigStartValue" SG_ 291 CCU_6_Counter 0;
BA_ "GenSigTimeoutValue" SG_ 291 CCU_6_Counter 0;
BA_ "Remark" SG_ 291 CCU_6_Counter "";
BA_ "EventCommandSignal" SG_ 291 ATWS_ATWSAlarmReq 0;
BA_ "GatewayedSignals" SG_ 291 ATWS_ATWSAlarmReq 0;
BA_ "GenSigInactiveValue" SG_ 291 ATWS_ATWSAlarmReq 0;
BA_ "GenSigInvalidValue" SG_ 291 ATWS_ATWSAlarmReq 0;
BA_ "GenSigSendType" SG_ 291 ATWS_ATWSAlarmReq 1;
BA_ "GenSigStartValue" SG_ 291 ATWS_ATWSAlarmReq 0;
BA_ "GenSigTimeoutValue" SG_ 291 ATWS_ATWSAlarmReq 0;
BA_ "Remark" SG_ 291 ATWS_ATWSAlarmReq "";
BA_ "EventCommandSignal" SG_ 291 ATWS_ATWSSt 0;
BA_ "GatewayedSignals" SG_ 291 ATWS_ATWSSt 0;
BA_ "GenSigInactiveValue" SG_ 291 ATWS_ATWSSt 0;
BA_ "GenSigInvalidValue" SG_ 291 ATWS_ATWSSt 0;
BA_ "GenSigSendType" SG_ 291 ATWS_ATWSSt 1;
BA_ "GenSigStartValue" SG_ 291 ATWS_ATWSSt 0;
BA_ "GenSigTimeoutValue" SG_ 291 ATWS_ATWSSt 0;
BA_ "Remark" SG_ 291 ATWS_ATWSSt "";
BA_ "EventCommandSignal" SG_ 291 WW_FrontWasherCmd 0;
BA_ "GatewayedSignals" SG_ 291 WW_FrontWasherCmd 0;
BA_ "GenSigInactiveValue" SG_ 291 WW_FrontWasherCmd 0;
BA_ "GenSigInvalidValue" SG_ 291 WW_FrontWasherCmd 0;
BA_ "GenSigSendType" SG_ 291 WW_FrontWasherCmd 1;
BA_ "GenSigStartValue" SG_ 291 WW_FrontWasherCmd 0;
BA_ "GenSigTimeoutValue" SG_ 291 WW_FrontWasherCmd 0;
BA_ "Remark" SG_ 291 WW_FrontWasherCmd "";
BA_ "EventCommandSignal" SG_ 291 WW_FrontWiperCmd_Speed 0;
BA_ "GatewayedSignals" SG_ 291 WW_FrontWiperCmd_Speed 0;
BA_ "GenSigInactiveValue" SG_ 291 WW_FrontWiperCmd_Speed 0;
BA_ "GenSigInvalidValue" SG_ 291 WW_FrontWiperCmd_Speed 0;
BA_ "GenSigSendType" SG_ 291 WW_FrontWiperCmd_Speed 1;
BA_ "GenSigStartValue" SG_ 291 WW_FrontWiperCmd_Speed 0;
BA_ "GenSigTimeoutValue" SG_ 291 WW_FrontWiperCmd_Speed 0;
BA_ "Remark" SG_ 291 WW_FrontWiperCmd_Speed "";
BA_ "EventCommandSignal" SG_ 291 WW_FrontWiperCtrlSt 0;
BA_ "GatewayedSignals" SG_ 291 WW_FrontWiperCtrlSt 0;
BA_ "GenSigInactiveValue" SG_ 291 WW_FrontWiperCtrlSt 0;
BA_ "GenSigInvalidValue" SG_ 291 WW_FrontWiperCtrlSt 0;
BA_ "GenSigSendType" SG_ 291 WW_FrontWiperCtrlSt 1;
BA_ "GenSigStartValue" SG_ 291 WW_FrontWiperCtrlSt 0;
BA_ "GenSigTimeoutValue" SG_ 291 WW_FrontWiperCtrlSt 0;
BA_ "Remark" SG_ 291 WW_FrontWiperCtrlSt "";
BA_ "EventCommandSignal" SG_ 291 WW_RearWiperCtrlSt 0;
BA_ "GatewayedSignals" SG_ 291 WW_RearWiperCtrlSt 0;
BA_ "GenSigInactiveValue" SG_ 291 WW_RearWiperCtrlSt 0;
BA_ "GenSigInvalidValue" SG_ 291 WW_RearWiperCtrlSt 0;
BA_ "GenSigSendType" SG_ 291 WW_RearWiperCtrlSt 1;
BA_ "GenSigStartValue" SG_ 291 WW_RearWiperCtrlSt 0;
BA_ "GenSigTimeoutValue" SG_ 291 WW_RearWiperCtrlSt 0;
BA_ "Remark" SG_ 291 WW_RearWiperCtrlSt "";
BA_ "EventCommandSignal" SG_ 291 WW_FrontWiperCtrlSrc 0;
BA_ "GatewayedSignals" SG_ 291 WW_FrontWiperCtrlSrc 0;
BA_ "GenSigInactiveValue" SG_ 291 WW_FrontWiperCtrlSrc 0;
BA_ "GenSigInvalidValue" SG_ 291 WW_FrontWiperCtrlSrc 0;
BA_ "GenSigSendType" SG_ 291 WW_FrontWiperCtrlSrc 1;
BA_ "GenSigStartValue" SG_ 291 WW_FrontWiperCtrlSrc 0;
BA_ "GenSigTimeoutValue" SG_ 291 WW_FrontWiperCtrlSrc 0;
BA_ "Remark" SG_ 291 WW_FrontWiperCtrlSrc "";
BA_ "EventCommandSignal" SG_ 291 WW_RearWiperCtrlSrc 0;
BA_ "GatewayedSignals" SG_ 291 WW_RearWiperCtrlSrc 0;
BA_ "GenSigInactiveValue" SG_ 291 WW_RearWiperCtrlSrc 0;
BA_ "GenSigInvalidValue" SG_ 291 WW_RearWiperCtrlSrc 0;
BA_ "GenSigSendType" SG_ 291 WW_RearWiperCtrlSrc 1;
BA_ "GenSigStartValue" SG_ 291 WW_RearWiperCtrlSrc 0;
BA_ "GenSigTimeoutValue" SG_ 291 WW_RearWiperCtrlSrc 0;
BA_ "Remark" SG_ 291 WW_RearWiperCtrlSrc "";
BA_ "EventCommandSignal" SG_ 291 WW_RearCamWasherVKResp 0;
BA_ "GatewayedSignals" SG_ 291 WW_RearCamWasherVKResp 0;
BA_ "GenSigInactiveValue" SG_ 291 WW_RearCamWasherVKResp 0;
BA_ "GenSigInvalidValue" SG_ 291 WW_RearCamWasherVKResp 3;
BA_ "GenSigSendType" SG_ 291 WW_RearCamWasherVKResp 1;
BA_ "GenSigStartValue" SG_ 291 WW_RearCamWasherVKResp 0;
BA_ "GenSigTimeoutValue" SG_ 291 WW_RearCamWasherVKResp 0;
BA_ "Remark" SG_ 291 WW_RearCamWasherVKResp "";
BA_ "EventCommandSignal" SG_ 291 WW_RearCamWasherVRResp 0;
BA_ "GatewayedSignals" SG_ 291 WW_RearCamWasherVRResp 0;
BA_ "GenSigInactiveValue" SG_ 291 WW_RearCamWasherVRResp 0;
BA_ "GenSigInvalidValue" SG_ 291 WW_RearCamWasherVRResp 3;
BA_ "GenSigSendType" SG_ 291 WW_RearCamWasherVRResp 1;
BA_ "GenSigStartValue" SG_ 291 WW_RearCamWasherVRResp 0;
BA_ "GenSigTimeoutValue" SG_ 291 WW_RearCamWasherVRResp 0;
BA_ "Remark" SG_ 291 WW_RearCamWasherVRResp "";
BA_ "EventCommandSignal" SG_ 865 EL_ReverseLightCtrlCmd 0;
BA_ "GatewayedSignals" SG_ 865 EL_ReverseLightCtrlCmd 0;
BA_ "GenSigInactiveValue" SG_ 865 EL_ReverseLightCtrlCmd 0;
BA_ "GenSigInvalidValue" SG_ 865 EL_ReverseLightCtrlCmd 0;
BA_ "GenSigSendType" SG_ 865 EL_ReverseLightCtrlCmd 1;
BA_ "GenSigStartValue" SG_ 865 EL_ReverseLightCtrlCmd 0;
BA_ "GenSigTimeoutValue" SG_ 865 EL_ReverseLightCtrlCmd 0;
BA_ "Remark" SG_ 865 EL_ReverseLightCtrlCmd "";
BA_ "EventCommandSignal" SG_ 865 EL_SideBrkLightCtrlCmd 0;
BA_ "GatewayedSignals" SG_ 865 EL_SideBrkLightCtrlCmd 0;
BA_ "GenSigInactiveValue" SG_ 865 EL_SideBrkLightCtrlCmd 0;
BA_ "GenSigInvalidValue" SG_ 865 EL_SideBrkLightCtrlCmd 0;
BA_ "GenSigSendType" SG_ 865 EL_SideBrkLightCtrlCmd 1;
BA_ "GenSigStartValue" SG_ 865 EL_SideBrkLightCtrlCmd 0;
BA_ "GenSigTimeoutValue" SG_ 865 EL_SideBrkLightCtrlCmd 0;
BA_ "Remark" SG_ 865 EL_SideBrkLightCtrlCmd "";
BA_ "EventCommandSignal" SG_ 865 EL_LeftLowBeamCtrlCmd 0;
BA_ "GatewayedSignals" SG_ 865 EL_LeftLowBeamCtrlCmd 0;
BA_ "GenSigInactiveValue" SG_ 865 EL_LeftLowBeamCtrlCmd 0;
BA_ "GenSigInvalidValue" SG_ 865 EL_LeftLowBeamCtrlCmd 0;
BA_ "GenSigSendType" SG_ 865 EL_LeftLowBeamCtrlCmd 1;
BA_ "GenSigStartValue" SG_ 865 EL_LeftLowBeamCtrlCmd 0;
BA_ "GenSigTimeoutValue" SG_ 865 EL_LeftLowBeamCtrlCmd 0;
BA_ "Remark" SG_ 865 EL_LeftLowBeamCtrlCmd "";
BA_ "EventCommandSignal" SG_ 865 EL_RightLowBeamCtrlCmd 0;
BA_ "GatewayedSignals" SG_ 865 EL_RightLowBeamCtrlCmd 0;
BA_ "GenSigInactiveValue" SG_ 865 EL_RightLowBeamCtrlCmd 0;
BA_ "GenSigInvalidValue" SG_ 865 EL_RightLowBeamCtrlCmd 0;
BA_ "GenSigSendType" SG_ 865 EL_RightLowBeamCtrlCmd 1;
BA_ "GenSigStartValue" SG_ 865 EL_RightLowBeamCtrlCmd 0;
BA_ "GenSigTimeoutValue" SG_ 865 EL_RightLowBeamCtrlCmd 0;
BA_ "Remark" SG_ 865 EL_RightLowBeamCtrlCmd "";
BA_ "EventCommandSignal" SG_ 865 EL_PositionLightCtrlSource 0;
BA_ "GatewayedSignals" SG_ 865 EL_PositionLightCtrlSource 0;
BA_ "GenSigInactiveValue" SG_ 865 EL_PositionLightCtrlSource 0;
BA_ "GenSigInvalidValue" SG_ 865 EL_PositionLightCtrlSource 0;
BA_ "GenSigSendType" SG_ 865 EL_PositionLightCtrlSource 1;
BA_ "GenSigStartValue" SG_ 865 EL_PositionLightCtrlSource 0;
BA_ "GenSigTimeoutValue" SG_ 865 EL_PositionLightCtrlSource 0;
BA_ "Remark" SG_ 865 EL_PositionLightCtrlSource "";
BA_ "EventCommandSignal" SG_ 865 EL_LeftHighBeamCtrlCmd 0;
BA_ "GatewayedSignals" SG_ 865 EL_LeftHighBeamCtrlCmd 0;
BA_ "GenSigInactiveValue" SG_ 865 EL_LeftHighBeamCtrlCmd 0;
BA_ "GenSigInvalidValue" SG_ 865 EL_LeftHighBeamCtrlCmd 0;
BA_ "GenSigSendType" SG_ 865 EL_LeftHighBeamCtrlCmd 1;
BA_ "GenSigStartValue" SG_ 865 EL_LeftHighBeamCtrlCmd 0;
BA_ "GenSigTimeoutValue" SG_ 865 EL_LeftHighBeamCtrlCmd 0;
BA_ "Remark" SG_ 865 EL_LeftHighBeamCtrlCmd "";
BA_ "EventCommandSignal" SG_ 865 EL_RightHighBeamCtrlCmd 0;
BA_ "GatewayedSignals" SG_ 865 EL_RightHighBeamCtrlCmd 0;
BA_ "GenSigInactiveValue" SG_ 865 EL_RightHighBeamCtrlCmd 0;
BA_ "GenSigInvalidValue" SG_ 865 EL_RightHighBeamCtrlCmd 0;
BA_ "GenSigSendType" SG_ 865 EL_RightHighBeamCtrlCmd 1;
BA_ "GenSigStartValue" SG_ 865 EL_RightHighBeamCtrlCmd 0;
BA_ "GenSigTimeoutValue" SG_ 865 EL_RightHighBeamCtrlCmd 0;
BA_ "Remark" SG_ 865 EL_RightHighBeamCtrlCmd "";
BA_ "EventCommandSignal" SG_ 865 EL_LowBeamCtrlSource 0;
BA_ "GatewayedSignals" SG_ 865 EL_LowBeamCtrlSource 0;
BA_ "GenSigInactiveValue" SG_ 865 EL_LowBeamCtrlSource 0;
BA_ "GenSigInvalidValue" SG_ 865 EL_LowBeamCtrlSource 0;
BA_ "GenSigSendType" SG_ 865 EL_LowBeamCtrlSource 1;
BA_ "GenSigStartValue" SG_ 865 EL_LowBeamCtrlSource 0;
BA_ "GenSigTimeoutValue" SG_ 865 EL_LowBeamCtrlSource 0;
BA_ "Remark" SG_ 865 EL_LowBeamCtrlSource "";
BA_ "EventCommandSignal" SG_ 865 EL_RearFogLightCtrlSource 0;
BA_ "GatewayedSignals" SG_ 865 EL_RearFogLightCtrlSource 0;
BA_ "GenSigInactiveValue" SG_ 865 EL_RearFogLightCtrlSource 0;
BA_ "GenSigInvalidValue" SG_ 865 EL_RearFogLightCtrlSource 0;
BA_ "GenSigSendType" SG_ 865 EL_RearFogLightCtrlSource 1;
BA_ "GenSigStartValue" SG_ 865 EL_RearFogLightCtrlSource 0;
BA_ "GenSigTimeoutValue" SG_ 865 EL_RearFogLightCtrlSource 0;
BA_ "Remark" SG_ 865 EL_RearFogLightCtrlSource "";
BA_ "EventCommandSignal" SG_ 865 EL_HighBeamCtrlSource 0;
BA_ "GatewayedSignals" SG_ 865 EL_HighBeamCtrlSource 0;
BA_ "GenSigInactiveValue" SG_ 865 EL_HighBeamCtrlSource 0;
BA_ "GenSigInvalidValue" SG_ 865 EL_HighBeamCtrlSource 0;
BA_ "GenSigSendType" SG_ 865 EL_HighBeamCtrlSource 1;
BA_ "GenSigStartValue" SG_ 865 EL_HighBeamCtrlSource 0;
BA_ "GenSigTimeoutValue" SG_ 865 EL_HighBeamCtrlSource 0;
BA_ "Remark" SG_ 865 EL_HighBeamCtrlSource "";
BA_ "EventCommandSignal" SG_ 865 EL_FrontFogLightCtrlSource 0;
BA_ "GatewayedSignals" SG_ 865 EL_FrontFogLightCtrlSource 0;
BA_ "GenSigInactiveValue" SG_ 865 EL_FrontFogLightCtrlSource 0;
BA_ "GenSigInvalidValue" SG_ 865 EL_FrontFogLightCtrlSource 0;
BA_ "GenSigSendType" SG_ 865 EL_FrontFogLightCtrlSource 1;
BA_ "GenSigStartValue" SG_ 865 EL_FrontFogLightCtrlSource 0;
BA_ "GenSigTimeoutValue" SG_ 865 EL_FrontFogLightCtrlSource 0;
BA_ "Remark" SG_ 865 EL_FrontFogLightCtrlSource "";
BA_ "EventCommandSignal" SG_ 865 EL_LicencePlateLightCtrlSource 0;
BA_ "GatewayedSignals" SG_ 865 EL_LicencePlateLightCtrlSource 0;
BA_ "GenSigInactiveValue" SG_ 865 EL_LicencePlateLightCtrlSource 0;
BA_ "GenSigInvalidValue" SG_ 865 EL_LicencePlateLightCtrlSource 0;
BA_ "GenSigSendType" SG_ 865 EL_LicencePlateLightCtrlSource 1;
BA_ "GenSigStartValue" SG_ 865 EL_LicencePlateLightCtrlSource 0;
BA_ "GenSigTimeoutValue" SG_ 865 EL_LicencePlateLightCtrlSource 0;
BA_ "Remark" SG_ 865 EL_LicencePlateLightCtrlSource "";
BA_ "EventCommandSignal" SG_ 865 EL_FlasherCtrlSource 0;
BA_ "GatewayedSignals" SG_ 865 EL_FlasherCtrlSource 0;
BA_ "GenSigInactiveValue" SG_ 865 EL_FlasherCtrlSource 0;
BA_ "GenSigInvalidValue" SG_ 865 EL_FlasherCtrlSource 0;
BA_ "GenSigSendType" SG_ 865 EL_FlasherCtrlSource 1;
BA_ "GenSigStartValue" SG_ 865 EL_FlasherCtrlSource 0;
BA_ "GenSigTimeoutValue" SG_ 865 EL_FlasherCtrlSource 0;
BA_ "Remark" SG_ 865 EL_FlasherCtrlSource "";
BA_ "EventCommandSignal" SG_ 865 EL_FADASLightCtrlCmd 0;
BA_ "GatewayedSignals" SG_ 865 EL_FADASLightCtrlCmd 0;
BA_ "GenSigInactiveValue" SG_ 865 EL_FADASLightCtrlCmd 0;
BA_ "GenSigInvalidValue" SG_ 865 EL_FADASLightCtrlCmd 0;
BA_ "GenSigSendType" SG_ 865 EL_FADASLightCtrlCmd 1;
BA_ "GenSigStartValue" SG_ 865 EL_FADASLightCtrlCmd 0;
BA_ "GenSigTimeoutValue" SG_ 865 EL_FADASLightCtrlCmd 0;
BA_ "Remark" SG_ 865 EL_FADASLightCtrlCmd "";
BA_ "EventCommandSignal" SG_ 865 EL_RADASLightCtrlCmd 0;
BA_ "GatewayedSignals" SG_ 865 EL_RADASLightCtrlCmd 0;
BA_ "GenSigInactiveValue" SG_ 865 EL_RADASLightCtrlCmd 0;
BA_ "GenSigInvalidValue" SG_ 865 EL_RADASLightCtrlCmd 0;
BA_ "GenSigSendType" SG_ 865 EL_RADASLightCtrlCmd 1;
BA_ "GenSigStartValue" SG_ 865 EL_RADASLightCtrlCmd 0;
BA_ "GenSigTimeoutValue" SG_ 865 EL_RADASLightCtrlCmd 0;
BA_ "Remark" SG_ 865 EL_RADASLightCtrlCmd "";
BA_ "EventCommandSignal" SG_ 865 EL_IHBColourSt 0;
BA_ "GatewayedSignals" SG_ 865 EL_IHBColourSt 0;
BA_ "GenSigInactiveValue" SG_ 865 EL_IHBColourSt 0;
BA_ "GenSigInvalidValue" SG_ 865 EL_IHBColourSt 0;
BA_ "GenSigSendType" SG_ 865 EL_IHBColourSt 1;
BA_ "GenSigStartValue" SG_ 865 EL_IHBColourSt 0;
BA_ "GenSigTimeoutValue" SG_ 865 EL_IHBColourSt 0;
BA_ "Remark" SG_ 865 EL_IHBColourSt "";
BA_ "EventCommandSignal" SG_ 865 EL_AutoHighBeamCtrlSt 0;
BA_ "GatewayedSignals" SG_ 865 EL_AutoHighBeamCtrlSt 0;
BA_ "GenSigInactiveValue" SG_ 865 EL_AutoHighBeamCtrlSt 0;
BA_ "GenSigInvalidValue" SG_ 865 EL_AutoHighBeamCtrlSt 0;
BA_ "GenSigSendType" SG_ 865 EL_AutoHighBeamCtrlSt 1;
BA_ "GenSigStartValue" SG_ 865 EL_AutoHighBeamCtrlSt 0;
BA_ "GenSigTimeoutValue" SG_ 865 EL_AutoHighBeamCtrlSt 0;
BA_ "Remark" SG_ 865 EL_AutoHighBeamCtrlSt "";
BA_ "EventCommandSignal" SG_ 865 EL_ADC_2_VERFailFlag 0;
BA_ "GatewayedSignals" SG_ 865 EL_ADC_2_VERFailFlag 0;
BA_ "GenSigInactiveValue" SG_ 865 EL_ADC_2_VERFailFlag 0;
BA_ "GenSigInvalidValue" SG_ 865 EL_ADC_2_VERFailFlag 0;
BA_ "GenSigSendType" SG_ 865 EL_ADC_2_VERFailFlag 1;
BA_ "GenSigStartValue" SG_ 865 EL_ADC_2_VERFailFlag 0;
BA_ "GenSigTimeoutValue" SG_ 865 EL_ADC_2_VERFailFlag 0;
BA_ "Remark" SG_ 865 EL_ADC_2_VERFailFlag "";
BA_ "EventCommandSignal" SG_ 865 EL_ADC_4_New_VERFailFlag 0;
BA_ "GatewayedSignals" SG_ 865 EL_ADC_4_New_VERFailFlag 0;
BA_ "GenSigInactiveValue" SG_ 865 EL_ADC_4_New_VERFailFlag 0;
BA_ "GenSigInvalidValue" SG_ 865 EL_ADC_4_New_VERFailFlag 0;
BA_ "GenSigSendType" SG_ 865 EL_ADC_4_New_VERFailFlag 1;
BA_ "GenSigStartValue" SG_ 865 EL_ADC_4_New_VERFailFlag 0;
BA_ "GenSigTimeoutValue" SG_ 865 EL_ADC_4_New_VERFailFlag 0;
BA_ "Remark" SG_ 865 EL_ADC_4_New_VERFailFlag "";
BA_ "EventCommandSignal" SG_ 865 EL_ADC_8_VERFailFlag 0;
BA_ "GatewayedSignals" SG_ 865 EL_ADC_8_VERFailFlag 0;
BA_ "GenSigInactiveValue" SG_ 865 EL_ADC_8_VERFailFlag 0;
BA_ "GenSigInvalidValue" SG_ 865 EL_ADC_8_VERFailFlag 0;
BA_ "GenSigSendType" SG_ 865 EL_ADC_8_VERFailFlag 1;
BA_ "GenSigStartValue" SG_ 865 EL_ADC_8_VERFailFlag 0;
BA_ "GenSigTimeoutValue" SG_ 865 EL_ADC_8_VERFailFlag 0;
BA_ "Remark" SG_ 865 EL_ADC_8_VERFailFlag "";
BA_ "EventCommandSignal" SG_ 865 EL_ADBEnable 0;
BA_ "GatewayedSignals" SG_ 865 EL_ADBEnable 0;
BA_ "GenSigInactiveValue" SG_ 865 EL_ADBEnable 0;
BA_ "GenSigInvalidValue" SG_ 865 EL_ADBEnable 0;
BA_ "GenSigSendType" SG_ 865 EL_ADBEnable 1;
BA_ "GenSigStartValue" SG_ 865 EL_ADBEnable 1;
BA_ "GenSigTimeoutValue" SG_ 865 EL_ADBEnable 0;
BA_ "Remark" SG_ 865 EL_ADBEnable "";
BA_ "EventCommandSignal" SG_ 865 EL_HeadLightLevelingSWSt 0;
BA_ "GatewayedSignals" SG_ 865 EL_HeadLightLevelingSWSt 0;
BA_ "GenSigInactiveValue" SG_ 865 EL_HeadLightLevelingSWSt 0;
BA_ "GenSigInvalidValue" SG_ 865 EL_HeadLightLevelingSWSt 0;
BA_ "GenSigSendType" SG_ 865 EL_HeadLightLevelingSWSt 1;
BA_ "GenSigStartValue" SG_ 865 EL_HeadLightLevelingSWSt 0;
BA_ "GenSigTimeoutValue" SG_ 865 EL_HeadLightLevelingSWSt 0;
BA_ "Remark" SG_ 865 EL_HeadLightLevelingSWSt "";
BA_ "EventCommandSignal" SG_ 865 EL_LeftTurnLightStForDisp 0;
BA_ "GatewayedSignals" SG_ 865 EL_LeftTurnLightStForDisp 0;
BA_ "GenSigInactiveValue" SG_ 865 EL_LeftTurnLightStForDisp 0;
BA_ "GenSigInvalidValue" SG_ 865 EL_LeftTurnLightStForDisp 0;
BA_ "GenSigSendType" SG_ 865 EL_LeftTurnLightStForDisp 1;
BA_ "GenSigStartValue" SG_ 865 EL_LeftTurnLightStForDisp 0;
BA_ "GenSigTimeoutValue" SG_ 865 EL_LeftTurnLightStForDisp 0;
BA_ "Remark" SG_ 865 EL_LeftTurnLightStForDisp "";
BA_ "EventCommandSignal" SG_ 865 EL_RightTurnLightStForDisp 0;
BA_ "GatewayedSignals" SG_ 865 EL_RightTurnLightStForDisp 0;
BA_ "GenSigInactiveValue" SG_ 865 EL_RightTurnLightStForDisp 0;
BA_ "GenSigInvalidValue" SG_ 865 EL_RightTurnLightStForDisp 0;
BA_ "GenSigSendType" SG_ 865 EL_RightTurnLightStForDisp 1;
BA_ "GenSigStartValue" SG_ 865 EL_RightTurnLightStForDisp 0;
BA_ "GenSigTimeoutValue" SG_ 865 EL_RightTurnLightStForDisp 0;
BA_ "Remark" SG_ 865 EL_RightTurnLightStForDisp "";
BA_ "EventCommandSignal" SG_ 865 EL_PositionLightStForDisp 0;
BA_ "GatewayedSignals" SG_ 865 EL_PositionLightStForDisp 0;
BA_ "GenSigInactiveValue" SG_ 865 EL_PositionLightStForDisp 0;
BA_ "GenSigInvalidValue" SG_ 865 EL_PositionLightStForDisp 0;
BA_ "GenSigSendType" SG_ 865 EL_PositionLightStForDisp 1;
BA_ "GenSigStartValue" SG_ 865 EL_PositionLightStForDisp 0;
BA_ "GenSigTimeoutValue" SG_ 865 EL_PositionLightStForDisp 0;
BA_ "Remark" SG_ 865 EL_PositionLightStForDisp "";
BA_ "EventCommandSignal" SG_ 865 EL_FrontFogLightStForDisp 0;
BA_ "GatewayedSignals" SG_ 865 EL_FrontFogLightStForDisp 0;
BA_ "GenSigInactiveValue" SG_ 865 EL_FrontFogLightStForDisp 0;
BA_ "GenSigInvalidValue" SG_ 865 EL_FrontFogLightStForDisp 0;
BA_ "GenSigSendType" SG_ 865 EL_FrontFogLightStForDisp 1;
BA_ "GenSigStartValue" SG_ 865 EL_FrontFogLightStForDisp 0;
BA_ "GenSigTimeoutValue" SG_ 865 EL_FrontFogLightStForDisp 0;
BA_ "Remark" SG_ 865 EL_FrontFogLightStForDisp "";
BA_ "EventCommandSignal" SG_ 865 EL_RearFogLightStForDisp 0;
BA_ "GatewayedSignals" SG_ 865 EL_RearFogLightStForDisp 0;
BA_ "GenSigInactiveValue" SG_ 865 EL_RearFogLightStForDisp 0;
BA_ "GenSigInvalidValue" SG_ 865 EL_RearFogLightStForDisp 0;
BA_ "GenSigSendType" SG_ 865 EL_RearFogLightStForDisp 1;
BA_ "GenSigStartValue" SG_ 865 EL_RearFogLightStForDisp 0;
BA_ "GenSigTimeoutValue" SG_ 865 EL_RearFogLightStForDisp 0;
BA_ "Remark" SG_ 865 EL_RearFogLightStForDisp "";
BA_ "EventCommandSignal" SG_ 865 EL_LowBeamStForDisp 0;
BA_ "GatewayedSignals" SG_ 865 EL_LowBeamStForDisp 0;
BA_ "GenSigInactiveValue" SG_ 865 EL_LowBeamStForDisp 0;
BA_ "GenSigInvalidValue" SG_ 865 EL_LowBeamStForDisp 0;
BA_ "GenSigSendType" SG_ 865 EL_LowBeamStForDisp 1;
BA_ "GenSigStartValue" SG_ 865 EL_LowBeamStForDisp 0;
BA_ "GenSigTimeoutValue" SG_ 865 EL_LowBeamStForDisp 0;
BA_ "Remark" SG_ 865 EL_LowBeamStForDisp "";
BA_ "EventCommandSignal" SG_ 865 EL_HighBeamStForDisp 0;
BA_ "GatewayedSignals" SG_ 865 EL_HighBeamStForDisp 0;
BA_ "GenSigInactiveValue" SG_ 865 EL_HighBeamStForDisp 0;
BA_ "GenSigInvalidValue" SG_ 865 EL_HighBeamStForDisp 0;
BA_ "GenSigSendType" SG_ 865 EL_HighBeamStForDisp 1;
BA_ "GenSigStartValue" SG_ 865 EL_HighBeamStForDisp 0;
BA_ "GenSigTimeoutValue" SG_ 865 EL_HighBeamStForDisp 0;
BA_ "Remark" SG_ 865 EL_HighBeamStForDisp "";
BA_ "EventCommandSignal" SG_ 865 EL_HeadLightSWSt 0;
BA_ "GatewayedSignals" SG_ 865 EL_HeadLightSWSt 0;
BA_ "GenSigInactiveValue" SG_ 865 EL_HeadLightSWSt 0;
BA_ "GenSigInvalidValue" SG_ 865 EL_HeadLightSWSt 0;
BA_ "GenSigSendType" SG_ 865 EL_HeadLightSWSt 1;
BA_ "GenSigStartValue" SG_ 865 EL_HeadLightSWSt 0;
BA_ "GenSigTimeoutValue" SG_ 865 EL_HeadLightSWSt 0;
BA_ "Remark" SG_ 865 EL_HeadLightSWSt "";
BA_ "EventCommandSignal" SG_ 293 TPMS_FrontLeftTireBlowout 1;
BA_ "GatewayedSignals" SG_ 293 TPMS_FrontLeftTireBlowout 0;
BA_ "GenSigInactiveValue" SG_ 293 TPMS_FrontLeftTireBlowout 0;
BA_ "GenSigInvalidValue" SG_ 293 TPMS_FrontLeftTireBlowout 0;
BA_ "GenSigSendType" SG_ 293 TPMS_FrontLeftTireBlowout 0;
BA_ "GenSigStartValue" SG_ 293 TPMS_FrontLeftTireBlowout 0;
BA_ "GenSigTimeoutValue" SG_ 293 TPMS_FrontLeftTireBlowout 0;
BA_ "Remark" SG_ 293 TPMS_FrontLeftTireBlowout "";
BA_ "EventCommandSignal" SG_ 293 TPMS_FrontRightTireBlowout 1;
BA_ "GatewayedSignals" SG_ 293 TPMS_FrontRightTireBlowout 0;
BA_ "GenSigInactiveValue" SG_ 293 TPMS_FrontRightTireBlowout 0;
BA_ "GenSigInvalidValue" SG_ 293 TPMS_FrontRightTireBlowout 0;
BA_ "GenSigSendType" SG_ 293 TPMS_FrontRightTireBlowout 0;
BA_ "GenSigStartValue" SG_ 293 TPMS_FrontRightTireBlowout 0;
BA_ "GenSigTimeoutValue" SG_ 293 TPMS_FrontRightTireBlowout 0;
BA_ "Remark" SG_ 293 TPMS_FrontRightTireBlowout "";
BA_ "EventCommandSignal" SG_ 293 TPMS_RearRightTireBlowout 1;
BA_ "GatewayedSignals" SG_ 293 TPMS_RearRightTireBlowout 0;
BA_ "GenSigInactiveValue" SG_ 293 TPMS_RearRightTireBlowout 0;
BA_ "GenSigInvalidValue" SG_ 293 TPMS_RearRightTireBlowout 0;
BA_ "GenSigSendType" SG_ 293 TPMS_RearRightTireBlowout 0;
BA_ "GenSigStartValue" SG_ 293 TPMS_RearRightTireBlowout 0;
BA_ "GenSigTimeoutValue" SG_ 293 TPMS_RearRightTireBlowout 0;
BA_ "Remark" SG_ 293 TPMS_RearRightTireBlowout "";
BA_ "EventCommandSignal" SG_ 293 TPMS_RearLeftTireBlowout 1;
BA_ "GatewayedSignals" SG_ 293 TPMS_RearLeftTireBlowout 0;
BA_ "GenSigInactiveValue" SG_ 293 TPMS_RearLeftTireBlowout 0;
BA_ "GenSigInvalidValue" SG_ 293 TPMS_RearLeftTireBlowout 0;
BA_ "GenSigSendType" SG_ 293 TPMS_RearLeftTireBlowout 0;
BA_ "GenSigStartValue" SG_ 293 TPMS_RearLeftTireBlowout 0;
BA_ "GenSigTimeoutValue" SG_ 293 TPMS_RearLeftTireBlowout 0;
BA_ "Remark" SG_ 293 TPMS_RearLeftTireBlowout "";
BA_ "EventCommandSignal" SG_ 293 TPMS_FrontLeftTirePressure 0;
BA_ "GatewayedSignals" SG_ 293 TPMS_FrontLeftTirePressure 0;
BA_ "GenSigInactiveValue" SG_ 293 TPMS_FrontLeftTirePressure 0;
BA_ "GenSigInvalidValue" SG_ 293 TPMS_FrontLeftTirePressure 0;
BA_ "GenSigSendType" SG_ 293 TPMS_FrontLeftTirePressure 1;
BA_ "GenSigStartValue" SG_ 293 TPMS_FrontLeftTirePressure 255;
BA_ "GenSigTimeoutValue" SG_ 293 TPMS_FrontLeftTirePressure 255;
BA_ "Remark" SG_ 293 TPMS_FrontLeftTirePressure "";
BA_ "EventCommandSignal" SG_ 293 TPMS_FrontRightTirePressure 0;
BA_ "GatewayedSignals" SG_ 293 TPMS_FrontRightTirePressure 0;
BA_ "GenSigInactiveValue" SG_ 293 TPMS_FrontRightTirePressure 0;
BA_ "GenSigInvalidValue" SG_ 293 TPMS_FrontRightTirePressure 0;
BA_ "GenSigSendType" SG_ 293 TPMS_FrontRightTirePressure 1;
BA_ "GenSigStartValue" SG_ 293 TPMS_FrontRightTirePressure 255;
BA_ "GenSigTimeoutValue" SG_ 293 TPMS_FrontRightTirePressure 255;
BA_ "Remark" SG_ 293 TPMS_FrontRightTirePressure "";
BA_ "EventCommandSignal" SG_ 293 TPMS_RearRightTirePressure 0;
BA_ "GatewayedSignals" SG_ 293 TPMS_RearRightTirePressure 0;
BA_ "GenSigInactiveValue" SG_ 293 TPMS_RearRightTirePressure 0;
BA_ "GenSigInvalidValue" SG_ 293 TPMS_RearRightTirePressure 0;
BA_ "GenSigSendType" SG_ 293 TPMS_RearRightTirePressure 1;
BA_ "GenSigStartValue" SG_ 293 TPMS_RearRightTirePressure 255;
BA_ "GenSigTimeoutValue" SG_ 293 TPMS_RearRightTirePressure 255;
BA_ "Remark" SG_ 293 TPMS_RearRightTirePressure "";
BA_ "EventCommandSignal" SG_ 293 TPMS_RearLeftTirePressure 0;
BA_ "GatewayedSignals" SG_ 293 TPMS_RearLeftTirePressure 0;
BA_ "GenSigInactiveValue" SG_ 293 TPMS_RearLeftTirePressure 0;
BA_ "GenSigInvalidValue" SG_ 293 TPMS_RearLeftTirePressure 0;
BA_ "GenSigSendType" SG_ 293 TPMS_RearLeftTirePressure 1;
BA_ "GenSigStartValue" SG_ 293 TPMS_RearLeftTirePressure 255;
BA_ "GenSigTimeoutValue" SG_ 293 TPMS_RearLeftTirePressure 255;
BA_ "Remark" SG_ 293 TPMS_RearLeftTirePressure "";
BA_ "EventCommandSignal" SG_ 293 TPMS_TireWarningLamp 1;
BA_ "GatewayedSignals" SG_ 293 TPMS_TireWarningLamp 0;
BA_ "GenSigInactiveValue" SG_ 293 TPMS_TireWarningLamp 0;
BA_ "GenSigInvalidValue" SG_ 293 TPMS_TireWarningLamp 0;
BA_ "GenSigSendType" SG_ 293 TPMS_TireWarningLamp 0;
BA_ "GenSigStartValue" SG_ 293 TPMS_TireWarningLamp 0;
BA_ "GenSigTimeoutValue" SG_ 293 TPMS_TireWarningLamp 0;
BA_ "Remark" SG_ 293 TPMS_TireWarningLamp "";
BA_ "EventCommandSignal" SG_ 293 TPMS_SystemWarningLamp 1;
BA_ "GatewayedSignals" SG_ 293 TPMS_SystemWarningLamp 0;
BA_ "GenSigInactiveValue" SG_ 293 TPMS_SystemWarningLamp 0;
BA_ "GenSigInvalidValue" SG_ 293 TPMS_SystemWarningLamp 0;
BA_ "GenSigSendType" SG_ 293 TPMS_SystemWarningLamp 0;
BA_ "GenSigStartValue" SG_ 293 TPMS_SystemWarningLamp 0;
BA_ "GenSigTimeoutValue" SG_ 293 TPMS_SystemWarningLamp 0;
BA_ "Remark" SG_ 293 TPMS_SystemWarningLamp "";
BA_ "EventCommandSignal" SG_ 294 LCK_DriverDoorAjarSt 1;
BA_ "GatewayedSignals" SG_ 294 LCK_DriverDoorAjarSt 0;
BA_ "GenSigInactiveValue" SG_ 294 LCK_DriverDoorAjarSt 0;
BA_ "GenSigInvalidValue" SG_ 294 LCK_DriverDoorAjarSt 0;
BA_ "GenSigSendType" SG_ 294 LCK_DriverDoorAjarSt 0;
BA_ "GenSigStartValue" SG_ 294 LCK_DriverDoorAjarSt 0;
BA_ "GenSigTimeoutValue" SG_ 294 LCK_DriverDoorAjarSt 0;
BA_ "Remark" SG_ 294 LCK_DriverDoorAjarSt "";
BA_ "EventCommandSignal" SG_ 294 LCK_PassengerDoorAjarSt 1;
BA_ "GatewayedSignals" SG_ 294 LCK_PassengerDoorAjarSt 0;
BA_ "GenSigInactiveValue" SG_ 294 LCK_PassengerDoorAjarSt 0;
BA_ "GenSigInvalidValue" SG_ 294 LCK_PassengerDoorAjarSt 0;
BA_ "GenSigSendType" SG_ 294 LCK_PassengerDoorAjarSt 0;
BA_ "GenSigStartValue" SG_ 294 LCK_PassengerDoorAjarSt 0;
BA_ "GenSigTimeoutValue" SG_ 294 LCK_PassengerDoorAjarSt 0;
BA_ "Remark" SG_ 294 LCK_PassengerDoorAjarSt "";
BA_ "EventCommandSignal" SG_ 294 LCK_DriverDoorLockSt 1;
BA_ "GatewayedSignals" SG_ 294 LCK_DriverDoorLockSt 0;
BA_ "GenSigInactiveValue" SG_ 294 LCK_DriverDoorLockSt 0;
BA_ "GenSigInvalidValue" SG_ 294 LCK_DriverDoorLockSt 0;
BA_ "GenSigSendType" SG_ 294 LCK_DriverDoorLockSt 0;
BA_ "GenSigStartValue" SG_ 294 LCK_DriverDoorLockSt 0;
BA_ "GenSigTimeoutValue" SG_ 294 LCK_DriverDoorLockSt 0;
BA_ "Remark" SG_ 294 LCK_DriverDoorLockSt "";
BA_ "EventCommandSignal" SG_ 294 LCK_PassengerDoorLockSt 1;
BA_ "GatewayedSignals" SG_ 294 LCK_PassengerDoorLockSt 0;
BA_ "GenSigInactiveValue" SG_ 294 LCK_PassengerDoorLockSt 0;
BA_ "GenSigInvalidValue" SG_ 294 LCK_PassengerDoorLockSt 0;
BA_ "GenSigSendType" SG_ 294 LCK_PassengerDoorLockSt 0;
BA_ "GenSigStartValue" SG_ 294 LCK_PassengerDoorLockSt 0;
BA_ "GenSigTimeoutValue" SG_ 294 LCK_PassengerDoorLockSt 0;
BA_ "Remark" SG_ 294 LCK_PassengerDoorLockSt "";
BA_ "EventCommandSignal" SG_ 294 LCK_VehicleDoorAjarSt 1;
BA_ "GatewayedSignals" SG_ 294 LCK_VehicleDoorAjarSt 0;
BA_ "GenSigInactiveValue" SG_ 294 LCK_VehicleDoorAjarSt 0;
BA_ "GenSigInvalidValue" SG_ 294 LCK_VehicleDoorAjarSt 0;
BA_ "GenSigSendType" SG_ 294 LCK_VehicleDoorAjarSt 0;
BA_ "GenSigStartValue" SG_ 294 LCK_VehicleDoorAjarSt 0;
BA_ "GenSigTimeoutValue" SG_ 294 LCK_VehicleDoorAjarSt 0;
BA_ "Remark" SG_ 294 LCK_VehicleDoorAjarSt "";
BA_ "EventCommandSignal" SG_ 294 LCK_VehicleDoorLockSt 1;
BA_ "GatewayedSignals" SG_ 294 LCK_VehicleDoorLockSt 0;
BA_ "GenSigInactiveValue" SG_ 294 LCK_VehicleDoorLockSt 0;
BA_ "GenSigInvalidValue" SG_ 294 LCK_VehicleDoorLockSt 0;
BA_ "GenSigSendType" SG_ 294 LCK_VehicleDoorLockSt 0;
BA_ "GenSigStartValue" SG_ 294 LCK_VehicleDoorLockSt 0;
BA_ "GenSigTimeoutValue" SG_ 294 LCK_VehicleDoorLockSt 0;
BA_ "Remark" SG_ 294 LCK_VehicleDoorLockSt "";
BA_ "EventCommandSignal" SG_ 294 LCK_VehicleChildSaftyLockSt 1;
BA_ "GatewayedSignals" SG_ 294 LCK_VehicleChildSaftyLockSt 0;
BA_ "GenSigInactiveValue" SG_ 294 LCK_VehicleChildSaftyLockSt 0;
BA_ "GenSigInvalidValue" SG_ 294 LCK_VehicleChildSaftyLockSt 0;
BA_ "GenSigSendType" SG_ 294 LCK_VehicleChildSaftyLockSt 0;
BA_ "GenSigStartValue" SG_ 294 LCK_VehicleChildSaftyLockSt 0;
BA_ "GenSigTimeoutValue" SG_ 294 LCK_VehicleChildSaftyLockSt 0;
BA_ "Remark" SG_ 294 LCK_VehicleChildSaftyLockSt "";
BA_ "EventCommandSignal" SG_ 294 LCK_VehicleChildSaftyLockedIndicate 1;
BA_ "GatewayedSignals" SG_ 294 LCK_VehicleChildSaftyLockedIndicate 0;
BA_ "GenSigInactiveValue" SG_ 294 LCK_VehicleChildSaftyLockedIndicate 0;
BA_ "GenSigInvalidValue" SG_ 294 LCK_VehicleChildSaftyLockedIndicate 0;
BA_ "GenSigSendType" SG_ 294 LCK_VehicleChildSaftyLockedIndicate 0;
BA_ "GenSigStartValue" SG_ 294 LCK_VehicleChildSaftyLockedIndicate 0;
BA_ "GenSigTimeoutValue" SG_ 294 LCK_VehicleChildSaftyLockedIndicate 0;
BA_ "Remark" SG_ 294 LCK_VehicleChildSaftyLockedIndicate "";
BA_ "EventCommandSignal" SG_ 294 LCK_PowerFillerCapSt 1;
BA_ "GatewayedSignals" SG_ 294 LCK_PowerFillerCapSt 0;
BA_ "GenSigInactiveValue" SG_ 294 LCK_PowerFillerCapSt 0;
BA_ "GenSigInvalidValue" SG_ 294 LCK_PowerFillerCapSt 0;
BA_ "GenSigSendType" SG_ 294 LCK_PowerFillerCapSt 0;
BA_ "GenSigStartValue" SG_ 294 LCK_PowerFillerCapSt 0;
BA_ "GenSigTimeoutValue" SG_ 294 LCK_PowerFillerCapSt 0;
BA_ "Remark" SG_ 294 LCK_PowerFillerCapSt "";
BA_ "EventCommandSignal" SG_ 294 KAE_UserDefinedCfgSt 1;
BA_ "GatewayedSignals" SG_ 294 KAE_UserDefinedCfgSt 0;
BA_ "GenSigInactiveValue" SG_ 294 KAE_UserDefinedCfgSt 0;
BA_ "GenSigInvalidValue" SG_ 294 KAE_UserDefinedCfgSt 0;
BA_ "GenSigSendType" SG_ 294 KAE_UserDefinedCfgSt 0;
BA_ "GenSigStartValue" SG_ 294 KAE_UserDefinedCfgSt 0;
BA_ "GenSigTimeoutValue" SG_ 294 KAE_UserDefinedCfgSt 0;
BA_ "Remark" SG_ 294 KAE_UserDefinedCfgSt "";
BA_ "EventCommandSignal" SG_ 294 CCU_9_FreshnessValue 0;
BA_ "GatewayedSignals" SG_ 294 CCU_9_FreshnessValue 0;
BA_ "GenSigInactiveValue" SG_ 294 CCU_9_FreshnessValue 0;
BA_ "GenSigInvalidValue" SG_ 294 CCU_9_FreshnessValue 0;
BA_ "GenSigSendType" SG_ 294 CCU_9_FreshnessValue 1;
BA_ "GenSigStartValue" SG_ 294 CCU_9_FreshnessValue 0;
BA_ "GenSigTimeoutValue" SG_ 294 CCU_9_FreshnessValue 0;
BA_ "Remark" SG_ 294 CCU_9_FreshnessValue "";
BA_ "EventCommandSignal" SG_ 294 CCU_9_MAC_Check 0;
BA_ "GatewayedSignals" SG_ 294 CCU_9_MAC_Check 0;
BA_ "GenSigInactiveValue" SG_ 294 CCU_9_MAC_Check 0;
BA_ "GenSigInvalidValue" SG_ 294 CCU_9_MAC_Check 0;
BA_ "GenSigSendType" SG_ 294 CCU_9_MAC_Check 1;
BA_ "GenSigStartValue" SG_ 294 CCU_9_MAC_Check 0;
BA_ "GenSigTimeoutValue" SG_ 294 CCU_9_MAC_Check 0;
BA_ "Remark" SG_ 294 CCU_9_MAC_Check "";

VAL_ 777 EL_MRADASLightSt 0 "Off" 1 "On" 2 "Fault" 3 "Not used"  ;
VAL_ 777 MR_RightMirrorFoldUnfoldSt 0 "Unknown" 1 "Mirror fold" 2 "Mirror unfold" 3 "Reserved"  ;
VAL_ 777 PWL_WinCurrentPos_FRWinPst 255 "Undefined window position"  ;
VAL_ 777 EL_MRTurnLightSt 0 "Not active" 1 "OFF" 2 "ON" 3 "Not used"  ;
VAL_ 777 EL_MRTurnLightFaultSt 0 "Not fault" 1 "Fault"  ;
VAL_ 777 EL_RightBSDIndicatorSt 0 "OFF" 1 "ON"  ;
VAL_ 777 EL_RightBSDIndicatorFaultSt 0 "Not fault" 1 "Fault"  ;
VAL_ 342 KAE_FOB1Position 0 "Undifiend" 1 "Inside Vehicle" 2 "Outside Vehicle" 3 "Inside Vehicle Or Outside Vehicle" 4 "InsideTrunke"  ;
VAL_ 342 KAE_FOB2Position 0 "Undifiend" 1 "Inside Vehicle" 2 "Outside Vehicle" 3 "Inside Vehicle Or Outside Vehicle" 4 "InsideTrunke"  ;
VAL_ 342 KAE_FOB3Position 0 "Undifiend" 1 "Inside Vehicle" 2 "Outside Vehicle" 3 "Inside Vehicle Or Outside Vehicle" 4 "InsideTrunke"  ;
VAL_ 342 KAE_FOB1UnlockBtnPressSt 0 "Undifiend" 1 "Short press" 2 "Twice short press" 3 "Long press"  ;
VAL_ 342 KAE_FOB1LockBtnPressSt 0 "Undifiend" 1 "Short press" 2 "Twice short press" 3 "Long press"  ;
VAL_ 342 KAE_FOB1RESBtnPressSt 0 "Undifiend" 1 "Short press" 2 "Twice short press" 3 "Long press"  ;
VAL_ 342 KAE_FOB1PSD_LBtnPressSt 0 "Undifiend" 1 "Short press" 2 "Twice short press" 3 "Long press"  ;
VAL_ 342 KAE_FOB1PSD_RBtnPressSt 0 "Undifiend" 1 "Short press" 2 "Twice short press" 3 "Long press"  ;
VAL_ 342 KAE_FOB1TrunkBtnPressSt 0 "Undifiend" 1 "Short press" 2 "Twice short press" 3 "Long press"  ;
VAL_ 342 KAE_FOB1PanicBtnPressSt 0 "Undifiend" 1 "Short press" 2 "Twice short press" 3 "Long press"  ;
VAL_ 342 KAE_FOB1User_definedBtnPressSt 0 "Undifiend" 1 "Short press" 2 "Twice short press" 3 "Long press"  ;
VAL_ 776 EL_MLADASLightSt 0 "Off" 1 "On" 2 "Fault" 3 "Not used"  ;
VAL_ 957 HOD_St 0 "Hands Off" 1 "Left Touch" 2 "Right Touch" 3 "Inside Touch" 4 "Outer Touch" 5 "Front Touch" 6 "Rear Touch" 7 "Both side touch" 8 "Left Grip" 9 "Right Grip" 10 "Both side Grip" 11 "Hands On" 12 "Reserved" 13 "Temporal Failure" 14 "Permanent Failure" 15 "int"  ;
VAL_ 957 HOD_TouchZone1 0 "False" 1 "True"  ;
VAL_ 957 HOD_TouchZone2 0 "False" 1 "True"  ;
VAL_ 957 HOD_TouchZone3 0 "False" 1 "True"  ;
VAL_ 957 HOD_HeatingSt 0 "off" 1 "heating" 2 "Preservation" 3 "Reserved"  ;
VAL_ 957 HOD_CalibrationSt 0 "Not Calibrated" 1 "Calibrated"  ;
VAL_ 957 HOD_LINComFault 0 "Not Fault" 1 "Fault"  ;
VAL_ 957 HOD_FaultSt 0 "Not Fault" 1 "Fault"  ;
VAL_ 957 HOD_VBattOORFault 0 "Not Fault" 1 "Fault"  ;
VAL_ 957 HOD_HeatingOtherFaultSt 0 "Not Fault                                         1"  ;
VAL_ 957 HOD_HeatingOverUnderCurrentSt 0 "Not Fault" 1 "Fault"  ;
VAL_ 957 HOD_HeatingThermSt 0 "Not Fault" 1 "Fault"  ;
VAL_ 957 HOD_HeatingTempOutSt 0 "Not Fault                                            1"  ;
VAL_ 957 HOD_Typ 0 "0" 1 "one zone" 2 "L/R zone" 3 "I/O zone" 4 "L/R/Inner zone" 5 "L/R/Rear zone"  ;
VAL_ 784 HVAC_PTCExterPwrSupplyFault 0 "Battery voltage okay" 1 "Battery voltage off"  ;
VAL_ 791 WW_FWPMotorSt 0 "Off" 1 "Reserve" 2 "Stall protection" 3 "Failure" 4 "Low speed" 5 "High speed" 6 "Hard stopped" 7 "Interval delaying"  ;
VAL_ 791 WW_FWSHMotorSt 0 "OFF" 1 "ON" 2 "Failure"  ;
VAL_ 791 HRN_HornRunningSt 0 "Off" 1 "On" 2 "Failure"  ;
VAL_ 791 HRN_HornWorkingTemplet 0 "No Action"  ;
VAL_ 791 EL_FLPositionLightSt 0 "OFF" 1 "ON"  ;
VAL_ 791 EL_FLPositionLightFaultSt 0 "Not fault" 1 "Fault"  ;
VAL_ 791 EL_FRPositionLightSt 0 "OFF" 1 "ON"  ;
VAL_ 791 EL_FRPositionLightFaultSt 0 "Not fault" 1 "Fault"  ;
VAL_ 791 EL_LeftLowBeamSt 0 "OFF" 1 "ON"  ;
VAL_ 791 EL_LeftLowBeamFaultSt 0 "Not fault" 1 "Fault"  ;
VAL_ 791 EL_RightLowBeamSt 0 "OFF" 1 "ON"  ;
VAL_ 791 EL_RightLowBeamFaultSt 0 "Not fault" 1 "Fault"  ;
VAL_ 791 EL_LeftHighBeamSt 0 "OFF" 1 "ON"  ;
VAL_ 791 EL_LeftHighBeamFaultSt 0 "Not fault" 1 "Fault"  ;
VAL_ 791 EL_RightHighBeamSt 0 "OFF" 1 "ON"  ;
VAL_ 791 EL_RightHighBeamFaultSt 0 "Not fault" 1 "Fault"  ;
VAL_ 791 EL_FLFogLightSt 0 "OFF" 1 "ON"  ;
VAL_ 791 EL_FLFogLightFaultSt 0 "Not fault" 1 "Fault"  ;
VAL_ 791 EL_FRFogLightSt 0 "OFF" 1 "ON"  ;
VAL_ 791 EL_FRFogLightFaultSt 0 "Not fault" 1 "Fault"  ;
VAL_ 791 EL_LeftDRLSt 0 "OFF" 1 "ON"  ;
VAL_ 791 EL_LeftDRLFaultSt 0 "Not fault" 1 "Fault"  ;
VAL_ 791 EL_RightDRLSt 0 "OFF" 1 "ON"  ;
VAL_ 791 EL_RightDRLFaultSt 0 "Not fault" 1 "Fault"  ;
VAL_ 791 EL_FLTurnLightSt 0 "Not active" 1 "OFF" 2 "ON" 3 "Not used"  ;
VAL_ 791 EL_FLTurnLightFaultSt 0 "Not fault" 1 "Fault"  ;
VAL_ 791 EL_FRTurnLightSt 0 "Not active" 1 "OFF" 2 "ON" 3 "Not used"  ;
VAL_ 791 EL_FRTurnLightFaultSt 0 "Not fault" 1 "Fault"  ;
VAL_ 791 WW_RWSHMotorSt 0 "OFF" 1 "ON" 2 "Failure"  ;
VAL_ 791 EL_FADASLightSt 0 "Off" 1 "On" 2 "Fault" 3 "Not used"  ;
VAL_ 791 EBSF_CurrentRange 0 "current Range [-1, 1A]" 1 "current Range [-200, 200A]" 2 "current Range [-1500,1500A]"  ;
VAL_ 792 UMM_SecondLHSeatSt 0 "Undefined" 1 "Off" 2 "On" 3 "Failure"  ;
VAL_ 792 UMM_SecondRHSeatSt 0 "Undefined" 1 "Off" 2 "On" 3 "Failure"  ;
VAL_ 792 UMM_SecondMIDSeatSt 0 "Undefined" 1 "Off" 2 "On" 3 "Failure"  ;
VAL_ 792 LCK_PowerFillerCapAngle 0 "FullyClosed" 255 "Unknown"  ;
VAL_ 792 EL_ReverseLightSt 0 "OFF" 1 "ON"  ;
VAL_ 792 EL_ReverseLightFaultSt 0 "Not fault" 1 "Fault"  ;
VAL_ 792 EL_SideBrkLightSt 0 "OFF" 1 "ON"  ;
VAL_ 792 EL_SideBrkLightFaultSt 0 "Not fault" 1 "Fault"  ;
VAL_ 792 EL_CHMSLSt 0 "OFF" 1 "ON"  ;
VAL_ 792 EL_CHMSLFaultSt 0 "Not fault" 1 "Fault"  ;
VAL_ 792 EL_RLPositionLightSt 0 "OFF" 1 "ON"  ;
VAL_ 792 EL_RLPositionLightFaultSt 0 "Not fault" 1 "Fault"  ;
VAL_ 792 EL_RRPositionLightSt 0 "OFF" 1 "ON"  ;
VAL_ 792 EL_RRPositionLightFaultSt 0 "Not fault" 1 "Fault"  ;
VAL_ 792 EL_RearFogLightSt 0 "OFF" 1 "ON"  ;
VAL_ 792 EL_RearFogLightFaultSt 0 "Not fault" 1 "Fault"  ;
VAL_ 792 EL_RLTurnLightSt 0 "Not active" 1 "OFF" 2 "ON" 3 "Not used"  ;
VAL_ 792 EL_RLTurnLightFaultSt 0 "Not fault" 1 "Fault"  ;
VAL_ 792 EL_RRTurnLightSt 0 "Not active" 1 "OFF" 2 "ON" 3 "Not used"  ;
VAL_ 792 EL_RRTurnLightFaultSt 0 "Not fault" 1 "Fault"  ;
VAL_ 792 EL_RADASLightSt 0 "Off" 1 "On" 2 "Fault" 3 "Not used"  ;
VAL_ 616 UMM_UsageModeSt 0 "Standby" 1 "Comfort" 2 "Reserved" 3 "DRV" 4 "Reserved" 5 "Reserved" 6 "Reserved" 7 "Invalid"  ;
VAL_ 616 OTA_FuncReq_ADCWakeup 0 "Inactive" 1 "Active" 2 "Reserved" 3 "Reserved" 4 "Reserved" 5 "Reserved" 6 "Reserved" 7 "Reserved"  ;
VAL_ 616 UMM_DriverSeatSt 0 "Undefined" 1 "Off" 2 "On" 3 "Failure"  ;
VAL_ 616 UMM_FrontPassengerSeatSt 0 "Undefined" 1 "Off" 2 "On" 3 "Failure"  ;
VAL_ 616 VMM_VehModeSt 0 "Normal Mode" 1 "Manufacture Mode" 2 "Transport Mode" 3 "Showroom Mode" 4 "PostCrash Mode" 5 "Maintenance Mode" 6 "Reserved" 7 "Reserved" 8 "Reserved" 9 "Reserved" 10 "Reserved" 11 "Reserved" 12 "Reserved" 13 "Reserved" 14 "Reserved" 15 "Invalid Value"  ;
VAL_ 616 VMM_LastVehModeSt 0 "Normal Mode" 1 "Manufacture Mode" 2 "Transport Mode" 3 "Showroom Mode" 4 "PostCrash Mode" 5 "Maintenance Mode" 6 "Reserved" 7 "Reserved" 8 "Reserved" 9 "Reserved" 10 "Reserved" 11 "Reserved" 12 "Reserved" 13 "Reserved" 14 "Reserved" 15 "Invalid Value"  ;
VAL_ 616 VMM_OTAModeSt 0 "NonOTA Mode" 1 "OTA Mode" 2 "Invalid Value" 3 "reserved"  ;
VAL_ 616 CCU_DstFlag 0 "inactive" 1 "active"  ;
VAL_ 616 CSM_RC_PAARequest 0 "No request" 1 "SBM RPA request" 2 "SBM HPA request" 3 "EDK request" 4 "TSP HPA request" 5 "TSP AVP request" 6 "check picture" 7 "check video"  ;
VAL_ 616 CSM_RC_AuthSt 0 "Not Used" 1 "Pass" 2 "Failed"  ;
VAL_ 616 IPDS_EnablePowerSup 0 "Not Active" 1 "Active" 2 "PreOFF" 3 "Reserve"  ;
VAL_ 616 ASB_DriverActiveBeltFaultSt 0 "Not fault" 1 "Fault"  ;
VAL_ 818 HVAC_SysErrSt 0 "normal" 1 "Error,work" 2 "Error,No work" 3 "Reserve"  ;
VAL_ 818 HVAC_RefLeakFault 0 "False" 1 "true" 2 "Reserve" 3 "Reserve"  ;
VAL_ 816 HVAC_WindExitMode 0 "Invalid" 1 "Face" 2 "Face/Foot" 3 "Foot" 4 "Foot/Defrost" 5 "Defrost" 6 "Face/Defrost" 7 "Face/Foot/Defrost"  ;
VAL_ 816 HVAC_DriverTempSelect 31 "Invalid"  ;
VAL_ 816 HVAC_PsnTempSelect 31 "Invalid"  ;
VAL_ 960 HVAC_AutoFogFlt 0 "No Fault" 1 "Fault"  ;
VAL_ 960 HVAC_AutoFogSts 0 "Not Active" 1 "Active"  ;
VAL_ 825 CCU_FuncReq_SentryMod 0 "OFF" 1 "SentryModeWake"  ;
VAL_ 291 ATWS_ATWSAlarmReq 0 "No Request" 1 "Alarm ON" 2 "Alarm OFF"  ;
VAL_ 291 ATWS_ATWSSt 0 "DisArm" 1 "PreArm" 2 "Partially Armed" 3 "Fully Armed" 4 "PreDisarm" 5 "Alarm"  ;
VAL_ 291 WW_FrontWasherCmd 0 "No Request" 1 "Active" 2 "Not Active"  ;
VAL_ 291 WW_FrontWiperCmd_Speed 0 "no request" 1 "off" 2 "low speed" 3 "high speed"  ;
VAL_ 291 WW_FrontWiperCtrlSt 0 "Off" 1 "Int" 2 "LowSpeed" 3 "HighSpeed" 4 "Auto"  ;
VAL_ 291 WW_RearWiperCtrlSt 0 "Off" 1 "Int" 2 "LowSpeed" 3 "HighSpeed" 4 "Auto"  ;
VAL_ 291 WW_FrontWiperCtrlSrc 0 "No source" 1 "Switch" 2 "VirtualKey" 3 "VoiceControl" 4 "RLS" 5 "OtherLocalSystem" 6 "WiperSystem" 7 "ServiceConsumer"  ;
VAL_ 291 WW_RearWiperCtrlSrc 0 "No source" 1 "Switch" 2 "VirtualKey" 3 "VoiceControl" 4 "RLS" 5 "OtherLocalSystem" 6 "WiperSystem" 7 "ServiceConsumer"  ;
VAL_ 291 WW_RearCamWasherVKResp 0 "No response" 1 "Success" 2 "Fail"  ;
VAL_ 291 WW_RearCamWasherVRResp 0 "No response" 1 "Success" 2 "Fail"  ;
VAL_ 865 EL_ReverseLightCtrlCmd 0 "OFF" 1 "ON"  ;
VAL_ 865 EL_SideBrkLightCtrlCmd 0 "OFF" 1 "ON"  ;
VAL_ 865 EL_LeftLowBeamCtrlCmd 0 "OFF" 1 "ON"  ;
VAL_ 865 EL_RightLowBeamCtrlCmd 0 "OFF" 1 "ON"  ;
VAL_ 865 EL_PositionLightCtrlSource 0 "Not active" 1 "Group1" 2 "Group2" 3 "Group3" 4 "Reserved" 5 "Reserved" 6 "Reserved" 7 "Reserved"  ;
VAL_ 865 EL_LeftHighBeamCtrlCmd 0 "OFF" 1 "ON"  ;
VAL_ 865 EL_RightHighBeamCtrlCmd 0 "OFF" 1 "ON"  ;
VAL_ 865 EL_LowBeamCtrlSource 0 "Not active" 1 "Group1" 2 "Group2" 3 "Group3" 4 "Reserved" 5 "Reserved" 6 "Reserved" 7 "Reserved"  ;
VAL_ 865 EL_RearFogLightCtrlSource 0 "Not active" 1 "Group1" 2 "Group2" 3 "Group3" 4 "Reserved" 5 "Reserved" 6 "Reserved" 7 "Reserved"  ;
VAL_ 865 EL_HighBeamCtrlSource 0 "Not active" 1 "Group1" 2 "Group2" 3 "Group3" 4 "Reserved" 5 "Reserved" 6 "Reserved" 7 "Reserved"  ;
VAL_ 865 EL_FrontFogLightCtrlSource 0 "Not active" 1 "Group1" 2 "Group2" 3 "Group3" 4 "Reserved" 5 "Reserved" 6 "Reserved" 7 "Reserved"  ;
VAL_ 865 EL_LicencePlateLightCtrlSource 0 "Not active" 1 "Group1" 2 "Group2" 3 "Group3" 4 "Reserved" 5 "Reserved" 6 "Reserved" 7 "Reserved"  ;
VAL_ 865 EL_FlasherCtrlSource 0 "Not active" 1 "Group1_TurnLight" 2 "Group1_HazardLight" 3 "Group1_ReminderLight" 4 "Group2_HazardLight" 5 "Group2_ReminderLight" 6 "Group3" 7 "Reserved" 8 "Reserved" 9 "Reserved" 10 "Reserved" 11 "Reserved" 12 "Reserved" 13 "Reserved" 14 "Reserved" 15 "Reserved"  ;
VAL_ 865 EL_FADASLightCtrlCmd 0 "OFF" 1 "ON"  ;
VAL_ 865 EL_RADASLightCtrlCmd 0 "OFF" 1 "ON"  ;
VAL_ 865 EL_IHBColourSt 0 "No display" 1 "Active colour-blue" 2 "Standby colour-grey" 3 "Failure colour-yellow"  ;
VAL_ 865 EL_AutoHighBeamCtrlSt 0 "Not active" 1 "Active"  ;
VAL_ 865 EL_ADC_2_VERFailFlag 0 "Not active" 1 "Active"  ;
VAL_ 865 EL_ADC_4_New_VERFailFlag 0 "Not active" 1 "Active"  ;
VAL_ 865 EL_ADC_8_VERFailFlag 0 "Not active" 1 "Active"  ;
VAL_ 865 EL_ADBEnable 0 "Disable" 1 "Enable"  ;
VAL_ 865 EL_HeadLightLevelingSWSt 0 "Level 0" 1 "Level 1" 2 "Level 2" 3 "Level 3"  ;
VAL_ 865 EL_LeftTurnLightStForDisp 0 "OFF" 1 "ON"  ;
VAL_ 865 EL_RightTurnLightStForDisp 0 "OFF" 1 "ON"  ;
VAL_ 865 EL_PositionLightStForDisp 0 "OFF" 1 "ON"  ;
VAL_ 865 EL_FrontFogLightStForDisp 0 "OFF" 1 "ON"  ;
VAL_ 865 EL_RearFogLightStForDisp 0 "OFF" 1 "ON"  ;
VAL_ 865 EL_LowBeamStForDisp 0 "OFF" 1 "ON"  ;
VAL_ 865 EL_HighBeamStForDisp 0 "OFF" 1 "ON"  ;
VAL_ 865 EL_HeadLightSWSt 0 "OFF" 1 "Positon light" 2 "LowBeam" 3 "Auto"  ;
VAL_ 293 TPMS_FrontLeftTireBlowout 0 "No Function" 1 "Not Blowout" 2 "Blowout" 3 "Reserved"  ;
VAL_ 293 TPMS_FrontRightTireBlowout 0 "No Function" 1 "Not Blowout" 2 "Blowout" 3 "Reserved"  ;
VAL_ 293 TPMS_RearRightTireBlowout 0 "No Function" 1 "Not Blowout" 2 "Blowout" 3 "Reserved"  ;
VAL_ 293 TPMS_RearLeftTireBlowout 0 "No Function" 1 "Not Blowout" 2 "Blowout" 3 "Reserved"  ;
VAL_ 293 TPMS_FrontLeftTirePressure 0 "Invalid" 255 "Unknown"  ;
VAL_ 293 TPMS_FrontRightTirePressure 0 "Invalid" 255 "Unknown"  ;
VAL_ 293 TPMS_RearRightTirePressure 0 "Invalid" 255 "Unknown"  ;
VAL_ 293 TPMS_RearLeftTirePressure 0 "Invalid" 255 "Unknown"  ;
VAL_ 293 TPMS_TireWarningLamp 0 "NoWarning" 1 "Warning"  ;
VAL_ 293 TPMS_SystemWarningLamp 0 "NoWarning" 1 "Warning"  ;
VAL_ 294 LCK_DriverDoorAjarSt 0 "Closed" 1 "Opened"  ;
VAL_ 294 LCK_PassengerDoorAjarSt 0 "Closed" 1 "Opened"  ;
VAL_ 294 LCK_DriverDoorLockSt 0 "Locked" 1 "Unlocked"  ;
VAL_ 294 LCK_PassengerDoorLockSt 0 "Locked" 1 "Unlocked"  ;
VAL_ 294 LCK_VehicleDoorAjarSt 0 "ALLDoorsClosed" 1 "AllDoorsClosedAndHoodorTrunkOpened" 2 "AnyDoorOpened"  ;
VAL_ 294 LCK_VehicleDoorLockSt 0 "AllDoorLocked" 1 "PartialDoorUnlocked" 2 "AllDoorUnlocked"  ;
VAL_ 294 LCK_VehicleChildSaftyLockSt 0 "AllChildSaftyLocked" 1 "AnyChildSaftyUnlocked"  ;
VAL_ 294 LCK_VehicleChildSaftyLockedIndicate 0 "IndicateLampOff" 1 "IndicateLampOn"  ;
VAL_ 294 LCK_PowerFillerCapSt 0 "Closed" 1 "Opened"  ;
