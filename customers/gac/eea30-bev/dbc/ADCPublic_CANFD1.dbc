VERSION "Version"

NS_ :

BS_:

BU_: CCU ADC FAPA IFC FLR FRR RRR RLR INU Tester CBM VIU SRS IDC PCS AMP IMR FIMR TBOX IBCS IXCU V2XOBU WHUD RLBMS CCURT2 RT2_C3 OTAWL ZCUF ZCUL ZCUR ZCUT IPS DCU NIDU RBM WACUFL IID CCURT1 RT1_C0 RT1_C1 AVAS FLLCM FRLCM RLLCMA RRLCMA RLLCMB RRLCMB LBMS LBMSAD MFS FCP IDU ITS BCB DCDC PCU EOP DCU2 BMS TMC EPS ECS CD PAS SBM WCM ETC TBOX2 DSM FLPDM FRPDM RLPDM RRPDM HVSMR SCMRL SCMRR EBU EPB VDC EVCC ADM PLGM FBLCM RLISD RRISD RCP RFR WCMFR SCMR TFOAR TROAR HVSPRL HVSPRR

BO_ 549 ADC_12: 64 ADC
 SG_ ADC_12_CRC : 7|16@0+ (1,0) [0|65535] ""  CCU,CCURT1,CCURT2
 SG_ ADC_12_Counter : 23|8@0+ (1,0) [0|255] ""  CCU,CCURT1,CCURT2
 SG_ ADC_APAst : 31|4@0+ (1,0) [0|15] ""  CCU,CCURT1,CCURT2,ZCUF,ZCUT,IBCS,SBM,TBOX
 SG_ ADC_AVPst : 27|4@0+ (1,0) [0|15] ""  CCU,CCURT1,CCURT2,ZCUF,ZCUT,IBCS,SBM
 SG_ ADC_PAAFuncSt : 39|4@0+ (1,0) [0|15] ""  CCU,CCURT1,CCURT2,RT1_C0,RT1_C1,VDC,IDC,SBM
 SG_ ADC_PAAVoiceReminder : 35|12@0+ (1,0) [0|4095] ""  CCU,CCURT1,CCURT2,ZCUR,SBM
 SG_ ADC_PAAVRSwitchFailSt : 55|1@0+ (1,0) [0|1] ""  CCU,CCURT1,CCURT2,ZCUR,SBM
 SG_ ADC_APKDisplayReq : 54|1@0+ (1,0) [0|1] ""  CCU,CCURT1,CCURT2,ZCUR,SBM
 SG_ ADC_APAActFuncInd : 53|4@0+ (1,0) [0|15] ""  CCU,CCURT1,CCURT2
 SG_ ADC_APABackParkDisplayReq : 49|2@0+ (1,0) [0|3] ""  CCU,CCURT1,CCURT2,ZCUR,IDC,SBM
 SG_ ADC_VCU_Gearshiftprompt : 56|1@0+ (1,0) [0|1] ""  CCU,CCURT1,RT1_C1,VDC
 SG_ ADC_AVPActFuncind : 63|5@0+ (1,0) [0|31] ""  CCU,CCURT1,CCURT2,SBM,TBOX
 SG_ ADC_APAMessagePushSt : 58|2@0+ (1,0) [0|3] ""  CCU,CCURT1,CCURT2,ZCUR,IDC,SBM
 SG_ ADC_HPAMessagePushSt : 71|2@0+ (1,0) [0|3] ""  CCU,CCURT1,CCURT2,ZCUR,IDC,SBM
 SG_ ADC_PedWarnToneCtrl : 67|2@0+ (1,0) [0|3] ""  CCU,CCURT1,CCURT2
 SG_ ADC_AVPMessagePushSt : 69|2@0+ (1,0) [0|3] ""  CCU,CCURT1,CCURT2,ZCUR,IDC,SBM
 SG_ ADC_PAADrvInteraction : 64|9@0+ (1,0) [0|511] ""  CCU,CCURT1,CCURT2,IDC,SBM,TBOX
 SG_ ADC_PAARemoteParkingMode : 87|2@0+ (1,0) [0|3] ""  CCU,CCURT1,CCURT2,ZCUF,ZCUT,SBM,TBOX
 SG_ ADC_PAARemoteParkingEnable : 85|1@0+ (1,0) [0|1] ""  CCU,CCURT1,CCURT2,ZCUF,ZCUT,SBM,TBOX
 SG_ ADC_LocalToBeDRVReq : 83|1@0+ (1,0) [0|1] ""  CCU,CCURT1,CCURT2,RT1_C0
 SG_ ADC_UsageModeStAscendReq : 82|1@0+ (1,0) [0|1] ""  CCU,CCURT1,CCURT2,RT1_C0
 SG_ ADC_UsageModeStDescendReq : 81|1@0+ (1,0) [0|1] ""  CCU,CCURT1,CCURT2,RT1_C0
 SG_ ADC_PAAIGCInhibitSt : 80|1@0+ (1,0) [0|1] ""  CCU,CCURT1,CCURT2
 SG_ ADC_PAAEDKFunInhibitReq : 95|1@0+ (1,0) [0|1] ""  CCU,CCURT1,CCURT2,SBM
 SG_ ADC_PAARespondMode : 94|4@0+ (1,0) [0|15] ""  CCU,CCURT1,CCURT2,ZCUR,SBM
 SG_ ADC_UsageModeStHold : 90|1@0+ (1,0) [0|1] ""  CCU,CCURT1,CCURT2,RT1_C0
 SG_ ADC_PAAToNDAReq : 89|2@0+ (1,0) [0|3] ""  CCU,CCURT1,CCURT2,ZCUF,ZCUT,IBCS
 SG_ ADC_DriverPresentSt : 103|2@0+ (1,0) [0|3] ""  CCU,CCURT1,CCURT2,RT2_C3,ZCUF,ZCUT,IBCS
 SG_ ADC_RAEBWorkSts : 101|2@0+ (1,0) [0|3] ""  CCU,CCURT1,CCURT2,IDC
 SG_ ADC_UsageModeStHoldVD : 99|1@0+ (1,0) [0|1] ""  CCU,CCURT1,CCURT2,RT1_C0
 SG_ ADC_RAEBEmgyBrkReq : 111|1@0+ (1,0) [0|1] ""  CCU,CCURT1,CCURT2,IBCS
 SG_ ADC_RAEBTarAccel : 110|7@0+ (0.1,-10) [-10|0] "m/s"  CCU,CCURT1,CCURT2,IBCS
 SG_ ADC_PAADrvReq : 119|8@0+ (1,0) [0|255] ""  CCU,CCURT1,CCURT2,IDC,SBM
 SG_ ADC_PAAQuitInd : 127|8@0+ (1,0) [0|255] ""  CCU,CCURT1,CCURT2,IDC,SBM
 SG_ ADC_PAARecInd : 135|6@0+ (1,0) [0|63] ""  CCU,CCURT1,CCURT2,IDC,SBM
 SG_ ADC_NSAMessagePushSt : 129|2@0+ (1,0) [0|3] ""  CCU,CCURT1,CCURT2,IDC,SBM
 SG_ ADC_NSASt : 143|4@0+ (1,0) [0|15] ""  CCU,CCURT1,CCURT2,IDC,SBM
 SG_ ADC_RA_RemainDist : 139|12@0+ (1,0) [0|4000] "m"  CCU,CCURT1,CCURT2,ZCUR,IDC
 SG_ ADC_Rast : 159|3@0+ (1,0) [0|7] ""  CCU,CCURT1,CCURT2,ZCUR,IDC
 SG_ ADC_RAButtonPress : 156|1@0+ (1,0) [0|1] ""  CCU,CCURT1,CCURT2,ZCUR,IDC
 SG_ ADC_AuthPassSt : 165|2@0+ (1,0) [0|3] ""  CCU,CCURT1,CCURT2,ZCUR,SBM
 SG_ ADC_SBMAuthst : 163|2@0+ (1,0) [0|3] ""  CCU,CCURT1,CCURT2,IDC,SBM,TBOX
 SG_ ADC_RPADirectionSel : 155|4@0+ (1,0) [0|15] ""  CCU,CCURT1,CCURT2,IDC,SBM
 SG_ ADC_VehPoscoord : 167|1@0+ (1,0) [0|1] ""  CCU,CCURT1,CCURT2,IDC,SBM
 SG_ ADC_VehDynamicPosX : 161|13@0+ (1,-4000) [-4000|4000] "cm"  CCU,CCURT1,CCURT2,ZCUR,IDC
 SG_ ADC_VehDynamicPosY : 180|13@0+ (1,-4000) [-4000|4000] "cm"  CCU,CCURT1,CCURT2,ZCUR,IDC
 SG_ ADC_VehPosYawrate : 343|16@0+ (0.01,-180) [-180|180] "degree"  CCU,CCURT1,CCURT2,ZCUR,IDC
 SG_ ADC_VehCurv : 206|10@0+ (1,-500) [-500|500] "m^-1"  CCU,CCURT1,CCURT2,IDC,SBM
 SG_ ADC_SlotPosX : 212|13@0+ (1,-4000) [-4000|4000] "cm"  CCU,CCURT1,CCURT2,IDC,SBM
 SG_ ADC_SlotPosY : 231|13@0+ (1,-4000) [-4000|4000] "cm"  CCU,CCURT1,CCURT2,ZCUR,IDC
 SG_ ADC_HPAst : 245|4@0+ (1,0) [0|15] ""  CCU,ZCUR
 SG_ ADC_SlotAngle : 359|16@0+ (0.01,-180) [-180|180] "degree"  CCU,CCURT1,CCURT2,ZCUR,IDC
 SG_ ADC_SlotCurv : 241|10@0+ (1,-500) [-500|500] "m^-1"  CCU,CCURT1,CCURT2,ZCUR,IDC
 SG_ ADC_FusionDSMWorkStFL : 263|2@0+ (1,0) [0|3] ""  CCU,CCURT1,CCURT2
 SG_ ADC_FusionDSMWorkStFR : 261|2@0+ (1,0) [0|3] ""  CCU,CCURT1,CCURT2
 SG_ ADC_FusionDSMWorkStRL : 259|2@0+ (1,0) [0|3] ""  CCU,CCURT1,CCURT2
 SG_ ADC_FusionDSMWorkStRR : 257|2@0+ (1,0) [0|3] ""  CCU,CCURT1,CCURT2
 SG_ ADC_FusionDSMOpenablePercentFL : 271|7@0+ (1,0) [0|127] "%"  CCU,CCURT1,CCURT2,ZCUL,FLPDM
 SG_ ADC_FusionDSMEmergencyStopFL : 264|1@0+ (1,0) [0|1] ""  CCU,CCURT1,CCURT2,ZCUL,FLPDM
 SG_ ADC_FusionDSMValidFL : 279|1@0+ (1,0) [0|1] ""  CCU,CCURT1,CCURT2,ZCUL,FLPDM
 SG_ ADC_FusionDSMOpenablePercentFR : 278|7@0+ (1,0) [0|127] "%"  CCU,CCURT1,CCURT2,ZCUR,FRPDM
 SG_ ADC_FusionDSMEmergencyStopFR : 287|1@0+ (1,0) [0|1] ""  CCU,CCURT1,CCURT2,ZCUR,FRPDM
 SG_ ADC_FusionDSMOpenablePercentRL : 286|7@0+ (1,0) [0|127] "%"  CCU,CCURT1,CCURT2,ZCUT,RLPDM,RRPDM
 SG_ ADC_FusionDSMValidFR : 295|1@0+ (1,0) [0|1] ""  CCU,CCURT1,CCURT2,ZCUR,FRPDM
 SG_ ADC_parkInOutDirection : 299|4@0+ (1,0) [0|15] ""  CCU,ZCUR,SBM
 SG_ ADC_RPAStMessagePush : 98|3@0+ (1,0) [0|7] ""  CCU,CCURT1,CCURT2
 SG_ ADC_RPAtype : 383|2@0+ (1,0) [0|3] ""  CCU,CCURT1,CCURT2
 SG_ ADC_FusionDSMOpenablePercentRR : 294|7@0+ (1,0) [0|127] "%"  CCU,CCURT1,CCURT2,ZCUT,RLPDM,RRPDM
 SG_ ADC_FusionDSMEmergencyStopRL : 303|1@0+ (1,0) [0|1] ""  CCU,CCURT1,CCURT2,ZCUT,RLPDM,RRPDM
 SG_ ADC_FusionDSMValidRL : 302|1@0+ (1,0) [0|1] ""  CCU,CCURT1,CCURT2,ZCUT,RLPDM,RRPDM
 SG_ ADC_FusionDSMEmergencyStopRR : 301|1@0+ (1,0) [0|1] ""  CCU,CCURT1,CCURT2,ZCUT,RLPDM,RRPDM
 SG_ ADC_FusionDSMValidRR : 300|1@0+ (1,0) [0|1] ""  CCU,CCURT1,CCURT2,ZCUT,RLPDM,RRPDM
 SG_ ADC_FusionDSMObstacleDisFL : 311|8@0+ (1,0) [0|255] "cm"  CCU,CCURT1,CCURT2,ZCUL,ZCUR,ZCUT,FLPDM,FRPDM,RLPDM,RRPDM
 SG_ ADC_FusionDSMObstacleDisFR : 319|8@0+ (1,0) [0|255] "cm"  CCU,CCURT1,CCURT2,ZCUL,ZCUR,ZCUT,FLPDM,FRPDM,RLPDM,RRPDM
 SG_ ADC_FusionDSMObstacleDisRL : 327|8@0+ (1,0) [0|255] "cm"  CCU,CCURT1,CCURT2,ZCUT,RLPDM,RRPDM
 SG_ ADC_FusionDSMObstacleDisRR : 335|8@0+ (1,0) [0|255] "cm"  CCU,CCURT1,CCURT2,ZCUT,RLPDM,RRPDM
 SG_ ADC_DskScreenOperationReq : 368|1@0+ (1,0) [0|1] ""  CCU,CCURT1,CCURT2,IDC
 SG_ ADC_SenslesEtyParkingSt : 369|1@0+ (1,0) [0|1] ""  CCU,CCURT1,CCURT2,IDC
 SG_ ADC_PAALimitToast : 372|3@0+ (1,0) [0|7] ""  CCU,CCURT1,CCURT2,IDC
 SG_ ADC_PAALimitReminder : 375|3@0+ (1,0) [0|7] ""  CCU,CCURT1,CCURT2,IDC
 SG_ ADC_ParkOutMode : 381|3@0+ (1,0) [0|7] ""  CCU,ZCUR,SBM
 SG_ ADAS_ParkStats : 391|8@0+ (1,0) [0|255] ""  CCU,ZCUR,SBM
 SG_ Reserved1 : 440|1@0+ (1,0) [0|0] ""  CCU

BO_ 969 ADC_14: 64 ADC
 SG_ ADAS_RemoterParkingOnlineOrNot : 31|8@0+ (1,0) [0|255] ""  CCU,CCURT1,CCURT2,RT1_C0,RT1_C1,VDC
 SG_ ADC_RpaParkAuthn : 33|2@0+ (1,0) [0|3] ""  CCU
 SG_ ADC_RemParkPatSel : 35|2@0+ (1,0) [0|2] ""  CCU
 SG_ ADC_ParkDirCfm : 39|4@0+ (1,0) [0|8] ""  CCU
 SG_ ADC_ParkStMac : 44|5@0+ (1,0) [0|31] ""  CCU
 SG_ ADC_PwrOnOffReq : 47|3@0+ (1,0) [0|7] ""  CCU,CCURT1,CCURT2,RT1_C0,RT1_C1,VDC
 SG_ ADC_ParkOutDir_ParaLe : 48|1@0+ (1,0) [0|1] ""  CCU
 SG_ ADC_ParkOutDir_ParaRi : 49|1@0+ (1,0) [0|1] ""  CCU
 SG_ ADC_ParkOutDir_PerpFwd : 50|1@0+ (1,0) [0|1] ""  CCU
 SG_ ADC_ParkOutDir_PerpLeFwd : 51|1@0+ (1,0) [0|1] ""  CCU
 SG_ ADC_ParkOutDir_PerpRiFwd : 52|1@0+ (1,0) [0|1] ""  CCU
 SG_ ADC_ParkOutDir_PerpLeBack : 53|1@0+ (1,0) [0|1] ""  CCU
 SG_ ADC_ParkOutDir_PerpRiBack : 54|1@0+ (1,0) [0|1] ""  CCU
 SG_ ADC_ParkOutDir_PerpBack : 55|1@0+ (1,0) [0|1] ""  CCU
 SG_ ADC_APA_RPAFctUnavlMsg1 : 56|1@0+ (1,0) [0|1] ""  CCU
 SG_ ADC_APA_RPAFctUnavlMsg2 : 57|1@0+ (1,0) [0|1] ""  CCU
 SG_ ADC_APA_RPAFctUnavlMsg3 : 58|1@0+ (1,0) [0|1] ""  CCU
 SG_ ADC_APA_RPAFctUnavlMsg4 : 59|1@0+ (1,0) [0|1] ""  CCU
 SG_ ADC_APA_RPAFctUnavlMsg5 : 60|1@0+ (1,0) [0|1] ""  CCU
 SG_ ADC_APA_RPAFctUnavlMsg6 : 61|1@0+ (1,0) [0|1] ""  CCU
 SG_ ADC_APA_RPAFctUnavlMsg7 : 62|1@0+ (1,0) [0|1] ""  CCU
 SG_ ADC_APA_RPAFctUnavlMsg8 : 63|1@0+ (1,0) [0|1] ""  CCU
 SG_ ADC_APA_RPAFctUnavlMsg9 : 64|1@0+ (1,0) [0|1] ""  CCU
 SG_ ADC_APA_RPAFctUnavlMsg10 : 65|1@0+ (1,0) [0|1] ""  CCU
 SG_ ADC_APA_RPAFctUnavlMsg11 : 66|1@0+ (1,0) [0|1] ""  CCU
 SG_ ADC_APA_RPAFctUnavlMsg12 : 67|1@0+ (1,0) [0|1] ""  CCU
 SG_ ADC_APA_RPAFctUnavlMsg13 : 68|1@0+ (1,0) [0|1] ""  CCU
 SG_ ADC_APA_RPAFctUnavlMsg14 : 69|1@0+ (1,0) [0|1] ""  CCU
 SG_ ADC_APA_RPAFctUnavlMsg15 : 70|1@0+ (1,0) [0|1] ""  CCU
 SG_ ADC_APA_RPAFctUnavlMsg16 : 71|1@0+ (1,0) [0|1] ""  CCU
 SG_ ADC_APA_RPAFctUnavlMsg17 : 72|1@0+ (1,0) [0|1] ""  CCU
 SG_ ADC_APA_RPAFctUnavlMsg18 : 73|1@0+ (1,0) [0|1] ""  CCU
 SG_ ADC_APA_RPAFctUnavlMsg19 : 74|1@0+ (1,0) [0|1] ""  CCU
 SG_ ADC_APA_RPAFctUnavlMsg20 : 75|1@0+ (1,0) [0|1] ""  CCU
 SG_ ADC_APA_RPAFctUnavlMsg21 : 76|1@0+ (1,0) [0|1] ""  CCU
 SG_ ADC_APA_RPAFctUnavlMsg22 : 77|1@0+ (1,0) [0|1] ""  CCU
 SG_ ADC_APA_RPAFctUnavlMsg23 : 78|1@0+ (1,0) [0|1] ""  CCU
 SG_ ADC_APA_RPAFctUnavlMsg24 : 79|1@0+ (1,0) [0|1] ""  CCU
 SG_ ADC_APA_RPAFctUnavlMsg25 : 80|1@0+ (1,0) [0|1] ""  CCU
 SG_ ADC_APA_RPACnclMsg1 : 81|1@0+ (1,0) [0|1] ""  CCU
 SG_ ADC_APA_RPACnclMsg2 : 82|1@0+ (1,0) [0|1] ""  CCU
 SG_ ADC_APA_RPACnclMsg3 : 83|1@0+ (1,0) [0|1] ""  CCU
 SG_ ADC_APA_RPACnclMsg4 : 84|1@0+ (1,0) [0|1] ""  CCU
 SG_ ADC_APA_RPACnclMsg5 : 85|1@0+ (1,0) [0|1] ""  CCU
 SG_ ADC_APA_RPACnclMsg6 : 86|1@0+ (1,0) [0|1] ""  CCU
 SG_ ADC_APA_RPACnclMsg7 : 87|1@0+ (1,0) [0|1] ""  CCU
 SG_ ADC_APA_RPACnclMsg8 : 88|1@0+ (1,0) [0|1] ""  CCU
 SG_ ADC_APA_RPACnclMsg9 : 89|1@0+ (1,0) [0|1] ""  CCU
 SG_ ADC_APA_RPACnclMsg10 : 90|1@0+ (1,0) [0|1] ""  CCU
 SG_ ADC_APA_RPACnclMsg11 : 91|1@0+ (1,0) [0|1] ""  CCU
 SG_ ADC_APA_RPACnclMsg12 : 92|1@0+ (1,0) [0|1] ""  CCU
 SG_ ADC_APA_RPACnclMsg13 : 93|1@0+ (1,0) [0|1] ""  CCU
 SG_ ADC_APA_RPACnclMsg14 : 94|1@0+ (1,0) [0|1] ""  CCU
 SG_ ADC_APA_RPACnclMsg15 : 95|1@0+ (1,0) [0|1] ""  CCU
 SG_ ADC_APA_RPACnclMsg16 : 96|1@0+ (1,0) [0|1] ""  CCU
 SG_ ADC_APA_RPACnclMsg17 : 97|1@0+ (1,0) [0|1] ""  CCU
 SG_ ADC_APA_RPACnclMsg18 : 98|1@0+ (1,0) [0|1] ""  CCU
 SG_ ADC_APA_RPACnclMsg19 : 99|1@0+ (1,0) [0|1] ""  CCU
 SG_ ADC_APA_RPACnclMsg20 : 100|1@0+ (1,0) [0|1] ""  CCU
 SG_ ADC_APA_RPAPauseMsg1 : 101|1@0+ (1,0) [0|1] ""  CCU
 SG_ ADC_APA_RPAPauseMsg2 : 102|1@0+ (1,0) [0|1] ""  CCU
 SG_ ADC_APA_RPAPauseMsg3 : 103|1@0+ (1,0) [0|1] ""  CCU
 SG_ ADC_APA_RPAPauseMsg4 : 104|1@0+ (1,0) [0|1] ""  CCU
 SG_ ADC_APA_RPAPauseMsg5 : 105|1@0+ (1,0) [0|1] ""  CCU
 SG_ ADC_APA_RPAPauseMsg6 : 106|1@0+ (1,0) [0|1] ""  CCU
 SG_ ADC_APA_RPAPauseMsg7 : 107|1@0+ (1,0) [0|1] ""  CCU
 SG_ ADC_APA_RPAPauseMsg8 : 108|1@0+ (1,0) [0|1] ""  CCU
 SG_ ADC_APA_RPAPauseMsg9 : 109|1@0+ (1,0) [0|1] ""  CCU
 SG_ ADC_APA_RPAPauseMsg10 : 110|1@0+ (1,0) [0|1] ""  CCU
 SG_ ADC_PathPlanPos1X : 119|10@0+ (0.1,-50) [-50|50] "m"  CCU
 SG_ ADC_PathPlanPos1Y : 125|10@0+ (0.1,-50) [-50|50] "m"  CCU
 SG_ ADC_PathPlanPos2X : 131|10@0+ (0.1,-50) [-50|50] "m"  CCU
 SG_ ADC_PathPlanPos2Y : 137|10@0+ (0.1,-50) [-50|50] "m"  CCU
 SG_ ADC_PathPlanPos3X : 159|10@0+ (0.1,-50) [-50|50] "m"  CCU
 SG_ ADC_PathPlanPos3Y : 165|10@0+ (0.1,-50) [-50|50] "m"  CCU
 SG_ ADC_PathPlanPos4X : 171|10@0+ (0.1,-50) [-50|50] "m"  CCU
 SG_ ADC_PathPlanPos4Y : 177|10@0+ (0.1,-50) [-50|50] "m"  CCU
 SG_ ADC_PathPlanPos5X : 199|10@0+ (0.1,-50) [-50|50] "m"  CCU
 SG_ ADC_PathPlanPos5Y : 205|10@0+ (0.1,-50) [-50|50] "m"  CCU
 SG_ ADC_PathPlanPos6X : 211|10@0+ (0.1,-50) [-50|50] "m"  CCU
 SG_ ADC_PathPlanPos6Y : 217|10@0+ (0.1,-50) [-50|50] "m"  CCU
 SG_ ADC_PathPlanPos7X : 239|10@0+ (0.1,-50) [-50|50] "m"  CCU
 SG_ ADC_PathPlanPos7Y : 245|10@0+ (0.1,-50) [-50|50] "m"  CCU
 SG_ ADC_PathPlanPos8X : 251|10@0+ (0.1,-50) [-50|50] "m"  CCU
 SG_ ADC_PathPlanPos8Y : 257|10@0+ (0.1,-50) [-50|50] "m"  CCU
 SG_ ADC_PathPlanPos9X : 279|10@0+ (0.1,-50) [-50|50] "m"  CCU
 SG_ ADC_PathPlanPos9Y : 285|10@0+ (0.1,-50) [-50|50] "m"  CCU
 SG_ ADC_PathPlanPos10X : 291|10@0+ (0.1,-50) [-50|50] "m"  CCU
 SG_ ADC_PathPlanPos10Y : 297|10@0+ (0.1,-50) [-50|50] "m"  CCU
 SG_ ADC_PathPlanPos11X : 319|10@0+ (0.1,-50) [-50|50] "m"  CCU
 SG_ ADC_PathPlanPos11Y : 325|10@0+ (0.1,-50) [-50|50] "m"  CCU
 SG_ ADC_PathPlanPos12X : 331|10@0+ (0.1,-50) [-50|50] "m"  CCU
 SG_ ADC_PathPlanPos12Y : 337|10@0+ (0.1,-50) [-50|50] "m"  CCU
 SG_ ADC_PathPlanPos13X : 359|10@0+ (0.1,-50) [-50|50] "m"  CCU
 SG_ ADC_PathPlanPos13Y : 365|10@0+ (0.1,-50) [-50|50] "m"  CCU
 SG_ ADC_PathPlanPos14X : 371|10@0+ (0.1,-50) [-50|50] "m"  CCU
 SG_ ADC_PathPlanPos14Y : 377|10@0+ (0.1,-50) [-50|50] "m"  CCU
 SG_ ADC_PathPlanPos15X : 399|10@0+ (0.1,-50) [-50|50] "m"  CCU
 SG_ ADC_PathPlanPos15Y : 405|10@0+ (0.1,-50) [-50|50] "m"  CCU
 SG_ ADC_PathPlanPos16X : 411|10@0+ (0.1,-50) [-50|50] "m"  CCU
 SG_ ADC_PathPlanPos16Y : 417|10@0+ (0.1,-50) [-50|50] "m"  CCU
 SG_ ADC_PathPlanPos17X : 439|10@0+ (0.1,-50) [-50|50] "m"  CCU
 SG_ ADC_PathPlanPos17Y : 445|10@0+ (0.1,-50) [-50|50] "m"  CCU
 SG_ ADC_PathPlanPos18X : 451|10@0+ (0.1,-50) [-50|50] "m"  CCU
 SG_ ADC_PathPlanPos18Y : 457|10@0+ (0.1,-50) [-50|50] "m"  CCU
 SG_ ADC_PathPlanPos19X : 479|10@0+ (0.1,-50) [-50|50] "m"  CCU
 SG_ ADC_PathPlanPos19Y : 485|10@0+ (0.1,-50) [-50|50] "m"  CCU
 SG_ ADC_PathPlanPos20X : 491|10@0+ (0.1,-50) [-50|50] "m"  CCU
 SG_ ADC_PathPlanPos20Y : 497|10@0+ (0.1,-50) [-50|50] "m"  CCU

BO_ 970 ADC_15: 64 ADC

CM_ SG_ 549 ADC_12_CRC "E2E Profile 5 CRC";
CM_ SG_ 549 ADC_12_Counter "E2E Profile 5 Counter";
CM_ SG_ 549 ADC_APAst "APA and FAPA status";
CM_ SG_ 549 ADC_AVPst "HPA and AVP status";
CM_ SG_ 549 ADC_PAAFuncSt "PAA working functions inaication signal";
CM_ SG_ 549 ADC_PAAVoiceReminder "PAA Voice Reminder";
CM_ SG_ 549 ADC_PAAVRSwitchFailSt "PAA VR Switch Fail State";
CM_ SG_ 549 ADC_APKDisplayReq "APK display request";
CM_ SG_ 549 ADC_APAActFuncInd "Auto_parking Active Function Indication";
CM_ SG_ 549 ADC_APABackParkDisplayReq "APA Background Parking For AVNT Display";
CM_ SG_ 549 ADC_VCU_Gearshiftprompt "The signal prohibiting gear shifting prompt sent from the ADC to the VCU";
CM_ SG_ 549 ADC_AVPActFuncind "AVP Active Function Indication";
CM_ SG_ 549 ADC_APAMessagePushSt "APA Message Push Staus";
CM_ SG_ 549 ADC_HPAMessagePushSt "HPA Message  Push Staus";
CM_ SG_ 549 ADC_PedWarnToneCtrl "Parking cost pedestrian warning sound";
CM_ SG_ 549 ADC_AVPMessagePushSt "AVP Message  Push Staus";
CM_ SG_ 549 ADC_PAADrvInteraction "PAA Driver Interaction signal";
CM_ SG_ 549 ADC_PAARemoteParkingMode "PAA Remote parking Mode";
CM_ SG_ 549 ADC_PAARemoteParkingEnable "PAA Remote Parking Enable";
CM_ SG_ 549 ADC_LocalToBeDRVReq "Request IPDS  PW KL15";
CM_ SG_ 549 ADC_UsageModeStAscendReq "Request UMM to Comfort";
CM_ SG_ 549 ADC_UsageModeStDescendReq "Request UMM to Standby";
CM_ SG_ 549 ADC_PAAIGCInhibitSt "The inhibit state of IGC function";
CM_ SG_ 549 ADC_PAAEDKFunInhibitReq "PAA send key function inhibit request to EDK";
CM_ SG_ 549 ADC_PAARespondMode "PAA? Respond Mode";
CM_ SG_ 549 ADC_UsageModeStHold "ADC UsageMode State Hold";
CM_ SG_ 549 ADC_PAAToNDAReq "PAA  to NDA status requested, or NDA to PAA  status requested";
CM_ SG_ 549 ADC_DriverPresentSt "The Status of Driver on/off the Front Left seat.";
CM_ SG_ 549 ADC_RAEBWorkSts "RAEB Work status ";
CM_ SG_ 549 ADC_UsageModeStHoldVD "ADC UsageMode State Hold Valid";
CM_ SG_ 549 ADC_RAEBEmgyBrkReq "RAEB Emergency brake requested";
CM_ SG_ 549 ADC_RAEBTarAccel "RAEB target acceleration";
CM_ SG_ 549 ADC_PAADrvReq "Parking Driver Request";
CM_ SG_ 549 ADC_PAAQuitInd "Parking Quit indication";
CM_ SG_ 549 ADC_PAARecInd "Parking Recover indication";
CM_ SG_ 549 ADC_NSAMessagePushSt "NSA Message Push Staus";
CM_ SG_ 549 ADC_NSASt "NSA function state";
CM_ SG_ 549 ADC_RA_RemainDist "RA the remainin distance";
CM_ SG_ 549 ADC_Rast "RA state";
CM_ SG_ 549 ADC_RAButtonPress "PCS RA button press status";
CM_ SG_ 549 ADC_AuthPassSt "PAA Authst Pass Status";
CM_ SG_ 549 ADC_SBMAuthst "PAA Authst with SBM";
CM_ SG_ 549 ADC_RPADirectionSel "ADC select park out direction for RPA";
CM_ SG_ 549 ADC_VehPoscoord "Vehicle coordinate system type";
CM_ SG_ 549 ADC_VehDynamicPosX "Vehicle dynamic postion in X axis";
CM_ SG_ 549 ADC_VehDynamicPosY "Vehicle dynamic postion in Y axis";
CM_ SG_ 549 ADC_VehPosYawrate "Vehicle dynamic postion yawrate";
CM_ SG_ 549 ADC_VehCurv "Vehicle dynamic curve";
CM_ SG_ 549 ADC_SlotPosX "Current choosed slot postion in X axis";
CM_ SG_ 549 ADC_SlotPosY "Current choosed slot postion in Y axis";
CM_ SG_ 549 ADC_HPAst "HPA status";
CM_ SG_ 549 ADC_SlotAngle "Current choosed slot angle";
CM_ SG_ 549 ADC_SlotCurv "Current choosed slot curve";
CM_ SG_ 549 ADC_FusionDSMWorkStFL "FL door vision detection work status视觉无法使用就发off或failure";
CM_ SG_ 549 ADC_FusionDSMWorkStFR "FR door vision detection work status视觉无法使用就发off或failure";
CM_ SG_ 549 ADC_FusionDSMWorkStRL "RL door vision detection work status视觉无法使用就发off或failure";
CM_ SG_ 549 ADC_FusionDSMWorkStRR "RR door vision detection work status视觉无法使用就发off或failure";
CM_ SG_ 549 ADC_FusionDSMOpenablePercentFL "Power Operation Door openable angle";
CM_ SG_ 549 ADC_FusionDSMEmergencyStopFL "Power operation door emergency stop flag";
CM_ SG_ 549 ADC_FusionDSMValidFL "Vaild Flag of DSM information";
CM_ SG_ 549 ADC_FusionDSMOpenablePercentFR "Power Operation Door openable angle";
CM_ SG_ 549 ADC_FusionDSMEmergencyStopFR "Power operation door emergency stop flag";
CM_ SG_ 549 ADC_FusionDSMOpenablePercentRL "Power Operation Door openable angle";
CM_ SG_ 549 ADC_FusionDSMValidFR "Vaild Flag of DSM information";
CM_ SG_ 549 ADC_parkInOutDirection "ADC Park in/out Direction";
CM_ SG_ 549 ADC_RPAStMessagePush "indicate the LRPA push message to APP";
CM_ SG_ 549 ADC_RPAtype "Indicate the RPA type";
CM_ SG_ 549 ADC_FusionDSMOpenablePercentRR "Power Operation Door openable angle";
CM_ SG_ 549 ADC_FusionDSMEmergencyStopRL "Power operation door emergency stop flag";
CM_ SG_ 549 ADC_FusionDSMValidRL "Vaild Flag of DSM information";
CM_ SG_ 549 ADC_FusionDSMEmergencyStopRR "Power operation door emergency stop flag";
CM_ SG_ 549 ADC_FusionDSMValidRR "Vaild Flag of DSM information";
CM_ SG_ 549 ADC_FusionDSMObstacleDisFL "The distance between door and obstacle";
CM_ SG_ 549 ADC_FusionDSMObstacleDisFR "The distance between FR door and obstacle";
CM_ SG_ 549 ADC_FusionDSMObstacleDisRL "The distance between RL door and obstacle";
CM_ SG_ 549 ADC_FusionDSMObstacleDisRR "The distance between RR door and obstacle";
CM_ SG_ 549 ADC_DskScreenOperationReq "Desktop Screen Operation State Request";
CM_ SG_ 549 ADC_SenslesEtyParkingSt "Senseless entry parking switch state";
CM_ SG_ 549 ADC_PAALimitToast "PAA not available toast";
CM_ SG_ 549 ADC_PAALimitReminder "PAA not available voice reminder";
CM_ SG_ 549 ADC_ParkOutMode "ADC Park out Mode";
CM_ SG_ 549 ADAS_ParkStats "HW ADS Parking status signal";
CM_ SG_ 969 ADAS_RemoterParkingOnlineOrNot "Indicate RemoterParkingOnline Or Not";
CM_ SG_ 969 ADC_RpaParkAuthn "RPA phone authorized_confirm state";
CM_ SG_ 969 ADC_RemParkPatSel "Parkin or Parkout";
CM_ SG_ 969 ADC_ParkDirCfm "Parkout direction";
CM_ SG_ 969 ADC_ParkStMac "APA state machine";
CM_ SG_ 969 ADC_PwrOnOffReq "Vehicle power-on and power-off control request";
CM_ SG_ 969 ADC_ParkOutDir_ParaLe "Parallel Left parkout direction";
CM_ SG_ 969 ADC_ParkOutDir_ParaRi "Parallel right parkout direction";
CM_ SG_ 969 ADC_ParkOutDir_PerpFwd "Perpendicular Forward parkout direction";
CM_ SG_ 969 ADC_ParkOutDir_PerpLeFwd "Perpendicular left Forward parkout direction";
CM_ SG_ 969 ADC_ParkOutDir_PerpRiFwd "Perpendicular right Forward parkout direction";
CM_ SG_ 969 ADC_ParkOutDir_PerpLeBack "Perpendicular left backward parkout direction";
CM_ SG_ 969 ADC_ParkOutDir_PerpRiBack "Perpendicular right backward parkout direction";
CM_ SG_ 969 ADC_ParkOutDir_PerpBack "Perpendicular backward parkout direction";
CM_ SG_ 969 ADC_APA_RPAFctUnavlMsg1 "RPA unavailable reason 1";
CM_ SG_ 969 ADC_APA_RPAFctUnavlMsg2 "RPA unavailable reason 2";
CM_ SG_ 969 ADC_APA_RPAFctUnavlMsg3 "RPA unavailable reason 3";
CM_ SG_ 969 ADC_APA_RPAFctUnavlMsg4 "RPA unavailable reason 4";
CM_ SG_ 969 ADC_APA_RPAFctUnavlMsg5 "RPA unavailable reason 5";
CM_ SG_ 969 ADC_APA_RPAFctUnavlMsg6 "RPA unavailable reason 6";
CM_ SG_ 969 ADC_APA_RPAFctUnavlMsg7 "RPA unavailable reason 7";
CM_ SG_ 969 ADC_APA_RPAFctUnavlMsg8 "RPA unavailable reason 8";
CM_ SG_ 969 ADC_APA_RPAFctUnavlMsg9 "RPA unavailable reason 9";
CM_ SG_ 969 ADC_APA_RPAFctUnavlMsg10 "RPA unavailable reason 10";
CM_ SG_ 969 ADC_APA_RPAFctUnavlMsg11 "RPA unavailable reason 11";
CM_ SG_ 969 ADC_APA_RPAFctUnavlMsg12 "RPA unavailable reason 12";
CM_ SG_ 969 ADC_APA_RPAFctUnavlMsg13 "RPA unavailable reason 13";
CM_ SG_ 969 ADC_APA_RPAFctUnavlMsg14 "RPA unavailable reason 14";
CM_ SG_ 969 ADC_APA_RPAFctUnavlMsg15 "RPA unavailable reason 15";
CM_ SG_ 969 ADC_APA_RPAFctUnavlMsg16 "RPA unavailable reason 16";
CM_ SG_ 969 ADC_APA_RPAFctUnavlMsg17 "RPA unavailable reason 17";
CM_ SG_ 969 ADC_APA_RPAFctUnavlMsg18 "RPA unavailable reason 18";
CM_ SG_ 969 ADC_APA_RPAFctUnavlMsg19 "RPA unavailable reason 19";
CM_ SG_ 969 ADC_APA_RPAFctUnavlMsg20 "RPA unavailable reason 20";
CM_ SG_ 969 ADC_APA_RPAFctUnavlMsg21 "RPA unavailable reason 21";
CM_ SG_ 969 ADC_APA_RPAFctUnavlMsg22 "RPA unavailable reason 22";
CM_ SG_ 969 ADC_APA_RPAFctUnavlMsg23 "RPA unavailable reason 23";
CM_ SG_ 969 ADC_APA_RPAFctUnavlMsg24 "RPA unavailable reason 24";
CM_ SG_ 969 ADC_APA_RPAFctUnavlMsg25 "RPA unavailable reason 25";
CM_ SG_ 969 ADC_APA_RPACnclMsg1 "RPA cancel reason 1";
CM_ SG_ 969 ADC_APA_RPACnclMsg2 "RPA cancel reason 2";
CM_ SG_ 969 ADC_APA_RPACnclMsg3 "RPA cancel reason 3";
CM_ SG_ 969 ADC_APA_RPACnclMsg4 "RPA cancel reason 4";
CM_ SG_ 969 ADC_APA_RPACnclMsg5 "RPA cancel reason 5";
CM_ SG_ 969 ADC_APA_RPACnclMsg6 "RPA cancel reason 6";
CM_ SG_ 969 ADC_APA_RPACnclMsg7 "RPA cancel reason 7";
CM_ SG_ 969 ADC_APA_RPACnclMsg8 "RPA cancel reason 8";
CM_ SG_ 969 ADC_APA_RPACnclMsg9 "RPA cancel reason 9";
CM_ SG_ 969 ADC_APA_RPACnclMsg10 "RPA cancel reason 10";
CM_ SG_ 969 ADC_APA_RPACnclMsg11 "RPA cancel reason 11";
CM_ SG_ 969 ADC_APA_RPACnclMsg12 "RPA cancel reason 12";
CM_ SG_ 969 ADC_APA_RPACnclMsg13 "RPA cancel reason 13";
CM_ SG_ 969 ADC_APA_RPACnclMsg14 "RPA cancel reason 14";
CM_ SG_ 969 ADC_APA_RPACnclMsg15 "RPA cancel reason 15";
CM_ SG_ 969 ADC_APA_RPACnclMsg16 "RPA cancel reason 16";
CM_ SG_ 969 ADC_APA_RPACnclMsg17 "RPA cancel reason 17";
CM_ SG_ 969 ADC_APA_RPACnclMsg18 "RPA cancel reason 18";
CM_ SG_ 969 ADC_APA_RPACnclMsg19 "RPA cancel reason 19";
CM_ SG_ 969 ADC_APA_RPACnclMsg20 "RPA cancel reason 20";
CM_ SG_ 969 ADC_APA_RPAPauseMsg1 "RPA pause reason 1";
CM_ SG_ 969 ADC_APA_RPAPauseMsg2 "RPA pause reason 2";
CM_ SG_ 969 ADC_APA_RPAPauseMsg3 "RPA pause reason 3";
CM_ SG_ 969 ADC_APA_RPAPauseMsg4 "RPA pause reason 4";
CM_ SG_ 969 ADC_APA_RPAPauseMsg5 "RPA pause reason 5";
CM_ SG_ 969 ADC_APA_RPAPauseMsg6 "RPA pause reason 6";
CM_ SG_ 969 ADC_APA_RPAPauseMsg7 "RPA pause reason 7";
CM_ SG_ 969 ADC_APA_RPAPauseMsg8 "RPA pause reason 8";
CM_ SG_ 969 ADC_APA_RPAPauseMsg9 "RPA pause reason 9";
CM_ SG_ 969 ADC_APA_RPAPauseMsg10 "RPA pause reason 10";
CM_ SG_ 969 ADC_PathPlanPos1X "ADC_PathPlanPos1_x";
CM_ SG_ 969 ADC_PathPlanPos1Y "ADC_PathPlanPos1_y";
CM_ SG_ 969 ADC_PathPlanPos2X "ADC_PathPlanPos2_x";
CM_ SG_ 969 ADC_PathPlanPos2Y "ADC_PathPlanPos2_y";
CM_ SG_ 969 ADC_PathPlanPos3X "ADC_PathPlanPos3_x";
CM_ SG_ 969 ADC_PathPlanPos3Y "ADC_PathPlanPos3_y";
CM_ SG_ 969 ADC_PathPlanPos4X "ADC_PathPlanPos4_x";
CM_ SG_ 969 ADC_PathPlanPos4Y "ADC_PathPlanPos4_y";
CM_ SG_ 969 ADC_PathPlanPos5X "ADC_PathPlanPos5_x";
CM_ SG_ 969 ADC_PathPlanPos5Y "ADC_PathPlanPos5_y";
CM_ SG_ 969 ADC_PathPlanPos6X "ADC_PathPlanPos6_x";
CM_ SG_ 969 ADC_PathPlanPos6Y "ADC_PathPlanPos6_y";
CM_ SG_ 969 ADC_PathPlanPos7X "ADC_PathPlanPos7_x";
CM_ SG_ 969 ADC_PathPlanPos7Y "ADC_PathPlanPos7_y";
CM_ SG_ 969 ADC_PathPlanPos8X "ADC_PathPlanPos8_x";
CM_ SG_ 969 ADC_PathPlanPos8Y "ADC_PathPlanPos8_y";
CM_ SG_ 969 ADC_PathPlanPos9X "ADC_PathPlanPos9_x";
CM_ SG_ 969 ADC_PathPlanPos9Y "ADC_PathPlanPos9_y";
CM_ SG_ 969 ADC_PathPlanPos10X "ADC_PathPlanPos10_x";
CM_ SG_ 969 ADC_PathPlanPos10Y "ADC_PathPlanPos10_y";
CM_ SG_ 969 ADC_PathPlanPos11X "ADC_PathPlanPos11_x";
CM_ SG_ 969 ADC_PathPlanPos11Y "ADC_PathPlanPos11_y";
CM_ SG_ 969 ADC_PathPlanPos12X "ADC_PathPlanPos12_x";
CM_ SG_ 969 ADC_PathPlanPos12Y "ADC_PathPlanPos12_y";
CM_ SG_ 969 ADC_PathPlanPos13X "ADC_PathPlanPos13_x";
CM_ SG_ 969 ADC_PathPlanPos13Y "ADC_PathPlanPos13_y";
CM_ SG_ 969 ADC_PathPlanPos14X "ADC_PathPlanPos14_x";
CM_ SG_ 969 ADC_PathPlanPos14Y "ADC_PathPlanPos14_y";
CM_ SG_ 969 ADC_PathPlanPos15X "ADC_PathPlanPos15_x";
CM_ SG_ 969 ADC_PathPlanPos15Y "ADC_PathPlanPos15_y";
CM_ SG_ 969 ADC_PathPlanPos16X "ADC_PathPlanPos16_x";
CM_ SG_ 969 ADC_PathPlanPos16Y "ADC_PathPlanPos16_y";
CM_ SG_ 969 ADC_PathPlanPos17X "ADC_PathPlanPos17_x";
CM_ SG_ 969 ADC_PathPlanPos17Y "ADC_PathPlanPos17_y";
CM_ SG_ 969 ADC_PathPlanPos18X "ADC_PathPlanPos18_x";
CM_ SG_ 969 ADC_PathPlanPos18Y "ADC_PathPlanPos18_y";
CM_ SG_ 969 ADC_PathPlanPos19X "ADC_PathPlanPos19_x";
CM_ SG_ 969 ADC_PathPlanPos19Y "ADC_PathPlanPos19_y";
CM_ SG_ 969 ADC_PathPlanPos20X "ADC_PathPlanPos20_x";
CM_ SG_ 969 ADC_PathPlanPos20Y "ADC_PathPlanPos20_y";

BA_DEF_ BO_  "GenMsgCycleTime" INT 0 0;
BA_DEF_ BO_  "GenMsgCycleTimeFast" INT 0 0;
BA_DEF_ BO_  "GenMsgSendType" ENUM  "Periodic","Event","IfActive","POE","PA","FixedPeriodic","Event","EnabledPeriodic","NotUsed","NotUsed","EventPeriodic","NotUsed","NotUsed","NoMsgSendType";
BA_DEF_ BO_  "VFrameFormat" ENUM  "StandardCAN","ExtendedCAN","reserved","reserved","reserved","reserved","reserved","reserved","reserved","reserved","reserved","reserved","reserved","reserved","StandardCAN_FD","ExtendedCAN_FD";
BA_DEF_ BO_  "CANFD_BRS" ENUM  "0","1";
BA_DEF_ SG_  "EventCommandSignal" ENUM  "No","Yes";
BA_DEF_ SG_  "GatewayedSignals" ENUM  "No","Yes";
BA_DEF_ SG_  "GenSigInactiveValue" HEX 0 0;
BA_DEF_ SG_  "GenSigInvalidValue" HEX 0 0;
BA_DEF_ SG_  "GenSigSendType" ENUM  "Trigger","Passive","Cyclic","OnWrite","OnWriteWithRepetition","OnChange","OnChangeWithRepetition","IfActive","IfActiveWithRepetition","NoSigSendType";
BA_DEF_ SG_  "GenSigStartValue" HEX 0 0;
BA_DEF_ SG_  "GenSigTimeoutValue" HEX 0 0;
BA_DEF_ SG_  "Remark" STRING ;
BA_ "GenMsgCycleTime" BO_ 549 20;
BA_ "GenMsgCycleTimeFast" BO_ 549 0;
BA_ "GenMsgSendType" BO_ 549 0;
BA_ "VFrameFormat" BO_ 549 14;
BA_ "CANFD_BRS" BO_ 549 1;
BA_ "GenMsgCycleTime" BO_ 549 20;
BA_ "GenMsgCycleTimeFast" BO_ 549 0;
BA_ "GenMsgSendType" BO_ 549 0;
BA_ "VFrameFormat" BO_ 549 14;
BA_ "CANFD_BRS" BO_ 549 1;
BA_ "GenMsgCycleTime" BO_ 549 20;
BA_ "GenMsgCycleTimeFast" BO_ 549 0;
BA_ "GenMsgSendType" BO_ 549 0;
BA_ "VFrameFormat" BO_ 549 14;
BA_ "CANFD_BRS" BO_ 549 1;
BA_ "GenMsgCycleTime" BO_ 549 20;
BA_ "GenMsgCycleTimeFast" BO_ 549 0;
BA_ "GenMsgSendType" BO_ 549 0;
BA_ "VFrameFormat" BO_ 549 14;
BA_ "CANFD_BRS" BO_ 549 1;
BA_ "GenMsgCycleTime" BO_ 549 20;
BA_ "GenMsgCycleTimeFast" BO_ 549 0;
BA_ "GenMsgSendType" BO_ 549 0;
BA_ "VFrameFormat" BO_ 549 14;
BA_ "CANFD_BRS" BO_ 549 1;
BA_ "GenMsgCycleTime" BO_ 549 20;
BA_ "GenMsgCycleTimeFast" BO_ 549 0;
BA_ "GenMsgSendType" BO_ 549 0;
BA_ "VFrameFormat" BO_ 549 14;
BA_ "CANFD_BRS" BO_ 549 1;
BA_ "GenMsgCycleTime" BO_ 549 20;
BA_ "GenMsgCycleTimeFast" BO_ 549 0;
BA_ "GenMsgSendType" BO_ 549 0;
BA_ "VFrameFormat" BO_ 549 14;
BA_ "CANFD_BRS" BO_ 549 1;
BA_ "GenMsgCycleTime" BO_ 549 20;
BA_ "GenMsgCycleTimeFast" BO_ 549 0;
BA_ "GenMsgSendType" BO_ 549 0;
BA_ "VFrameFormat" BO_ 549 14;
BA_ "CANFD_BRS" BO_ 549 1;
BA_ "GenMsgCycleTime" BO_ 549 20;
BA_ "GenMsgCycleTimeFast" BO_ 549 0;
BA_ "GenMsgSendType" BO_ 549 0;
BA_ "VFrameFormat" BO_ 549 14;
BA_ "CANFD_BRS" BO_ 549 1;
BA_ "GenMsgCycleTime" BO_ 549 20;
BA_ "GenMsgCycleTimeFast" BO_ 549 0;
BA_ "GenMsgSendType" BO_ 549 0;
BA_ "VFrameFormat" BO_ 549 14;
BA_ "CANFD_BRS" BO_ 549 1;
BA_ "GenMsgCycleTime" BO_ 549 20;
BA_ "GenMsgCycleTimeFast" BO_ 549 0;
BA_ "GenMsgSendType" BO_ 549 0;
BA_ "VFrameFormat" BO_ 549 14;
BA_ "CANFD_BRS" BO_ 549 1;
BA_ "GenMsgCycleTime" BO_ 549 20;
BA_ "GenMsgCycleTimeFast" BO_ 549 0;
BA_ "GenMsgSendType" BO_ 549 0;
BA_ "VFrameFormat" BO_ 549 14;
BA_ "CANFD_BRS" BO_ 549 1;
BA_ "GenMsgCycleTime" BO_ 549 20;
BA_ "GenMsgCycleTimeFast" BO_ 549 0;
BA_ "GenMsgSendType" BO_ 549 0;
BA_ "VFrameFormat" BO_ 549 14;
BA_ "CANFD_BRS" BO_ 549 1;
BA_ "GenMsgCycleTime" BO_ 549 20;
BA_ "GenMsgCycleTimeFast" BO_ 549 0;
BA_ "GenMsgSendType" BO_ 549 0;
BA_ "VFrameFormat" BO_ 549 14;
BA_ "CANFD_BRS" BO_ 549 1;
BA_ "GenMsgCycleTime" BO_ 549 20;
BA_ "GenMsgCycleTimeFast" BO_ 549 0;
BA_ "GenMsgSendType" BO_ 549 0;
BA_ "VFrameFormat" BO_ 549 14;
BA_ "CANFD_BRS" BO_ 549 1;
BA_ "GenMsgCycleTime" BO_ 549 20;
BA_ "GenMsgCycleTimeFast" BO_ 549 0;
BA_ "GenMsgSendType" BO_ 549 0;
BA_ "VFrameFormat" BO_ 549 14;
BA_ "CANFD_BRS" BO_ 549 1;
BA_ "GenMsgCycleTime" BO_ 549 20;
BA_ "GenMsgCycleTimeFast" BO_ 549 0;
BA_ "GenMsgSendType" BO_ 549 0;
BA_ "VFrameFormat" BO_ 549 14;
BA_ "CANFD_BRS" BO_ 549 1;
BA_ "GenMsgCycleTime" BO_ 549 20;
BA_ "GenMsgCycleTimeFast" BO_ 549 0;
BA_ "GenMsgSendType" BO_ 549 0;
BA_ "VFrameFormat" BO_ 549 14;
BA_ "CANFD_BRS" BO_ 549 1;
BA_ "GenMsgCycleTime" BO_ 549 20;
BA_ "GenMsgCycleTimeFast" BO_ 549 0;
BA_ "GenMsgSendType" BO_ 549 0;
BA_ "VFrameFormat" BO_ 549 14;
BA_ "CANFD_BRS" BO_ 549 1;
BA_ "GenMsgCycleTime" BO_ 549 20;
BA_ "GenMsgCycleTimeFast" BO_ 549 0;
BA_ "GenMsgSendType" BO_ 549 0;
BA_ "VFrameFormat" BO_ 549 14;
BA_ "CANFD_BRS" BO_ 549 1;
BA_ "GenMsgCycleTime" BO_ 549 20;
BA_ "GenMsgCycleTimeFast" BO_ 549 0;
BA_ "GenMsgSendType" BO_ 549 0;
BA_ "VFrameFormat" BO_ 549 14;
BA_ "CANFD_BRS" BO_ 549 1;
BA_ "GenMsgCycleTime" BO_ 549 20;
BA_ "GenMsgCycleTimeFast" BO_ 549 0;
BA_ "GenMsgSendType" BO_ 549 0;
BA_ "VFrameFormat" BO_ 549 14;
BA_ "CANFD_BRS" BO_ 549 1;
BA_ "GenMsgCycleTime" BO_ 549 20;
BA_ "GenMsgCycleTimeFast" BO_ 549 0;
BA_ "GenMsgSendType" BO_ 549 0;
BA_ "VFrameFormat" BO_ 549 14;
BA_ "CANFD_BRS" BO_ 549 1;
BA_ "GenMsgCycleTime" BO_ 549 20;
BA_ "GenMsgCycleTimeFast" BO_ 549 0;
BA_ "GenMsgSendType" BO_ 549 0;
BA_ "VFrameFormat" BO_ 549 14;
BA_ "CANFD_BRS" BO_ 549 1;
BA_ "GenMsgCycleTime" BO_ 549 20;
BA_ "GenMsgCycleTimeFast" BO_ 549 0;
BA_ "GenMsgSendType" BO_ 549 0;
BA_ "VFrameFormat" BO_ 549 14;
BA_ "CANFD_BRS" BO_ 549 1;
BA_ "GenMsgCycleTime" BO_ 549 20;
BA_ "GenMsgCycleTimeFast" BO_ 549 0;
BA_ "GenMsgSendType" BO_ 549 0;
BA_ "VFrameFormat" BO_ 549 14;
BA_ "CANFD_BRS" BO_ 549 1;
BA_ "GenMsgCycleTime" BO_ 549 20;
BA_ "GenMsgCycleTimeFast" BO_ 549 0;
BA_ "GenMsgSendType" BO_ 549 0;
BA_ "VFrameFormat" BO_ 549 14;
BA_ "CANFD_BRS" BO_ 549 1;
BA_ "GenMsgCycleTime" BO_ 549 20;
BA_ "GenMsgCycleTimeFast" BO_ 549 0;
BA_ "GenMsgSendType" BO_ 549 0;
BA_ "VFrameFormat" BO_ 549 14;
BA_ "CANFD_BRS" BO_ 549 1;
BA_ "GenMsgCycleTime" BO_ 549 20;
BA_ "GenMsgCycleTimeFast" BO_ 549 0;
BA_ "GenMsgSendType" BO_ 549 0;
BA_ "VFrameFormat" BO_ 549 14;
BA_ "CANFD_BRS" BO_ 549 1;
BA_ "GenMsgCycleTime" BO_ 549 20;
BA_ "GenMsgCycleTimeFast" BO_ 549 0;
BA_ "GenMsgSendType" BO_ 549 0;
BA_ "VFrameFormat" BO_ 549 14;
BA_ "CANFD_BRS" BO_ 549 1;
BA_ "GenMsgCycleTime" BO_ 549 20;
BA_ "GenMsgCycleTimeFast" BO_ 549 0;
BA_ "GenMsgSendType" BO_ 549 0;
BA_ "VFrameFormat" BO_ 549 14;
BA_ "CANFD_BRS" BO_ 549 1;
BA_ "GenMsgCycleTime" BO_ 549 20;
BA_ "GenMsgCycleTimeFast" BO_ 549 0;
BA_ "GenMsgSendType" BO_ 549 0;
BA_ "VFrameFormat" BO_ 549 14;
BA_ "CANFD_BRS" BO_ 549 1;
BA_ "GenMsgCycleTime" BO_ 549 20;
BA_ "GenMsgCycleTimeFast" BO_ 549 0;
BA_ "GenMsgSendType" BO_ 549 0;
BA_ "VFrameFormat" BO_ 549 14;
BA_ "CANFD_BRS" BO_ 549 1;
BA_ "GenMsgCycleTime" BO_ 549 20;
BA_ "GenMsgCycleTimeFast" BO_ 549 0;
BA_ "GenMsgSendType" BO_ 549 0;
BA_ "VFrameFormat" BO_ 549 14;
BA_ "CANFD_BRS" BO_ 549 1;
BA_ "GenMsgCycleTime" BO_ 549 20;
BA_ "GenMsgCycleTimeFast" BO_ 549 0;
BA_ "GenMsgSendType" BO_ 549 0;
BA_ "VFrameFormat" BO_ 549 14;
BA_ "CANFD_BRS" BO_ 549 1;
BA_ "GenMsgCycleTime" BO_ 549 20;
BA_ "GenMsgCycleTimeFast" BO_ 549 0;
BA_ "GenMsgSendType" BO_ 549 0;
BA_ "VFrameFormat" BO_ 549 14;
BA_ "CANFD_BRS" BO_ 549 1;
BA_ "GenMsgCycleTime" BO_ 549 20;
BA_ "GenMsgCycleTimeFast" BO_ 549 0;
BA_ "GenMsgSendType" BO_ 549 0;
BA_ "VFrameFormat" BO_ 549 14;
BA_ "CANFD_BRS" BO_ 549 1;
BA_ "GenMsgCycleTime" BO_ 549 20;
BA_ "GenMsgCycleTimeFast" BO_ 549 0;
BA_ "GenMsgSendType" BO_ 549 0;
BA_ "VFrameFormat" BO_ 549 14;
BA_ "CANFD_BRS" BO_ 549 1;
BA_ "GenMsgCycleTime" BO_ 549 20;
BA_ "GenMsgCycleTimeFast" BO_ 549 0;
BA_ "GenMsgSendType" BO_ 549 0;
BA_ "VFrameFormat" BO_ 549 14;
BA_ "CANFD_BRS" BO_ 549 1;
BA_ "GenMsgCycleTime" BO_ 549 20;
BA_ "GenMsgCycleTimeFast" BO_ 549 0;
BA_ "GenMsgSendType" BO_ 549 0;
BA_ "VFrameFormat" BO_ 549 14;
BA_ "CANFD_BRS" BO_ 549 1;
BA_ "GenMsgCycleTime" BO_ 549 20;
BA_ "GenMsgCycleTimeFast" BO_ 549 0;
BA_ "GenMsgSendType" BO_ 549 0;
BA_ "VFrameFormat" BO_ 549 14;
BA_ "CANFD_BRS" BO_ 549 1;
BA_ "GenMsgCycleTime" BO_ 549 20;
BA_ "GenMsgCycleTimeFast" BO_ 549 0;
BA_ "GenMsgSendType" BO_ 549 0;
BA_ "VFrameFormat" BO_ 549 14;
BA_ "CANFD_BRS" BO_ 549 1;
BA_ "GenMsgCycleTime" BO_ 549 20;
BA_ "GenMsgCycleTimeFast" BO_ 549 0;
BA_ "GenMsgSendType" BO_ 549 0;
BA_ "VFrameFormat" BO_ 549 14;
BA_ "CANFD_BRS" BO_ 549 1;
BA_ "GenMsgCycleTime" BO_ 549 20;
BA_ "GenMsgCycleTimeFast" BO_ 549 0;
BA_ "GenMsgSendType" BO_ 549 0;
BA_ "VFrameFormat" BO_ 549 14;
BA_ "CANFD_BRS" BO_ 549 1;
BA_ "GenMsgCycleTime" BO_ 549 20;
BA_ "GenMsgCycleTimeFast" BO_ 549 0;
BA_ "GenMsgSendType" BO_ 549 0;
BA_ "VFrameFormat" BO_ 549 14;
BA_ "CANFD_BRS" BO_ 549 1;
BA_ "GenMsgCycleTime" BO_ 549 20;
BA_ "GenMsgCycleTimeFast" BO_ 549 0;
BA_ "GenMsgSendType" BO_ 549 0;
BA_ "VFrameFormat" BO_ 549 14;
BA_ "CANFD_BRS" BO_ 549 1;
BA_ "GenMsgCycleTime" BO_ 549 20;
BA_ "GenMsgCycleTimeFast" BO_ 549 0;
BA_ "GenMsgSendType" BO_ 549 0;
BA_ "VFrameFormat" BO_ 549 14;
BA_ "CANFD_BRS" BO_ 549 1;
BA_ "GenMsgCycleTime" BO_ 549 20;
BA_ "GenMsgCycleTimeFast" BO_ 549 0;
BA_ "GenMsgSendType" BO_ 549 0;
BA_ "VFrameFormat" BO_ 549 14;
BA_ "CANFD_BRS" BO_ 549 1;
BA_ "GenMsgCycleTime" BO_ 549 20;
BA_ "GenMsgCycleTimeFast" BO_ 549 0;
BA_ "GenMsgSendType" BO_ 549 0;
BA_ "VFrameFormat" BO_ 549 14;
BA_ "CANFD_BRS" BO_ 549 1;
BA_ "GenMsgCycleTime" BO_ 549 20;
BA_ "GenMsgCycleTimeFast" BO_ 549 0;
BA_ "GenMsgSendType" BO_ 549 0;
BA_ "VFrameFormat" BO_ 549 14;
BA_ "CANFD_BRS" BO_ 549 1;
BA_ "GenMsgCycleTime" BO_ 549 20;
BA_ "GenMsgCycleTimeFast" BO_ 549 0;
BA_ "GenMsgSendType" BO_ 549 0;
BA_ "VFrameFormat" BO_ 549 14;
BA_ "CANFD_BRS" BO_ 549 1;
BA_ "GenMsgCycleTime" BO_ 549 20;
BA_ "GenMsgCycleTimeFast" BO_ 549 0;
BA_ "GenMsgSendType" BO_ 549 0;
BA_ "VFrameFormat" BO_ 549 14;
BA_ "CANFD_BRS" BO_ 549 1;
BA_ "GenMsgCycleTime" BO_ 549 20;
BA_ "GenMsgCycleTimeFast" BO_ 549 0;
BA_ "GenMsgSendType" BO_ 549 0;
BA_ "VFrameFormat" BO_ 549 14;
BA_ "CANFD_BRS" BO_ 549 1;
BA_ "GenMsgCycleTime" BO_ 549 20;
BA_ "GenMsgCycleTimeFast" BO_ 549 0;
BA_ "GenMsgSendType" BO_ 549 0;
BA_ "VFrameFormat" BO_ 549 14;
BA_ "CANFD_BRS" BO_ 549 1;
BA_ "GenMsgCycleTime" BO_ 549 20;
BA_ "GenMsgCycleTimeFast" BO_ 549 0;
BA_ "GenMsgSendType" BO_ 549 0;
BA_ "VFrameFormat" BO_ 549 14;
BA_ "CANFD_BRS" BO_ 549 1;
BA_ "GenMsgCycleTime" BO_ 549 20;
BA_ "GenMsgCycleTimeFast" BO_ 549 0;
BA_ "GenMsgSendType" BO_ 549 0;
BA_ "VFrameFormat" BO_ 549 14;
BA_ "CANFD_BRS" BO_ 549 1;
BA_ "GenMsgCycleTime" BO_ 549 20;
BA_ "GenMsgCycleTimeFast" BO_ 549 0;
BA_ "GenMsgSendType" BO_ 549 0;
BA_ "VFrameFormat" BO_ 549 14;
BA_ "CANFD_BRS" BO_ 549 1;
BA_ "GenMsgCycleTime" BO_ 549 20;
BA_ "GenMsgCycleTimeFast" BO_ 549 0;
BA_ "GenMsgSendType" BO_ 549 0;
BA_ "VFrameFormat" BO_ 549 14;
BA_ "CANFD_BRS" BO_ 549 1;
BA_ "GenMsgCycleTime" BO_ 549 20;
BA_ "GenMsgCycleTimeFast" BO_ 549 0;
BA_ "GenMsgSendType" BO_ 549 0;
BA_ "VFrameFormat" BO_ 549 14;
BA_ "CANFD_BRS" BO_ 549 1;
BA_ "GenMsgCycleTime" BO_ 549 20;
BA_ "GenMsgCycleTimeFast" BO_ 549 0;
BA_ "GenMsgSendType" BO_ 549 0;
BA_ "VFrameFormat" BO_ 549 14;
BA_ "CANFD_BRS" BO_ 549 1;
BA_ "GenMsgCycleTime" BO_ 549 20;
BA_ "GenMsgCycleTimeFast" BO_ 549 0;
BA_ "GenMsgSendType" BO_ 549 0;
BA_ "VFrameFormat" BO_ 549 14;
BA_ "CANFD_BRS" BO_ 549 1;
BA_ "GenMsgCycleTime" BO_ 549 20;
BA_ "GenMsgCycleTimeFast" BO_ 549 0;
BA_ "GenMsgSendType" BO_ 549 0;
BA_ "VFrameFormat" BO_ 549 14;
BA_ "CANFD_BRS" BO_ 549 1;
BA_ "GenMsgCycleTime" BO_ 549 20;
BA_ "GenMsgCycleTimeFast" BO_ 549 0;
BA_ "GenMsgSendType" BO_ 549 0;
BA_ "VFrameFormat" BO_ 549 14;
BA_ "CANFD_BRS" BO_ 549 1;
BA_ "GenMsgCycleTime" BO_ 549 20;
BA_ "GenMsgCycleTimeFast" BO_ 549 0;
BA_ "GenMsgSendType" BO_ 549 0;
BA_ "VFrameFormat" BO_ 549 14;
BA_ "CANFD_BRS" BO_ 549 1;
BA_ "GenMsgCycleTime" BO_ 549 20;
BA_ "GenMsgCycleTimeFast" BO_ 549 0;
BA_ "GenMsgSendType" BO_ 549 0;
BA_ "VFrameFormat" BO_ 549 14;
BA_ "CANFD_BRS" BO_ 549 1;
BA_ "GenMsgCycleTime" BO_ 549 20;
BA_ "GenMsgCycleTimeFast" BO_ 549 0;
BA_ "GenMsgSendType" BO_ 549 0;
BA_ "VFrameFormat" BO_ 549 14;
BA_ "CANFD_BRS" BO_ 549 1;
BA_ "GenMsgCycleTime" BO_ 549 20;
BA_ "GenMsgCycleTimeFast" BO_ 549 0;
BA_ "GenMsgSendType" BO_ 549 0;
BA_ "VFrameFormat" BO_ 549 14;
BA_ "CANFD_BRS" BO_ 549 1;
BA_ "GenMsgCycleTime" BO_ 549 20;
BA_ "GenMsgCycleTimeFast" BO_ 549 0;
BA_ "GenMsgSendType" BO_ 549 0;
BA_ "VFrameFormat" BO_ 549 14;
BA_ "CANFD_BRS" BO_ 549 1;
BA_ "GenMsgCycleTime" BO_ 549 20;
BA_ "GenMsgCycleTimeFast" BO_ 549 0;
BA_ "GenMsgSendType" BO_ 549 0;
BA_ "VFrameFormat" BO_ 549 14;
BA_ "CANFD_BRS" BO_ 549 1;
BA_ "GenMsgCycleTime" BO_ 549 20;
BA_ "GenMsgCycleTimeFast" BO_ 549 0;
BA_ "GenMsgSendType" BO_ 549 0;
BA_ "VFrameFormat" BO_ 549 14;
BA_ "CANFD_BRS" BO_ 549 1;
BA_ "GenMsgCycleTime" BO_ 549 20;
BA_ "GenMsgCycleTimeFast" BO_ 549 0;
BA_ "GenMsgSendType" BO_ 549 0;
BA_ "VFrameFormat" BO_ 549 14;
BA_ "CANFD_BRS" BO_ 549 1;
BA_ "GenMsgCycleTime" BO_ 549 20;
BA_ "GenMsgCycleTimeFast" BO_ 549 0;
BA_ "GenMsgSendType" BO_ 549 0;
BA_ "VFrameFormat" BO_ 549 14;
BA_ "CANFD_BRS" BO_ 549 1;
BA_ "GenMsgCycleTime" BO_ 549 20;
BA_ "GenMsgCycleTimeFast" BO_ 549 0;
BA_ "GenMsgSendType" BO_ 549 0;
BA_ "VFrameFormat" BO_ 549 14;
BA_ "CANFD_BRS" BO_ 549 1;
BA_ "GenMsgCycleTime" BO_ 549 20;
BA_ "GenMsgCycleTimeFast" BO_ 549 0;
BA_ "GenMsgSendType" BO_ 549 0;
BA_ "VFrameFormat" BO_ 549 14;
BA_ "CANFD_BRS" BO_ 549 1;
BA_ "GenMsgCycleTime" BO_ 549 20;
BA_ "GenMsgCycleTimeFast" BO_ 549 0;
BA_ "GenMsgSendType" BO_ 549 0;
BA_ "VFrameFormat" BO_ 549 14;
BA_ "CANFD_BRS" BO_ 549 1;
BA_ "GenMsgCycleTime" BO_ 549 20;
BA_ "GenMsgCycleTimeFast" BO_ 549 0;
BA_ "GenMsgSendType" BO_ 549 0;
BA_ "VFrameFormat" BO_ 549 14;
BA_ "CANFD_BRS" BO_ 549 1;
BA_ "GenMsgCycleTime" BO_ 549 20;
BA_ "GenMsgCycleTimeFast" BO_ 549 0;
BA_ "GenMsgSendType" BO_ 549 0;
BA_ "VFrameFormat" BO_ 549 14;
BA_ "CANFD_BRS" BO_ 549 1;
BA_ "GenMsgCycleTime" BO_ 549 20;
BA_ "GenMsgCycleTimeFast" BO_ 549 0;
BA_ "GenMsgSendType" BO_ 549 0;
BA_ "VFrameFormat" BO_ 549 14;
BA_ "CANFD_BRS" BO_ 549 1;
BA_ "GenMsgCycleTime" BO_ 549 20;
BA_ "GenMsgCycleTimeFast" BO_ 549 0;
BA_ "GenMsgSendType" BO_ 549 0;
BA_ "VFrameFormat" BO_ 549 14;
BA_ "CANFD_BRS" BO_ 549 1;
BA_ "GenMsgCycleTime" BO_ 549 20;
BA_ "GenMsgCycleTimeFast" BO_ 549 0;
BA_ "GenMsgSendType" BO_ 549 0;
BA_ "VFrameFormat" BO_ 549 14;
BA_ "CANFD_BRS" BO_ 549 1;
BA_ "GenMsgCycleTime" BO_ 549 20;
BA_ "GenMsgCycleTimeFast" BO_ 549 0;
BA_ "GenMsgSendType" BO_ 549 0;
BA_ "VFrameFormat" BO_ 549 14;
BA_ "CANFD_BRS" BO_ 549 1;
BA_ "GenMsgCycleTime" BO_ 549 20;
BA_ "GenMsgCycleTimeFast" BO_ 549 0;
BA_ "GenMsgSendType" BO_ 549 0;
BA_ "VFrameFormat" BO_ 549 14;
BA_ "CANFD_BRS" BO_ 549 1;
BA_ "GenMsgCycleTime" BO_ 549 20;
BA_ "GenMsgCycleTimeFast" BO_ 549 0;
BA_ "GenMsgSendType" BO_ 549 0;
BA_ "VFrameFormat" BO_ 549 14;
BA_ "CANFD_BRS" BO_ 549 1;
BA_ "GenMsgCycleTime" BO_ 969 100;
BA_ "GenMsgCycleTimeFast" BO_ 969 0;
BA_ "GenMsgSendType" BO_ 969 0;
BA_ "VFrameFormat" BO_ 969 14;
BA_ "CANFD_BRS" BO_ 969 1;
BA_ "GenMsgCycleTime" BO_ 969 100;
BA_ "GenMsgCycleTimeFast" BO_ 969 0;
BA_ "GenMsgSendType" BO_ 969 0;
BA_ "VFrameFormat" BO_ 969 14;
BA_ "CANFD_BRS" BO_ 969 1;
BA_ "GenMsgCycleTime" BO_ 969 100;
BA_ "GenMsgCycleTimeFast" BO_ 969 0;
BA_ "GenMsgSendType" BO_ 969 0;
BA_ "VFrameFormat" BO_ 969 14;
BA_ "CANFD_BRS" BO_ 969 1;
BA_ "GenMsgCycleTime" BO_ 969 100;
BA_ "GenMsgCycleTimeFast" BO_ 969 0;
BA_ "GenMsgSendType" BO_ 969 0;
BA_ "VFrameFormat" BO_ 969 14;
BA_ "CANFD_BRS" BO_ 969 1;
BA_ "GenMsgCycleTime" BO_ 969 100;
BA_ "GenMsgCycleTimeFast" BO_ 969 0;
BA_ "GenMsgSendType" BO_ 969 0;
BA_ "VFrameFormat" BO_ 969 14;
BA_ "CANFD_BRS" BO_ 969 1;
BA_ "GenMsgCycleTime" BO_ 969 100;
BA_ "GenMsgCycleTimeFast" BO_ 969 0;
BA_ "GenMsgSendType" BO_ 969 0;
BA_ "VFrameFormat" BO_ 969 14;
BA_ "CANFD_BRS" BO_ 969 1;
BA_ "GenMsgCycleTime" BO_ 969 100;
BA_ "GenMsgCycleTimeFast" BO_ 969 0;
BA_ "GenMsgSendType" BO_ 969 0;
BA_ "VFrameFormat" BO_ 969 14;
BA_ "CANFD_BRS" BO_ 969 1;
BA_ "GenMsgCycleTime" BO_ 969 100;
BA_ "GenMsgCycleTimeFast" BO_ 969 0;
BA_ "GenMsgSendType" BO_ 969 0;
BA_ "VFrameFormat" BO_ 969 14;
BA_ "CANFD_BRS" BO_ 969 1;
BA_ "GenMsgCycleTime" BO_ 969 100;
BA_ "GenMsgCycleTimeFast" BO_ 969 0;
BA_ "GenMsgSendType" BO_ 969 0;
BA_ "VFrameFormat" BO_ 969 14;
BA_ "CANFD_BRS" BO_ 969 1;
BA_ "GenMsgCycleTime" BO_ 969 100;
BA_ "GenMsgCycleTimeFast" BO_ 969 0;
BA_ "GenMsgSendType" BO_ 969 0;
BA_ "VFrameFormat" BO_ 969 14;
BA_ "CANFD_BRS" BO_ 969 1;
BA_ "GenMsgCycleTime" BO_ 969 100;
BA_ "GenMsgCycleTimeFast" BO_ 969 0;
BA_ "GenMsgSendType" BO_ 969 0;
BA_ "VFrameFormat" BO_ 969 14;
BA_ "CANFD_BRS" BO_ 969 1;
BA_ "GenMsgCycleTime" BO_ 969 100;
BA_ "GenMsgCycleTimeFast" BO_ 969 0;
BA_ "GenMsgSendType" BO_ 969 0;
BA_ "VFrameFormat" BO_ 969 14;
BA_ "CANFD_BRS" BO_ 969 1;
BA_ "GenMsgCycleTime" BO_ 969 100;
BA_ "GenMsgCycleTimeFast" BO_ 969 0;
BA_ "GenMsgSendType" BO_ 969 0;
BA_ "VFrameFormat" BO_ 969 14;
BA_ "CANFD_BRS" BO_ 969 1;
BA_ "GenMsgCycleTime" BO_ 969 100;
BA_ "GenMsgCycleTimeFast" BO_ 969 0;
BA_ "GenMsgSendType" BO_ 969 0;
BA_ "VFrameFormat" BO_ 969 14;
BA_ "CANFD_BRS" BO_ 969 1;
BA_ "GenMsgCycleTime" BO_ 969 100;
BA_ "GenMsgCycleTimeFast" BO_ 969 0;
BA_ "GenMsgSendType" BO_ 969 0;
BA_ "VFrameFormat" BO_ 969 14;
BA_ "CANFD_BRS" BO_ 969 1;
BA_ "GenMsgCycleTime" BO_ 969 100;
BA_ "GenMsgCycleTimeFast" BO_ 969 0;
BA_ "GenMsgSendType" BO_ 969 0;
BA_ "VFrameFormat" BO_ 969 14;
BA_ "CANFD_BRS" BO_ 969 1;
BA_ "GenMsgCycleTime" BO_ 969 100;
BA_ "GenMsgCycleTimeFast" BO_ 969 0;
BA_ "GenMsgSendType" BO_ 969 0;
BA_ "VFrameFormat" BO_ 969 14;
BA_ "CANFD_BRS" BO_ 969 1;
BA_ "GenMsgCycleTime" BO_ 969 100;
BA_ "GenMsgCycleTimeFast" BO_ 969 0;
BA_ "GenMsgSendType" BO_ 969 0;
BA_ "VFrameFormat" BO_ 969 14;
BA_ "CANFD_BRS" BO_ 969 1;
BA_ "GenMsgCycleTime" BO_ 969 100;
BA_ "GenMsgCycleTimeFast" BO_ 969 0;
BA_ "GenMsgSendType" BO_ 969 0;
BA_ "VFrameFormat" BO_ 969 14;
BA_ "CANFD_BRS" BO_ 969 1;
BA_ "GenMsgCycleTime" BO_ 969 100;
BA_ "GenMsgCycleTimeFast" BO_ 969 0;
BA_ "GenMsgSendType" BO_ 969 0;
BA_ "VFrameFormat" BO_ 969 14;
BA_ "CANFD_BRS" BO_ 969 1;
BA_ "GenMsgCycleTime" BO_ 969 100;
BA_ "GenMsgCycleTimeFast" BO_ 969 0;
BA_ "GenMsgSendType" BO_ 969 0;
BA_ "VFrameFormat" BO_ 969 14;
BA_ "CANFD_BRS" BO_ 969 1;
BA_ "GenMsgCycleTime" BO_ 969 100;
BA_ "GenMsgCycleTimeFast" BO_ 969 0;
BA_ "GenMsgSendType" BO_ 969 0;
BA_ "VFrameFormat" BO_ 969 14;
BA_ "CANFD_BRS" BO_ 969 1;
BA_ "GenMsgCycleTime" BO_ 969 100;
BA_ "GenMsgCycleTimeFast" BO_ 969 0;
BA_ "GenMsgSendType" BO_ 969 0;
BA_ "VFrameFormat" BO_ 969 14;
BA_ "CANFD_BRS" BO_ 969 1;
BA_ "GenMsgCycleTime" BO_ 969 100;
BA_ "GenMsgCycleTimeFast" BO_ 969 0;
BA_ "GenMsgSendType" BO_ 969 0;
BA_ "VFrameFormat" BO_ 969 14;
BA_ "CANFD_BRS" BO_ 969 1;
BA_ "GenMsgCycleTime" BO_ 969 100;
BA_ "GenMsgCycleTimeFast" BO_ 969 0;
BA_ "GenMsgSendType" BO_ 969 0;
BA_ "VFrameFormat" BO_ 969 14;
BA_ "CANFD_BRS" BO_ 969 1;
BA_ "GenMsgCycleTime" BO_ 969 100;
BA_ "GenMsgCycleTimeFast" BO_ 969 0;
BA_ "GenMsgSendType" BO_ 969 0;
BA_ "VFrameFormat" BO_ 969 14;
BA_ "CANFD_BRS" BO_ 969 1;
BA_ "GenMsgCycleTime" BO_ 969 100;
BA_ "GenMsgCycleTimeFast" BO_ 969 0;
BA_ "GenMsgSendType" BO_ 969 0;
BA_ "VFrameFormat" BO_ 969 14;
BA_ "CANFD_BRS" BO_ 969 1;
BA_ "GenMsgCycleTime" BO_ 969 100;
BA_ "GenMsgCycleTimeFast" BO_ 969 0;
BA_ "GenMsgSendType" BO_ 969 0;
BA_ "VFrameFormat" BO_ 969 14;
BA_ "CANFD_BRS" BO_ 969 1;
BA_ "GenMsgCycleTime" BO_ 969 100;
BA_ "GenMsgCycleTimeFast" BO_ 969 0;
BA_ "GenMsgSendType" BO_ 969 0;
BA_ "VFrameFormat" BO_ 969 14;
BA_ "CANFD_BRS" BO_ 969 1;
BA_ "GenMsgCycleTime" BO_ 969 100;
BA_ "GenMsgCycleTimeFast" BO_ 969 0;
BA_ "GenMsgSendType" BO_ 969 0;
BA_ "VFrameFormat" BO_ 969 14;
BA_ "CANFD_BRS" BO_ 969 1;
BA_ "GenMsgCycleTime" BO_ 969 100;
BA_ "GenMsgCycleTimeFast" BO_ 969 0;
BA_ "GenMsgSendType" BO_ 969 0;
BA_ "VFrameFormat" BO_ 969 14;
BA_ "CANFD_BRS" BO_ 969 1;
BA_ "GenMsgCycleTime" BO_ 969 100;
BA_ "GenMsgCycleTimeFast" BO_ 969 0;
BA_ "GenMsgSendType" BO_ 969 0;
BA_ "VFrameFormat" BO_ 969 14;
BA_ "CANFD_BRS" BO_ 969 1;
BA_ "GenMsgCycleTime" BO_ 969 100;
BA_ "GenMsgCycleTimeFast" BO_ 969 0;
BA_ "GenMsgSendType" BO_ 969 0;
BA_ "VFrameFormat" BO_ 969 14;
BA_ "CANFD_BRS" BO_ 969 1;
BA_ "GenMsgCycleTime" BO_ 969 100;
BA_ "GenMsgCycleTimeFast" BO_ 969 0;
BA_ "GenMsgSendType" BO_ 969 0;
BA_ "VFrameFormat" BO_ 969 14;
BA_ "CANFD_BRS" BO_ 969 1;
BA_ "GenMsgCycleTime" BO_ 969 100;
BA_ "GenMsgCycleTimeFast" BO_ 969 0;
BA_ "GenMsgSendType" BO_ 969 0;
BA_ "VFrameFormat" BO_ 969 14;
BA_ "CANFD_BRS" BO_ 969 1;
BA_ "GenMsgCycleTime" BO_ 969 100;
BA_ "GenMsgCycleTimeFast" BO_ 969 0;
BA_ "GenMsgSendType" BO_ 969 0;
BA_ "VFrameFormat" BO_ 969 14;
BA_ "CANFD_BRS" BO_ 969 1;
BA_ "GenMsgCycleTime" BO_ 969 100;
BA_ "GenMsgCycleTimeFast" BO_ 969 0;
BA_ "GenMsgSendType" BO_ 969 0;
BA_ "VFrameFormat" BO_ 969 14;
BA_ "CANFD_BRS" BO_ 969 1;
BA_ "GenMsgCycleTime" BO_ 969 100;
BA_ "GenMsgCycleTimeFast" BO_ 969 0;
BA_ "GenMsgSendType" BO_ 969 0;
BA_ "VFrameFormat" BO_ 969 14;
BA_ "CANFD_BRS" BO_ 969 1;
BA_ "GenMsgCycleTime" BO_ 969 100;
BA_ "GenMsgCycleTimeFast" BO_ 969 0;
BA_ "GenMsgSendType" BO_ 969 0;
BA_ "VFrameFormat" BO_ 969 14;
BA_ "CANFD_BRS" BO_ 969 1;
BA_ "GenMsgCycleTime" BO_ 969 100;
BA_ "GenMsgCycleTimeFast" BO_ 969 0;
BA_ "GenMsgSendType" BO_ 969 0;
BA_ "VFrameFormat" BO_ 969 14;
BA_ "CANFD_BRS" BO_ 969 1;
BA_ "GenMsgCycleTime" BO_ 969 100;
BA_ "GenMsgCycleTimeFast" BO_ 969 0;
BA_ "GenMsgSendType" BO_ 969 0;
BA_ "VFrameFormat" BO_ 969 14;
BA_ "CANFD_BRS" BO_ 969 1;
BA_ "GenMsgCycleTime" BO_ 969 100;
BA_ "GenMsgCycleTimeFast" BO_ 969 0;
BA_ "GenMsgSendType" BO_ 969 0;
BA_ "VFrameFormat" BO_ 969 14;
BA_ "CANFD_BRS" BO_ 969 1;
BA_ "GenMsgCycleTime" BO_ 969 100;
BA_ "GenMsgCycleTimeFast" BO_ 969 0;
BA_ "GenMsgSendType" BO_ 969 0;
BA_ "VFrameFormat" BO_ 969 14;
BA_ "CANFD_BRS" BO_ 969 1;
BA_ "GenMsgCycleTime" BO_ 969 100;
BA_ "GenMsgCycleTimeFast" BO_ 969 0;
BA_ "GenMsgSendType" BO_ 969 0;
BA_ "VFrameFormat" BO_ 969 14;
BA_ "CANFD_BRS" BO_ 969 1;
BA_ "GenMsgCycleTime" BO_ 969 100;
BA_ "GenMsgCycleTimeFast" BO_ 969 0;
BA_ "GenMsgSendType" BO_ 969 0;
BA_ "VFrameFormat" BO_ 969 14;
BA_ "CANFD_BRS" BO_ 969 1;
BA_ "GenMsgCycleTime" BO_ 969 100;
BA_ "GenMsgCycleTimeFast" BO_ 969 0;
BA_ "GenMsgSendType" BO_ 969 0;
BA_ "VFrameFormat" BO_ 969 14;
BA_ "CANFD_BRS" BO_ 969 1;
BA_ "GenMsgCycleTime" BO_ 969 100;
BA_ "GenMsgCycleTimeFast" BO_ 969 0;
BA_ "GenMsgSendType" BO_ 969 0;
BA_ "VFrameFormat" BO_ 969 14;
BA_ "CANFD_BRS" BO_ 969 1;
BA_ "GenMsgCycleTime" BO_ 969 100;
BA_ "GenMsgCycleTimeFast" BO_ 969 0;
BA_ "GenMsgSendType" BO_ 969 0;
BA_ "VFrameFormat" BO_ 969 14;
BA_ "CANFD_BRS" BO_ 969 1;
BA_ "GenMsgCycleTime" BO_ 969 100;
BA_ "GenMsgCycleTimeFast" BO_ 969 0;
BA_ "GenMsgSendType" BO_ 969 0;
BA_ "VFrameFormat" BO_ 969 14;
BA_ "CANFD_BRS" BO_ 969 1;
BA_ "GenMsgCycleTime" BO_ 969 100;
BA_ "GenMsgCycleTimeFast" BO_ 969 0;
BA_ "GenMsgSendType" BO_ 969 0;
BA_ "VFrameFormat" BO_ 969 14;
BA_ "CANFD_BRS" BO_ 969 1;
BA_ "GenMsgCycleTime" BO_ 969 100;
BA_ "GenMsgCycleTimeFast" BO_ 969 0;
BA_ "GenMsgSendType" BO_ 969 0;
BA_ "VFrameFormat" BO_ 969 14;
BA_ "CANFD_BRS" BO_ 969 1;
BA_ "GenMsgCycleTime" BO_ 969 100;
BA_ "GenMsgCycleTimeFast" BO_ 969 0;
BA_ "GenMsgSendType" BO_ 969 0;
BA_ "VFrameFormat" BO_ 969 14;
BA_ "CANFD_BRS" BO_ 969 1;
BA_ "GenMsgCycleTime" BO_ 969 100;
BA_ "GenMsgCycleTimeFast" BO_ 969 0;
BA_ "GenMsgSendType" BO_ 969 0;
BA_ "VFrameFormat" BO_ 969 14;
BA_ "CANFD_BRS" BO_ 969 1;
BA_ "GenMsgCycleTime" BO_ 969 100;
BA_ "GenMsgCycleTimeFast" BO_ 969 0;
BA_ "GenMsgSendType" BO_ 969 0;
BA_ "VFrameFormat" BO_ 969 14;
BA_ "CANFD_BRS" BO_ 969 1;
BA_ "GenMsgCycleTime" BO_ 969 100;
BA_ "GenMsgCycleTimeFast" BO_ 969 0;
BA_ "GenMsgSendType" BO_ 969 0;
BA_ "VFrameFormat" BO_ 969 14;
BA_ "CANFD_BRS" BO_ 969 1;
BA_ "GenMsgCycleTime" BO_ 969 100;
BA_ "GenMsgCycleTimeFast" BO_ 969 0;
BA_ "GenMsgSendType" BO_ 969 0;
BA_ "VFrameFormat" BO_ 969 14;
BA_ "CANFD_BRS" BO_ 969 1;
BA_ "GenMsgCycleTime" BO_ 969 100;
BA_ "GenMsgCycleTimeFast" BO_ 969 0;
BA_ "GenMsgSendType" BO_ 969 0;
BA_ "VFrameFormat" BO_ 969 14;
BA_ "CANFD_BRS" BO_ 969 1;
BA_ "GenMsgCycleTime" BO_ 969 100;
BA_ "GenMsgCycleTimeFast" BO_ 969 0;
BA_ "GenMsgSendType" BO_ 969 0;
BA_ "VFrameFormat" BO_ 969 14;
BA_ "CANFD_BRS" BO_ 969 1;
BA_ "GenMsgCycleTime" BO_ 969 100;
BA_ "GenMsgCycleTimeFast" BO_ 969 0;
BA_ "GenMsgSendType" BO_ 969 0;
BA_ "VFrameFormat" BO_ 969 14;
BA_ "CANFD_BRS" BO_ 969 1;
BA_ "GenMsgCycleTime" BO_ 969 100;
BA_ "GenMsgCycleTimeFast" BO_ 969 0;
BA_ "GenMsgSendType" BO_ 969 0;
BA_ "VFrameFormat" BO_ 969 14;
BA_ "CANFD_BRS" BO_ 969 1;
BA_ "GenMsgCycleTime" BO_ 969 100;
BA_ "GenMsgCycleTimeFast" BO_ 969 0;
BA_ "GenMsgSendType" BO_ 969 0;
BA_ "VFrameFormat" BO_ 969 14;
BA_ "CANFD_BRS" BO_ 969 1;
BA_ "GenMsgCycleTime" BO_ 969 100;
BA_ "GenMsgCycleTimeFast" BO_ 969 0;
BA_ "GenMsgSendType" BO_ 969 0;
BA_ "VFrameFormat" BO_ 969 14;
BA_ "CANFD_BRS" BO_ 969 1;
BA_ "GenMsgCycleTime" BO_ 969 100;
BA_ "GenMsgCycleTimeFast" BO_ 969 0;
BA_ "GenMsgSendType" BO_ 969 0;
BA_ "VFrameFormat" BO_ 969 14;
BA_ "CANFD_BRS" BO_ 969 1;
BA_ "GenMsgCycleTime" BO_ 969 100;
BA_ "GenMsgCycleTimeFast" BO_ 969 0;
BA_ "GenMsgSendType" BO_ 969 0;
BA_ "VFrameFormat" BO_ 969 14;
BA_ "CANFD_BRS" BO_ 969 1;
BA_ "GenMsgCycleTime" BO_ 969 100;
BA_ "GenMsgCycleTimeFast" BO_ 969 0;
BA_ "GenMsgSendType" BO_ 969 0;
BA_ "VFrameFormat" BO_ 969 14;
BA_ "CANFD_BRS" BO_ 969 1;
BA_ "GenMsgCycleTime" BO_ 969 100;
BA_ "GenMsgCycleTimeFast" BO_ 969 0;
BA_ "GenMsgSendType" BO_ 969 0;
BA_ "VFrameFormat" BO_ 969 14;
BA_ "CANFD_BRS" BO_ 969 1;
BA_ "GenMsgCycleTime" BO_ 969 100;
BA_ "GenMsgCycleTimeFast" BO_ 969 0;
BA_ "GenMsgSendType" BO_ 969 0;
BA_ "VFrameFormat" BO_ 969 14;
BA_ "CANFD_BRS" BO_ 969 1;
BA_ "GenMsgCycleTime" BO_ 969 100;
BA_ "GenMsgCycleTimeFast" BO_ 969 0;
BA_ "GenMsgSendType" BO_ 969 0;
BA_ "VFrameFormat" BO_ 969 14;
BA_ "CANFD_BRS" BO_ 969 1;
BA_ "GenMsgCycleTime" BO_ 969 100;
BA_ "GenMsgCycleTimeFast" BO_ 969 0;
BA_ "GenMsgSendType" BO_ 969 0;
BA_ "VFrameFormat" BO_ 969 14;
BA_ "CANFD_BRS" BO_ 969 1;
BA_ "GenMsgCycleTime" BO_ 969 100;
BA_ "GenMsgCycleTimeFast" BO_ 969 0;
BA_ "GenMsgSendType" BO_ 969 0;
BA_ "VFrameFormat" BO_ 969 14;
BA_ "CANFD_BRS" BO_ 969 1;
BA_ "GenMsgCycleTime" BO_ 969 100;
BA_ "GenMsgCycleTimeFast" BO_ 969 0;
BA_ "GenMsgSendType" BO_ 969 0;
BA_ "VFrameFormat" BO_ 969 14;
BA_ "CANFD_BRS" BO_ 969 1;
BA_ "GenMsgCycleTime" BO_ 969 100;
BA_ "GenMsgCycleTimeFast" BO_ 969 0;
BA_ "GenMsgSendType" BO_ 969 0;
BA_ "VFrameFormat" BO_ 969 14;
BA_ "CANFD_BRS" BO_ 969 1;
BA_ "GenMsgCycleTime" BO_ 969 100;
BA_ "GenMsgCycleTimeFast" BO_ 969 0;
BA_ "GenMsgSendType" BO_ 969 0;
BA_ "VFrameFormat" BO_ 969 14;
BA_ "CANFD_BRS" BO_ 969 1;
BA_ "GenMsgCycleTime" BO_ 969 100;
BA_ "GenMsgCycleTimeFast" BO_ 969 0;
BA_ "GenMsgSendType" BO_ 969 0;
BA_ "VFrameFormat" BO_ 969 14;
BA_ "CANFD_BRS" BO_ 969 1;
BA_ "GenMsgCycleTime" BO_ 969 100;
BA_ "GenMsgCycleTimeFast" BO_ 969 0;
BA_ "GenMsgSendType" BO_ 969 0;
BA_ "VFrameFormat" BO_ 969 14;
BA_ "CANFD_BRS" BO_ 969 1;
BA_ "GenMsgCycleTime" BO_ 969 100;
BA_ "GenMsgCycleTimeFast" BO_ 969 0;
BA_ "GenMsgSendType" BO_ 969 0;
BA_ "VFrameFormat" BO_ 969 14;
BA_ "CANFD_BRS" BO_ 969 1;
BA_ "GenMsgCycleTime" BO_ 969 100;
BA_ "GenMsgCycleTimeFast" BO_ 969 0;
BA_ "GenMsgSendType" BO_ 969 0;
BA_ "VFrameFormat" BO_ 969 14;
BA_ "CANFD_BRS" BO_ 969 1;
BA_ "GenMsgCycleTime" BO_ 969 100;
BA_ "GenMsgCycleTimeFast" BO_ 969 0;
BA_ "GenMsgSendType" BO_ 969 0;
BA_ "VFrameFormat" BO_ 969 14;
BA_ "CANFD_BRS" BO_ 969 1;
BA_ "GenMsgCycleTime" BO_ 969 100;
BA_ "GenMsgCycleTimeFast" BO_ 969 0;
BA_ "GenMsgSendType" BO_ 969 0;
BA_ "VFrameFormat" BO_ 969 14;
BA_ "CANFD_BRS" BO_ 969 1;
BA_ "GenMsgCycleTime" BO_ 969 100;
BA_ "GenMsgCycleTimeFast" BO_ 969 0;
BA_ "GenMsgSendType" BO_ 969 0;
BA_ "VFrameFormat" BO_ 969 14;
BA_ "CANFD_BRS" BO_ 969 1;
BA_ "GenMsgCycleTime" BO_ 969 100;
BA_ "GenMsgCycleTimeFast" BO_ 969 0;
BA_ "GenMsgSendType" BO_ 969 0;
BA_ "VFrameFormat" BO_ 969 14;
BA_ "CANFD_BRS" BO_ 969 1;
BA_ "GenMsgCycleTime" BO_ 969 100;
BA_ "GenMsgCycleTimeFast" BO_ 969 0;
BA_ "GenMsgSendType" BO_ 969 0;
BA_ "VFrameFormat" BO_ 969 14;
BA_ "CANFD_BRS" BO_ 969 1;
BA_ "GenMsgCycleTime" BO_ 969 100;
BA_ "GenMsgCycleTimeFast" BO_ 969 0;
BA_ "GenMsgSendType" BO_ 969 0;
BA_ "VFrameFormat" BO_ 969 14;
BA_ "CANFD_BRS" BO_ 969 1;
BA_ "GenMsgCycleTime" BO_ 969 100;
BA_ "GenMsgCycleTimeFast" BO_ 969 0;
BA_ "GenMsgSendType" BO_ 969 0;
BA_ "VFrameFormat" BO_ 969 14;
BA_ "CANFD_BRS" BO_ 969 1;
BA_ "GenMsgCycleTime" BO_ 969 100;
BA_ "GenMsgCycleTimeFast" BO_ 969 0;
BA_ "GenMsgSendType" BO_ 969 0;
BA_ "VFrameFormat" BO_ 969 14;
BA_ "CANFD_BRS" BO_ 969 1;
BA_ "GenMsgCycleTime" BO_ 969 100;
BA_ "GenMsgCycleTimeFast" BO_ 969 0;
BA_ "GenMsgSendType" BO_ 969 0;
BA_ "VFrameFormat" BO_ 969 14;
BA_ "CANFD_BRS" BO_ 969 1;
BA_ "GenMsgCycleTime" BO_ 969 100;
BA_ "GenMsgCycleTimeFast" BO_ 969 0;
BA_ "GenMsgSendType" BO_ 969 0;
BA_ "VFrameFormat" BO_ 969 14;
BA_ "CANFD_BRS" BO_ 969 1;
BA_ "GenMsgCycleTime" BO_ 969 100;
BA_ "GenMsgCycleTimeFast" BO_ 969 0;
BA_ "GenMsgSendType" BO_ 969 0;
BA_ "VFrameFormat" BO_ 969 14;
BA_ "CANFD_BRS" BO_ 969 1;
BA_ "GenMsgCycleTime" BO_ 969 100;
BA_ "GenMsgCycleTimeFast" BO_ 969 0;
BA_ "GenMsgSendType" BO_ 969 0;
BA_ "VFrameFormat" BO_ 969 14;
BA_ "CANFD_BRS" BO_ 969 1;
BA_ "GenMsgCycleTime" BO_ 969 100;
BA_ "GenMsgCycleTimeFast" BO_ 969 0;
BA_ "GenMsgSendType" BO_ 969 0;
BA_ "VFrameFormat" BO_ 969 14;
BA_ "CANFD_BRS" BO_ 969 1;
BA_ "GenMsgCycleTime" BO_ 969 100;
BA_ "GenMsgCycleTimeFast" BO_ 969 0;
BA_ "GenMsgSendType" BO_ 969 0;
BA_ "VFrameFormat" BO_ 969 14;
BA_ "CANFD_BRS" BO_ 969 1;
BA_ "GenMsgCycleTime" BO_ 969 100;
BA_ "GenMsgCycleTimeFast" BO_ 969 0;
BA_ "GenMsgSendType" BO_ 969 0;
BA_ "VFrameFormat" BO_ 969 14;
BA_ "CANFD_BRS" BO_ 969 1;
BA_ "GenMsgCycleTime" BO_ 969 100;
BA_ "GenMsgCycleTimeFast" BO_ 969 0;
BA_ "GenMsgSendType" BO_ 969 0;
BA_ "VFrameFormat" BO_ 969 14;
BA_ "CANFD_BRS" BO_ 969 1;
BA_ "GenMsgCycleTime" BO_ 969 100;
BA_ "GenMsgCycleTimeFast" BO_ 969 0;
BA_ "GenMsgSendType" BO_ 969 0;
BA_ "VFrameFormat" BO_ 969 14;
BA_ "CANFD_BRS" BO_ 969 1;
BA_ "GenMsgCycleTime" BO_ 969 100;
BA_ "GenMsgCycleTimeFast" BO_ 969 0;
BA_ "GenMsgSendType" BO_ 969 0;
BA_ "VFrameFormat" BO_ 969 14;
BA_ "CANFD_BRS" BO_ 969 1;
BA_ "GenMsgCycleTime" BO_ 969 100;
BA_ "GenMsgCycleTimeFast" BO_ 969 0;
BA_ "GenMsgSendType" BO_ 969 0;
BA_ "VFrameFormat" BO_ 969 14;
BA_ "CANFD_BRS" BO_ 969 1;
BA_ "GenMsgCycleTime" BO_ 969 100;
BA_ "GenMsgCycleTimeFast" BO_ 969 0;
BA_ "GenMsgSendType" BO_ 969 0;
BA_ "VFrameFormat" BO_ 969 14;
BA_ "CANFD_BRS" BO_ 969 1;
BA_ "GenMsgCycleTime" BO_ 969 100;
BA_ "GenMsgCycleTimeFast" BO_ 969 0;
BA_ "GenMsgSendType" BO_ 969 0;
BA_ "VFrameFormat" BO_ 969 14;
BA_ "CANFD_BRS" BO_ 969 1;
BA_ "GenMsgCycleTime" BO_ 969 100;
BA_ "GenMsgCycleTimeFast" BO_ 969 0;
BA_ "GenMsgSendType" BO_ 969 0;
BA_ "VFrameFormat" BO_ 969 14;
BA_ "CANFD_BRS" BO_ 969 1;
BA_ "GenMsgCycleTime" BO_ 969 100;
BA_ "GenMsgCycleTimeFast" BO_ 969 0;
BA_ "GenMsgSendType" BO_ 969 0;
BA_ "VFrameFormat" BO_ 969 14;
BA_ "CANFD_BRS" BO_ 969 1;
BA_ "GenMsgCycleTime" BO_ 969 100;
BA_ "GenMsgCycleTimeFast" BO_ 969 0;
BA_ "GenMsgSendType" BO_ 969 0;
BA_ "VFrameFormat" BO_ 969 14;
BA_ "CANFD_BRS" BO_ 969 1;
BA_ "GenMsgCycleTime" BO_ 969 100;
BA_ "GenMsgCycleTimeFast" BO_ 969 0;
BA_ "GenMsgSendType" BO_ 969 0;
BA_ "VFrameFormat" BO_ 969 14;
BA_ "CANFD_BRS" BO_ 969 1;
BA_ "GenMsgCycleTime" BO_ 969 100;
BA_ "GenMsgCycleTimeFast" BO_ 969 0;
BA_ "GenMsgSendType" BO_ 969 0;
BA_ "VFrameFormat" BO_ 969 14;
BA_ "CANFD_BRS" BO_ 969 1;
BA_ "GenMsgCycleTime" BO_ 969 100;
BA_ "GenMsgCycleTimeFast" BO_ 969 0;
BA_ "GenMsgSendType" BO_ 969 0;
BA_ "VFrameFormat" BO_ 969 14;
BA_ "CANFD_BRS" BO_ 969 1;
BA_ "GenMsgCycleTime" BO_ 969 100;
BA_ "GenMsgCycleTimeFast" BO_ 969 0;
BA_ "GenMsgSendType" BO_ 969 0;
BA_ "VFrameFormat" BO_ 969 14;
BA_ "CANFD_BRS" BO_ 969 1;
BA_ "GenMsgCycleTime" BO_ 969 100;
BA_ "GenMsgCycleTimeFast" BO_ 969 0;
BA_ "GenMsgSendType" BO_ 969 0;
BA_ "VFrameFormat" BO_ 969 14;
BA_ "CANFD_BRS" BO_ 969 1;
BA_ "GenMsgCycleTime" BO_ 969 100;
BA_ "GenMsgCycleTimeFast" BO_ 969 0;
BA_ "GenMsgSendType" BO_ 969 0;
BA_ "VFrameFormat" BO_ 969 14;
BA_ "CANFD_BRS" BO_ 969 1;
BA_ "GenMsgCycleTime" BO_ 969 100;
BA_ "GenMsgCycleTimeFast" BO_ 969 0;
BA_ "GenMsgSendType" BO_ 969 0;
BA_ "VFrameFormat" BO_ 969 14;
BA_ "CANFD_BRS" BO_ 969 1;
BA_ "GenMsgCycleTime" BO_ 969 100;
BA_ "GenMsgCycleTimeFast" BO_ 969 0;
BA_ "GenMsgSendType" BO_ 969 0;
BA_ "VFrameFormat" BO_ 969 14;
BA_ "CANFD_BRS" BO_ 969 1;
BA_ "GenMsgCycleTime" BO_ 970 100;
BA_ "GenMsgCycleTimeFast" BO_ 970 0;
BA_ "GenMsgSendType" BO_ 970 0;
BA_ "VFrameFormat" BO_ 970 14;
BA_ "CANFD_BRS" BO_ 970 1;
BA_ "GenMsgCycleTime" BO_ 970 100;
BA_ "GenMsgCycleTimeFast" BO_ 970 0;
BA_ "GenMsgSendType" BO_ 970 0;
BA_ "VFrameFormat" BO_ 970 14;
BA_ "CANFD_BRS" BO_ 970 1;
BA_ "GenMsgCycleTime" BO_ 970 100;
BA_ "GenMsgCycleTimeFast" BO_ 970 0;
BA_ "GenMsgSendType" BO_ 970 0;
BA_ "VFrameFormat" BO_ 970 14;
BA_ "CANFD_BRS" BO_ 970 1;
BA_ "GenMsgCycleTime" BO_ 970 100;
BA_ "GenMsgCycleTimeFast" BO_ 970 0;
BA_ "GenMsgSendType" BO_ 970 0;
BA_ "VFrameFormat" BO_ 970 14;
BA_ "CANFD_BRS" BO_ 970 1;
BA_ "GenMsgCycleTime" BO_ 970 100;
BA_ "GenMsgCycleTimeFast" BO_ 970 0;
BA_ "GenMsgSendType" BO_ 970 0;
BA_ "VFrameFormat" BO_ 970 14;
BA_ "CANFD_BRS" BO_ 970 1;
BA_ "GenMsgCycleTime" BO_ 970 100;
BA_ "GenMsgCycleTimeFast" BO_ 970 0;
BA_ "GenMsgSendType" BO_ 970 0;
BA_ "VFrameFormat" BO_ 970 14;
BA_ "CANFD_BRS" BO_ 970 1;
BA_ "GenMsgCycleTime" BO_ 970 100;
BA_ "GenMsgCycleTimeFast" BO_ 970 0;
BA_ "GenMsgSendType" BO_ 970 0;
BA_ "VFrameFormat" BO_ 970 14;
BA_ "CANFD_BRS" BO_ 970 1;
BA_ "GenMsgCycleTime" BO_ 970 100;
BA_ "GenMsgCycleTimeFast" BO_ 970 0;
BA_ "GenMsgSendType" BO_ 970 0;
BA_ "VFrameFormat" BO_ 970 14;
BA_ "CANFD_BRS" BO_ 970 1;
BA_ "GenMsgCycleTime" BO_ 970 100;
BA_ "GenMsgCycleTimeFast" BO_ 970 0;
BA_ "GenMsgSendType" BO_ 970 0;
BA_ "VFrameFormat" BO_ 970 14;
BA_ "CANFD_BRS" BO_ 970 1;
BA_ "GenMsgCycleTime" BO_ 970 100;
BA_ "GenMsgCycleTimeFast" BO_ 970 0;
BA_ "GenMsgSendType" BO_ 970 0;
BA_ "VFrameFormat" BO_ 970 14;
BA_ "CANFD_BRS" BO_ 970 1;
BA_ "GenMsgCycleTime" BO_ 970 100;
BA_ "GenMsgCycleTimeFast" BO_ 970 0;
BA_ "GenMsgSendType" BO_ 970 0;
BA_ "VFrameFormat" BO_ 970 14;
BA_ "CANFD_BRS" BO_ 970 1;
BA_ "GenMsgCycleTime" BO_ 970 100;
BA_ "GenMsgCycleTimeFast" BO_ 970 0;
BA_ "GenMsgSendType" BO_ 970 0;
BA_ "VFrameFormat" BO_ 970 14;
BA_ "CANFD_BRS" BO_ 970 1;
BA_ "GenMsgCycleTime" BO_ 970 100;
BA_ "GenMsgCycleTimeFast" BO_ 970 0;
BA_ "GenMsgSendType" BO_ 970 0;
BA_ "VFrameFormat" BO_ 970 14;
BA_ "CANFD_BRS" BO_ 970 1;
BA_ "GenMsgCycleTime" BO_ 970 100;
BA_ "GenMsgCycleTimeFast" BO_ 970 0;
BA_ "GenMsgSendType" BO_ 970 0;
BA_ "VFrameFormat" BO_ 970 14;
BA_ "CANFD_BRS" BO_ 970 1;
BA_ "GenMsgCycleTime" BO_ 970 100;
BA_ "GenMsgCycleTimeFast" BO_ 970 0;
BA_ "GenMsgSendType" BO_ 970 0;
BA_ "VFrameFormat" BO_ 970 14;
BA_ "CANFD_BRS" BO_ 970 1;
BA_ "GenMsgCycleTime" BO_ 970 100;
BA_ "GenMsgCycleTimeFast" BO_ 970 0;
BA_ "GenMsgSendType" BO_ 970 0;
BA_ "VFrameFormat" BO_ 970 14;
BA_ "CANFD_BRS" BO_ 970 1;
BA_ "GenMsgCycleTime" BO_ 970 100;
BA_ "GenMsgCycleTimeFast" BO_ 970 0;
BA_ "GenMsgSendType" BO_ 970 0;
BA_ "VFrameFormat" BO_ 970 14;
BA_ "CANFD_BRS" BO_ 970 1;
BA_ "GenMsgCycleTime" BO_ 970 100;
BA_ "GenMsgCycleTimeFast" BO_ 970 0;
BA_ "GenMsgSendType" BO_ 970 0;
BA_ "VFrameFormat" BO_ 970 14;
BA_ "CANFD_BRS" BO_ 970 1;
BA_ "GenMsgCycleTime" BO_ 970 100;
BA_ "GenMsgCycleTimeFast" BO_ 970 0;
BA_ "GenMsgSendType" BO_ 970 0;
BA_ "VFrameFormat" BO_ 970 14;
BA_ "CANFD_BRS" BO_ 970 1;
BA_ "GenMsgCycleTime" BO_ 970 100;
BA_ "GenMsgCycleTimeFast" BO_ 970 0;
BA_ "GenMsgSendType" BO_ 970 0;
BA_ "VFrameFormat" BO_ 970 14;
BA_ "CANFD_BRS" BO_ 970 1;
BA_ "GenMsgCycleTime" BO_ 970 100;
BA_ "GenMsgCycleTimeFast" BO_ 970 0;
BA_ "GenMsgSendType" BO_ 970 0;
BA_ "VFrameFormat" BO_ 970 14;
BA_ "CANFD_BRS" BO_ 970 1;
BA_ "GenMsgCycleTime" BO_ 970 100;
BA_ "GenMsgCycleTimeFast" BO_ 970 0;
BA_ "GenMsgSendType" BO_ 970 0;
BA_ "VFrameFormat" BO_ 970 14;
BA_ "CANFD_BRS" BO_ 970 1;
BA_ "GenMsgCycleTime" BO_ 970 100;
BA_ "GenMsgCycleTimeFast" BO_ 970 0;
BA_ "GenMsgSendType" BO_ 970 0;
BA_ "VFrameFormat" BO_ 970 14;
BA_ "CANFD_BRS" BO_ 970 1;
BA_ "GenMsgCycleTime" BO_ 970 100;
BA_ "GenMsgCycleTimeFast" BO_ 970 0;
BA_ "GenMsgSendType" BO_ 970 0;
BA_ "VFrameFormat" BO_ 970 14;
BA_ "CANFD_BRS" BO_ 970 1;
BA_ "GenMsgCycleTime" BO_ 970 100;
BA_ "GenMsgCycleTimeFast" BO_ 970 0;
BA_ "GenMsgSendType" BO_ 970 0;
BA_ "VFrameFormat" BO_ 970 14;
BA_ "CANFD_BRS" BO_ 970 1;
BA_ "GenMsgCycleTime" BO_ 970 100;
BA_ "GenMsgCycleTimeFast" BO_ 970 0;
BA_ "GenMsgSendType" BO_ 970 0;
BA_ "VFrameFormat" BO_ 970 14;
BA_ "CANFD_BRS" BO_ 970 1;
BA_ "GenMsgCycleTime" BO_ 970 100;
BA_ "GenMsgCycleTimeFast" BO_ 970 0;
BA_ "GenMsgSendType" BO_ 970 0;
BA_ "VFrameFormat" BO_ 970 14;
BA_ "CANFD_BRS" BO_ 970 1;
BA_ "GenMsgCycleTime" BO_ 970 100;
BA_ "GenMsgCycleTimeFast" BO_ 970 0;
BA_ "GenMsgSendType" BO_ 970 0;
BA_ "VFrameFormat" BO_ 970 14;
BA_ "CANFD_BRS" BO_ 970 1;
BA_ "GenMsgCycleTime" BO_ 970 100;
BA_ "GenMsgCycleTimeFast" BO_ 970 0;
BA_ "GenMsgSendType" BO_ 970 0;
BA_ "VFrameFormat" BO_ 970 14;
BA_ "CANFD_BRS" BO_ 970 1;
BA_ "GenMsgCycleTime" BO_ 970 100;
BA_ "GenMsgCycleTimeFast" BO_ 970 0;
BA_ "GenMsgSendType" BO_ 970 0;
BA_ "VFrameFormat" BO_ 970 14;
BA_ "CANFD_BRS" BO_ 970 1;
BA_ "GenMsgCycleTime" BO_ 970 100;
BA_ "GenMsgCycleTimeFast" BO_ 970 0;
BA_ "GenMsgSendType" BO_ 970 0;
BA_ "VFrameFormat" BO_ 970 14;
BA_ "CANFD_BRS" BO_ 970 1;
BA_ "GenMsgCycleTime" BO_ 970 100;
BA_ "GenMsgCycleTimeFast" BO_ 970 0;
BA_ "GenMsgSendType" BO_ 970 0;
BA_ "VFrameFormat" BO_ 970 14;
BA_ "CANFD_BRS" BO_ 970 1;
BA_ "GenMsgCycleTime" BO_ 970 100;
BA_ "GenMsgCycleTimeFast" BO_ 970 0;
BA_ "GenMsgSendType" BO_ 970 0;
BA_ "VFrameFormat" BO_ 970 14;
BA_ "CANFD_BRS" BO_ 970 1;
BA_ "GenMsgCycleTime" BO_ 970 100;
BA_ "GenMsgCycleTimeFast" BO_ 970 0;
BA_ "GenMsgSendType" BO_ 970 0;
BA_ "VFrameFormat" BO_ 970 14;
BA_ "CANFD_BRS" BO_ 970 1;
BA_ "GenMsgCycleTime" BO_ 970 100;
BA_ "GenMsgCycleTimeFast" BO_ 970 0;
BA_ "GenMsgSendType" BO_ 970 0;
BA_ "VFrameFormat" BO_ 970 14;
BA_ "CANFD_BRS" BO_ 970 1;
BA_ "GenMsgCycleTime" BO_ 970 100;
BA_ "GenMsgCycleTimeFast" BO_ 970 0;
BA_ "GenMsgSendType" BO_ 970 0;
BA_ "VFrameFormat" BO_ 970 14;
BA_ "CANFD_BRS" BO_ 970 1;
BA_ "GenMsgCycleTime" BO_ 970 100;
BA_ "GenMsgCycleTimeFast" BO_ 970 0;
BA_ "GenMsgSendType" BO_ 970 0;
BA_ "VFrameFormat" BO_ 970 14;
BA_ "CANFD_BRS" BO_ 970 1;
BA_ "GenMsgCycleTime" BO_ 970 100;
BA_ "GenMsgCycleTimeFast" BO_ 970 0;
BA_ "GenMsgSendType" BO_ 970 0;
BA_ "VFrameFormat" BO_ 970 14;
BA_ "CANFD_BRS" BO_ 970 1;
BA_ "GenMsgCycleTime" BO_ 970 100;
BA_ "GenMsgCycleTimeFast" BO_ 970 0;
BA_ "GenMsgSendType" BO_ 970 0;
BA_ "VFrameFormat" BO_ 970 14;
BA_ "CANFD_BRS" BO_ 970 1;
BA_ "GenMsgCycleTime" BO_ 970 100;
BA_ "GenMsgCycleTimeFast" BO_ 970 0;
BA_ "GenMsgSendType" BO_ 970 0;
BA_ "VFrameFormat" BO_ 970 14;
BA_ "CANFD_BRS" BO_ 970 1;
BA_ "GenMsgCycleTime" BO_ 970 100;
BA_ "GenMsgCycleTimeFast" BO_ 970 0;
BA_ "GenMsgSendType" BO_ 970 0;
BA_ "VFrameFormat" BO_ 970 14;
BA_ "CANFD_BRS" BO_ 970 1;
BA_ "GenMsgCycleTime" BO_ 970 100;
BA_ "GenMsgCycleTimeFast" BO_ 970 0;
BA_ "GenMsgSendType" BO_ 970 0;
BA_ "VFrameFormat" BO_ 970 14;
BA_ "CANFD_BRS" BO_ 970 1;
BA_ "GenMsgCycleTime" BO_ 970 100;
BA_ "GenMsgCycleTimeFast" BO_ 970 0;
BA_ "GenMsgSendType" BO_ 970 0;
BA_ "VFrameFormat" BO_ 970 14;
BA_ "CANFD_BRS" BO_ 970 1;
BA_ "GenMsgCycleTime" BO_ 970 100;
BA_ "GenMsgCycleTimeFast" BO_ 970 0;
BA_ "GenMsgSendType" BO_ 970 0;
BA_ "VFrameFormat" BO_ 970 14;
BA_ "CANFD_BRS" BO_ 970 1;
BA_ "GenMsgCycleTime" BO_ 970 100;
BA_ "GenMsgCycleTimeFast" BO_ 970 0;
BA_ "GenMsgSendType" BO_ 970 0;
BA_ "VFrameFormat" BO_ 970 14;
BA_ "CANFD_BRS" BO_ 970 1;
BA_ "GenMsgCycleTime" BO_ 970 100;
BA_ "GenMsgCycleTimeFast" BO_ 970 0;
BA_ "GenMsgSendType" BO_ 970 0;
BA_ "VFrameFormat" BO_ 970 14;
BA_ "CANFD_BRS" BO_ 970 1;
BA_ "GenMsgCycleTime" BO_ 970 100;
BA_ "GenMsgCycleTimeFast" BO_ 970 0;
BA_ "GenMsgSendType" BO_ 970 0;
BA_ "VFrameFormat" BO_ 970 14;
BA_ "CANFD_BRS" BO_ 970 1;
BA_ "GenMsgCycleTime" BO_ 970 100;
BA_ "GenMsgCycleTimeFast" BO_ 970 0;
BA_ "GenMsgSendType" BO_ 970 0;
BA_ "VFrameFormat" BO_ 970 14;
BA_ "CANFD_BRS" BO_ 970 1;
BA_ "GenMsgCycleTime" BO_ 970 100;
BA_ "GenMsgCycleTimeFast" BO_ 970 0;
BA_ "GenMsgSendType" BO_ 970 0;
BA_ "VFrameFormat" BO_ 970 14;
BA_ "CANFD_BRS" BO_ 970 1;
BA_ "GenMsgCycleTime" BO_ 970 100;
BA_ "GenMsgCycleTimeFast" BO_ 970 0;
BA_ "GenMsgSendType" BO_ 970 0;
BA_ "VFrameFormat" BO_ 970 14;
BA_ "CANFD_BRS" BO_ 970 1;
BA_ "GenMsgCycleTime" BO_ 970 100;
BA_ "GenMsgCycleTimeFast" BO_ 970 0;
BA_ "GenMsgSendType" BO_ 970 0;
BA_ "VFrameFormat" BO_ 970 14;
BA_ "CANFD_BRS" BO_ 970 1;
BA_ "GenMsgCycleTime" BO_ 970 100;
BA_ "GenMsgCycleTimeFast" BO_ 970 0;
BA_ "GenMsgSendType" BO_ 970 0;
BA_ "VFrameFormat" BO_ 970 14;
BA_ "CANFD_BRS" BO_ 970 1;
BA_ "GenMsgCycleTime" BO_ 970 100;
BA_ "GenMsgCycleTimeFast" BO_ 970 0;
BA_ "GenMsgSendType" BO_ 970 0;
BA_ "VFrameFormat" BO_ 970 14;
BA_ "CANFD_BRS" BO_ 970 1;
BA_ "GenMsgCycleTime" BO_ 970 100;
BA_ "GenMsgCycleTimeFast" BO_ 970 0;
BA_ "GenMsgSendType" BO_ 970 0;
BA_ "VFrameFormat" BO_ 970 14;
BA_ "CANFD_BRS" BO_ 970 1;
BA_ "GenMsgCycleTime" BO_ 970 100;
BA_ "GenMsgCycleTimeFast" BO_ 970 0;
BA_ "GenMsgSendType" BO_ 970 0;
BA_ "VFrameFormat" BO_ 970 14;
BA_ "CANFD_BRS" BO_ 970 1;
BA_ "GenMsgCycleTime" BO_ 970 100;
BA_ "GenMsgCycleTimeFast" BO_ 970 0;
BA_ "GenMsgSendType" BO_ 970 0;
BA_ "VFrameFormat" BO_ 970 14;
BA_ "CANFD_BRS" BO_ 970 1;
BA_ "GenMsgCycleTime" BO_ 970 100;
BA_ "GenMsgCycleTimeFast" BO_ 970 0;
BA_ "GenMsgSendType" BO_ 970 0;
BA_ "VFrameFormat" BO_ 970 14;
BA_ "CANFD_BRS" BO_ 970 1;
BA_ "GenMsgCycleTime" BO_ 970 100;
BA_ "GenMsgCycleTimeFast" BO_ 970 0;
BA_ "GenMsgSendType" BO_ 970 0;
BA_ "VFrameFormat" BO_ 970 14;
BA_ "CANFD_BRS" BO_ 970 1;
BA_ "GenMsgCycleTime" BO_ 970 100;
BA_ "GenMsgCycleTimeFast" BO_ 970 0;
BA_ "GenMsgSendType" BO_ 970 0;
BA_ "VFrameFormat" BO_ 970 14;
BA_ "CANFD_BRS" BO_ 970 1;
BA_ "GenMsgCycleTime" BO_ 970 100;
BA_ "GenMsgCycleTimeFast" BO_ 970 0;
BA_ "GenMsgSendType" BO_ 970 0;
BA_ "VFrameFormat" BO_ 970 14;
BA_ "CANFD_BRS" BO_ 970 1;
BA_ "GenMsgCycleTime" BO_ 970 100;
BA_ "GenMsgCycleTimeFast" BO_ 970 0;
BA_ "GenMsgSendType" BO_ 970 0;
BA_ "VFrameFormat" BO_ 970 14;
BA_ "CANFD_BRS" BO_ 970 1;
BA_ "EventCommandSignal" SG_ 549 ADC_12_CRC 0;
BA_ "GatewayedSignals" SG_ 549 ADC_12_CRC 0;
BA_ "GenSigInactiveValue" SG_ 549 ADC_12_CRC 0;
BA_ "GenSigInvalidValue" SG_ 549 ADC_12_CRC 0;
BA_ "GenSigSendType" SG_ 549 ADC_12_CRC 1;
BA_ "GenSigStartValue" SG_ 549 ADC_12_CRC 0;
BA_ "GenSigTimeoutValue" SG_ 549 ADC_12_CRC 0;
BA_ "Remark" SG_ 549 ADC_12_CRC "";
BA_ "EventCommandSignal" SG_ 549 ADC_12_Counter 0;
BA_ "GatewayedSignals" SG_ 549 ADC_12_Counter 0;
BA_ "GenSigInactiveValue" SG_ 549 ADC_12_Counter 0;
BA_ "GenSigInvalidValue" SG_ 549 ADC_12_Counter 0;
BA_ "GenSigSendType" SG_ 549 ADC_12_Counter 1;
BA_ "GenSigStartValue" SG_ 549 ADC_12_Counter 0;
BA_ "GenSigTimeoutValue" SG_ 549 ADC_12_Counter 0;
BA_ "Remark" SG_ 549 ADC_12_Counter "";
BA_ "EventCommandSignal" SG_ 549 ADC_APAst 0;
BA_ "GatewayedSignals" SG_ 549 ADC_APAst 0;
BA_ "GenSigInactiveValue" SG_ 549 ADC_APAst 0;
BA_ "GenSigInvalidValue" SG_ 549 ADC_APAst 0;
BA_ "GenSigSendType" SG_ 549 ADC_APAst 1;
BA_ "GenSigStartValue" SG_ 549 ADC_APAst 0;
BA_ "GenSigTimeoutValue" SG_ 549 ADC_APAst 0;
BA_ "Remark" SG_ 549 ADC_APAst "";
BA_ "EventCommandSignal" SG_ 549 ADC_AVPst 0;
BA_ "GatewayedSignals" SG_ 549 ADC_AVPst 0;
BA_ "GenSigInactiveValue" SG_ 549 ADC_AVPst 0;
BA_ "GenSigInvalidValue" SG_ 549 ADC_AVPst 0;
BA_ "GenSigSendType" SG_ 549 ADC_AVPst 1;
BA_ "GenSigStartValue" SG_ 549 ADC_AVPst 0;
BA_ "GenSigTimeoutValue" SG_ 549 ADC_AVPst 0;
BA_ "Remark" SG_ 549 ADC_AVPst "";
BA_ "EventCommandSignal" SG_ 549 ADC_PAAFuncSt 0;
BA_ "GatewayedSignals" SG_ 549 ADC_PAAFuncSt 0;
BA_ "GenSigInactiveValue" SG_ 549 ADC_PAAFuncSt 0;
BA_ "GenSigInvalidValue" SG_ 549 ADC_PAAFuncSt 0;
BA_ "GenSigSendType" SG_ 549 ADC_PAAFuncSt 1;
BA_ "GenSigStartValue" SG_ 549 ADC_PAAFuncSt 0;
BA_ "GenSigTimeoutValue" SG_ 549 ADC_PAAFuncSt 0;
BA_ "Remark" SG_ 549 ADC_PAAFuncSt "";
BA_ "EventCommandSignal" SG_ 549 ADC_PAAVoiceReminder 0;
BA_ "GatewayedSignals" SG_ 549 ADC_PAAVoiceReminder 0;
BA_ "GenSigInactiveValue" SG_ 549 ADC_PAAVoiceReminder 0;
BA_ "GenSigInvalidValue" SG_ 549 ADC_PAAVoiceReminder 0;
BA_ "GenSigSendType" SG_ 549 ADC_PAAVoiceReminder 1;
BA_ "GenSigStartValue" SG_ 549 ADC_PAAVoiceReminder 0;
BA_ "GenSigTimeoutValue" SG_ 549 ADC_PAAVoiceReminder 0;
BA_ "Remark" SG_ 549 ADC_PAAVoiceReminder "";
BA_ "EventCommandSignal" SG_ 549 ADC_PAAVRSwitchFailSt 0;
BA_ "GatewayedSignals" SG_ 549 ADC_PAAVRSwitchFailSt 0;
BA_ "GenSigInactiveValue" SG_ 549 ADC_PAAVRSwitchFailSt 0;
BA_ "GenSigInvalidValue" SG_ 549 ADC_PAAVRSwitchFailSt 0;
BA_ "GenSigSendType" SG_ 549 ADC_PAAVRSwitchFailSt 1;
BA_ "GenSigStartValue" SG_ 549 ADC_PAAVRSwitchFailSt 0;
BA_ "GenSigTimeoutValue" SG_ 549 ADC_PAAVRSwitchFailSt 0;
BA_ "Remark" SG_ 549 ADC_PAAVRSwitchFailSt "";
BA_ "EventCommandSignal" SG_ 549 ADC_APKDisplayReq 0;
BA_ "GatewayedSignals" SG_ 549 ADC_APKDisplayReq 0;
BA_ "GenSigInactiveValue" SG_ 549 ADC_APKDisplayReq 0;
BA_ "GenSigInvalidValue" SG_ 549 ADC_APKDisplayReq 0;
BA_ "GenSigSendType" SG_ 549 ADC_APKDisplayReq 1;
BA_ "GenSigStartValue" SG_ 549 ADC_APKDisplayReq 0;
BA_ "GenSigTimeoutValue" SG_ 549 ADC_APKDisplayReq 0;
BA_ "Remark" SG_ 549 ADC_APKDisplayReq "";
BA_ "EventCommandSignal" SG_ 549 ADC_APAActFuncInd 0;
BA_ "GatewayedSignals" SG_ 549 ADC_APAActFuncInd 0;
BA_ "GenSigInactiveValue" SG_ 549 ADC_APAActFuncInd 0;
BA_ "GenSigInvalidValue" SG_ 549 ADC_APAActFuncInd 0;
BA_ "GenSigSendType" SG_ 549 ADC_APAActFuncInd 1;
BA_ "GenSigStartValue" SG_ 549 ADC_APAActFuncInd 0;
BA_ "GenSigTimeoutValue" SG_ 549 ADC_APAActFuncInd 0;
BA_ "Remark" SG_ 549 ADC_APAActFuncInd "";
BA_ "EventCommandSignal" SG_ 549 ADC_APABackParkDisplayReq 0;
BA_ "GatewayedSignals" SG_ 549 ADC_APABackParkDisplayReq 0;
BA_ "GenSigInactiveValue" SG_ 549 ADC_APABackParkDisplayReq 0;
BA_ "GenSigInvalidValue" SG_ 549 ADC_APABackParkDisplayReq 0;
BA_ "GenSigSendType" SG_ 549 ADC_APABackParkDisplayReq 1;
BA_ "GenSigStartValue" SG_ 549 ADC_APABackParkDisplayReq 0;
BA_ "GenSigTimeoutValue" SG_ 549 ADC_APABackParkDisplayReq 0;
BA_ "Remark" SG_ 549 ADC_APABackParkDisplayReq "";
BA_ "EventCommandSignal" SG_ 549 ADC_VCU_Gearshiftprompt 0;
BA_ "GatewayedSignals" SG_ 549 ADC_VCU_Gearshiftprompt 0;
BA_ "GenSigInactiveValue" SG_ 549 ADC_VCU_Gearshiftprompt 0;
BA_ "GenSigInvalidValue" SG_ 549 ADC_VCU_Gearshiftprompt 0;
BA_ "GenSigSendType" SG_ 549 ADC_VCU_Gearshiftprompt 1;
BA_ "GenSigStartValue" SG_ 549 ADC_VCU_Gearshiftprompt 0;
BA_ "GenSigTimeoutValue" SG_ 549 ADC_VCU_Gearshiftprompt 0;
BA_ "Remark" SG_ 549 ADC_VCU_Gearshiftprompt "";
BA_ "EventCommandSignal" SG_ 549 ADC_AVPActFuncind 0;
BA_ "GatewayedSignals" SG_ 549 ADC_AVPActFuncind 0;
BA_ "GenSigInactiveValue" SG_ 549 ADC_AVPActFuncind 0;
BA_ "GenSigInvalidValue" SG_ 549 ADC_AVPActFuncind 0;
BA_ "GenSigSendType" SG_ 549 ADC_AVPActFuncind 1;
BA_ "GenSigStartValue" SG_ 549 ADC_AVPActFuncind 0;
BA_ "GenSigTimeoutValue" SG_ 549 ADC_AVPActFuncind 0;
BA_ "Remark" SG_ 549 ADC_AVPActFuncind "";
BA_ "EventCommandSignal" SG_ 549 ADC_APAMessagePushSt 0;
BA_ "GatewayedSignals" SG_ 549 ADC_APAMessagePushSt 0;
BA_ "GenSigInactiveValue" SG_ 549 ADC_APAMessagePushSt 0;
BA_ "GenSigInvalidValue" SG_ 549 ADC_APAMessagePushSt 0;
BA_ "GenSigSendType" SG_ 549 ADC_APAMessagePushSt 1;
BA_ "GenSigStartValue" SG_ 549 ADC_APAMessagePushSt 0;
BA_ "GenSigTimeoutValue" SG_ 549 ADC_APAMessagePushSt 0;
BA_ "Remark" SG_ 549 ADC_APAMessagePushSt "";
BA_ "EventCommandSignal" SG_ 549 ADC_HPAMessagePushSt 0;
BA_ "GatewayedSignals" SG_ 549 ADC_HPAMessagePushSt 0;
BA_ "GenSigInactiveValue" SG_ 549 ADC_HPAMessagePushSt 0;
BA_ "GenSigInvalidValue" SG_ 549 ADC_HPAMessagePushSt 0;
BA_ "GenSigSendType" SG_ 549 ADC_HPAMessagePushSt 1;
BA_ "GenSigStartValue" SG_ 549 ADC_HPAMessagePushSt 0;
BA_ "GenSigTimeoutValue" SG_ 549 ADC_HPAMessagePushSt 0;
BA_ "Remark" SG_ 549 ADC_HPAMessagePushSt "";
BA_ "EventCommandSignal" SG_ 549 ADC_PedWarnToneCtrl 0;
BA_ "GatewayedSignals" SG_ 549 ADC_PedWarnToneCtrl 0;
BA_ "GenSigInactiveValue" SG_ 549 ADC_PedWarnToneCtrl 0;
BA_ "GenSigInvalidValue" SG_ 549 ADC_PedWarnToneCtrl 0;
BA_ "GenSigSendType" SG_ 549 ADC_PedWarnToneCtrl 1;
BA_ "GenSigStartValue" SG_ 549 ADC_PedWarnToneCtrl 0;
BA_ "GenSigTimeoutValue" SG_ 549 ADC_PedWarnToneCtrl 0;
BA_ "Remark" SG_ 549 ADC_PedWarnToneCtrl "";
BA_ "EventCommandSignal" SG_ 549 ADC_AVPMessagePushSt 0;
BA_ "GatewayedSignals" SG_ 549 ADC_AVPMessagePushSt 0;
BA_ "GenSigInactiveValue" SG_ 549 ADC_AVPMessagePushSt 0;
BA_ "GenSigInvalidValue" SG_ 549 ADC_AVPMessagePushSt 0;
BA_ "GenSigSendType" SG_ 549 ADC_AVPMessagePushSt 1;
BA_ "GenSigStartValue" SG_ 549 ADC_AVPMessagePushSt 0;
BA_ "GenSigTimeoutValue" SG_ 549 ADC_AVPMessagePushSt 0;
BA_ "Remark" SG_ 549 ADC_AVPMessagePushSt "";
BA_ "EventCommandSignal" SG_ 549 ADC_PAADrvInteraction 0;
BA_ "GatewayedSignals" SG_ 549 ADC_PAADrvInteraction 0;
BA_ "GenSigInactiveValue" SG_ 549 ADC_PAADrvInteraction 0;
BA_ "GenSigInvalidValue" SG_ 549 ADC_PAADrvInteraction 0;
BA_ "GenSigSendType" SG_ 549 ADC_PAADrvInteraction 1;
BA_ "GenSigStartValue" SG_ 549 ADC_PAADrvInteraction 0;
BA_ "GenSigTimeoutValue" SG_ 549 ADC_PAADrvInteraction 0;
BA_ "Remark" SG_ 549 ADC_PAADrvInteraction "";
BA_ "EventCommandSignal" SG_ 549 ADC_PAARemoteParkingMode 0;
BA_ "GatewayedSignals" SG_ 549 ADC_PAARemoteParkingMode 0;
BA_ "GenSigInactiveValue" SG_ 549 ADC_PAARemoteParkingMode 0;
BA_ "GenSigInvalidValue" SG_ 549 ADC_PAARemoteParkingMode 0;
BA_ "GenSigSendType" SG_ 549 ADC_PAARemoteParkingMode 1;
BA_ "GenSigStartValue" SG_ 549 ADC_PAARemoteParkingMode 0;
BA_ "GenSigTimeoutValue" SG_ 549 ADC_PAARemoteParkingMode 0;
BA_ "Remark" SG_ 549 ADC_PAARemoteParkingMode "";
BA_ "EventCommandSignal" SG_ 549 ADC_PAARemoteParkingEnable 0;
BA_ "GatewayedSignals" SG_ 549 ADC_PAARemoteParkingEnable 0;
BA_ "GenSigInactiveValue" SG_ 549 ADC_PAARemoteParkingEnable 0;
BA_ "GenSigInvalidValue" SG_ 549 ADC_PAARemoteParkingEnable 0;
BA_ "GenSigSendType" SG_ 549 ADC_PAARemoteParkingEnable 1;
BA_ "GenSigStartValue" SG_ 549 ADC_PAARemoteParkingEnable 0;
BA_ "GenSigTimeoutValue" SG_ 549 ADC_PAARemoteParkingEnable 0;
BA_ "Remark" SG_ 549 ADC_PAARemoteParkingEnable "";
BA_ "EventCommandSignal" SG_ 549 ADC_LocalToBeDRVReq 0;
BA_ "GatewayedSignals" SG_ 549 ADC_LocalToBeDRVReq 0;
BA_ "GenSigInactiveValue" SG_ 549 ADC_LocalToBeDRVReq 0;
BA_ "GenSigInvalidValue" SG_ 549 ADC_LocalToBeDRVReq 0;
BA_ "GenSigSendType" SG_ 549 ADC_LocalToBeDRVReq 1;
BA_ "GenSigStartValue" SG_ 549 ADC_LocalToBeDRVReq 0;
BA_ "GenSigTimeoutValue" SG_ 549 ADC_LocalToBeDRVReq 0;
BA_ "Remark" SG_ 549 ADC_LocalToBeDRVReq "";
BA_ "EventCommandSignal" SG_ 549 ADC_UsageModeStAscendReq 0;
BA_ "GatewayedSignals" SG_ 549 ADC_UsageModeStAscendReq 0;
BA_ "GenSigInactiveValue" SG_ 549 ADC_UsageModeStAscendReq 0;
BA_ "GenSigInvalidValue" SG_ 549 ADC_UsageModeStAscendReq 0;
BA_ "GenSigSendType" SG_ 549 ADC_UsageModeStAscendReq 1;
BA_ "GenSigStartValue" SG_ 549 ADC_UsageModeStAscendReq 0;
BA_ "GenSigTimeoutValue" SG_ 549 ADC_UsageModeStAscendReq 0;
BA_ "Remark" SG_ 549 ADC_UsageModeStAscendReq "";
BA_ "EventCommandSignal" SG_ 549 ADC_UsageModeStDescendReq 0;
BA_ "GatewayedSignals" SG_ 549 ADC_UsageModeStDescendReq 0;
BA_ "GenSigInactiveValue" SG_ 549 ADC_UsageModeStDescendReq 0;
BA_ "GenSigInvalidValue" SG_ 549 ADC_UsageModeStDescendReq 0;
BA_ "GenSigSendType" SG_ 549 ADC_UsageModeStDescendReq 1;
BA_ "GenSigStartValue" SG_ 549 ADC_UsageModeStDescendReq 0;
BA_ "GenSigTimeoutValue" SG_ 549 ADC_UsageModeStDescendReq 0;
BA_ "Remark" SG_ 549 ADC_UsageModeStDescendReq "";
BA_ "EventCommandSignal" SG_ 549 ADC_PAAIGCInhibitSt 0;
BA_ "GatewayedSignals" SG_ 549 ADC_PAAIGCInhibitSt 0;
BA_ "GenSigInactiveValue" SG_ 549 ADC_PAAIGCInhibitSt 0;
BA_ "GenSigInvalidValue" SG_ 549 ADC_PAAIGCInhibitSt 0;
BA_ "GenSigSendType" SG_ 549 ADC_PAAIGCInhibitSt 1;
BA_ "GenSigStartValue" SG_ 549 ADC_PAAIGCInhibitSt 0;
BA_ "GenSigTimeoutValue" SG_ 549 ADC_PAAIGCInhibitSt 0;
BA_ "Remark" SG_ 549 ADC_PAAIGCInhibitSt "";
BA_ "EventCommandSignal" SG_ 549 ADC_PAAEDKFunInhibitReq 0;
BA_ "GatewayedSignals" SG_ 549 ADC_PAAEDKFunInhibitReq 0;
BA_ "GenSigInactiveValue" SG_ 549 ADC_PAAEDKFunInhibitReq 0;
BA_ "GenSigInvalidValue" SG_ 549 ADC_PAAEDKFunInhibitReq 0;
BA_ "GenSigSendType" SG_ 549 ADC_PAAEDKFunInhibitReq 1;
BA_ "GenSigStartValue" SG_ 549 ADC_PAAEDKFunInhibitReq 0;
BA_ "GenSigTimeoutValue" SG_ 549 ADC_PAAEDKFunInhibitReq 0;
BA_ "Remark" SG_ 549 ADC_PAAEDKFunInhibitReq "";
BA_ "EventCommandSignal" SG_ 549 ADC_PAARespondMode 0;
BA_ "GatewayedSignals" SG_ 549 ADC_PAARespondMode 0;
BA_ "GenSigInactiveValue" SG_ 549 ADC_PAARespondMode 0;
BA_ "GenSigInvalidValue" SG_ 549 ADC_PAARespondMode 0;
BA_ "GenSigSendType" SG_ 549 ADC_PAARespondMode 1;
BA_ "GenSigStartValue" SG_ 549 ADC_PAARespondMode 0;
BA_ "GenSigTimeoutValue" SG_ 549 ADC_PAARespondMode 0;
BA_ "Remark" SG_ 549 ADC_PAARespondMode "";
BA_ "EventCommandSignal" SG_ 549 ADC_UsageModeStHold 0;
BA_ "GatewayedSignals" SG_ 549 ADC_UsageModeStHold 0;
BA_ "GenSigInactiveValue" SG_ 549 ADC_UsageModeStHold 0;
BA_ "GenSigInvalidValue" SG_ 549 ADC_UsageModeStHold 0;
BA_ "GenSigSendType" SG_ 549 ADC_UsageModeStHold 1;
BA_ "GenSigStartValue" SG_ 549 ADC_UsageModeStHold 0;
BA_ "GenSigTimeoutValue" SG_ 549 ADC_UsageModeStHold 0;
BA_ "Remark" SG_ 549 ADC_UsageModeStHold "";
BA_ "EventCommandSignal" SG_ 549 ADC_PAAToNDAReq 0;
BA_ "GatewayedSignals" SG_ 549 ADC_PAAToNDAReq 0;
BA_ "GenSigInactiveValue" SG_ 549 ADC_PAAToNDAReq 0;
BA_ "GenSigInvalidValue" SG_ 549 ADC_PAAToNDAReq 0;
BA_ "GenSigSendType" SG_ 549 ADC_PAAToNDAReq 1;
BA_ "GenSigStartValue" SG_ 549 ADC_PAAToNDAReq 0;
BA_ "GenSigTimeoutValue" SG_ 549 ADC_PAAToNDAReq 0;
BA_ "Remark" SG_ 549 ADC_PAAToNDAReq "";
BA_ "EventCommandSignal" SG_ 549 ADC_DriverPresentSt 0;
BA_ "GatewayedSignals" SG_ 549 ADC_DriverPresentSt 0;
BA_ "GenSigInactiveValue" SG_ 549 ADC_DriverPresentSt 0;
BA_ "GenSigInvalidValue" SG_ 549 ADC_DriverPresentSt 0;
BA_ "GenSigSendType" SG_ 549 ADC_DriverPresentSt 1;
BA_ "GenSigStartValue" SG_ 549 ADC_DriverPresentSt 0;
BA_ "GenSigTimeoutValue" SG_ 549 ADC_DriverPresentSt 0;
BA_ "Remark" SG_ 549 ADC_DriverPresentSt "";
BA_ "EventCommandSignal" SG_ 549 ADC_RAEBWorkSts 0;
BA_ "GatewayedSignals" SG_ 549 ADC_RAEBWorkSts 0;
BA_ "GenSigInactiveValue" SG_ 549 ADC_RAEBWorkSts 0;
BA_ "GenSigInvalidValue" SG_ 549 ADC_RAEBWorkSts 0;
BA_ "GenSigSendType" SG_ 549 ADC_RAEBWorkSts 1;
BA_ "GenSigStartValue" SG_ 549 ADC_RAEBWorkSts 0;
BA_ "GenSigTimeoutValue" SG_ 549 ADC_RAEBWorkSts 0;
BA_ "Remark" SG_ 549 ADC_RAEBWorkSts "";
BA_ "EventCommandSignal" SG_ 549 ADC_UsageModeStHoldVD 0;
BA_ "GatewayedSignals" SG_ 549 ADC_UsageModeStHoldVD 0;
BA_ "GenSigInactiveValue" SG_ 549 ADC_UsageModeStHoldVD 0;
BA_ "GenSigInvalidValue" SG_ 549 ADC_UsageModeStHoldVD 0;
BA_ "GenSigSendType" SG_ 549 ADC_UsageModeStHoldVD 1;
BA_ "GenSigStartValue" SG_ 549 ADC_UsageModeStHoldVD 0;
BA_ "GenSigTimeoutValue" SG_ 549 ADC_UsageModeStHoldVD 0;
BA_ "Remark" SG_ 549 ADC_UsageModeStHoldVD "";
BA_ "EventCommandSignal" SG_ 549 ADC_RAEBEmgyBrkReq 0;
BA_ "GatewayedSignals" SG_ 549 ADC_RAEBEmgyBrkReq 0;
BA_ "GenSigInactiveValue" SG_ 549 ADC_RAEBEmgyBrkReq 0;
BA_ "GenSigInvalidValue" SG_ 549 ADC_RAEBEmgyBrkReq 0;
BA_ "GenSigSendType" SG_ 549 ADC_RAEBEmgyBrkReq 1;
BA_ "GenSigStartValue" SG_ 549 ADC_RAEBEmgyBrkReq 0;
BA_ "GenSigTimeoutValue" SG_ 549 ADC_RAEBEmgyBrkReq 0;
BA_ "Remark" SG_ 549 ADC_RAEBEmgyBrkReq "";
BA_ "EventCommandSignal" SG_ 549 ADC_RAEBTarAccel 0;
BA_ "GatewayedSignals" SG_ 549 ADC_RAEBTarAccel 0;
BA_ "GenSigInactiveValue" SG_ 549 ADC_RAEBTarAccel 0;
BA_ "GenSigInvalidValue" SG_ 549 ADC_RAEBTarAccel 0;
BA_ "GenSigSendType" SG_ 549 ADC_RAEBTarAccel 1;
BA_ "GenSigStartValue" SG_ 549 ADC_RAEBTarAccel 0;
BA_ "GenSigTimeoutValue" SG_ 549 ADC_RAEBTarAccel 0;
BA_ "Remark" SG_ 549 ADC_RAEBTarAccel "";
BA_ "EventCommandSignal" SG_ 549 ADC_PAADrvReq 0;
BA_ "GatewayedSignals" SG_ 549 ADC_PAADrvReq 0;
BA_ "GenSigInactiveValue" SG_ 549 ADC_PAADrvReq 0;
BA_ "GenSigInvalidValue" SG_ 549 ADC_PAADrvReq 0;
BA_ "GenSigSendType" SG_ 549 ADC_PAADrvReq 1;
BA_ "GenSigStartValue" SG_ 549 ADC_PAADrvReq 0;
BA_ "GenSigTimeoutValue" SG_ 549 ADC_PAADrvReq 0;
BA_ "Remark" SG_ 549 ADC_PAADrvReq "";
BA_ "EventCommandSignal" SG_ 549 ADC_PAAQuitInd 0;
BA_ "GatewayedSignals" SG_ 549 ADC_PAAQuitInd 0;
BA_ "GenSigInactiveValue" SG_ 549 ADC_PAAQuitInd 0;
BA_ "GenSigInvalidValue" SG_ 549 ADC_PAAQuitInd 0;
BA_ "GenSigSendType" SG_ 549 ADC_PAAQuitInd 1;
BA_ "GenSigStartValue" SG_ 549 ADC_PAAQuitInd 0;
BA_ "GenSigTimeoutValue" SG_ 549 ADC_PAAQuitInd 0;
BA_ "Remark" SG_ 549 ADC_PAAQuitInd "";
BA_ "EventCommandSignal" SG_ 549 ADC_PAARecInd 0;
BA_ "GatewayedSignals" SG_ 549 ADC_PAARecInd 0;
BA_ "GenSigInactiveValue" SG_ 549 ADC_PAARecInd 0;
BA_ "GenSigInvalidValue" SG_ 549 ADC_PAARecInd 0;
BA_ "GenSigSendType" SG_ 549 ADC_PAARecInd 1;
BA_ "GenSigStartValue" SG_ 549 ADC_PAARecInd 0;
BA_ "GenSigTimeoutValue" SG_ 549 ADC_PAARecInd 0;
BA_ "Remark" SG_ 549 ADC_PAARecInd "";
BA_ "EventCommandSignal" SG_ 549 ADC_NSAMessagePushSt 0;
BA_ "GatewayedSignals" SG_ 549 ADC_NSAMessagePushSt 0;
BA_ "GenSigInactiveValue" SG_ 549 ADC_NSAMessagePushSt 0;
BA_ "GenSigInvalidValue" SG_ 549 ADC_NSAMessagePushSt 0;
BA_ "GenSigSendType" SG_ 549 ADC_NSAMessagePushSt 1;
BA_ "GenSigStartValue" SG_ 549 ADC_NSAMessagePushSt 0;
BA_ "GenSigTimeoutValue" SG_ 549 ADC_NSAMessagePushSt 0;
BA_ "Remark" SG_ 549 ADC_NSAMessagePushSt "";
BA_ "EventCommandSignal" SG_ 549 ADC_NSASt 0;
BA_ "GatewayedSignals" SG_ 549 ADC_NSASt 0;
BA_ "GenSigInactiveValue" SG_ 549 ADC_NSASt 0;
BA_ "GenSigInvalidValue" SG_ 549 ADC_NSASt 0;
BA_ "GenSigSendType" SG_ 549 ADC_NSASt 1;
BA_ "GenSigStartValue" SG_ 549 ADC_NSASt 0;
BA_ "GenSigTimeoutValue" SG_ 549 ADC_NSASt 0;
BA_ "Remark" SG_ 549 ADC_NSASt "";
BA_ "EventCommandSignal" SG_ 549 ADC_RA_RemainDist 0;
BA_ "GatewayedSignals" SG_ 549 ADC_RA_RemainDist 0;
BA_ "GenSigInactiveValue" SG_ 549 ADC_RA_RemainDist 0;
BA_ "GenSigInvalidValue" SG_ 549 ADC_RA_RemainDist 0;
BA_ "GenSigSendType" SG_ 549 ADC_RA_RemainDist 1;
BA_ "GenSigStartValue" SG_ 549 ADC_RA_RemainDist 0;
BA_ "GenSigTimeoutValue" SG_ 549 ADC_RA_RemainDist 0;
BA_ "Remark" SG_ 549 ADC_RA_RemainDist "";
BA_ "EventCommandSignal" SG_ 549 ADC_Rast 0;
BA_ "GatewayedSignals" SG_ 549 ADC_Rast 0;
BA_ "GenSigInactiveValue" SG_ 549 ADC_Rast 0;
BA_ "GenSigInvalidValue" SG_ 549 ADC_Rast 0;
BA_ "GenSigSendType" SG_ 549 ADC_Rast 1;
BA_ "GenSigStartValue" SG_ 549 ADC_Rast 0;
BA_ "GenSigTimeoutValue" SG_ 549 ADC_Rast 0;
BA_ "Remark" SG_ 549 ADC_Rast "";
BA_ "EventCommandSignal" SG_ 549 ADC_RAButtonPress 0;
BA_ "GatewayedSignals" SG_ 549 ADC_RAButtonPress 0;
BA_ "GenSigInactiveValue" SG_ 549 ADC_RAButtonPress 0;
BA_ "GenSigInvalidValue" SG_ 549 ADC_RAButtonPress 0;
BA_ "GenSigSendType" SG_ 549 ADC_RAButtonPress 1;
BA_ "GenSigStartValue" SG_ 549 ADC_RAButtonPress 0;
BA_ "GenSigTimeoutValue" SG_ 549 ADC_RAButtonPress 0;
BA_ "Remark" SG_ 549 ADC_RAButtonPress "";
BA_ "EventCommandSignal" SG_ 549 ADC_AuthPassSt 0;
BA_ "GatewayedSignals" SG_ 549 ADC_AuthPassSt 0;
BA_ "GenSigInactiveValue" SG_ 549 ADC_AuthPassSt 0;
BA_ "GenSigInvalidValue" SG_ 549 ADC_AuthPassSt 0;
BA_ "GenSigSendType" SG_ 549 ADC_AuthPassSt 1;
BA_ "GenSigStartValue" SG_ 549 ADC_AuthPassSt 0;
BA_ "GenSigTimeoutValue" SG_ 549 ADC_AuthPassSt 0;
BA_ "Remark" SG_ 549 ADC_AuthPassSt "";
BA_ "EventCommandSignal" SG_ 549 ADC_SBMAuthst 0;
BA_ "GatewayedSignals" SG_ 549 ADC_SBMAuthst 0;
BA_ "GenSigInactiveValue" SG_ 549 ADC_SBMAuthst 0;
BA_ "GenSigInvalidValue" SG_ 549 ADC_SBMAuthst 0;
BA_ "GenSigSendType" SG_ 549 ADC_SBMAuthst 1;
BA_ "GenSigStartValue" SG_ 549 ADC_SBMAuthst 0;
BA_ "GenSigTimeoutValue" SG_ 549 ADC_SBMAuthst 0;
BA_ "Remark" SG_ 549 ADC_SBMAuthst "";
BA_ "EventCommandSignal" SG_ 549 ADC_RPADirectionSel 0;
BA_ "GatewayedSignals" SG_ 549 ADC_RPADirectionSel 0;
BA_ "GenSigInactiveValue" SG_ 549 ADC_RPADirectionSel 0;
BA_ "GenSigInvalidValue" SG_ 549 ADC_RPADirectionSel 0;
BA_ "GenSigSendType" SG_ 549 ADC_RPADirectionSel 1;
BA_ "GenSigStartValue" SG_ 549 ADC_RPADirectionSel 0;
BA_ "GenSigTimeoutValue" SG_ 549 ADC_RPADirectionSel 0;
BA_ "Remark" SG_ 549 ADC_RPADirectionSel "";
BA_ "EventCommandSignal" SG_ 549 ADC_VehPoscoord 0;
BA_ "GatewayedSignals" SG_ 549 ADC_VehPoscoord 0;
BA_ "GenSigInactiveValue" SG_ 549 ADC_VehPoscoord 0;
BA_ "GenSigInvalidValue" SG_ 549 ADC_VehPoscoord 0;
BA_ "GenSigSendType" SG_ 549 ADC_VehPoscoord 1;
BA_ "GenSigStartValue" SG_ 549 ADC_VehPoscoord 0;
BA_ "GenSigTimeoutValue" SG_ 549 ADC_VehPoscoord 0;
BA_ "Remark" SG_ 549 ADC_VehPoscoord "";
BA_ "EventCommandSignal" SG_ 549 ADC_VehDynamicPosX 0;
BA_ "GatewayedSignals" SG_ 549 ADC_VehDynamicPosX 0;
BA_ "GenSigInactiveValue" SG_ 549 ADC_VehDynamicPosX 0;
BA_ "GenSigInvalidValue" SG_ 549 ADC_VehDynamicPosX 0;
BA_ "GenSigSendType" SG_ 549 ADC_VehDynamicPosX 1;
BA_ "GenSigStartValue" SG_ 549 ADC_VehDynamicPosX 0;
BA_ "GenSigTimeoutValue" SG_ 549 ADC_VehDynamicPosX 0;
BA_ "Remark" SG_ 549 ADC_VehDynamicPosX "";
BA_ "EventCommandSignal" SG_ 549 ADC_VehDynamicPosY 0;
BA_ "GatewayedSignals" SG_ 549 ADC_VehDynamicPosY 0;
BA_ "GenSigInactiveValue" SG_ 549 ADC_VehDynamicPosY 0;
BA_ "GenSigInvalidValue" SG_ 549 ADC_VehDynamicPosY 0;
BA_ "GenSigSendType" SG_ 549 ADC_VehDynamicPosY 1;
BA_ "GenSigStartValue" SG_ 549 ADC_VehDynamicPosY 0;
BA_ "GenSigTimeoutValue" SG_ 549 ADC_VehDynamicPosY 0;
BA_ "Remark" SG_ 549 ADC_VehDynamicPosY "";
BA_ "EventCommandSignal" SG_ 549 ADC_VehPosYawrate 0;
BA_ "GatewayedSignals" SG_ 549 ADC_VehPosYawrate 0;
BA_ "GenSigInactiveValue" SG_ 549 ADC_VehPosYawrate 0;
BA_ "GenSigInvalidValue" SG_ 549 ADC_VehPosYawrate 0;
BA_ "GenSigSendType" SG_ 549 ADC_VehPosYawrate 1;
BA_ "GenSigStartValue" SG_ 549 ADC_VehPosYawrate 0;
BA_ "GenSigTimeoutValue" SG_ 549 ADC_VehPosYawrate 0;
BA_ "Remark" SG_ 549 ADC_VehPosYawrate "";
BA_ "EventCommandSignal" SG_ 549 ADC_VehCurv 0;
BA_ "GatewayedSignals" SG_ 549 ADC_VehCurv 0;
BA_ "GenSigInactiveValue" SG_ 549 ADC_VehCurv 0;
BA_ "GenSigInvalidValue" SG_ 549 ADC_VehCurv 0;
BA_ "GenSigSendType" SG_ 549 ADC_VehCurv 1;
BA_ "GenSigStartValue" SG_ 549 ADC_VehCurv 0;
BA_ "GenSigTimeoutValue" SG_ 549 ADC_VehCurv 0;
BA_ "Remark" SG_ 549 ADC_VehCurv "";
BA_ "EventCommandSignal" SG_ 549 ADC_SlotPosX 0;
BA_ "GatewayedSignals" SG_ 549 ADC_SlotPosX 0;
BA_ "GenSigInactiveValue" SG_ 549 ADC_SlotPosX 0;
BA_ "GenSigInvalidValue" SG_ 549 ADC_SlotPosX 0;
BA_ "GenSigSendType" SG_ 549 ADC_SlotPosX 1;
BA_ "GenSigStartValue" SG_ 549 ADC_SlotPosX 0;
BA_ "GenSigTimeoutValue" SG_ 549 ADC_SlotPosX 0;
BA_ "Remark" SG_ 549 ADC_SlotPosX "";
BA_ "EventCommandSignal" SG_ 549 ADC_SlotPosY 0;
BA_ "GatewayedSignals" SG_ 549 ADC_SlotPosY 0;
BA_ "GenSigInactiveValue" SG_ 549 ADC_SlotPosY 0;
BA_ "GenSigInvalidValue" SG_ 549 ADC_SlotPosY 0;
BA_ "GenSigSendType" SG_ 549 ADC_SlotPosY 1;
BA_ "GenSigStartValue" SG_ 549 ADC_SlotPosY 0;
BA_ "GenSigTimeoutValue" SG_ 549 ADC_SlotPosY 0;
BA_ "Remark" SG_ 549 ADC_SlotPosY "";
BA_ "EventCommandSignal" SG_ 549 ADC_HPAst 0;
BA_ "GatewayedSignals" SG_ 549 ADC_HPAst 0;
BA_ "GenSigInactiveValue" SG_ 549 ADC_HPAst 0;
BA_ "GenSigInvalidValue" SG_ 549 ADC_HPAst 0;
BA_ "GenSigSendType" SG_ 549 ADC_HPAst 1;
BA_ "GenSigStartValue" SG_ 549 ADC_HPAst 0;
BA_ "GenSigTimeoutValue" SG_ 549 ADC_HPAst 0;
BA_ "Remark" SG_ 549 ADC_HPAst "";
BA_ "EventCommandSignal" SG_ 549 ADC_SlotAngle 0;
BA_ "GatewayedSignals" SG_ 549 ADC_SlotAngle 0;
BA_ "GenSigInactiveValue" SG_ 549 ADC_SlotAngle 0;
BA_ "GenSigInvalidValue" SG_ 549 ADC_SlotAngle 0;
BA_ "GenSigSendType" SG_ 549 ADC_SlotAngle 1;
BA_ "GenSigStartValue" SG_ 549 ADC_SlotAngle 0;
BA_ "GenSigTimeoutValue" SG_ 549 ADC_SlotAngle 0;
BA_ "Remark" SG_ 549 ADC_SlotAngle "";
BA_ "EventCommandSignal" SG_ 549 ADC_SlotCurv 0;
BA_ "GatewayedSignals" SG_ 549 ADC_SlotCurv 0;
BA_ "GenSigInactiveValue" SG_ 549 ADC_SlotCurv 0;
BA_ "GenSigInvalidValue" SG_ 549 ADC_SlotCurv 0;
BA_ "GenSigSendType" SG_ 549 ADC_SlotCurv 1;
BA_ "GenSigStartValue" SG_ 549 ADC_SlotCurv 0;
BA_ "GenSigTimeoutValue" SG_ 549 ADC_SlotCurv 0;
BA_ "Remark" SG_ 549 ADC_SlotCurv "";
BA_ "EventCommandSignal" SG_ 549 ADC_FusionDSMWorkStFL 0;
BA_ "GatewayedSignals" SG_ 549 ADC_FusionDSMWorkStFL 0;
BA_ "GenSigInactiveValue" SG_ 549 ADC_FusionDSMWorkStFL 0;
BA_ "GenSigInvalidValue" SG_ 549 ADC_FusionDSMWorkStFL 0;
BA_ "GenSigSendType" SG_ 549 ADC_FusionDSMWorkStFL 1;
BA_ "GenSigStartValue" SG_ 549 ADC_FusionDSMWorkStFL 0;
BA_ "GenSigTimeoutValue" SG_ 549 ADC_FusionDSMWorkStFL 0;
BA_ "Remark" SG_ 549 ADC_FusionDSMWorkStFL "预留";
BA_ "EventCommandSignal" SG_ 549 ADC_FusionDSMWorkStFR 0;
BA_ "GatewayedSignals" SG_ 549 ADC_FusionDSMWorkStFR 0;
BA_ "GenSigInactiveValue" SG_ 549 ADC_FusionDSMWorkStFR 0;
BA_ "GenSigInvalidValue" SG_ 549 ADC_FusionDSMWorkStFR 0;
BA_ "GenSigSendType" SG_ 549 ADC_FusionDSMWorkStFR 1;
BA_ "GenSigStartValue" SG_ 549 ADC_FusionDSMWorkStFR 0;
BA_ "GenSigTimeoutValue" SG_ 549 ADC_FusionDSMWorkStFR 0;
BA_ "Remark" SG_ 549 ADC_FusionDSMWorkStFR "预留";
BA_ "EventCommandSignal" SG_ 549 ADC_FusionDSMWorkStRL 0;
BA_ "GatewayedSignals" SG_ 549 ADC_FusionDSMWorkStRL 0;
BA_ "GenSigInactiveValue" SG_ 549 ADC_FusionDSMWorkStRL 0;
BA_ "GenSigInvalidValue" SG_ 549 ADC_FusionDSMWorkStRL 0;
BA_ "GenSigSendType" SG_ 549 ADC_FusionDSMWorkStRL 1;
BA_ "GenSigStartValue" SG_ 549 ADC_FusionDSMWorkStRL 0;
BA_ "GenSigTimeoutValue" SG_ 549 ADC_FusionDSMWorkStRL 0;
BA_ "Remark" SG_ 549 ADC_FusionDSMWorkStRL "预留";
BA_ "EventCommandSignal" SG_ 549 ADC_FusionDSMWorkStRR 0;
BA_ "GatewayedSignals" SG_ 549 ADC_FusionDSMWorkStRR 0;
BA_ "GenSigInactiveValue" SG_ 549 ADC_FusionDSMWorkStRR 0;
BA_ "GenSigInvalidValue" SG_ 549 ADC_FusionDSMWorkStRR 0;
BA_ "GenSigSendType" SG_ 549 ADC_FusionDSMWorkStRR 1;
BA_ "GenSigStartValue" SG_ 549 ADC_FusionDSMWorkStRR 0;
BA_ "GenSigTimeoutValue" SG_ 549 ADC_FusionDSMWorkStRR 0;
BA_ "Remark" SG_ 549 ADC_FusionDSMWorkStRR "预留";
BA_ "EventCommandSignal" SG_ 549 ADC_FusionDSMOpenablePercentFL 0;
BA_ "GatewayedSignals" SG_ 549 ADC_FusionDSMOpenablePercentFL 0;
BA_ "GenSigInactiveValue" SG_ 549 ADC_FusionDSMOpenablePercentFL 0;
BA_ "GenSigInvalidValue" SG_ 549 ADC_FusionDSMOpenablePercentFL 0;
BA_ "GenSigSendType" SG_ 549 ADC_FusionDSMOpenablePercentFL 1;
BA_ "GenSigStartValue" SG_ 549 ADC_FusionDSMOpenablePercentFL 127;
BA_ "GenSigTimeoutValue" SG_ 549 ADC_FusionDSMOpenablePercentFL 0;
BA_ "Remark" SG_ 549 ADC_FusionDSMOpenablePercentFL "";
BA_ "EventCommandSignal" SG_ 549 ADC_FusionDSMEmergencyStopFL 0;
BA_ "GatewayedSignals" SG_ 549 ADC_FusionDSMEmergencyStopFL 0;
BA_ "GenSigInactiveValue" SG_ 549 ADC_FusionDSMEmergencyStopFL 0;
BA_ "GenSigInvalidValue" SG_ 549 ADC_FusionDSMEmergencyStopFL 0;
BA_ "GenSigSendType" SG_ 549 ADC_FusionDSMEmergencyStopFL 1;
BA_ "GenSigStartValue" SG_ 549 ADC_FusionDSMEmergencyStopFL 0;
BA_ "GenSigTimeoutValue" SG_ 549 ADC_FusionDSMEmergencyStopFL 0;
BA_ "Remark" SG_ 549 ADC_FusionDSMEmergencyStopFL "";
BA_ "EventCommandSignal" SG_ 549 ADC_FusionDSMValidFL 0;
BA_ "GatewayedSignals" SG_ 549 ADC_FusionDSMValidFL 0;
BA_ "GenSigInactiveValue" SG_ 549 ADC_FusionDSMValidFL 0;
BA_ "GenSigInvalidValue" SG_ 549 ADC_FusionDSMValidFL 0;
BA_ "GenSigSendType" SG_ 549 ADC_FusionDSMValidFL 1;
BA_ "GenSigStartValue" SG_ 549 ADC_FusionDSMValidFL 0;
BA_ "GenSigTimeoutValue" SG_ 549 ADC_FusionDSMValidFL 0;
BA_ "Remark" SG_ 549 ADC_FusionDSMValidFL "";
BA_ "EventCommandSignal" SG_ 549 ADC_FusionDSMOpenablePercentFR 0;
BA_ "GatewayedSignals" SG_ 549 ADC_FusionDSMOpenablePercentFR 0;
BA_ "GenSigInactiveValue" SG_ 549 ADC_FusionDSMOpenablePercentFR 0;
BA_ "GenSigInvalidValue" SG_ 549 ADC_FusionDSMOpenablePercentFR 0;
BA_ "GenSigSendType" SG_ 549 ADC_FusionDSMOpenablePercentFR 1;
BA_ "GenSigStartValue" SG_ 549 ADC_FusionDSMOpenablePercentFR 127;
BA_ "GenSigTimeoutValue" SG_ 549 ADC_FusionDSMOpenablePercentFR 0;
BA_ "Remark" SG_ 549 ADC_FusionDSMOpenablePercentFR "";
BA_ "EventCommandSignal" SG_ 549 ADC_FusionDSMEmergencyStopFR 0;
BA_ "GatewayedSignals" SG_ 549 ADC_FusionDSMEmergencyStopFR 0;
BA_ "GenSigInactiveValue" SG_ 549 ADC_FusionDSMEmergencyStopFR 0;
BA_ "GenSigInvalidValue" SG_ 549 ADC_FusionDSMEmergencyStopFR 0;
BA_ "GenSigSendType" SG_ 549 ADC_FusionDSMEmergencyStopFR 1;
BA_ "GenSigStartValue" SG_ 549 ADC_FusionDSMEmergencyStopFR 0;
BA_ "GenSigTimeoutValue" SG_ 549 ADC_FusionDSMEmergencyStopFR 0;
BA_ "Remark" SG_ 549 ADC_FusionDSMEmergencyStopFR "";
BA_ "EventCommandSignal" SG_ 549 ADC_FusionDSMOpenablePercentRL 0;
BA_ "GatewayedSignals" SG_ 549 ADC_FusionDSMOpenablePercentRL 0;
BA_ "GenSigInactiveValue" SG_ 549 ADC_FusionDSMOpenablePercentRL 0;
BA_ "GenSigInvalidValue" SG_ 549 ADC_FusionDSMOpenablePercentRL 0;
BA_ "GenSigSendType" SG_ 549 ADC_FusionDSMOpenablePercentRL 1;
BA_ "GenSigStartValue" SG_ 549 ADC_FusionDSMOpenablePercentRL 127;
BA_ "GenSigTimeoutValue" SG_ 549 ADC_FusionDSMOpenablePercentRL 0;
BA_ "Remark" SG_ 549 ADC_FusionDSMOpenablePercentRL "";
BA_ "EventCommandSignal" SG_ 549 ADC_FusionDSMValidFR 0;
BA_ "GatewayedSignals" SG_ 549 ADC_FusionDSMValidFR 0;
BA_ "GenSigInactiveValue" SG_ 549 ADC_FusionDSMValidFR 0;
BA_ "GenSigInvalidValue" SG_ 549 ADC_FusionDSMValidFR 0;
BA_ "GenSigSendType" SG_ 549 ADC_FusionDSMValidFR 1;
BA_ "GenSigStartValue" SG_ 549 ADC_FusionDSMValidFR 0;
BA_ "GenSigTimeoutValue" SG_ 549 ADC_FusionDSMValidFR 0;
BA_ "Remark" SG_ 549 ADC_FusionDSMValidFR "";
BA_ "EventCommandSignal" SG_ 549 ADC_parkInOutDirection 0;
BA_ "GatewayedSignals" SG_ 549 ADC_parkInOutDirection 0;
BA_ "GenSigInactiveValue" SG_ 549 ADC_parkInOutDirection 0;
BA_ "GenSigInvalidValue" SG_ 549 ADC_parkInOutDirection 0;
BA_ "GenSigSendType" SG_ 549 ADC_parkInOutDirection 1;
BA_ "GenSigStartValue" SG_ 549 ADC_parkInOutDirection 0;
BA_ "GenSigTimeoutValue" SG_ 549 ADC_parkInOutDirection 0;
BA_ "Remark" SG_ 549 ADC_parkInOutDirection "";
BA_ "EventCommandSignal" SG_ 549 ADC_RPAStMessagePush 0;
BA_ "GatewayedSignals" SG_ 549 ADC_RPAStMessagePush 0;
BA_ "GenSigInactiveValue" SG_ 549 ADC_RPAStMessagePush 0;
BA_ "GenSigInvalidValue" SG_ 549 ADC_RPAStMessagePush 0;
BA_ "GenSigSendType" SG_ 549 ADC_RPAStMessagePush 1;
BA_ "GenSigStartValue" SG_ 549 ADC_RPAStMessagePush 0;
BA_ "GenSigTimeoutValue" SG_ 549 ADC_RPAStMessagePush 0;
BA_ "Remark" SG_ 549 ADC_RPAStMessagePush "";
BA_ "EventCommandSignal" SG_ 549 ADC_RPAtype 0;
BA_ "GatewayedSignals" SG_ 549 ADC_RPAtype 0;
BA_ "GenSigInactiveValue" SG_ 549 ADC_RPAtype 0;
BA_ "GenSigInvalidValue" SG_ 549 ADC_RPAtype 0;
BA_ "GenSigSendType" SG_ 549 ADC_RPAtype 1;
BA_ "GenSigStartValue" SG_ 549 ADC_RPAtype 0;
BA_ "GenSigTimeoutValue" SG_ 549 ADC_RPAtype 0;
BA_ "Remark" SG_ 549 ADC_RPAtype "";
BA_ "EventCommandSignal" SG_ 549 ADC_FusionDSMOpenablePercentRR 0;
BA_ "GatewayedSignals" SG_ 549 ADC_FusionDSMOpenablePercentRR 0;
BA_ "GenSigInactiveValue" SG_ 549 ADC_FusionDSMOpenablePercentRR 0;
BA_ "GenSigInvalidValue" SG_ 549 ADC_FusionDSMOpenablePercentRR 0;
BA_ "GenSigSendType" SG_ 549 ADC_FusionDSMOpenablePercentRR 1;
BA_ "GenSigStartValue" SG_ 549 ADC_FusionDSMOpenablePercentRR 127;
BA_ "GenSigTimeoutValue" SG_ 549 ADC_FusionDSMOpenablePercentRR 0;
BA_ "Remark" SG_ 549 ADC_FusionDSMOpenablePercentRR "";
BA_ "EventCommandSignal" SG_ 549 ADC_FusionDSMEmergencyStopRL 0;
BA_ "GatewayedSignals" SG_ 549 ADC_FusionDSMEmergencyStopRL 0;
BA_ "GenSigInactiveValue" SG_ 549 ADC_FusionDSMEmergencyStopRL 0;
BA_ "GenSigInvalidValue" SG_ 549 ADC_FusionDSMEmergencyStopRL 0;
BA_ "GenSigSendType" SG_ 549 ADC_FusionDSMEmergencyStopRL 1;
BA_ "GenSigStartValue" SG_ 549 ADC_FusionDSMEmergencyStopRL 0;
BA_ "GenSigTimeoutValue" SG_ 549 ADC_FusionDSMEmergencyStopRL 0;
BA_ "Remark" SG_ 549 ADC_FusionDSMEmergencyStopRL "";
BA_ "EventCommandSignal" SG_ 549 ADC_FusionDSMValidRL 0;
BA_ "GatewayedSignals" SG_ 549 ADC_FusionDSMValidRL 0;
BA_ "GenSigInactiveValue" SG_ 549 ADC_FusionDSMValidRL 0;
BA_ "GenSigInvalidValue" SG_ 549 ADC_FusionDSMValidRL 0;
BA_ "GenSigSendType" SG_ 549 ADC_FusionDSMValidRL 1;
BA_ "GenSigStartValue" SG_ 549 ADC_FusionDSMValidRL 0;
BA_ "GenSigTimeoutValue" SG_ 549 ADC_FusionDSMValidRL 0;
BA_ "Remark" SG_ 549 ADC_FusionDSMValidRL "";
BA_ "EventCommandSignal" SG_ 549 ADC_FusionDSMEmergencyStopRR 0;
BA_ "GatewayedSignals" SG_ 549 ADC_FusionDSMEmergencyStopRR 0;
BA_ "GenSigInactiveValue" SG_ 549 ADC_FusionDSMEmergencyStopRR 0;
BA_ "GenSigInvalidValue" SG_ 549 ADC_FusionDSMEmergencyStopRR 0;
BA_ "GenSigSendType" SG_ 549 ADC_FusionDSMEmergencyStopRR 1;
BA_ "GenSigStartValue" SG_ 549 ADC_FusionDSMEmergencyStopRR 0;
BA_ "GenSigTimeoutValue" SG_ 549 ADC_FusionDSMEmergencyStopRR 0;
BA_ "Remark" SG_ 549 ADC_FusionDSMEmergencyStopRR "";
BA_ "EventCommandSignal" SG_ 549 ADC_FusionDSMValidRR 0;
BA_ "GatewayedSignals" SG_ 549 ADC_FusionDSMValidRR 0;
BA_ "GenSigInactiveValue" SG_ 549 ADC_FusionDSMValidRR 0;
BA_ "GenSigInvalidValue" SG_ 549 ADC_FusionDSMValidRR 0;
BA_ "GenSigSendType" SG_ 549 ADC_FusionDSMValidRR 1;
BA_ "GenSigStartValue" SG_ 549 ADC_FusionDSMValidRR 0;
BA_ "GenSigTimeoutValue" SG_ 549 ADC_FusionDSMValidRR 0;
BA_ "Remark" SG_ 549 ADC_FusionDSMValidRR "";
BA_ "EventCommandSignal" SG_ 549 ADC_FusionDSMObstacleDisFL 0;
BA_ "GatewayedSignals" SG_ 549 ADC_FusionDSMObstacleDisFL 0;
BA_ "GenSigInactiveValue" SG_ 549 ADC_FusionDSMObstacleDisFL 0;
BA_ "GenSigInvalidValue" SG_ 549 ADC_FusionDSMObstacleDisFL 0;
BA_ "GenSigSendType" SG_ 549 ADC_FusionDSMObstacleDisFL 1;
BA_ "GenSigStartValue" SG_ 549 ADC_FusionDSMObstacleDisFL 255;
BA_ "GenSigTimeoutValue" SG_ 549 ADC_FusionDSMObstacleDisFL 0;
BA_ "Remark" SG_ 549 ADC_FusionDSMObstacleDisFL "";
BA_ "EventCommandSignal" SG_ 549 ADC_FusionDSMObstacleDisFR 0;
BA_ "GatewayedSignals" SG_ 549 ADC_FusionDSMObstacleDisFR 0;
BA_ "GenSigInactiveValue" SG_ 549 ADC_FusionDSMObstacleDisFR 0;
BA_ "GenSigInvalidValue" SG_ 549 ADC_FusionDSMObstacleDisFR 0;
BA_ "GenSigSendType" SG_ 549 ADC_FusionDSMObstacleDisFR 1;
BA_ "GenSigStartValue" SG_ 549 ADC_FusionDSMObstacleDisFR 255;
BA_ "GenSigTimeoutValue" SG_ 549 ADC_FusionDSMObstacleDisFR 0;
BA_ "Remark" SG_ 549 ADC_FusionDSMObstacleDisFR "";
BA_ "EventCommandSignal" SG_ 549 ADC_FusionDSMObstacleDisRL 0;
BA_ "GatewayedSignals" SG_ 549 ADC_FusionDSMObstacleDisRL 0;
BA_ "GenSigInactiveValue" SG_ 549 ADC_FusionDSMObstacleDisRL 0;
BA_ "GenSigInvalidValue" SG_ 549 ADC_FusionDSMObstacleDisRL 0;
BA_ "GenSigSendType" SG_ 549 ADC_FusionDSMObstacleDisRL 1;
BA_ "GenSigStartValue" SG_ 549 ADC_FusionDSMObstacleDisRL 255;
BA_ "GenSigTimeoutValue" SG_ 549 ADC_FusionDSMObstacleDisRL 0;
BA_ "Remark" SG_ 549 ADC_FusionDSMObstacleDisRL "";
BA_ "EventCommandSignal" SG_ 549 ADC_FusionDSMObstacleDisRR 0;
BA_ "GatewayedSignals" SG_ 549 ADC_FusionDSMObstacleDisRR 0;
BA_ "GenSigInactiveValue" SG_ 549 ADC_FusionDSMObstacleDisRR 0;
BA_ "GenSigInvalidValue" SG_ 549 ADC_FusionDSMObstacleDisRR 0;
BA_ "GenSigSendType" SG_ 549 ADC_FusionDSMObstacleDisRR 1;
BA_ "GenSigStartValue" SG_ 549 ADC_FusionDSMObstacleDisRR 255;
BA_ "GenSigTimeoutValue" SG_ 549 ADC_FusionDSMObstacleDisRR 0;
BA_ "Remark" SG_ 549 ADC_FusionDSMObstacleDisRR "";
BA_ "EventCommandSignal" SG_ 549 ADC_DskScreenOperationReq 0;
BA_ "GatewayedSignals" SG_ 549 ADC_DskScreenOperationReq 0;
BA_ "GenSigInactiveValue" SG_ 549 ADC_DskScreenOperationReq 0;
BA_ "GenSigInvalidValue" SG_ 549 ADC_DskScreenOperationReq 0;
BA_ "GenSigSendType" SG_ 549 ADC_DskScreenOperationReq 1;
BA_ "GenSigStartValue" SG_ 549 ADC_DskScreenOperationReq 1;
BA_ "GenSigTimeoutValue" SG_ 549 ADC_DskScreenOperationReq 0;
BA_ "Remark" SG_ 549 ADC_DskScreenOperationReq "";
BA_ "EventCommandSignal" SG_ 549 ADC_SenslesEtyParkingSt 0;
BA_ "GatewayedSignals" SG_ 549 ADC_SenslesEtyParkingSt 0;
BA_ "GenSigInactiveValue" SG_ 549 ADC_SenslesEtyParkingSt 0;
BA_ "GenSigInvalidValue" SG_ 549 ADC_SenslesEtyParkingSt 0;
BA_ "GenSigSendType" SG_ 549 ADC_SenslesEtyParkingSt 1;
BA_ "GenSigStartValue" SG_ 549 ADC_SenslesEtyParkingSt 0;
BA_ "GenSigTimeoutValue" SG_ 549 ADC_SenslesEtyParkingSt 0;
BA_ "Remark" SG_ 549 ADC_SenslesEtyParkingSt "";
BA_ "EventCommandSignal" SG_ 549 ADC_PAALimitToast 0;
BA_ "GatewayedSignals" SG_ 549 ADC_PAALimitToast 0;
BA_ "GenSigInactiveValue" SG_ 549 ADC_PAALimitToast 0;
BA_ "GenSigInvalidValue" SG_ 549 ADC_PAALimitToast 0;
BA_ "GenSigSendType" SG_ 549 ADC_PAALimitToast 1;
BA_ "GenSigStartValue" SG_ 549 ADC_PAALimitToast 0;
BA_ "GenSigTimeoutValue" SG_ 549 ADC_PAALimitToast 0;
BA_ "Remark" SG_ 549 ADC_PAALimitToast "";
BA_ "EventCommandSignal" SG_ 549 ADC_PAALimitReminder 0;
BA_ "GatewayedSignals" SG_ 549 ADC_PAALimitReminder 0;
BA_ "GenSigInactiveValue" SG_ 549 ADC_PAALimitReminder 0;
BA_ "GenSigInvalidValue" SG_ 549 ADC_PAALimitReminder 0;
BA_ "GenSigSendType" SG_ 549 ADC_PAALimitReminder 1;
BA_ "GenSigStartValue" SG_ 549 ADC_PAALimitReminder 0;
BA_ "GenSigTimeoutValue" SG_ 549 ADC_PAALimitReminder 0;
BA_ "Remark" SG_ 549 ADC_PAALimitReminder "";
BA_ "EventCommandSignal" SG_ 549 ADC_ParkOutMode 0;
BA_ "GatewayedSignals" SG_ 549 ADC_ParkOutMode 0;
BA_ "GenSigInactiveValue" SG_ 549 ADC_ParkOutMode 0;
BA_ "GenSigInvalidValue" SG_ 549 ADC_ParkOutMode 0;
BA_ "GenSigSendType" SG_ 549 ADC_ParkOutMode 1;
BA_ "GenSigStartValue" SG_ 549 ADC_ParkOutMode 0;
BA_ "GenSigTimeoutValue" SG_ 549 ADC_ParkOutMode 0;
BA_ "Remark" SG_ 549 ADC_ParkOutMode "";
BA_ "EventCommandSignal" SG_ 549 ADAS_ParkStats 0;
BA_ "GatewayedSignals" SG_ 549 ADAS_ParkStats 0;
BA_ "GenSigInactiveValue" SG_ 549 ADAS_ParkStats 0;
BA_ "GenSigInvalidValue" SG_ 549 ADAS_ParkStats 0;
BA_ "GenSigSendType" SG_ 549 ADAS_ParkStats 1;
BA_ "GenSigStartValue" SG_ 549 ADAS_ParkStats 0;
BA_ "GenSigTimeoutValue" SG_ 549 ADAS_ParkStats 0;
BA_ "Remark" SG_ 549 ADAS_ParkStats "";
BA_ "EventCommandSignal" SG_ 549 Reserved1 0;
BA_ "GatewayedSignals" SG_ 549 Reserved1 0;
BA_ "GenSigInactiveValue" SG_ 549 Reserved1 0;
BA_ "GenSigInvalidValue" SG_ 549 Reserved1 0;
BA_ "GenSigSendType" SG_ 549 Reserved1 1;
BA_ "GenSigStartValue" SG_ 549 Reserved1 0;
BA_ "GenSigTimeoutValue" SG_ 549 Reserved1 0;
BA_ "Remark" SG_ 549 Reserved1 "";
BA_ "EventCommandSignal" SG_ 969 ADAS_RemoterParkingOnlineOrNot 0;
BA_ "GatewayedSignals" SG_ 969 ADAS_RemoterParkingOnlineOrNot 0;
BA_ "GenSigInactiveValue" SG_ 969 ADAS_RemoterParkingOnlineOrNot 0;
BA_ "GenSigInvalidValue" SG_ 969 ADAS_RemoterParkingOnlineOrNot 0;
BA_ "GenSigSendType" SG_ 969 ADAS_RemoterParkingOnlineOrNot 1;
BA_ "GenSigStartValue" SG_ 969 ADAS_RemoterParkingOnlineOrNot 0;
BA_ "GenSigTimeoutValue" SG_ 969 ADAS_RemoterParkingOnlineOrNot 0;
BA_ "Remark" SG_ 969 ADAS_RemoterParkingOnlineOrNot "";
BA_ "EventCommandSignal" SG_ 969 ADC_RpaParkAuthn 0;
BA_ "GatewayedSignals" SG_ 969 ADC_RpaParkAuthn 0;
BA_ "GenSigInactiveValue" SG_ 969 ADC_RpaParkAuthn 0;
BA_ "GenSigInvalidValue" SG_ 969 ADC_RpaParkAuthn 0;
BA_ "GenSigSendType" SG_ 969 ADC_RpaParkAuthn 1;
BA_ "GenSigStartValue" SG_ 969 ADC_RpaParkAuthn 0;
BA_ "GenSigTimeoutValue" SG_ 969 ADC_RpaParkAuthn 0;
BA_ "Remark" SG_ 969 ADC_RpaParkAuthn "";
BA_ "EventCommandSignal" SG_ 969 ADC_RemParkPatSel 0;
BA_ "GatewayedSignals" SG_ 969 ADC_RemParkPatSel 0;
BA_ "GenSigInactiveValue" SG_ 969 ADC_RemParkPatSel 0;
BA_ "GenSigInvalidValue" SG_ 969 ADC_RemParkPatSel 0;
BA_ "GenSigSendType" SG_ 969 ADC_RemParkPatSel 1;
BA_ "GenSigStartValue" SG_ 969 ADC_RemParkPatSel 0;
BA_ "GenSigTimeoutValue" SG_ 969 ADC_RemParkPatSel 0;
BA_ "Remark" SG_ 969 ADC_RemParkPatSel "";
BA_ "EventCommandSignal" SG_ 969 ADC_ParkDirCfm 0;
BA_ "GatewayedSignals" SG_ 969 ADC_ParkDirCfm 0;
BA_ "GenSigInactiveValue" SG_ 969 ADC_ParkDirCfm 0;
BA_ "GenSigInvalidValue" SG_ 969 ADC_ParkDirCfm 0;
BA_ "GenSigSendType" SG_ 969 ADC_ParkDirCfm 1;
BA_ "GenSigStartValue" SG_ 969 ADC_ParkDirCfm 0;
BA_ "GenSigTimeoutValue" SG_ 969 ADC_ParkDirCfm 0;
BA_ "Remark" SG_ 969 ADC_ParkDirCfm "";
BA_ "EventCommandSignal" SG_ 969 ADC_ParkStMac 0;
BA_ "GatewayedSignals" SG_ 969 ADC_ParkStMac 0;
BA_ "GenSigInactiveValue" SG_ 969 ADC_ParkStMac 0;
BA_ "GenSigInvalidValue" SG_ 969 ADC_ParkStMac 0;
BA_ "GenSigSendType" SG_ 969 ADC_ParkStMac 1;
BA_ "GenSigStartValue" SG_ 969 ADC_ParkStMac 0;
BA_ "GenSigTimeoutValue" SG_ 969 ADC_ParkStMac 0;
BA_ "Remark" SG_ 969 ADC_ParkStMac "";
BA_ "EventCommandSignal" SG_ 969 ADC_PwrOnOffReq 0;
BA_ "GatewayedSignals" SG_ 969 ADC_PwrOnOffReq 0;
BA_ "GenSigInactiveValue" SG_ 969 ADC_PwrOnOffReq 0;
BA_ "GenSigInvalidValue" SG_ 969 ADC_PwrOnOffReq 0;
BA_ "GenSigSendType" SG_ 969 ADC_PwrOnOffReq 1;
BA_ "GenSigStartValue" SG_ 969 ADC_PwrOnOffReq 0;
BA_ "GenSigTimeoutValue" SG_ 969 ADC_PwrOnOffReq 0;
BA_ "Remark" SG_ 969 ADC_PwrOnOffReq "";
BA_ "EventCommandSignal" SG_ 969 ADC_ParkOutDir_ParaLe 0;
BA_ "GatewayedSignals" SG_ 969 ADC_ParkOutDir_ParaLe 0;
BA_ "GenSigInactiveValue" SG_ 969 ADC_ParkOutDir_ParaLe 0;
BA_ "GenSigInvalidValue" SG_ 969 ADC_ParkOutDir_ParaLe 0;
BA_ "GenSigSendType" SG_ 969 ADC_ParkOutDir_ParaLe 1;
BA_ "GenSigStartValue" SG_ 969 ADC_ParkOutDir_ParaLe 0;
BA_ "GenSigTimeoutValue" SG_ 969 ADC_ParkOutDir_ParaLe 0;
BA_ "Remark" SG_ 969 ADC_ParkOutDir_ParaLe "";
BA_ "EventCommandSignal" SG_ 969 ADC_ParkOutDir_ParaRi 0;
BA_ "GatewayedSignals" SG_ 969 ADC_ParkOutDir_ParaRi 0;
BA_ "GenSigInactiveValue" SG_ 969 ADC_ParkOutDir_ParaRi 0;
BA_ "GenSigInvalidValue" SG_ 969 ADC_ParkOutDir_ParaRi 0;
BA_ "GenSigSendType" SG_ 969 ADC_ParkOutDir_ParaRi 1;
BA_ "GenSigStartValue" SG_ 969 ADC_ParkOutDir_ParaRi 0;
BA_ "GenSigTimeoutValue" SG_ 969 ADC_ParkOutDir_ParaRi 0;
BA_ "Remark" SG_ 969 ADC_ParkOutDir_ParaRi "";
BA_ "EventCommandSignal" SG_ 969 ADC_ParkOutDir_PerpFwd 0;
BA_ "GatewayedSignals" SG_ 969 ADC_ParkOutDir_PerpFwd 0;
BA_ "GenSigInactiveValue" SG_ 969 ADC_ParkOutDir_PerpFwd 0;
BA_ "GenSigInvalidValue" SG_ 969 ADC_ParkOutDir_PerpFwd 0;
BA_ "GenSigSendType" SG_ 969 ADC_ParkOutDir_PerpFwd 1;
BA_ "GenSigStartValue" SG_ 969 ADC_ParkOutDir_PerpFwd 0;
BA_ "GenSigTimeoutValue" SG_ 969 ADC_ParkOutDir_PerpFwd 0;
BA_ "Remark" SG_ 969 ADC_ParkOutDir_PerpFwd "";
BA_ "EventCommandSignal" SG_ 969 ADC_ParkOutDir_PerpLeFwd 0;
BA_ "GatewayedSignals" SG_ 969 ADC_ParkOutDir_PerpLeFwd 0;
BA_ "GenSigInactiveValue" SG_ 969 ADC_ParkOutDir_PerpLeFwd 0;
BA_ "GenSigInvalidValue" SG_ 969 ADC_ParkOutDir_PerpLeFwd 0;
BA_ "GenSigSendType" SG_ 969 ADC_ParkOutDir_PerpLeFwd 1;
BA_ "GenSigStartValue" SG_ 969 ADC_ParkOutDir_PerpLeFwd 0;
BA_ "GenSigTimeoutValue" SG_ 969 ADC_ParkOutDir_PerpLeFwd 0;
BA_ "Remark" SG_ 969 ADC_ParkOutDir_PerpLeFwd "";
BA_ "EventCommandSignal" SG_ 969 ADC_ParkOutDir_PerpRiFwd 0;
BA_ "GatewayedSignals" SG_ 969 ADC_ParkOutDir_PerpRiFwd 0;
BA_ "GenSigInactiveValue" SG_ 969 ADC_ParkOutDir_PerpRiFwd 0;
BA_ "GenSigInvalidValue" SG_ 969 ADC_ParkOutDir_PerpRiFwd 0;
BA_ "GenSigSendType" SG_ 969 ADC_ParkOutDir_PerpRiFwd 1;
BA_ "GenSigStartValue" SG_ 969 ADC_ParkOutDir_PerpRiFwd 0;
BA_ "GenSigTimeoutValue" SG_ 969 ADC_ParkOutDir_PerpRiFwd 0;
BA_ "Remark" SG_ 969 ADC_ParkOutDir_PerpRiFwd "";
BA_ "EventCommandSignal" SG_ 969 ADC_ParkOutDir_PerpLeBack 0;
BA_ "GatewayedSignals" SG_ 969 ADC_ParkOutDir_PerpLeBack 0;
BA_ "GenSigInactiveValue" SG_ 969 ADC_ParkOutDir_PerpLeBack 0;
BA_ "GenSigInvalidValue" SG_ 969 ADC_ParkOutDir_PerpLeBack 0;
BA_ "GenSigSendType" SG_ 969 ADC_ParkOutDir_PerpLeBack 1;
BA_ "GenSigStartValue" SG_ 969 ADC_ParkOutDir_PerpLeBack 0;
BA_ "GenSigTimeoutValue" SG_ 969 ADC_ParkOutDir_PerpLeBack 0;
BA_ "Remark" SG_ 969 ADC_ParkOutDir_PerpLeBack "";
BA_ "EventCommandSignal" SG_ 969 ADC_ParkOutDir_PerpRiBack 0;
BA_ "GatewayedSignals" SG_ 969 ADC_ParkOutDir_PerpRiBack 0;
BA_ "GenSigInactiveValue" SG_ 969 ADC_ParkOutDir_PerpRiBack 0;
BA_ "GenSigInvalidValue" SG_ 969 ADC_ParkOutDir_PerpRiBack 0;
BA_ "GenSigSendType" SG_ 969 ADC_ParkOutDir_PerpRiBack 1;
BA_ "GenSigStartValue" SG_ 969 ADC_ParkOutDir_PerpRiBack 0;
BA_ "GenSigTimeoutValue" SG_ 969 ADC_ParkOutDir_PerpRiBack 0;
BA_ "Remark" SG_ 969 ADC_ParkOutDir_PerpRiBack "";
BA_ "EventCommandSignal" SG_ 969 ADC_ParkOutDir_PerpBack 0;
BA_ "GatewayedSignals" SG_ 969 ADC_ParkOutDir_PerpBack 0;
BA_ "GenSigInactiveValue" SG_ 969 ADC_ParkOutDir_PerpBack 0;
BA_ "GenSigInvalidValue" SG_ 969 ADC_ParkOutDir_PerpBack 0;
BA_ "GenSigSendType" SG_ 969 ADC_ParkOutDir_PerpBack 1;
BA_ "GenSigStartValue" SG_ 969 ADC_ParkOutDir_PerpBack 0;
BA_ "GenSigTimeoutValue" SG_ 969 ADC_ParkOutDir_PerpBack 0;
BA_ "Remark" SG_ 969 ADC_ParkOutDir_PerpBack "";
BA_ "EventCommandSignal" SG_ 969 ADC_APA_RPAFctUnavlMsg1 0;
BA_ "GatewayedSignals" SG_ 969 ADC_APA_RPAFctUnavlMsg1 0;
BA_ "GenSigInactiveValue" SG_ 969 ADC_APA_RPAFctUnavlMsg1 0;
BA_ "GenSigInvalidValue" SG_ 969 ADC_APA_RPAFctUnavlMsg1 0;
BA_ "GenSigSendType" SG_ 969 ADC_APA_RPAFctUnavlMsg1 1;
BA_ "GenSigStartValue" SG_ 969 ADC_APA_RPAFctUnavlMsg1 0;
BA_ "GenSigTimeoutValue" SG_ 969 ADC_APA_RPAFctUnavlMsg1 0;
BA_ "Remark" SG_ 969 ADC_APA_RPAFctUnavlMsg1 "";
BA_ "EventCommandSignal" SG_ 969 ADC_APA_RPAFctUnavlMsg2 0;
BA_ "GatewayedSignals" SG_ 969 ADC_APA_RPAFctUnavlMsg2 0;
BA_ "GenSigInactiveValue" SG_ 969 ADC_APA_RPAFctUnavlMsg2 0;
BA_ "GenSigInvalidValue" SG_ 969 ADC_APA_RPAFctUnavlMsg2 0;
BA_ "GenSigSendType" SG_ 969 ADC_APA_RPAFctUnavlMsg2 1;
BA_ "GenSigStartValue" SG_ 969 ADC_APA_RPAFctUnavlMsg2 0;
BA_ "GenSigTimeoutValue" SG_ 969 ADC_APA_RPAFctUnavlMsg2 0;
BA_ "Remark" SG_ 969 ADC_APA_RPAFctUnavlMsg2 "";
BA_ "EventCommandSignal" SG_ 969 ADC_APA_RPAFctUnavlMsg3 0;
BA_ "GatewayedSignals" SG_ 969 ADC_APA_RPAFctUnavlMsg3 0;
BA_ "GenSigInactiveValue" SG_ 969 ADC_APA_RPAFctUnavlMsg3 0;
BA_ "GenSigInvalidValue" SG_ 969 ADC_APA_RPAFctUnavlMsg3 0;
BA_ "GenSigSendType" SG_ 969 ADC_APA_RPAFctUnavlMsg3 1;
BA_ "GenSigStartValue" SG_ 969 ADC_APA_RPAFctUnavlMsg3 0;
BA_ "GenSigTimeoutValue" SG_ 969 ADC_APA_RPAFctUnavlMsg3 0;
BA_ "Remark" SG_ 969 ADC_APA_RPAFctUnavlMsg3 "";
BA_ "EventCommandSignal" SG_ 969 ADC_APA_RPAFctUnavlMsg4 0;
BA_ "GatewayedSignals" SG_ 969 ADC_APA_RPAFctUnavlMsg4 0;
BA_ "GenSigInactiveValue" SG_ 969 ADC_APA_RPAFctUnavlMsg4 0;
BA_ "GenSigInvalidValue" SG_ 969 ADC_APA_RPAFctUnavlMsg4 0;
BA_ "GenSigSendType" SG_ 969 ADC_APA_RPAFctUnavlMsg4 1;
BA_ "GenSigStartValue" SG_ 969 ADC_APA_RPAFctUnavlMsg4 0;
BA_ "GenSigTimeoutValue" SG_ 969 ADC_APA_RPAFctUnavlMsg4 0;
BA_ "Remark" SG_ 969 ADC_APA_RPAFctUnavlMsg4 "";
BA_ "EventCommandSignal" SG_ 969 ADC_APA_RPAFctUnavlMsg5 0;
BA_ "GatewayedSignals" SG_ 969 ADC_APA_RPAFctUnavlMsg5 0;
BA_ "GenSigInactiveValue" SG_ 969 ADC_APA_RPAFctUnavlMsg5 0;
BA_ "GenSigInvalidValue" SG_ 969 ADC_APA_RPAFctUnavlMsg5 0;
BA_ "GenSigSendType" SG_ 969 ADC_APA_RPAFctUnavlMsg5 1;
BA_ "GenSigStartValue" SG_ 969 ADC_APA_RPAFctUnavlMsg5 0;
BA_ "GenSigTimeoutValue" SG_ 969 ADC_APA_RPAFctUnavlMsg5 0;
BA_ "Remark" SG_ 969 ADC_APA_RPAFctUnavlMsg5 "";
BA_ "EventCommandSignal" SG_ 969 ADC_APA_RPAFctUnavlMsg6 0;
BA_ "GatewayedSignals" SG_ 969 ADC_APA_RPAFctUnavlMsg6 0;
BA_ "GenSigInactiveValue" SG_ 969 ADC_APA_RPAFctUnavlMsg6 0;
BA_ "GenSigInvalidValue" SG_ 969 ADC_APA_RPAFctUnavlMsg6 0;
BA_ "GenSigSendType" SG_ 969 ADC_APA_RPAFctUnavlMsg6 1;
BA_ "GenSigStartValue" SG_ 969 ADC_APA_RPAFctUnavlMsg6 0;
BA_ "GenSigTimeoutValue" SG_ 969 ADC_APA_RPAFctUnavlMsg6 0;
BA_ "Remark" SG_ 969 ADC_APA_RPAFctUnavlMsg6 "";
BA_ "EventCommandSignal" SG_ 969 ADC_APA_RPAFctUnavlMsg7 0;
BA_ "GatewayedSignals" SG_ 969 ADC_APA_RPAFctUnavlMsg7 0;
BA_ "GenSigInactiveValue" SG_ 969 ADC_APA_RPAFctUnavlMsg7 0;
BA_ "GenSigInvalidValue" SG_ 969 ADC_APA_RPAFctUnavlMsg7 0;
BA_ "GenSigSendType" SG_ 969 ADC_APA_RPAFctUnavlMsg7 1;
BA_ "GenSigStartValue" SG_ 969 ADC_APA_RPAFctUnavlMsg7 0;
BA_ "GenSigTimeoutValue" SG_ 969 ADC_APA_RPAFctUnavlMsg7 0;
BA_ "Remark" SG_ 969 ADC_APA_RPAFctUnavlMsg7 "";
BA_ "EventCommandSignal" SG_ 969 ADC_APA_RPAFctUnavlMsg8 0;
BA_ "GatewayedSignals" SG_ 969 ADC_APA_RPAFctUnavlMsg8 0;
BA_ "GenSigInactiveValue" SG_ 969 ADC_APA_RPAFctUnavlMsg8 0;
BA_ "GenSigInvalidValue" SG_ 969 ADC_APA_RPAFctUnavlMsg8 0;
BA_ "GenSigSendType" SG_ 969 ADC_APA_RPAFctUnavlMsg8 1;
BA_ "GenSigStartValue" SG_ 969 ADC_APA_RPAFctUnavlMsg8 0;
BA_ "GenSigTimeoutValue" SG_ 969 ADC_APA_RPAFctUnavlMsg8 0;
BA_ "Remark" SG_ 969 ADC_APA_RPAFctUnavlMsg8 "";
BA_ "EventCommandSignal" SG_ 969 ADC_APA_RPAFctUnavlMsg9 0;
BA_ "GatewayedSignals" SG_ 969 ADC_APA_RPAFctUnavlMsg9 0;
BA_ "GenSigInactiveValue" SG_ 969 ADC_APA_RPAFctUnavlMsg9 0;
BA_ "GenSigInvalidValue" SG_ 969 ADC_APA_RPAFctUnavlMsg9 0;
BA_ "GenSigSendType" SG_ 969 ADC_APA_RPAFctUnavlMsg9 1;
BA_ "GenSigStartValue" SG_ 969 ADC_APA_RPAFctUnavlMsg9 0;
BA_ "GenSigTimeoutValue" SG_ 969 ADC_APA_RPAFctUnavlMsg9 0;
BA_ "Remark" SG_ 969 ADC_APA_RPAFctUnavlMsg9 "";
BA_ "EventCommandSignal" SG_ 969 ADC_APA_RPAFctUnavlMsg10 0;
BA_ "GatewayedSignals" SG_ 969 ADC_APA_RPAFctUnavlMsg10 0;
BA_ "GenSigInactiveValue" SG_ 969 ADC_APA_RPAFctUnavlMsg10 0;
BA_ "GenSigInvalidValue" SG_ 969 ADC_APA_RPAFctUnavlMsg10 0;
BA_ "GenSigSendType" SG_ 969 ADC_APA_RPAFctUnavlMsg10 1;
BA_ "GenSigStartValue" SG_ 969 ADC_APA_RPAFctUnavlMsg10 0;
BA_ "GenSigTimeoutValue" SG_ 969 ADC_APA_RPAFctUnavlMsg10 0;
BA_ "Remark" SG_ 969 ADC_APA_RPAFctUnavlMsg10 "";
BA_ "EventCommandSignal" SG_ 969 ADC_APA_RPAFctUnavlMsg11 0;
BA_ "GatewayedSignals" SG_ 969 ADC_APA_RPAFctUnavlMsg11 0;
BA_ "GenSigInactiveValue" SG_ 969 ADC_APA_RPAFctUnavlMsg11 0;
BA_ "GenSigInvalidValue" SG_ 969 ADC_APA_RPAFctUnavlMsg11 0;
BA_ "GenSigSendType" SG_ 969 ADC_APA_RPAFctUnavlMsg11 1;
BA_ "GenSigStartValue" SG_ 969 ADC_APA_RPAFctUnavlMsg11 0;
BA_ "GenSigTimeoutValue" SG_ 969 ADC_APA_RPAFctUnavlMsg11 0;
BA_ "Remark" SG_ 969 ADC_APA_RPAFctUnavlMsg11 "";
BA_ "EventCommandSignal" SG_ 969 ADC_APA_RPAFctUnavlMsg12 0;
BA_ "GatewayedSignals" SG_ 969 ADC_APA_RPAFctUnavlMsg12 0;
BA_ "GenSigInactiveValue" SG_ 969 ADC_APA_RPAFctUnavlMsg12 0;
BA_ "GenSigInvalidValue" SG_ 969 ADC_APA_RPAFctUnavlMsg12 0;
BA_ "GenSigSendType" SG_ 969 ADC_APA_RPAFctUnavlMsg12 1;
BA_ "GenSigStartValue" SG_ 969 ADC_APA_RPAFctUnavlMsg12 0;
BA_ "GenSigTimeoutValue" SG_ 969 ADC_APA_RPAFctUnavlMsg12 0;
BA_ "Remark" SG_ 969 ADC_APA_RPAFctUnavlMsg12 "";
BA_ "EventCommandSignal" SG_ 969 ADC_APA_RPAFctUnavlMsg13 0;
BA_ "GatewayedSignals" SG_ 969 ADC_APA_RPAFctUnavlMsg13 0;
BA_ "GenSigInactiveValue" SG_ 969 ADC_APA_RPAFctUnavlMsg13 0;
BA_ "GenSigInvalidValue" SG_ 969 ADC_APA_RPAFctUnavlMsg13 0;
BA_ "GenSigSendType" SG_ 969 ADC_APA_RPAFctUnavlMsg13 1;
BA_ "GenSigStartValue" SG_ 969 ADC_APA_RPAFctUnavlMsg13 0;
BA_ "GenSigTimeoutValue" SG_ 969 ADC_APA_RPAFctUnavlMsg13 0;
BA_ "Remark" SG_ 969 ADC_APA_RPAFctUnavlMsg13 "";
BA_ "EventCommandSignal" SG_ 969 ADC_APA_RPAFctUnavlMsg14 0;
BA_ "GatewayedSignals" SG_ 969 ADC_APA_RPAFctUnavlMsg14 0;
BA_ "GenSigInactiveValue" SG_ 969 ADC_APA_RPAFctUnavlMsg14 0;
BA_ "GenSigInvalidValue" SG_ 969 ADC_APA_RPAFctUnavlMsg14 0;
BA_ "GenSigSendType" SG_ 969 ADC_APA_RPAFctUnavlMsg14 1;
BA_ "GenSigStartValue" SG_ 969 ADC_APA_RPAFctUnavlMsg14 0;
BA_ "GenSigTimeoutValue" SG_ 969 ADC_APA_RPAFctUnavlMsg14 0;
BA_ "Remark" SG_ 969 ADC_APA_RPAFctUnavlMsg14 "";
BA_ "EventCommandSignal" SG_ 969 ADC_APA_RPAFctUnavlMsg15 0;
BA_ "GatewayedSignals" SG_ 969 ADC_APA_RPAFctUnavlMsg15 0;
BA_ "GenSigInactiveValue" SG_ 969 ADC_APA_RPAFctUnavlMsg15 0;
BA_ "GenSigInvalidValue" SG_ 969 ADC_APA_RPAFctUnavlMsg15 0;
BA_ "GenSigSendType" SG_ 969 ADC_APA_RPAFctUnavlMsg15 1;
BA_ "GenSigStartValue" SG_ 969 ADC_APA_RPAFctUnavlMsg15 0;
BA_ "GenSigTimeoutValue" SG_ 969 ADC_APA_RPAFctUnavlMsg15 0;
BA_ "Remark" SG_ 969 ADC_APA_RPAFctUnavlMsg15 "";
BA_ "EventCommandSignal" SG_ 969 ADC_APA_RPAFctUnavlMsg16 0;
BA_ "GatewayedSignals" SG_ 969 ADC_APA_RPAFctUnavlMsg16 0;
BA_ "GenSigInactiveValue" SG_ 969 ADC_APA_RPAFctUnavlMsg16 0;
BA_ "GenSigInvalidValue" SG_ 969 ADC_APA_RPAFctUnavlMsg16 0;
BA_ "GenSigSendType" SG_ 969 ADC_APA_RPAFctUnavlMsg16 1;
BA_ "GenSigStartValue" SG_ 969 ADC_APA_RPAFctUnavlMsg16 0;
BA_ "GenSigTimeoutValue" SG_ 969 ADC_APA_RPAFctUnavlMsg16 0;
BA_ "Remark" SG_ 969 ADC_APA_RPAFctUnavlMsg16 "";
BA_ "EventCommandSignal" SG_ 969 ADC_APA_RPAFctUnavlMsg17 0;
BA_ "GatewayedSignals" SG_ 969 ADC_APA_RPAFctUnavlMsg17 0;
BA_ "GenSigInactiveValue" SG_ 969 ADC_APA_RPAFctUnavlMsg17 0;
BA_ "GenSigInvalidValue" SG_ 969 ADC_APA_RPAFctUnavlMsg17 0;
BA_ "GenSigSendType" SG_ 969 ADC_APA_RPAFctUnavlMsg17 1;
BA_ "GenSigStartValue" SG_ 969 ADC_APA_RPAFctUnavlMsg17 0;
BA_ "GenSigTimeoutValue" SG_ 969 ADC_APA_RPAFctUnavlMsg17 0;
BA_ "Remark" SG_ 969 ADC_APA_RPAFctUnavlMsg17 "";
BA_ "EventCommandSignal" SG_ 969 ADC_APA_RPAFctUnavlMsg18 0;
BA_ "GatewayedSignals" SG_ 969 ADC_APA_RPAFctUnavlMsg18 0;
BA_ "GenSigInactiveValue" SG_ 969 ADC_APA_RPAFctUnavlMsg18 0;
BA_ "GenSigInvalidValue" SG_ 969 ADC_APA_RPAFctUnavlMsg18 0;
BA_ "GenSigSendType" SG_ 969 ADC_APA_RPAFctUnavlMsg18 1;
BA_ "GenSigStartValue" SG_ 969 ADC_APA_RPAFctUnavlMsg18 0;
BA_ "GenSigTimeoutValue" SG_ 969 ADC_APA_RPAFctUnavlMsg18 0;
BA_ "Remark" SG_ 969 ADC_APA_RPAFctUnavlMsg18 "";
BA_ "EventCommandSignal" SG_ 969 ADC_APA_RPAFctUnavlMsg19 0;
BA_ "GatewayedSignals" SG_ 969 ADC_APA_RPAFctUnavlMsg19 0;
BA_ "GenSigInactiveValue" SG_ 969 ADC_APA_RPAFctUnavlMsg19 0;
BA_ "GenSigInvalidValue" SG_ 969 ADC_APA_RPAFctUnavlMsg19 0;
BA_ "GenSigSendType" SG_ 969 ADC_APA_RPAFctUnavlMsg19 1;
BA_ "GenSigStartValue" SG_ 969 ADC_APA_RPAFctUnavlMsg19 0;
BA_ "GenSigTimeoutValue" SG_ 969 ADC_APA_RPAFctUnavlMsg19 0;
BA_ "Remark" SG_ 969 ADC_APA_RPAFctUnavlMsg19 "";
BA_ "EventCommandSignal" SG_ 969 ADC_APA_RPAFctUnavlMsg20 0;
BA_ "GatewayedSignals" SG_ 969 ADC_APA_RPAFctUnavlMsg20 0;
BA_ "GenSigInactiveValue" SG_ 969 ADC_APA_RPAFctUnavlMsg20 0;
BA_ "GenSigInvalidValue" SG_ 969 ADC_APA_RPAFctUnavlMsg20 0;
BA_ "GenSigSendType" SG_ 969 ADC_APA_RPAFctUnavlMsg20 1;
BA_ "GenSigStartValue" SG_ 969 ADC_APA_RPAFctUnavlMsg20 0;
BA_ "GenSigTimeoutValue" SG_ 969 ADC_APA_RPAFctUnavlMsg20 0;
BA_ "Remark" SG_ 969 ADC_APA_RPAFctUnavlMsg20 "";
BA_ "EventCommandSignal" SG_ 969 ADC_APA_RPAFctUnavlMsg21 0;
BA_ "GatewayedSignals" SG_ 969 ADC_APA_RPAFctUnavlMsg21 0;
BA_ "GenSigInactiveValue" SG_ 969 ADC_APA_RPAFctUnavlMsg21 0;
BA_ "GenSigInvalidValue" SG_ 969 ADC_APA_RPAFctUnavlMsg21 0;
BA_ "GenSigSendType" SG_ 969 ADC_APA_RPAFctUnavlMsg21 1;
BA_ "GenSigStartValue" SG_ 969 ADC_APA_RPAFctUnavlMsg21 0;
BA_ "GenSigTimeoutValue" SG_ 969 ADC_APA_RPAFctUnavlMsg21 0;
BA_ "Remark" SG_ 969 ADC_APA_RPAFctUnavlMsg21 "";
BA_ "EventCommandSignal" SG_ 969 ADC_APA_RPAFctUnavlMsg22 0;
BA_ "GatewayedSignals" SG_ 969 ADC_APA_RPAFctUnavlMsg22 0;
BA_ "GenSigInactiveValue" SG_ 969 ADC_APA_RPAFctUnavlMsg22 0;
BA_ "GenSigInvalidValue" SG_ 969 ADC_APA_RPAFctUnavlMsg22 0;
BA_ "GenSigSendType" SG_ 969 ADC_APA_RPAFctUnavlMsg22 1;
BA_ "GenSigStartValue" SG_ 969 ADC_APA_RPAFctUnavlMsg22 0;
BA_ "GenSigTimeoutValue" SG_ 969 ADC_APA_RPAFctUnavlMsg22 0;
BA_ "Remark" SG_ 969 ADC_APA_RPAFctUnavlMsg22 "";
BA_ "EventCommandSignal" SG_ 969 ADC_APA_RPAFctUnavlMsg23 0;
BA_ "GatewayedSignals" SG_ 969 ADC_APA_RPAFctUnavlMsg23 0;
BA_ "GenSigInactiveValue" SG_ 969 ADC_APA_RPAFctUnavlMsg23 0;
BA_ "GenSigInvalidValue" SG_ 969 ADC_APA_RPAFctUnavlMsg23 0;
BA_ "GenSigSendType" SG_ 969 ADC_APA_RPAFctUnavlMsg23 1;
BA_ "GenSigStartValue" SG_ 969 ADC_APA_RPAFctUnavlMsg23 0;
BA_ "GenSigTimeoutValue" SG_ 969 ADC_APA_RPAFctUnavlMsg23 0;
BA_ "Remark" SG_ 969 ADC_APA_RPAFctUnavlMsg23 "";
BA_ "EventCommandSignal" SG_ 969 ADC_APA_RPAFctUnavlMsg24 0;
BA_ "GatewayedSignals" SG_ 969 ADC_APA_RPAFctUnavlMsg24 0;
BA_ "GenSigInactiveValue" SG_ 969 ADC_APA_RPAFctUnavlMsg24 0;
BA_ "GenSigInvalidValue" SG_ 969 ADC_APA_RPAFctUnavlMsg24 0;
BA_ "GenSigSendType" SG_ 969 ADC_APA_RPAFctUnavlMsg24 1;
BA_ "GenSigStartValue" SG_ 969 ADC_APA_RPAFctUnavlMsg24 0;
BA_ "GenSigTimeoutValue" SG_ 969 ADC_APA_RPAFctUnavlMsg24 0;
BA_ "Remark" SG_ 969 ADC_APA_RPAFctUnavlMsg24 "";
BA_ "EventCommandSignal" SG_ 969 ADC_APA_RPAFctUnavlMsg25 0;
BA_ "GatewayedSignals" SG_ 969 ADC_APA_RPAFctUnavlMsg25 0;
BA_ "GenSigInactiveValue" SG_ 969 ADC_APA_RPAFctUnavlMsg25 0;
BA_ "GenSigInvalidValue" SG_ 969 ADC_APA_RPAFctUnavlMsg25 0;
BA_ "GenSigSendType" SG_ 969 ADC_APA_RPAFctUnavlMsg25 1;
BA_ "GenSigStartValue" SG_ 969 ADC_APA_RPAFctUnavlMsg25 0;
BA_ "GenSigTimeoutValue" SG_ 969 ADC_APA_RPAFctUnavlMsg25 0;
BA_ "Remark" SG_ 969 ADC_APA_RPAFctUnavlMsg25 "";
BA_ "EventCommandSignal" SG_ 969 ADC_APA_RPACnclMsg1 0;
BA_ "GatewayedSignals" SG_ 969 ADC_APA_RPACnclMsg1 0;
BA_ "GenSigInactiveValue" SG_ 969 ADC_APA_RPACnclMsg1 0;
BA_ "GenSigInvalidValue" SG_ 969 ADC_APA_RPACnclMsg1 0;
BA_ "GenSigSendType" SG_ 969 ADC_APA_RPACnclMsg1 1;
BA_ "GenSigStartValue" SG_ 969 ADC_APA_RPACnclMsg1 0;
BA_ "GenSigTimeoutValue" SG_ 969 ADC_APA_RPACnclMsg1 0;
BA_ "Remark" SG_ 969 ADC_APA_RPACnclMsg1 "";
BA_ "EventCommandSignal" SG_ 969 ADC_APA_RPACnclMsg2 0;
BA_ "GatewayedSignals" SG_ 969 ADC_APA_RPACnclMsg2 0;
BA_ "GenSigInactiveValue" SG_ 969 ADC_APA_RPACnclMsg2 0;
BA_ "GenSigInvalidValue" SG_ 969 ADC_APA_RPACnclMsg2 0;
BA_ "GenSigSendType" SG_ 969 ADC_APA_RPACnclMsg2 1;
BA_ "GenSigStartValue" SG_ 969 ADC_APA_RPACnclMsg2 0;
BA_ "GenSigTimeoutValue" SG_ 969 ADC_APA_RPACnclMsg2 0;
BA_ "Remark" SG_ 969 ADC_APA_RPACnclMsg2 "";
BA_ "EventCommandSignal" SG_ 969 ADC_APA_RPACnclMsg3 0;
BA_ "GatewayedSignals" SG_ 969 ADC_APA_RPACnclMsg3 0;
BA_ "GenSigInactiveValue" SG_ 969 ADC_APA_RPACnclMsg3 0;
BA_ "GenSigInvalidValue" SG_ 969 ADC_APA_RPACnclMsg3 0;
BA_ "GenSigSendType" SG_ 969 ADC_APA_RPACnclMsg3 1;
BA_ "GenSigStartValue" SG_ 969 ADC_APA_RPACnclMsg3 0;
BA_ "GenSigTimeoutValue" SG_ 969 ADC_APA_RPACnclMsg3 0;
BA_ "Remark" SG_ 969 ADC_APA_RPACnclMsg3 "";
BA_ "EventCommandSignal" SG_ 969 ADC_APA_RPACnclMsg4 0;
BA_ "GatewayedSignals" SG_ 969 ADC_APA_RPACnclMsg4 0;
BA_ "GenSigInactiveValue" SG_ 969 ADC_APA_RPACnclMsg4 0;
BA_ "GenSigInvalidValue" SG_ 969 ADC_APA_RPACnclMsg4 0;
BA_ "GenSigSendType" SG_ 969 ADC_APA_RPACnclMsg4 1;
BA_ "GenSigStartValue" SG_ 969 ADC_APA_RPACnclMsg4 0;
BA_ "GenSigTimeoutValue" SG_ 969 ADC_APA_RPACnclMsg4 0;
BA_ "Remark" SG_ 969 ADC_APA_RPACnclMsg4 "";
BA_ "EventCommandSignal" SG_ 969 ADC_APA_RPACnclMsg5 0;
BA_ "GatewayedSignals" SG_ 969 ADC_APA_RPACnclMsg5 0;
BA_ "GenSigInactiveValue" SG_ 969 ADC_APA_RPACnclMsg5 0;
BA_ "GenSigInvalidValue" SG_ 969 ADC_APA_RPACnclMsg5 0;
BA_ "GenSigSendType" SG_ 969 ADC_APA_RPACnclMsg5 1;
BA_ "GenSigStartValue" SG_ 969 ADC_APA_RPACnclMsg5 0;
BA_ "GenSigTimeoutValue" SG_ 969 ADC_APA_RPACnclMsg5 0;
BA_ "Remark" SG_ 969 ADC_APA_RPACnclMsg5 "";
BA_ "EventCommandSignal" SG_ 969 ADC_APA_RPACnclMsg6 0;
BA_ "GatewayedSignals" SG_ 969 ADC_APA_RPACnclMsg6 0;
BA_ "GenSigInactiveValue" SG_ 969 ADC_APA_RPACnclMsg6 0;
BA_ "GenSigInvalidValue" SG_ 969 ADC_APA_RPACnclMsg6 0;
BA_ "GenSigSendType" SG_ 969 ADC_APA_RPACnclMsg6 1;
BA_ "GenSigStartValue" SG_ 969 ADC_APA_RPACnclMsg6 0;
BA_ "GenSigTimeoutValue" SG_ 969 ADC_APA_RPACnclMsg6 0;
BA_ "Remark" SG_ 969 ADC_APA_RPACnclMsg6 "";
BA_ "EventCommandSignal" SG_ 969 ADC_APA_RPACnclMsg7 0;
BA_ "GatewayedSignals" SG_ 969 ADC_APA_RPACnclMsg7 0;
BA_ "GenSigInactiveValue" SG_ 969 ADC_APA_RPACnclMsg7 0;
BA_ "GenSigInvalidValue" SG_ 969 ADC_APA_RPACnclMsg7 0;
BA_ "GenSigSendType" SG_ 969 ADC_APA_RPACnclMsg7 1;
BA_ "GenSigStartValue" SG_ 969 ADC_APA_RPACnclMsg7 0;
BA_ "GenSigTimeoutValue" SG_ 969 ADC_APA_RPACnclMsg7 0;
BA_ "Remark" SG_ 969 ADC_APA_RPACnclMsg7 "";
BA_ "EventCommandSignal" SG_ 969 ADC_APA_RPACnclMsg8 0;
BA_ "GatewayedSignals" SG_ 969 ADC_APA_RPACnclMsg8 0;
BA_ "GenSigInactiveValue" SG_ 969 ADC_APA_RPACnclMsg8 0;
BA_ "GenSigInvalidValue" SG_ 969 ADC_APA_RPACnclMsg8 0;
BA_ "GenSigSendType" SG_ 969 ADC_APA_RPACnclMsg8 1;
BA_ "GenSigStartValue" SG_ 969 ADC_APA_RPACnclMsg8 0;
BA_ "GenSigTimeoutValue" SG_ 969 ADC_APA_RPACnclMsg8 0;
BA_ "Remark" SG_ 969 ADC_APA_RPACnclMsg8 "";
BA_ "EventCommandSignal" SG_ 969 ADC_APA_RPACnclMsg9 0;
BA_ "GatewayedSignals" SG_ 969 ADC_APA_RPACnclMsg9 0;
BA_ "GenSigInactiveValue" SG_ 969 ADC_APA_RPACnclMsg9 0;
BA_ "GenSigInvalidValue" SG_ 969 ADC_APA_RPACnclMsg9 0;
BA_ "GenSigSendType" SG_ 969 ADC_APA_RPACnclMsg9 1;
BA_ "GenSigStartValue" SG_ 969 ADC_APA_RPACnclMsg9 0;
BA_ "GenSigTimeoutValue" SG_ 969 ADC_APA_RPACnclMsg9 0;
BA_ "Remark" SG_ 969 ADC_APA_RPACnclMsg9 "";
BA_ "EventCommandSignal" SG_ 969 ADC_APA_RPACnclMsg10 0;
BA_ "GatewayedSignals" SG_ 969 ADC_APA_RPACnclMsg10 0;
BA_ "GenSigInactiveValue" SG_ 969 ADC_APA_RPACnclMsg10 0;
BA_ "GenSigInvalidValue" SG_ 969 ADC_APA_RPACnclMsg10 0;
BA_ "GenSigSendType" SG_ 969 ADC_APA_RPACnclMsg10 1;
BA_ "GenSigStartValue" SG_ 969 ADC_APA_RPACnclMsg10 0;
BA_ "GenSigTimeoutValue" SG_ 969 ADC_APA_RPACnclMsg10 0;
BA_ "Remark" SG_ 969 ADC_APA_RPACnclMsg10 "";
BA_ "EventCommandSignal" SG_ 969 ADC_APA_RPACnclMsg11 0;
BA_ "GatewayedSignals" SG_ 969 ADC_APA_RPACnclMsg11 0;
BA_ "GenSigInactiveValue" SG_ 969 ADC_APA_RPACnclMsg11 0;
BA_ "GenSigInvalidValue" SG_ 969 ADC_APA_RPACnclMsg11 0;
BA_ "GenSigSendType" SG_ 969 ADC_APA_RPACnclMsg11 1;
BA_ "GenSigStartValue" SG_ 969 ADC_APA_RPACnclMsg11 0;
BA_ "GenSigTimeoutValue" SG_ 969 ADC_APA_RPACnclMsg11 0;
BA_ "Remark" SG_ 969 ADC_APA_RPACnclMsg11 "";
BA_ "EventCommandSignal" SG_ 969 ADC_APA_RPACnclMsg12 0;
BA_ "GatewayedSignals" SG_ 969 ADC_APA_RPACnclMsg12 0;
BA_ "GenSigInactiveValue" SG_ 969 ADC_APA_RPACnclMsg12 0;
BA_ "GenSigInvalidValue" SG_ 969 ADC_APA_RPACnclMsg12 0;
BA_ "GenSigSendType" SG_ 969 ADC_APA_RPACnclMsg12 1;
BA_ "GenSigStartValue" SG_ 969 ADC_APA_RPACnclMsg12 0;
BA_ "GenSigTimeoutValue" SG_ 969 ADC_APA_RPACnclMsg12 0;
BA_ "Remark" SG_ 969 ADC_APA_RPACnclMsg12 "";
BA_ "EventCommandSignal" SG_ 969 ADC_APA_RPACnclMsg13 0;
BA_ "GatewayedSignals" SG_ 969 ADC_APA_RPACnclMsg13 0;
BA_ "GenSigInactiveValue" SG_ 969 ADC_APA_RPACnclMsg13 0;
BA_ "GenSigInvalidValue" SG_ 969 ADC_APA_RPACnclMsg13 0;
BA_ "GenSigSendType" SG_ 969 ADC_APA_RPACnclMsg13 1;
BA_ "GenSigStartValue" SG_ 969 ADC_APA_RPACnclMsg13 0;
BA_ "GenSigTimeoutValue" SG_ 969 ADC_APA_RPACnclMsg13 0;
BA_ "Remark" SG_ 969 ADC_APA_RPACnclMsg13 "";
BA_ "EventCommandSignal" SG_ 969 ADC_APA_RPACnclMsg14 0;
BA_ "GatewayedSignals" SG_ 969 ADC_APA_RPACnclMsg14 0;
BA_ "GenSigInactiveValue" SG_ 969 ADC_APA_RPACnclMsg14 0;
BA_ "GenSigInvalidValue" SG_ 969 ADC_APA_RPACnclMsg14 0;
BA_ "GenSigSendType" SG_ 969 ADC_APA_RPACnclMsg14 1;
BA_ "GenSigStartValue" SG_ 969 ADC_APA_RPACnclMsg14 0;
BA_ "GenSigTimeoutValue" SG_ 969 ADC_APA_RPACnclMsg14 0;
BA_ "Remark" SG_ 969 ADC_APA_RPACnclMsg14 "";
BA_ "EventCommandSignal" SG_ 969 ADC_APA_RPACnclMsg15 0;
BA_ "GatewayedSignals" SG_ 969 ADC_APA_RPACnclMsg15 0;
BA_ "GenSigInactiveValue" SG_ 969 ADC_APA_RPACnclMsg15 0;
BA_ "GenSigInvalidValue" SG_ 969 ADC_APA_RPACnclMsg15 0;
BA_ "GenSigSendType" SG_ 969 ADC_APA_RPACnclMsg15 1;
BA_ "GenSigStartValue" SG_ 969 ADC_APA_RPACnclMsg15 0;
BA_ "GenSigTimeoutValue" SG_ 969 ADC_APA_RPACnclMsg15 0;
BA_ "Remark" SG_ 969 ADC_APA_RPACnclMsg15 "";
BA_ "EventCommandSignal" SG_ 969 ADC_APA_RPACnclMsg16 0;
BA_ "GatewayedSignals" SG_ 969 ADC_APA_RPACnclMsg16 0;
BA_ "GenSigInactiveValue" SG_ 969 ADC_APA_RPACnclMsg16 0;
BA_ "GenSigInvalidValue" SG_ 969 ADC_APA_RPACnclMsg16 0;
BA_ "GenSigSendType" SG_ 969 ADC_APA_RPACnclMsg16 1;
BA_ "GenSigStartValue" SG_ 969 ADC_APA_RPACnclMsg16 0;
BA_ "GenSigTimeoutValue" SG_ 969 ADC_APA_RPACnclMsg16 0;
BA_ "Remark" SG_ 969 ADC_APA_RPACnclMsg16 "";
BA_ "EventCommandSignal" SG_ 969 ADC_APA_RPACnclMsg17 0;
BA_ "GatewayedSignals" SG_ 969 ADC_APA_RPACnclMsg17 0;
BA_ "GenSigInactiveValue" SG_ 969 ADC_APA_RPACnclMsg17 0;
BA_ "GenSigInvalidValue" SG_ 969 ADC_APA_RPACnclMsg17 0;
BA_ "GenSigSendType" SG_ 969 ADC_APA_RPACnclMsg17 1;
BA_ "GenSigStartValue" SG_ 969 ADC_APA_RPACnclMsg17 0;
BA_ "GenSigTimeoutValue" SG_ 969 ADC_APA_RPACnclMsg17 0;
BA_ "Remark" SG_ 969 ADC_APA_RPACnclMsg17 "";
BA_ "EventCommandSignal" SG_ 969 ADC_APA_RPACnclMsg18 0;
BA_ "GatewayedSignals" SG_ 969 ADC_APA_RPACnclMsg18 0;
BA_ "GenSigInactiveValue" SG_ 969 ADC_APA_RPACnclMsg18 0;
BA_ "GenSigInvalidValue" SG_ 969 ADC_APA_RPACnclMsg18 0;
BA_ "GenSigSendType" SG_ 969 ADC_APA_RPACnclMsg18 1;
BA_ "GenSigStartValue" SG_ 969 ADC_APA_RPACnclMsg18 0;
BA_ "GenSigTimeoutValue" SG_ 969 ADC_APA_RPACnclMsg18 0;
BA_ "Remark" SG_ 969 ADC_APA_RPACnclMsg18 "";
BA_ "EventCommandSignal" SG_ 969 ADC_APA_RPACnclMsg19 0;
BA_ "GatewayedSignals" SG_ 969 ADC_APA_RPACnclMsg19 0;
BA_ "GenSigInactiveValue" SG_ 969 ADC_APA_RPACnclMsg19 0;
BA_ "GenSigInvalidValue" SG_ 969 ADC_APA_RPACnclMsg19 0;
BA_ "GenSigSendType" SG_ 969 ADC_APA_RPACnclMsg19 1;
BA_ "GenSigStartValue" SG_ 969 ADC_APA_RPACnclMsg19 0;
BA_ "GenSigTimeoutValue" SG_ 969 ADC_APA_RPACnclMsg19 0;
BA_ "Remark" SG_ 969 ADC_APA_RPACnclMsg19 "";
BA_ "EventCommandSignal" SG_ 969 ADC_APA_RPACnclMsg20 0;
BA_ "GatewayedSignals" SG_ 969 ADC_APA_RPACnclMsg20 0;
BA_ "GenSigInactiveValue" SG_ 969 ADC_APA_RPACnclMsg20 0;
BA_ "GenSigInvalidValue" SG_ 969 ADC_APA_RPACnclMsg20 0;
BA_ "GenSigSendType" SG_ 969 ADC_APA_RPACnclMsg20 1;
BA_ "GenSigStartValue" SG_ 969 ADC_APA_RPACnclMsg20 0;
BA_ "GenSigTimeoutValue" SG_ 969 ADC_APA_RPACnclMsg20 0;
BA_ "Remark" SG_ 969 ADC_APA_RPACnclMsg20 "";
BA_ "EventCommandSignal" SG_ 969 ADC_APA_RPAPauseMsg1 0;
BA_ "GatewayedSignals" SG_ 969 ADC_APA_RPAPauseMsg1 0;
BA_ "GenSigInactiveValue" SG_ 969 ADC_APA_RPAPauseMsg1 0;
BA_ "GenSigInvalidValue" SG_ 969 ADC_APA_RPAPauseMsg1 0;
BA_ "GenSigSendType" SG_ 969 ADC_APA_RPAPauseMsg1 1;
BA_ "GenSigStartValue" SG_ 969 ADC_APA_RPAPauseMsg1 0;
BA_ "GenSigTimeoutValue" SG_ 969 ADC_APA_RPAPauseMsg1 0;
BA_ "Remark" SG_ 969 ADC_APA_RPAPauseMsg1 "";
BA_ "EventCommandSignal" SG_ 969 ADC_APA_RPAPauseMsg2 0;
BA_ "GatewayedSignals" SG_ 969 ADC_APA_RPAPauseMsg2 0;
BA_ "GenSigInactiveValue" SG_ 969 ADC_APA_RPAPauseMsg2 0;
BA_ "GenSigInvalidValue" SG_ 969 ADC_APA_RPAPauseMsg2 0;
BA_ "GenSigSendType" SG_ 969 ADC_APA_RPAPauseMsg2 1;
BA_ "GenSigStartValue" SG_ 969 ADC_APA_RPAPauseMsg2 0;
BA_ "GenSigTimeoutValue" SG_ 969 ADC_APA_RPAPauseMsg2 0;
BA_ "Remark" SG_ 969 ADC_APA_RPAPauseMsg2 "";
BA_ "EventCommandSignal" SG_ 969 ADC_APA_RPAPauseMsg3 0;
BA_ "GatewayedSignals" SG_ 969 ADC_APA_RPAPauseMsg3 0;
BA_ "GenSigInactiveValue" SG_ 969 ADC_APA_RPAPauseMsg3 0;
BA_ "GenSigInvalidValue" SG_ 969 ADC_APA_RPAPauseMsg3 0;
BA_ "GenSigSendType" SG_ 969 ADC_APA_RPAPauseMsg3 1;
BA_ "GenSigStartValue" SG_ 969 ADC_APA_RPAPauseMsg3 0;
BA_ "GenSigTimeoutValue" SG_ 969 ADC_APA_RPAPauseMsg3 0;
BA_ "Remark" SG_ 969 ADC_APA_RPAPauseMsg3 "";
BA_ "EventCommandSignal" SG_ 969 ADC_APA_RPAPauseMsg4 0;
BA_ "GatewayedSignals" SG_ 969 ADC_APA_RPAPauseMsg4 0;
BA_ "GenSigInactiveValue" SG_ 969 ADC_APA_RPAPauseMsg4 0;
BA_ "GenSigInvalidValue" SG_ 969 ADC_APA_RPAPauseMsg4 0;
BA_ "GenSigSendType" SG_ 969 ADC_APA_RPAPauseMsg4 1;
BA_ "GenSigStartValue" SG_ 969 ADC_APA_RPAPauseMsg4 0;
BA_ "GenSigTimeoutValue" SG_ 969 ADC_APA_RPAPauseMsg4 0;
BA_ "Remark" SG_ 969 ADC_APA_RPAPauseMsg4 "";
BA_ "EventCommandSignal" SG_ 969 ADC_APA_RPAPauseMsg5 0;
BA_ "GatewayedSignals" SG_ 969 ADC_APA_RPAPauseMsg5 0;
BA_ "GenSigInactiveValue" SG_ 969 ADC_APA_RPAPauseMsg5 0;
BA_ "GenSigInvalidValue" SG_ 969 ADC_APA_RPAPauseMsg5 0;
BA_ "GenSigSendType" SG_ 969 ADC_APA_RPAPauseMsg5 1;
BA_ "GenSigStartValue" SG_ 969 ADC_APA_RPAPauseMsg5 0;
BA_ "GenSigTimeoutValue" SG_ 969 ADC_APA_RPAPauseMsg5 0;
BA_ "Remark" SG_ 969 ADC_APA_RPAPauseMsg5 "";
BA_ "EventCommandSignal" SG_ 969 ADC_APA_RPAPauseMsg6 0;
BA_ "GatewayedSignals" SG_ 969 ADC_APA_RPAPauseMsg6 0;
BA_ "GenSigInactiveValue" SG_ 969 ADC_APA_RPAPauseMsg6 0;
BA_ "GenSigInvalidValue" SG_ 969 ADC_APA_RPAPauseMsg6 0;
BA_ "GenSigSendType" SG_ 969 ADC_APA_RPAPauseMsg6 1;
BA_ "GenSigStartValue" SG_ 969 ADC_APA_RPAPauseMsg6 0;
BA_ "GenSigTimeoutValue" SG_ 969 ADC_APA_RPAPauseMsg6 0;
BA_ "Remark" SG_ 969 ADC_APA_RPAPauseMsg6 "";
BA_ "EventCommandSignal" SG_ 969 ADC_APA_RPAPauseMsg7 0;
BA_ "GatewayedSignals" SG_ 969 ADC_APA_RPAPauseMsg7 0;
BA_ "GenSigInactiveValue" SG_ 969 ADC_APA_RPAPauseMsg7 0;
BA_ "GenSigInvalidValue" SG_ 969 ADC_APA_RPAPauseMsg7 0;
BA_ "GenSigSendType" SG_ 969 ADC_APA_RPAPauseMsg7 1;
BA_ "GenSigStartValue" SG_ 969 ADC_APA_RPAPauseMsg7 0;
BA_ "GenSigTimeoutValue" SG_ 969 ADC_APA_RPAPauseMsg7 0;
BA_ "Remark" SG_ 969 ADC_APA_RPAPauseMsg7 "";
BA_ "EventCommandSignal" SG_ 969 ADC_APA_RPAPauseMsg8 0;
BA_ "GatewayedSignals" SG_ 969 ADC_APA_RPAPauseMsg8 0;
BA_ "GenSigInactiveValue" SG_ 969 ADC_APA_RPAPauseMsg8 0;
BA_ "GenSigInvalidValue" SG_ 969 ADC_APA_RPAPauseMsg8 0;
BA_ "GenSigSendType" SG_ 969 ADC_APA_RPAPauseMsg8 1;
BA_ "GenSigStartValue" SG_ 969 ADC_APA_RPAPauseMsg8 0;
BA_ "GenSigTimeoutValue" SG_ 969 ADC_APA_RPAPauseMsg8 0;
BA_ "Remark" SG_ 969 ADC_APA_RPAPauseMsg8 "";
BA_ "EventCommandSignal" SG_ 969 ADC_APA_RPAPauseMsg9 0;
BA_ "GatewayedSignals" SG_ 969 ADC_APA_RPAPauseMsg9 0;
BA_ "GenSigInactiveValue" SG_ 969 ADC_APA_RPAPauseMsg9 0;
BA_ "GenSigInvalidValue" SG_ 969 ADC_APA_RPAPauseMsg9 0;
BA_ "GenSigSendType" SG_ 969 ADC_APA_RPAPauseMsg9 1;
BA_ "GenSigStartValue" SG_ 969 ADC_APA_RPAPauseMsg9 0;
BA_ "GenSigTimeoutValue" SG_ 969 ADC_APA_RPAPauseMsg9 0;
BA_ "Remark" SG_ 969 ADC_APA_RPAPauseMsg9 "";
BA_ "EventCommandSignal" SG_ 969 ADC_APA_RPAPauseMsg10 0;
BA_ "GatewayedSignals" SG_ 969 ADC_APA_RPAPauseMsg10 0;
BA_ "GenSigInactiveValue" SG_ 969 ADC_APA_RPAPauseMsg10 0;
BA_ "GenSigInvalidValue" SG_ 969 ADC_APA_RPAPauseMsg10 0;
BA_ "GenSigSendType" SG_ 969 ADC_APA_RPAPauseMsg10 1;
BA_ "GenSigStartValue" SG_ 969 ADC_APA_RPAPauseMsg10 0;
BA_ "GenSigTimeoutValue" SG_ 969 ADC_APA_RPAPauseMsg10 0;
BA_ "Remark" SG_ 969 ADC_APA_RPAPauseMsg10 "";
BA_ "EventCommandSignal" SG_ 969 ADC_PathPlanPos1X 0;
BA_ "GatewayedSignals" SG_ 969 ADC_PathPlanPos1X 0;
BA_ "GenSigInactiveValue" SG_ 969 ADC_PathPlanPos1X 0;
BA_ "GenSigInvalidValue" SG_ 969 ADC_PathPlanPos1X 0;
BA_ "GenSigSendType" SG_ 969 ADC_PathPlanPos1X 1;
BA_ "GenSigStartValue" SG_ 969 ADC_PathPlanPos1X 0;
BA_ "GenSigTimeoutValue" SG_ 969 ADC_PathPlanPos1X 0;
BA_ "Remark" SG_ 969 ADC_PathPlanPos1X "";
BA_ "EventCommandSignal" SG_ 969 ADC_PathPlanPos1Y 0;
BA_ "GatewayedSignals" SG_ 969 ADC_PathPlanPos1Y 0;
BA_ "GenSigInactiveValue" SG_ 969 ADC_PathPlanPos1Y 0;
BA_ "GenSigInvalidValue" SG_ 969 ADC_PathPlanPos1Y 0;
BA_ "GenSigSendType" SG_ 969 ADC_PathPlanPos1Y 1;
BA_ "GenSigStartValue" SG_ 969 ADC_PathPlanPos1Y 0;
BA_ "GenSigTimeoutValue" SG_ 969 ADC_PathPlanPos1Y 0;
BA_ "Remark" SG_ 969 ADC_PathPlanPos1Y "";
BA_ "EventCommandSignal" SG_ 969 ADC_PathPlanPos2X 0;
BA_ "GatewayedSignals" SG_ 969 ADC_PathPlanPos2X 0;
BA_ "GenSigInactiveValue" SG_ 969 ADC_PathPlanPos2X 0;
BA_ "GenSigInvalidValue" SG_ 969 ADC_PathPlanPos2X 0;
BA_ "GenSigSendType" SG_ 969 ADC_PathPlanPos2X 1;
BA_ "GenSigStartValue" SG_ 969 ADC_PathPlanPos2X 0;
BA_ "GenSigTimeoutValue" SG_ 969 ADC_PathPlanPos2X 0;
BA_ "Remark" SG_ 969 ADC_PathPlanPos2X "";
BA_ "EventCommandSignal" SG_ 969 ADC_PathPlanPos2Y 0;
BA_ "GatewayedSignals" SG_ 969 ADC_PathPlanPos2Y 0;
BA_ "GenSigInactiveValue" SG_ 969 ADC_PathPlanPos2Y 0;
BA_ "GenSigInvalidValue" SG_ 969 ADC_PathPlanPos2Y 0;
BA_ "GenSigSendType" SG_ 969 ADC_PathPlanPos2Y 1;
BA_ "GenSigStartValue" SG_ 969 ADC_PathPlanPos2Y 0;
BA_ "GenSigTimeoutValue" SG_ 969 ADC_PathPlanPos2Y 0;
BA_ "Remark" SG_ 969 ADC_PathPlanPos2Y "";
BA_ "EventCommandSignal" SG_ 969 ADC_PathPlanPos3X 0;
BA_ "GatewayedSignals" SG_ 969 ADC_PathPlanPos3X 0;
BA_ "GenSigInactiveValue" SG_ 969 ADC_PathPlanPos3X 0;
BA_ "GenSigInvalidValue" SG_ 969 ADC_PathPlanPos3X 0;
BA_ "GenSigSendType" SG_ 969 ADC_PathPlanPos3X 1;
BA_ "GenSigStartValue" SG_ 969 ADC_PathPlanPos3X 0;
BA_ "GenSigTimeoutValue" SG_ 969 ADC_PathPlanPos3X 0;
BA_ "Remark" SG_ 969 ADC_PathPlanPos3X "";
BA_ "EventCommandSignal" SG_ 969 ADC_PathPlanPos3Y 0;
BA_ "GatewayedSignals" SG_ 969 ADC_PathPlanPos3Y 0;
BA_ "GenSigInactiveValue" SG_ 969 ADC_PathPlanPos3Y 0;
BA_ "GenSigInvalidValue" SG_ 969 ADC_PathPlanPos3Y 0;
BA_ "GenSigSendType" SG_ 969 ADC_PathPlanPos3Y 1;
BA_ "GenSigStartValue" SG_ 969 ADC_PathPlanPos3Y 0;
BA_ "GenSigTimeoutValue" SG_ 969 ADC_PathPlanPos3Y 0;
BA_ "Remark" SG_ 969 ADC_PathPlanPos3Y "";
BA_ "EventCommandSignal" SG_ 969 ADC_PathPlanPos4X 0;
BA_ "GatewayedSignals" SG_ 969 ADC_PathPlanPos4X 0;
BA_ "GenSigInactiveValue" SG_ 969 ADC_PathPlanPos4X 0;
BA_ "GenSigInvalidValue" SG_ 969 ADC_PathPlanPos4X 0;
BA_ "GenSigSendType" SG_ 969 ADC_PathPlanPos4X 1;
BA_ "GenSigStartValue" SG_ 969 ADC_PathPlanPos4X 0;
BA_ "GenSigTimeoutValue" SG_ 969 ADC_PathPlanPos4X 0;
BA_ "Remark" SG_ 969 ADC_PathPlanPos4X "";
BA_ "EventCommandSignal" SG_ 969 ADC_PathPlanPos4Y 0;
BA_ "GatewayedSignals" SG_ 969 ADC_PathPlanPos4Y 0;
BA_ "GenSigInactiveValue" SG_ 969 ADC_PathPlanPos4Y 0;
BA_ "GenSigInvalidValue" SG_ 969 ADC_PathPlanPos4Y 0;
BA_ "GenSigSendType" SG_ 969 ADC_PathPlanPos4Y 1;
BA_ "GenSigStartValue" SG_ 969 ADC_PathPlanPos4Y 0;
BA_ "GenSigTimeoutValue" SG_ 969 ADC_PathPlanPos4Y 0;
BA_ "Remark" SG_ 969 ADC_PathPlanPos4Y "";
BA_ "EventCommandSignal" SG_ 969 ADC_PathPlanPos5X 0;
BA_ "GatewayedSignals" SG_ 969 ADC_PathPlanPos5X 0;
BA_ "GenSigInactiveValue" SG_ 969 ADC_PathPlanPos5X 0;
BA_ "GenSigInvalidValue" SG_ 969 ADC_PathPlanPos5X 0;
BA_ "GenSigSendType" SG_ 969 ADC_PathPlanPos5X 1;
BA_ "GenSigStartValue" SG_ 969 ADC_PathPlanPos5X 0;
BA_ "GenSigTimeoutValue" SG_ 969 ADC_PathPlanPos5X 0;
BA_ "Remark" SG_ 969 ADC_PathPlanPos5X "";
BA_ "EventCommandSignal" SG_ 969 ADC_PathPlanPos5Y 0;
BA_ "GatewayedSignals" SG_ 969 ADC_PathPlanPos5Y 0;
BA_ "GenSigInactiveValue" SG_ 969 ADC_PathPlanPos5Y 0;
BA_ "GenSigInvalidValue" SG_ 969 ADC_PathPlanPos5Y 0;
BA_ "GenSigSendType" SG_ 969 ADC_PathPlanPos5Y 1;
BA_ "GenSigStartValue" SG_ 969 ADC_PathPlanPos5Y 0;
BA_ "GenSigTimeoutValue" SG_ 969 ADC_PathPlanPos5Y 0;
BA_ "Remark" SG_ 969 ADC_PathPlanPos5Y "";
BA_ "EventCommandSignal" SG_ 969 ADC_PathPlanPos6X 0;
BA_ "GatewayedSignals" SG_ 969 ADC_PathPlanPos6X 0;
BA_ "GenSigInactiveValue" SG_ 969 ADC_PathPlanPos6X 0;
BA_ "GenSigInvalidValue" SG_ 969 ADC_PathPlanPos6X 0;
BA_ "GenSigSendType" SG_ 969 ADC_PathPlanPos6X 1;
BA_ "GenSigStartValue" SG_ 969 ADC_PathPlanPos6X 0;
BA_ "GenSigTimeoutValue" SG_ 969 ADC_PathPlanPos6X 0;
BA_ "Remark" SG_ 969 ADC_PathPlanPos6X "";
BA_ "EventCommandSignal" SG_ 969 ADC_PathPlanPos6Y 0;
BA_ "GatewayedSignals" SG_ 969 ADC_PathPlanPos6Y 0;
BA_ "GenSigInactiveValue" SG_ 969 ADC_PathPlanPos6Y 0;
BA_ "GenSigInvalidValue" SG_ 969 ADC_PathPlanPos6Y 0;
BA_ "GenSigSendType" SG_ 969 ADC_PathPlanPos6Y 1;
BA_ "GenSigStartValue" SG_ 969 ADC_PathPlanPos6Y 0;
BA_ "GenSigTimeoutValue" SG_ 969 ADC_PathPlanPos6Y 0;
BA_ "Remark" SG_ 969 ADC_PathPlanPos6Y "";
BA_ "EventCommandSignal" SG_ 969 ADC_PathPlanPos7X 0;
BA_ "GatewayedSignals" SG_ 969 ADC_PathPlanPos7X 0;
BA_ "GenSigInactiveValue" SG_ 969 ADC_PathPlanPos7X 0;
BA_ "GenSigInvalidValue" SG_ 969 ADC_PathPlanPos7X 0;
BA_ "GenSigSendType" SG_ 969 ADC_PathPlanPos7X 1;
BA_ "GenSigStartValue" SG_ 969 ADC_PathPlanPos7X 0;
BA_ "GenSigTimeoutValue" SG_ 969 ADC_PathPlanPos7X 0;
BA_ "Remark" SG_ 969 ADC_PathPlanPos7X "";
BA_ "EventCommandSignal" SG_ 969 ADC_PathPlanPos7Y 0;
BA_ "GatewayedSignals" SG_ 969 ADC_PathPlanPos7Y 0;
BA_ "GenSigInactiveValue" SG_ 969 ADC_PathPlanPos7Y 0;
BA_ "GenSigInvalidValue" SG_ 969 ADC_PathPlanPos7Y 0;
BA_ "GenSigSendType" SG_ 969 ADC_PathPlanPos7Y 1;
BA_ "GenSigStartValue" SG_ 969 ADC_PathPlanPos7Y 0;
BA_ "GenSigTimeoutValue" SG_ 969 ADC_PathPlanPos7Y 0;
BA_ "Remark" SG_ 969 ADC_PathPlanPos7Y "";
BA_ "EventCommandSignal" SG_ 969 ADC_PathPlanPos8X 0;
BA_ "GatewayedSignals" SG_ 969 ADC_PathPlanPos8X 0;
BA_ "GenSigInactiveValue" SG_ 969 ADC_PathPlanPos8X 0;
BA_ "GenSigInvalidValue" SG_ 969 ADC_PathPlanPos8X 0;
BA_ "GenSigSendType" SG_ 969 ADC_PathPlanPos8X 1;
BA_ "GenSigStartValue" SG_ 969 ADC_PathPlanPos8X 0;
BA_ "GenSigTimeoutValue" SG_ 969 ADC_PathPlanPos8X 0;
BA_ "Remark" SG_ 969 ADC_PathPlanPos8X "";
BA_ "EventCommandSignal" SG_ 969 ADC_PathPlanPos8Y 0;
BA_ "GatewayedSignals" SG_ 969 ADC_PathPlanPos8Y 0;
BA_ "GenSigInactiveValue" SG_ 969 ADC_PathPlanPos8Y 0;
BA_ "GenSigInvalidValue" SG_ 969 ADC_PathPlanPos8Y 0;
BA_ "GenSigSendType" SG_ 969 ADC_PathPlanPos8Y 1;
BA_ "GenSigStartValue" SG_ 969 ADC_PathPlanPos8Y 0;
BA_ "GenSigTimeoutValue" SG_ 969 ADC_PathPlanPos8Y 0;
BA_ "Remark" SG_ 969 ADC_PathPlanPos8Y "";
BA_ "EventCommandSignal" SG_ 969 ADC_PathPlanPos9X 0;
BA_ "GatewayedSignals" SG_ 969 ADC_PathPlanPos9X 0;
BA_ "GenSigInactiveValue" SG_ 969 ADC_PathPlanPos9X 0;
BA_ "GenSigInvalidValue" SG_ 969 ADC_PathPlanPos9X 0;
BA_ "GenSigSendType" SG_ 969 ADC_PathPlanPos9X 1;
BA_ "GenSigStartValue" SG_ 969 ADC_PathPlanPos9X 0;
BA_ "GenSigTimeoutValue" SG_ 969 ADC_PathPlanPos9X 0;
BA_ "Remark" SG_ 969 ADC_PathPlanPos9X "";
BA_ "EventCommandSignal" SG_ 969 ADC_PathPlanPos9Y 0;
BA_ "GatewayedSignals" SG_ 969 ADC_PathPlanPos9Y 0;
BA_ "GenSigInactiveValue" SG_ 969 ADC_PathPlanPos9Y 0;
BA_ "GenSigInvalidValue" SG_ 969 ADC_PathPlanPos9Y 0;
BA_ "GenSigSendType" SG_ 969 ADC_PathPlanPos9Y 1;
BA_ "GenSigStartValue" SG_ 969 ADC_PathPlanPos9Y 0;
BA_ "GenSigTimeoutValue" SG_ 969 ADC_PathPlanPos9Y 0;
BA_ "Remark" SG_ 969 ADC_PathPlanPos9Y "";
BA_ "EventCommandSignal" SG_ 969 ADC_PathPlanPos10X 0;
BA_ "GatewayedSignals" SG_ 969 ADC_PathPlanPos10X 0;
BA_ "GenSigInactiveValue" SG_ 969 ADC_PathPlanPos10X 0;
BA_ "GenSigInvalidValue" SG_ 969 ADC_PathPlanPos10X 0;
BA_ "GenSigSendType" SG_ 969 ADC_PathPlanPos10X 1;
BA_ "GenSigStartValue" SG_ 969 ADC_PathPlanPos10X 0;
BA_ "GenSigTimeoutValue" SG_ 969 ADC_PathPlanPos10X 0;
BA_ "Remark" SG_ 969 ADC_PathPlanPos10X "";
BA_ "EventCommandSignal" SG_ 969 ADC_PathPlanPos10Y 0;
BA_ "GatewayedSignals" SG_ 969 ADC_PathPlanPos10Y 0;
BA_ "GenSigInactiveValue" SG_ 969 ADC_PathPlanPos10Y 0;
BA_ "GenSigInvalidValue" SG_ 969 ADC_PathPlanPos10Y 0;
BA_ "GenSigSendType" SG_ 969 ADC_PathPlanPos10Y 1;
BA_ "GenSigStartValue" SG_ 969 ADC_PathPlanPos10Y 0;
BA_ "GenSigTimeoutValue" SG_ 969 ADC_PathPlanPos10Y 0;
BA_ "Remark" SG_ 969 ADC_PathPlanPos10Y "";
BA_ "EventCommandSignal" SG_ 969 ADC_PathPlanPos11X 0;
BA_ "GatewayedSignals" SG_ 969 ADC_PathPlanPos11X 0;
BA_ "GenSigInactiveValue" SG_ 969 ADC_PathPlanPos11X 0;
BA_ "GenSigInvalidValue" SG_ 969 ADC_PathPlanPos11X 0;
BA_ "GenSigSendType" SG_ 969 ADC_PathPlanPos11X 1;
BA_ "GenSigStartValue" SG_ 969 ADC_PathPlanPos11X 0;
BA_ "GenSigTimeoutValue" SG_ 969 ADC_PathPlanPos11X 0;
BA_ "Remark" SG_ 969 ADC_PathPlanPos11X "";
BA_ "EventCommandSignal" SG_ 969 ADC_PathPlanPos11Y 0;
BA_ "GatewayedSignals" SG_ 969 ADC_PathPlanPos11Y 0;
BA_ "GenSigInactiveValue" SG_ 969 ADC_PathPlanPos11Y 0;
BA_ "GenSigInvalidValue" SG_ 969 ADC_PathPlanPos11Y 0;
BA_ "GenSigSendType" SG_ 969 ADC_PathPlanPos11Y 1;
BA_ "GenSigStartValue" SG_ 969 ADC_PathPlanPos11Y 0;
BA_ "GenSigTimeoutValue" SG_ 969 ADC_PathPlanPos11Y 0;
BA_ "Remark" SG_ 969 ADC_PathPlanPos11Y "";
BA_ "EventCommandSignal" SG_ 969 ADC_PathPlanPos12X 0;
BA_ "GatewayedSignals" SG_ 969 ADC_PathPlanPos12X 0;
BA_ "GenSigInactiveValue" SG_ 969 ADC_PathPlanPos12X 0;
BA_ "GenSigInvalidValue" SG_ 969 ADC_PathPlanPos12X 0;
BA_ "GenSigSendType" SG_ 969 ADC_PathPlanPos12X 1;
BA_ "GenSigStartValue" SG_ 969 ADC_PathPlanPos12X 0;
BA_ "GenSigTimeoutValue" SG_ 969 ADC_PathPlanPos12X 0;
BA_ "Remark" SG_ 969 ADC_PathPlanPos12X "";
BA_ "EventCommandSignal" SG_ 969 ADC_PathPlanPos12Y 0;
BA_ "GatewayedSignals" SG_ 969 ADC_PathPlanPos12Y 0;
BA_ "GenSigInactiveValue" SG_ 969 ADC_PathPlanPos12Y 0;
BA_ "GenSigInvalidValue" SG_ 969 ADC_PathPlanPos12Y 0;
BA_ "GenSigSendType" SG_ 969 ADC_PathPlanPos12Y 1;
BA_ "GenSigStartValue" SG_ 969 ADC_PathPlanPos12Y 0;
BA_ "GenSigTimeoutValue" SG_ 969 ADC_PathPlanPos12Y 0;
BA_ "Remark" SG_ 969 ADC_PathPlanPos12Y "";
BA_ "EventCommandSignal" SG_ 969 ADC_PathPlanPos13X 0;
BA_ "GatewayedSignals" SG_ 969 ADC_PathPlanPos13X 0;
BA_ "GenSigInactiveValue" SG_ 969 ADC_PathPlanPos13X 0;
BA_ "GenSigInvalidValue" SG_ 969 ADC_PathPlanPos13X 0;
BA_ "GenSigSendType" SG_ 969 ADC_PathPlanPos13X 1;
BA_ "GenSigStartValue" SG_ 969 ADC_PathPlanPos13X 0;
BA_ "GenSigTimeoutValue" SG_ 969 ADC_PathPlanPos13X 0;
BA_ "Remark" SG_ 969 ADC_PathPlanPos13X "";
BA_ "EventCommandSignal" SG_ 969 ADC_PathPlanPos13Y 0;
BA_ "GatewayedSignals" SG_ 969 ADC_PathPlanPos13Y 0;
BA_ "GenSigInactiveValue" SG_ 969 ADC_PathPlanPos13Y 0;
BA_ "GenSigInvalidValue" SG_ 969 ADC_PathPlanPos13Y 0;
BA_ "GenSigSendType" SG_ 969 ADC_PathPlanPos13Y 1;
BA_ "GenSigStartValue" SG_ 969 ADC_PathPlanPos13Y 0;
BA_ "GenSigTimeoutValue" SG_ 969 ADC_PathPlanPos13Y 0;
BA_ "Remark" SG_ 969 ADC_PathPlanPos13Y "";
BA_ "EventCommandSignal" SG_ 969 ADC_PathPlanPos14X 0;
BA_ "GatewayedSignals" SG_ 969 ADC_PathPlanPos14X 0;
BA_ "GenSigInactiveValue" SG_ 969 ADC_PathPlanPos14X 0;
BA_ "GenSigInvalidValue" SG_ 969 ADC_PathPlanPos14X 0;
BA_ "GenSigSendType" SG_ 969 ADC_PathPlanPos14X 1;
BA_ "GenSigStartValue" SG_ 969 ADC_PathPlanPos14X 0;
BA_ "GenSigTimeoutValue" SG_ 969 ADC_PathPlanPos14X 0;
BA_ "Remark" SG_ 969 ADC_PathPlanPos14X "";
BA_ "EventCommandSignal" SG_ 969 ADC_PathPlanPos14Y 0;
BA_ "GatewayedSignals" SG_ 969 ADC_PathPlanPos14Y 0;
BA_ "GenSigInactiveValue" SG_ 969 ADC_PathPlanPos14Y 0;
BA_ "GenSigInvalidValue" SG_ 969 ADC_PathPlanPos14Y 0;
BA_ "GenSigSendType" SG_ 969 ADC_PathPlanPos14Y 1;
BA_ "GenSigStartValue" SG_ 969 ADC_PathPlanPos14Y 0;
BA_ "GenSigTimeoutValue" SG_ 969 ADC_PathPlanPos14Y 0;
BA_ "Remark" SG_ 969 ADC_PathPlanPos14Y "";
BA_ "EventCommandSignal" SG_ 969 ADC_PathPlanPos15X 0;
BA_ "GatewayedSignals" SG_ 969 ADC_PathPlanPos15X 0;
BA_ "GenSigInactiveValue" SG_ 969 ADC_PathPlanPos15X 0;
BA_ "GenSigInvalidValue" SG_ 969 ADC_PathPlanPos15X 0;
BA_ "GenSigSendType" SG_ 969 ADC_PathPlanPos15X 1;
BA_ "GenSigStartValue" SG_ 969 ADC_PathPlanPos15X 0;
BA_ "GenSigTimeoutValue" SG_ 969 ADC_PathPlanPos15X 0;
BA_ "Remark" SG_ 969 ADC_PathPlanPos15X "";
BA_ "EventCommandSignal" SG_ 969 ADC_PathPlanPos15Y 0;
BA_ "GatewayedSignals" SG_ 969 ADC_PathPlanPos15Y 0;
BA_ "GenSigInactiveValue" SG_ 969 ADC_PathPlanPos15Y 0;
BA_ "GenSigInvalidValue" SG_ 969 ADC_PathPlanPos15Y 0;
BA_ "GenSigSendType" SG_ 969 ADC_PathPlanPos15Y 1;
BA_ "GenSigStartValue" SG_ 969 ADC_PathPlanPos15Y 0;
BA_ "GenSigTimeoutValue" SG_ 969 ADC_PathPlanPos15Y 0;
BA_ "Remark" SG_ 969 ADC_PathPlanPos15Y "";
BA_ "EventCommandSignal" SG_ 969 ADC_PathPlanPos16X 0;
BA_ "GatewayedSignals" SG_ 969 ADC_PathPlanPos16X 0;
BA_ "GenSigInactiveValue" SG_ 969 ADC_PathPlanPos16X 0;
BA_ "GenSigInvalidValue" SG_ 969 ADC_PathPlanPos16X 0;
BA_ "GenSigSendType" SG_ 969 ADC_PathPlanPos16X 1;
BA_ "GenSigStartValue" SG_ 969 ADC_PathPlanPos16X 0;
BA_ "GenSigTimeoutValue" SG_ 969 ADC_PathPlanPos16X 0;
BA_ "Remark" SG_ 969 ADC_PathPlanPos16X "";
BA_ "EventCommandSignal" SG_ 969 ADC_PathPlanPos16Y 0;
BA_ "GatewayedSignals" SG_ 969 ADC_PathPlanPos16Y 0;
BA_ "GenSigInactiveValue" SG_ 969 ADC_PathPlanPos16Y 0;
BA_ "GenSigInvalidValue" SG_ 969 ADC_PathPlanPos16Y 0;
BA_ "GenSigSendType" SG_ 969 ADC_PathPlanPos16Y 1;
BA_ "GenSigStartValue" SG_ 969 ADC_PathPlanPos16Y 0;
BA_ "GenSigTimeoutValue" SG_ 969 ADC_PathPlanPos16Y 0;
BA_ "Remark" SG_ 969 ADC_PathPlanPos16Y "";
BA_ "EventCommandSignal" SG_ 969 ADC_PathPlanPos17X 0;
BA_ "GatewayedSignals" SG_ 969 ADC_PathPlanPos17X 0;
BA_ "GenSigInactiveValue" SG_ 969 ADC_PathPlanPos17X 0;
BA_ "GenSigInvalidValue" SG_ 969 ADC_PathPlanPos17X 0;
BA_ "GenSigSendType" SG_ 969 ADC_PathPlanPos17X 1;
BA_ "GenSigStartValue" SG_ 969 ADC_PathPlanPos17X 0;
BA_ "GenSigTimeoutValue" SG_ 969 ADC_PathPlanPos17X 0;
BA_ "Remark" SG_ 969 ADC_PathPlanPos17X "";
BA_ "EventCommandSignal" SG_ 969 ADC_PathPlanPos17Y 0;
BA_ "GatewayedSignals" SG_ 969 ADC_PathPlanPos17Y 0;
BA_ "GenSigInactiveValue" SG_ 969 ADC_PathPlanPos17Y 0;
BA_ "GenSigInvalidValue" SG_ 969 ADC_PathPlanPos17Y 0;
BA_ "GenSigSendType" SG_ 969 ADC_PathPlanPos17Y 1;
BA_ "GenSigStartValue" SG_ 969 ADC_PathPlanPos17Y 0;
BA_ "GenSigTimeoutValue" SG_ 969 ADC_PathPlanPos17Y 0;
BA_ "Remark" SG_ 969 ADC_PathPlanPos17Y "";
BA_ "EventCommandSignal" SG_ 969 ADC_PathPlanPos18X 0;
BA_ "GatewayedSignals" SG_ 969 ADC_PathPlanPos18X 0;
BA_ "GenSigInactiveValue" SG_ 969 ADC_PathPlanPos18X 0;
BA_ "GenSigInvalidValue" SG_ 969 ADC_PathPlanPos18X 0;
BA_ "GenSigSendType" SG_ 969 ADC_PathPlanPos18X 1;
BA_ "GenSigStartValue" SG_ 969 ADC_PathPlanPos18X 0;
BA_ "GenSigTimeoutValue" SG_ 969 ADC_PathPlanPos18X 0;
BA_ "Remark" SG_ 969 ADC_PathPlanPos18X "";
BA_ "EventCommandSignal" SG_ 969 ADC_PathPlanPos18Y 0;
BA_ "GatewayedSignals" SG_ 969 ADC_PathPlanPos18Y 0;
BA_ "GenSigInactiveValue" SG_ 969 ADC_PathPlanPos18Y 0;
BA_ "GenSigInvalidValue" SG_ 969 ADC_PathPlanPos18Y 0;
BA_ "GenSigSendType" SG_ 969 ADC_PathPlanPos18Y 1;
BA_ "GenSigStartValue" SG_ 969 ADC_PathPlanPos18Y 0;
BA_ "GenSigTimeoutValue" SG_ 969 ADC_PathPlanPos18Y 0;
BA_ "Remark" SG_ 969 ADC_PathPlanPos18Y "";
BA_ "EventCommandSignal" SG_ 969 ADC_PathPlanPos19X 0;
BA_ "GatewayedSignals" SG_ 969 ADC_PathPlanPos19X 0;
BA_ "GenSigInactiveValue" SG_ 969 ADC_PathPlanPos19X 0;
BA_ "GenSigInvalidValue" SG_ 969 ADC_PathPlanPos19X 0;
BA_ "GenSigSendType" SG_ 969 ADC_PathPlanPos19X 1;
BA_ "GenSigStartValue" SG_ 969 ADC_PathPlanPos19X 0;
BA_ "GenSigTimeoutValue" SG_ 969 ADC_PathPlanPos19X 0;
BA_ "Remark" SG_ 969 ADC_PathPlanPos19X "";
BA_ "EventCommandSignal" SG_ 969 ADC_PathPlanPos19Y 0;
BA_ "GatewayedSignals" SG_ 969 ADC_PathPlanPos19Y 0;
BA_ "GenSigInactiveValue" SG_ 969 ADC_PathPlanPos19Y 0;
BA_ "GenSigInvalidValue" SG_ 969 ADC_PathPlanPos19Y 0;
BA_ "GenSigSendType" SG_ 969 ADC_PathPlanPos19Y 1;
BA_ "GenSigStartValue" SG_ 969 ADC_PathPlanPos19Y 0;
BA_ "GenSigTimeoutValue" SG_ 969 ADC_PathPlanPos19Y 0;
BA_ "Remark" SG_ 969 ADC_PathPlanPos19Y "";
BA_ "EventCommandSignal" SG_ 969 ADC_PathPlanPos20X 0;
BA_ "GatewayedSignals" SG_ 969 ADC_PathPlanPos20X 0;
BA_ "GenSigInactiveValue" SG_ 969 ADC_PathPlanPos20X 0;
BA_ "GenSigInvalidValue" SG_ 969 ADC_PathPlanPos20X 0;
BA_ "GenSigSendType" SG_ 969 ADC_PathPlanPos20X 1;
BA_ "GenSigStartValue" SG_ 969 ADC_PathPlanPos20X 0;
BA_ "GenSigTimeoutValue" SG_ 969 ADC_PathPlanPos20X 0;
BA_ "Remark" SG_ 969 ADC_PathPlanPos20X "";
BA_ "EventCommandSignal" SG_ 969 ADC_PathPlanPos20Y 0;
BA_ "GatewayedSignals" SG_ 969 ADC_PathPlanPos20Y 0;
BA_ "GenSigInactiveValue" SG_ 969 ADC_PathPlanPos20Y 0;
BA_ "GenSigInvalidValue" SG_ 969 ADC_PathPlanPos20Y 0;
BA_ "GenSigSendType" SG_ 969 ADC_PathPlanPos20Y 1;
BA_ "GenSigStartValue" SG_ 969 ADC_PathPlanPos20Y 0;
BA_ "GenSigTimeoutValue" SG_ 969 ADC_PathPlanPos20Y 0;
BA_ "Remark" SG_ 969 ADC_PathPlanPos20Y "";
VAL_ 549 ADC_APAst 0 "Off" 1 "Standby" 2 "Searching" 3 "Guidance active" 4 "Completed" 5 "Failure" 6 "Terminated" 7 "Pause"  ;
VAL_ 549 ADC_AVPst 0 "None" 1 "standby" 2 "Parked_in_slot" 3 "failure" 4 "Checking_Learning" 5 "Route_learning" 6 "Map_builded_awaiting_confirmation" 7 "Post_processing_after_map_building" 8 "Map_building_completed" 9 "Map_building_terminated" 10 "Checking_Cruising" 11 "Route_matching_successful" 12 "Cruising" 13 "Cruising_paused" 14 "Cruising_terminated" 15 "Cruising_completed"  ;
VAL_ 549 ADC_PAAFuncSt 0 "None" 1 "APA" 2 "RPA" 3 "HPA" 4 "AVP" 5 "RA" 6 "Custom Slot" 7 "PAA" 8 "DPA" 9 "summon" 10 "BSPA" 11 "Voice APA"  ;
VAL_ 549 ADC_PAAVoiceReminder 16 "The parking function is temporarily unavailable due to excessive speed" 17 "Searching for parking space, please proceed" 18 "Found parking space, please stop" 19 "Please hold the brake and click to start parking" 20 "Please release brakes and steering wheel" 21 "Parking completed" 22 "Remote parking is temporarily unavailable because no parking space is found" 23 "Remote parking is temporarily unavailable in automatic parking" 24 "Please close the door and continue" 25 "Please click to continue" 26 "Obstruction detected, please wait" 27 "Search timeout, parking exit" 28 "Please slow down" 29 "Speed is too fast, parking is about to exit" 30 "Please proceed" 31 "Please select the docking direction" 32 "Exit parking" 33 "Limited space, parking exit" 34 "System response timed out, parking exits" 35 "Throttle intervention, parking exit" 36 "Assist driving function starts and parking exits" 37 "Steering wheel interferes, parking exits" 38 "Gear intervention, parking exit" 39 "Sorry, there is a small problem with the system, parking exit" 768 "Please adjust the parking space after parking" 1024 "Reverse tracking is enabled, release brake and steering wheel" 1025 "Be aware of your surroundings and be ready to brake" 1026 "Reverse tracking completed" 1027 "Please switch to R" 1028 "Wait timeout, the function exits" 1029 "Please release the brakes before continuing" 1031 "Sorry, there is a small problem with the system, the reverse tracking is not working" 1031 "Reverse tracking has exited, please take over vehicle" 1032 "Sorry, there is a small problem with the system, reverse tracking has been quitted" 1033 "Caution when reversing" 1536 "Start Setting, please wait" 1537 "Start point set successfully!Please move to the parking space so I can learn the route" 1538 "Start point setting failed" 1539 "Route only 150 meters recorded, please park as soon as possible" 1540 "Please park in the parking space as soon as possible, otherwise this route learning will not be saved" 1541 "Excessive speed, please keep the speed less than 20 km/h" 1542 "Sorry, route learning failed" 1543 "Please click setting end" 1544 "Setting endpoint, please wait" 1545 "Finish setting is successful, click Save" 1546 "Endpoint setting failed" 1547 "Please save the route" 1548 "Saving the route" 1549 "Route saved successfully" 1550 "Sorry, route saving failed" 1551 "The route can only record 150 meters, please park as soon as possible" 1552 "Matching route" 1553 "The route is successfully matched" 1554 "Obstacle removed, parking continues" 1555 "Pay attention to pedestrians ahead" 1556 "Attention traffic ahead" 1557 "Please note the speed bump ahead" 1558 "About to turn left" 1559 "About to turn right" 1560 "Intersection ahead, please pay attention to your surroundings" 1561 "Curve ahead" 1562 "Vehicle deceleration" 1563 "rounding" 1564 "Approaching parking space" 1565 "Near the end" 2816 "Ready to go, now guide you to the designated area for valet parking" 2817 "Please keep straight" 2818 "Center lane, please" 2819 "Please keep to the left" 2820 "Please keep on the right side" 2821 "Please go straight ahead" 2822 "Turn left about 20 meters ahead" 2823 "Turn right about 20 meters ahead" 2824 "turn left" 2825 "turn right" 2826 "Off course, rerouting the course" 2827 "You are going too fast for the system to complete location" 2828 "Boot exit" 2829 "The system fails to locate and exits the boot" 2830 "Boot complete" 2831 "You have reached the valet parking activated area" 2832 "You are not within the valet parking available area" 2833 "Please select valet parking" 2834 "The pickup position has been reached"  ;
VAL_ 549 ADC_PAAVRSwitchFailSt 0 "No Fail" 1 "Fail"  ;
VAL_ 549 ADC_APKDisplayReq 0 "Not request" 1 "Request"  ;
VAL_ 549 ADC_APAActFuncInd 0 "No Active" 1 "Automatic cross park in" 2 "Automatic Parallel Park in" 3 "Automatic crossl park out" 4 "Automatic parallel park out" 5 "Remote cross Parkin" 6 "Remote parallel Parkin" 7 "Remote crossl POC" 8 "Remote parallel POC" 9 "Remote Front out" 10 "Remote Back out" 11 "Decent park in" 12 "Decent park out" 13 "Reserved" 14 "Reserved" 15 "Reserved"  ;
VAL_ 549 ADC_APABackParkDisplayReq 0 "None" 1 "Image parking" 2 "Space parking" 3 "Reserve"  ;
VAL_ 549 ADC_VCU_Gearshiftprompt 0 "Not request" 1 "Prohibit"  ;
VAL_ 549 ADC_APAMessagePushSt 0 "No Request" 1 "ReqParkingIn" 2 "ReqParkingOut" 3 "ReqActive"  ;
VAL_ 549 ADC_HPAMessagePushSt 0 "No Request" 1 "ReqStop" 2 "ReqActive" 3 "ReqLearning"  ;
VAL_ 549 ADC_PedWarnToneCtrl 0 "No Request" 1 "On" 2 "Off" 3 "reserve"  ;
VAL_ 549 ADC_PAADrvInteraction 0 "No Interaction" 1 "Req_ClosAllDoors" 2 "Req_PowerReady" 3 "Req_StopCharging" 4 "Req_GearP" 5 "Req_DrivePathScope" 6 "Req_UpdatePath" 7 "Req_PowerOFF" 8 "Req_FasteSaftyBelt" 9 "Req_ConfirmStartButton" 10 "Req_GettingOff" 11 "Req_ConfirmNoPerson_" 12 "Req_ConfirmContinueButton" 13 "Req_DriveActiveScope" 14 "Req_ReleaseBrake" 15 "Req_SlowDwon" 16 "Req_PressBrake" 17 "Req_Stop" 18 "Req_SelectedDirection" 19 "Req_Forward" 20 "Req_EPB" 21 "Req_Close Trunk" 22 "Req_CloseEngineDoor" 23 "Req_CloseDriverDoor" 24 "Req_ReleaseGasPedal" 25 "Req_GetInTakeOver" 26 "Req_ExpandRearviewMirror" 27 "Req_PayAttentionSurrounding" 28 "Req_SelectFunction" 29 "Req_SelectPickUpPoint" 55 "Req_TabSelfCheck" 56 "Req_TabParking" 80 "Quit_SysFailure" 81 "Quit_SpeedHigh" 82 "Quit_SearchingTimingOverflow" 83 "Quit_ParkingTimingOverflow" 84 "Quit_MoveTimesOverflow" 85 "Quit_WaitTimingOverflow" 86 "Quit_RecoverInterruptTimesOverflow" 87 "Quit_GasPedalIntervention" 88 "Quit_BrakePedalIntervention" 89 "Quit_GearIntervention" 90 "Quit_ExternalECUActive" 91 "Quit_TrajectoryLimit" 92 "Quit_SpaceLimit" 93 "Quit_PhoneDisconnected" 94 "Quit_SeatBeltUnbuckle" 95 "Quit_DoorOpen" 96 "Quit_EPBApply" 97 "Quit_VehicleBlock" 98 "Quit_GearIntervention" 99 "Quit_LuggageDoorOpen" 100 "Quit_SteeringWheelHandsOn" 101 "Quit_CancelButtonPressed" 102 "Quit_DoorLock" 103 "Quit_SBMFailureReason" 104 "Quit_RemoteDeviceFairlureReason" 105 "Quilt_UnsafeBehavior" 106 "Quit_PhoneLowBattey" 107 "Quit_VCUFailureReason" 108 "Quit_ESPFailureReason" 109 "Quit_EPSFailureReason" 110 "Quit_TBOXFailureReason" 111 "Quit_ExternalECUFailure" 112 "Quit_NoParkingLot" 113 "Quit_UnallowedParkingLot" 114 "Quit_PTReadyFailure" 115 "Quit_AlreadyInParkingSpace" 116 "Quit_PathEndingArrived" 117 "Quit_TaskFailed" 118 "Quit_PathMatchFailed" 119 "Quit_RearviewMirrorFolded" 120 "Quit_PowerOffFailed" 121 "Quit_FuncitonOff" 122 "Quit_EPSHandshakingFailed" 123 "Quit_ESPHandshakingFailed" 124 "Quit_PathMatchingFailed" 125 "Quit_ConditionDetectingFailed" 126 "Quit_PositionUnaviable" 127 "Quit_ObtainPathFailed" 128 "Quit_NoParkingLot" 129 "Quit_UnallowedParkingLot" 130 "Quit_OutOfAvailableParkingLot" 131 "Quit_UnactiveRegion" 132 "Quit_DoorLockFailure" 133 "Quit_AbnormalTirePressure" 134 "Quit_GearInterrupt" 135 "Quit_UserCancel" 192 "Recover_PressInterruptSwitch" 193 "Recover_MobileOutRange" 194 "Recover_DoorOpened" 195 "Recover_FoundObstacleTrajectory" 196 "Recover_MobileCommunicationWeak" 197 "Recover_SeatBeltUnbuckle" 198 "Recover_ParkingTimingOverflow" 199 "Recover_MoveTimesOverflow" 200 "Recover_GasPedalIntervention" 201 "Recover_BrakePedalIntervention" 202 "Recover_SpaceLimit" 203 "Recover_PhoneDisconnected" 204 "Recover_EPBApply" 205 "Recover_VehicleBlock" 206 "Recover_LuggageDoorOpen" 207 "Recover_PhoneLowBattey" 208 "Recover_NoParkingLot" 209 "Recover_UnallowedParkingLot" 210 "Recover_RearviewMirrorFolded" 211 "Recover_SteeringWheelHandsOn" 212 "Recover_GearIntervention" 256 "Info_SearchingProcess" 257 "Info_CruisingProcess" 258 "Info_PrakingProcess" 259 "Info_FuncitonSuspend" 260 "Info_FuncitonRecover" 261 "Info_FuncitonOff" 262 "Info_FuncitonComplete" 263 "Info_ConditionDetecting" 264 "Info_ConditionDetected" 265 "Info_PathMatching" 266 "Info_PathMatched" 267 "Info_ArrivedEndingPoint" 268 "Info_ArrivedStartingPoint" 269 "Info_CommunicationComplete" 270 "Info_ParkingToCruising" 271 "Info_CruisingToParking" 272 "Info_AlreadyInParkingSpace" 273 "Info_DriverSeatEmpty" 274 "Info_ParkingInFixedLot" 275 "Info_SearchingRandomLot" 276 "Info_NoParkingLot" 277 "Info_UnallowedParkingLot" 278 "Info_SteerByPeople" 279 "Info_SteerByObstacle" 280 "Info_AlreardySearchedLot" 281 "Info_DetectedObstacle" 282 "Info_DetectedPeople" 283 "Info_DetectedCrossing" 284 "Info_DetectedVehicle" 285 "Info_DetectedSpeedBumps" 286 "Info_SteerByVehicle" 287 "Info_TurnLeft" 288 "Info_TurnRight" 289 "Info_RefindParkingSpace" 290 "Info_OutOfAvailableParkingLot" 291 "Info_PathMatchingFailed" 292 "Info_ConditionDetectingFailed" 293 "Info_FoundParkingSpace" 294 "Info_InGuideRegion" 295 "Info_UnactiveRegion" 296 "Info_PowerOffFailed" 297 "Info_ParkingBrakeFailure" 298 "Info_DoorLockFailure" 299 "Info_ShutWindowFailure"  ;
VAL_ 549 ADC_PAARemoteParkingMode 0 "Default" 1 "Remote parking" 2 "Automatic parking" 3 "Not used"  ;
VAL_ 549 ADC_PAARemoteParkingEnable 0 "Disable" 1 "Enable"  ;
VAL_ 549 ADC_LocalToBeDRVReq 0 "No request" 1 "Request"  ;
VAL_ 549 ADC_UsageModeStAscendReq 0 "No Request" 1 "Power On Request (PTready)"  ;
VAL_ 549 ADC_UsageModeStDescendReq 0 "No request" 1 "Request"  ;
VAL_ 549 ADC_PAAIGCInhibitSt 0 "Not Inhibit" 1 "Inhibit"  ;
VAL_ 549 ADC_PAAEDKFunInhibitReq 0 "Not inhibit" 1 "Inhibit"  ;
VAL_ 549 ADC_PAARespondMode 0 "None"  ;
VAL_ 549 ADC_UsageModeStHold 0 "No request" 1 "UsageMode Hold"  ;
VAL_ 549 ADC_PAAToNDAReq 0 "No Request" 1 "PAA to NDA" 2 "NDA to PAA" 3 "Reserved"  ;
VAL_ 549 ADC_DriverPresentSt 0 "Undefined" 1 "Off" 2 "On" 3 "Failure"  ;
VAL_ 549 ADC_RAEBWorkSts 0 "Off" 1 "Standby" 2 "Active" 3 "Failed"  ;
VAL_ 549 ADC_UsageModeStHoldVD 0 "not valid;" 1 "valid;"  ;
VAL_ 549 ADC_RAEBEmgyBrkReq 0 "Not active" 1 "Active"  ;
VAL_ 549 ADC_PAADrvReq 0 "No_Request" 1 "Req_ClosAllDoors" 2 "Req_PowerReady" 3 "Req_StopCharging" 4 "Req_GearP" 5 "Req_DrivePathScope" 6 "Req_UpdatePath" 7 "Req_PowerOFF" 8 "Req_FasteSaftyBelt" 9 "Req_ConfirmStartButton" 10 "Req_GettingOff" 11 "Req_ConfirmNoPerson_" 12 "Req_ConfirmContinueButton" 13 "Req_DriveActiveScope" 14 "Req_ReleaseBrake" 15 "Req_SlowDwon" 16 "Req_PressBrake" 17 "Req_Stop" 18 "Req_SelectedDirection" 19 "Req_Forward" 20 "Req_EPB" 21 "Req_Close_Trunk" 22 "Req_CloseEngineDoor" 23 "Req_CloseDriverDoor" 24 "Req_ReleaseGasPedal" 25 "Req_GetInTakeOver" 26 "Req_ExpandRearviewMirror" 27 "Req_PayAttentionSurrounding" 28 "Req_SelectFunction" 29 "Req_SelectPickUpPoint" 30 "Req_SetStartPoint" 31 "Req_SetEndPoint" 32 "Req_StartAPAtoParkIntoLearningSlot" 33 "Req_DriverParkIntoLearningSlot" 34 "Req_PressBrakePedalAndContinueButton" 35 "Req_ClosePassengerDoors" 36 "Req_ProperDistance" 37 "Req_GearR" 38 "Req_ConfirmStartButtonByVoice" 39 "Req_SelectSlotByVoice" 40 "Req_ForwardToEndPoint" 41 "Req_ParkingOtherSlot" 42 "Req_ParkingInMobileSlot" 43 "Req_PayAttentionSurroundingsKeepBrakingInTime" 44 "Req_SetParkingSlot" 45 "Info_ApproachingLimitBlockAndParkingToCompleted" 46 "Req_DonotPressTheAcceleratorPedal" 47 "Req_ReleaseTheBrakeAndParkingToCompleted" 48 "Info_DrvingModeToParkingMode" 49 "Req_LeaveTheCarWithYourKeyAndBelongings" 50 "Info_LeaveCarAndClosedDoor" 51 "Req_DoubleShifterLever" 52 "Req_StopVehicleBeforParking" 55 "Req_TabSelfCheck" 56 "Req_TabParking" 57 "Info_SearchingProcess" 58 "Info_CruisingProcess" 59 "Info_PrakingProcess" 60 "Info_FuncitonSuspend" 61 "Info_FuncitonRecover" 62 "Info_FuncitonOff" 63 "Info_FuncitonComplete" 64 "Info_ConditionDetecting" 65 "Info_ConditionDetected" 66 "Info_PathMatching" 67 "Info_PathMatched" 68 "Info_ArrivedEndingPoint" 69 "Info_ArrivedStartingPoint" 70 "Info_CommunicationComplete" 71 "Info_ParkingToCruising" 72 "Info_CruisingToParking" 73 "Info_AlreadyInParkingSpace" 74 "Info_DriverSeatEmpty" 75 "Info_ParkingInFixedLot" 76 "Info_SearchingRandomLot" 77 "Info_NoParkingLot" 78 "Info_UnallowedParkingLot" 79 "Info_SteerByPeople" 80 "Info_SteerByObstacle" 81 "Info_AlreardySearchedLot" 82 "Info_DetectedObstacle" 83 "Info_DetectedPeople" 84 "Info_DetectedCrossing" 85 "Info_DetectedVehicle" 86 "Info_DetectedSpeedBumps" 87 "Info_SteerByVehicle" 88 "Info_TurnLeft" 89 "Info_TurnRight" 90 "Info_RefindParkingSpace" 91 "Info_OutOfAvailableParkingLot" 92 "Info_PathMatchingFailed" 93 "Info_ConditionDetectingFailed" 94 "Info_FoundParkingSpace" 95 "Info_InGuideRegion" 96 "Info_UnactiveRegion" 97 "Info_PowerOffFailed" 98 "Info_ParkingBrakeFailure" 99 "Info_DoorLockFailure" 100 "Info_ShutWindowFailure" 101 "Info_CloseToDestination" 102 "Info_ReachedTheEnd" 103 "Info_FunctionStart" 104 "Info_ParkingRearviewMirrorFolded" 105 "Info_ParkingSenslesEty" 106 "Info_NumberOfLineLearnlimited" 107 "Info_ExceedMaxlearningdistance" 108 "Info_OnlineMappingExceedLimit" 109 "Info_OfflineMappingExceedLimit" 110 "Info_LearningFailed" 111 "Info_SurroundingStaticObstacleTooClose" 112 "Info_SurroundingLightAbnormal" 113 "Info_Info_SurroundingSlopeAbnormal" 114 "Info_SurroundingRainy" 115 "Info_LearningFewerPointFeature" 116 "Info_CameraBlocked" 117 "Info_SurroundingSnowy" 118 "Info_LineSaveFailed" 119 "Info_SpeedExceedWarning" 120 "Info_DistanceExceedLv1Warning" 121 "Info_DistanceExceedLv2Warning" 122 "Info_ReservedDistanceExceed" 123 "Info_StartPointSuccess" 124 "Info_EndPointSuccess" 125 "Info_StartPointFail" 126 "Info_EndPointFail" 127 "Info_DetectedTurbulence" 128 "Info_DetectedSlope" 129 "Info_WaitingCarPullAway" 130 "Info_BrakeOnTime" 131 "Info_RemoteControl" 132 "Info_ArrivalDrop_offPointUseSmartKey" 133 "Info_ArrivalDrop_offPointUseAPP" 134 "Req_TryAgain_BeforeTakeKeyAway" 135 "Info_ParkingMode_CurrentlyUnavailable" 136 "Info_Move_Rotate" 137 "Info_ADASOpening" 138 "Req_Stop_Custom" 139 "Info_NarrowSlot_StopOutward" 140 "Info_Bluetooth_Detection" 141 "Info_PrkgSlotLeftOffsetNoAvailable" 142 "InfoPrkgSlotRightOffsetNoAvailable" 143 "Info_ParkingMode_CurrentlyUnavailable" 144 "ExcessiveVehicleSpeed_ReduceSpeedToInitiateParing" 145 "ReversePathAssistInProgress_PleaseMonitorTheSurroundings" 146 "Req_ConnectBluetooth" 147 "Info_BluetoothSignalWeak" 148 "Info_PrakingOutProcess" 149 "Info_PrakingInProcess" 150 "Info_TurbulencePossibility"  ;
VAL_ 549 ADC_PAAQuitInd 0 "No_Request" 1 "Quit_SysFailure" 2 "Quit_SpeedHigh" 3 "Quit_SearchingTimingOverflow" 4 "Quit_ParkingTimingOverflow" 5 "Quit_MoveTimesOverflow" 6 "Quit_WaitTimingOverflow" 7 "Quit_RecoverInterruptTimesOverflow" 8 "Quit_GasPedalIntervention" 9 "Quit_BrakePedalIntervention" 10 "Quit_GearIntervention" 11 "Quit_ExternalECUActive" 12 "Quit_TrajectoryLimit" 13 "Quit_SpaceLimit" 14 "Quit_PhoneDisconnected" 15 "Quit_SeatBeltUnbuckle" 16 "Quit_DoorOpen" 17 "Quit_EPBApply" 18 "Quit_VehicleBlock" 19 "Quit_GearIntervention" 20 "Quit_LuggageDoorOpen" 21 "Quit_SteeringWheelHandsOn" 22 "Quit_CancelButtonPressed" 23 "Quit_DoorLock" 24 "Quit_SBMFailureReason" 25 "Quit_RemoteDeviceFairlureReason" 26 "Quilt_UnsafeBehavior" 27 "Quit_PhoneLowBattey" 28 "Quit_VCUFailureReason" 29 "Quit_ESPFailureReason" 30 "Quit_EPSFailureReason" 31 "Quit_TBOXFailureReason" 32 "Quit_ExternalECUFailure" 33 "Quit_NoParkingLot" 34 "Quit_UnallowedParkingLot" 35 "Quit_PTReadyFailure" 36 "Quit_AlreadyInParkingSpace" 37 "Quit_PathEndingArrived" 38 "Quit_TaskFailed" 39 "Quit_PathMatchFailed" 40 "Quit_RearviewMirrorFolded" 41 "Quit_PowerOffFailed" 42 "Quit_FuncitonOff" 43 "Quit_EPSHandshakingFailed" 44 "Quit_ESPHandshakingFailed" 45 "Quit_PathMatchingFailed" 46 "Quit_ConditionDetectingFailed" 47 "Quit_PositionUnaviable" 48 "Quit_ObtainPathFailed" 49 "Quit_NoParkingLot" 50 "Quit_UnallowedParkingLot" 51 "Quit_OutOfAvailableParkingLot" 52 "Quit_UnactiveRegion" 53 "Quit_DoorLockFailure" 54 "Quit_AbnormalTirePressure" 55 "Quit_GearInterrupt" 56 "Quit_UserCancel" 57 "Quit_DriverDoorOpened" 58 "Quit_HoodOpened" 59 "Quit_CrashedDetected" 60 "Quit_LightAbnormal" 61 "Quit_RainyDay" 62 "Quit_SlopeAbnormal" 63 "Quit_FewPointFeature" 64 "Quit_FrontCameraDirty" 65 "Quit_SurroundCameraDirty" 66 "Quit_No Valid Path" 67 "Quit_Charger connected" 68 "Quit_FunctionButtonPressed" 69 "Quit_OffTrack"  ;
VAL_ 549 ADC_PAARecInd 0 "No_Request" 1 "Recover_PressInterruptSwitch" 2 "Recover_MobileOutRange" 3 "Recover_DoorOpened" 4 "Recover_FoundObstacleTrajectory" 5 "Recover_MobileCommunicationWeak" 6 "Recover_SeatBeltUnbuckle" 7 "Recover_ParkingTimingOverflow" 8 "Recover_MoveTimesOverflow" 9 "Recover_GasPedalIntervention" 10 "Recover_BrakePedalIntervention" 11 "Recover_SpaceLimit" 12 "Recover_PhoneDisconnected" 13 "Recover_EPBApply" 14 "Recover_VehicleBlock" 15 "Recover_LuggageDoorOpen" 16 "Recover_PhoneLowBattey" 17 "Recover_NoParkingLot" 18 "Recover_UnallowedParkingLot" 19 "Recover_RearviewMirrorFolded" 20 "Recover_SteeringWheelHandsOn" 21 "Recover_GearIntervention" 22 "Recover_FrontCameraDirty" 23 "Recover_SurroundCameraDirty" 24 "Recover_PressContinueSwitch (New Add)" 25 "Recover_VehicleCrossing (New Add)" 26 "Recover_PressContinue Switch BrakePedal (New Add)"  ;
VAL_ 549 ADC_Rast 0 "Off" 1 "Standby" 2 "Confirm" 3 "Active" 4 "Completed" 5 "Failure" 6 "Terminated" 7 "Reserved"  ;
VAL_ 549 ADC_RAButtonPress 0 "Not Press" 1 "Press"  ;
VAL_ 549 ADC_AuthPassSt 0 "Default" 1 "Fail" 2 "Pass" 3 "Not used"  ;
VAL_ 549 ADC_SBMAuthst 0 "Default" 1 "Fail" 2 "Pass" 3 "Not used"  ;
VAL_ 549 ADC_VehPoscoord 0 "Veh Coordinate" 1 "Slot Coordinate"  ;
VAL_ 549 ADC_HPAst 0 "Standby" 1 "Parking" 2 "HPA Completed" 3 "HPA Interrupt" 4 "HPA Terminated" 5 "HPA Resume" 6 "HPA Failure" 7 "HPA backend mapping" 8 "HPA parking into slot" 9 "HPA Checking" 10 "HPA Learning"  ;
VAL_ 549 ADC_FusionDSMWorkStFL 0 "Off" 1 "Standby" 2 "Active" 3 "Failure"  ;
VAL_ 549 ADC_FusionDSMWorkStFR 0 "Off" 1 "Standby" 2 "Active" 3 "Failure"  ;
VAL_ 549 ADC_FusionDSMWorkStRL 0 "Off" 1 "Standby" 2 "Active" 3 "Failure"  ;
VAL_ 549 ADC_FusionDSMWorkStRR 0 "Off" 1 "Standby" 2 "Active" 3 "Failure"  ;
VAL_ 549 ADC_FusionDSMOpenablePercentFL 127 "To be detected"  ;
VAL_ 549 ADC_FusionDSMEmergencyStopFL 0 "Non-Emergency stop" 1 "Emergency stop"  ;
VAL_ 549 ADC_FusionDSMValidFL 0 "Invalid" 1 "Valid"  ;
VAL_ 549 ADC_FusionDSMOpenablePercentFR 127 "To be detected"  ;
VAL_ 549 ADC_FusionDSMEmergencyStopFR 0 "Non-Emergency stop" 1 "Emergency stop"  ;
VAL_ 549 ADC_FusionDSMOpenablePercentRL 127 "To be detected"  ;
VAL_ 549 ADC_FusionDSMValidFR 0 "Invalid" 1 "Valid"  ;
VAL_ 549 ADC_parkInOutDirection 0 "None" 1 "Right cross or Diagonal rear-end park in右垂直/斜列车尾泊入" 2 "Left cross or Diagonal rear-end park in左垂直/斜列车尾泊入" 3 "Right Parallel  rear-end park in右水平车尾泊入" 4 "Left Parallel  rear-end park in左水平车尾泊入" 5 "Right Diagonal park in右斜列泊入（兼容旧ADC）" 6 "Left Diagonal park in左斜列泊入（兼容旧ADC）" 7 "Right cross or Diagonal front-end park in右垂直/斜列车头泊入" 8 "Left cross or  Diagonal front-end park in左垂直/斜列车头泊入" 9 "Right cross or Diagonal front-end park out右垂直/斜列车头泊出" 10 "Left cross or Diagonal front-end park out左垂直/斜列车头泊出" 11 "Right Parallel front-end park out右水平车头泊出" 12 "Left Parallel front-end park out左水平车头泊出" 13 "Right cross or Diagonal rear-end park out右垂直/斜列车尾泊出" 14 "Left cross or Diagonal rear-end park out左垂直/斜列车尾泊出"  ;
VAL_ 549 ADC_RPAStMessagePush 0 "Not Request" 1 "RPA standby" 2 "LRPA start" 3 "LRPA complete" 4 "LRPA teminal"  ;
VAL_ 549 ADC_RPAtype 0 "invalid" 1 "RPAWithoutConfirmation" 2 "RPAByConfirmationSelected"  ;
VAL_ 549 ADC_FusionDSMOpenablePercentRR 127 "To be detected"  ;
VAL_ 549 ADC_FusionDSMEmergencyStopRL 0 "Non-Emergency stop" 1 "Emergency stop"  ;
VAL_ 549 ADC_FusionDSMValidRL 0 "Invalid" 1 "Valid"  ;
VAL_ 549 ADC_FusionDSMEmergencyStopRR 0 "Non-Emergency stop" 1 "Emergency stop"  ;
VAL_ 549 ADC_FusionDSMValidRR 0 "Invalid" 1 "Valid"  ;
VAL_ 549 ADC_FusionDSMObstacleDisFL 255 "No obstacle detected;"  ;
VAL_ 549 ADC_FusionDSMObstacleDisFR 255 "No obstacle detected;"  ;
VAL_ 549 ADC_FusionDSMObstacleDisRL 255 "No obstacle detected;"  ;
VAL_ 549 ADC_FusionDSMObstacleDisRR 255 "No obstacle detected;"  ;
VAL_ 549 ADC_DskScreenOperationReq 0 "No request" 1 "Request"  ;
VAL_ 549 ADC_SenslesEtyParkingSt 0 "Off" 1 "On"  ;
VAL_ 549 ADC_PAALimitToast 0 "No Request;" 1 "APA OverSpeed;" 2 "Failure Limit;" 3 "Vehicle Mode Limit;" 4 "ADAS Limit;" 5 "Not Ready Limit;" 6 "AVM OverSpeed;" 7 "Not ParkSlot"  ;
VAL_ 549 ADC_PAALimitReminder 0 "No Request;" 1 "APA OverSpeed;" 2 "Failure Limit;" 3 "Vehicle Mode Limit;" 4 "ADAS Limit;" 5 "Not Ready Limit;" 6 "AVM OverSpeed;" 7 "reserved"  ;
VAL_ 549 ADC_ParkOutMode 0 "None" 1 "Cross or Diagonal   front-end  park out垂直/斜列车头泊出" 2 "Cross or Diagonal  rear-end  park out垂直/斜列车尾泊出" 3 "Parallel front-end park out水平车头泊出" 4 "Reserve" 5 "Reserve" 6 "Reserve" 7 "Reserve"  ;
VAL_ 549 ADAS_ParkStats 0 "OFF" 1 "VPD parkin active" 2 "VPD parkin abort" 3 "VPD parkin finish" 4 "VPD parkout active" 5 "VPD parkout abort" 6 "VPD parkout finish" 7 "EPA active" 8 "EPA abort" 9 "EPA finish" 10 "RPA parkin active" 11 "RPA parkin abort" 12 "RPA parkin finish" 13 "RPA parkout active" 14 "RPA parkout abort" 15 "RPA parkout finish" 16 "RDA forward active" 17 "RDA forward abort" 18 "RDA forward finish" 19 "RDA back active" 20 "RDA back abort" 21 "RDA back finish" 22 "APA parkin active" 23 "APA parkin abort" 24 "APA parkin finish" 25 "APA parkout active" 26 "APA parkout abort" 27 "APA parkout finish"  ;
VAL_ 969 ADAS_RemoterParkingOnlineOrNot 0 "None" 1 "rolling counter" 2 "rolling counter" 3 "rolling counter" 4 "rolling counter" 5 "rolling counter" 6 "rolling counter" 7 "rolling counter" 8 "rolling counter" 9 "rolling counter" 10 "rolling counter" 11 "rolling counter" 12 "rolling counter" 13 "rolling counter" 14 "rolling counter" 15 "rolling counter" 16 "rolling counter" 17 "rolling counter" 18 "rolling counter" 19 "rolling counter" 20 "rolling counter" 21 "rolling counter" 22 "rolling counter" 23 "rolling counter" 24 "rolling counter" 25 "rolling counter" 26 "rolling counter" 27 "rolling counter" 28 "rolling counter" 29 "rolling counter" 30 "rolling counter" 31 "rolling counter" 32 "rolling counter" 33 "rolling counter" 34 "rolling counter" 35 "rolling counter" 36 "rolling counter" 37 "rolling counter" 38 "rolling counter" 39 "rolling counter" 40 "rolling counter" 41 "rolling counter" 42 "rolling counter" 43 "rolling counter" 44 "rolling counter" 45 "rolling counter" 46 "rolling counter" 47 "rolling counter" 48 "rolling counter" 49 "rolling counter" 50 "rolling counter" 51 "rolling counter" 52 "rolling counter" 53 "rolling counter" 54 "rolling counter" 55 "rolling counter" 56 "rolling counter" 57 "rolling counter" 58 "rolling counter" 59 "rolling counter" 60 "rolling counter" 61 "rolling counter" 62 "rolling counter" 63 "rolling counter" 64 "rolling counter" 65 "rolling counter" 66 "rolling counter" 67 "rolling counter" 68 "rolling counter" 69 "rolling counter" 70 "rolling counter" 71 "rolling counter" 72 "rolling counter" 73 "rolling counter" 74 "rolling counter" 75 "rolling counter" 76 "rolling counter" 77 "rolling counter" 78 "rolling counter" 79 "rolling counter" 80 "rolling counter" 81 "rolling counter" 82 "rolling counter" 83 "rolling counter" 84 "rolling counter" 85 "rolling counter" 86 "rolling counter" 87 "rolling counter" 88 "rolling counter" 89 "rolling counter" 90 "rolling counter" 91 "rolling counter" 92 "rolling counter" 93 "rolling counter" 94 "rolling counter" 95 "rolling counter" 96 "rolling counter" 97 "rolling counter" 98 "rolling counter" 99 "rolling counter" 100 "rolling counter" 101 "rolling counter" 102 "rolling counter" 103 "rolling counter" 104 "rolling counter" 105 "rolling counter" 106 "rolling counter" 107 "rolling counter" 108 "rolling counter" 109 "rolling counter" 110 "rolling counter" 111 "rolling counter" 112 "rolling counter" 113 "rolling counter" 114 "rolling counter" 115 "rolling counter" 116 "rolling counter" 117 "rolling counter" 118 "rolling counter" 119 "rolling counter" 120 "rolling counter" 121 "rolling counter" 122 "rolling counter" 123 "rolling counter" 124 "rolling counter" 125 "rolling counter" 126 "rolling counter" 127 "rolling counter" 128 "rolling counter" 129 "rolling counter" 130 "rolling counter" 131 "rolling counter" 132 "rolling counter" 133 "rolling counter" 134 "rolling counter" 135 "rolling counter" 136 "rolling counter" 137 "rolling counter" 138 "rolling counter" 139 "rolling counter" 140 "rolling counter" 141 "rolling counter" 142 "rolling counter" 143 "rolling counter" 144 "rolling counter" 145 "rolling counter" 146 "rolling counter" 147 "rolling counter" 148 "rolling counter" 149 "rolling counter" 150 "rolling counter" 151 "rolling counter" 152 "rolling counter" 153 "rolling counter" 154 "rolling counter" 155 "rolling counter" 156 "rolling counter" 157 "rolling counter" 158 "rolling counter" 159 "rolling counter" 160 "rolling counter" 161 "rolling counter" 162 "rolling counter" 163 "rolling counter" 164 "rolling counter" 165 "rolling counter" 166 "rolling counter" 167 "rolling counter" 168 "rolling counter" 169 "rolling counter" 170 "rolling counter" 171 "rolling counter" 172 "rolling counter" 173 "rolling counter" 174 "rolling counter" 175 "rolling counter" 176 "rolling counter" 177 "rolling counter" 178 "rolling counter" 179 "rolling counter" 180 "rolling counter" 181 "rolling counter" 182 "rolling counter" 183 "rolling counter" 184 "rolling counter" 185 "rolling counter" 186 "rolling counter" 187 "rolling counter" 188 "rolling counter" 189 "rolling counter" 190 "rolling counter" 191 "rolling counter" 192 "rolling counter" 193 "rolling counter" 194 "rolling counter" 195 "rolling counter" 196 "rolling counter" 197 "rolling counter" 198 "rolling counter" 199 "rolling counter" 200 "rolling counter" 201 "rolling counter" 202 "rolling counter" 203 "rolling counter" 204 "rolling counter" 205 "rolling counter" 206 "rolling counter" 207 "rolling counter" 208 "rolling counter" 209 "rolling counter" 210 "rolling counter" 211 "rolling counter" 212 "rolling counter" 213 "rolling counter" 214 "rolling counter" 215 "rolling counter" 216 "rolling counter" 217 "rolling counter" 218 "rolling counter" 219 "rolling counter" 220 "rolling counter" 221 "rolling counter" 222 "rolling counter" 223 "rolling counter" 224 "rolling counter" 225 "rolling counter" 226 "rolling counter" 227 "rolling counter" 228 "rolling counter" 229 "rolling counter" 230 "rolling counter" 231 "rolling counter" 232 "rolling counter" 233 "rolling counter" 234 "rolling counter" 235 "rolling counter" 236 "rolling counter" 237 "rolling counter" 238 "rolling counter" 239 "rolling counter" 240 "rolling counter" 241 "rolling counter" 242 "rolling counter" 243 "rolling counter" 244 "rolling counter" 245 "rolling counter" 246 "rolling counter" 247 "rolling counter" 248 "rolling counter" 249 "rolling counter" 250 "rolling counter" 251 "rolling counter" 252 "rolling counter" 253 "rolling counter" 254 "rolling counter" 255 "rolling counter"  ;
VAL_ 969 ADC_RpaParkAuthn 0 "phone_authorized_unconfirm" 1 "phone_authorized_confirm" 2 "reserve_1" 3 "reserve_2"  ;
VAL_ 969 ADC_RemParkPatSel 0 "NONE" 1 "PARK_IN_REQUEST_CONFIRMED" 2 "PARK_OUT_REQUEST_CONFIRMED" 3 "RESERVED"  ;
VAL_ 969 ADC_ParkDirCfm 0 "None" 1 "ParallelLeft_confirm" 2 "ParallelRight_confirm" 3 "PerpendicularForward_confirm" 4 "PerpendicularLeftForward_confirm" 5 "PerpendicularRightForward_confirm" 6 "PerpendicularLeftBack_confirm" 7 "PerpendicularRightBack_confirm" 8 "PerpendicularBack_confirm" 9 "Reserved" 10 "Reserved" 11 "Reserved" 12 "Reserved" 13 "Reserved" 14 "Reserved" 15 "Reserved"  ;
VAL_ 969 ADC_ParkStMac 0 "STATE_OFF" 1 "STATE_RDA_FORWARD" 2 "STATE_RDA_BACK" 3 "STATE_RDA_ABORT" 4 "STATE_RDA_FINISH" 5 "STATE_CRUISE_FINISH" 6 "STATE_APA_SUSPEND" 7 "STATE_APA_SEARCH" 8 "STATE_APA_STANDBY" 9 "STATE_PARK_OUT" 10 "STATE_PARK_IN" 11 "STATE_APA_FINISH" 12 "STATE_PAUSE" 13 "STATE_OVERRIDE" 14 "Reserved" 15 "Reserved"  ;
VAL_ 969 ADC_PwrOnOffReq 0 "None" 1 "Power on & Enter Ready" 2 "Power off & Lock car" 3 "Enter the ready state" 4 "Exit ready state (maintain high voltage)" 5 "Power off only" 6 "Reserved" 7 "Reserved"  ;
VAL_ 969 ADC_ParkOutDir_ParaLe 0 "Not available" 1 "Available"  ;
VAL_ 969 ADC_ParkOutDir_ParaRi 0 "Not available" 1 "Available"  ;
VAL_ 969 ADC_ParkOutDir_PerpFwd 0 "Not available" 1 "Available"  ;
VAL_ 969 ADC_ParkOutDir_PerpLeFwd 0 "Not available" 1 "Available"  ;
VAL_ 969 ADC_ParkOutDir_PerpRiFwd 0 "Not available" 1 "Available"  ;
VAL_ 969 ADC_ParkOutDir_PerpLeBack 0 "Not available" 1 "Available"  ;
VAL_ 969 ADC_ParkOutDir_PerpRiBack 0 "Not available" 1 "Available"  ;
VAL_ 969 ADC_ParkOutDir_PerpBack 0 "Not available" 1 "Available"  ;
VAL_ 969 ADC_APA_RPAFctUnavlMsg1 0 "none" 1 "happened"  ;
VAL_ 969 ADC_APA_RPAFctUnavlMsg2 0 "none" 1 "happened"  ;
VAL_ 969 ADC_APA_RPAFctUnavlMsg3 0 "none" 1 "happened"  ;
VAL_ 969 ADC_APA_RPAFctUnavlMsg4 0 "none" 1 "happened"  ;
VAL_ 969 ADC_APA_RPAFctUnavlMsg5 0 "none" 1 "happened"  ;
VAL_ 969 ADC_APA_RPAFctUnavlMsg6 0 "none" 1 "happened"  ;
VAL_ 969 ADC_APA_RPAFctUnavlMsg7 0 "none" 1 "happened"  ;
VAL_ 969 ADC_APA_RPAFctUnavlMsg8 0 "none" 1 "happened"  ;
VAL_ 969 ADC_APA_RPAFctUnavlMsg9 0 "none" 1 "happened"  ;
VAL_ 969 ADC_APA_RPAFctUnavlMsg10 0 "none" 1 "happened"  ;
VAL_ 969 ADC_APA_RPAFctUnavlMsg11 0 "none" 1 "happened"  ;
VAL_ 969 ADC_APA_RPAFctUnavlMsg12 0 "none" 1 "happened"  ;
VAL_ 969 ADC_APA_RPAFctUnavlMsg13 0 "none" 1 "happened"  ;
VAL_ 969 ADC_APA_RPAFctUnavlMsg14 0 "none" 1 "happened"  ;
VAL_ 969 ADC_APA_RPAFctUnavlMsg15 0 "none" 1 "happened"  ;
VAL_ 969 ADC_APA_RPAFctUnavlMsg16 0 "none" 1 "happened"  ;
VAL_ 969 ADC_APA_RPAFctUnavlMsg17 0 "none" 1 "happened"  ;
VAL_ 969 ADC_APA_RPAFctUnavlMsg18 0 "none" 1 "happened"  ;
VAL_ 969 ADC_APA_RPAFctUnavlMsg19 0 "none" 1 "happened"  ;
VAL_ 969 ADC_APA_RPAFctUnavlMsg20 0 "none" 1 "happened"  ;
VAL_ 969 ADC_APA_RPAFctUnavlMsg21 0 "none" 1 "happened"  ;
VAL_ 969 ADC_APA_RPAFctUnavlMsg22 0 "none" 1 "happened"  ;
VAL_ 969 ADC_APA_RPAFctUnavlMsg23 0 "none" 1 "happened"  ;
VAL_ 969 ADC_APA_RPAFctUnavlMsg24 0 "none" 1 "happened"  ;
VAL_ 969 ADC_APA_RPAFctUnavlMsg25 0 "none" 1 "happened"  ;
VAL_ 969 ADC_APA_RPACnclMsg1 0 "none" 1 "happened"  ;
VAL_ 969 ADC_APA_RPACnclMsg2 0 "none" 1 "happened"  ;
VAL_ 969 ADC_APA_RPACnclMsg3 0 "none" 1 "happened"  ;
VAL_ 969 ADC_APA_RPACnclMsg4 0 "none" 1 "happened"  ;
VAL_ 969 ADC_APA_RPACnclMsg5 0 "none" 1 "happened"  ;
VAL_ 969 ADC_APA_RPACnclMsg6 0 "none" 1 "happened"  ;
VAL_ 969 ADC_APA_RPACnclMsg7 0 "none" 1 "happened"  ;
VAL_ 969 ADC_APA_RPACnclMsg8 0 "none" 1 "happened"  ;
VAL_ 969 ADC_APA_RPACnclMsg9 0 "none" 1 "happened"  ;
VAL_ 969 ADC_APA_RPACnclMsg10 0 "none" 1 "happened"  ;
VAL_ 969 ADC_APA_RPACnclMsg11 0 "none" 1 "happened"  ;
VAL_ 969 ADC_APA_RPACnclMsg12 0 "none" 1 "happened"  ;
VAL_ 969 ADC_APA_RPACnclMsg13 0 "none" 1 "happened"  ;
VAL_ 969 ADC_APA_RPACnclMsg14 0 "none" 1 "happened"  ;
VAL_ 969 ADC_APA_RPACnclMsg15 0 "none" 1 "happened"  ;
VAL_ 969 ADC_APA_RPACnclMsg16 0 "none" 1 "happened"  ;
VAL_ 969 ADC_APA_RPACnclMsg17 0 "none" 1 "happened"  ;
VAL_ 969 ADC_APA_RPACnclMsg18 0 "none" 1 "happened"  ;
VAL_ 969 ADC_APA_RPACnclMsg19 0 "none" 1 "happened"  ;
VAL_ 969 ADC_APA_RPACnclMsg20 0 "none" 1 "happened"  ;
VAL_ 969 ADC_APA_RPAPauseMsg1 0 "none" 1 "happened"  ;
VAL_ 969 ADC_APA_RPAPauseMsg2 0 "none" 1 "happened"  ;
VAL_ 969 ADC_APA_RPAPauseMsg3 0 "none" 1 "happened"  ;
VAL_ 969 ADC_APA_RPAPauseMsg4 0 "none" 1 "happened"  ;
VAL_ 969 ADC_APA_RPAPauseMsg5 0 "none" 1 "happened"  ;
VAL_ 969 ADC_APA_RPAPauseMsg6 0 "none" 1 "happened"  ;
VAL_ 969 ADC_APA_RPAPauseMsg7 0 "none" 1 "happened"  ;
VAL_ 969 ADC_APA_RPAPauseMsg8 0 "none" 1 "happened"  ;
VAL_ 969 ADC_APA_RPAPauseMsg9 0 "none" 1 "happened"  ;
VAL_ 969 ADC_APA_RPAPauseMsg10 0 "none" 1 "happened"  ;
