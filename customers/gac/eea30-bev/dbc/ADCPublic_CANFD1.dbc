VERSION "Version"

NS_ :

BS_:

BU_: CCU ADC FAPA IFC FLR FRR RRR RLR INU Tester CBM VIU SRS IDC PCS AMP IMR FIMR TBOX IBCS IXCU V2XOBU WHUD RLBMS CCURT2 RT2_C3 OTAWL ZCUF ZCUL ZCUR ZCUT IPS DCU NIDU RBM WACUFL IID CCURT1 RT1_C0 RT1_C1 AVAS FLLCM FRLCM RLLCMA RRLCMA RLLCMB RRLCMB LBMS LBMSAD MFS FCP IDU ITS BCB DCDC PCU EOP DCU2 BMS TMC EPS ECS CD PAS SBM WCM ETC TBOX2 DSM FLPDM FRPDM RLPDM RRPDM HVSMR SCMRL SCMRR EBU EPB VDC EVCC ADM PLGM FBLCM RLISD RRISD RCP RFR WCMFR SCMR TFOAR TROAR HVSPRL HVSPRR

BO_ 411 ADC_2: 64 ADC
 SG_ ADC_2_CRC : 7|16@0+ (1,0) [0|65535] ""  CCU,CCURT1,CCURT2,RT2_C3,FAPA,FLR,FRR
 SG_ ADC_2_Counter : 23|8@0+ (1,0) [0|255] ""  CCU,CCURT1,CCURT2,RT2_C3,FAPA,FLR,FRR
 SG_ ADC_FCWAssistType : 31|2@0+ (1,0) [0|3] ""  CCU,CCURT1,CCURT2,IDC,FAPA
 SG_ ADC_FCWFaultSt : 29|1@0+ (1,0) [0|1] ""  CCU,CCURT1,CCURT2,IDC,FAPA
 SG_ ADC_FCWPreWarn : 28|2@0+ (1,0) [0|3] ""  CCU,CCURT1,CCURT2,RT1_C1,IDC,FAPA
 SG_ ADC_FCWLatentWarn : 26|2@0+ (1,0) [0|3] ""  CCU,CCURT1,CCURT2,IDC,FAPA
 SG_ ADC_AutonomyLevel : 24|3@0+ (1,0) [0|7] ""  CCU,CCURT1,CCURT2,FAPA
 SG_ ADC_FCWWarmDistance : 37|2@0+ (1,0) [0|3] ""  CCU,CCURT1,CCURT2,IDC,FAPA
 SG_ ADC_AEBTarObjType : 35|4@0+ (1,0) [0|15] ""  CCU,CCURT1,CCURT2,IDC,FAPA
 SG_ ADC_PMAEnableSt : 47|1@0+ (1,0) [0|1] ""  CCU,CCURT1,CCURT2,FAPA
 SG_ ADC_PMAWarStatus : 48|1@0+ (1,0) [0|1] ""  CCU,CCURT1,CCURT2,FAPA
 SG_ ADC_BSDVibrWarnR : 46|3@0+ (1,0) [0|7] ""  CCU,CCURT1,CCURT2,RT2_C3,FAPA,FLR,FRR
 SG_ ADC_BSDVibrWarnL : 43|3@0+ (1,0) [0|7] ""  CCU,CCURT1,CCURT2,RT2_C3,FAPA,FLR,FRR
 SG_ ADC_AEBBrkPedalOverRide : 52|1@0+ (1,0) [0|1] ""  CCU,CCURT1,CCURT2,FAPA
 SG_ ADC_AEBBrePedalPressure : 51|1@0+ (1,0) [0|1] ""  CCU,CCURT1,CCURT2,FAPA
 SG_ ADC_AEBAccelePedalOverRide : 50|1@0+ (1,0) [0|1] ""  CCU,CCURT1,CCURT2,FAPA
 SG_ ADC_AEBSteeringInhibit : 49|1@0+ (1,0) [0|1] ""  CCU,CCURT1,CCURT2,RT2_C3,FAPA
 SG_ ADC_AEBTarLatPos : 63|10@0+ (0.1,-51.2) [-51.2|51.1] "m"  CCU,CCURT1,CCURT2,FAPA
 SG_ ADC_AEBTarRangeRate : 69|10@0+ (0.1,-51.2) [-51.2|51.1] "m/s"  CCU,CCURT1,CCURT2,FAPA
 SG_ ADC_AEBTarOncomingState : 87|1@0+ (1,0) [0|1] ""  CCU,CCURT1,CCURT2,FAPA
 SG_ ADC_AEBTarMotionState : 86|2@0+ (1,0) [0|3] ""  CCU,CCURT1,CCURT2,FAPA
 SG_ ADC_AEBTarConfiLevel : 84|3@0+ (1,0) [0|7] ""  CCU,CCURT1,CCURT2,FAPA
 SG_ ADC_AEBTarLongPos : 81|10@0+ (0.1,0) [0|102.3] "m"  CCU,CCURT1,CCURT2,FAPA
 SG_ ADC_AEBTarLatSpd : 103|9@0+ (0.1,-25.5) [-25.5|25.5] "m/s"  CCU,CCURT1,CCURT2,FAPA
 SG_ ADC_AEBTarSensorSource : 110|4@0+ (1,0) [0|15] ""  CCU,CCURT1,CCURT2,FAPA
 SG_ ADC_AEBTarRangeAccel : 105|9@0+ (0.1,-25.5) [-25.5|25.5] "m/s^2"  CCU,CCURT1,CCURT2,FAPA
 SG_ ADC_DOWAudioWarnFR : 143|2@0+ (1,0) [0|3] ""  CCU,CCURT1,CCURT2,IDC,FAPA,FLR,FRR
 SG_ ADC_DOWAudioWarnFL : 141|2@0+ (1,0) [0|3] ""  CCU,CCURT1,CCURT2,IDC,FAPA,FLR,FRR
 SG_ ADC_DOWAudioWarnRR : 139|2@0+ (1,0) [0|3] ""  CCU,CCURT1,CCURT2,IDC,FAPA,FLR,FRR
 SG_ ADC_DOWAudioWarnRL : 137|2@0+ (1,0) [0|3] ""  CCU,CCURT1,CCURT2,IDC,FAPA,FLR,FRR
 SG_ ADC_DOWIALWarnFR : 151|2@0+ (1,0) [0|3] ""  CCU,CCURT1,CCURT2,RT2_C3,IDC,FAPA,FLR,FRR,RLR,RRR
 SG_ ADC_DOWIALWarnFL : 149|2@0+ (1,0) [0|3] ""  CCU,CCURT1,CCURT2,RT2_C3,FAPA,FLR,FRR,RLR,RRR
 SG_ ADC_DOWIALWarnRR : 147|2@0+ (1,0) [0|3] ""  CCU,CCURT1,CCURT2,RT2_C3,IDC,FAPA,FLR,FRR,RLR,RRR
 SG_ ADC_DOWIALWarnRL : 145|2@0+ (1,0) [0|3] ""  CCU,CCURT1,CCURT2,RT2_C3,FAPA,FLR,FRR,RLR,RRR
 SG_ ADC_BSDExMirLedWarnR : 159|2@0+ (1,0) [0|3] ""  CCU,CCURT1,CCURT2,RT2_C3,ZCUR,FAPA,FLR,FRR,RLR,RRR
 SG_ ADC_BSDExMirLedWarnL : 157|2@0+ (1,0) [0|3] ""  CCU,CCURT1,CCURT2,RT2_C3,ZCUR,FAPA,FLR,FRR,RLR,RRR
 SG_ ADC_BSDLCASt : 153|2@0+ (1,0) [0|3] ""  CCU,CCURT1,CCURT2,IDC,FAPA,FLR,FRR,RLR,RRR,TBOX
 SG_ ADC_BSDLCAEnableSt : 167|1@0+ (1,0) [0|1] ""  CCU,CCURT1,CCURT2,FAPA,FLR,FRR,RLR,RRR
 SG_ ADC_RCTAEnableSt : 166|1@0+ (1,0) [0|1] ""  CCU,CCURT1,CCURT2,FAPA,FLR,FRR,RLR,RRR
 SG_ ADC_RCTASt : 165|2@0+ (1,0) [0|3] ""  CCU,CCURT1,CCURT2,IDC,FAPA,FLR,FRR,RLR,RRR,TBOX
 SG_ ADC_RCTAAssistType : 163|2@0+ (1,0) [0|3] ""  CCU,CCURT1,CCURT2,IDC,FAPA,FLR,FRR,RLR,RRR,TBOX
 SG_ ADC_DOWSt : 161|2@0+ (1,0) [0|3] ""  CCU,CCURT1,CCURT2,IDC,FAPA,FLR,FRR,RLR,RRR,TBOX
 SG_ ADC_DOWEnableSt : 175|1@0+ (1,0) [0|1] ""  CCU,CCURT1,CCURT2,FAPA,FLR,FRR,RLR,RRR
 SG_ ADC_LCAWarnLeft : 174|2@0+ (1,0) [0|3] ""  CCU,CCURT1,CCURT2,FAPA,FLR,FRR,RLR,RRR
 SG_ ADC_LCAWarnRight : 172|2@0+ (1,0) [0|3] ""  CCU,CCURT1,CCURT2,FAPA,FLR,FRR,RLR,RRR
 SG_ ADC_RCTAWarnLeft : 170|2@0+ (1,0) [0|3] ""  CCU,CCURT1,CCURT2,IDC,FAPA,FLR,FRR,RLR
 SG_ ADC_RCWEnableSt : 168|1@0+ (1,0) [0|1] ""  CCU,CCURT1,CCURT2,FAPA,FLR,FRR,RLR,RRR
 SG_ ADC_RCTAWarnRight : 183|2@0+ (1,0) [0|3] ""  CCU,CCURT1,CCURT2,IDC,FAPA,FLR,FRR,RLR
 SG_ ADC_RCWSt : 181|2@0+ (1,0) [0|3] ""  CCU,CCURT1,CCURT2,IDC,FAPA,FLR,FRR,RLR
 SG_ ADC_RCWWarn : 179|2@0+ (1,0) [0|3] ""  CCU,CCURT1,CCURT2,RT2_C3,FAPA,FLR,FRR,RLR
 SG_ ADC_FCTAEnableSt : 177|1@0+ (1,0) [0|1] ""  CCU,CCURT1,CCURT2,FAPA
 SG_ ADC_FCTASt : 191|2@0+ (1,0) [0|3] ""  CCU,CCURT1,CCURT2,IDC,FAPA
 SG_ ADC_FCTAAssistType : 189|2@0+ (1,0) [0|3] ""  CCU,CCURT1,CCURT2,IDC,FAPA,FLR,FRR
 SG_ ADC_FCTAWarnL : 187|2@0+ (1,0) [0|3] ""  CCU,CCURT1,CCURT2,IDC,FAPA
 SG_ ADC_FCTAWarnR : 185|2@0+ (1,0) [0|3] ""  CCU,CCURT1,CCURT2,IDC,FAPA
 SG_ ADC_FroNestTarRangeRate : 199|10@0+ (0.1,-51.2) [-51.2|51.1] "m/s"  CCU,CCURT1,CCURT2,FAPA
 SG_ ADC_FroNestTarLatSpd : 205|9@0+ (0.1,-25.5) [-25.5|25.5] "m/s"  CCU,CCURT1,CCURT2,FAPA
 SG_ ADC_FroNestTarRangeAccel : 208|9@0+ (0.1,-25.5) [-25.5|25.5] "m/s^2"  CCU,CCURT1,CCURT2,FAPA
 SG_ ADC_FroNestTarObjType : 231|4@0+ (1,0) [0|15] ""  CCU,CCURT1,CCURT2,FAPA
 SG_ ADC_FroNestTarDetSensor : 227|4@0+ (1,0) [0|15] ""  CCU,CCURT1,CCURT2,FAPA
 SG_ ADC_LDS_LaneAssistType : 239|2@0+ (1,0) [0|3] ""  CCU,CCURT1,CCURT2,IDC,FAPA,TBOX
 SG_ ADC_IHBC_EnableSt : 237|1@0+ (1,0) [0|1] ""  CCU,CCURT1,CCURT2,IDC,FAPA
 SG_ ADC_TSR_EnableSt : 236|1@0+ (1,0) [0|1] ""  CCU,CCURT1,CCURT2,IDC,FAPA
 SG_ ADC_TSR_AudioWarn_EnableSt : 235|1@0+ (1,0) [0|1] ""  CCU,CCURT1,CCURT2,IDC,FAPA
 SG_ ADC_ELK_EnableSt : 234|1@0+ (1,0) [0|1] ""  CCU,CCURT1,CCURT2,IDC,FAPA,FLR,FRR
 SG_ ADC_ESA_EnableSt : 233|1@0+ (1,0) [0|1] ""  CCU,CCURT1,CCURT2,IDC,FAPA
 SG_ ADC_AES_EnableSt : 232|1@0+ (1,0) [0|1] ""  CCU,CCURT1,CCURT2,IDC,FAPA
 SG_ ADC_LDWSt : 247|3@0+ (1,0) [0|7] ""  CCU,CCURT1,CCURT2,RT1_C1,FAPA
 SG_ ADC_LDW_Actdirection : 244|2@0+ (1,0) [0|3] ""  CCU,CCURT1,CCURT2,FAPA
 SG_ ADC_LDP_Actdirection : 242|2@0+ (1,0) [0|3] ""  CCU,CCURT1,CCURT2,FAPA
 SG_ ADC_LDW_PassiveReason : 255|5@0+ (1,0) [0|31] ""  CCU,CCURT1,CCURT2,FAPA
 SG_ ADC_LDPSt : 250|3@0+ (1,0) [0|7] ""  CCU,CCURT1,CCURT2,RT1_C1,FAPA
 SG_ ADC_LDP_PassiveReason : 263|5@0+ (1,0) [0|31] ""  CCU,CCURT1,CCURT2,FAPA
 SG_ ADC_RDP_St : 258|3@0+ (1,0) [0|7] ""  CCU,CCURT1,CCURT2,FAPA
 SG_ ADC_RDP_PassiveReason : 271|5@0+ (1,0) [0|31] ""  CCU,CCURT1,CCURT2,FAPA
 SG_ ADC_IHBC_St : 266|3@0+ (1,0) [0|7] ""  CCU,CCURT1,CCURT2,RT2_C3,FAPA
 SG_ ADC_RDP_Actdirection : 279|2@0+ (1,0) [0|3] ""  CCU,CCURT1,CCURT2,FAPA
 SG_ ADC_FCMS_SwitchLockReq : 75|2@0+ (1,0) [0|3] ""  CCU,CCURT1,CCURT2,FAPA
 SG_ ADC_LKSLaneAssistSensitivity : 211|3@0+ (1,0) [0|7] ""  CCU,CCURT1,CCURT2,FAPA
 SG_ ADC_ELKSt : 277|2@0+ (1,0) [0|3] ""  CCU,CCURT1,CCURT2,FAPA
 SG_ ADC_IHBC_SuppressSt : 286|2@0+ (1,0) [0|3] ""  CCU,CCURT1,CCURT2,FAPA
 SG_ ADC_IHBC_SuppressReason : 284|5@0+ (1,0) [0|31] ""  CCU,CCURT1,CCURT2,FAPA
 SG_ ADC_IHBC_Dis2Oncoming : 295|8@0+ (1,0) [0|100] ""  CCU,CCURT1,CCURT2,FAPA
 SG_ ADC_IHBC_Dis2Preceding : 303|8@0+ (1,0) [0|100] ""  CCU,CCURT1,CCURT2,FAPA
 SG_ ADC_IHBC_RoadlightNum : 311|8@0+ (1,0) [0|100] ""  CCU,CCURT1,CCURT2,FAPA
 SG_ ADC_IHBC_Dis2NearestRoadlight : 319|8@0+ (1,0) [0|200] ""  CCU,CCURT1,CCURT2,FAPA
 SG_ ADC_IHBC_TargetType : 327|3@0+ (1,0) [0|7] ""  CCU,CCURT1,CCURT2,FAPA
 SG_ ADC_TSR_SpdLimit : 324|5@0+ (1,0) [0|31] ""  CCU,CCURT1,CCURT2,IDC,FAPA,TBOX
 SG_ ADC_TSR_SpdLimType : 335|2@0+ (1,0) [0|3] ""  CCU,CCURT1,CCURT2,FAPA
 SG_ ADC_TSRMode : 333|3@0+ (1,0) [0|7] ""  CCU,CCURT1,CCURT2,FAPA
 SG_ ADC_TSR_St : 330|2@0+ (1,0) [0|3] ""  CCU,CCURT1,CCURT2,FAPA
 SG_ ADC_TSR_FailureReason : 328|3@0+ (1,0) [0|7] ""  CCU,CCURT1,CCURT2,FAPA
 SG_ ADC_TSR_TrafficSignType : 341|6@0+ (1,0) [0|40] ""  CCU,CCURT1,CCURT2,FAPA
 SG_ ADC_TSRDisToIntervalEnd : 351|8@0+ (1,0) [0|70] "km"  CCU,CCURT1,CCURT2,FAPA
 SG_ ADC_TSRDisToCamera : 359|8@0+ (5,0) [0|1250] "m"  CCU,CCURT1,CCURT2,FAPA
 SG_ ADC_TSR_SpeedLimitSource : 367|3@0+ (1,0) [0|7] ""  CCU,CCURT1,CCURT2,FAPA
 SG_ ADC_TSR_WarnEnabledType : 364|3@0+ (1,0) [0|7] ""  CCU,CCURT1,CCURT2,FAPA
 SG_ ADC_TSR_TactileWarn : 361|1@0+ (1,0) [0|1] ""  CCU,CCURT1,CCURT2,FAPA
 SG_ ADC_TSR_VisualWarn : 360|1@0+ (1,0) [0|1] ""  CCU,CCURT1,CCURT2,FAPA
 SG_ ADC_TSR_SuppressReason : 375|5@0+ (1,0) [0|31] ""  CCU,CCURT1,CCURT2,FAPA
 SG_ ADC_TSR_SpdLimitUnit : 370|2@0+ (1,0) [0|3] ""  CCU,CCURT1,CCURT2,IDC,FAPA
 SG_ ADC_TSR_AcousticWarn : 368|1@0+ (1,0) [0|1] ""  CCU,CCURT1,CCURT2,FAPA
 SG_ ADC_ELKoncomingSt : 383|3@0+ (1,0) [0|7] ""  CCU,CCURT1,CCURT2,RT1_C1,FAPA
 SG_ ADC_ELKoncoming_PassiveReason : 380|5@0+ (1,0) [0|31] ""  CCU,CCURT1,CCURT2,FAPA
 SG_ ADC_ELKoncoming_Actdirection : 391|2@0+ (1,0) [0|3] ""  CCU,CCURT1,CCURT2,FAPA
 SG_ ADC_ELKovertakingSt : 389|3@0+ (1,0) [0|7] ""  CCU,CCURT1,CCURT2,RT1_C1,FAPA,FLR,FRR
 SG_ ADC_ELKovertaking_ActDirection : 386|2@0+ (1,0) [0|3] ""  CCU,CCURT1,CCURT2,FAPA,FLR,FRR
 SG_ ADC_ISAChangeAudEnable : 384|1@0+ (1,0) [0|1] ""  CCU,CCURT1,CCURT2,FAPA
 SG_ ADC_ELKovertaking_PassiveReason : 399|5@0+ (1,0) [0|31] ""  CCU,CCURT1,CCURT2,FAPA,FLR,FRR
 SG_ ADC_ELK_TargetObjClass : 394|3@0+ (1,0) [0|7] ""  CCU,CCURT1,CCURT2,FAPA,FLR,FRR
 SG_ ADC_ESA_St : 407|3@0+ (1,0) [0|7] ""  CCU,CCURT1,CCURT2,RT1_C1,FAPA
 SG_ ADC_ESA_ActDirection : 404|2@0+ (1,0) [0|3] ""  CCU,CCURT1,CCURT2,FAPA
 SG_ ADC_AES_St : 402|3@0+ (1,0) [0|7] ""  CCU,CCURT1,CCURT2,RT1_C1,FAPA
 SG_ ADC_AES_ActDirection : 415|2@0+ (1,0) [0|3] ""  CCU,CCURT1,CCURT2,FAPA
 SG_ ADC_RDP_Number : 413|6@0+ (1,0) [0|63] ""  CCU,CCURT1,CCURT2,FAPA
 SG_ ADC_ELKoncoming_ActiveWarn : 423|1@0+ (1,0) [0|1] ""  CCU,CCURT1,CCURT2,FAPA,FLR,FRR
 SG_ ADC_ELKovertaking_ActiveWarn : 422|1@0+ (1,0) [0|1] ""  CCU,CCURT1,CCURT2,FAPA,FLR,FRR
 SG_ ADC_ELKoncoming_Number : 421|6@0+ (1,0) [0|63] ""  CCU,CCURT1,CCURT2,FAPA
 SG_ ADC_ESA_ActiveWarn : 431|1@0+ (1,0) [0|1] ""  CCU,CCURT1,CCURT2,FAPA
 SG_ ADC_AES_ActiveWarn : 430|1@0+ (1,0) [0|1] ""  CCU,CCURT1,CCURT2,FAPA
 SG_ ADC_ELKovertaking_Numbe : 429|6@0+ (1,0) [0|63] ""  CCU,CCURT1,CCURT2,FAPA
 SG_ ADC_ESA_TargetObjClass : 439|3@0+ (1,0) [0|7] ""  CCU,CCURT1,CCURT2,FAPA
 SG_ ADC_ESA_PassiveReason : 436|5@0+ (1,0) [0|31] ""  CCU,CCURT1,CCURT2,FAPA
 SG_ ADC_AES_TargetObjClass : 447|3@0+ (1,0) [0|7] ""  CCU,CCURT1,CCURT2,FAPA
 SG_ ADC_AES_PassiveReason : 444|5@0+ (1,0) [0|31] ""  CCU,CCURT1,CCURT2,FAPA
 SG_ ADC_LDW_Number : 455|8@0+ (1,0) [0|255] ""  CCU,CCURT1,CCURT2,FAPA
 SG_ ADC_LDPNumber : 463|8@0+ (1,0) [0|255] ""  CCU,CCURT1,CCURT2,FAPA
 SG_ ADC_L1_LatfaultReason : 471|5@0+ (1,0) [0|31] ""  CCU,CCURT1,CCURT2,FAPA
 SG_ ADC_ESA_Number : 466|6@0+ (1,0) [0|63] ""  CCU,CCURT1,CCURT2,FAPA
 SG_ ADC_AES_Number : 476|6@0+ (1,0) [0|63] ""  CCU,CCURT1,CCURT2,FAPA
 SG_ ADC_FroNestTarLatPos : 486|10@0+ (0.1,-51.2) [-51.2|51.1] "m"  CCU,CCURT1,CCURT2,FAPA
 SG_ ADC_FroNestTarLongPos : 492|10@0+ (0.1,0) [0|102.3] "m"  CCU,CCURT1,CCURT2,FAPA
 SG_ ADC_LDSIconColor : 498|3@0+ (1,0) [0|7] ""  CCU,CCURT1,CCURT2,FAPA
 SG_ ADC_LOCP_St : 506|3@0+ (1,0) [0|7] ""  CCU,CCURT1,CCURT2,FAPA

BO_ 915 ADC_3: 64 ADC
 SG_ ADC_3_CRC : 7|16@0+ (1,0) [0|65535] ""  CCU,CCURT1,CCURT2,IFC,INU
 SG_ ADC_3_Counter : 23|8@0+ (1,0) [0|255] ""  CCU,CCURT1,CCURT2,IFC,INU
 SG_ ADC_FroTrkTargt0ObjClass : 31|4@0+ (1,0) [0|15] ""  CCU,CCURT1,CCURT2
 SG_ ADC_FroTrkTargt0St : 27|1@0+ (1,0) [0|1] ""  CCU,CCURT1,CCURT2
 SG_ ADC_FroTrkTargt0longPos : 25|10@0+ (0.2,0) [0|204.4] "m"  CCU,CCURT1,CCURT2,TBOX
 SG_ ADC_FroTrkTargt0latPos : 47|10@0+ (0.1,-51.2) [-51.2|51.1] "m"  CCU,CCURT1,CCURT2,TBOX
 SG_ ADC_FroTrkTargt0LatRelSpd : 53|9@0+ (0.1,-25.5) [-25.5|25.5] "m/s"  CCU,CCURT1,CCURT2,TBOX
 SG_ ADC_FroTrkTargt0LongRelSpd : 60|10@0+ (0.1,-51.2) [-51.2|51.1] "m/s"  CCU,CCURT1,CCURT2,TBOX
 SG_ ADC_FroTrkTargt0DetSensor : 79|4@0+ (1,0) [0|15] ""  CCU,CCURT1,CCURT2
 SG_ ADC_FroTrkTargt1ObjClass : 75|4@0+ (1,0) [0|15] ""  CCU,CCURT1,CCURT2
 SG_ ADC_FroTrkTargt1St : 87|1@0+ (1,0) [0|1] ""  CCU,CCURT1,CCURT2
 SG_ ADC_FroTrkTargt1longPos : 86|10@0+ (0.2,0) [0|204.4] "m"  CCU,CCURT1,CCURT2,TBOX
 SG_ ADC_FroTrkTargt1latPos : 92|10@0+ (0.1,-51.2) [-51.2|51.1] "m"  CCU,CCURT1,CCURT2,TBOX
 SG_ ADC_FroTrkTargt1LatRelSpd : 98|9@0+ (0.1,-25.5) [-25.5|25.5] "m/s"  CCU,CCURT1,CCURT2,TBOX
 SG_ ADC_FroTrkTargt1LongRelSpd : 105|10@0+ (0.1,-51.2) [-51.2|51.1] "m/s"  CCU,CCURT1,CCURT2,TBOX
 SG_ ADC_FroTrkTargt1DetSensor : 127|4@0+ (1,0) [0|15] ""  CCU,CCURT1,CCURT2,TBOX
 SG_ ADC_FroTrkTargt2ObjClass : 123|4@0+ (1,0) [0|15] ""  CCU,CCURT1,CCURT2,TBOX
 SG_ ADC_FroTrkTargt2St : 135|1@0+ (1,0) [0|1] ""  CCU,CCURT1,CCURT2,TBOX
 SG_ ADC_FroTrkTargt2longPos : 134|10@0+ (0.2,0) [0|204.4] "m"  CCU,CCURT1,CCURT2,TBOX
 SG_ ADC_FroTrkTargt2latPos : 140|10@0+ (0.1,-51.2) [-51.2|51.1] "m"  CCU,CCURT1,CCURT2,TBOX
 SG_ ADC_FroTrkTargt2LatRelSpd : 146|9@0+ (0.1,-25.5) [-25.5|25.5] "m/s"  CCU,CCURT1,CCURT2,TBOX
 SG_ ADC_FroTrkTargt2LongRelSpd : 167|10@0+ (0.1,-51.2) [-51.2|51.1] "m/s"  CCU,CCURT1,CCURT2,TBOX
 SG_ ADC_FroTrkTargt2DetSensor : 183|4@0+ (1,0) [0|15] ""  CCU,CCURT1,CCURT2,TBOX
 SG_ ADC_FroTrkTargt3ObjClass : 179|4@0+ (1,0) [0|15] ""  CCU,CCURT1,CCURT2,TBOX
 SG_ ADC_FroTrkTargt3St : 191|1@0+ (1,0) [0|1] ""  CCU,CCURT1,CCURT2,TBOX
 SG_ ADC_FroTrkTargt3longPos : 190|10@0+ (0.2,0) [0|204.4] "m"  CCU,CCURT1,CCURT2,TBOX
 SG_ ADC_FroTrkTargt3latPos : 196|10@0+ (0.1,-51.2) [-51.2|51.1] "m"  CCU,CCURT1,CCURT2,TBOX
 SG_ ADC_FroTrkTargt3LatRelSpd : 202|9@0+ (0.1,-25.5) [-25.5|25.5] "m/s"  CCU,CCURT1,CCURT2,TBOX
 SG_ ADC_FroTrkTargt3LongRelSpd : 209|10@0+ (0.1,-51.2) [-51.2|51.1] "m/s"  CCU,CCURT1,CCURT2,TBOX
 SG_ ADC_FroTrkTargt3DetSensor : 231|4@0+ (1,0) [0|15] ""  CCU,CCURT1,CCURT2
 SG_ ADC_ReaTrkTargt4ObjClass : 227|4@0+ (1,0) [0|15] ""  CCU,CCURT1,CCURT2
 SG_ ADC_ReaTrkTargt4St : 239|1@0+ (1,0) [0|1] ""  CCU,CCURT1,CCURT2
 SG_ ADC_ReaTrkTargt4longPos : 238|9@0+ (0.2,0) [0|102] "m"  CCU,CCURT1,CCURT2
 SG_ ADC_ReaTrkTargt4latPos : 245|10@0+ (0.1,-51.2) [-51.2|51.1] "m"  CCU,CCURT1,CCURT2
 SG_ ADC_ReaTrkTargt4LatRelSpd : 251|9@0+ (0.1,-25.5) [-25.5|25.5] "m/s"  CCU,CCURT1,CCURT2
 SG_ ADC_ReaTrkTargt4LongRelSpd : 257|10@0+ (0.1,-51.2) [-51.2|51.1] "m/s"  CCU,CCURT1,CCURT2
 SG_ ADC_ReaTrkTargt4DetSensor : 279|4@0+ (1,0) [0|15] ""  CCU,CCURT1,CCURT2
 SG_ ADC_ReaTrkTargt5ObjClass : 275|4@0+ (1,0) [0|15] ""  CCU,CCURT1,CCURT2
 SG_ ADC_ReaTrkTargt5St : 287|1@0+ (1,0) [0|1] ""  CCU,CCURT1,CCURT2
 SG_ ADC_ReaTrkTargt5longPos : 286|9@0+ (0.2,0) [0|102] "m"  CCU,CCURT1,CCURT2
 SG_ ADC_ReaTrkTargt5latPos : 293|10@0+ (0.1,-51.2) [-51.2|51.1] "m"  CCU,CCURT1,CCURT2
 SG_ ADC_ReaTrkTargt5LatRelSpd : 299|9@0+ (0.1,-25.5) [-25.5|25.5] "m/s"  CCU,CCURT1,CCURT2
 SG_ ADC_ReaTrkTargt5LongRelSpd : 305|10@0+ (0.1,-51.2) [-51.2|51.1] "m/s"  CCU,CCURT1,CCURT2
 SG_ ADC_ReaTrkTargt5DetSensor : 327|4@0+ (1,0) [0|15] ""  CCU,CCURT1,CCURT2
 SG_ ADC_ReaTrkTargt6ObjClass : 323|4@0+ (1,0) [0|15] ""  CCU,CCURT1,CCURT2
 SG_ ADC_ReaTrkTargt6St : 335|1@0+ (1,0) [0|1] ""  CCU,CCURT1,CCURT2
 SG_ ADC_ReaTrkTargt6longPos : 334|9@0+ (0.2,0) [0|102] "m"  CCU,CCURT1,CCURT2
 SG_ ADC_ReaTrkTargt6latPos : 341|10@0+ (0.1,-51.2) [-51.2|51.1] "m"  CCU,CCURT1,CCURT2
 SG_ ADC_ReaTrkTargt6LatRelSpd : 347|9@0+ (0.1,-25.5) [-25.5|25.5] "m/s"  CCU,CCURT1,CCURT2
 SG_ ADC_ReaTrkTargt6LongRelSpd : 353|10@0+ (0.1,-51.2) [-51.2|51.1] "m/s"  CCU,CCURT1,CCURT2
 SG_ ADC_ReaTrkTargt6DetSensor : 375|4@0+ (1,0) [0|15] ""  CCU,CCURT1,CCURT2
 SG_ ADC_RadarPowerDownReq : 371|2@0+ (1,0) [0|3] ""  CCU,CCURT1,CCURT2,RT1_C0
 SG_ ADC_RadarPowerDownReqVD : 369|1@0+ (1,0) [0|1] ""  CCU,CCURT1,CCURT2,RT1_C0
 SG_ ADC_UPSPowerDownReq : 383|2@0+ (1,0) [0|3] ""  CCU,CCURT1,CCURT2,RT1_C0
 SG_ ADC_UPSPowerDownReqVD : 368|1@0+ (1,0) [0|1] ""  CCU,CCURT1,CCURT2,RT1_C0
 SG_ ADC_LidarPowerDownReq : 381|2@0+ (1,0) [0|3] ""  CCU,CCURT1,CCURT2,RT1_C0
 SG_ ADC_LidarPowerDownReqVD : 379|1@0+ (1,0) [0|1] ""  CCU,CCURT1,CCURT2,RT1_C0
 SG_ ADC_IFCPowerDownReq : 378|2@0+ (1,0) [0|3] ""  CCU,CCURT1,CCURT2,RT1_C0,IFC
 SG_ ADC_IFCPowerDownReqVD : 376|1@0+ (1,0) [0|1] ""  CCU,CCURT1,CCURT2,RT1_C0,IFC
 SG_ ADC_LowPowerReq : 391|2@0+ (1,0) [0|3] ""  CCU,CCURT1,CCURT2,IFC,INU
 SG_ ADC_LowPowerReqVD : 389|1@0+ (1,0) [0|1] ""  CCU,CCURT1,CCURT2,IFC,INU
 SG_ Reserved1 : 440|1@0+ (1,0) [0|0] ""  CCU

CM_ SG_ 411 ADC_2_CRC "E2E Profile 5 CRC";
CM_ SG_ 411 ADC_2_Counter "E2E Profile 5 Counter";
CM_ SG_ 411 ADC_FCWAssistType "This signal indicates if the FCW(Front Collision Warning) Assist Type";
CM_ SG_ 411 ADC_FCWFaultSt "This signal indicates if the FCW(Front Collision Warning) fault status";
CM_ SG_ 411 ADC_FCWPreWarn "Visual and Audio warning if the FCW (Imminent Warning) intervents";
CM_ SG_ 411 ADC_FCWLatentWarn "Visual warning if the FCW (Alert Warning) intervents";
CM_ SG_ 411 ADC_AutonomyLevel "Provide the autonomy level that the vehicle isoperating with";
CM_ SG_ 411 ADC_FCWWarmDistance "FCW warming distance";
CM_ SG_ 411 ADC_AEBTarObjType "AEB Target Object Type";
CM_ SG_ 411 ADC_PMAEnableSt "PMA Enable status";
CM_ SG_ 411 ADC_PMAWarStatus "Visual and Audio warning if the PMA(Accelerator Pedal Misaction)intervents";
CM_ SG_ 411 ADC_BSDVibrWarnR "Driver seat vibration warning right";
CM_ SG_ 411 ADC_BSDVibrWarnL "Driver seat vibration warning left";
CM_ SG_ 411 ADC_AEBBrkPedalOverRide "AEB override status when Brakepedal applied";
CM_ SG_ 411 ADC_AEBBrePedalPressure "AEB override status when Brakepedal with ESP Pressure";
CM_ SG_ 411 ADC_AEBAccelePedalOverRide "AEB override status whith Certain gaspedal";
CM_ SG_ 411 ADC_AEBSteeringInhibit "AEB override status whith Certain Steering angel or angelSpeed";
CM_ SG_ 411 ADC_AEBTarLatPos "AEB Target  lateral Position";
CM_ SG_ 411 ADC_AEBTarRangeRate "AEB Target RangeRate";
CM_ SG_ 411 ADC_AEBTarOncomingState "Indictate AEB Target Oncomgin or not";
CM_ SG_ 411 ADC_AEBTarMotionState "Indictate AEB Target in Moving or stationary";
CM_ SG_ 411 ADC_AEBTarConfiLevel "AEB Target Confidence Level";
CM_ SG_ 411 ADC_AEBTarLongPos "AEB Target Longitudinal Possition";
CM_ SG_ 411 ADC_AEBTarLatSpd "AEB Target  lateral Speed";
CM_ SG_ 411 ADC_AEBTarSensorSource "AEB Target Property Detected by Sensor";
CM_ SG_ 411 ADC_AEBTarRangeAccel "AEB Target Longtitul Acceleration";
CM_ SG_ 411 ADC_DOWAudioWarnFR "Front right door speaker warning";
CM_ SG_ 411 ADC_DOWAudioWarnFL "Front left door speaker warning";
CM_ SG_ 411 ADC_DOWAudioWarnRR "Rear right door speaker warning";
CM_ SG_ 411 ADC_DOWAudioWarnRL "Rear left door speaker warning";
CM_ SG_ 411 ADC_DOWIALWarnFR "Front right door light warning ";
CM_ SG_ 411 ADC_DOWIALWarnFL "Front left door light warning";
CM_ SG_ 411 ADC_DOWIALWarnRR "Rear right door light warning ";
CM_ SG_ 411 ADC_DOWIALWarnRL "Rear left door light warning";
CM_ SG_ 411 ADC_BSDExMirLedWarnR "Exterior mirror LED warning right";
CM_ SG_ 411 ADC_BSDExMirLedWarnL "Exterior mirror LED warning left";
CM_ SG_ 411 ADC_BSDLCASt "BSD-LCA Function status";
CM_ SG_ 411 ADC_BSDLCAEnableSt "BSD-LCA Enable status";
CM_ SG_ 411 ADC_RCTAEnableSt "RCTA Enable status";
CM_ SG_ 411 ADC_RCTASt "RCTA Function status";
CM_ SG_ 411 ADC_RCTAAssistType "RCTA assist type request";
CM_ SG_ 411 ADC_DOWSt "DOW Function state";
CM_ SG_ 411 ADC_DOWEnableSt "DOW Enable status";
CM_ SG_ 411 ADC_LCAWarnLeft " the vehicle left warning level in the LCA feature";
CM_ SG_ 411 ADC_LCAWarnRight " the vehicle right warning level in the LCA feature";
CM_ SG_ 411 ADC_RCTAWarnLeft " the vehicle left warning in the RCTA feature";
CM_ SG_ 411 ADC_RCWEnableSt "RCW Enable status";
CM_ SG_ 411 ADC_RCTAWarnRight " the vehicle right warning in the RCTA feature";
CM_ SG_ 411 ADC_RCWSt "RCW(rear collision warning ) feature status";
CM_ SG_ 411 ADC_RCWWarn " the vehicle warning  level in the RCW feature";
CM_ SG_ 411 ADC_FCTAEnableSt "FCTA Enable status";
CM_ SG_ 411 ADC_FCTASt "FCTA feature status";
CM_ SG_ 411 ADC_FCTAAssistType "FCTA assist type request";
CM_ SG_ 411 ADC_FCTAWarnL "FCTA warning left";
CM_ SG_ 411 ADC_FCTAWarnR "FCTA warning right";
CM_ SG_ 411 ADC_FroNestTarRangeRate "Front Nearest Target RangeRate";
CM_ SG_ 411 ADC_FroNestTarLatSpd "Front Nearest Target  lateral Speed";
CM_ SG_ 411 ADC_FroNestTarRangeAccel "Front Nearest Target Longtitul Acceleration";
CM_ SG_ 411 ADC_FroNestTarObjType "Front Nearest Target Object Type";
CM_ SG_ 411 ADC_FroNestTarDetSensor "Front Nearest Target Property Detected by Sensor";
CM_ SG_ 411 ADC_LDS_LaneAssistType "operation mode of LDS";
CM_ SG_ 411 ADC_IHBC_EnableSt "IHBC enable status";
CM_ SG_ 411 ADC_TSR_EnableSt "TSR enable status";
CM_ SG_ 411 ADC_TSR_AudioWarn_EnableSt "TSR warn enable status";
CM_ SG_ 411 ADC_ELK_EnableSt "ELK Enable State";
CM_ SG_ 411 ADC_ESA_EnableSt "ESA Enable State";
CM_ SG_ 411 ADC_AES_EnableSt "AES Enable State";
CM_ SG_ 411 ADC_LDWSt "LDW state information";
CM_ SG_ 411 ADC_LDW_Actdirection "LDW active direction";
CM_ SG_ 411 ADC_LDP_Actdirection "LDP active direction";
CM_ SG_ 411 ADC_LDW_PassiveReason "LDW passive reason";
CM_ SG_ 411 ADC_LDPSt "LDP state information";
CM_ SG_ 411 ADC_LDP_PassiveReason "Left LDP passive reason";
CM_ SG_ 411 ADC_RDP_St "RDP state information";
CM_ SG_ 411 ADC_RDP_PassiveReason "RDP passive reason";
CM_ SG_ 411 ADC_IHBC_St "IHBC State";
CM_ SG_ 411 ADC_RDP_Actdirection "RDP active direction";
CM_ SG_ 411 ADC_FCMS_SwitchLockReq "This signal indicates if the Front Collision Mitigation System (AEB&FCW) Switch is locked because of VehSpeed & ESP";
CM_ SG_ 411 ADC_LKSLaneAssistSensitivity "This signal indicates the LKSLaneAssist Sensitivity State";
CM_ SG_ 411 ADC_ELKSt "ELK state information";
CM_ SG_ 411 ADC_IHBC_SuppressSt "IHBC Suppress State";
CM_ SG_ 411 ADC_IHBC_SuppressReason "IHBC Suppress Reason";
CM_ SG_ 411 ADC_IHBC_Dis2Oncoming "distance of oncoming target which lead to IHBC Suppress";
CM_ SG_ 411 ADC_IHBC_Dis2Preceding "distance of preceding target which lead to IHBC Suppress";
CM_ SG_ 411 ADC_IHBC_RoadlightNum " number of roadlight ";
CM_ SG_ 411 ADC_IHBC_Dis2NearestRoadlight "distance of nearest roadlight  ";
CM_ SG_ 411 ADC_IHBC_TargetType "type of target  which lead to IHBC Suppress";
CM_ SG_ 411 ADC_TSR_SpdLimit "TSR(Traffic Sign Recognition)Speed limit values";
CM_ SG_ 411 ADC_TSR_SpdLimType "TSR specific speed limit type";
CM_ SG_ 411 ADC_TSRMode "TSR Mode";
CM_ SG_ 411 ADC_TSR_St "TSR State";
CM_ SG_ 411 ADC_TSR_FailureReason "TSR Failure Reason";
CM_ SG_ 411 ADC_TSR_TrafficSignType "Type of traffic sign ";
CM_ SG_ 411 ADC_TSRDisToIntervalEnd "distance to the ending of Interval speed detection";
CM_ SG_ 411 ADC_TSRDisToCamera "distance to Speed limit camera detection";
CM_ SG_ 411 ADC_TSR_SpeedLimitSource "source of speed limit ";
CM_ SG_ 411 ADC_TSR_WarnEnabledType "TSR Warning enabled type";
CM_ SG_ 411 ADC_TSR_TactileWarn "TSR(Traffic Sign Recognition) Tactile  warning";
CM_ SG_ 411 ADC_TSR_VisualWarn "TSR(Traffic Sign Recognition) visual warning";
CM_ SG_ 411 ADC_TSR_SuppressReason "TSR(Traffic Sign Recognition) Suppress Reason";
CM_ SG_ 411 ADC_TSR_SpdLimitUnit "TSR(Traffic Sign Recognition) speed limit unit";
CM_ SG_ 411 ADC_TSR_AcousticWarn "TSR(Traffic Sign Recognition) acoustic  warning";
CM_ SG_ 411 ADC_ELKoncomingSt "ELKoncoming state information";
CM_ SG_ 411 ADC_ELKoncoming_PassiveReason "Left ELKoncoming passive reason";
CM_ SG_ 411 ADC_ELKoncoming_Actdirection "ELKoncoming active direction";
CM_ SG_ 411 ADC_ELKovertakingSt "ELKovertaking state information";
CM_ SG_ 411 ADC_ELKovertaking_ActDirection "ELKovertaking active direction";
CM_ SG_ 411 ADC_ISAChangeAudEnable "ISA speed limit  change audio enable status";
CM_ SG_ 411 ADC_ELKovertaking_PassiveReason " ELKovertaking passive reason";
CM_ SG_ 411 ADC_ELK_TargetObjClass "Type of ELK target Object class";
CM_ SG_ 411 ADC_ESA_St "ESA state information";
CM_ SG_ 411 ADC_ESA_ActDirection "ESA active direction";
CM_ SG_ 411 ADC_AES_St "AES state information";
CM_ SG_ 411 ADC_AES_ActDirection "AES active direction";
CM_ SG_ 411 ADC_RDP_Number "Number of times RDP is activated in the current ignition cycle";
CM_ SG_ 411 ADC_ELKoncoming_ActiveWarn "ELKoncoming active Warn";
CM_ SG_ 411 ADC_ELKovertaking_ActiveWarn "ELKoncoming active Warn";
CM_ SG_ 411 ADC_ELKoncoming_Number "Number of times ELKoncoming is activated in the current ignition cycle";
CM_ SG_ 411 ADC_ESA_ActiveWarn "ESA active Warn";
CM_ SG_ 411 ADC_AES_ActiveWarn "AES active Warn";
CM_ SG_ 411 ADC_ELKovertaking_Numbe "Number of times ELKovertaking is activated in the current ignition cycle";
CM_ SG_ 411 ADC_ESA_TargetObjClass "Type of ESA target Object class";
CM_ SG_ 411 ADC_ESA_PassiveReason "ESA passive reason";
CM_ SG_ 411 ADC_AES_TargetObjClass "Type of AES target Object class";
CM_ SG_ 411 ADC_AES_PassiveReason "AES passive reason";
CM_ SG_ 411 ADC_LDW_Number "Number of times LDW is activated in the current ignition cycle";
CM_ SG_ 411 ADC_LDPNumber "Number of times LDP is activated in the current ignition cycle";
CM_ SG_ 411 ADC_L1_LatfaultReason "L0 & L1 lateral function fault reason";
CM_ SG_ 411 ADC_ESA_Number "Number of times ESA is activated in the current ignition cycle";
CM_ SG_ 411 ADC_AES_Number "Number of times AES is activated in the current ignition cycle";
CM_ SG_ 411 ADC_FroNestTarLatPos "Front Nearest Target lateral Position";
CM_ SG_ 411 ADC_FroNestTarLongPos "Front Nearest Target Longitudinal Possition";
CM_ SG_ 411 ADC_LDSIconColor "LDS（include LDW and LDP ) Icon Color";
CM_ SG_ 411 ADC_LOCP_St "LOCP?state?information";
CM_ SG_ 915 ADC_3_CRC "E2E Profile 5 CRC";
CM_ SG_ 915 ADC_3_Counter "E2E Profile 5 Counter";
CM_ SG_ 915 ADC_FroTrkTargt0ObjClass "Front Track Target 0（Closest Same Lane）Object class";
CM_ SG_ 915 ADC_FroTrkTargt0St "Front Track Target 0（Closest Same Lane）detection state";
CM_ SG_ 915 ADC_FroTrkTargt0longPos "Front Track Target 0（Closest Same Lane）Longitudinal Position";
CM_ SG_ 915 ADC_FroTrkTargt0latPos "Front Track Target 0（Closest Same Lane）Lateral Position";
CM_ SG_ 915 ADC_FroTrkTargt0LatRelSpd "Front Track Target 0（Closest Same Lane）Lateral Relative Speed";
CM_ SG_ 915 ADC_FroTrkTargt0LongRelSpd "Front Track Target 0（Closest Same Lane）Longitudinal Relative Speed";
CM_ SG_ 915 ADC_FroTrkTargt0DetSensor "Front Track Target 0（Closest Same Lane）Property Detected by Sensor";
CM_ SG_ 915 ADC_FroTrkTargt1ObjClass "Front Track Target 1（Before Target 0, TheSecond Closest Same Lane）Objectclass";
CM_ SG_ 915 ADC_FroTrkTargt1St "Front Track Target 1（Before Target 0, TheSecond Closest Same Lane）detection state";
CM_ SG_ 915 ADC_FroTrkTargt1longPos "Front Track Target 1（Before Target 0, TheSecond Closest Same Lane）Longitudinal Position";
CM_ SG_ 915 ADC_FroTrkTargt1latPos "Front Track Target 1（Before Target 0, TheSecond Closest Same Lane）Lateral Position";
CM_ SG_ 915 ADC_FroTrkTargt1LatRelSpd "Front Track Target 1（Before Target 0, TheSecond Closest Same Lane）Lateral Relative Speed";
CM_ SG_ 915 ADC_FroTrkTargt1LongRelSpd "Front Track Target 1（Before Target 0, TheSecond Closest Same Lane）Longitudinal Relative Speed";
CM_ SG_ 915 ADC_FroTrkTargt1DetSensor "Front Track Target 1（Before Target 0, TheSecond Closest Same Lane）Property Detected by Sensor";
CM_ SG_ 915 ADC_FroTrkTargt2ObjClass "Front Track Target 2（Closest Left Lane）Object class";
CM_ SG_ 915 ADC_FroTrkTargt2St "Front Track Target 2（Closest Left Lane）detection state";
CM_ SG_ 915 ADC_FroTrkTargt2longPos "Front Track Target 2（Closest Left Lane） Longitudinal Position";
CM_ SG_ 915 ADC_FroTrkTargt2latPos "Front Track Target 2（Closest Left Lane） Lateral Position";
CM_ SG_ 915 ADC_FroTrkTargt2LatRelSpd "Front Track Target 2（Closest Left Lane）Lateral Relative Speed";
CM_ SG_ 915 ADC_FroTrkTargt2LongRelSpd "Front Track Target 2（Closest Left Lane）Longitudinal Relative Speed";
CM_ SG_ 915 ADC_FroTrkTargt2DetSensor "Front Track Target 2（Closest Left Lane）Property Detected by Sensor";
CM_ SG_ 915 ADC_FroTrkTargt3ObjClass "Front Track Target 3（Closest Right Lane）Objectclass";
CM_ SG_ 915 ADC_FroTrkTargt3St "Front Track Target 2（Closest Right Lane）detection state";
CM_ SG_ 915 ADC_FroTrkTargt3longPos "Front Track Target 3（Closest Right Lane）Longitudinal Position";
CM_ SG_ 915 ADC_FroTrkTargt3latPos "Front Track Target 3（Closest Right Lane）Lateral Position";
CM_ SG_ 915 ADC_FroTrkTargt3LatRelSpd "Front Track Target 3（Closest Right Lane）Lateral Relative Speed";
CM_ SG_ 915 ADC_FroTrkTargt3LongRelSpd "Front Track Target 3（Closest Right Lane）Longitudinal Relative Speed";
CM_ SG_ 915 ADC_FroTrkTargt3DetSensor "Front Track Target 3（Closest Right Lane）Property Detected by Sensor";
CM_ SG_ 915 ADC_ReaTrkTargt4ObjClass "Rear Track Target 4（After Target 2, TheSecond Closest Left Lane）Object class";
CM_ SG_ 915 ADC_ReaTrkTargt4St "Rear Track Target 4（After Target 2, TheSecond Closest Left Lane）detection state";
CM_ SG_ 915 ADC_ReaTrkTargt4longPos "Rear Track Target 4（AfterAfter Target 2, TheSecond Closest Left Lane）Longitudinal Position";
CM_ SG_ 915 ADC_ReaTrkTargt4latPos "Rear Track Target 4（After Target 2, TheSecond Closest Left Lane）Lateral Position";
CM_ SG_ 915 ADC_ReaTrkTargt4LatRelSpd "Rear Track Target 4（After Target 2, TheSecond Closest Left Lane）Lateral Relative Speed";
CM_ SG_ 915 ADC_ReaTrkTargt4LongRelSpd "Rear Track Target 4（After Target 2, TheSecond Closest Left Lane）Longitudinal Relative Speed";
CM_ SG_ 915 ADC_ReaTrkTargt4DetSensor "Rear Track Target 4（After Target 2, TheSecond Closest Left Lane）Property Detected by Sensor";
CM_ SG_ 915 ADC_ReaTrkTargt5ObjClass "Rear Track Target 5（After Target 3, TheSecond Closest Right Lane）Objectclass";
CM_ SG_ 915 ADC_ReaTrkTargt5St "Rear Track Target 5（After Target 3, TheSecond Closest Right Lane）detection state";
CM_ SG_ 915 ADC_ReaTrkTargt5longPos "Rear Track Target 5（After Target 3, TheSecond Closest Right Lane）Longitudinal Position";
CM_ SG_ 915 ADC_ReaTrkTargt5latPos "Rear Track Target 5（After Target 3, TheSecond Closest Right Lane）Lateral Position";
CM_ SG_ 915 ADC_ReaTrkTargt5LatRelSpd "Rear Track Target 5（After Target 3, TheSecond Closest Right Lane）Lateral Relative Speed";
CM_ SG_ 915 ADC_ReaTrkTargt5LongRelSpd "Rear Track Target 5（After Target 3, TheSecond Closest Right Lane）Longitudinal Relative Speed";
CM_ SG_ 915 ADC_ReaTrkTargt5DetSensor "Rear Track Target 5（After Tarcet 3, TheSecond Closest Right Lane）Property Detected by Sensor";
CM_ SG_ 915 ADC_ReaTrkTargt6ObjClass "Rear Track Target 6（behind ego car,  On the Same Lane）Objectclass";
CM_ SG_ 915 ADC_ReaTrkTargt6St "Rear Track Target 6（behind ego car,  On the Same Lane）detection state";
CM_ SG_ 915 ADC_ReaTrkTargt6longPos "Rear Track Target 6（behind ego car,  On the Same Lane）Longitudinal Position";
CM_ SG_ 915 ADC_ReaTrkTargt6latPos "Rear Track Target 6（behind ego car,  On the Same Lane）Lateral Position";
CM_ SG_ 915 ADC_ReaTrkTargt6LatRelSpd "Rear Track Target 6（behind ego car,  On the Same Lane）Lateral Relative Speed";
CM_ SG_ 915 ADC_ReaTrkTargt6LongRelSpd "Rear Track Target 6（behind ego car,  On the Same Lane）Longitudinal Relative Speed";
CM_ SG_ 915 ADC_ReaTrkTargt6DetSensor "Rear Track Target 6（behind ego car,  On the Same Lane）Property Detected by Sensor";
CM_ SG_ 915 ADC_RadarPowerDownReq "ADC request CCU to power down radars";
CM_ SG_ 915 ADC_UPSPowerDownReq "ADC request CCU to power down UPS";
CM_ SG_ 915 ADC_LidarPowerDownReq "ADC request CCU to power down Lidar";
CM_ SG_ 915 ADC_IFCPowerDownReq "ADC request CCU to power down IFC";
CM_ SG_ 915 ADC_LowPowerReq "indicate ADC lowpower Mode state";

BA_DEF_ BO_  "GenMsgCycleTime" INT 0 0;
BA_DEF_ BO_  "GenMsgCycleTimeFast" INT 0 0;
BA_DEF_ BO_  "GenMsgSendType" ENUM  "Periodic","Event","IfActive","POE","PA","FixedPeriodic","Event","EnabledPeriodic","NotUsed","NotUsed","EventPeriodic","NotUsed","NotUsed","NoMsgSendType";
BA_DEF_ BO_  "VFrameFormat" ENUM  "StandardCAN","ExtendedCAN","reserved","reserved","reserved","reserved","reserved","reserved","reserved","reserved","reserved","reserved","reserved","reserved","StandardCAN_FD","ExtendedCAN_FD";
BA_DEF_ BO_  "CANFD_BRS" ENUM  "0","1";
BA_DEF_ SG_  "EventCommandSignal" ENUM  "No","Yes";
BA_DEF_ SG_  "GatewayedSignals" ENUM  "No","Yes";
BA_DEF_ SG_  "GenSigInactiveValue" HEX 0 0;
BA_DEF_ SG_  "GenSigInvalidValue" HEX 0 0;
BA_DEF_ SG_  "GenSigSendType" ENUM  "Trigger","Passive","Cyclic","OnWrite","OnWriteWithRepetition","OnChange","OnChangeWithRepetition","IfActive","IfActiveWithRepetition","NoSigSendType";
BA_DEF_ SG_  "GenSigStartValue" HEX 0 0;
BA_DEF_ SG_  "GenSigTimeoutValue" HEX 0 0;
BA_DEF_ SG_  "Remark" STRING ;
BA_ "GenMsgCycleTime" BO_ 411 20;
BA_ "GenMsgCycleTimeFast" BO_ 411 0;
BA_ "GenMsgSendType" BO_ 411 0;
BA_ "VFrameFormat" BO_ 411 14;
BA_ "CANFD_BRS" BO_ 411 1;
BA_ "GenMsgCycleTime" BO_ 411 20;
BA_ "GenMsgCycleTimeFast" BO_ 411 0;
BA_ "GenMsgSendType" BO_ 411 0;
BA_ "VFrameFormat" BO_ 411 14;
BA_ "CANFD_BRS" BO_ 411 1;
BA_ "GenMsgCycleTime" BO_ 411 20;
BA_ "GenMsgCycleTimeFast" BO_ 411 0;
BA_ "GenMsgSendType" BO_ 411 0;
BA_ "VFrameFormat" BO_ 411 14;
BA_ "CANFD_BRS" BO_ 411 1;
BA_ "GenMsgCycleTime" BO_ 411 20;
BA_ "GenMsgCycleTimeFast" BO_ 411 0;
BA_ "GenMsgSendType" BO_ 411 0;
BA_ "VFrameFormat" BO_ 411 14;
BA_ "CANFD_BRS" BO_ 411 1;
BA_ "GenMsgCycleTime" BO_ 411 20;
BA_ "GenMsgCycleTimeFast" BO_ 411 0;
BA_ "GenMsgSendType" BO_ 411 0;
BA_ "VFrameFormat" BO_ 411 14;
BA_ "CANFD_BRS" BO_ 411 1;
BA_ "GenMsgCycleTime" BO_ 411 20;
BA_ "GenMsgCycleTimeFast" BO_ 411 0;
BA_ "GenMsgSendType" BO_ 411 0;
BA_ "VFrameFormat" BO_ 411 14;
BA_ "CANFD_BRS" BO_ 411 1;
BA_ "GenMsgCycleTime" BO_ 411 20;
BA_ "GenMsgCycleTimeFast" BO_ 411 0;
BA_ "GenMsgSendType" BO_ 411 0;
BA_ "VFrameFormat" BO_ 411 14;
BA_ "CANFD_BRS" BO_ 411 1;
BA_ "GenMsgCycleTime" BO_ 411 20;
BA_ "GenMsgCycleTimeFast" BO_ 411 0;
BA_ "GenMsgSendType" BO_ 411 0;
BA_ "VFrameFormat" BO_ 411 14;
BA_ "CANFD_BRS" BO_ 411 1;
BA_ "GenMsgCycleTime" BO_ 411 20;
BA_ "GenMsgCycleTimeFast" BO_ 411 0;
BA_ "GenMsgSendType" BO_ 411 0;
BA_ "VFrameFormat" BO_ 411 14;
BA_ "CANFD_BRS" BO_ 411 1;
BA_ "GenMsgCycleTime" BO_ 411 20;
BA_ "GenMsgCycleTimeFast" BO_ 411 0;
BA_ "GenMsgSendType" BO_ 411 0;
BA_ "VFrameFormat" BO_ 411 14;
BA_ "CANFD_BRS" BO_ 411 1;
BA_ "GenMsgCycleTime" BO_ 411 20;
BA_ "GenMsgCycleTimeFast" BO_ 411 0;
BA_ "GenMsgSendType" BO_ 411 0;
BA_ "VFrameFormat" BO_ 411 14;
BA_ "CANFD_BRS" BO_ 411 1;
BA_ "GenMsgCycleTime" BO_ 411 20;
BA_ "GenMsgCycleTimeFast" BO_ 411 0;
BA_ "GenMsgSendType" BO_ 411 0;
BA_ "VFrameFormat" BO_ 411 14;
BA_ "CANFD_BRS" BO_ 411 1;
BA_ "GenMsgCycleTime" BO_ 411 20;
BA_ "GenMsgCycleTimeFast" BO_ 411 0;
BA_ "GenMsgSendType" BO_ 411 0;
BA_ "VFrameFormat" BO_ 411 14;
BA_ "CANFD_BRS" BO_ 411 1;
BA_ "GenMsgCycleTime" BO_ 411 20;
BA_ "GenMsgCycleTimeFast" BO_ 411 0;
BA_ "GenMsgSendType" BO_ 411 0;
BA_ "VFrameFormat" BO_ 411 14;
BA_ "CANFD_BRS" BO_ 411 1;
BA_ "GenMsgCycleTime" BO_ 411 20;
BA_ "GenMsgCycleTimeFast" BO_ 411 0;
BA_ "GenMsgSendType" BO_ 411 0;
BA_ "VFrameFormat" BO_ 411 14;
BA_ "CANFD_BRS" BO_ 411 1;
BA_ "GenMsgCycleTime" BO_ 411 20;
BA_ "GenMsgCycleTimeFast" BO_ 411 0;
BA_ "GenMsgSendType" BO_ 411 0;
BA_ "VFrameFormat" BO_ 411 14;
BA_ "CANFD_BRS" BO_ 411 1;
BA_ "GenMsgCycleTime" BO_ 411 20;
BA_ "GenMsgCycleTimeFast" BO_ 411 0;
BA_ "GenMsgSendType" BO_ 411 0;
BA_ "VFrameFormat" BO_ 411 14;
BA_ "CANFD_BRS" BO_ 411 1;
BA_ "GenMsgCycleTime" BO_ 411 20;
BA_ "GenMsgCycleTimeFast" BO_ 411 0;
BA_ "GenMsgSendType" BO_ 411 0;
BA_ "VFrameFormat" BO_ 411 14;
BA_ "CANFD_BRS" BO_ 411 1;
BA_ "GenMsgCycleTime" BO_ 411 20;
BA_ "GenMsgCycleTimeFast" BO_ 411 0;
BA_ "GenMsgSendType" BO_ 411 0;
BA_ "VFrameFormat" BO_ 411 14;
BA_ "CANFD_BRS" BO_ 411 1;
BA_ "GenMsgCycleTime" BO_ 411 20;
BA_ "GenMsgCycleTimeFast" BO_ 411 0;
BA_ "GenMsgSendType" BO_ 411 0;
BA_ "VFrameFormat" BO_ 411 14;
BA_ "CANFD_BRS" BO_ 411 1;
BA_ "GenMsgCycleTime" BO_ 411 20;
BA_ "GenMsgCycleTimeFast" BO_ 411 0;
BA_ "GenMsgSendType" BO_ 411 0;
BA_ "VFrameFormat" BO_ 411 14;
BA_ "CANFD_BRS" BO_ 411 1;
BA_ "GenMsgCycleTime" BO_ 411 20;
BA_ "GenMsgCycleTimeFast" BO_ 411 0;
BA_ "GenMsgSendType" BO_ 411 0;
BA_ "VFrameFormat" BO_ 411 14;
BA_ "CANFD_BRS" BO_ 411 1;
BA_ "GenMsgCycleTime" BO_ 411 20;
BA_ "GenMsgCycleTimeFast" BO_ 411 0;
BA_ "GenMsgSendType" BO_ 411 0;
BA_ "VFrameFormat" BO_ 411 14;
BA_ "CANFD_BRS" BO_ 411 1;
BA_ "GenMsgCycleTime" BO_ 411 20;
BA_ "GenMsgCycleTimeFast" BO_ 411 0;
BA_ "GenMsgSendType" BO_ 411 0;
BA_ "VFrameFormat" BO_ 411 14;
BA_ "CANFD_BRS" BO_ 411 1;
BA_ "GenMsgCycleTime" BO_ 411 20;
BA_ "GenMsgCycleTimeFast" BO_ 411 0;
BA_ "GenMsgSendType" BO_ 411 0;
BA_ "VFrameFormat" BO_ 411 14;
BA_ "CANFD_BRS" BO_ 411 1;
BA_ "GenMsgCycleTime" BO_ 411 20;
BA_ "GenMsgCycleTimeFast" BO_ 411 0;
BA_ "GenMsgSendType" BO_ 411 0;
BA_ "VFrameFormat" BO_ 411 14;
BA_ "CANFD_BRS" BO_ 411 1;
BA_ "GenMsgCycleTime" BO_ 411 20;
BA_ "GenMsgCycleTimeFast" BO_ 411 0;
BA_ "GenMsgSendType" BO_ 411 0;
BA_ "VFrameFormat" BO_ 411 14;
BA_ "CANFD_BRS" BO_ 411 1;
BA_ "GenMsgCycleTime" BO_ 411 20;
BA_ "GenMsgCycleTimeFast" BO_ 411 0;
BA_ "GenMsgSendType" BO_ 411 0;
BA_ "VFrameFormat" BO_ 411 14;
BA_ "CANFD_BRS" BO_ 411 1;
BA_ "GenMsgCycleTime" BO_ 411 20;
BA_ "GenMsgCycleTimeFast" BO_ 411 0;
BA_ "GenMsgSendType" BO_ 411 0;
BA_ "VFrameFormat" BO_ 411 14;
BA_ "CANFD_BRS" BO_ 411 1;
BA_ "GenMsgCycleTime" BO_ 411 20;
BA_ "GenMsgCycleTimeFast" BO_ 411 0;
BA_ "GenMsgSendType" BO_ 411 0;
BA_ "VFrameFormat" BO_ 411 14;
BA_ "CANFD_BRS" BO_ 411 1;
BA_ "GenMsgCycleTime" BO_ 411 20;
BA_ "GenMsgCycleTimeFast" BO_ 411 0;
BA_ "GenMsgSendType" BO_ 411 0;
BA_ "VFrameFormat" BO_ 411 14;
BA_ "CANFD_BRS" BO_ 411 1;
BA_ "GenMsgCycleTime" BO_ 411 20;
BA_ "GenMsgCycleTimeFast" BO_ 411 0;
BA_ "GenMsgSendType" BO_ 411 0;
BA_ "VFrameFormat" BO_ 411 14;
BA_ "CANFD_BRS" BO_ 411 1;
BA_ "GenMsgCycleTime" BO_ 411 20;
BA_ "GenMsgCycleTimeFast" BO_ 411 0;
BA_ "GenMsgSendType" BO_ 411 0;
BA_ "VFrameFormat" BO_ 411 14;
BA_ "CANFD_BRS" BO_ 411 1;
BA_ "GenMsgCycleTime" BO_ 411 20;
BA_ "GenMsgCycleTimeFast" BO_ 411 0;
BA_ "GenMsgSendType" BO_ 411 0;
BA_ "VFrameFormat" BO_ 411 14;
BA_ "CANFD_BRS" BO_ 411 1;
BA_ "GenMsgCycleTime" BO_ 411 20;
BA_ "GenMsgCycleTimeFast" BO_ 411 0;
BA_ "GenMsgSendType" BO_ 411 0;
BA_ "VFrameFormat" BO_ 411 14;
BA_ "CANFD_BRS" BO_ 411 1;
BA_ "GenMsgCycleTime" BO_ 411 20;
BA_ "GenMsgCycleTimeFast" BO_ 411 0;
BA_ "GenMsgSendType" BO_ 411 0;
BA_ "VFrameFormat" BO_ 411 14;
BA_ "CANFD_BRS" BO_ 411 1;
BA_ "GenMsgCycleTime" BO_ 411 20;
BA_ "GenMsgCycleTimeFast" BO_ 411 0;
BA_ "GenMsgSendType" BO_ 411 0;
BA_ "VFrameFormat" BO_ 411 14;
BA_ "CANFD_BRS" BO_ 411 1;
BA_ "GenMsgCycleTime" BO_ 411 20;
BA_ "GenMsgCycleTimeFast" BO_ 411 0;
BA_ "GenMsgSendType" BO_ 411 0;
BA_ "VFrameFormat" BO_ 411 14;
BA_ "CANFD_BRS" BO_ 411 1;
BA_ "GenMsgCycleTime" BO_ 411 20;
BA_ "GenMsgCycleTimeFast" BO_ 411 0;
BA_ "GenMsgSendType" BO_ 411 0;
BA_ "VFrameFormat" BO_ 411 14;
BA_ "CANFD_BRS" BO_ 411 1;
BA_ "GenMsgCycleTime" BO_ 411 20;
BA_ "GenMsgCycleTimeFast" BO_ 411 0;
BA_ "GenMsgSendType" BO_ 411 0;
BA_ "VFrameFormat" BO_ 411 14;
BA_ "CANFD_BRS" BO_ 411 1;
BA_ "GenMsgCycleTime" BO_ 411 20;
BA_ "GenMsgCycleTimeFast" BO_ 411 0;
BA_ "GenMsgSendType" BO_ 411 0;
BA_ "VFrameFormat" BO_ 411 14;
BA_ "CANFD_BRS" BO_ 411 1;
BA_ "GenMsgCycleTime" BO_ 411 20;
BA_ "GenMsgCycleTimeFast" BO_ 411 0;
BA_ "GenMsgSendType" BO_ 411 0;
BA_ "VFrameFormat" BO_ 411 14;
BA_ "CANFD_BRS" BO_ 411 1;
BA_ "GenMsgCycleTime" BO_ 411 20;
BA_ "GenMsgCycleTimeFast" BO_ 411 0;
BA_ "GenMsgSendType" BO_ 411 0;
BA_ "VFrameFormat" BO_ 411 14;
BA_ "CANFD_BRS" BO_ 411 1;
BA_ "GenMsgCycleTime" BO_ 411 20;
BA_ "GenMsgCycleTimeFast" BO_ 411 0;
BA_ "GenMsgSendType" BO_ 411 0;
BA_ "VFrameFormat" BO_ 411 14;
BA_ "CANFD_BRS" BO_ 411 1;
BA_ "GenMsgCycleTime" BO_ 411 20;
BA_ "GenMsgCycleTimeFast" BO_ 411 0;
BA_ "GenMsgSendType" BO_ 411 0;
BA_ "VFrameFormat" BO_ 411 14;
BA_ "CANFD_BRS" BO_ 411 1;
BA_ "GenMsgCycleTime" BO_ 411 20;
BA_ "GenMsgCycleTimeFast" BO_ 411 0;
BA_ "GenMsgSendType" BO_ 411 0;
BA_ "VFrameFormat" BO_ 411 14;
BA_ "CANFD_BRS" BO_ 411 1;
BA_ "GenMsgCycleTime" BO_ 411 20;
BA_ "GenMsgCycleTimeFast" BO_ 411 0;
BA_ "GenMsgSendType" BO_ 411 0;
BA_ "VFrameFormat" BO_ 411 14;
BA_ "CANFD_BRS" BO_ 411 1;
BA_ "GenMsgCycleTime" BO_ 411 20;
BA_ "GenMsgCycleTimeFast" BO_ 411 0;
BA_ "GenMsgSendType" BO_ 411 0;
BA_ "VFrameFormat" BO_ 411 14;
BA_ "CANFD_BRS" BO_ 411 1;
BA_ "GenMsgCycleTime" BO_ 411 20;
BA_ "GenMsgCycleTimeFast" BO_ 411 0;
BA_ "GenMsgSendType" BO_ 411 0;
BA_ "VFrameFormat" BO_ 411 14;
BA_ "CANFD_BRS" BO_ 411 1;
BA_ "GenMsgCycleTime" BO_ 411 20;
BA_ "GenMsgCycleTimeFast" BO_ 411 0;
BA_ "GenMsgSendType" BO_ 411 0;
BA_ "VFrameFormat" BO_ 411 14;
BA_ "CANFD_BRS" BO_ 411 1;
BA_ "GenMsgCycleTime" BO_ 411 20;
BA_ "GenMsgCycleTimeFast" BO_ 411 0;
BA_ "GenMsgSendType" BO_ 411 0;
BA_ "VFrameFormat" BO_ 411 14;
BA_ "CANFD_BRS" BO_ 411 1;
BA_ "GenMsgCycleTime" BO_ 411 20;
BA_ "GenMsgCycleTimeFast" BO_ 411 0;
BA_ "GenMsgSendType" BO_ 411 0;
BA_ "VFrameFormat" BO_ 411 14;
BA_ "CANFD_BRS" BO_ 411 1;
BA_ "GenMsgCycleTime" BO_ 411 20;
BA_ "GenMsgCycleTimeFast" BO_ 411 0;
BA_ "GenMsgSendType" BO_ 411 0;
BA_ "VFrameFormat" BO_ 411 14;
BA_ "CANFD_BRS" BO_ 411 1;
BA_ "GenMsgCycleTime" BO_ 411 20;
BA_ "GenMsgCycleTimeFast" BO_ 411 0;
BA_ "GenMsgSendType" BO_ 411 0;
BA_ "VFrameFormat" BO_ 411 14;
BA_ "CANFD_BRS" BO_ 411 1;
BA_ "GenMsgCycleTime" BO_ 411 20;
BA_ "GenMsgCycleTimeFast" BO_ 411 0;
BA_ "GenMsgSendType" BO_ 411 0;
BA_ "VFrameFormat" BO_ 411 14;
BA_ "CANFD_BRS" BO_ 411 1;
BA_ "GenMsgCycleTime" BO_ 411 20;
BA_ "GenMsgCycleTimeFast" BO_ 411 0;
BA_ "GenMsgSendType" BO_ 411 0;
BA_ "VFrameFormat" BO_ 411 14;
BA_ "CANFD_BRS" BO_ 411 1;
BA_ "GenMsgCycleTime" BO_ 411 20;
BA_ "GenMsgCycleTimeFast" BO_ 411 0;
BA_ "GenMsgSendType" BO_ 411 0;
BA_ "VFrameFormat" BO_ 411 14;
BA_ "CANFD_BRS" BO_ 411 1;
BA_ "GenMsgCycleTime" BO_ 411 20;
BA_ "GenMsgCycleTimeFast" BO_ 411 0;
BA_ "GenMsgSendType" BO_ 411 0;
BA_ "VFrameFormat" BO_ 411 14;
BA_ "CANFD_BRS" BO_ 411 1;
BA_ "GenMsgCycleTime" BO_ 411 20;
BA_ "GenMsgCycleTimeFast" BO_ 411 0;
BA_ "GenMsgSendType" BO_ 411 0;
BA_ "VFrameFormat" BO_ 411 14;
BA_ "CANFD_BRS" BO_ 411 1;
BA_ "GenMsgCycleTime" BO_ 411 20;
BA_ "GenMsgCycleTimeFast" BO_ 411 0;
BA_ "GenMsgSendType" BO_ 411 0;
BA_ "VFrameFormat" BO_ 411 14;
BA_ "CANFD_BRS" BO_ 411 1;
BA_ "GenMsgCycleTime" BO_ 411 20;
BA_ "GenMsgCycleTimeFast" BO_ 411 0;
BA_ "GenMsgSendType" BO_ 411 0;
BA_ "VFrameFormat" BO_ 411 14;
BA_ "CANFD_BRS" BO_ 411 1;
BA_ "GenMsgCycleTime" BO_ 411 20;
BA_ "GenMsgCycleTimeFast" BO_ 411 0;
BA_ "GenMsgSendType" BO_ 411 0;
BA_ "VFrameFormat" BO_ 411 14;
BA_ "CANFD_BRS" BO_ 411 1;
BA_ "GenMsgCycleTime" BO_ 411 20;
BA_ "GenMsgCycleTimeFast" BO_ 411 0;
BA_ "GenMsgSendType" BO_ 411 0;
BA_ "VFrameFormat" BO_ 411 14;
BA_ "CANFD_BRS" BO_ 411 1;
BA_ "GenMsgCycleTime" BO_ 411 20;
BA_ "GenMsgCycleTimeFast" BO_ 411 0;
BA_ "GenMsgSendType" BO_ 411 0;
BA_ "VFrameFormat" BO_ 411 14;
BA_ "CANFD_BRS" BO_ 411 1;
BA_ "GenMsgCycleTime" BO_ 411 20;
BA_ "GenMsgCycleTimeFast" BO_ 411 0;
BA_ "GenMsgSendType" BO_ 411 0;
BA_ "VFrameFormat" BO_ 411 14;
BA_ "CANFD_BRS" BO_ 411 1;
BA_ "GenMsgCycleTime" BO_ 411 20;
BA_ "GenMsgCycleTimeFast" BO_ 411 0;
BA_ "GenMsgSendType" BO_ 411 0;
BA_ "VFrameFormat" BO_ 411 14;
BA_ "CANFD_BRS" BO_ 411 1;
BA_ "GenMsgCycleTime" BO_ 411 20;
BA_ "GenMsgCycleTimeFast" BO_ 411 0;
BA_ "GenMsgSendType" BO_ 411 0;
BA_ "VFrameFormat" BO_ 411 14;
BA_ "CANFD_BRS" BO_ 411 1;
BA_ "GenMsgCycleTime" BO_ 411 20;
BA_ "GenMsgCycleTimeFast" BO_ 411 0;
BA_ "GenMsgSendType" BO_ 411 0;
BA_ "VFrameFormat" BO_ 411 14;
BA_ "CANFD_BRS" BO_ 411 1;
BA_ "GenMsgCycleTime" BO_ 411 20;
BA_ "GenMsgCycleTimeFast" BO_ 411 0;
BA_ "GenMsgSendType" BO_ 411 0;
BA_ "VFrameFormat" BO_ 411 14;
BA_ "CANFD_BRS" BO_ 411 1;
BA_ "GenMsgCycleTime" BO_ 411 20;
BA_ "GenMsgCycleTimeFast" BO_ 411 0;
BA_ "GenMsgSendType" BO_ 411 0;
BA_ "VFrameFormat" BO_ 411 14;
BA_ "CANFD_BRS" BO_ 411 1;
BA_ "GenMsgCycleTime" BO_ 411 20;
BA_ "GenMsgCycleTimeFast" BO_ 411 0;
BA_ "GenMsgSendType" BO_ 411 0;
BA_ "VFrameFormat" BO_ 411 14;
BA_ "CANFD_BRS" BO_ 411 1;
BA_ "GenMsgCycleTime" BO_ 411 20;
BA_ "GenMsgCycleTimeFast" BO_ 411 0;
BA_ "GenMsgSendType" BO_ 411 0;
BA_ "VFrameFormat" BO_ 411 14;
BA_ "CANFD_BRS" BO_ 411 1;
BA_ "GenMsgCycleTime" BO_ 411 20;
BA_ "GenMsgCycleTimeFast" BO_ 411 0;
BA_ "GenMsgSendType" BO_ 411 0;
BA_ "VFrameFormat" BO_ 411 14;
BA_ "CANFD_BRS" BO_ 411 1;
BA_ "GenMsgCycleTime" BO_ 411 20;
BA_ "GenMsgCycleTimeFast" BO_ 411 0;
BA_ "GenMsgSendType" BO_ 411 0;
BA_ "VFrameFormat" BO_ 411 14;
BA_ "CANFD_BRS" BO_ 411 1;
BA_ "GenMsgCycleTime" BO_ 411 20;
BA_ "GenMsgCycleTimeFast" BO_ 411 0;
BA_ "GenMsgSendType" BO_ 411 0;
BA_ "VFrameFormat" BO_ 411 14;
BA_ "CANFD_BRS" BO_ 411 1;
BA_ "GenMsgCycleTime" BO_ 411 20;
BA_ "GenMsgCycleTimeFast" BO_ 411 0;
BA_ "GenMsgSendType" BO_ 411 0;
BA_ "VFrameFormat" BO_ 411 14;
BA_ "CANFD_BRS" BO_ 411 1;
BA_ "GenMsgCycleTime" BO_ 411 20;
BA_ "GenMsgCycleTimeFast" BO_ 411 0;
BA_ "GenMsgSendType" BO_ 411 0;
BA_ "VFrameFormat" BO_ 411 14;
BA_ "CANFD_BRS" BO_ 411 1;
BA_ "GenMsgCycleTime" BO_ 411 20;
BA_ "GenMsgCycleTimeFast" BO_ 411 0;
BA_ "GenMsgSendType" BO_ 411 0;
BA_ "VFrameFormat" BO_ 411 14;
BA_ "CANFD_BRS" BO_ 411 1;
BA_ "GenMsgCycleTime" BO_ 411 20;
BA_ "GenMsgCycleTimeFast" BO_ 411 0;
BA_ "GenMsgSendType" BO_ 411 0;
BA_ "VFrameFormat" BO_ 411 14;
BA_ "CANFD_BRS" BO_ 411 1;
BA_ "GenMsgCycleTime" BO_ 411 20;
BA_ "GenMsgCycleTimeFast" BO_ 411 0;
BA_ "GenMsgSendType" BO_ 411 0;
BA_ "VFrameFormat" BO_ 411 14;
BA_ "CANFD_BRS" BO_ 411 1;
BA_ "GenMsgCycleTime" BO_ 411 20;
BA_ "GenMsgCycleTimeFast" BO_ 411 0;
BA_ "GenMsgSendType" BO_ 411 0;
BA_ "VFrameFormat" BO_ 411 14;
BA_ "CANFD_BRS" BO_ 411 1;
BA_ "GenMsgCycleTime" BO_ 411 20;
BA_ "GenMsgCycleTimeFast" BO_ 411 0;
BA_ "GenMsgSendType" BO_ 411 0;
BA_ "VFrameFormat" BO_ 411 14;
BA_ "CANFD_BRS" BO_ 411 1;
BA_ "GenMsgCycleTime" BO_ 411 20;
BA_ "GenMsgCycleTimeFast" BO_ 411 0;
BA_ "GenMsgSendType" BO_ 411 0;
BA_ "VFrameFormat" BO_ 411 14;
BA_ "CANFD_BRS" BO_ 411 1;
BA_ "GenMsgCycleTime" BO_ 411 20;
BA_ "GenMsgCycleTimeFast" BO_ 411 0;
BA_ "GenMsgSendType" BO_ 411 0;
BA_ "VFrameFormat" BO_ 411 14;
BA_ "CANFD_BRS" BO_ 411 1;
BA_ "GenMsgCycleTime" BO_ 411 20;
BA_ "GenMsgCycleTimeFast" BO_ 411 0;
BA_ "GenMsgSendType" BO_ 411 0;
BA_ "VFrameFormat" BO_ 411 14;
BA_ "CANFD_BRS" BO_ 411 1;
BA_ "GenMsgCycleTime" BO_ 411 20;
BA_ "GenMsgCycleTimeFast" BO_ 411 0;
BA_ "GenMsgSendType" BO_ 411 0;
BA_ "VFrameFormat" BO_ 411 14;
BA_ "CANFD_BRS" BO_ 411 1;
BA_ "GenMsgCycleTime" BO_ 411 20;
BA_ "GenMsgCycleTimeFast" BO_ 411 0;
BA_ "GenMsgSendType" BO_ 411 0;
BA_ "VFrameFormat" BO_ 411 14;
BA_ "CANFD_BRS" BO_ 411 1;
BA_ "GenMsgCycleTime" BO_ 411 20;
BA_ "GenMsgCycleTimeFast" BO_ 411 0;
BA_ "GenMsgSendType" BO_ 411 0;
BA_ "VFrameFormat" BO_ 411 14;
BA_ "CANFD_BRS" BO_ 411 1;
BA_ "GenMsgCycleTime" BO_ 411 20;
BA_ "GenMsgCycleTimeFast" BO_ 411 0;
BA_ "GenMsgSendType" BO_ 411 0;
BA_ "VFrameFormat" BO_ 411 14;
BA_ "CANFD_BRS" BO_ 411 1;
BA_ "GenMsgCycleTime" BO_ 411 20;
BA_ "GenMsgCycleTimeFast" BO_ 411 0;
BA_ "GenMsgSendType" BO_ 411 0;
BA_ "VFrameFormat" BO_ 411 14;
BA_ "CANFD_BRS" BO_ 411 1;
BA_ "GenMsgCycleTime" BO_ 411 20;
BA_ "GenMsgCycleTimeFast" BO_ 411 0;
BA_ "GenMsgSendType" BO_ 411 0;
BA_ "VFrameFormat" BO_ 411 14;
BA_ "CANFD_BRS" BO_ 411 1;
BA_ "GenMsgCycleTime" BO_ 411 20;
BA_ "GenMsgCycleTimeFast" BO_ 411 0;
BA_ "GenMsgSendType" BO_ 411 0;
BA_ "VFrameFormat" BO_ 411 14;
BA_ "CANFD_BRS" BO_ 411 1;
BA_ "GenMsgCycleTime" BO_ 411 20;
BA_ "GenMsgCycleTimeFast" BO_ 411 0;
BA_ "GenMsgSendType" BO_ 411 0;
BA_ "VFrameFormat" BO_ 411 14;
BA_ "CANFD_BRS" BO_ 411 1;
BA_ "GenMsgCycleTime" BO_ 411 20;
BA_ "GenMsgCycleTimeFast" BO_ 411 0;
BA_ "GenMsgSendType" BO_ 411 0;
BA_ "VFrameFormat" BO_ 411 14;
BA_ "CANFD_BRS" BO_ 411 1;
BA_ "GenMsgCycleTime" BO_ 411 20;
BA_ "GenMsgCycleTimeFast" BO_ 411 0;
BA_ "GenMsgSendType" BO_ 411 0;
BA_ "VFrameFormat" BO_ 411 14;
BA_ "CANFD_BRS" BO_ 411 1;
BA_ "GenMsgCycleTime" BO_ 411 20;
BA_ "GenMsgCycleTimeFast" BO_ 411 0;
BA_ "GenMsgSendType" BO_ 411 0;
BA_ "VFrameFormat" BO_ 411 14;
BA_ "CANFD_BRS" BO_ 411 1;
BA_ "GenMsgCycleTime" BO_ 411 20;
BA_ "GenMsgCycleTimeFast" BO_ 411 0;
BA_ "GenMsgSendType" BO_ 411 0;
BA_ "VFrameFormat" BO_ 411 14;
BA_ "CANFD_BRS" BO_ 411 1;
BA_ "GenMsgCycleTime" BO_ 411 20;
BA_ "GenMsgCycleTimeFast" BO_ 411 0;
BA_ "GenMsgSendType" BO_ 411 0;
BA_ "VFrameFormat" BO_ 411 14;
BA_ "CANFD_BRS" BO_ 411 1;
BA_ "GenMsgCycleTime" BO_ 411 20;
BA_ "GenMsgCycleTimeFast" BO_ 411 0;
BA_ "GenMsgSendType" BO_ 411 0;
BA_ "VFrameFormat" BO_ 411 14;
BA_ "CANFD_BRS" BO_ 411 1;
BA_ "GenMsgCycleTime" BO_ 411 20;
BA_ "GenMsgCycleTimeFast" BO_ 411 0;
BA_ "GenMsgSendType" BO_ 411 0;
BA_ "VFrameFormat" BO_ 411 14;
BA_ "CANFD_BRS" BO_ 411 1;
BA_ "GenMsgCycleTime" BO_ 411 20;
BA_ "GenMsgCycleTimeFast" BO_ 411 0;
BA_ "GenMsgSendType" BO_ 411 0;
BA_ "VFrameFormat" BO_ 411 14;
BA_ "CANFD_BRS" BO_ 411 1;
BA_ "GenMsgCycleTime" BO_ 411 20;
BA_ "GenMsgCycleTimeFast" BO_ 411 0;
BA_ "GenMsgSendType" BO_ 411 0;
BA_ "VFrameFormat" BO_ 411 14;
BA_ "CANFD_BRS" BO_ 411 1;
BA_ "GenMsgCycleTime" BO_ 411 20;
BA_ "GenMsgCycleTimeFast" BO_ 411 0;
BA_ "GenMsgSendType" BO_ 411 0;
BA_ "VFrameFormat" BO_ 411 14;
BA_ "CANFD_BRS" BO_ 411 1;
BA_ "GenMsgCycleTime" BO_ 411 20;
BA_ "GenMsgCycleTimeFast" BO_ 411 0;
BA_ "GenMsgSendType" BO_ 411 0;
BA_ "VFrameFormat" BO_ 411 14;
BA_ "CANFD_BRS" BO_ 411 1;
BA_ "GenMsgCycleTime" BO_ 411 20;
BA_ "GenMsgCycleTimeFast" BO_ 411 0;
BA_ "GenMsgSendType" BO_ 411 0;
BA_ "VFrameFormat" BO_ 411 14;
BA_ "CANFD_BRS" BO_ 411 1;
BA_ "GenMsgCycleTime" BO_ 411 20;
BA_ "GenMsgCycleTimeFast" BO_ 411 0;
BA_ "GenMsgSendType" BO_ 411 0;
BA_ "VFrameFormat" BO_ 411 14;
BA_ "CANFD_BRS" BO_ 411 1;
BA_ "GenMsgCycleTime" BO_ 411 20;
BA_ "GenMsgCycleTimeFast" BO_ 411 0;
BA_ "GenMsgSendType" BO_ 411 0;
BA_ "VFrameFormat" BO_ 411 14;
BA_ "CANFD_BRS" BO_ 411 1;
BA_ "GenMsgCycleTime" BO_ 411 20;
BA_ "GenMsgCycleTimeFast" BO_ 411 0;
BA_ "GenMsgSendType" BO_ 411 0;
BA_ "VFrameFormat" BO_ 411 14;
BA_ "CANFD_BRS" BO_ 411 1;
BA_ "GenMsgCycleTime" BO_ 411 20;
BA_ "GenMsgCycleTimeFast" BO_ 411 0;
BA_ "GenMsgSendType" BO_ 411 0;
BA_ "VFrameFormat" BO_ 411 14;
BA_ "CANFD_BRS" BO_ 411 1;
BA_ "GenMsgCycleTime" BO_ 411 20;
BA_ "GenMsgCycleTimeFast" BO_ 411 0;
BA_ "GenMsgSendType" BO_ 411 0;
BA_ "VFrameFormat" BO_ 411 14;
BA_ "CANFD_BRS" BO_ 411 1;
BA_ "GenMsgCycleTime" BO_ 411 20;
BA_ "GenMsgCycleTimeFast" BO_ 411 0;
BA_ "GenMsgSendType" BO_ 411 0;
BA_ "VFrameFormat" BO_ 411 14;
BA_ "CANFD_BRS" BO_ 411 1;
BA_ "GenMsgCycleTime" BO_ 411 20;
BA_ "GenMsgCycleTimeFast" BO_ 411 0;
BA_ "GenMsgSendType" BO_ 411 0;
BA_ "VFrameFormat" BO_ 411 14;
BA_ "CANFD_BRS" BO_ 411 1;
BA_ "GenMsgCycleTime" BO_ 411 20;
BA_ "GenMsgCycleTimeFast" BO_ 411 0;
BA_ "GenMsgSendType" BO_ 411 0;
BA_ "VFrameFormat" BO_ 411 14;
BA_ "CANFD_BRS" BO_ 411 1;
BA_ "GenMsgCycleTime" BO_ 411 20;
BA_ "GenMsgCycleTimeFast" BO_ 411 0;
BA_ "GenMsgSendType" BO_ 411 0;
BA_ "VFrameFormat" BO_ 411 14;
BA_ "CANFD_BRS" BO_ 411 1;
BA_ "GenMsgCycleTime" BO_ 411 20;
BA_ "GenMsgCycleTimeFast" BO_ 411 0;
BA_ "GenMsgSendType" BO_ 411 0;
BA_ "VFrameFormat" BO_ 411 14;
BA_ "CANFD_BRS" BO_ 411 1;
BA_ "GenMsgCycleTime" BO_ 411 20;
BA_ "GenMsgCycleTimeFast" BO_ 411 0;
BA_ "GenMsgSendType" BO_ 411 0;
BA_ "VFrameFormat" BO_ 411 14;
BA_ "CANFD_BRS" BO_ 411 1;
BA_ "GenMsgCycleTime" BO_ 411 20;
BA_ "GenMsgCycleTimeFast" BO_ 411 0;
BA_ "GenMsgSendType" BO_ 411 0;
BA_ "VFrameFormat" BO_ 411 14;
BA_ "CANFD_BRS" BO_ 411 1;
BA_ "GenMsgCycleTime" BO_ 411 20;
BA_ "GenMsgCycleTimeFast" BO_ 411 0;
BA_ "GenMsgSendType" BO_ 411 0;
BA_ "VFrameFormat" BO_ 411 14;
BA_ "CANFD_BRS" BO_ 411 1;
BA_ "GenMsgCycleTime" BO_ 411 20;
BA_ "GenMsgCycleTimeFast" BO_ 411 0;
BA_ "GenMsgSendType" BO_ 411 0;
BA_ "VFrameFormat" BO_ 411 14;
BA_ "CANFD_BRS" BO_ 411 1;
BA_ "GenMsgCycleTime" BO_ 411 20;
BA_ "GenMsgCycleTimeFast" BO_ 411 0;
BA_ "GenMsgSendType" BO_ 411 0;
BA_ "VFrameFormat" BO_ 411 14;
BA_ "CANFD_BRS" BO_ 411 1;
BA_ "GenMsgCycleTime" BO_ 411 20;
BA_ "GenMsgCycleTimeFast" BO_ 411 0;
BA_ "GenMsgSendType" BO_ 411 0;
BA_ "VFrameFormat" BO_ 411 14;
BA_ "CANFD_BRS" BO_ 411 1;
BA_ "GenMsgCycleTime" BO_ 411 20;
BA_ "GenMsgCycleTimeFast" BO_ 411 0;
BA_ "GenMsgSendType" BO_ 411 0;
BA_ "VFrameFormat" BO_ 411 14;
BA_ "CANFD_BRS" BO_ 411 1;
BA_ "GenMsgCycleTime" BO_ 411 20;
BA_ "GenMsgCycleTimeFast" BO_ 411 0;
BA_ "GenMsgSendType" BO_ 411 0;
BA_ "VFrameFormat" BO_ 411 14;
BA_ "CANFD_BRS" BO_ 411 1;
BA_ "GenMsgCycleTime" BO_ 411 20;
BA_ "GenMsgCycleTimeFast" BO_ 411 0;
BA_ "GenMsgSendType" BO_ 411 0;
BA_ "VFrameFormat" BO_ 411 14;
BA_ "CANFD_BRS" BO_ 411 1;
BA_ "GenMsgCycleTime" BO_ 411 20;
BA_ "GenMsgCycleTimeFast" BO_ 411 0;
BA_ "GenMsgSendType" BO_ 411 0;
BA_ "VFrameFormat" BO_ 411 14;
BA_ "CANFD_BRS" BO_ 411 1;
BA_ "GenMsgCycleTime" BO_ 411 20;
BA_ "GenMsgCycleTimeFast" BO_ 411 0;
BA_ "GenMsgSendType" BO_ 411 0;
BA_ "VFrameFormat" BO_ 411 14;
BA_ "CANFD_BRS" BO_ 411 1;
BA_ "GenMsgCycleTime" BO_ 411 20;
BA_ "GenMsgCycleTimeFast" BO_ 411 0;
BA_ "GenMsgSendType" BO_ 411 0;
BA_ "VFrameFormat" BO_ 411 14;
BA_ "CANFD_BRS" BO_ 411 1;
BA_ "GenMsgCycleTime" BO_ 411 20;
BA_ "GenMsgCycleTimeFast" BO_ 411 0;
BA_ "GenMsgSendType" BO_ 411 0;
BA_ "VFrameFormat" BO_ 411 14;
BA_ "CANFD_BRS" BO_ 411 1;
BA_ "GenMsgCycleTime" BO_ 411 20;
BA_ "GenMsgCycleTimeFast" BO_ 411 0;
BA_ "GenMsgSendType" BO_ 411 0;
BA_ "VFrameFormat" BO_ 411 14;
BA_ "CANFD_BRS" BO_ 411 1;
BA_ "GenMsgCycleTime" BO_ 411 20;
BA_ "GenMsgCycleTimeFast" BO_ 411 0;
BA_ "GenMsgSendType" BO_ 411 0;
BA_ "VFrameFormat" BO_ 411 14;
BA_ "CANFD_BRS" BO_ 411 1;
BA_ "GenMsgCycleTime" BO_ 411 20;
BA_ "GenMsgCycleTimeFast" BO_ 411 0;
BA_ "GenMsgSendType" BO_ 411 0;
BA_ "VFrameFormat" BO_ 411 14;
BA_ "CANFD_BRS" BO_ 411 1;
BA_ "GenMsgCycleTime" BO_ 411 20;
BA_ "GenMsgCycleTimeFast" BO_ 411 0;
BA_ "GenMsgSendType" BO_ 411 0;
BA_ "VFrameFormat" BO_ 411 14;
BA_ "CANFD_BRS" BO_ 411 1;
BA_ "GenMsgCycleTime" BO_ 411 20;
BA_ "GenMsgCycleTimeFast" BO_ 411 0;
BA_ "GenMsgSendType" BO_ 411 0;
BA_ "VFrameFormat" BO_ 411 14;
BA_ "CANFD_BRS" BO_ 411 1;
BA_ "GenMsgCycleTime" BO_ 411 20;
BA_ "GenMsgCycleTimeFast" BO_ 411 0;
BA_ "GenMsgSendType" BO_ 411 0;
BA_ "VFrameFormat" BO_ 411 14;
BA_ "CANFD_BRS" BO_ 411 1;
BA_ "GenMsgCycleTime" BO_ 915 50;
BA_ "GenMsgCycleTimeFast" BO_ 915 0;
BA_ "GenMsgSendType" BO_ 915 0;
BA_ "VFrameFormat" BO_ 915 14;
BA_ "CANFD_BRS" BO_ 915 1;
BA_ "GenMsgCycleTime" BO_ 915 50;
BA_ "GenMsgCycleTimeFast" BO_ 915 0;
BA_ "GenMsgSendType" BO_ 915 0;
BA_ "VFrameFormat" BO_ 915 14;
BA_ "CANFD_BRS" BO_ 915 1;
BA_ "GenMsgCycleTime" BO_ 915 50;
BA_ "GenMsgCycleTimeFast" BO_ 915 0;
BA_ "GenMsgSendType" BO_ 915 0;
BA_ "VFrameFormat" BO_ 915 14;
BA_ "CANFD_BRS" BO_ 915 1;
BA_ "GenMsgCycleTime" BO_ 915 50;
BA_ "GenMsgCycleTimeFast" BO_ 915 0;
BA_ "GenMsgSendType" BO_ 915 0;
BA_ "VFrameFormat" BO_ 915 14;
BA_ "CANFD_BRS" BO_ 915 1;
BA_ "GenMsgCycleTime" BO_ 915 50;
BA_ "GenMsgCycleTimeFast" BO_ 915 0;
BA_ "GenMsgSendType" BO_ 915 0;
BA_ "VFrameFormat" BO_ 915 14;
BA_ "CANFD_BRS" BO_ 915 1;
BA_ "GenMsgCycleTime" BO_ 915 50;
BA_ "GenMsgCycleTimeFast" BO_ 915 0;
BA_ "GenMsgSendType" BO_ 915 0;
BA_ "VFrameFormat" BO_ 915 14;
BA_ "CANFD_BRS" BO_ 915 1;
BA_ "GenMsgCycleTime" BO_ 915 50;
BA_ "GenMsgCycleTimeFast" BO_ 915 0;
BA_ "GenMsgSendType" BO_ 915 0;
BA_ "VFrameFormat" BO_ 915 14;
BA_ "CANFD_BRS" BO_ 915 1;
BA_ "GenMsgCycleTime" BO_ 915 50;
BA_ "GenMsgCycleTimeFast" BO_ 915 0;
BA_ "GenMsgSendType" BO_ 915 0;
BA_ "VFrameFormat" BO_ 915 14;
BA_ "CANFD_BRS" BO_ 915 1;
BA_ "GenMsgCycleTime" BO_ 915 50;
BA_ "GenMsgCycleTimeFast" BO_ 915 0;
BA_ "GenMsgSendType" BO_ 915 0;
BA_ "VFrameFormat" BO_ 915 14;
BA_ "CANFD_BRS" BO_ 915 1;
BA_ "GenMsgCycleTime" BO_ 915 50;
BA_ "GenMsgCycleTimeFast" BO_ 915 0;
BA_ "GenMsgSendType" BO_ 915 0;
BA_ "VFrameFormat" BO_ 915 14;
BA_ "CANFD_BRS" BO_ 915 1;
BA_ "GenMsgCycleTime" BO_ 915 50;
BA_ "GenMsgCycleTimeFast" BO_ 915 0;
BA_ "GenMsgSendType" BO_ 915 0;
BA_ "VFrameFormat" BO_ 915 14;
BA_ "CANFD_BRS" BO_ 915 1;
BA_ "GenMsgCycleTime" BO_ 915 50;
BA_ "GenMsgCycleTimeFast" BO_ 915 0;
BA_ "GenMsgSendType" BO_ 915 0;
BA_ "VFrameFormat" BO_ 915 14;
BA_ "CANFD_BRS" BO_ 915 1;
BA_ "GenMsgCycleTime" BO_ 915 50;
BA_ "GenMsgCycleTimeFast" BO_ 915 0;
BA_ "GenMsgSendType" BO_ 915 0;
BA_ "VFrameFormat" BO_ 915 14;
BA_ "CANFD_BRS" BO_ 915 1;
BA_ "GenMsgCycleTime" BO_ 915 50;
BA_ "GenMsgCycleTimeFast" BO_ 915 0;
BA_ "GenMsgSendType" BO_ 915 0;
BA_ "VFrameFormat" BO_ 915 14;
BA_ "CANFD_BRS" BO_ 915 1;
BA_ "GenMsgCycleTime" BO_ 915 50;
BA_ "GenMsgCycleTimeFast" BO_ 915 0;
BA_ "GenMsgSendType" BO_ 915 0;
BA_ "VFrameFormat" BO_ 915 14;
BA_ "CANFD_BRS" BO_ 915 1;
BA_ "GenMsgCycleTime" BO_ 915 50;
BA_ "GenMsgCycleTimeFast" BO_ 915 0;
BA_ "GenMsgSendType" BO_ 915 0;
BA_ "VFrameFormat" BO_ 915 14;
BA_ "CANFD_BRS" BO_ 915 1;
BA_ "GenMsgCycleTime" BO_ 915 50;
BA_ "GenMsgCycleTimeFast" BO_ 915 0;
BA_ "GenMsgSendType" BO_ 915 0;
BA_ "VFrameFormat" BO_ 915 14;
BA_ "CANFD_BRS" BO_ 915 1;
BA_ "GenMsgCycleTime" BO_ 915 50;
BA_ "GenMsgCycleTimeFast" BO_ 915 0;
BA_ "GenMsgSendType" BO_ 915 0;
BA_ "VFrameFormat" BO_ 915 14;
BA_ "CANFD_BRS" BO_ 915 1;
BA_ "GenMsgCycleTime" BO_ 915 50;
BA_ "GenMsgCycleTimeFast" BO_ 915 0;
BA_ "GenMsgSendType" BO_ 915 0;
BA_ "VFrameFormat" BO_ 915 14;
BA_ "CANFD_BRS" BO_ 915 1;
BA_ "GenMsgCycleTime" BO_ 915 50;
BA_ "GenMsgCycleTimeFast" BO_ 915 0;
BA_ "GenMsgSendType" BO_ 915 0;
BA_ "VFrameFormat" BO_ 915 14;
BA_ "CANFD_BRS" BO_ 915 1;
BA_ "GenMsgCycleTime" BO_ 915 50;
BA_ "GenMsgCycleTimeFast" BO_ 915 0;
BA_ "GenMsgSendType" BO_ 915 0;
BA_ "VFrameFormat" BO_ 915 14;
BA_ "CANFD_BRS" BO_ 915 1;
BA_ "GenMsgCycleTime" BO_ 915 50;
BA_ "GenMsgCycleTimeFast" BO_ 915 0;
BA_ "GenMsgSendType" BO_ 915 0;
BA_ "VFrameFormat" BO_ 915 14;
BA_ "CANFD_BRS" BO_ 915 1;
BA_ "GenMsgCycleTime" BO_ 915 50;
BA_ "GenMsgCycleTimeFast" BO_ 915 0;
BA_ "GenMsgSendType" BO_ 915 0;
BA_ "VFrameFormat" BO_ 915 14;
BA_ "CANFD_BRS" BO_ 915 1;
BA_ "GenMsgCycleTime" BO_ 915 50;
BA_ "GenMsgCycleTimeFast" BO_ 915 0;
BA_ "GenMsgSendType" BO_ 915 0;
BA_ "VFrameFormat" BO_ 915 14;
BA_ "CANFD_BRS" BO_ 915 1;
BA_ "GenMsgCycleTime" BO_ 915 50;
BA_ "GenMsgCycleTimeFast" BO_ 915 0;
BA_ "GenMsgSendType" BO_ 915 0;
BA_ "VFrameFormat" BO_ 915 14;
BA_ "CANFD_BRS" BO_ 915 1;
BA_ "GenMsgCycleTime" BO_ 915 50;
BA_ "GenMsgCycleTimeFast" BO_ 915 0;
BA_ "GenMsgSendType" BO_ 915 0;
BA_ "VFrameFormat" BO_ 915 14;
BA_ "CANFD_BRS" BO_ 915 1;
BA_ "GenMsgCycleTime" BO_ 915 50;
BA_ "GenMsgCycleTimeFast" BO_ 915 0;
BA_ "GenMsgSendType" BO_ 915 0;
BA_ "VFrameFormat" BO_ 915 14;
BA_ "CANFD_BRS" BO_ 915 1;
BA_ "GenMsgCycleTime" BO_ 915 50;
BA_ "GenMsgCycleTimeFast" BO_ 915 0;
BA_ "GenMsgSendType" BO_ 915 0;
BA_ "VFrameFormat" BO_ 915 14;
BA_ "CANFD_BRS" BO_ 915 1;
BA_ "GenMsgCycleTime" BO_ 915 50;
BA_ "GenMsgCycleTimeFast" BO_ 915 0;
BA_ "GenMsgSendType" BO_ 915 0;
BA_ "VFrameFormat" BO_ 915 14;
BA_ "CANFD_BRS" BO_ 915 1;
BA_ "GenMsgCycleTime" BO_ 915 50;
BA_ "GenMsgCycleTimeFast" BO_ 915 0;
BA_ "GenMsgSendType" BO_ 915 0;
BA_ "VFrameFormat" BO_ 915 14;
BA_ "CANFD_BRS" BO_ 915 1;
BA_ "GenMsgCycleTime" BO_ 915 50;
BA_ "GenMsgCycleTimeFast" BO_ 915 0;
BA_ "GenMsgSendType" BO_ 915 0;
BA_ "VFrameFormat" BO_ 915 14;
BA_ "CANFD_BRS" BO_ 915 1;
BA_ "GenMsgCycleTime" BO_ 915 50;
BA_ "GenMsgCycleTimeFast" BO_ 915 0;
BA_ "GenMsgSendType" BO_ 915 0;
BA_ "VFrameFormat" BO_ 915 14;
BA_ "CANFD_BRS" BO_ 915 1;
BA_ "GenMsgCycleTime" BO_ 915 50;
BA_ "GenMsgCycleTimeFast" BO_ 915 0;
BA_ "GenMsgSendType" BO_ 915 0;
BA_ "VFrameFormat" BO_ 915 14;
BA_ "CANFD_BRS" BO_ 915 1;
BA_ "GenMsgCycleTime" BO_ 915 50;
BA_ "GenMsgCycleTimeFast" BO_ 915 0;
BA_ "GenMsgSendType" BO_ 915 0;
BA_ "VFrameFormat" BO_ 915 14;
BA_ "CANFD_BRS" BO_ 915 1;
BA_ "GenMsgCycleTime" BO_ 915 50;
BA_ "GenMsgCycleTimeFast" BO_ 915 0;
BA_ "GenMsgSendType" BO_ 915 0;
BA_ "VFrameFormat" BO_ 915 14;
BA_ "CANFD_BRS" BO_ 915 1;
BA_ "GenMsgCycleTime" BO_ 915 50;
BA_ "GenMsgCycleTimeFast" BO_ 915 0;
BA_ "GenMsgSendType" BO_ 915 0;
BA_ "VFrameFormat" BO_ 915 14;
BA_ "CANFD_BRS" BO_ 915 1;
BA_ "GenMsgCycleTime" BO_ 915 50;
BA_ "GenMsgCycleTimeFast" BO_ 915 0;
BA_ "GenMsgSendType" BO_ 915 0;
BA_ "VFrameFormat" BO_ 915 14;
BA_ "CANFD_BRS" BO_ 915 1;
BA_ "GenMsgCycleTime" BO_ 915 50;
BA_ "GenMsgCycleTimeFast" BO_ 915 0;
BA_ "GenMsgSendType" BO_ 915 0;
BA_ "VFrameFormat" BO_ 915 14;
BA_ "CANFD_BRS" BO_ 915 1;
BA_ "GenMsgCycleTime" BO_ 915 50;
BA_ "GenMsgCycleTimeFast" BO_ 915 0;
BA_ "GenMsgSendType" BO_ 915 0;
BA_ "VFrameFormat" BO_ 915 14;
BA_ "CANFD_BRS" BO_ 915 1;
BA_ "GenMsgCycleTime" BO_ 915 50;
BA_ "GenMsgCycleTimeFast" BO_ 915 0;
BA_ "GenMsgSendType" BO_ 915 0;
BA_ "VFrameFormat" BO_ 915 14;
BA_ "CANFD_BRS" BO_ 915 1;
BA_ "GenMsgCycleTime" BO_ 915 50;
BA_ "GenMsgCycleTimeFast" BO_ 915 0;
BA_ "GenMsgSendType" BO_ 915 0;
BA_ "VFrameFormat" BO_ 915 14;
BA_ "CANFD_BRS" BO_ 915 1;
BA_ "GenMsgCycleTime" BO_ 915 50;
BA_ "GenMsgCycleTimeFast" BO_ 915 0;
BA_ "GenMsgSendType" BO_ 915 0;
BA_ "VFrameFormat" BO_ 915 14;
BA_ "CANFD_BRS" BO_ 915 1;
BA_ "GenMsgCycleTime" BO_ 915 50;
BA_ "GenMsgCycleTimeFast" BO_ 915 0;
BA_ "GenMsgSendType" BO_ 915 0;
BA_ "VFrameFormat" BO_ 915 14;
BA_ "CANFD_BRS" BO_ 915 1;
BA_ "GenMsgCycleTime" BO_ 915 50;
BA_ "GenMsgCycleTimeFast" BO_ 915 0;
BA_ "GenMsgSendType" BO_ 915 0;
BA_ "VFrameFormat" BO_ 915 14;
BA_ "CANFD_BRS" BO_ 915 1;
BA_ "GenMsgCycleTime" BO_ 915 50;
BA_ "GenMsgCycleTimeFast" BO_ 915 0;
BA_ "GenMsgSendType" BO_ 915 0;
BA_ "VFrameFormat" BO_ 915 14;
BA_ "CANFD_BRS" BO_ 915 1;
BA_ "GenMsgCycleTime" BO_ 915 50;
BA_ "GenMsgCycleTimeFast" BO_ 915 0;
BA_ "GenMsgSendType" BO_ 915 0;
BA_ "VFrameFormat" BO_ 915 14;
BA_ "CANFD_BRS" BO_ 915 1;
BA_ "GenMsgCycleTime" BO_ 915 50;
BA_ "GenMsgCycleTimeFast" BO_ 915 0;
BA_ "GenMsgSendType" BO_ 915 0;
BA_ "VFrameFormat" BO_ 915 14;
BA_ "CANFD_BRS" BO_ 915 1;
BA_ "GenMsgCycleTime" BO_ 915 50;
BA_ "GenMsgCycleTimeFast" BO_ 915 0;
BA_ "GenMsgSendType" BO_ 915 0;
BA_ "VFrameFormat" BO_ 915 14;
BA_ "CANFD_BRS" BO_ 915 1;
BA_ "GenMsgCycleTime" BO_ 915 50;
BA_ "GenMsgCycleTimeFast" BO_ 915 0;
BA_ "GenMsgSendType" BO_ 915 0;
BA_ "VFrameFormat" BO_ 915 14;
BA_ "CANFD_BRS" BO_ 915 1;
BA_ "GenMsgCycleTime" BO_ 915 50;
BA_ "GenMsgCycleTimeFast" BO_ 915 0;
BA_ "GenMsgSendType" BO_ 915 0;
BA_ "VFrameFormat" BO_ 915 14;
BA_ "CANFD_BRS" BO_ 915 1;
BA_ "GenMsgCycleTime" BO_ 915 50;
BA_ "GenMsgCycleTimeFast" BO_ 915 0;
BA_ "GenMsgSendType" BO_ 915 0;
BA_ "VFrameFormat" BO_ 915 14;
BA_ "CANFD_BRS" BO_ 915 1;
BA_ "GenMsgCycleTime" BO_ 915 50;
BA_ "GenMsgCycleTimeFast" BO_ 915 0;
BA_ "GenMsgSendType" BO_ 915 0;
BA_ "VFrameFormat" BO_ 915 14;
BA_ "CANFD_BRS" BO_ 915 1;
BA_ "GenMsgCycleTime" BO_ 915 50;
BA_ "GenMsgCycleTimeFast" BO_ 915 0;
BA_ "GenMsgSendType" BO_ 915 0;
BA_ "VFrameFormat" BO_ 915 14;
BA_ "CANFD_BRS" BO_ 915 1;
BA_ "GenMsgCycleTime" BO_ 915 50;
BA_ "GenMsgCycleTimeFast" BO_ 915 0;
BA_ "GenMsgSendType" BO_ 915 0;
BA_ "VFrameFormat" BO_ 915 14;
BA_ "CANFD_BRS" BO_ 915 1;
BA_ "GenMsgCycleTime" BO_ 915 50;
BA_ "GenMsgCycleTimeFast" BO_ 915 0;
BA_ "GenMsgSendType" BO_ 915 0;
BA_ "VFrameFormat" BO_ 915 14;
BA_ "CANFD_BRS" BO_ 915 1;
BA_ "GenMsgCycleTime" BO_ 915 50;
BA_ "GenMsgCycleTimeFast" BO_ 915 0;
BA_ "GenMsgSendType" BO_ 915 0;
BA_ "VFrameFormat" BO_ 915 14;
BA_ "CANFD_BRS" BO_ 915 1;
BA_ "GenMsgCycleTime" BO_ 915 50;
BA_ "GenMsgCycleTimeFast" BO_ 915 0;
BA_ "GenMsgSendType" BO_ 915 0;
BA_ "VFrameFormat" BO_ 915 14;
BA_ "CANFD_BRS" BO_ 915 1;
BA_ "GenMsgCycleTime" BO_ 915 50;
BA_ "GenMsgCycleTimeFast" BO_ 915 0;
BA_ "GenMsgSendType" BO_ 915 0;
BA_ "VFrameFormat" BO_ 915 14;
BA_ "CANFD_BRS" BO_ 915 1;
BA_ "GenMsgCycleTime" BO_ 915 50;
BA_ "GenMsgCycleTimeFast" BO_ 915 0;
BA_ "GenMsgSendType" BO_ 915 0;
BA_ "VFrameFormat" BO_ 915 14;
BA_ "CANFD_BRS" BO_ 915 1;
BA_ "GenMsgCycleTime" BO_ 915 50;
BA_ "GenMsgCycleTimeFast" BO_ 915 0;
BA_ "GenMsgSendType" BO_ 915 0;
BA_ "VFrameFormat" BO_ 915 14;
BA_ "CANFD_BRS" BO_ 915 1;
BA_ "GenMsgCycleTime" BO_ 915 50;
BA_ "GenMsgCycleTimeFast" BO_ 915 0;
BA_ "GenMsgSendType" BO_ 915 0;
BA_ "VFrameFormat" BO_ 915 14;
BA_ "CANFD_BRS" BO_ 915 1;
BA_ "GenMsgCycleTime" BO_ 915 50;
BA_ "GenMsgCycleTimeFast" BO_ 915 0;
BA_ "GenMsgSendType" BO_ 915 0;
BA_ "VFrameFormat" BO_ 915 14;
BA_ "CANFD_BRS" BO_ 915 1;
BA_ "EventCommandSignal" SG_ 411 ADC_2_CRC 0;
BA_ "GatewayedSignals" SG_ 411 ADC_2_CRC 0;
BA_ "GenSigInactiveValue" SG_ 411 ADC_2_CRC 0;
BA_ "GenSigInvalidValue" SG_ 411 ADC_2_CRC 0;
BA_ "GenSigSendType" SG_ 411 ADC_2_CRC 1;
BA_ "GenSigStartValue" SG_ 411 ADC_2_CRC 0;
BA_ "GenSigTimeoutValue" SG_ 411 ADC_2_CRC 0;
BA_ "Remark" SG_ 411 ADC_2_CRC "";
BA_ "EventCommandSignal" SG_ 411 ADC_2_Counter 0;
BA_ "GatewayedSignals" SG_ 411 ADC_2_Counter 0;
BA_ "GenSigInactiveValue" SG_ 411 ADC_2_Counter 0;
BA_ "GenSigInvalidValue" SG_ 411 ADC_2_Counter 0;
BA_ "GenSigSendType" SG_ 411 ADC_2_Counter 1;
BA_ "GenSigStartValue" SG_ 411 ADC_2_Counter 0;
BA_ "GenSigTimeoutValue" SG_ 411 ADC_2_Counter 0;
BA_ "Remark" SG_ 411 ADC_2_Counter "";
BA_ "EventCommandSignal" SG_ 411 ADC_FCWAssistType 0;
BA_ "GatewayedSignals" SG_ 411 ADC_FCWAssistType 0;
BA_ "GenSigInactiveValue" SG_ 411 ADC_FCWAssistType 0;
BA_ "GenSigInvalidValue" SG_ 411 ADC_FCWAssistType 2;
BA_ "GenSigSendType" SG_ 411 ADC_FCWAssistType 1;
BA_ "GenSigStartValue" SG_ 411 ADC_FCWAssistType 0;
BA_ "GenSigTimeoutValue" SG_ 411 ADC_FCWAssistType 2;
BA_ "Remark" SG_ 411 ADC_FCWAssistType "";
BA_ "EventCommandSignal" SG_ 411 ADC_FCWFaultSt 0;
BA_ "GatewayedSignals" SG_ 411 ADC_FCWFaultSt 0;
BA_ "GenSigInactiveValue" SG_ 411 ADC_FCWFaultSt 0;
BA_ "GenSigInvalidValue" SG_ 411 ADC_FCWFaultSt 1;
BA_ "GenSigSendType" SG_ 411 ADC_FCWFaultSt 1;
BA_ "GenSigStartValue" SG_ 411 ADC_FCWFaultSt 0;
BA_ "GenSigTimeoutValue" SG_ 411 ADC_FCWFaultSt 1;
BA_ "Remark" SG_ 411 ADC_FCWFaultSt "";
BA_ "EventCommandSignal" SG_ 411 ADC_FCWPreWarn 0;
BA_ "GatewayedSignals" SG_ 411 ADC_FCWPreWarn 0;
BA_ "GenSigInactiveValue" SG_ 411 ADC_FCWPreWarn 0;
BA_ "GenSigInvalidValue" SG_ 411 ADC_FCWPreWarn 0;
BA_ "GenSigSendType" SG_ 411 ADC_FCWPreWarn 1;
BA_ "GenSigStartValue" SG_ 411 ADC_FCWPreWarn 0;
BA_ "GenSigTimeoutValue" SG_ 411 ADC_FCWPreWarn 0;
BA_ "Remark" SG_ 411 ADC_FCWPreWarn "";
BA_ "EventCommandSignal" SG_ 411 ADC_FCWLatentWarn 0;
BA_ "GatewayedSignals" SG_ 411 ADC_FCWLatentWarn 0;
BA_ "GenSigInactiveValue" SG_ 411 ADC_FCWLatentWarn 0;
BA_ "GenSigInvalidValue" SG_ 411 ADC_FCWLatentWarn 0;
BA_ "GenSigSendType" SG_ 411 ADC_FCWLatentWarn 1;
BA_ "GenSigStartValue" SG_ 411 ADC_FCWLatentWarn 0;
BA_ "GenSigTimeoutValue" SG_ 411 ADC_FCWLatentWarn 0;
BA_ "Remark" SG_ 411 ADC_FCWLatentWarn "";
BA_ "EventCommandSignal" SG_ 411 ADC_AutonomyLevel 0;
BA_ "GatewayedSignals" SG_ 411 ADC_AutonomyLevel 0;
BA_ "GenSigInactiveValue" SG_ 411 ADC_AutonomyLevel 0;
BA_ "GenSigInvalidValue" SG_ 411 ADC_AutonomyLevel 0;
BA_ "GenSigSendType" SG_ 411 ADC_AutonomyLevel 1;
BA_ "GenSigStartValue" SG_ 411 ADC_AutonomyLevel 0;
BA_ "GenSigTimeoutValue" SG_ 411 ADC_AutonomyLevel 0;
BA_ "Remark" SG_ 411 ADC_AutonomyLevel "";
BA_ "EventCommandSignal" SG_ 411 ADC_FCWWarmDistance 0;
BA_ "GatewayedSignals" SG_ 411 ADC_FCWWarmDistance 0;
BA_ "GenSigInactiveValue" SG_ 411 ADC_FCWWarmDistance 0;
BA_ "GenSigInvalidValue" SG_ 411 ADC_FCWWarmDistance 0;
BA_ "GenSigSendType" SG_ 411 ADC_FCWWarmDistance 1;
BA_ "GenSigStartValue" SG_ 411 ADC_FCWWarmDistance 0;
BA_ "GenSigTimeoutValue" SG_ 411 ADC_FCWWarmDistance 1;
BA_ "Remark" SG_ 411 ADC_FCWWarmDistance "Remove in next phases";
BA_ "EventCommandSignal" SG_ 411 ADC_AEBTarObjType 0;
BA_ "GatewayedSignals" SG_ 411 ADC_AEBTarObjType 0;
BA_ "GenSigInactiveValue" SG_ 411 ADC_AEBTarObjType 0;
BA_ "GenSigInvalidValue" SG_ 411 ADC_AEBTarObjType 0;
BA_ "GenSigSendType" SG_ 411 ADC_AEBTarObjType 1;
BA_ "GenSigStartValue" SG_ 411 ADC_AEBTarObjType 0;
BA_ "GenSigTimeoutValue" SG_ 411 ADC_AEBTarObjType 0;
BA_ "Remark" SG_ 411 ADC_AEBTarObjType "Remove in next phases";
BA_ "EventCommandSignal" SG_ 411 ADC_PMAEnableSt 0;
BA_ "GatewayedSignals" SG_ 411 ADC_PMAEnableSt 0;
BA_ "GenSigInactiveValue" SG_ 411 ADC_PMAEnableSt 0;
BA_ "GenSigInvalidValue" SG_ 411 ADC_PMAEnableSt 0;
BA_ "GenSigSendType" SG_ 411 ADC_PMAEnableSt 1;
BA_ "GenSigStartValue" SG_ 411 ADC_PMAEnableSt 0;
BA_ "GenSigTimeoutValue" SG_ 411 ADC_PMAEnableSt 0;
BA_ "Remark" SG_ 411 ADC_PMAEnableSt "";
BA_ "EventCommandSignal" SG_ 411 ADC_PMAWarStatus 0;
BA_ "GatewayedSignals" SG_ 411 ADC_PMAWarStatus 0;
BA_ "GenSigInactiveValue" SG_ 411 ADC_PMAWarStatus 0;
BA_ "GenSigInvalidValue" SG_ 411 ADC_PMAWarStatus 0;
BA_ "GenSigSendType" SG_ 411 ADC_PMAWarStatus 1;
BA_ "GenSigStartValue" SG_ 411 ADC_PMAWarStatus 0;
BA_ "GenSigTimeoutValue" SG_ 411 ADC_PMAWarStatus 0;
BA_ "Remark" SG_ 411 ADC_PMAWarStatus "";
BA_ "EventCommandSignal" SG_ 411 ADC_BSDVibrWarnR 0;
BA_ "GatewayedSignals" SG_ 411 ADC_BSDVibrWarnR 0;
BA_ "GenSigInactiveValue" SG_ 411 ADC_BSDVibrWarnR 0;
BA_ "GenSigInvalidValue" SG_ 411 ADC_BSDVibrWarnR 0;
BA_ "GenSigSendType" SG_ 411 ADC_BSDVibrWarnR 1;
BA_ "GenSigStartValue" SG_ 411 ADC_BSDVibrWarnR 0;
BA_ "GenSigTimeoutValue" SG_ 411 ADC_BSDVibrWarnR 0;
BA_ "Remark" SG_ 411 ADC_BSDVibrWarnR "";
BA_ "EventCommandSignal" SG_ 411 ADC_BSDVibrWarnL 0;
BA_ "GatewayedSignals" SG_ 411 ADC_BSDVibrWarnL 0;
BA_ "GenSigInactiveValue" SG_ 411 ADC_BSDVibrWarnL 0;
BA_ "GenSigInvalidValue" SG_ 411 ADC_BSDVibrWarnL 0;
BA_ "GenSigSendType" SG_ 411 ADC_BSDVibrWarnL 1;
BA_ "GenSigStartValue" SG_ 411 ADC_BSDVibrWarnL 0;
BA_ "GenSigTimeoutValue" SG_ 411 ADC_BSDVibrWarnL 0;
BA_ "Remark" SG_ 411 ADC_BSDVibrWarnL "";
BA_ "EventCommandSignal" SG_ 411 ADC_AEBBrkPedalOverRide 0;
BA_ "GatewayedSignals" SG_ 411 ADC_AEBBrkPedalOverRide 0;
BA_ "GenSigInactiveValue" SG_ 411 ADC_AEBBrkPedalOverRide 0;
BA_ "GenSigInvalidValue" SG_ 411 ADC_AEBBrkPedalOverRide 0;
BA_ "GenSigSendType" SG_ 411 ADC_AEBBrkPedalOverRide 1;
BA_ "GenSigStartValue" SG_ 411 ADC_AEBBrkPedalOverRide 0;
BA_ "GenSigTimeoutValue" SG_ 411 ADC_AEBBrkPedalOverRide 0;
BA_ "Remark" SG_ 411 ADC_AEBBrkPedalOverRide "Remove in next phases";
BA_ "EventCommandSignal" SG_ 411 ADC_AEBBrePedalPressure 0;
BA_ "GatewayedSignals" SG_ 411 ADC_AEBBrePedalPressure 0;
BA_ "GenSigInactiveValue" SG_ 411 ADC_AEBBrePedalPressure 0;
BA_ "GenSigInvalidValue" SG_ 411 ADC_AEBBrePedalPressure 0;
BA_ "GenSigSendType" SG_ 411 ADC_AEBBrePedalPressure 1;
BA_ "GenSigStartValue" SG_ 411 ADC_AEBBrePedalPressure 0;
BA_ "GenSigTimeoutValue" SG_ 411 ADC_AEBBrePedalPressure 0;
BA_ "Remark" SG_ 411 ADC_AEBBrePedalPressure "";
BA_ "EventCommandSignal" SG_ 411 ADC_AEBAccelePedalOverRide 0;
BA_ "GatewayedSignals" SG_ 411 ADC_AEBAccelePedalOverRide 0;
BA_ "GenSigInactiveValue" SG_ 411 ADC_AEBAccelePedalOverRide 0;
BA_ "GenSigInvalidValue" SG_ 411 ADC_AEBAccelePedalOverRide 0;
BA_ "GenSigSendType" SG_ 411 ADC_AEBAccelePedalOverRide 1;
BA_ "GenSigStartValue" SG_ 411 ADC_AEBAccelePedalOverRide 0;
BA_ "GenSigTimeoutValue" SG_ 411 ADC_AEBAccelePedalOverRide 0;
BA_ "Remark" SG_ 411 ADC_AEBAccelePedalOverRide "";
BA_ "EventCommandSignal" SG_ 411 ADC_AEBSteeringInhibit 0;
BA_ "GatewayedSignals" SG_ 411 ADC_AEBSteeringInhibit 0;
BA_ "GenSigInactiveValue" SG_ 411 ADC_AEBSteeringInhibit 0;
BA_ "GenSigInvalidValue" SG_ 411 ADC_AEBSteeringInhibit 0;
BA_ "GenSigSendType" SG_ 411 ADC_AEBSteeringInhibit 1;
BA_ "GenSigStartValue" SG_ 411 ADC_AEBSteeringInhibit 0;
BA_ "GenSigTimeoutValue" SG_ 411 ADC_AEBSteeringInhibit 0;
BA_ "Remark" SG_ 411 ADC_AEBSteeringInhibit "";
BA_ "EventCommandSignal" SG_ 411 ADC_AEBTarLatPos 0;
BA_ "GatewayedSignals" SG_ 411 ADC_AEBTarLatPos 0;
BA_ "GenSigInactiveValue" SG_ 411 ADC_AEBTarLatPos 0;
BA_ "GenSigInvalidValue" SG_ 411 ADC_AEBTarLatPos 0;
BA_ "GenSigSendType" SG_ 411 ADC_AEBTarLatPos 1;
BA_ "GenSigStartValue" SG_ 411 ADC_AEBTarLatPos 0;
BA_ "GenSigTimeoutValue" SG_ 411 ADC_AEBTarLatPos 0;
BA_ "Remark" SG_ 411 ADC_AEBTarLatPos "";
BA_ "EventCommandSignal" SG_ 411 ADC_AEBTarRangeRate 0;
BA_ "GatewayedSignals" SG_ 411 ADC_AEBTarRangeRate 0;
BA_ "GenSigInactiveValue" SG_ 411 ADC_AEBTarRangeRate 0;
BA_ "GenSigInvalidValue" SG_ 411 ADC_AEBTarRangeRate 0;
BA_ "GenSigSendType" SG_ 411 ADC_AEBTarRangeRate 1;
BA_ "GenSigStartValue" SG_ 411 ADC_AEBTarRangeRate 0;
BA_ "GenSigTimeoutValue" SG_ 411 ADC_AEBTarRangeRate 0;
BA_ "Remark" SG_ 411 ADC_AEBTarRangeRate "";
BA_ "EventCommandSignal" SG_ 411 ADC_AEBTarOncomingState 0;
BA_ "GatewayedSignals" SG_ 411 ADC_AEBTarOncomingState 0;
BA_ "GenSigInactiveValue" SG_ 411 ADC_AEBTarOncomingState 0;
BA_ "GenSigInvalidValue" SG_ 411 ADC_AEBTarOncomingState 0;
BA_ "GenSigSendType" SG_ 411 ADC_AEBTarOncomingState 1;
BA_ "GenSigStartValue" SG_ 411 ADC_AEBTarOncomingState 0;
BA_ "GenSigTimeoutValue" SG_ 411 ADC_AEBTarOncomingState 0;
BA_ "Remark" SG_ 411 ADC_AEBTarOncomingState "";
BA_ "EventCommandSignal" SG_ 411 ADC_AEBTarMotionState 0;
BA_ "GatewayedSignals" SG_ 411 ADC_AEBTarMotionState 0;
BA_ "GenSigInactiveValue" SG_ 411 ADC_AEBTarMotionState 0;
BA_ "GenSigInvalidValue" SG_ 411 ADC_AEBTarMotionState 0;
BA_ "GenSigSendType" SG_ 411 ADC_AEBTarMotionState 1;
BA_ "GenSigStartValue" SG_ 411 ADC_AEBTarMotionState 0;
BA_ "GenSigTimeoutValue" SG_ 411 ADC_AEBTarMotionState 0;
BA_ "Remark" SG_ 411 ADC_AEBTarMotionState "";
BA_ "EventCommandSignal" SG_ 411 ADC_AEBTarConfiLevel 0;
BA_ "GatewayedSignals" SG_ 411 ADC_AEBTarConfiLevel 0;
BA_ "GenSigInactiveValue" SG_ 411 ADC_AEBTarConfiLevel 0;
BA_ "GenSigInvalidValue" SG_ 411 ADC_AEBTarConfiLevel 0;
BA_ "GenSigSendType" SG_ 411 ADC_AEBTarConfiLevel 1;
BA_ "GenSigStartValue" SG_ 411 ADC_AEBTarConfiLevel 0;
BA_ "GenSigTimeoutValue" SG_ 411 ADC_AEBTarConfiLevel 0;
BA_ "Remark" SG_ 411 ADC_AEBTarConfiLevel "";
BA_ "EventCommandSignal" SG_ 411 ADC_AEBTarLongPos 0;
BA_ "GatewayedSignals" SG_ 411 ADC_AEBTarLongPos 0;
BA_ "GenSigInactiveValue" SG_ 411 ADC_AEBTarLongPos 0;
BA_ "GenSigInvalidValue" SG_ 411 ADC_AEBTarLongPos 0;
BA_ "GenSigSendType" SG_ 411 ADC_AEBTarLongPos 1;
BA_ "GenSigStartValue" SG_ 411 ADC_AEBTarLongPos 0;
BA_ "GenSigTimeoutValue" SG_ 411 ADC_AEBTarLongPos 0;
BA_ "Remark" SG_ 411 ADC_AEBTarLongPos "";
BA_ "EventCommandSignal" SG_ 411 ADC_AEBTarLatSpd 0;
BA_ "GatewayedSignals" SG_ 411 ADC_AEBTarLatSpd 0;
BA_ "GenSigInactiveValue" SG_ 411 ADC_AEBTarLatSpd 0;
BA_ "GenSigInvalidValue" SG_ 411 ADC_AEBTarLatSpd 0;
BA_ "GenSigSendType" SG_ 411 ADC_AEBTarLatSpd 1;
BA_ "GenSigStartValue" SG_ 411 ADC_AEBTarLatSpd 0;
BA_ "GenSigTimeoutValue" SG_ 411 ADC_AEBTarLatSpd 0;
BA_ "Remark" SG_ 411 ADC_AEBTarLatSpd "";
BA_ "EventCommandSignal" SG_ 411 ADC_AEBTarSensorSource 0;
BA_ "GatewayedSignals" SG_ 411 ADC_AEBTarSensorSource 0;
BA_ "GenSigInactiveValue" SG_ 411 ADC_AEBTarSensorSource 0;
BA_ "GenSigInvalidValue" SG_ 411 ADC_AEBTarSensorSource 0;
BA_ "GenSigSendType" SG_ 411 ADC_AEBTarSensorSource 1;
BA_ "GenSigStartValue" SG_ 411 ADC_AEBTarSensorSource 0;
BA_ "GenSigTimeoutValue" SG_ 411 ADC_AEBTarSensorSource 0;
BA_ "Remark" SG_ 411 ADC_AEBTarSensorSource "";
BA_ "EventCommandSignal" SG_ 411 ADC_AEBTarRangeAccel 0;
BA_ "GatewayedSignals" SG_ 411 ADC_AEBTarRangeAccel 0;
BA_ "GenSigInactiveValue" SG_ 411 ADC_AEBTarRangeAccel 0;
BA_ "GenSigInvalidValue" SG_ 411 ADC_AEBTarRangeAccel 0;
BA_ "GenSigSendType" SG_ 411 ADC_AEBTarRangeAccel 1;
BA_ "GenSigStartValue" SG_ 411 ADC_AEBTarRangeAccel 0;
BA_ "GenSigTimeoutValue" SG_ 411 ADC_AEBTarRangeAccel 0;
BA_ "Remark" SG_ 411 ADC_AEBTarRangeAccel "Remove in next phases";
BA_ "EventCommandSignal" SG_ 411 ADC_DOWAudioWarnFR 0;
BA_ "GatewayedSignals" SG_ 411 ADC_DOWAudioWarnFR 0;
BA_ "GenSigInactiveValue" SG_ 411 ADC_DOWAudioWarnFR 0;
BA_ "GenSigInvalidValue" SG_ 411 ADC_DOWAudioWarnFR 0;
BA_ "GenSigSendType" SG_ 411 ADC_DOWAudioWarnFR 1;
BA_ "GenSigStartValue" SG_ 411 ADC_DOWAudioWarnFR 0;
BA_ "GenSigTimeoutValue" SG_ 411 ADC_DOWAudioWarnFR 0;
BA_ "Remark" SG_ 411 ADC_DOWAudioWarnFR "";
BA_ "EventCommandSignal" SG_ 411 ADC_DOWAudioWarnFL 0;
BA_ "GatewayedSignals" SG_ 411 ADC_DOWAudioWarnFL 0;
BA_ "GenSigInactiveValue" SG_ 411 ADC_DOWAudioWarnFL 0;
BA_ "GenSigInvalidValue" SG_ 411 ADC_DOWAudioWarnFL 0;
BA_ "GenSigSendType" SG_ 411 ADC_DOWAudioWarnFL 1;
BA_ "GenSigStartValue" SG_ 411 ADC_DOWAudioWarnFL 0;
BA_ "GenSigTimeoutValue" SG_ 411 ADC_DOWAudioWarnFL 0;
BA_ "Remark" SG_ 411 ADC_DOWAudioWarnFL "";
BA_ "EventCommandSignal" SG_ 411 ADC_DOWAudioWarnRR 0;
BA_ "GatewayedSignals" SG_ 411 ADC_DOWAudioWarnRR 0;
BA_ "GenSigInactiveValue" SG_ 411 ADC_DOWAudioWarnRR 0;
BA_ "GenSigInvalidValue" SG_ 411 ADC_DOWAudioWarnRR 0;
BA_ "GenSigSendType" SG_ 411 ADC_DOWAudioWarnRR 1;
BA_ "GenSigStartValue" SG_ 411 ADC_DOWAudioWarnRR 0;
BA_ "GenSigTimeoutValue" SG_ 411 ADC_DOWAudioWarnRR 0;
BA_ "Remark" SG_ 411 ADC_DOWAudioWarnRR "";
BA_ "EventCommandSignal" SG_ 411 ADC_DOWAudioWarnRL 0;
BA_ "GatewayedSignals" SG_ 411 ADC_DOWAudioWarnRL 0;
BA_ "GenSigInactiveValue" SG_ 411 ADC_DOWAudioWarnRL 0;
BA_ "GenSigInvalidValue" SG_ 411 ADC_DOWAudioWarnRL 0;
BA_ "GenSigSendType" SG_ 411 ADC_DOWAudioWarnRL 1;
BA_ "GenSigStartValue" SG_ 411 ADC_DOWAudioWarnRL 0;
BA_ "GenSigTimeoutValue" SG_ 411 ADC_DOWAudioWarnRL 0;
BA_ "Remark" SG_ 411 ADC_DOWAudioWarnRL "Remove in next phases";
BA_ "EventCommandSignal" SG_ 411 ADC_DOWIALWarnFR 0;
BA_ "GatewayedSignals" SG_ 411 ADC_DOWIALWarnFR 0;
BA_ "GenSigInactiveValue" SG_ 411 ADC_DOWIALWarnFR 0;
BA_ "GenSigInvalidValue" SG_ 411 ADC_DOWIALWarnFR 0;
BA_ "GenSigSendType" SG_ 411 ADC_DOWIALWarnFR 1;
BA_ "GenSigStartValue" SG_ 411 ADC_DOWIALWarnFR 0;
BA_ "GenSigTimeoutValue" SG_ 411 ADC_DOWIALWarnFR 0;
BA_ "Remark" SG_ 411 ADC_DOWIALWarnFR "";
BA_ "EventCommandSignal" SG_ 411 ADC_DOWIALWarnFL 0;
BA_ "GatewayedSignals" SG_ 411 ADC_DOWIALWarnFL 0;
BA_ "GenSigInactiveValue" SG_ 411 ADC_DOWIALWarnFL 0;
BA_ "GenSigInvalidValue" SG_ 411 ADC_DOWIALWarnFL 0;
BA_ "GenSigSendType" SG_ 411 ADC_DOWIALWarnFL 1;
BA_ "GenSigStartValue" SG_ 411 ADC_DOWIALWarnFL 0;
BA_ "GenSigTimeoutValue" SG_ 411 ADC_DOWIALWarnFL 0;
BA_ "Remark" SG_ 411 ADC_DOWIALWarnFL "Remove in next phases";
BA_ "EventCommandSignal" SG_ 411 ADC_DOWIALWarnRR 0;
BA_ "GatewayedSignals" SG_ 411 ADC_DOWIALWarnRR 0;
BA_ "GenSigInactiveValue" SG_ 411 ADC_DOWIALWarnRR 0;
BA_ "GenSigInvalidValue" SG_ 411 ADC_DOWIALWarnRR 0;
BA_ "GenSigSendType" SG_ 411 ADC_DOWIALWarnRR 1;
BA_ "GenSigStartValue" SG_ 411 ADC_DOWIALWarnRR 0;
BA_ "GenSigTimeoutValue" SG_ 411 ADC_DOWIALWarnRR 0;
BA_ "Remark" SG_ 411 ADC_DOWIALWarnRR "Remove in next phases";
BA_ "EventCommandSignal" SG_ 411 ADC_DOWIALWarnRL 0;
BA_ "GatewayedSignals" SG_ 411 ADC_DOWIALWarnRL 0;
BA_ "GenSigInactiveValue" SG_ 411 ADC_DOWIALWarnRL 0;
BA_ "GenSigInvalidValue" SG_ 411 ADC_DOWIALWarnRL 0;
BA_ "GenSigSendType" SG_ 411 ADC_DOWIALWarnRL 1;
BA_ "GenSigStartValue" SG_ 411 ADC_DOWIALWarnRL 0;
BA_ "GenSigTimeoutValue" SG_ 411 ADC_DOWIALWarnRL 0;
BA_ "Remark" SG_ 411 ADC_DOWIALWarnRL "";
BA_ "EventCommandSignal" SG_ 411 ADC_BSDExMirLedWarnR 0;
BA_ "GatewayedSignals" SG_ 411 ADC_BSDExMirLedWarnR 0;
BA_ "GenSigInactiveValue" SG_ 411 ADC_BSDExMirLedWarnR 0;
BA_ "GenSigInvalidValue" SG_ 411 ADC_BSDExMirLedWarnR 0;
BA_ "GenSigSendType" SG_ 411 ADC_BSDExMirLedWarnR 1;
BA_ "GenSigStartValue" SG_ 411 ADC_BSDExMirLedWarnR 0;
BA_ "GenSigTimeoutValue" SG_ 411 ADC_BSDExMirLedWarnR 0;
BA_ "Remark" SG_ 411 ADC_BSDExMirLedWarnR "";
BA_ "EventCommandSignal" SG_ 411 ADC_BSDExMirLedWarnL 0;
BA_ "GatewayedSignals" SG_ 411 ADC_BSDExMirLedWarnL 0;
BA_ "GenSigInactiveValue" SG_ 411 ADC_BSDExMirLedWarnL 0;
BA_ "GenSigInvalidValue" SG_ 411 ADC_BSDExMirLedWarnL 0;
BA_ "GenSigSendType" SG_ 411 ADC_BSDExMirLedWarnL 1;
BA_ "GenSigStartValue" SG_ 411 ADC_BSDExMirLedWarnL 0;
BA_ "GenSigTimeoutValue" SG_ 411 ADC_BSDExMirLedWarnL 0;
BA_ "Remark" SG_ 411 ADC_BSDExMirLedWarnL "";
BA_ "EventCommandSignal" SG_ 411 ADC_BSDLCASt 0;
BA_ "GatewayedSignals" SG_ 411 ADC_BSDLCASt 0;
BA_ "GenSigInactiveValue" SG_ 411 ADC_BSDLCASt 0;
BA_ "GenSigInvalidValue" SG_ 411 ADC_BSDLCASt 0;
BA_ "GenSigSendType" SG_ 411 ADC_BSDLCASt 1;
BA_ "GenSigStartValue" SG_ 411 ADC_BSDLCASt 0;
BA_ "GenSigTimeoutValue" SG_ 411 ADC_BSDLCASt 3;
BA_ "Remark" SG_ 411 ADC_BSDLCASt "";
BA_ "EventCommandSignal" SG_ 411 ADC_BSDLCAEnableSt 0;
BA_ "GatewayedSignals" SG_ 411 ADC_BSDLCAEnableSt 0;
BA_ "GenSigInactiveValue" SG_ 411 ADC_BSDLCAEnableSt 0;
BA_ "GenSigInvalidValue" SG_ 411 ADC_BSDLCAEnableSt 0;
BA_ "GenSigSendType" SG_ 411 ADC_BSDLCAEnableSt 1;
BA_ "GenSigStartValue" SG_ 411 ADC_BSDLCAEnableSt 0;
BA_ "GenSigTimeoutValue" SG_ 411 ADC_BSDLCAEnableSt 0;
BA_ "Remark" SG_ 411 ADC_BSDLCAEnableSt "";
BA_ "EventCommandSignal" SG_ 411 ADC_RCTAEnableSt 0;
BA_ "GatewayedSignals" SG_ 411 ADC_RCTAEnableSt 0;
BA_ "GenSigInactiveValue" SG_ 411 ADC_RCTAEnableSt 0;
BA_ "GenSigInvalidValue" SG_ 411 ADC_RCTAEnableSt 0;
BA_ "GenSigSendType" SG_ 411 ADC_RCTAEnableSt 1;
BA_ "GenSigStartValue" SG_ 411 ADC_RCTAEnableSt 0;
BA_ "GenSigTimeoutValue" SG_ 411 ADC_RCTAEnableSt 0;
BA_ "Remark" SG_ 411 ADC_RCTAEnableSt "";
BA_ "EventCommandSignal" SG_ 411 ADC_RCTASt 0;
BA_ "GatewayedSignals" SG_ 411 ADC_RCTASt 0;
BA_ "GenSigInactiveValue" SG_ 411 ADC_RCTASt 0;
BA_ "GenSigInvalidValue" SG_ 411 ADC_RCTASt 0;
BA_ "GenSigSendType" SG_ 411 ADC_RCTASt 1;
BA_ "GenSigStartValue" SG_ 411 ADC_RCTASt 0;
BA_ "GenSigTimeoutValue" SG_ 411 ADC_RCTASt 3;
BA_ "Remark" SG_ 411 ADC_RCTASt "";
BA_ "EventCommandSignal" SG_ 411 ADC_RCTAAssistType 0;
BA_ "GatewayedSignals" SG_ 411 ADC_RCTAAssistType 0;
BA_ "GenSigInactiveValue" SG_ 411 ADC_RCTAAssistType 0;
BA_ "GenSigInvalidValue" SG_ 411 ADC_RCTAAssistType 0;
BA_ "GenSigSendType" SG_ 411 ADC_RCTAAssistType 1;
BA_ "GenSigStartValue" SG_ 411 ADC_RCTAAssistType 0;
BA_ "GenSigTimeoutValue" SG_ 411 ADC_RCTAAssistType 0;
BA_ "Remark" SG_ 411 ADC_RCTAAssistType "";
BA_ "EventCommandSignal" SG_ 411 ADC_DOWSt 0;
BA_ "GatewayedSignals" SG_ 411 ADC_DOWSt 0;
BA_ "GenSigInactiveValue" SG_ 411 ADC_DOWSt 0;
BA_ "GenSigInvalidValue" SG_ 411 ADC_DOWSt 0;
BA_ "GenSigSendType" SG_ 411 ADC_DOWSt 1;
BA_ "GenSigStartValue" SG_ 411 ADC_DOWSt 0;
BA_ "GenSigTimeoutValue" SG_ 411 ADC_DOWSt 3;
BA_ "Remark" SG_ 411 ADC_DOWSt "";
BA_ "EventCommandSignal" SG_ 411 ADC_DOWEnableSt 0;
BA_ "GatewayedSignals" SG_ 411 ADC_DOWEnableSt 0;
BA_ "GenSigInactiveValue" SG_ 411 ADC_DOWEnableSt 0;
BA_ "GenSigInvalidValue" SG_ 411 ADC_DOWEnableSt 0;
BA_ "GenSigSendType" SG_ 411 ADC_DOWEnableSt 1;
BA_ "GenSigStartValue" SG_ 411 ADC_DOWEnableSt 0;
BA_ "GenSigTimeoutValue" SG_ 411 ADC_DOWEnableSt 0;
BA_ "Remark" SG_ 411 ADC_DOWEnableSt "";
BA_ "EventCommandSignal" SG_ 411 ADC_LCAWarnLeft 0;
BA_ "GatewayedSignals" SG_ 411 ADC_LCAWarnLeft 0;
BA_ "GenSigInactiveValue" SG_ 411 ADC_LCAWarnLeft 0;
BA_ "GenSigInvalidValue" SG_ 411 ADC_LCAWarnLeft 0;
BA_ "GenSigSendType" SG_ 411 ADC_LCAWarnLeft 1;
BA_ "GenSigStartValue" SG_ 411 ADC_LCAWarnLeft 0;
BA_ "GenSigTimeoutValue" SG_ 411 ADC_LCAWarnLeft 0;
BA_ "Remark" SG_ 411 ADC_LCAWarnLeft "";
BA_ "EventCommandSignal" SG_ 411 ADC_LCAWarnRight 0;
BA_ "GatewayedSignals" SG_ 411 ADC_LCAWarnRight 0;
BA_ "GenSigInactiveValue" SG_ 411 ADC_LCAWarnRight 0;
BA_ "GenSigInvalidValue" SG_ 411 ADC_LCAWarnRight 0;
BA_ "GenSigSendType" SG_ 411 ADC_LCAWarnRight 1;
BA_ "GenSigStartValue" SG_ 411 ADC_LCAWarnRight 0;
BA_ "GenSigTimeoutValue" SG_ 411 ADC_LCAWarnRight 0;
BA_ "Remark" SG_ 411 ADC_LCAWarnRight "";
BA_ "EventCommandSignal" SG_ 411 ADC_RCTAWarnLeft 0;
BA_ "GatewayedSignals" SG_ 411 ADC_RCTAWarnLeft 0;
BA_ "GenSigInactiveValue" SG_ 411 ADC_RCTAWarnLeft 0;
BA_ "GenSigInvalidValue" SG_ 411 ADC_RCTAWarnLeft 0;
BA_ "GenSigSendType" SG_ 411 ADC_RCTAWarnLeft 1;
BA_ "GenSigStartValue" SG_ 411 ADC_RCTAWarnLeft 0;
BA_ "GenSigTimeoutValue" SG_ 411 ADC_RCTAWarnLeft 0;
BA_ "Remark" SG_ 411 ADC_RCTAWarnLeft "";
BA_ "EventCommandSignal" SG_ 411 ADC_RCWEnableSt 0;
BA_ "GatewayedSignals" SG_ 411 ADC_RCWEnableSt 0;
BA_ "GenSigInactiveValue" SG_ 411 ADC_RCWEnableSt 0;
BA_ "GenSigInvalidValue" SG_ 411 ADC_RCWEnableSt 0;
BA_ "GenSigSendType" SG_ 411 ADC_RCWEnableSt 1;
BA_ "GenSigStartValue" SG_ 411 ADC_RCWEnableSt 0;
BA_ "GenSigTimeoutValue" SG_ 411 ADC_RCWEnableSt 0;
BA_ "Remark" SG_ 411 ADC_RCWEnableSt "";
BA_ "EventCommandSignal" SG_ 411 ADC_RCTAWarnRight 0;
BA_ "GatewayedSignals" SG_ 411 ADC_RCTAWarnRight 0;
BA_ "GenSigInactiveValue" SG_ 411 ADC_RCTAWarnRight 0;
BA_ "GenSigInvalidValue" SG_ 411 ADC_RCTAWarnRight 0;
BA_ "GenSigSendType" SG_ 411 ADC_RCTAWarnRight 1;
BA_ "GenSigStartValue" SG_ 411 ADC_RCTAWarnRight 0;
BA_ "GenSigTimeoutValue" SG_ 411 ADC_RCTAWarnRight 0;
BA_ "Remark" SG_ 411 ADC_RCTAWarnRight "";
BA_ "EventCommandSignal" SG_ 411 ADC_RCWSt 0;
BA_ "GatewayedSignals" SG_ 411 ADC_RCWSt 0;
BA_ "GenSigInactiveValue" SG_ 411 ADC_RCWSt 0;
BA_ "GenSigInvalidValue" SG_ 411 ADC_RCWSt 0;
BA_ "GenSigSendType" SG_ 411 ADC_RCWSt 1;
BA_ "GenSigStartValue" SG_ 411 ADC_RCWSt 0;
BA_ "GenSigTimeoutValue" SG_ 411 ADC_RCWSt 3;
BA_ "Remark" SG_ 411 ADC_RCWSt "";
BA_ "EventCommandSignal" SG_ 411 ADC_RCWWarn 0;
BA_ "GatewayedSignals" SG_ 411 ADC_RCWWarn 0;
BA_ "GenSigInactiveValue" SG_ 411 ADC_RCWWarn 0;
BA_ "GenSigInvalidValue" SG_ 411 ADC_RCWWarn 0;
BA_ "GenSigSendType" SG_ 411 ADC_RCWWarn 1;
BA_ "GenSigStartValue" SG_ 411 ADC_RCWWarn 0;
BA_ "GenSigTimeoutValue" SG_ 411 ADC_RCWWarn 0;
BA_ "Remark" SG_ 411 ADC_RCWWarn "";
BA_ "EventCommandSignal" SG_ 411 ADC_FCTAEnableSt 0;
BA_ "GatewayedSignals" SG_ 411 ADC_FCTAEnableSt 0;
BA_ "GenSigInactiveValue" SG_ 411 ADC_FCTAEnableSt 0;
BA_ "GenSigInvalidValue" SG_ 411 ADC_FCTAEnableSt 0;
BA_ "GenSigSendType" SG_ 411 ADC_FCTAEnableSt 1;
BA_ "GenSigStartValue" SG_ 411 ADC_FCTAEnableSt 0;
BA_ "GenSigTimeoutValue" SG_ 411 ADC_FCTAEnableSt 0;
BA_ "Remark" SG_ 411 ADC_FCTAEnableSt "";
BA_ "EventCommandSignal" SG_ 411 ADC_FCTASt 0;
BA_ "GatewayedSignals" SG_ 411 ADC_FCTASt 0;
BA_ "GenSigInactiveValue" SG_ 411 ADC_FCTASt 0;
BA_ "GenSigInvalidValue" SG_ 411 ADC_FCTASt 0;
BA_ "GenSigSendType" SG_ 411 ADC_FCTASt 1;
BA_ "GenSigStartValue" SG_ 411 ADC_FCTASt 0;
BA_ "GenSigTimeoutValue" SG_ 411 ADC_FCTASt 3;
BA_ "Remark" SG_ 411 ADC_FCTASt "";
BA_ "EventCommandSignal" SG_ 411 ADC_FCTAAssistType 0;
BA_ "GatewayedSignals" SG_ 411 ADC_FCTAAssistType 0;
BA_ "GenSigInactiveValue" SG_ 411 ADC_FCTAAssistType 0;
BA_ "GenSigInvalidValue" SG_ 411 ADC_FCTAAssistType 0;
BA_ "GenSigSendType" SG_ 411 ADC_FCTAAssistType 1;
BA_ "GenSigStartValue" SG_ 411 ADC_FCTAAssistType 0;
BA_ "GenSigTimeoutValue" SG_ 411 ADC_FCTAAssistType 0;
BA_ "Remark" SG_ 411 ADC_FCTAAssistType "";
BA_ "EventCommandSignal" SG_ 411 ADC_FCTAWarnL 0;
BA_ "GatewayedSignals" SG_ 411 ADC_FCTAWarnL 0;
BA_ "GenSigInactiveValue" SG_ 411 ADC_FCTAWarnL 0;
BA_ "GenSigInvalidValue" SG_ 411 ADC_FCTAWarnL 0;
BA_ "GenSigSendType" SG_ 411 ADC_FCTAWarnL 1;
BA_ "GenSigStartValue" SG_ 411 ADC_FCTAWarnL 0;
BA_ "GenSigTimeoutValue" SG_ 411 ADC_FCTAWarnL 0;
BA_ "Remark" SG_ 411 ADC_FCTAWarnL "";
BA_ "EventCommandSignal" SG_ 411 ADC_FCTAWarnR 0;
BA_ "GatewayedSignals" SG_ 411 ADC_FCTAWarnR 0;
BA_ "GenSigInactiveValue" SG_ 411 ADC_FCTAWarnR 0;
BA_ "GenSigInvalidValue" SG_ 411 ADC_FCTAWarnR 0;
BA_ "GenSigSendType" SG_ 411 ADC_FCTAWarnR 1;
BA_ "GenSigStartValue" SG_ 411 ADC_FCTAWarnR 0;
BA_ "GenSigTimeoutValue" SG_ 411 ADC_FCTAWarnR 0;
BA_ "Remark" SG_ 411 ADC_FCTAWarnR "";
BA_ "EventCommandSignal" SG_ 411 ADC_FroNestTarRangeRate 0;
BA_ "GatewayedSignals" SG_ 411 ADC_FroNestTarRangeRate 0;
BA_ "GenSigInactiveValue" SG_ 411 ADC_FroNestTarRangeRate 0;
BA_ "GenSigInvalidValue" SG_ 411 ADC_FroNestTarRangeRate 0;
BA_ "GenSigSendType" SG_ 411 ADC_FroNestTarRangeRate 1;
BA_ "GenSigStartValue" SG_ 411 ADC_FroNestTarRangeRate 0;
BA_ "GenSigTimeoutValue" SG_ 411 ADC_FroNestTarRangeRate 0;
BA_ "Remark" SG_ 411 ADC_FroNestTarRangeRate "";
BA_ "EventCommandSignal" SG_ 411 ADC_FroNestTarLatSpd 0;
BA_ "GatewayedSignals" SG_ 411 ADC_FroNestTarLatSpd 0;
BA_ "GenSigInactiveValue" SG_ 411 ADC_FroNestTarLatSpd 0;
BA_ "GenSigInvalidValue" SG_ 411 ADC_FroNestTarLatSpd 0;
BA_ "GenSigSendType" SG_ 411 ADC_FroNestTarLatSpd 1;
BA_ "GenSigStartValue" SG_ 411 ADC_FroNestTarLatSpd 0;
BA_ "GenSigTimeoutValue" SG_ 411 ADC_FroNestTarLatSpd 0;
BA_ "Remark" SG_ 411 ADC_FroNestTarLatSpd "";
BA_ "EventCommandSignal" SG_ 411 ADC_FroNestTarRangeAccel 0;
BA_ "GatewayedSignals" SG_ 411 ADC_FroNestTarRangeAccel 0;
BA_ "GenSigInactiveValue" SG_ 411 ADC_FroNestTarRangeAccel 0;
BA_ "GenSigInvalidValue" SG_ 411 ADC_FroNestTarRangeAccel 0;
BA_ "GenSigSendType" SG_ 411 ADC_FroNestTarRangeAccel 1;
BA_ "GenSigStartValue" SG_ 411 ADC_FroNestTarRangeAccel 0;
BA_ "GenSigTimeoutValue" SG_ 411 ADC_FroNestTarRangeAccel 0;
BA_ "Remark" SG_ 411 ADC_FroNestTarRangeAccel "";
BA_ "EventCommandSignal" SG_ 411 ADC_FroNestTarObjType 0;
BA_ "GatewayedSignals" SG_ 411 ADC_FroNestTarObjType 0;
BA_ "GenSigInactiveValue" SG_ 411 ADC_FroNestTarObjType 0;
BA_ "GenSigInvalidValue" SG_ 411 ADC_FroNestTarObjType 0;
BA_ "GenSigSendType" SG_ 411 ADC_FroNestTarObjType 1;
BA_ "GenSigStartValue" SG_ 411 ADC_FroNestTarObjType 0;
BA_ "GenSigTimeoutValue" SG_ 411 ADC_FroNestTarObjType 0;
BA_ "Remark" SG_ 411 ADC_FroNestTarObjType "";
BA_ "EventCommandSignal" SG_ 411 ADC_FroNestTarDetSensor 0;
BA_ "GatewayedSignals" SG_ 411 ADC_FroNestTarDetSensor 0;
BA_ "GenSigInactiveValue" SG_ 411 ADC_FroNestTarDetSensor 0;
BA_ "GenSigInvalidValue" SG_ 411 ADC_FroNestTarDetSensor 0;
BA_ "GenSigSendType" SG_ 411 ADC_FroNestTarDetSensor 1;
BA_ "GenSigStartValue" SG_ 411 ADC_FroNestTarDetSensor 0;
BA_ "GenSigTimeoutValue" SG_ 411 ADC_FroNestTarDetSensor 0;
BA_ "Remark" SG_ 411 ADC_FroNestTarDetSensor "";
BA_ "EventCommandSignal" SG_ 411 ADC_LDS_LaneAssistType 0;
BA_ "GatewayedSignals" SG_ 411 ADC_LDS_LaneAssistType 0;
BA_ "GenSigInactiveValue" SG_ 411 ADC_LDS_LaneAssistType 0;
BA_ "GenSigInvalidValue" SG_ 411 ADC_LDS_LaneAssistType 0;
BA_ "GenSigSendType" SG_ 411 ADC_LDS_LaneAssistType 1;
BA_ "GenSigStartValue" SG_ 411 ADC_LDS_LaneAssistType 0;
BA_ "GenSigTimeoutValue" SG_ 411 ADC_LDS_LaneAssistType 0;
BA_ "Remark" SG_ 411 ADC_LDS_LaneAssistType "";
BA_ "EventCommandSignal" SG_ 411 ADC_IHBC_EnableSt 0;
BA_ "GatewayedSignals" SG_ 411 ADC_IHBC_EnableSt 0;
BA_ "GenSigInactiveValue" SG_ 411 ADC_IHBC_EnableSt 0;
BA_ "GenSigInvalidValue" SG_ 411 ADC_IHBC_EnableSt 0;
BA_ "GenSigSendType" SG_ 411 ADC_IHBC_EnableSt 1;
BA_ "GenSigStartValue" SG_ 411 ADC_IHBC_EnableSt 0;
BA_ "GenSigTimeoutValue" SG_ 411 ADC_IHBC_EnableSt 0;
BA_ "Remark" SG_ 411 ADC_IHBC_EnableSt "";
BA_ "EventCommandSignal" SG_ 411 ADC_TSR_EnableSt 0;
BA_ "GatewayedSignals" SG_ 411 ADC_TSR_EnableSt 0;
BA_ "GenSigInactiveValue" SG_ 411 ADC_TSR_EnableSt 0;
BA_ "GenSigInvalidValue" SG_ 411 ADC_TSR_EnableSt 0;
BA_ "GenSigSendType" SG_ 411 ADC_TSR_EnableSt 1;
BA_ "GenSigStartValue" SG_ 411 ADC_TSR_EnableSt 0;
BA_ "GenSigTimeoutValue" SG_ 411 ADC_TSR_EnableSt 0;
BA_ "Remark" SG_ 411 ADC_TSR_EnableSt "";
BA_ "EventCommandSignal" SG_ 411 ADC_TSR_AudioWarn_EnableSt 0;
BA_ "GatewayedSignals" SG_ 411 ADC_TSR_AudioWarn_EnableSt 0;
BA_ "GenSigInactiveValue" SG_ 411 ADC_TSR_AudioWarn_EnableSt 0;
BA_ "GenSigInvalidValue" SG_ 411 ADC_TSR_AudioWarn_EnableSt 0;
BA_ "GenSigSendType" SG_ 411 ADC_TSR_AudioWarn_EnableSt 1;
BA_ "GenSigStartValue" SG_ 411 ADC_TSR_AudioWarn_EnableSt 0;
BA_ "GenSigTimeoutValue" SG_ 411 ADC_TSR_AudioWarn_EnableSt 0;
BA_ "Remark" SG_ 411 ADC_TSR_AudioWarn_EnableSt "";
BA_ "EventCommandSignal" SG_ 411 ADC_ELK_EnableSt 0;
BA_ "GatewayedSignals" SG_ 411 ADC_ELK_EnableSt 0;
BA_ "GenSigInactiveValue" SG_ 411 ADC_ELK_EnableSt 0;
BA_ "GenSigInvalidValue" SG_ 411 ADC_ELK_EnableSt 0;
BA_ "GenSigSendType" SG_ 411 ADC_ELK_EnableSt 1;
BA_ "GenSigStartValue" SG_ 411 ADC_ELK_EnableSt 0;
BA_ "GenSigTimeoutValue" SG_ 411 ADC_ELK_EnableSt 0;
BA_ "Remark" SG_ 411 ADC_ELK_EnableSt "";
BA_ "EventCommandSignal" SG_ 411 ADC_ESA_EnableSt 0;
BA_ "GatewayedSignals" SG_ 411 ADC_ESA_EnableSt 0;
BA_ "GenSigInactiveValue" SG_ 411 ADC_ESA_EnableSt 0;
BA_ "GenSigInvalidValue" SG_ 411 ADC_ESA_EnableSt 0;
BA_ "GenSigSendType" SG_ 411 ADC_ESA_EnableSt 1;
BA_ "GenSigStartValue" SG_ 411 ADC_ESA_EnableSt 0;
BA_ "GenSigTimeoutValue" SG_ 411 ADC_ESA_EnableSt 0;
BA_ "Remark" SG_ 411 ADC_ESA_EnableSt "";
BA_ "EventCommandSignal" SG_ 411 ADC_AES_EnableSt 0;
BA_ "GatewayedSignals" SG_ 411 ADC_AES_EnableSt 0;
BA_ "GenSigInactiveValue" SG_ 411 ADC_AES_EnableSt 0;
BA_ "GenSigInvalidValue" SG_ 411 ADC_AES_EnableSt 0;
BA_ "GenSigSendType" SG_ 411 ADC_AES_EnableSt 1;
BA_ "GenSigStartValue" SG_ 411 ADC_AES_EnableSt 0;
BA_ "GenSigTimeoutValue" SG_ 411 ADC_AES_EnableSt 0;
BA_ "Remark" SG_ 411 ADC_AES_EnableSt "";
BA_ "EventCommandSignal" SG_ 411 ADC_LDWSt 0;
BA_ "GatewayedSignals" SG_ 411 ADC_LDWSt 0;
BA_ "GenSigInactiveValue" SG_ 411 ADC_LDWSt 0;
BA_ "GenSigInvalidValue" SG_ 411 ADC_LDWSt 0;
BA_ "GenSigSendType" SG_ 411 ADC_LDWSt 1;
BA_ "GenSigStartValue" SG_ 411 ADC_LDWSt 0;
BA_ "GenSigTimeoutValue" SG_ 411 ADC_LDWSt 0;
BA_ "Remark" SG_ 411 ADC_LDWSt "";
BA_ "EventCommandSignal" SG_ 411 ADC_LDW_Actdirection 0;
BA_ "GatewayedSignals" SG_ 411 ADC_LDW_Actdirection 0;
BA_ "GenSigInactiveValue" SG_ 411 ADC_LDW_Actdirection 0;
BA_ "GenSigInvalidValue" SG_ 411 ADC_LDW_Actdirection 0;
BA_ "GenSigSendType" SG_ 411 ADC_LDW_Actdirection 1;
BA_ "GenSigStartValue" SG_ 411 ADC_LDW_Actdirection 0;
BA_ "GenSigTimeoutValue" SG_ 411 ADC_LDW_Actdirection 0;
BA_ "Remark" SG_ 411 ADC_LDW_Actdirection "";
BA_ "EventCommandSignal" SG_ 411 ADC_LDP_Actdirection 0;
BA_ "GatewayedSignals" SG_ 411 ADC_LDP_Actdirection 0;
BA_ "GenSigInactiveValue" SG_ 411 ADC_LDP_Actdirection 0;
BA_ "GenSigInvalidValue" SG_ 411 ADC_LDP_Actdirection 0;
BA_ "GenSigSendType" SG_ 411 ADC_LDP_Actdirection 1;
BA_ "GenSigStartValue" SG_ 411 ADC_LDP_Actdirection 0;
BA_ "GenSigTimeoutValue" SG_ 411 ADC_LDP_Actdirection 0;
BA_ "Remark" SG_ 411 ADC_LDP_Actdirection "";
BA_ "EventCommandSignal" SG_ 411 ADC_LDW_PassiveReason 0;
BA_ "GatewayedSignals" SG_ 411 ADC_LDW_PassiveReason 0;
BA_ "GenSigInactiveValue" SG_ 411 ADC_LDW_PassiveReason 0;
BA_ "GenSigInvalidValue" SG_ 411 ADC_LDW_PassiveReason 0;
BA_ "GenSigSendType" SG_ 411 ADC_LDW_PassiveReason 1;
BA_ "GenSigStartValue" SG_ 411 ADC_LDW_PassiveReason 0;
BA_ "GenSigTimeoutValue" SG_ 411 ADC_LDW_PassiveReason 0;
BA_ "Remark" SG_ 411 ADC_LDW_PassiveReason "Remove in next phases";
BA_ "EventCommandSignal" SG_ 411 ADC_LDPSt 0;
BA_ "GatewayedSignals" SG_ 411 ADC_LDPSt 0;
BA_ "GenSigInactiveValue" SG_ 411 ADC_LDPSt 0;
BA_ "GenSigInvalidValue" SG_ 411 ADC_LDPSt 0;
BA_ "GenSigSendType" SG_ 411 ADC_LDPSt 1;
BA_ "GenSigStartValue" SG_ 411 ADC_LDPSt 0;
BA_ "GenSigTimeoutValue" SG_ 411 ADC_LDPSt 0;
BA_ "Remark" SG_ 411 ADC_LDPSt "";
BA_ "EventCommandSignal" SG_ 411 ADC_LDP_PassiveReason 0;
BA_ "GatewayedSignals" SG_ 411 ADC_LDP_PassiveReason 0;
BA_ "GenSigInactiveValue" SG_ 411 ADC_LDP_PassiveReason 0;
BA_ "GenSigInvalidValue" SG_ 411 ADC_LDP_PassiveReason 0;
BA_ "GenSigSendType" SG_ 411 ADC_LDP_PassiveReason 1;
BA_ "GenSigStartValue" SG_ 411 ADC_LDP_PassiveReason 0;
BA_ "GenSigTimeoutValue" SG_ 411 ADC_LDP_PassiveReason 0;
BA_ "Remark" SG_ 411 ADC_LDP_PassiveReason "";
BA_ "EventCommandSignal" SG_ 411 ADC_RDP_St 0;
BA_ "GatewayedSignals" SG_ 411 ADC_RDP_St 0;
BA_ "GenSigInactiveValue" SG_ 411 ADC_RDP_St 0;
BA_ "GenSigInvalidValue" SG_ 411 ADC_RDP_St 0;
BA_ "GenSigSendType" SG_ 411 ADC_RDP_St 1;
BA_ "GenSigStartValue" SG_ 411 ADC_RDP_St 0;
BA_ "GenSigTimeoutValue" SG_ 411 ADC_RDP_St 0;
BA_ "Remark" SG_ 411 ADC_RDP_St "Remove in next phases";
BA_ "EventCommandSignal" SG_ 411 ADC_RDP_PassiveReason 0;
BA_ "GatewayedSignals" SG_ 411 ADC_RDP_PassiveReason 0;
BA_ "GenSigInactiveValue" SG_ 411 ADC_RDP_PassiveReason 0;
BA_ "GenSigInvalidValue" SG_ 411 ADC_RDP_PassiveReason 0;
BA_ "GenSigSendType" SG_ 411 ADC_RDP_PassiveReason 1;
BA_ "GenSigStartValue" SG_ 411 ADC_RDP_PassiveReason 0;
BA_ "GenSigTimeoutValue" SG_ 411 ADC_RDP_PassiveReason 0;
BA_ "Remark" SG_ 411 ADC_RDP_PassiveReason "";
BA_ "EventCommandSignal" SG_ 411 ADC_IHBC_St 0;
BA_ "GatewayedSignals" SG_ 411 ADC_IHBC_St 0;
BA_ "GenSigInactiveValue" SG_ 411 ADC_IHBC_St 0;
BA_ "GenSigInvalidValue" SG_ 411 ADC_IHBC_St 0;
BA_ "GenSigSendType" SG_ 411 ADC_IHBC_St 1;
BA_ "GenSigStartValue" SG_ 411 ADC_IHBC_St 0;
BA_ "GenSigTimeoutValue" SG_ 411 ADC_IHBC_St 0;
BA_ "Remark" SG_ 411 ADC_IHBC_St "";
BA_ "EventCommandSignal" SG_ 411 ADC_RDP_Actdirection 0;
BA_ "GatewayedSignals" SG_ 411 ADC_RDP_Actdirection 0;
BA_ "GenSigInactiveValue" SG_ 411 ADC_RDP_Actdirection 0;
BA_ "GenSigInvalidValue" SG_ 411 ADC_RDP_Actdirection 0;
BA_ "GenSigSendType" SG_ 411 ADC_RDP_Actdirection 1;
BA_ "GenSigStartValue" SG_ 411 ADC_RDP_Actdirection 0;
BA_ "GenSigTimeoutValue" SG_ 411 ADC_RDP_Actdirection 0;
BA_ "Remark" SG_ 411 ADC_RDP_Actdirection "";
BA_ "EventCommandSignal" SG_ 411 ADC_FCMS_SwitchLockReq 0;
BA_ "GatewayedSignals" SG_ 411 ADC_FCMS_SwitchLockReq 0;
BA_ "GenSigInactiveValue" SG_ 411 ADC_FCMS_SwitchLockReq 0;
BA_ "GenSigInvalidValue" SG_ 411 ADC_FCMS_SwitchLockReq 0;
BA_ "GenSigSendType" SG_ 411 ADC_FCMS_SwitchLockReq 1;
BA_ "GenSigStartValue" SG_ 411 ADC_FCMS_SwitchLockReq 0;
BA_ "GenSigTimeoutValue" SG_ 411 ADC_FCMS_SwitchLockReq 0;
BA_ "Remark" SG_ 411 ADC_FCMS_SwitchLockReq "";
BA_ "EventCommandSignal" SG_ 411 ADC_LKSLaneAssistSensitivity 0;
BA_ "GatewayedSignals" SG_ 411 ADC_LKSLaneAssistSensitivity 0;
BA_ "GenSigInactiveValue" SG_ 411 ADC_LKSLaneAssistSensitivity 0;
BA_ "GenSigInvalidValue" SG_ 411 ADC_LKSLaneAssistSensitivity 0;
BA_ "GenSigSendType" SG_ 411 ADC_LKSLaneAssistSensitivity 1;
BA_ "GenSigStartValue" SG_ 411 ADC_LKSLaneAssistSensitivity 0;
BA_ "GenSigTimeoutValue" SG_ 411 ADC_LKSLaneAssistSensitivity 4;
BA_ "Remark" SG_ 411 ADC_LKSLaneAssistSensitivity "";
BA_ "EventCommandSignal" SG_ 411 ADC_ELKSt 0;
BA_ "GatewayedSignals" SG_ 411 ADC_ELKSt 0;
BA_ "GenSigInactiveValue" SG_ 411 ADC_ELKSt 0;
BA_ "GenSigInvalidValue" SG_ 411 ADC_ELKSt 0;
BA_ "GenSigSendType" SG_ 411 ADC_ELKSt 1;
BA_ "GenSigStartValue" SG_ 411 ADC_ELKSt 0;
BA_ "GenSigTimeoutValue" SG_ 411 ADC_ELKSt 0;
BA_ "Remark" SG_ 411 ADC_ELKSt "";
BA_ "EventCommandSignal" SG_ 411 ADC_IHBC_SuppressSt 0;
BA_ "GatewayedSignals" SG_ 411 ADC_IHBC_SuppressSt 0;
BA_ "GenSigInactiveValue" SG_ 411 ADC_IHBC_SuppressSt 0;
BA_ "GenSigInvalidValue" SG_ 411 ADC_IHBC_SuppressSt 0;
BA_ "GenSigSendType" SG_ 411 ADC_IHBC_SuppressSt 1;
BA_ "GenSigStartValue" SG_ 411 ADC_IHBC_SuppressSt 0;
BA_ "GenSigTimeoutValue" SG_ 411 ADC_IHBC_SuppressSt 0;
BA_ "Remark" SG_ 411 ADC_IHBC_SuppressSt "";
BA_ "EventCommandSignal" SG_ 411 ADC_IHBC_SuppressReason 0;
BA_ "GatewayedSignals" SG_ 411 ADC_IHBC_SuppressReason 0;
BA_ "GenSigInactiveValue" SG_ 411 ADC_IHBC_SuppressReason 0;
BA_ "GenSigInvalidValue" SG_ 411 ADC_IHBC_SuppressReason 0;
BA_ "GenSigSendType" SG_ 411 ADC_IHBC_SuppressReason 1;
BA_ "GenSigStartValue" SG_ 411 ADC_IHBC_SuppressReason 0;
BA_ "GenSigTimeoutValue" SG_ 411 ADC_IHBC_SuppressReason 0;
BA_ "Remark" SG_ 411 ADC_IHBC_SuppressReason "";
BA_ "EventCommandSignal" SG_ 411 ADC_IHBC_Dis2Oncoming 0;
BA_ "GatewayedSignals" SG_ 411 ADC_IHBC_Dis2Oncoming 0;
BA_ "GenSigInactiveValue" SG_ 411 ADC_IHBC_Dis2Oncoming 0;
BA_ "GenSigInvalidValue" SG_ 411 ADC_IHBC_Dis2Oncoming 0;
BA_ "GenSigSendType" SG_ 411 ADC_IHBC_Dis2Oncoming 1;
BA_ "GenSigStartValue" SG_ 411 ADC_IHBC_Dis2Oncoming 0;
BA_ "GenSigTimeoutValue" SG_ 411 ADC_IHBC_Dis2Oncoming 0;
BA_ "Remark" SG_ 411 ADC_IHBC_Dis2Oncoming "";
BA_ "EventCommandSignal" SG_ 411 ADC_IHBC_Dis2Preceding 0;
BA_ "GatewayedSignals" SG_ 411 ADC_IHBC_Dis2Preceding 0;
BA_ "GenSigInactiveValue" SG_ 411 ADC_IHBC_Dis2Preceding 0;
BA_ "GenSigInvalidValue" SG_ 411 ADC_IHBC_Dis2Preceding 0;
BA_ "GenSigSendType" SG_ 411 ADC_IHBC_Dis2Preceding 1;
BA_ "GenSigStartValue" SG_ 411 ADC_IHBC_Dis2Preceding 0;
BA_ "GenSigTimeoutValue" SG_ 411 ADC_IHBC_Dis2Preceding 0;
BA_ "Remark" SG_ 411 ADC_IHBC_Dis2Preceding "";
BA_ "EventCommandSignal" SG_ 411 ADC_IHBC_RoadlightNum 0;
BA_ "GatewayedSignals" SG_ 411 ADC_IHBC_RoadlightNum 0;
BA_ "GenSigInactiveValue" SG_ 411 ADC_IHBC_RoadlightNum 0;
BA_ "GenSigInvalidValue" SG_ 411 ADC_IHBC_RoadlightNum 0;
BA_ "GenSigSendType" SG_ 411 ADC_IHBC_RoadlightNum 1;
BA_ "GenSigStartValue" SG_ 411 ADC_IHBC_RoadlightNum 0;
BA_ "GenSigTimeoutValue" SG_ 411 ADC_IHBC_RoadlightNum 0;
BA_ "Remark" SG_ 411 ADC_IHBC_RoadlightNum "";
BA_ "EventCommandSignal" SG_ 411 ADC_IHBC_Dis2NearestRoadlight 0;
BA_ "GatewayedSignals" SG_ 411 ADC_IHBC_Dis2NearestRoadlight 0;
BA_ "GenSigInactiveValue" SG_ 411 ADC_IHBC_Dis2NearestRoadlight 0;
BA_ "GenSigInvalidValue" SG_ 411 ADC_IHBC_Dis2NearestRoadlight 0;
BA_ "GenSigSendType" SG_ 411 ADC_IHBC_Dis2NearestRoadlight 1;
BA_ "GenSigStartValue" SG_ 411 ADC_IHBC_Dis2NearestRoadlight 0;
BA_ "GenSigTimeoutValue" SG_ 411 ADC_IHBC_Dis2NearestRoadlight 0;
BA_ "Remark" SG_ 411 ADC_IHBC_Dis2NearestRoadlight "";
BA_ "EventCommandSignal" SG_ 411 ADC_IHBC_TargetType 0;
BA_ "GatewayedSignals" SG_ 411 ADC_IHBC_TargetType 0;
BA_ "GenSigInactiveValue" SG_ 411 ADC_IHBC_TargetType 0;
BA_ "GenSigInvalidValue" SG_ 411 ADC_IHBC_TargetType 0;
BA_ "GenSigSendType" SG_ 411 ADC_IHBC_TargetType 1;
BA_ "GenSigStartValue" SG_ 411 ADC_IHBC_TargetType 0;
BA_ "GenSigTimeoutValue" SG_ 411 ADC_IHBC_TargetType 0;
BA_ "Remark" SG_ 411 ADC_IHBC_TargetType "";
BA_ "EventCommandSignal" SG_ 411 ADC_TSR_SpdLimit 0;
BA_ "GatewayedSignals" SG_ 411 ADC_TSR_SpdLimit 0;
BA_ "GenSigInactiveValue" SG_ 411 ADC_TSR_SpdLimit 0;
BA_ "GenSigInvalidValue" SG_ 411 ADC_TSR_SpdLimit 0;
BA_ "GenSigSendType" SG_ 411 ADC_TSR_SpdLimit 1;
BA_ "GenSigStartValue" SG_ 411 ADC_TSR_SpdLimit 0;
BA_ "GenSigTimeoutValue" SG_ 411 ADC_TSR_SpdLimit 0;
BA_ "Remark" SG_ 411 ADC_TSR_SpdLimit "";
BA_ "EventCommandSignal" SG_ 411 ADC_TSR_SpdLimType 0;
BA_ "GatewayedSignals" SG_ 411 ADC_TSR_SpdLimType 0;
BA_ "GenSigInactiveValue" SG_ 411 ADC_TSR_SpdLimType 0;
BA_ "GenSigInvalidValue" SG_ 411 ADC_TSR_SpdLimType 0;
BA_ "GenSigSendType" SG_ 411 ADC_TSR_SpdLimType 1;
BA_ "GenSigStartValue" SG_ 411 ADC_TSR_SpdLimType 0;
BA_ "GenSigTimeoutValue" SG_ 411 ADC_TSR_SpdLimType 0;
BA_ "Remark" SG_ 411 ADC_TSR_SpdLimType "";
BA_ "EventCommandSignal" SG_ 411 ADC_TSRMode 0;
BA_ "GatewayedSignals" SG_ 411 ADC_TSRMode 0;
BA_ "GenSigInactiveValue" SG_ 411 ADC_TSRMode 0;
BA_ "GenSigInvalidValue" SG_ 411 ADC_TSRMode 0;
BA_ "GenSigSendType" SG_ 411 ADC_TSRMode 1;
BA_ "GenSigStartValue" SG_ 411 ADC_TSRMode 0;
BA_ "GenSigTimeoutValue" SG_ 411 ADC_TSRMode 0;
BA_ "Remark" SG_ 411 ADC_TSRMode "Remove in next phases";
BA_ "EventCommandSignal" SG_ 411 ADC_TSR_St 0;
BA_ "GatewayedSignals" SG_ 411 ADC_TSR_St 0;
BA_ "GenSigInactiveValue" SG_ 411 ADC_TSR_St 0;
BA_ "GenSigInvalidValue" SG_ 411 ADC_TSR_St 0;
BA_ "GenSigSendType" SG_ 411 ADC_TSR_St 1;
BA_ "GenSigStartValue" SG_ 411 ADC_TSR_St 0;
BA_ "GenSigTimeoutValue" SG_ 411 ADC_TSR_St 0;
BA_ "Remark" SG_ 411 ADC_TSR_St "";
BA_ "EventCommandSignal" SG_ 411 ADC_TSR_FailureReason 0;
BA_ "GatewayedSignals" SG_ 411 ADC_TSR_FailureReason 0;
BA_ "GenSigInactiveValue" SG_ 411 ADC_TSR_FailureReason 0;
BA_ "GenSigInvalidValue" SG_ 411 ADC_TSR_FailureReason 0;
BA_ "GenSigSendType" SG_ 411 ADC_TSR_FailureReason 1;
BA_ "GenSigStartValue" SG_ 411 ADC_TSR_FailureReason 0;
BA_ "GenSigTimeoutValue" SG_ 411 ADC_TSR_FailureReason 0;
BA_ "Remark" SG_ 411 ADC_TSR_FailureReason "";
BA_ "EventCommandSignal" SG_ 411 ADC_TSR_TrafficSignType 0;
BA_ "GatewayedSignals" SG_ 411 ADC_TSR_TrafficSignType 0;
BA_ "GenSigInactiveValue" SG_ 411 ADC_TSR_TrafficSignType 0;
BA_ "GenSigInvalidValue" SG_ 411 ADC_TSR_TrafficSignType 0;
BA_ "GenSigSendType" SG_ 411 ADC_TSR_TrafficSignType 1;
BA_ "GenSigStartValue" SG_ 411 ADC_TSR_TrafficSignType 0;
BA_ "GenSigTimeoutValue" SG_ 411 ADC_TSR_TrafficSignType 0;
BA_ "Remark" SG_ 411 ADC_TSR_TrafficSignType "";
BA_ "EventCommandSignal" SG_ 411 ADC_TSRDisToIntervalEnd 0;
BA_ "GatewayedSignals" SG_ 411 ADC_TSRDisToIntervalEnd 0;
BA_ "GenSigInactiveValue" SG_ 411 ADC_TSRDisToIntervalEnd 0;
BA_ "GenSigInvalidValue" SG_ 411 ADC_TSRDisToIntervalEnd 0;
BA_ "GenSigSendType" SG_ 411 ADC_TSRDisToIntervalEnd 1;
BA_ "GenSigStartValue" SG_ 411 ADC_TSRDisToIntervalEnd 0;
BA_ "GenSigTimeoutValue" SG_ 411 ADC_TSRDisToIntervalEnd 0;
BA_ "Remark" SG_ 411 ADC_TSRDisToIntervalEnd "";
BA_ "EventCommandSignal" SG_ 411 ADC_TSRDisToCamera 0;
BA_ "GatewayedSignals" SG_ 411 ADC_TSRDisToCamera 0;
BA_ "GenSigInactiveValue" SG_ 411 ADC_TSRDisToCamera 0;
BA_ "GenSigInvalidValue" SG_ 411 ADC_TSRDisToCamera 0;
BA_ "GenSigSendType" SG_ 411 ADC_TSRDisToCamera 1;
BA_ "GenSigStartValue" SG_ 411 ADC_TSRDisToCamera 0;
BA_ "GenSigTimeoutValue" SG_ 411 ADC_TSRDisToCamera 0;
BA_ "Remark" SG_ 411 ADC_TSRDisToCamera "";
BA_ "EventCommandSignal" SG_ 411 ADC_TSR_SpeedLimitSource 0;
BA_ "GatewayedSignals" SG_ 411 ADC_TSR_SpeedLimitSource 0;
BA_ "GenSigInactiveValue" SG_ 411 ADC_TSR_SpeedLimitSource 0;
BA_ "GenSigInvalidValue" SG_ 411 ADC_TSR_SpeedLimitSource 0;
BA_ "GenSigSendType" SG_ 411 ADC_TSR_SpeedLimitSource 1;
BA_ "GenSigStartValue" SG_ 411 ADC_TSR_SpeedLimitSource 0;
BA_ "GenSigTimeoutValue" SG_ 411 ADC_TSR_SpeedLimitSource 0;
BA_ "Remark" SG_ 411 ADC_TSR_SpeedLimitSource "Remove in next phases";
BA_ "EventCommandSignal" SG_ 411 ADC_TSR_WarnEnabledType 0;
BA_ "GatewayedSignals" SG_ 411 ADC_TSR_WarnEnabledType 0;
BA_ "GenSigInactiveValue" SG_ 411 ADC_TSR_WarnEnabledType 0;
BA_ "GenSigInvalidValue" SG_ 411 ADC_TSR_WarnEnabledType 0;
BA_ "GenSigSendType" SG_ 411 ADC_TSR_WarnEnabledType 1;
BA_ "GenSigStartValue" SG_ 411 ADC_TSR_WarnEnabledType 0;
BA_ "GenSigTimeoutValue" SG_ 411 ADC_TSR_WarnEnabledType 0;
BA_ "Remark" SG_ 411 ADC_TSR_WarnEnabledType "";
BA_ "EventCommandSignal" SG_ 411 ADC_TSR_TactileWarn 0;
BA_ "GatewayedSignals" SG_ 411 ADC_TSR_TactileWarn 0;
BA_ "GenSigInactiveValue" SG_ 411 ADC_TSR_TactileWarn 0;
BA_ "GenSigInvalidValue" SG_ 411 ADC_TSR_TactileWarn 0;
BA_ "GenSigSendType" SG_ 411 ADC_TSR_TactileWarn 1;
BA_ "GenSigStartValue" SG_ 411 ADC_TSR_TactileWarn 0;
BA_ "GenSigTimeoutValue" SG_ 411 ADC_TSR_TactileWarn 0;
BA_ "Remark" SG_ 411 ADC_TSR_TactileWarn "Remove in next phases";
BA_ "EventCommandSignal" SG_ 411 ADC_TSR_VisualWarn 0;
BA_ "GatewayedSignals" SG_ 411 ADC_TSR_VisualWarn 0;
BA_ "GenSigInactiveValue" SG_ 411 ADC_TSR_VisualWarn 0;
BA_ "GenSigInvalidValue" SG_ 411 ADC_TSR_VisualWarn 0;
BA_ "GenSigSendType" SG_ 411 ADC_TSR_VisualWarn 1;
BA_ "GenSigStartValue" SG_ 411 ADC_TSR_VisualWarn 0;
BA_ "GenSigTimeoutValue" SG_ 411 ADC_TSR_VisualWarn 0;
BA_ "Remark" SG_ 411 ADC_TSR_VisualWarn "Remove in next phases";
BA_ "EventCommandSignal" SG_ 411 ADC_TSR_SuppressReason 0;
BA_ "GatewayedSignals" SG_ 411 ADC_TSR_SuppressReason 0;
BA_ "GenSigInactiveValue" SG_ 411 ADC_TSR_SuppressReason 0;
BA_ "GenSigInvalidValue" SG_ 411 ADC_TSR_SuppressReason 0;
BA_ "GenSigSendType" SG_ 411 ADC_TSR_SuppressReason 1;
BA_ "GenSigStartValue" SG_ 411 ADC_TSR_SuppressReason 0;
BA_ "GenSigTimeoutValue" SG_ 411 ADC_TSR_SuppressReason 0;
BA_ "Remark" SG_ 411 ADC_TSR_SuppressReason "";
BA_ "EventCommandSignal" SG_ 411 ADC_TSR_SpdLimitUnit 0;
BA_ "GatewayedSignals" SG_ 411 ADC_TSR_SpdLimitUnit 0;
BA_ "GenSigInactiveValue" SG_ 411 ADC_TSR_SpdLimitUnit 0;
BA_ "GenSigInvalidValue" SG_ 411 ADC_TSR_SpdLimitUnit 0;
BA_ "GenSigSendType" SG_ 411 ADC_TSR_SpdLimitUnit 1;
BA_ "GenSigStartValue" SG_ 411 ADC_TSR_SpdLimitUnit 0;
BA_ "GenSigTimeoutValue" SG_ 411 ADC_TSR_SpdLimitUnit 0;
BA_ "Remark" SG_ 411 ADC_TSR_SpdLimitUnit "";
BA_ "EventCommandSignal" SG_ 411 ADC_TSR_AcousticWarn 0;
BA_ "GatewayedSignals" SG_ 411 ADC_TSR_AcousticWarn 0;
BA_ "GenSigInactiveValue" SG_ 411 ADC_TSR_AcousticWarn 0;
BA_ "GenSigInvalidValue" SG_ 411 ADC_TSR_AcousticWarn 0;
BA_ "GenSigSendType" SG_ 411 ADC_TSR_AcousticWarn 1;
BA_ "GenSigStartValue" SG_ 411 ADC_TSR_AcousticWarn 0;
BA_ "GenSigTimeoutValue" SG_ 411 ADC_TSR_AcousticWarn 0;
BA_ "Remark" SG_ 411 ADC_TSR_AcousticWarn "";
BA_ "EventCommandSignal" SG_ 411 ADC_ELKoncomingSt 0;
BA_ "GatewayedSignals" SG_ 411 ADC_ELKoncomingSt 0;
BA_ "GenSigInactiveValue" SG_ 411 ADC_ELKoncomingSt 0;
BA_ "GenSigInvalidValue" SG_ 411 ADC_ELKoncomingSt 0;
BA_ "GenSigSendType" SG_ 411 ADC_ELKoncomingSt 1;
BA_ "GenSigStartValue" SG_ 411 ADC_ELKoncomingSt 0;
BA_ "GenSigTimeoutValue" SG_ 411 ADC_ELKoncomingSt 0;
BA_ "Remark" SG_ 411 ADC_ELKoncomingSt "";
BA_ "EventCommandSignal" SG_ 411 ADC_ELKoncoming_PassiveReason 0;
BA_ "GatewayedSignals" SG_ 411 ADC_ELKoncoming_PassiveReason 0;
BA_ "GenSigInactiveValue" SG_ 411 ADC_ELKoncoming_PassiveReason 0;
BA_ "GenSigInvalidValue" SG_ 411 ADC_ELKoncoming_PassiveReason 0;
BA_ "GenSigSendType" SG_ 411 ADC_ELKoncoming_PassiveReason 1;
BA_ "GenSigStartValue" SG_ 411 ADC_ELKoncoming_PassiveReason 0;
BA_ "GenSigTimeoutValue" SG_ 411 ADC_ELKoncoming_PassiveReason 0;
BA_ "Remark" SG_ 411 ADC_ELKoncoming_PassiveReason "";
BA_ "EventCommandSignal" SG_ 411 ADC_ELKoncoming_Actdirection 0;
BA_ "GatewayedSignals" SG_ 411 ADC_ELKoncoming_Actdirection 0;
BA_ "GenSigInactiveValue" SG_ 411 ADC_ELKoncoming_Actdirection 0;
BA_ "GenSigInvalidValue" SG_ 411 ADC_ELKoncoming_Actdirection 0;
BA_ "GenSigSendType" SG_ 411 ADC_ELKoncoming_Actdirection 1;
BA_ "GenSigStartValue" SG_ 411 ADC_ELKoncoming_Actdirection 0;
BA_ "GenSigTimeoutValue" SG_ 411 ADC_ELKoncoming_Actdirection 0;
BA_ "Remark" SG_ 411 ADC_ELKoncoming_Actdirection "";
BA_ "EventCommandSignal" SG_ 411 ADC_ELKovertakingSt 0;
BA_ "GatewayedSignals" SG_ 411 ADC_ELKovertakingSt 0;
BA_ "GenSigInactiveValue" SG_ 411 ADC_ELKovertakingSt 0;
BA_ "GenSigInvalidValue" SG_ 411 ADC_ELKovertakingSt 0;
BA_ "GenSigSendType" SG_ 411 ADC_ELKovertakingSt 1;
BA_ "GenSigStartValue" SG_ 411 ADC_ELKovertakingSt 0;
BA_ "GenSigTimeoutValue" SG_ 411 ADC_ELKovertakingSt 0;
BA_ "Remark" SG_ 411 ADC_ELKovertakingSt "";
BA_ "EventCommandSignal" SG_ 411 ADC_ELKovertaking_ActDirection 0;
BA_ "GatewayedSignals" SG_ 411 ADC_ELKovertaking_ActDirection 0;
BA_ "GenSigInactiveValue" SG_ 411 ADC_ELKovertaking_ActDirection 0;
BA_ "GenSigInvalidValue" SG_ 411 ADC_ELKovertaking_ActDirection 0;
BA_ "GenSigSendType" SG_ 411 ADC_ELKovertaking_ActDirection 1;
BA_ "GenSigStartValue" SG_ 411 ADC_ELKovertaking_ActDirection 0;
BA_ "GenSigTimeoutValue" SG_ 411 ADC_ELKovertaking_ActDirection 0;
BA_ "Remark" SG_ 411 ADC_ELKovertaking_ActDirection "Remove in next phases";
BA_ "EventCommandSignal" SG_ 411 ADC_ISAChangeAudEnable 0;
BA_ "GatewayedSignals" SG_ 411 ADC_ISAChangeAudEnable 0;
BA_ "GenSigInactiveValue" SG_ 411 ADC_ISAChangeAudEnable 0;
BA_ "GenSigInvalidValue" SG_ 411 ADC_ISAChangeAudEnable 0;
BA_ "GenSigSendType" SG_ 411 ADC_ISAChangeAudEnable 1;
BA_ "GenSigStartValue" SG_ 411 ADC_ISAChangeAudEnable 0;
BA_ "GenSigTimeoutValue" SG_ 411 ADC_ISAChangeAudEnable 0;
BA_ "Remark" SG_ 411 ADC_ISAChangeAudEnable "";
BA_ "EventCommandSignal" SG_ 411 ADC_ELKovertaking_PassiveReason 0;
BA_ "GatewayedSignals" SG_ 411 ADC_ELKovertaking_PassiveReason 0;
BA_ "GenSigInactiveValue" SG_ 411 ADC_ELKovertaking_PassiveReason 0;
BA_ "GenSigInvalidValue" SG_ 411 ADC_ELKovertaking_PassiveReason 0;
BA_ "GenSigSendType" SG_ 411 ADC_ELKovertaking_PassiveReason 1;
BA_ "GenSigStartValue" SG_ 411 ADC_ELKovertaking_PassiveReason 0;
BA_ "GenSigTimeoutValue" SG_ 411 ADC_ELKovertaking_PassiveReason 0;
BA_ "Remark" SG_ 411 ADC_ELKovertaking_PassiveReason "";
BA_ "EventCommandSignal" SG_ 411 ADC_ELK_TargetObjClass 0;
BA_ "GatewayedSignals" SG_ 411 ADC_ELK_TargetObjClass 0;
BA_ "GenSigInactiveValue" SG_ 411 ADC_ELK_TargetObjClass 0;
BA_ "GenSigInvalidValue" SG_ 411 ADC_ELK_TargetObjClass 0;
BA_ "GenSigSendType" SG_ 411 ADC_ELK_TargetObjClass 1;
BA_ "GenSigStartValue" SG_ 411 ADC_ELK_TargetObjClass 0;
BA_ "GenSigTimeoutValue" SG_ 411 ADC_ELK_TargetObjClass 0;
BA_ "Remark" SG_ 411 ADC_ELK_TargetObjClass "";
BA_ "EventCommandSignal" SG_ 411 ADC_ESA_St 0;
BA_ "GatewayedSignals" SG_ 411 ADC_ESA_St 0;
BA_ "GenSigInactiveValue" SG_ 411 ADC_ESA_St 0;
BA_ "GenSigInvalidValue" SG_ 411 ADC_ESA_St 0;
BA_ "GenSigSendType" SG_ 411 ADC_ESA_St 1;
BA_ "GenSigStartValue" SG_ 411 ADC_ESA_St 0;
BA_ "GenSigTimeoutValue" SG_ 411 ADC_ESA_St 4;
BA_ "Remark" SG_ 411 ADC_ESA_St "Remove in next phases";
BA_ "EventCommandSignal" SG_ 411 ADC_ESA_ActDirection 0;
BA_ "GatewayedSignals" SG_ 411 ADC_ESA_ActDirection 0;
BA_ "GenSigInactiveValue" SG_ 411 ADC_ESA_ActDirection 0;
BA_ "GenSigInvalidValue" SG_ 411 ADC_ESA_ActDirection 0;
BA_ "GenSigSendType" SG_ 411 ADC_ESA_ActDirection 1;
BA_ "GenSigStartValue" SG_ 411 ADC_ESA_ActDirection 0;
BA_ "GenSigTimeoutValue" SG_ 411 ADC_ESA_ActDirection 0;
BA_ "Remark" SG_ 411 ADC_ESA_ActDirection "";
BA_ "EventCommandSignal" SG_ 411 ADC_AES_St 0;
BA_ "GatewayedSignals" SG_ 411 ADC_AES_St 0;
BA_ "GenSigInactiveValue" SG_ 411 ADC_AES_St 0;
BA_ "GenSigInvalidValue" SG_ 411 ADC_AES_St 0;
BA_ "GenSigSendType" SG_ 411 ADC_AES_St 1;
BA_ "GenSigStartValue" SG_ 411 ADC_AES_St 0;
BA_ "GenSigTimeoutValue" SG_ 411 ADC_AES_St 4;
BA_ "Remark" SG_ 411 ADC_AES_St "";
BA_ "EventCommandSignal" SG_ 411 ADC_AES_ActDirection 0;
BA_ "GatewayedSignals" SG_ 411 ADC_AES_ActDirection 0;
BA_ "GenSigInactiveValue" SG_ 411 ADC_AES_ActDirection 0;
BA_ "GenSigInvalidValue" SG_ 411 ADC_AES_ActDirection 0;
BA_ "GenSigSendType" SG_ 411 ADC_AES_ActDirection 1;
BA_ "GenSigStartValue" SG_ 411 ADC_AES_ActDirection 0;
BA_ "GenSigTimeoutValue" SG_ 411 ADC_AES_ActDirection 0;
BA_ "Remark" SG_ 411 ADC_AES_ActDirection "";
BA_ "EventCommandSignal" SG_ 411 ADC_RDP_Number 0;
BA_ "GatewayedSignals" SG_ 411 ADC_RDP_Number 0;
BA_ "GenSigInactiveValue" SG_ 411 ADC_RDP_Number 0;
BA_ "GenSigInvalidValue" SG_ 411 ADC_RDP_Number 0;
BA_ "GenSigSendType" SG_ 411 ADC_RDP_Number 1;
BA_ "GenSigStartValue" SG_ 411 ADC_RDP_Number 0;
BA_ "GenSigTimeoutValue" SG_ 411 ADC_RDP_Number 0;
BA_ "Remark" SG_ 411 ADC_RDP_Number "";
BA_ "EventCommandSignal" SG_ 411 ADC_ELKoncoming_ActiveWarn 0;
BA_ "GatewayedSignals" SG_ 411 ADC_ELKoncoming_ActiveWarn 0;
BA_ "GenSigInactiveValue" SG_ 411 ADC_ELKoncoming_ActiveWarn 0;
BA_ "GenSigInvalidValue" SG_ 411 ADC_ELKoncoming_ActiveWarn 0;
BA_ "GenSigSendType" SG_ 411 ADC_ELKoncoming_ActiveWarn 1;
BA_ "GenSigStartValue" SG_ 411 ADC_ELKoncoming_ActiveWarn 0;
BA_ "GenSigTimeoutValue" SG_ 411 ADC_ELKoncoming_ActiveWarn 0;
BA_ "Remark" SG_ 411 ADC_ELKoncoming_ActiveWarn "";
BA_ "EventCommandSignal" SG_ 411 ADC_ELKovertaking_ActiveWarn 0;
BA_ "GatewayedSignals" SG_ 411 ADC_ELKovertaking_ActiveWarn 0;
BA_ "GenSigInactiveValue" SG_ 411 ADC_ELKovertaking_ActiveWarn 0;
BA_ "GenSigInvalidValue" SG_ 411 ADC_ELKovertaking_ActiveWarn 0;
BA_ "GenSigSendType" SG_ 411 ADC_ELKovertaking_ActiveWarn 1;
BA_ "GenSigStartValue" SG_ 411 ADC_ELKovertaking_ActiveWarn 0;
BA_ "GenSigTimeoutValue" SG_ 411 ADC_ELKovertaking_ActiveWarn 0;
BA_ "Remark" SG_ 411 ADC_ELKovertaking_ActiveWarn "";
BA_ "EventCommandSignal" SG_ 411 ADC_ELKoncoming_Number 0;
BA_ "GatewayedSignals" SG_ 411 ADC_ELKoncoming_Number 0;
BA_ "GenSigInactiveValue" SG_ 411 ADC_ELKoncoming_Number 0;
BA_ "GenSigInvalidValue" SG_ 411 ADC_ELKoncoming_Number 0;
BA_ "GenSigSendType" SG_ 411 ADC_ELKoncoming_Number 1;
BA_ "GenSigStartValue" SG_ 411 ADC_ELKoncoming_Number 0;
BA_ "GenSigTimeoutValue" SG_ 411 ADC_ELKoncoming_Number 0;
BA_ "Remark" SG_ 411 ADC_ELKoncoming_Number "";
BA_ "EventCommandSignal" SG_ 411 ADC_ESA_ActiveWarn 0;
BA_ "GatewayedSignals" SG_ 411 ADC_ESA_ActiveWarn 0;
BA_ "GenSigInactiveValue" SG_ 411 ADC_ESA_ActiveWarn 0;
BA_ "GenSigInvalidValue" SG_ 411 ADC_ESA_ActiveWarn 0;
BA_ "GenSigSendType" SG_ 411 ADC_ESA_ActiveWarn 1;
BA_ "GenSigStartValue" SG_ 411 ADC_ESA_ActiveWarn 0;
BA_ "GenSigTimeoutValue" SG_ 411 ADC_ESA_ActiveWarn 0;
BA_ "Remark" SG_ 411 ADC_ESA_ActiveWarn "";
BA_ "EventCommandSignal" SG_ 411 ADC_AES_ActiveWarn 0;
BA_ "GatewayedSignals" SG_ 411 ADC_AES_ActiveWarn 0;
BA_ "GenSigInactiveValue" SG_ 411 ADC_AES_ActiveWarn 0;
BA_ "GenSigInvalidValue" SG_ 411 ADC_AES_ActiveWarn 0;
BA_ "GenSigSendType" SG_ 411 ADC_AES_ActiveWarn 1;
BA_ "GenSigStartValue" SG_ 411 ADC_AES_ActiveWarn 0;
BA_ "GenSigTimeoutValue" SG_ 411 ADC_AES_ActiveWarn 0;
BA_ "Remark" SG_ 411 ADC_AES_ActiveWarn "";
BA_ "EventCommandSignal" SG_ 411 ADC_ELKovertaking_Numbe 0;
BA_ "GatewayedSignals" SG_ 411 ADC_ELKovertaking_Numbe 0;
BA_ "GenSigInactiveValue" SG_ 411 ADC_ELKovertaking_Numbe 0;
BA_ "GenSigInvalidValue" SG_ 411 ADC_ELKovertaking_Numbe 0;
BA_ "GenSigSendType" SG_ 411 ADC_ELKovertaking_Numbe 1;
BA_ "GenSigStartValue" SG_ 411 ADC_ELKovertaking_Numbe 0;
BA_ "GenSigTimeoutValue" SG_ 411 ADC_ELKovertaking_Numbe 0;
BA_ "Remark" SG_ 411 ADC_ELKovertaking_Numbe "";
BA_ "EventCommandSignal" SG_ 411 ADC_ESA_TargetObjClass 0;
BA_ "GatewayedSignals" SG_ 411 ADC_ESA_TargetObjClass 0;
BA_ "GenSigInactiveValue" SG_ 411 ADC_ESA_TargetObjClass 0;
BA_ "GenSigInvalidValue" SG_ 411 ADC_ESA_TargetObjClass 0;
BA_ "GenSigSendType" SG_ 411 ADC_ESA_TargetObjClass 1;
BA_ "GenSigStartValue" SG_ 411 ADC_ESA_TargetObjClass 0;
BA_ "GenSigTimeoutValue" SG_ 411 ADC_ESA_TargetObjClass 0;
BA_ "Remark" SG_ 411 ADC_ESA_TargetObjClass "";
BA_ "EventCommandSignal" SG_ 411 ADC_ESA_PassiveReason 0;
BA_ "GatewayedSignals" SG_ 411 ADC_ESA_PassiveReason 0;
BA_ "GenSigInactiveValue" SG_ 411 ADC_ESA_PassiveReason 0;
BA_ "GenSigInvalidValue" SG_ 411 ADC_ESA_PassiveReason 0;
BA_ "GenSigSendType" SG_ 411 ADC_ESA_PassiveReason 1;
BA_ "GenSigStartValue" SG_ 411 ADC_ESA_PassiveReason 0;
BA_ "GenSigTimeoutValue" SG_ 411 ADC_ESA_PassiveReason 0;
BA_ "Remark" SG_ 411 ADC_ESA_PassiveReason "";
BA_ "EventCommandSignal" SG_ 411 ADC_AES_TargetObjClass 0;
BA_ "GatewayedSignals" SG_ 411 ADC_AES_TargetObjClass 0;
BA_ "GenSigInactiveValue" SG_ 411 ADC_AES_TargetObjClass 0;
BA_ "GenSigInvalidValue" SG_ 411 ADC_AES_TargetObjClass 0;
BA_ "GenSigSendType" SG_ 411 ADC_AES_TargetObjClass 1;
BA_ "GenSigStartValue" SG_ 411 ADC_AES_TargetObjClass 0;
BA_ "GenSigTimeoutValue" SG_ 411 ADC_AES_TargetObjClass 0;
BA_ "Remark" SG_ 411 ADC_AES_TargetObjClass "";
BA_ "EventCommandSignal" SG_ 411 ADC_AES_PassiveReason 0;
BA_ "GatewayedSignals" SG_ 411 ADC_AES_PassiveReason 0;
BA_ "GenSigInactiveValue" SG_ 411 ADC_AES_PassiveReason 0;
BA_ "GenSigInvalidValue" SG_ 411 ADC_AES_PassiveReason 0;
BA_ "GenSigSendType" SG_ 411 ADC_AES_PassiveReason 1;
BA_ "GenSigStartValue" SG_ 411 ADC_AES_PassiveReason 0;
BA_ "GenSigTimeoutValue" SG_ 411 ADC_AES_PassiveReason 0;
BA_ "Remark" SG_ 411 ADC_AES_PassiveReason "";
BA_ "EventCommandSignal" SG_ 411 ADC_LDW_Number 0;
BA_ "GatewayedSignals" SG_ 411 ADC_LDW_Number 0;
BA_ "GenSigInactiveValue" SG_ 411 ADC_LDW_Number 0;
BA_ "GenSigInvalidValue" SG_ 411 ADC_LDW_Number 0;
BA_ "GenSigSendType" SG_ 411 ADC_LDW_Number 1;
BA_ "GenSigStartValue" SG_ 411 ADC_LDW_Number 0;
BA_ "GenSigTimeoutValue" SG_ 411 ADC_LDW_Number 0;
BA_ "Remark" SG_ 411 ADC_LDW_Number "Remove in next phases";
BA_ "EventCommandSignal" SG_ 411 ADC_LDPNumber 0;
BA_ "GatewayedSignals" SG_ 411 ADC_LDPNumber 0;
BA_ "GenSigInactiveValue" SG_ 411 ADC_LDPNumber 0;
BA_ "GenSigInvalidValue" SG_ 411 ADC_LDPNumber 0;
BA_ "GenSigSendType" SG_ 411 ADC_LDPNumber 1;
BA_ "GenSigStartValue" SG_ 411 ADC_LDPNumber 0;
BA_ "GenSigTimeoutValue" SG_ 411 ADC_LDPNumber 0;
BA_ "Remark" SG_ 411 ADC_LDPNumber "";
BA_ "EventCommandSignal" SG_ 411 ADC_L1_LatfaultReason 0;
BA_ "GatewayedSignals" SG_ 411 ADC_L1_LatfaultReason 0;
BA_ "GenSigInactiveValue" SG_ 411 ADC_L1_LatfaultReason 0;
BA_ "GenSigInvalidValue" SG_ 411 ADC_L1_LatfaultReason 0;
BA_ "GenSigSendType" SG_ 411 ADC_L1_LatfaultReason 1;
BA_ "GenSigStartValue" SG_ 411 ADC_L1_LatfaultReason 0;
BA_ "GenSigTimeoutValue" SG_ 411 ADC_L1_LatfaultReason 0;
BA_ "Remark" SG_ 411 ADC_L1_LatfaultReason "";
BA_ "EventCommandSignal" SG_ 411 ADC_ESA_Number 0;
BA_ "GatewayedSignals" SG_ 411 ADC_ESA_Number 0;
BA_ "GenSigInactiveValue" SG_ 411 ADC_ESA_Number 0;
BA_ "GenSigInvalidValue" SG_ 411 ADC_ESA_Number 0;
BA_ "GenSigSendType" SG_ 411 ADC_ESA_Number 1;
BA_ "GenSigStartValue" SG_ 411 ADC_ESA_Number 0;
BA_ "GenSigTimeoutValue" SG_ 411 ADC_ESA_Number 0;
BA_ "Remark" SG_ 411 ADC_ESA_Number "";
BA_ "EventCommandSignal" SG_ 411 ADC_AES_Number 0;
BA_ "GatewayedSignals" SG_ 411 ADC_AES_Number 0;
BA_ "GenSigInactiveValue" SG_ 411 ADC_AES_Number 0;
BA_ "GenSigInvalidValue" SG_ 411 ADC_AES_Number 0;
BA_ "GenSigSendType" SG_ 411 ADC_AES_Number 1;
BA_ "GenSigStartValue" SG_ 411 ADC_AES_Number 0;
BA_ "GenSigTimeoutValue" SG_ 411 ADC_AES_Number 0;
BA_ "Remark" SG_ 411 ADC_AES_Number "";
BA_ "EventCommandSignal" SG_ 411 ADC_FroNestTarLatPos 0;
BA_ "GatewayedSignals" SG_ 411 ADC_FroNestTarLatPos 0;
BA_ "GenSigInactiveValue" SG_ 411 ADC_FroNestTarLatPos 0;
BA_ "GenSigInvalidValue" SG_ 411 ADC_FroNestTarLatPos 0;
BA_ "GenSigSendType" SG_ 411 ADC_FroNestTarLatPos 1;
BA_ "GenSigStartValue" SG_ 411 ADC_FroNestTarLatPos 0;
BA_ "GenSigTimeoutValue" SG_ 411 ADC_FroNestTarLatPos 0;
BA_ "Remark" SG_ 411 ADC_FroNestTarLatPos "";
BA_ "EventCommandSignal" SG_ 411 ADC_FroNestTarLongPos 0;
BA_ "GatewayedSignals" SG_ 411 ADC_FroNestTarLongPos 0;
BA_ "GenSigInactiveValue" SG_ 411 ADC_FroNestTarLongPos 0;
BA_ "GenSigInvalidValue" SG_ 411 ADC_FroNestTarLongPos 0;
BA_ "GenSigSendType" SG_ 411 ADC_FroNestTarLongPos 1;
BA_ "GenSigStartValue" SG_ 411 ADC_FroNestTarLongPos 0;
BA_ "GenSigTimeoutValue" SG_ 411 ADC_FroNestTarLongPos 0;
BA_ "Remark" SG_ 411 ADC_FroNestTarLongPos "";
BA_ "EventCommandSignal" SG_ 411 ADC_LDSIconColor 0;
BA_ "GatewayedSignals" SG_ 411 ADC_LDSIconColor 0;
BA_ "GenSigInactiveValue" SG_ 411 ADC_LDSIconColor 0;
BA_ "GenSigInvalidValue" SG_ 411 ADC_LDSIconColor 0;
BA_ "GenSigSendType" SG_ 411 ADC_LDSIconColor 1;
BA_ "GenSigStartValue" SG_ 411 ADC_LDSIconColor 0;
BA_ "GenSigTimeoutValue" SG_ 411 ADC_LDSIconColor 5;
BA_ "Remark" SG_ 411 ADC_LDSIconColor "";
BA_ "EventCommandSignal" SG_ 411 ADC_LOCP_St 0;
BA_ "GatewayedSignals" SG_ 411 ADC_LOCP_St 0;
BA_ "GenSigInactiveValue" SG_ 411 ADC_LOCP_St 0;
BA_ "GenSigInvalidValue" SG_ 411 ADC_LOCP_St 0;
BA_ "GenSigSendType" SG_ 411 ADC_LOCP_St 1;
BA_ "GenSigStartValue" SG_ 411 ADC_LOCP_St 0;
BA_ "GenSigTimeoutValue" SG_ 411 ADC_LOCP_St 4;
BA_ "Remark" SG_ 411 ADC_LOCP_St "";
BA_ "EventCommandSignal" SG_ 915 ADC_3_CRC 0;
BA_ "GatewayedSignals" SG_ 915 ADC_3_CRC 0;
BA_ "GenSigInactiveValue" SG_ 915 ADC_3_CRC 0;
BA_ "GenSigInvalidValue" SG_ 915 ADC_3_CRC 0;
BA_ "GenSigSendType" SG_ 915 ADC_3_CRC 1;
BA_ "GenSigStartValue" SG_ 915 ADC_3_CRC 0;
BA_ "GenSigTimeoutValue" SG_ 915 ADC_3_CRC 0;
BA_ "Remark" SG_ 915 ADC_3_CRC "";
BA_ "EventCommandSignal" SG_ 915 ADC_3_Counter 0;
BA_ "GatewayedSignals" SG_ 915 ADC_3_Counter 0;
BA_ "GenSigInactiveValue" SG_ 915 ADC_3_Counter 0;
BA_ "GenSigInvalidValue" SG_ 915 ADC_3_Counter 0;
BA_ "GenSigSendType" SG_ 915 ADC_3_Counter 1;
BA_ "GenSigStartValue" SG_ 915 ADC_3_Counter 0;
BA_ "GenSigTimeoutValue" SG_ 915 ADC_3_Counter 0;
BA_ "Remark" SG_ 915 ADC_3_Counter "";
BA_ "EventCommandSignal" SG_ 915 ADC_FroTrkTargt0ObjClass 0;
BA_ "GatewayedSignals" SG_ 915 ADC_FroTrkTargt0ObjClass 0;
BA_ "GenSigInactiveValue" SG_ 915 ADC_FroTrkTargt0ObjClass 0;
BA_ "GenSigInvalidValue" SG_ 915 ADC_FroTrkTargt0ObjClass 0;
BA_ "GenSigSendType" SG_ 915 ADC_FroTrkTargt0ObjClass 1;
BA_ "GenSigStartValue" SG_ 915 ADC_FroTrkTargt0ObjClass 0;
BA_ "GenSigTimeoutValue" SG_ 915 ADC_FroTrkTargt0ObjClass 0;
BA_ "Remark" SG_ 915 ADC_FroTrkTargt0ObjClass "";
BA_ "EventCommandSignal" SG_ 915 ADC_FroTrkTargt0St 0;
BA_ "GatewayedSignals" SG_ 915 ADC_FroTrkTargt0St 0;
BA_ "GenSigInactiveValue" SG_ 915 ADC_FroTrkTargt0St 0;
BA_ "GenSigInvalidValue" SG_ 915 ADC_FroTrkTargt0St 0;
BA_ "GenSigSendType" SG_ 915 ADC_FroTrkTargt0St 1;
BA_ "GenSigStartValue" SG_ 915 ADC_FroTrkTargt0St 0;
BA_ "GenSigTimeoutValue" SG_ 915 ADC_FroTrkTargt0St 0;
BA_ "Remark" SG_ 915 ADC_FroTrkTargt0St "";
BA_ "EventCommandSignal" SG_ 915 ADC_FroTrkTargt0longPos 0;
BA_ "GatewayedSignals" SG_ 915 ADC_FroTrkTargt0longPos 0;
BA_ "GenSigInactiveValue" SG_ 915 ADC_FroTrkTargt0longPos 0;
BA_ "GenSigInvalidValue" SG_ 915 ADC_FroTrkTargt0longPos 1023;
BA_ "GenSigSendType" SG_ 915 ADC_FroTrkTargt0longPos 1;
BA_ "GenSigStartValue" SG_ 915 ADC_FroTrkTargt0longPos 0;
BA_ "GenSigTimeoutValue" SG_ 915 ADC_FroTrkTargt0longPos 0;
BA_ "Remark" SG_ 915 ADC_FroTrkTargt0longPos "";
BA_ "EventCommandSignal" SG_ 915 ADC_FroTrkTargt0latPos 0;
BA_ "GatewayedSignals" SG_ 915 ADC_FroTrkTargt0latPos 0;
BA_ "GenSigInactiveValue" SG_ 915 ADC_FroTrkTargt0latPos 0;
BA_ "GenSigInvalidValue" SG_ 915 ADC_FroTrkTargt0latPos 0;
BA_ "GenSigSendType" SG_ 915 ADC_FroTrkTargt0latPos 1;
BA_ "GenSigStartValue" SG_ 915 ADC_FroTrkTargt0latPos 512;
BA_ "GenSigTimeoutValue" SG_ 915 ADC_FroTrkTargt0latPos 0;
BA_ "Remark" SG_ 915 ADC_FroTrkTargt0latPos "";
BA_ "EventCommandSignal" SG_ 915 ADC_FroTrkTargt0LatRelSpd 0;
BA_ "GatewayedSignals" SG_ 915 ADC_FroTrkTargt0LatRelSpd 0;
BA_ "GenSigInactiveValue" SG_ 915 ADC_FroTrkTargt0LatRelSpd 0;
BA_ "GenSigInvalidValue" SG_ 915 ADC_FroTrkTargt0LatRelSpd 511;
BA_ "GenSigSendType" SG_ 915 ADC_FroTrkTargt0LatRelSpd 1;
BA_ "GenSigStartValue" SG_ 915 ADC_FroTrkTargt0LatRelSpd 0;
BA_ "GenSigTimeoutValue" SG_ 915 ADC_FroTrkTargt0LatRelSpd 0;
BA_ "Remark" SG_ 915 ADC_FroTrkTargt0LatRelSpd "";
BA_ "EventCommandSignal" SG_ 915 ADC_FroTrkTargt0LongRelSpd 0;
BA_ "GatewayedSignals" SG_ 915 ADC_FroTrkTargt0LongRelSpd 0;
BA_ "GenSigInactiveValue" SG_ 915 ADC_FroTrkTargt0LongRelSpd 0;
BA_ "GenSigInvalidValue" SG_ 915 ADC_FroTrkTargt0LongRelSpd 0;
BA_ "GenSigSendType" SG_ 915 ADC_FroTrkTargt0LongRelSpd 1;
BA_ "GenSigStartValue" SG_ 915 ADC_FroTrkTargt0LongRelSpd 0;
BA_ "GenSigTimeoutValue" SG_ 915 ADC_FroTrkTargt0LongRelSpd 0;
BA_ "Remark" SG_ 915 ADC_FroTrkTargt0LongRelSpd "";
BA_ "EventCommandSignal" SG_ 915 ADC_FroTrkTargt0DetSensor 0;
BA_ "GatewayedSignals" SG_ 915 ADC_FroTrkTargt0DetSensor 0;
BA_ "GenSigInactiveValue" SG_ 915 ADC_FroTrkTargt0DetSensor 0;
BA_ "GenSigInvalidValue" SG_ 915 ADC_FroTrkTargt0DetSensor 0;
BA_ "GenSigSendType" SG_ 915 ADC_FroTrkTargt0DetSensor 1;
BA_ "GenSigStartValue" SG_ 915 ADC_FroTrkTargt0DetSensor 0;
BA_ "GenSigTimeoutValue" SG_ 915 ADC_FroTrkTargt0DetSensor 0;
BA_ "Remark" SG_ 915 ADC_FroTrkTargt0DetSensor "";
BA_ "EventCommandSignal" SG_ 915 ADC_FroTrkTargt1ObjClass 0;
BA_ "GatewayedSignals" SG_ 915 ADC_FroTrkTargt1ObjClass 0;
BA_ "GenSigInactiveValue" SG_ 915 ADC_FroTrkTargt1ObjClass 0;
BA_ "GenSigInvalidValue" SG_ 915 ADC_FroTrkTargt1ObjClass 0;
BA_ "GenSigSendType" SG_ 915 ADC_FroTrkTargt1ObjClass 1;
BA_ "GenSigStartValue" SG_ 915 ADC_FroTrkTargt1ObjClass 0;
BA_ "GenSigTimeoutValue" SG_ 915 ADC_FroTrkTargt1ObjClass 0;
BA_ "Remark" SG_ 915 ADC_FroTrkTargt1ObjClass "";
BA_ "EventCommandSignal" SG_ 915 ADC_FroTrkTargt1St 0;
BA_ "GatewayedSignals" SG_ 915 ADC_FroTrkTargt1St 0;
BA_ "GenSigInactiveValue" SG_ 915 ADC_FroTrkTargt1St 0;
BA_ "GenSigInvalidValue" SG_ 915 ADC_FroTrkTargt1St 0;
BA_ "GenSigSendType" SG_ 915 ADC_FroTrkTargt1St 1;
BA_ "GenSigStartValue" SG_ 915 ADC_FroTrkTargt1St 0;
BA_ "GenSigTimeoutValue" SG_ 915 ADC_FroTrkTargt1St 0;
BA_ "Remark" SG_ 915 ADC_FroTrkTargt1St "";
BA_ "EventCommandSignal" SG_ 915 ADC_FroTrkTargt1longPos 0;
BA_ "GatewayedSignals" SG_ 915 ADC_FroTrkTargt1longPos 0;
BA_ "GenSigInactiveValue" SG_ 915 ADC_FroTrkTargt1longPos 0;
BA_ "GenSigInvalidValue" SG_ 915 ADC_FroTrkTargt1longPos 1023;
BA_ "GenSigSendType" SG_ 915 ADC_FroTrkTargt1longPos 1;
BA_ "GenSigStartValue" SG_ 915 ADC_FroTrkTargt1longPos 0;
BA_ "GenSigTimeoutValue" SG_ 915 ADC_FroTrkTargt1longPos 0;
BA_ "Remark" SG_ 915 ADC_FroTrkTargt1longPos "";
BA_ "EventCommandSignal" SG_ 915 ADC_FroTrkTargt1latPos 0;
BA_ "GatewayedSignals" SG_ 915 ADC_FroTrkTargt1latPos 0;
BA_ "GenSigInactiveValue" SG_ 915 ADC_FroTrkTargt1latPos 0;
BA_ "GenSigInvalidValue" SG_ 915 ADC_FroTrkTargt1latPos 0;
BA_ "GenSigSendType" SG_ 915 ADC_FroTrkTargt1latPos 1;
BA_ "GenSigStartValue" SG_ 915 ADC_FroTrkTargt1latPos 512;
BA_ "GenSigTimeoutValue" SG_ 915 ADC_FroTrkTargt1latPos 0;
BA_ "Remark" SG_ 915 ADC_FroTrkTargt1latPos "";
BA_ "EventCommandSignal" SG_ 915 ADC_FroTrkTargt1LatRelSpd 0;
BA_ "GatewayedSignals" SG_ 915 ADC_FroTrkTargt1LatRelSpd 0;
BA_ "GenSigInactiveValue" SG_ 915 ADC_FroTrkTargt1LatRelSpd 0;
BA_ "GenSigInvalidValue" SG_ 915 ADC_FroTrkTargt1LatRelSpd 511;
BA_ "GenSigSendType" SG_ 915 ADC_FroTrkTargt1LatRelSpd 1;
BA_ "GenSigStartValue" SG_ 915 ADC_FroTrkTargt1LatRelSpd 0;
BA_ "GenSigTimeoutValue" SG_ 915 ADC_FroTrkTargt1LatRelSpd 0;
BA_ "Remark" SG_ 915 ADC_FroTrkTargt1LatRelSpd "";
BA_ "EventCommandSignal" SG_ 915 ADC_FroTrkTargt1LongRelSpd 0;
BA_ "GatewayedSignals" SG_ 915 ADC_FroTrkTargt1LongRelSpd 0;
BA_ "GenSigInactiveValue" SG_ 915 ADC_FroTrkTargt1LongRelSpd 0;
BA_ "GenSigInvalidValue" SG_ 915 ADC_FroTrkTargt1LongRelSpd 0;
BA_ "GenSigSendType" SG_ 915 ADC_FroTrkTargt1LongRelSpd 1;
BA_ "GenSigStartValue" SG_ 915 ADC_FroTrkTargt1LongRelSpd 0;
BA_ "GenSigTimeoutValue" SG_ 915 ADC_FroTrkTargt1LongRelSpd 0;
BA_ "Remark" SG_ 915 ADC_FroTrkTargt1LongRelSpd "";
BA_ "EventCommandSignal" SG_ 915 ADC_FroTrkTargt1DetSensor 0;
BA_ "GatewayedSignals" SG_ 915 ADC_FroTrkTargt1DetSensor 0;
BA_ "GenSigInactiveValue" SG_ 915 ADC_FroTrkTargt1DetSensor 0;
BA_ "GenSigInvalidValue" SG_ 915 ADC_FroTrkTargt1DetSensor 0;
BA_ "GenSigSendType" SG_ 915 ADC_FroTrkTargt1DetSensor 1;
BA_ "GenSigStartValue" SG_ 915 ADC_FroTrkTargt1DetSensor 0;
BA_ "GenSigTimeoutValue" SG_ 915 ADC_FroTrkTargt1DetSensor 0;
BA_ "Remark" SG_ 915 ADC_FroTrkTargt1DetSensor "";
BA_ "EventCommandSignal" SG_ 915 ADC_FroTrkTargt2ObjClass 0;
BA_ "GatewayedSignals" SG_ 915 ADC_FroTrkTargt2ObjClass 0;
BA_ "GenSigInactiveValue" SG_ 915 ADC_FroTrkTargt2ObjClass 0;
BA_ "GenSigInvalidValue" SG_ 915 ADC_FroTrkTargt2ObjClass 0;
BA_ "GenSigSendType" SG_ 915 ADC_FroTrkTargt2ObjClass 1;
BA_ "GenSigStartValue" SG_ 915 ADC_FroTrkTargt2ObjClass 0;
BA_ "GenSigTimeoutValue" SG_ 915 ADC_FroTrkTargt2ObjClass 0;
BA_ "Remark" SG_ 915 ADC_FroTrkTargt2ObjClass "";
BA_ "EventCommandSignal" SG_ 915 ADC_FroTrkTargt2St 0;
BA_ "GatewayedSignals" SG_ 915 ADC_FroTrkTargt2St 0;
BA_ "GenSigInactiveValue" SG_ 915 ADC_FroTrkTargt2St 0;
BA_ "GenSigInvalidValue" SG_ 915 ADC_FroTrkTargt2St 0;
BA_ "GenSigSendType" SG_ 915 ADC_FroTrkTargt2St 1;
BA_ "GenSigStartValue" SG_ 915 ADC_FroTrkTargt2St 0;
BA_ "GenSigTimeoutValue" SG_ 915 ADC_FroTrkTargt2St 0;
BA_ "Remark" SG_ 915 ADC_FroTrkTargt2St "";
BA_ "EventCommandSignal" SG_ 915 ADC_FroTrkTargt2longPos 0;
BA_ "GatewayedSignals" SG_ 915 ADC_FroTrkTargt2longPos 0;
BA_ "GenSigInactiveValue" SG_ 915 ADC_FroTrkTargt2longPos 0;
BA_ "GenSigInvalidValue" SG_ 915 ADC_FroTrkTargt2longPos 1023;
BA_ "GenSigSendType" SG_ 915 ADC_FroTrkTargt2longPos 1;
BA_ "GenSigStartValue" SG_ 915 ADC_FroTrkTargt2longPos 0;
BA_ "GenSigTimeoutValue" SG_ 915 ADC_FroTrkTargt2longPos 0;
BA_ "Remark" SG_ 915 ADC_FroTrkTargt2longPos "";
BA_ "EventCommandSignal" SG_ 915 ADC_FroTrkTargt2latPos 0;
BA_ "GatewayedSignals" SG_ 915 ADC_FroTrkTargt2latPos 0;
BA_ "GenSigInactiveValue" SG_ 915 ADC_FroTrkTargt2latPos 0;
BA_ "GenSigInvalidValue" SG_ 915 ADC_FroTrkTargt2latPos 0;
BA_ "GenSigSendType" SG_ 915 ADC_FroTrkTargt2latPos 1;
BA_ "GenSigStartValue" SG_ 915 ADC_FroTrkTargt2latPos 512;
BA_ "GenSigTimeoutValue" SG_ 915 ADC_FroTrkTargt2latPos 0;
BA_ "Remark" SG_ 915 ADC_FroTrkTargt2latPos "";
BA_ "EventCommandSignal" SG_ 915 ADC_FroTrkTargt2LatRelSpd 0;
BA_ "GatewayedSignals" SG_ 915 ADC_FroTrkTargt2LatRelSpd 0;
BA_ "GenSigInactiveValue" SG_ 915 ADC_FroTrkTargt2LatRelSpd 0;
BA_ "GenSigInvalidValue" SG_ 915 ADC_FroTrkTargt2LatRelSpd 511;
BA_ "GenSigSendType" SG_ 915 ADC_FroTrkTargt2LatRelSpd 1;
BA_ "GenSigStartValue" SG_ 915 ADC_FroTrkTargt2LatRelSpd 0;
BA_ "GenSigTimeoutValue" SG_ 915 ADC_FroTrkTargt2LatRelSpd 0;
BA_ "Remark" SG_ 915 ADC_FroTrkTargt2LatRelSpd "";
BA_ "EventCommandSignal" SG_ 915 ADC_FroTrkTargt2LongRelSpd 0;
BA_ "GatewayedSignals" SG_ 915 ADC_FroTrkTargt2LongRelSpd 0;
BA_ "GenSigInactiveValue" SG_ 915 ADC_FroTrkTargt2LongRelSpd 0;
BA_ "GenSigInvalidValue" SG_ 915 ADC_FroTrkTargt2LongRelSpd 0;
BA_ "GenSigSendType" SG_ 915 ADC_FroTrkTargt2LongRelSpd 1;
BA_ "GenSigStartValue" SG_ 915 ADC_FroTrkTargt2LongRelSpd 0;
BA_ "GenSigTimeoutValue" SG_ 915 ADC_FroTrkTargt2LongRelSpd 0;
BA_ "Remark" SG_ 915 ADC_FroTrkTargt2LongRelSpd "";
BA_ "EventCommandSignal" SG_ 915 ADC_FroTrkTargt2DetSensor 0;
BA_ "GatewayedSignals" SG_ 915 ADC_FroTrkTargt2DetSensor 0;
BA_ "GenSigInactiveValue" SG_ 915 ADC_FroTrkTargt2DetSensor 0;
BA_ "GenSigInvalidValue" SG_ 915 ADC_FroTrkTargt2DetSensor 0;
BA_ "GenSigSendType" SG_ 915 ADC_FroTrkTargt2DetSensor 1;
BA_ "GenSigStartValue" SG_ 915 ADC_FroTrkTargt2DetSensor 0;
BA_ "GenSigTimeoutValue" SG_ 915 ADC_FroTrkTargt2DetSensor 0;
BA_ "Remark" SG_ 915 ADC_FroTrkTargt2DetSensor "";
BA_ "EventCommandSignal" SG_ 915 ADC_FroTrkTargt3ObjClass 0;
BA_ "GatewayedSignals" SG_ 915 ADC_FroTrkTargt3ObjClass 0;
BA_ "GenSigInactiveValue" SG_ 915 ADC_FroTrkTargt3ObjClass 0;
BA_ "GenSigInvalidValue" SG_ 915 ADC_FroTrkTargt3ObjClass 0;
BA_ "GenSigSendType" SG_ 915 ADC_FroTrkTargt3ObjClass 1;
BA_ "GenSigStartValue" SG_ 915 ADC_FroTrkTargt3ObjClass 0;
BA_ "GenSigTimeoutValue" SG_ 915 ADC_FroTrkTargt3ObjClass 0;
BA_ "Remark" SG_ 915 ADC_FroTrkTargt3ObjClass "";
BA_ "EventCommandSignal" SG_ 915 ADC_FroTrkTargt3St 0;
BA_ "GatewayedSignals" SG_ 915 ADC_FroTrkTargt3St 0;
BA_ "GenSigInactiveValue" SG_ 915 ADC_FroTrkTargt3St 0;
BA_ "GenSigInvalidValue" SG_ 915 ADC_FroTrkTargt3St 0;
BA_ "GenSigSendType" SG_ 915 ADC_FroTrkTargt3St 1;
BA_ "GenSigStartValue" SG_ 915 ADC_FroTrkTargt3St 0;
BA_ "GenSigTimeoutValue" SG_ 915 ADC_FroTrkTargt3St 0;
BA_ "Remark" SG_ 915 ADC_FroTrkTargt3St "";
BA_ "EventCommandSignal" SG_ 915 ADC_FroTrkTargt3longPos 0;
BA_ "GatewayedSignals" SG_ 915 ADC_FroTrkTargt3longPos 0;
BA_ "GenSigInactiveValue" SG_ 915 ADC_FroTrkTargt3longPos 0;
BA_ "GenSigInvalidValue" SG_ 915 ADC_FroTrkTargt3longPos 1023;
BA_ "GenSigSendType" SG_ 915 ADC_FroTrkTargt3longPos 1;
BA_ "GenSigStartValue" SG_ 915 ADC_FroTrkTargt3longPos 0;
BA_ "GenSigTimeoutValue" SG_ 915 ADC_FroTrkTargt3longPos 0;
BA_ "Remark" SG_ 915 ADC_FroTrkTargt3longPos "";
BA_ "EventCommandSignal" SG_ 915 ADC_FroTrkTargt3latPos 0;
BA_ "GatewayedSignals" SG_ 915 ADC_FroTrkTargt3latPos 0;
BA_ "GenSigInactiveValue" SG_ 915 ADC_FroTrkTargt3latPos 0;
BA_ "GenSigInvalidValue" SG_ 915 ADC_FroTrkTargt3latPos 0;
BA_ "GenSigSendType" SG_ 915 ADC_FroTrkTargt3latPos 1;
BA_ "GenSigStartValue" SG_ 915 ADC_FroTrkTargt3latPos 512;
BA_ "GenSigTimeoutValue" SG_ 915 ADC_FroTrkTargt3latPos 0;
BA_ "Remark" SG_ 915 ADC_FroTrkTargt3latPos "";
BA_ "EventCommandSignal" SG_ 915 ADC_FroTrkTargt3LatRelSpd 0;
BA_ "GatewayedSignals" SG_ 915 ADC_FroTrkTargt3LatRelSpd 0;
BA_ "GenSigInactiveValue" SG_ 915 ADC_FroTrkTargt3LatRelSpd 0;
BA_ "GenSigInvalidValue" SG_ 915 ADC_FroTrkTargt3LatRelSpd 511;
BA_ "GenSigSendType" SG_ 915 ADC_FroTrkTargt3LatRelSpd 1;
BA_ "GenSigStartValue" SG_ 915 ADC_FroTrkTargt3LatRelSpd 0;
BA_ "GenSigTimeoutValue" SG_ 915 ADC_FroTrkTargt3LatRelSpd 0;
BA_ "Remark" SG_ 915 ADC_FroTrkTargt3LatRelSpd "";
BA_ "EventCommandSignal" SG_ 915 ADC_FroTrkTargt3LongRelSpd 0;
BA_ "GatewayedSignals" SG_ 915 ADC_FroTrkTargt3LongRelSpd 0;
BA_ "GenSigInactiveValue" SG_ 915 ADC_FroTrkTargt3LongRelSpd 0;
BA_ "GenSigInvalidValue" SG_ 915 ADC_FroTrkTargt3LongRelSpd 0;
BA_ "GenSigSendType" SG_ 915 ADC_FroTrkTargt3LongRelSpd 1;
BA_ "GenSigStartValue" SG_ 915 ADC_FroTrkTargt3LongRelSpd 0;
BA_ "GenSigTimeoutValue" SG_ 915 ADC_FroTrkTargt3LongRelSpd 0;
BA_ "Remark" SG_ 915 ADC_FroTrkTargt3LongRelSpd "";
BA_ "EventCommandSignal" SG_ 915 ADC_FroTrkTargt3DetSensor 0;
BA_ "GatewayedSignals" SG_ 915 ADC_FroTrkTargt3DetSensor 0;
BA_ "GenSigInactiveValue" SG_ 915 ADC_FroTrkTargt3DetSensor 0;
BA_ "GenSigInvalidValue" SG_ 915 ADC_FroTrkTargt3DetSensor 0;
BA_ "GenSigSendType" SG_ 915 ADC_FroTrkTargt3DetSensor 1;
BA_ "GenSigStartValue" SG_ 915 ADC_FroTrkTargt3DetSensor 0;
BA_ "GenSigTimeoutValue" SG_ 915 ADC_FroTrkTargt3DetSensor 0;
BA_ "Remark" SG_ 915 ADC_FroTrkTargt3DetSensor "";
BA_ "EventCommandSignal" SG_ 915 ADC_ReaTrkTargt4ObjClass 0;
BA_ "GatewayedSignals" SG_ 915 ADC_ReaTrkTargt4ObjClass 0;
BA_ "GenSigInactiveValue" SG_ 915 ADC_ReaTrkTargt4ObjClass 0;
BA_ "GenSigInvalidValue" SG_ 915 ADC_ReaTrkTargt4ObjClass 0;
BA_ "GenSigSendType" SG_ 915 ADC_ReaTrkTargt4ObjClass 1;
BA_ "GenSigStartValue" SG_ 915 ADC_ReaTrkTargt4ObjClass 0;
BA_ "GenSigTimeoutValue" SG_ 915 ADC_ReaTrkTargt4ObjClass 0;
BA_ "Remark" SG_ 915 ADC_ReaTrkTargt4ObjClass "";
BA_ "EventCommandSignal" SG_ 915 ADC_ReaTrkTargt4St 0;
BA_ "GatewayedSignals" SG_ 915 ADC_ReaTrkTargt4St 0;
BA_ "GenSigInactiveValue" SG_ 915 ADC_ReaTrkTargt4St 0;
BA_ "GenSigInvalidValue" SG_ 915 ADC_ReaTrkTargt4St 0;
BA_ "GenSigSendType" SG_ 915 ADC_ReaTrkTargt4St 1;
BA_ "GenSigStartValue" SG_ 915 ADC_ReaTrkTargt4St 0;
BA_ "GenSigTimeoutValue" SG_ 915 ADC_ReaTrkTargt4St 0;
BA_ "Remark" SG_ 915 ADC_ReaTrkTargt4St "";
BA_ "EventCommandSignal" SG_ 915 ADC_ReaTrkTargt4longPos 0;
BA_ "GatewayedSignals" SG_ 915 ADC_ReaTrkTargt4longPos 0;
BA_ "GenSigInactiveValue" SG_ 915 ADC_ReaTrkTargt4longPos 0;
BA_ "GenSigInvalidValue" SG_ 915 ADC_ReaTrkTargt4longPos 511;
BA_ "GenSigSendType" SG_ 915 ADC_ReaTrkTargt4longPos 1;
BA_ "GenSigStartValue" SG_ 915 ADC_ReaTrkTargt4longPos 0;
BA_ "GenSigTimeoutValue" SG_ 915 ADC_ReaTrkTargt4longPos 0;
BA_ "Remark" SG_ 915 ADC_ReaTrkTargt4longPos "";
BA_ "EventCommandSignal" SG_ 915 ADC_ReaTrkTargt4latPos 0;
BA_ "GatewayedSignals" SG_ 915 ADC_ReaTrkTargt4latPos 0;
BA_ "GenSigInactiveValue" SG_ 915 ADC_ReaTrkTargt4latPos 0;
BA_ "GenSigInvalidValue" SG_ 915 ADC_ReaTrkTargt4latPos 0;
BA_ "GenSigSendType" SG_ 915 ADC_ReaTrkTargt4latPos 1;
BA_ "GenSigStartValue" SG_ 915 ADC_ReaTrkTargt4latPos 512;
BA_ "GenSigTimeoutValue" SG_ 915 ADC_ReaTrkTargt4latPos 0;
BA_ "Remark" SG_ 915 ADC_ReaTrkTargt4latPos "";
BA_ "EventCommandSignal" SG_ 915 ADC_ReaTrkTargt4LatRelSpd 0;
BA_ "GatewayedSignals" SG_ 915 ADC_ReaTrkTargt4LatRelSpd 0;
BA_ "GenSigInactiveValue" SG_ 915 ADC_ReaTrkTargt4LatRelSpd 0;
BA_ "GenSigInvalidValue" SG_ 915 ADC_ReaTrkTargt4LatRelSpd 511;
BA_ "GenSigSendType" SG_ 915 ADC_ReaTrkTargt4LatRelSpd 1;
BA_ "GenSigStartValue" SG_ 915 ADC_ReaTrkTargt4LatRelSpd 0;
BA_ "GenSigTimeoutValue" SG_ 915 ADC_ReaTrkTargt4LatRelSpd 0;
BA_ "Remark" SG_ 915 ADC_ReaTrkTargt4LatRelSpd "";
BA_ "EventCommandSignal" SG_ 915 ADC_ReaTrkTargt4LongRelSpd 0;
BA_ "GatewayedSignals" SG_ 915 ADC_ReaTrkTargt4LongRelSpd 0;
BA_ "GenSigInactiveValue" SG_ 915 ADC_ReaTrkTargt4LongRelSpd 0;
BA_ "GenSigInvalidValue" SG_ 915 ADC_ReaTrkTargt4LongRelSpd 0;
BA_ "GenSigSendType" SG_ 915 ADC_ReaTrkTargt4LongRelSpd 1;
BA_ "GenSigStartValue" SG_ 915 ADC_ReaTrkTargt4LongRelSpd 0;
BA_ "GenSigTimeoutValue" SG_ 915 ADC_ReaTrkTargt4LongRelSpd 0;
BA_ "Remark" SG_ 915 ADC_ReaTrkTargt4LongRelSpd "";
BA_ "EventCommandSignal" SG_ 915 ADC_ReaTrkTargt4DetSensor 0;
BA_ "GatewayedSignals" SG_ 915 ADC_ReaTrkTargt4DetSensor 0;
BA_ "GenSigInactiveValue" SG_ 915 ADC_ReaTrkTargt4DetSensor 0;
BA_ "GenSigInvalidValue" SG_ 915 ADC_ReaTrkTargt4DetSensor 0;
BA_ "GenSigSendType" SG_ 915 ADC_ReaTrkTargt4DetSensor 1;
BA_ "GenSigStartValue" SG_ 915 ADC_ReaTrkTargt4DetSensor 0;
BA_ "GenSigTimeoutValue" SG_ 915 ADC_ReaTrkTargt4DetSensor 0;
BA_ "Remark" SG_ 915 ADC_ReaTrkTargt4DetSensor "";
BA_ "EventCommandSignal" SG_ 915 ADC_ReaTrkTargt5ObjClass 0;
BA_ "GatewayedSignals" SG_ 915 ADC_ReaTrkTargt5ObjClass 0;
BA_ "GenSigInactiveValue" SG_ 915 ADC_ReaTrkTargt5ObjClass 0;
BA_ "GenSigInvalidValue" SG_ 915 ADC_ReaTrkTargt5ObjClass 0;
BA_ "GenSigSendType" SG_ 915 ADC_ReaTrkTargt5ObjClass 1;
BA_ "GenSigStartValue" SG_ 915 ADC_ReaTrkTargt5ObjClass 0;
BA_ "GenSigTimeoutValue" SG_ 915 ADC_ReaTrkTargt5ObjClass 0;
BA_ "Remark" SG_ 915 ADC_ReaTrkTargt5ObjClass "";
BA_ "EventCommandSignal" SG_ 915 ADC_ReaTrkTargt5St 0;
BA_ "GatewayedSignals" SG_ 915 ADC_ReaTrkTargt5St 0;
BA_ "GenSigInactiveValue" SG_ 915 ADC_ReaTrkTargt5St 0;
BA_ "GenSigInvalidValue" SG_ 915 ADC_ReaTrkTargt5St 0;
BA_ "GenSigSendType" SG_ 915 ADC_ReaTrkTargt5St 1;
BA_ "GenSigStartValue" SG_ 915 ADC_ReaTrkTargt5St 0;
BA_ "GenSigTimeoutValue" SG_ 915 ADC_ReaTrkTargt5St 0;
BA_ "Remark" SG_ 915 ADC_ReaTrkTargt5St "";
BA_ "EventCommandSignal" SG_ 915 ADC_ReaTrkTargt5longPos 0;
BA_ "GatewayedSignals" SG_ 915 ADC_ReaTrkTargt5longPos 0;
BA_ "GenSigInactiveValue" SG_ 915 ADC_ReaTrkTargt5longPos 0;
BA_ "GenSigInvalidValue" SG_ 915 ADC_ReaTrkTargt5longPos 511;
BA_ "GenSigSendType" SG_ 915 ADC_ReaTrkTargt5longPos 1;
BA_ "GenSigStartValue" SG_ 915 ADC_ReaTrkTargt5longPos 0;
BA_ "GenSigTimeoutValue" SG_ 915 ADC_ReaTrkTargt5longPos 0;
BA_ "Remark" SG_ 915 ADC_ReaTrkTargt5longPos "";
BA_ "EventCommandSignal" SG_ 915 ADC_ReaTrkTargt5latPos 0;
BA_ "GatewayedSignals" SG_ 915 ADC_ReaTrkTargt5latPos 0;
BA_ "GenSigInactiveValue" SG_ 915 ADC_ReaTrkTargt5latPos 0;
BA_ "GenSigInvalidValue" SG_ 915 ADC_ReaTrkTargt5latPos 0;
BA_ "GenSigSendType" SG_ 915 ADC_ReaTrkTargt5latPos 1;
BA_ "GenSigStartValue" SG_ 915 ADC_ReaTrkTargt5latPos 512;
BA_ "GenSigTimeoutValue" SG_ 915 ADC_ReaTrkTargt5latPos 0;
BA_ "Remark" SG_ 915 ADC_ReaTrkTargt5latPos "";
BA_ "EventCommandSignal" SG_ 915 ADC_ReaTrkTargt5LatRelSpd 0;
BA_ "GatewayedSignals" SG_ 915 ADC_ReaTrkTargt5LatRelSpd 0;
BA_ "GenSigInactiveValue" SG_ 915 ADC_ReaTrkTargt5LatRelSpd 0;
BA_ "GenSigInvalidValue" SG_ 915 ADC_ReaTrkTargt5LatRelSpd 511;
BA_ "GenSigSendType" SG_ 915 ADC_ReaTrkTargt5LatRelSpd 1;
BA_ "GenSigStartValue" SG_ 915 ADC_ReaTrkTargt5LatRelSpd 0;
BA_ "GenSigTimeoutValue" SG_ 915 ADC_ReaTrkTargt5LatRelSpd 0;
BA_ "Remark" SG_ 915 ADC_ReaTrkTargt5LatRelSpd "";
BA_ "EventCommandSignal" SG_ 915 ADC_ReaTrkTargt5LongRelSpd 0;
BA_ "GatewayedSignals" SG_ 915 ADC_ReaTrkTargt5LongRelSpd 0;
BA_ "GenSigInactiveValue" SG_ 915 ADC_ReaTrkTargt5LongRelSpd 0;
BA_ "GenSigInvalidValue" SG_ 915 ADC_ReaTrkTargt5LongRelSpd 0;
BA_ "GenSigSendType" SG_ 915 ADC_ReaTrkTargt5LongRelSpd 1;
BA_ "GenSigStartValue" SG_ 915 ADC_ReaTrkTargt5LongRelSpd 0;
BA_ "GenSigTimeoutValue" SG_ 915 ADC_ReaTrkTargt5LongRelSpd 0;
BA_ "Remark" SG_ 915 ADC_ReaTrkTargt5LongRelSpd "";
BA_ "EventCommandSignal" SG_ 915 ADC_ReaTrkTargt5DetSensor 0;
BA_ "GatewayedSignals" SG_ 915 ADC_ReaTrkTargt5DetSensor 0;
BA_ "GenSigInactiveValue" SG_ 915 ADC_ReaTrkTargt5DetSensor 0;
BA_ "GenSigInvalidValue" SG_ 915 ADC_ReaTrkTargt5DetSensor 0;
BA_ "GenSigSendType" SG_ 915 ADC_ReaTrkTargt5DetSensor 1;
BA_ "GenSigStartValue" SG_ 915 ADC_ReaTrkTargt5DetSensor 0;
BA_ "GenSigTimeoutValue" SG_ 915 ADC_ReaTrkTargt5DetSensor 0;
BA_ "Remark" SG_ 915 ADC_ReaTrkTargt5DetSensor "";
BA_ "EventCommandSignal" SG_ 915 ADC_ReaTrkTargt6ObjClass 0;
BA_ "GatewayedSignals" SG_ 915 ADC_ReaTrkTargt6ObjClass 0;
BA_ "GenSigInactiveValue" SG_ 915 ADC_ReaTrkTargt6ObjClass 0;
BA_ "GenSigInvalidValue" SG_ 915 ADC_ReaTrkTargt6ObjClass 0;
BA_ "GenSigSendType" SG_ 915 ADC_ReaTrkTargt6ObjClass 1;
BA_ "GenSigStartValue" SG_ 915 ADC_ReaTrkTargt6ObjClass 0;
BA_ "GenSigTimeoutValue" SG_ 915 ADC_ReaTrkTargt6ObjClass 0;
BA_ "Remark" SG_ 915 ADC_ReaTrkTargt6ObjClass "";
BA_ "EventCommandSignal" SG_ 915 ADC_ReaTrkTargt6St 0;
BA_ "GatewayedSignals" SG_ 915 ADC_ReaTrkTargt6St 0;
BA_ "GenSigInactiveValue" SG_ 915 ADC_ReaTrkTargt6St 0;
BA_ "GenSigInvalidValue" SG_ 915 ADC_ReaTrkTargt6St 0;
BA_ "GenSigSendType" SG_ 915 ADC_ReaTrkTargt6St 1;
BA_ "GenSigStartValue" SG_ 915 ADC_ReaTrkTargt6St 0;
BA_ "GenSigTimeoutValue" SG_ 915 ADC_ReaTrkTargt6St 0;
BA_ "Remark" SG_ 915 ADC_ReaTrkTargt6St "";
BA_ "EventCommandSignal" SG_ 915 ADC_ReaTrkTargt6longPos 0;
BA_ "GatewayedSignals" SG_ 915 ADC_ReaTrkTargt6longPos 0;
BA_ "GenSigInactiveValue" SG_ 915 ADC_ReaTrkTargt6longPos 0;
BA_ "GenSigInvalidValue" SG_ 915 ADC_ReaTrkTargt6longPos 511;
BA_ "GenSigSendType" SG_ 915 ADC_ReaTrkTargt6longPos 1;
BA_ "GenSigStartValue" SG_ 915 ADC_ReaTrkTargt6longPos 0;
BA_ "GenSigTimeoutValue" SG_ 915 ADC_ReaTrkTargt6longPos 0;
BA_ "Remark" SG_ 915 ADC_ReaTrkTargt6longPos "";
BA_ "EventCommandSignal" SG_ 915 ADC_ReaTrkTargt6latPos 0;
BA_ "GatewayedSignals" SG_ 915 ADC_ReaTrkTargt6latPos 0;
BA_ "GenSigInactiveValue" SG_ 915 ADC_ReaTrkTargt6latPos 0;
BA_ "GenSigInvalidValue" SG_ 915 ADC_ReaTrkTargt6latPos 0;
BA_ "GenSigSendType" SG_ 915 ADC_ReaTrkTargt6latPos 1;
BA_ "GenSigStartValue" SG_ 915 ADC_ReaTrkTargt6latPos 512;
BA_ "GenSigTimeoutValue" SG_ 915 ADC_ReaTrkTargt6latPos 0;
BA_ "Remark" SG_ 915 ADC_ReaTrkTargt6latPos "";
BA_ "EventCommandSignal" SG_ 915 ADC_ReaTrkTargt6LatRelSpd 0;
BA_ "GatewayedSignals" SG_ 915 ADC_ReaTrkTargt6LatRelSpd 0;
BA_ "GenSigInactiveValue" SG_ 915 ADC_ReaTrkTargt6LatRelSpd 0;
BA_ "GenSigInvalidValue" SG_ 915 ADC_ReaTrkTargt6LatRelSpd 511;
BA_ "GenSigSendType" SG_ 915 ADC_ReaTrkTargt6LatRelSpd 1;
BA_ "GenSigStartValue" SG_ 915 ADC_ReaTrkTargt6LatRelSpd 0;
BA_ "GenSigTimeoutValue" SG_ 915 ADC_ReaTrkTargt6LatRelSpd 0;
BA_ "Remark" SG_ 915 ADC_ReaTrkTargt6LatRelSpd "";
BA_ "EventCommandSignal" SG_ 915 ADC_ReaTrkTargt6LongRelSpd 0;
BA_ "GatewayedSignals" SG_ 915 ADC_ReaTrkTargt6LongRelSpd 0;
BA_ "GenSigInactiveValue" SG_ 915 ADC_ReaTrkTargt6LongRelSpd 0;
BA_ "GenSigInvalidValue" SG_ 915 ADC_ReaTrkTargt6LongRelSpd 0;
BA_ "GenSigSendType" SG_ 915 ADC_ReaTrkTargt6LongRelSpd 1;
BA_ "GenSigStartValue" SG_ 915 ADC_ReaTrkTargt6LongRelSpd 0;
BA_ "GenSigTimeoutValue" SG_ 915 ADC_ReaTrkTargt6LongRelSpd 0;
BA_ "Remark" SG_ 915 ADC_ReaTrkTargt6LongRelSpd "";
BA_ "EventCommandSignal" SG_ 915 ADC_ReaTrkTargt6DetSensor 0;
BA_ "GatewayedSignals" SG_ 915 ADC_ReaTrkTargt6DetSensor 0;
BA_ "GenSigInactiveValue" SG_ 915 ADC_ReaTrkTargt6DetSensor 0;
BA_ "GenSigInvalidValue" SG_ 915 ADC_ReaTrkTargt6DetSensor 0;
BA_ "GenSigSendType" SG_ 915 ADC_ReaTrkTargt6DetSensor 1;
BA_ "GenSigStartValue" SG_ 915 ADC_ReaTrkTargt6DetSensor 0;
BA_ "GenSigTimeoutValue" SG_ 915 ADC_ReaTrkTargt6DetSensor 0;
BA_ "Remark" SG_ 915 ADC_ReaTrkTargt6DetSensor "";
BA_ "EventCommandSignal" SG_ 915 ADC_RadarPowerDownReq 0;
BA_ "GatewayedSignals" SG_ 915 ADC_RadarPowerDownReq 0;
BA_ "GenSigInactiveValue" SG_ 915 ADC_RadarPowerDownReq 0;
BA_ "GenSigInvalidValue" SG_ 915 ADC_RadarPowerDownReq 0;
BA_ "GenSigSendType" SG_ 915 ADC_RadarPowerDownReq 1;
BA_ "GenSigStartValue" SG_ 915 ADC_RadarPowerDownReq 0;
BA_ "GenSigTimeoutValue" SG_ 915 ADC_RadarPowerDownReq 0;
BA_ "Remark" SG_ 915 ADC_RadarPowerDownReq "";
BA_ "EventCommandSignal" SG_ 915 ADC_RadarPowerDownReqVD 0;
BA_ "GatewayedSignals" SG_ 915 ADC_RadarPowerDownReqVD 0;
BA_ "GenSigInactiveValue" SG_ 915 ADC_RadarPowerDownReqVD 0;
BA_ "GenSigInvalidValue" SG_ 915 ADC_RadarPowerDownReqVD 0;
BA_ "GenSigSendType" SG_ 915 ADC_RadarPowerDownReqVD 1;
BA_ "GenSigStartValue" SG_ 915 ADC_RadarPowerDownReqVD 0;
BA_ "GenSigTimeoutValue" SG_ 915 ADC_RadarPowerDownReqVD 0;
BA_ "Remark" SG_ 915 ADC_RadarPowerDownReqVD "";
BA_ "EventCommandSignal" SG_ 915 ADC_UPSPowerDownReq 0;
BA_ "GatewayedSignals" SG_ 915 ADC_UPSPowerDownReq 0;
BA_ "GenSigInactiveValue" SG_ 915 ADC_UPSPowerDownReq 0;
BA_ "GenSigInvalidValue" SG_ 915 ADC_UPSPowerDownReq 0;
BA_ "GenSigSendType" SG_ 915 ADC_UPSPowerDownReq 1;
BA_ "GenSigStartValue" SG_ 915 ADC_UPSPowerDownReq 0;
BA_ "GenSigTimeoutValue" SG_ 915 ADC_UPSPowerDownReq 0;
BA_ "Remark" SG_ 915 ADC_UPSPowerDownReq "";
BA_ "EventCommandSignal" SG_ 915 ADC_UPSPowerDownReqVD 0;
BA_ "GatewayedSignals" SG_ 915 ADC_UPSPowerDownReqVD 0;
BA_ "GenSigInactiveValue" SG_ 915 ADC_UPSPowerDownReqVD 0;
BA_ "GenSigInvalidValue" SG_ 915 ADC_UPSPowerDownReqVD 0;
BA_ "GenSigSendType" SG_ 915 ADC_UPSPowerDownReqVD 1;
BA_ "GenSigStartValue" SG_ 915 ADC_UPSPowerDownReqVD 0;
BA_ "GenSigTimeoutValue" SG_ 915 ADC_UPSPowerDownReqVD 0;
BA_ "Remark" SG_ 915 ADC_UPSPowerDownReqVD "";
BA_ "EventCommandSignal" SG_ 915 ADC_LidarPowerDownReq 0;
BA_ "GatewayedSignals" SG_ 915 ADC_LidarPowerDownReq 0;
BA_ "GenSigInactiveValue" SG_ 915 ADC_LidarPowerDownReq 0;
BA_ "GenSigInvalidValue" SG_ 915 ADC_LidarPowerDownReq 0;
BA_ "GenSigSendType" SG_ 915 ADC_LidarPowerDownReq 1;
BA_ "GenSigStartValue" SG_ 915 ADC_LidarPowerDownReq 0;
BA_ "GenSigTimeoutValue" SG_ 915 ADC_LidarPowerDownReq 0;
BA_ "Remark" SG_ 915 ADC_LidarPowerDownReq "";
BA_ "EventCommandSignal" SG_ 915 ADC_LidarPowerDownReqVD 0;
BA_ "GatewayedSignals" SG_ 915 ADC_LidarPowerDownReqVD 0;
BA_ "GenSigInactiveValue" SG_ 915 ADC_LidarPowerDownReqVD 0;
BA_ "GenSigInvalidValue" SG_ 915 ADC_LidarPowerDownReqVD 0;
BA_ "GenSigSendType" SG_ 915 ADC_LidarPowerDownReqVD 1;
BA_ "GenSigStartValue" SG_ 915 ADC_LidarPowerDownReqVD 0;
BA_ "GenSigTimeoutValue" SG_ 915 ADC_LidarPowerDownReqVD 0;
BA_ "Remark" SG_ 915 ADC_LidarPowerDownReqVD "";
BA_ "EventCommandSignal" SG_ 915 ADC_IFCPowerDownReq 0;
BA_ "GatewayedSignals" SG_ 915 ADC_IFCPowerDownReq 0;
BA_ "GenSigInactiveValue" SG_ 915 ADC_IFCPowerDownReq 0;
BA_ "GenSigInvalidValue" SG_ 915 ADC_IFCPowerDownReq 0;
BA_ "GenSigSendType" SG_ 915 ADC_IFCPowerDownReq 1;
BA_ "GenSigStartValue" SG_ 915 ADC_IFCPowerDownReq 0;
BA_ "GenSigTimeoutValue" SG_ 915 ADC_IFCPowerDownReq 0;
BA_ "Remark" SG_ 915 ADC_IFCPowerDownReq "";
BA_ "EventCommandSignal" SG_ 915 ADC_IFCPowerDownReqVD 0;
BA_ "GatewayedSignals" SG_ 915 ADC_IFCPowerDownReqVD 0;
BA_ "GenSigInactiveValue" SG_ 915 ADC_IFCPowerDownReqVD 0;
BA_ "GenSigInvalidValue" SG_ 915 ADC_IFCPowerDownReqVD 0;
BA_ "GenSigSendType" SG_ 915 ADC_IFCPowerDownReqVD 1;
BA_ "GenSigStartValue" SG_ 915 ADC_IFCPowerDownReqVD 0;
BA_ "GenSigTimeoutValue" SG_ 915 ADC_IFCPowerDownReqVD 0;
BA_ "Remark" SG_ 915 ADC_IFCPowerDownReqVD "";
BA_ "EventCommandSignal" SG_ 915 ADC_LowPowerReq 0;
BA_ "GatewayedSignals" SG_ 915 ADC_LowPowerReq 0;
BA_ "GenSigInactiveValue" SG_ 915 ADC_LowPowerReq 0;
BA_ "GenSigInvalidValue" SG_ 915 ADC_LowPowerReq 0;
BA_ "GenSigSendType" SG_ 915 ADC_LowPowerReq 1;
BA_ "GenSigStartValue" SG_ 915 ADC_LowPowerReq 0;
BA_ "GenSigTimeoutValue" SG_ 915 ADC_LowPowerReq 0;
BA_ "Remark" SG_ 915 ADC_LowPowerReq "";
BA_ "EventCommandSignal" SG_ 915 ADC_LowPowerReqVD 0;
BA_ "GatewayedSignals" SG_ 915 ADC_LowPowerReqVD 0;
BA_ "GenSigInactiveValue" SG_ 915 ADC_LowPowerReqVD 0;
BA_ "GenSigInvalidValue" SG_ 915 ADC_LowPowerReqVD 0;
BA_ "GenSigSendType" SG_ 915 ADC_LowPowerReqVD 1;
BA_ "GenSigStartValue" SG_ 915 ADC_LowPowerReqVD 0;
BA_ "GenSigTimeoutValue" SG_ 915 ADC_LowPowerReqVD 0;
BA_ "Remark" SG_ 915 ADC_LowPowerReqVD "";
BA_ "EventCommandSignal" SG_ 915 Reserved1 0;
BA_ "GatewayedSignals" SG_ 915 Reserved1 0;
BA_ "GenSigInactiveValue" SG_ 915 Reserved1 0;
BA_ "GenSigInvalidValue" SG_ 915 Reserved1 0;
BA_ "GenSigSendType" SG_ 915 Reserved1 1;
BA_ "GenSigStartValue" SG_ 915 Reserved1 0;
BA_ "GenSigTimeoutValue" SG_ 915 Reserved1 0;
BA_ "Remark" SG_ 915 Reserved1 "";
VAL_ 411 ADC_FCWAssistType 0 "Warning and brake" 1 "Warning only" 2 "Off" 3 "Not used"  ;
VAL_ 411 ADC_FCWFaultSt 0 "Not fault" 1 "Fault"  ;
VAL_ 411 ADC_FCWPreWarn 0 "No warning" 1 "Warning" 2 "Not used" 3 "Not used"  ;
VAL_ 411 ADC_FCWLatentWarn 0 "No warning" 1 "Warning" 2 "Not used" 3 "Not used"  ;
VAL_ 411 ADC_AutonomyLevel 0 "None" 1 "Level 1 / Level 2" 2 "Level 2.5" 3 "Level 3" 4 "Reserved" 5 "Reserved" 6 "Reserved" 7 "Reserved"  ;
VAL_ 411 ADC_FCWWarmDistance 0 "Normal" 1 "Close" 2 "Far" 3 "Off"  ;
VAL_ 411 ADC_AEBTarObjType 0 "Not dectected" 1 "Car" 2 "Pedestrian" 3 "Two wheels" 4 "Motorcycle" 5 "Truck" 6 "Unknown"  ;
VAL_ 411 ADC_PMAEnableSt 0 "Off" 1 "On"  ;
VAL_ 411 ADC_PMAWarStatus 0 "No warning" 1 "Warning"  ;
VAL_ 411 ADC_BSDVibrWarnR 0 "No Request" 1 "Slightly" 2 "General" 3 "Urgent" 4 "No Warning"  ;
VAL_ 411 ADC_BSDVibrWarnL 0 "No Request" 1 "Slightly" 2 "General" 3 "Urgent" 4 "No Warning"  ;
VAL_ 411 ADC_AEBBrkPedalOverRide 0 "False" 1 "True"  ;
VAL_ 411 ADC_AEBBrePedalPressure 0 "False" 1 "True"  ;
VAL_ 411 ADC_AEBAccelePedalOverRide 0 "False" 1 "True"  ;
VAL_ 411 ADC_AEBSteeringInhibit 0 "False" 1 "True"  ;
VAL_ 411 ADC_AEBTarOncomingState 0 "Not Oncoming" 1 "Oncoming"  ;
VAL_ 411 ADC_AEBTarMotionState 0 "Not dectected" 1 "stationary" 2 "moving"  ;
VAL_ 411 ADC_AEBTarConfiLevel 0 "NoLevel" 1 "Low_1[0~0.4]" 2 "Low_1[0.4~0.5]" 3 "Mid_1 [0.5~0.6]" 4 "Mid_2 [0.6~0.7]" 5 "High_1 [0.7~0.8]" 6 "High_2 [0.8~0.9]" 7 "High_3 [0.9~1.0]"  ;
VAL_ 411 ADC_AEBTarSensorSource 0 "Invalid" 1 "Radar only" 2 "Vision only" 3 "Radar+Vision" 4 "Lidar only" 5 "Lidar+Radar" 6 "Lidar+Vision" 7 "Lidar+Radar+Vision" 8 "Reserve" 9 "Reserve" 10 "Reserve" 11 "Reserve" 12 "Reserve" 13 "Reserve" 14 "Reserve" 15 "Reserve"  ;
VAL_ 411 ADC_DOWAudioWarnFR 0 "No Warning" 1 "Warning_Lv2" 2 "Warning_Lv1" 3 "Reserved"  ;
VAL_ 411 ADC_DOWAudioWarnFL 0 "No Warning" 1 "Warning_Lv2" 2 "Warning_Lv1" 3 "Reserved"  ;
VAL_ 411 ADC_DOWAudioWarnRR 0 "No Warning" 1 "Warning_Lv2" 2 "Warning_Lv1" 3 "Reserved"  ;
VAL_ 411 ADC_DOWAudioWarnRL 0 "No Warning" 1 "Warning_Lv2" 2 "Warning_Lv1" 3 "Reserved"  ;
VAL_ 411 ADC_DOWIALWarnFR 0 "No Request" 1 "Warning level 1" 2 "Warning level 2" 3 "No Warning"  ;
VAL_ 411 ADC_DOWIALWarnFL 0 "No Request" 1 "Warning level 1" 2 "Warning level 2" 3 "No Warning"  ;
VAL_ 411 ADC_DOWIALWarnRR 0 "No Request" 1 "Warning level 1" 2 "Warning level 2" 3 "No Warning"  ;
VAL_ 411 ADC_DOWIALWarnRL 0 "No Request" 1 "Warning level 1" 2 "Warning level 2" 3 "No Warning"  ;
VAL_ 411 ADC_BSDExMirLedWarnR 0 "No Request" 1 "Continue ON（Warning level 1）" 2 "Flashing（Warning level 2）" 3 "OFF"  ;
VAL_ 411 ADC_BSDExMirLedWarnL 0 "No Request" 1 "Continue ON（Warning level 1）" 2 "Flashing（Warning level 2）" 3 "OFF"  ;
VAL_ 411 ADC_BSDLCASt 0 "OFF" 1 "Passive" 2 "Active" 3 "Failure"  ;
VAL_ 411 ADC_BSDLCAEnableSt 0 "Off" 1 "ON"  ;
VAL_ 411 ADC_RCTAEnableSt 0 "Off" 1 "ON"  ;
VAL_ 411 ADC_RCTASt 0 "OFF" 1 "Passive" 2 "Active" 3 "Failure"  ;
VAL_ 411 ADC_RCTAAssistType 0 "OFF" 1 "fail" 2 "Warning" 3 "brake and Warning"  ;
VAL_ 411 ADC_DOWSt 0 "OFF" 1 "Passive" 2 "Active" 3 "Failure"  ;
VAL_ 411 ADC_DOWEnableSt 0 "Off" 1 "ON"  ;
VAL_ 411 ADC_LCAWarnLeft 0 "No warning" 1 "Warning level 1" 2 "Warning level 2" 3 "Not used"  ;
VAL_ 411 ADC_LCAWarnRight 0 "No warning" 1 "Warning level 1" 2 "Warning level 2" 3 "Not used"  ;
VAL_ 411 ADC_RCTAWarnLeft 0 "No_Warning" 1 "Warning_level1_RCTA" 2 "Warning_level2_RCTB" 3 "Warning_level2_RCTA"  ;
VAL_ 411 ADC_RCWEnableSt 0 "Off" 1 "ON"  ;
VAL_ 411 ADC_RCTAWarnRight 0 "No_Warning" 1 "Warning_level1_RCTA" 2 "Warning_level2_RCTB" 3 "Warning_level2_RCTA"  ;
VAL_ 411 ADC_RCWSt 0 "Off" 1 "Passive/On/Inactive" 2 "Active" 3 "Failure"  ;
VAL_ 411 ADC_RCWWarn 0 "No warning" 1 "Warning level 1" 2 "Warning level 2" 3 "Not used"  ;
VAL_ 411 ADC_FCTAEnableSt 0 "Off" 1 "ON"  ;
VAL_ 411 ADC_FCTASt 0 "Off" 1 "Passive/On/Inactive" 2 "Active" 3 "failure"  ;
VAL_ 411 ADC_FCTAAssistType 0 "No Selected" 1 "Failure" 2 "Warning" 3 "brake and Warning"  ;
VAL_ 411 ADC_FCTAWarnL 0 "No_Warning" 1 "Warning_level1_FCTA" 2 "Warning_level2_FCTB" 3 "Warning_level2_FCTA"  ;
VAL_ 411 ADC_FCTAWarnR 0 "No_Warning" 1 "Warning_level1_FCTA" 2 "Warning_level2_FCTB" 3 "Warning_level2_FCTA"  ;
VAL_ 411 ADC_FroNestTarObjType 0 "Not dectected" 1 "Car" 2 "Pedestrian" 3 "Two wheels" 4 "Motorcycle" 5 "Truck" 6 "Unknown"  ;
VAL_ 411 ADC_FroNestTarDetSensor 0 "Invalid" 1 "Radar only" 2 "Vision only" 3 "Radar+Vision" 4 "Lidar only" 5 "Lidar+Radar" 6 "Lidar+Vision" 7 "Lidar+Radar+Vision" 8 "Reserve" 9 "Reserve" 10 "Reserve" 11 "Reserve" 12 "Reserve" 13 "Reserve" 14 "Reserve" 15 "Reserve"  ;
VAL_ 411 ADC_LDS_LaneAssistType 0 "Disable" 1 "Steering" 2 "Warning" 3 "Steering and Warning"  ;
VAL_ 411 ADC_IHBC_EnableSt 0 "Disable" 1 "Enable"  ;
VAL_ 411 ADC_TSR_EnableSt 0 "Disable" 1 "Enable"  ;
VAL_ 411 ADC_TSR_AudioWarn_EnableSt 0 "Disable" 1 "Enable"  ;
VAL_ 411 ADC_ELK_EnableSt 0 "Disable" 1 "Enable"  ;
VAL_ 411 ADC_ESA_EnableSt 0 "Disable" 1 "Enable"  ;
VAL_ 411 ADC_AES_EnableSt 0 "Disable" 1 "Enable"  ;
VAL_ 411 ADC_LDWSt 0 "LDW disable" 1 "LDW passive" 2 "LDW standby" 3 "LDW active" 4 "LDW failure no light" 5 "LDW failure light" 6 "Not used" 7 "Not used"  ;
VAL_ 411 ADC_LDW_Actdirection 0 "not active" 1 "left" 2 "right" 3 "Not used"  ;
VAL_ 411 ADC_LDP_Actdirection 0 "not active" 1 "left" 2 "right" 3 "Not used"  ;
VAL_ 411 ADC_LDW_PassiveReason 0 "No Function passive state" 1 "Lane Missing" 2 "Vehicle speed too high" 3 "Vehicle speed too low" 4 "Lane too wide" 5 "Lane too narrow" 6 "Excessive curvature" 7 "High priority function is triggered" 8 "Sensor Blocked" 9 "Turn lamp light" 10 "Braking" 11 "Steering AngleSpd too high" 12 "Driver Steerin Torque too high" 13 "Hazard lamp light" 14 "Ride line" 15 "Step on the accelerator quickly" 16 "Yaw rate too high" 17 "Alarm timeout" 18 "Lane merging" 19 "ABS or ESP active" 20 "Others"  ;
VAL_ 411 ADC_LDPSt 0 "LDP disable" 1 "LDP passive" 2 "LDP standby" 3 "LDP active" 4 "LDP failure no light" 5 "LDP failure light" 6 "Not used" 7 "Not used"  ;
VAL_ 411 ADC_LDP_PassiveReason 0 "NO Function passive state" 1 "Lane Missing" 2 "Vehicle speed too high" 3 "Vehicle speed too low" 4 "Lane too wide" 5 "Lane too narrow" 6 "Excessive curvature" 7 "High priority function active" 8 "Sensor Blocked" 9 "Turn lamp light" 10 "Braking" 11 "Steering AngleSpd too high" 12 "Driver Steerin Torque too high" 13 "Hazard lamp light" 14 "Ride line" 15 "Step on the accelerator quickly" 16 "Yaw rate too high" 17 "Alarm timeout" 19 "ABS or ESP active" 20 ":hands off too long" 21 "Others"  ;
VAL_ 411 ADC_RDP_St 0 "RDP disable" 1 "RDP passive" 2 "RDP standby" 3 "RDP active" 4 "RDP failure no light" 5 "RDP failure light" 6 "Not used" 7 "Not used"  ;
VAL_ 411 ADC_RDP_PassiveReason 0 "NO Function passive state" 1 "Lane Missing" 2 "Vehicle speed too high" 3 "Vehicle speed too low" 4 "Lane too wide" 5 "Lane too narrow" 6 "Excessive curvature" 7 "High priority function active" 8 "Sensor Blocked" 9 "Turn lamp light" 10 "Braking" 11 "Steering AngleSpd too high" 12 "Driver Steerin Torque too high" 13 "Hazard lamp light" 14 "Ride line" 15 "Step on the accelerator quickly" 16 "Yaw rate too high" 17 "Alarm timeout" 19 "ABS or ESP active" 20 ":hands off too long" 21 "Others"  ;
VAL_ 411 ADC_IHBC_St 0 "IHBC disable" 1 "IHBC passive" 2 "IHBC standby" 3 "IHBC active" 4 "IHBC failure" 5 "Not Used" 6 "Not Used" 7 "Not Used"  ;
VAL_ 411 ADC_RDP_Actdirection 0 "not active" 1 "left" 2 "right" 3 "Not used"  ;
VAL_ 411 ADC_FCMS_SwitchLockReq 0 "No_locked_ESP" 1 "Locked_ESP" 0 "No_locked_Speed" 1 "Locked_Speed"  ;
VAL_ 411 ADC_LKSLaneAssistSensitivity 0 "Not_Selected" 1 "Medium" 2 "Low" 3 "High" 4 "Failure" 5 "UserDefined"  ;
VAL_ 411 ADC_ELKSt 0 "OFF" 1 "Passive" 2 "Active" 3 "Failure"  ;
VAL_ 411 ADC_IHBC_SuppressSt 0 "No" 1 "Suppress transition" 2 "Suppress High beam" 3 "Not used"  ;
VAL_ 411 ADC_IHBC_SuppressReason 0 "No" 1 "yawrate" 2 "Steering angle rate" 3 "Lateral Acceleration" 4 "Turn light active" 5 "ABS Active" 6 "High Beam shortest active duation" 7 "Spped too low" 8 "Fog Light Active" 9 "Windsreen Wiper fast" 10 "Illumination Intensity" 11 "Oncoming Vehicle" 12 "Following vehicle" 13 "Camera Blockage" 14 "Partner ECU Failure" 15 "System Failure" 16 "Other Traffic Particapant" 17 "Not Used" 18 "Not Used" 19 "Not Used" 20 "Not Used" 21 "Not Used" 22 "Not Used" 23 "Not Used" 24 "Not Used" 25 "Not Used" 26 "Not Used" 27 "Not Used" 28 "Not Used" 29 "Not Used" 30 "Not Used" 31 "Not Used"  ;
VAL_ 411 ADC_IHBC_TargetType 0 "NO" 1 "pedestrian" 2 "car" 3 "not used"  ;
VAL_ 411 ADC_TSR_SpdLimit 0 "No display" 1 "Cancelled" 2 "5" 3 "10" 4 "15" 5 "20" 6 "25" 7 "30" 8 "35" 9 "40" 10 "45" 11 "50" 12 "55" 13 "60" 14 "65" 15 "70" 16 "75" 17 "80" 18 "85" 19 "90" 20 "95" 21 "100" 22 "105" 23 "110" 24 "115" 25 "120" 26 "125" 27 "130" 28 "135" 29 "140" 30 "145" 31 "150"  ;
VAL_ 411 ADC_TSR_SpdLimType 0 "not specific" 1 "Camera detection" 2 "Interval speed detection" 3 "Not used"  ;
VAL_ 411 ADC_TSRMode 0 "No" 1 "Video only" 2 "Navi only" 3 "Map only" 4 "Video+Navi" 5 "Video+Map" 6 "Navi+Map" 7 "Video+Navi+Map"  ;
VAL_ 411 ADC_TSR_St 0 "TSR disable" 1 "TSR passive" 2 "TSR active" 3 "TSR failure"  ;
VAL_ 411 ADC_TSR_FailureReason 0 "No" 1 "HD MAP" 2 "Communication" 3 "Partner ECU" 4 "Vison" 5 "Power Supply" 6 "Temerature" 7 "Not Used"  ;
VAL_ 411 ADC_TSR_TrafficSignType 0 "NO"  ;
VAL_ 411 ADC_TSRDisToIntervalEnd 0 "not in ISD" 251 "over 70km" 252 "not used" 253 "not used" 254 "not used" 255 "not used"  ;
VAL_ 411 ADC_TSRDisToCamera 251 "over 1.25km" 252 "not used" 253 "not used" 254 "not used" 255 "not used"  ;
VAL_ 411 ADC_TSR_SpeedLimitSource 0 "No" 1 "Video only" 2 "Navi only" 3 "Map only" 4 "Video+Navi" 5 "Video+Map" 6 "Navi+Map" 7 "Video+Navi+Map"  ;
VAL_ 411 ADC_TSR_WarnEnabledType 0 "No" 1 "Visual" 2 "Acoustic" 3 "Tactile" 4 "Visual+Acoustic" 5 "Visual+Tactile" 6 "Acoustic+Tactile" 7 "Visual+Acoustic+Tactile"  ;
VAL_ 411 ADC_TSR_TactileWarn 0 "NO warning" 1 "Warning"  ;
VAL_ 411 ADC_TSR_VisualWarn 0 "No warning" 1 "warning"  ;
VAL_ 411 ADC_TSR_SuppressReason 0 "No" 1 "Steering angle"  ;
VAL_ 411 ADC_TSR_SpdLimitUnit 0 "Unknown" 1 "km/h" 2 "Miles/h" 3 "Not used"  ;
VAL_ 411 ADC_TSR_AcousticWarn 0 "No warning" 1 "warning"  ;
VAL_ 411 ADC_ELKoncomingSt 0 "ELKoncoming disable" 1 "ELKoncoming passive" 2 "ELKoncoming standby" 3 "ELKoncoming active" 4 "ELKoncoming failure no light" 5 "ELKoncoming failure light" 6 "Not used" 7 "Not used"  ;
VAL_ 411 ADC_ELKoncoming_PassiveReason 0 "NO Function passive state" 1 "Lane Missing" 2 "Vehicle speed too high" 3 "Vehicle speed too low" 4 "Lane too wide" 5 "Lane too narrow" 6 "Excessive curvature" 7 "High priority function active" 8 "Sensor Blocked" 9 "Turn lamp light" 10 "Braking" 11 "Steering AngleSpd too high" 12 "Driver Steerin Torque too high" 13 "Hazard lamp light" 14 "Ride line" 15 "Step on the accelerator quickly" 16 "Yaw rate too high" 17 "Alarm timeout" 18 "Lane merging" 19 "ABS or ESP active" 20 "hands off too long" 21 "Others"  ;
VAL_ 411 ADC_ELKoncoming_Actdirection 0 "not active" 1 "left" 2 "right" 3 "Not used"  ;
VAL_ 411 ADC_ELKovertakingSt 0 "ELKovertaking disable" 1 "ELKovertaking passive" 2 "ELKovertaking standby" 3 "ELKovertaking active" 4 "ELKovertaking failure no light" 5 "ELKovertaking failure light" 6 "Not used" 7 "Not used"  ;
VAL_ 411 ADC_ELKovertaking_ActDirection 0 "not active" 1 "left" 2 "right" 3 "Not used"  ;
VAL_ 411 ADC_ISAChangeAudEnable 0 "Disable" 1 "Enable"  ;
VAL_ 411 ADC_ELKovertaking_PassiveReason 0 "NO Function passive state" 1 "Lane Missing" 2 "Vehicle speed too high" 3 "Vehicle speed too low" 4 "Lane too wide" 5 "Lane too narrow" 6 "Excessive curvature" 7 "High priority function active" 8 "Sensor Blocked" 9 "Turn lamp light" 10 "Braking" 11 "Steering AngleSpd too high" 12 "Driver Steerin Torque too high" 13 "Hazard lamp light" 14 "Ride line" 15 "Step on the accelerator quickly" 16 "Yaw rate too high" 17 "Alarm timeout" 18 "Lane merging" 19 "ABS or ESP active" 20 "hands off too long" 21 "Others"  ;
VAL_ 411 ADC_ELK_TargetObjClass 0 "Underdetemined" 1 "Car" 2 "motorcycle" 3 "Truck" 4 "bicycle" 5 "Not used" 6 "Not used" 7 "Not used"  ;
VAL_ 411 ADC_ESA_St 0 "ESA?disable" 1 "ESA?passive" 2 "ESA?standby" 3 "ESA?active" 4 "ESA?failure" 5 "No?License" 6 "Finish" 7 "Invalid"  ;
VAL_ 411 ADC_ESA_ActDirection 0 "not active" 1 "left" 2 "right" 3 "Not used"  ;
VAL_ 411 ADC_AES_St 0 "AES?disable" 1 "AES?passive" 2 "AES?standby" 3 "AES?active" 4 "AES?failure" 5 "No?License" 6 "Finish" 7 "Invalid"  ;
VAL_ 411 ADC_AES_ActDirection 0 "not active" 1 "left" 2 "right" 3 "Not used"  ;
VAL_ 411 ADC_ELKoncoming_ActiveWarn 0 "No warning" 1 "Warning"  ;
VAL_ 411 ADC_ELKovertaking_ActiveWarn 0 "No warning" 1 "Warning"  ;
VAL_ 411 ADC_ESA_ActiveWarn 0 "No warning" 1 "Warning"  ;
VAL_ 411 ADC_AES_ActiveWarn 0 "No warning" 1 "Warning"  ;
VAL_ 411 ADC_ESA_TargetObjClass 0 "Underdetemined" 1 "Car" 2 "motorcycle" 3 "Truck" 4 "bicycle" 5 "pedestrian" 6 "obstacle" 7 "Not used"  ;
VAL_ 411 ADC_ESA_PassiveReason 0 "NO passive reason" 1 "Lane Missing" 2 "Vehicle speed too high" 3 "Vehicle speed too low" 4 "Lane too wide" 5 "Lane too narrow" 6 "Excessive curvature" 7 "High priority function active" 8 "Sensor Blocked" 9 "Turn lamp light" 10 "Braking" 11 "Steering AngleSpd too high" 12 "Driver Steerin Torque too high" 13 "Hazard lamp light" 14 "Ride line" 15 "Step on the accelerator quickly" 16 "Yaw rate too high" 17 "Alarm timeout" 18 "Lane merging" 19 "ABS or ESP active" 20 "hands off too long" 21 "NO gap space" 22 "Others"  ;
VAL_ 411 ADC_AES_TargetObjClass 0 "Underdetemined" 1 "Car" 2 "motorcycle" 3 "Truck" 4 "bicycle" 5 "pedestrian" 6 "obstacle" 7 "Not used"  ;
VAL_ 411 ADC_AES_PassiveReason 0 "NO passive reason" 1 "Lane Missing" 2 "Vehicle speed too high" 3 "Vehicle speed too low" 4 "Lane too wide" 5 "Lane too narrow" 6 "Excessive curvature" 7 "High priority function active" 8 "Sensor Blocked" 9 "Turn lamp light" 10 "Braking" 11 "Steering AngleSpd too high" 12 "Driver Steerin Torque too high" 13 "Hazard lamp light" 14 "Ride line" 15 "Step on the accelerator quickly" 16 "Yaw rate too high" 17 "Alarm timeout" 18 "Lane merging" 19 "ABS or ESP active" 20 "hands off too long" 21 "NO gap space" 22 "Others"  ;
VAL_ 411 ADC_L1_LatfaultReason 0 "NO Function fault state" 1 "Sensor Failure" 2 "ADC Failure" 3 "ZCU failure or BCM  Failure" 4 "CCU failure" 5 "SRS failure" 6 "EPS failure" 7 "EBB failure" 8 ":ESC failure" 9 "VCU and relevate system failure" 10 "IDU failure" 11 "A-CAN? failure" 12 "P-CAN failure" 13 "I-CAN failure" 14 "Power abnormal" 15 "others"  ;
VAL_ 411 ADC_LDSIconColor 0 "IconColor_None" 1 "IconColor_Grey" 2 "IconColor_White" 3 "IconColor_Green" 4 "IconColor_Blue" 5 "IconClolor_Yellow" 6 "override flash_blue" 7 "IconColor_Yellow_Off"  ;
VAL_ 411 ADC_LOCP_St 0 "LOCP?disable" 1 "LOCP?passive" 2 "LOCP?standby" 3 "LOCP?active" 4 "LOCP?failure" 5 "No?License" 6 "Finish" 7 "Invalid"  ;
VAL_ 915 ADC_FroTrkTargt0ObjClass 0 "Underdetemined" 1 "Car" 2 "motorcycle" 3 "truck" 4 "pedestrian" 5 "Pole(TBD)" 6 "tree(TBD)" 7 "animal(TBD)" 8 "General on-borad object(TBD)" 9 "bicycle" 10 "unidentified vehicle(TBD)" 11 "Reserved" 12 "Reserved" 13 "Reserved" 14 "Reserved" 15 "Reserved"  ;
VAL_ 915 ADC_FroTrkTargt0St 0 "not dectected" 1 "dectected"  ;
VAL_ 915 ADC_FroTrkTargt0DetSensor 0 "Invalid" 1 "Radar only" 2 "Vision only" 3 "Radar+Vision" 4 "Lidar only" 5 "Lidar+Radar" 6 "Lidar+Vision" 7 "Lidar+Radar+Vision" 8 "Reserve" 9 "Reserve" 10 "Reserve" 11 "Reserve" 12 "Reserve" 13 "Reserve" 14 "Reserve" 15 "Reserve"  ;
VAL_ 915 ADC_FroTrkTargt1ObjClass 0 "Underdetemined" 1 "Car" 2 "motorcycle" 3 "truck" 4 "pedestrian" 5 "Pole(TBD)" 6 "tree(TBD)" 7 "animal(TBD)" 8 "General on-borad object(TBD)" 9 "bicycle" 10 "unidentified vehicle(TBD)" 11 "Reserved" 12 "Reserved" 13 "Reserved" 14 "Reserved" 15 "Reserved"  ;
VAL_ 915 ADC_FroTrkTargt1St 0 "not dectected" 1 "dectected"  ;
VAL_ 915 ADC_FroTrkTargt1DetSensor 0 "Invalid" 1 "Radar only" 2 "Vision only" 3 "Radar+Vision" 4 "Lidar only" 5 "Lidar+Radar" 6 "Lidar+Vision" 7 "Lidar+Radar+Vision" 8 "Reserve" 9 "Reserve" 10 "Reserve" 11 "Reserve" 12 "Reserve" 13 "Reserve" 14 "Reserve" 15 "Reserve"  ;
VAL_ 915 ADC_FroTrkTargt2ObjClass 0 "Underdetemined" 1 "Car" 2 "motorcycle" 3 "truck" 4 "pedestrian" 5 "Pole(TBD)" 6 "tree(TBD)" 7 "animal(TBD)" 8 "General on-borad object(TBD)" 9 "bicycle" 10 "unidentified vehicle(TBD)" 11 "Reserved" 12 "Reserved" 13 "Reserved" 14 "Reserved" 15 "Reserved"  ;
VAL_ 915 ADC_FroTrkTargt2St 0 "not dectected" 1 "dectected"  ;
VAL_ 915 ADC_FroTrkTargt2DetSensor 0 "Invalid" 1 "Radar only" 2 "Vision only" 3 "Radar+Vision" 4 "Lidar only" 5 "Lidar+Radar" 6 "Lidar+Vision" 7 "Lidar+Radar+Vision" 8 "Reserve" 9 "Reserve" 10 "Reserve" 11 "Reserve" 12 "Reserve" 13 "Reserve" 14 "Reserve" 15 "Reserve"  ;
VAL_ 915 ADC_FroTrkTargt3ObjClass 0 "Underdetemined" 1 "Car" 2 "motorcycle" 3 "truck" 4 "pedestrian" 5 "Pole(TBD)" 6 "tree(TBD)" 7 "animal(TBD)" 8 "General on-borad object(TBD)" 9 "bicycle" 10 "unidentified vehicle(TBD)" 11 "Reserved" 12 "Reserved" 13 "Reserved" 14 "Reserved" 15 "Reserved"  ;
VAL_ 915 ADC_FroTrkTargt3St 0 "not dectected" 1 "dectected"  ;
VAL_ 915 ADC_FroTrkTargt3DetSensor 0 "Invalid" 1 "Radar only" 2 "Vision only" 3 "Radar+Vision" 4 "Lidar only" 5 "Lidar+Radar" 6 "Lidar+Vision" 7 "Lidar+Radar+Vision" 8 "Reserve" 9 "Reserve" 10 "Reserve" 11 "Reserve" 12 "Reserve" 13 "Reserve" 14 "Reserve" 15 "Reserve"  ;
VAL_ 915 ADC_ReaTrkTargt4ObjClass 0 "Underdetemined" 1 "Car" 2 "motorcycle" 3 "truck" 4 "pedestrian" 5 "Pole(TBD)" 6 "tree(TBD)" 7 "animal(TBD)" 8 "General on-borad object(TBD)" 9 "bicycle" 10 "unidentified vehicle(TBD)" 11 "Reserved" 12 "Reserved" 13 "Reserved" 14 "Reserved" 15 "Reserved"  ;
VAL_ 915 ADC_ReaTrkTargt4St 0 "not dectected" 1 "dectected"  ;
VAL_ 915 ADC_ReaTrkTargt4DetSensor 0 "Invalid" 1 "Radar only" 2 "Vision only" 3 "Radar+Vision" 4 "Lidar only" 5 "Lidar+Radar" 6 "Lidar+Vision" 7 "Lidar+Radar+Vision" 8 "Reserve" 9 "Reserve" 10 "Reserve" 11 "Reserve" 12 "Reserve" 13 "Reserve" 14 "Reserve" 15 "Reserve"  ;
VAL_ 915 ADC_ReaTrkTargt5ObjClass 0 "Underdetemined" 1 "Car" 2 "motorcycle" 3 "truck" 4 "pedestrian" 5 "Pole(TBD)" 6 "tree(TBD)" 7 "animal(TBD)" 8 "General on-borad object(TBD)" 9 "bicycle" 10 "unidentified vehicle(TBD)" 11 "Reserved" 12 "Reserved" 13 "Reserved" 14 "Reserved" 15 "Reserved"  ;
VAL_ 915 ADC_ReaTrkTargt5St 0 "not dectected" 1 "dectected"  ;
VAL_ 915 ADC_ReaTrkTargt5DetSensor 0 "Invalid" 1 "Radar only" 2 "Vision only" 3 "Radar+Vision" 4 "Lidar only" 5 "Lidar+Radar" 6 "Lidar+Vision" 7 "Lidar+Radar+Vision" 8 "Reserve" 9 "Reserve" 10 "Reserve" 11 "Reserve" 12 "Reserve" 13 "Reserve" 14 "Reserve" 15 "Reserve"  ;
VAL_ 915 ADC_ReaTrkTargt6ObjClass 0 "Underdetemined" 1 "Car" 2 "motorcycle" 3 "truck" 4 "pedestrian" 5 "Pole(TBD)" 6 "tree(TBD)" 7 "animal(TBD)" 8 "General on-borad object(TBD)" 9 "bicycle" 10 "unidentified vehicle(TBD)" 11 "Reserved" 12 "Reserved" 13 "Reserved" 14 "Reserved" 15 "Reserved"  ;
VAL_ 915 ADC_ReaTrkTargt6St 0 "not dectected" 1 "dectected"  ;
VAL_ 915 ADC_ReaTrkTargt6DetSensor 0 "Invalid" 1 "Radar only" 2 "Vision only" 3 "Radar+Vision" 4 "Lidar only" 5 "Lidar+Radar" 6 "Lidar+Vision" 7 "Lidar+Radar+Vision" 8 "Reserve" 9 "Reserve" 10 "Reserve" 11 "Reserve" 12 "Reserve" 13 "Reserve" 14 "Reserve" 15 "Reserve"  ;
VAL_ 915 ADC_RadarPowerDownReq 0 "Not Request" 1 "Power Down" 2 "Power ON" 3 "reverse"  ;
VAL_ 915 ADC_RadarPowerDownReqVD 0 "Not valid" 1 "Valid"  ;
VAL_ 915 ADC_UPSPowerDownReq 0 "Not Request" 1 "Power Down" 2 "Power ON" 3 "reverse"  ;
VAL_ 915 ADC_UPSPowerDownReqVD 0 "Not valid" 1 "Valid"  ;
VAL_ 915 ADC_LidarPowerDownReq 0 "Not Request" 1 "Power Down" 2 "Power ON" 3 "reverse"  ;
VAL_ 915 ADC_LidarPowerDownReqVD 0 "Not valid" 1 "Valid"  ;
VAL_ 915 ADC_IFCPowerDownReq 0 "Not Request" 1 "Power Down" 2 "Power ON" 3 "reverse"  ;
VAL_ 915 ADC_IFCPowerDownReqVD 0 "Not valid" 1 "Valid"  ;
VAL_ 915 ADC_LowPowerReq 0 "Not Request" 1 "Low Power"  ;
VAL_ 915 ADC_LowPowerReqVD 0 "Not valid" 1 "Valid"  ;
