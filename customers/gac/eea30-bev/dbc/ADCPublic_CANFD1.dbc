VERSION "Version"

NS_ :

BS_:

BU_: CCU ADC FAPA IFC FLR FRR RRR RLR INU Tester CBM VIU SRS IDC PCS AMP IMR FIMR TBOX IBCS IXCU V2XOBU WHUD RLBMS CCURT2 RT2_C3 OTAWL ZCUF ZCUL ZCUR ZCUT IPS DCU NIDU RBM WACUFL IID CCURT1 RT1_C0 RT1_C1 AVAS FLLCM FRLCM RLLCMA RRLCMA RLLCMB RRLCMB LBMS LBMSAD MFS FCP IDU ITS BCB DCDC PCU EOP DCU2 BMS TMC EPS ECS CD PAS SBM WCM ETC TBOX2 DSM FLPDM FRPDM RLPDM RRPDM HVSMR SCMRL SCMRR EBU EPB VDC EVCC ADM PLGM FBLCM RLISD RRISD RCP RFR WCMFR SCMR TFOAR TROAR HVSPRL HVSPRR

BO_ 175 ADC_9: 64 ADC
 SG_ ADC_9_CRC : 7|16@0+ (1,0) [0|65535] ""  CCU,SBM
 SG_ ADC_9_Counter : 23|8@0+ (1,0) [0|255] ""  CCU,SBM
 SG_ ADC_PAAChallengeReceive : 29|1@0+ (1,0) [0|1] ""  CCU,SBM,TBOX
 SG_ PAA_TimeStampYear : 28|5@0+ (1,2020) [2020|2051] "y"  CCU,TBOX
 SG_ ADC_PAAChallenge1SBM : 39|8@0+ (1,0) [0|255] ""  CCU,IDC,SBM,TBOX
 SG_ ADC_PAAChallenge2SBM : 47|8@0+ (1,0) [0|255] ""  CCU,IDC,SBM,TBOX
 SG_ ADC_PAAChallenge1TEL : 55|8@0+ (1,0) [0|255] ""  CCU,SBM,TBOX
 SG_ ADC_PAAChallenge2TEL : 63|8@0+ (1,0) [0|255] ""  CCU,SBM,TBOX
 SG_ PAA_TimeStampMonth : 71|4@0+ (1,0) [1|12] "m"  CCU,TBOX
 SG_ PAA_TimeStampDay : 67|5@0+ (1,0) [1|31] "h"  CCU,TBOX
 SG_ PAA_TimeStampHour : 78|5@0+ (1,0) [0|23] "d"  CCU,TBOX
 SG_ PAA_TimeStampMin : 73|6@0+ (1,0) [0|59] "min"  CCU,TBOX
 SG_ PAA_TimeStampSec : 83|6@0+ (1,0) [0|59] "s"  CCU,TBOX
 SG_ PAA_TimeStampMilliSec : 93|4@0+ (100,0) [0|900] "ms"  CCU,TBOX
 SG_ PAA_DVRTriggerId : 89|5@0+ (1,0) [0|31] ""  CCU
 SG_ PAA_DVRTrigger : 100|1@0+ (1,0) [0|1] ""  CCU
 SG_ ADC_LCAEnableSt : 99|2@0+ (1,0) [0|3] ""  CCU,RLR,RRR
 SG_ ADC_APAActPushSt : 97|2@0+ (1,0) [0|3] ""  CCU
 SG_ ADC_HPALearningPathUniqueID : 111|64@0+ (1,0) [0|0] ""  CCU

BO_ 941 ADC_10: 64 ADC
 SG_ ADC_10_CRC : 7|16@0+ (1,0) [0|65535] ""  CCU,CCURT1,RT1_C1,VDC
 SG_ ADC_10_Counter : 23|8@0+ (1,0) [0|255] ""  CCU,CCURT1,RT1_C1,VDC
 SG_ PAS_APASuccNum : 31|8@0+ (1,0) [0|255] ""  CCU,SBM
 SG_ ADC_HPAStrtgEndgPointInfo : 39|5@0+ (1,0) [0|31] ""  CCU,IDC,SBM,TBOX
 SG_ ADC_HPALearningProcessInfo : 34|5@0+ (1,0) [0|31] ""  CCU,IDC,SBM,TBOX
 SG_ ADC_HPALearningFailedInfo : 45|4@0+ (1,0) [0|15] ""  CCU,IDC,SBM,TBOX
 SG_ ADC_HPALrngDst : 41|12@0+ (1,0) [0|4000] "m"  CCU,IDC,SBM,TBOX
 SG_ ADC_HPAResRouteLeg : 61|12@0+ (1,0) [0|4000] "m"  CCU,IDC,SBM,TBOX
 SG_ ADC_HPAUseActDis : 65|12@0+ (1,0) [0|4000] "m"  CCU,IDC,SBM,TBOX
 SG_ ADC_HPAProcRat : 85|7@0+ (1,0) [0|100] "%"  CCU,IDC,SBM,TBOX
 SG_ ADC_HPAUseTolTime : 94|12@0+ (1,0) [0|4095] "s"  CCU,IDC,SBM,TBOX
 SG_ ADC_ParkSlotChoiceL1 : 98|2@0+ (1,0) [0|3] ""  CCU,IDC,SBM,TBOX
 SG_ ADC_IconTwinkle : 96|1@0+ (1,0) [0|1] ""  CCU,IDC,SBM,TBOX
 SG_ ADC_ParkSlotChoiceR1 : 111|2@0+ (1,0) [0|3] ""  CCU,IDC,SBM,TBOX
 SG_ ADC_ParkSlotChoiceL2 : 109|2@0+ (1,0) [0|3] ""  CCU,IDC,SBM,TBOX
 SG_ ADC_ParkSlotChoiceR2 : 107|2@0+ (1,0) [0|3] ""  CCU,IDC,SBM,TBOX
 SG_ ADC_ParkSlotChoiceL3 : 105|2@0+ (1,0) [0|3] ""  CCU,IDC,SBM,TBOX
 SG_ ADC_ParkSlotChoiceR3 : 119|2@0+ (1,0) [0|3] ""  CCU,IDC,SBM,TBOX
 SG_ ADC_ParkSlotChoiceL4 : 117|2@0+ (1,0) [0|3] ""  CCU,IDC,SBM,TBOX
 SG_ ADC_ParkSlotChoiceR4 : 115|2@0+ (1,0) [0|3] ""  CCU,IDC,SBM,TBOX
 SG_ ADC_ParkSlotChoiceL5 : 113|2@0+ (1,0) [0|3] ""  CCU,IDC,SBM,TBOX
 SG_ ADC_ParkSlotChoiceR5 : 127|2@0+ (1,0) [0|3] ""  CCU,IDC,SBM,TBOX
 SG_ ADC_ParkSlotChoiceL6 : 125|2@0+ (1,0) [0|3] ""  CCU,IDC,SBM,TBOX
 SG_ ADC_ParkSlotChoiceR6 : 123|2@0+ (1,0) [0|3] ""  CCU,IDC,SBM,TBOX
 SG_ ADC_ParkSlotChoiceL7 : 121|2@0+ (1,0) [0|3] ""  CCU,IDC,SBM,TBOX
 SG_ ADC_ParkSlotChoiceR7 : 135|2@0+ (1,0) [0|3] ""  CCU,IDC,SBM,TBOX
 SG_ ADC_ParkSlotChoiceL8 : 133|2@0+ (1,0) [0|3] ""  CCU,IDC,SBM,TBOX
 SG_ ADC_ParkSlotChoiceR8 : 131|2@0+ (1,0) [0|3] ""  CCU,IDC,SBM,TBOX
 SG_ ADC_SlotSelectFebk : 129|5@0+ (1,0) [0|31] ""  CCU,IDC,SBM,TBOX
 SG_ ADC_AVPParkSlotInfo : 140|10@0+ (1,0) [0|1023] "cm"  CCU,IDC,SBM,TBOX
 SG_ ADC_SwitchStShow : 146|2@0+ (1,0) [0|3] ""  CCU,IDC,SBM,TBOX
 SG_ FAPA_RPAShortPresSuppSt : 144|1@0+ (1,0) [0|1] ""  CCU,IDC,SBM,TBOX
 SG_ ADC_HPASwitchStShow : 159|2@0+ (1,0) [0|3] ""  CCU,IDC,SBM,TBOX
 SG_ ADC_AVPSwitchStShow : 157|2@0+ (1,0) [0|3] ""  CCU,IDC,SBM,TBOX
 SG_ ADC_HPALearningPathType1 : 155|2@0+ (1,0) [0|3] ""  CCU,IDC,SBM,TBOX
 SG_ ADC_HPALearningLotType1 : 153|2@0+ (1,0) [0|3] ""  CCU,IDC,SBM,TBOX
 SG_ ADC_HPALearningPathNum1 : 167|4@0+ (1,0) [0|15] ""  CCU,IDC,SBM,TBOX
 SG_ ADC_HPAPathLearnRate1 : 163|4@0+ (10,0) [0|90] "%"  CCU,IDC,SBM,TBOX
 SG_ ADC_HPAPathSt1 : 175|2@0+ (1,0) [0|3] ""  CCU,IDC,SBM,TBOX
 SG_ ADC_HPAPath1Src : 173|2@0+ (1,0) [0|3] ""  CCU,IDC,SBM,TBOX
 SG_ ADC_HPAPathDst1 : 171|12@0+ (1,0) [0|4000] "m"  CCU,IDC,SBM,TBOX
 SG_ ADC_HPALearningPathNum2 : 191|4@0+ (1,0) [0|15] ""  CCU,IDC,SBM,TBOX
 SG_ ADC_HPAHAVPPathLearnRate2 : 187|4@0+ (10,0) [0|90] "%"  CCU,IDC,SBM,TBOX
 SG_ ADC_HPALearningPathType2 : 199|2@0+ (1,0) [0|3] ""  CCU,IDC,SBM,TBOX
 SG_ ADC_HPALearningLotType2 : 197|2@0+ (1,0) [0|3] ""  CCU,IDC,SBM,TBOX
 SG_ ADC_HPAPathSt2 : 195|2@0+ (1,0) [0|3] ""  CCU,IDC,SBM,TBOX
 SG_ ADC_HPAPath2Src : 193|2@0+ (1,0) [0|3] ""  CCU,IDC,SBM,TBOX
 SG_ ADC_HPAPathDst2 : 207|12@0+ (1,0) [0|4000] "m"  CCU,IDC,SBM,TBOX
 SG_ ADC_HPAPath1MatGpsSucces : 211|1@0+ (1,0) [0|1] ""  CCU,IDC,SBM,TBOX
 SG_ ADC_HPAPath2MatGpsSucces : 210|1@0+ (1,0) [0|1] ""  CCU,IDC,SBM,TBOX
 SG_ ADC_HPALearningPathType3 : 209|2@0+ (1,0) [0|3] ""  CCU,IDC,SBM,TBOX
 SG_ ADC_HPALearningPathNum3 : 223|4@0+ (1,0) [0|15] ""  CCU,IDC,SBM,TBOX
 SG_ ADC_HPAPathLearnRate3 : 219|4@0+ (10,0) [0|90] "%"  CCU,IDC,SBM,TBOX
 SG_ ADC_HPALearningLotType3 : 231|2@0+ (1,0) [0|3] ""  CCU,IDC,SBM,TBOX
 SG_ ADC_HPAPathSt3 : 229|2@0+ (1,0) [0|3] ""  CCU,IDC,SBM,TBOX
 SG_ ADC_HPAPath3Src : 227|2@0+ (1,0) [0|3] ""  CCU,IDC,SBM,TBOX
 SG_ ADC_HPAPathDst3 : 225|12@0+ (1,0) [0|4000] "m"  CCU,IDC,SBM,TBOX
 SG_ ADC_HPALearningPathNum4 : 245|4@0+ (1,0) [0|15] ""  CCU,IDC,SBM,TBOX
 SG_ ADC_HPAPathLearnRate4 : 241|4@0+ (10,0) [0|90] "%"  CCU,IDC,SBM,TBOX
 SG_ ADC_HPALearningPathType4 : 253|2@0+ (1,0) [0|3] ""  CCU,IDC,SBM,TBOX
 SG_ ADC_HPALearningLotType4 : 251|2@0+ (1,0) [0|3] ""  CCU,IDC,SBM,TBOX
 SG_ ADC_HPAPathSt4 : 249|2@0+ (1,0) [0|3] ""  CCU,IDC,SBM,TBOX
 SG_ ADC_HPAPath4Src : 263|2@0+ (1,0) [0|3] ""  CCU,IDC,SBM,TBOX
 SG_ ADC_HPAPathDst4 : 261|12@0+ (1,0) [0|4000] "m"  CCU,IDC,SBM,TBOX
 SG_ ADC_HPAPath3MatGpsSucces : 265|1@0+ (1,0) [0|1] ""  CCU,IDC,SBM,TBOX
 SG_ ADC_HPAPath4MatGpsSucces : 264|1@0+ (1,0) [0|1] ""  CCU,IDC,SBM,TBOX
 SG_ ADC_HPALearningPathNum5 : 279|4@0+ (1,0) [0|15] ""  CCU,IDC,SBM,TBOX
 SG_ ADC_HPAPathLearnRate5 : 275|4@0+ (10,0) [0|90] "%"  CCU,IDC,SBM,TBOX
 SG_ ADC_HPALearningPathType5 : 287|2@0+ (1,0) [0|3] ""  CCU,IDC,SBM,TBOX
 SG_ ADC_HPALearningLotType5 : 285|2@0+ (1,0) [0|3] ""  CCU,IDC,SBM,TBOX
 SG_ ADC_HPAPathSt5 : 283|2@0+ (1,0) [0|3] ""  CCU,IDC,SBM,TBOX
 SG_ ADC_HPAPath5Src : 281|2@0+ (1,0) [0|3] ""  CCU,IDC,SBM,TBOX
 SG_ ADC_HPAPathDst5 : 295|12@0+ (1,0) [0|4000] "m"  CCU,IDC,SBM,TBOX
 SG_ ADC_HPALearningPathNum6 : 299|4@0+ (1,0) [0|15] ""  CCU,IDC,SBM,TBOX
 SG_ ADC_HPAPathLearnRate6 : 311|4@0+ (10,0) [0|90] "%"  CCU,IDC,SBM,TBOX
 SG_ ADC_HPALearningPathType6 : 307|2@0+ (1,0) [0|3] ""  CCU,IDC,SBM,TBOX
 SG_ ADC_HPALearningLotType6 : 305|2@0+ (1,0) [0|3] ""  CCU,IDC,SBM,TBOX
 SG_ ADC_HPAPathSt6 : 319|2@0+ (1,0) [0|3] ""  CCU,IDC,SBM,TBOX
 SG_ ADC_HPAPath6Src : 317|2@0+ (1,0) [0|3] ""  CCU,IDC,SBM,TBOX
 SG_ ADC_HPAPathDst6 : 315|12@0+ (1,0) [0|4000] "m"  CCU,IDC,SBM,TBOX
 SG_ ADC_HPAPath5MatGpsSucces : 335|1@0+ (1,0) [0|1] ""  CCU,IDC,SBM,TBOX
 SG_ ADC_HPAPath6MatGpsSucces : 334|1@0+ (1,0) [0|1] ""  CCU,IDC,SBM,TBOX
 SG_ ADC_HPALearningPathNum7 : 333|4@0+ (1,0) [0|15] ""  CCU,IDC,SBM,TBOX
 SG_ ADC_HPAPathLearnRate7 : 329|4@0+ (10,0) [0|90] "%"  CCU,IDC,SBM,TBOX
 SG_ ADC_HPALearningPathType7 : 341|2@0+ (1,0) [0|3] ""  CCU,IDC,SBM,TBOX
 SG_ ADC_HPALearningLotType7 : 339|2@0+ (1,0) [0|3] ""  CCU,IDC,SBM,TBOX
 SG_ ADC_HPAPathSt7 : 337|2@0+ (1,0) [0|3] ""  CCU,IDC,SBM,TBOX
 SG_ ADC_HPAPath7Src : 351|2@0+ (1,0) [0|3] ""  CCU,IDC,SBM,TBOX
 SG_ ADC_HPAPathDst7 : 349|12@0+ (1,0) [0|4000] "m"  CCU,IDC,SBM,TBOX
 SG_ ADC_HPALearningPathNum8 : 353|4@0+ (1,0) [0|15] ""  CCU,IDC,SBM,TBOX
 SG_ ADC_HPAPathLearnRate8 : 365|4@0+ (10,0) [0|90] "%"  CCU,IDC,SBM,TBOX
 SG_ ADC_HPALearningPathType8 : 361|2@0+ (1,0) [0|3] ""  CCU,IDC,SBM,TBOX
 SG_ ADC_HPALearningLotType8 : 375|2@0+ (1,0) [0|3] ""  CCU,IDC,SBM,TBOX
 SG_ ADC_HPAPPathSt8 : 373|2@0+ (1,0) [0|3] ""  CCU,IDC,SBM,TBOX
 SG_ ADC_HPAPath8Src : 371|2@0+ (1,0) [0|3] ""  CCU,IDC,SBM,TBOX
 SG_ ADC_HPAPathDst8 : 369|12@0+ (1,0) [0|4000] "m"  CCU,IDC,SBM,TBOX
 SG_ ADC_HPAPath7MatGpsSucces : 389|1@0+ (1,0) [0|1] ""  CCU,IDC,SBM,TBOX
 SG_ ADC_HPAPath8MatGpsSucces : 388|1@0+ (1,0) [0|1] ""  CCU,IDC,SBM,TBOX
 SG_ ADC_HPALearningPathNum9 : 387|4@0+ (1,0) [0|15] ""  CCU,IDC,SBM,TBOX
 SG_ ADC_HPAPathLearnRate9 : 399|4@0+ (10,0) [0|90] "%"  CCU,IDC,SBM,TBOX
 SG_ ADC_HPALearningPathType9 : 395|2@0+ (1,0) [0|3] ""  CCU,IDC,SBM,TBOX
 SG_ ADC_HPALearningLotType9 : 393|2@0+ (1,0) [0|3] ""  CCU,IDC,SBM,TBOX
 SG_ ADC_HPAPathSt9 : 407|2@0+ (1,0) [0|3] ""  CCU,IDC,SBM,TBOX
 SG_ ADC_HPAPath9Src : 405|2@0+ (1,0) [0|3] ""  CCU,IDC,SBM,TBOX
 SG_ ADC_HPAPathDst9 : 403|12@0+ (1,0) [0|4000] "m"  CCU,IDC,SBM,TBOX
 SG_ ADC_HPALearningPathNum10 : 423|4@0+ (1,0) [0|15] ""  CCU,IDC,SBM,TBOX
 SG_ ADC_HPAPathLearnRate10 : 419|4@0+ (10,0) [0|90] "%"  CCU,IDC,SBM,TBOX
 SG_ ADC_HPALearningPathType10 : 431|2@0+ (1,0) [0|3] ""  CCU,IDC,SBM,TBOX
 SG_ ADC_HPALearningLotType10 : 429|2@0+ (1,0) [0|3] ""  CCU,IDC,SBM,TBOX
 SG_ ADC_HPAPathSt10 : 427|2@0+ (1,0) [0|3] ""  CCU,IDC,SBM,TBOX
 SG_ ADC_HPAPath10Src : 425|2@0+ (1,0) [0|3] ""  CCU,IDC,SBM,TBOX
 SG_ ADC_HPAPathDst10 : 439|12@0+ (1,0) [0|4000] "m"  CCU,IDC,SBM,TBOX
 SG_ ADC_HPAPath9MatGpsSucces : 443|1@0+ (1,0) [0|1] ""  CCU,IDC,SBM,TBOX
 SG_ ADC_HPAPath10MatGpsSucces : 442|1@0+ (1,0) [0|1] ""  CCU,IDC,SBM,TBOX
 SG_ ADC_LowPowerfeedback : 455|3@0+ (1,0) [0|7] ""  CCU,CCURT1,RT1_C1,VDC,IDC
 SG_ ADC_APAParkingSpdSt : 452|2@0+ (1,0) [0|3] ""  CCU,IDC
 SG_ ADC_HPAParkingSpdSt : 450|2@0+ (1,0) [0|3] ""  CCU,IDC
 SG_ PCS_APAParkingReady : 463|2@0+ (1,0) [0|3] ""  CCU,IDC

BO_ 835 ADC_11: 64 ADC
 SG_ ADC_11_CRC : 7|16@0+ (1,0) [0|65535] ""  CCU,ZCUR,SBM
 SG_ ADC_11_Counter : 23|8@0+ (1,0) [0|255] ""  CCU,ZCUR,SBM
 SG_ PAS_SystemType : 31|2@0+ (1,0) [0|3] ""  CCU,ZCUR,IDC,PCS,SBM
 SG_ PAS_WarnTone : 29|4@0+ (1,0) [0|15] ""  CCU,ZCUR,IDC,PCS,SBM
 SG_ PAS_ButtonPress : 25|1@0+ (1,0) [0|1] ""  CCU,ZCUR,IDC,PCS,SBM
 SG_ PAS_SideZoneStatusF : 39|2@0+ (1,0) [0|3] ""  CCU,ZCUR,IDC,PCS,SBM
 SG_ PAS_SideZoneStatusR : 37|2@0+ (1,0) [0|3] ""  CCU,ZCUR,IDC,PCS,SBM
 SG_ PAS_RRMidDistance : 47|8@0+ (1,0) [0|255] "cm"  CCU,ZCUR,IDC,PCS,SBM
 SG_ PAS_RLMidDistance : 55|8@0+ (1,0) [0|255] "cm"  CCU,ZCUR,IDC,PCS,SBM
 SG_ PAS_RRDistance : 63|8@0+ (1,0) [0|255] "cm"  CCU,ZCUR,IDC,PCS,SBM
 SG_ PAS_RLDistance : 71|8@0+ (1,0) [0|255] "cm"  CCU,ZCUR,IDC,PCS,SBM
 SG_ PAS_RSLSideDistance : 79|8@0+ (1,0) [0|255] "cm"  CCU,ZCUR,IDC,PCS,SBM
 SG_ PAS_RSRSideDistance : 87|8@0+ (1,0) [0|255] "cm"  CCU,ZCUR,IDC,PCS,SBM
 SG_ PAS_FRDistance : 95|8@0+ (1,0) [0|255] "cm"  CCU,ZCUR,IDC,PCS,SBM
 SG_ PAS_FLDistance : 103|8@0+ (1,0) [0|255] "cm"  CCU,ZCUR,IDC,PCS,SBM
 SG_ PAS_FRMidDistance : 111|8@0+ (1,0) [0|255] "cm"  CCU,ZCUR,IDC,PCS,SBM
 SG_ PAS_FLMidDistance : 119|8@0+ (1,0) [0|255] "cm"  CCU,ZCUR,IDC,PCS,SBM
 SG_ PAS_FSRSideDistance : 127|8@0+ (1,0) [0|255] "cm"  CCU,ZCUR,IDC,PCS,SBM
 SG_ PAS_FSLSideDistance : 135|8@0+ (1,0) [0|255] "cm"  CCU,ZCUR,IDC,PCS,SBM
 SG_ PAS_Mode : 143|4@0+ (1,0) [0|15] ""  CCU,ZCUR,IDC,PCS,SBM
 SG_ PAS_RRMidSnsErrFlag : 139|1@0+ (1,0) [0|1] ""  CCU,IDC,PCS
 SG_ PAS_RLMidSnsErrFlag : 138|1@0+ (1,0) [0|1] ""  CCU,IDC,PCS
 SG_ PAS_RRSnsErrFlag : 137|1@0+ (1,0) [0|1] ""  CCU,IDC,PCS
 SG_ PAS_RLSnsErrFlag : 136|1@0+ (1,0) [0|1] ""  CCU,IDC,PCS
 SG_ PAS_RSLSnsErrFlag : 151|1@0+ (1,0) [0|1] ""  CCU,IDC,PCS
 SG_ PAS_RSRSnsErrFlag : 150|1@0+ (1,0) [0|1] ""  CCU,IDC,PCS
 SG_ PAS_FRSnsErrFlag : 149|1@0+ (1,0) [0|1] ""  CCU,IDC,PCS
 SG_ PAS_FLSnsErrFlag : 148|1@0+ (1,0) [0|1] ""  CCU,IDC,PCS
 SG_ PAS_FRMidSnsErrFlag : 147|1@0+ (1,0) [0|1] ""  CCU,IDC,PCS
 SG_ PAS_FLMidSnsErrFlag : 146|1@0+ (1,0) [0|1] ""  CCU,IDC,PCS
 SG_ PAS_FSLSnsErrFlag : 145|1@0+ (1,0) [0|1] ""  CCU,IDC,PCS
 SG_ PAS_FSRSnsErrFlag : 144|1@0+ (1,0) [0|1] ""  CCU,IDC,PCS
 SG_ PAS_RRMidDislv : 33|2@0+ (1,0) [0|3] ""  CCU
 SG_ PAS_RLMidDislv : 35|2@0+ (1,0) [0|3] ""  CCU
 SG_ PAS_RRDislv : 289|2@0+ (1,0) [0|3] ""  CCU
 SG_ PAS_RLDislv : 291|2@0+ (1,0) [0|3] ""  CCU
 SG_ PAS_RSLSideDislv : 293|2@0+ (1,0) [0|3] ""  CCU
 SG_ PAS_RSRSideDislv : 295|2@0+ (1,0) [0|3] ""  CCU
 SG_ PAS_FRDislv : 303|2@0+ (1,0) [0|3] ""  CCU
 SG_ PAS_FLDislv : 306|2@0+ (1,0) [0|3] ""  CCU
 SG_ PAS_FRMidDislv : 308|2@0+ (1,0) [0|3] ""  CCU
 SG_ PAS_FLMidDislv : 314|2@0+ (1,0) [0|3] ""  CCU
 SG_ PAS_FSRSideDislv : 330|2@0+ (1,0) [0|3] ""  CCU
 SG_ PAS_FSLSideDislv : 332|2@0+ (1,0) [0|3] ""  CCU
 SG_ PAS_CtrlModulerrFlag : 159|1@0+ (1,0) [0|1] ""  CCU,IDC,PCS
 SG_ PAS_BattVoltErrFlag : 158|1@0+ (1,0) [0|1] ""  CCU,IDC,PCS
 SG_ ADC_IDC_DisplayReq : 157|5@0+ (1,0) [0|31] ""  CCU,IDC
 SG_ ADC_PAAShortPresSuppSt : 199|1@0+ (1,0) [0|1] ""  CCU,ZCUR,SBM
 SG_ ADC_PAACtrlSigSrc : 198|2@0+ (1,0) [0|3] ""  CCU,ZCUR,SBM
 SG_ ADC_UsageModeRequstResult : 196|4@0+ (1,0) [0|15] ""  CCU,ZCUR,SBM
 SG_ ADC_ACU_DisplayReq : 192|1@0+ (1,0) [0|1] ""  CCU,IDC
 SG_ ADC_DPMessagePushSt : 221|2@0+ (1,0) [0|3] ""  CCU,IDC
 SG_ PCS_SystemSt : 263|1@0+ (1,0) [0|1] ""  CCU,ZCUR,IDC,SBM
 SG_ PCS_FrontLeftCameraFail : 262|1@0+ (1,0) [0|1] ""  CCU,ZCUR,IDC,SBM
 SG_ PCS_FrontRightCameraFail : 261|1@0+ (1,0) [0|1] ""  CCU,ZCUR,IDC,SBM
 SG_ PCS_EventRecordSt : 260|1@0+ (1,0) [0|1] ""  CCU,ZCUR,IDC,SBM
 SG_ PCS_HMIIndex : 259|4@0+ (1,0) [0|15] ""  CCU,ZCUR,IDC,SBM
 SG_ PCS_SingleViewInd : 271|4@0+ (1,0) [0|15] ""  CCU,ZCUR,IDC,SBM
 SG_ PCS_VoiceReq : 267|4@0+ (1,0) [0|15] ""  CCU,ZCUR,IDC,SBM
 SG_ PCS_LeftBlindSpotViewSt : 279|1@0+ (1,0) [0|1] ""  CCU,ZCUR,IDC,SBM
 SG_ PCS_RightBlindSpotViewSt : 278|1@0+ (1,0) [0|1] ""  CCU,ZCUR,IDC,SBM
 SG_ PCS_ReturnSt : 277|1@0+ (1,0) [0|1] ""  CCU,ZCUR,IDC,SBM
 SG_ PCS_HelpMenuSt : 276|1@0+ (1,0) [0|1] ""  CCU,ZCUR,IDC,SBM
 SG_ PCS_SoundReminderSt : 275|1@0+ (1,0) [0|1] ""  CCU,ZCUR,IDC,SBM
 SG_ PCS_ER_EnterConfirm : 274|1@0+ (1,0) [0|1] ""  CCU,ZCUR,IDC,SBM
 SG_ PCS_MirrorPageDownButton : 273|2@0+ (1,0) [0|3] ""  CCU,ZCUR,IDC,SBM
 SG_ PCS_ER_QuitReq : 287|1@0+ (1,0) [0|1] ""  CCU,ZCUR,IDC,SBM
 SG_ PCS_PASButtonPress : 286|1@0+ (1,0) [0|1] ""  CCU,IDC
 SG_ PCS_VRSwitchFailSt : 285|1@0+ (1,0) [0|1] ""  CCU,IDC
 SG_ PCS_FrontCameraFail : 284|1@0+ (1,0) [0|1] ""  CCU,IDC
 SG_ PCS_LeftCameraFail : 283|1@0+ (1,0) [0|1] ""  CCU,IDC
 SG_ PCS_RightCameraFail : 282|1@0+ (1,0) [0|1] ""  CCU,IDC
 SG_ PCS_RearCameraFail : 281|1@0+ (1,0) [0|1] ""  CCU,IDC
 SG_ PCS_ACU_DisplayReq : 280|1@0+ (1,0) [0|1] ""  CCU,IDC
 SG_ PCS_CalibrateSt : 311|3@0+ (1,0) [0|7] ""  CCU,IDC
 SG_ PCS_MODEnalbe : 304|1@0+ (1,0) [0|1] ""  CCU,IDC
 SG_ PCS_3DEnalbe : 319|1@0+ (1,0) [0|1] ""  CCU,IDC
 SG_ PCS_SystemType : 318|2@0+ (1,0) [0|3] ""  CCU,IDC
 SG_ PCS_OperationSt : 316|2@0+ (1,0) [0|3] ""  CCU,IDC
 SG_ DMS_FaceID_ADC : 327|4@0+ (1,0) [0|15] ""  CCU,IDC
 SG_ DMS_SysErrSt_ADC : 323|3@0+ (1,0) [0|7] ""  CCU,IDC
 SG_ OMS_SysErrSt_ADC : 335|3@0+ (1,0) [0|7] ""  CCU,IDC

CM_ SG_ 175 ADC_9_CRC "E2E Profile 5 CRC";
CM_ SG_ 175 ADC_9_Counter "E2E Profile 5 Counter";
CM_ SG_ 175 ADC_PAAChallengeReceive "PAA Receive Challenge Singal";
CM_ SG_ 175 PAA_TimeStampYear "Time Stamp Year number";
CM_ SG_ 175 ADC_PAAChallenge1SBM "RPA Challenge SBM Singal1";
CM_ SG_ 175 ADC_PAAChallenge2SBM "RPA Challenge SBM Singal2";
CM_ SG_ 175 ADC_PAAChallenge1TEL "Challenge SBM Singal1";
CM_ SG_ 175 ADC_PAAChallenge2TEL "Challenge SBM Singal2";
CM_ SG_ 175 PAA_TimeStampMonth "Time Stamp Month number";
CM_ SG_ 175 PAA_TimeStampDay "Time Stamp Day number";
CM_ SG_ 175 PAA_TimeStampHour "Time Stamp Hour number";
CM_ SG_ 175 PAA_TimeStampMin "Time Stamp Minute number";
CM_ SG_ 175 PAA_TimeStampSec "Time Stamp Second number";
CM_ SG_ 175 PAA_TimeStampMilliSec "Time Stamp Millisecond number";
CM_ SG_ 175 PAA_DVRTriggerId "Indicate PAA DVR  event type";
CM_ SG_ 175 PAA_DVRTrigger "PAA DVR Trigger Status";
CM_ SG_ 175 ADC_LCAEnableSt "LCA button Status";
CM_ SG_ 175 ADC_APAActPushSt "Push APA sensless entry parking";
CM_ SG_ 175 ADC_HPALearningPathUniqueID "The unique ID of the learning path";
CM_ SG_ 941 ADC_10_CRC "E2E Profile 5 CRC";
CM_ SG_ 941 ADC_10_Counter "E2E Profile 5 Counter";
CM_ SG_ 941 PAS_APASuccNum "PAS APA Succ Num";
CM_ SG_ 941 ADC_HPAStrtgEndgPointInfo "This signal indicates the reasons for invalid starting and ending point";
CM_ SG_ 941 ADC_HPALearningProcessInfo "AVP controller will send this singal to show indications through HU to driver during learning process.";
CM_ SG_ 941 ADC_HPALearningFailedInfo "Learning failed reasons for HAVP learning results.";
CM_ SG_ 941 ADC_HPALrngDst "Learning distance calculated by AVP controller";
CM_ SG_ 941 ADC_HPAResRouteLeg "HAVP Residual route length";
CM_ SG_ 941 ADC_HPAUseActDis "HAVP Use the actual distance";
CM_ SG_ 941 ADC_HPAProcRat "HAVP drving process ratio";
CM_ SG_ 941 ADC_HPAUseTolTime "HAVP Total time of route use";
CM_ SG_ 941 ADC_ParkSlotChoiceL1 "Left No.1 Slot Type";
CM_ SG_ 941 ADC_IconTwinkle "APA Twinkle Remind";
CM_ SG_ 941 ADC_ParkSlotChoiceR1 "Right No.1 Slot Type";
CM_ SG_ 941 ADC_ParkSlotChoiceL2 "Left No.2 Slot Type";
CM_ SG_ 941 ADC_ParkSlotChoiceR2 "Right No.2 Slot Type";
CM_ SG_ 941 ADC_ParkSlotChoiceL3 "Left No.3 Slot Type";
CM_ SG_ 941 ADC_ParkSlotChoiceR3 "Right No.3 Slot Type";
CM_ SG_ 941 ADC_ParkSlotChoiceL4 "Left No.4 Slot Type";
CM_ SG_ 941 ADC_ParkSlotChoiceR4 "Right No.4 Slot Type";
CM_ SG_ 941 ADC_ParkSlotChoiceL5 "Left No.5 Slot Type";
CM_ SG_ 941 ADC_ParkSlotChoiceR5 "Right No.5 Slot Type";
CM_ SG_ 941 ADC_ParkSlotChoiceL6 "Left No.6 Slot Type";
CM_ SG_ 941 ADC_ParkSlotChoiceR6 "Right No.6 Slot Type";
CM_ SG_ 941 ADC_ParkSlotChoiceL7 "Left No.7 Slot Type";
CM_ SG_ 941 ADC_ParkSlotChoiceR7 "Right No.7 Slot Type";
CM_ SG_ 941 ADC_ParkSlotChoiceL8 "Left No.8 Slot Type";
CM_ SG_ 941 ADC_ParkSlotChoiceR8 "Right No.8 Slot Type";
CM_ SG_ 941 ADC_SlotSelectFebk "APA Slot Select Feedback";
CM_ SG_ 941 ADC_AVPParkSlotInfo "AVP Slot's Length or Width";
CM_ SG_ 941 ADC_SwitchStShow "APA Switch status Show";
CM_ SG_ 941 FAPA_RPAShortPresSuppSt "RPA short press support status";
CM_ SG_ 941 ADC_HPASwitchStShow "HAVP Switch status Show ";
CM_ SG_ 941 ADC_AVPSwitchStShow "PAVP Switch status Show ";
CM_ SG_ 941 ADC_HPALearningPathType1 "Path type for path 1,0x0 represents invalid path";
CM_ SG_ 941 ADC_HPALearningLotType1 "Lot type for path 1,0x0 represents invalid path";
CM_ SG_ 941 ADC_HPALearningPathNum1 "Path number 1,0x0 represents invalid path";
CM_ SG_ 941 ADC_HPAPathLearnRate1 "Learnrate for path1";
CM_ SG_ 941 ADC_HPAPathSt1 "Status for path1";
CM_ SG_ 941 ADC_HPAPath1Src "Path number 1 is Learn or share";
CM_ SG_ 941 ADC_HPAPathDst1 "Learned path1 distance";
CM_ SG_ 941 ADC_HPALearningPathNum2 "Path number 2,0x0 represents invalid path";
CM_ SG_ 941 ADC_HPAHAVPPathLearnRate2 "Learnrate for path2";
CM_ SG_ 941 ADC_HPALearningPathType2 "Path type for path 2,0x0 represents invalid path";
CM_ SG_ 941 ADC_HPALearningLotType2 "Lot type for path 2,0x0 represents invalid path";
CM_ SG_ 941 ADC_HPAPathSt2 "Status for path2";
CM_ SG_ 941 ADC_HPAPath2Src "Path number 2 is Learn or share";
CM_ SG_ 941 ADC_HPAPathDst2 "Learned path2 distance";
CM_ SG_ 941 ADC_HPAPath1MatGpsSucces "The Path matches the geofence successfully";
CM_ SG_ 941 ADC_HPAPath2MatGpsSucces "The Path matches the geofence successfully";
CM_ SG_ 941 ADC_HPALearningPathType3 "Path type for path 3,0x0 represents invalid path";
CM_ SG_ 941 ADC_HPALearningPathNum3 "Path number 3,0x0 represents invalid path";
CM_ SG_ 941 ADC_HPAPathLearnRate3 "Learnrate for path3";
CM_ SG_ 941 ADC_HPALearningLotType3 "Lot type for path 3,0x0 represents invalid path";
CM_ SG_ 941 ADC_HPAPathSt3 "Status for path3";
CM_ SG_ 941 ADC_HPAPath3Src "Path number 3 is Learn or share";
CM_ SG_ 941 ADC_HPAPathDst3 "Learned path3 distance";
CM_ SG_ 941 ADC_HPALearningPathNum4 "Path number 4,0x0 represents invalid path";
CM_ SG_ 941 ADC_HPAPathLearnRate4 "Learnrate for path4";
CM_ SG_ 941 ADC_HPALearningPathType4 "Path type for path 4,0x0 represents invalid path";
CM_ SG_ 941 ADC_HPALearningLotType4 "Lot type for path 4,0x0 represents invalid path";
CM_ SG_ 941 ADC_HPAPathSt4 "Status for path4";
CM_ SG_ 941 ADC_HPAPath4Src "Path number 4 is Learn or share";
CM_ SG_ 941 ADC_HPAPathDst4 "Learned path4 distance";
CM_ SG_ 941 ADC_HPAPath3MatGpsSucces "The Path matches the geofence successfully";
CM_ SG_ 941 ADC_HPAPath4MatGpsSucces "The Path matches the geofence successfully";
CM_ SG_ 941 ADC_HPALearningPathNum5 "Path number 5,0x0 represents invalid path";
CM_ SG_ 941 ADC_HPAPathLearnRate5 "Learnrate for path5";
CM_ SG_ 941 ADC_HPALearningPathType5 "Path type for path 5,0x0 represents invalid path";
CM_ SG_ 941 ADC_HPALearningLotType5 "Lot type for path 5,0x0 represents invalid path";
CM_ SG_ 941 ADC_HPAPathSt5 "Status for path5";
CM_ SG_ 941 ADC_HPAPath5Src "Path number 5 is Learn or share";
CM_ SG_ 941 ADC_HPAPathDst5 "Learned path5 distance";
CM_ SG_ 941 ADC_HPALearningPathNum6 "Path number 6,0x0 represents invalid path";
CM_ SG_ 941 ADC_HPAPathLearnRate6 "Learnrate for path6";
CM_ SG_ 941 ADC_HPALearningPathType6 "Path type for path 6,0x0 represents invalid path";
CM_ SG_ 941 ADC_HPALearningLotType6 "Lot type for path 6,0x0 represents invalid path";
CM_ SG_ 941 ADC_HPAPathSt6 "Status for path6";
CM_ SG_ 941 ADC_HPAPath6Src "Path number 6 is Learn or share";
CM_ SG_ 941 ADC_HPAPathDst6 "Learned path6 distance";
CM_ SG_ 941 ADC_HPAPath5MatGpsSucces "The Path matches the geofence successfully";
CM_ SG_ 941 ADC_HPAPath6MatGpsSucces "The Path matches the geofence successfully";
CM_ SG_ 941 ADC_HPALearningPathNum7 "Path number 7,0x0 represents invalid path";
CM_ SG_ 941 ADC_HPAPathLearnRate7 "Learnrate for path7";
CM_ SG_ 941 ADC_HPALearningPathType7 "Path type for path 7,0x0 represents invalid path";
CM_ SG_ 941 ADC_HPALearningLotType7 "Lot type for path 7,0x0 represents invalid path";
CM_ SG_ 941 ADC_HPAPathSt7 "Status for path7";
CM_ SG_ 941 ADC_HPAPath7Src "Path number 7 is Learn or share";
CM_ SG_ 941 ADC_HPAPathDst7 "Learned path7 distance";
CM_ SG_ 941 ADC_HPALearningPathNum8 "Path number 8,0x0 represents invalid path";
CM_ SG_ 941 ADC_HPAPathLearnRate8 "Learnrate for path8";
CM_ SG_ 941 ADC_HPALearningPathType8 "Path type for path 8,0x0 represents invalid path";
CM_ SG_ 941 ADC_HPALearningLotType8 "Lot type for path 8,0x0 represents invalid path";
CM_ SG_ 941 ADC_HPAPPathSt8 "Status for path8";
CM_ SG_ 941 ADC_HPAPath8Src "Path number 8 is Learn or share";
CM_ SG_ 941 ADC_HPAPathDst8 "Learned path8 distance";
CM_ SG_ 941 ADC_HPAPath7MatGpsSucces "The Path matches the geofence successfully";
CM_ SG_ 941 ADC_HPAPath8MatGpsSucces "The Path matches the geofence successfully";
CM_ SG_ 941 ADC_HPALearningPathNum9 "Path number 9,0x0 represents invalid path";
CM_ SG_ 941 ADC_HPAPathLearnRate9 "Learnrate for path9";
CM_ SG_ 941 ADC_HPALearningPathType9 "Path type for path 9,0x0 represents invalid path";
CM_ SG_ 941 ADC_HPALearningLotType9 "Lot type for path 9,0x0 represents invalid path";
CM_ SG_ 941 ADC_HPAPathSt9 "Status for path9";
CM_ SG_ 941 ADC_HPAPath9Src "Path number 9 is Learn or share";
CM_ SG_ 941 ADC_HPAPathDst9 "Learned path9 distance";
CM_ SG_ 941 ADC_HPALearningPathNum10 "Path number 10,0x0 represents invalid path";
CM_ SG_ 941 ADC_HPAPathLearnRate10 "Learnrate for path10";
CM_ SG_ 941 ADC_HPALearningPathType10 "Path type for path 10,0x0 represents invalid path";
CM_ SG_ 941 ADC_HPALearningLotType10 "Lot type for path 10,0x0 represents invalid path";
CM_ SG_ 941 ADC_HPAPathSt10 "Status for path10";
CM_ SG_ 941 ADC_HPAPath10Src "Path number 10 is Learn or share";
CM_ SG_ 941 ADC_HPAPathDst10 "Learned path10 distance";
CM_ SG_ 941 ADC_HPAPath9MatGpsSucces "The Path matches the geofence successfully";
CM_ SG_ 941 ADC_HPAPath10MatGpsSucces "The Path matches the geofence successfully";
CM_ SG_ 941 ADC_LowPowerfeedback "indicate ADC lowpower Mode state";
CM_ SG_ 941 ADC_APAParkingSpdSt "APA Parking speed status";
CM_ SG_ 941 ADC_HPAParkingSpdSt "HPA Parking speed status";
CM_ SG_ 941 PCS_APAParkingReady "PCS APA Parking Requst";
CM_ SG_ 835 ADC_11_CRC "E2E Profile 5 CRC";
CM_ SG_ 835 ADC_11_Counter "E2E Profile 5 Counter";
CM_ SG_ 835 PAS_SystemType "PAS(Parking Assistant Sytem)  system type";
CM_ SG_ 835 PAS_WarnTone "Warning tone";
CM_ SG_ 835 PAS_ButtonPress "RPA button press status";
CM_ SG_ 835 PAS_SideZoneStatusF "Front side zone status ";
CM_ SG_ 835 PAS_SideZoneStatusR "Rear side zone status";
CM_ SG_ 835 PAS_RRMidDistance "Distance from rear right middle sensor  ";
CM_ SG_ 835 PAS_RLMidDistance "Distance from rear left middle sensor  ";
CM_ SG_ 835 PAS_RRDistance "Distance from rear right  sensor  ";
CM_ SG_ 835 PAS_RLDistance "Distance from rear left sensor ";
CM_ SG_ 835 PAS_RSLSideDistance "Distance from rear left side sensor ";
CM_ SG_ 835 PAS_RSRSideDistance "Distance from rear right side sensor ";
CM_ SG_ 835 PAS_FRDistance "Distance from front right sensor  ";
CM_ SG_ 835 PAS_FLDistance "Distance from front left sensor  ";
CM_ SG_ 835 PAS_FRMidDistance "Distance from front right middle sensor  ";
CM_ SG_ 835 PAS_FLMidDistance "Distance from front left middle sensor  ";
CM_ SG_ 835 PAS_FSRSideDistance "Distance from front right side sensor ";
CM_ SG_ 835 PAS_FSLSideDistance "Distance from front left side sensor ";
CM_ SG_ 835 PAS_Mode "Ultrasonic Sensor Working Mode";
CM_ SG_ 835 PAS_RRMidSnsErrFlag "Error flag of rear right middle sensor";
CM_ SG_ 835 PAS_RLMidSnsErrFlag "Error flag of rear leftt middle sensor";
CM_ SG_ 835 PAS_RRSnsErrFlag "Error flag of rear right sensor";
CM_ SG_ 835 PAS_RLSnsErrFlag "Error flag of rear left sensor";
CM_ SG_ 835 PAS_RSLSnsErrFlag "Error flag of rear left side sensor";
CM_ SG_ 835 PAS_RSRSnsErrFlag "Error flag of rear right side sensor";
CM_ SG_ 835 PAS_FRSnsErrFlag "Error flag of front right sensor";
CM_ SG_ 835 PAS_FLSnsErrFlag "Error flag of front left sensor";
CM_ SG_ 835 PAS_FRMidSnsErrFlag "Error flag of front right middle sensor";
CM_ SG_ 835 PAS_FLMidSnsErrFlag "Error flag of front left middle sensor";
CM_ SG_ 835 PAS_FSLSnsErrFlag "Error flag of front left side sensor";
CM_ SG_ 835 PAS_FSRSnsErrFlag "Error flag of front right side sensor";
CM_ SG_ 835 PAS_RRMidDislv "PAS_RRMidDislv";
CM_ SG_ 835 PAS_RLMidDislv "PAS_RLMidDislv";
CM_ SG_ 835 PAS_RRDislv "PAS_RRDislv";
CM_ SG_ 835 PAS_RLDislv "PAS_RLDislv";
CM_ SG_ 835 PAS_RSLSideDislv "PAS_RSLSideDislv";
CM_ SG_ 835 PAS_RSRSideDislv "PAS_RSRSideDislv";
CM_ SG_ 835 PAS_FRDislv "PAS_FRDislv";
CM_ SG_ 835 PAS_FLDislv "PAS_FLDislv";
CM_ SG_ 835 PAS_FRMidDislv "PAS_FRMidDislv";
CM_ SG_ 835 PAS_FLMidDislv "PAS_FLMidDislv";
CM_ SG_ 835 PAS_FSRSideDislv "PAS_FSRSideDislv";
CM_ SG_ 835 PAS_FSLSideDislv "PAS_FSLSideDislv";
CM_ SG_ 835 PAS_CtrlModulerrFlag "Error flag of EEPROM.";
CM_ SG_ 835 PAS_BattVoltErrFlag "Error flag of IGN voltage.";
CM_ SG_ 835 ADC_IDC_DisplayReq "AVM display request";
CM_ SG_ 835 ADC_PAAShortPresSuppSt "RPA short press support status";
CM_ SG_ 835 ADC_PAACtrlSigSrc "PAA? Control signal source";
CM_ SG_ 835 ADC_UsageModeRequstResult "Usage Mode Requst Result";
CM_ SG_ 835 ADC_ACU_DisplayReq "AVM display request";
CM_ SG_ 835 ADC_DPMessagePushSt "DP Message? Push Staus";
CM_ SG_ 835 PCS_SystemSt "System status ";
CM_ SG_ 835 PCS_FrontLeftCameraFail "Front left camera failure";
CM_ SG_ 835 PCS_FrontRightCameraFail "Front right camera failure";
CM_ SG_ 835 PCS_EventRecordSt "Indication event record turn off/on status ";
CM_ SG_ 835 PCS_HMIIndex "HMI index,used to indicate the current HMIindex";
CM_ SG_ 835 PCS_SingleViewInd "Single view indication, used to indicate thecurrent single view";
CM_ SG_ 835 PCS_VoiceReq "Voice request, used to indicate whicehvoice should be played";
CM_ SG_ 835 PCS_LeftBlindSpotViewSt "Indication left side blind spot view turnoff/on status";
CM_ SG_ 835 PCS_RightBlindSpotViewSt "Indication right side blind spot view turnoff/on status";
CM_ SG_ 835 PCS_ReturnSt "Return status ";
CM_ SG_ 835 PCS_HelpMenuSt "Help menu status ";
CM_ SG_ 835 PCS_SoundReminderSt "Sound reminder status ";
CM_ SG_ 835 PCS_ER_EnterConfirm "Event record enter comfirm ";
CM_ SG_ 835 PCS_MirrorPageDownButton "Mirror page down button ";
CM_ SG_ 835 PCS_ER_QuitReq "Event record quit request ";
CM_ SG_ 835 PCS_PASButtonPress "PAS button press status";
CM_ SG_ 835 PCS_VRSwitchFailSt "PCS VR Switch Fail State";
CM_ SG_ 835 PCS_FrontCameraFail "Front camera failure";
CM_ SG_ 835 PCS_LeftCameraFail "Left camera failure";
CM_ SG_ 835 PCS_RightCameraFail "Right camera failure";
CM_ SG_ 835 PCS_RearCameraFail "Rear camera failure";
CM_ SG_ 835 PCS_ACU_DisplayReq "ACU display request";
CM_ SG_ 835 PCS_CalibrateSt "Indication the calibration status";
CM_ SG_ 835 PCS_MODEnalbe "Indicate status of MOD(Moving Object Detection) function";
CM_ SG_ 835 PCS_3DEnalbe "Indicate status of 3D SVM function";
CM_ SG_ 835 PCS_SystemType "System type";
CM_ SG_ 835 PCS_OperationSt "Used to indicate the current status of PCS";
CM_ SG_ 835 DMS_FaceID_ADC "FaceID";
CM_ SG_ 835 DMS_SysErrSt_ADC "Driver monitoring system error status";
CM_ SG_ 835 OMS_SysErrSt_ADC "occupancy monitoring system error status";

BA_DEF_ BO_  "GenMsgCycleTime" INT 0 0;
BA_DEF_ BO_  "GenMsgCycleTimeFast" INT 0 0;
BA_DEF_ BO_  "GenMsgSendType" ENUM  "Periodic","Event","IfActive","POE","PA","FixedPeriodic","Event","EnabledPeriodic","NotUsed","NotUsed","EventPeriodic","NotUsed","NotUsed","NoMsgSendType";
BA_DEF_ BO_  "VFrameFormat" ENUM  "StandardCAN","ExtendedCAN","reserved","reserved","reserved","reserved","reserved","reserved","reserved","reserved","reserved","reserved","reserved","reserved","StandardCAN_FD","ExtendedCAN_FD";
BA_DEF_ BO_  "CANFD_BRS" ENUM  "0","1";
BA_DEF_ SG_  "EventCommandSignal" ENUM  "No","Yes";
BA_DEF_ SG_  "GatewayedSignals" ENUM  "No","Yes";
BA_DEF_ SG_  "GenSigInactiveValue" HEX 0 0;
BA_DEF_ SG_  "GenSigInvalidValue" HEX 0 0;
BA_DEF_ SG_  "GenSigSendType" ENUM  "Trigger","Passive","Cyclic","OnWrite","OnWriteWithRepetition","OnChange","OnChangeWithRepetition","IfActive","IfActiveWithRepetition","NoSigSendType";
BA_DEF_ SG_  "GenSigStartValue" HEX 0 0;
BA_DEF_ SG_  "GenSigTimeoutValue" HEX 0 0;
BA_DEF_ SG_  "Remark" STRING ;
BA_ "GenMsgCycleTime" BO_ 175 0;
BA_ "GenMsgCycleTimeFast" BO_ 175 0;
BA_ "GenMsgSendType" BO_ 175 1;
BA_ "VFrameFormat" BO_ 175 14;
BA_ "CANFD_BRS" BO_ 175 1;
BA_ "GenMsgCycleTime" BO_ 175 0;
BA_ "GenMsgCycleTimeFast" BO_ 175 0;
BA_ "GenMsgSendType" BO_ 175 1;
BA_ "VFrameFormat" BO_ 175 14;
BA_ "CANFD_BRS" BO_ 175 1;
BA_ "GenMsgCycleTime" BO_ 175 0;
BA_ "GenMsgCycleTimeFast" BO_ 175 0;
BA_ "GenMsgSendType" BO_ 175 1;
BA_ "VFrameFormat" BO_ 175 14;
BA_ "CANFD_BRS" BO_ 175 1;
BA_ "GenMsgCycleTime" BO_ 175 0;
BA_ "GenMsgCycleTimeFast" BO_ 175 0;
BA_ "GenMsgSendType" BO_ 175 1;
BA_ "VFrameFormat" BO_ 175 14;
BA_ "CANFD_BRS" BO_ 175 1;
BA_ "GenMsgCycleTime" BO_ 175 0;
BA_ "GenMsgCycleTimeFast" BO_ 175 0;
BA_ "GenMsgSendType" BO_ 175 1;
BA_ "VFrameFormat" BO_ 175 14;
BA_ "CANFD_BRS" BO_ 175 1;
BA_ "GenMsgCycleTime" BO_ 175 0;
BA_ "GenMsgCycleTimeFast" BO_ 175 0;
BA_ "GenMsgSendType" BO_ 175 1;
BA_ "VFrameFormat" BO_ 175 14;
BA_ "CANFD_BRS" BO_ 175 1;
BA_ "GenMsgCycleTime" BO_ 175 0;
BA_ "GenMsgCycleTimeFast" BO_ 175 0;
BA_ "GenMsgSendType" BO_ 175 1;
BA_ "VFrameFormat" BO_ 175 14;
BA_ "CANFD_BRS" BO_ 175 1;
BA_ "GenMsgCycleTime" BO_ 175 0;
BA_ "GenMsgCycleTimeFast" BO_ 175 0;
BA_ "GenMsgSendType" BO_ 175 1;
BA_ "VFrameFormat" BO_ 175 14;
BA_ "CANFD_BRS" BO_ 175 1;
BA_ "GenMsgCycleTime" BO_ 175 0;
BA_ "GenMsgCycleTimeFast" BO_ 175 0;
BA_ "GenMsgSendType" BO_ 175 1;
BA_ "VFrameFormat" BO_ 175 14;
BA_ "CANFD_BRS" BO_ 175 1;
BA_ "GenMsgCycleTime" BO_ 175 0;
BA_ "GenMsgCycleTimeFast" BO_ 175 0;
BA_ "GenMsgSendType" BO_ 175 1;
BA_ "VFrameFormat" BO_ 175 14;
BA_ "CANFD_BRS" BO_ 175 1;
BA_ "GenMsgCycleTime" BO_ 175 0;
BA_ "GenMsgCycleTimeFast" BO_ 175 0;
BA_ "GenMsgSendType" BO_ 175 1;
BA_ "VFrameFormat" BO_ 175 14;
BA_ "CANFD_BRS" BO_ 175 1;
BA_ "GenMsgCycleTime" BO_ 175 0;
BA_ "GenMsgCycleTimeFast" BO_ 175 0;
BA_ "GenMsgSendType" BO_ 175 1;
BA_ "VFrameFormat" BO_ 175 14;
BA_ "CANFD_BRS" BO_ 175 1;
BA_ "GenMsgCycleTime" BO_ 175 0;
BA_ "GenMsgCycleTimeFast" BO_ 175 0;
BA_ "GenMsgSendType" BO_ 175 1;
BA_ "VFrameFormat" BO_ 175 14;
BA_ "CANFD_BRS" BO_ 175 1;
BA_ "GenMsgCycleTime" BO_ 175 0;
BA_ "GenMsgCycleTimeFast" BO_ 175 0;
BA_ "GenMsgSendType" BO_ 175 1;
BA_ "VFrameFormat" BO_ 175 14;
BA_ "CANFD_BRS" BO_ 175 1;
BA_ "GenMsgCycleTime" BO_ 175 0;
BA_ "GenMsgCycleTimeFast" BO_ 175 0;
BA_ "GenMsgSendType" BO_ 175 1;
BA_ "VFrameFormat" BO_ 175 14;
BA_ "CANFD_BRS" BO_ 175 1;
BA_ "GenMsgCycleTime" BO_ 175 0;
BA_ "GenMsgCycleTimeFast" BO_ 175 0;
BA_ "GenMsgSendType" BO_ 175 1;
BA_ "VFrameFormat" BO_ 175 14;
BA_ "CANFD_BRS" BO_ 175 1;
BA_ "GenMsgCycleTime" BO_ 175 0;
BA_ "GenMsgCycleTimeFast" BO_ 175 0;
BA_ "GenMsgSendType" BO_ 175 1;
BA_ "VFrameFormat" BO_ 175 14;
BA_ "CANFD_BRS" BO_ 175 1;
BA_ "GenMsgCycleTime" BO_ 175 0;
BA_ "GenMsgCycleTimeFast" BO_ 175 0;
BA_ "GenMsgSendType" BO_ 175 1;
BA_ "VFrameFormat" BO_ 175 14;
BA_ "CANFD_BRS" BO_ 175 1;
BA_ "GenMsgCycleTime" BO_ 175 0;
BA_ "GenMsgCycleTimeFast" BO_ 175 0;
BA_ "GenMsgSendType" BO_ 175 1;
BA_ "VFrameFormat" BO_ 175 14;
BA_ "CANFD_BRS" BO_ 175 1;
BA_ "GenMsgCycleTime" BO_ 941 100;
BA_ "GenMsgCycleTimeFast" BO_ 941 0;
BA_ "GenMsgSendType" BO_ 941 0;
BA_ "VFrameFormat" BO_ 941 14;
BA_ "CANFD_BRS" BO_ 941 1;
BA_ "GenMsgCycleTime" BO_ 941 100;
BA_ "GenMsgCycleTimeFast" BO_ 941 0;
BA_ "GenMsgSendType" BO_ 941 0;
BA_ "VFrameFormat" BO_ 941 14;
BA_ "CANFD_BRS" BO_ 941 1;
BA_ "GenMsgCycleTime" BO_ 941 100;
BA_ "GenMsgCycleTimeFast" BO_ 941 0;
BA_ "GenMsgSendType" BO_ 941 0;
BA_ "VFrameFormat" BO_ 941 14;
BA_ "CANFD_BRS" BO_ 941 1;
BA_ "GenMsgCycleTime" BO_ 941 100;
BA_ "GenMsgCycleTimeFast" BO_ 941 0;
BA_ "GenMsgSendType" BO_ 941 0;
BA_ "VFrameFormat" BO_ 941 14;
BA_ "CANFD_BRS" BO_ 941 1;
BA_ "GenMsgCycleTime" BO_ 941 100;
BA_ "GenMsgCycleTimeFast" BO_ 941 0;
BA_ "GenMsgSendType" BO_ 941 0;
BA_ "VFrameFormat" BO_ 941 14;
BA_ "CANFD_BRS" BO_ 941 1;
BA_ "GenMsgCycleTime" BO_ 941 100;
BA_ "GenMsgCycleTimeFast" BO_ 941 0;
BA_ "GenMsgSendType" BO_ 941 0;
BA_ "VFrameFormat" BO_ 941 14;
BA_ "CANFD_BRS" BO_ 941 1;
BA_ "GenMsgCycleTime" BO_ 941 100;
BA_ "GenMsgCycleTimeFast" BO_ 941 0;
BA_ "GenMsgSendType" BO_ 941 0;
BA_ "VFrameFormat" BO_ 941 14;
BA_ "CANFD_BRS" BO_ 941 1;
BA_ "GenMsgCycleTime" BO_ 941 100;
BA_ "GenMsgCycleTimeFast" BO_ 941 0;
BA_ "GenMsgSendType" BO_ 941 0;
BA_ "VFrameFormat" BO_ 941 14;
BA_ "CANFD_BRS" BO_ 941 1;
BA_ "GenMsgCycleTime" BO_ 941 100;
BA_ "GenMsgCycleTimeFast" BO_ 941 0;
BA_ "GenMsgSendType" BO_ 941 0;
BA_ "VFrameFormat" BO_ 941 14;
BA_ "CANFD_BRS" BO_ 941 1;
BA_ "GenMsgCycleTime" BO_ 941 100;
BA_ "GenMsgCycleTimeFast" BO_ 941 0;
BA_ "GenMsgSendType" BO_ 941 0;
BA_ "VFrameFormat" BO_ 941 14;
BA_ "CANFD_BRS" BO_ 941 1;
BA_ "GenMsgCycleTime" BO_ 941 100;
BA_ "GenMsgCycleTimeFast" BO_ 941 0;
BA_ "GenMsgSendType" BO_ 941 0;
BA_ "VFrameFormat" BO_ 941 14;
BA_ "CANFD_BRS" BO_ 941 1;
BA_ "GenMsgCycleTime" BO_ 941 100;
BA_ "GenMsgCycleTimeFast" BO_ 941 0;
BA_ "GenMsgSendType" BO_ 941 0;
BA_ "VFrameFormat" BO_ 941 14;
BA_ "CANFD_BRS" BO_ 941 1;
BA_ "GenMsgCycleTime" BO_ 941 100;
BA_ "GenMsgCycleTimeFast" BO_ 941 0;
BA_ "GenMsgSendType" BO_ 941 0;
BA_ "VFrameFormat" BO_ 941 14;
BA_ "CANFD_BRS" BO_ 941 1;
BA_ "GenMsgCycleTime" BO_ 941 100;
BA_ "GenMsgCycleTimeFast" BO_ 941 0;
BA_ "GenMsgSendType" BO_ 941 0;
BA_ "VFrameFormat" BO_ 941 14;
BA_ "CANFD_BRS" BO_ 941 1;
BA_ "GenMsgCycleTime" BO_ 941 100;
BA_ "GenMsgCycleTimeFast" BO_ 941 0;
BA_ "GenMsgSendType" BO_ 941 0;
BA_ "VFrameFormat" BO_ 941 14;
BA_ "CANFD_BRS" BO_ 941 1;
BA_ "GenMsgCycleTime" BO_ 941 100;
BA_ "GenMsgCycleTimeFast" BO_ 941 0;
BA_ "GenMsgSendType" BO_ 941 0;
BA_ "VFrameFormat" BO_ 941 14;
BA_ "CANFD_BRS" BO_ 941 1;
BA_ "GenMsgCycleTime" BO_ 941 100;
BA_ "GenMsgCycleTimeFast" BO_ 941 0;
BA_ "GenMsgSendType" BO_ 941 0;
BA_ "VFrameFormat" BO_ 941 14;
BA_ "CANFD_BRS" BO_ 941 1;
BA_ "GenMsgCycleTime" BO_ 941 100;
BA_ "GenMsgCycleTimeFast" BO_ 941 0;
BA_ "GenMsgSendType" BO_ 941 0;
BA_ "VFrameFormat" BO_ 941 14;
BA_ "CANFD_BRS" BO_ 941 1;
BA_ "GenMsgCycleTime" BO_ 941 100;
BA_ "GenMsgCycleTimeFast" BO_ 941 0;
BA_ "GenMsgSendType" BO_ 941 0;
BA_ "VFrameFormat" BO_ 941 14;
BA_ "CANFD_BRS" BO_ 941 1;
BA_ "GenMsgCycleTime" BO_ 941 100;
BA_ "GenMsgCycleTimeFast" BO_ 941 0;
BA_ "GenMsgSendType" BO_ 941 0;
BA_ "VFrameFormat" BO_ 941 14;
BA_ "CANFD_BRS" BO_ 941 1;
BA_ "GenMsgCycleTime" BO_ 941 100;
BA_ "GenMsgCycleTimeFast" BO_ 941 0;
BA_ "GenMsgSendType" BO_ 941 0;
BA_ "VFrameFormat" BO_ 941 14;
BA_ "CANFD_BRS" BO_ 941 1;
BA_ "GenMsgCycleTime" BO_ 941 100;
BA_ "GenMsgCycleTimeFast" BO_ 941 0;
BA_ "GenMsgSendType" BO_ 941 0;
BA_ "VFrameFormat" BO_ 941 14;
BA_ "CANFD_BRS" BO_ 941 1;
BA_ "GenMsgCycleTime" BO_ 941 100;
BA_ "GenMsgCycleTimeFast" BO_ 941 0;
BA_ "GenMsgSendType" BO_ 941 0;
BA_ "VFrameFormat" BO_ 941 14;
BA_ "CANFD_BRS" BO_ 941 1;
BA_ "GenMsgCycleTime" BO_ 941 100;
BA_ "GenMsgCycleTimeFast" BO_ 941 0;
BA_ "GenMsgSendType" BO_ 941 0;
BA_ "VFrameFormat" BO_ 941 14;
BA_ "CANFD_BRS" BO_ 941 1;
BA_ "GenMsgCycleTime" BO_ 941 100;
BA_ "GenMsgCycleTimeFast" BO_ 941 0;
BA_ "GenMsgSendType" BO_ 941 0;
BA_ "VFrameFormat" BO_ 941 14;
BA_ "CANFD_BRS" BO_ 941 1;
BA_ "GenMsgCycleTime" BO_ 941 100;
BA_ "GenMsgCycleTimeFast" BO_ 941 0;
BA_ "GenMsgSendType" BO_ 941 0;
BA_ "VFrameFormat" BO_ 941 14;
BA_ "CANFD_BRS" BO_ 941 1;
BA_ "GenMsgCycleTime" BO_ 941 100;
BA_ "GenMsgCycleTimeFast" BO_ 941 0;
BA_ "GenMsgSendType" BO_ 941 0;
BA_ "VFrameFormat" BO_ 941 14;
BA_ "CANFD_BRS" BO_ 941 1;
BA_ "GenMsgCycleTime" BO_ 941 100;
BA_ "GenMsgCycleTimeFast" BO_ 941 0;
BA_ "GenMsgSendType" BO_ 941 0;
BA_ "VFrameFormat" BO_ 941 14;
BA_ "CANFD_BRS" BO_ 941 1;
BA_ "GenMsgCycleTime" BO_ 941 100;
BA_ "GenMsgCycleTimeFast" BO_ 941 0;
BA_ "GenMsgSendType" BO_ 941 0;
BA_ "VFrameFormat" BO_ 941 14;
BA_ "CANFD_BRS" BO_ 941 1;
BA_ "GenMsgCycleTime" BO_ 941 100;
BA_ "GenMsgCycleTimeFast" BO_ 941 0;
BA_ "GenMsgSendType" BO_ 941 0;
BA_ "VFrameFormat" BO_ 941 14;
BA_ "CANFD_BRS" BO_ 941 1;
BA_ "GenMsgCycleTime" BO_ 941 100;
BA_ "GenMsgCycleTimeFast" BO_ 941 0;
BA_ "GenMsgSendType" BO_ 941 0;
BA_ "VFrameFormat" BO_ 941 14;
BA_ "CANFD_BRS" BO_ 941 1;
BA_ "GenMsgCycleTime" BO_ 941 100;
BA_ "GenMsgCycleTimeFast" BO_ 941 0;
BA_ "GenMsgSendType" BO_ 941 0;
BA_ "VFrameFormat" BO_ 941 14;
BA_ "CANFD_BRS" BO_ 941 1;
BA_ "GenMsgCycleTime" BO_ 941 100;
BA_ "GenMsgCycleTimeFast" BO_ 941 0;
BA_ "GenMsgSendType" BO_ 941 0;
BA_ "VFrameFormat" BO_ 941 14;
BA_ "CANFD_BRS" BO_ 941 1;
BA_ "GenMsgCycleTime" BO_ 941 100;
BA_ "GenMsgCycleTimeFast" BO_ 941 0;
BA_ "GenMsgSendType" BO_ 941 0;
BA_ "VFrameFormat" BO_ 941 14;
BA_ "CANFD_BRS" BO_ 941 1;
BA_ "GenMsgCycleTime" BO_ 941 100;
BA_ "GenMsgCycleTimeFast" BO_ 941 0;
BA_ "GenMsgSendType" BO_ 941 0;
BA_ "VFrameFormat" BO_ 941 14;
BA_ "CANFD_BRS" BO_ 941 1;
BA_ "GenMsgCycleTime" BO_ 941 100;
BA_ "GenMsgCycleTimeFast" BO_ 941 0;
BA_ "GenMsgSendType" BO_ 941 0;
BA_ "VFrameFormat" BO_ 941 14;
BA_ "CANFD_BRS" BO_ 941 1;
BA_ "GenMsgCycleTime" BO_ 941 100;
BA_ "GenMsgCycleTimeFast" BO_ 941 0;
BA_ "GenMsgSendType" BO_ 941 0;
BA_ "VFrameFormat" BO_ 941 14;
BA_ "CANFD_BRS" BO_ 941 1;
BA_ "GenMsgCycleTime" BO_ 941 100;
BA_ "GenMsgCycleTimeFast" BO_ 941 0;
BA_ "GenMsgSendType" BO_ 941 0;
BA_ "VFrameFormat" BO_ 941 14;
BA_ "CANFD_BRS" BO_ 941 1;
BA_ "GenMsgCycleTime" BO_ 941 100;
BA_ "GenMsgCycleTimeFast" BO_ 941 0;
BA_ "GenMsgSendType" BO_ 941 0;
BA_ "VFrameFormat" BO_ 941 14;
BA_ "CANFD_BRS" BO_ 941 1;
BA_ "GenMsgCycleTime" BO_ 941 100;
BA_ "GenMsgCycleTimeFast" BO_ 941 0;
BA_ "GenMsgSendType" BO_ 941 0;
BA_ "VFrameFormat" BO_ 941 14;
BA_ "CANFD_BRS" BO_ 941 1;
BA_ "GenMsgCycleTime" BO_ 941 100;
BA_ "GenMsgCycleTimeFast" BO_ 941 0;
BA_ "GenMsgSendType" BO_ 941 0;
BA_ "VFrameFormat" BO_ 941 14;
BA_ "CANFD_BRS" BO_ 941 1;
BA_ "GenMsgCycleTime" BO_ 941 100;
BA_ "GenMsgCycleTimeFast" BO_ 941 0;
BA_ "GenMsgSendType" BO_ 941 0;
BA_ "VFrameFormat" BO_ 941 14;
BA_ "CANFD_BRS" BO_ 941 1;
BA_ "GenMsgCycleTime" BO_ 941 100;
BA_ "GenMsgCycleTimeFast" BO_ 941 0;
BA_ "GenMsgSendType" BO_ 941 0;
BA_ "VFrameFormat" BO_ 941 14;
BA_ "CANFD_BRS" BO_ 941 1;
BA_ "GenMsgCycleTime" BO_ 941 100;
BA_ "GenMsgCycleTimeFast" BO_ 941 0;
BA_ "GenMsgSendType" BO_ 941 0;
BA_ "VFrameFormat" BO_ 941 14;
BA_ "CANFD_BRS" BO_ 941 1;
BA_ "GenMsgCycleTime" BO_ 941 100;
BA_ "GenMsgCycleTimeFast" BO_ 941 0;
BA_ "GenMsgSendType" BO_ 941 0;
BA_ "VFrameFormat" BO_ 941 14;
BA_ "CANFD_BRS" BO_ 941 1;
BA_ "GenMsgCycleTime" BO_ 941 100;
BA_ "GenMsgCycleTimeFast" BO_ 941 0;
BA_ "GenMsgSendType" BO_ 941 0;
BA_ "VFrameFormat" BO_ 941 14;
BA_ "CANFD_BRS" BO_ 941 1;
BA_ "GenMsgCycleTime" BO_ 941 100;
BA_ "GenMsgCycleTimeFast" BO_ 941 0;
BA_ "GenMsgSendType" BO_ 941 0;
BA_ "VFrameFormat" BO_ 941 14;
BA_ "CANFD_BRS" BO_ 941 1;
BA_ "GenMsgCycleTime" BO_ 941 100;
BA_ "GenMsgCycleTimeFast" BO_ 941 0;
BA_ "GenMsgSendType" BO_ 941 0;
BA_ "VFrameFormat" BO_ 941 14;
BA_ "CANFD_BRS" BO_ 941 1;
BA_ "GenMsgCycleTime" BO_ 941 100;
BA_ "GenMsgCycleTimeFast" BO_ 941 0;
BA_ "GenMsgSendType" BO_ 941 0;
BA_ "VFrameFormat" BO_ 941 14;
BA_ "CANFD_BRS" BO_ 941 1;
BA_ "GenMsgCycleTime" BO_ 941 100;
BA_ "GenMsgCycleTimeFast" BO_ 941 0;
BA_ "GenMsgSendType" BO_ 941 0;
BA_ "VFrameFormat" BO_ 941 14;
BA_ "CANFD_BRS" BO_ 941 1;
BA_ "GenMsgCycleTime" BO_ 941 100;
BA_ "GenMsgCycleTimeFast" BO_ 941 0;
BA_ "GenMsgSendType" BO_ 941 0;
BA_ "VFrameFormat" BO_ 941 14;
BA_ "CANFD_BRS" BO_ 941 1;
BA_ "GenMsgCycleTime" BO_ 941 100;
BA_ "GenMsgCycleTimeFast" BO_ 941 0;
BA_ "GenMsgSendType" BO_ 941 0;
BA_ "VFrameFormat" BO_ 941 14;
BA_ "CANFD_BRS" BO_ 941 1;
BA_ "GenMsgCycleTime" BO_ 941 100;
BA_ "GenMsgCycleTimeFast" BO_ 941 0;
BA_ "GenMsgSendType" BO_ 941 0;
BA_ "VFrameFormat" BO_ 941 14;
BA_ "CANFD_BRS" BO_ 941 1;
BA_ "GenMsgCycleTime" BO_ 941 100;
BA_ "GenMsgCycleTimeFast" BO_ 941 0;
BA_ "GenMsgSendType" BO_ 941 0;
BA_ "VFrameFormat" BO_ 941 14;
BA_ "CANFD_BRS" BO_ 941 1;
BA_ "GenMsgCycleTime" BO_ 941 100;
BA_ "GenMsgCycleTimeFast" BO_ 941 0;
BA_ "GenMsgSendType" BO_ 941 0;
BA_ "VFrameFormat" BO_ 941 14;
BA_ "CANFD_BRS" BO_ 941 1;
BA_ "GenMsgCycleTime" BO_ 941 100;
BA_ "GenMsgCycleTimeFast" BO_ 941 0;
BA_ "GenMsgSendType" BO_ 941 0;
BA_ "VFrameFormat" BO_ 941 14;
BA_ "CANFD_BRS" BO_ 941 1;
BA_ "GenMsgCycleTime" BO_ 941 100;
BA_ "GenMsgCycleTimeFast" BO_ 941 0;
BA_ "GenMsgSendType" BO_ 941 0;
BA_ "VFrameFormat" BO_ 941 14;
BA_ "CANFD_BRS" BO_ 941 1;
BA_ "GenMsgCycleTime" BO_ 941 100;
BA_ "GenMsgCycleTimeFast" BO_ 941 0;
BA_ "GenMsgSendType" BO_ 941 0;
BA_ "VFrameFormat" BO_ 941 14;
BA_ "CANFD_BRS" BO_ 941 1;
BA_ "GenMsgCycleTime" BO_ 941 100;
BA_ "GenMsgCycleTimeFast" BO_ 941 0;
BA_ "GenMsgSendType" BO_ 941 0;
BA_ "VFrameFormat" BO_ 941 14;
BA_ "CANFD_BRS" BO_ 941 1;
BA_ "GenMsgCycleTime" BO_ 941 100;
BA_ "GenMsgCycleTimeFast" BO_ 941 0;
BA_ "GenMsgSendType" BO_ 941 0;
BA_ "VFrameFormat" BO_ 941 14;
BA_ "CANFD_BRS" BO_ 941 1;
BA_ "GenMsgCycleTime" BO_ 941 100;
BA_ "GenMsgCycleTimeFast" BO_ 941 0;
BA_ "GenMsgSendType" BO_ 941 0;
BA_ "VFrameFormat" BO_ 941 14;
BA_ "CANFD_BRS" BO_ 941 1;
BA_ "GenMsgCycleTime" BO_ 941 100;
BA_ "GenMsgCycleTimeFast" BO_ 941 0;
BA_ "GenMsgSendType" BO_ 941 0;
BA_ "VFrameFormat" BO_ 941 14;
BA_ "CANFD_BRS" BO_ 941 1;
BA_ "GenMsgCycleTime" BO_ 941 100;
BA_ "GenMsgCycleTimeFast" BO_ 941 0;
BA_ "GenMsgSendType" BO_ 941 0;
BA_ "VFrameFormat" BO_ 941 14;
BA_ "CANFD_BRS" BO_ 941 1;
BA_ "GenMsgCycleTime" BO_ 941 100;
BA_ "GenMsgCycleTimeFast" BO_ 941 0;
BA_ "GenMsgSendType" BO_ 941 0;
BA_ "VFrameFormat" BO_ 941 14;
BA_ "CANFD_BRS" BO_ 941 1;
BA_ "GenMsgCycleTime" BO_ 941 100;
BA_ "GenMsgCycleTimeFast" BO_ 941 0;
BA_ "GenMsgSendType" BO_ 941 0;
BA_ "VFrameFormat" BO_ 941 14;
BA_ "CANFD_BRS" BO_ 941 1;
BA_ "GenMsgCycleTime" BO_ 941 100;
BA_ "GenMsgCycleTimeFast" BO_ 941 0;
BA_ "GenMsgSendType" BO_ 941 0;
BA_ "VFrameFormat" BO_ 941 14;
BA_ "CANFD_BRS" BO_ 941 1;
BA_ "GenMsgCycleTime" BO_ 941 100;
BA_ "GenMsgCycleTimeFast" BO_ 941 0;
BA_ "GenMsgSendType" BO_ 941 0;
BA_ "VFrameFormat" BO_ 941 14;
BA_ "CANFD_BRS" BO_ 941 1;
BA_ "GenMsgCycleTime" BO_ 941 100;
BA_ "GenMsgCycleTimeFast" BO_ 941 0;
BA_ "GenMsgSendType" BO_ 941 0;
BA_ "VFrameFormat" BO_ 941 14;
BA_ "CANFD_BRS" BO_ 941 1;
BA_ "GenMsgCycleTime" BO_ 941 100;
BA_ "GenMsgCycleTimeFast" BO_ 941 0;
BA_ "GenMsgSendType" BO_ 941 0;
BA_ "VFrameFormat" BO_ 941 14;
BA_ "CANFD_BRS" BO_ 941 1;
BA_ "GenMsgCycleTime" BO_ 941 100;
BA_ "GenMsgCycleTimeFast" BO_ 941 0;
BA_ "GenMsgSendType" BO_ 941 0;
BA_ "VFrameFormat" BO_ 941 14;
BA_ "CANFD_BRS" BO_ 941 1;
BA_ "GenMsgCycleTime" BO_ 941 100;
BA_ "GenMsgCycleTimeFast" BO_ 941 0;
BA_ "GenMsgSendType" BO_ 941 0;
BA_ "VFrameFormat" BO_ 941 14;
BA_ "CANFD_BRS" BO_ 941 1;
BA_ "GenMsgCycleTime" BO_ 941 100;
BA_ "GenMsgCycleTimeFast" BO_ 941 0;
BA_ "GenMsgSendType" BO_ 941 0;
BA_ "VFrameFormat" BO_ 941 14;
BA_ "CANFD_BRS" BO_ 941 1;
BA_ "GenMsgCycleTime" BO_ 941 100;
BA_ "GenMsgCycleTimeFast" BO_ 941 0;
BA_ "GenMsgSendType" BO_ 941 0;
BA_ "VFrameFormat" BO_ 941 14;
BA_ "CANFD_BRS" BO_ 941 1;
BA_ "GenMsgCycleTime" BO_ 941 100;
BA_ "GenMsgCycleTimeFast" BO_ 941 0;
BA_ "GenMsgSendType" BO_ 941 0;
BA_ "VFrameFormat" BO_ 941 14;
BA_ "CANFD_BRS" BO_ 941 1;
BA_ "GenMsgCycleTime" BO_ 941 100;
BA_ "GenMsgCycleTimeFast" BO_ 941 0;
BA_ "GenMsgSendType" BO_ 941 0;
BA_ "VFrameFormat" BO_ 941 14;
BA_ "CANFD_BRS" BO_ 941 1;
BA_ "GenMsgCycleTime" BO_ 941 100;
BA_ "GenMsgCycleTimeFast" BO_ 941 0;
BA_ "GenMsgSendType" BO_ 941 0;
BA_ "VFrameFormat" BO_ 941 14;
BA_ "CANFD_BRS" BO_ 941 1;
BA_ "GenMsgCycleTime" BO_ 941 100;
BA_ "GenMsgCycleTimeFast" BO_ 941 0;
BA_ "GenMsgSendType" BO_ 941 0;
BA_ "VFrameFormat" BO_ 941 14;
BA_ "CANFD_BRS" BO_ 941 1;
BA_ "GenMsgCycleTime" BO_ 941 100;
BA_ "GenMsgCycleTimeFast" BO_ 941 0;
BA_ "GenMsgSendType" BO_ 941 0;
BA_ "VFrameFormat" BO_ 941 14;
BA_ "CANFD_BRS" BO_ 941 1;
BA_ "GenMsgCycleTime" BO_ 941 100;
BA_ "GenMsgCycleTimeFast" BO_ 941 0;
BA_ "GenMsgSendType" BO_ 941 0;
BA_ "VFrameFormat" BO_ 941 14;
BA_ "CANFD_BRS" BO_ 941 1;
BA_ "GenMsgCycleTime" BO_ 941 100;
BA_ "GenMsgCycleTimeFast" BO_ 941 0;
BA_ "GenMsgSendType" BO_ 941 0;
BA_ "VFrameFormat" BO_ 941 14;
BA_ "CANFD_BRS" BO_ 941 1;
BA_ "GenMsgCycleTime" BO_ 941 100;
BA_ "GenMsgCycleTimeFast" BO_ 941 0;
BA_ "GenMsgSendType" BO_ 941 0;
BA_ "VFrameFormat" BO_ 941 14;
BA_ "CANFD_BRS" BO_ 941 1;
BA_ "GenMsgCycleTime" BO_ 941 100;
BA_ "GenMsgCycleTimeFast" BO_ 941 0;
BA_ "GenMsgSendType" BO_ 941 0;
BA_ "VFrameFormat" BO_ 941 14;
BA_ "CANFD_BRS" BO_ 941 1;
BA_ "GenMsgCycleTime" BO_ 941 100;
BA_ "GenMsgCycleTimeFast" BO_ 941 0;
BA_ "GenMsgSendType" BO_ 941 0;
BA_ "VFrameFormat" BO_ 941 14;
BA_ "CANFD_BRS" BO_ 941 1;
BA_ "GenMsgCycleTime" BO_ 941 100;
BA_ "GenMsgCycleTimeFast" BO_ 941 0;
BA_ "GenMsgSendType" BO_ 941 0;
BA_ "VFrameFormat" BO_ 941 14;
BA_ "CANFD_BRS" BO_ 941 1;
BA_ "GenMsgCycleTime" BO_ 941 100;
BA_ "GenMsgCycleTimeFast" BO_ 941 0;
BA_ "GenMsgSendType" BO_ 941 0;
BA_ "VFrameFormat" BO_ 941 14;
BA_ "CANFD_BRS" BO_ 941 1;
BA_ "GenMsgCycleTime" BO_ 941 100;
BA_ "GenMsgCycleTimeFast" BO_ 941 0;
BA_ "GenMsgSendType" BO_ 941 0;
BA_ "VFrameFormat" BO_ 941 14;
BA_ "CANFD_BRS" BO_ 941 1;
BA_ "GenMsgCycleTime" BO_ 941 100;
BA_ "GenMsgCycleTimeFast" BO_ 941 0;
BA_ "GenMsgSendType" BO_ 941 0;
BA_ "VFrameFormat" BO_ 941 14;
BA_ "CANFD_BRS" BO_ 941 1;
BA_ "GenMsgCycleTime" BO_ 941 100;
BA_ "GenMsgCycleTimeFast" BO_ 941 0;
BA_ "GenMsgSendType" BO_ 941 0;
BA_ "VFrameFormat" BO_ 941 14;
BA_ "CANFD_BRS" BO_ 941 1;
BA_ "GenMsgCycleTime" BO_ 941 100;
BA_ "GenMsgCycleTimeFast" BO_ 941 0;
BA_ "GenMsgSendType" BO_ 941 0;
BA_ "VFrameFormat" BO_ 941 14;
BA_ "CANFD_BRS" BO_ 941 1;
BA_ "GenMsgCycleTime" BO_ 941 100;
BA_ "GenMsgCycleTimeFast" BO_ 941 0;
BA_ "GenMsgSendType" BO_ 941 0;
BA_ "VFrameFormat" BO_ 941 14;
BA_ "CANFD_BRS" BO_ 941 1;
BA_ "GenMsgCycleTime" BO_ 941 100;
BA_ "GenMsgCycleTimeFast" BO_ 941 0;
BA_ "GenMsgSendType" BO_ 941 0;
BA_ "VFrameFormat" BO_ 941 14;
BA_ "CANFD_BRS" BO_ 941 1;
BA_ "GenMsgCycleTime" BO_ 941 100;
BA_ "GenMsgCycleTimeFast" BO_ 941 0;
BA_ "GenMsgSendType" BO_ 941 0;
BA_ "VFrameFormat" BO_ 941 14;
BA_ "CANFD_BRS" BO_ 941 1;
BA_ "GenMsgCycleTime" BO_ 941 100;
BA_ "GenMsgCycleTimeFast" BO_ 941 0;
BA_ "GenMsgSendType" BO_ 941 0;
BA_ "VFrameFormat" BO_ 941 14;
BA_ "CANFD_BRS" BO_ 941 1;
BA_ "GenMsgCycleTime" BO_ 941 100;
BA_ "GenMsgCycleTimeFast" BO_ 941 0;
BA_ "GenMsgSendType" BO_ 941 0;
BA_ "VFrameFormat" BO_ 941 14;
BA_ "CANFD_BRS" BO_ 941 1;
BA_ "GenMsgCycleTime" BO_ 941 100;
BA_ "GenMsgCycleTimeFast" BO_ 941 0;
BA_ "GenMsgSendType" BO_ 941 0;
BA_ "VFrameFormat" BO_ 941 14;
BA_ "CANFD_BRS" BO_ 941 1;
BA_ "GenMsgCycleTime" BO_ 941 100;
BA_ "GenMsgCycleTimeFast" BO_ 941 0;
BA_ "GenMsgSendType" BO_ 941 0;
BA_ "VFrameFormat" BO_ 941 14;
BA_ "CANFD_BRS" BO_ 941 1;
BA_ "GenMsgCycleTime" BO_ 941 100;
BA_ "GenMsgCycleTimeFast" BO_ 941 0;
BA_ "GenMsgSendType" BO_ 941 0;
BA_ "VFrameFormat" BO_ 941 14;
BA_ "CANFD_BRS" BO_ 941 1;
BA_ "GenMsgCycleTime" BO_ 941 100;
BA_ "GenMsgCycleTimeFast" BO_ 941 0;
BA_ "GenMsgSendType" BO_ 941 0;
BA_ "VFrameFormat" BO_ 941 14;
BA_ "CANFD_BRS" BO_ 941 1;
BA_ "GenMsgCycleTime" BO_ 941 100;
BA_ "GenMsgCycleTimeFast" BO_ 941 0;
BA_ "GenMsgSendType" BO_ 941 0;
BA_ "VFrameFormat" BO_ 941 14;
BA_ "CANFD_BRS" BO_ 941 1;
BA_ "GenMsgCycleTime" BO_ 941 100;
BA_ "GenMsgCycleTimeFast" BO_ 941 0;
BA_ "GenMsgSendType" BO_ 941 0;
BA_ "VFrameFormat" BO_ 941 14;
BA_ "CANFD_BRS" BO_ 941 1;
BA_ "GenMsgCycleTime" BO_ 941 100;
BA_ "GenMsgCycleTimeFast" BO_ 941 0;
BA_ "GenMsgSendType" BO_ 941 0;
BA_ "VFrameFormat" BO_ 941 14;
BA_ "CANFD_BRS" BO_ 941 1;
BA_ "GenMsgCycleTime" BO_ 941 100;
BA_ "GenMsgCycleTimeFast" BO_ 941 0;
BA_ "GenMsgSendType" BO_ 941 0;
BA_ "VFrameFormat" BO_ 941 14;
BA_ "CANFD_BRS" BO_ 941 1;
BA_ "GenMsgCycleTime" BO_ 941 100;
BA_ "GenMsgCycleTimeFast" BO_ 941 0;
BA_ "GenMsgSendType" BO_ 941 0;
BA_ "VFrameFormat" BO_ 941 14;
BA_ "CANFD_BRS" BO_ 941 1;
BA_ "GenMsgCycleTime" BO_ 941 100;
BA_ "GenMsgCycleTimeFast" BO_ 941 0;
BA_ "GenMsgSendType" BO_ 941 0;
BA_ "VFrameFormat" BO_ 941 14;
BA_ "CANFD_BRS" BO_ 941 1;
BA_ "GenMsgCycleTime" BO_ 941 100;
BA_ "GenMsgCycleTimeFast" BO_ 941 0;
BA_ "GenMsgSendType" BO_ 941 0;
BA_ "VFrameFormat" BO_ 941 14;
BA_ "CANFD_BRS" BO_ 941 1;
BA_ "GenMsgCycleTime" BO_ 941 100;
BA_ "GenMsgCycleTimeFast" BO_ 941 0;
BA_ "GenMsgSendType" BO_ 941 0;
BA_ "VFrameFormat" BO_ 941 14;
BA_ "CANFD_BRS" BO_ 941 1;
BA_ "GenMsgCycleTime" BO_ 941 100;
BA_ "GenMsgCycleTimeFast" BO_ 941 0;
BA_ "GenMsgSendType" BO_ 941 0;
BA_ "VFrameFormat" BO_ 941 14;
BA_ "CANFD_BRS" BO_ 941 1;
BA_ "GenMsgCycleTime" BO_ 941 100;
BA_ "GenMsgCycleTimeFast" BO_ 941 0;
BA_ "GenMsgSendType" BO_ 941 0;
BA_ "VFrameFormat" BO_ 941 14;
BA_ "CANFD_BRS" BO_ 941 1;
BA_ "GenMsgCycleTime" BO_ 941 100;
BA_ "GenMsgCycleTimeFast" BO_ 941 0;
BA_ "GenMsgSendType" BO_ 941 0;
BA_ "VFrameFormat" BO_ 941 14;
BA_ "CANFD_BRS" BO_ 941 1;
BA_ "GenMsgCycleTime" BO_ 941 100;
BA_ "GenMsgCycleTimeFast" BO_ 941 0;
BA_ "GenMsgSendType" BO_ 941 0;
BA_ "VFrameFormat" BO_ 941 14;
BA_ "CANFD_BRS" BO_ 941 1;
BA_ "GenMsgCycleTime" BO_ 941 100;
BA_ "GenMsgCycleTimeFast" BO_ 941 0;
BA_ "GenMsgSendType" BO_ 941 0;
BA_ "VFrameFormat" BO_ 941 14;
BA_ "CANFD_BRS" BO_ 941 1;
BA_ "GenMsgCycleTime" BO_ 941 100;
BA_ "GenMsgCycleTimeFast" BO_ 941 0;
BA_ "GenMsgSendType" BO_ 941 0;
BA_ "VFrameFormat" BO_ 941 14;
BA_ "CANFD_BRS" BO_ 941 1;
BA_ "GenMsgCycleTime" BO_ 941 100;
BA_ "GenMsgCycleTimeFast" BO_ 941 0;
BA_ "GenMsgSendType" BO_ 941 0;
BA_ "VFrameFormat" BO_ 941 14;
BA_ "CANFD_BRS" BO_ 941 1;
BA_ "GenMsgCycleTime" BO_ 941 100;
BA_ "GenMsgCycleTimeFast" BO_ 941 0;
BA_ "GenMsgSendType" BO_ 941 0;
BA_ "VFrameFormat" BO_ 941 14;
BA_ "CANFD_BRS" BO_ 941 1;
BA_ "GenMsgCycleTime" BO_ 941 100;
BA_ "GenMsgCycleTimeFast" BO_ 941 0;
BA_ "GenMsgSendType" BO_ 941 0;
BA_ "VFrameFormat" BO_ 941 14;
BA_ "CANFD_BRS" BO_ 941 1;
BA_ "GenMsgCycleTime" BO_ 941 100;
BA_ "GenMsgCycleTimeFast" BO_ 941 0;
BA_ "GenMsgSendType" BO_ 941 0;
BA_ "VFrameFormat" BO_ 941 14;
BA_ "CANFD_BRS" BO_ 941 1;
BA_ "GenMsgCycleTime" BO_ 941 100;
BA_ "GenMsgCycleTimeFast" BO_ 941 0;
BA_ "GenMsgSendType" BO_ 941 0;
BA_ "VFrameFormat" BO_ 941 14;
BA_ "CANFD_BRS" BO_ 941 1;
BA_ "GenMsgCycleTime" BO_ 941 100;
BA_ "GenMsgCycleTimeFast" BO_ 941 0;
BA_ "GenMsgSendType" BO_ 941 0;
BA_ "VFrameFormat" BO_ 941 14;
BA_ "CANFD_BRS" BO_ 941 1;
BA_ "GenMsgCycleTime" BO_ 835 100;
BA_ "GenMsgCycleTimeFast" BO_ 835 0;
BA_ "GenMsgSendType" BO_ 835 0;
BA_ "VFrameFormat" BO_ 835 14;
BA_ "CANFD_BRS" BO_ 835 1;
BA_ "GenMsgCycleTime" BO_ 835 100;
BA_ "GenMsgCycleTimeFast" BO_ 835 0;
BA_ "GenMsgSendType" BO_ 835 0;
BA_ "VFrameFormat" BO_ 835 14;
BA_ "CANFD_BRS" BO_ 835 1;
BA_ "GenMsgCycleTime" BO_ 835 100;
BA_ "GenMsgCycleTimeFast" BO_ 835 0;
BA_ "GenMsgSendType" BO_ 835 0;
BA_ "VFrameFormat" BO_ 835 14;
BA_ "CANFD_BRS" BO_ 835 1;
BA_ "GenMsgCycleTime" BO_ 835 100;
BA_ "GenMsgCycleTimeFast" BO_ 835 0;
BA_ "GenMsgSendType" BO_ 835 0;
BA_ "VFrameFormat" BO_ 835 14;
BA_ "CANFD_BRS" BO_ 835 1;
BA_ "GenMsgCycleTime" BO_ 835 100;
BA_ "GenMsgCycleTimeFast" BO_ 835 0;
BA_ "GenMsgSendType" BO_ 835 0;
BA_ "VFrameFormat" BO_ 835 14;
BA_ "CANFD_BRS" BO_ 835 1;
BA_ "GenMsgCycleTime" BO_ 835 100;
BA_ "GenMsgCycleTimeFast" BO_ 835 0;
BA_ "GenMsgSendType" BO_ 835 0;
BA_ "VFrameFormat" BO_ 835 14;
BA_ "CANFD_BRS" BO_ 835 1;
BA_ "GenMsgCycleTime" BO_ 835 100;
BA_ "GenMsgCycleTimeFast" BO_ 835 0;
BA_ "GenMsgSendType" BO_ 835 0;
BA_ "VFrameFormat" BO_ 835 14;
BA_ "CANFD_BRS" BO_ 835 1;
BA_ "GenMsgCycleTime" BO_ 835 100;
BA_ "GenMsgCycleTimeFast" BO_ 835 0;
BA_ "GenMsgSendType" BO_ 835 0;
BA_ "VFrameFormat" BO_ 835 14;
BA_ "CANFD_BRS" BO_ 835 1;
BA_ "GenMsgCycleTime" BO_ 835 100;
BA_ "GenMsgCycleTimeFast" BO_ 835 0;
BA_ "GenMsgSendType" BO_ 835 0;
BA_ "VFrameFormat" BO_ 835 14;
BA_ "CANFD_BRS" BO_ 835 1;
BA_ "GenMsgCycleTime" BO_ 835 100;
BA_ "GenMsgCycleTimeFast" BO_ 835 0;
BA_ "GenMsgSendType" BO_ 835 0;
BA_ "VFrameFormat" BO_ 835 14;
BA_ "CANFD_BRS" BO_ 835 1;
BA_ "GenMsgCycleTime" BO_ 835 100;
BA_ "GenMsgCycleTimeFast" BO_ 835 0;
BA_ "GenMsgSendType" BO_ 835 0;
BA_ "VFrameFormat" BO_ 835 14;
BA_ "CANFD_BRS" BO_ 835 1;
BA_ "GenMsgCycleTime" BO_ 835 100;
BA_ "GenMsgCycleTimeFast" BO_ 835 0;
BA_ "GenMsgSendType" BO_ 835 0;
BA_ "VFrameFormat" BO_ 835 14;
BA_ "CANFD_BRS" BO_ 835 1;
BA_ "GenMsgCycleTime" BO_ 835 100;
BA_ "GenMsgCycleTimeFast" BO_ 835 0;
BA_ "GenMsgSendType" BO_ 835 0;
BA_ "VFrameFormat" BO_ 835 14;
BA_ "CANFD_BRS" BO_ 835 1;
BA_ "GenMsgCycleTime" BO_ 835 100;
BA_ "GenMsgCycleTimeFast" BO_ 835 0;
BA_ "GenMsgSendType" BO_ 835 0;
BA_ "VFrameFormat" BO_ 835 14;
BA_ "CANFD_BRS" BO_ 835 1;
BA_ "GenMsgCycleTime" BO_ 835 100;
BA_ "GenMsgCycleTimeFast" BO_ 835 0;
BA_ "GenMsgSendType" BO_ 835 0;
BA_ "VFrameFormat" BO_ 835 14;
BA_ "CANFD_BRS" BO_ 835 1;
BA_ "GenMsgCycleTime" BO_ 835 100;
BA_ "GenMsgCycleTimeFast" BO_ 835 0;
BA_ "GenMsgSendType" BO_ 835 0;
BA_ "VFrameFormat" BO_ 835 14;
BA_ "CANFD_BRS" BO_ 835 1;
BA_ "GenMsgCycleTime" BO_ 835 100;
BA_ "GenMsgCycleTimeFast" BO_ 835 0;
BA_ "GenMsgSendType" BO_ 835 0;
BA_ "VFrameFormat" BO_ 835 14;
BA_ "CANFD_BRS" BO_ 835 1;
BA_ "GenMsgCycleTime" BO_ 835 100;
BA_ "GenMsgCycleTimeFast" BO_ 835 0;
BA_ "GenMsgSendType" BO_ 835 0;
BA_ "VFrameFormat" BO_ 835 14;
BA_ "CANFD_BRS" BO_ 835 1;
BA_ "GenMsgCycleTime" BO_ 835 100;
BA_ "GenMsgCycleTimeFast" BO_ 835 0;
BA_ "GenMsgSendType" BO_ 835 0;
BA_ "VFrameFormat" BO_ 835 14;
BA_ "CANFD_BRS" BO_ 835 1;
BA_ "GenMsgCycleTime" BO_ 835 100;
BA_ "GenMsgCycleTimeFast" BO_ 835 0;
BA_ "GenMsgSendType" BO_ 835 0;
BA_ "VFrameFormat" BO_ 835 14;
BA_ "CANFD_BRS" BO_ 835 1;
BA_ "GenMsgCycleTime" BO_ 835 100;
BA_ "GenMsgCycleTimeFast" BO_ 835 0;
BA_ "GenMsgSendType" BO_ 835 0;
BA_ "VFrameFormat" BO_ 835 14;
BA_ "CANFD_BRS" BO_ 835 1;
BA_ "GenMsgCycleTime" BO_ 835 100;
BA_ "GenMsgCycleTimeFast" BO_ 835 0;
BA_ "GenMsgSendType" BO_ 835 0;
BA_ "VFrameFormat" BO_ 835 14;
BA_ "CANFD_BRS" BO_ 835 1;
BA_ "GenMsgCycleTime" BO_ 835 100;
BA_ "GenMsgCycleTimeFast" BO_ 835 0;
BA_ "GenMsgSendType" BO_ 835 0;
BA_ "VFrameFormat" BO_ 835 14;
BA_ "CANFD_BRS" BO_ 835 1;
BA_ "GenMsgCycleTime" BO_ 835 100;
BA_ "GenMsgCycleTimeFast" BO_ 835 0;
BA_ "GenMsgSendType" BO_ 835 0;
BA_ "VFrameFormat" BO_ 835 14;
BA_ "CANFD_BRS" BO_ 835 1;
BA_ "GenMsgCycleTime" BO_ 835 100;
BA_ "GenMsgCycleTimeFast" BO_ 835 0;
BA_ "GenMsgSendType" BO_ 835 0;
BA_ "VFrameFormat" BO_ 835 14;
BA_ "CANFD_BRS" BO_ 835 1;
BA_ "GenMsgCycleTime" BO_ 835 100;
BA_ "GenMsgCycleTimeFast" BO_ 835 0;
BA_ "GenMsgSendType" BO_ 835 0;
BA_ "VFrameFormat" BO_ 835 14;
BA_ "CANFD_BRS" BO_ 835 1;
BA_ "GenMsgCycleTime" BO_ 835 100;
BA_ "GenMsgCycleTimeFast" BO_ 835 0;
BA_ "GenMsgSendType" BO_ 835 0;
BA_ "VFrameFormat" BO_ 835 14;
BA_ "CANFD_BRS" BO_ 835 1;
BA_ "GenMsgCycleTime" BO_ 835 100;
BA_ "GenMsgCycleTimeFast" BO_ 835 0;
BA_ "GenMsgSendType" BO_ 835 0;
BA_ "VFrameFormat" BO_ 835 14;
BA_ "CANFD_BRS" BO_ 835 1;
BA_ "GenMsgCycleTime" BO_ 835 100;
BA_ "GenMsgCycleTimeFast" BO_ 835 0;
BA_ "GenMsgSendType" BO_ 835 0;
BA_ "VFrameFormat" BO_ 835 14;
BA_ "CANFD_BRS" BO_ 835 1;
BA_ "GenMsgCycleTime" BO_ 835 100;
BA_ "GenMsgCycleTimeFast" BO_ 835 0;
BA_ "GenMsgSendType" BO_ 835 0;
BA_ "VFrameFormat" BO_ 835 14;
BA_ "CANFD_BRS" BO_ 835 1;
BA_ "GenMsgCycleTime" BO_ 835 100;
BA_ "GenMsgCycleTimeFast" BO_ 835 0;
BA_ "GenMsgSendType" BO_ 835 0;
BA_ "VFrameFormat" BO_ 835 14;
BA_ "CANFD_BRS" BO_ 835 1;
BA_ "GenMsgCycleTime" BO_ 835 100;
BA_ "GenMsgCycleTimeFast" BO_ 835 0;
BA_ "GenMsgSendType" BO_ 835 0;
BA_ "VFrameFormat" BO_ 835 14;
BA_ "CANFD_BRS" BO_ 835 1;
BA_ "GenMsgCycleTime" BO_ 835 100;
BA_ "GenMsgCycleTimeFast" BO_ 835 0;
BA_ "GenMsgSendType" BO_ 835 0;
BA_ "VFrameFormat" BO_ 835 14;
BA_ "CANFD_BRS" BO_ 835 1;
BA_ "GenMsgCycleTime" BO_ 835 100;
BA_ "GenMsgCycleTimeFast" BO_ 835 0;
BA_ "GenMsgSendType" BO_ 835 0;
BA_ "VFrameFormat" BO_ 835 14;
BA_ "CANFD_BRS" BO_ 835 1;
BA_ "GenMsgCycleTime" BO_ 835 100;
BA_ "GenMsgCycleTimeFast" BO_ 835 0;
BA_ "GenMsgSendType" BO_ 835 0;
BA_ "VFrameFormat" BO_ 835 14;
BA_ "CANFD_BRS" BO_ 835 1;
BA_ "GenMsgCycleTime" BO_ 835 100;
BA_ "GenMsgCycleTimeFast" BO_ 835 0;
BA_ "GenMsgSendType" BO_ 835 0;
BA_ "VFrameFormat" BO_ 835 14;
BA_ "CANFD_BRS" BO_ 835 1;
BA_ "GenMsgCycleTime" BO_ 835 100;
BA_ "GenMsgCycleTimeFast" BO_ 835 0;
BA_ "GenMsgSendType" BO_ 835 0;
BA_ "VFrameFormat" BO_ 835 14;
BA_ "CANFD_BRS" BO_ 835 1;
BA_ "GenMsgCycleTime" BO_ 835 100;
BA_ "GenMsgCycleTimeFast" BO_ 835 0;
BA_ "GenMsgSendType" BO_ 835 0;
BA_ "VFrameFormat" BO_ 835 14;
BA_ "CANFD_BRS" BO_ 835 1;
BA_ "GenMsgCycleTime" BO_ 835 100;
BA_ "GenMsgCycleTimeFast" BO_ 835 0;
BA_ "GenMsgSendType" BO_ 835 0;
BA_ "VFrameFormat" BO_ 835 14;
BA_ "CANFD_BRS" BO_ 835 1;
BA_ "GenMsgCycleTime" BO_ 835 100;
BA_ "GenMsgCycleTimeFast" BO_ 835 0;
BA_ "GenMsgSendType" BO_ 835 0;
BA_ "VFrameFormat" BO_ 835 14;
BA_ "CANFD_BRS" BO_ 835 1;
BA_ "GenMsgCycleTime" BO_ 835 100;
BA_ "GenMsgCycleTimeFast" BO_ 835 0;
BA_ "GenMsgSendType" BO_ 835 0;
BA_ "VFrameFormat" BO_ 835 14;
BA_ "CANFD_BRS" BO_ 835 1;
BA_ "GenMsgCycleTime" BO_ 835 100;
BA_ "GenMsgCycleTimeFast" BO_ 835 0;
BA_ "GenMsgSendType" BO_ 835 0;
BA_ "VFrameFormat" BO_ 835 14;
BA_ "CANFD_BRS" BO_ 835 1;
BA_ "GenMsgCycleTime" BO_ 835 100;
BA_ "GenMsgCycleTimeFast" BO_ 835 0;
BA_ "GenMsgSendType" BO_ 835 0;
BA_ "VFrameFormat" BO_ 835 14;
BA_ "CANFD_BRS" BO_ 835 1;
BA_ "GenMsgCycleTime" BO_ 835 100;
BA_ "GenMsgCycleTimeFast" BO_ 835 0;
BA_ "GenMsgSendType" BO_ 835 0;
BA_ "VFrameFormat" BO_ 835 14;
BA_ "CANFD_BRS" BO_ 835 1;
BA_ "GenMsgCycleTime" BO_ 835 100;
BA_ "GenMsgCycleTimeFast" BO_ 835 0;
BA_ "GenMsgSendType" BO_ 835 0;
BA_ "VFrameFormat" BO_ 835 14;
BA_ "CANFD_BRS" BO_ 835 1;
BA_ "GenMsgCycleTime" BO_ 835 100;
BA_ "GenMsgCycleTimeFast" BO_ 835 0;
BA_ "GenMsgSendType" BO_ 835 0;
BA_ "VFrameFormat" BO_ 835 14;
BA_ "CANFD_BRS" BO_ 835 1;
BA_ "GenMsgCycleTime" BO_ 835 100;
BA_ "GenMsgCycleTimeFast" BO_ 835 0;
BA_ "GenMsgSendType" BO_ 835 0;
BA_ "VFrameFormat" BO_ 835 14;
BA_ "CANFD_BRS" BO_ 835 1;
BA_ "GenMsgCycleTime" BO_ 835 100;
BA_ "GenMsgCycleTimeFast" BO_ 835 0;
BA_ "GenMsgSendType" BO_ 835 0;
BA_ "VFrameFormat" BO_ 835 14;
BA_ "CANFD_BRS" BO_ 835 1;
BA_ "GenMsgCycleTime" BO_ 835 100;
BA_ "GenMsgCycleTimeFast" BO_ 835 0;
BA_ "GenMsgSendType" BO_ 835 0;
BA_ "VFrameFormat" BO_ 835 14;
BA_ "CANFD_BRS" BO_ 835 1;
BA_ "GenMsgCycleTime" BO_ 835 100;
BA_ "GenMsgCycleTimeFast" BO_ 835 0;
BA_ "GenMsgSendType" BO_ 835 0;
BA_ "VFrameFormat" BO_ 835 14;
BA_ "CANFD_BRS" BO_ 835 1;
BA_ "GenMsgCycleTime" BO_ 835 100;
BA_ "GenMsgCycleTimeFast" BO_ 835 0;
BA_ "GenMsgSendType" BO_ 835 0;
BA_ "VFrameFormat" BO_ 835 14;
BA_ "CANFD_BRS" BO_ 835 1;
BA_ "GenMsgCycleTime" BO_ 835 100;
BA_ "GenMsgCycleTimeFast" BO_ 835 0;
BA_ "GenMsgSendType" BO_ 835 0;
BA_ "VFrameFormat" BO_ 835 14;
BA_ "CANFD_BRS" BO_ 835 1;
BA_ "GenMsgCycleTime" BO_ 835 100;
BA_ "GenMsgCycleTimeFast" BO_ 835 0;
BA_ "GenMsgSendType" BO_ 835 0;
BA_ "VFrameFormat" BO_ 835 14;
BA_ "CANFD_BRS" BO_ 835 1;
BA_ "GenMsgCycleTime" BO_ 835 100;
BA_ "GenMsgCycleTimeFast" BO_ 835 0;
BA_ "GenMsgSendType" BO_ 835 0;
BA_ "VFrameFormat" BO_ 835 14;
BA_ "CANFD_BRS" BO_ 835 1;
BA_ "GenMsgCycleTime" BO_ 835 100;
BA_ "GenMsgCycleTimeFast" BO_ 835 0;
BA_ "GenMsgSendType" BO_ 835 0;
BA_ "VFrameFormat" BO_ 835 14;
BA_ "CANFD_BRS" BO_ 835 1;
BA_ "GenMsgCycleTime" BO_ 835 100;
BA_ "GenMsgCycleTimeFast" BO_ 835 0;
BA_ "GenMsgSendType" BO_ 835 0;
BA_ "VFrameFormat" BO_ 835 14;
BA_ "CANFD_BRS" BO_ 835 1;
BA_ "GenMsgCycleTime" BO_ 835 100;
BA_ "GenMsgCycleTimeFast" BO_ 835 0;
BA_ "GenMsgSendType" BO_ 835 0;
BA_ "VFrameFormat" BO_ 835 14;
BA_ "CANFD_BRS" BO_ 835 1;
BA_ "GenMsgCycleTime" BO_ 835 100;
BA_ "GenMsgCycleTimeFast" BO_ 835 0;
BA_ "GenMsgSendType" BO_ 835 0;
BA_ "VFrameFormat" BO_ 835 14;
BA_ "CANFD_BRS" BO_ 835 1;
BA_ "GenMsgCycleTime" BO_ 835 100;
BA_ "GenMsgCycleTimeFast" BO_ 835 0;
BA_ "GenMsgSendType" BO_ 835 0;
BA_ "VFrameFormat" BO_ 835 14;
BA_ "CANFD_BRS" BO_ 835 1;
BA_ "GenMsgCycleTime" BO_ 835 100;
BA_ "GenMsgCycleTimeFast" BO_ 835 0;
BA_ "GenMsgSendType" BO_ 835 0;
BA_ "VFrameFormat" BO_ 835 14;
BA_ "CANFD_BRS" BO_ 835 1;
BA_ "GenMsgCycleTime" BO_ 835 100;
BA_ "GenMsgCycleTimeFast" BO_ 835 0;
BA_ "GenMsgSendType" BO_ 835 0;
BA_ "VFrameFormat" BO_ 835 14;
BA_ "CANFD_BRS" BO_ 835 1;
BA_ "GenMsgCycleTime" BO_ 835 100;
BA_ "GenMsgCycleTimeFast" BO_ 835 0;
BA_ "GenMsgSendType" BO_ 835 0;
BA_ "VFrameFormat" BO_ 835 14;
BA_ "CANFD_BRS" BO_ 835 1;
BA_ "GenMsgCycleTime" BO_ 835 100;
BA_ "GenMsgCycleTimeFast" BO_ 835 0;
BA_ "GenMsgSendType" BO_ 835 0;
BA_ "VFrameFormat" BO_ 835 14;
BA_ "CANFD_BRS" BO_ 835 1;
BA_ "GenMsgCycleTime" BO_ 835 100;
BA_ "GenMsgCycleTimeFast" BO_ 835 0;
BA_ "GenMsgSendType" BO_ 835 0;
BA_ "VFrameFormat" BO_ 835 14;
BA_ "CANFD_BRS" BO_ 835 1;
BA_ "GenMsgCycleTime" BO_ 835 100;
BA_ "GenMsgCycleTimeFast" BO_ 835 0;
BA_ "GenMsgSendType" BO_ 835 0;
BA_ "VFrameFormat" BO_ 835 14;
BA_ "CANFD_BRS" BO_ 835 1;
BA_ "GenMsgCycleTime" BO_ 835 100;
BA_ "GenMsgCycleTimeFast" BO_ 835 0;
BA_ "GenMsgSendType" BO_ 835 0;
BA_ "VFrameFormat" BO_ 835 14;
BA_ "CANFD_BRS" BO_ 835 1;
BA_ "GenMsgCycleTime" BO_ 835 100;
BA_ "GenMsgCycleTimeFast" BO_ 835 0;
BA_ "GenMsgSendType" BO_ 835 0;
BA_ "VFrameFormat" BO_ 835 14;
BA_ "CANFD_BRS" BO_ 835 1;
BA_ "GenMsgCycleTime" BO_ 835 100;
BA_ "GenMsgCycleTimeFast" BO_ 835 0;
BA_ "GenMsgSendType" BO_ 835 0;
BA_ "VFrameFormat" BO_ 835 14;
BA_ "CANFD_BRS" BO_ 835 1;
BA_ "GenMsgCycleTime" BO_ 835 100;
BA_ "GenMsgCycleTimeFast" BO_ 835 0;
BA_ "GenMsgSendType" BO_ 835 0;
BA_ "VFrameFormat" BO_ 835 14;
BA_ "CANFD_BRS" BO_ 835 1;
BA_ "GenMsgCycleTime" BO_ 835 100;
BA_ "GenMsgCycleTimeFast" BO_ 835 0;
BA_ "GenMsgSendType" BO_ 835 0;
BA_ "VFrameFormat" BO_ 835 14;
BA_ "CANFD_BRS" BO_ 835 1;
BA_ "GenMsgCycleTime" BO_ 835 100;
BA_ "GenMsgCycleTimeFast" BO_ 835 0;
BA_ "GenMsgSendType" BO_ 835 0;
BA_ "VFrameFormat" BO_ 835 14;
BA_ "CANFD_BRS" BO_ 835 1;
BA_ "GenMsgCycleTime" BO_ 835 100;
BA_ "GenMsgCycleTimeFast" BO_ 835 0;
BA_ "GenMsgSendType" BO_ 835 0;
BA_ "VFrameFormat" BO_ 835 14;
BA_ "CANFD_BRS" BO_ 835 1;
BA_ "GenMsgCycleTime" BO_ 835 100;
BA_ "GenMsgCycleTimeFast" BO_ 835 0;
BA_ "GenMsgSendType" BO_ 835 0;
BA_ "VFrameFormat" BO_ 835 14;
BA_ "CANFD_BRS" BO_ 835 1;
BA_ "GenMsgCycleTime" BO_ 835 100;
BA_ "GenMsgCycleTimeFast" BO_ 835 0;
BA_ "GenMsgSendType" BO_ 835 0;
BA_ "VFrameFormat" BO_ 835 14;
BA_ "CANFD_BRS" BO_ 835 1;
BA_ "GenMsgCycleTime" BO_ 835 100;
BA_ "GenMsgCycleTimeFast" BO_ 835 0;
BA_ "GenMsgSendType" BO_ 835 0;
BA_ "VFrameFormat" BO_ 835 14;
BA_ "CANFD_BRS" BO_ 835 1;
BA_ "GenMsgCycleTime" BO_ 835 100;
BA_ "GenMsgCycleTimeFast" BO_ 835 0;
BA_ "GenMsgSendType" BO_ 835 0;
BA_ "VFrameFormat" BO_ 835 14;
BA_ "CANFD_BRS" BO_ 835 1;
BA_ "GenMsgCycleTime" BO_ 835 100;
BA_ "GenMsgCycleTimeFast" BO_ 835 0;
BA_ "GenMsgSendType" BO_ 835 0;
BA_ "VFrameFormat" BO_ 835 14;
BA_ "CANFD_BRS" BO_ 835 1;
BA_ "GenMsgCycleTime" BO_ 835 100;
BA_ "GenMsgCycleTimeFast" BO_ 835 0;
BA_ "GenMsgSendType" BO_ 835 0;
BA_ "VFrameFormat" BO_ 835 14;
BA_ "CANFD_BRS" BO_ 835 1;
BA_ "GenMsgCycleTime" BO_ 835 100;
BA_ "GenMsgCycleTimeFast" BO_ 835 0;
BA_ "GenMsgSendType" BO_ 835 0;
BA_ "VFrameFormat" BO_ 835 14;
BA_ "CANFD_BRS" BO_ 835 1;
BA_ "GenMsgCycleTime" BO_ 835 100;
BA_ "GenMsgCycleTimeFast" BO_ 835 0;
BA_ "GenMsgSendType" BO_ 835 0;
BA_ "VFrameFormat" BO_ 835 14;
BA_ "CANFD_BRS" BO_ 835 1;
BA_ "GenMsgCycleTime" BO_ 835 100;
BA_ "GenMsgCycleTimeFast" BO_ 835 0;
BA_ "GenMsgSendType" BO_ 835 0;
BA_ "VFrameFormat" BO_ 835 14;
BA_ "CANFD_BRS" BO_ 835 1;
BA_ "GenMsgCycleTime" BO_ 835 100;
BA_ "GenMsgCycleTimeFast" BO_ 835 0;
BA_ "GenMsgSendType" BO_ 835 0;
BA_ "VFrameFormat" BO_ 835 14;
BA_ "CANFD_BRS" BO_ 835 1;
BA_ "EventCommandSignal" SG_ 175 ADC_9_CRC 0;
BA_ "GatewayedSignals" SG_ 175 ADC_9_CRC 0;
BA_ "GenSigInactiveValue" SG_ 175 ADC_9_CRC 0;
BA_ "GenSigInvalidValue" SG_ 175 ADC_9_CRC 0;
BA_ "GenSigSendType" SG_ 175 ADC_9_CRC 1;
BA_ "GenSigStartValue" SG_ 175 ADC_9_CRC 0;
BA_ "GenSigTimeoutValue" SG_ 175 ADC_9_CRC 0;
BA_ "Remark" SG_ 175 ADC_9_CRC "";
BA_ "EventCommandSignal" SG_ 175 ADC_9_Counter 0;
BA_ "GatewayedSignals" SG_ 175 ADC_9_Counter 0;
BA_ "GenSigInactiveValue" SG_ 175 ADC_9_Counter 0;
BA_ "GenSigInvalidValue" SG_ 175 ADC_9_Counter 0;
BA_ "GenSigSendType" SG_ 175 ADC_9_Counter 1;
BA_ "GenSigStartValue" SG_ 175 ADC_9_Counter 0;
BA_ "GenSigTimeoutValue" SG_ 175 ADC_9_Counter 0;
BA_ "Remark" SG_ 175 ADC_9_Counter "";
BA_ "EventCommandSignal" SG_ 175 ADC_PAAChallengeReceive 1;
BA_ "GatewayedSignals" SG_ 175 ADC_PAAChallengeReceive 0;
BA_ "GenSigInactiveValue" SG_ 175 ADC_PAAChallengeReceive 0;
BA_ "GenSigInvalidValue" SG_ 175 ADC_PAAChallengeReceive 0;
BA_ "GenSigSendType" SG_ 175 ADC_PAAChallengeReceive 0;
BA_ "GenSigStartValue" SG_ 175 ADC_PAAChallengeReceive 0;
BA_ "GenSigTimeoutValue" SG_ 175 ADC_PAAChallengeReceive 0;
BA_ "Remark" SG_ 175 ADC_PAAChallengeReceive "";
BA_ "EventCommandSignal" SG_ 175 PAA_TimeStampYear 1;
BA_ "GatewayedSignals" SG_ 175 PAA_TimeStampYear 0;
BA_ "GenSigInactiveValue" SG_ 175 PAA_TimeStampYear 0;
BA_ "GenSigInvalidValue" SG_ 175 PAA_TimeStampYear 0;
BA_ "GenSigSendType" SG_ 175 PAA_TimeStampYear 0;
BA_ "GenSigStartValue" SG_ 175 PAA_TimeStampYear 0;
BA_ "GenSigTimeoutValue" SG_ 175 PAA_TimeStampYear 0;
BA_ "Remark" SG_ 175 PAA_TimeStampYear "";
BA_ "EventCommandSignal" SG_ 175 ADC_PAAChallenge1SBM 1;
BA_ "GatewayedSignals" SG_ 175 ADC_PAAChallenge1SBM 0;
BA_ "GenSigInactiveValue" SG_ 175 ADC_PAAChallenge1SBM 0;
BA_ "GenSigInvalidValue" SG_ 175 ADC_PAAChallenge1SBM 255;
BA_ "GenSigSendType" SG_ 175 ADC_PAAChallenge1SBM 0;
BA_ "GenSigStartValue" SG_ 175 ADC_PAAChallenge1SBM 0;
BA_ "GenSigTimeoutValue" SG_ 175 ADC_PAAChallenge1SBM 0;
BA_ "Remark" SG_ 175 ADC_PAAChallenge1SBM "";
BA_ "EventCommandSignal" SG_ 175 ADC_PAAChallenge2SBM 1;
BA_ "GatewayedSignals" SG_ 175 ADC_PAAChallenge2SBM 0;
BA_ "GenSigInactiveValue" SG_ 175 ADC_PAAChallenge2SBM 0;
BA_ "GenSigInvalidValue" SG_ 175 ADC_PAAChallenge2SBM 255;
BA_ "GenSigSendType" SG_ 175 ADC_PAAChallenge2SBM 0;
BA_ "GenSigStartValue" SG_ 175 ADC_PAAChallenge2SBM 0;
BA_ "GenSigTimeoutValue" SG_ 175 ADC_PAAChallenge2SBM 0;
BA_ "Remark" SG_ 175 ADC_PAAChallenge2SBM "";
BA_ "EventCommandSignal" SG_ 175 ADC_PAAChallenge1TEL 1;
BA_ "GatewayedSignals" SG_ 175 ADC_PAAChallenge1TEL 0;
BA_ "GenSigInactiveValue" SG_ 175 ADC_PAAChallenge1TEL 0;
BA_ "GenSigInvalidValue" SG_ 175 ADC_PAAChallenge1TEL 255;
BA_ "GenSigSendType" SG_ 175 ADC_PAAChallenge1TEL 0;
BA_ "GenSigStartValue" SG_ 175 ADC_PAAChallenge1TEL 0;
BA_ "GenSigTimeoutValue" SG_ 175 ADC_PAAChallenge1TEL 0;
BA_ "Remark" SG_ 175 ADC_PAAChallenge1TEL "";
BA_ "EventCommandSignal" SG_ 175 ADC_PAAChallenge2TEL 1;
BA_ "GatewayedSignals" SG_ 175 ADC_PAAChallenge2TEL 0;
BA_ "GenSigInactiveValue" SG_ 175 ADC_PAAChallenge2TEL 0;
BA_ "GenSigInvalidValue" SG_ 175 ADC_PAAChallenge2TEL 255;
BA_ "GenSigSendType" SG_ 175 ADC_PAAChallenge2TEL 0;
BA_ "GenSigStartValue" SG_ 175 ADC_PAAChallenge2TEL 0;
BA_ "GenSigTimeoutValue" SG_ 175 ADC_PAAChallenge2TEL 0;
BA_ "Remark" SG_ 175 ADC_PAAChallenge2TEL "";
BA_ "EventCommandSignal" SG_ 175 PAA_TimeStampMonth 1;
BA_ "GatewayedSignals" SG_ 175 PAA_TimeStampMonth 0;
BA_ "GenSigInactiveValue" SG_ 175 PAA_TimeStampMonth 0;
BA_ "GenSigInvalidValue" SG_ 175 PAA_TimeStampMonth 0;
BA_ "GenSigSendType" SG_ 175 PAA_TimeStampMonth 0;
BA_ "GenSigStartValue" SG_ 175 PAA_TimeStampMonth 1;
BA_ "GenSigTimeoutValue" SG_ 175 PAA_TimeStampMonth 0;
BA_ "Remark" SG_ 175 PAA_TimeStampMonth "";
BA_ "EventCommandSignal" SG_ 175 PAA_TimeStampDay 1;
BA_ "GatewayedSignals" SG_ 175 PAA_TimeStampDay 0;
BA_ "GenSigInactiveValue" SG_ 175 PAA_TimeStampDay 0;
BA_ "GenSigInvalidValue" SG_ 175 PAA_TimeStampDay 0;
BA_ "GenSigSendType" SG_ 175 PAA_TimeStampDay 0;
BA_ "GenSigStartValue" SG_ 175 PAA_TimeStampDay 1;
BA_ "GenSigTimeoutValue" SG_ 175 PAA_TimeStampDay 0;
BA_ "Remark" SG_ 175 PAA_TimeStampDay "";
BA_ "EventCommandSignal" SG_ 175 PAA_TimeStampHour 1;
BA_ "GatewayedSignals" SG_ 175 PAA_TimeStampHour 0;
BA_ "GenSigInactiveValue" SG_ 175 PAA_TimeStampHour 0;
BA_ "GenSigInvalidValue" SG_ 175 PAA_TimeStampHour 0;
BA_ "GenSigSendType" SG_ 175 PAA_TimeStampHour 0;
BA_ "GenSigStartValue" SG_ 175 PAA_TimeStampHour 0;
BA_ "GenSigTimeoutValue" SG_ 175 PAA_TimeStampHour 0;
BA_ "Remark" SG_ 175 PAA_TimeStampHour "";
BA_ "EventCommandSignal" SG_ 175 PAA_TimeStampMin 1;
BA_ "GatewayedSignals" SG_ 175 PAA_TimeStampMin 0;
BA_ "GenSigInactiveValue" SG_ 175 PAA_TimeStampMin 0;
BA_ "GenSigInvalidValue" SG_ 175 PAA_TimeStampMin 0;
BA_ "GenSigSendType" SG_ 175 PAA_TimeStampMin 0;
BA_ "GenSigStartValue" SG_ 175 PAA_TimeStampMin 0;
BA_ "GenSigTimeoutValue" SG_ 175 PAA_TimeStampMin 0;
BA_ "Remark" SG_ 175 PAA_TimeStampMin "";
BA_ "EventCommandSignal" SG_ 175 PAA_TimeStampSec 1;
BA_ "GatewayedSignals" SG_ 175 PAA_TimeStampSec 0;
BA_ "GenSigInactiveValue" SG_ 175 PAA_TimeStampSec 0;
BA_ "GenSigInvalidValue" SG_ 175 PAA_TimeStampSec 0;
BA_ "GenSigSendType" SG_ 175 PAA_TimeStampSec 0;
BA_ "GenSigStartValue" SG_ 175 PAA_TimeStampSec 0;
BA_ "GenSigTimeoutValue" SG_ 175 PAA_TimeStampSec 0;
BA_ "Remark" SG_ 175 PAA_TimeStampSec "";
BA_ "EventCommandSignal" SG_ 175 PAA_TimeStampMilliSec 1;
BA_ "GatewayedSignals" SG_ 175 PAA_TimeStampMilliSec 0;
BA_ "GenSigInactiveValue" SG_ 175 PAA_TimeStampMilliSec 0;
BA_ "GenSigInvalidValue" SG_ 175 PAA_TimeStampMilliSec 0;
BA_ "GenSigSendType" SG_ 175 PAA_TimeStampMilliSec 0;
BA_ "GenSigStartValue" SG_ 175 PAA_TimeStampMilliSec 0;
BA_ "GenSigTimeoutValue" SG_ 175 PAA_TimeStampMilliSec 0;
BA_ "Remark" SG_ 175 PAA_TimeStampMilliSec "";
BA_ "EventCommandSignal" SG_ 175 PAA_DVRTriggerId 1;
BA_ "GatewayedSignals" SG_ 175 PAA_DVRTriggerId 0;
BA_ "GenSigInactiveValue" SG_ 175 PAA_DVRTriggerId 0;
BA_ "GenSigInvalidValue" SG_ 175 PAA_DVRTriggerId 0;
BA_ "GenSigSendType" SG_ 175 PAA_DVRTriggerId 0;
BA_ "GenSigStartValue" SG_ 175 PAA_DVRTriggerId 0;
BA_ "GenSigTimeoutValue" SG_ 175 PAA_DVRTriggerId 0;
BA_ "Remark" SG_ 175 PAA_DVRTriggerId "";
BA_ "EventCommandSignal" SG_ 175 PAA_DVRTrigger 1;
BA_ "GatewayedSignals" SG_ 175 PAA_DVRTrigger 0;
BA_ "GenSigInactiveValue" SG_ 175 PAA_DVRTrigger 0;
BA_ "GenSigInvalidValue" SG_ 175 PAA_DVRTrigger 0;
BA_ "GenSigSendType" SG_ 175 PAA_DVRTrigger 0;
BA_ "GenSigStartValue" SG_ 175 PAA_DVRTrigger 0;
BA_ "GenSigTimeoutValue" SG_ 175 PAA_DVRTrigger 0;
BA_ "Remark" SG_ 175 PAA_DVRTrigger "";
BA_ "EventCommandSignal" SG_ 175 ADC_LCAEnableSt 1;
BA_ "GatewayedSignals" SG_ 175 ADC_LCAEnableSt 0;
BA_ "GenSigInactiveValue" SG_ 175 ADC_LCAEnableSt 0;
BA_ "GenSigInvalidValue" SG_ 175 ADC_LCAEnableSt 0;
BA_ "GenSigSendType" SG_ 175 ADC_LCAEnableSt 0;
BA_ "GenSigStartValue" SG_ 175 ADC_LCAEnableSt 0;
BA_ "GenSigTimeoutValue" SG_ 175 ADC_LCAEnableSt 3;
BA_ "Remark" SG_ 175 ADC_LCAEnableSt "Only for IFC";
BA_ "EventCommandSignal" SG_ 175 ADC_APAActPushSt 1;
BA_ "GatewayedSignals" SG_ 175 ADC_APAActPushSt 0;
BA_ "GenSigInactiveValue" SG_ 175 ADC_APAActPushSt 0;
BA_ "GenSigInvalidValue" SG_ 175 ADC_APAActPushSt 0;
BA_ "GenSigSendType" SG_ 175 ADC_APAActPushSt 0;
BA_ "GenSigStartValue" SG_ 175 ADC_APAActPushSt 0;
BA_ "GenSigTimeoutValue" SG_ 175 ADC_APAActPushSt 0;
BA_ "Remark" SG_ 175 ADC_APAActPushSt "";
BA_ "EventCommandSignal" SG_ 175 ADC_HPALearningPathUniqueID 1;
BA_ "GatewayedSignals" SG_ 175 ADC_HPALearningPathUniqueID 0;
BA_ "GenSigInactiveValue" SG_ 175 ADC_HPALearningPathUniqueID 0;
BA_ "GenSigInvalidValue" SG_ 175 ADC_HPALearningPathUniqueID 0;
BA_ "GenSigSendType" SG_ 175 ADC_HPALearningPathUniqueID 0;
BA_ "GenSigStartValue" SG_ 175 ADC_HPALearningPathUniqueID 0;
BA_ "GenSigTimeoutValue" SG_ 175 ADC_HPALearningPathUniqueID 0;
BA_ "Remark" SG_ 175 ADC_HPALearningPathUniqueID "";
BA_ "EventCommandSignal" SG_ 941 ADC_10_CRC 0;
BA_ "GatewayedSignals" SG_ 941 ADC_10_CRC 0;
BA_ "GenSigInactiveValue" SG_ 941 ADC_10_CRC 0;
BA_ "GenSigInvalidValue" SG_ 941 ADC_10_CRC 0;
BA_ "GenSigSendType" SG_ 941 ADC_10_CRC 1;
BA_ "GenSigStartValue" SG_ 941 ADC_10_CRC 0;
BA_ "GenSigTimeoutValue" SG_ 941 ADC_10_CRC 0;
BA_ "Remark" SG_ 941 ADC_10_CRC "";
BA_ "EventCommandSignal" SG_ 941 ADC_10_Counter 0;
BA_ "GatewayedSignals" SG_ 941 ADC_10_Counter 0;
BA_ "GenSigInactiveValue" SG_ 941 ADC_10_Counter 0;
BA_ "GenSigInvalidValue" SG_ 941 ADC_10_Counter 0;
BA_ "GenSigSendType" SG_ 941 ADC_10_Counter 1;
BA_ "GenSigStartValue" SG_ 941 ADC_10_Counter 0;
BA_ "GenSigTimeoutValue" SG_ 941 ADC_10_Counter 0;
BA_ "Remark" SG_ 941 ADC_10_Counter "";
BA_ "EventCommandSignal" SG_ 941 PAS_APASuccNum 0;
BA_ "GatewayedSignals" SG_ 941 PAS_APASuccNum 0;
BA_ "GenSigInactiveValue" SG_ 941 PAS_APASuccNum 0;
BA_ "GenSigInvalidValue" SG_ 941 PAS_APASuccNum 0;
BA_ "GenSigSendType" SG_ 941 PAS_APASuccNum 1;
BA_ "GenSigStartValue" SG_ 941 PAS_APASuccNum 0;
BA_ "GenSigTimeoutValue" SG_ 941 PAS_APASuccNum 0;
BA_ "Remark" SG_ 941 PAS_APASuccNum "";
BA_ "EventCommandSignal" SG_ 941 ADC_HPAStrtgEndgPointInfo 0;
BA_ "GatewayedSignals" SG_ 941 ADC_HPAStrtgEndgPointInfo 0;
BA_ "GenSigInactiveValue" SG_ 941 ADC_HPAStrtgEndgPointInfo 0;
BA_ "GenSigInvalidValue" SG_ 941 ADC_HPAStrtgEndgPointInfo 0;
BA_ "GenSigSendType" SG_ 941 ADC_HPAStrtgEndgPointInfo 1;
BA_ "GenSigStartValue" SG_ 941 ADC_HPAStrtgEndgPointInfo 0;
BA_ "GenSigTimeoutValue" SG_ 941 ADC_HPAStrtgEndgPointInfo 0;
BA_ "Remark" SG_ 941 ADC_HPAStrtgEndgPointInfo "";
BA_ "EventCommandSignal" SG_ 941 ADC_HPALearningProcessInfo 0;
BA_ "GatewayedSignals" SG_ 941 ADC_HPALearningProcessInfo 0;
BA_ "GenSigInactiveValue" SG_ 941 ADC_HPALearningProcessInfo 0;
BA_ "GenSigInvalidValue" SG_ 941 ADC_HPALearningProcessInfo 0;
BA_ "GenSigSendType" SG_ 941 ADC_HPALearningProcessInfo 1;
BA_ "GenSigStartValue" SG_ 941 ADC_HPALearningProcessInfo 0;
BA_ "GenSigTimeoutValue" SG_ 941 ADC_HPALearningProcessInfo 0;
BA_ "Remark" SG_ 941 ADC_HPALearningProcessInfo "";
BA_ "EventCommandSignal" SG_ 941 ADC_HPALearningFailedInfo 0;
BA_ "GatewayedSignals" SG_ 941 ADC_HPALearningFailedInfo 0;
BA_ "GenSigInactiveValue" SG_ 941 ADC_HPALearningFailedInfo 0;
BA_ "GenSigInvalidValue" SG_ 941 ADC_HPALearningFailedInfo 0;
BA_ "GenSigSendType" SG_ 941 ADC_HPALearningFailedInfo 1;
BA_ "GenSigStartValue" SG_ 941 ADC_HPALearningFailedInfo 0;
BA_ "GenSigTimeoutValue" SG_ 941 ADC_HPALearningFailedInfo 0;
BA_ "Remark" SG_ 941 ADC_HPALearningFailedInfo "";
BA_ "EventCommandSignal" SG_ 941 ADC_HPALrngDst 0;
BA_ "GatewayedSignals" SG_ 941 ADC_HPALrngDst 0;
BA_ "GenSigInactiveValue" SG_ 941 ADC_HPALrngDst 0;
BA_ "GenSigInvalidValue" SG_ 941 ADC_HPALrngDst 0;
BA_ "GenSigSendType" SG_ 941 ADC_HPALrngDst 1;
BA_ "GenSigStartValue" SG_ 941 ADC_HPALrngDst 0;
BA_ "GenSigTimeoutValue" SG_ 941 ADC_HPALrngDst 0;
BA_ "Remark" SG_ 941 ADC_HPALrngDst "";
BA_ "EventCommandSignal" SG_ 941 ADC_HPAResRouteLeg 0;
BA_ "GatewayedSignals" SG_ 941 ADC_HPAResRouteLeg 0;
BA_ "GenSigInactiveValue" SG_ 941 ADC_HPAResRouteLeg 0;
BA_ "GenSigInvalidValue" SG_ 941 ADC_HPAResRouteLeg 0;
BA_ "GenSigSendType" SG_ 941 ADC_HPAResRouteLeg 1;
BA_ "GenSigStartValue" SG_ 941 ADC_HPAResRouteLeg 0;
BA_ "GenSigTimeoutValue" SG_ 941 ADC_HPAResRouteLeg 0;
BA_ "Remark" SG_ 941 ADC_HPAResRouteLeg "";
BA_ "EventCommandSignal" SG_ 941 ADC_HPAUseActDis 0;
BA_ "GatewayedSignals" SG_ 941 ADC_HPAUseActDis 0;
BA_ "GenSigInactiveValue" SG_ 941 ADC_HPAUseActDis 0;
BA_ "GenSigInvalidValue" SG_ 941 ADC_HPAUseActDis 0;
BA_ "GenSigSendType" SG_ 941 ADC_HPAUseActDis 1;
BA_ "GenSigStartValue" SG_ 941 ADC_HPAUseActDis 0;
BA_ "GenSigTimeoutValue" SG_ 941 ADC_HPAUseActDis 0;
BA_ "Remark" SG_ 941 ADC_HPAUseActDis "";
BA_ "EventCommandSignal" SG_ 941 ADC_HPAProcRat 0;
BA_ "GatewayedSignals" SG_ 941 ADC_HPAProcRat 0;
BA_ "GenSigInactiveValue" SG_ 941 ADC_HPAProcRat 0;
BA_ "GenSigInvalidValue" SG_ 941 ADC_HPAProcRat 0;
BA_ "GenSigSendType" SG_ 941 ADC_HPAProcRat 1;
BA_ "GenSigStartValue" SG_ 941 ADC_HPAProcRat 0;
BA_ "GenSigTimeoutValue" SG_ 941 ADC_HPAProcRat 0;
BA_ "Remark" SG_ 941 ADC_HPAProcRat "";
BA_ "EventCommandSignal" SG_ 941 ADC_HPAUseTolTime 0;
BA_ "GatewayedSignals" SG_ 941 ADC_HPAUseTolTime 0;
BA_ "GenSigInactiveValue" SG_ 941 ADC_HPAUseTolTime 0;
BA_ "GenSigInvalidValue" SG_ 941 ADC_HPAUseTolTime 0;
BA_ "GenSigSendType" SG_ 941 ADC_HPAUseTolTime 1;
BA_ "GenSigStartValue" SG_ 941 ADC_HPAUseTolTime 0;
BA_ "GenSigTimeoutValue" SG_ 941 ADC_HPAUseTolTime 0;
BA_ "Remark" SG_ 941 ADC_HPAUseTolTime "";
BA_ "EventCommandSignal" SG_ 941 ADC_ParkSlotChoiceL1 0;
BA_ "GatewayedSignals" SG_ 941 ADC_ParkSlotChoiceL1 0;
BA_ "GenSigInactiveValue" SG_ 941 ADC_ParkSlotChoiceL1 0;
BA_ "GenSigInvalidValue" SG_ 941 ADC_ParkSlotChoiceL1 0;
BA_ "GenSigSendType" SG_ 941 ADC_ParkSlotChoiceL1 1;
BA_ "GenSigStartValue" SG_ 941 ADC_ParkSlotChoiceL1 0;
BA_ "GenSigTimeoutValue" SG_ 941 ADC_ParkSlotChoiceL1 0;
BA_ "Remark" SG_ 941 ADC_ParkSlotChoiceL1 "";
BA_ "EventCommandSignal" SG_ 941 ADC_IconTwinkle 0;
BA_ "GatewayedSignals" SG_ 941 ADC_IconTwinkle 0;
BA_ "GenSigInactiveValue" SG_ 941 ADC_IconTwinkle 0;
BA_ "GenSigInvalidValue" SG_ 941 ADC_IconTwinkle 0;
BA_ "GenSigSendType" SG_ 941 ADC_IconTwinkle 1;
BA_ "GenSigStartValue" SG_ 941 ADC_IconTwinkle 0;
BA_ "GenSigTimeoutValue" SG_ 941 ADC_IconTwinkle 0;
BA_ "Remark" SG_ 941 ADC_IconTwinkle "";
BA_ "EventCommandSignal" SG_ 941 ADC_ParkSlotChoiceR1 0;
BA_ "GatewayedSignals" SG_ 941 ADC_ParkSlotChoiceR1 0;
BA_ "GenSigInactiveValue" SG_ 941 ADC_ParkSlotChoiceR1 0;
BA_ "GenSigInvalidValue" SG_ 941 ADC_ParkSlotChoiceR1 0;
BA_ "GenSigSendType" SG_ 941 ADC_ParkSlotChoiceR1 1;
BA_ "GenSigStartValue" SG_ 941 ADC_ParkSlotChoiceR1 0;
BA_ "GenSigTimeoutValue" SG_ 941 ADC_ParkSlotChoiceR1 0;
BA_ "Remark" SG_ 941 ADC_ParkSlotChoiceR1 "";
BA_ "EventCommandSignal" SG_ 941 ADC_ParkSlotChoiceL2 0;
BA_ "GatewayedSignals" SG_ 941 ADC_ParkSlotChoiceL2 0;
BA_ "GenSigInactiveValue" SG_ 941 ADC_ParkSlotChoiceL2 0;
BA_ "GenSigInvalidValue" SG_ 941 ADC_ParkSlotChoiceL2 0;
BA_ "GenSigSendType" SG_ 941 ADC_ParkSlotChoiceL2 1;
BA_ "GenSigStartValue" SG_ 941 ADC_ParkSlotChoiceL2 0;
BA_ "GenSigTimeoutValue" SG_ 941 ADC_ParkSlotChoiceL2 0;
BA_ "Remark" SG_ 941 ADC_ParkSlotChoiceL2 "";
BA_ "EventCommandSignal" SG_ 941 ADC_ParkSlotChoiceR2 0;
BA_ "GatewayedSignals" SG_ 941 ADC_ParkSlotChoiceR2 0;
BA_ "GenSigInactiveValue" SG_ 941 ADC_ParkSlotChoiceR2 0;
BA_ "GenSigInvalidValue" SG_ 941 ADC_ParkSlotChoiceR2 0;
BA_ "GenSigSendType" SG_ 941 ADC_ParkSlotChoiceR2 1;
BA_ "GenSigStartValue" SG_ 941 ADC_ParkSlotChoiceR2 0;
BA_ "GenSigTimeoutValue" SG_ 941 ADC_ParkSlotChoiceR2 0;
BA_ "Remark" SG_ 941 ADC_ParkSlotChoiceR2 "";
BA_ "EventCommandSignal" SG_ 941 ADC_ParkSlotChoiceL3 0;
BA_ "GatewayedSignals" SG_ 941 ADC_ParkSlotChoiceL3 0;
BA_ "GenSigInactiveValue" SG_ 941 ADC_ParkSlotChoiceL3 0;
BA_ "GenSigInvalidValue" SG_ 941 ADC_ParkSlotChoiceL3 0;
BA_ "GenSigSendType" SG_ 941 ADC_ParkSlotChoiceL3 1;
BA_ "GenSigStartValue" SG_ 941 ADC_ParkSlotChoiceL3 0;
BA_ "GenSigTimeoutValue" SG_ 941 ADC_ParkSlotChoiceL3 0;
BA_ "Remark" SG_ 941 ADC_ParkSlotChoiceL3 "";
BA_ "EventCommandSignal" SG_ 941 ADC_ParkSlotChoiceR3 0;
BA_ "GatewayedSignals" SG_ 941 ADC_ParkSlotChoiceR3 0;
BA_ "GenSigInactiveValue" SG_ 941 ADC_ParkSlotChoiceR3 0;
BA_ "GenSigInvalidValue" SG_ 941 ADC_ParkSlotChoiceR3 0;
BA_ "GenSigSendType" SG_ 941 ADC_ParkSlotChoiceR3 1;
BA_ "GenSigStartValue" SG_ 941 ADC_ParkSlotChoiceR3 0;
BA_ "GenSigTimeoutValue" SG_ 941 ADC_ParkSlotChoiceR3 0;
BA_ "Remark" SG_ 941 ADC_ParkSlotChoiceR3 "";
BA_ "EventCommandSignal" SG_ 941 ADC_ParkSlotChoiceL4 0;
BA_ "GatewayedSignals" SG_ 941 ADC_ParkSlotChoiceL4 0;
BA_ "GenSigInactiveValue" SG_ 941 ADC_ParkSlotChoiceL4 0;
BA_ "GenSigInvalidValue" SG_ 941 ADC_ParkSlotChoiceL4 0;
BA_ "GenSigSendType" SG_ 941 ADC_ParkSlotChoiceL4 1;
BA_ "GenSigStartValue" SG_ 941 ADC_ParkSlotChoiceL4 0;
BA_ "GenSigTimeoutValue" SG_ 941 ADC_ParkSlotChoiceL4 0;
BA_ "Remark" SG_ 941 ADC_ParkSlotChoiceL4 "";
BA_ "EventCommandSignal" SG_ 941 ADC_ParkSlotChoiceR4 0;
BA_ "GatewayedSignals" SG_ 941 ADC_ParkSlotChoiceR4 0;
BA_ "GenSigInactiveValue" SG_ 941 ADC_ParkSlotChoiceR4 0;
BA_ "GenSigInvalidValue" SG_ 941 ADC_ParkSlotChoiceR4 0;
BA_ "GenSigSendType" SG_ 941 ADC_ParkSlotChoiceR4 1;
BA_ "GenSigStartValue" SG_ 941 ADC_ParkSlotChoiceR4 0;
BA_ "GenSigTimeoutValue" SG_ 941 ADC_ParkSlotChoiceR4 0;
BA_ "Remark" SG_ 941 ADC_ParkSlotChoiceR4 "";
BA_ "EventCommandSignal" SG_ 941 ADC_ParkSlotChoiceL5 0;
BA_ "GatewayedSignals" SG_ 941 ADC_ParkSlotChoiceL5 0;
BA_ "GenSigInactiveValue" SG_ 941 ADC_ParkSlotChoiceL5 0;
BA_ "GenSigInvalidValue" SG_ 941 ADC_ParkSlotChoiceL5 0;
BA_ "GenSigSendType" SG_ 941 ADC_ParkSlotChoiceL5 1;
BA_ "GenSigStartValue" SG_ 941 ADC_ParkSlotChoiceL5 0;
BA_ "GenSigTimeoutValue" SG_ 941 ADC_ParkSlotChoiceL5 0;
BA_ "Remark" SG_ 941 ADC_ParkSlotChoiceL5 "";
BA_ "EventCommandSignal" SG_ 941 ADC_ParkSlotChoiceR5 0;
BA_ "GatewayedSignals" SG_ 941 ADC_ParkSlotChoiceR5 0;
BA_ "GenSigInactiveValue" SG_ 941 ADC_ParkSlotChoiceR5 0;
BA_ "GenSigInvalidValue" SG_ 941 ADC_ParkSlotChoiceR5 0;
BA_ "GenSigSendType" SG_ 941 ADC_ParkSlotChoiceR5 1;
BA_ "GenSigStartValue" SG_ 941 ADC_ParkSlotChoiceR5 0;
BA_ "GenSigTimeoutValue" SG_ 941 ADC_ParkSlotChoiceR5 0;
BA_ "Remark" SG_ 941 ADC_ParkSlotChoiceR5 "";
BA_ "EventCommandSignal" SG_ 941 ADC_ParkSlotChoiceL6 0;
BA_ "GatewayedSignals" SG_ 941 ADC_ParkSlotChoiceL6 0;
BA_ "GenSigInactiveValue" SG_ 941 ADC_ParkSlotChoiceL6 0;
BA_ "GenSigInvalidValue" SG_ 941 ADC_ParkSlotChoiceL6 0;
BA_ "GenSigSendType" SG_ 941 ADC_ParkSlotChoiceL6 1;
BA_ "GenSigStartValue" SG_ 941 ADC_ParkSlotChoiceL6 0;
BA_ "GenSigTimeoutValue" SG_ 941 ADC_ParkSlotChoiceL6 0;
BA_ "Remark" SG_ 941 ADC_ParkSlotChoiceL6 "";
BA_ "EventCommandSignal" SG_ 941 ADC_ParkSlotChoiceR6 0;
BA_ "GatewayedSignals" SG_ 941 ADC_ParkSlotChoiceR6 0;
BA_ "GenSigInactiveValue" SG_ 941 ADC_ParkSlotChoiceR6 0;
BA_ "GenSigInvalidValue" SG_ 941 ADC_ParkSlotChoiceR6 0;
BA_ "GenSigSendType" SG_ 941 ADC_ParkSlotChoiceR6 1;
BA_ "GenSigStartValue" SG_ 941 ADC_ParkSlotChoiceR6 0;
BA_ "GenSigTimeoutValue" SG_ 941 ADC_ParkSlotChoiceR6 0;
BA_ "Remark" SG_ 941 ADC_ParkSlotChoiceR6 "";
BA_ "EventCommandSignal" SG_ 941 ADC_ParkSlotChoiceL7 0;
BA_ "GatewayedSignals" SG_ 941 ADC_ParkSlotChoiceL7 0;
BA_ "GenSigInactiveValue" SG_ 941 ADC_ParkSlotChoiceL7 0;
BA_ "GenSigInvalidValue" SG_ 941 ADC_ParkSlotChoiceL7 0;
BA_ "GenSigSendType" SG_ 941 ADC_ParkSlotChoiceL7 1;
BA_ "GenSigStartValue" SG_ 941 ADC_ParkSlotChoiceL7 0;
BA_ "GenSigTimeoutValue" SG_ 941 ADC_ParkSlotChoiceL7 0;
BA_ "Remark" SG_ 941 ADC_ParkSlotChoiceL7 "";
BA_ "EventCommandSignal" SG_ 941 ADC_ParkSlotChoiceR7 0;
BA_ "GatewayedSignals" SG_ 941 ADC_ParkSlotChoiceR7 0;
BA_ "GenSigInactiveValue" SG_ 941 ADC_ParkSlotChoiceR7 0;
BA_ "GenSigInvalidValue" SG_ 941 ADC_ParkSlotChoiceR7 0;
BA_ "GenSigSendType" SG_ 941 ADC_ParkSlotChoiceR7 1;
BA_ "GenSigStartValue" SG_ 941 ADC_ParkSlotChoiceR7 0;
BA_ "GenSigTimeoutValue" SG_ 941 ADC_ParkSlotChoiceR7 0;
BA_ "Remark" SG_ 941 ADC_ParkSlotChoiceR7 "";
BA_ "EventCommandSignal" SG_ 941 ADC_ParkSlotChoiceL8 0;
BA_ "GatewayedSignals" SG_ 941 ADC_ParkSlotChoiceL8 0;
BA_ "GenSigInactiveValue" SG_ 941 ADC_ParkSlotChoiceL8 0;
BA_ "GenSigInvalidValue" SG_ 941 ADC_ParkSlotChoiceL8 0;
BA_ "GenSigSendType" SG_ 941 ADC_ParkSlotChoiceL8 1;
BA_ "GenSigStartValue" SG_ 941 ADC_ParkSlotChoiceL8 0;
BA_ "GenSigTimeoutValue" SG_ 941 ADC_ParkSlotChoiceL8 0;
BA_ "Remark" SG_ 941 ADC_ParkSlotChoiceL8 "";
BA_ "EventCommandSignal" SG_ 941 ADC_ParkSlotChoiceR8 0;
BA_ "GatewayedSignals" SG_ 941 ADC_ParkSlotChoiceR8 0;
BA_ "GenSigInactiveValue" SG_ 941 ADC_ParkSlotChoiceR8 0;
BA_ "GenSigInvalidValue" SG_ 941 ADC_ParkSlotChoiceR8 0;
BA_ "GenSigSendType" SG_ 941 ADC_ParkSlotChoiceR8 1;
BA_ "GenSigStartValue" SG_ 941 ADC_ParkSlotChoiceR8 0;
BA_ "GenSigTimeoutValue" SG_ 941 ADC_ParkSlotChoiceR8 0;
BA_ "Remark" SG_ 941 ADC_ParkSlotChoiceR8 "";
BA_ "EventCommandSignal" SG_ 941 ADC_SlotSelectFebk 0;
BA_ "GatewayedSignals" SG_ 941 ADC_SlotSelectFebk 0;
BA_ "GenSigInactiveValue" SG_ 941 ADC_SlotSelectFebk 0;
BA_ "GenSigInvalidValue" SG_ 941 ADC_SlotSelectFebk 0;
BA_ "GenSigSendType" SG_ 941 ADC_SlotSelectFebk 1;
BA_ "GenSigStartValue" SG_ 941 ADC_SlotSelectFebk 0;
BA_ "GenSigTimeoutValue" SG_ 941 ADC_SlotSelectFebk 0;
BA_ "Remark" SG_ 941 ADC_SlotSelectFebk "";
BA_ "EventCommandSignal" SG_ 941 ADC_AVPParkSlotInfo 0;
BA_ "GatewayedSignals" SG_ 941 ADC_AVPParkSlotInfo 0;
BA_ "GenSigInactiveValue" SG_ 941 ADC_AVPParkSlotInfo 0;
BA_ "GenSigInvalidValue" SG_ 941 ADC_AVPParkSlotInfo 0;
BA_ "GenSigSendType" SG_ 941 ADC_AVPParkSlotInfo 1;
BA_ "GenSigStartValue" SG_ 941 ADC_AVPParkSlotInfo 0;
BA_ "GenSigTimeoutValue" SG_ 941 ADC_AVPParkSlotInfo 0;
BA_ "Remark" SG_ 941 ADC_AVPParkSlotInfo "";
BA_ "EventCommandSignal" SG_ 941 ADC_SwitchStShow 0;
BA_ "GatewayedSignals" SG_ 941 ADC_SwitchStShow 0;
BA_ "GenSigInactiveValue" SG_ 941 ADC_SwitchStShow 0;
BA_ "GenSigInvalidValue" SG_ 941 ADC_SwitchStShow 0;
BA_ "GenSigSendType" SG_ 941 ADC_SwitchStShow 1;
BA_ "GenSigStartValue" SG_ 941 ADC_SwitchStShow 0;
BA_ "GenSigTimeoutValue" SG_ 941 ADC_SwitchStShow 0;
BA_ "Remark" SG_ 941 ADC_SwitchStShow "";
BA_ "EventCommandSignal" SG_ 941 FAPA_RPAShortPresSuppSt 0;
BA_ "GatewayedSignals" SG_ 941 FAPA_RPAShortPresSuppSt 0;
BA_ "GenSigInactiveValue" SG_ 941 FAPA_RPAShortPresSuppSt 0;
BA_ "GenSigInvalidValue" SG_ 941 FAPA_RPAShortPresSuppSt 0;
BA_ "GenSigSendType" SG_ 941 FAPA_RPAShortPresSuppSt 1;
BA_ "GenSigStartValue" SG_ 941 FAPA_RPAShortPresSuppSt 0;
BA_ "GenSigTimeoutValue" SG_ 941 FAPA_RPAShortPresSuppSt 0;
BA_ "Remark" SG_ 941 FAPA_RPAShortPresSuppSt "";
BA_ "EventCommandSignal" SG_ 941 ADC_HPASwitchStShow 0;
BA_ "GatewayedSignals" SG_ 941 ADC_HPASwitchStShow 0;
BA_ "GenSigInactiveValue" SG_ 941 ADC_HPASwitchStShow 0;
BA_ "GenSigInvalidValue" SG_ 941 ADC_HPASwitchStShow 0;
BA_ "GenSigSendType" SG_ 941 ADC_HPASwitchStShow 1;
BA_ "GenSigStartValue" SG_ 941 ADC_HPASwitchStShow 0;
BA_ "GenSigTimeoutValue" SG_ 941 ADC_HPASwitchStShow 0;
BA_ "Remark" SG_ 941 ADC_HPASwitchStShow "";
BA_ "EventCommandSignal" SG_ 941 ADC_AVPSwitchStShow 0;
BA_ "GatewayedSignals" SG_ 941 ADC_AVPSwitchStShow 0;
BA_ "GenSigInactiveValue" SG_ 941 ADC_AVPSwitchStShow 0;
BA_ "GenSigInvalidValue" SG_ 941 ADC_AVPSwitchStShow 0;
BA_ "GenSigSendType" SG_ 941 ADC_AVPSwitchStShow 1;
BA_ "GenSigStartValue" SG_ 941 ADC_AVPSwitchStShow 0;
BA_ "GenSigTimeoutValue" SG_ 941 ADC_AVPSwitchStShow 0;
BA_ "Remark" SG_ 941 ADC_AVPSwitchStShow "";
BA_ "EventCommandSignal" SG_ 941 ADC_HPALearningPathType1 0;
BA_ "GatewayedSignals" SG_ 941 ADC_HPALearningPathType1 0;
BA_ "GenSigInactiveValue" SG_ 941 ADC_HPALearningPathType1 0;
BA_ "GenSigInvalidValue" SG_ 941 ADC_HPALearningPathType1 0;
BA_ "GenSigSendType" SG_ 941 ADC_HPALearningPathType1 1;
BA_ "GenSigStartValue" SG_ 941 ADC_HPALearningPathType1 0;
BA_ "GenSigTimeoutValue" SG_ 941 ADC_HPALearningPathType1 0;
BA_ "Remark" SG_ 941 ADC_HPALearningPathType1 "";
BA_ "EventCommandSignal" SG_ 941 ADC_HPALearningLotType1 0;
BA_ "GatewayedSignals" SG_ 941 ADC_HPALearningLotType1 0;
BA_ "GenSigInactiveValue" SG_ 941 ADC_HPALearningLotType1 0;
BA_ "GenSigInvalidValue" SG_ 941 ADC_HPALearningLotType1 0;
BA_ "GenSigSendType" SG_ 941 ADC_HPALearningLotType1 1;
BA_ "GenSigStartValue" SG_ 941 ADC_HPALearningLotType1 0;
BA_ "GenSigTimeoutValue" SG_ 941 ADC_HPALearningLotType1 0;
BA_ "Remark" SG_ 941 ADC_HPALearningLotType1 "";
BA_ "EventCommandSignal" SG_ 941 ADC_HPALearningPathNum1 0;
BA_ "GatewayedSignals" SG_ 941 ADC_HPALearningPathNum1 0;
BA_ "GenSigInactiveValue" SG_ 941 ADC_HPALearningPathNum1 0;
BA_ "GenSigInvalidValue" SG_ 941 ADC_HPALearningPathNum1 0;
BA_ "GenSigSendType" SG_ 941 ADC_HPALearningPathNum1 1;
BA_ "GenSigStartValue" SG_ 941 ADC_HPALearningPathNum1 0;
BA_ "GenSigTimeoutValue" SG_ 941 ADC_HPALearningPathNum1 0;
BA_ "Remark" SG_ 941 ADC_HPALearningPathNum1 "";
BA_ "EventCommandSignal" SG_ 941 ADC_HPAPathLearnRate1 0;
BA_ "GatewayedSignals" SG_ 941 ADC_HPAPathLearnRate1 0;
BA_ "GenSigInactiveValue" SG_ 941 ADC_HPAPathLearnRate1 0;
BA_ "GenSigInvalidValue" SG_ 941 ADC_HPAPathLearnRate1 0;
BA_ "GenSigSendType" SG_ 941 ADC_HPAPathLearnRate1 1;
BA_ "GenSigStartValue" SG_ 941 ADC_HPAPathLearnRate1 0;
BA_ "GenSigTimeoutValue" SG_ 941 ADC_HPAPathLearnRate1 0;
BA_ "Remark" SG_ 941 ADC_HPAPathLearnRate1 "";
BA_ "EventCommandSignal" SG_ 941 ADC_HPAPathSt1 0;
BA_ "GatewayedSignals" SG_ 941 ADC_HPAPathSt1 0;
BA_ "GenSigInactiveValue" SG_ 941 ADC_HPAPathSt1 0;
BA_ "GenSigInvalidValue" SG_ 941 ADC_HPAPathSt1 0;
BA_ "GenSigSendType" SG_ 941 ADC_HPAPathSt1 1;
BA_ "GenSigStartValue" SG_ 941 ADC_HPAPathSt1 0;
BA_ "GenSigTimeoutValue" SG_ 941 ADC_HPAPathSt1 0;
BA_ "Remark" SG_ 941 ADC_HPAPathSt1 "";
BA_ "EventCommandSignal" SG_ 941 ADC_HPAPath1Src 0;
BA_ "GatewayedSignals" SG_ 941 ADC_HPAPath1Src 0;
BA_ "GenSigInactiveValue" SG_ 941 ADC_HPAPath1Src 0;
BA_ "GenSigInvalidValue" SG_ 941 ADC_HPAPath1Src 0;
BA_ "GenSigSendType" SG_ 941 ADC_HPAPath1Src 1;
BA_ "GenSigStartValue" SG_ 941 ADC_HPAPath1Src 0;
BA_ "GenSigTimeoutValue" SG_ 941 ADC_HPAPath1Src 0;
BA_ "Remark" SG_ 941 ADC_HPAPath1Src "";
BA_ "EventCommandSignal" SG_ 941 ADC_HPAPathDst1 0;
BA_ "GatewayedSignals" SG_ 941 ADC_HPAPathDst1 0;
BA_ "GenSigInactiveValue" SG_ 941 ADC_HPAPathDst1 0;
BA_ "GenSigInvalidValue" SG_ 941 ADC_HPAPathDst1 0;
BA_ "GenSigSendType" SG_ 941 ADC_HPAPathDst1 1;
BA_ "GenSigStartValue" SG_ 941 ADC_HPAPathDst1 0;
BA_ "GenSigTimeoutValue" SG_ 941 ADC_HPAPathDst1 0;
BA_ "Remark" SG_ 941 ADC_HPAPathDst1 "";
BA_ "EventCommandSignal" SG_ 941 ADC_HPALearningPathNum2 0;
BA_ "GatewayedSignals" SG_ 941 ADC_HPALearningPathNum2 0;
BA_ "GenSigInactiveValue" SG_ 941 ADC_HPALearningPathNum2 0;
BA_ "GenSigInvalidValue" SG_ 941 ADC_HPALearningPathNum2 0;
BA_ "GenSigSendType" SG_ 941 ADC_HPALearningPathNum2 1;
BA_ "GenSigStartValue" SG_ 941 ADC_HPALearningPathNum2 0;
BA_ "GenSigTimeoutValue" SG_ 941 ADC_HPALearningPathNum2 0;
BA_ "Remark" SG_ 941 ADC_HPALearningPathNum2 "";
BA_ "EventCommandSignal" SG_ 941 ADC_HPAHAVPPathLearnRate2 0;
BA_ "GatewayedSignals" SG_ 941 ADC_HPAHAVPPathLearnRate2 0;
BA_ "GenSigInactiveValue" SG_ 941 ADC_HPAHAVPPathLearnRate2 0;
BA_ "GenSigInvalidValue" SG_ 941 ADC_HPAHAVPPathLearnRate2 0;
BA_ "GenSigSendType" SG_ 941 ADC_HPAHAVPPathLearnRate2 1;
BA_ "GenSigStartValue" SG_ 941 ADC_HPAHAVPPathLearnRate2 0;
BA_ "GenSigTimeoutValue" SG_ 941 ADC_HPAHAVPPathLearnRate2 0;
BA_ "Remark" SG_ 941 ADC_HPAHAVPPathLearnRate2 "";
BA_ "EventCommandSignal" SG_ 941 ADC_HPALearningPathType2 0;
BA_ "GatewayedSignals" SG_ 941 ADC_HPALearningPathType2 0;
BA_ "GenSigInactiveValue" SG_ 941 ADC_HPALearningPathType2 0;
BA_ "GenSigInvalidValue" SG_ 941 ADC_HPALearningPathType2 0;
BA_ "GenSigSendType" SG_ 941 ADC_HPALearningPathType2 1;
BA_ "GenSigStartValue" SG_ 941 ADC_HPALearningPathType2 0;
BA_ "GenSigTimeoutValue" SG_ 941 ADC_HPALearningPathType2 0;
BA_ "Remark" SG_ 941 ADC_HPALearningPathType2 "";
BA_ "EventCommandSignal" SG_ 941 ADC_HPALearningLotType2 0;
BA_ "GatewayedSignals" SG_ 941 ADC_HPALearningLotType2 0;
BA_ "GenSigInactiveValue" SG_ 941 ADC_HPALearningLotType2 0;
BA_ "GenSigInvalidValue" SG_ 941 ADC_HPALearningLotType2 0;
BA_ "GenSigSendType" SG_ 941 ADC_HPALearningLotType2 1;
BA_ "GenSigStartValue" SG_ 941 ADC_HPALearningLotType2 0;
BA_ "GenSigTimeoutValue" SG_ 941 ADC_HPALearningLotType2 0;
BA_ "Remark" SG_ 941 ADC_HPALearningLotType2 "";
BA_ "EventCommandSignal" SG_ 941 ADC_HPAPathSt2 0;
BA_ "GatewayedSignals" SG_ 941 ADC_HPAPathSt2 0;
BA_ "GenSigInactiveValue" SG_ 941 ADC_HPAPathSt2 0;
BA_ "GenSigInvalidValue" SG_ 941 ADC_HPAPathSt2 0;
BA_ "GenSigSendType" SG_ 941 ADC_HPAPathSt2 1;
BA_ "GenSigStartValue" SG_ 941 ADC_HPAPathSt2 0;
BA_ "GenSigTimeoutValue" SG_ 941 ADC_HPAPathSt2 0;
BA_ "Remark" SG_ 941 ADC_HPAPathSt2 "";
BA_ "EventCommandSignal" SG_ 941 ADC_HPAPath2Src 0;
BA_ "GatewayedSignals" SG_ 941 ADC_HPAPath2Src 0;
BA_ "GenSigInactiveValue" SG_ 941 ADC_HPAPath2Src 0;
BA_ "GenSigInvalidValue" SG_ 941 ADC_HPAPath2Src 0;
BA_ "GenSigSendType" SG_ 941 ADC_HPAPath2Src 1;
BA_ "GenSigStartValue" SG_ 941 ADC_HPAPath2Src 0;
BA_ "GenSigTimeoutValue" SG_ 941 ADC_HPAPath2Src 0;
BA_ "Remark" SG_ 941 ADC_HPAPath2Src "";
BA_ "EventCommandSignal" SG_ 941 ADC_HPAPathDst2 0;
BA_ "GatewayedSignals" SG_ 941 ADC_HPAPathDst2 0;
BA_ "GenSigInactiveValue" SG_ 941 ADC_HPAPathDst2 0;
BA_ "GenSigInvalidValue" SG_ 941 ADC_HPAPathDst2 0;
BA_ "GenSigSendType" SG_ 941 ADC_HPAPathDst2 1;
BA_ "GenSigStartValue" SG_ 941 ADC_HPAPathDst2 0;
BA_ "GenSigTimeoutValue" SG_ 941 ADC_HPAPathDst2 0;
BA_ "Remark" SG_ 941 ADC_HPAPathDst2 "";
BA_ "EventCommandSignal" SG_ 941 ADC_HPAPath1MatGpsSucces 0;
BA_ "GatewayedSignals" SG_ 941 ADC_HPAPath1MatGpsSucces 0;
BA_ "GenSigInactiveValue" SG_ 941 ADC_HPAPath1MatGpsSucces 0;
BA_ "GenSigInvalidValue" SG_ 941 ADC_HPAPath1MatGpsSucces 0;
BA_ "GenSigSendType" SG_ 941 ADC_HPAPath1MatGpsSucces 1;
BA_ "GenSigStartValue" SG_ 941 ADC_HPAPath1MatGpsSucces 0;
BA_ "GenSigTimeoutValue" SG_ 941 ADC_HPAPath1MatGpsSucces 0;
BA_ "Remark" SG_ 941 ADC_HPAPath1MatGpsSucces "";
BA_ "EventCommandSignal" SG_ 941 ADC_HPAPath2MatGpsSucces 0;
BA_ "GatewayedSignals" SG_ 941 ADC_HPAPath2MatGpsSucces 0;
BA_ "GenSigInactiveValue" SG_ 941 ADC_HPAPath2MatGpsSucces 0;
BA_ "GenSigInvalidValue" SG_ 941 ADC_HPAPath2MatGpsSucces 0;
BA_ "GenSigSendType" SG_ 941 ADC_HPAPath2MatGpsSucces 1;
BA_ "GenSigStartValue" SG_ 941 ADC_HPAPath2MatGpsSucces 0;
BA_ "GenSigTimeoutValue" SG_ 941 ADC_HPAPath2MatGpsSucces 0;
BA_ "Remark" SG_ 941 ADC_HPAPath2MatGpsSucces "";
BA_ "EventCommandSignal" SG_ 941 ADC_HPALearningPathType3 0;
BA_ "GatewayedSignals" SG_ 941 ADC_HPALearningPathType3 0;
BA_ "GenSigInactiveValue" SG_ 941 ADC_HPALearningPathType3 0;
BA_ "GenSigInvalidValue" SG_ 941 ADC_HPALearningPathType3 0;
BA_ "GenSigSendType" SG_ 941 ADC_HPALearningPathType3 1;
BA_ "GenSigStartValue" SG_ 941 ADC_HPALearningPathType3 0;
BA_ "GenSigTimeoutValue" SG_ 941 ADC_HPALearningPathType3 0;
BA_ "Remark" SG_ 941 ADC_HPALearningPathType3 "";
BA_ "EventCommandSignal" SG_ 941 ADC_HPALearningPathNum3 0;
BA_ "GatewayedSignals" SG_ 941 ADC_HPALearningPathNum3 0;
BA_ "GenSigInactiveValue" SG_ 941 ADC_HPALearningPathNum3 0;
BA_ "GenSigInvalidValue" SG_ 941 ADC_HPALearningPathNum3 0;
BA_ "GenSigSendType" SG_ 941 ADC_HPALearningPathNum3 1;
BA_ "GenSigStartValue" SG_ 941 ADC_HPALearningPathNum3 0;
BA_ "GenSigTimeoutValue" SG_ 941 ADC_HPALearningPathNum3 0;
BA_ "Remark" SG_ 941 ADC_HPALearningPathNum3 "";
BA_ "EventCommandSignal" SG_ 941 ADC_HPAPathLearnRate3 0;
BA_ "GatewayedSignals" SG_ 941 ADC_HPAPathLearnRate3 0;
BA_ "GenSigInactiveValue" SG_ 941 ADC_HPAPathLearnRate3 0;
BA_ "GenSigInvalidValue" SG_ 941 ADC_HPAPathLearnRate3 0;
BA_ "GenSigSendType" SG_ 941 ADC_HPAPathLearnRate3 1;
BA_ "GenSigStartValue" SG_ 941 ADC_HPAPathLearnRate3 0;
BA_ "GenSigTimeoutValue" SG_ 941 ADC_HPAPathLearnRate3 0;
BA_ "Remark" SG_ 941 ADC_HPAPathLearnRate3 "";
BA_ "EventCommandSignal" SG_ 941 ADC_HPALearningLotType3 0;
BA_ "GatewayedSignals" SG_ 941 ADC_HPALearningLotType3 0;
BA_ "GenSigInactiveValue" SG_ 941 ADC_HPALearningLotType3 0;
BA_ "GenSigInvalidValue" SG_ 941 ADC_HPALearningLotType3 0;
BA_ "GenSigSendType" SG_ 941 ADC_HPALearningLotType3 1;
BA_ "GenSigStartValue" SG_ 941 ADC_HPALearningLotType3 0;
BA_ "GenSigTimeoutValue" SG_ 941 ADC_HPALearningLotType3 0;
BA_ "Remark" SG_ 941 ADC_HPALearningLotType3 "";
BA_ "EventCommandSignal" SG_ 941 ADC_HPAPathSt3 0;
BA_ "GatewayedSignals" SG_ 941 ADC_HPAPathSt3 0;
BA_ "GenSigInactiveValue" SG_ 941 ADC_HPAPathSt3 0;
BA_ "GenSigInvalidValue" SG_ 941 ADC_HPAPathSt3 0;
BA_ "GenSigSendType" SG_ 941 ADC_HPAPathSt3 1;
BA_ "GenSigStartValue" SG_ 941 ADC_HPAPathSt3 0;
BA_ "GenSigTimeoutValue" SG_ 941 ADC_HPAPathSt3 0;
BA_ "Remark" SG_ 941 ADC_HPAPathSt3 "";
BA_ "EventCommandSignal" SG_ 941 ADC_HPAPath3Src 0;
BA_ "GatewayedSignals" SG_ 941 ADC_HPAPath3Src 0;
BA_ "GenSigInactiveValue" SG_ 941 ADC_HPAPath3Src 0;
BA_ "GenSigInvalidValue" SG_ 941 ADC_HPAPath3Src 0;
BA_ "GenSigSendType" SG_ 941 ADC_HPAPath3Src 1;
BA_ "GenSigStartValue" SG_ 941 ADC_HPAPath3Src 0;
BA_ "GenSigTimeoutValue" SG_ 941 ADC_HPAPath3Src 0;
BA_ "Remark" SG_ 941 ADC_HPAPath3Src "";
BA_ "EventCommandSignal" SG_ 941 ADC_HPAPathDst3 0;
BA_ "GatewayedSignals" SG_ 941 ADC_HPAPathDst3 0;
BA_ "GenSigInactiveValue" SG_ 941 ADC_HPAPathDst3 0;
BA_ "GenSigInvalidValue" SG_ 941 ADC_HPAPathDst3 0;
BA_ "GenSigSendType" SG_ 941 ADC_HPAPathDst3 1;
BA_ "GenSigStartValue" SG_ 941 ADC_HPAPathDst3 0;
BA_ "GenSigTimeoutValue" SG_ 941 ADC_HPAPathDst3 0;
BA_ "Remark" SG_ 941 ADC_HPAPathDst3 "";
BA_ "EventCommandSignal" SG_ 941 ADC_HPALearningPathNum4 0;
BA_ "GatewayedSignals" SG_ 941 ADC_HPALearningPathNum4 0;
BA_ "GenSigInactiveValue" SG_ 941 ADC_HPALearningPathNum4 0;
BA_ "GenSigInvalidValue" SG_ 941 ADC_HPALearningPathNum4 0;
BA_ "GenSigSendType" SG_ 941 ADC_HPALearningPathNum4 1;
BA_ "GenSigStartValue" SG_ 941 ADC_HPALearningPathNum4 0;
BA_ "GenSigTimeoutValue" SG_ 941 ADC_HPALearningPathNum4 0;
BA_ "Remark" SG_ 941 ADC_HPALearningPathNum4 "";
BA_ "EventCommandSignal" SG_ 941 ADC_HPAPathLearnRate4 0;
BA_ "GatewayedSignals" SG_ 941 ADC_HPAPathLearnRate4 0;
BA_ "GenSigInactiveValue" SG_ 941 ADC_HPAPathLearnRate4 0;
BA_ "GenSigInvalidValue" SG_ 941 ADC_HPAPathLearnRate4 0;
BA_ "GenSigSendType" SG_ 941 ADC_HPAPathLearnRate4 1;
BA_ "GenSigStartValue" SG_ 941 ADC_HPAPathLearnRate4 0;
BA_ "GenSigTimeoutValue" SG_ 941 ADC_HPAPathLearnRate4 0;
BA_ "Remark" SG_ 941 ADC_HPAPathLearnRate4 "";
BA_ "EventCommandSignal" SG_ 941 ADC_HPALearningPathType4 0;
BA_ "GatewayedSignals" SG_ 941 ADC_HPALearningPathType4 0;
BA_ "GenSigInactiveValue" SG_ 941 ADC_HPALearningPathType4 0;
BA_ "GenSigInvalidValue" SG_ 941 ADC_HPALearningPathType4 0;
BA_ "GenSigSendType" SG_ 941 ADC_HPALearningPathType4 1;
BA_ "GenSigStartValue" SG_ 941 ADC_HPALearningPathType4 0;
BA_ "GenSigTimeoutValue" SG_ 941 ADC_HPALearningPathType4 0;
BA_ "Remark" SG_ 941 ADC_HPALearningPathType4 "";
BA_ "EventCommandSignal" SG_ 941 ADC_HPALearningLotType4 0;
BA_ "GatewayedSignals" SG_ 941 ADC_HPALearningLotType4 0;
BA_ "GenSigInactiveValue" SG_ 941 ADC_HPALearningLotType4 0;
BA_ "GenSigInvalidValue" SG_ 941 ADC_HPALearningLotType4 0;
BA_ "GenSigSendType" SG_ 941 ADC_HPALearningLotType4 1;
BA_ "GenSigStartValue" SG_ 941 ADC_HPALearningLotType4 0;
BA_ "GenSigTimeoutValue" SG_ 941 ADC_HPALearningLotType4 0;
BA_ "Remark" SG_ 941 ADC_HPALearningLotType4 "";
BA_ "EventCommandSignal" SG_ 941 ADC_HPAPathSt4 0;
BA_ "GatewayedSignals" SG_ 941 ADC_HPAPathSt4 0;
BA_ "GenSigInactiveValue" SG_ 941 ADC_HPAPathSt4 0;
BA_ "GenSigInvalidValue" SG_ 941 ADC_HPAPathSt4 0;
BA_ "GenSigSendType" SG_ 941 ADC_HPAPathSt4 1;
BA_ "GenSigStartValue" SG_ 941 ADC_HPAPathSt4 0;
BA_ "GenSigTimeoutValue" SG_ 941 ADC_HPAPathSt4 0;
BA_ "Remark" SG_ 941 ADC_HPAPathSt4 "";
BA_ "EventCommandSignal" SG_ 941 ADC_HPAPath4Src 0;
BA_ "GatewayedSignals" SG_ 941 ADC_HPAPath4Src 0;
BA_ "GenSigInactiveValue" SG_ 941 ADC_HPAPath4Src 0;
BA_ "GenSigInvalidValue" SG_ 941 ADC_HPAPath4Src 0;
BA_ "GenSigSendType" SG_ 941 ADC_HPAPath4Src 1;
BA_ "GenSigStartValue" SG_ 941 ADC_HPAPath4Src 0;
BA_ "GenSigTimeoutValue" SG_ 941 ADC_HPAPath4Src 0;
BA_ "Remark" SG_ 941 ADC_HPAPath4Src "";
BA_ "EventCommandSignal" SG_ 941 ADC_HPAPathDst4 0;
BA_ "GatewayedSignals" SG_ 941 ADC_HPAPathDst4 0;
BA_ "GenSigInactiveValue" SG_ 941 ADC_HPAPathDst4 0;
BA_ "GenSigInvalidValue" SG_ 941 ADC_HPAPathDst4 0;
BA_ "GenSigSendType" SG_ 941 ADC_HPAPathDst4 1;
BA_ "GenSigStartValue" SG_ 941 ADC_HPAPathDst4 0;
BA_ "GenSigTimeoutValue" SG_ 941 ADC_HPAPathDst4 0;
BA_ "Remark" SG_ 941 ADC_HPAPathDst4 "";
BA_ "EventCommandSignal" SG_ 941 ADC_HPAPath3MatGpsSucces 0;
BA_ "GatewayedSignals" SG_ 941 ADC_HPAPath3MatGpsSucces 0;
BA_ "GenSigInactiveValue" SG_ 941 ADC_HPAPath3MatGpsSucces 0;
BA_ "GenSigInvalidValue" SG_ 941 ADC_HPAPath3MatGpsSucces 0;
BA_ "GenSigSendType" SG_ 941 ADC_HPAPath3MatGpsSucces 1;
BA_ "GenSigStartValue" SG_ 941 ADC_HPAPath3MatGpsSucces 0;
BA_ "GenSigTimeoutValue" SG_ 941 ADC_HPAPath3MatGpsSucces 0;
BA_ "Remark" SG_ 941 ADC_HPAPath3MatGpsSucces "";
BA_ "EventCommandSignal" SG_ 941 ADC_HPAPath4MatGpsSucces 0;
BA_ "GatewayedSignals" SG_ 941 ADC_HPAPath4MatGpsSucces 0;
BA_ "GenSigInactiveValue" SG_ 941 ADC_HPAPath4MatGpsSucces 0;
BA_ "GenSigInvalidValue" SG_ 941 ADC_HPAPath4MatGpsSucces 0;
BA_ "GenSigSendType" SG_ 941 ADC_HPAPath4MatGpsSucces 1;
BA_ "GenSigStartValue" SG_ 941 ADC_HPAPath4MatGpsSucces 0;
BA_ "GenSigTimeoutValue" SG_ 941 ADC_HPAPath4MatGpsSucces 0;
BA_ "Remark" SG_ 941 ADC_HPAPath4MatGpsSucces "";
BA_ "EventCommandSignal" SG_ 941 ADC_HPALearningPathNum5 0;
BA_ "GatewayedSignals" SG_ 941 ADC_HPALearningPathNum5 0;
BA_ "GenSigInactiveValue" SG_ 941 ADC_HPALearningPathNum5 0;
BA_ "GenSigInvalidValue" SG_ 941 ADC_HPALearningPathNum5 0;
BA_ "GenSigSendType" SG_ 941 ADC_HPALearningPathNum5 1;
BA_ "GenSigStartValue" SG_ 941 ADC_HPALearningPathNum5 0;
BA_ "GenSigTimeoutValue" SG_ 941 ADC_HPALearningPathNum5 0;
BA_ "Remark" SG_ 941 ADC_HPALearningPathNum5 "";
BA_ "EventCommandSignal" SG_ 941 ADC_HPAPathLearnRate5 0;
BA_ "GatewayedSignals" SG_ 941 ADC_HPAPathLearnRate5 0;
BA_ "GenSigInactiveValue" SG_ 941 ADC_HPAPathLearnRate5 0;
BA_ "GenSigInvalidValue" SG_ 941 ADC_HPAPathLearnRate5 0;
BA_ "GenSigSendType" SG_ 941 ADC_HPAPathLearnRate5 1;
BA_ "GenSigStartValue" SG_ 941 ADC_HPAPathLearnRate5 0;
BA_ "GenSigTimeoutValue" SG_ 941 ADC_HPAPathLearnRate5 0;
BA_ "Remark" SG_ 941 ADC_HPAPathLearnRate5 "";
BA_ "EventCommandSignal" SG_ 941 ADC_HPALearningPathType5 0;
BA_ "GatewayedSignals" SG_ 941 ADC_HPALearningPathType5 0;
BA_ "GenSigInactiveValue" SG_ 941 ADC_HPALearningPathType5 0;
BA_ "GenSigInvalidValue" SG_ 941 ADC_HPALearningPathType5 0;
BA_ "GenSigSendType" SG_ 941 ADC_HPALearningPathType5 1;
BA_ "GenSigStartValue" SG_ 941 ADC_HPALearningPathType5 0;
BA_ "GenSigTimeoutValue" SG_ 941 ADC_HPALearningPathType5 0;
BA_ "Remark" SG_ 941 ADC_HPALearningPathType5 "";
BA_ "EventCommandSignal" SG_ 941 ADC_HPALearningLotType5 0;
BA_ "GatewayedSignals" SG_ 941 ADC_HPALearningLotType5 0;
BA_ "GenSigInactiveValue" SG_ 941 ADC_HPALearningLotType5 0;
BA_ "GenSigInvalidValue" SG_ 941 ADC_HPALearningLotType5 0;
BA_ "GenSigSendType" SG_ 941 ADC_HPALearningLotType5 1;
BA_ "GenSigStartValue" SG_ 941 ADC_HPALearningLotType5 0;
BA_ "GenSigTimeoutValue" SG_ 941 ADC_HPALearningLotType5 0;
BA_ "Remark" SG_ 941 ADC_HPALearningLotType5 "";
BA_ "EventCommandSignal" SG_ 941 ADC_HPAPathSt5 0;
BA_ "GatewayedSignals" SG_ 941 ADC_HPAPathSt5 0;
BA_ "GenSigInactiveValue" SG_ 941 ADC_HPAPathSt5 0;
BA_ "GenSigInvalidValue" SG_ 941 ADC_HPAPathSt5 0;
BA_ "GenSigSendType" SG_ 941 ADC_HPAPathSt5 1;
BA_ "GenSigStartValue" SG_ 941 ADC_HPAPathSt5 0;
BA_ "GenSigTimeoutValue" SG_ 941 ADC_HPAPathSt5 0;
BA_ "Remark" SG_ 941 ADC_HPAPathSt5 "";
BA_ "EventCommandSignal" SG_ 941 ADC_HPAPath5Src 0;
BA_ "GatewayedSignals" SG_ 941 ADC_HPAPath5Src 0;
BA_ "GenSigInactiveValue" SG_ 941 ADC_HPAPath5Src 0;
BA_ "GenSigInvalidValue" SG_ 941 ADC_HPAPath5Src 0;
BA_ "GenSigSendType" SG_ 941 ADC_HPAPath5Src 1;
BA_ "GenSigStartValue" SG_ 941 ADC_HPAPath5Src 0;
BA_ "GenSigTimeoutValue" SG_ 941 ADC_HPAPath5Src 0;
BA_ "Remark" SG_ 941 ADC_HPAPath5Src "";
BA_ "EventCommandSignal" SG_ 941 ADC_HPAPathDst5 0;
BA_ "GatewayedSignals" SG_ 941 ADC_HPAPathDst5 0;
BA_ "GenSigInactiveValue" SG_ 941 ADC_HPAPathDst5 0;
BA_ "GenSigInvalidValue" SG_ 941 ADC_HPAPathDst5 0;
BA_ "GenSigSendType" SG_ 941 ADC_HPAPathDst5 1;
BA_ "GenSigStartValue" SG_ 941 ADC_HPAPathDst5 0;
BA_ "GenSigTimeoutValue" SG_ 941 ADC_HPAPathDst5 0;
BA_ "Remark" SG_ 941 ADC_HPAPathDst5 "";
BA_ "EventCommandSignal" SG_ 941 ADC_HPALearningPathNum6 0;
BA_ "GatewayedSignals" SG_ 941 ADC_HPALearningPathNum6 0;
BA_ "GenSigInactiveValue" SG_ 941 ADC_HPALearningPathNum6 0;
BA_ "GenSigInvalidValue" SG_ 941 ADC_HPALearningPathNum6 0;
BA_ "GenSigSendType" SG_ 941 ADC_HPALearningPathNum6 1;
BA_ "GenSigStartValue" SG_ 941 ADC_HPALearningPathNum6 0;
BA_ "GenSigTimeoutValue" SG_ 941 ADC_HPALearningPathNum6 0;
BA_ "Remark" SG_ 941 ADC_HPALearningPathNum6 "";
BA_ "EventCommandSignal" SG_ 941 ADC_HPAPathLearnRate6 0;
BA_ "GatewayedSignals" SG_ 941 ADC_HPAPathLearnRate6 0;
BA_ "GenSigInactiveValue" SG_ 941 ADC_HPAPathLearnRate6 0;
BA_ "GenSigInvalidValue" SG_ 941 ADC_HPAPathLearnRate6 0;
BA_ "GenSigSendType" SG_ 941 ADC_HPAPathLearnRate6 1;
BA_ "GenSigStartValue" SG_ 941 ADC_HPAPathLearnRate6 0;
BA_ "GenSigTimeoutValue" SG_ 941 ADC_HPAPathLearnRate6 0;
BA_ "Remark" SG_ 941 ADC_HPAPathLearnRate6 "";
BA_ "EventCommandSignal" SG_ 941 ADC_HPALearningPathType6 0;
BA_ "GatewayedSignals" SG_ 941 ADC_HPALearningPathType6 0;
BA_ "GenSigInactiveValue" SG_ 941 ADC_HPALearningPathType6 0;
BA_ "GenSigInvalidValue" SG_ 941 ADC_HPALearningPathType6 0;
BA_ "GenSigSendType" SG_ 941 ADC_HPALearningPathType6 1;
BA_ "GenSigStartValue" SG_ 941 ADC_HPALearningPathType6 0;
BA_ "GenSigTimeoutValue" SG_ 941 ADC_HPALearningPathType6 0;
BA_ "Remark" SG_ 941 ADC_HPALearningPathType6 "";
BA_ "EventCommandSignal" SG_ 941 ADC_HPALearningLotType6 0;
BA_ "GatewayedSignals" SG_ 941 ADC_HPALearningLotType6 0;
BA_ "GenSigInactiveValue" SG_ 941 ADC_HPALearningLotType6 0;
BA_ "GenSigInvalidValue" SG_ 941 ADC_HPALearningLotType6 0;
BA_ "GenSigSendType" SG_ 941 ADC_HPALearningLotType6 1;
BA_ "GenSigStartValue" SG_ 941 ADC_HPALearningLotType6 0;
BA_ "GenSigTimeoutValue" SG_ 941 ADC_HPALearningLotType6 0;
BA_ "Remark" SG_ 941 ADC_HPALearningLotType6 "";
BA_ "EventCommandSignal" SG_ 941 ADC_HPAPathSt6 0;
BA_ "GatewayedSignals" SG_ 941 ADC_HPAPathSt6 0;
BA_ "GenSigInactiveValue" SG_ 941 ADC_HPAPathSt6 0;
BA_ "GenSigInvalidValue" SG_ 941 ADC_HPAPathSt6 0;
BA_ "GenSigSendType" SG_ 941 ADC_HPAPathSt6 1;
BA_ "GenSigStartValue" SG_ 941 ADC_HPAPathSt6 0;
BA_ "GenSigTimeoutValue" SG_ 941 ADC_HPAPathSt6 0;
BA_ "Remark" SG_ 941 ADC_HPAPathSt6 "";
BA_ "EventCommandSignal" SG_ 941 ADC_HPAPath6Src 0;
BA_ "GatewayedSignals" SG_ 941 ADC_HPAPath6Src 0;
BA_ "GenSigInactiveValue" SG_ 941 ADC_HPAPath6Src 0;
BA_ "GenSigInvalidValue" SG_ 941 ADC_HPAPath6Src 0;
BA_ "GenSigSendType" SG_ 941 ADC_HPAPath6Src 1;
BA_ "GenSigStartValue" SG_ 941 ADC_HPAPath6Src 0;
BA_ "GenSigTimeoutValue" SG_ 941 ADC_HPAPath6Src 0;
BA_ "Remark" SG_ 941 ADC_HPAPath6Src "";
BA_ "EventCommandSignal" SG_ 941 ADC_HPAPathDst6 0;
BA_ "GatewayedSignals" SG_ 941 ADC_HPAPathDst6 0;
BA_ "GenSigInactiveValue" SG_ 941 ADC_HPAPathDst6 0;
BA_ "GenSigInvalidValue" SG_ 941 ADC_HPAPathDst6 0;
BA_ "GenSigSendType" SG_ 941 ADC_HPAPathDst6 1;
BA_ "GenSigStartValue" SG_ 941 ADC_HPAPathDst6 0;
BA_ "GenSigTimeoutValue" SG_ 941 ADC_HPAPathDst6 0;
BA_ "Remark" SG_ 941 ADC_HPAPathDst6 "";
BA_ "EventCommandSignal" SG_ 941 ADC_HPAPath5MatGpsSucces 0;
BA_ "GatewayedSignals" SG_ 941 ADC_HPAPath5MatGpsSucces 0;
BA_ "GenSigInactiveValue" SG_ 941 ADC_HPAPath5MatGpsSucces 0;
BA_ "GenSigInvalidValue" SG_ 941 ADC_HPAPath5MatGpsSucces 0;
BA_ "GenSigSendType" SG_ 941 ADC_HPAPath5MatGpsSucces 1;
BA_ "GenSigStartValue" SG_ 941 ADC_HPAPath5MatGpsSucces 0;
BA_ "GenSigTimeoutValue" SG_ 941 ADC_HPAPath5MatGpsSucces 0;
BA_ "Remark" SG_ 941 ADC_HPAPath5MatGpsSucces "";
BA_ "EventCommandSignal" SG_ 941 ADC_HPAPath6MatGpsSucces 0;
BA_ "GatewayedSignals" SG_ 941 ADC_HPAPath6MatGpsSucces 0;
BA_ "GenSigInactiveValue" SG_ 941 ADC_HPAPath6MatGpsSucces 0;
BA_ "GenSigInvalidValue" SG_ 941 ADC_HPAPath6MatGpsSucces 0;
BA_ "GenSigSendType" SG_ 941 ADC_HPAPath6MatGpsSucces 1;
BA_ "GenSigStartValue" SG_ 941 ADC_HPAPath6MatGpsSucces 0;
BA_ "GenSigTimeoutValue" SG_ 941 ADC_HPAPath6MatGpsSucces 0;
BA_ "Remark" SG_ 941 ADC_HPAPath6MatGpsSucces "";
BA_ "EventCommandSignal" SG_ 941 ADC_HPALearningPathNum7 0;
BA_ "GatewayedSignals" SG_ 941 ADC_HPALearningPathNum7 0;
BA_ "GenSigInactiveValue" SG_ 941 ADC_HPALearningPathNum7 0;
BA_ "GenSigInvalidValue" SG_ 941 ADC_HPALearningPathNum7 0;
BA_ "GenSigSendType" SG_ 941 ADC_HPALearningPathNum7 1;
BA_ "GenSigStartValue" SG_ 941 ADC_HPALearningPathNum7 0;
BA_ "GenSigTimeoutValue" SG_ 941 ADC_HPALearningPathNum7 0;
BA_ "Remark" SG_ 941 ADC_HPALearningPathNum7 "";
BA_ "EventCommandSignal" SG_ 941 ADC_HPAPathLearnRate7 0;
BA_ "GatewayedSignals" SG_ 941 ADC_HPAPathLearnRate7 0;
BA_ "GenSigInactiveValue" SG_ 941 ADC_HPAPathLearnRate7 0;
BA_ "GenSigInvalidValue" SG_ 941 ADC_HPAPathLearnRate7 0;
BA_ "GenSigSendType" SG_ 941 ADC_HPAPathLearnRate7 1;
BA_ "GenSigStartValue" SG_ 941 ADC_HPAPathLearnRate7 0;
BA_ "GenSigTimeoutValue" SG_ 941 ADC_HPAPathLearnRate7 0;
BA_ "Remark" SG_ 941 ADC_HPAPathLearnRate7 "";
BA_ "EventCommandSignal" SG_ 941 ADC_HPALearningPathType7 0;
BA_ "GatewayedSignals" SG_ 941 ADC_HPALearningPathType7 0;
BA_ "GenSigInactiveValue" SG_ 941 ADC_HPALearningPathType7 0;
BA_ "GenSigInvalidValue" SG_ 941 ADC_HPALearningPathType7 0;
BA_ "GenSigSendType" SG_ 941 ADC_HPALearningPathType7 1;
BA_ "GenSigStartValue" SG_ 941 ADC_HPALearningPathType7 0;
BA_ "GenSigTimeoutValue" SG_ 941 ADC_HPALearningPathType7 0;
BA_ "Remark" SG_ 941 ADC_HPALearningPathType7 "";
BA_ "EventCommandSignal" SG_ 941 ADC_HPALearningLotType7 0;
BA_ "GatewayedSignals" SG_ 941 ADC_HPALearningLotType7 0;
BA_ "GenSigInactiveValue" SG_ 941 ADC_HPALearningLotType7 0;
BA_ "GenSigInvalidValue" SG_ 941 ADC_HPALearningLotType7 0;
BA_ "GenSigSendType" SG_ 941 ADC_HPALearningLotType7 1;
BA_ "GenSigStartValue" SG_ 941 ADC_HPALearningLotType7 0;
BA_ "GenSigTimeoutValue" SG_ 941 ADC_HPALearningLotType7 0;
BA_ "Remark" SG_ 941 ADC_HPALearningLotType7 "";
BA_ "EventCommandSignal" SG_ 941 ADC_HPAPathSt7 0;
BA_ "GatewayedSignals" SG_ 941 ADC_HPAPathSt7 0;
BA_ "GenSigInactiveValue" SG_ 941 ADC_HPAPathSt7 0;
BA_ "GenSigInvalidValue" SG_ 941 ADC_HPAPathSt7 0;
BA_ "GenSigSendType" SG_ 941 ADC_HPAPathSt7 1;
BA_ "GenSigStartValue" SG_ 941 ADC_HPAPathSt7 0;
BA_ "GenSigTimeoutValue" SG_ 941 ADC_HPAPathSt7 0;
BA_ "Remark" SG_ 941 ADC_HPAPathSt7 "";
BA_ "EventCommandSignal" SG_ 941 ADC_HPAPath7Src 0;
BA_ "GatewayedSignals" SG_ 941 ADC_HPAPath7Src 0;
BA_ "GenSigInactiveValue" SG_ 941 ADC_HPAPath7Src 0;
BA_ "GenSigInvalidValue" SG_ 941 ADC_HPAPath7Src 0;
BA_ "GenSigSendType" SG_ 941 ADC_HPAPath7Src 1;
BA_ "GenSigStartValue" SG_ 941 ADC_HPAPath7Src 0;
BA_ "GenSigTimeoutValue" SG_ 941 ADC_HPAPath7Src 0;
BA_ "Remark" SG_ 941 ADC_HPAPath7Src "";
BA_ "EventCommandSignal" SG_ 941 ADC_HPAPathDst7 0;
BA_ "GatewayedSignals" SG_ 941 ADC_HPAPathDst7 0;
BA_ "GenSigInactiveValue" SG_ 941 ADC_HPAPathDst7 0;
BA_ "GenSigInvalidValue" SG_ 941 ADC_HPAPathDst7 0;
BA_ "GenSigSendType" SG_ 941 ADC_HPAPathDst7 1;
BA_ "GenSigStartValue" SG_ 941 ADC_HPAPathDst7 0;
BA_ "GenSigTimeoutValue" SG_ 941 ADC_HPAPathDst7 0;
BA_ "Remark" SG_ 941 ADC_HPAPathDst7 "";
BA_ "EventCommandSignal" SG_ 941 ADC_HPALearningPathNum8 0;
BA_ "GatewayedSignals" SG_ 941 ADC_HPALearningPathNum8 0;
BA_ "GenSigInactiveValue" SG_ 941 ADC_HPALearningPathNum8 0;
BA_ "GenSigInvalidValue" SG_ 941 ADC_HPALearningPathNum8 0;
BA_ "GenSigSendType" SG_ 941 ADC_HPALearningPathNum8 1;
BA_ "GenSigStartValue" SG_ 941 ADC_HPALearningPathNum8 0;
BA_ "GenSigTimeoutValue" SG_ 941 ADC_HPALearningPathNum8 0;
BA_ "Remark" SG_ 941 ADC_HPALearningPathNum8 "";
BA_ "EventCommandSignal" SG_ 941 ADC_HPAPathLearnRate8 0;
BA_ "GatewayedSignals" SG_ 941 ADC_HPAPathLearnRate8 0;
BA_ "GenSigInactiveValue" SG_ 941 ADC_HPAPathLearnRate8 0;
BA_ "GenSigInvalidValue" SG_ 941 ADC_HPAPathLearnRate8 0;
BA_ "GenSigSendType" SG_ 941 ADC_HPAPathLearnRate8 1;
BA_ "GenSigStartValue" SG_ 941 ADC_HPAPathLearnRate8 0;
BA_ "GenSigTimeoutValue" SG_ 941 ADC_HPAPathLearnRate8 0;
BA_ "Remark" SG_ 941 ADC_HPAPathLearnRate8 "";
BA_ "EventCommandSignal" SG_ 941 ADC_HPALearningPathType8 0;
BA_ "GatewayedSignals" SG_ 941 ADC_HPALearningPathType8 0;
BA_ "GenSigInactiveValue" SG_ 941 ADC_HPALearningPathType8 0;
BA_ "GenSigInvalidValue" SG_ 941 ADC_HPALearningPathType8 0;
BA_ "GenSigSendType" SG_ 941 ADC_HPALearningPathType8 1;
BA_ "GenSigStartValue" SG_ 941 ADC_HPALearningPathType8 0;
BA_ "GenSigTimeoutValue" SG_ 941 ADC_HPALearningPathType8 0;
BA_ "Remark" SG_ 941 ADC_HPALearningPathType8 "";
BA_ "EventCommandSignal" SG_ 941 ADC_HPALearningLotType8 0;
BA_ "GatewayedSignals" SG_ 941 ADC_HPALearningLotType8 0;
BA_ "GenSigInactiveValue" SG_ 941 ADC_HPALearningLotType8 0;
BA_ "GenSigInvalidValue" SG_ 941 ADC_HPALearningLotType8 0;
BA_ "GenSigSendType" SG_ 941 ADC_HPALearningLotType8 1;
BA_ "GenSigStartValue" SG_ 941 ADC_HPALearningLotType8 0;
BA_ "GenSigTimeoutValue" SG_ 941 ADC_HPALearningLotType8 0;
BA_ "Remark" SG_ 941 ADC_HPALearningLotType8 "";
BA_ "EventCommandSignal" SG_ 941 ADC_HPAPPathSt8 0;
BA_ "GatewayedSignals" SG_ 941 ADC_HPAPPathSt8 0;
BA_ "GenSigInactiveValue" SG_ 941 ADC_HPAPPathSt8 0;
BA_ "GenSigInvalidValue" SG_ 941 ADC_HPAPPathSt8 0;
BA_ "GenSigSendType" SG_ 941 ADC_HPAPPathSt8 1;
BA_ "GenSigStartValue" SG_ 941 ADC_HPAPPathSt8 0;
BA_ "GenSigTimeoutValue" SG_ 941 ADC_HPAPPathSt8 0;
BA_ "Remark" SG_ 941 ADC_HPAPPathSt8 "";
BA_ "EventCommandSignal" SG_ 941 ADC_HPAPath8Src 0;
BA_ "GatewayedSignals" SG_ 941 ADC_HPAPath8Src 0;
BA_ "GenSigInactiveValue" SG_ 941 ADC_HPAPath8Src 0;
BA_ "GenSigInvalidValue" SG_ 941 ADC_HPAPath8Src 0;
BA_ "GenSigSendType" SG_ 941 ADC_HPAPath8Src 1;
BA_ "GenSigStartValue" SG_ 941 ADC_HPAPath8Src 0;
BA_ "GenSigTimeoutValue" SG_ 941 ADC_HPAPath8Src 0;
BA_ "Remark" SG_ 941 ADC_HPAPath8Src "";
BA_ "EventCommandSignal" SG_ 941 ADC_HPAPathDst8 0;
BA_ "GatewayedSignals" SG_ 941 ADC_HPAPathDst8 0;
BA_ "GenSigInactiveValue" SG_ 941 ADC_HPAPathDst8 0;
BA_ "GenSigInvalidValue" SG_ 941 ADC_HPAPathDst8 0;
BA_ "GenSigSendType" SG_ 941 ADC_HPAPathDst8 1;
BA_ "GenSigStartValue" SG_ 941 ADC_HPAPathDst8 0;
BA_ "GenSigTimeoutValue" SG_ 941 ADC_HPAPathDst8 0;
BA_ "Remark" SG_ 941 ADC_HPAPathDst8 "";
BA_ "EventCommandSignal" SG_ 941 ADC_HPAPath7MatGpsSucces 0;
BA_ "GatewayedSignals" SG_ 941 ADC_HPAPath7MatGpsSucces 0;
BA_ "GenSigInactiveValue" SG_ 941 ADC_HPAPath7MatGpsSucces 0;
BA_ "GenSigInvalidValue" SG_ 941 ADC_HPAPath7MatGpsSucces 0;
BA_ "GenSigSendType" SG_ 941 ADC_HPAPath7MatGpsSucces 1;
BA_ "GenSigStartValue" SG_ 941 ADC_HPAPath7MatGpsSucces 0;
BA_ "GenSigTimeoutValue" SG_ 941 ADC_HPAPath7MatGpsSucces 0;
BA_ "Remark" SG_ 941 ADC_HPAPath7MatGpsSucces "";
BA_ "EventCommandSignal" SG_ 941 ADC_HPAPath8MatGpsSucces 0;
BA_ "GatewayedSignals" SG_ 941 ADC_HPAPath8MatGpsSucces 0;
BA_ "GenSigInactiveValue" SG_ 941 ADC_HPAPath8MatGpsSucces 0;
BA_ "GenSigInvalidValue" SG_ 941 ADC_HPAPath8MatGpsSucces 0;
BA_ "GenSigSendType" SG_ 941 ADC_HPAPath8MatGpsSucces 1;
BA_ "GenSigStartValue" SG_ 941 ADC_HPAPath8MatGpsSucces 0;
BA_ "GenSigTimeoutValue" SG_ 941 ADC_HPAPath8MatGpsSucces 0;
BA_ "Remark" SG_ 941 ADC_HPAPath8MatGpsSucces "";
BA_ "EventCommandSignal" SG_ 941 ADC_HPALearningPathNum9 0;
BA_ "GatewayedSignals" SG_ 941 ADC_HPALearningPathNum9 0;
BA_ "GenSigInactiveValue" SG_ 941 ADC_HPALearningPathNum9 0;
BA_ "GenSigInvalidValue" SG_ 941 ADC_HPALearningPathNum9 0;
BA_ "GenSigSendType" SG_ 941 ADC_HPALearningPathNum9 1;
BA_ "GenSigStartValue" SG_ 941 ADC_HPALearningPathNum9 0;
BA_ "GenSigTimeoutValue" SG_ 941 ADC_HPALearningPathNum9 0;
BA_ "Remark" SG_ 941 ADC_HPALearningPathNum9 "";
BA_ "EventCommandSignal" SG_ 941 ADC_HPAPathLearnRate9 0;
BA_ "GatewayedSignals" SG_ 941 ADC_HPAPathLearnRate9 0;
BA_ "GenSigInactiveValue" SG_ 941 ADC_HPAPathLearnRate9 0;
BA_ "GenSigInvalidValue" SG_ 941 ADC_HPAPathLearnRate9 0;
BA_ "GenSigSendType" SG_ 941 ADC_HPAPathLearnRate9 1;
BA_ "GenSigStartValue" SG_ 941 ADC_HPAPathLearnRate9 0;
BA_ "GenSigTimeoutValue" SG_ 941 ADC_HPAPathLearnRate9 0;
BA_ "Remark" SG_ 941 ADC_HPAPathLearnRate9 "";
BA_ "EventCommandSignal" SG_ 941 ADC_HPALearningPathType9 0;
BA_ "GatewayedSignals" SG_ 941 ADC_HPALearningPathType9 0;
BA_ "GenSigInactiveValue" SG_ 941 ADC_HPALearningPathType9 0;
BA_ "GenSigInvalidValue" SG_ 941 ADC_HPALearningPathType9 0;
BA_ "GenSigSendType" SG_ 941 ADC_HPALearningPathType9 1;
BA_ "GenSigStartValue" SG_ 941 ADC_HPALearningPathType9 0;
BA_ "GenSigTimeoutValue" SG_ 941 ADC_HPALearningPathType9 0;
BA_ "Remark" SG_ 941 ADC_HPALearningPathType9 "";
BA_ "EventCommandSignal" SG_ 941 ADC_HPALearningLotType9 0;
BA_ "GatewayedSignals" SG_ 941 ADC_HPALearningLotType9 0;
BA_ "GenSigInactiveValue" SG_ 941 ADC_HPALearningLotType9 0;
BA_ "GenSigInvalidValue" SG_ 941 ADC_HPALearningLotType9 0;
BA_ "GenSigSendType" SG_ 941 ADC_HPALearningLotType9 1;
BA_ "GenSigStartValue" SG_ 941 ADC_HPALearningLotType9 0;
BA_ "GenSigTimeoutValue" SG_ 941 ADC_HPALearningLotType9 0;
BA_ "Remark" SG_ 941 ADC_HPALearningLotType9 "";
BA_ "EventCommandSignal" SG_ 941 ADC_HPAPathSt9 0;
BA_ "GatewayedSignals" SG_ 941 ADC_HPAPathSt9 0;
BA_ "GenSigInactiveValue" SG_ 941 ADC_HPAPathSt9 0;
BA_ "GenSigInvalidValue" SG_ 941 ADC_HPAPathSt9 0;
BA_ "GenSigSendType" SG_ 941 ADC_HPAPathSt9 1;
BA_ "GenSigStartValue" SG_ 941 ADC_HPAPathSt9 0;
BA_ "GenSigTimeoutValue" SG_ 941 ADC_HPAPathSt9 0;
BA_ "Remark" SG_ 941 ADC_HPAPathSt9 "";
BA_ "EventCommandSignal" SG_ 941 ADC_HPAPath9Src 0;
BA_ "GatewayedSignals" SG_ 941 ADC_HPAPath9Src 0;
BA_ "GenSigInactiveValue" SG_ 941 ADC_HPAPath9Src 0;
BA_ "GenSigInvalidValue" SG_ 941 ADC_HPAPath9Src 0;
BA_ "GenSigSendType" SG_ 941 ADC_HPAPath9Src 1;
BA_ "GenSigStartValue" SG_ 941 ADC_HPAPath9Src 0;
BA_ "GenSigTimeoutValue" SG_ 941 ADC_HPAPath9Src 0;
BA_ "Remark" SG_ 941 ADC_HPAPath9Src "";
BA_ "EventCommandSignal" SG_ 941 ADC_HPAPathDst9 0;
BA_ "GatewayedSignals" SG_ 941 ADC_HPAPathDst9 0;
BA_ "GenSigInactiveValue" SG_ 941 ADC_HPAPathDst9 0;
BA_ "GenSigInvalidValue" SG_ 941 ADC_HPAPathDst9 0;
BA_ "GenSigSendType" SG_ 941 ADC_HPAPathDst9 1;
BA_ "GenSigStartValue" SG_ 941 ADC_HPAPathDst9 0;
BA_ "GenSigTimeoutValue" SG_ 941 ADC_HPAPathDst9 0;
BA_ "Remark" SG_ 941 ADC_HPAPathDst9 "";
BA_ "EventCommandSignal" SG_ 941 ADC_HPALearningPathNum10 0;
BA_ "GatewayedSignals" SG_ 941 ADC_HPALearningPathNum10 0;
BA_ "GenSigInactiveValue" SG_ 941 ADC_HPALearningPathNum10 0;
BA_ "GenSigInvalidValue" SG_ 941 ADC_HPALearningPathNum10 0;
BA_ "GenSigSendType" SG_ 941 ADC_HPALearningPathNum10 1;
BA_ "GenSigStartValue" SG_ 941 ADC_HPALearningPathNum10 0;
BA_ "GenSigTimeoutValue" SG_ 941 ADC_HPALearningPathNum10 0;
BA_ "Remark" SG_ 941 ADC_HPALearningPathNum10 "";
BA_ "EventCommandSignal" SG_ 941 ADC_HPAPathLearnRate10 0;
BA_ "GatewayedSignals" SG_ 941 ADC_HPAPathLearnRate10 0;
BA_ "GenSigInactiveValue" SG_ 941 ADC_HPAPathLearnRate10 0;
BA_ "GenSigInvalidValue" SG_ 941 ADC_HPAPathLearnRate10 0;
BA_ "GenSigSendType" SG_ 941 ADC_HPAPathLearnRate10 1;
BA_ "GenSigStartValue" SG_ 941 ADC_HPAPathLearnRate10 0;
BA_ "GenSigTimeoutValue" SG_ 941 ADC_HPAPathLearnRate10 0;
BA_ "Remark" SG_ 941 ADC_HPAPathLearnRate10 "";
BA_ "EventCommandSignal" SG_ 941 ADC_HPALearningPathType10 0;
BA_ "GatewayedSignals" SG_ 941 ADC_HPALearningPathType10 0;
BA_ "GenSigInactiveValue" SG_ 941 ADC_HPALearningPathType10 0;
BA_ "GenSigInvalidValue" SG_ 941 ADC_HPALearningPathType10 0;
BA_ "GenSigSendType" SG_ 941 ADC_HPALearningPathType10 1;
BA_ "GenSigStartValue" SG_ 941 ADC_HPALearningPathType10 0;
BA_ "GenSigTimeoutValue" SG_ 941 ADC_HPALearningPathType10 0;
BA_ "Remark" SG_ 941 ADC_HPALearningPathType10 "";
BA_ "EventCommandSignal" SG_ 941 ADC_HPALearningLotType10 0;
BA_ "GatewayedSignals" SG_ 941 ADC_HPALearningLotType10 0;
BA_ "GenSigInactiveValue" SG_ 941 ADC_HPALearningLotType10 0;
BA_ "GenSigInvalidValue" SG_ 941 ADC_HPALearningLotType10 0;
BA_ "GenSigSendType" SG_ 941 ADC_HPALearningLotType10 1;
BA_ "GenSigStartValue" SG_ 941 ADC_HPALearningLotType10 0;
BA_ "GenSigTimeoutValue" SG_ 941 ADC_HPALearningLotType10 0;
BA_ "Remark" SG_ 941 ADC_HPALearningLotType10 "";
BA_ "EventCommandSignal" SG_ 941 ADC_HPAPathSt10 0;
BA_ "GatewayedSignals" SG_ 941 ADC_HPAPathSt10 0;
BA_ "GenSigInactiveValue" SG_ 941 ADC_HPAPathSt10 0;
BA_ "GenSigInvalidValue" SG_ 941 ADC_HPAPathSt10 0;
BA_ "GenSigSendType" SG_ 941 ADC_HPAPathSt10 1;
BA_ "GenSigStartValue" SG_ 941 ADC_HPAPathSt10 0;
BA_ "GenSigTimeoutValue" SG_ 941 ADC_HPAPathSt10 0;
BA_ "Remark" SG_ 941 ADC_HPAPathSt10 "";
BA_ "EventCommandSignal" SG_ 941 ADC_HPAPath10Src 0;
BA_ "GatewayedSignals" SG_ 941 ADC_HPAPath10Src 0;
BA_ "GenSigInactiveValue" SG_ 941 ADC_HPAPath10Src 0;
BA_ "GenSigInvalidValue" SG_ 941 ADC_HPAPath10Src 0;
BA_ "GenSigSendType" SG_ 941 ADC_HPAPath10Src 1;
BA_ "GenSigStartValue" SG_ 941 ADC_HPAPath10Src 0;
BA_ "GenSigTimeoutValue" SG_ 941 ADC_HPAPath10Src 0;
BA_ "Remark" SG_ 941 ADC_HPAPath10Src "";
BA_ "EventCommandSignal" SG_ 941 ADC_HPAPathDst10 0;
BA_ "GatewayedSignals" SG_ 941 ADC_HPAPathDst10 0;
BA_ "GenSigInactiveValue" SG_ 941 ADC_HPAPathDst10 0;
BA_ "GenSigInvalidValue" SG_ 941 ADC_HPAPathDst10 0;
BA_ "GenSigSendType" SG_ 941 ADC_HPAPathDst10 1;
BA_ "GenSigStartValue" SG_ 941 ADC_HPAPathDst10 0;
BA_ "GenSigTimeoutValue" SG_ 941 ADC_HPAPathDst10 0;
BA_ "Remark" SG_ 941 ADC_HPAPathDst10 "";
BA_ "EventCommandSignal" SG_ 941 ADC_HPAPath9MatGpsSucces 0;
BA_ "GatewayedSignals" SG_ 941 ADC_HPAPath9MatGpsSucces 0;
BA_ "GenSigInactiveValue" SG_ 941 ADC_HPAPath9MatGpsSucces 0;
BA_ "GenSigInvalidValue" SG_ 941 ADC_HPAPath9MatGpsSucces 0;
BA_ "GenSigSendType" SG_ 941 ADC_HPAPath9MatGpsSucces 1;
BA_ "GenSigStartValue" SG_ 941 ADC_HPAPath9MatGpsSucces 0;
BA_ "GenSigTimeoutValue" SG_ 941 ADC_HPAPath9MatGpsSucces 0;
BA_ "Remark" SG_ 941 ADC_HPAPath9MatGpsSucces "";
BA_ "EventCommandSignal" SG_ 941 ADC_HPAPath10MatGpsSucces 0;
BA_ "GatewayedSignals" SG_ 941 ADC_HPAPath10MatGpsSucces 0;
BA_ "GenSigInactiveValue" SG_ 941 ADC_HPAPath10MatGpsSucces 0;
BA_ "GenSigInvalidValue" SG_ 941 ADC_HPAPath10MatGpsSucces 0;
BA_ "GenSigSendType" SG_ 941 ADC_HPAPath10MatGpsSucces 1;
BA_ "GenSigStartValue" SG_ 941 ADC_HPAPath10MatGpsSucces 0;
BA_ "GenSigTimeoutValue" SG_ 941 ADC_HPAPath10MatGpsSucces 0;
BA_ "Remark" SG_ 941 ADC_HPAPath10MatGpsSucces "";
BA_ "EventCommandSignal" SG_ 941 ADC_LowPowerfeedback 0;
BA_ "GatewayedSignals" SG_ 941 ADC_LowPowerfeedback 0;
BA_ "GenSigInactiveValue" SG_ 941 ADC_LowPowerfeedback 0;
BA_ "GenSigInvalidValue" SG_ 941 ADC_LowPowerfeedback 0;
BA_ "GenSigSendType" SG_ 941 ADC_LowPowerfeedback 1;
BA_ "GenSigStartValue" SG_ 941 ADC_LowPowerfeedback 0;
BA_ "EventCommandSignal" SG_ 941 ADC_APAParkingSpdSt 0;
BA_ "GatewayedSignals" SG_ 941 ADC_APAParkingSpdSt 0;
BA_ "GenSigInactiveValue" SG_ 941 ADC_APAParkingSpdSt 0;
BA_ "GenSigInvalidValue" SG_ 941 ADC_APAParkingSpdSt 0;
BA_ "GenSigSendType" SG_ 941 ADC_APAParkingSpdSt 1;
BA_ "GenSigStartValue" SG_ 941 ADC_APAParkingSpdSt 0;
BA_ "GenSigTimeoutValue" SG_ 941 ADC_APAParkingSpdSt 0;
BA_ "Remark" SG_ 941 ADC_APAParkingSpdSt "";
BA_ "EventCommandSignal" SG_ 941 ADC_HPAParkingSpdSt 0;
BA_ "GatewayedSignals" SG_ 941 ADC_HPAParkingSpdSt 0;
BA_ "GenSigInactiveValue" SG_ 941 ADC_HPAParkingSpdSt 0;
BA_ "GenSigInvalidValue" SG_ 941 ADC_HPAParkingSpdSt 0;
BA_ "GenSigSendType" SG_ 941 ADC_HPAParkingSpdSt 1;
BA_ "GenSigStartValue" SG_ 941 ADC_HPAParkingSpdSt 0;
BA_ "GenSigTimeoutValue" SG_ 941 ADC_HPAParkingSpdSt 0;
BA_ "Remark" SG_ 941 ADC_HPAParkingSpdSt "";
BA_ "EventCommandSignal" SG_ 941 PCS_APAParkingReady 0;
BA_ "GatewayedSignals" SG_ 941 PCS_APAParkingReady 0;
BA_ "GenSigInactiveValue" SG_ 941 PCS_APAParkingReady 0;
BA_ "GenSigInvalidValue" SG_ 941 PCS_APAParkingReady 0;
BA_ "GenSigSendType" SG_ 941 PCS_APAParkingReady 1;
BA_ "GenSigStartValue" SG_ 941 PCS_APAParkingReady 0;
BA_ "GenSigTimeoutValue" SG_ 941 PCS_APAParkingReady 0;
BA_ "Remark" SG_ 941 PCS_APAParkingReady "";
BA_ "EventCommandSignal" SG_ 835 ADC_11_CRC 0;
BA_ "GatewayedSignals" SG_ 835 ADC_11_CRC 0;
BA_ "GenSigInactiveValue" SG_ 835 ADC_11_CRC 0;
BA_ "GenSigInvalidValue" SG_ 835 ADC_11_CRC 0;
BA_ "GenSigSendType" SG_ 835 ADC_11_CRC 1;
BA_ "GenSigStartValue" SG_ 835 ADC_11_CRC 0;
BA_ "GenSigTimeoutValue" SG_ 835 ADC_11_CRC 0;
BA_ "Remark" SG_ 835 ADC_11_CRC "1R1V IFC不发";
BA_ "EventCommandSignal" SG_ 835 ADC_11_Counter 0;
BA_ "GatewayedSignals" SG_ 835 ADC_11_Counter 0;
BA_ "GenSigInactiveValue" SG_ 835 ADC_11_Counter 0;
BA_ "GenSigInvalidValue" SG_ 835 ADC_11_Counter 0;
BA_ "GenSigSendType" SG_ 835 ADC_11_Counter 1;
BA_ "GenSigStartValue" SG_ 835 ADC_11_Counter 0;
BA_ "GenSigTimeoutValue" SG_ 835 ADC_11_Counter 0;
BA_ "Remark" SG_ 835 ADC_11_Counter "1R1V IFC不发";
BA_ "EventCommandSignal" SG_ 835 PAS_SystemType 0;
BA_ "GatewayedSignals" SG_ 835 PAS_SystemType 0;
BA_ "GenSigInactiveValue" SG_ 835 PAS_SystemType 0;
BA_ "GenSigInvalidValue" SG_ 835 PAS_SystemType 0;
BA_ "GenSigSendType" SG_ 835 PAS_SystemType 1;
BA_ "GenSigStartValue" SG_ 835 PAS_SystemType 0;
BA_ "GenSigTimeoutValue" SG_ 835 PAS_SystemType 0;
BA_ "Remark" SG_ 835 PAS_SystemType "1R1V IFC不发";
BA_ "EventCommandSignal" SG_ 835 PAS_WarnTone 0;
BA_ "GatewayedSignals" SG_ 835 PAS_WarnTone 0;
BA_ "GenSigInactiveValue" SG_ 835 PAS_WarnTone 0;
BA_ "GenSigInvalidValue" SG_ 835 PAS_WarnTone 0;
BA_ "GenSigSendType" SG_ 835 PAS_WarnTone 1;
BA_ "GenSigStartValue" SG_ 835 PAS_WarnTone 0;
BA_ "GenSigTimeoutValue" SG_ 835 PAS_WarnTone 0;
BA_ "Remark" SG_ 835 PAS_WarnTone "1R1V IFC不发";
BA_ "EventCommandSignal" SG_ 835 PAS_ButtonPress 0;
BA_ "GatewayedSignals" SG_ 835 PAS_ButtonPress 0;
BA_ "GenSigInactiveValue" SG_ 835 PAS_ButtonPress 0;
BA_ "GenSigInvalidValue" SG_ 835 PAS_ButtonPress 0;
BA_ "GenSigSendType" SG_ 835 PAS_ButtonPress 1;
BA_ "GenSigStartValue" SG_ 835 PAS_ButtonPress 0;
BA_ "GenSigTimeoutValue" SG_ 835 PAS_ButtonPress 0;
BA_ "Remark" SG_ 835 PAS_ButtonPress "1R1V IFC不发";
BA_ "EventCommandSignal" SG_ 835 PAS_SideZoneStatusF 0;
BA_ "GatewayedSignals" SG_ 835 PAS_SideZoneStatusF 0;
BA_ "GenSigInactiveValue" SG_ 835 PAS_SideZoneStatusF 0;
BA_ "GenSigInvalidValue" SG_ 835 PAS_SideZoneStatusF 0;
BA_ "GenSigSendType" SG_ 835 PAS_SideZoneStatusF 1;
BA_ "GenSigStartValue" SG_ 835 PAS_SideZoneStatusF 0;
BA_ "GenSigTimeoutValue" SG_ 835 PAS_SideZoneStatusF 0;
BA_ "Remark" SG_ 835 PAS_SideZoneStatusF "1R1V IFC不发";
BA_ "EventCommandSignal" SG_ 835 PAS_SideZoneStatusR 0;
BA_ "GatewayedSignals" SG_ 835 PAS_SideZoneStatusR 0;
BA_ "GenSigInactiveValue" SG_ 835 PAS_SideZoneStatusR 0;
BA_ "GenSigInvalidValue" SG_ 835 PAS_SideZoneStatusR 0;
BA_ "GenSigSendType" SG_ 835 PAS_SideZoneStatusR 1;
BA_ "GenSigStartValue" SG_ 835 PAS_SideZoneStatusR 0;
BA_ "GenSigTimeoutValue" SG_ 835 PAS_SideZoneStatusR 0;
BA_ "Remark" SG_ 835 PAS_SideZoneStatusR "1R1V IFC不发";
BA_ "EventCommandSignal" SG_ 835 PAS_RRMidDistance 0;
BA_ "GatewayedSignals" SG_ 835 PAS_RRMidDistance 0;
BA_ "GenSigInactiveValue" SG_ 835 PAS_RRMidDistance 0;
BA_ "EventCommandSignal" SG_ 835 PAS_RLMidDistance 0;
BA_ "GatewayedSignals" SG_ 835 PAS_RLMidDistance 0;
BA_ "GenSigInactiveValue" SG_ 835 PAS_RLMidDistance 0;
BA_ "EventCommandSignal" SG_ 835 PAS_RRDistance 0;
BA_ "GatewayedSignals" SG_ 835 PAS_RRDistance 0;
BA_ "GenSigInactiveValue" SG_ 835 PAS_RRDistance 0;
BA_ "EventCommandSignal" SG_ 835 PAS_RLDistance 0;
BA_ "GatewayedSignals" SG_ 835 PAS_RLDistance 0;
BA_ "GenSigInactiveValue" SG_ 835 PAS_RLDistance 0;
BA_ "EventCommandSignal" SG_ 835 PAS_RSLSideDistance 0;
BA_ "GatewayedSignals" SG_ 835 PAS_RSLSideDistance 0;
BA_ "GenSigInactiveValue" SG_ 835 PAS_RSLSideDistance 0;
BA_ "EventCommandSignal" SG_ 835 PAS_RSRSideDistance 0;
BA_ "GatewayedSignals" SG_ 835 PAS_RSRSideDistance 0;
BA_ "GenSigInactiveValue" SG_ 835 PAS_RSRSideDistance 0;
BA_ "EventCommandSignal" SG_ 835 PAS_FRDistance 0;
BA_ "GatewayedSignals" SG_ 835 PAS_FRDistance 0;
BA_ "GenSigInactiveValue" SG_ 835 PAS_FRDistance 0;
BA_ "EventCommandSignal" SG_ 835 PAS_FLDistance 0;
BA_ "GatewayedSignals" SG_ 835 PAS_FLDistance 0;
BA_ "GenSigInactiveValue" SG_ 835 PAS_FLDistance 0;
BA_ "EventCommandSignal" SG_ 835 PAS_FRMidDistance 0;
BA_ "GatewayedSignals" SG_ 835 PAS_FRMidDistance 0;
BA_ "GenSigInactiveValue" SG_ 835 PAS_FRMidDistance 0;
BA_ "EventCommandSignal" SG_ 835 PAS_FLMidDistance 0;
BA_ "GatewayedSignals" SG_ 835 PAS_FLMidDistance 0;
BA_ "GenSigInactiveValue" SG_ 835 PAS_FLMidDistance 0;
BA_ "EventCommandSignal" SG_ 835 PAS_FSRSideDistance 0;
BA_ "GatewayedSignals" SG_ 835 PAS_FSRSideDistance 0;
BA_ "GenSigInactiveValue" SG_ 835 PAS_FSRSideDistance 0;
BA_ "EventCommandSignal" SG_ 835 PAS_FSLSideDistance 0;
BA_ "GatewayedSignals" SG_ 835 PAS_FSLSideDistance 0;
BA_ "GenSigInactiveValue" SG_ 835 PAS_FSLSideDistance 0;
BA_ "EventCommandSignal" SG_ 835 PAS_Mode 0;
BA_ "GatewayedSignals" SG_ 835 PAS_Mode 0;
BA_ "GenSigInactiveValue" SG_ 835 PAS_Mode 0;
BA_ "GenSigInvalidValue" SG_ 835 PAS_Mode 0;
BA_ "GenSigSendType" SG_ 835 PAS_Mode 1;
BA_ "GenSigStartValue" SG_ 835 PAS_Mode 0;
BA_ "GenSigTimeoutValue" SG_ 835 PAS_Mode 0;
BA_ "Remark" SG_ 835 PAS_Mode "1R1V IFC不发";
BA_ "EventCommandSignal" SG_ 835 PAS_RRMidSnsErrFlag 0;
BA_ "GatewayedSignals" SG_ 835 PAS_RRMidSnsErrFlag 0;
BA_ "GenSigInactiveValue" SG_ 835 PAS_RRMidSnsErrFlag 0;
BA_ "GenSigInvalidValue" SG_ 835 PAS_RRMidSnsErrFlag 0;
BA_ "GenSigSendType" SG_ 835 PAS_RRMidSnsErrFlag 1;
BA_ "GenSigStartValue" SG_ 835 PAS_RRMidSnsErrFlag 0;
BA_ "GenSigTimeoutValue" SG_ 835 PAS_RRMidSnsErrFlag 0;
BA_ "Remark" SG_ 835 PAS_RRMidSnsErrFlag "1R1V IFC不发";
BA_ "EventCommandSignal" SG_ 835 PAS_RLMidSnsErrFlag 0;
BA_ "GatewayedSignals" SG_ 835 PAS_RLMidSnsErrFlag 0;
BA_ "GenSigInactiveValue" SG_ 835 PAS_RLMidSnsErrFlag 0;
BA_ "GenSigInvalidValue" SG_ 835 PAS_RLMidSnsErrFlag 0;
BA_ "GenSigSendType" SG_ 835 PAS_RLMidSnsErrFlag 1;
BA_ "GenSigStartValue" SG_ 835 PAS_RLMidSnsErrFlag 0;
BA_ "GenSigTimeoutValue" SG_ 835 PAS_RLMidSnsErrFlag 0;
BA_ "Remark" SG_ 835 PAS_RLMidSnsErrFlag "1R1V IFC不发";
BA_ "EventCommandSignal" SG_ 835 PAS_RRSnsErrFlag 0;
BA_ "GatewayedSignals" SG_ 835 PAS_RRSnsErrFlag 0;
BA_ "GenSigInactiveValue" SG_ 835 PAS_RRSnsErrFlag 0;
BA_ "GenSigInvalidValue" SG_ 835 PAS_RRSnsErrFlag 0;
BA_ "GenSigSendType" SG_ 835 PAS_RRSnsErrFlag 1;
BA_ "GenSigStartValue" SG_ 835 PAS_RRSnsErrFlag 0;
BA_ "GenSigTimeoutValue" SG_ 835 PAS_RRSnsErrFlag 0;
BA_ "Remark" SG_ 835 PAS_RRSnsErrFlag "1R1V IFC不发";
BA_ "EventCommandSignal" SG_ 835 PAS_RLSnsErrFlag 0;
BA_ "GatewayedSignals" SG_ 835 PAS_RLSnsErrFlag 0;
BA_ "GenSigInactiveValue" SG_ 835 PAS_RLSnsErrFlag 0;
BA_ "GenSigInvalidValue" SG_ 835 PAS_RLSnsErrFlag 0;
BA_ "GenSigSendType" SG_ 835 PAS_RLSnsErrFlag 1;
BA_ "GenSigStartValue" SG_ 835 PAS_RLSnsErrFlag 0;
BA_ "GenSigTimeoutValue" SG_ 835 PAS_RLSnsErrFlag 0;
BA_ "Remark" SG_ 835 PAS_RLSnsErrFlag "1R1V IFC不发";
BA_ "EventCommandSignal" SG_ 835 PAS_RSLSnsErrFlag 0;
BA_ "GatewayedSignals" SG_ 835 PAS_RSLSnsErrFlag 0;
BA_ "GenSigInactiveValue" SG_ 835 PAS_RSLSnsErrFlag 0;
BA_ "GenSigInvalidValue" SG_ 835 PAS_RSLSnsErrFlag 0;
BA_ "GenSigSendType" SG_ 835 PAS_RSLSnsErrFlag 1;
BA_ "GenSigStartValue" SG_ 835 PAS_RSLSnsErrFlag 0;
BA_ "GenSigTimeoutValue" SG_ 835 PAS_RSLSnsErrFlag 0;
BA_ "Remark" SG_ 835 PAS_RSLSnsErrFlag "1R1V IFC不发";
BA_ "EventCommandSignal" SG_ 835 PAS_RSRSnsErrFlag 0;
BA_ "GatewayedSignals" SG_ 835 PAS_RSRSnsErrFlag 0;
BA_ "GenSigInactiveValue" SG_ 835 PAS_RSRSnsErrFlag 0;
BA_ "GenSigInvalidValue" SG_ 835 PAS_RSRSnsErrFlag 0;
BA_ "GenSigSendType" SG_ 835 PAS_RSRSnsErrFlag 1;
BA_ "GenSigStartValue" SG_ 835 PAS_RSRSnsErrFlag 0;
BA_ "GenSigTimeoutValue" SG_ 835 PAS_RSRSnsErrFlag 0;
BA_ "Remark" SG_ 835 PAS_RSRSnsErrFlag "1R1V IFC不发";
BA_ "EventCommandSignal" SG_ 835 PAS_FRSnsErrFlag 0;
BA_ "GatewayedSignals" SG_ 835 PAS_FRSnsErrFlag 0;
BA_ "GenSigInactiveValue" SG_ 835 PAS_FRSnsErrFlag 0;
BA_ "GenSigInvalidValue" SG_ 835 PAS_FRSnsErrFlag 0;
BA_ "GenSigSendType" SG_ 835 PAS_FRSnsErrFlag 1;
BA_ "GenSigStartValue" SG_ 835 PAS_FRSnsErrFlag 0;
BA_ "GenSigTimeoutValue" SG_ 835 PAS_FRSnsErrFlag 0;
BA_ "Remark" SG_ 835 PAS_FRSnsErrFlag "1R1V IFC不发";
BA_ "EventCommandSignal" SG_ 835 PAS_FLSnsErrFlag 0;
BA_ "GatewayedSignals" SG_ 835 PAS_FLSnsErrFlag 0;
BA_ "GenSigInactiveValue" SG_ 835 PAS_FLSnsErrFlag 0;
BA_ "GenSigInvalidValue" SG_ 835 PAS_FLSnsErrFlag 0;
BA_ "GenSigSendType" SG_ 835 PAS_FLSnsErrFlag 1;
BA_ "GenSigStartValue" SG_ 835 PAS_FLSnsErrFlag 0;
BA_ "GenSigTimeoutValue" SG_ 835 PAS_FLSnsErrFlag 0;
BA_ "Remark" SG_ 835 PAS_FLSnsErrFlag "1R1V IFC不发";
BA_ "EventCommandSignal" SG_ 835 PAS_FRMidSnsErrFlag 0;
BA_ "GatewayedSignals" SG_ 835 PAS_FRMidSnsErrFlag 0;
BA_ "GenSigInactiveValue" SG_ 835 PAS_FRMidSnsErrFlag 0;
BA_ "GenSigInvalidValue" SG_ 835 PAS_FRMidSnsErrFlag 0;
BA_ "GenSigSendType" SG_ 835 PAS_FRMidSnsErrFlag 1;
BA_ "GenSigStartValue" SG_ 835 PAS_FRMidSnsErrFlag 0;
BA_ "GenSigTimeoutValue" SG_ 835 PAS_FRMidSnsErrFlag 0;
BA_ "Remark" SG_ 835 PAS_FRMidSnsErrFlag "1R1V IFC不发";
BA_ "EventCommandSignal" SG_ 835 PAS_FLMidSnsErrFlag 0;
BA_ "GatewayedSignals" SG_ 835 PAS_FLMidSnsErrFlag 0;
BA_ "GenSigInactiveValue" SG_ 835 PAS_FLMidSnsErrFlag 0;
BA_ "GenSigInvalidValue" SG_ 835 PAS_FLMidSnsErrFlag 0;
BA_ "GenSigSendType" SG_ 835 PAS_FLMidSnsErrFlag 1;
BA_ "GenSigStartValue" SG_ 835 PAS_FLMidSnsErrFlag 0;
BA_ "GenSigTimeoutValue" SG_ 835 PAS_FLMidSnsErrFlag 0;
BA_ "Remark" SG_ 835 PAS_FLMidSnsErrFlag "1R1V IFC不发";
BA_ "EventCommandSignal" SG_ 835 PAS_FSLSnsErrFlag 0;
BA_ "GatewayedSignals" SG_ 835 PAS_FSLSnsErrFlag 0;
BA_ "GenSigInactiveValue" SG_ 835 PAS_FSLSnsErrFlag 0;
BA_ "GenSigInvalidValue" SG_ 835 PAS_FSLSnsErrFlag 0;
BA_ "GenSigSendType" SG_ 835 PAS_FSLSnsErrFlag 1;
BA_ "GenSigStartValue" SG_ 835 PAS_FSLSnsErrFlag 0;
BA_ "GenSigTimeoutValue" SG_ 835 PAS_FSLSnsErrFlag 0;
BA_ "Remark" SG_ 835 PAS_FSLSnsErrFlag "1R1V IFC不发";
BA_ "EventCommandSignal" SG_ 835 PAS_FSRSnsErrFlag 0;
BA_ "GatewayedSignals" SG_ 835 PAS_FSRSnsErrFlag 0;
BA_ "GenSigInactiveValue" SG_ 835 PAS_FSRSnsErrFlag 0;
BA_ "GenSigInvalidValue" SG_ 835 PAS_FSRSnsErrFlag 0;
BA_ "GenSigSendType" SG_ 835 PAS_FSRSnsErrFlag 1;
BA_ "GenSigStartValue" SG_ 835 PAS_FSRSnsErrFlag 0;
BA_ "GenSigTimeoutValue" SG_ 835 PAS_FSRSnsErrFlag 0;
BA_ "Remark" SG_ 835 PAS_FSRSnsErrFlag "1R1V IFC不发";
BA_ "EventCommandSignal" SG_ 835 PAS_RRMidDislv 0;
BA_ "GatewayedSignals" SG_ 835 PAS_RRMidDislv 0;
BA_ "GenSigInactiveValue" SG_ 835 PAS_RRMidDislv 0;
BA_ "GenSigInvalidValue" SG_ 835 PAS_RRMidDislv 0;
BA_ "GenSigSendType" SG_ 835 PAS_RRMidDislv 1;
BA_ "GenSigStartValue" SG_ 835 PAS_RRMidDislv 0;
BA_ "GenSigTimeoutValue" SG_ 835 PAS_RRMidDislv 0;
BA_ "Remark" SG_ 835 PAS_RRMidDislv "1R1V IFC不发";
BA_ "EventCommandSignal" SG_ 835 PAS_RLMidDislv 0;
BA_ "GatewayedSignals" SG_ 835 PAS_RLMidDislv 0;
BA_ "GenSigInactiveValue" SG_ 835 PAS_RLMidDislv 0;
BA_ "GenSigInvalidValue" SG_ 835 PAS_RLMidDislv 0;
BA_ "GenSigSendType" SG_ 835 PAS_RLMidDislv 1;
BA_ "GenSigStartValue" SG_ 835 PAS_RLMidDislv 0;
BA_ "GenSigTimeoutValue" SG_ 835 PAS_RLMidDislv 0;
BA_ "Remark" SG_ 835 PAS_RLMidDislv "1R1V IFC不发";
BA_ "EventCommandSignal" SG_ 835 PAS_RRDislv 0;
BA_ "GatewayedSignals" SG_ 835 PAS_RRDislv 0;
BA_ "GenSigInactiveValue" SG_ 835 PAS_RRDislv 0;
BA_ "GenSigInvalidValue" SG_ 835 PAS_RRDislv 0;
BA_ "GenSigSendType" SG_ 835 PAS_RRDislv 1;
BA_ "GenSigStartValue" SG_ 835 PAS_RRDislv 0;
BA_ "GenSigTimeoutValue" SG_ 835 PAS_RRDislv 0;
BA_ "Remark" SG_ 835 PAS_RRDislv "1R1V IFC不发";
BA_ "EventCommandSignal" SG_ 835 PAS_RLDislv 0;
BA_ "GatewayedSignals" SG_ 835 PAS_RLDislv 0;
BA_ "GenSigInactiveValue" SG_ 835 PAS_RLDislv 0;
BA_ "GenSigInvalidValue" SG_ 835 PAS_RLDislv 0;
BA_ "GenSigSendType" SG_ 835 PAS_RLDislv 1;
BA_ "GenSigStartValue" SG_ 835 PAS_RLDislv 0;
BA_ "GenSigTimeoutValue" SG_ 835 PAS_RLDislv 0;
BA_ "Remark" SG_ 835 PAS_RLDislv "1R1V IFC不发";
BA_ "EventCommandSignal" SG_ 835 PAS_RSLSideDislv 0;
BA_ "GatewayedSignals" SG_ 835 PAS_RSLSideDislv 0;
BA_ "GenSigInactiveValue" SG_ 835 PAS_RSLSideDislv 0;
BA_ "GenSigInvalidValue" SG_ 835 PAS_RSLSideDislv 0;
BA_ "GenSigSendType" SG_ 835 PAS_RSLSideDislv 1;
BA_ "GenSigStartValue" SG_ 835 PAS_RSLSideDislv 0;
BA_ "GenSigTimeoutValue" SG_ 835 PAS_RSLSideDislv 0;
BA_ "Remark" SG_ 835 PAS_RSLSideDislv "1R1V IFC不发";
BA_ "EventCommandSignal" SG_ 835 PAS_RSRSideDislv 0;
BA_ "GatewayedSignals" SG_ 835 PAS_RSRSideDislv 0;
BA_ "GenSigInactiveValue" SG_ 835 PAS_RSRSideDislv 0;
BA_ "GenSigInvalidValue" SG_ 835 PAS_RSRSideDislv 0;
BA_ "GenSigSendType" SG_ 835 PAS_RSRSideDislv 1;
BA_ "GenSigStartValue" SG_ 835 PAS_RSRSideDislv 0;
BA_ "GenSigTimeoutValue" SG_ 835 PAS_RSRSideDislv 0;
BA_ "Remark" SG_ 835 PAS_RSRSideDislv "1R1V IFC不发";
BA_ "EventCommandSignal" SG_ 835 PAS_FRDislv 0;
BA_ "GatewayedSignals" SG_ 835 PAS_FRDislv 0;
BA_ "GenSigInactiveValue" SG_ 835 PAS_FRDislv 0;
BA_ "GenSigInvalidValue" SG_ 835 PAS_FRDislv 0;
BA_ "GenSigSendType" SG_ 835 PAS_FRDislv 1;
BA_ "GenSigStartValue" SG_ 835 PAS_FRDislv 0;
BA_ "GenSigTimeoutValue" SG_ 835 PAS_FRDislv 0;
BA_ "Remark" SG_ 835 PAS_FRDislv "1R1V IFC不发";
BA_ "EventCommandSignal" SG_ 835 PAS_FLDislv 0;
BA_ "GatewayedSignals" SG_ 835 PAS_FLDislv 0;
BA_ "GenSigInactiveValue" SG_ 835 PAS_FLDislv 0;
BA_ "GenSigInvalidValue" SG_ 835 PAS_FLDislv 0;
BA_ "GenSigSendType" SG_ 835 PAS_FLDislv 1;
BA_ "GenSigStartValue" SG_ 835 PAS_FLDislv 0;
BA_ "GenSigTimeoutValue" SG_ 835 PAS_FLDislv 0;
BA_ "Remark" SG_ 835 PAS_FLDislv "1R1V IFC不发";
BA_ "EventCommandSignal" SG_ 835 PAS_FRMidDislv 0;
BA_ "GatewayedSignals" SG_ 835 PAS_FRMidDislv 0;
BA_ "GenSigInactiveValue" SG_ 835 PAS_FRMidDislv 0;
BA_ "GenSigInvalidValue" SG_ 835 PAS_FRMidDislv 0;
BA_ "GenSigSendType" SG_ 835 PAS_FRMidDislv 1;
BA_ "GenSigStartValue" SG_ 835 PAS_FRMidDislv 0;
BA_ "GenSigTimeoutValue" SG_ 835 PAS_FRMidDislv 0;
BA_ "Remark" SG_ 835 PAS_FRMidDislv "1R1V IFC不发";
BA_ "EventCommandSignal" SG_ 835 PAS_FLMidDislv 0;
BA_ "GatewayedSignals" SG_ 835 PAS_FLMidDislv 0;
BA_ "GenSigInactiveValue" SG_ 835 PAS_FLMidDislv 0;
BA_ "GenSigInvalidValue" SG_ 835 PAS_FLMidDislv 0;
BA_ "GenSigSendType" SG_ 835 PAS_FLMidDislv 1;
BA_ "GenSigStartValue" SG_ 835 PAS_FLMidDislv 0;
BA_ "GenSigTimeoutValue" SG_ 835 PAS_FLMidDislv 0;
BA_ "Remark" SG_ 835 PAS_FLMidDislv "1R1V IFC不发";
BA_ "EventCommandSignal" SG_ 835 PAS_FSRSideDislv 0;
BA_ "GatewayedSignals" SG_ 835 PAS_FSRSideDislv 0;
BA_ "GenSigInactiveValue" SG_ 835 PAS_FSRSideDislv 0;
BA_ "GenSigInvalidValue" SG_ 835 PAS_FSRSideDislv 0;
BA_ "GenSigSendType" SG_ 835 PAS_FSRSideDislv 1;
BA_ "GenSigStartValue" SG_ 835 PAS_FSRSideDislv 0;
BA_ "GenSigTimeoutValue" SG_ 835 PAS_FSRSideDislv 0;
BA_ "Remark" SG_ 835 PAS_FSRSideDislv "1R1V IFC不发";
BA_ "EventCommandSignal" SG_ 835 PAS_FSLSideDislv 0;
BA_ "GatewayedSignals" SG_ 835 PAS_FSLSideDislv 0;
BA_ "GenSigInactiveValue" SG_ 835 PAS_FSLSideDislv 0;
BA_ "GenSigInvalidValue" SG_ 835 PAS_FSLSideDislv 0;
BA_ "GenSigSendType" SG_ 835 PAS_FSLSideDislv 1;
BA_ "GenSigStartValue" SG_ 835 PAS_FSLSideDislv 0;
BA_ "GenSigTimeoutValue" SG_ 835 PAS_FSLSideDislv 0;
BA_ "Remark" SG_ 835 PAS_FSLSideDislv "1R1V IFC不发";
BA_ "EventCommandSignal" SG_ 835 PAS_CtrlModulerrFlag 0;
BA_ "GatewayedSignals" SG_ 835 PAS_CtrlModulerrFlag 0;
BA_ "GenSigInactiveValue" SG_ 835 PAS_CtrlModulerrFlag 0;
BA_ "GenSigInvalidValue" SG_ 835 PAS_CtrlModulerrFlag 0;
BA_ "GenSigSendType" SG_ 835 PAS_CtrlModulerrFlag 1;
BA_ "GenSigStartValue" SG_ 835 PAS_CtrlModulerrFlag 0;
BA_ "GenSigTimeoutValue" SG_ 835 PAS_CtrlModulerrFlag 0;
BA_ "Remark" SG_ 835 PAS_CtrlModulerrFlag "1R1V IFC不发";
BA_ "EventCommandSignal" SG_ 835 PAS_BattVoltErrFlag 0;
BA_ "GatewayedSignals" SG_ 835 PAS_BattVoltErrFlag 0;
BA_ "GenSigInactiveValue" SG_ 835 PAS_BattVoltErrFlag 0;
BA_ "GenSigInvalidValue" SG_ 835 PAS_BattVoltErrFlag 0;
BA_ "GenSigSendType" SG_ 835 PAS_BattVoltErrFlag 1;
BA_ "GenSigStartValue" SG_ 835 PAS_BattVoltErrFlag 0;
BA_ "GenSigTimeoutValue" SG_ 835 PAS_BattVoltErrFlag 0;
BA_ "Remark" SG_ 835 PAS_BattVoltErrFlag "1R1V IFC不发";
BA_ "EventCommandSignal" SG_ 835 ADC_IDC_DisplayReq 0;
BA_ "GatewayedSignals" SG_ 835 ADC_IDC_DisplayReq 0;
BA_ "GenSigInactiveValue" SG_ 835 ADC_IDC_DisplayReq 0;
BA_ "GenSigInvalidValue" SG_ 835 ADC_IDC_DisplayReq 0;
BA_ "GenSigSendType" SG_ 835 ADC_IDC_DisplayReq 1;
BA_ "GenSigStartValue" SG_ 835 ADC_IDC_DisplayReq 1;
BA_ "GenSigTimeoutValue" SG_ 835 ADC_IDC_DisplayReq 0;
BA_ "Remark" SG_ 835 ADC_IDC_DisplayReq "1R1V IFC不发";
BA_ "EventCommandSignal" SG_ 835 ADC_PAAShortPresSuppSt 0;
BA_ "GatewayedSignals" SG_ 835 ADC_PAAShortPresSuppSt 0;
BA_ "GenSigInactiveValue" SG_ 835 ADC_PAAShortPresSuppSt 0;
BA_ "GenSigInvalidValue" SG_ 835 ADC_PAAShortPresSuppSt 0;
BA_ "GenSigSendType" SG_ 835 ADC_PAAShortPresSuppSt 1;
BA_ "GenSigStartValue" SG_ 835 ADC_PAAShortPresSuppSt 0;
BA_ "GenSigTimeoutValue" SG_ 835 ADC_PAAShortPresSuppSt 0;
BA_ "Remark" SG_ 835 ADC_PAAShortPresSuppSt "1R1V IFC不发";
BA_ "EventCommandSignal" SG_ 835 ADC_PAACtrlSigSrc 0;
BA_ "GatewayedSignals" SG_ 835 ADC_PAACtrlSigSrc 0;
BA_ "GenSigInactiveValue" SG_ 835 ADC_PAACtrlSigSrc 0;
BA_ "GenSigInvalidValue" SG_ 835 ADC_PAACtrlSigSrc 0;
BA_ "GenSigSendType" SG_ 835 ADC_PAACtrlSigSrc 1;
BA_ "GenSigStartValue" SG_ 835 ADC_PAACtrlSigSrc 0;
BA_ "GenSigTimeoutValue" SG_ 835 ADC_PAACtrlSigSrc 0;
BA_ "Remark" SG_ 835 ADC_PAACtrlSigSrc "1R1V IFC不发";
BA_ "EventCommandSignal" SG_ 835 ADC_UsageModeRequstResult 0;
BA_ "GatewayedSignals" SG_ 835 ADC_UsageModeRequstResult 0;
BA_ "GenSigInactiveValue" SG_ 835 ADC_UsageModeRequstResult 0;
BA_ "GenSigInvalidValue" SG_ 835 ADC_UsageModeRequstResult 0;
BA_ "GenSigSendType" SG_ 835 ADC_UsageModeRequstResult 1;
BA_ "GenSigStartValue" SG_ 835 ADC_UsageModeRequstResult 0;
BA_ "GenSigTimeoutValue" SG_ 835 ADC_UsageModeRequstResult 0;
BA_ "Remark" SG_ 835 ADC_UsageModeRequstResult "1R1V IFC不发";
BA_ "EventCommandSignal" SG_ 835 ADC_ACU_DisplayReq 0;
BA_ "GatewayedSignals" SG_ 835 ADC_ACU_DisplayReq 0;
BA_ "GenSigInactiveValue" SG_ 835 ADC_ACU_DisplayReq 0;
BA_ "GenSigInvalidValue" SG_ 835 ADC_ACU_DisplayReq 0;
BA_ "GenSigSendType" SG_ 835 ADC_ACU_DisplayReq 1;
BA_ "GenSigStartValue" SG_ 835 ADC_ACU_DisplayReq 0;
BA_ "GenSigTimeoutValue" SG_ 835 ADC_ACU_DisplayReq 0;
BA_ "Remark" SG_ 835 ADC_ACU_DisplayReq "1R1V IFC不发";
BA_ "EventCommandSignal" SG_ 835 ADC_DPMessagePushSt 0;
BA_ "GatewayedSignals" SG_ 835 ADC_DPMessagePushSt 0;
BA_ "GenSigInactiveValue" SG_ 835 ADC_DPMessagePushSt 0;
BA_ "GenSigInvalidValue" SG_ 835 ADC_DPMessagePushSt 0;
BA_ "GenSigSendType" SG_ 835 ADC_DPMessagePushSt 1;
BA_ "GenSigStartValue" SG_ 835 ADC_DPMessagePushSt 0;
BA_ "GenSigTimeoutValue" SG_ 835 ADC_DPMessagePushSt 0;
BA_ "Remark" SG_ 835 ADC_DPMessagePushSt "1R1V IFC不发";
BA_ "EventCommandSignal" SG_ 835 PCS_SystemSt 0;
BA_ "GatewayedSignals" SG_ 835 PCS_SystemSt 0;
BA_ "GenSigInactiveValue" SG_ 835 PCS_SystemSt 0;
BA_ "GenSigInvalidValue" SG_ 835 PCS_SystemSt 0;
BA_ "GenSigSendType" SG_ 835 PCS_SystemSt 1;
BA_ "GenSigStartValue" SG_ 835 PCS_SystemSt 0;
BA_ "GenSigTimeoutValue" SG_ 835 PCS_SystemSt 0;
BA_ "Remark" SG_ 835 PCS_SystemSt "1R1V IFC不发";
BA_ "EventCommandSignal" SG_ 835 PCS_FrontLeftCameraFail 0;
BA_ "GatewayedSignals" SG_ 835 PCS_FrontLeftCameraFail 0;
BA_ "GenSigInactiveValue" SG_ 835 PCS_FrontLeftCameraFail 0;
BA_ "GenSigInvalidValue" SG_ 835 PCS_FrontLeftCameraFail 0;
BA_ "GenSigSendType" SG_ 835 PCS_FrontLeftCameraFail 1;
BA_ "GenSigStartValue" SG_ 835 PCS_FrontLeftCameraFail 0;
BA_ "GenSigTimeoutValue" SG_ 835 PCS_FrontLeftCameraFail 0;
BA_ "Remark" SG_ 835 PCS_FrontLeftCameraFail "1R1V IFC不发";
BA_ "EventCommandSignal" SG_ 835 PCS_FrontRightCameraFail 0;
BA_ "GatewayedSignals" SG_ 835 PCS_FrontRightCameraFail 0;
BA_ "GenSigInactiveValue" SG_ 835 PCS_FrontRightCameraFail 0;
BA_ "GenSigInvalidValue" SG_ 835 PCS_FrontRightCameraFail 0;
BA_ "GenSigSendType" SG_ 835 PCS_FrontRightCameraFail 1;
BA_ "GenSigStartValue" SG_ 835 PCS_FrontRightCameraFail 0;
BA_ "GenSigTimeoutValue" SG_ 835 PCS_FrontRightCameraFail 0;
BA_ "Remark" SG_ 835 PCS_FrontRightCameraFail "1R1V IFC不发";
BA_ "EventCommandSignal" SG_ 835 PCS_EventRecordSt 0;
BA_ "GatewayedSignals" SG_ 835 PCS_EventRecordSt 0;
BA_ "GenSigInactiveValue" SG_ 835 PCS_EventRecordSt 0;
BA_ "GenSigInvalidValue" SG_ 835 PCS_EventRecordSt 0;
BA_ "GenSigSendType" SG_ 835 PCS_EventRecordSt 1;
BA_ "GenSigStartValue" SG_ 835 PCS_EventRecordSt 0;
BA_ "GenSigTimeoutValue" SG_ 835 PCS_EventRecordSt 0;
BA_ "Remark" SG_ 835 PCS_EventRecordSt "1R1V IFC不发";
BA_ "EventCommandSignal" SG_ 835 PCS_HMIIndex 0;
BA_ "GatewayedSignals" SG_ 835 PCS_HMIIndex 0;
BA_ "GenSigInactiveValue" SG_ 835 PCS_HMIIndex 0;
BA_ "GenSigInvalidValue" SG_ 835 PCS_HMIIndex 0;
BA_ "GenSigSendType" SG_ 835 PCS_HMIIndex 1;
BA_ "GenSigStartValue" SG_ 835 PCS_HMIIndex 0;
BA_ "GenSigTimeoutValue" SG_ 835 PCS_HMIIndex 0;
BA_ "Remark" SG_ 835 PCS_HMIIndex "1R1V IFC不发";
BA_ "EventCommandSignal" SG_ 835 PCS_SingleViewInd 0;
BA_ "GatewayedSignals" SG_ 835 PCS_SingleViewInd 0;
BA_ "GenSigInactiveValue" SG_ 835 PCS_SingleViewInd 0;
BA_ "GenSigInvalidValue" SG_ 835 PCS_SingleViewInd 0;
BA_ "GenSigSendType" SG_ 835 PCS_SingleViewInd 1;
BA_ "GenSigStartValue" SG_ 835 PCS_SingleViewInd 0;
BA_ "GenSigTimeoutValue" SG_ 835 PCS_SingleViewInd 0;
BA_ "Remark" SG_ 835 PCS_SingleViewInd "1R1V IFC不发";
BA_ "EventCommandSignal" SG_ 835 PCS_VoiceReq 0;
BA_ "GatewayedSignals" SG_ 835 PCS_VoiceReq 0;
BA_ "GenSigInactiveValue" SG_ 835 PCS_VoiceReq 0;
BA_ "GenSigInvalidValue" SG_ 835 PCS_VoiceReq 0;
BA_ "GenSigSendType" SG_ 835 PCS_VoiceReq 1;
BA_ "GenSigStartValue" SG_ 835 PCS_VoiceReq 0;
BA_ "GenSigTimeoutValue" SG_ 835 PCS_VoiceReq 0;
BA_ "Remark" SG_ 835 PCS_VoiceReq "1R1V IFC不发";
BA_ "EventCommandSignal" SG_ 835 PCS_LeftBlindSpotViewSt 0;
BA_ "GatewayedSignals" SG_ 835 PCS_LeftBlindSpotViewSt 0;
BA_ "GenSigInactiveValue" SG_ 835 PCS_LeftBlindSpotViewSt 0;
BA_ "GenSigInvalidValue" SG_ 835 PCS_LeftBlindSpotViewSt 0;
BA_ "GenSigSendType" SG_ 835 PCS_LeftBlindSpotViewSt 1;
BA_ "GenSigStartValue" SG_ 835 PCS_LeftBlindSpotViewSt 0;
BA_ "GenSigTimeoutValue" SG_ 835 PCS_LeftBlindSpotViewSt 0;
BA_ "Remark" SG_ 835 PCS_LeftBlindSpotViewSt "1R1V IFC不发";
BA_ "EventCommandSignal" SG_ 835 PCS_RightBlindSpotViewSt 0;
BA_ "GatewayedSignals" SG_ 835 PCS_RightBlindSpotViewSt 0;
BA_ "GenSigInactiveValue" SG_ 835 PCS_RightBlindSpotViewSt 0;
BA_ "GenSigInvalidValue" SG_ 835 PCS_RightBlindSpotViewSt 0;
BA_ "GenSigSendType" SG_ 835 PCS_RightBlindSpotViewSt 1;
BA_ "GenSigStartValue" SG_ 835 PCS_RightBlindSpotViewSt 0;
BA_ "GenSigTimeoutValue" SG_ 835 PCS_RightBlindSpotViewSt 0;
BA_ "Remark" SG_ 835 PCS_RightBlindSpotViewSt "1R1V IFC不发";
BA_ "EventCommandSignal" SG_ 835 PCS_ReturnSt 0;
BA_ "GatewayedSignals" SG_ 835 PCS_ReturnSt 0;
BA_ "GenSigInactiveValue" SG_ 835 PCS_ReturnSt 0;
BA_ "GenSigInvalidValue" SG_ 835 PCS_ReturnSt 0;
BA_ "GenSigSendType" SG_ 835 PCS_ReturnSt 1;
BA_ "GenSigStartValue" SG_ 835 PCS_ReturnSt 0;
BA_ "GenSigTimeoutValue" SG_ 835 PCS_ReturnSt 0;
BA_ "Remark" SG_ 835 PCS_ReturnSt "1R1V IFC不发";
BA_ "EventCommandSignal" SG_ 835 PCS_HelpMenuSt 0;
BA_ "GatewayedSignals" SG_ 835 PCS_HelpMenuSt 0;
BA_ "GenSigInactiveValue" SG_ 835 PCS_HelpMenuSt 0;
BA_ "GenSigInvalidValue" SG_ 835 PCS_HelpMenuSt 0;
BA_ "GenSigSendType" SG_ 835 PCS_HelpMenuSt 1;
BA_ "GenSigStartValue" SG_ 835 PCS_HelpMenuSt 0;
BA_ "GenSigTimeoutValue" SG_ 835 PCS_HelpMenuSt 0;
BA_ "Remark" SG_ 835 PCS_HelpMenuSt "1R1V IFC不发";
BA_ "EventCommandSignal" SG_ 835 PCS_SoundReminderSt 0;
BA_ "GatewayedSignals" SG_ 835 PCS_SoundReminderSt 0;
BA_ "GenSigInactiveValue" SG_ 835 PCS_SoundReminderSt 0;
BA_ "GenSigInvalidValue" SG_ 835 PCS_SoundReminderSt 0;
BA_ "GenSigSendType" SG_ 835 PCS_SoundReminderSt 1;
BA_ "GenSigStartValue" SG_ 835 PCS_SoundReminderSt 0;
BA_ "GenSigTimeoutValue" SG_ 835 PCS_SoundReminderSt 0;
BA_ "Remark" SG_ 835 PCS_SoundReminderSt "1R1V IFC不发";
BA_ "EventCommandSignal" SG_ 835 PCS_ER_EnterConfirm 0;
BA_ "GatewayedSignals" SG_ 835 PCS_ER_EnterConfirm 0;
BA_ "GenSigInactiveValue" SG_ 835 PCS_ER_EnterConfirm 0;
BA_ "GenSigInvalidValue" SG_ 835 PCS_ER_EnterConfirm 0;
BA_ "GenSigSendType" SG_ 835 PCS_ER_EnterConfirm 1;
BA_ "GenSigStartValue" SG_ 835 PCS_ER_EnterConfirm 0;
BA_ "GenSigTimeoutValue" SG_ 835 PCS_ER_EnterConfirm 0;
BA_ "Remark" SG_ 835 PCS_ER_EnterConfirm "1R1V IFC不发";
BA_ "EventCommandSignal" SG_ 835 PCS_MirrorPageDownButton 0;
BA_ "GatewayedSignals" SG_ 835 PCS_MirrorPageDownButton 0;
BA_ "GenSigInactiveValue" SG_ 835 PCS_MirrorPageDownButton 0;
BA_ "GenSigInvalidValue" SG_ 835 PCS_MirrorPageDownButton 0;
BA_ "GenSigSendType" SG_ 835 PCS_MirrorPageDownButton 1;
BA_ "GenSigStartValue" SG_ 835 PCS_MirrorPageDownButton 0;
BA_ "GenSigTimeoutValue" SG_ 835 PCS_MirrorPageDownButton 0;
BA_ "Remark" SG_ 835 PCS_MirrorPageDownButton "1R1V IFC不发";
BA_ "EventCommandSignal" SG_ 835 PCS_ER_QuitReq 0;
BA_ "GatewayedSignals" SG_ 835 PCS_ER_QuitReq 0;
BA_ "GenSigInactiveValue" SG_ 835 PCS_ER_QuitReq 0;
BA_ "GenSigInvalidValue" SG_ 835 PCS_ER_QuitReq 0;
BA_ "GenSigSendType" SG_ 835 PCS_ER_QuitReq 1;
BA_ "GenSigStartValue" SG_ 835 PCS_ER_QuitReq 0;
BA_ "GenSigTimeoutValue" SG_ 835 PCS_ER_QuitReq 0;
BA_ "Remark" SG_ 835 PCS_ER_QuitReq "1R1V IFC不发";
BA_ "EventCommandSignal" SG_ 835 PCS_PASButtonPress 0;
BA_ "GatewayedSignals" SG_ 835 PCS_PASButtonPress 0;
BA_ "GenSigInactiveValue" SG_ 835 PCS_PASButtonPress 0;
BA_ "GenSigInvalidValue" SG_ 835 PCS_PASButtonPress 0;
BA_ "GenSigSendType" SG_ 835 PCS_PASButtonPress 1;
BA_ "GenSigStartValue" SG_ 835 PCS_PASButtonPress 0;
BA_ "GenSigTimeoutValue" SG_ 835 PCS_PASButtonPress 0;
BA_ "Remark" SG_ 835 PCS_PASButtonPress "1R1V IFC不发";
BA_ "EventCommandSignal" SG_ 835 PCS_VRSwitchFailSt 0;
BA_ "GatewayedSignals" SG_ 835 PCS_VRSwitchFailSt 0;
BA_ "GenSigInactiveValue" SG_ 835 PCS_VRSwitchFailSt 0;
BA_ "GenSigInvalidValue" SG_ 835 PCS_VRSwitchFailSt 0;
BA_ "GenSigSendType" SG_ 835 PCS_VRSwitchFailSt 1;
BA_ "GenSigStartValue" SG_ 835 PCS_VRSwitchFailSt 0;
BA_ "GenSigTimeoutValue" SG_ 835 PCS_VRSwitchFailSt 0;
BA_ "Remark" SG_ 835 PCS_VRSwitchFailSt "1R1V IFC不发";
BA_ "EventCommandSignal" SG_ 835 PCS_FrontCameraFail 0;
BA_ "GatewayedSignals" SG_ 835 PCS_FrontCameraFail 0;
BA_ "GenSigInactiveValue" SG_ 835 PCS_FrontCameraFail 0;
BA_ "GenSigInvalidValue" SG_ 835 PCS_FrontCameraFail 0;
BA_ "GenSigSendType" SG_ 835 PCS_FrontCameraFail 1;
BA_ "GenSigStartValue" SG_ 835 PCS_FrontCameraFail 0;
BA_ "GenSigTimeoutValue" SG_ 835 PCS_FrontCameraFail 0;
BA_ "Remark" SG_ 835 PCS_FrontCameraFail "1R1V IFC不发";
BA_ "EventCommandSignal" SG_ 835 PCS_LeftCameraFail 0;
BA_ "GatewayedSignals" SG_ 835 PCS_LeftCameraFail 0;
BA_ "GenSigInactiveValue" SG_ 835 PCS_LeftCameraFail 0;
BA_ "GenSigInvalidValue" SG_ 835 PCS_LeftCameraFail 0;
BA_ "GenSigSendType" SG_ 835 PCS_LeftCameraFail 1;
BA_ "GenSigStartValue" SG_ 835 PCS_LeftCameraFail 0;
BA_ "GenSigTimeoutValue" SG_ 835 PCS_LeftCameraFail 0;
BA_ "Remark" SG_ 835 PCS_LeftCameraFail "1R1V IFC不发";
BA_ "EventCommandSignal" SG_ 835 PCS_RightCameraFail 0;
BA_ "GatewayedSignals" SG_ 835 PCS_RightCameraFail 0;
BA_ "GenSigInactiveValue" SG_ 835 PCS_RightCameraFail 0;
BA_ "GenSigInvalidValue" SG_ 835 PCS_RightCameraFail 0;
BA_ "GenSigSendType" SG_ 835 PCS_RightCameraFail 1;
BA_ "GenSigStartValue" SG_ 835 PCS_RightCameraFail 0;
BA_ "GenSigTimeoutValue" SG_ 835 PCS_RightCameraFail 0;
BA_ "Remark" SG_ 835 PCS_RightCameraFail "1R1V IFC不发";
BA_ "EventCommandSignal" SG_ 835 PCS_RearCameraFail 0;
BA_ "GatewayedSignals" SG_ 835 PCS_RearCameraFail 0;
BA_ "GenSigInactiveValue" SG_ 835 PCS_RearCameraFail 0;
BA_ "GenSigInvalidValue" SG_ 835 PCS_RearCameraFail 0;
BA_ "GenSigSendType" SG_ 835 PCS_RearCameraFail 1;
BA_ "GenSigStartValue" SG_ 835 PCS_RearCameraFail 0;
BA_ "GenSigTimeoutValue" SG_ 835 PCS_RearCameraFail 0;
BA_ "Remark" SG_ 835 PCS_RearCameraFail "1R1V IFC不发";
BA_ "EventCommandSignal" SG_ 835 PCS_ACU_DisplayReq 0;
BA_ "GatewayedSignals" SG_ 835 PCS_ACU_DisplayReq 0;
BA_ "GenSigInactiveValue" SG_ 835 PCS_ACU_DisplayReq 0;
BA_ "GenSigInvalidValue" SG_ 835 PCS_ACU_DisplayReq 0;
BA_ "GenSigSendType" SG_ 835 PCS_ACU_DisplayReq 1;
BA_ "GenSigStartValue" SG_ 835 PCS_ACU_DisplayReq 0;
BA_ "GenSigTimeoutValue" SG_ 835 PCS_ACU_DisplayReq 0;
BA_ "Remark" SG_ 835 PCS_ACU_DisplayReq "1R1V IFC不发";
BA_ "EventCommandSignal" SG_ 835 PCS_CalibrateSt 0;
BA_ "GatewayedSignals" SG_ 835 PCS_CalibrateSt 0;
BA_ "GenSigInactiveValue" SG_ 835 PCS_CalibrateSt 0;
BA_ "GenSigInvalidValue" SG_ 835 PCS_CalibrateSt 0;
BA_ "GenSigSendType" SG_ 835 PCS_CalibrateSt 1;
BA_ "GenSigStartValue" SG_ 835 PCS_CalibrateSt 0;
BA_ "GenSigTimeoutValue" SG_ 835 PCS_CalibrateSt 0;
BA_ "Remark" SG_ 835 PCS_CalibrateSt "1R1V IFC不发";
BA_ "EventCommandSignal" SG_ 835 PCS_MODEnalbe 0;
BA_ "GatewayedSignals" SG_ 835 PCS_MODEnalbe 0;
BA_ "GenSigInactiveValue" SG_ 835 PCS_MODEnalbe 0;
BA_ "GenSigInvalidValue" SG_ 835 PCS_MODEnalbe 0;
BA_ "GenSigSendType" SG_ 835 PCS_MODEnalbe 1;
BA_ "GenSigStartValue" SG_ 835 PCS_MODEnalbe 0;
BA_ "GenSigTimeoutValue" SG_ 835 PCS_MODEnalbe 0;
BA_ "Remark" SG_ 835 PCS_MODEnalbe "1R1V IFC不发";
BA_ "EventCommandSignal" SG_ 835 PCS_3DEnalbe 0;
BA_ "GatewayedSignals" SG_ 835 PCS_3DEnalbe 0;
BA_ "GenSigInactiveValue" SG_ 835 PCS_3DEnalbe 0;
BA_ "GenSigInvalidValue" SG_ 835 PCS_3DEnalbe 0;
BA_ "GenSigSendType" SG_ 835 PCS_3DEnalbe 1;
BA_ "GenSigStartValue" SG_ 835 PCS_3DEnalbe 0;
BA_ "GenSigTimeoutValue" SG_ 835 PCS_3DEnalbe 0;
BA_ "Remark" SG_ 835 PCS_3DEnalbe "1R1V IFC不发";
BA_ "EventCommandSignal" SG_ 835 PCS_SystemType 0;
BA_ "GatewayedSignals" SG_ 835 PCS_SystemType 0;
BA_ "GenSigInactiveValue" SG_ 835 PCS_SystemType 0;
BA_ "GenSigInvalidValue" SG_ 835 PCS_SystemType 0;
BA_ "GenSigSendType" SG_ 835 PCS_SystemType 1;
BA_ "GenSigStartValue" SG_ 835 PCS_SystemType 0;
BA_ "GenSigTimeoutValue" SG_ 835 PCS_SystemType 0;
BA_ "Remark" SG_ 835 PCS_SystemType "1R1V IFC不发";
BA_ "EventCommandSignal" SG_ 835 PCS_OperationSt 0;
BA_ "GatewayedSignals" SG_ 835 PCS_OperationSt 0;
BA_ "GenSigInactiveValue" SG_ 835 PCS_OperationSt 0;
BA_ "GenSigInvalidValue" SG_ 835 PCS_OperationSt 0;
BA_ "GenSigSendType" SG_ 835 PCS_OperationSt 1;
BA_ "GenSigStartValue" SG_ 835 PCS_OperationSt 0;
BA_ "GenSigTimeoutValue" SG_ 835 PCS_OperationSt 0;
BA_ "Remark" SG_ 835 PCS_OperationSt "1R1V IFC不发";
BA_ "EventCommandSignal" SG_ 835 DMS_FaceID_ADC 0;
BA_ "GatewayedSignals" SG_ 835 DMS_FaceID_ADC 0;
BA_ "GenSigInactiveValue" SG_ 835 DMS_FaceID_ADC 0;
BA_ "GenSigInvalidValue" SG_ 835 DMS_FaceID_ADC 0;
BA_ "GenSigSendType" SG_ 835 DMS_FaceID_ADC 1;
BA_ "GenSigStartValue" SG_ 835 DMS_FaceID_ADC 0;
BA_ "GenSigTimeoutValue" SG_ 835 DMS_FaceID_ADC 0;
BA_ "Remark" SG_ 835 DMS_FaceID_ADC "Byte40~Byte47 for DMS
1R1V IFC不发";
BA_ "EventCommandSignal" SG_ 835 DMS_SysErrSt_ADC 0;
BA_ "GatewayedSignals" SG_ 835 DMS_SysErrSt_ADC 0;
BA_ "GenSigInactiveValue" SG_ 835 DMS_SysErrSt_ADC 0;
BA_ "GenSigInvalidValue" SG_ 835 DMS_SysErrSt_ADC 0;
BA_ "GenSigSendType" SG_ 835 DMS_SysErrSt_ADC 1;
BA_ "GenSigStartValue" SG_ 835 DMS_SysErrSt_ADC 0;
BA_ "GenSigTimeoutValue" SG_ 835 DMS_SysErrSt_ADC 0;
BA_ "Remark" SG_ 835 DMS_SysErrSt_ADC "1R1V IFC不发";
BA_ "EventCommandSignal" SG_ 835 OMS_SysErrSt_ADC 0;
BA_ "GatewayedSignals" SG_ 835 OMS_SysErrSt_ADC 0;
BA_ "GenSigInactiveValue" SG_ 835 OMS_SysErrSt_ADC 0;
BA_ "GenSigInvalidValue" SG_ 835 OMS_SysErrSt_ADC 0;
BA_ "GenSigSendType" SG_ 835 OMS_SysErrSt_ADC 1;
BA_ "GenSigStartValue" SG_ 835 OMS_SysErrSt_ADC 0;
BA_ "GenSigTimeoutValue" SG_ 835 OMS_SysErrSt_ADC 0;
BA_ "Remark" SG_ 835 OMS_SysErrSt_ADC "1R1V IFC不发";
VAL_ 175 ADC_PAAChallengeReceive 0 "No Receive" 1 "Receive"  ;
VAL_ 175 PAA_DVRTriggerId 0 "Real time Video Request" 1 "AEB Trigger" 2 "FCW Trigger" 3 "ABP Request" 4 "Crash happen" 5 "LongAccel Over limit" 6 "APA Terminated" 7 "HWA ILCLeft Trigger" 8 "HWA ILCRight Trigger" 9 "HWA TakeOver Trigger" 10 "HWA SafeStop" 11 "RAEB Active" 12 "Parking Real time Video Request" 13 "Reserve" 14 "Reserve" 15 "Reserve" 16 "Reserve" 17 "Reserve" 18 "Reserve" 19 "Reserve" 20 "Reserve" 21 "Reserve" 22 "Reserve" 23 "Reserve" 24 "Reserve" 25 "Reserve" 26 "Reserve" 27 "Reserve" 28 "Reserve" 29 "Reserve" 30 "Reserve" 31 "Reserve"  ;
VAL_ 175 PAA_DVRTrigger 0 "No trigger" 1 "Trigger"  ;
VAL_ 175 ADC_LCAEnableSt 0 "Off" 1 "On" 2 "Failure" 3 "reserved"  ;
VAL_ 175 ADC_APAActPushSt 0 "Not Push" 1 "SenslesEtyParkingPush"  ;
VAL_ 941 ADC_HPAStrtgEndgPointInfo 0 "No Request" 1 "Insufficient brightness for PI starting" 2 "Too empty environment for PI starting" 3 "Front car is too close for PI starting" 4 "Camera is blocked for PI starting" 5 "Environment is abnormal for PI starting" 6 "System error for PI starting" 7 "Insufficient brightness for PO starting" 8 "Too empty environment for PO starting" 9 "Front car is too close for PO starting" 10 "Camera is blocked for PO starting" 11 "Environment is abnormal for PO starting" 12 "System error for for PO starting" 13 "Not in parking space linefor PO starting" 14 "Insufficient brightness for PI ending" 15 "Too empty environment for PI ending" 16 "Front car is too close for PI ending" 17 "Camera is blocked for PI ending" 18 "Environment is abnormal for PI ending" 19 "System error for PI ending" 20 "Not in parking space line for PI ending" 21 "Insufficient brightness for PO ending" 22 "Too empty environment for PO ending" 23 "Front car is too close for PO ending" 24 "Camera is blocked for PO ending" 25 "Environment is abnormal for PO ending" 26 "System error for PO ending" 27 "Not in parking space line for PO ending" 28 "Not supported R gear? for PO ending" 29 "Not supported D gear? for PI ending" 30 "Ending invailid" 31 "Reserved"  ;
VAL_ 941 ADC_HPALearningProcessInfo 0 "No text" 1 "Set path starting point" 2 "Speed high" 3 "Starting point invalid" 4 "Continue driving" 5 "Distance limit" 6 "Exceed learning distance limit" 7 "Automatic parking in" 8 "Saving path" 9 "Learning path invalid_Reserved" 10 "Setting path name" 11 "Learning path valid_Reserved" 12 "Fixed or random parking lot" 13 "Learning finished" 14 "Keep drving to ending" 15 "Setting path ending" 16 "Ending point invalid" 17 "Learning path failed" 18 "Speed higher than 15km/h" 19 "Speed higher than 20km/h and quit" 20 "Path starting point success" 21 "Reserved" 22 "Reserved" 23 "Reserved" 24 "Reserved" 25 "Reserved" 26 "Reserved" 27 "Reserved" 28 "Reserved" 29 "Reserved" 30 "Reserved" 31 "Reserved"  ;
VAL_ 941 ADC_HPALearningFailedInfo 0 "No text" 1 "Learning time exceed 10mins" 2 "Insufficient brightness" 3 "Too empty environment" 4 "Front car is too close" 5 "Camera is blocked" 6 "Environment is abnormal" 7 "System error" 8 "Slope beyond limit 15%" 9 "Need to overscan a slot" 10 "Reserved" 11 "Reserved" 12 "Reserved" 13 "Reserved" 14 "Reserved" 15 "Reserved"  ;
VAL_ 941 ADC_ParkSlotChoiceL1 0 "No Park" 1 "Parallel" 2 "Cross" 3 "Diagnoal"  ;
VAL_ 941 ADC_IconTwinkle 0 "No" 1 "Yes"  ;
VAL_ 941 ADC_ParkSlotChoiceR1 0 "No Park" 1 "Parallel" 2 "Cross" 3 "Diagnoal"  ;
VAL_ 941 ADC_ParkSlotChoiceL2 0 "No Park" 1 "Parallel" 2 "Cross" 3 "Diagnoal"  ;
VAL_ 941 ADC_ParkSlotChoiceR2 0 "No Park" 1 "Parallel" 2 "Cross" 3 "Diagnoal"  ;
VAL_ 941 ADC_ParkSlotChoiceL3 0 "No Park" 1 "Parallel" 2 "Cross" 3 "Diagnoal"  ;
VAL_ 941 ADC_ParkSlotChoiceR3 0 "No Park" 1 "Parallel" 2 "Cross" 3 "Diagnoal"  ;
VAL_ 941 ADC_ParkSlotChoiceL4 0 "No Park" 1 "Parallel" 2 "Cross" 3 "Diagnoal"  ;
VAL_ 941 ADC_ParkSlotChoiceR4 0 "No Park" 1 "Parallel" 2 "Cross" 3 "Diagnoal"  ;
VAL_ 941 ADC_ParkSlotChoiceL5 0 "No Park" 1 "Parallel" 2 "Cross" 3 "Diagnoal"  ;
VAL_ 941 ADC_ParkSlotChoiceR5 0 "No Park" 1 "Parallel" 2 "Cross" 3 "Diagnoal"  ;
VAL_ 941 ADC_ParkSlotChoiceL6 0 "No Park" 1 "Parallel" 2 "Cross" 3 "Diagnoal"  ;
VAL_ 941 ADC_ParkSlotChoiceR6 0 "No Park" 1 "Parallel" 2 "Cross" 3 "Diagnoal"  ;
VAL_ 941 ADC_ParkSlotChoiceL7 0 "No Park" 1 "Parallel" 2 "Cross" 3 "Diagnoal"  ;
VAL_ 941 ADC_ParkSlotChoiceR7 0 "No Park" 1 "Parallel" 2 "Cross" 3 "Diagnoal"  ;
VAL_ 941 ADC_ParkSlotChoiceL8 0 "No Park" 1 "Parallel" 2 "Cross" 3 "Diagnoal"  ;
VAL_ 941 ADC_ParkSlotChoiceR8 0 "No Park" 1 "Parallel" 2 "Cross" 3 "Diagnoal"  ;
VAL_ 941 ADC_SlotSelectFebk 0 "No text" 1 "L1" 2 "L2" 3 "L3" 4 "L4" 5 "L5" 6 "L6" 7 "L7" 8 "L8" 9 "R1" 10 "R2" 11 "R3" 12 "R4" 13 "R5" 14 "R6" 15 "R7" 16 "R8" 17 "Reserved" 18 "Reserved" 19 "Reserved" 20 "Reserved" 21 "Reserved" 22 "Reserved" 23 "Reserved" 24 "Reserved" 25 "Reserved" 26 "Reserved" 27 "Reserved" 28 "Reserved" 29 "Reserved" 30 "Reserved" 31 "Reserved"  ;
VAL_ 941 ADC_AVPParkSlotInfo 0 "No command"  ;
VAL_ 941 ADC_SwitchStShow 0 "None" 1 "invalid" 2 "valid" 3 "Reversed"  ;
VAL_ 941 FAPA_RPAShortPresSuppSt 0 "Not support" 1 "Support"  ;
VAL_ 941 ADC_HPASwitchStShow 0 "None" 1 "invalid" 2 "valid" 3 "Reversed"  ;
VAL_ 941 ADC_AVPSwitchStShow 0 "None" 1 "invalid" 2 "valid" 3 "Reversed"  ;
VAL_ 941 ADC_HPALearningPathType1 0 "Invalid" 1 "Parking in type" 2 "Trace tracking type" 3 "Parking out type"  ;
VAL_ 941 ADC_HPALearningLotType1 0 "Invalid" 1 "Fixed parking lot" 2 "Random parking lot" 3 "Reserved"  ;
VAL_ 941 ADC_HPAPathSt1 0 "No comment" 1 "Valid Path" 2 "Learning Inprocess Path" 3 "backstage Learning Inprocess Path"  ;
VAL_ 941 ADC_HPAPath1Src 0 "No comment" 1 "Learn Path" 2 "Share Path" 3 "Reserved"  ;
VAL_ 941 ADC_HPALearningPathType2 0 "Invalid" 1 "Parking in type" 2 "Trace tracking type" 3 "Parking out type"  ;
VAL_ 941 ADC_HPALearningLotType2 0 "Invalid" 1 "Fixed parking lot" 2 "Random parking lot" 3 "Reserved"  ;
VAL_ 941 ADC_HPAPathSt2 0 "No comment" 1 "Valid Path" 2 "Learning Inprocess Path" 3 "backstage Learning Inprocess Path"  ;
VAL_ 941 ADC_HPAPath2Src 0 "No comment" 1 "Learn Path" 2 "Share Path" 3 "Reserved"  ;
VAL_ 941 ADC_HPAPath1MatGpsSucces 0 "No request" 1 "Request"  ;
VAL_ 941 ADC_HPAPath2MatGpsSucces 0 "No request" 1 "Request"  ;
VAL_ 941 ADC_HPALearningPathType3 0 "Invalid" 1 "Parking in type" 2 "Trace tracking type" 3 "Parking out type"  ;
VAL_ 941 ADC_HPALearningLotType3 0 "Invalid" 1 "Fixed parking lot" 2 "Random parking lot" 3 "Reserved"  ;
VAL_ 941 ADC_HPAPathSt3 0 "No comment" 1 "Valid Path" 2 "Learning Inprocess Path" 3 "backstage Learning Inprocess Path"  ;
VAL_ 941 ADC_HPAPath3Src 0 "No comment" 1 "Learn Path" 2 "Share Path" 3 "Reserved"  ;
VAL_ 941 ADC_HPALearningPathType4 0 "Invalid" 1 "Parking in type" 2 "Trace tracking type" 3 "Parking out type"  ;
VAL_ 941 ADC_HPALearningLotType4 0 "Invalid" 1 "Fixed parking lot" 2 "Random parking lot" 3 "Reserved"  ;
VAL_ 941 ADC_HPAPathSt4 0 "No comment" 1 "Valid Path" 2 "Learning Inprocess Path" 3 "backstage Learning Inprocess Path"  ;
VAL_ 941 ADC_HPAPath4Src 0 "No comment" 1 "Learn Path" 2 "Share Path" 3 "Reserved"  ;
VAL_ 941 ADC_HPAPath3MatGpsSucces 0 "No request" 1 "Request"  ;
VAL_ 941 ADC_HPAPath4MatGpsSucces 0 "No request" 1 "Request"  ;
VAL_ 941 ADC_HPALearningPathType5 0 "Invalid" 1 "Parking in type" 2 "Trace tracking type" 3 "Parking out type"  ;
VAL_ 941 ADC_HPALearningLotType5 0 "Invalid" 1 "Fixed parking lot" 2 "Random parking lot" 3 "Reserved"  ;
VAL_ 941 ADC_HPAPathSt5 0 "No comment" 1 "Valid Path" 2 "Learning Inprocess Path" 3 "backstage Learning Inprocess Path"  ;
VAL_ 941 ADC_HPAPath5Src 0 "No comment" 1 "Learn Path" 2 "Share Path" 3 "Reserved"  ;
VAL_ 941 ADC_HPALearningPathType6 0 "Invalid" 1 "Parking in type" 2 "Trace tracking type" 3 "Parking out type"  ;
VAL_ 941 ADC_HPALearningLotType6 0 "Invalid" 1 "Fixed parking lot" 2 "Random parking lot" 3 "Reserved"  ;
VAL_ 941 ADC_HPAPathSt6 0 "No comment" 1 "Valid Path" 2 "Learning Inprocess Path" 3 "backstage Learning Inprocess Path"  ;
VAL_ 941 ADC_HPAPath6Src 0 "No comment" 1 "Learn Path" 2 "Share Path" 3 "Reserved"  ;
VAL_ 941 ADC_HPAPath5MatGpsSucces 0 "No request" 1 "Request"  ;
VAL_ 941 ADC_HPAPath6MatGpsSucces 0 "No request" 1 "Request"  ;
VAL_ 941 ADC_HPALearningPathType7 0 "Invalid" 1 "Parking in type" 2 "Trace tracking type" 3 "Parking out type"  ;
VAL_ 941 ADC_HPALearningLotType7 0 "Invalid" 1 "Fixed parking lot" 2 "Random parking lot" 3 "Reserved"  ;
VAL_ 941 ADC_HPAPathSt7 0 "No comment" 1 "Valid Path" 2 "Learning Inprocess Path" 3 "backstage Learning Inprocess Path"  ;
VAL_ 941 ADC_HPAPath7Src 0 "No comment" 1 "Learn Path" 2 "Share Path" 3 "Reserved"  ;
VAL_ 941 ADC_HPALearningPathType8 0 "Invalid" 1 "Parking in type" 2 "Trace tracking type" 3 "Parking out type"  ;
VAL_ 941 ADC_HPALearningLotType8 0 "Invalid" 1 "Fixed parking lot" 2 "Random parking lot" 3 "Reserved"  ;
VAL_ 941 ADC_HPAPPathSt8 0 "No comment" 1 "Valid Path" 2 "Learning Inprocess Path" 3 "backstage Learning Inprocess Path"  ;
VAL_ 941 ADC_HPAPath8Src 0 "No comment" 1 "Learn Path" 2 "Share Path" 3 "Reserved"  ;
VAL_ 941 ADC_HPAPath7MatGpsSucces 0 "No request" 1 "Request"  ;
VAL_ 941 ADC_HPAPath8MatGpsSucces 0 "No request" 1 "Request"  ;
VAL_ 941 ADC_HPALearningPathType9 0 "Invalid" 1 "Parking in type" 2 "Trace tracking type" 3 "Parking out type"  ;
VAL_ 941 ADC_HPALearningLotType9 0 "Invalid" 1 "Fixed parking lot" 2 "Random parking lot" 3 "Reserved"  ;
VAL_ 941 ADC_HPAPathSt9 0 "No comment" 1 "Valid Path" 2 "Learning Inprocess Path" 3 "backstage Learning Inprocess Path"  ;
VAL_ 941 ADC_HPAPath9Src 0 "No comment" 1 "Learn Path" 2 "Share Path" 3 "Reserved"  ;
VAL_ 941 ADC_HPALearningPathType10 0 "Invalid" 1 "Parking in type" 2 "Trace tracking type" 3 "Parking out type"  ;
VAL_ 941 ADC_HPALearningLotType10 0 "Invalid" 1 "Fixed parking lot" 2 "Random parking lot" 3 "Reserved"  ;
VAL_ 941 ADC_HPAPathSt10 0 "No comment" 1 "Valid Path" 2 "Learning Inprocess Path" 3 "backstage Learning Inprocess Path"  ;
VAL_ 941 ADC_HPAPath10Src 0 "No comment" 1 "Learn Path" 2 "Share Path" 3 "Reserved"  ;
VAL_ 941 ADC_HPAPath9MatGpsSucces 0 "No request" 1 "Request"  ;
VAL_ 941 ADC_HPAPath10MatGpsSucces 0 "No request" 1 "Request"  ;
VAL_ 941 ADC_LowPowerfeedback 0 "No Responce" 1 "Modechanging" 2 "Nomal Mode" 3 "LowPower Mode" 4 "Not Satisfy"  ;
VAL_ 941 ADC_APAParkingSpdSt 0 "Not active;" 1 "Slow" 2 "Middle" 3 "High"  ;
VAL_ 941 ADC_HPAParkingSpdSt 0 "Not active;" 1 "Slow" 2 "Middle" 3 "High"  ;
VAL_ 835 PAS_SystemType 0 "RPA(Reverse Parking Assistant)" 1 "APA(Automatic Parking Assistant)" 2 "Not used" 3 "Not used"  ;
VAL_ 835 PAS_WarnTone 0 "Not active" 1 "Continuous tone" 2 "Fast intermittent tone" 3 "Medium-speed intermittent tone" 4 "Slow intermittent tone" 5 "Mute" 6 "Not used" 7 "Not used" 8 "Not used" 9 "Not used" 10 "Not used" 11 "Not used" 12 "Not used" 13 "Not used" 14 "Not used" 15 "Not used"  ;
VAL_ 835 PAS_ButtonPress 0 "Not press" 1 "Press"  ;
VAL_ 835 PAS_SideZoneStatusF 0 "None" 1 "Left and right" 2 "Not used" 3 "Not used"  ;
VAL_ 835 PAS_SideZoneStatusR 0 "None" 1 "Left and right" 2 "Not used" 3 "Not used"  ;
VAL_ 835 PAS_RRMidDistance 255 "No Obstacle Detected"  ;
VAL_ 835 PAS_RLMidDistance 255 "No Obstacle Detected"  ;
VAL_ 835 PAS_RRDistance 255 "No Obstacle Detected"  ;
VAL_ 835 PAS_RLDistance 255 "No Obstacle Detected"  ;
VAL_ 835 PAS_RSLSideDistance 255 "No Obstacle Detected"  ;
VAL_ 835 PAS_RSRSideDistance 255 "No Obstacle Detected"  ;
VAL_ 835 PAS_FRDistance 255 "No Obstacle Detected"  ;
VAL_ 835 PAS_FLDistance 255 "No Obstacle Detected"  ;
VAL_ 835 PAS_FRMidDistance 255 "No Obstacle Detected"  ;
VAL_ 835 PAS_FLMidDistance 255 "No Obstacle Detected"  ;
VAL_ 835 PAS_FSRSideDistance 255 "No Obstacle Detected"  ;
VAL_ 835 PAS_FSLSideDistance 255 "No Obstacle Detected"  ;
VAL_ 835 PAS_Mode 0 "Off" 1 "Standby" 2 "StandbyAndFrontFailure(Reserved)" 3 "StandbyAndRearFailure(Reserved)" 4 "FrontActive" 5 "FrontActiveAndRearFailure" 6 "RearActive(Reserved)" 7 "RearActiveAndFrontFailure" 8 "FrontRearActive" 9 "SystemFailure" 10 "Front failure and Rear inactive" 11 "Rear failure and Front inactive(Reserved)" 12 "System Inhibited" 13 "Reserved" 14 "Reserved" 15 "Reserved"  ;
VAL_ 835 PAS_RRMidSnsErrFlag 0 "Not fault" 1 "Fault"  ;
VAL_ 835 PAS_RLMidSnsErrFlag 0 "Not fault" 1 "Fault"  ;
VAL_ 835 PAS_RRSnsErrFlag 0 "Not fault" 1 "Fault"  ;
VAL_ 835 PAS_RLSnsErrFlag 0 "Not fault" 1 "Fault"  ;
VAL_ 835 PAS_RSLSnsErrFlag 0 "Not fault" 1 "Fault"  ;
VAL_ 835 PAS_RSRSnsErrFlag 0 "Not fault" 1 "Fault"  ;
VAL_ 835 PAS_FRSnsErrFlag 0 "Not fault" 1 "Fault"  ;
VAL_ 835 PAS_FLSnsErrFlag 0 "Not fault" 1 "Fault"  ;
VAL_ 835 PAS_FRMidSnsErrFlag 0 "Not fault" 1 "Fault"  ;
VAL_ 835 PAS_FLMidSnsErrFlag 0 "Not fault" 1 "Fault"  ;
VAL_ 835 PAS_FSLSnsErrFlag 0 "Not fault" 1 "Fault"  ;
VAL_ 835 PAS_FSRSnsErrFlag 0 "Not fault" 1 "Fault"  ;
VAL_ 835 PAS_RRMidDislv 0 "No warnning" 1 "Warning level1" 2 "Warning level2" 3 "Warning level3"  ;
VAL_ 835 PAS_RLMidDislv 0 "No warnning" 1 "Warning level1" 2 "Warning level2" 3 "Warning level3"  ;
VAL_ 835 PAS_RRDislv 0 "No warnning" 1 "Warning level1" 2 "Warning level2" 3 "Warning level3"  ;
VAL_ 835 PAS_RLDislv 0 "No warnning" 1 "Warning level1" 2 "Warning level2" 3 "Warning level3"  ;
VAL_ 835 PAS_RSLSideDislv 0 "No warnning" 1 "Warning level1" 2 "Warning level2" 3 "Warning level3"  ;
VAL_ 835 PAS_RSRSideDislv 0 "No warnning" 1 "Warning level1" 2 "Warning level2" 3 "Warning level3"  ;
VAL_ 835 PAS_FRDislv 0 "No warnning" 1 "Warning level1" 2 "Warning level2" 3 "Warning level3"  ;
VAL_ 835 PAS_FLDislv 0 "No warnning" 1 "Warning level1" 2 "Warning level2" 3 "Warning level3"  ;
VAL_ 835 PAS_FRMidDislv 0 "No warnning" 1 "Warning level1" 2 "Warning level2" 3 "Warning level3"  ;
VAL_ 835 PAS_FLMidDislv 0 "No warnning" 1 "Warning level1" 2 "Warning level2" 3 "Warning level3"  ;
VAL_ 835 PAS_FSRSideDislv 0 "No warnning" 1 "Warning level1" 2 "Warning level2" 3 "Warning level3"  ;
VAL_ 835 PAS_FSLSideDislv 0 "No warnning" 1 "Warning level1" 2 "Warning level2" 3 "Warning level3"  ;
VAL_ 835 PAS_CtrlModulerrFlag 0 "Not fault" 1 "Fault"  ;
VAL_ 835 PAS_BattVoltErrFlag 0 "Not fault" 1 "Fault"  ;
VAL_ 835 ADC_IDC_DisplayReq 0 "No function-无功能" 1 "Front view of 2D mode---2D模式" 2 "Rear view of 2D mode---2D模式" 3 "Left view of 2D mode---2D模式" 4 "Right view of 2D mode---2D模式" 5 "Front view of 3D mode---3D模式" 6 "Rear view of 3D mode---3D模式" 7 "Left front view of 3D mode---3D模式" 8 "Right front view of 3D mode---3D模式" 9 "Left rear view of 3D mode---3D模式" 10 "Right rear view of 3D mode---3D模式" 11 "Front wide angle view---广角模式_前广角" 12 "Rear wide angle view---广角模式_后广角" 13 "Front wheel view---广角模式_前车轮" 14 "Rear wheel view---广角模式_后车轮" 15 "Four-wheel splicing view---广角模式" 16 "Surround view-鸟瞰图" 17 "Surround view and left view-鸟瞰图+左视图" 18 "Surround view and right view-鸟瞰图+右视图" 19 "Left blind spot view of right card---右卡片左视图" 20 "Right blind spot view of right card---右卡片右视图" 21 "Quick start view---快启模式" 22 "Left and right view of 2D mode--2D模式" 23 "Narrow road view --窄道视图" 24 "Side left_rear view--侧左后视图" 25 "Side righ_reat view  --侧右后视图"  ;
VAL_ 835 ADC_PAAShortPresSuppSt 0 "Not support" 1 "Support"  ;
VAL_ 835 ADC_PAACtrlSigSrc 0 "No comment" 1 "IHU control" 2 "APP control" 3 "IHU? and APP control mod"  ;
VAL_ 835 ADC_UsageModeRequstResult 0 "No Indication" 1 "Success" 2 "Fail for other reason" 3 "Fail for EPB state" 4 "Fail for gear level" 5 "Fail for door state" 6 "Fail for  charge plug state" 7 "Fail for Vehicl Speed"  ;
VAL_ 835 ADC_ACU_DisplayReq 0 "Not request" 1 "Request"  ;
VAL_ 835 ADC_DPMessagePushSt 0 "No Request" 1 "ReqDP1" 2 "ReqDP2" 3 "Reserve"  ;
VAL_ 835 PCS_SystemSt 0 "System OK" 1 "System not OK"  ;
VAL_ 835 PCS_FrontLeftCameraFail 0 "Not fail" 1 "Fail"  ;
VAL_ 835 PCS_FrontRightCameraFail 0 "Not fail" 1 "Fail"  ;
VAL_ 835 PCS_EventRecordSt 0 "Off" 1 "On"  ;
VAL_ 835 PCS_HMIIndex 0 "No function" 1 "Surround view and Front view(SVM)" 2 "Enlarge front view(SVM)" 3 "Surround view and Rear view(SVM)" 4 "Enlarge rear view(SVM)" 5 "Left blind spot view (SVM)" 6 "Right blind spot view(SVM)" 7 "Parking guidance view(SVM)" 8 "Parallel parking view(SVM)" 9 "Vertical parking view(SVM)" 10 "Surround view" 11 "Surround view and 2D Module" 12 "Surround view and 3D Module" 13 "Surround view and Wide Angle Module" 14 "Reserved" 15 "Request to cancel"  ;
VAL_ 835 PCS_SingleViewInd 0 "No function" 1 "Front view" 2 "Rear view" 3 "Front of left view" 4 "Front of right view" 5 "Rear of left view" 6 "Rear of right view" 7 "Left view" 8 "Right view                                                                                                        9" 10 "Front wide angle view                                                                  11" 12 "Front wheel view" 13 "Rear wheel view" 14 "Not used" 15 "Not used"  ;
VAL_ 835 PCS_VoiceReq 0 "No voice request" 1 "Voice request NO.1(SVM)" 2 "Voice request NO.2(SVM)" 3 "Voice request NO.3(SVM)" 4 "Voice request NO.4(SVM)" 5 "Voice request NO.5(SVM)" 6 "Voice request NO.6(SVM)" 7 "Voice request NO.7(SVM)" 8 "Voice request NO.8(SVM)" 9 "Voice request NO.9(SVM)" 10 "Voice request NO.10(SVM)" 11 "Voice request NO.11（ RVM||SVM）" 12 "Voice request NO.12(RVM)" 13 "Voice request NO.13(RVM)" 14 "Voice request NO.14(RVM)" 15 "Voice request NO.15(RVM)"  ;
VAL_ 835 PCS_LeftBlindSpotViewSt 0 "Off" 1 "On"  ;
VAL_ 835 PCS_RightBlindSpotViewSt 0 "Off" 1 "On"  ;
VAL_ 835 PCS_ReturnSt 0 "Off" 1 "On"  ;
VAL_ 835 PCS_HelpMenuSt 0 "Off" 1 "On"  ;
VAL_ 835 PCS_SoundReminderSt 0 "Off" 1 "On"  ;
VAL_ 835 PCS_ER_EnterConfirm 0 "Not active" 1 "Active"  ;
VAL_ 835 PCS_MirrorPageDownButton 0 "Not Pressed" 1 "Pressed"  ;
VAL_ 835 PCS_ER_QuitReq 0 "Not active" 1 "Active"  ;
VAL_ 835 PCS_PASButtonPress 0 "Not press" 1 "Press"  ;
VAL_ 835 PCS_VRSwitchFailSt 0 "No Fail" 1 "Fail"  ;
VAL_ 835 PCS_FrontCameraFail 0 "Not fail" 1 "Fail"  ;
VAL_ 835 PCS_LeftCameraFail 0 "Not fail" 1 "Fail"  ;
VAL_ 835 PCS_RightCameraFail 0 "Not fail" 1 "Fail"  ;
VAL_ 835 PCS_RearCameraFail 0 "Not fail" 1 "Fail"  ;
VAL_ 835 PCS_ACU_DisplayReq 0 "Not request" 1 "Request"  ;
VAL_ 835 PCS_CalibrateSt 0 "Not calibrate" 1 "Claibrating" 2 "Claibrate success" 3 "Calibrate failure" 4 "Partially calibrated (FAPA)" 5 "Not used" 6 "Not used" 7 "Not used"  ;
VAL_ 835 PCS_MODEnalbe 0 "Disable" 1 "Enalbe"  ;
VAL_ 835 PCS_3DEnalbe 0 "Disable" 1 "Enalbe"  ;
VAL_ 835 PCS_SystemType 0 "Unknown" 1 "RVM(Rear View Module)" 2 "SVM(Surround View Module)" 3 "Not used"  ;
VAL_ 835 PCS_OperationSt 0 "Sleep" 1 "Standby" 2 "Normal" 3 "Not used"  ;
VAL_ 835 DMS_FaceID_ADC 0 "Default" 1 "Face_ID_1" 2 "Face_ID_2" 3 "Face_ID_3" 4 "Face_ID_4" 5 "Face_ID_5" 6 "Face_ID_6" 7 "Face_ID_7" 8 "Face_ID_8" 9 "Other" 10 "Other" 11 "Other" 12 "Other" 13 "Other" 14 "Other" 15 "Other"  ;
VAL_ 835 DMS_SysErrSt_ADC 0 "Unavailable--default value" 1 "DMC blocked by steeringwheel" 2 "DMC blocked" 3 "DMS system error" 4 "FF lose templates" 5 "IR-proof sunglass detected"  ;
VAL_ 835 OMS_SysErrSt_ADC 0 "Unavailable_Default value" 1 "OMS blocked" 2 "FF lose templates" 3 "IR-proof sunglass detected" 4 "OMS system error" 5 "OMS_Camera_error"  ;
