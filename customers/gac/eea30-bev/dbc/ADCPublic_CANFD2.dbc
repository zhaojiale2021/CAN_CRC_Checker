VERSION "Version"

NS_ :

BS_:

BU_: CCU IBCS IXCU RBM EPS ADC IBCS_IXCU IDU Tester CCURT2 RT2_C3 OTAWL ZCUF ZCUL ZCUR ZCUT IPS DCU NIDU RLBMS CBM WACUFL IDC IID VIU CCURT1 RT1_C0 RT1_C1 AVAS FLLCM FRLCM RLLCMA RRLCMA RLLCMB RRLCMB LBMS LBMSAD MFS FCP ITS BCB DCDC PCU EOP DCU2 BMS TMC SRS ECS CD AMP WHUD IMR FIMR FAPA FLR FRR RLR RRR IFC PAS INU SBM WCM ETC TBOX TBOX2 DSM FLPDM FRPDM RLPDM RRPDM HVSMR SCMRL SCMRR EBU EPB PCS V2XOBU EVCC VDC ADM PLGM FBLCM RLISD RRISD RCP RFR WCMFR SCMR TFOAR TROAR HVSPRL HVSPRR

BO_ 616 CCU_1: 64 CCU
 SG_ CCU_1_CRC : 7|16@0+ (1,0) [0|65535] ""  CCURT2,RT2_C3,OTAWL,ZCUF,ZCUL,ZCUR,ZCUT,IPS,DCU,NIDU,RBM,IBCS,RLBMS,CBM,IXCU,WACUFL,IDC,IID,ADC,VIU
 SG_ CCU_1_Counter : 23|8@0+ (1,0) [0|255] ""  CCURT2,RT2_C3,OTAWL,ZCUF,ZCUL,ZCUR,ZCUT,IPS,DCU,NIDU,RBM,IBCS,RLBMS,CBM,IXCU,WACUFL,IDC,IID,ADC,VIU
 SG_ UMM_UsageModeSt : 26|3@0+ (1,0) [0|7] ""  CCURT1,CCURT2,RT1_C0,RT1_C1,RT2_C3,OTAWL,ZCUF,ZCUL,ZCUR,ZCUT,AVAS,FLLCM,FRLCM,RLLCMA,RRLCMA,RLLCMB,RRLCMB,LBMS,LBMSAD,MFS,FCP,IDU,ITS,BCB,IPS,DCDC,PCU,EOP,DCU,DCU2,NIDU,BMS,TMC,SRS,EPS,RBM,IBCS,ECS,RLBMS,CBM,IXCU,WACUFL,IDC,IID,CD,AMP,WHUD,IMR,FIMR,ADC,FAPA,FLR,FRR,RLR,RRR,VIU,IFC,PAS,INU,SBM,WCM,ETC,TBOX,TBOX2,DSM,FLPDM,FRPDM,RLPDM,RRPDM
 SG_ OTA_FuncReq_ADCWakeup : 45|3@0+ (1,0) [0|7] ""  ADC,FAPA
 SG_ UMM_DriverSeatSt : 59|2@0+ (1,0) [0|3] ""  CCURT2,RT2_C3,ZCUR,SRS,IBCS,IDC,ADC,FAPA,FLR,FRR,RLR,RRR,VIU,IFC
 SG_ UMM_FrontPassengerSeatSt : 57|2@0+ (1,0) [0|3] ""  CCURT2,RT2_C3,OTAWL,SRS,IDC,ADC,FAPA,FLR,FRR,RLR,RRR,VIU
 SG_ VMM_VehModeSt : 159|4@0+ (1,0) [0|15] ""  CCURT1,CCURT2,RT1_C0,RT1_C1,RT2_C3,OTAWL,ZCUF,ZCUL,ZCUR,ZCUT,AVAS,FLLCM,FRLCM,RLLCMA,RRLCMA,RLLCMB,RRLCMB,LBMS,LBMSAD,MFS,FCP,IDU,ITS,BCB,IPS,DCDC,PCU,EOP,DCU,DCU2,NIDU,BMS,SRS,EPS,RBM,IBCS,ECS,RLBMS,IXCU,WACUFL,IDC,AMP,WHUD,IMR,FIMR,ADC,FAPA,FLR,FRR,RLR,RRR,VIU,IFC,SBM,WCM,ETC,TBOX,TBOX2,DSM,FLPDM,FRPDM,RLPDM,RRPDM,HVSMR,SCMRL,SCMRR
 SG_ VMM_LastVehModeSt : 155|4@0+ (1,0) [0|15] ""  CCURT1,RT1_C1,ZCUF,ZCUL,ZCUR,ZCUT,AVAS,FLLCM,FRLCM,RLLCMA,RRLCMA,RLLCMB,RRLCMB,MFS,FCP,ITS,IPS,DCDC,PCU,EOP,DCU,NIDU,BMS,SRS,EPS,RBM,IBCS,IXCU,WACUFL,IDC,AMP,WHUD,ADC,FAPA,VIU,IFC,SBM,WCM,ETC,TBOX,DSM,FLPDM,FRPDM,RLPDM,RRPDM,HVSMR,SCMRL,SCMRR
 SG_ VMM_OTAModeSt : 167|2@0+ (1,0) [0|3] ""  CCURT1,CCURT2,RT1_C0,RT1_C1,RT2_C3,OTAWL,ZCUF,ZCUL,ZCUR,ZCUT,AVAS,FLLCM,FRLCM,RLLCMA,RRLCMA,RLLCMB,RRLCMB,LBMS,LBMSAD,MFS,FCP,IDU,ITS,BCB,IPS,DCDC,PCU,EOP,DCU,DCU2,NIDU,BMS,SRS,EPS,RBM,IBCS,ECS,RLBMS,IXCU,WACUFL,IDC,IID,AMP,WHUD,ADC,FAPA,FLR,FRR,RLR,RRR,VIU,IFC,SBM,WCM,ETC,TBOX,DSM,FLPDM,FRPDM,RLPDM,RRPDM,HVSMR,SCMRL,SCMRR
 SG_ CCU_DstFlag : 272|1@0+ (1,0) [0|1] ""  ZCUF,ZCUL,ZCUR,ZCUT,ADC,FAPA,VIU
 SG_ CSM_RC_PAARequest : 287|4@0+ (1,0) [0|15] ""  ADC,FAPA,FLR,FRR,RLR,RRR,VIU
 SG_ CSM_RC_AuthSt : 295|2@0+ (1,0) [0|3] ""  ADC,FAPA,VIU
 SG_ IPDS_EnablePowerSup : 327|2@0+ (1,0) [0|3] ""  ZCUF,ZCUR,ZCUT,BMS,SRS,RBM,IBCS,ECS,EBU,RLBMS,EPB,IXCU,WACUFL,IDC,IID,ADC,FAPA,VIU,TBOX
 SG_ Time_Year : 343|8@0+ (1,2000) [2000|2255] "y"  CCURT1,CCURT2,RT1_C0,RT1_C1,RT2_C3,ZCUF,ZCUL,ZCUR,ZCUT,LBMS,LBMSAD,MFS,FCP,IDU,ITS,IPS,PCU,EOP,DCU,DCU2,NIDU,BMS,TMC,SRS,EPS,RBM,IBCS,ECS,EBU,RLBMS,CBM,EPB,IXCU,WACUFL,AMP,WHUD,IMR,FIMR,ADC,FAPA,FLR,FRR,RLR,RRR,VIU,IFC,PAS,PCS,INU
 SG_ Time_Month : 351|4@0+ (1,0) [1|12] "m"  CCURT1,CCURT2,RT1_C0,RT1_C1,RT2_C3,ZCUF,ZCUL,ZCUR,ZCUT,LBMS,LBMSAD,MFS,FCP,IDU,ITS,IPS,PCU,EOP,DCU,DCU2,NIDU,BMS,TMC,SRS,EPS,RBM,IBCS,ECS,EBU,RLBMS,CBM,EPB,IXCU,WACUFL,AMP,WHUD,IMR,FIMR,ADC,FAPA,FLR,FRR,RLR,RRR,VIU,IFC,PAS,PCS,INU
 SG_ Time_Day : 347|5@0+ (1,0) [1|31] "d"  CCURT1,CCURT2,RT1_C0,RT1_C1,RT2_C3,ZCUF,ZCUL,ZCUR,ZCUT,LBMS,LBMSAD,MFS,FCP,IDU,ITS,IPS,PCU,EOP,DCU,DCU2,NIDU,BMS,TMC,SRS,EPS,RBM,IBCS,ECS,EBU,RLBMS,CBM,EPB,IXCU,WACUFL,AMP,WHUD,IMR,FIMR,ADC,FAPA,FLR,FRR,RLR,RRR,VIU,IFC,PAS,PCS,INU
 SG_ Time_Hour : 358|5@0+ (1,0) [0|23] "h"  CCURT1,CCURT2,RT1_C0,RT1_C1,RT2_C3,ZCUF,ZCUL,ZCUR,ZCUT,LBMS,LBMSAD,MFS,FCP,IDU,ITS,IPS,PCU,EOP,DCU,DCU2,NIDU,BMS,TMC,SRS,EPS,RBM,IBCS,ECS,EBU,RLBMS,CBM,EPB,IXCU,WACUFL,AMP,WHUD,IMR,FIMR,ADC,FAPA,FLR,FRR,RLR,RRR,VIU,IFC,PAS,PCS,INU
 SG_ Time_Min : 353|6@0+ (1,0) [0|59] "min"  CCURT1,CCURT2,RT1_C0,RT1_C1,RT2_C3,ZCUF,ZCUL,ZCUR,ZCUT,LBMS,LBMSAD,MFS,FCP,IDU,ITS,IPS,PCU,EOP,DCU,DCU2,NIDU,BMS,TMC,SRS,EPS,RBM,IBCS,ECS,EBU,RLBMS,CBM,EPB,IXCU,WACUFL,AMP,WHUD,IMR,FIMR,ADC,FAPA,FLR,FRR,RLR,RRR,VIU,IFC,PAS,PCS,INU
 SG_ Time_Sec : 363|6@0+ (1,0) [0|59] "s"  CCURT1,CCURT2,RT1_C0,RT1_C1,RT2_C3,ZCUF,ZCUL,ZCUR,ZCUT,LBMS,LBMSAD,MFS,FCP,IDU,ITS,IPS,PCU,EOP,DCU,DCU2,NIDU,BMS,TMC,SRS,EPS,RBM,IBCS,ECS,EBU,RLBMS,CBM,EPB,IXCU,WACUFL,AMP,WHUD,IMR,FIMR,ADC,FAPA,FLR,FRR,RLR,RRR,VIU,IFC,PAS,PCS,INU
 SG_ ASB_DriverActiveBeltFaultSt : 420|1@0+ (1,0) [0|1] ""  IDC,ADC

BO_ 909 CCU_ZCU_1: 64 CCU
 SG_ LCK_HoodAjarSt : 37|1@0+ (1,0) [0|1] ""  OTAWL,ZCUL,ZCUR,ZCUT,IDC,IID,AMP,ADC,FAPA,FLR,FRR,RLR,RRR,VIU,IFC,PCS
 SG_ LCK_FrontLeftDoorAjarSt : 36|1@0+ (1,0) [0|1] ""  OTAWL,ZCUF,ZCUR,ZCUT,RBM,IBCS,EPB,IXCU,WACUFL,IDC,IID,AMP,IMR,ADC,FAPA,FLR,FRR,RLR,RRR,VIU,IFC,TBOX,V2XOBU
 SG_ LCK_FrontRightDoorAjarSt : 35|1@0+ (1,0) [0|1] ""  ZCUF,ZCUL,ZCUT,RBM,IBCS,IXCU,WACUFL,IDC,IID,AMP,IMR,ADC,FAPA,FLR,FRR,RLR,RRR,VIU,IFC,TBOX
 SG_ LCK_RearLeftDoorAjarSt : 34|1@0+ (1,0) [0|1] ""  OTAWL,ZCUF,ZCUL,ZCUR,RBM,IBCS,IXCU,WACUFL,IDC,IID,AMP,IMR,ADC,FAPA,FLR,FRR,RLR,RRR,VIU,IFC,PCS,TBOX
 SG_ LCK_RearRightDoorAjarSt : 33|1@0+ (1,0) [0|1] ""  OTAWL,ZCUF,ZCUL,ZCUR,RBM,IBCS,IXCU,WACUFL,IDC,IID,AMP,IMR,ADC,FAPA,FLR,FRR,RLR,RRR,VIU,IFC,PCS,TBOX
 SG_ LCK_TrunkAjarSt : 32|1@0+ (1,0) [0|1] ""  OTAWL,ZCUF,ZCUL,ZCUR,IDC,IID,AMP,ADC,FAPA,FLR,FRR,RLR,RRR,VIU,IFC,PCS
 SG_ LCK_FrontLeftDoorLockSt : 47|1@0+ (1,0) [0|1] ""  OTAWL,ZCUF,ZCUR,ZCUT,CBM,IDC,ADC,FAPA,FLR,FRR,RLR,RRR,VIU,IFC
 SG_ LCK_FrontRightDoorLockSt : 46|1@0+ (1,0) [0|1] ""  OTAWL,ZCUF,ZCUL,ZCUT,CBM,IDC,ADC,FAPA,FLR,FRR,RLR,RRR,VIU,IFC
 SG_ LCK_RearLeftDoorLockSt : 45|1@0+ (1,0) [0|1] ""  OTAWL,ZCUF,ZCUL,ZCUR,CBM,IDC,ADC,FAPA,FLR,FRR,RLR,RRR,VIU,IFC
 SG_ LCK_RearRightDoorLockSt : 44|1@0+ (1,0) [0|1] ""  OTAWL,ZCUF,ZCUL,ZCUR,CBM,IDC,ADC,FAPA,FLR,FRR,RLR,RRR,VIU,IFC
 SG_ LCK_RearLeftChildSaftyLockSt : 43|1@0+ (1,0) [0|1] ""  ZCUF,ZCUL,ZCUR,CBM,IDC,ADC,FAPA,FLR,FRR,RLR,RRR,VIU,IFC
 SG_ LCK_RearRightChildSaftyLockSt : 42|1@0+ (1,0) [0|1] ""  ZCUF,ZCUL,ZCUR,CBM,IDC,ADC,FAPA,FLR,FRR,RLR,RRR,VIU,IFC
 SG_ LCK_FrontLeftDoorHandlePosition : 135|8@0+ (1,0) [0|255] ""  IDC,ADC,FAPA,IFC
 SG_ LCK_FrontRightDoorHandlePosition : 143|8@0+ (1,0) [0|255] ""  IDC,ADC,FAPA,IFC
 SG_ LCK_RearLeftDoorHandlePosition : 151|8@0+ (1,0) [0|255] ""  IDC,ADC,FAPA,IFC
 SG_ LCK_RearRightDoorHandlePosition : 159|8@0+ (1,0) [0|255] ""  IDC,ADC,FAPA,IFC
 SG_ LCK_FillerCapASt : 239|1@0+ (1,0) [0|1] ""  ADC,FAPA,IFC
 SG_ LCK_FillerCapBSt : 238|1@0+ (1,0) [0|1] ""  ADC,FAPA,IFC
 SG_ MR_LeftMirrorFoldUnfoldSt : 233|2@0+ (1,0) [0|3] ""  IDC,ADC,FAPA,FLR,FRR,RLR,RRR,VIU,PCS
 SG_ SBM_SwapHvBattModeSt : 247|4@0+ (1,0) [0|15] ""  ADC,FAPA,VIU
 SG_ SBM_SwapStaDiagCode : 243|4@0+ (1,0) [0|15] ""  ADC,FAPA,VIU
 SG_ SBM_SwapVehDiagCode : 255|4@0+ (1,0) [0|15] ""  ADC,FAPA,VIU
 SG_ SBM_SwapHvBattModeFaultSt : 251|3@0+ (1,0) [0|7] ""  ADC,FAPA,VIU
 SG_ POD_CurDoorPosFL : 262|7@0+ (1,0) [0|100] "%"  ZCUR,IDC,ADC,FAPA,VIU,SBM
 SG_ IPDS_HDMapPowerSt : 271|1@0+ (1,0) [0|1] ""  ADC,FAPA,VIU,IFC
 SG_ IPDS_KL15L1PowerSt : 270|1@0+ (1,0) [0|1] ""  EPS,ADC,FAPA,FLR,FRR,RLR,RRR,VIU,IFC
 SG_ IPDS_SRSECUPowerSt : 269|1@0+ (1,0) [0|1] ""  ADC,FAPA,VIU,IFC
 SG_ IPDS_HODPowerSt : 268|1@0+ (1,0) [0|1] ""  ADC,FAPA,VIU,IFC
 SG_ KAE_BLEOption : 265|1@0+ (1,0) [0|1] ""  ADC,FAPA,VIU,IFC
 SG_ KAE_UWBOption : 264|1@0+ (1,0) [0|1] ""  ADC,FAPA,VIU,IFC
 SG_ WW_RWPMotorSt : 226|3@0+ (1,0) [0|7] ""  ADC,FAPA,VIU
 SG_ ACEleclocksSt : 282|3@0+ (1,0) [0|7] ""  BMS,EVCC,ADC,FAPA
 SG_ WCM_Reminder : 103|1@0+ (1,0) [0|1] ""  ADC,FAPA,IFC
 SG_ WCM_ChargingSt : 89|2@0+ (1,0) [0|3] ""  ADC,FAPA,IFC
 SG_ AVAS_ActivatedSt : 231|3@0+ (1,0) [0|7] ""  ADC,FAPA,IFC
 SG_ PWL_WinCurrentPos_FLWinPst : 470|8@0+ (0.5,0) [0|100] "%"  ADC,FAPA,IFC
 SG_ UINM_FrontLeftPowerReleaseReq : 456|1@0+ (1,0) [0|1] ""  ADC,FAPA,IFC
 SG_ UINM_FrontLeftPowerReleaseFaultSt : 457|1@0+ (1,0) [0|1] ""  ADC,FAPA,IFC
 SG_ UINM_FrontRightPowerReleaseReq : 458|1@0+ (1,0) [0|1] ""  ADC,FAPA,IFC
 SG_ UINM_FrontRightPowerReleaseFaultSt : 459|1@0+ (1,0) [0|1] ""  ADC,FAPA,IFC
 SG_ UINM_RearLeftPowerReleaseFaultSt : 460|1@0+ (1,0) [0|1] ""  ADC,FAPA,IFC
 SG_ UINM_RearLeftPowerReleaseReq : 461|1@0+ (1,0) [0|1] ""  ADC,FAPA,IFC
 SG_ UINM_RearRightPowerReleaseFaultSt : 462|1@0+ (1,0) [0|1] ""  ADC,FAPA,IFC
 SG_ UINM_RearRightPowerReleaseReq : 471|1@0+ (1,0) [0|1] ""  ADC,FAPA,IFC
 SG_ PWL_WinCurrentPos_RRWinPst : 503|8@0+ (0.5,0) [0|100] "%"  IDC,AMP,IMR,FIMR,ADC,FAPA,VIU,IFC
 SG_ PWL_WinCurrentPos_RLWinPst : 511|8@0+ (0.5,0) [0|100] "%"  IDC,AMP,IMR,FIMR,ADC,FAPA,VIU,IFC

BO_ 905 CCU_IDC_ICM_1: 64 CCU
 SG_ ICM_SetIACCSt : 27|1@0+ (1,0) [0|1] ""  ADC,FAPA,VIU
 SG_ ICM_TotalOdometer : 35|20@0+ (1,0) [0|999999] "km"  ZCUF,ZCUT,BMS,EPS,RBM,IBCS,ECS,EBU,EPB,IXCU,WACUFL,ADC,FAPA,FLR,FRR,RLR,RRR,VIU,PCS
 SG_ ICM_VehInsSpd : 103|8@0+ (1,0) [0|254] "km/h"  SRS,ADC,FAPA,VIU,IFC
 SG_ ICM_VehInsSpd_accurate : 272|11@0+ (0.1,0) [0|204.6] "km/h"  ECS,ADC,FAPA,RLR,RRR,VIU
 SG_ ICM_FuelAvaibleDriveDistance : 311|11@0+ (1,0) [0|2046] "km"  ADC
 SG_ ICM_TotalAvaibleDriveDistance : 316|11@0+ (1,0) [0|2046] "km"  ADC

BO_ 161 CCU_IDC_1: 64 CCU
 SG_ ACU_FaceID_Delete : 119|4@0+ (1,0) [0|15] ""  ADC,FAPA,IFC
 SG_ ACU_RegisterTriger : 115|4@0+ (1,0) [0|15] ""  ADC,FAPA,IFC
 SG_ ACU_VerifyTriger : 127|4@0+ (1,0) [0|15] ""  ADC,FAPA,IFC
 SG_ ACU_FaceIDQuit : 123|1@0+ (1,0) [0|1] ""  ADC,FAPA,IFC
 SG_ ACU_FaceIDSwitch : 122|2@0+ (1,0) [0|3] ""  ADC,FAPA,IFC
 SG_ ACU_AVAS_SwitchCfgReq : 273|2@0+ (1,0) [0|3] ""  ZCUF,ADC,FAPA,IFC

BO_ 615 BCS_1_C: 64 IBCS
 SG_ BCS_1_CRC : 7|16@0+ (1,0) [0|65535] ""  CCU,CCURT1,CCURT2,RT1_C1,RT2_C3,VDC,EPS,RBM,ECS,EPB,IDC,ADC,VIU
 SG_ BCS_1_Counter : 23|8@0+ (1,0) [0|255] ""  CCU,CCURT1,CCURT2,RT1_C1,RT2_C3,VDC,EPS,RBM,ECS,EPB,IDC,ADC,VIU
 SG_ BCS_FLWheelSpd : 31|13@0+ (0.05625,0) [0|240] "km/h"  CCU,CCURT1,CCURT2,RT1_C0,RT1_C1,RT2_C3,VDC,DCU,NIDU,EPS,RBM,ECS,EPB,ADC,VIU
 SG_ BCS_FLWheelSpdVD : 34|1@0+ (1,0) [0|1] ""  CCU,CCURT1,CCURT2,RT1_C0,RT1_C1,RT2_C3,VDC,EPS,RBM,ECS,EPB,ADC,VIU
 SG_ BCS_FLWheelRotatedDirection : 33|1@0+ (1,0) [0|1] ""  CCU,CCURT1,CCURT2,RT1_C0,RT1_C1,VDC,EPS,RBM,ECS,ADC,VIU
 SG_ BCS_FLWheelRotatedDirectionVD : 32|1@0+ (1,0) [0|1] ""  CCU,CCURT1,CCURT2,RT1_C1,VDC,EPS,RBM,ECS,ADC,VIU
 SG_ BCS_FRWheelSpd : 47|13@0+ (0.05625,0) [0|240] "km/h"  CCU,CCURT1,CCURT2,RT1_C0,RT1_C1,RT2_C3,VDC,DCU,NIDU,EPS,RBM,ECS,EPB,ADC,VIU
 SG_ BCS_FRWheelSpdVD : 50|1@0+ (1,0) [0|1] ""  CCU,CCURT1,CCURT2,RT1_C0,RT1_C1,RT2_C3,VDC,EPS,RBM,ECS,EPB,ADC,VIU
 SG_ BCS_FRWheelRotatedDirection : 49|1@0+ (1,0) [0|1] ""  CCU,CCURT1,CCURT2,RT1_C0,RT1_C1,VDC,EPS,RBM,ECS,ADC,VIU
 SG_ BCS_FRWheelRotatedDirectionVD : 48|1@0+ (1,0) [0|1] ""  CCU,CCURT1,CCURT2,RT1_C1,VDC,EPS,RBM,ECS,ADC,VIU
 SG_ BCS_RLWheelSpd : 63|13@0+ (0.05625,0) [0|240] "km/h"  CCU,CCURT1,CCURT2,RT1_C0,RT1_C1,RT2_C3,VDC,DCU,NIDU,EPS,RBM,ECS,EPB,ADC,VIU
 SG_ BCS_RLWheelSpdVD : 66|1@0+ (1,0) [0|1] ""  CCU,CCURT1,CCURT2,RT1_C0,RT1_C1,RT2_C3,VDC,EPS,RBM,ECS,EPB,ADC,VIU
 SG_ BCS_RLWheelRotatedDirection : 65|1@0+ (1,0) [0|1] ""  CCU,CCURT1,CCURT2,RT1_C0,RT1_C1,VDC,EPS,RBM,ECS,ADC,VIU
 SG_ BCS_RLWheelRotatedDirectionVD : 64|1@0+ (1,0) [0|1] ""  CCU,CCURT1,CCURT2,RT1_C1,VDC,EPS,RBM,ECS,ADC,VIU
 SG_ BCS_RRWheelSpd : 79|13@0+ (0.05625,0) [0|240] "km/h"  CCU,CCURT1,CCURT2,RT1_C0,RT1_C1,RT2_C3,VDC,DCU,NIDU,EPS,RBM,ECS,EPB,ADC,VIU
 SG_ BCS_RRWheelSpdVD : 82|1@0+ (1,0) [0|1] ""  CCU,CCURT1,CCURT2,RT1_C0,RT1_C1,RT2_C3,VDC,EPS,RBM,ECS,EPB,ADC,VIU
 SG_ BCS_RRWheelRotatedDirection : 81|1@0+ (1,0) [0|1] ""  CCU,CCURT1,CCURT2,RT1_C0,RT1_C1,VDC,EPS,RBM,ECS,ADC,VIU
 SG_ BCS_RRWheelRotatedDirectionVD : 80|1@0+ (1,0) [0|1] ""  CCU,CCURT1,CCURT2,RT1_C1,VDC,EPS,RBM,ECS,ADC,VIU
 SG_ BCS_HDCCtrlSt : 93|2@0+ (1,0) [0|3] ""  CCU,CCURT1,CCURT2,RT1_C1,VDC,DCU,NIDU,EPS,RBM,ECS,IDC,ADC,VIU
 SG_ BCS_HDCErrSt : 91|1@0+ (1,0) [0|1] ""  CCU,CCURT1,CCURT2,RT1_C1,VDC,EPS,RBM,ECS,IDC,ADC,VIU
 SG_ BCS_FLWheelSpdEdgesSum : 103|12@0+ (1,0) [0|4095] ""  CCU,CCURT1,CCURT2,RT1_C0,RT2_C3,EPS,RBM,ECS,EPB,ADC,VIU
 SG_ BCS_FRWheelSpdEdgesSum : 107|12@0+ (1,0) [0|4095] ""  CCU,CCURT1,CCURT2,RT1_C0,RT2_C3,EPS,RBM,ECS,EPB,ADC,VIU
 SG_ BCS_RLWheelSpdEdgesSum : 127|12@0+ (1,0) [0|4095] ""  CCU,CCURT1,CCURT2,RT1_C0,RT2_C3,EPS,RBM,ECS,EPB,ADC,VIU
 SG_ BCS_RRWheelSpdEdgesSum : 131|12@0+ (1,0) [0|4095] ""  CCU,CCURT1,CCURT2,RT1_C0,RT2_C3,EPS,RBM,ECS,EPB,ADC,VIU
 SG_ BCS_FLWheelSpdEdgesSumVD : 151|1@0+ (1,0) [0|1] ""  CCU,CCURT1,CCURT2,RT2_C3,EPS,RBM,ECS,EPB,ADC,VIU
 SG_ BCS_FRWheelSpdEdgesSumVD : 150|1@0+ (1,0) [0|1] ""  CCU,CCURT1,CCURT2,RT2_C3,EPS,RBM,ECS,EPB,ADC,VIU
 SG_ BCS_RLWheelSpdEdgesSumVD : 149|1@0+ (1,0) [0|1] ""  CCU,CCURT1,CCURT2,RT2_C3,EPS,RBM,ECS,EPB,ADC,VIU
 SG_ BCS_RRWheelSpdEdgesSumVD : 148|1@0+ (1,0) [0|1] ""  CCU,CCURT1,CCURT2,RT2_C3,EPS,RBM,ECS,EPB,ADC,VIU
 SG_ BCS_FLWheelRotatedDirectionAPA : 147|2@0+ (1,0) [0|3] ""  CCU,CCURT1,CCURT2,RT1_C1,VDC,EPS,RBM,ECS,ADC,VIU
 SG_ BCS_FRWheelRotatedDirectionAPA : 145|2@0+ (1,0) [0|3] ""  CCU,CCURT1,CCURT2,RT1_C1,VDC,EPS,RBM,ECS,ADC,VIU
 SG_ BCS_RLWheelRotatedDirectionAPA : 159|2@0+ (1,0) [0|3] ""  CCU,CCURT1,CCURT2,RT1_C1,VDC,EPS,RBM,ECS,ADC,VIU
 SG_ BCS_RRWheelRotatedDirectionAPA : 157|2@0+ (1,0) [0|3] ""  CCU,CCURT1,CCURT2,RT1_C1,VDC,EPS,RBM,ECS,ADC,VIU
 SG_ BCS_ParkingReqToEPB : 155|2@0+ (1,0) [0|3] ""  CCU,CCURT1,CCURT2,RT1_C1,VDC,EPS,RBM,ECS,EPB,ADC,VIU
 SG_ BCS_VDCOff : 153|1@0+ (1,0) [0|1] ""  CCU,CCURT1,CCURT2,RT1_C0,RT1_C1,SRS,EPS,RBM,ECS,IDC,ADC,VIU
 SG_ BCS_AVHSt : 152|1@0+ (1,0) [0|1] ""  CCU,CCURT1,CCURT2,RT1_C0,RT1_C1,VDC,EPS,RBM,ECS,EPB,IDC,ADC,VIU,SBM
 SG_ BCS_AVHStandby : 167|1@0+ (1,0) [0|1] ""  CCU,CCURT1,CCURT2,RT1_C0,RT1_C1,VDC,EPS,RBM,ECS,EPB,IDC,ADC
 SG_ BCS_AVHAvailable : 166|1@0+ (1,0) [0|1] ""  CCU,CCURT1,CCURT2,RT1_C0,RT1_C1,VDC,EPS,RBM,ECS,EPB,IDC,ADC
 SG_ BCS_TCSOff : 165|1@0+ (1,0) [0|1] ""  CCU,CCURT1,CCURT2,RT1_C0,RT1_C1,VDC,SRS,EPS,RBM,ECS,IDC,ADC,VIU
 SG_ BCS_BrkPdlPstVD : 163|1@0+ (1,0) [0|1] ""  CCU,CCURT1,CCURT2,VDC,SRS,EPS,ADC,VIU
 SG_ BCS_BrakeOverHeat : 160|1@0+ (1,0) [0|1] ""  CCU,CCURT1,CCURT2,EPS,RBM,ECS,ADC,VIU
 SG_ BCS_ABAactive : 175|1@0+ (1,0) [0|1] ""  CCU,CCURT1,CCURT2,EPS,RBM,ECS,ADC,VIU
 SG_ BCS_ABAavailable : 174|1@0+ (1,0) [0|1] ""  CCU,CCURT1,CCURT2,EPS,RBM,ECS,ADC,VIU
 SG_ BCS_ABPActive : 173|1@0+ (1,0) [0|1] ""  CCU,CCURT1,CCURT2,RT1_C1,EPS,RBM,ECS,ADC,VIU
 SG_ BCS_ABPAvailable : 172|1@0+ (1,0) [0|1] ""  CCU,CCURT1,CCURT2,RT1_C1,EPS,RBM,ECS,ADC,VIU
 SG_ BCS_AEBActive : 171|1@0+ (1,0) [0|1] ""  CCU,CCURT1,CCURT2,RT1_C1,VDC,EPS,RBM,ECS,ADC,VIU
 SG_ BCS_AEBAvailable : 170|1@0+ (1,0) [0|1] ""  CCU,CCURT1,CCURT2,RT1_C1,EPS,RBM,ECS,ADC,VIU
 SG_ BCS_AWBActive : 169|1@0+ (1,0) [0|1] ""  CCU,CCURT1,CCURT2,RT1_C1,EPS,RBM,ECS,ADC,VIU
 SG_ BCS_AWBAvailable : 168|1@0+ (1,0) [0|1] ""  CCU,CCURT1,CCURT2,RT1_C1,EPS,RBM,ECS,ADC,VIU
 SG_ BCS_BrkPdlPst : 191|8@0+ (0.392,0) [0|99.96] "%"  CCU,CCURT1,CCURT2,RT1_C0,VDC,SRS,EPS,ADC,VIU
 SG_ BCS_VehicleStandStillSt : 180|2@0+ (1,0) [0|3] ""  CCU,CCURT1,CCURT2,RT1_C1,IDU,EPS,RBM,ECS,ADC,VIU
 SG_ BCS_AEBBAActive : 178|1@0+ (1,0) [0|1] ""  CCU,CCURT1,CCURT2,EPS,RBM,ECS,ADC,VIU
 SG_ IPB_InputRodStroke : 363|10@0+ (0.05,-5) [-5|46.15] "mm"  CCU,CCURT1,CCURT2,RT1_C0,RT1_C1,VDC,DCU,NIDU,EPS,RBM,ECS,IDC,AMP,ADC,VIU
 SG_ IPB_InputRodStrokeSt : 379|1@0+ (1,0) [0|1] ""  CCU,CCURT1,CCURT2,RT1_C0,RT1_C1,VDC,EPS,RBM,ECS,IDC,AMP,ADC,VIU
 SG_ BCS_RAEBActive : 378|1@0+ (1,0) [0|1] ""  CCU,CCURT1,CCURT2,EPS,ECS,ADC,VIU
 SG_ BCS_RAEBAvailable : 377|1@0+ (1,0) [0|1] ""  CCU,CCURT1,CCURT2,EPS,ECS,ADC,VIU
 SG_ BCS_DrvModeAvailable : 380|1@0+ (1,0) [0|1] ""  CCU,CCURT1,RT1_C1,VDC,EPS,ECS,IDC,ADC
 SG_ BCS_DrvMode : 383|3@0+ (1,0) [0|7] ""  CCU,CCURT1,RT1_C0,RT1_C1,VDC,EPS,ECS,IDC,ADC
 SG_ IPB_PlungerPressure : 391|12@0+ (0.3,-5) [-5|301.9] "bar"  CCU,CCURT1,CCURT2,RT1_C0,RT1_C1,ZCUF,ZCUT,VDC,EPS,RBM,ECS,EPB,ADC,VIU,IFC
 SG_ IPB_PlungerPressureSt : 376|1@0+ (1,0) [0|1] ""  CCU,CCURT1,CCURT2,RT1_C0,RT1_C1,ZCUF,ZCUT,VDC,EPS,RBM,ECS,EPB,ADC,VIU,IFC

BO_ 352 BCS_2_C: 64 IBCS
 SG_ BCS_2_CRC : 7|16@0+ (1,0) [0|65535] ""  CCU,CCURT1,CCURT2,RT1_C1,RT2_C3,VDC,EPS,RBM,EPB,IDC,ADC,VIU
 SG_ BCS_2_Counter : 23|8@0+ (1,0) [0|255] ""  CCU,CCURT1,CCURT2,RT1_C1,RT2_C3,VDC,EPS,RBM,EPB,IDC,ADC,VIU
 SG_ BCS_VehSpd : 31|13@0+ (0.05625,0) [0|240] "km/h"  CCU,CCURT1,CCURT2,RT1_C0,RT1_C1,RT2_C3,ZCUR,VDC,DCU,NIDU,SRS,EPS,RBM,ADC,VIU
 SG_ BCS_VehSpdVD : 34|1@0+ (1,0) [0|1] ""  CCU,CCURT1,CCURT2,RT1_C0,RT1_C1,RT2_C3,ZCUR,VDC,SRS,EPS,RBM,ADC,VIU
 SG_ BCS_EBDActiveSt : 32|1@0+ (1,0) [0|1] ""  CCU,CCURT1,CCURT2,RT1_C0,RT1_C1,ZCUF,ZCUT,VDC,RBM,ADC,VIU
 SG_ BCS_EBDFaultSt : 47|1@0+ (1,0) [0|1] ""  CCU,CCURT1,CCURT2,RT1_C0,RT1_C1,ZCUF,ZCUT,VDC,SRS,RBM,ADC,VIU
 SG_ BCS_ABSActiveSt : 46|1@0+ (1,0) [0|1] ""  CCU,CCURT1,CCURT2,RT1_C0,RT1_C1,ZCUF,ZCUT,VDC,DCU,NIDU,SRS,RBM,ADC,VIU
 SG_ BCS_ABSFaultSt : 45|1@0+ (1,0) [0|1] ""  CCU,CCURT1,CCURT2,RT1_C0,RT1_C1,ZCUF,ZCUT,VDC,SRS,RBM,ADC,VIU
 SG_ BCS_TCSActiveSt : 44|1@0+ (1,0) [0|1] ""  CCU,CCURT1,CCURT2,RT1_C0,RT1_C1,ZCUF,ZCUT,VDC,DCU,NIDU,SRS,RBM,ADC,VIU
 SG_ BCS_TCSFaultSt : 43|1@0+ (1,0) [0|1] ""  CCU,CCURT1,CCURT2,RT1_C0,RT1_C1,ZCUF,ZCUT,VDC,SRS,RBM,ADC,VIU
 SG_ BCS_VDCActiveSt : 42|1@0+ (1,0) [0|1] ""  CCU,CCURT1,CCURT2,RT1_C0,RT1_C1,ZCUF,ZCUT,VDC,SRS,RBM,ADC,VIU
 SG_ BCS_VDCFaultSt : 41|1@0+ (1,0) [0|1] ""  CCU,CCURT1,CCURT2,RT1_C0,RT1_C1,ZCUF,ZCUT,VDC,SRS,RBM,ADC,VIU
 SG_ BCS_EngTorqDecActiveSt : 71|1@0+ (1,0) [0|1] ""  CCU,CCURT1,CCURT2,RT1_C1,ZCUF,ZCUT,VDC,RBM,ADC,VIU
 SG_ BCS_EngTorqIncActiveSt : 69|1@0+ (1,0) [0|1] ""  CCU,CCURT1,CCURT2,RT1_C1,VDC,RBM,ADC,VIU
 SG_ BCS_RegenModulationAvailable : 64|1@0+ (1,0) [0|1] ""  CCU,CCURT1,CCURT2,RT1_C1,VDC,RBM,ADC
 SG_ BCS_RegenModuleActive : 79|1@0+ (1,0) [0|1] ""  CCU,CCURT1,CCURT2,RT1_C1,VDC,RBM,ADC,VIU
 SG_ BCS_EngTorqDecFastRANm : 55|16@0+ (1,-30000) [-30000|30000] "Nm"  ADC
 SG_ BCS_EngTorqIncRANm : 77|14@0+ (1,-6000) [-6000|10380] "Nm"  ADC
 SG_ BCS_RealTCSActiveSt : 95|1@0+ (1,0) [0|1] ""  CCU,CCURT1,CCURT2,RT1_C1,VDC,ADC,VIU
 SG_ BCS_TargetRecpTorqRq : 93|14@0+ (1,-6000) [-6000|6000] "Nm"  CCU,CCURT1,CCURT2,RT1_C1,RT2_C3,VDC,RBM,ADC,VIU
 SG_ BCS_TargetRecpTorqRqSt : 111|2@0+ (1,0) [0|3] ""  CCU,CCURT1,CCURT2,RT1_C1,RT2_C3,VDC,RBM,ADC,VIU
 SG_ BCS_CrbsActive : 105|1@0+ (1,0) [0|1] ""  CCU,CCURT1,CCURT2,RT1_C1,RT2_C3,VDC,RBM,ADC
 SG_ BCS_EngTorqDecFastFA : 189|8@0+ (0.392,0) [0|99.96] "%"  ADC
 SG_ BCS_TargetRecpTorqRqFA : 197|14@0+ (1,-6000) [-6000|6000] "Nm"  ADC
 SG_ BCS_TargetRecpTorqRqFASt : 215|2@0+ (1,0) [0|3] ""  ADC
 SG_ BCS_TargetRecpTorqRqRA : 213|14@0+ (1,-6000) [-6000|6000] "Nm"  ADC
 SG_ BCS_TargetRecpTorqRqRASt : 231|2@0+ (1,0) [0|3] ""  ADC
 SG_ IPB_BrakePedalSt : 227|2@0+ (1,0) [0|3] ""  CCU,CCURT1,CCURT2,RT1_C0,RT1_C1,ZCUF,ZCUT,RBM,EPB,ADC,VIU
 SG_ IPB_BrakePedalStsVld : 224|1@0+ (1,0) [0|1] ""  ADC
 SG_ BCS_ESP2Park_DrvBrkOverrideFlg : 234|1@0+ (1,0) [0|1] ""  CCU,CCURT1,CCURT2,RT1_C1,ZCUF,ZCUT,VDC,ADC,VIU,IFC
 SG_ BCS_EngTorqDecActiveStRA : 233|1@0+ (1,0) [0|1] ""  CCU,CCURT1,CCURT2,RT1_C1,VDC,ADC,VIU,IFC
 SG_ BCS_EngTorqIncActiveStRA : 232|1@0+ (1,0) [0|1] ""  CCU,CCURT1,CCURT2,RT1_C1,VDC,ADC,VIU,IFC
 SG_ BCS_EngTorqIncActiveStFA : 239|1@0+ (1,0) [0|1] ""  ADC
 SG_ BCS_EngTorqDecFastRA : 247|8@0+ (0.392,0) [0|99.96] "%"  CCU,CCURT1,CCURT2,RT1_C1,VDC,ADC,VIU,IFC
 SG_ BCS_EngTorqIncRA : 255|8@0+ (0.392,0) [0|99.96] "%"  CCU,CCURT1,CCURT2,RT1_C1,VDC,ADC,VIU,IFC
 SG_ BCS_EngTorqDecActiveStFA : 275|1@0+ (1,0) [0|1] ""  CCU,CCURT1,CCURT2,RT1_C1,ADC
 SG_ BCS_PrimBrkCDAAvailableSt : 274|3@0+ (1,0) [0|7] ""  CCU,CCURT1,CCURT2,RBM,ADC,IFC
 SG_ BCS_PrimBrkCommuniSt : 287|1@0+ (1,0) [0|1] ""  CCU,CCURT1,CCURT2,RBM,ADC,VIU,IFC
 SG_ BCS_PrimBrkActiveSt : 286|2@0+ (1,0) [0|3] ""  CCU,CCURT1,CCURT2,ZCUF,ZCUT,RBM,ADC,VIU,IFC
 SG_ BCS_PrimBrkSuspendSt : 284|2@0+ (1,0) [0|3] ""  CCU,CCURT1,CCURT2,RBM,ADC,VIU,IFC
 SG_ BCS_2ParkDynamicAVPavailability : 282|2@0+ (1,0) [0|3] ""  ADC,VIU
 SG_ BCS_2ParkCddApActiveVehHld : 280|1@0+ (1,0) [0|1] ""  CCU,CCURT1,CCURT2,ADC,VIU,IFC
 SG_ BCS_2ParkAPCStatus : 311|3@0+ (1,0) [0|7] ""  CCU,CCURT1,CCURT2,ZCUF,ZCUT,ADC,VIU,IFC
 SG_ BCS_2ParkAPAavailability : 308|3@0+ (1,0) [0|7] ""  CCU,CCURT1,CCURT2,ADC,VIU,IFC
 SG_ BCS_2ParkRPAAVPavailability : 305|2@0+ (1,0) [0|3] ""  CCU,CCURT1,CCURT2,ADC,VIU,IFC
 SG_ BCS_2ParkAPCFailureSts : 319|3@0+ (1,0) [0|7] ""  CCU,CCURT1,CCURT2,ADC,VIU,IFC
 SG_ BCS_APCMain2BackupReq : 316|1@0+ (1,0) [0|1] ""  CCU,CCURT1,CCURT2,RT1_C1,ZCUF,ZCUT,VDC,RBM,ADC,VIU,IFC
 SG_ BCS_PrimBrkCtrlUsedChannel : 315|2@0+ (1,0) [0|3] ""  CCU,CCURT1,CCURT2,ADC,VIU
 SG_ BCS_PrimBrkCDAActiveSt : 313|1@0+ (1,0) [0|1] ""  ADC,VIU
 SG_ BCS_PrimBrkDecCtrlActiveSt : 312|1@0+ (1,0) [0|1] ""  ADC
 SG_ BCS_PrimBrkCDDAvailableSt : 330|2@0+ (1,0) [0|3] ""  ADC
 SG_ BCS_EngTorqIncFA : 432|8@0+ (0.392,0) [0|99.96] "%"  ADC

BO_ 611 BCS_3_C: 64 IBCS
 SG_ BCS_HydBrkActvTq_FL_1 : 103|16@0+ (1,-32768) [-32768|32767] "Nm"  CCU,CCURT1,ADC
 SG_ BCS_HydBrkActvTq_FR_1 : 119|16@0+ (1,-32768) [-32768|32767] "Nm"  CCU,CCURT1,ADC
 SG_ BCS_HydBrkActvTq_RL_1 : 135|16@0+ (1,-32768) [-32768|32767] "Nm"  CCU,CCURT1,ADC
 SG_ BCS_HydBrkActvTq_RR_1 : 151|16@0+ (1,-32768) [-32768|32767] "Nm"  CCU,CCURT1,ADC
 SG_ BCS_PrimCommPathSt : 200|1@0+ (1,0) [0|1] ""  CCU,ADC
 SG_ BCS_SeconCommPathSt : 201|1@0+ (1,0) [0|1] ""  CCU,ADC
 SG_ BCS_PressureHldSt : 202|1@0+ (1,0) [0|1] ""  CCU,ADC
 SG_ BCS_CDDFuncSt : 203|1@0+ (1,0) [0|1] ""  CCU,ADC
 SG_ IPB_SimulatorPressure : 199|12@0+ (0.3,-5) [-5|301.9] "bar"  CCU,CCURT1,RT1_C1,VDC,RBM,ECS,ADC
 SG_ IPB_SimulatorPressureSt : 223|1@0+ (1,0) [0|1] ""  CCU,CCURT1,RT1_C1,VDC,RBM,ECS,ADC
 SG_ IBCS_SystemSt : 226|3@0+ (1,0) [0|7] ""  CCU,CCURT1,CCURT2,RT1_C0,SRS,RBM,ECS,IDC,ADC,VIU,IFC
 SG_ IBCS_FWAWarning : 239|2@0+ (1,0) [0|3] ""  CCU,CCURT2,RT1_C0,RBM,IDC,ADC,VIU
 SG_ IPB_CSTSt : 233|2@0+ (1,0) [0|3] ""  CCU,CCURT1,CCURT2,RT1_C0,RBM,IDC,ADC
 SG_ BCS_AVDCActive : 240|1@0+ (1,0) [0|1] ""  CCU,ADC
 SG_ BCS_AVDCAvailable : 241|1@0+ (1,0) [0|1] ""  CCU,ADC

CM_ SG_ 616 CCU_1_CRC "E2E Profile 5 CRC";
CM_ SG_ 616 CCU_1_Counter "E2E Profile 5 Counter";
CM_ SG_ 616 UMM_UsageModeSt "Usage mode state";
CM_ SG_ 616 OTA_FuncReq_ADCWakeup "OTA Requset ADC to Wakeup";
CM_ SG_ 616 UMM_DriverSeatSt "Front Left Seat Sensor Status";
CM_ SG_ 616 UMM_FrontPassengerSeatSt "Front Right Seat Sensor Status";
CM_ SG_ 616 VMM_VehModeSt "Vehicle mode state";
CM_ SG_ 616 VMM_LastVehModeSt "Last time vehicle mode";
CM_ SG_ 616 VMM_OTAModeSt "OTA Mode state";
CM_ SG_ 616 CCU_DstFlag "Daylight Saving Time Flag";
CM_ SG_ 616 CSM_RC_PAARequest "CSM_RC_Park request";
CM_ SG_ 616 CSM_RC_AuthSt "Auth Result with SBM/TBOX/KAE";
CM_ SG_ 616 IPDS_EnablePowerSup "Enable power supply";
CM_ SG_ 616 Time_Year "Year number";
CM_ SG_ 616 Time_Month "Month number";
CM_ SG_ 616 Time_Day "Day number";
CM_ SG_ 616 Time_Hour "Hour number";
CM_ SG_ 616 Time_Min "Minute number";
CM_ SG_ 616 Time_Sec "Second number";
CM_ SG_ 616 ASB_DriverActiveBeltFaultSt "Driver Side Active Seat Belt Fault State";
CM_ SG_ 909 LCK_HoodAjarSt "HoodAjarSt";
CM_ SG_ 909 LCK_FrontLeftDoorAjarSt "FrontLeftDoorAjarSt";
CM_ SG_ 909 LCK_FrontRightDoorAjarSt "FrontRightDoorAjarSt";
CM_ SG_ 909 LCK_RearLeftDoorAjarSt "RearLeftDoorAjarSt";
CM_ SG_ 909 LCK_RearRightDoorAjarSt "RearRightDoorAjarSt";
CM_ SG_ 909 LCK_TrunkAjarSt "TrunkAjarSt";
CM_ SG_ 909 LCK_FrontLeftDoorLockSt "FrontLeftDoorLockSt";
CM_ SG_ 909 LCK_FrontRightDoorLockSt "FrontRightDoorLockSt";
CM_ SG_ 909 LCK_RearLeftDoorLockSt "RearLeftDoorLockSt";
CM_ SG_ 909 LCK_RearRightDoorLockSt "RearRightDoorLockSt";
CM_ SG_ 909 LCK_RearLeftChildSaftyLockSt "RearLeftChildSaftyLockSt";
CM_ SG_ 909 LCK_RearRightChildSaftyLockSt "RearRightChildSaftyLockSt";
CM_ SG_ 909 LCK_FrontLeftDoorHandlePosition "FrontLeftDoorHandlePosition";
CM_ SG_ 909 LCK_FrontRightDoorHandlePosition "FrontRightDoorHandlePosition";
CM_ SG_ 909 LCK_RearLeftDoorHandlePosition "RearLeftDoorHandlePosition";
CM_ SG_ 909 LCK_RearRightDoorHandlePosition "RearRightDoorHandlePosition";
CM_ SG_ 909 LCK_FillerCapASt "FillerCapASt";
CM_ SG_ 909 LCK_FillerCapBSt "FillerCapBSt";
CM_ SG_ 909 MR_LeftMirrorFoldUnfoldSt "Left Mirror Fold Unfold Status";
CM_ SG_ 909 SBM_SwapHvBattModeSt "Swap station mode statue";
CM_ SG_ 909 SBM_SwapStaDiagCode "Swap station erroe";
CM_ SG_ 909 SBM_SwapVehDiagCode "vehicl erroe in swap station";
CM_ SG_ 909 SBM_SwapHvBattModeFaultSt "Swap station mode fault statue";
CM_ SG_ 909 POD_CurDoorPosFL "The current position of power operation door";
CM_ SG_ 909 IPDS_HDMapPowerSt "HD map power state";
CM_ SG_ 909 IPDS_KL15L1PowerSt "KL15 L1 power state";
CM_ SG_ 909 IPDS_SRSECUPowerSt "SRS ECU power state";
CM_ SG_ 909 IPDS_HODPowerSt "HOD power state";
CM_ SG_ 909 KAE_BLEOption "BLEOption";
CM_ SG_ 909 KAE_UWBOption "UWB Option";
CM_ SG_ 909 WW_RWPMotorSt "RearWiper Motor status";
CM_ SG_ 909 ACEleclocksSt "AC gun electronic lock status feedback";
CM_ SG_ 909 WCM_Reminder "Reminder the Phone left";
CM_ SG_ 909 WCM_ChargingSt "Charging is ongoing or stopped";
CM_ SG_ 909 AVAS_ActivatedSt "AVAS activated status";
CM_ SG_ 909 PWL_WinCurrentPos_FLWinPst "Front Left Window Current Position";
CM_ SG_ 909 UINM_FrontLeftPowerReleaseReq "FrontLeftPowerReleaseReq";
CM_ SG_ 909 UINM_FrontLeftPowerReleaseFaultSt "Front Left Power Release Swtich fault state";
CM_ SG_ 909 UINM_FrontRightPowerReleaseReq "FrontRightPowerReleaseReq";
CM_ SG_ 909 UINM_FrontRightPowerReleaseFaultSt "Front Right Power Release Swtich fault state";
CM_ SG_ 909 UINM_RearLeftPowerReleaseFaultSt "RearLeftPowerReleaseReq";
CM_ SG_ 909 UINM_RearLeftPowerReleaseReq "RearLeftPowerReleaseReq";
CM_ SG_ 909 UINM_RearRightPowerReleaseFaultSt "RearRightPowerReleaseReq";
CM_ SG_ 909 UINM_RearRightPowerReleaseReq "RearRightPowerReleaseReq";
CM_ SG_ 909 PWL_WinCurrentPos_RRWinPst "Rear Right Window Current Position";
CM_ SG_ 909 PWL_WinCurrentPos_RLWinPst "Rear Left Window Current Position";
CM_ SG_ 905 ICM_SetIACCSt "ICM set IACC status";
CM_ SG_ 905 ICM_TotalOdometer "Total odometer";
CM_ SG_ 905 ICM_VehInsSpd "Vehicle instantaneous speed";
CM_ SG_ 905 ICM_VehInsSpd_accurate "Vehicle instantaneous speed";
CM_ SG_ 905 ICM_FuelAvaibleDriveDistance "The available driving distance according to the fuel";
CM_ SG_ 905 ICM_TotalAvaibleDriveDistance "The available driving distance according to the total";
CM_ SG_ 161 ACU_FaceID_Delete "Delete_FaceID";
CM_ SG_ 161 ACU_RegisterTriger "FaceID register triger";
CM_ SG_ 161 ACU_VerifyTriger "FaceID verify triger";
CM_ SG_ 161 ACU_FaceIDQuit "FaceID quit triger";
CM_ SG_ 161 ACU_FaceIDSwitch "FaceID switch triger";
CM_ SG_ 161 ACU_AVAS_SwitchCfgReq "AVAS switch configuration require";
CM_ SG_ 615 BCS_1_CRC "E2E Profile 5 CRC";
CM_ SG_ 615 BCS_1_Counter "E2E Profile 5 Counter";
CM_ SG_ 615 BCS_FLWheelSpd "Current wheel speed information of front left wheel";
CM_ SG_ 615 BCS_FLWheelSpdVD "Quality/fault information to current wheel speed of front left wheel";
CM_ SG_ 615 BCS_FLWheelRotatedDirection "FL wheel rotate direction";
CM_ SG_ 615 BCS_FLWheelRotatedDirectionVD "FL wheel rotate direction validity";
CM_ SG_ 615 BCS_FRWheelSpd "Current wheel speed information of FR wheel";
CM_ SG_ 615 BCS_FRWheelSpdVD "Quality/fault information to current wheel speed of FR wheel";
CM_ SG_ 615 BCS_FRWheelRotatedDirection "FR wheel rotate direction";
CM_ SG_ 615 BCS_FRWheelRotatedDirectionVD "FR wheel rotate direction validity";
CM_ SG_ 615 BCS_RLWheelSpd "Current wheel speed information of RL wheel";
CM_ SG_ 615 BCS_RLWheelSpdVD "Quality/fault information to current wheel speed of  RL wheel";
CM_ SG_ 615 BCS_RLWheelRotatedDirection "RL wheel rotate direction";
CM_ SG_ 615 BCS_RLWheelRotatedDirectionVD "RL wheel rotate direction validity";
CM_ SG_ 615 BCS_RRWheelSpd "Current wheel speed information of RR wheel";
CM_ SG_ 615 BCS_RRWheelSpdVD "Quality/fault information to current wheel speed of RR wheel";
CM_ SG_ 615 BCS_RRWheelRotatedDirection "RR wheel rotate direction";
CM_ SG_ 615 BCS_RRWheelRotatedDirectionVD "RR wheel rotate direction validity";
CM_ SG_ 615 BCS_HDCCtrlSt "HDC(Hill Descent Control) control status";
CM_ SG_ 615 BCS_HDCErrSt "HDC error status";
CM_ SG_ 615 BCS_FLWheelSpdEdgesSum "Accumulated sum of rising and falling edges of front left wheel speed sensor output·since IGN ON( the wheel plate have 48 teeth/cycle,the edge is 96)";
CM_ SG_ 615 BCS_FRWheelSpdEdgesSum "Accumulated sum of rising and falling edges of front right wheel speed sensor output·since IGN ON( the wheel plate have 48 teeth/cycle,the edge is 96)";
CM_ SG_ 615 BCS_RLWheelSpdEdgesSum "Accumulated sum of rising and falling edges of rear left wheel speed sensor output·since IGN ON( the wheel plate have 48 teeth/cycle,the edge is 96)";
CM_ SG_ 615 BCS_RRWheelSpdEdgesSum "Accumulated sum of rising and falling edges of  rear right wheel speed sensor output·since IGN ON( the wheel plate have 48 teeth/cycle,the edge is 96)";
CM_ SG_ 615 BCS_FLWheelSpdEdgesSumVD "Quality/fault information to current wheel speed edges sum of front left wheel";
CM_ SG_ 615 BCS_FRWheelSpdEdgesSumVD "Quality/fault information to current wheel speed edges sum of front right wheel";
CM_ SG_ 615 BCS_RLWheelSpdEdgesSumVD "Quality/fault information to current wheel speed edges sum of rear left wheel";
CM_ SG_ 615 BCS_RRWheelSpdEdgesSumVD "Quality/fault information to current wheel speed edges sum of rear right wheel";
CM_ SG_ 615 BCS_FLWheelRotatedDirectionAPA "FL wheel rotate direction for APA";
CM_ SG_ 615 BCS_FRWheelRotatedDirectionAPA "FR wheel rotate direction for APA";
CM_ SG_ 615 BCS_RLWheelRotatedDirectionAPA "RL wheel rotate direction for APA";
CM_ SG_ 615 BCS_RRWheelRotatedDirectionAPA "RR wheel rotate direction for APA";
CM_ SG_ 615 BCS_ParkingReqToEPB "Indicates the release/lock brake request to EPB";
CM_ SG_ 615 BCS_VDCOff "VDC is switched off ";
CM_ SG_ 615 BCS_AVHSt "Indicates AVH(Auto Vehicle Hold)in active or not ";
CM_ SG_ 615 BCS_AVHStandby "Indicates AVH(Auto Vehicle Hold)in standby mode or not ";
CM_ SG_ 615 BCS_AVHAvailable "HMI responsible, can get degrate AVH(Auto Vehicle Hold) statement from DSW and send out ";
CM_ SG_ 615 BCS_TCSOff "TCS is switched off ";
CM_ SG_ 615 BCS_BrkPdlPstVD "Current brake pedal position valid data";
CM_ SG_ 615 BCS_BrakeOverHeat "Indicating brake temperature too high or not";
CM_ SG_ 615 BCS_ABAactive "ABA(Adaptive Brake Assistance) is active";
CM_ SG_ 615 BCS_ABAavailable "The ABA(Adaptive Brake Assistance)  function is available";
CM_ SG_ 615 BCS_ABPActive "ABP(Automatic brake Pre-fill) is active";
CM_ SG_ 615 BCS_ABPAvailable "ABP(Automatic brake Pre-fill) is available";
CM_ SG_ 615 BCS_AEBActive "AEB(Automatic EmergencyBraking) is active (in deceleration)";
CM_ SG_ 615 BCS_AEBAvailable "AEB(Automatic EmergencyBraking) is available";
CM_ SG_ 615 BCS_AWBActive "AWB(Automatic Warning Brake) is active";
CM_ SG_ 615 BCS_AWBAvailable "AWB(Automatic Warning Brake) is available";
CM_ SG_ 615 BCS_BrkPdlPst "Current brake pedal position";
CM_ SG_ 615 BCS_VehicleStandStillSt "Indicating whether the vehicle is standstill or not;must not be set until standstill is surely reached.";
CM_ SG_ 615 BCS_AEBBAActive "Indicates AEBBA active or not";
CM_ SG_ 615 IPB_InputRodStroke "Indicate inputRod stroke value";
CM_ SG_ 615 IPB_InputRodStrokeSt "Indicate inputRod stroke status";
CM_ SG_ 615 BCS_RAEBActive "RAEB is active ";
CM_ SG_ 615 BCS_RAEBAvailable "RAEB is available ";
CM_ SG_ 615 BCS_DrvModeAvailable "indicater zhe ability to go into abnormal patterns for ESP";
CM_ SG_ 615 BCS_DrvMode "indicate current driving mode parameters for ESP";
CM_ SG_ 615 IPB_PlungerPressure "Indicate plunger pressure value";
CM_ SG_ 615 IPB_PlungerPressureSt "Indicate plunger pressure status";
CM_ SG_ 352 BCS_2_CRC "E2E Profile 5 CRC";
CM_ SG_ 352 BCS_2_Counter "E2E Profile 5 Counter";
CM_ SG_ 352 BCS_VehSpd "Vehicle speed";
CM_ SG_ 352 BCS_VehSpdVD "Quality/fault information to vehicle speed";
CM_ SG_ 352 BCS_EBDActiveSt "Indication that EBD system currently performs a brake/engine intervention";
CM_ SG_ 352 BCS_EBDFaultSt "ABS system has detected a heavy fault, which does not even allow a reliable electronic brake distribution and is therefore completely shut down";
CM_ SG_ 352 BCS_ABSActiveSt "Indication that ABS system currently performs a brake intervention";
CM_ SG_ 352 BCS_ABSFaultSt "ABS system has detected a failure which does no allow a reliable ABS regulation and is therefore switched off";
CM_ SG_ 352 BCS_TCSActiveSt "Indication that TCS system currently performs a brake/engine intervention";
CM_ SG_ 352 BCS_TCSFaultSt "TCS is switched off due to detected failure";
CM_ SG_ 352 BCS_VDCActiveSt "Indication that VDC system currently performs a brake/engine intervention when ESP adjust the posture of vehicle ";
CM_ SG_ 352 BCS_VDCFaultSt "VDC is switched off due to detected failure";
CM_ SG_ 352 BCS_EngTorqDecActiveSt "Decrease enginetorque  active status (fast and low)";
CM_ SG_ 352 BCS_EngTorqIncActiveSt "Increased engine torque  active status";
CM_ SG_ 352 BCS_RegenModulationAvailable "Indicate whether ESP can follow ePedal request and modify the recuperation torque";
CM_ SG_ 352 BCS_RegenModuleActive "Reduce repcuperation torque requested by oppotize TCS control active status";
CM_ SG_ 352 BCS_EngTorqDecFastRANm "This torque  is engine combustion(indicated)decreased target torque (fast) for Rear Axle";
CM_ SG_ 352 BCS_EngTorqIncRANm "This torque  is  increased enginecombustion(indicated)target torque for Rear Axle";
CM_ SG_ 352 BCS_RealTCSActiveSt "Indication that TCS system currently real performs a brake/engine intervention ";
CM_ SG_ 352 BCS_TargetRecpTorqRq "Target recuperation torque request by BCS to generator,applies to 4WD and front wheel drive";
CM_ SG_ 352 BCS_TargetRecpTorqRqSt "Status of target recuperation torque request by BCS to generator,applies to 4WD and front wheel drive";
CM_ SG_ 352 BCS_CrbsActive "Indicate whether ESP recuperation torque is controlled by CRBS ";
CM_ SG_ 352 BCS_EngTorqDecFastFA "This torque  is engine combustion(indicated) decreased target torque (fast)";
CM_ SG_ 352 BCS_TargetRecpTorqRqFA "Target recuperation torque request by BCS to generator,applies to 4WD and front wheel drive";
CM_ SG_ 352 BCS_TargetRecpTorqRqFASt "Status of target recuperation torque request by BCS to generator,applies to 4WD and front wheel drive";
CM_ SG_ 352 BCS_TargetRecpTorqRqRA "Target recuperation torque request by BCS to generator,applies to 4WD and rear wheel drive";
CM_ SG_ 352 BCS_TargetRecpTorqRqRASt "Status of target recuperation torque request by BCS to generator,applies to 4WD and rear wheel drive";
CM_ SG_ 352 IPB_BrakePedalSt "IBCS Brake Pedal Status";
CM_ SG_ 352 IPB_BrakePedalStsVld "The validity  of brake pedal status";
CM_ SG_ 352 BCS_ESP2Park_DrvBrkOverrideFlg "Indicate driver brakes more than the system. ";
CM_ SG_ 352 BCS_EngTorqDecActiveStRA "Decrease enginetorque  active status (fast and low) for Rear Axle";
CM_ SG_ 352 BCS_EngTorqIncActiveStRA "Increased engine torque  active status for Rear Axle";
CM_ SG_ 352 BCS_EngTorqIncActiveStFA "Increased engine torque active status for Front Axle";
CM_ SG_ 352 BCS_EngTorqDecFastRA "This torque  is engine combustion(indicated)decreased target torque (fast) for Rear Axle";
CM_ SG_ 352 BCS_EngTorqIncRA "This torque  is  increased enginecombustion(indicated)target torque for Rear Axle";
CM_ SG_ 352 BCS_EngTorqDecActiveStFA "Decrease enginetorque active status (fast and low) for Front Axle";
CM_ SG_ 352 BCS_PrimBrkCDAAvailableSt "Primary brake actuator L2++ Cruise funtion interface healthy status.CDA NotAvailable: not available forL2++ system due to not initialization or failure or BAT not Finish. .CDA NotAvailable By Situation: not available for L2++ system due to rules not fulfilled.CDA NotAvailable For RBU Failure: CDA not available due to redundant system failure.CDA NotAvailable By Situation: CDA  not available due to rules not fulfilled.CDA Available With Fault: L2++ system Available with failure in short time.CDA Available With Situation: L2++ system active with rules not fulfilled in short time.CDA Available:No failure detected, pre-condition for activing L2++ are fullfilled";
CM_ SG_ 352 BCS_PrimBrkCommuniSt "Primary brake actuator communication healthy status.ADC and Primary brake actuator relevant network communication can be received on at least one channel.Invalid meaning communication is impossible , ADC need to receive the brake actuator signals from RBU.";
CM_ SG_ 352 BCS_PrimBrkActiveSt "Primary brake actuator working status.CDD (Controlled Deceleration for Driver) for L2.CDA (Controlled Deceleration for Automated Driving) for L2++ or Advance Cruise .L2 Active: Brake actuator working in L2 Cruise;L2++ Active：Brake actuator  working in L2++ or Advance Cruise";
CM_ SG_ 352 BCS_PrimBrkSuspendSt "CDD and CDA Normal: No interaction detected.CDD_RampOff By DriverBrake :  during L2 active, driver propulsion will suspend L2 deceleration control.";
CM_ SG_ 352 BCS_2ParkDynamicAVPavailability "Flag indicate  Dynamic AVP availability for longitudinal control";
CM_ SG_ 352 BCS_2ParkCddApActiveVehHld "Flag indicate that vehicle is activly hold by longitudinal actuator controller";
CM_ SG_ 352 BCS_2ParkAPCStatus "Longitudinal controller status";
CM_ SG_ 352 BCS_2ParkAPAavailability "Flag indicate  APA availability for longitudinal control";
CM_ SG_ 352 BCS_2ParkRPAAVPavailability "Flag indicate  RPA AVP availability for longitudinal control";
CM_ SG_ 352 BCS_2ParkAPCFailureSts "detailed information why this APC maneuver failed";
CM_ SG_ 352 BCS_APCMain2BackupReq "APC_24 main activation request towards backup for RPA/AVP";
CM_ SG_ 352 BCS_PrimBrkCtrlUsedChannel "Primary brake actuator Feekback which communication channel is used for ADC Control";
CM_ SG_ 352 BCS_PrimBrkCDAActiveSt "Primary brake actuator CDA(Controlled Deceleration for Automated Driving) working status.L2++ Active:Brake actuator  working in L2++ or Advance Cruise.";
CM_ SG_ 352 BCS_PrimBrkDecCtrlActiveSt "Primary Brake actuator Deceleration Control Active Status for ADC Ax Request .(CDD or CDA)";
CM_ SG_ 352 BCS_PrimBrkCDDAvailableSt "Primary brake actuator L2 Cruise funtion interface healthy status.";
CM_ SG_ 352 BCS_EngTorqIncFA "This torque is increased engine combustion(indicated)target torque for Front ear Axle";
CM_ SG_ 611 BCS_HydBrkActvTq_FL_1 "Hydraulic brake torque of the  front left wheel";
CM_ SG_ 611 BCS_HydBrkActvTq_FR_1 "Hydraulic brake torque of the  front right wheel";
CM_ SG_ 611 BCS_HydBrkActvTq_RL_1 "Hydraulic brake torque of the  rear left wheel";
CM_ SG_ 611 BCS_HydBrkActvTq_RR_1 "Hydraulic brake torque of the  rear right wheel";
CM_ SG_ 611 BCS_PrimCommPathSt "Indicates the communication error status of the primary CAN channel monitored by the brake control system.";
CM_ SG_ 611 BCS_SeconCommPathSt "Indicates the communication error status of the Secondary CAN channel monitored by the brake control system.";
CM_ SG_ 611 BCS_PressureHldSt "Indicates the pressure holding status of the brake control system.";
CM_ SG_ 611 BCS_CDDFuncSt "Indicates the CDD function status of  the brake control system.";
CM_ SG_ 611 IPB_SimulatorPressure "Indicate simulator pressure value";
CM_ SG_ 611 IPB_SimulatorPressureSt "Indicate simulator pressure status";
CM_ SG_ 611 IBCS_SystemSt "IBCS system state";
CM_ SG_ 611 IBCS_FWAWarning "Indicate FWA state, dashboard need warn driver";
CM_ SG_ 611 IPB_CSTSt "indicates CST status. Only valid for project with CST function.";
CM_ SG_ 611 BCS_AVDCActive "Indicate AVDC deceleration active or not";
CM_ SG_ 611 BCS_AVDCAvailable "Indicate AVDC deceleration available ornot";

BA_DEF_ BO_  "GenMsgCycleTime" INT 0 0;
BA_DEF_ BO_  "GenMsgCycleTimeFast" INT 0 0;
BA_DEF_ BO_  "GenMsgSendType" ENUM  "Periodic","Event","IfActive","POE","PA","FixedPeriodic","Event","EnabledPeriodic","NotUsed","NotUsed","EventPeriodic","NotUsed","NotUsed","NoMsgSendType";
BA_DEF_ BO_  "VFrameFormat" ENUM  "StandardCAN","ExtendedCAN","reserved","reserved","reserved","reserved","reserved","reserved","reserved","reserved","reserved","reserved","reserved","reserved","StandardCAN_FD","ExtendedCAN_FD";
BA_DEF_ BO_  "CANFD_BRS" ENUM  "0","1";
BA_DEF_ SG_  "EventCommandSignal" ENUM  "No","Yes";
BA_DEF_ SG_  "GatewayedSignals" ENUM  "No","Yes";
BA_DEF_ SG_  "GenSigInactiveValue" HEX 0 0;
BA_DEF_ SG_  "GenSigInvalidValue" HEX 0 0;
BA_DEF_ SG_  "GenSigSendType" ENUM  "Trigger","Passive","Cyclic","OnWrite","OnWriteWithRepetition","OnChange","OnChangeWithRepetition","IfActive","IfActiveWithRepetition","NoSigSendType";
BA_DEF_ SG_  "GenSigStartValue" HEX 0 0;
BA_DEF_ SG_  "GenSigTimeoutValue" HEX 0 0;
BA_DEF_ SG_  "Remark" STRING ;
BA_DEF_  "Manufacturer" STRING ;
BA_DEF_  "Project" STRING ;
BA_DEF_  "Version" STRING ;
BA_DEF_  "Date" STRING ;
BA_DEF_  "Author" STRING ;
BA_DEF_  "DBName" STRING ;
BA_DEF_  "BusType" STRING ;
BA_DEF_  "Checker" STRING ;
BA_DEF_  "Approver" STRING ;
BA_ "Manufacturer" "GACRND";
BA_ "Project" "A88";
BA_ "Version" "0.1";
BA_ "Date" "2026-7-8 10:31:28";
BA_ "Author" "LeoFeng";
BA_ "DBName" "ADCPublic_CANFD2";
BA_ "BusType" "CAN FD";
BA_ "Checker" "Miss Fan";
BA_ "Approver" "Mr Hu";

BA_ "GenMsgCycleTime" BO_ 616 20;
BA_ "GenMsgCycleTimeFast" BO_ 616 0;
BA_ "GenMsgSendType" BO_ 616 0;
BA_ "VFrameFormat" BO_ 616 14;
BA_ "CANFD_BRS" BO_ 616 1;
BA_ "GenMsgCycleTime" BO_ 616 20;
BA_ "GenMsgCycleTimeFast" BO_ 616 0;
BA_ "GenMsgSendType" BO_ 616 0;
BA_ "VFrameFormat" BO_ 616 14;
BA_ "CANFD_BRS" BO_ 616 1;
BA_ "GenMsgCycleTime" BO_ 616 20;
BA_ "GenMsgCycleTimeFast" BO_ 616 0;
BA_ "GenMsgSendType" BO_ 616 0;
BA_ "VFrameFormat" BO_ 616 14;
BA_ "CANFD_BRS" BO_ 616 1;
BA_ "GenMsgCycleTime" BO_ 616 20;
BA_ "GenMsgCycleTimeFast" BO_ 616 0;
BA_ "GenMsgSendType" BO_ 616 0;
BA_ "VFrameFormat" BO_ 616 14;
BA_ "CANFD_BRS" BO_ 616 1;
BA_ "GenMsgCycleTime" BO_ 616 20;
BA_ "GenMsgCycleTimeFast" BO_ 616 0;
BA_ "GenMsgSendType" BO_ 616 0;
BA_ "VFrameFormat" BO_ 616 14;
BA_ "CANFD_BRS" BO_ 616 1;
BA_ "GenMsgCycleTime" BO_ 616 20;
BA_ "GenMsgCycleTimeFast" BO_ 616 0;
BA_ "GenMsgSendType" BO_ 616 0;
BA_ "VFrameFormat" BO_ 616 14;
BA_ "CANFD_BRS" BO_ 616 1;
BA_ "GenMsgCycleTime" BO_ 616 20;
BA_ "GenMsgCycleTimeFast" BO_ 616 0;
BA_ "GenMsgSendType" BO_ 616 0;
BA_ "VFrameFormat" BO_ 616 14;
BA_ "CANFD_BRS" BO_ 616 1;
BA_ "GenMsgCycleTime" BO_ 616 20;
BA_ "GenMsgCycleTimeFast" BO_ 616 0;
BA_ "GenMsgSendType" BO_ 616 0;
BA_ "VFrameFormat" BO_ 616 14;
BA_ "CANFD_BRS" BO_ 616 1;
BA_ "GenMsgCycleTime" BO_ 616 20;
BA_ "GenMsgCycleTimeFast" BO_ 616 0;
BA_ "GenMsgSendType" BO_ 616 0;
BA_ "VFrameFormat" BO_ 616 14;
BA_ "CANFD_BRS" BO_ 616 1;
BA_ "GenMsgCycleTime" BO_ 616 20;
BA_ "GenMsgCycleTimeFast" BO_ 616 0;
BA_ "GenMsgSendType" BO_ 616 0;
BA_ "VFrameFormat" BO_ 616 14;
BA_ "CANFD_BRS" BO_ 616 1;
BA_ "GenMsgCycleTime" BO_ 616 20;
BA_ "GenMsgCycleTimeFast" BO_ 616 0;
BA_ "GenMsgSendType" BO_ 616 0;
BA_ "VFrameFormat" BO_ 616 14;
BA_ "CANFD_BRS" BO_ 616 1;
BA_ "GenMsgCycleTime" BO_ 616 20;
BA_ "GenMsgCycleTimeFast" BO_ 616 0;
BA_ "GenMsgSendType" BO_ 616 0;
BA_ "VFrameFormat" BO_ 616 14;
BA_ "CANFD_BRS" BO_ 616 1;
BA_ "GenMsgCycleTime" BO_ 616 20;
BA_ "GenMsgCycleTimeFast" BO_ 616 0;
BA_ "GenMsgSendType" BO_ 616 0;
BA_ "VFrameFormat" BO_ 616 14;
BA_ "CANFD_BRS" BO_ 616 1;
BA_ "GenMsgCycleTime" BO_ 616 20;
BA_ "GenMsgCycleTimeFast" BO_ 616 0;
BA_ "GenMsgSendType" BO_ 616 0;
BA_ "VFrameFormat" BO_ 616 14;
BA_ "CANFD_BRS" BO_ 616 1;
BA_ "GenMsgCycleTime" BO_ 616 20;
BA_ "GenMsgCycleTimeFast" BO_ 616 0;
BA_ "GenMsgSendType" BO_ 616 0;
BA_ "VFrameFormat" BO_ 616 14;
BA_ "CANFD_BRS" BO_ 616 1;
BA_ "GenMsgCycleTime" BO_ 616 20;
BA_ "GenMsgCycleTimeFast" BO_ 616 0;
BA_ "GenMsgSendType" BO_ 616 0;
BA_ "VFrameFormat" BO_ 616 14;
BA_ "CANFD_BRS" BO_ 616 1;
BA_ "GenMsgCycleTime" BO_ 616 20;
BA_ "GenMsgCycleTimeFast" BO_ 616 0;
BA_ "GenMsgSendType" BO_ 616 0;
BA_ "VFrameFormat" BO_ 616 14;
BA_ "CANFD_BRS" BO_ 616 1;
BA_ "GenMsgCycleTime" BO_ 616 20;
BA_ "GenMsgCycleTimeFast" BO_ 616 0;
BA_ "GenMsgSendType" BO_ 616 0;
BA_ "VFrameFormat" BO_ 616 14;
BA_ "CANFD_BRS" BO_ 616 1;
BA_ "GenMsgCycleTime" BO_ 616 20;
BA_ "GenMsgCycleTimeFast" BO_ 616 0;
BA_ "GenMsgSendType" BO_ 616 0;
BA_ "VFrameFormat" BO_ 616 14;
BA_ "CANFD_BRS" BO_ 616 1;
BA_ "GenMsgCycleTime" BO_ 616 20;
BA_ "GenMsgCycleTimeFast" BO_ 616 0;
BA_ "GenMsgSendType" BO_ 616 0;
BA_ "VFrameFormat" BO_ 616 14;
BA_ "CANFD_BRS" BO_ 616 1;
BA_ "GenMsgCycleTime" BO_ 909 100;
BA_ "GenMsgCycleTimeFast" BO_ 909 0;
BA_ "GenMsgSendType" BO_ 909 0;
BA_ "VFrameFormat" BO_ 909 14;
BA_ "CANFD_BRS" BO_ 909 1;
BA_ "GenMsgCycleTime" BO_ 909 100;
BA_ "GenMsgCycleTimeFast" BO_ 909 0;
BA_ "GenMsgSendType" BO_ 909 0;
BA_ "VFrameFormat" BO_ 909 14;
BA_ "CANFD_BRS" BO_ 909 1;
BA_ "GenMsgCycleTime" BO_ 909 100;
BA_ "GenMsgCycleTimeFast" BO_ 909 0;
BA_ "GenMsgSendType" BO_ 909 0;
BA_ "VFrameFormat" BO_ 909 14;
BA_ "CANFD_BRS" BO_ 909 1;
BA_ "GenMsgCycleTime" BO_ 909 100;
BA_ "GenMsgCycleTimeFast" BO_ 909 0;
BA_ "GenMsgSendType" BO_ 909 0;
BA_ "VFrameFormat" BO_ 909 14;
BA_ "CANFD_BRS" BO_ 909 1;
BA_ "GenMsgCycleTime" BO_ 909 100;
BA_ "GenMsgCycleTimeFast" BO_ 909 0;
BA_ "GenMsgSendType" BO_ 909 0;
BA_ "VFrameFormat" BO_ 909 14;
BA_ "CANFD_BRS" BO_ 909 1;
BA_ "GenMsgCycleTime" BO_ 909 100;
BA_ "GenMsgCycleTimeFast" BO_ 909 0;
BA_ "GenMsgSendType" BO_ 909 0;
BA_ "VFrameFormat" BO_ 909 14;
BA_ "CANFD_BRS" BO_ 909 1;
BA_ "GenMsgCycleTime" BO_ 909 100;
BA_ "GenMsgCycleTimeFast" BO_ 909 0;
BA_ "GenMsgSendType" BO_ 909 0;
BA_ "VFrameFormat" BO_ 909 14;
BA_ "CANFD_BRS" BO_ 909 1;
BA_ "GenMsgCycleTime" BO_ 909 100;
BA_ "GenMsgCycleTimeFast" BO_ 909 0;
BA_ "GenMsgSendType" BO_ 909 0;
BA_ "VFrameFormat" BO_ 909 14;
BA_ "CANFD_BRS" BO_ 909 1;
BA_ "GenMsgCycleTime" BO_ 909 100;
BA_ "GenMsgCycleTimeFast" BO_ 909 0;
BA_ "GenMsgSendType" BO_ 909 0;
BA_ "VFrameFormat" BO_ 909 14;
BA_ "CANFD_BRS" BO_ 909 1;
BA_ "GenMsgCycleTime" BO_ 909 100;
BA_ "GenMsgCycleTimeFast" BO_ 909 0;
BA_ "GenMsgSendType" BO_ 909 0;
BA_ "VFrameFormat" BO_ 909 14;
BA_ "CANFD_BRS" BO_ 909 1;
BA_ "GenMsgCycleTime" BO_ 909 100;
BA_ "GenMsgCycleTimeFast" BO_ 909 0;
BA_ "GenMsgSendType" BO_ 909 0;
BA_ "VFrameFormat" BO_ 909 14;
BA_ "CANFD_BRS" BO_ 909 1;
BA_ "GenMsgCycleTime" BO_ 909 100;
BA_ "GenMsgCycleTimeFast" BO_ 909 0;
BA_ "GenMsgSendType" BO_ 909 0;
BA_ "VFrameFormat" BO_ 909 14;
BA_ "CANFD_BRS" BO_ 909 1;
BA_ "GenMsgCycleTime" BO_ 909 100;
BA_ "GenMsgCycleTimeFast" BO_ 909 0;
BA_ "GenMsgSendType" BO_ 909 0;
BA_ "VFrameFormat" BO_ 909 14;
BA_ "CANFD_BRS" BO_ 909 1;
BA_ "GenMsgCycleTime" BO_ 909 100;
BA_ "GenMsgCycleTimeFast" BO_ 909 0;
BA_ "GenMsgSendType" BO_ 909 0;
BA_ "VFrameFormat" BO_ 909 14;
BA_ "CANFD_BRS" BO_ 909 1;
BA_ "GenMsgCycleTime" BO_ 909 100;
BA_ "GenMsgCycleTimeFast" BO_ 909 0;
BA_ "GenMsgSendType" BO_ 909 0;
BA_ "VFrameFormat" BO_ 909 14;
BA_ "CANFD_BRS" BO_ 909 1;
BA_ "GenMsgCycleTime" BO_ 909 100;
BA_ "GenMsgCycleTimeFast" BO_ 909 0;
BA_ "GenMsgSendType" BO_ 909 0;
BA_ "VFrameFormat" BO_ 909 14;
BA_ "CANFD_BRS" BO_ 909 1;
BA_ "GenMsgCycleTime" BO_ 909 100;
BA_ "GenMsgCycleTimeFast" BO_ 909 0;
BA_ "GenMsgSendType" BO_ 909 0;
BA_ "VFrameFormat" BO_ 909 14;
BA_ "CANFD_BRS" BO_ 909 1;
BA_ "GenMsgCycleTime" BO_ 909 100;
BA_ "GenMsgCycleTimeFast" BO_ 909 0;
BA_ "GenMsgSendType" BO_ 909 0;
BA_ "VFrameFormat" BO_ 909 14;
BA_ "CANFD_BRS" BO_ 909 1;
BA_ "GenMsgCycleTime" BO_ 909 100;
BA_ "GenMsgCycleTimeFast" BO_ 909 0;
BA_ "GenMsgSendType" BO_ 909 0;
BA_ "VFrameFormat" BO_ 909 14;
BA_ "CANFD_BRS" BO_ 909 1;
BA_ "GenMsgCycleTime" BO_ 909 100;
BA_ "GenMsgCycleTimeFast" BO_ 909 0;
BA_ "GenMsgSendType" BO_ 909 0;
BA_ "VFrameFormat" BO_ 909 14;
BA_ "CANFD_BRS" BO_ 909 1;
BA_ "GenMsgCycleTime" BO_ 909 100;
BA_ "GenMsgCycleTimeFast" BO_ 909 0;
BA_ "GenMsgSendType" BO_ 909 0;
BA_ "VFrameFormat" BO_ 909 14;
BA_ "CANFD_BRS" BO_ 909 1;
BA_ "GenMsgCycleTime" BO_ 909 100;
BA_ "GenMsgCycleTimeFast" BO_ 909 0;
BA_ "GenMsgSendType" BO_ 909 0;
BA_ "VFrameFormat" BO_ 909 14;
BA_ "CANFD_BRS" BO_ 909 1;
BA_ "GenMsgCycleTime" BO_ 909 100;
BA_ "GenMsgCycleTimeFast" BO_ 909 0;
BA_ "GenMsgSendType" BO_ 909 0;
BA_ "VFrameFormat" BO_ 909 14;
BA_ "CANFD_BRS" BO_ 909 1;
BA_ "GenMsgCycleTime" BO_ 909 100;
BA_ "GenMsgCycleTimeFast" BO_ 909 0;
BA_ "GenMsgSendType" BO_ 909 0;
BA_ "VFrameFormat" BO_ 909 14;
BA_ "CANFD_BRS" BO_ 909 1;
BA_ "GenMsgCycleTime" BO_ 909 100;
BA_ "GenMsgCycleTimeFast" BO_ 909 0;
BA_ "GenMsgSendType" BO_ 909 0;
BA_ "VFrameFormat" BO_ 909 14;
BA_ "CANFD_BRS" BO_ 909 1;
BA_ "GenMsgCycleTime" BO_ 909 100;
BA_ "GenMsgCycleTimeFast" BO_ 909 0;
BA_ "GenMsgSendType" BO_ 909 0;
BA_ "VFrameFormat" BO_ 909 14;
BA_ "CANFD_BRS" BO_ 909 1;
BA_ "GenMsgCycleTime" BO_ 909 100;
BA_ "GenMsgCycleTimeFast" BO_ 909 0;
BA_ "GenMsgSendType" BO_ 909 0;
BA_ "VFrameFormat" BO_ 909 14;
BA_ "CANFD_BRS" BO_ 909 1;
BA_ "GenMsgCycleTime" BO_ 909 100;
BA_ "GenMsgCycleTimeFast" BO_ 909 0;
BA_ "GenMsgSendType" BO_ 909 0;
BA_ "VFrameFormat" BO_ 909 14;
BA_ "CANFD_BRS" BO_ 909 1;
BA_ "GenMsgCycleTime" BO_ 909 100;
BA_ "GenMsgCycleTimeFast" BO_ 909 0;
BA_ "GenMsgSendType" BO_ 909 0;
BA_ "VFrameFormat" BO_ 909 14;
BA_ "CANFD_BRS" BO_ 909 1;
BA_ "GenMsgCycleTime" BO_ 909 100;
BA_ "GenMsgCycleTimeFast" BO_ 909 0;
BA_ "GenMsgSendType" BO_ 909 0;
BA_ "VFrameFormat" BO_ 909 14;
BA_ "CANFD_BRS" BO_ 909 1;
BA_ "GenMsgCycleTime" BO_ 909 100;
BA_ "GenMsgCycleTimeFast" BO_ 909 0;
BA_ "GenMsgSendType" BO_ 909 0;
BA_ "VFrameFormat" BO_ 909 14;
BA_ "CANFD_BRS" BO_ 909 1;
BA_ "GenMsgCycleTime" BO_ 909 100;
BA_ "GenMsgCycleTimeFast" BO_ 909 0;
BA_ "GenMsgSendType" BO_ 909 0;
BA_ "VFrameFormat" BO_ 909 14;
BA_ "CANFD_BRS" BO_ 909 1;
BA_ "GenMsgCycleTime" BO_ 909 100;
BA_ "GenMsgCycleTimeFast" BO_ 909 0;
BA_ "GenMsgSendType" BO_ 909 0;
BA_ "VFrameFormat" BO_ 909 14;
BA_ "CANFD_BRS" BO_ 909 1;
BA_ "GenMsgCycleTime" BO_ 909 100;
BA_ "GenMsgCycleTimeFast" BO_ 909 0;
BA_ "GenMsgSendType" BO_ 909 0;
BA_ "VFrameFormat" BO_ 909 14;
BA_ "CANFD_BRS" BO_ 909 1;
BA_ "GenMsgCycleTime" BO_ 909 100;
BA_ "GenMsgCycleTimeFast" BO_ 909 0;
BA_ "GenMsgSendType" BO_ 909 0;
BA_ "VFrameFormat" BO_ 909 14;
BA_ "CANFD_BRS" BO_ 909 1;
BA_ "GenMsgCycleTime" BO_ 909 100;
BA_ "GenMsgCycleTimeFast" BO_ 909 0;
BA_ "GenMsgSendType" BO_ 909 0;
BA_ "VFrameFormat" BO_ 909 14;
BA_ "CANFD_BRS" BO_ 909 1;
BA_ "GenMsgCycleTime" BO_ 909 100;
BA_ "GenMsgCycleTimeFast" BO_ 909 0;
BA_ "GenMsgSendType" BO_ 909 0;
BA_ "VFrameFormat" BO_ 909 14;
BA_ "CANFD_BRS" BO_ 909 1;
BA_ "GenMsgCycleTime" BO_ 909 100;
BA_ "GenMsgCycleTimeFast" BO_ 909 0;
BA_ "GenMsgSendType" BO_ 909 0;
BA_ "VFrameFormat" BO_ 909 14;
BA_ "CANFD_BRS" BO_ 909 1;
BA_ "GenMsgCycleTime" BO_ 909 100;
BA_ "GenMsgCycleTimeFast" BO_ 909 0;
BA_ "GenMsgSendType" BO_ 909 0;
BA_ "VFrameFormat" BO_ 909 14;
BA_ "CANFD_BRS" BO_ 909 1;
BA_ "GenMsgCycleTime" BO_ 909 100;
BA_ "GenMsgCycleTimeFast" BO_ 909 0;
BA_ "GenMsgSendType" BO_ 909 0;
BA_ "VFrameFormat" BO_ 909 14;
BA_ "CANFD_BRS" BO_ 909 1;
BA_ "GenMsgCycleTime" BO_ 909 100;
BA_ "GenMsgCycleTimeFast" BO_ 909 0;
BA_ "GenMsgSendType" BO_ 909 0;
BA_ "VFrameFormat" BO_ 909 14;
BA_ "CANFD_BRS" BO_ 909 1;
BA_ "GenMsgCycleTime" BO_ 909 100;
BA_ "GenMsgCycleTimeFast" BO_ 909 0;
BA_ "GenMsgSendType" BO_ 909 0;
BA_ "VFrameFormat" BO_ 909 14;
BA_ "CANFD_BRS" BO_ 909 1;
BA_ "GenMsgCycleTime" BO_ 909 100;
BA_ "GenMsgCycleTimeFast" BO_ 909 0;
BA_ "GenMsgSendType" BO_ 909 0;
BA_ "VFrameFormat" BO_ 909 14;
BA_ "CANFD_BRS" BO_ 909 1;
BA_ "GenMsgCycleTime" BO_ 909 100;
BA_ "GenMsgCycleTimeFast" BO_ 909 0;
BA_ "GenMsgSendType" BO_ 909 0;
BA_ "VFrameFormat" BO_ 909 14;
BA_ "CANFD_BRS" BO_ 909 1;
BA_ "GenMsgCycleTime" BO_ 909 100;
BA_ "GenMsgCycleTimeFast" BO_ 909 0;
BA_ "GenMsgSendType" BO_ 909 0;
BA_ "VFrameFormat" BO_ 909 14;
BA_ "CANFD_BRS" BO_ 909 1;
BA_ "GenMsgCycleTime" BO_ 909 100;
BA_ "GenMsgCycleTimeFast" BO_ 909 0;
BA_ "GenMsgSendType" BO_ 909 0;
BA_ "VFrameFormat" BO_ 909 14;
BA_ "CANFD_BRS" BO_ 909 1;
BA_ "GenMsgCycleTime" BO_ 905 100;
BA_ "GenMsgCycleTimeFast" BO_ 905 0;
BA_ "GenMsgSendType" BO_ 905 0;
BA_ "VFrameFormat" BO_ 905 14;
BA_ "CANFD_BRS" BO_ 905 1;
BA_ "GenMsgCycleTime" BO_ 905 100;
BA_ "GenMsgCycleTimeFast" BO_ 905 0;
BA_ "GenMsgSendType" BO_ 905 0;
BA_ "VFrameFormat" BO_ 905 14;
BA_ "CANFD_BRS" BO_ 905 1;
BA_ "GenMsgCycleTime" BO_ 905 100;
BA_ "GenMsgCycleTimeFast" BO_ 905 0;
BA_ "GenMsgSendType" BO_ 905 0;
BA_ "VFrameFormat" BO_ 905 14;
BA_ "CANFD_BRS" BO_ 905 1;
BA_ "GenMsgCycleTime" BO_ 905 100;
BA_ "GenMsgCycleTimeFast" BO_ 905 0;
BA_ "GenMsgSendType" BO_ 905 0;
BA_ "VFrameFormat" BO_ 905 14;
BA_ "CANFD_BRS" BO_ 905 1;
BA_ "GenMsgCycleTime" BO_ 905 100;
BA_ "GenMsgCycleTimeFast" BO_ 905 0;
BA_ "GenMsgSendType" BO_ 905 0;
BA_ "VFrameFormat" BO_ 905 14;
BA_ "CANFD_BRS" BO_ 905 1;
BA_ "GenMsgCycleTime" BO_ 905 100;
BA_ "GenMsgCycleTimeFast" BO_ 905 0;
BA_ "GenMsgSendType" BO_ 905 0;
BA_ "VFrameFormat" BO_ 905 14;
BA_ "CANFD_BRS" BO_ 905 1;
BA_ "GenMsgCycleTime" BO_ 161 0;
BA_ "GenMsgCycleTimeFast" BO_ 161 0;
BA_ "GenMsgSendType" BO_ 161 1;
BA_ "VFrameFormat" BO_ 161 14;
BA_ "CANFD_BRS" BO_ 161 1;
BA_ "GenMsgCycleTime" BO_ 161 0;
BA_ "GenMsgCycleTimeFast" BO_ 161 0;
BA_ "GenMsgSendType" BO_ 161 1;
BA_ "VFrameFormat" BO_ 161 14;
BA_ "CANFD_BRS" BO_ 161 1;
BA_ "GenMsgCycleTime" BO_ 161 0;
BA_ "GenMsgCycleTimeFast" BO_ 161 0;
BA_ "GenMsgSendType" BO_ 161 1;
BA_ "VFrameFormat" BO_ 161 14;
BA_ "CANFD_BRS" BO_ 161 1;
BA_ "GenMsgCycleTime" BO_ 161 0;
BA_ "GenMsgCycleTimeFast" BO_ 161 0;
BA_ "GenMsgSendType" BO_ 161 1;
BA_ "VFrameFormat" BO_ 161 14;
BA_ "CANFD_BRS" BO_ 161 1;
BA_ "GenMsgCycleTime" BO_ 161 0;
BA_ "GenMsgCycleTimeFast" BO_ 161 0;
BA_ "GenMsgSendType" BO_ 161 1;
BA_ "VFrameFormat" BO_ 161 14;
BA_ "CANFD_BRS" BO_ 161 1;
BA_ "GenMsgCycleTime" BO_ 161 0;
BA_ "GenMsgCycleTimeFast" BO_ 161 0;
BA_ "GenMsgSendType" BO_ 161 1;
BA_ "VFrameFormat" BO_ 161 14;
BA_ "CANFD_BRS" BO_ 161 1;
BA_ "GenMsgCycleTime" BO_ 615 20;
BA_ "GenMsgCycleTimeFast" BO_ 615 0;
BA_ "GenMsgSendType" BO_ 615 0;
BA_ "VFrameFormat" BO_ 615 14;
BA_ "CANFD_BRS" BO_ 615 1;
BA_ "GenMsgCycleTime" BO_ 615 20;
BA_ "GenMsgCycleTimeFast" BO_ 615 0;
BA_ "GenMsgSendType" BO_ 615 0;
BA_ "VFrameFormat" BO_ 615 14;
BA_ "CANFD_BRS" BO_ 615 1;
BA_ "GenMsgCycleTime" BO_ 615 20;
BA_ "GenMsgCycleTimeFast" BO_ 615 0;
BA_ "GenMsgSendType" BO_ 615 0;
BA_ "VFrameFormat" BO_ 615 14;
BA_ "CANFD_BRS" BO_ 615 1;
BA_ "GenMsgCycleTime" BO_ 615 20;
BA_ "GenMsgCycleTimeFast" BO_ 615 0;
BA_ "GenMsgSendType" BO_ 615 0;
BA_ "VFrameFormat" BO_ 615 14;
BA_ "CANFD_BRS" BO_ 615 1;
BA_ "GenMsgCycleTime" BO_ 615 20;
BA_ "GenMsgCycleTimeFast" BO_ 615 0;
BA_ "GenMsgSendType" BO_ 615 0;
BA_ "VFrameFormat" BO_ 615 14;
BA_ "CANFD_BRS" BO_ 615 1;
BA_ "GenMsgCycleTime" BO_ 615 20;
BA_ "GenMsgCycleTimeFast" BO_ 615 0;
BA_ "GenMsgSendType" BO_ 615 0;
BA_ "VFrameFormat" BO_ 615 14;
BA_ "CANFD_BRS" BO_ 615 1;
BA_ "GenMsgCycleTime" BO_ 615 20;
BA_ "GenMsgCycleTimeFast" BO_ 615 0;
BA_ "GenMsgSendType" BO_ 615 0;
BA_ "VFrameFormat" BO_ 615 14;
BA_ "CANFD_BRS" BO_ 615 1;
BA_ "GenMsgCycleTime" BO_ 615 20;
BA_ "GenMsgCycleTimeFast" BO_ 615 0;
BA_ "GenMsgSendType" BO_ 615 0;
BA_ "VFrameFormat" BO_ 615 14;
BA_ "CANFD_BRS" BO_ 615 1;
BA_ "GenMsgCycleTime" BO_ 615 20;
BA_ "GenMsgCycleTimeFast" BO_ 615 0;
BA_ "GenMsgSendType" BO_ 615 0;
BA_ "VFrameFormat" BO_ 615 14;
BA_ "CANFD_BRS" BO_ 615 1;
BA_ "GenMsgCycleTime" BO_ 615 20;
BA_ "GenMsgCycleTimeFast" BO_ 615 0;
BA_ "GenMsgSendType" BO_ 615 0;
BA_ "VFrameFormat" BO_ 615 14;
BA_ "CANFD_BRS" BO_ 615 1;
BA_ "GenMsgCycleTime" BO_ 615 20;
BA_ "GenMsgCycleTimeFast" BO_ 615 0;
BA_ "GenMsgSendType" BO_ 615 0;
BA_ "VFrameFormat" BO_ 615 14;
BA_ "CANFD_BRS" BO_ 615 1;
BA_ "GenMsgCycleTime" BO_ 615 20;
BA_ "GenMsgCycleTimeFast" BO_ 615 0;
BA_ "GenMsgSendType" BO_ 615 0;
BA_ "VFrameFormat" BO_ 615 14;
BA_ "CANFD_BRS" BO_ 615 1;
BA_ "GenMsgCycleTime" BO_ 615 20;
BA_ "GenMsgCycleTimeFast" BO_ 615 0;
BA_ "GenMsgSendType" BO_ 615 0;
BA_ "VFrameFormat" BO_ 615 14;
BA_ "CANFD_BRS" BO_ 615 1;
BA_ "GenMsgCycleTime" BO_ 615 20;
BA_ "GenMsgCycleTimeFast" BO_ 615 0;
BA_ "GenMsgSendType" BO_ 615 0;
BA_ "VFrameFormat" BO_ 615 14;
BA_ "CANFD_BRS" BO_ 615 1;
BA_ "GenMsgCycleTime" BO_ 615 20;
BA_ "GenMsgCycleTimeFast" BO_ 615 0;
BA_ "GenMsgSendType" BO_ 615 0;
BA_ "VFrameFormat" BO_ 615 14;
BA_ "CANFD_BRS" BO_ 615 1;
BA_ "GenMsgCycleTime" BO_ 615 20;
BA_ "GenMsgCycleTimeFast" BO_ 615 0;
BA_ "GenMsgSendType" BO_ 615 0;
BA_ "VFrameFormat" BO_ 615 14;
BA_ "CANFD_BRS" BO_ 615 1;
BA_ "GenMsgCycleTime" BO_ 615 20;
BA_ "GenMsgCycleTimeFast" BO_ 615 0;
BA_ "GenMsgSendType" BO_ 615 0;
BA_ "VFrameFormat" BO_ 615 14;
BA_ "CANFD_BRS" BO_ 615 1;
BA_ "GenMsgCycleTime" BO_ 615 20;
BA_ "GenMsgCycleTimeFast" BO_ 615 0;
BA_ "GenMsgSendType" BO_ 615 0;
BA_ "VFrameFormat" BO_ 615 14;
BA_ "CANFD_BRS" BO_ 615 1;
BA_ "GenMsgCycleTime" BO_ 615 20;
BA_ "GenMsgCycleTimeFast" BO_ 615 0;
BA_ "GenMsgSendType" BO_ 615 0;
BA_ "VFrameFormat" BO_ 615 14;
BA_ "CANFD_BRS" BO_ 615 1;
BA_ "GenMsgCycleTime" BO_ 615 20;
BA_ "GenMsgCycleTimeFast" BO_ 615 0;
BA_ "GenMsgSendType" BO_ 615 0;
BA_ "VFrameFormat" BO_ 615 14;
BA_ "CANFD_BRS" BO_ 615 1;
BA_ "GenMsgCycleTime" BO_ 615 20;
BA_ "GenMsgCycleTimeFast" BO_ 615 0;
BA_ "GenMsgSendType" BO_ 615 0;
BA_ "VFrameFormat" BO_ 615 14;
BA_ "CANFD_BRS" BO_ 615 1;
BA_ "GenMsgCycleTime" BO_ 615 20;
BA_ "GenMsgCycleTimeFast" BO_ 615 0;
BA_ "GenMsgSendType" BO_ 615 0;
BA_ "VFrameFormat" BO_ 615 14;
BA_ "CANFD_BRS" BO_ 615 1;
BA_ "GenMsgCycleTime" BO_ 615 20;
BA_ "GenMsgCycleTimeFast" BO_ 615 0;
BA_ "GenMsgSendType" BO_ 615 0;
BA_ "VFrameFormat" BO_ 615 14;
BA_ "CANFD_BRS" BO_ 615 1;
BA_ "GenMsgCycleTime" BO_ 615 20;
BA_ "GenMsgCycleTimeFast" BO_ 615 0;
BA_ "GenMsgSendType" BO_ 615 0;
BA_ "VFrameFormat" BO_ 615 14;
BA_ "CANFD_BRS" BO_ 615 1;
BA_ "GenMsgCycleTime" BO_ 615 20;
BA_ "GenMsgCycleTimeFast" BO_ 615 0;
BA_ "GenMsgSendType" BO_ 615 0;
BA_ "VFrameFormat" BO_ 615 14;
BA_ "CANFD_BRS" BO_ 615 1;
BA_ "GenMsgCycleTime" BO_ 615 20;
BA_ "GenMsgCycleTimeFast" BO_ 615 0;
BA_ "GenMsgSendType" BO_ 615 0;
BA_ "VFrameFormat" BO_ 615 14;
BA_ "CANFD_BRS" BO_ 615 1;
BA_ "GenMsgCycleTime" BO_ 615 20;
BA_ "GenMsgCycleTimeFast" BO_ 615 0;
BA_ "GenMsgSendType" BO_ 615 0;
BA_ "VFrameFormat" BO_ 615 14;
BA_ "CANFD_BRS" BO_ 615 1;
BA_ "GenMsgCycleTime" BO_ 615 20;
BA_ "GenMsgCycleTimeFast" BO_ 615 0;
BA_ "GenMsgSendType" BO_ 615 0;
BA_ "VFrameFormat" BO_ 615 14;
BA_ "CANFD_BRS" BO_ 615 1;
BA_ "GenMsgCycleTime" BO_ 615 20;
BA_ "GenMsgCycleTimeFast" BO_ 615 0;
BA_ "GenMsgSendType" BO_ 615 0;
BA_ "VFrameFormat" BO_ 615 14;
BA_ "CANFD_BRS" BO_ 615 1;
BA_ "GenMsgCycleTime" BO_ 615 20;
BA_ "GenMsgCycleTimeFast" BO_ 615 0;
BA_ "GenMsgSendType" BO_ 615 0;
BA_ "VFrameFormat" BO_ 615 14;
BA_ "CANFD_BRS" BO_ 615 1;
BA_ "GenMsgCycleTime" BO_ 615 20;
BA_ "GenMsgCycleTimeFast" BO_ 615 0;
BA_ "GenMsgSendType" BO_ 615 0;
BA_ "VFrameFormat" BO_ 615 14;
BA_ "CANFD_BRS" BO_ 615 1;
BA_ "GenMsgCycleTime" BO_ 615 20;
BA_ "GenMsgCycleTimeFast" BO_ 615 0;
BA_ "GenMsgSendType" BO_ 615 0;
BA_ "VFrameFormat" BO_ 615 14;
BA_ "CANFD_BRS" BO_ 615 1;
BA_ "GenMsgCycleTime" BO_ 615 20;
BA_ "GenMsgCycleTimeFast" BO_ 615 0;
BA_ "GenMsgSendType" BO_ 615 0;
BA_ "VFrameFormat" BO_ 615 14;
BA_ "CANFD_BRS" BO_ 615 1;
BA_ "GenMsgCycleTime" BO_ 615 20;
BA_ "GenMsgCycleTimeFast" BO_ 615 0;
BA_ "GenMsgSendType" BO_ 615 0;
BA_ "VFrameFormat" BO_ 615 14;
BA_ "CANFD_BRS" BO_ 615 1;
BA_ "GenMsgCycleTime" BO_ 615 20;
BA_ "GenMsgCycleTimeFast" BO_ 615 0;
BA_ "GenMsgSendType" BO_ 615 0;
BA_ "VFrameFormat" BO_ 615 14;
BA_ "CANFD_BRS" BO_ 615 1;
BA_ "GenMsgCycleTime" BO_ 615 20;
BA_ "GenMsgCycleTimeFast" BO_ 615 0;
BA_ "GenMsgSendType" BO_ 615 0;
BA_ "VFrameFormat" BO_ 615 14;
BA_ "CANFD_BRS" BO_ 615 1;
BA_ "GenMsgCycleTime" BO_ 615 20;
BA_ "GenMsgCycleTimeFast" BO_ 615 0;
BA_ "GenMsgSendType" BO_ 615 0;
BA_ "VFrameFormat" BO_ 615 14;
BA_ "CANFD_BRS" BO_ 615 1;
BA_ "GenMsgCycleTime" BO_ 615 20;
BA_ "GenMsgCycleTimeFast" BO_ 615 0;
BA_ "GenMsgSendType" BO_ 615 0;
BA_ "VFrameFormat" BO_ 615 14;
BA_ "CANFD_BRS" BO_ 615 1;
BA_ "GenMsgCycleTime" BO_ 615 20;
BA_ "GenMsgCycleTimeFast" BO_ 615 0;
BA_ "GenMsgSendType" BO_ 615 0;
BA_ "VFrameFormat" BO_ 615 14;
BA_ "CANFD_BRS" BO_ 615 1;
BA_ "GenMsgCycleTime" BO_ 615 20;
BA_ "GenMsgCycleTimeFast" BO_ 615 0;
BA_ "GenMsgSendType" BO_ 615 0;
BA_ "VFrameFormat" BO_ 615 14;
BA_ "CANFD_BRS" BO_ 615 1;
BA_ "GenMsgCycleTime" BO_ 615 20;
BA_ "GenMsgCycleTimeFast" BO_ 615 0;
BA_ "GenMsgSendType" BO_ 615 0;
BA_ "VFrameFormat" BO_ 615 14;
BA_ "CANFD_BRS" BO_ 615 1;
BA_ "GenMsgCycleTime" BO_ 615 20;
BA_ "GenMsgCycleTimeFast" BO_ 615 0;
BA_ "GenMsgSendType" BO_ 615 0;
BA_ "VFrameFormat" BO_ 615 14;
BA_ "CANFD_BRS" BO_ 615 1;
BA_ "GenMsgCycleTime" BO_ 615 20;
BA_ "GenMsgCycleTimeFast" BO_ 615 0;
BA_ "GenMsgSendType" BO_ 615 0;
BA_ "VFrameFormat" BO_ 615 14;
BA_ "CANFD_BRS" BO_ 615 1;
BA_ "GenMsgCycleTime" BO_ 615 20;
BA_ "GenMsgCycleTimeFast" BO_ 615 0;
BA_ "GenMsgSendType" BO_ 615 0;
BA_ "VFrameFormat" BO_ 615 14;
BA_ "CANFD_BRS" BO_ 615 1;
BA_ "GenMsgCycleTime" BO_ 615 20;
BA_ "GenMsgCycleTimeFast" BO_ 615 0;
BA_ "GenMsgSendType" BO_ 615 0;
BA_ "VFrameFormat" BO_ 615 14;
BA_ "CANFD_BRS" BO_ 615 1;
BA_ "GenMsgCycleTime" BO_ 615 20;
BA_ "GenMsgCycleTimeFast" BO_ 615 0;
BA_ "GenMsgSendType" BO_ 615 0;
BA_ "VFrameFormat" BO_ 615 14;
BA_ "CANFD_BRS" BO_ 615 1;
BA_ "GenMsgCycleTime" BO_ 615 20;
BA_ "GenMsgCycleTimeFast" BO_ 615 0;
BA_ "GenMsgSendType" BO_ 615 0;
BA_ "VFrameFormat" BO_ 615 14;
BA_ "CANFD_BRS" BO_ 615 1;
BA_ "GenMsgCycleTime" BO_ 615 20;
BA_ "GenMsgCycleTimeFast" BO_ 615 0;
BA_ "GenMsgSendType" BO_ 615 0;
BA_ "VFrameFormat" BO_ 615 14;
BA_ "CANFD_BRS" BO_ 615 1;
BA_ "GenMsgCycleTime" BO_ 615 20;
BA_ "GenMsgCycleTimeFast" BO_ 615 0;
BA_ "GenMsgSendType" BO_ 615 0;
BA_ "VFrameFormat" BO_ 615 14;
BA_ "CANFD_BRS" BO_ 615 1;
BA_ "GenMsgCycleTime" BO_ 615 20;
BA_ "GenMsgCycleTimeFast" BO_ 615 0;
BA_ "GenMsgSendType" BO_ 615 0;
BA_ "VFrameFormat" BO_ 615 14;
BA_ "CANFD_BRS" BO_ 615 1;
BA_ "GenMsgCycleTime" BO_ 615 20;
BA_ "GenMsgCycleTimeFast" BO_ 615 0;
BA_ "GenMsgSendType" BO_ 615 0;
BA_ "VFrameFormat" BO_ 615 14;
BA_ "CANFD_BRS" BO_ 615 1;
BA_ "GenMsgCycleTime" BO_ 615 20;
BA_ "GenMsgCycleTimeFast" BO_ 615 0;
BA_ "GenMsgSendType" BO_ 615 0;
BA_ "VFrameFormat" BO_ 615 14;
BA_ "CANFD_BRS" BO_ 615 1;
BA_ "GenMsgCycleTime" BO_ 615 20;
BA_ "GenMsgCycleTimeFast" BO_ 615 0;
BA_ "GenMsgSendType" BO_ 615 0;
BA_ "VFrameFormat" BO_ 615 14;
BA_ "CANFD_BRS" BO_ 615 1;
BA_ "GenMsgCycleTime" BO_ 615 20;
BA_ "GenMsgCycleTimeFast" BO_ 615 0;
BA_ "GenMsgSendType" BO_ 615 0;
BA_ "VFrameFormat" BO_ 615 14;
BA_ "CANFD_BRS" BO_ 615 1;
BA_ "GenMsgCycleTime" BO_ 615 20;
BA_ "GenMsgCycleTimeFast" BO_ 615 0;
BA_ "GenMsgSendType" BO_ 615 0;
BA_ "VFrameFormat" BO_ 615 14;
BA_ "CANFD_BRS" BO_ 615 1;
BA_ "GenMsgCycleTime" BO_ 615 20;
BA_ "GenMsgCycleTimeFast" BO_ 615 0;
BA_ "GenMsgSendType" BO_ 615 0;
BA_ "VFrameFormat" BO_ 615 14;
BA_ "CANFD_BRS" BO_ 615 1;
BA_ "GenMsgCycleTime" BO_ 615 20;
BA_ "GenMsgCycleTimeFast" BO_ 615 0;
BA_ "GenMsgSendType" BO_ 615 0;
BA_ "VFrameFormat" BO_ 615 14;
BA_ "CANFD_BRS" BO_ 615 1;
BA_ "GenMsgCycleTime" BO_ 615 20;
BA_ "GenMsgCycleTimeFast" BO_ 615 0;
BA_ "GenMsgSendType" BO_ 615 0;
BA_ "VFrameFormat" BO_ 615 14;
BA_ "CANFD_BRS" BO_ 615 1;
BA_ "GenMsgCycleTime" BO_ 615 20;
BA_ "GenMsgCycleTimeFast" BO_ 615 0;
BA_ "GenMsgSendType" BO_ 615 0;
BA_ "VFrameFormat" BO_ 615 14;
BA_ "CANFD_BRS" BO_ 615 1;
BA_ "GenMsgCycleTime" BO_ 352 10;
BA_ "GenMsgCycleTimeFast" BO_ 352 0;
BA_ "GenMsgSendType" BO_ 352 0;
BA_ "VFrameFormat" BO_ 352 14;
BA_ "CANFD_BRS" BO_ 352 1;
BA_ "GenMsgCycleTime" BO_ 352 10;
BA_ "GenMsgCycleTimeFast" BO_ 352 0;
BA_ "GenMsgSendType" BO_ 352 0;
BA_ "VFrameFormat" BO_ 352 14;
BA_ "CANFD_BRS" BO_ 352 1;
BA_ "GenMsgCycleTime" BO_ 352 10;
BA_ "GenMsgCycleTimeFast" BO_ 352 0;
BA_ "GenMsgSendType" BO_ 352 0;
BA_ "VFrameFormat" BO_ 352 14;
BA_ "CANFD_BRS" BO_ 352 1;
BA_ "GenMsgCycleTime" BO_ 352 10;
BA_ "GenMsgCycleTimeFast" BO_ 352 0;
BA_ "GenMsgSendType" BO_ 352 0;
BA_ "VFrameFormat" BO_ 352 14;
BA_ "CANFD_BRS" BO_ 352 1;
BA_ "GenMsgCycleTime" BO_ 352 10;
BA_ "GenMsgCycleTimeFast" BO_ 352 0;
BA_ "GenMsgSendType" BO_ 352 0;
BA_ "VFrameFormat" BO_ 352 14;
BA_ "CANFD_BRS" BO_ 352 1;
BA_ "GenMsgCycleTime" BO_ 352 10;
BA_ "GenMsgCycleTimeFast" BO_ 352 0;
BA_ "GenMsgSendType" BO_ 352 0;
BA_ "VFrameFormat" BO_ 352 14;
BA_ "CANFD_BRS" BO_ 352 1;
BA_ "GenMsgCycleTime" BO_ 352 10;
BA_ "GenMsgCycleTimeFast" BO_ 352 0;
BA_ "GenMsgSendType" BO_ 352 0;
BA_ "VFrameFormat" BO_ 352 14;
BA_ "CANFD_BRS" BO_ 352 1;
BA_ "GenMsgCycleTime" BO_ 352 10;
BA_ "GenMsgCycleTimeFast" BO_ 352 0;
BA_ "GenMsgSendType" BO_ 352 0;
BA_ "VFrameFormat" BO_ 352 14;
BA_ "CANFD_BRS" BO_ 352 1;
BA_ "GenMsgCycleTime" BO_ 352 10;
BA_ "GenMsgCycleTimeFast" BO_ 352 0;
BA_ "GenMsgSendType" BO_ 352 0;
BA_ "VFrameFormat" BO_ 352 14;
BA_ "CANFD_BRS" BO_ 352 1;
BA_ "GenMsgCycleTime" BO_ 352 10;
BA_ "GenMsgCycleTimeFast" BO_ 352 0;
BA_ "GenMsgSendType" BO_ 352 0;
BA_ "VFrameFormat" BO_ 352 14;
BA_ "CANFD_BRS" BO_ 352 1;
BA_ "GenMsgCycleTime" BO_ 352 10;
BA_ "GenMsgCycleTimeFast" BO_ 352 0;
BA_ "GenMsgSendType" BO_ 352 0;
BA_ "VFrameFormat" BO_ 352 14;
BA_ "CANFD_BRS" BO_ 352 1;
BA_ "GenMsgCycleTime" BO_ 352 10;
BA_ "GenMsgCycleTimeFast" BO_ 352 0;
BA_ "GenMsgSendType" BO_ 352 0;
BA_ "VFrameFormat" BO_ 352 14;
BA_ "CANFD_BRS" BO_ 352 1;
BA_ "GenMsgCycleTime" BO_ 352 10;
BA_ "GenMsgCycleTimeFast" BO_ 352 0;
BA_ "GenMsgSendType" BO_ 352 0;
BA_ "VFrameFormat" BO_ 352 14;
BA_ "CANFD_BRS" BO_ 352 1;
BA_ "GenMsgCycleTime" BO_ 352 10;
BA_ "GenMsgCycleTimeFast" BO_ 352 0;
BA_ "GenMsgSendType" BO_ 352 0;
BA_ "VFrameFormat" BO_ 352 14;
BA_ "CANFD_BRS" BO_ 352 1;
BA_ "GenMsgCycleTime" BO_ 352 10;
BA_ "GenMsgCycleTimeFast" BO_ 352 0;
BA_ "GenMsgSendType" BO_ 352 0;
BA_ "VFrameFormat" BO_ 352 14;
BA_ "CANFD_BRS" BO_ 352 1;
BA_ "GenMsgCycleTime" BO_ 352 10;
BA_ "GenMsgCycleTimeFast" BO_ 352 0;
BA_ "GenMsgSendType" BO_ 352 0;
BA_ "VFrameFormat" BO_ 352 14;
BA_ "CANFD_BRS" BO_ 352 1;
BA_ "GenMsgCycleTime" BO_ 352 10;
BA_ "GenMsgCycleTimeFast" BO_ 352 0;
BA_ "GenMsgSendType" BO_ 352 0;
BA_ "VFrameFormat" BO_ 352 14;
BA_ "CANFD_BRS" BO_ 352 1;
BA_ "GenMsgCycleTime" BO_ 352 10;
BA_ "GenMsgCycleTimeFast" BO_ 352 0;
BA_ "GenMsgSendType" BO_ 352 0;
BA_ "VFrameFormat" BO_ 352 14;
BA_ "CANFD_BRS" BO_ 352 1;
BA_ "GenMsgCycleTime" BO_ 352 10;
BA_ "GenMsgCycleTimeFast" BO_ 352 0;
BA_ "GenMsgSendType" BO_ 352 0;
BA_ "VFrameFormat" BO_ 352 14;
BA_ "CANFD_BRS" BO_ 352 1;
BA_ "GenMsgCycleTime" BO_ 352 10;
BA_ "GenMsgCycleTimeFast" BO_ 352 0;
BA_ "GenMsgSendType" BO_ 352 0;
BA_ "VFrameFormat" BO_ 352 14;
BA_ "CANFD_BRS" BO_ 352 1;
BA_ "GenMsgCycleTime" BO_ 352 10;
BA_ "GenMsgCycleTimeFast" BO_ 352 0;
BA_ "GenMsgSendType" BO_ 352 0;
BA_ "VFrameFormat" BO_ 352 14;
BA_ "CANFD_BRS" BO_ 352 1;
BA_ "GenMsgCycleTime" BO_ 352 10;
BA_ "GenMsgCycleTimeFast" BO_ 352 0;
BA_ "GenMsgSendType" BO_ 352 0;
BA_ "VFrameFormat" BO_ 352 14;
BA_ "CANFD_BRS" BO_ 352 1;
BA_ "GenMsgCycleTime" BO_ 352 10;
BA_ "GenMsgCycleTimeFast" BO_ 352 0;
BA_ "GenMsgSendType" BO_ 352 0;
BA_ "VFrameFormat" BO_ 352 14;
BA_ "CANFD_BRS" BO_ 352 1;
BA_ "GenMsgCycleTime" BO_ 352 10;
BA_ "GenMsgCycleTimeFast" BO_ 352 0;
BA_ "GenMsgSendType" BO_ 352 0;
BA_ "VFrameFormat" BO_ 352 14;
BA_ "CANFD_BRS" BO_ 352 1;
BA_ "GenMsgCycleTime" BO_ 352 10;
BA_ "GenMsgCycleTimeFast" BO_ 352 0;
BA_ "GenMsgSendType" BO_ 352 0;
BA_ "VFrameFormat" BO_ 352 14;
BA_ "CANFD_BRS" BO_ 352 1;
BA_ "GenMsgCycleTime" BO_ 352 10;
BA_ "GenMsgCycleTimeFast" BO_ 352 0;
BA_ "GenMsgSendType" BO_ 352 0;
BA_ "VFrameFormat" BO_ 352 14;
BA_ "CANFD_BRS" BO_ 352 1;
BA_ "GenMsgCycleTime" BO_ 352 10;
BA_ "GenMsgCycleTimeFast" BO_ 352 0;
BA_ "GenMsgSendType" BO_ 352 0;
BA_ "VFrameFormat" BO_ 352 14;
BA_ "CANFD_BRS" BO_ 352 1;
BA_ "GenMsgCycleTime" BO_ 352 10;
BA_ "GenMsgCycleTimeFast" BO_ 352 0;
BA_ "GenMsgSendType" BO_ 352 0;
BA_ "VFrameFormat" BO_ 352 14;
BA_ "CANFD_BRS" BO_ 352 1;
BA_ "GenMsgCycleTime" BO_ 352 10;
BA_ "GenMsgCycleTimeFast" BO_ 352 0;
BA_ "GenMsgSendType" BO_ 352 0;
BA_ "VFrameFormat" BO_ 352 14;
BA_ "CANFD_BRS" BO_ 352 1;
BA_ "GenMsgCycleTime" BO_ 352 10;
BA_ "GenMsgCycleTimeFast" BO_ 352 0;
BA_ "GenMsgSendType" BO_ 352 0;
BA_ "VFrameFormat" BO_ 352 14;
BA_ "CANFD_BRS" BO_ 352 1;
BA_ "GenMsgCycleTime" BO_ 352 10;
BA_ "GenMsgCycleTimeFast" BO_ 352 0;
BA_ "GenMsgSendType" BO_ 352 0;
BA_ "VFrameFormat" BO_ 352 14;
BA_ "CANFD_BRS" BO_ 352 1;
BA_ "GenMsgCycleTime" BO_ 352 10;
BA_ "GenMsgCycleTimeFast" BO_ 352 0;
BA_ "GenMsgSendType" BO_ 352 0;
BA_ "VFrameFormat" BO_ 352 14;
BA_ "CANFD_BRS" BO_ 352 1;
BA_ "GenMsgCycleTime" BO_ 352 10;
BA_ "GenMsgCycleTimeFast" BO_ 352 0;
BA_ "GenMsgSendType" BO_ 352 0;
BA_ "VFrameFormat" BO_ 352 14;
BA_ "CANFD_BRS" BO_ 352 1;
BA_ "GenMsgCycleTime" BO_ 352 10;
BA_ "GenMsgCycleTimeFast" BO_ 352 0;
BA_ "GenMsgSendType" BO_ 352 0;
BA_ "VFrameFormat" BO_ 352 14;
BA_ "CANFD_BRS" BO_ 352 1;
BA_ "GenMsgCycleTime" BO_ 352 10;
BA_ "GenMsgCycleTimeFast" BO_ 352 0;
BA_ "GenMsgSendType" BO_ 352 0;
BA_ "VFrameFormat" BO_ 352 14;
BA_ "CANFD_BRS" BO_ 352 1;
BA_ "GenMsgCycleTime" BO_ 352 10;
BA_ "GenMsgCycleTimeFast" BO_ 352 0;
BA_ "GenMsgSendType" BO_ 352 0;
BA_ "VFrameFormat" BO_ 352 14;
BA_ "CANFD_BRS" BO_ 352 1;
BA_ "GenMsgCycleTime" BO_ 352 10;
BA_ "GenMsgCycleTimeFast" BO_ 352 0;
BA_ "GenMsgSendType" BO_ 352 0;
BA_ "VFrameFormat" BO_ 352 14;
BA_ "CANFD_BRS" BO_ 352 1;
BA_ "GenMsgCycleTime" BO_ 352 10;
BA_ "GenMsgCycleTimeFast" BO_ 352 0;
BA_ "GenMsgSendType" BO_ 352 0;
BA_ "VFrameFormat" BO_ 352 14;
BA_ "CANFD_BRS" BO_ 352 1;
BA_ "GenMsgCycleTime" BO_ 352 10;
BA_ "GenMsgCycleTimeFast" BO_ 352 0;
BA_ "GenMsgSendType" BO_ 352 0;
BA_ "VFrameFormat" BO_ 352 14;
BA_ "CANFD_BRS" BO_ 352 1;
BA_ "GenMsgCycleTime" BO_ 352 10;
BA_ "GenMsgCycleTimeFast" BO_ 352 0;
BA_ "GenMsgSendType" BO_ 352 0;
BA_ "VFrameFormat" BO_ 352 14;
BA_ "CANFD_BRS" BO_ 352 1;
BA_ "GenMsgCycleTime" BO_ 352 10;
BA_ "GenMsgCycleTimeFast" BO_ 352 0;
BA_ "GenMsgSendType" BO_ 352 0;
BA_ "VFrameFormat" BO_ 352 14;
BA_ "CANFD_BRS" BO_ 352 1;
BA_ "GenMsgCycleTime" BO_ 352 10;
BA_ "GenMsgCycleTimeFast" BO_ 352 0;
BA_ "GenMsgSendType" BO_ 352 0;
BA_ "VFrameFormat" BO_ 352 14;
BA_ "CANFD_BRS" BO_ 352 1;
BA_ "GenMsgCycleTime" BO_ 352 10;
BA_ "GenMsgCycleTimeFast" BO_ 352 0;
BA_ "GenMsgSendType" BO_ 352 0;
BA_ "VFrameFormat" BO_ 352 14;
BA_ "CANFD_BRS" BO_ 352 1;
BA_ "GenMsgCycleTime" BO_ 352 10;
BA_ "GenMsgCycleTimeFast" BO_ 352 0;
BA_ "GenMsgSendType" BO_ 352 0;
BA_ "VFrameFormat" BO_ 352 14;
BA_ "CANFD_BRS" BO_ 352 1;
BA_ "GenMsgCycleTime" BO_ 352 10;
BA_ "GenMsgCycleTimeFast" BO_ 352 0;
BA_ "GenMsgSendType" BO_ 352 0;
BA_ "VFrameFormat" BO_ 352 14;
BA_ "CANFD_BRS" BO_ 352 1;
BA_ "GenMsgCycleTime" BO_ 352 10;
BA_ "GenMsgCycleTimeFast" BO_ 352 0;
BA_ "GenMsgSendType" BO_ 352 0;
BA_ "VFrameFormat" BO_ 352 14;
BA_ "CANFD_BRS" BO_ 352 1;
BA_ "GenMsgCycleTime" BO_ 352 10;
BA_ "GenMsgCycleTimeFast" BO_ 352 0;
BA_ "GenMsgSendType" BO_ 352 0;
BA_ "VFrameFormat" BO_ 352 14;
BA_ "CANFD_BRS" BO_ 352 1;
BA_ "GenMsgCycleTime" BO_ 352 10;
BA_ "GenMsgCycleTimeFast" BO_ 352 0;
BA_ "GenMsgSendType" BO_ 352 0;
BA_ "VFrameFormat" BO_ 352 14;
BA_ "CANFD_BRS" BO_ 352 1;
BA_ "GenMsgCycleTime" BO_ 352 10;
BA_ "GenMsgCycleTimeFast" BO_ 352 0;
BA_ "GenMsgSendType" BO_ 352 0;
BA_ "VFrameFormat" BO_ 352 14;
BA_ "CANFD_BRS" BO_ 352 1;
BA_ "GenMsgCycleTime" BO_ 352 10;
BA_ "GenMsgCycleTimeFast" BO_ 352 0;
BA_ "GenMsgSendType" BO_ 352 0;
BA_ "VFrameFormat" BO_ 352 14;
BA_ "CANFD_BRS" BO_ 352 1;
BA_ "GenMsgCycleTime" BO_ 352 10;
BA_ "GenMsgCycleTimeFast" BO_ 352 0;
BA_ "GenMsgSendType" BO_ 352 0;
BA_ "VFrameFormat" BO_ 352 14;
BA_ "CANFD_BRS" BO_ 352 1;
BA_ "GenMsgCycleTime" BO_ 352 10;
BA_ "GenMsgCycleTimeFast" BO_ 352 0;
BA_ "GenMsgSendType" BO_ 352 0;
BA_ "VFrameFormat" BO_ 352 14;
BA_ "CANFD_BRS" BO_ 352 1;
BA_ "GenMsgCycleTime" BO_ 611 20;
BA_ "GenMsgCycleTimeFast" BO_ 611 0;
BA_ "GenMsgSendType" BO_ 611 0;
BA_ "VFrameFormat" BO_ 611 14;
BA_ "CANFD_BRS" BO_ 611 1;
BA_ "GenMsgCycleTime" BO_ 611 20;
BA_ "GenMsgCycleTimeFast" BO_ 611 0;
BA_ "GenMsgSendType" BO_ 611 0;
BA_ "VFrameFormat" BO_ 611 14;
BA_ "CANFD_BRS" BO_ 611 1;
BA_ "GenMsgCycleTime" BO_ 611 20;
BA_ "GenMsgCycleTimeFast" BO_ 611 0;
BA_ "GenMsgSendType" BO_ 611 0;
BA_ "VFrameFormat" BO_ 611 14;
BA_ "CANFD_BRS" BO_ 611 1;
BA_ "GenMsgCycleTime" BO_ 611 20;
BA_ "GenMsgCycleTimeFast" BO_ 611 0;
BA_ "GenMsgSendType" BO_ 611 0;
BA_ "VFrameFormat" BO_ 611 14;
BA_ "CANFD_BRS" BO_ 611 1;
BA_ "GenMsgCycleTime" BO_ 611 20;
BA_ "GenMsgCycleTimeFast" BO_ 611 0;
BA_ "GenMsgSendType" BO_ 611 0;
BA_ "VFrameFormat" BO_ 611 14;
BA_ "CANFD_BRS" BO_ 611 1;
BA_ "GenMsgCycleTime" BO_ 611 20;
BA_ "GenMsgCycleTimeFast" BO_ 611 0;
BA_ "GenMsgSendType" BO_ 611 0;
BA_ "VFrameFormat" BO_ 611 14;
BA_ "CANFD_BRS" BO_ 611 1;
BA_ "GenMsgCycleTime" BO_ 611 20;
BA_ "GenMsgCycleTimeFast" BO_ 611 0;
BA_ "GenMsgSendType" BO_ 611 0;
BA_ "VFrameFormat" BO_ 611 14;
BA_ "CANFD_BRS" BO_ 611 1;
BA_ "GenMsgCycleTime" BO_ 611 20;
BA_ "GenMsgCycleTimeFast" BO_ 611 0;
BA_ "GenMsgSendType" BO_ 611 0;
BA_ "VFrameFormat" BO_ 611 14;
BA_ "CANFD_BRS" BO_ 611 1;
BA_ "GenMsgCycleTime" BO_ 611 20;
BA_ "GenMsgCycleTimeFast" BO_ 611 0;
BA_ "GenMsgSendType" BO_ 611 0;
BA_ "VFrameFormat" BO_ 611 14;
BA_ "CANFD_BRS" BO_ 611 1;
BA_ "GenMsgCycleTime" BO_ 611 20;
BA_ "GenMsgCycleTimeFast" BO_ 611 0;
BA_ "GenMsgSendType" BO_ 611 0;
BA_ "VFrameFormat" BO_ 611 14;
BA_ "CANFD_BRS" BO_ 611 1;
BA_ "GenMsgCycleTime" BO_ 611 20;
BA_ "GenMsgCycleTimeFast" BO_ 611 0;
BA_ "GenMsgSendType" BO_ 611 0;
BA_ "VFrameFormat" BO_ 611 14;
BA_ "CANFD_BRS" BO_ 611 1;
BA_ "GenMsgCycleTime" BO_ 611 20;
BA_ "GenMsgCycleTimeFast" BO_ 611 0;
BA_ "GenMsgSendType" BO_ 611 0;
BA_ "VFrameFormat" BO_ 611 14;
BA_ "CANFD_BRS" BO_ 611 1;
BA_ "GenMsgCycleTime" BO_ 611 20;
BA_ "GenMsgCycleTimeFast" BO_ 611 0;
BA_ "GenMsgSendType" BO_ 611 0;
BA_ "VFrameFormat" BO_ 611 14;
BA_ "CANFD_BRS" BO_ 611 1;
BA_ "GenMsgCycleTime" BO_ 611 20;
BA_ "GenMsgCycleTimeFast" BO_ 611 0;
BA_ "GenMsgSendType" BO_ 611 0;
BA_ "VFrameFormat" BO_ 611 14;
BA_ "CANFD_BRS" BO_ 611 1;
BA_ "GenMsgCycleTime" BO_ 611 20;
BA_ "GenMsgCycleTimeFast" BO_ 611 0;
BA_ "GenMsgSendType" BO_ 611 0;
BA_ "VFrameFormat" BO_ 611 14;
BA_ "CANFD_BRS" BO_ 611 1;

BA_ "EventCommandSignal" SG_ 616 CCU_1_CRC 0;
BA_ "GatewayedSignals" SG_ 616 CCU_1_CRC 0;
BA_ "GenSigInactiveValue" SG_ 616 CCU_1_CRC 0;
BA_ "GenSigInvalidValue" SG_ 616 CCU_1_CRC 0;
BA_ "GenSigSendType" SG_ 616 CCU_1_CRC 1;
BA_ "GenSigStartValue" SG_ 616 CCU_1_CRC 0;
BA_ "GenSigTimeoutValue" SG_ 616 CCU_1_CRC 0;
BA_ "Remark" SG_ 616 CCU_1_CRC "";
BA_ "EventCommandSignal" SG_ 616 CCU_1_Counter 0;
BA_ "GatewayedSignals" SG_ 616 CCU_1_Counter 0;
BA_ "GenSigInactiveValue" SG_ 616 CCU_1_Counter 0;
BA_ "GenSigInvalidValue" SG_ 616 CCU_1_Counter 0;
BA_ "GenSigSendType" SG_ 616 CCU_1_Counter 1;
BA_ "GenSigStartValue" SG_ 616 CCU_1_Counter 0;
BA_ "GenSigTimeoutValue" SG_ 616 CCU_1_Counter 0;
BA_ "Remark" SG_ 616 CCU_1_Counter "";
BA_ "EventCommandSignal" SG_ 616 UMM_UsageModeSt 0;
BA_ "GatewayedSignals" SG_ 616 UMM_UsageModeSt 0;
BA_ "GenSigInactiveValue" SG_ 616 UMM_UsageModeSt 0;
BA_ "GenSigInvalidValue" SG_ 616 UMM_UsageModeSt 0;
BA_ "GenSigSendType" SG_ 616 UMM_UsageModeSt 1;
BA_ "GenSigStartValue" SG_ 616 UMM_UsageModeSt 7;
BA_ "GenSigTimeoutValue" SG_ 616 UMM_UsageModeSt 0;
BA_ "Remark" SG_ 616 UMM_UsageModeSt "";
BA_ "EventCommandSignal" SG_ 616 OTA_FuncReq_ADCWakeup 0;
BA_ "GatewayedSignals" SG_ 616 OTA_FuncReq_ADCWakeup 0;
BA_ "GenSigInactiveValue" SG_ 616 OTA_FuncReq_ADCWakeup 0;
BA_ "GenSigInvalidValue" SG_ 616 OTA_FuncReq_ADCWakeup 0;
BA_ "GenSigSendType" SG_ 616 OTA_FuncReq_ADCWakeup 1;
BA_ "GenSigStartValue" SG_ 616 OTA_FuncReq_ADCWakeup 0;
BA_ "GenSigTimeoutValue" SG_ 616 OTA_FuncReq_ADCWakeup 0;
BA_ "Remark" SG_ 616 OTA_FuncReq_ADCWakeup "";
BA_ "EventCommandSignal" SG_ 616 UMM_DriverSeatSt 0;
BA_ "GatewayedSignals" SG_ 616 UMM_DriverSeatSt 0;
BA_ "GenSigInactiveValue" SG_ 616 UMM_DriverSeatSt 0;
BA_ "GenSigInvalidValue" SG_ 616 UMM_DriverSeatSt 0;
BA_ "GenSigSendType" SG_ 616 UMM_DriverSeatSt 1;
BA_ "GenSigStartValue" SG_ 616 UMM_DriverSeatSt 0;
BA_ "GenSigTimeoutValue" SG_ 616 UMM_DriverSeatSt 0;
BA_ "Remark" SG_ 616 UMM_DriverSeatSt "";
BA_ "EventCommandSignal" SG_ 616 UMM_FrontPassengerSeatSt 0;
BA_ "GatewayedSignals" SG_ 616 UMM_FrontPassengerSeatSt 0;
BA_ "GenSigInactiveValue" SG_ 616 UMM_FrontPassengerSeatSt 0;
BA_ "GenSigInvalidValue" SG_ 616 UMM_FrontPassengerSeatSt 0;
BA_ "GenSigSendType" SG_ 616 UMM_FrontPassengerSeatSt 1;
BA_ "GenSigStartValue" SG_ 616 UMM_FrontPassengerSeatSt 0;
BA_ "GenSigTimeoutValue" SG_ 616 UMM_FrontPassengerSeatSt 0;
BA_ "Remark" SG_ 616 UMM_FrontPassengerSeatSt "";
BA_ "EventCommandSignal" SG_ 616 VMM_VehModeSt 0;
BA_ "GatewayedSignals" SG_ 616 VMM_VehModeSt 0;
BA_ "GenSigInactiveValue" SG_ 616 VMM_VehModeSt 0;
BA_ "GenSigInvalidValue" SG_ 616 VMM_VehModeSt 15;
BA_ "GenSigSendType" SG_ 616 VMM_VehModeSt 1;
BA_ "GenSigStartValue" SG_ 616 VMM_VehModeSt 15;
BA_ "GenSigTimeoutValue" SG_ 616 VMM_VehModeSt 15;
BA_ "Remark" SG_ 616 VMM_VehModeSt "";
BA_ "EventCommandSignal" SG_ 616 VMM_LastVehModeSt 0;
BA_ "GatewayedSignals" SG_ 616 VMM_LastVehModeSt 0;
BA_ "GenSigInactiveValue" SG_ 616 VMM_LastVehModeSt 0;
BA_ "GenSigInvalidValue" SG_ 616 VMM_LastVehModeSt 15;
BA_ "GenSigSendType" SG_ 616 VMM_LastVehModeSt 1;
BA_ "GenSigStartValue" SG_ 616 VMM_LastVehModeSt 15;
BA_ "GenSigTimeoutValue" SG_ 616 VMM_LastVehModeSt 15;
BA_ "Remark" SG_ 616 VMM_LastVehModeSt "";
BA_ "EventCommandSignal" SG_ 616 VMM_OTAModeSt 0;
BA_ "GatewayedSignals" SG_ 616 VMM_OTAModeSt 0;
BA_ "GenSigInactiveValue" SG_ 616 VMM_OTAModeSt 0;
BA_ "GenSigInvalidValue" SG_ 616 VMM_OTAModeSt 2;
BA_ "GenSigSendType" SG_ 616 VMM_OTAModeSt 1;
BA_ "GenSigStartValue" SG_ 616 VMM_OTAModeSt 0;
BA_ "GenSigTimeoutValue" SG_ 616 VMM_OTAModeSt 0;
BA_ "Remark" SG_ 616 VMM_OTAModeSt "";
BA_ "EventCommandSignal" SG_ 616 CCU_DstFlag 0;
BA_ "GatewayedSignals" SG_ 616 CCU_DstFlag 0;
BA_ "GenSigInactiveValue" SG_ 616 CCU_DstFlag 0;
BA_ "GenSigInvalidValue" SG_ 616 CCU_DstFlag 0;
BA_ "GenSigSendType" SG_ 616 CCU_DstFlag 1;
BA_ "GenSigStartValue" SG_ 616 CCU_DstFlag 0;
BA_ "GenSigTimeoutValue" SG_ 616 CCU_DstFlag 0;
BA_ "Remark" SG_ 616 CCU_DstFlag "";
BA_ "EventCommandSignal" SG_ 616 CSM_RC_PAARequest 0;
BA_ "GatewayedSignals" SG_ 616 CSM_RC_PAARequest 0;
BA_ "GenSigInactiveValue" SG_ 616 CSM_RC_PAARequest 0;
BA_ "GenSigInvalidValue" SG_ 616 CSM_RC_PAARequest 0;
BA_ "GenSigSendType" SG_ 616 CSM_RC_PAARequest 1;
BA_ "GenSigStartValue" SG_ 616 CSM_RC_PAARequest 0;
BA_ "GenSigTimeoutValue" SG_ 616 CSM_RC_PAARequest 0;
BA_ "Remark" SG_ 616 CSM_RC_PAARequest "";
BA_ "EventCommandSignal" SG_ 616 CSM_RC_AuthSt 0;
BA_ "GatewayedSignals" SG_ 616 CSM_RC_AuthSt 0;
BA_ "GenSigInactiveValue" SG_ 616 CSM_RC_AuthSt 0;
BA_ "GenSigInvalidValue" SG_ 616 CSM_RC_AuthSt 0;
BA_ "GenSigSendType" SG_ 616 CSM_RC_AuthSt 1;
BA_ "GenSigStartValue" SG_ 616 CSM_RC_AuthSt 0;
BA_ "GenSigTimeoutValue" SG_ 616 CSM_RC_AuthSt 0;
BA_ "Remark" SG_ 616 CSM_RC_AuthSt "";
BA_ "EventCommandSignal" SG_ 616 IPDS_EnablePowerSup 0;
BA_ "GatewayedSignals" SG_ 616 IPDS_EnablePowerSup 0;
BA_ "GenSigInactiveValue" SG_ 616 IPDS_EnablePowerSup 0;
BA_ "GenSigInvalidValue" SG_ 616 IPDS_EnablePowerSup 0;
BA_ "GenSigSendType" SG_ 616 IPDS_EnablePowerSup 1;
BA_ "GenSigStartValue" SG_ 616 IPDS_EnablePowerSup 0;
BA_ "GenSigTimeoutValue" SG_ 616 IPDS_EnablePowerSup 0;
BA_ "Remark" SG_ 616 IPDS_EnablePowerSup "";
BA_ "EventCommandSignal" SG_ 616 Time_Year 0;
BA_ "GatewayedSignals" SG_ 616 Time_Year 0;
BA_ "GenSigInactiveValue" SG_ 616 Time_Year 0;
BA_ "GenSigInvalidValue" SG_ 616 Time_Year 0;
BA_ "GenSigSendType" SG_ 616 Time_Year 1;
BA_ "GenSigStartValue" SG_ 616 Time_Year 0;
BA_ "GenSigTimeoutValue" SG_ 616 Time_Year 0;
BA_ "Remark" SG_ 616 Time_Year "";
BA_ "EventCommandSignal" SG_ 616 Time_Month 0;
BA_ "GatewayedSignals" SG_ 616 Time_Month 0;
BA_ "GenSigInactiveValue" SG_ 616 Time_Month 0;
BA_ "GenSigInvalidValue" SG_ 616 Time_Month 0;
BA_ "GenSigSendType" SG_ 616 Time_Month 1;
BA_ "GenSigStartValue" SG_ 616 Time_Month 0;
BA_ "GenSigTimeoutValue" SG_ 616 Time_Month 0;
BA_ "Remark" SG_ 616 Time_Month "";
BA_ "EventCommandSignal" SG_ 616 Time_Day 0;
BA_ "GatewayedSignals" SG_ 616 Time_Day 0;
BA_ "GenSigInactiveValue" SG_ 616 Time_Day 0;
BA_ "GenSigInvalidValue" SG_ 616 Time_Day 0;
BA_ "GenSigSendType" SG_ 616 Time_Day 1;
BA_ "GenSigStartValue" SG_ 616 Time_Day 1;
BA_ "GenSigTimeoutValue" SG_ 616 Time_Day 0;
BA_ "Remark" SG_ 616 Time_Day "";
BA_ "EventCommandSignal" SG_ 616 Time_Hour 0;
BA_ "GatewayedSignals" SG_ 616 Time_Hour 0;
BA_ "GenSigInactiveValue" SG_ 616 Time_Hour 0;
BA_ "GenSigInvalidValue" SG_ 616 Time_Hour 0;
BA_ "GenSigSendType" SG_ 616 Time_Hour 1;
BA_ "GenSigStartValue" SG_ 616 Time_Hour 1;
BA_ "GenSigTimeoutValue" SG_ 616 Time_Hour 0;
BA_ "Remark" SG_ 616 Time_Hour "";
BA_ "EventCommandSignal" SG_ 616 Time_Min 0;
BA_ "GatewayedSignals" SG_ 616 Time_Min 0;
BA_ "GenSigInactiveValue" SG_ 616 Time_Min 0;
BA_ "GenSigInvalidValue" SG_ 616 Time_Min 0;
BA_ "GenSigSendType" SG_ 616 Time_Min 1;
BA_ "GenSigStartValue" SG_ 616 Time_Min 1;
BA_ "GenSigTimeoutValue" SG_ 616 Time_Min 0;
BA_ "Remark" SG_ 616 Time_Min "";
BA_ "EventCommandSignal" SG_ 616 Time_Sec 0;
BA_ "GatewayedSignals" SG_ 616 Time_Sec 0;
BA_ "GenSigInactiveValue" SG_ 616 Time_Sec 0;
BA_ "GenSigInvalidValue" SG_ 616 Time_Sec 0;
BA_ "GenSigSendType" SG_ 616 Time_Sec 1;
BA_ "GenSigStartValue" SG_ 616 Time_Sec 1;
BA_ "GenSigTimeoutValue" SG_ 616 Time_Sec 0;
BA_ "Remark" SG_ 616 Time_Sec "";
BA_ "EventCommandSignal" SG_ 616 ASB_DriverActiveBeltFaultSt 0;
BA_ "GatewayedSignals" SG_ 616 ASB_DriverActiveBeltFaultSt 0;
BA_ "GenSigInactiveValue" SG_ 616 ASB_DriverActiveBeltFaultSt 0;
BA_ "GenSigInvalidValue" SG_ 616 ASB_DriverActiveBeltFaultSt 0;
BA_ "GenSigSendType" SG_ 616 ASB_DriverActiveBeltFaultSt 1;
BA_ "GenSigStartValue" SG_ 616 ASB_DriverActiveBeltFaultSt 0;
BA_ "GenSigTimeoutValue" SG_ 616 ASB_DriverActiveBeltFaultSt 1;
BA_ "Remark" SG_ 616 ASB_DriverActiveBeltFaultSt "";
BA_ "EventCommandSignal" SG_ 909 LCK_HoodAjarSt 0;
BA_ "GatewayedSignals" SG_ 909 LCK_HoodAjarSt 0;
BA_ "GenSigInactiveValue" SG_ 909 LCK_HoodAjarSt 0;
BA_ "GenSigInvalidValue" SG_ 909 LCK_HoodAjarSt 0;
BA_ "GenSigSendType" SG_ 909 LCK_HoodAjarSt 0;
BA_ "GenSigStartValue" SG_ 909 LCK_HoodAjarSt 0;
BA_ "GenSigTimeoutValue" SG_ 909 LCK_HoodAjarSt 0;
BA_ "Remark" SG_ 909 LCK_HoodAjarSt "";
BA_ "EventCommandSignal" SG_ 909 LCK_FrontLeftDoorAjarSt 0;
BA_ "GatewayedSignals" SG_ 909 LCK_FrontLeftDoorAjarSt 0;
BA_ "GenSigInactiveValue" SG_ 909 LCK_FrontLeftDoorAjarSt 0;
BA_ "GenSigInvalidValue" SG_ 909 LCK_FrontLeftDoorAjarSt 0;
BA_ "GenSigSendType" SG_ 909 LCK_FrontLeftDoorAjarSt 0;
BA_ "GenSigStartValue" SG_ 909 LCK_FrontLeftDoorAjarSt 0;
BA_ "GenSigTimeoutValue" SG_ 909 LCK_FrontLeftDoorAjarSt 0;
BA_ "Remark" SG_ 909 LCK_FrontLeftDoorAjarSt "";
BA_ "EventCommandSignal" SG_ 909 LCK_FrontRightDoorAjarSt 0;
BA_ "GatewayedSignals" SG_ 909 LCK_FrontRightDoorAjarSt 0;
BA_ "GenSigInactiveValue" SG_ 909 LCK_FrontRightDoorAjarSt 0;
BA_ "GenSigInvalidValue" SG_ 909 LCK_FrontRightDoorAjarSt 0;
BA_ "GenSigSendType" SG_ 909 LCK_FrontRightDoorAjarSt 0;
BA_ "GenSigStartValue" SG_ 909 LCK_FrontRightDoorAjarSt 0;
BA_ "GenSigTimeoutValue" SG_ 909 LCK_FrontRightDoorAjarSt 0;
BA_ "Remark" SG_ 909 LCK_FrontRightDoorAjarSt "";
BA_ "EventCommandSignal" SG_ 909 LCK_RearLeftDoorAjarSt 0;
BA_ "GatewayedSignals" SG_ 909 LCK_RearLeftDoorAjarSt 0;
BA_ "GenSigInactiveValue" SG_ 909 LCK_RearLeftDoorAjarSt 0;
BA_ "GenSigInvalidValue" SG_ 909 LCK_RearLeftDoorAjarSt 0;
BA_ "GenSigSendType" SG_ 909 LCK_RearLeftDoorAjarSt 0;
BA_ "GenSigStartValue" SG_ 909 LCK_RearLeftDoorAjarSt 0;
BA_ "GenSigTimeoutValue" SG_ 909 LCK_RearLeftDoorAjarSt 0;
BA_ "Remark" SG_ 909 LCK_RearLeftDoorAjarSt "";
BA_ "EventCommandSignal" SG_ 909 LCK_RearRightDoorAjarSt 0;
BA_ "GatewayedSignals" SG_ 909 LCK_RearRightDoorAjarSt 0;
BA_ "GenSigInactiveValue" SG_ 909 LCK_RearRightDoorAjarSt 0;
BA_ "GenSigInvalidValue" SG_ 909 LCK_RearRightDoorAjarSt 0;
BA_ "GenSigSendType" SG_ 909 LCK_RearRightDoorAjarSt 0;
BA_ "GenSigStartValue" SG_ 909 LCK_RearRightDoorAjarSt 0;
BA_ "GenSigTimeoutValue" SG_ 909 LCK_RearRightDoorAjarSt 0;
BA_ "Remark" SG_ 909 LCK_RearRightDoorAjarSt "";
BA_ "EventCommandSignal" SG_ 909 LCK_TrunkAjarSt 0;
BA_ "GatewayedSignals" SG_ 909 LCK_TrunkAjarSt 0;
BA_ "GenSigInactiveValue" SG_ 909 LCK_TrunkAjarSt 0;
BA_ "GenSigInvalidValue" SG_ 909 LCK_TrunkAjarSt 0;
BA_ "GenSigSendType" SG_ 909 LCK_TrunkAjarSt 0;
BA_ "GenSigStartValue" SG_ 909 LCK_TrunkAjarSt 0;
BA_ "GenSigTimeoutValue" SG_ 909 LCK_TrunkAjarSt 0;
BA_ "Remark" SG_ 909 LCK_TrunkAjarSt "";
BA_ "EventCommandSignal" SG_ 909 LCK_FrontLeftDoorLockSt 0;
BA_ "GatewayedSignals" SG_ 909 LCK_FrontLeftDoorLockSt 0;
BA_ "GenSigInactiveValue" SG_ 909 LCK_FrontLeftDoorLockSt 0;
BA_ "GenSigInvalidValue" SG_ 909 LCK_FrontLeftDoorLockSt 0;
BA_ "GenSigSendType" SG_ 909 LCK_FrontLeftDoorLockSt 0;
BA_ "GenSigStartValue" SG_ 909 LCK_FrontLeftDoorLockSt 0;
BA_ "GenSigTimeoutValue" SG_ 909 LCK_FrontLeftDoorLockSt 0;
BA_ "Remark" SG_ 909 LCK_FrontLeftDoorLockSt "";
BA_ "EventCommandSignal" SG_ 909 LCK_FrontRightDoorLockSt 0;
BA_ "GatewayedSignals" SG_ 909 LCK_FrontRightDoorLockSt 0;
BA_ "GenSigInactiveValue" SG_ 909 LCK_FrontRightDoorLockSt 0;
BA_ "GenSigInvalidValue" SG_ 909 LCK_FrontRightDoorLockSt 0;
BA_ "GenSigSendType" SG_ 909 LCK_FrontRightDoorLockSt 0;
BA_ "GenSigStartValue" SG_ 909 LCK_FrontRightDoorLockSt 0;
BA_ "GenSigTimeoutValue" SG_ 909 LCK_FrontRightDoorLockSt 0;
BA_ "Remark" SG_ 909 LCK_FrontRightDoorLockSt "";
BA_ "EventCommandSignal" SG_ 909 LCK_RearLeftDoorLockSt 0;
BA_ "GatewayedSignals" SG_ 909 LCK_RearLeftDoorLockSt 0;
BA_ "GenSigInactiveValue" SG_ 909 LCK_RearLeftDoorLockSt 0;
BA_ "GenSigInvalidValue" SG_ 909 LCK_RearLeftDoorLockSt 0;
BA_ "GenSigSendType" SG_ 909 LCK_RearLeftDoorLockSt 0;
BA_ "GenSigStartValue" SG_ 909 LCK_RearLeftDoorLockSt 0;
BA_ "GenSigTimeoutValue" SG_ 909 LCK_RearLeftDoorLockSt 0;
BA_ "Remark" SG_ 909 LCK_RearLeftDoorLockSt "";
BA_ "EventCommandSignal" SG_ 909 LCK_RearRightDoorLockSt 0;
BA_ "GatewayedSignals" SG_ 909 LCK_RearRightDoorLockSt 0;
BA_ "GenSigInactiveValue" SG_ 909 LCK_RearRightDoorLockSt 0;
BA_ "GenSigInvalidValue" SG_ 909 LCK_RearRightDoorLockSt 0;
BA_ "GenSigSendType" SG_ 909 LCK_RearRightDoorLockSt 0;
BA_ "GenSigStartValue" SG_ 909 LCK_RearRightDoorLockSt 0;
BA_ "GenSigTimeoutValue" SG_ 909 LCK_RearRightDoorLockSt 0;
BA_ "Remark" SG_ 909 LCK_RearRightDoorLockSt "";
BA_ "EventCommandSignal" SG_ 909 LCK_RearLeftChildSaftyLockSt 0;
BA_ "GatewayedSignals" SG_ 909 LCK_RearLeftChildSaftyLockSt 0;
BA_ "GenSigInactiveValue" SG_ 909 LCK_RearLeftChildSaftyLockSt 0;
BA_ "GenSigInvalidValue" SG_ 909 LCK_RearLeftChildSaftyLockSt 0;
BA_ "GenSigSendType" SG_ 909 LCK_RearLeftChildSaftyLockSt 0;
BA_ "GenSigStartValue" SG_ 909 LCK_RearLeftChildSaftyLockSt 0;
BA_ "GenSigTimeoutValue" SG_ 909 LCK_RearLeftChildSaftyLockSt 0;
BA_ "Remark" SG_ 909 LCK_RearLeftChildSaftyLockSt "";
BA_ "EventCommandSignal" SG_ 909 LCK_RearRightChildSaftyLockSt 0;
BA_ "GatewayedSignals" SG_ 909 LCK_RearRightChildSaftyLockSt 0;
BA_ "GenSigInactiveValue" SG_ 909 LCK_RearRightChildSaftyLockSt 0;
BA_ "GenSigInvalidValue" SG_ 909 LCK_RearRightChildSaftyLockSt 0;
BA_ "GenSigSendType" SG_ 909 LCK_RearRightChildSaftyLockSt 0;
BA_ "GenSigStartValue" SG_ 909 LCK_RearRightChildSaftyLockSt 0;
BA_ "GenSigTimeoutValue" SG_ 909 LCK_RearRightChildSaftyLockSt 0;
BA_ "Remark" SG_ 909 LCK_RearRightChildSaftyLockSt "";
BA_ "EventCommandSignal" SG_ 909 LCK_FrontLeftDoorHandlePosition 0;
BA_ "GatewayedSignals" SG_ 909 LCK_FrontLeftDoorHandlePosition 0;
BA_ "GenSigInactiveValue" SG_ 909 LCK_FrontLeftDoorHandlePosition 0;
BA_ "GenSigInvalidValue" SG_ 909 LCK_FrontLeftDoorHandlePosition 255;
BA_ "GenSigSendType" SG_ 909 LCK_FrontLeftDoorHandlePosition 0;
BA_ "GenSigStartValue" SG_ 909 LCK_FrontLeftDoorHandlePosition 0;
BA_ "GenSigTimeoutValue" SG_ 909 LCK_FrontLeftDoorHandlePosition 0;
BA_ "Remark" SG_ 909 LCK_FrontLeftDoorHandlePosition "";
BA_ "EventCommandSignal" SG_ 909 LCK_FrontRightDoorHandlePosition 0;
BA_ "GatewayedSignals" SG_ 909 LCK_FrontRightDoorHandlePosition 0;
BA_ "GenSigInactiveValue" SG_ 909 LCK_FrontRightDoorHandlePosition 0;
BA_ "GenSigInvalidValue" SG_ 909 LCK_FrontRightDoorHandlePosition 255;
BA_ "GenSigSendType" SG_ 909 LCK_FrontRightDoorHandlePosition 0;
BA_ "GenSigStartValue" SG_ 909 LCK_FrontRightDoorHandlePosition 0;
BA_ "GenSigTimeoutValue" SG_ 909 LCK_FrontRightDoorHandlePosition 0;
BA_ "Remark" SG_ 909 LCK_FrontRightDoorHandlePosition "";
BA_ "EventCommandSignal" SG_ 909 LCK_RearLeftDoorHandlePosition 0;
BA_ "GatewayedSignals" SG_ 909 LCK_RearLeftDoorHandlePosition 0;
BA_ "GenSigInactiveValue" SG_ 909 LCK_RearLeftDoorHandlePosition 0;
BA_ "GenSigInvalidValue" SG_ 909 LCK_RearLeftDoorHandlePosition 255;
BA_ "GenSigSendType" SG_ 909 LCK_RearLeftDoorHandlePosition 0;
BA_ "GenSigStartValue" SG_ 909 LCK_RearLeftDoorHandlePosition 0;
BA_ "GenSigTimeoutValue" SG_ 909 LCK_RearLeftDoorHandlePosition 0;
BA_ "Remark" SG_ 909 LCK_RearLeftDoorHandlePosition "";
BA_ "EventCommandSignal" SG_ 909 LCK_RearRightDoorHandlePosition 0;
BA_ "GatewayedSignals" SG_ 909 LCK_RearRightDoorHandlePosition 0;
BA_ "GenSigInactiveValue" SG_ 909 LCK_RearRightDoorHandlePosition 0;
BA_ "GenSigInvalidValue" SG_ 909 LCK_RearRightDoorHandlePosition 255;
BA_ "GenSigSendType" SG_ 909 LCK_RearRightDoorHandlePosition 0;
BA_ "GenSigStartValue" SG_ 909 LCK_RearRightDoorHandlePosition 0;
BA_ "GenSigTimeoutValue" SG_ 909 LCK_RearRightDoorHandlePosition 0;
BA_ "Remark" SG_ 909 LCK_RearRightDoorHandlePosition "";
BA_ "EventCommandSignal" SG_ 909 LCK_FillerCapASt 0;
BA_ "GatewayedSignals" SG_ 909 LCK_FillerCapASt 0;
BA_ "GenSigInactiveValue" SG_ 909 LCK_FillerCapASt 0;
BA_ "GenSigInvalidValue" SG_ 909 LCK_FillerCapASt 0;
BA_ "GenSigSendType" SG_ 909 LCK_FillerCapASt 0;
BA_ "GenSigStartValue" SG_ 909 LCK_FillerCapASt 0;
BA_ "GenSigTimeoutValue" SG_ 909 LCK_FillerCapASt 0;
BA_ "Remark" SG_ 909 LCK_FillerCapASt "";
BA_ "EventCommandSignal" SG_ 909 LCK_FillerCapBSt 0;
BA_ "GatewayedSignals" SG_ 909 LCK_FillerCapBSt 0;
BA_ "GenSigInactiveValue" SG_ 909 LCK_FillerCapBSt 0;
BA_ "GenSigInvalidValue" SG_ 909 LCK_FillerCapBSt 0;
BA_ "GenSigSendType" SG_ 909 LCK_FillerCapBSt 0;
BA_ "GenSigStartValue" SG_ 909 LCK_FillerCapBSt 0;
BA_ "GenSigTimeoutValue" SG_ 909 LCK_FillerCapBSt 0;
BA_ "Remark" SG_ 909 LCK_FillerCapBSt "";
BA_ "EventCommandSignal" SG_ 909 MR_LeftMirrorFoldUnfoldSt 0;
BA_ "GatewayedSignals" SG_ 909 MR_LeftMirrorFoldUnfoldSt 0;
BA_ "GenSigInactiveValue" SG_ 909 MR_LeftMirrorFoldUnfoldSt 0;
BA_ "GenSigInvalidValue" SG_ 909 MR_LeftMirrorFoldUnfoldSt 0;
BA_ "GenSigSendType" SG_ 909 MR_LeftMirrorFoldUnfoldSt 1;
BA_ "GenSigStartValue" SG_ 909 MR_LeftMirrorFoldUnfoldSt 0;
BA_ "GenSigTimeoutValue" SG_ 909 MR_LeftMirrorFoldUnfoldSt 0;
BA_ "Remark" SG_ 909 MR_LeftMirrorFoldUnfoldSt "";
BA_ "EventCommandSignal" SG_ 909 SBM_SwapHvBattModeSt 0;
BA_ "GatewayedSignals" SG_ 909 SBM_SwapHvBattModeSt 0;
BA_ "GenSigInactiveValue" SG_ 909 SBM_SwapHvBattModeSt 0;
BA_ "GenSigInvalidValue" SG_ 909 SBM_SwapHvBattModeSt 0;
BA_ "GenSigSendType" SG_ 909 SBM_SwapHvBattModeSt 1;
BA_ "GenSigStartValue" SG_ 909 SBM_SwapHvBattModeSt 0;
BA_ "GenSigTimeoutValue" SG_ 909 SBM_SwapHvBattModeSt 0;
BA_ "Remark" SG_ 909 SBM_SwapHvBattModeSt "";
BA_ "EventCommandSignal" SG_ 909 SBM_SwapStaDiagCode 0;
BA_ "GatewayedSignals" SG_ 909 SBM_SwapStaDiagCode 0;
BA_ "GenSigInactiveValue" SG_ 909 SBM_SwapStaDiagCode 0;
BA_ "GenSigInvalidValue" SG_ 909 SBM_SwapStaDiagCode 0;
BA_ "GenSigSendType" SG_ 909 SBM_SwapStaDiagCode 1;
BA_ "GenSigStartValue" SG_ 909 SBM_SwapStaDiagCode 0;
BA_ "GenSigTimeoutValue" SG_ 909 SBM_SwapStaDiagCode 0;
BA_ "Remark" SG_ 909 SBM_SwapStaDiagCode "";
BA_ "EventCommandSignal" SG_ 909 SBM_SwapVehDiagCode 0;
BA_ "GatewayedSignals" SG_ 909 SBM_SwapVehDiagCode 0;
BA_ "GenSigInactiveValue" SG_ 909 SBM_SwapVehDiagCode 0;
BA_ "GenSigInvalidValue" SG_ 909 SBM_SwapVehDiagCode 0;
BA_ "GenSigSendType" SG_ 909 SBM_SwapVehDiagCode 1;
BA_ "GenSigStartValue" SG_ 909 SBM_SwapVehDiagCode 0;
BA_ "GenSigTimeoutValue" SG_ 909 SBM_SwapVehDiagCode 0;
BA_ "Remark" SG_ 909 SBM_SwapVehDiagCode "";
BA_ "EventCommandSignal" SG_ 909 SBM_SwapHvBattModeFaultSt 0;
BA_ "GatewayedSignals" SG_ 909 SBM_SwapHvBattModeFaultSt 0;
BA_ "GenSigInactiveValue" SG_ 909 SBM_SwapHvBattModeFaultSt 0;
BA_ "GenSigInvalidValue" SG_ 909 SBM_SwapHvBattModeFaultSt 0;
BA_ "GenSigSendType" SG_ 909 SBM_SwapHvBattModeFaultSt 1;
BA_ "GenSigStartValue" SG_ 909 SBM_SwapHvBattModeFaultSt 0;
BA_ "GenSigTimeoutValue" SG_ 909 SBM_SwapHvBattModeFaultSt 0;
BA_ "Remark" SG_ 909 SBM_SwapHvBattModeFaultSt "";
BA_ "EventCommandSignal" SG_ 909 POD_CurDoorPosFL 0;
BA_ "GatewayedSignals" SG_ 909 POD_CurDoorPosFL 0;
BA_ "GenSigInactiveValue" SG_ 909 POD_CurDoorPosFL 0;
BA_ "GenSigInvalidValue" SG_ 909 POD_CurDoorPosFL 0;
BA_ "GenSigSendType" SG_ 909 POD_CurDoorPosFL 1;
BA_ "GenSigStartValue" SG_ 909 POD_CurDoorPosFL 0;
BA_ "GenSigTimeoutValue" SG_ 909 POD_CurDoorPosFL 0;
BA_ "Remark" SG_ 909 POD_CurDoorPosFL "";
BA_ "EventCommandSignal" SG_ 909 IPDS_HDMapPowerSt 0;
BA_ "GatewayedSignals" SG_ 909 IPDS_HDMapPowerSt 0;
BA_ "GenSigInactiveValue" SG_ 909 IPDS_HDMapPowerSt 0;
BA_ "GenSigInvalidValue" SG_ 909 IPDS_HDMapPowerSt 0;
BA_ "GenSigSendType" SG_ 909 IPDS_HDMapPowerSt 1;
BA_ "GenSigStartValue" SG_ 909 IPDS_HDMapPowerSt 0;
BA_ "GenSigTimeoutValue" SG_ 909 IPDS_HDMapPowerSt 0;
BA_ "Remark" SG_ 909 IPDS_HDMapPowerSt "";
BA_ "EventCommandSignal" SG_ 909 IPDS_KL15L1PowerSt 0;
BA_ "GatewayedSignals" SG_ 909 IPDS_KL15L1PowerSt 0;
BA_ "GenSigInactiveValue" SG_ 909 IPDS_KL15L1PowerSt 0;
BA_ "GenSigInvalidValue" SG_ 909 IPDS_KL15L1PowerSt 0;
BA_ "GenSigSendType" SG_ 909 IPDS_KL15L1PowerSt 1;
BA_ "GenSigStartValue" SG_ 909 IPDS_KL15L1PowerSt 0;
BA_ "GenSigTimeoutValue" SG_ 909 IPDS_KL15L1PowerSt 0;
BA_ "Remark" SG_ 909 IPDS_KL15L1PowerSt "";
BA_ "EventCommandSignal" SG_ 909 IPDS_SRSECUPowerSt 0;
BA_ "GatewayedSignals" SG_ 909 IPDS_SRSECUPowerSt 0;
BA_ "GenSigInactiveValue" SG_ 909 IPDS_SRSECUPowerSt 0;
BA_ "GenSigInvalidValue" SG_ 909 IPDS_SRSECUPowerSt 0;
BA_ "GenSigSendType" SG_ 909 IPDS_SRSECUPowerSt 1;
BA_ "GenSigStartValue" SG_ 909 IPDS_SRSECUPowerSt 0;
BA_ "GenSigTimeoutValue" SG_ 909 IPDS_SRSECUPowerSt 0;
BA_ "Remark" SG_ 909 IPDS_SRSECUPowerSt "";
BA_ "EventCommandSignal" SG_ 909 IPDS_HODPowerSt 0;
BA_ "GatewayedSignals" SG_ 909 IPDS_HODPowerSt 0;
BA_ "GenSigInactiveValue" SG_ 909 IPDS_HODPowerSt 0;
BA_ "GenSigInvalidValue" SG_ 909 IPDS_HODPowerSt 0;
BA_ "GenSigSendType" SG_ 909 IPDS_HODPowerSt 1;
BA_ "GenSigStartValue" SG_ 909 IPDS_HODPowerSt 0;
BA_ "GenSigTimeoutValue" SG_ 909 IPDS_HODPowerSt 0;
BA_ "Remark" SG_ 909 IPDS_HODPowerSt "";
BA_ "EventCommandSignal" SG_ 909 KAE_BLEOption 0;
BA_ "GatewayedSignals" SG_ 909 KAE_BLEOption 0;
BA_ "GenSigInactiveValue" SG_ 909 KAE_BLEOption 0;
BA_ "GenSigInvalidValue" SG_ 909 KAE_BLEOption 0;
BA_ "GenSigSendType" SG_ 909 KAE_BLEOption 1;
BA_ "GenSigStartValue" SG_ 909 KAE_BLEOption 0;
BA_ "GenSigTimeoutValue" SG_ 909 KAE_BLEOption 0;
BA_ "Remark" SG_ 909 KAE_BLEOption "";
BA_ "EventCommandSignal" SG_ 909 KAE_UWBOption 0;
BA_ "GatewayedSignals" SG_ 909 KAE_UWBOption 0;
BA_ "GenSigInactiveValue" SG_ 909 KAE_UWBOption 0;
BA_ "GenSigInvalidValue" SG_ 909 KAE_UWBOption 0;
BA_ "GenSigSendType" SG_ 909 KAE_UWBOption 1;
BA_ "GenSigStartValue" SG_ 909 KAE_UWBOption 0;
BA_ "GenSigTimeoutValue" SG_ 909 KAE_UWBOption 0;
BA_ "Remark" SG_ 909 KAE_UWBOption "";
BA_ "EventCommandSignal" SG_ 909 WW_RWPMotorSt 0;
BA_ "GatewayedSignals" SG_ 909 WW_RWPMotorSt 0;
BA_ "GenSigInactiveValue" SG_ 909 WW_RWPMotorSt 0;
BA_ "GenSigInvalidValue" SG_ 909 WW_RWPMotorSt 0;
BA_ "GenSigSendType" SG_ 909 WW_RWPMotorSt 1;
BA_ "GenSigStartValue" SG_ 909 WW_RWPMotorSt 0;
BA_ "GenSigTimeoutValue" SG_ 909 WW_RWPMotorSt 0;
BA_ "Remark" SG_ 909 WW_RWPMotorSt "";
BA_ "EventCommandSignal" SG_ 909 ACEleclocksSt 0;
BA_ "GatewayedSignals" SG_ 909 ACEleclocksSt 0;
BA_ "GenSigInactiveValue" SG_ 909 ACEleclocksSt 0;
BA_ "GenSigInvalidValue" SG_ 909 ACEleclocksSt 0;
BA_ "GenSigSendType" SG_ 909 ACEleclocksSt 1;
BA_ "GenSigStartValue" SG_ 909 ACEleclocksSt 0;
BA_ "GenSigTimeoutValue" SG_ 909 ACEleclocksSt 0;
BA_ "Remark" SG_ 909 ACEleclocksSt "";
BA_ "EventCommandSignal" SG_ 909 WCM_Reminder 0;
BA_ "GatewayedSignals" SG_ 909 WCM_Reminder 0;
BA_ "GenSigInactiveValue" SG_ 909 WCM_Reminder 0;
BA_ "GenSigInvalidValue" SG_ 909 WCM_Reminder 0;
BA_ "GenSigSendType" SG_ 909 WCM_Reminder 1;
BA_ "GenSigStartValue" SG_ 909 WCM_Reminder 0;
BA_ "GenSigTimeoutValue" SG_ 909 WCM_Reminder 0;
BA_ "Remark" SG_ 909 WCM_Reminder "";
BA_ "EventCommandSignal" SG_ 909 WCM_ChargingSt 0;
BA_ "GatewayedSignals" SG_ 909 WCM_ChargingSt 0;
BA_ "GenSigInactiveValue" SG_ 909 WCM_ChargingSt 0;
BA_ "GenSigInvalidValue" SG_ 909 WCM_ChargingSt 0;
BA_ "GenSigSendType" SG_ 909 WCM_ChargingSt 1;
BA_ "GenSigStartValue" SG_ 909 WCM_ChargingSt 0;
BA_ "GenSigTimeoutValue" SG_ 909 WCM_ChargingSt 0;
BA_ "Remark" SG_ 909 WCM_ChargingSt "";
BA_ "EventCommandSignal" SG_ 909 AVAS_ActivatedSt 0;
BA_ "GatewayedSignals" SG_ 909 AVAS_ActivatedSt 0;
BA_ "GenSigInactiveValue" SG_ 909 AVAS_ActivatedSt 0;
BA_ "GenSigInvalidValue" SG_ 909 AVAS_ActivatedSt 0;
BA_ "GenSigSendType" SG_ 909 AVAS_ActivatedSt 1;
BA_ "GenSigStartValue" SG_ 909 AVAS_ActivatedSt 0;
BA_ "GenSigTimeoutValue" SG_ 909 AVAS_ActivatedSt 0;
BA_ "Remark" SG_ 909 AVAS_ActivatedSt "";
BA_ "EventCommandSignal" SG_ 909 PWL_WinCurrentPos_FLWinPst 0;
BA_ "GatewayedSignals" SG_ 909 PWL_WinCurrentPos_FLWinPst 0;
BA_ "GenSigInactiveValue" SG_ 909 PWL_WinCurrentPos_FLWinPst 0;
BA_ "GenSigInvalidValue" SG_ 909 PWL_WinCurrentPos_FLWinPst 0;
BA_ "GenSigSendType" SG_ 909 PWL_WinCurrentPos_FLWinPst 1;
BA_ "GenSigStartValue" SG_ 909 PWL_WinCurrentPos_FLWinPst 255;
BA_ "GenSigTimeoutValue" SG_ 909 PWL_WinCurrentPos_FLWinPst 0;
BA_ "Remark" SG_ 909 PWL_WinCurrentPos_FLWinPst "";
BA_ "EventCommandSignal" SG_ 909 UINM_FrontLeftPowerReleaseReq 0;
BA_ "GatewayedSignals" SG_ 909 UINM_FrontLeftPowerReleaseReq 0;
BA_ "GenSigInactiveValue" SG_ 909 UINM_FrontLeftPowerReleaseReq 0;
BA_ "GenSigInvalidValue" SG_ 909 UINM_FrontLeftPowerReleaseReq 0;
BA_ "GenSigSendType" SG_ 909 UINM_FrontLeftPowerReleaseReq 1;
BA_ "GenSigStartValue" SG_ 909 UINM_FrontLeftPowerReleaseReq 0;
BA_ "GenSigTimeoutValue" SG_ 909 UINM_FrontLeftPowerReleaseReq 0;
BA_ "Remark" SG_ 909 UINM_FrontLeftPowerReleaseReq "";
BA_ "EventCommandSignal" SG_ 909 UINM_FrontLeftPowerReleaseFaultSt 0;
BA_ "GatewayedSignals" SG_ 909 UINM_FrontLeftPowerReleaseFaultSt 0;
BA_ "GenSigInactiveValue" SG_ 909 UINM_FrontLeftPowerReleaseFaultSt 0;
BA_ "GenSigInvalidValue" SG_ 909 UINM_FrontLeftPowerReleaseFaultSt 0;
BA_ "GenSigSendType" SG_ 909 UINM_FrontLeftPowerReleaseFaultSt 1;
BA_ "GenSigStartValue" SG_ 909 UINM_FrontLeftPowerReleaseFaultSt 0;
BA_ "GenSigTimeoutValue" SG_ 909 UINM_FrontLeftPowerReleaseFaultSt 0;
BA_ "Remark" SG_ 909 UINM_FrontLeftPowerReleaseFaultSt "";
BA_ "EventCommandSignal" SG_ 909 UINM_FrontRightPowerReleaseReq 0;
BA_ "GatewayedSignals" SG_ 909 UINM_FrontRightPowerReleaseReq 0;
BA_ "GenSigInactiveValue" SG_ 909 UINM_FrontRightPowerReleaseReq 0;
BA_ "GenSigInvalidValue" SG_ 909 UINM_FrontRightPowerReleaseReq 0;
BA_ "GenSigSendType" SG_ 909 UINM_FrontRightPowerReleaseReq 1;
BA_ "GenSigStartValue" SG_ 909 UINM_FrontRightPowerReleaseReq 0;
BA_ "GenSigTimeoutValue" SG_ 909 UINM_FrontRightPowerReleaseReq 0;
BA_ "Remark" SG_ 909 UINM_FrontRightPowerReleaseReq "";
BA_ "EventCommandSignal" SG_ 909 UINM_FrontRightPowerReleaseFaultSt 0;
BA_ "GatewayedSignals" SG_ 909 UINM_FrontRightPowerReleaseFaultSt 0;
BA_ "GenSigInactiveValue" SG_ 909 UINM_FrontRightPowerReleaseFaultSt 0;
BA_ "GenSigInvalidValue" SG_ 909 UINM_FrontRightPowerReleaseFaultSt 0;
BA_ "GenSigSendType" SG_ 909 UINM_FrontRightPowerReleaseFaultSt 1;
BA_ "GenSigStartValue" SG_ 909 UINM_FrontRightPowerReleaseFaultSt 0;
BA_ "GenSigTimeoutValue" SG_ 909 UINM_FrontRightPowerReleaseFaultSt 0;
BA_ "Remark" SG_ 909 UINM_FrontRightPowerReleaseFaultSt "";
BA_ "EventCommandSignal" SG_ 909 UINM_RearLeftPowerReleaseFaultSt 0;
BA_ "GatewayedSignals" SG_ 909 UINM_RearLeftPowerReleaseFaultSt 0;
BA_ "GenSigInactiveValue" SG_ 909 UINM_RearLeftPowerReleaseFaultSt 0;
BA_ "GenSigInvalidValue" SG_ 909 UINM_RearLeftPowerReleaseFaultSt 0;
BA_ "GenSigSendType" SG_ 909 UINM_RearLeftPowerReleaseFaultSt 1;
BA_ "GenSigStartValue" SG_ 909 UINM_RearLeftPowerReleaseFaultSt 0;
BA_ "GenSigTimeoutValue" SG_ 909 UINM_RearLeftPowerReleaseFaultSt 0;
BA_ "Remark" SG_ 909 UINM_RearLeftPowerReleaseFaultSt "";
BA_ "EventCommandSignal" SG_ 909 UINM_RearLeftPowerReleaseReq 0;
BA_ "GatewayedSignals" SG_ 909 UINM_RearLeftPowerReleaseReq 0;
BA_ "GenSigInactiveValue" SG_ 909 UINM_RearLeftPowerReleaseReq 0;
BA_ "GenSigInvalidValue" SG_ 909 UINM_RearLeftPowerReleaseReq 0;
BA_ "GenSigSendType" SG_ 909 UINM_RearLeftPowerReleaseReq 1;
BA_ "GenSigStartValue" SG_ 909 UINM_RearLeftPowerReleaseReq 0;
BA_ "GenSigTimeoutValue" SG_ 909 UINM_RearLeftPowerReleaseReq 0;
BA_ "Remark" SG_ 909 UINM_RearLeftPowerReleaseReq "";
BA_ "EventCommandSignal" SG_ 909 UINM_RearRightPowerReleaseFaultSt 0;
BA_ "GatewayedSignals" SG_ 909 UINM_RearRightPowerReleaseFaultSt 0;
BA_ "GenSigInactiveValue" SG_ 909 UINM_RearRightPowerReleaseFaultSt 0;
BA_ "GenSigInvalidValue" SG_ 909 UINM_RearRightPowerReleaseFaultSt 0;
BA_ "GenSigSendType" SG_ 909 UINM_RearRightPowerReleaseFaultSt 1;
BA_ "GenSigStartValue" SG_ 909 UINM_RearRightPowerReleaseFaultSt 0;
BA_ "GenSigTimeoutValue" SG_ 909 UINM_RearRightPowerReleaseFaultSt 0;
BA_ "Remark" SG_ 909 UINM_RearRightPowerReleaseFaultSt "";
BA_ "EventCommandSignal" SG_ 909 UINM_RearRightPowerReleaseReq 0;
BA_ "GatewayedSignals" SG_ 909 UINM_RearRightPowerReleaseReq 0;
BA_ "GenSigInactiveValue" SG_ 909 UINM_RearRightPowerReleaseReq 0;
BA_ "GenSigInvalidValue" SG_ 909 UINM_RearRightPowerReleaseReq 0;
BA_ "GenSigSendType" SG_ 909 UINM_RearRightPowerReleaseReq 1;
BA_ "GenSigStartValue" SG_ 909 UINM_RearRightPowerReleaseReq 0;
BA_ "GenSigTimeoutValue" SG_ 909 UINM_RearRightPowerReleaseReq 0;
BA_ "Remark" SG_ 909 UINM_RearRightPowerReleaseReq "";
BA_ "EventCommandSignal" SG_ 909 PWL_WinCurrentPos_RRWinPst 0;
BA_ "GatewayedSignals" SG_ 909 PWL_WinCurrentPos_RRWinPst 0;
BA_ "GenSigInactiveValue" SG_ 909 PWL_WinCurrentPos_RRWinPst 0;
BA_ "GenSigInvalidValue" SG_ 909 PWL_WinCurrentPos_RRWinPst 0;
BA_ "GenSigSendType" SG_ 909 PWL_WinCurrentPos_RRWinPst 1;
BA_ "GenSigStartValue" SG_ 909 PWL_WinCurrentPos_RRWinPst 255;
BA_ "GenSigTimeoutValue" SG_ 909 PWL_WinCurrentPos_RRWinPst 0;
BA_ "Remark" SG_ 909 PWL_WinCurrentPos_RRWinPst "";
BA_ "EventCommandSignal" SG_ 909 PWL_WinCurrentPos_RLWinPst 0;
BA_ "GatewayedSignals" SG_ 909 PWL_WinCurrentPos_RLWinPst 0;
BA_ "GenSigInactiveValue" SG_ 909 PWL_WinCurrentPos_RLWinPst 0;
BA_ "GenSigInvalidValue" SG_ 909 PWL_WinCurrentPos_RLWinPst 0;
BA_ "GenSigSendType" SG_ 909 PWL_WinCurrentPos_RLWinPst 1;
BA_ "GenSigStartValue" SG_ 909 PWL_WinCurrentPos_RLWinPst 255;
BA_ "GenSigTimeoutValue" SG_ 909 PWL_WinCurrentPos_RLWinPst 0;
BA_ "Remark" SG_ 909 PWL_WinCurrentPos_RLWinPst "";
BA_ "EventCommandSignal" SG_ 905 ICM_SetIACCSt 0;
BA_ "GatewayedSignals" SG_ 905 ICM_SetIACCSt 0;
BA_ "GenSigInactiveValue" SG_ 905 ICM_SetIACCSt 0;
BA_ "GenSigInvalidValue" SG_ 905 ICM_SetIACCSt 0;
BA_ "GenSigSendType" SG_ 905 ICM_SetIACCSt 1;
BA_ "GenSigStartValue" SG_ 905 ICM_SetIACCSt 0;
BA_ "GenSigTimeoutValue" SG_ 905 ICM_SetIACCSt 0;
BA_ "Remark" SG_ 905 ICM_SetIACCSt "";
BA_ "EventCommandSignal" SG_ 905 ICM_TotalOdometer 0;
BA_ "GatewayedSignals" SG_ 905 ICM_TotalOdometer 0;
BA_ "GenSigInactiveValue" SG_ 905 ICM_TotalOdometer 0;
BA_ "GenSigInvalidValue" SG_ 905 ICM_TotalOdometer 0;
BA_ "GenSigSendType" SG_ 905 ICM_TotalOdometer 1;
BA_ "GenSigStartValue" SG_ 905 ICM_TotalOdometer 0;
BA_ "EventCommandSignal" SG_ 905 ICM_VehInsSpd 0;
BA_ "GatewayedSignals" SG_ 905 ICM_VehInsSpd 0;
BA_ "GenSigInactiveValue" SG_ 905 ICM_VehInsSpd 0;
BA_ "GenSigInvalidValue" SG_ 905 ICM_VehInsSpd 255;
BA_ "GenSigSendType" SG_ 905 ICM_VehInsSpd 1;
BA_ "GenSigStartValue" SG_ 905 ICM_VehInsSpd 0;
BA_ "GenSigTimeoutValue" SG_ 905 ICM_VehInsSpd 0;
BA_ "Remark" SG_ 905 ICM_VehInsSpd "";
BA_ "EventCommandSignal" SG_ 905 ICM_VehInsSpd_accurate 0;
BA_ "GatewayedSignals" SG_ 905 ICM_VehInsSpd_accurate 0;
BA_ "GenSigInactiveValue" SG_ 905 ICM_VehInsSpd_accurate 0;
BA_ "GenSigInvalidValue" SG_ 905 ICM_VehInsSpd_accurate 2047;
BA_ "GenSigSendType" SG_ 905 ICM_VehInsSpd_accurate 1;
BA_ "GenSigStartValue" SG_ 905 ICM_VehInsSpd_accurate 0;
BA_ "GenSigTimeoutValue" SG_ 905 ICM_VehInsSpd_accurate 0;
BA_ "Remark" SG_ 905 ICM_VehInsSpd_accurate "";
BA_ "EventCommandSignal" SG_ 905 ICM_FuelAvaibleDriveDistance 0;
BA_ "GatewayedSignals" SG_ 905 ICM_FuelAvaibleDriveDistance 0;
BA_ "GenSigInactiveValue" SG_ 905 ICM_FuelAvaibleDriveDistance 0;
BA_ "GenSigInvalidValue" SG_ 905 ICM_FuelAvaibleDriveDistance 2047;
BA_ "GenSigSendType" SG_ 905 ICM_FuelAvaibleDriveDistance 1;
BA_ "GenSigStartValue" SG_ 905 ICM_FuelAvaibleDriveDistance 0;
BA_ "GenSigTimeoutValue" SG_ 905 ICM_FuelAvaibleDriveDistance 0;
BA_ "Remark" SG_ 905 ICM_FuelAvaibleDriveDistance "";
BA_ "EventCommandSignal" SG_ 905 ICM_TotalAvaibleDriveDistance 0;
BA_ "GatewayedSignals" SG_ 905 ICM_TotalAvaibleDriveDistance 0;
BA_ "GenSigInactiveValue" SG_ 905 ICM_TotalAvaibleDriveDistance 0;
BA_ "GenSigInvalidValue" SG_ 905 ICM_TotalAvaibleDriveDistance 2047;
BA_ "GenSigSendType" SG_ 905 ICM_TotalAvaibleDriveDistance 1;
BA_ "GenSigStartValue" SG_ 905 ICM_TotalAvaibleDriveDistance 0;
BA_ "GenSigTimeoutValue" SG_ 905 ICM_TotalAvaibleDriveDistance 0;
BA_ "Remark" SG_ 905 ICM_TotalAvaibleDriveDistance "";
BA_ "EventCommandSignal" SG_ 161 ACU_FaceID_Delete 1;
BA_ "GatewayedSignals" SG_ 161 ACU_FaceID_Delete 0;
BA_ "GenSigInactiveValue" SG_ 161 ACU_FaceID_Delete 0;
BA_ "GenSigInvalidValue" SG_ 161 ACU_FaceID_Delete 0;
BA_ "GenSigSendType" SG_ 161 ACU_FaceID_Delete 0;
BA_ "GenSigStartValue" SG_ 161 ACU_FaceID_Delete 0;
BA_ "GenSigTimeoutValue" SG_ 161 ACU_FaceID_Delete 0;
BA_ "Remark" SG_ 161 ACU_FaceID_Delete "";
BA_ "EventCommandSignal" SG_ 161 ACU_RegisterTriger 1;
BA_ "GatewayedSignals" SG_ 161 ACU_RegisterTriger 0;
BA_ "GenSigInactiveValue" SG_ 161 ACU_RegisterTriger 0;
BA_ "GenSigInvalidValue" SG_ 161 ACU_RegisterTriger 0;
BA_ "GenSigSendType" SG_ 161 ACU_RegisterTriger 0;
BA_ "GenSigStartValue" SG_ 161 ACU_RegisterTriger 0;
BA_ "GenSigTimeoutValue" SG_ 161 ACU_RegisterTriger 0;
BA_ "Remark" SG_ 161 ACU_RegisterTriger "";
BA_ "EventCommandSignal" SG_ 161 ACU_VerifyTriger 1;
BA_ "GatewayedSignals" SG_ 161 ACU_VerifyTriger 0;
BA_ "GenSigInactiveValue" SG_ 161 ACU_VerifyTriger 0;
BA_ "GenSigInvalidValue" SG_ 161 ACU_VerifyTriger 0;
BA_ "GenSigSendType" SG_ 161 ACU_VerifyTriger 0;
BA_ "GenSigStartValue" SG_ 161 ACU_VerifyTriger 0;
BA_ "GenSigTimeoutValue" SG_ 161 ACU_VerifyTriger 0;
BA_ "Remark" SG_ 161 ACU_VerifyTriger "";
BA_ "EventCommandSignal" SG_ 161 ACU_FaceIDQuit 1;
BA_ "GatewayedSignals" SG_ 161 ACU_FaceIDQuit 0;
BA_ "GenSigInactiveValue" SG_ 161 ACU_FaceIDQuit 0;
BA_ "GenSigInvalidValue" SG_ 161 ACU_FaceIDQuit 0;
BA_ "GenSigSendType" SG_ 161 ACU_FaceIDQuit 0;
BA_ "GenSigStartValue" SG_ 161 ACU_FaceIDQuit 0;
BA_ "GenSigTimeoutValue" SG_ 161 ACU_FaceIDQuit 0;
BA_ "Remark" SG_ 161 ACU_FaceIDQuit "";
BA_ "EventCommandSignal" SG_ 161 ACU_FaceIDSwitch 1;
BA_ "GatewayedSignals" SG_ 161 ACU_FaceIDSwitch 0;
BA_ "GenSigInactiveValue" SG_ 161 ACU_FaceIDSwitch 0;
BA_ "GenSigInvalidValue" SG_ 161 ACU_FaceIDSwitch 0;
BA_ "GenSigSendType" SG_ 161 ACU_FaceIDSwitch 0;
BA_ "GenSigStartValue" SG_ 161 ACU_FaceIDSwitch 0;
BA_ "GenSigTimeoutValue" SG_ 161 ACU_FaceIDSwitch 0;
BA_ "Remark" SG_ 161 ACU_FaceIDSwitch "";
BA_ "EventCommandSignal" SG_ 161 ACU_AVAS_SwitchCfgReq 1;
BA_ "GatewayedSignals" SG_ 161 ACU_AVAS_SwitchCfgReq 0;
BA_ "GenSigInactiveValue" SG_ 161 ACU_AVAS_SwitchCfgReq 0;
BA_ "GenSigInvalidValue" SG_ 161 ACU_AVAS_SwitchCfgReq 0;
BA_ "GenSigSendType" SG_ 161 ACU_AVAS_SwitchCfgReq 0;
BA_ "GenSigStartValue" SG_ 161 ACU_AVAS_SwitchCfgReq 0;
BA_ "GenSigTimeoutValue" SG_ 161 ACU_AVAS_SwitchCfgReq 0;
BA_ "Remark" SG_ 161 ACU_AVAS_SwitchCfgReq "";
BA_ "EventCommandSignal" SG_ 615 BCS_1_CRC 0;
BA_ "GatewayedSignals" SG_ 615 BCS_1_CRC 0;
BA_ "GenSigInactiveValue" SG_ 615 BCS_1_CRC 0;
BA_ "GenSigInvalidValue" SG_ 615 BCS_1_CRC 0;
BA_ "GenSigSendType" SG_ 615 BCS_1_CRC 1;
BA_ "GenSigStartValue" SG_ 615 BCS_1_CRC 0;
BA_ "GenSigTimeoutValue" SG_ 615 BCS_1_CRC 0;
BA_ "Remark" SG_ 615 BCS_1_CRC "";
BA_ "EventCommandSignal" SG_ 615 BCS_1_Counter 0;
BA_ "GatewayedSignals" SG_ 615 BCS_1_Counter 0;
BA_ "GenSigInactiveValue" SG_ 615 BCS_1_Counter 0;
BA_ "GenSigInvalidValue" SG_ 615 BCS_1_Counter 0;
BA_ "GenSigSendType" SG_ 615 BCS_1_Counter 1;
BA_ "GenSigStartValue" SG_ 615 BCS_1_Counter 0;
BA_ "GenSigTimeoutValue" SG_ 615 BCS_1_Counter 0;
BA_ "Remark" SG_ 615 BCS_1_Counter "";
BA_ "EventCommandSignal" SG_ 615 BCS_FLWheelSpd 0;
BA_ "GatewayedSignals" SG_ 615 BCS_FLWheelSpd 0;
BA_ "GenSigInactiveValue" SG_ 615 BCS_FLWheelSpd 0;
BA_ "GenSigInvalidValue" SG_ 615 BCS_FLWheelSpd 0;
BA_ "GenSigSendType" SG_ 615 BCS_FLWheelSpd 1;
BA_ "GenSigStartValue" SG_ 615 BCS_FLWheelSpd 0;
BA_ "GenSigTimeoutValue" SG_ 615 BCS_FLWheelSpd 0;
BA_ "Remark" SG_ 615 BCS_FLWheelSpd "";
BA_ "EventCommandSignal" SG_ 615 BCS_FLWheelSpdVD 0;
BA_ "GatewayedSignals" SG_ 615 BCS_FLWheelSpdVD 0;
BA_ "GenSigInactiveValue" SG_ 615 BCS_FLWheelSpdVD 0;
BA_ "GenSigInvalidValue" SG_ 615 BCS_FLWheelSpdVD 0;
BA_ "GenSigSendType" SG_ 615 BCS_FLWheelSpdVD 1;
BA_ "GenSigStartValue" SG_ 615 BCS_FLWheelSpdVD 0;
BA_ "GenSigTimeoutValue" SG_ 615 BCS_FLWheelSpdVD 0;
BA_ "Remark" SG_ 615 BCS_FLWheelSpdVD "";
BA_ "EventCommandSignal" SG_ 615 BCS_FLWheelRotatedDirection 0;
BA_ "GatewayedSignals" SG_ 615 BCS_FLWheelRotatedDirection 0;
BA_ "GenSigInactiveValue" SG_ 615 BCS_FLWheelRotatedDirection 0;
BA_ "GenSigInvalidValue" SG_ 615 BCS_FLWheelRotatedDirection 0;
BA_ "GenSigSendType" SG_ 615 BCS_FLWheelRotatedDirection 1;
BA_ "GenSigStartValue" SG_ 615 BCS_FLWheelRotatedDirection 0;
BA_ "GenSigTimeoutValue" SG_ 615 BCS_FLWheelRotatedDirection 0;
BA_ "Remark" SG_ 615 BCS_FLWheelRotatedDirection "";
BA_ "EventCommandSignal" SG_ 615 BCS_FLWheelRotatedDirectionVD 0;
BA_ "GatewayedSignals" SG_ 615 BCS_FLWheelRotatedDirectionVD 0;
BA_ "GenSigInactiveValue" SG_ 615 BCS_FLWheelRotatedDirectionVD 0;
BA_ "GenSigInvalidValue" SG_ 615 BCS_FLWheelRotatedDirectionVD 0;
BA_ "GenSigSendType" SG_ 615 BCS_FLWheelRotatedDirectionVD 1;
BA_ "GenSigStartValue" SG_ 615 BCS_FLWheelRotatedDirectionVD 0;
BA_ "GenSigTimeoutValue" SG_ 615 BCS_FLWheelRotatedDirectionVD 0;
BA_ "Remark" SG_ 615 BCS_FLWheelRotatedDirectionVD "";
BA_ "EventCommandSignal" SG_ 615 BCS_FRWheelSpd 0;
BA_ "GatewayedSignals" SG_ 615 BCS_FRWheelSpd 0;
BA_ "GenSigInactiveValue" SG_ 615 BCS_FRWheelSpd 0;
BA_ "GenSigInvalidValue" SG_ 615 BCS_FRWheelSpd 0;
BA_ "GenSigSendType" SG_ 615 BCS_FRWheelSpd 1;
BA_ "GenSigStartValue" SG_ 615 BCS_FRWheelSpd 0;
BA_ "GenSigTimeoutValue" SG_ 615 BCS_FRWheelSpd 0;
BA_ "Remark" SG_ 615 BCS_FRWheelSpd "";
BA_ "EventCommandSignal" SG_ 615 BCS_FRWheelSpdVD 0;
BA_ "GatewayedSignals" SG_ 615 BCS_FRWheelSpdVD 0;
BA_ "GenSigInactiveValue" SG_ 615 BCS_FRWheelSpdVD 0;
BA_ "GenSigInvalidValue" SG_ 615 BCS_FRWheelSpdVD 0;
BA_ "GenSigSendType" SG_ 615 BCS_FRWheelSpdVD 1;
BA_ "GenSigStartValue" SG_ 615 BCS_FRWheelSpdVD 0;
BA_ "GenSigTimeoutValue" SG_ 615 BCS_FRWheelSpdVD 0;
BA_ "Remark" SG_ 615 BCS_FRWheelSpdVD "";
BA_ "EventCommandSignal" SG_ 615 BCS_FRWheelRotatedDirection 0;
BA_ "GatewayedSignals" SG_ 615 BCS_FRWheelRotatedDirection 0;
BA_ "GenSigInactiveValue" SG_ 615 BCS_FRWheelRotatedDirection 0;
BA_ "GenSigInvalidValue" SG_ 615 BCS_FRWheelRotatedDirection 0;
BA_ "GenSigSendType" SG_ 615 BCS_FRWheelRotatedDirection 1;
BA_ "GenSigStartValue" SG_ 615 BCS_FRWheelRotatedDirection 0;
BA_ "GenSigTimeoutValue" SG_ 615 BCS_FRWheelRotatedDirection 0;
BA_ "Remark" SG_ 615 BCS_FRWheelRotatedDirection "";
BA_ "EventCommandSignal" SG_ 615 BCS_FRWheelRotatedDirectionVD 0;
BA_ "GatewayedSignals" SG_ 615 BCS_FRWheelRotatedDirectionVD 0;
BA_ "GenSigInactiveValue" SG_ 615 BCS_FRWheelRotatedDirectionVD 0;
BA_ "GenSigInvalidValue" SG_ 615 BCS_FRWheelRotatedDirectionVD 0;
BA_ "GenSigSendType" SG_ 615 BCS_FRWheelRotatedDirectionVD 1;
BA_ "GenSigStartValue" SG_ 615 BCS_FRWheelRotatedDirectionVD 0;
BA_ "GenSigTimeoutValue" SG_ 615 BCS_FRWheelRotatedDirectionVD 0;
BA_ "Remark" SG_ 615 BCS_FRWheelRotatedDirectionVD "";
BA_ "EventCommandSignal" SG_ 615 BCS_RLWheelSpd 0;
BA_ "GatewayedSignals" SG_ 615 BCS_RLWheelSpd 0;
BA_ "GenSigInactiveValue" SG_ 615 BCS_RLWheelSpd 0;
BA_ "GenSigInvalidValue" SG_ 615 BCS_RLWheelSpd 0;
BA_ "GenSigSendType" SG_ 615 BCS_RLWheelSpd 1;
BA_ "GenSigStartValue" SG_ 615 BCS_RLWheelSpd 0;
BA_ "GenSigTimeoutValue" SG_ 615 BCS_RLWheelSpd 0;
BA_ "Remark" SG_ 615 BCS_RLWheelSpd "";
BA_ "EventCommandSignal" SG_ 615 BCS_RLWheelSpdVD 0;
BA_ "GatewayedSignals" SG_ 615 BCS_RLWheelSpdVD 0;
BA_ "GenSigInactiveValue" SG_ 615 BCS_RLWheelSpdVD 0;
BA_ "GenSigInvalidValue" SG_ 615 BCS_RLWheelSpdVD 0;
BA_ "GenSigSendType" SG_ 615 BCS_RLWheelSpdVD 1;
BA_ "GenSigStartValue" SG_ 615 BCS_RLWheelSpdVD 0;
BA_ "GenSigTimeoutValue" SG_ 615 BCS_RLWheelSpdVD 0;
BA_ "Remark" SG_ 615 BCS_RLWheelSpdVD "";
BA_ "EventCommandSignal" SG_ 615 BCS_RLWheelRotatedDirection 0;
BA_ "GatewayedSignals" SG_ 615 BCS_RLWheelRotatedDirection 0;
BA_ "GenSigInactiveValue" SG_ 615 BCS_RLWheelRotatedDirection 0;
BA_ "GenSigInvalidValue" SG_ 615 BCS_RLWheelRotatedDirection 0;
BA_ "GenSigSendType" SG_ 615 BCS_RLWheelRotatedDirection 1;
BA_ "GenSigStartValue" SG_ 615 BCS_RLWheelRotatedDirection 0;
BA_ "GenSigTimeoutValue" SG_ 615 BCS_RLWheelRotatedDirection 0;
BA_ "Remark" SG_ 615 BCS_RLWheelRotatedDirection "";
BA_ "EventCommandSignal" SG_ 615 BCS_RLWheelRotatedDirectionVD 0;
BA_ "GatewayedSignals" SG_ 615 BCS_RLWheelRotatedDirectionVD 0;
BA_ "GenSigInactiveValue" SG_ 615 BCS_RLWheelRotatedDirectionVD 0;
BA_ "GenSigInvalidValue" SG_ 615 BCS_RLWheelRotatedDirectionVD 0;
BA_ "GenSigSendType" SG_ 615 BCS_RLWheelRotatedDirectionVD 1;
BA_ "GenSigStartValue" SG_ 615 BCS_RLWheelRotatedDirectionVD 0;
BA_ "GenSigTimeoutValue" SG_ 615 BCS_RLWheelRotatedDirectionVD 0;
BA_ "Remark" SG_ 615 BCS_RLWheelRotatedDirectionVD "";
BA_ "EventCommandSignal" SG_ 615 BCS_RRWheelSpd 0;
BA_ "GatewayedSignals" SG_ 615 BCS_RRWheelSpd 0;
BA_ "GenSigInactiveValue" SG_ 615 BCS_RRWheelSpd 0;
BA_ "GenSigInvalidValue" SG_ 615 BCS_RRWheelSpd 0;
BA_ "GenSigSendType" SG_ 615 BCS_RRWheelSpd 1;
BA_ "GenSigStartValue" SG_ 615 BCS_RRWheelSpd 0;
BA_ "GenSigTimeoutValue" SG_ 615 BCS_RRWheelSpd 0;
BA_ "Remark" SG_ 615 BCS_RRWheelSpd "";
BA_ "EventCommandSignal" SG_ 615 BCS_RRWheelSpdVD 0;
BA_ "GatewayedSignals" SG_ 615 BCS_RRWheelSpdVD 0;
BA_ "GenSigInactiveValue" SG_ 615 BCS_RRWheelSpdVD 0;
BA_ "GenSigInvalidValue" SG_ 615 BCS_RRWheelSpdVD 0;
BA_ "GenSigSendType" SG_ 615 BCS_RRWheelSpdVD 1;
BA_ "GenSigStartValue" SG_ 615 BCS_RRWheelSpdVD 0;
BA_ "GenSigTimeoutValue" SG_ 615 BCS_RRWheelSpdVD 0;
BA_ "Remark" SG_ 615 BCS_RRWheelSpdVD "";
BA_ "EventCommandSignal" SG_ 615 BCS_RRWheelRotatedDirection 0;
BA_ "GatewayedSignals" SG_ 615 BCS_RRWheelRotatedDirection 0;
BA_ "GenSigInactiveValue" SG_ 615 BCS_RRWheelRotatedDirection 0;
BA_ "GenSigInvalidValue" SG_ 615 BCS_RRWheelRotatedDirection 0;
BA_ "GenSigSendType" SG_ 615 BCS_RRWheelRotatedDirection 1;
BA_ "GenSigStartValue" SG_ 615 BCS_RRWheelRotatedDirection 0;
BA_ "GenSigTimeoutValue" SG_ 615 BCS_RRWheelRotatedDirection 0;
BA_ "Remark" SG_ 615 BCS_RRWheelRotatedDirection "";
BA_ "EventCommandSignal" SG_ 615 BCS_RRWheelRotatedDirectionVD 0;
BA_ "GatewayedSignals" SG_ 615 BCS_RRWheelRotatedDirectionVD 0;
BA_ "GenSigInactiveValue" SG_ 615 BCS_RRWheelRotatedDirectionVD 0;
BA_ "GenSigInvalidValue" SG_ 615 BCS_RRWheelRotatedDirectionVD 0;
BA_ "GenSigSendType" SG_ 615 BCS_RRWheelRotatedDirectionVD 1;
BA_ "GenSigStartValue" SG_ 615 BCS_RRWheelRotatedDirectionVD 0;
BA_ "GenSigTimeoutValue" SG_ 615 BCS_RRWheelRotatedDirectionVD 0;
BA_ "Remark" SG_ 615 BCS_RRWheelRotatedDirectionVD "";
BA_ "EventCommandSignal" SG_ 615 BCS_HDCCtrlSt 0;
BA_ "GatewayedSignals" SG_ 615 BCS_HDCCtrlSt 0;
BA_ "GenSigInactiveValue" SG_ 615 BCS_HDCCtrlSt 0;
BA_ "GenSigInvalidValue" SG_ 615 BCS_HDCCtrlSt 0;
BA_ "GenSigSendType" SG_ 615 BCS_HDCCtrlSt 1;
BA_ "GenSigStartValue" SG_ 615 BCS_HDCCtrlSt 0;
BA_ "GenSigTimeoutValue" SG_ 615 BCS_HDCCtrlSt 0;
BA_ "Remark" SG_ 615 BCS_HDCCtrlSt "";
BA_ "EventCommandSignal" SG_ 615 BCS_HDCErrSt 0;
BA_ "GatewayedSignals" SG_ 615 BCS_HDCErrSt 0;
BA_ "GenSigInactiveValue" SG_ 615 BCS_HDCErrSt 0;
BA_ "GenSigInvalidValue" SG_ 615 BCS_HDCErrSt 0;
BA_ "GenSigSendType" SG_ 615 BCS_HDCErrSt 1;
BA_ "GenSigStartValue" SG_ 615 BCS_HDCErrSt 0;
BA_ "GenSigTimeoutValue" SG_ 615 BCS_HDCErrSt 1;
BA_ "Remark" SG_ 615 BCS_HDCErrSt "";
BA_ "EventCommandSignal" SG_ 615 BCS_FLWheelSpdEdgesSum 0;
BA_ "GatewayedSignals" SG_ 615 BCS_FLWheelSpdEdgesSum 0;
BA_ "GenSigInactiveValue" SG_ 615 BCS_FLWheelSpdEdgesSum 0;
BA_ "GenSigInvalidValue" SG_ 615 BCS_FLWheelSpdEdgesSum 0;
BA_ "GenSigSendType" SG_ 615 BCS_FLWheelSpdEdgesSum 1;
BA_ "GenSigStartValue" SG_ 615 BCS_FLWheelSpdEdgesSum 0;
BA_ "GenSigTimeoutValue" SG_ 615 BCS_FLWheelSpdEdgesSum 0;
BA_ "Remark" SG_ 615 BCS_FLWheelSpdEdgesSum "";
BA_ "EventCommandSignal" SG_ 615 BCS_FRWheelSpdEdgesSum 0;
BA_ "GatewayedSignals" SG_ 615 BCS_FRWheelSpdEdgesSum 0;
BA_ "GenSigInactiveValue" SG_ 615 BCS_FRWheelSpdEdgesSum 0;
BA_ "GenSigInvalidValue" SG_ 615 BCS_FRWheelSpdEdgesSum 0;
BA_ "GenSigSendType" SG_ 615 BCS_FRWheelSpdEdgesSum 1;
BA_ "GenSigStartValue" SG_ 615 BCS_FRWheelSpdEdgesSum 0;
BA_ "GenSigTimeoutValue" SG_ 615 BCS_FRWheelSpdEdgesSum 0;
BA_ "Remark" SG_ 615 BCS_FRWheelSpdEdgesSum "";
BA_ "EventCommandSignal" SG_ 615 BCS_RLWheelSpdEdgesSum 0;
BA_ "GatewayedSignals" SG_ 615 BCS_RLWheelSpdEdgesSum 0;
BA_ "GenSigInactiveValue" SG_ 615 BCS_RLWheelSpdEdgesSum 0;
BA_ "GenSigInvalidValue" SG_ 615 BCS_RLWheelSpdEdgesSum 0;
BA_ "GenSigSendType" SG_ 615 BCS_RLWheelSpdEdgesSum 1;
BA_ "GenSigStartValue" SG_ 615 BCS_RLWheelSpdEdgesSum 0;
BA_ "GenSigTimeoutValue" SG_ 615 BCS_RLWheelSpdEdgesSum 0;
BA_ "Remark" SG_ 615 BCS_RLWheelSpdEdgesSum "";
BA_ "EventCommandSignal" SG_ 615 BCS_RRWheelSpdEdgesSum 0;
BA_ "GatewayedSignals" SG_ 615 BCS_RRWheelSpdEdgesSum 0;
BA_ "GenSigInactiveValue" SG_ 615 BCS_RRWheelSpdEdgesSum 0;
BA_ "GenSigInvalidValue" SG_ 615 BCS_RRWheelSpdEdgesSum 0;
BA_ "GenSigSendType" SG_ 615 BCS_RRWheelSpdEdgesSum 1;
BA_ "GenSigStartValue" SG_ 615 BCS_RRWheelSpdEdgesSum 0;
BA_ "GenSigTimeoutValue" SG_ 615 BCS_RRWheelSpdEdgesSum 0;
BA_ "Remark" SG_ 615 BCS_RRWheelSpdEdgesSum "";
BA_ "EventCommandSignal" SG_ 615 BCS_FLWheelSpdEdgesSumVD 0;
BA_ "GatewayedSignals" SG_ 615 BCS_FLWheelSpdEdgesSumVD 0;
BA_ "GenSigInactiveValue" SG_ 615 BCS_FLWheelSpdEdgesSumVD 0;
BA_ "GenSigInvalidValue" SG_ 615 BCS_FLWheelSpdEdgesSumVD 0;
BA_ "GenSigSendType" SG_ 615 BCS_FLWheelSpdEdgesSumVD 1;
BA_ "GenSigStartValue" SG_ 615 BCS_FLWheelSpdEdgesSumVD 0;
BA_ "GenSigTimeoutValue" SG_ 615 BCS_FLWheelSpdEdgesSumVD 0;
BA_ "Remark" SG_ 615 BCS_FLWheelSpdEdgesSumVD "";
BA_ "EventCommandSignal" SG_ 615 BCS_FRWheelSpdEdgesSumVD 0;
BA_ "GatewayedSignals" SG_ 615 BCS_FRWheelSpdEdgesSumVD 0;
BA_ "GenSigInactiveValue" SG_ 615 BCS_FRWheelSpdEdgesSumVD 0;
BA_ "GenSigInvalidValue" SG_ 615 BCS_FRWheelSpdEdgesSumVD 0;
BA_ "GenSigSendType" SG_ 615 BCS_FRWheelSpdEdgesSumVD 1;
BA_ "GenSigStartValue" SG_ 615 BCS_FRWheelSpdEdgesSumVD 0;
BA_ "GenSigTimeoutValue" SG_ 615 BCS_FRWheelSpdEdgesSumVD 0;
BA_ "Remark" SG_ 615 BCS_FRWheelSpdEdgesSumVD "";
BA_ "EventCommandSignal" SG_ 615 BCS_RLWheelSpdEdgesSumVD 0;
BA_ "GatewayedSignals" SG_ 615 BCS_RLWheelSpdEdgesSumVD 0;
BA_ "GenSigInactiveValue" SG_ 615 BCS_RLWheelSpdEdgesSumVD 0;
BA_ "GenSigInvalidValue" SG_ 615 BCS_RLWheelSpdEdgesSumVD 0;
BA_ "GenSigSendType" SG_ 615 BCS_RLWheelSpdEdgesSumVD 1;
BA_ "GenSigStartValue" SG_ 615 BCS_RLWheelSpdEdgesSumVD 0;
BA_ "GenSigTimeoutValue" SG_ 615 BCS_RLWheelSpdEdgesSumVD 0;
BA_ "Remark" SG_ 615 BCS_RLWheelSpdEdgesSumVD "";
BA_ "EventCommandSignal" SG_ 615 BCS_RRWheelSpdEdgesSumVD 0;
BA_ "GatewayedSignals" SG_ 615 BCS_RRWheelSpdEdgesSumVD 0;
BA_ "GenSigInactiveValue" SG_ 615 BCS_RRWheelSpdEdgesSumVD 0;
BA_ "GenSigInvalidValue" SG_ 615 BCS_RRWheelSpdEdgesSumVD 0;
BA_ "GenSigSendType" SG_ 615 BCS_RRWheelSpdEdgesSumVD 1;
BA_ "GenSigStartValue" SG_ 615 BCS_RRWheelSpdEdgesSumVD 0;
BA_ "GenSigTimeoutValue" SG_ 615 BCS_RRWheelSpdEdgesSumVD 0;
BA_ "Remark" SG_ 615 BCS_RRWheelSpdEdgesSumVD "";
BA_ "EventCommandSignal" SG_ 615 BCS_FLWheelRotatedDirectionAPA 0;
BA_ "GatewayedSignals" SG_ 615 BCS_FLWheelRotatedDirectionAPA 0;
BA_ "GenSigInactiveValue" SG_ 615 BCS_FLWheelRotatedDirectionAPA 0;
BA_ "GenSigInvalidValue" SG_ 615 BCS_FLWheelRotatedDirectionAPA 0;
BA_ "GenSigSendType" SG_ 615 BCS_FLWheelRotatedDirectionAPA 1;
BA_ "GenSigStartValue" SG_ 615 BCS_FLWheelRotatedDirectionAPA 0;
BA_ "GenSigTimeoutValue" SG_ 615 BCS_FLWheelRotatedDirectionAPA 0;
BA_ "Remark" SG_ 615 BCS_FLWheelRotatedDirectionAPA "";
BA_ "EventCommandSignal" SG_ 615 BCS_FRWheelRotatedDirectionAPA 0;
BA_ "GatewayedSignals" SG_ 615 BCS_FRWheelRotatedDirectionAPA 0;
BA_ "GenSigInactiveValue" SG_ 615 BCS_FRWheelRotatedDirectionAPA 0;
BA_ "GenSigInvalidValue" SG_ 615 BCS_FRWheelRotatedDirectionAPA 0;
BA_ "GenSigSendType" SG_ 615 BCS_FRWheelRotatedDirectionAPA 1;
BA_ "GenSigStartValue" SG_ 615 BCS_FRWheelRotatedDirectionAPA 0;
BA_ "GenSigTimeoutValue" SG_ 615 BCS_FRWheelRotatedDirectionAPA 0;
BA_ "Remark" SG_ 615 BCS_FRWheelRotatedDirectionAPA "";
BA_ "EventCommandSignal" SG_ 615 BCS_RLWheelRotatedDirectionAPA 0;
BA_ "GatewayedSignals" SG_ 615 BCS_RLWheelRotatedDirectionAPA 0;
BA_ "GenSigInactiveValue" SG_ 615 BCS_RLWheelRotatedDirectionAPA 0;
BA_ "GenSigInvalidValue" SG_ 615 BCS_RLWheelRotatedDirectionAPA 0;
BA_ "GenSigSendType" SG_ 615 BCS_RLWheelRotatedDirectionAPA 1;
BA_ "GenSigStartValue" SG_ 615 BCS_RLWheelRotatedDirectionAPA 0;
BA_ "GenSigTimeoutValue" SG_ 615 BCS_RLWheelRotatedDirectionAPA 0;
BA_ "Remark" SG_ 615 BCS_RLWheelRotatedDirectionAPA "";
BA_ "EventCommandSignal" SG_ 615 BCS_RRWheelRotatedDirectionAPA 0;
BA_ "GatewayedSignals" SG_ 615 BCS_RRWheelRotatedDirectionAPA 0;
BA_ "GenSigInactiveValue" SG_ 615 BCS_RRWheelRotatedDirectionAPA 0;
BA_ "GenSigInvalidValue" SG_ 615 BCS_RRWheelRotatedDirectionAPA 0;
BA_ "GenSigSendType" SG_ 615 BCS_RRWheelRotatedDirectionAPA 1;
BA_ "GenSigStartValue" SG_ 615 BCS_RRWheelRotatedDirectionAPA 0;
BA_ "GenSigTimeoutValue" SG_ 615 BCS_RRWheelRotatedDirectionAPA 0;
BA_ "Remark" SG_ 615 BCS_RRWheelRotatedDirectionAPA "";
BA_ "EventCommandSignal" SG_ 615 BCS_ParkingReqToEPB 0;
BA_ "GatewayedSignals" SG_ 615 BCS_ParkingReqToEPB 0;
BA_ "GenSigInactiveValue" SG_ 615 BCS_ParkingReqToEPB 0;
BA_ "GenSigInvalidValue" SG_ 615 BCS_ParkingReqToEPB 0;
BA_ "GenSigSendType" SG_ 615 BCS_ParkingReqToEPB 1;
BA_ "GenSigStartValue" SG_ 615 BCS_ParkingReqToEPB 0;
BA_ "GenSigTimeoutValue" SG_ 615 BCS_ParkingReqToEPB 0;
BA_ "Remark" SG_ 615 BCS_ParkingReqToEPB "";
BA_ "EventCommandSignal" SG_ 615 BCS_VDCOff 0;
BA_ "GatewayedSignals" SG_ 615 BCS_VDCOff 0;
BA_ "GenSigInactiveValue" SG_ 615 BCS_VDCOff 0;
BA_ "GenSigInvalidValue" SG_ 615 BCS_VDCOff 0;
BA_ "GenSigSendType" SG_ 615 BCS_VDCOff 1;
BA_ "GenSigStartValue" SG_ 615 BCS_VDCOff 0;
BA_ "GenSigTimeoutValue" SG_ 615 BCS_VDCOff 0;
BA_ "Remark" SG_ 615 BCS_VDCOff "";
BA_ "EventCommandSignal" SG_ 615 BCS_AVHSt 0;
BA_ "GatewayedSignals" SG_ 615 BCS_AVHSt 0;
BA_ "GenSigInactiveValue" SG_ 615 BCS_AVHSt 0;
BA_ "GenSigInvalidValue" SG_ 615 BCS_AVHSt 0;
BA_ "GenSigSendType" SG_ 615 BCS_AVHSt 1;
BA_ "GenSigStartValue" SG_ 615 BCS_AVHSt 0;
BA_ "GenSigTimeoutValue" SG_ 615 BCS_AVHSt 0;
BA_ "Remark" SG_ 615 BCS_AVHSt "";
BA_ "EventCommandSignal" SG_ 615 BCS_AVHStandby 0;
BA_ "GatewayedSignals" SG_ 615 BCS_AVHStandby 0;
BA_ "GenSigInactiveValue" SG_ 615 BCS_AVHStandby 0;
BA_ "GenSigInvalidValue" SG_ 615 BCS_AVHStandby 0;
BA_ "GenSigSendType" SG_ 615 BCS_AVHStandby 1;
BA_ "GenSigStartValue" SG_ 615 BCS_AVHStandby 0;
BA_ "GenSigTimeoutValue" SG_ 615 BCS_AVHStandby 0;
BA_ "Remark" SG_ 615 BCS_AVHStandby "";
BA_ "EventCommandSignal" SG_ 615 BCS_AVHAvailable 0;
BA_ "GatewayedSignals" SG_ 615 BCS_AVHAvailable 0;
BA_ "GenSigInactiveValue" SG_ 615 BCS_AVHAvailable 0;
BA_ "GenSigInvalidValue" SG_ 615 BCS_AVHAvailable 0;
BA_ "GenSigSendType" SG_ 615 BCS_AVHAvailable 1;
BA_ "GenSigStartValue" SG_ 615 BCS_AVHAvailable 0;
BA_ "GenSigTimeoutValue" SG_ 615 BCS_AVHAvailable 0;
BA_ "Remark" SG_ 615 BCS_AVHAvailable "";
BA_ "EventCommandSignal" SG_ 615 BCS_TCSOff 0;
BA_ "GatewayedSignals" SG_ 615 BCS_TCSOff 0;
BA_ "GenSigInactiveValue" SG_ 615 BCS_TCSOff 0;
BA_ "GenSigInvalidValue" SG_ 615 BCS_TCSOff 0;
BA_ "GenSigSendType" SG_ 615 BCS_TCSOff 1;
BA_ "GenSigStartValue" SG_ 615 BCS_TCSOff 0;
BA_ "GenSigTimeoutValue" SG_ 615 BCS_TCSOff 0;
BA_ "Remark" SG_ 615 BCS_TCSOff "";
BA_ "EventCommandSignal" SG_ 615 BCS_BrkPdlPstVD 0;
BA_ "GatewayedSignals" SG_ 615 BCS_BrkPdlPstVD 0;
BA_ "GenSigInactiveValue" SG_ 615 BCS_BrkPdlPstVD 0;
BA_ "GenSigInvalidValue" SG_ 615 BCS_BrkPdlPstVD 0;
BA_ "GenSigSendType" SG_ 615 BCS_BrkPdlPstVD 1;
BA_ "GenSigStartValue" SG_ 615 BCS_BrkPdlPstVD 0;
BA_ "GenSigTimeoutValue" SG_ 615 BCS_BrkPdlPstVD 0;
BA_ "Remark" SG_ 615 BCS_BrkPdlPstVD "";
BA_ "EventCommandSignal" SG_ 615 BCS_BrakeOverHeat 0;
BA_ "GatewayedSignals" SG_ 615 BCS_BrakeOverHeat 0;
BA_ "GenSigInactiveValue" SG_ 615 BCS_BrakeOverHeat 0;
BA_ "GenSigInvalidValue" SG_ 615 BCS_BrakeOverHeat 0;
BA_ "GenSigSendType" SG_ 615 BCS_BrakeOverHeat 1;
BA_ "GenSigStartValue" SG_ 615 BCS_BrakeOverHeat 0;
BA_ "GenSigTimeoutValue" SG_ 615 BCS_BrakeOverHeat 0;
BA_ "Remark" SG_ 615 BCS_BrakeOverHeat "";
BA_ "EventCommandSignal" SG_ 615 BCS_ABAactive 0;
BA_ "GatewayedSignals" SG_ 615 BCS_ABAactive 0;
BA_ "GenSigInactiveValue" SG_ 615 BCS_ABAactive 0;
BA_ "GenSigInvalidValue" SG_ 615 BCS_ABAactive 0;
BA_ "GenSigSendType" SG_ 615 BCS_ABAactive 1;
BA_ "GenSigStartValue" SG_ 615 BCS_ABAactive 0;
BA_ "GenSigTimeoutValue" SG_ 615 BCS_ABAactive 0;
BA_ "Remark" SG_ 615 BCS_ABAactive "";
BA_ "EventCommandSignal" SG_ 615 BCS_ABAavailable 0;
BA_ "GatewayedSignals" SG_ 615 BCS_ABAavailable 0;
BA_ "GenSigInactiveValue" SG_ 615 BCS_ABAavailable 0;
BA_ "GenSigInvalidValue" SG_ 615 BCS_ABAavailable 0;
BA_ "GenSigSendType" SG_ 615 BCS_ABAavailable 1;
BA_ "GenSigStartValue" SG_ 615 BCS_ABAavailable 0;
BA_ "GenSigTimeoutValue" SG_ 615 BCS_ABAavailable 0;
BA_ "Remark" SG_ 615 BCS_ABAavailable "";
BA_ "EventCommandSignal" SG_ 615 BCS_ABPActive 0;
BA_ "GatewayedSignals" SG_ 615 BCS_ABPActive 0;
BA_ "GenSigInactiveValue" SG_ 615 BCS_ABPActive 0;
BA_ "GenSigInvalidValue" SG_ 615 BCS_ABPActive 0;
BA_ "GenSigSendType" SG_ 615 BCS_ABPActive 1;
BA_ "GenSigStartValue" SG_ 615 BCS_ABPActive 0;
BA_ "GenSigTimeoutValue" SG_ 615 BCS_ABPActive 0;
BA_ "Remark" SG_ 615 BCS_ABPActive "";
BA_ "EventCommandSignal" SG_ 615 BCS_ABPAvailable 0;
BA_ "GatewayedSignals" SG_ 615 BCS_ABPAvailable 0;
BA_ "GenSigInactiveValue" SG_ 615 BCS_ABPAvailable 0;
BA_ "GenSigInvalidValue" SG_ 615 BCS_ABPAvailable 0;
BA_ "GenSigSendType" SG_ 615 BCS_ABPAvailable 1;
BA_ "GenSigStartValue" SG_ 615 BCS_ABPAvailable 0;
BA_ "GenSigTimeoutValue" SG_ 615 BCS_ABPAvailable 0;
BA_ "Remark" SG_ 615 BCS_ABPAvailable "";
BA_ "EventCommandSignal" SG_ 615 BCS_AEBActive 0;
BA_ "GatewayedSignals" SG_ 615 BCS_AEBActive 0;
BA_ "GenSigInactiveValue" SG_ 615 BCS_AEBActive 0;
BA_ "GenSigInvalidValue" SG_ 615 BCS_AEBActive 0;
BA_ "GenSigSendType" SG_ 615 BCS_AEBActive 1;
BA_ "GenSigStartValue" SG_ 615 BCS_AEBActive 0;
BA_ "GenSigTimeoutValue" SG_ 615 BCS_AEBActive 0;
BA_ "Remark" SG_ 615 BCS_AEBActive "";
BA_ "EventCommandSignal" SG_ 615 BCS_AEBAvailable 0;
BA_ "GatewayedSignals" SG_ 615 BCS_AEBAvailable 0;
BA_ "GenSigInactiveValue" SG_ 615 BCS_AEBAvailable 0;
BA_ "GenSigInvalidValue" SG_ 615 BCS_AEBAvailable 0;
BA_ "GenSigSendType" SG_ 615 BCS_AEBAvailable 1;
BA_ "GenSigStartValue" SG_ 615 BCS_AEBAvailable 0;
BA_ "GenSigTimeoutValue" SG_ 615 BCS_AEBAvailable 0;
BA_ "Remark" SG_ 615 BCS_AEBAvailable "";
BA_ "EventCommandSignal" SG_ 615 BCS_AWBActive 0;
BA_ "GatewayedSignals" SG_ 615 BCS_AWBActive 0;
BA_ "GenSigInactiveValue" SG_ 615 BCS_AWBActive 0;
BA_ "GenSigInvalidValue" SG_ 615 BCS_AWBActive 0;
BA_ "GenSigSendType" SG_ 615 BCS_AWBActive 1;
BA_ "GenSigStartValue" SG_ 615 BCS_AWBActive 0;
BA_ "GenSigTimeoutValue" SG_ 615 BCS_AWBActive 0;
BA_ "Remark" SG_ 615 BCS_AWBActive "";
BA_ "EventCommandSignal" SG_ 615 BCS_AWBAvailable 0;
BA_ "GatewayedSignals" SG_ 615 BCS_AWBAvailable 0;
BA_ "GenSigInactiveValue" SG_ 615 BCS_AWBAvailable 0;
BA_ "GenSigInvalidValue" SG_ 615 BCS_AWBAvailable 0;
BA_ "GenSigSendType" SG_ 615 BCS_AWBAvailable 1;
BA_ "GenSigStartValue" SG_ 615 BCS_AWBAvailable 0;
BA_ "GenSigTimeoutValue" SG_ 615 BCS_AWBAvailable 0;
BA_ "Remark" SG_ 615 BCS_AWBAvailable "";
BA_ "EventCommandSignal" SG_ 615 BCS_BrkPdlPst 0;
BA_ "GatewayedSignals" SG_ 615 BCS_BrkPdlPst 0;
BA_ "GenSigInactiveValue" SG_ 615 BCS_BrkPdlPst 0;
BA_ "GenSigInvalidValue" SG_ 615 BCS_BrkPdlPst 0;
BA_ "GenSigSendType" SG_ 615 BCS_BrkPdlPst 1;
BA_ "GenSigStartValue" SG_ 615 BCS_BrkPdlPst 0;
BA_ "GenSigTimeoutValue" SG_ 615 BCS_BrkPdlPst 0;
BA_ "Remark" SG_ 615 BCS_BrkPdlPst "";
BA_ "EventCommandSignal" SG_ 615 BCS_VehicleStandStillSt 0;
BA_ "GatewayedSignals" SG_ 615 BCS_VehicleStandStillSt 0;
BA_ "GenSigInactiveValue" SG_ 615 BCS_VehicleStandStillSt 0;
BA_ "GenSigInvalidValue" SG_ 615 BCS_VehicleStandStillSt 0;
BA_ "GenSigSendType" SG_ 615 BCS_VehicleStandStillSt 1;
BA_ "GenSigStartValue" SG_ 615 BCS_VehicleStandStillSt 0;
BA_ "GenSigTimeoutValue" SG_ 615 BCS_VehicleStandStillSt 0;
BA_ "Remark" SG_ 615 BCS_VehicleStandStillSt "";
BA_ "EventCommandSignal" SG_ 615 BCS_AEBBAActive 0;
BA_ "GatewayedSignals" SG_ 615 BCS_AEBBAActive 0;
BA_ "GenSigInactiveValue" SG_ 615 BCS_AEBBAActive 0;
BA_ "GenSigInvalidValue" SG_ 615 BCS_AEBBAActive 0;
BA_ "GenSigSendType" SG_ 615 BCS_AEBBAActive 1;
BA_ "GenSigStartValue" SG_ 615 BCS_AEBBAActive 0;
BA_ "GenSigTimeoutValue" SG_ 615 BCS_AEBBAActive 0;
BA_ "Remark" SG_ 615 BCS_AEBBAActive "";
BA_ "EventCommandSignal" SG_ 615 IPB_InputRodStroke 0;
BA_ "GatewayedSignals" SG_ 615 IPB_InputRodStroke 0;
BA_ "GenSigInactiveValue" SG_ 615 IPB_InputRodStroke 0;
BA_ "GenSigInvalidValue" SG_ 615 IPB_InputRodStroke 0;
BA_ "GenSigSendType" SG_ 615 IPB_InputRodStroke 1;
BA_ "GenSigStartValue" SG_ 615 IPB_InputRodStroke 100;
BA_ "GenSigTimeoutValue" SG_ 615 IPB_InputRodStroke 0;
BA_ "Remark" SG_ 615 IPB_InputRodStroke "";
BA_ "EventCommandSignal" SG_ 615 IPB_InputRodStrokeSt 0;
BA_ "GatewayedSignals" SG_ 615 IPB_InputRodStrokeSt 0;
BA_ "GenSigInactiveValue" SG_ 615 IPB_InputRodStrokeSt 0;
BA_ "GenSigInvalidValue" SG_ 615 IPB_InputRodStrokeSt 0;
BA_ "GenSigSendType" SG_ 615 IPB_InputRodStrokeSt 1;
BA_ "GenSigStartValue" SG_ 615 IPB_InputRodStrokeSt 0;
BA_ "GenSigTimeoutValue" SG_ 615 IPB_InputRodStrokeSt 0;
BA_ "Remark" SG_ 615 IPB_InputRodStrokeSt "";
BA_ "EventCommandSignal" SG_ 615 BCS_RAEBActive 0;
BA_ "GatewayedSignals" SG_ 615 BCS_RAEBActive 0;
BA_ "GenSigInactiveValue" SG_ 615 BCS_RAEBActive 0;
BA_ "GenSigInvalidValue" SG_ 615 BCS_RAEBActive 0;
BA_ "GenSigSendType" SG_ 615 BCS_RAEBActive 1;
BA_ "GenSigStartValue" SG_ 615 BCS_RAEBActive 0;
BA_ "GenSigTimeoutValue" SG_ 615 BCS_RAEBActive 0;
BA_ "Remark" SG_ 615 BCS_RAEBActive "";
BA_ "EventCommandSignal" SG_ 615 BCS_RAEBAvailable 0;
BA_ "GatewayedSignals" SG_ 615 BCS_RAEBAvailable 0;
BA_ "GenSigInactiveValue" SG_ 615 BCS_RAEBAvailable 0;
BA_ "GenSigInvalidValue" SG_ 615 BCS_RAEBAvailable 0;
BA_ "GenSigSendType" SG_ 615 BCS_RAEBAvailable 1;
BA_ "GenSigStartValue" SG_ 615 BCS_RAEBAvailable 0;
BA_ "GenSigTimeoutValue" SG_ 615 BCS_RAEBAvailable 0;
BA_ "Remark" SG_ 615 BCS_RAEBAvailable "";
BA_ "EventCommandSignal" SG_ 615 BCS_DrvModeAvailable 0;
BA_ "GatewayedSignals" SG_ 615 BCS_DrvModeAvailable 0;
BA_ "GenSigInactiveValue" SG_ 615 BCS_DrvModeAvailable 0;
BA_ "GenSigInvalidValue" SG_ 615 BCS_DrvModeAvailable 0;
BA_ "GenSigSendType" SG_ 615 BCS_DrvModeAvailable 1;
BA_ "GenSigStartValue" SG_ 615 BCS_DrvModeAvailable 0;
BA_ "GenSigTimeoutValue" SG_ 615 BCS_DrvModeAvailable 0;
BA_ "Remark" SG_ 615 BCS_DrvModeAvailable "";
BA_ "EventCommandSignal" SG_ 615 BCS_DrvMode 0;
BA_ "GatewayedSignals" SG_ 615 BCS_DrvMode 0;
BA_ "GenSigInactiveValue" SG_ 615 BCS_DrvMode 0;
BA_ "GenSigInvalidValue" SG_ 615 BCS_DrvMode 0;
BA_ "GenSigSendType" SG_ 615 BCS_DrvMode 1;
BA_ "GenSigStartValue" SG_ 615 BCS_DrvMode 0;
BA_ "GenSigTimeoutValue" SG_ 615 BCS_DrvMode 0;
BA_ "Remark" SG_ 615 BCS_DrvMode "";
BA_ "EventCommandSignal" SG_ 615 IPB_PlungerPressure 0;
BA_ "GatewayedSignals" SG_ 615 IPB_PlungerPressure 0;
BA_ "GenSigInactiveValue" SG_ 615 IPB_PlungerPressure 0;
BA_ "GenSigInvalidValue" SG_ 615 IPB_PlungerPressure 0;
BA_ "GenSigSendType" SG_ 615 IPB_PlungerPressure 1;
BA_ "GenSigStartValue" SG_ 615 IPB_PlungerPressure 17;
BA_ "GenSigTimeoutValue" SG_ 615 IPB_PlungerPressure 0;
BA_ "Remark" SG_ 615 IPB_PlungerPressure "";
BA_ "EventCommandSignal" SG_ 615 IPB_PlungerPressureSt 0;
BA_ "GatewayedSignals" SG_ 615 IPB_PlungerPressureSt 0;
BA_ "GenSigInactiveValue" SG_ 615 IPB_PlungerPressureSt 0;
BA_ "GenSigInvalidValue" SG_ 615 IPB_PlungerPressureSt 0;
BA_ "GenSigSendType" SG_ 615 IPB_PlungerPressureSt 1;
BA_ "GenSigStartValue" SG_ 615 IPB_PlungerPressureSt 0;
BA_ "GenSigTimeoutValue" SG_ 615 IPB_PlungerPressureSt 0;
BA_ "Remark" SG_ 615 IPB_PlungerPressureSt "";
BA_ "EventCommandSignal" SG_ 352 BCS_2_CRC 0;
BA_ "GatewayedSignals" SG_ 352 BCS_2_CRC 0;
BA_ "GenSigInactiveValue" SG_ 352 BCS_2_CRC 0;
BA_ "GenSigInvalidValue" SG_ 352 BCS_2_CRC 0;
BA_ "GenSigSendType" SG_ 352 BCS_2_CRC 1;
BA_ "GenSigStartValue" SG_ 352 BCS_2_CRC 0;
BA_ "GenSigTimeoutValue" SG_ 352 BCS_2_CRC 0;
BA_ "Remark" SG_ 352 BCS_2_CRC "";
BA_ "EventCommandSignal" SG_ 352 BCS_2_Counter 0;
BA_ "GatewayedSignals" SG_ 352 BCS_2_Counter 0;
BA_ "GenSigInactiveValue" SG_ 352 BCS_2_Counter 0;
BA_ "GenSigInvalidValue" SG_ 352 BCS_2_Counter 0;
BA_ "GenSigSendType" SG_ 352 BCS_2_Counter 1;
BA_ "GenSigStartValue" SG_ 352 BCS_2_Counter 0;
BA_ "GenSigTimeoutValue" SG_ 352 BCS_2_Counter 0;
BA_ "Remark" SG_ 352 BCS_2_Counter "";
BA_ "EventCommandSignal" SG_ 352 BCS_VehSpd 0;
BA_ "GatewayedSignals" SG_ 352 BCS_VehSpd 0;
BA_ "GenSigInactiveValue" SG_ 352 BCS_VehSpd 0;
BA_ "GenSigInvalidValue" SG_ 352 BCS_VehSpd 0;
BA_ "GenSigSendType" SG_ 352 BCS_VehSpd 1;
BA_ "GenSigStartValue" SG_ 352 BCS_VehSpd 0;
BA_ "GenSigTimeoutValue" SG_ 352 BCS_VehSpd 0;
BA_ "Remark" SG_ 352 BCS_VehSpd "";
BA_ "EventCommandSignal" SG_ 352 BCS_VehSpdVD 0;
BA_ "GatewayedSignals" SG_ 352 BCS_VehSpdVD 0;
BA_ "GenSigInactiveValue" SG_ 352 BCS_VehSpdVD 0;
BA_ "GenSigInvalidValue" SG_ 352 BCS_VehSpdVD 0;
BA_ "GenSigSendType" SG_ 352 BCS_VehSpdVD 1;
BA_ "GenSigStartValue" SG_ 352 BCS_VehSpdVD 0;
BA_ "GenSigTimeoutValue" SG_ 352 BCS_VehSpdVD 0;
BA_ "Remark" SG_ 352 BCS_VehSpdVD "";
BA_ "EventCommandSignal" SG_ 352 BCS_EBDActiveSt 0;
BA_ "GatewayedSignals" SG_ 352 BCS_EBDActiveSt 0;
BA_ "GenSigInactiveValue" SG_ 352 BCS_EBDActiveSt 0;
BA_ "GenSigInvalidValue" SG_ 352 BCS_EBDActiveSt 0;
BA_ "GenSigSendType" SG_ 352 BCS_EBDActiveSt 1;
BA_ "GenSigStartValue" SG_ 352 BCS_EBDActiveSt 0;
BA_ "GenSigTimeoutValue" SG_ 352 BCS_EBDActiveSt 0;
BA_ "Remark" SG_ 352 BCS_EBDActiveSt "";
BA_ "EventCommandSignal" SG_ 352 BCS_EBDFaultSt 0;
BA_ "GatewayedSignals" SG_ 352 BCS_EBDFaultSt 0;
BA_ "GenSigInactiveValue" SG_ 352 BCS_EBDFaultSt 0;
BA_ "GenSigInvalidValue" SG_ 352 BCS_EBDFaultSt 0;
BA_ "GenSigSendType" SG_ 352 BCS_EBDFaultSt 1;
BA_ "GenSigStartValue" SG_ 352 BCS_EBDFaultSt 1;
BA_ "GenSigTimeoutValue" SG_ 352 BCS_EBDFaultSt 1;
BA_ "Remark" SG_ 352 BCS_EBDFaultSt "";
BA_ "EventCommandSignal" SG_ 352 BCS_ABSActiveSt 0;
BA_ "GatewayedSignals" SG_ 352 BCS_ABSActiveSt 0;
BA_ "GenSigInactiveValue" SG_ 352 BCS_ABSActiveSt 0;
BA_ "GenSigInvalidValue" SG_ 352 BCS_ABSActiveSt 0;
BA_ "GenSigSendType" SG_ 352 BCS_ABSActiveSt 1;
BA_ "GenSigStartValue" SG_ 352 BCS_ABSActiveSt 0;
BA_ "GenSigTimeoutValue" SG_ 352 BCS_ABSActiveSt 0;
BA_ "Remark" SG_ 352 BCS_ABSActiveSt "";
BA_ "EventCommandSignal" SG_ 352 BCS_ABSFaultSt 0;
BA_ "GatewayedSignals" SG_ 352 BCS_ABSFaultSt 0;
BA_ "GenSigInactiveValue" SG_ 352 BCS_ABSFaultSt 0;
BA_ "GenSigInvalidValue" SG_ 352 BCS_ABSFaultSt 0;
BA_ "GenSigSendType" SG_ 352 BCS_ABSFaultSt 1;
BA_ "GenSigStartValue" SG_ 352 BCS_ABSFaultSt 1;
BA_ "GenSigTimeoutValue" SG_ 352 BCS_ABSFaultSt 1;
BA_ "Remark" SG_ 352 BCS_ABSFaultSt "";
BA_ "EventCommandSignal" SG_ 352 BCS_TCSActiveSt 0;
BA_ "GatewayedSignals" SG_ 352 BCS_TCSActiveSt 0;
BA_ "GenSigInactiveValue" SG_ 352 BCS_TCSActiveSt 0;
BA_ "GenSigInvalidValue" SG_ 352 BCS_TCSActiveSt 0;
BA_ "GenSigSendType" SG_ 352 BCS_TCSActiveSt 1;
BA_ "GenSigStartValue" SG_ 352 BCS_TCSActiveSt 0;
BA_ "GenSigTimeoutValue" SG_ 352 BCS_TCSActiveSt 0;
BA_ "Remark" SG_ 352 BCS_TCSActiveSt "";
BA_ "EventCommandSignal" SG_ 352 BCS_TCSFaultSt 0;
BA_ "GatewayedSignals" SG_ 352 BCS_TCSFaultSt 0;
BA_ "GenSigInactiveValue" SG_ 352 BCS_TCSFaultSt 0;
BA_ "GenSigInvalidValue" SG_ 352 BCS_TCSFaultSt 0;
BA_ "GenSigSendType" SG_ 352 BCS_TCSFaultSt 1;
BA_ "GenSigStartValue" SG_ 352 BCS_TCSFaultSt 1;
BA_ "GenSigTimeoutValue" SG_ 352 BCS_TCSFaultSt 1;
BA_ "Remark" SG_ 352 BCS_TCSFaultSt "";
BA_ "EventCommandSignal" SG_ 352 BCS_VDCActiveSt 0;
BA_ "GatewayedSignals" SG_ 352 BCS_VDCActiveSt 0;
BA_ "GenSigInactiveValue" SG_ 352 BCS_VDCActiveSt 0;
BA_ "GenSigInvalidValue" SG_ 352 BCS_VDCActiveSt 0;
BA_ "GenSigSendType" SG_ 352 BCS_VDCActiveSt 1;
BA_ "GenSigStartValue" SG_ 352 BCS_VDCActiveSt 0;
BA_ "GenSigTimeoutValue" SG_ 352 BCS_VDCActiveSt 0;
BA_ "Remark" SG_ 352 BCS_VDCActiveSt "";
BA_ "EventCommandSignal" SG_ 352 BCS_VDCFaultSt 0;
BA_ "GatewayedSignals" SG_ 352 BCS_VDCFaultSt 0;
BA_ "GenSigInactiveValue" SG_ 352 BCS_VDCFaultSt 0;
BA_ "GenSigInvalidValue" SG_ 352 BCS_VDCFaultSt 0;
BA_ "GenSigSendType" SG_ 352 BCS_VDCFaultSt 1;
BA_ "GenSigStartValue" SG_ 352 BCS_VDCFaultSt 1;
BA_ "GenSigTimeoutValue" SG_ 352 BCS_VDCFaultSt 1;
BA_ "Remark" SG_ 352 BCS_VDCFaultSt "";
BA_ "EventCommandSignal" SG_ 352 BCS_EngTorqDecActiveSt 0;
BA_ "GatewayedSignals" SG_ 352 BCS_EngTorqDecActiveSt 0;
BA_ "GenSigInactiveValue" SG_ 352 BCS_EngTorqDecActiveSt 0;
BA_ "GenSigInvalidValue" SG_ 352 BCS_EngTorqDecActiveSt 0;
BA_ "GenSigSendType" SG_ 352 BCS_EngTorqDecActiveSt 1;
BA_ "GenSigStartValue" SG_ 352 BCS_EngTorqDecActiveSt 0;
BA_ "GenSigTimeoutValue" SG_ 352 BCS_EngTorqDecActiveSt 0;
BA_ "Remark" SG_ 352 BCS_EngTorqDecActiveSt "";
BA_ "EventCommandSignal" SG_ 352 BCS_EngTorqIncActiveSt 0;
BA_ "GatewayedSignals" SG_ 352 BCS_EngTorqIncActiveSt 0;
BA_ "GenSigInactiveValue" SG_ 352 BCS_EngTorqIncActiveSt 0;
BA_ "GenSigInvalidValue" SG_ 352 BCS_EngTorqIncActiveSt 0;
BA_ "GenSigSendType" SG_ 352 BCS_EngTorqIncActiveSt 1;
BA_ "GenSigStartValue" SG_ 352 BCS_EngTorqIncActiveSt 0;
BA_ "GenSigTimeoutValue" SG_ 352 BCS_EngTorqIncActiveSt 0;
BA_ "Remark" SG_ 352 BCS_EngTorqIncActiveSt "";
BA_ "EventCommandSignal" SG_ 352 BCS_RegenModulationAvailable 0;
BA_ "GatewayedSignals" SG_ 352 BCS_RegenModulationAvailable 0;
BA_ "GenSigInactiveValue" SG_ 352 BCS_RegenModulationAvailable 0;
BA_ "GenSigInvalidValue" SG_ 352 BCS_RegenModulationAvailable 0;
BA_ "GenSigSendType" SG_ 352 BCS_RegenModulationAvailable 1;
BA_ "GenSigStartValue" SG_ 352 BCS_RegenModulationAvailable 0;
BA_ "GenSigTimeoutValue" SG_ 352 BCS_RegenModulationAvailable 0;
BA_ "Remark" SG_ 352 BCS_RegenModulationAvailable "";
BA_ "EventCommandSignal" SG_ 352 BCS_RegenModuleActive 0;
BA_ "GatewayedSignals" SG_ 352 BCS_RegenModuleActive 0;
BA_ "GenSigInactiveValue" SG_ 352 BCS_RegenModuleActive 0;
BA_ "GenSigInvalidValue" SG_ 352 BCS_RegenModuleActive 0;
BA_ "GenSigSendType" SG_ 352 BCS_RegenModuleActive 1;
BA_ "GenSigStartValue" SG_ 352 BCS_RegenModuleActive 0;
BA_ "GenSigTimeoutValue" SG_ 352 BCS_RegenModuleActive 0;
BA_ "Remark" SG_ 352 BCS_RegenModuleActive "";
BA_ "EventCommandSignal" SG_ 352 BCS_EngTorqDecFastRANm 0;
BA_ "GatewayedSignals" SG_ 352 BCS_EngTorqDecFastRANm 0;
BA_ "GenSigInactiveValue" SG_ 352 BCS_EngTorqDecFastRANm 0;
BA_ "GenSigInvalidValue" SG_ 352 BCS_EngTorqDecFastRANm 0;
BA_ "GenSigSendType" SG_ 352 BCS_EngTorqDecFastRANm 1;
BA_ "GenSigStartValue" SG_ 352 BCS_EngTorqDecFastRANm 60000;
BA_ "GenSigTimeoutValue" SG_ 352 BCS_EngTorqDecFastRANm 0;
BA_ "Remark" SG_ 352 BCS_EngTorqDecFastRANm "";
BA_ "EventCommandSignal" SG_ 352 BCS_EngTorqIncRANm 0;
BA_ "GatewayedSignals" SG_ 352 BCS_EngTorqIncRANm 0;
BA_ "GenSigInactiveValue" SG_ 352 BCS_EngTorqIncRANm 0;
BA_ "GenSigInvalidValue" SG_ 352 BCS_EngTorqIncRANm 0;
BA_ "GenSigSendType" SG_ 352 BCS_EngTorqIncRANm 1;
BA_ "GenSigStartValue" SG_ 352 BCS_EngTorqIncRANm 0;
BA_ "GenSigTimeoutValue" SG_ 352 BCS_EngTorqIncRANm 0;
BA_ "Remark" SG_ 352 BCS_EngTorqIncRANm "";
BA_ "EventCommandSignal" SG_ 352 BCS_RealTCSActiveSt 0;
BA_ "GatewayedSignals" SG_ 352 BCS_RealTCSActiveSt 0;
BA_ "GenSigInactiveValue" SG_ 352 BCS_RealTCSActiveSt 0;
BA_ "GenSigInvalidValue" SG_ 352 BCS_RealTCSActiveSt 0;
BA_ "GenSigSendType" SG_ 352 BCS_RealTCSActiveSt 1;
BA_ "GenSigStartValue" SG_ 352 BCS_RealTCSActiveSt 0;
BA_ "GenSigTimeoutValue" SG_ 352 BCS_RealTCSActiveSt 0;
BA_ "Remark" SG_ 352 BCS_RealTCSActiveSt "";
BA_ "EventCommandSignal" SG_ 352 BCS_TargetRecpTorqRq 0;
BA_ "GatewayedSignals" SG_ 352 BCS_TargetRecpTorqRq 0;
BA_ "GenSigInactiveValue" SG_ 352 BCS_TargetRecpTorqRq 0;
BA_ "GenSigInvalidValue" SG_ 352 BCS_TargetRecpTorqRq 0;
BA_ "GenSigSendType" SG_ 352 BCS_TargetRecpTorqRq 1;
BA_ "GenSigStartValue" SG_ 352 BCS_TargetRecpTorqRq 6000;
BA_ "GenSigTimeoutValue" SG_ 352 BCS_TargetRecpTorqRq 0;
BA_ "Remark" SG_ 352 BCS_TargetRecpTorqRq "";
BA_ "EventCommandSignal" SG_ 352 BCS_TargetRecpTorqRqSt 0;
BA_ "GatewayedSignals" SG_ 352 BCS_TargetRecpTorqRqSt 0;
BA_ "GenSigInactiveValue" SG_ 352 BCS_TargetRecpTorqRqSt 0;
BA_ "GenSigInvalidValue" SG_ 352 BCS_TargetRecpTorqRqSt 0;
BA_ "GenSigSendType" SG_ 352 BCS_TargetRecpTorqRqSt 1;
BA_ "GenSigStartValue" SG_ 352 BCS_TargetRecpTorqRqSt 0;
BA_ "GenSigTimeoutValue" SG_ 352 BCS_TargetRecpTorqRqSt 0;
BA_ "Remark" SG_ 352 BCS_TargetRecpTorqRqSt "";
BA_ "EventCommandSignal" SG_ 352 BCS_CrbsActive 0;
BA_ "GatewayedSignals" SG_ 352 BCS_CrbsActive 0;
BA_ "GenSigInactiveValue" SG_ 352 BCS_CrbsActive 0;
BA_ "GenSigInvalidValue" SG_ 352 BCS_CrbsActive 0;
BA_ "GenSigSendType" SG_ 352 BCS_CrbsActive 1;
BA_ "GenSigStartValue" SG_ 352 BCS_CrbsActive 0;
BA_ "GenSigTimeoutValue" SG_ 352 BCS_CrbsActive 0;
BA_ "Remark" SG_ 352 BCS_CrbsActive "";
BA_ "EventCommandSignal" SG_ 352 BCS_EngTorqDecFastFA 0;
BA_ "GatewayedSignals" SG_ 352 BCS_EngTorqDecFastFA 0;
BA_ "GenSigInactiveValue" SG_ 352 BCS_EngTorqDecFastFA 0;
BA_ "GenSigInvalidValue" SG_ 352 BCS_EngTorqDecFastFA 0;
BA_ "GenSigSendType" SG_ 352 BCS_EngTorqDecFastFA 1;
BA_ "GenSigStartValue" SG_ 352 BCS_EngTorqDecFastFA 255;
BA_ "GenSigTimeoutValue" SG_ 352 BCS_EngTorqDecFastFA 0;
BA_ "Remark" SG_ 352 BCS_EngTorqDecFastFA "";
BA_ "EventCommandSignal" SG_ 352 BCS_TargetRecpTorqRqFA 0;
BA_ "GatewayedSignals" SG_ 352 BCS_TargetRecpTorqRqFA 0;
BA_ "GenSigInactiveValue" SG_ 352 BCS_TargetRecpTorqRqFA 0;
BA_ "GenSigInvalidValue" SG_ 352 BCS_TargetRecpTorqRqFA 0;
BA_ "GenSigSendType" SG_ 352 BCS_TargetRecpTorqRqFA 1;
BA_ "GenSigStartValue" SG_ 352 BCS_TargetRecpTorqRqFA 6000;
BA_ "GenSigTimeoutValue" SG_ 352 BCS_TargetRecpTorqRqFA 0;
BA_ "Remark" SG_ 352 BCS_TargetRecpTorqRqFA "";
BA_ "EventCommandSignal" SG_ 352 BCS_TargetRecpTorqRqFASt 0;
BA_ "GatewayedSignals" SG_ 352 BCS_TargetRecpTorqRqFASt 0;
BA_ "GenSigInactiveValue" SG_ 352 BCS_TargetRecpTorqRqFASt 0;
BA_ "GenSigInvalidValue" SG_ 352 BCS_TargetRecpTorqRqFASt 0;
BA_ "GenSigSendType" SG_ 352 BCS_TargetRecpTorqRqFASt 1;
BA_ "GenSigStartValue" SG_ 352 BCS_TargetRecpTorqRqFASt 0;
BA_ "GenSigTimeoutValue" SG_ 352 BCS_TargetRecpTorqRqFASt 0;
BA_ "Remark" SG_ 352 BCS_TargetRecpTorqRqFASt "";
BA_ "EventCommandSignal" SG_ 352 BCS_TargetRecpTorqRqRA 0;
BA_ "GatewayedSignals" SG_ 352 BCS_TargetRecpTorqRqRA 0;
BA_ "GenSigInactiveValue" SG_ 352 BCS_TargetRecpTorqRqRA 0;
BA_ "GenSigInvalidValue" SG_ 352 BCS_TargetRecpTorqRqRA 0;
BA_ "GenSigSendType" SG_ 352 BCS_TargetRecpTorqRqRA 1;
BA_ "GenSigStartValue" SG_ 352 BCS_TargetRecpTorqRqRA 6000;
BA_ "GenSigTimeoutValue" SG_ 352 BCS_TargetRecpTorqRqRA 0;
BA_ "Remark" SG_ 352 BCS_TargetRecpTorqRqRA "";
BA_ "EventCommandSignal" SG_ 352 BCS_TargetRecpTorqRqRASt 0;
BA_ "GatewayedSignals" SG_ 352 BCS_TargetRecpTorqRqRASt 0;
BA_ "GenSigInactiveValue" SG_ 352 BCS_TargetRecpTorqRqRASt 0;
BA_ "GenSigInvalidValue" SG_ 352 BCS_TargetRecpTorqRqRASt 0;
BA_ "GenSigSendType" SG_ 352 BCS_TargetRecpTorqRqRASt 1;
BA_ "GenSigStartValue" SG_ 352 BCS_TargetRecpTorqRqRASt 0;
BA_ "GenSigTimeoutValue" SG_ 352 BCS_TargetRecpTorqRqRASt 0;
BA_ "Remark" SG_ 352 BCS_TargetRecpTorqRqRASt "";
BA_ "EventCommandSignal" SG_ 352 IPB_BrakePedalSt 0;
BA_ "GatewayedSignals" SG_ 352 IPB_BrakePedalSt 0;
BA_ "GenSigInactiveValue" SG_ 352 IPB_BrakePedalSt 0;
BA_ "GenSigInvalidValue" SG_ 352 IPB_BrakePedalSt 0;
BA_ "GenSigSendType" SG_ 352 IPB_BrakePedalSt 1;
BA_ "GenSigStartValue" SG_ 352 IPB_BrakePedalSt 0;
BA_ "GenSigTimeoutValue" SG_ 352 IPB_BrakePedalSt 0;
BA_ "Remark" SG_ 352 IPB_BrakePedalSt "";
BA_ "EventCommandSignal" SG_ 352 IPB_BrakePedalStsVld 0;
BA_ "GatewayedSignals" SG_ 352 IPB_BrakePedalStsVld 0;
BA_ "GenSigInactiveValue" SG_ 352 IPB_BrakePedalStsVld 0;
BA_ "GenSigInvalidValue" SG_ 352 IPB_BrakePedalStsVld 0;
BA_ "GenSigSendType" SG_ 352 IPB_BrakePedalStsVld 1;
BA_ "GenSigStartValue" SG_ 352 IPB_BrakePedalStsVld 0;
BA_ "GenSigTimeoutValue" SG_ 352 IPB_BrakePedalStsVld 0;
BA_ "Remark" SG_ 352 IPB_BrakePedalStsVld "";
BA_ "EventCommandSignal" SG_ 352 BCS_ESP2Park_DrvBrkOverrideFlg 0;
BA_ "GatewayedSignals" SG_ 352 BCS_ESP2Park_DrvBrkOverrideFlg 0;
BA_ "GenSigInactiveValue" SG_ 352 BCS_ESP2Park_DrvBrkOverrideFlg 0;
BA_ "GenSigInvalidValue" SG_ 352 BCS_ESP2Park_DrvBrkOverrideFlg 0;
BA_ "GenSigSendType" SG_ 352 BCS_ESP2Park_DrvBrkOverrideFlg 1;
BA_ "GenSigStartValue" SG_ 352 BCS_ESP2Park_DrvBrkOverrideFlg 0;
BA_ "GenSigTimeoutValue" SG_ 352 BCS_ESP2Park_DrvBrkOverrideFlg 0;
BA_ "Remark" SG_ 352 BCS_ESP2Park_DrvBrkOverrideFlg "";
BA_ "EventCommandSignal" SG_ 352 BCS_EngTorqDecActiveStRA 0;
BA_ "GatewayedSignals" SG_ 352 BCS_EngTorqDecActiveStRA 0;
BA_ "GenSigInactiveValue" SG_ 352 BCS_EngTorqDecActiveStRA 0;
BA_ "GenSigInvalidValue" SG_ 352 BCS_EngTorqDecActiveStRA 0;
BA_ "GenSigSendType" SG_ 352 BCS_EngTorqDecActiveStRA 1;
BA_ "GenSigStartValue" SG_ 352 BCS_EngTorqDecActiveStRA 0;
BA_ "GenSigTimeoutValue" SG_ 352 BCS_EngTorqDecActiveStRA 0;
BA_ "Remark" SG_ 352 BCS_EngTorqDecActiveStRA "";
BA_ "EventCommandSignal" SG_ 352 BCS_EngTorqIncActiveStRA 0;
BA_ "GatewayedSignals" SG_ 352 BCS_EngTorqIncActiveStRA 0;
BA_ "GenSigInactiveValue" SG_ 352 BCS_EngTorqIncActiveStRA 0;
BA_ "GenSigInvalidValue" SG_ 352 BCS_EngTorqIncActiveStRA 0;
BA_ "GenSigSendType" SG_ 352 BCS_EngTorqIncActiveStRA 1;
BA_ "GenSigStartValue" SG_ 352 BCS_EngTorqIncActiveStRA 0;
BA_ "GenSigTimeoutValue" SG_ 352 BCS_EngTorqIncActiveStRA 0;
BA_ "Remark" SG_ 352 BCS_EngTorqIncActiveStRA "";
BA_ "EventCommandSignal" SG_ 352 BCS_EngTorqIncActiveStFA 0;
BA_ "GatewayedSignals" SG_ 352 BCS_EngTorqIncActiveStFA 0;
BA_ "GenSigInactiveValue" SG_ 352 BCS_EngTorqIncActiveStFA 0;
BA_ "GenSigInvalidValue" SG_ 352 BCS_EngTorqIncActiveStFA 0;
BA_ "GenSigSendType" SG_ 352 BCS_EngTorqIncActiveStFA 1;
BA_ "GenSigStartValue" SG_ 352 BCS_EngTorqIncActiveStFA 0;
BA_ "GenSigTimeoutValue" SG_ 352 BCS_EngTorqIncActiveStFA 0;
BA_ "Remark" SG_ 352 BCS_EngTorqIncActiveStFA "";
BA_ "EventCommandSignal" SG_ 352 BCS_EngTorqDecFastRA 0;
BA_ "GatewayedSignals" SG_ 352 BCS_EngTorqDecFastRA 0;
BA_ "GenSigInactiveValue" SG_ 352 BCS_EngTorqDecFastRA 0;
BA_ "GenSigInvalidValue" SG_ 352 BCS_EngTorqDecFastRA 0;
BA_ "GenSigSendType" SG_ 352 BCS_EngTorqDecFastRA 1;
BA_ "GenSigStartValue" SG_ 352 BCS_EngTorqDecFastRA 255;
BA_ "GenSigTimeoutValue" SG_ 352 BCS_EngTorqDecFastRA 0;
BA_ "Remark" SG_ 352 BCS_EngTorqDecFastRA "";
BA_ "EventCommandSignal" SG_ 352 BCS_EngTorqIncRA 0;
BA_ "GatewayedSignals" SG_ 352 BCS_EngTorqIncRA 0;
BA_ "GenSigInactiveValue" SG_ 352 BCS_EngTorqIncRA 0;
BA_ "GenSigInvalidValue" SG_ 352 BCS_EngTorqIncRA 0;
BA_ "GenSigSendType" SG_ 352 BCS_EngTorqIncRA 1;
BA_ "GenSigStartValue" SG_ 352 BCS_EngTorqIncRA 255;
BA_ "GenSigTimeoutValue" SG_ 352 BCS_EngTorqIncRA 0;
BA_ "Remark" SG_ 352 BCS_EngTorqIncRA "";
BA_ "EventCommandSignal" SG_ 352 BCS_EngTorqDecActiveStFA 0;
BA_ "GatewayedSignals" SG_ 352 BCS_EngTorqDecActiveStFA 0;
BA_ "GenSigInactiveValue" SG_ 352 BCS_EngTorqDecActiveStFA 0;
BA_ "GenSigInvalidValue" SG_ 352 BCS_EngTorqDecActiveStFA 0;
BA_ "GenSigSendType" SG_ 352 BCS_EngTorqDecActiveStFA 1;
BA_ "GenSigStartValue" SG_ 352 BCS_EngTorqDecActiveStFA 0;
BA_ "GenSigTimeoutValue" SG_ 352 BCS_EngTorqDecActiveStFA 0;
BA_ "Remark" SG_ 352 BCS_EngTorqDecActiveStFA "";
BA_ "EventCommandSignal" SG_ 352 BCS_PrimBrkCDAAvailableSt 0;
BA_ "GatewayedSignals" SG_ 352 BCS_PrimBrkCDAAvailableSt 0;
BA_ "GenSigInactiveValue" SG_ 352 BCS_PrimBrkCDAAvailableSt 0;
BA_ "GenSigInvalidValue" SG_ 352 BCS_PrimBrkCDAAvailableSt 0;
BA_ "GenSigSendType" SG_ 352 BCS_PrimBrkCDAAvailableSt 1;
BA_ "GenSigStartValue" SG_ 352 BCS_PrimBrkCDAAvailableSt 0;
BA_ "GenSigTimeoutValue" SG_ 352 BCS_PrimBrkCDAAvailableSt 0;
BA_ "Remark" SG_ 352 BCS_PrimBrkCDAAvailableSt "";
BA_ "EventCommandSignal" SG_ 352 BCS_PrimBrkCommuniSt 0;
BA_ "GatewayedSignals" SG_ 352 BCS_PrimBrkCommuniSt 0;
BA_ "GenSigInactiveValue" SG_ 352 BCS_PrimBrkCommuniSt 0;
BA_ "GenSigInvalidValue" SG_ 352 BCS_PrimBrkCommuniSt 0;
BA_ "GenSigSendType" SG_ 352 BCS_PrimBrkCommuniSt 1;
BA_ "GenSigStartValue" SG_ 352 BCS_PrimBrkCommuniSt 0;
BA_ "GenSigTimeoutValue" SG_ 352 BCS_PrimBrkCommuniSt 0;
BA_ "Remark" SG_ 352 BCS_PrimBrkCommuniSt "";
BA_ "EventCommandSignal" SG_ 352 BCS_PrimBrkActiveSt 0;
BA_ "GatewayedSignals" SG_ 352 BCS_PrimBrkActiveSt 0;
BA_ "GenSigInactiveValue" SG_ 352 BCS_PrimBrkActiveSt 0;
BA_ "GenSigInvalidValue" SG_ 352 BCS_PrimBrkActiveSt 0;
BA_ "GenSigSendType" SG_ 352 BCS_PrimBrkActiveSt 1;
BA_ "GenSigStartValue" SG_ 352 BCS_PrimBrkActiveSt 0;
BA_ "GenSigTimeoutValue" SG_ 352 BCS_PrimBrkActiveSt 0;
BA_ "Remark" SG_ 352 BCS_PrimBrkActiveSt "";
BA_ "EventCommandSignal" SG_ 352 BCS_PrimBrkSuspendSt 0;
BA_ "GatewayedSignals" SG_ 352 BCS_PrimBrkSuspendSt 0;
BA_ "GenSigInactiveValue" SG_ 352 BCS_PrimBrkSuspendSt 0;
BA_ "GenSigInvalidValue" SG_ 352 BCS_PrimBrkSuspendSt 0;
BA_ "GenSigSendType" SG_ 352 BCS_PrimBrkSuspendSt 1;
BA_ "GenSigStartValue" SG_ 352 BCS_PrimBrkSuspendSt 0;
BA_ "GenSigTimeoutValue" SG_ 352 BCS_PrimBrkSuspendSt 0;
BA_ "Remark" SG_ 352 BCS_PrimBrkSuspendSt "";
BA_ "EventCommandSignal" SG_ 352 BCS_2ParkDynamicAVPavailability 0;
BA_ "GatewayedSignals" SG_ 352 BCS_2ParkDynamicAVPavailability 0;
BA_ "GenSigInactiveValue" SG_ 352 BCS_2ParkDynamicAVPavailability 0;
BA_ "GenSigInvalidValue" SG_ 352 BCS_2ParkDynamicAVPavailability 0;
BA_ "GenSigSendType" SG_ 352 BCS_2ParkDynamicAVPavailability 1;
BA_ "GenSigStartValue" SG_ 352 BCS_2ParkDynamicAVPavailability 0;
BA_ "GenSigTimeoutValue" SG_ 352 BCS_2ParkDynamicAVPavailability 0;
BA_ "Remark" SG_ 352 BCS_2ParkDynamicAVPavailability "";
BA_ "EventCommandSignal" SG_ 352 BCS_2ParkCddApActiveVehHld 0;
BA_ "GatewayedSignals" SG_ 352 BCS_2ParkCddApActiveVehHld 0;
BA_ "GenSigInactiveValue" SG_ 352 BCS_2ParkCddApActiveVehHld 0;
BA_ "GenSigInvalidValue" SG_ 352 BCS_2ParkCddApActiveVehHld 0;
BA_ "GenSigSendType" SG_ 352 BCS_2ParkCddApActiveVehHld 1;
BA_ "GenSigStartValue" SG_ 352 BCS_2ParkCddApActiveVehHld 0;
BA_ "GenSigTimeoutValue" SG_ 352 BCS_2ParkCddApActiveVehHld 0;
BA_ "Remark" SG_ 352 BCS_2ParkCddApActiveVehHld "";
BA_ "EventCommandSignal" SG_ 352 BCS_2ParkAPCStatus 0;
BA_ "GatewayedSignals" SG_ 352 BCS_2ParkAPCStatus 0;
BA_ "GenSigInactiveValue" SG_ 352 BCS_2ParkAPCStatus 0;
BA_ "GenSigInvalidValue" SG_ 352 BCS_2ParkAPCStatus 0;
BA_ "GenSigSendType" SG_ 352 BCS_2ParkAPCStatus 1;
BA_ "GenSigStartValue" SG_ 352 BCS_2ParkAPCStatus 0;
BA_ "GenSigTimeoutValue" SG_ 352 BCS_2ParkAPCStatus 0;
BA_ "Remark" SG_ 352 BCS_2ParkAPCStatus "";
BA_ "EventCommandSignal" SG_ 352 BCS_2ParkAPAavailability 0;
BA_ "GatewayedSignals" SG_ 352 BCS_2ParkAPAavailability 0;
BA_ "GenSigInactiveValue" SG_ 352 BCS_2ParkAPAavailability 0;
BA_ "GenSigInvalidValue" SG_ 352 BCS_2ParkAPAavailability 0;
BA_ "GenSigSendType" SG_ 352 BCS_2ParkAPAavailability 1;
BA_ "GenSigStartValue" SG_ 352 BCS_2ParkAPAavailability 0;
BA_ "GenSigTimeoutValue" SG_ 352 BCS_2ParkAPAavailability 0;
BA_ "Remark" SG_ 352 BCS_2ParkAPAavailability "";
BA_ "EventCommandSignal" SG_ 352 BCS_2ParkRPAAVPavailability 0;
BA_ "GatewayedSignals" SG_ 352 BCS_2ParkRPAAVPavailability 0;
BA_ "GenSigInactiveValue" SG_ 352 BCS_2ParkRPAAVPavailability 0;
BA_ "GenSigInvalidValue" SG_ 352 BCS_2ParkRPAAVPavailability 0;
BA_ "GenSigSendType" SG_ 352 BCS_2ParkRPAAVPavailability 1;
BA_ "GenSigStartValue" SG_ 352 BCS_2ParkRPAAVPavailability 0;
BA_ "GenSigTimeoutValue" SG_ 352 BCS_2ParkRPAAVPavailability 0;
BA_ "Remark" SG_ 352 BCS_2ParkRPAAVPavailability "";
BA_ "EventCommandSignal" SG_ 352 BCS_2ParkAPCFailureSts 0;
BA_ "GatewayedSignals" SG_ 352 BCS_2ParkAPCFailureSts 0;
BA_ "GenSigInactiveValue" SG_ 352 BCS_2ParkAPCFailureSts 0;
BA_ "GenSigInvalidValue" SG_ 352 BCS_2ParkAPCFailureSts 0;
BA_ "GenSigSendType" SG_ 352 BCS_2ParkAPCFailureSts 1;
BA_ "GenSigStartValue" SG_ 352 BCS_2ParkAPCFailureSts 0;
BA_ "GenSigTimeoutValue" SG_ 352 BCS_2ParkAPCFailureSts 0;
BA_ "Remark" SG_ 352 BCS_2ParkAPCFailureSts "";
BA_ "EventCommandSignal" SG_ 352 BCS_APCMain2BackupReq 0;
BA_ "GatewayedSignals" SG_ 352 BCS_APCMain2BackupReq 0;
BA_ "GenSigInactiveValue" SG_ 352 BCS_APCMain2BackupReq 0;
BA_ "GenSigInvalidValue" SG_ 352 BCS_APCMain2BackupReq 0;
BA_ "GenSigSendType" SG_ 352 BCS_APCMain2BackupReq 1;
BA_ "GenSigStartValue" SG_ 352 BCS_APCMain2BackupReq 0;
BA_ "GenSigTimeoutValue" SG_ 352 BCS_APCMain2BackupReq 0;
BA_ "Remark" SG_ 352 BCS_APCMain2BackupReq "";
BA_ "EventCommandSignal" SG_ 352 BCS_PrimBrkCtrlUsedChannel 0;
BA_ "GatewayedSignals" SG_ 352 BCS_PrimBrkCtrlUsedChannel 0;
BA_ "GenSigInactiveValue" SG_ 352 BCS_PrimBrkCtrlUsedChannel 0;
BA_ "GenSigInvalidValue" SG_ 352 BCS_PrimBrkCtrlUsedChannel 0;
BA_ "GenSigSendType" SG_ 352 BCS_PrimBrkCtrlUsedChannel 1;
BA_ "GenSigStartValue" SG_ 352 BCS_PrimBrkCtrlUsedChannel 0;
BA_ "GenSigTimeoutValue" SG_ 352 BCS_PrimBrkCtrlUsedChannel 0;
BA_ "Remark" SG_ 352 BCS_PrimBrkCtrlUsedChannel "";
BA_ "EventCommandSignal" SG_ 352 BCS_PrimBrkCDAActiveSt 0;
BA_ "GatewayedSignals" SG_ 352 BCS_PrimBrkCDAActiveSt 0;
BA_ "GenSigInactiveValue" SG_ 352 BCS_PrimBrkCDAActiveSt 0;
BA_ "GenSigInvalidValue" SG_ 352 BCS_PrimBrkCDAActiveSt 0;
BA_ "GenSigSendType" SG_ 352 BCS_PrimBrkCDAActiveSt 1;
BA_ "GenSigStartValue" SG_ 352 BCS_PrimBrkCDAActiveSt 0;
BA_ "GenSigTimeoutValue" SG_ 352 BCS_PrimBrkCDAActiveSt 0;
BA_ "Remark" SG_ 352 BCS_PrimBrkCDAActiveSt "only send to publiccanfd2";
BA_ "EventCommandSignal" SG_ 352 BCS_PrimBrkDecCtrlActiveSt 0;
BA_ "GatewayedSignals" SG_ 352 BCS_PrimBrkDecCtrlActiveSt 0;
BA_ "GenSigInactiveValue" SG_ 352 BCS_PrimBrkDecCtrlActiveSt 0;
BA_ "GenSigInvalidValue" SG_ 352 BCS_PrimBrkDecCtrlActiveSt 0;
BA_ "GenSigSendType" SG_ 352 BCS_PrimBrkDecCtrlActiveSt 1;
BA_ "GenSigStartValue" SG_ 352 BCS_PrimBrkDecCtrlActiveSt 0;
BA_ "GenSigTimeoutValue" SG_ 352 BCS_PrimBrkDecCtrlActiveSt 0;
BA_ "Remark" SG_ 352 BCS_PrimBrkDecCtrlActiveSt "";
BA_ "EventCommandSignal" SG_ 352 BCS_PrimBrkCDDAvailableSt 0;
BA_ "GatewayedSignals" SG_ 352 BCS_PrimBrkCDDAvailableSt 0;
BA_ "GenSigInactiveValue" SG_ 352 BCS_PrimBrkCDDAvailableSt 0;
BA_ "GenSigInvalidValue" SG_ 352 BCS_PrimBrkCDDAvailableSt 0;
BA_ "GenSigSendType" SG_ 352 BCS_PrimBrkCDDAvailableSt 1;
BA_ "GenSigStartValue" SG_ 352 BCS_PrimBrkCDDAvailableSt 0;
BA_ "GenSigTimeoutValue" SG_ 352 BCS_PrimBrkCDDAvailableSt 0;
BA_ "Remark" SG_ 352 BCS_PrimBrkCDDAvailableSt "";
BA_ "EventCommandSignal" SG_ 352 BCS_EngTorqIncFA 0;
BA_ "GatewayedSignals" SG_ 352 BCS_EngTorqIncFA 0;
BA_ "GenSigInactiveValue" SG_ 352 BCS_EngTorqIncFA 0;
BA_ "GenSigInvalidValue" SG_ 352 BCS_EngTorqIncFA 0;
BA_ "GenSigSendType" SG_ 352 BCS_EngTorqIncFA 1;
BA_ "GenSigStartValue" SG_ 352 BCS_EngTorqIncFA 255;
BA_ "GenSigTimeoutValue" SG_ 352 BCS_EngTorqIncFA 0;
BA_ "Remark" SG_ 352 BCS_EngTorqIncFA "";
BA_ "EventCommandSignal" SG_ 611 BCS_HydBrkActvTq_FL_1 0;
BA_ "GatewayedSignals" SG_ 611 BCS_HydBrkActvTq_FL_1 0;
BA_ "GenSigInactiveValue" SG_ 611 BCS_HydBrkActvTq_FL_1 0;
BA_ "GenSigInvalidValue" SG_ 611 BCS_HydBrkActvTq_FL_1 0;
BA_ "GenSigSendType" SG_ 611 BCS_HydBrkActvTq_FL_1 1;
BA_ "GenSigStartValue" SG_ 611 BCS_HydBrkActvTq_FL_1 0;
BA_ "GenSigTimeoutValue" SG_ 611 BCS_HydBrkActvTq_FL_1 0;
BA_ "Remark" SG_ 611 BCS_HydBrkActvTq_FL_1 "";
BA_ "EventCommandSignal" SG_ 611 BCS_HydBrkActvTq_FR_1 0;
BA_ "GatewayedSignals" SG_ 611 BCS_HydBrkActvTq_FR_1 0;
BA_ "GenSigInactiveValue" SG_ 611 BCS_HydBrkActvTq_FR_1 0;
BA_ "GenSigInvalidValue" SG_ 611 BCS_HydBrkActvTq_FR_1 0;
BA_ "GenSigSendType" SG_ 611 BCS_HydBrkActvTq_FR_1 1;
BA_ "GenSigStartValue" SG_ 611 BCS_HydBrkActvTq_FR_1 0;
BA_ "GenSigTimeoutValue" SG_ 611 BCS_HydBrkActvTq_FR_1 0;
BA_ "Remark" SG_ 611 BCS_HydBrkActvTq_FR_1 "";
BA_ "EventCommandSignal" SG_ 611 BCS_HydBrkActvTq_RL_1 0;
BA_ "GatewayedSignals" SG_ 611 BCS_HydBrkActvTq_RL_1 0;
BA_ "GenSigInactiveValue" SG_ 611 BCS_HydBrkActvTq_RL_1 0;
BA_ "GenSigInvalidValue" SG_ 611 BCS_HydBrkActvTq_RL_1 0;
BA_ "GenSigSendType" SG_ 611 BCS_HydBrkActvTq_RL_1 1;
BA_ "GenSigStartValue" SG_ 611 BCS_HydBrkActvTq_RL_1 0;
BA_ "GenSigTimeoutValue" SG_ 611 BCS_HydBrkActvTq_RL_1 0;
BA_ "Remark" SG_ 611 BCS_HydBrkActvTq_RL_1 "";
BA_ "EventCommandSignal" SG_ 611 BCS_HydBrkActvTq_RR_1 0;
BA_ "GatewayedSignals" SG_ 611 BCS_HydBrkActvTq_RR_1 0;
BA_ "GenSigInactiveValue" SG_ 611 BCS_HydBrkActvTq_RR_1 0;
BA_ "GenSigInvalidValue" SG_ 611 BCS_HydBrkActvTq_RR_1 0;
BA_ "GenSigSendType" SG_ 611 BCS_HydBrkActvTq_RR_1 1;
BA_ "GenSigStartValue" SG_ 611 BCS_HydBrkActvTq_RR_1 0;
BA_ "GenSigTimeoutValue" SG_ 611 BCS_HydBrkActvTq_RR_1 0;
BA_ "Remark" SG_ 611 BCS_HydBrkActvTq_RR_1 "";
BA_ "EventCommandSignal" SG_ 611 BCS_PrimCommPathSt 0;
BA_ "GatewayedSignals" SG_ 611 BCS_PrimCommPathSt 0;
BA_ "GenSigInactiveValue" SG_ 611 BCS_PrimCommPathSt 0;
BA_ "GenSigInvalidValue" SG_ 611 BCS_PrimCommPathSt 0;
BA_ "GenSigSendType" SG_ 611 BCS_PrimCommPathSt 1;
BA_ "GenSigStartValue" SG_ 611 BCS_PrimCommPathSt 0;
BA_ "GenSigTimeoutValue" SG_ 611 BCS_PrimCommPathSt 0;
BA_ "Remark" SG_ 611 BCS_PrimCommPathSt "";
BA_ "EventCommandSignal" SG_ 611 BCS_SeconCommPathSt 0;
BA_ "GatewayedSignals" SG_ 611 BCS_SeconCommPathSt 0;
BA_ "GenSigInactiveValue" SG_ 611 BCS_SeconCommPathSt 0;
BA_ "GenSigInvalidValue" SG_ 611 BCS_SeconCommPathSt 0;
BA_ "GenSigSendType" SG_ 611 BCS_SeconCommPathSt 1;
BA_ "GenSigStartValue" SG_ 611 BCS_SeconCommPathSt 0;
BA_ "GenSigTimeoutValue" SG_ 611 BCS_SeconCommPathSt 0;
BA_ "Remark" SG_ 611 BCS_SeconCommPathSt "";
BA_ "EventCommandSignal" SG_ 611 BCS_PressureHldSt 0;
BA_ "GatewayedSignals" SG_ 611 BCS_PressureHldSt 0;
BA_ "GenSigInactiveValue" SG_ 611 BCS_PressureHldSt 0;
BA_ "GenSigInvalidValue" SG_ 611 BCS_PressureHldSt 0;
BA_ "GenSigSendType" SG_ 611 BCS_PressureHldSt 1;
BA_ "GenSigStartValue" SG_ 611 BCS_PressureHldSt 0;
BA_ "GenSigTimeoutValue" SG_ 611 BCS_PressureHldSt 0;
BA_ "Remark" SG_ 611 BCS_PressureHldSt "";
BA_ "EventCommandSignal" SG_ 611 BCS_CDDFuncSt 0;
BA_ "GatewayedSignals" SG_ 611 BCS_CDDFuncSt 0;
BA_ "GenSigInactiveValue" SG_ 611 BCS_CDDFuncSt 0;
BA_ "GenSigInvalidValue" SG_ 611 BCS_CDDFuncSt 0;
BA_ "GenSigSendType" SG_ 611 BCS_CDDFuncSt 1;
BA_ "GenSigStartValue" SG_ 611 BCS_CDDFuncSt 0;
BA_ "GenSigTimeoutValue" SG_ 611 BCS_CDDFuncSt 0;
BA_ "Remark" SG_ 611 BCS_CDDFuncSt "";
BA_ "EventCommandSignal" SG_ 611 IPB_SimulatorPressure 0;
BA_ "GatewayedSignals" SG_ 611 IPB_SimulatorPressure 0;
BA_ "GenSigInactiveValue" SG_ 611 IPB_SimulatorPressure 0;
BA_ "GenSigInvalidValue" SG_ 611 IPB_SimulatorPressure 0;
BA_ "GenSigSendType" SG_ 611 IPB_SimulatorPressure 1;
BA_ "GenSigStartValue" SG_ 611 IPB_SimulatorPressure 17;
BA_ "GenSigTimeoutValue" SG_ 611 IPB_SimulatorPressure 0;
BA_ "Remark" SG_ 611 IPB_SimulatorPressure "";
BA_ "EventCommandSignal" SG_ 611 IPB_SimulatorPressureSt 0;
BA_ "GatewayedSignals" SG_ 611 IPB_SimulatorPressureSt 0;
BA_ "GenSigInactiveValue" SG_ 611 IPB_SimulatorPressureSt 0;
BA_ "GenSigInvalidValue" SG_ 611 IPB_SimulatorPressureSt 0;
BA_ "GenSigSendType" SG_ 611 IPB_SimulatorPressureSt 1;
BA_ "GenSigStartValue" SG_ 611 IPB_SimulatorPressureSt 0;
BA_ "GenSigTimeoutValue" SG_ 611 IPB_SimulatorPressureSt 0;
BA_ "Remark" SG_ 611 IPB_SimulatorPressureSt "";
BA_ "EventCommandSignal" SG_ 611 IBCS_SystemSt 0;
BA_ "GatewayedSignals" SG_ 611 IBCS_SystemSt 0;
BA_ "GenSigInactiveValue" SG_ 611 IBCS_SystemSt 0;
BA_ "GenSigInvalidValue" SG_ 611 IBCS_SystemSt 0;
BA_ "GenSigSendType" SG_ 611 IBCS_SystemSt 1;
BA_ "GenSigStartValue" SG_ 611 IBCS_SystemSt 0;
BA_ "GenSigTimeoutValue" SG_ 611 IBCS_SystemSt 0;
BA_ "Remark" SG_ 611 IBCS_SystemSt "";
BA_ "EventCommandSignal" SG_ 611 IBCS_FWAWarning 0;
BA_ "GatewayedSignals" SG_ 611 IBCS_FWAWarning 0;
BA_ "GenSigInactiveValue" SG_ 611 IBCS_FWAWarning 0;
BA_ "GenSigInvalidValue" SG_ 611 IBCS_FWAWarning 0;
BA_ "GenSigSendType" SG_ 611 IBCS_FWAWarning 1;
BA_ "GenSigStartValue" SG_ 611 IBCS_FWAWarning 0;
BA_ "GenSigTimeoutValue" SG_ 611 IBCS_FWAWarning 0;
BA_ "Remark" SG_ 611 IBCS_FWAWarning "";
BA_ "EventCommandSignal" SG_ 611 IPB_CSTSt 0;
BA_ "GatewayedSignals" SG_ 611 IPB_CSTSt 0;
BA_ "GenSigInactiveValue" SG_ 611 IPB_CSTSt 0;
BA_ "GenSigInvalidValue" SG_ 611 IPB_CSTSt 0;
BA_ "GenSigSendType" SG_ 611 IPB_CSTSt 1;
BA_ "GenSigStartValue" SG_ 611 IPB_CSTSt 0;
BA_ "GenSigTimeoutValue" SG_ 611 IPB_CSTSt 0;
BA_ "Remark" SG_ 611 IPB_CSTSt "";
BA_ "EventCommandSignal" SG_ 611 BCS_AVDCActive 0;
BA_ "GatewayedSignals" SG_ 611 BCS_AVDCActive 0;
BA_ "GenSigInactiveValue" SG_ 611 BCS_AVDCActive 0;
BA_ "GenSigInvalidValue" SG_ 611 BCS_AVDCActive 0;
BA_ "GenSigSendType" SG_ 611 BCS_AVDCActive 1;
BA_ "GenSigStartValue" SG_ 611 BCS_AVDCActive 0;
BA_ "GenSigTimeoutValue" SG_ 611 BCS_AVDCActive 0;
BA_ "Remark" SG_ 611 BCS_AVDCActive "";
BA_ "EventCommandSignal" SG_ 611 BCS_AVDCAvailable 0;
BA_ "GatewayedSignals" SG_ 611 BCS_AVDCAvailable 0;
BA_ "GenSigInactiveValue" SG_ 611 BCS_AVDCAvailable 0;
BA_ "GenSigInvalidValue" SG_ 611 BCS_AVDCAvailable 0;
BA_ "GenSigSendType" SG_ 611 BCS_AVDCAvailable 1;
BA_ "GenSigStartValue" SG_ 611 BCS_AVDCAvailable 0;
BA_ "GenSigTimeoutValue" SG_ 611 BCS_AVDCAvailable 0;
BA_ "Remark" SG_ 611 BCS_AVDCAvailable "";

VAL_ 616 UMM_UsageModeSt 0 "Standby" 1 "Comfort" 2 "Reserved" 3 "DRV" 4 "Reserved" 5 "Reserved" 6 "Reserved" 7 "Invalid"  ;
VAL_ 616 OTA_FuncReq_ADCWakeup 0 "Inactive" 1 "Active" 2 "Reserved" 3 "Reserved" 4 "Reserved" 5 "Reserved" 6 "Reserved" 7 "Reserved"  ;
VAL_ 616 UMM_DriverSeatSt 0 "Undefined" 1 "Off" 2 "On" 3 "Failure"  ;
VAL_ 616 UMM_FrontPassengerSeatSt 0 "Undefined" 1 "Off" 2 "On" 3 "Failure"  ;
VAL_ 616 VMM_VehModeSt 0 "Normal Mode" 1 "Manufacture Mode" 2 "Transport Mode" 3 "Showroom Mode" 4 "PostCrash Mode" 5 "Maintenance Mode" 6 "Reserved" 7 "Reserved" 8 "Reserved" 9 "Reserved" 10 "Reserved" 11 "Reserved" 12 "Reserved" 13 "Reserved" 14 "Reserved" 15 "Invalid Value"  ;
VAL_ 616 VMM_LastVehModeSt 0 "Normal Mode" 1 "Manufacture Mode" 2 "Transport Mode" 3 "Showroom Mode" 4 "PostCrash Mode" 5 "Maintenance Mode" 6 "Reserved" 7 "Reserved" 8 "Reserved" 9 "Reserved" 10 "Reserved" 11 "Reserved" 12 "Reserved" 13 "Reserved" 14 "Reserved" 15 "Invalid Value"  ;
VAL_ 616 VMM_OTAModeSt 0 "NonOTA Mode" 1 "OTA Mode" 2 "Invalid Value" 3 "reserved"  ;
VAL_ 616 CCU_DstFlag 0 "inactive" 1 "active"  ;
VAL_ 616 CSM_RC_PAARequest 0 "No request" 1 "SBM RPA request" 2 "SBM HPA request" 3 "EDK request" 4 "TSP HPA request" 5 "TSP AVP request" 6 "check picture" 7 "check video"  ;
VAL_ 616 CSM_RC_AuthSt 0 "Not Used" 1 "Pass" 2 "Failed"  ;
VAL_ 616 IPDS_EnablePowerSup 0 "Not Active" 1 "Active" 2 "PreOFF" 3 "Reserve"  ;
VAL_ 616 ASB_DriverActiveBeltFaultSt 0 "Not fault" 1 "Fault"  ;
VAL_ 909 LCK_HoodAjarSt 0 "Closed" 1 "Opened"  ;
VAL_ 909 LCK_FrontLeftDoorAjarSt 0 "Closed" 1 "Opened"  ;
VAL_ 909 LCK_FrontRightDoorAjarSt 0 "Closed" 1 "Opened"  ;
VAL_ 909 LCK_RearLeftDoorAjarSt 0 "Closed" 1 "Opened"  ;
VAL_ 909 LCK_RearRightDoorAjarSt 0 "Closed" 1 "Opened"  ;
VAL_ 909 LCK_TrunkAjarSt 0 "Closed" 1 "Opened"  ;
VAL_ 909 LCK_FrontLeftDoorLockSt 0 "Locked" 1 "Unlocked"  ;
VAL_ 909 LCK_FrontRightDoorLockSt 0 "Locked" 1 "Unlocked"  ;
VAL_ 909 LCK_RearLeftDoorLockSt 0 "Locked" 1 "Unlocked"  ;
VAL_ 909 LCK_RearRightDoorLockSt 0 "Locked" 1 "Unlocked"  ;
VAL_ 909 LCK_RearLeftChildSaftyLockSt 0 "Locked" 1 "Unlocked"  ;
VAL_ 909 LCK_RearRightChildSaftyLockSt 0 "Locked" 1 "Unlocked"  ;
VAL_ 909 LCK_FrontLeftDoorHandlePosition 00 "FullyClosed" 100 "FullyOpened" 254 "Uninitialized" 255 "Unknown"  ;
VAL_ 909 LCK_FrontRightDoorHandlePosition 00 "FullyClosed" 100 "FullyOpened" 254 "Uninitialized" 255 "Unknown"  ;
VAL_ 909 LCK_RearLeftDoorHandlePosition 00 "FullyClosed" 100 "FullyOpened" 254 "Uninitialized" 255 "Unknown"  ;
VAL_ 909 LCK_RearRightDoorHandlePosition 00 "FullyClosed" 100 "FullyOpened" 254 "Uninitialized" 255 "Unknown"  ;
VAL_ 909 LCK_FillerCapASt 0 "Closed" 1 "Opened"  ;
VAL_ 909 LCK_FillerCapBSt 0 "Closed" 1 "Opened"  ;
VAL_ 909 MR_LeftMirrorFoldUnfoldSt 0 "Unknown" 1 "Mirror fold" 2 "Mirror unfold" 3 "Reserved"  ;
VAL_ 909 SBM_SwapHvBattModeSt 0 "default" 1 "Station open the door for veichle go in" 2 "Station find Vehicle stop OK" 3 "Station prepare to swap" 4 "Station begin to swap" 5 "Station finish assembling" 6 "Station complete to swap" 7 "Station pause swapping" 8 "Station open the door for veichle go out"  ;
VAL_ 909 SBM_SwapStaDiagCode 0 "Normal" 1 "Fault,BT cominication error" 2 "Fault,SWAP station error" 3 "Fault,vehile error"  ;
VAL_ 909 SBM_SwapVehDiagCode 0 "No error;" 1 "SBM CAN bus off" 2 "SBM lose ZCU-R" 3 "Active discharge disable"  ;
VAL_ 909 SBM_SwapHvBattModeFaultSt 0 "default" 1 "Normal" 2 "Error,can recovery" 3 "Error,can not recover"  ;
VAL_ 909 POD_CurDoorPosFL 127 "Position unknown"  ;
VAL_ 909 IPDS_HDMapPowerSt 0 "Not Active" 1 "Active"  ;
VAL_ 909 IPDS_KL15L1PowerSt 0 "Not Active" 1 "Active"  ;
VAL_ 909 IPDS_SRSECUPowerSt 0 "Not Active" 1 "Active"  ;
VAL_ 909 IPDS_HODPowerSt 0 "Not Active" 1 "Active"  ;
VAL_ 909 KAE_BLEOption 0 "Not active" 1 "Active"  ;
VAL_ 909 KAE_UWBOption 0 "Not active" 1 "Active"  ;
VAL_ 909 WW_RWPMotorSt 0 "Off" 1 "Reserve" 2 "Stall protection" 3 "Failure" 4 "Low speed" 5 "High speed" 6 "Hard stopped" 7 "Interval delaying"  ;
VAL_ 909 ACEleclocksSt 0 "init" 1 "Uncloked" 2 "Locked" 3 "Bosh open" 4 "Error,bosh close"  ;
VAL_ 909 WCM_Reminder 0 "No warning" 1 "Phone left in car"  ;
VAL_ 909 WCM_ChargingSt 0 "Standby" 1 "Charging" 2 "Charging completed (available when Rx support)" 3 "Not standby"  ;
VAL_ 909 AVAS_ActivatedSt 0 "OFF" 1 "ON" 2 "Sound_AVAS" 3 "Sound_UnLock" 4 "Sound_Lock"  ;
VAL_ 909 PWL_WinCurrentPos_FLWinPst 255 "Undefined window position"  ;
VAL_ 909 UINM_FrontLeftPowerReleaseReq 0 "NoReq" 1 "Release"  ;
VAL_ 909 UINM_FrontLeftPowerReleaseFaultSt 0 "noraml" 1 "fault"  ;
VAL_ 909 UINM_FrontRightPowerReleaseReq 0 "NoReq" 1 "Release"  ;
VAL_ 909 UINM_FrontRightPowerReleaseFaultSt 0 "noraml" 1 "fault"  ;
VAL_ 909 UINM_RearLeftPowerReleaseFaultSt 0 "noraml" 1 "fault"  ;
VAL_ 909 UINM_RearLeftPowerReleaseReq 0 "NoReq" 1 "Release"  ;
VAL_ 909 UINM_RearRightPowerReleaseFaultSt 0 "noraml" 1 "fault"  ;
VAL_ 909 UINM_RearRightPowerReleaseReq 0 "NoReq" 1 "Release"  ;
VAL_ 909 PWL_WinCurrentPos_RRWinPst 255 "Undefined window position"  ;
VAL_ 909 PWL_WinCurrentPos_RLWinPst 255 "Undefined window position"  ;
VAL_ 905 ICM_SetIACCSt 0 "Not active" 1 "Active"  ;
VAL_ 161 ACU_FaceID_Delete 0 "Default" 1 "Delete AUID1" 2 "Delete AUID2" 3 "Delete AUID3" 4 "Delete AUID4" 5 "Delete AUID5" 6 "Delete AUID6" 7 "Delete AUID7" 8 "Delete AUID8" 9 "Reserved" 10 "Reserved" 11 "Reserved" 12 "Reserved" 13 "Reserved" 14 "Reserved" 15 "Reserved"  ;
VAL_ 161 ACU_RegisterTriger 0 "Default" 1 "Register AUID1" 2 "Register AUID2" 3 "Register AUID3" 4 "Register AUID4" 5 "Register AUID5" 6 "Register AUID6" 7 "Register AUID7" 8 "Register AUID8" 9 "Reserved" 10 "Reserved" 11 "Reserved" 12 "Reserved" 13 "Reserved" 14 "Reserved" 15 "Reserved"  ;
VAL_ 161 ACU_VerifyTriger 0 "Default" 1 "Verify AUID1" 2 "Verify AUID2" 3 "Verify AUID3" 4 "Verify AUID4" 5 "Verify AUID5" 6 "Verify AUID6" 7 "Verify AUID7" 8 "Verify AUID8" 9 "Reserved" 10 "Reserved" 11 "Reserved" 12 "Reserved" 13 "Reserved" 14 "Reserved" 15 "Reserved"  ;
VAL_ 161 ACU_FaceIDQuit 0 "No command" 1 "Quit request"  ;
VAL_ 161 ACU_FaceIDSwitch 0 "No command" 1 "Off" 2 "On" 3 "Not used"  ;
VAL_ 161 ACU_AVAS_SwitchCfgReq 0 "No command" 1 "OFF" 2 "ON" 3 "Not used"  ;
VAL_ 615 BCS_FLWheelSpdVD 0 "Not valid" 1 "Valid"  ;
VAL_ 615 BCS_FLWheelRotatedDirection 0 "Forward" 1 "Backward"  ;
VAL_ 615 BCS_FLWheelRotatedDirectionVD 0 "Not valid" 1 "Valid"  ;
VAL_ 615 BCS_FRWheelSpdVD 0 "Not valid" 1 "Valid"  ;
VAL_ 615 BCS_FRWheelRotatedDirection 0 "Forward" 1 "Backward"  ;
VAL_ 615 BCS_FRWheelRotatedDirectionVD 0 "Not valid" 1 "Valid"  ;
VAL_ 615 BCS_RLWheelSpdVD 0 "Not valid" 1 "Valid"  ;
VAL_ 615 BCS_RLWheelRotatedDirection 0 "Forward" 1 "Backward"  ;
VAL_ 615 BCS_RLWheelRotatedDirectionVD 0 "Not valid" 1 "Valid"  ;
VAL_ 615 BCS_RRWheelSpdVD 0 "Not valid" 1 "Valid"  ;
VAL_ 615 BCS_RRWheelRotatedDirection 0 "Forward" 1 "Backward"  ;
VAL_ 615 BCS_RRWheelRotatedDirectionVD 0 "Not valid" 1 "Valid"  ;
VAL_ 615 BCS_HDCCtrlSt 0 "Off" 1 "On active braking" 2 "On not active braking" 3 "Not used"  ;
VAL_ 615 BCS_HDCErrSt 0 "No error" 1 "Error"  ;
VAL_ 615 BCS_FLWheelSpdEdgesSumVD 0 "Not valid" 1 "Valid"  ;
VAL_ 615 BCS_FRWheelSpdEdgesSumVD 0 "Not valid" 1 "Valid"  ;
VAL_ 615 BCS_RLWheelSpdEdgesSumVD 0 "Not valid" 1 "Valid"  ;
VAL_ 615 BCS_RRWheelSpdEdgesSumVD 0 "Not valid" 1 "Valid"  ;
VAL_ 615 BCS_FLWheelRotatedDirectionAPA 0 "Standstill" 1 "Forward" 2 "Backward" 3 "Unknown"  ;
VAL_ 615 BCS_FRWheelRotatedDirectionAPA 0 "Standstill" 1 "Forward" 2 "Backward" 3 "Unknown"  ;
VAL_ 615 BCS_RLWheelRotatedDirectionAPA 0 "Standstill" 1 "Forward" 2 "Backward" 3 "Unknown"  ;
VAL_ 615 BCS_RRWheelRotatedDirectionAPA 0 "Standstill" 1 "Forward" 2 "Backward" 3 "Unknown"  ;
VAL_ 615 BCS_ParkingReqToEPB 0 "No request" 1 "Release brake request" 2 "Lock brake request" 3 "Not used"  ;
VAL_ 615 BCS_VDCOff 0 "On" 1 "Off"  ;
VAL_ 615 BCS_AVHSt 0 "Not active" 1 "Active"  ;
VAL_ 615 BCS_AVHStandby 0 "Not standby" 1 "Standby"  ;
VAL_ 615 BCS_AVHAvailable 0 "Not available" 1 "Available"  ;
VAL_ 615 BCS_TCSOff 0 "On" 1 "Off"  ;
VAL_ 615 BCS_BrkPdlPstVD 0 "Not valid" 1 "Valid"  ;
VAL_ 615 BCS_BrakeOverHeat 0 "Not high" 1 "Temp too high"  ;
VAL_ 615 BCS_ABAactive 0 "Not active" 1 "Active"  ;
VAL_ 615 BCS_ABAavailable 0 "Not available" 1 "Available"  ;
VAL_ 615 BCS_ABPActive 0 "Not active" 1 "Active"  ;
VAL_ 615 BCS_ABPAvailable 0 "Not available" 1 "Available"  ;
VAL_ 615 BCS_AEBActive 0 "Not active" 1 "Active"  ;
VAL_ 615 BCS_AEBAvailable 0 "Not available" 1 "Available"  ;
VAL_ 615 BCS_AWBActive 0 "Not active" 1 "Active"  ;
VAL_ 615 BCS_AWBAvailable 0 "Not available" 1 "Available"  ;
VAL_ 615 BCS_VehicleStandStillSt 0 "Not standstill" 1 "standstill" 2 "Invalid (short unavailability, max 3s)" 3 "Not used"  ;
VAL_ 615 BCS_AEBBAActive 0 "Not active" 1 "Active"  ;
VAL_ 615 IPB_InputRodStrokeSt 0 "Valid/Init" 1 "Invalid/Default"  ;
VAL_ 615 BCS_RAEBActive 0 "Not active" 1 "Active"  ;
VAL_ 615 BCS_RAEBAvailable 0 "Not avaialbe" 1 "Available"  ;
VAL_ 615 BCS_DrvModeAvailable 0 "Not available" 1 "Available"  ;
VAL_ 615 BCS_DrvMode 0 "Normal" 1 "Sport" 2 "Snow" 3 "ipedal" 4 "Offroad" 5 "Slippery" 6 "Sand" 7 "Wade"  ;
VAL_ 615 IPB_PlungerPressureSt 0 "Valid/Init" 1 "Invalid/Default"  ;
VAL_ 352 BCS_VehSpdVD 0 "Not Valid" 1 "Valid"  ;
VAL_ 352 BCS_EBDActiveSt 0 "Not active" 1 "Active"  ;
VAL_ 352 BCS_EBDFaultSt 0 "Not fault" 1 "Fault"  ;
VAL_ 352 BCS_ABSActiveSt 0 "Not active" 1 "Active"  ;
VAL_ 352 BCS_ABSFaultSt 0 "Not fault" 1 "Fault"  ;
VAL_ 352 BCS_TCSActiveSt 0 "Not active" 1 "Active"  ;
VAL_ 352 BCS_TCSFaultSt 0 "Not fault" 1 "Fault"  ;
VAL_ 352 BCS_VDCActiveSt 0 "Not active" 1 "Active"  ;
VAL_ 352 BCS_VDCFaultSt 0 "Not fault" 1 "Fault"  ;
VAL_ 352 BCS_EngTorqDecActiveSt 0 "Not active" 1 "Active"  ;
VAL_ 352 BCS_EngTorqIncActiveSt 0 "Not active" 1 "Active"  ;
VAL_ 352 BCS_RegenModulationAvailable 0 "Not available" 1 "Available"  ;
VAL_ 352 BCS_RegenModuleActive 0 "Not Active" 1 "Active"  ;
VAL_ 352 BCS_RealTCSActiveSt 0 "Not active" 1 "Active"  ;
VAL_ 352 BCS_TargetRecpTorqRqSt 0 "NotIntialized" 1 "Normal" 2 "Faulty" 3 "Reserved"  ;
VAL_ 352 BCS_CrbsActive 0 "Not Active" 1 "Active"  ;
VAL_ 352 BCS_TargetRecpTorqRqFASt 0 "NotIntialized" 1 "Normal" 2 "Faulty" 3 "Reserved"  ;
VAL_ 352 BCS_TargetRecpTorqRqRASt 0 "NotIntialized" 1 "Normal" 2 "Faulty" 3 "Reserved"  ;
VAL_ 352 IPB_BrakePedalSt 0 "Not_Pressed/Init/Default" 1 "Pressed" 2 "Reserved" 3 "Error"  ;
VAL_ 352 IPB_BrakePedalStsVld 0 "Invalid" 1 "Valid"  ;
VAL_ 352 BCS_ESP2Park_DrvBrkOverrideFlg 0 "False" 1 "True"  ;
VAL_ 352 BCS_EngTorqDecActiveStRA 0 "Not active" 1 "Active"  ;
VAL_ 352 BCS_EngTorqIncActiveStRA 0 "Not active" 2 "Active"  ;
VAL_ 352 BCS_EngTorqIncActiveStFA 0 "Not active" 1 "Active"  ;
VAL_ 352 BCS_EngTorqDecActiveStFA 0 "Not active" 1 "Active"  ;
VAL_ 352 BCS_PrimBrkCDAAvailableSt 0 "CDA NotAvailable" 1 "CDA NotAvailable By Situation" 2 "CDA Available With Fault" 3 "CDA Available With Situation" 4 "CDA Available" 5 "Not used" 6 "Not used" 7 "Not used"  ;
VAL_ 352 BCS_PrimBrkCommuniSt 0 "Valid" 1 "Invalid"  ;
VAL_ 352 BCS_PrimBrkActiveSt 0 "L2 or L2++ NotActive" 1 "L2 Acitve" 2 "L2++ Active" 3 "Not used"  ;
VAL_ 352 BCS_PrimBrkSuspendSt 0 "CDD and CDA Normal" 1 "Not used" 2 "Not used" 3 "CDD_RampOff By DriverBrake"  ;
VAL_ 352 BCS_2ParkDynamicAVPavailability 0 "NotAvailable" 1 "Available" 2 "TestPending"  ;
VAL_ 352 BCS_2ParkCddApActiveVehHld 0 "False" 1 "True"  ;
VAL_ 352 BCS_2ParkAPCStatus 0 "Standby" 1 "Active_APA" 2 "Active_RPA" 3 "Active_AVP" 4 "Active_DynamicAVP"  ;
VAL_ 352 BCS_2ParkAPAavailability 0 "NotAvailable" 1 "Available"  ;
VAL_ 352 BCS_2ParkRPAAVPavailability 0 "NotAvailable" 1 "Available" 2 "TestPending"  ;
VAL_ 352 BCS_2ParkAPCFailureSts 0 "no error" 1 "APC1(APA) driver not present" 2 "too high speed" 3 "unexpect EPB Apply" 4 "reserved" 5 "reserved" 6 "Error" 7 "APC24(RPA AVP) trigger without secure"  ;
VAL_ 352 BCS_APCMain2BackupReq 0 "NoReq" 1 "StopRequest"  ;
VAL_ 352 BCS_PrimBrkCtrlUsedChannel 0 "No Channel used" 1 "Main ADC com1 Used" 2 "Main ADC com2 Used" 3 "Back up IFC com1 Used"  ;
VAL_ 352 BCS_PrimBrkCDAActiveSt 0 "L2++ NotActive" 1 "L2++ Active"  ;
VAL_ 352 BCS_PrimBrkDecCtrlActiveSt 0 "NotActive" 1 "Active"  ;
VAL_ 352 BCS_PrimBrkCDDAvailableSt 0 "CDD NotAvailable" 1 "CDD NotAvailable By Situation" 2 "CDD Available" 3 "Reserve"  ;
VAL_ 611 BCS_PrimCommPathSt 0 "Normal" 1 "Error"  ;
VAL_ 611 BCS_SeconCommPathSt 0 "Normal" 1 "Error"  ;
VAL_ 611 BCS_PressureHldSt 0 "Not holding" 1 "Holding"  ;
VAL_ 611 BCS_CDDFuncSt 0 "Normal" 1 "Degrade"  ;
VAL_ 611 IPB_SimulatorPressureSt 0 "Valid/Init" 1 "Invalid/Default"  ;
VAL_ 611 IBCS_SystemSt 0 "BBF_FullSys/Init/Default" 1 "BBF_DegradedPedalFeel" 2 "BBF_CircuitSperation" 3 "BBF_C1/2BoostOnly" 4 "HydBack w/ act / HydBack w/o act"  ;
VAL_ 611 IBCS_FWAWarning 0 "no failure/Init/Default" 1 "Warnig level 1 for high Temp. of Brake system" 2 "Warnig level 2 for high Temp. of Brake system" 3 "reserved"  ;
VAL_ 611 IPB_CSTSt 0 "CST is disabled/Init/Default" 1 "CST is Standby" 2 "CST is Active" 3 "CST is Failure"  ;
VAL_ 611 BCS_AVDCActive 0 "Not active" 1 "Active"  ;
VAL_ 611 BCS_AVDCAvailable 0 "Not active" 1 "Active"  ;
