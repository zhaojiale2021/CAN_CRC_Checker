VERSION "Version"

NS_ :

BS_:

BU_: CCU IBCS IXCU RBM EPS ADC IBCS_IXCU IDU Tester CCURT2 RT2_C3 OTAWL ZCUF ZCUL ZCUR ZCUT IPS DCU NIDU RLBMS CBM WACUFL IDC IID VIU CCURT1 RT1_C0 RT1_C1 AVAS FLLCM FRLCM RLLCMA RRLCMA RLLCMB RRLCMB LBMS LBMSAD MFS FCP ITS BCB DCDC PCU EOP DCU2 BMS TMC SRS ECS CD AMP WHUD IMR FIMR FAPA FLR FRR RLR RRR IFC PAS INU SBM WCM ETC TBOX TBOX2 DSM FLPDM FRPDM RLPDM RRPDM HVSMR SCMRL SCMRR EBU EPB PCS V2XOBU EVCC VDC ADM PLGM FBLCM RLISD RRISD RCP RFR WCMFR SCMR TFOAR TROAR HVSPRL HVSPRR

BO_ 368 CCU_DCU_1: 64 CCU
 SG_ DCU_1_CRC : 7|16@0+ (1,0) [0|65535] ""  RBM,IBCS,IXCU,WACUFL,ADC
 SG_ DCU_1_Counter : 23|8@0+ (1,0) [0|255] ""  RBM,IBCS,IXCU,WACUFL,ADC
 SG_ DCU_RotSpdAct : 31|16@0+ (1,-32767) [-32767|32766] "rpm"  EPB,ADC
 SG_ DCU_ModeSt : 79|4@0+ (1,0) [0|15] ""  ADC
 SG_ DCU_ADC_MCUBlkst : 268|3@0+ (1,0) [0|7] ""  ADC
 SG_ DCU_ADC_SpdSvModAvl : 256|1@0+ (1,0) [0|1] ""  ADC
 SG_ DCU_ADC_MCUStandstill : 257|1@0+ (1,0) [0|1] ""  ADC
 SG_ DCU_ADC_MCUSpdSVModFit : 271|3@0+ (1,0) [0|7] ""  ADC
 SG_ DCU_ADC_MCUVehSldSt : 258|1@0+ (1,0) [0|1] ""  ADC
 SG_ DCU_ADC_MCUReqTq : 253|11@0+ (1,-1023) [-1023|1023] "Nm"  ADC
 SG_ DCU_RotSpdAct_Raw : 415|16@0+ (1,-32767) [-32767|32766] "rpm"  ADC

BO_ 704 CCU_IPS_1: 64 CCU
 SG_ IPS_1_CRC : 7|16@0+ (1,0) [0|65535] ""  ADC,FAPA,VIU
 SG_ IPS_1_Counter : 23|8@0+ (1,0) [0|255] ""  ADC,FAPA,VIU
 SG_ IPS_DCDCModeSt : 39|3@0+ (1,0) [0|7] ""  OTAWL,EBU,RLBMS,ADC,FAPA,VIU

BO_ 824 VCU_2: 64 CCU
 SG_ VCU_2_CRC : 7|16@0+ (1,0) [0|65535] ""  CCURT2,RT2_C3,ZCUF,ZCUT,DCU,DCU2,NIDU,BMS,IXCU,IDC,ADC,FAPA,FLR,FRR,RLR,RRR,VIU,IFC
 SG_ VCU_2_Counter : 23|8@0+ (1,0) [0|255] ""  CCURT2,RT2_C3,ZCUF,ZCUT,DCU,DCU2,NIDU,BMS,IXCU,IDC,ADC,FAPA,FLR,FRR,RLR,RRR,VIU,IFC
 SG_ VCU_GearLvlDisp : 53|4@0+ (1,0) [0|15] ""  CCURT2,RT2_C3,ZCUF,ZCUR,ZCUT,IDC,ADC,FAPA,VIU,PCS,SBM
 SG_ VCU_VehDrvMod : 223|3@0+ (1,0) [0|7] ""  CCURT2,RT2_C3,ZCUF,ZCUL,ZCUR,ZCUT,DCU,NIDU,BMS,SRS,RBM,IBCS,IXCU,IDC,AMP,ADC,FAPA,VIU,IFC,WCM
 SG_ VCU_VehRdySt : 217|1@0+ (1,0) [0|1] ""  CCURT2,RT2_C3,OTAWL,ZCUF,ZCUR,ZCUT,EPB,IDC,IID,ADC,FAPA,FLR,FRR,RLR,RRR,VIU,IFC,SBM,TBOX
 SG_ VCU_GearLvl : 247|4@0+ (1,0) [0|15] ""  CCURT1,CCURT2,RT1_C0,RT1_C1,RT2_C3,ZCUF,ZCUT,EPB,ADC,FAPA,FLR,FRR,RLR,RRR,VIU,IFC
 SG_ VCU_PlgConnSt : 256|1@0+ (1,0) [0|1] ""  CCURT2,RT2_C3,ZCUT,DCU,DCU2,NIDU,ECS,IXCU,IDC,ADC,FAPA,VIU
 SG_ VCU_SwapHvBattRdySt : 351|8@0+ (1,0) [0|255] ""  ZCUR,ADC,FAPA,VIU,SBM
 SG_ VCU_SwapHvBattCompSt : 359|3@0+ (1,0) [0|7] ""  ZCUR,ADC,FAPA,VIU,SBM
 SG_ VCU_SwapHvBattModeSt : 356|2@0+ (1,0) [0|3] ""  ZCUF,ZCUR,ZCUT,ITS,IPS,DCDC,EOP,DCU,NIDU,BMS,IXCU,IDC,AMP,ADC,FAPA,VIU,SBM,TBOX
 SG_ VCU_SwapHvBattModeStVD : 353|1@0+ (1,0) [0|1] ""  ZCUF,ZCUR,ZCUT,ITS,IPS,DCDC,EOP,DCU,NIDU,BMS,IXCU,IDC,AMP,ADC,FAPA,VIU,SBM,TBOX
 SG_ VCU_RoadMod : 352|3@0+ (1,0) [0|7] ""  EPS,IBCS,ECS,IDC,ADC

BO_ 653 VCU_5: 64 CCU
 SG_ VCU_5_CRC : 7|16@0+ (1,0) [0|65535] ""  CCURT2,RT2_C3,ZCUF,ZCUT,RBM,IBCS,ECS,EBU,EPB,IXCU,WACUFL,ADC,FAPA,FLR,FRR,RLR,RRR,VIU,IFC,PAS,INU
 SG_ VCU_5_Counter : 23|8@0+ (1,0) [0|255] ""  CCURT2,RT2_C3,ZCUF,ZCUT,RBM,IBCS,ECS,EBU,EPB,IXCU,WACUFL,ADC,FAPA,FLR,FRR,RLR,RRR,VIU,IFC,PAS,INU
 SG_ VCU_AccButtInfo : 31|8@0+ (1,0) [0|255] ""  IDC,ADC,FAPA,VIU,IFC
 SG_ VCU_LateralAssistBtnInfo : 39|1@0+ (1,0) [0|1] ""  ADC,FAPA,VIU,IFC
 SG_ VCU_LateralAssistBtnInfoVD : 38|1@0+ (1,0) [0|1] ""  ADC,FAPA,VIU,IFC
 SG_ VCU_EMS_AccPedalActPst : 40|8@0+ (0.392,0) [0|99.96] "%"  CCURT2,RT2_C3,SRS,RBM,IBCS,ECS,EBU,IXCU,WACUFL,IDC,AMP,ADC,FAPA,VIU,IFC,TBOX
 SG_ VCU_EMS_BrkPedalSt : 63|1@0+ (1,0) [0|1] ""  CCURT2,RT2_C3,ZCUR,SRS,RBM,IBCS,ECS,IXCU,WACUFL,IDC,ADC,FAPA,VIU,IFC,SBM,TBOX
 SG_ VCU_EMS_BrkPedalStVD : 62|1@0+ (1,0) [0|1] ""  CCURT2,RT2_C3,ZCUR,SRS,RBM,IBCS,ECS,IXCU,WACUFL,ADC,FAPA,VIU,IFC,SBM
 SG_ VCU_EMS_AccPedalActPstVD : 61|1@0+ (1,0) [0|1] ""  CCURT2,RT2_C3,SRS,RBM,IBCS,ECS,EBU,IXCU,WACUFL,AMP,ADC,FAPA,VIU,IFC
 SG_ VCU_DCU_ActRotSpd : 60|16@0+ (1,-32767) [-32767|32766] "rpm"  CCURT1,CCURT2,RT1_C1,RT2_C3,ZCUF,ZCUT,VDC,TMC,SRS,RBM,IBCS,EBU,IXCU,WACUFL,AMP,ADC,FAPA,VIU
 SG_ VCU_BrkPedPstVD : 128|1@0+ (1,0) [0|1] ""  CCURT2,RT2_C3,SRS,RBM,IBCS,ECS,IXCU,WACUFL,IDC,ADC,FAPA,VIU,IFC
 SG_ VCU_CrntGearLvl : 143|3@0+ (1,0) [0|7] ""  CCURT2,RT2_C3,ZCUF,ZCUL,ZCUR,ZCUT,SRS,EPS,RBM,IBCS,ECS,EBU,EPB,IXCU,WACUFL,IDC,AMP,ADC,FAPA,FLR,FRR,RLR,RRR,VIU,IFC,PAS,INU,TBOX,V2XOBU
 SG_ VCU_BrkPedPst : 156|8@0+ (0.392,0) [0|99.96] "%"  CCURT2,RT2_C3,SRS,RBM,IBCS,ECS,IXCU,WACUFL,IDC,ADC,FAPA,VIU,IFC
 SG_ VCU_APAGasPedalIntv : 163|1@0+ (1,0) [0|1] ""  ADC,FAPA,VIU,IFC
 SG_ VCU_APAAvailable : 162|1@0+ (1,0) [0|1] ""  RBM,IBCS,IXCU,WACUFL,ADC,FAPA,VIU
 SG_ VCU_ACCMaxRecpDecel : 179|8@0+ (0.05,-5) [-5|7.75] "m/s2"  ADC,FAPA,VIU,IFC
 SG_ VCU_ACCLimitOperatingSt : 186|1@0+ (1,0) [0|1] ""  ADC,FAPA,VIU,IFC
 SG_ VCU_ACCMaxRecpDecelVD : 185|1@0+ (1,0) [0|1] ""  ADC,FAPA,VIU,IFC
 SG_ VCU_APA_Resp : 184|1@0+ (1,0) [0|1] ""  RBM,IBCS,IXCU,WACUFL,ADC,FAPA,VIU
 SG_ VCU_APAGearIntervern : 199|1@0+ (1,0) [0|1] ""  ADC,FAPA,VIU,IFC
 SG_ VCU_ActVehWheelTorq : 195|14@0+ (1,0) [0|10000] "Nm"  EPS,IBCS,ECS,IXCU,WACUFL,AMP,ADC,FAPA,VIU,IFC
 SG_ VCU_ACCmaxSpdLimit : 213|4@0+ (1,0) [0|15] ""  ADC,FAPA,VIU,IFC
 SG_ VCU_VehWheelTorqMax : 223|14@0+ (1,0) [0|10000] "Nm"  IBCS,ECS,IXCU,WACUFL,ADC,FAPA,VIU,IFC
 SG_ VCU_RecpTorqVD : 241|1@0+ (1,0) [0|1] ""  RBM,IBCS,IXCU,WACUFL,ADC,FAPA,VIU,IFC
 SG_ VCU_RecpTorq : 260|11@0+ (2,0) [0|4000] "Nm"  RBM,IBCS,IXCU,WACUFL,ADC,FAPA,VIU,IFC
 SG_ VCU_CrntGearLvlVD : 277|1@0+ (1,0) [0|1] ""  CCURT2,RT2_C3,AMP,ADC,FAPA,FLR,FRR,RLR,RRR,VIU,IFC,PAS,INU
 SG_ EMS_GasPedalActPstforMRRVD_D : 296|1@0+ (1,0) [0|1] ""  IDC,ADC

BO_ 644 VCU_7: 64 CCU
 SG_ VCU_7_CRC : 7|16@0+ (1,0) [0|65535] ""  CCURT2,RT2_C3,ZCUF,ZCUT,EPS,RBM,IBCS,EBU,EPB,IXCU,ADC,FAPA,VIU,IFC
 SG_ VCU_7_Counter : 23|8@0+ (1,0) [0|255] ""  CCURT2,RT2_C3,ZCUF,ZCUT,EPS,RBM,IBCS,EBU,EPB,IXCU,ADC,FAPA,VIU,IFC
 SG_ EMS_GasPedalActPstforMRRVD : 31|1@0+ (1,0) [0|1] ""  ZCUF,ZCUT,SRS,RBM,IBCS,EBU,EPB,IXCU,ADC,FAPA,FLR,VIU,IFC
 SG_ VCU_AccTMCFail : 29|1@0+ (1,0) [0|1] ""  RBM,IBCS,IXCU,ADC,FAPA,VIU,IFC
 SG_ VCU_AccElecECFail : 28|1@0+ (1,0) [0|1] ""  RBM,IBCS,IXCU,ADC,FAPA,VIU,IFC
 SG_ VCU_AccDriverOrvd : 27|1@0+ (1,0) [0|1] ""  ADC,FAPA,VIU,IFC
 SG_ EMS_GasPedalActPstforMRR : 26|8@0+ (0.392,0) [0|99.96] "%"  ZCUF,ZCUT,SRS,RBM,IBCS,EBU,EPB,IXCU,IDC,ADC,FAPA,FLR,VIU,IFC
 SG_ VCU_AccSpareCanError : 34|1@0+ (1,0) [0|1] ""  ADC,FAPA,VIU,IFC
 SG_ VCU_IFCFailureSt : 33|1@0+ (1,0) [0|1] ""  ADC,FAPA,VIU,IFC
 SG_ VCU_AccDriverOrvdVD : 47|1@0+ (1,0) [0|1] ""  RBM,IBCS,ADC,FAPA,IFC
 SG_ VCU_TorqDriverReq : 71|8@0+ (0.392,0) [0|99.96] "%"  RBM,IBCS,ECS,IXCU,ADC,FAPA,IFC

BO_ 393 VCU_9: 64 CCU
 SG_ VCU_9_CRC : 7|16@0+ (1,0) [0|65535] ""  IBCS,IXCU,ADC
 SG_ VCU_9_Counter : 23|8@0+ (1,0) [0|255] ""  IBCS,IXCU,ADC
 SG_ VCU_ErrorFb : 331|4@0+ (1,0) [0|15] ""  ADC
 SG_ VCU_VehWhlReqTqVld : 64|1@0+ (1,0) [0|1] ""  IBCS,IXCU,ADC
 SG_ VCU_MotorRegenTrqLmtlnDVaild : 65|1@0+ (1,0) [0|1] ""  ADC
 SG_ VCU_GearShiftAvl : 80|1@0+ (1,0) [0|1] ""  ADC
 SG_ VCU_PtTqAvl : 97|2@0+ (1,0) [0|3] ""  IBCS,IXCU,ADC
 SG_ VCU_PtTqActvSts : 81|1@0+ (1,0) [0|1] ""  IBCS,IXCU,ADC
 SG_ VCU_MotorRegenTorqueLmtlnD : 319|13@0+ (1,-8191) [-8191|0] "Nm"  ADC
 SG_ VCU_DriverTorqueDesired : 31|16@0+ (1,-32768) [-32768|32767] "Nm"  IBCS,IXCU,ADC
 SG_ VCU_VehWhlReqTq : 47|16@0+ (1,-32768) [-32768|32767] "Nm"  IBCS,IXCU,ADC
 SG_ VCU_TargetRecpTorqSt : 113|2@0+ (1,0) [0|3] ""  IBCS,IXCU,ADC
 SG_ VCU_TargetRecpTorqNm : 63|14@0+ (2,0) [0|16000] "Nm"  IBCS,IXCU,ADC
 SG_ VCU_TargetRecpTorqFA_Hyb : 79|14@0+ (1,0) [0|16000] "Nm"  IBCS,IXCU,ADC
 SG_ VCU_TargetRecpTorqRA_Hyb : 95|14@0+ (1,0) [0|16000] "Nm"  IBCS,IXCU,ADC
 SG_ VCU_TorqDriverReqFA_Hyb : 111|14@0+ (1,0) [0|16000] "Nm"  IBCS,IXCU,ADC
 SG_ VCU_TorqDriverReqRA_Hyb : 127|14@0+ (1,0) [0|16000] "Nm"  IBCS,IXCU,ADC
 SG_ VCU_VehActDrvTorqFA_Hyb : 143|14@0+ (1,0) [0|16000] "Nm"  IBCS,IXCU,ADC
 SG_ VCU_VehActDrvTorqRA_Hyb : 159|14@0+ (1,0) [0|16000] "Nm"  IBCS,IXCU,ADC
 SG_ VCU_TargetRecpTorqFAVD_Hyb : 128|1@0+ (1,0) [0|1] ""  IBCS,IXCU,ADC
 SG_ VCU_TargetRecpTorqRAVD_Hyb : 129|1@0+ (1,0) [0|1] ""  IBCS,IXCU,ADC
 SG_ VCU_TorqDriverReqFAVD : 144|1@0+ (1,0) [0|1] ""  IBCS,IXCU,ADC
 SG_ VCU_TorqDriverReqRAVD : 145|1@0+ (1,0) [0|1] ""  IBCS,IXCU,ADC
 SG_ VCU_VehActDrvTorqFAVD_Hyb : 160|1@0+ (1,0) [0|1] ""  IBCS,IXCU,ADC
 SG_ VCU_VehActDrvTorqRAVD_Hyb : 161|1@0+ (1,0) [0|1] ""  IBCS,IXCU,ADC
 SG_ VCU_BcsDecelReq : 335|4@0+ (0.066,-0.99) [-0.99|0] "m/s2"  IBCS,IXCU,ADC
 SG_ VCU_BcsDecelVD : 176|1@0+ (1,0) [0|1] ""  IBCS,IXCU,ADC
 SG_ VCU_BcsDecelEnable : 177|1@0+ (1,0) [0|1] ""  IBCS,IXCU,ADC
 SG_ VCU_CrntGearNoTrans : 322|3@0+ (1,0) [0|7] ""  ADC
 SG_ VCU_RecpTorqSt : 193|2@0+ (1,0) [0|3] ""  IBCS,IXCU,ADC
 SG_ VCU_RecpTorqNm : 175|14@0+ (1,0) [0|16000] "Nm"  IBCS,IXCU,ADC
 SG_ VCU_RecpTorqFAVD_Hyb : 208|1@0+ (1,0) [0|1] ""  IBCS,IXCU,ADC
 SG_ VCU_RecpTorqRAVD_Hyb : 209|1@0+ (1,0) [0|1] ""  IBCS,IXCU,ADC
 SG_ VCU_MaxRecpTorqFAVD_Hyb : 224|1@0+ (1,0) [0|1] ""  IBCS,IXCU,ADC
 SG_ VCU_MaxRecpTorqRAVD_Hyb : 225|1@0+ (1,0) [0|1] ""  IBCS,IXCU,ADC
 SG_ VCU_RecpTorqFA_Hyb : 191|14@0+ (1,0) [0|16000] "Nm"  IBCS,IXCU,ADC
 SG_ VCU_RecpTorqRA_Hyb : 207|14@0+ (1,0) [0|16000] "Nm"  IBCS,IXCU,ADC
 SG_ VCU_MaxRecpTorqFA_Hyb : 223|14@0+ (1,0) [0|16000] "Nm"  IBCS,IXCU,ADC
 SG_ VCU_MaxRecpTorqRA_Hyb : 239|14@0+ (1,0) [0|16000] "Nm"  IBCS,IXCU,ADC
 SG_ VCU_VehWheelTorqMinNm : 255|15@0+ (1,-16000) [-16000|16000] "Nm"  IBCS,IXCU,ADC
 SG_ VCU_VehWheelTorqMaxNmVD : 272|1@0+ (1,0) [0|1] ""  IBCS,IXCU,ADC
 SG_ VCU_VehWheelTorqMaxNm : 271|15@0+ (1,-16000) [-16000|16000] "Nm"  IBCS,IXCU,ADC
 SG_ VCU_ActVehWheelTorqNm : 287|15@0+ (1,-16000) [-16000|16000] "Nm"  CCURT1,RT1_C1,VDC,IBCS,IXCU,ADC
 SG_ VCU_APAWheelTorqDriverReqNm : 303|15@0+ (1,-16000) [-16000|16000] "Nm"  IBCS,IXCU,ADC

BO_ 404 ADC_1_B: 64 ADC
 SG_ ADC_1_B_CRC : 7|16@0+ (1,0) [0|65535] ""  CCU,CCURT1,CCURT2,RT1_C1,VDC,EPS,RBM,IBCS,IXCU
 SG_ ADC_1_B_Counter : 23|8@0+ (1,0) [0|255] ""  CCU,CCURT1,CCURT2,RT1_C1,VDC,EPS,RBM,IBCS,IXCU
 SG_ ADC_LongCtrlAvailability_B : 26|1@0+ (1,0) [0|1] ""  CCU,CCURT1,CCURT2,RT1_C1,VDC,EPS,RBM,IBCS,IXCU
 SG_ ADC_LongCtrlModeForBrkSys_B : 39|3@0+ (1,0) [0|7] ""  CCU,CCURT1,CCURT2,RT1_C1,VDC,RBM,IBCS,IXCU
 SG_ ADC_LongCtrlTargetAx_B : 36|11@0+ (0.01,-10) [-10|10] "m/s2"  CCU,CCURT1,CCURT2,RBM,IBCS,IXCU
 SG_ ADC_LongCtrlTargetAxReq_B : 41|1@0+ (1,0) [0|1] ""  CCU,CCURT1,CCURT2,RBM,IBCS,IXCU
 SG_ ADC_LongCtrlTypReq_B : 40|1@0+ (1,0) [0|1] ""  CCU,CCURT1,CCURT2,RT1_C1,RBM,IBCS,IXCU
 SG_ ADC_LongCtrlDecToStopReq_B : 55|1@0+ (1,0) [0|1] ""  CCU,CCURT1,CCURT2,RBM,IBCS,IXCU
 SG_ ADC_LongctrlSecureReq_B : 54|1@0+ (1,0) [0|1] ""  CCU,CCURT1,CCURT2,RBM,IBCS,IXCU
 SG_ ADC_ActTrqReq_B : 53|14@0+ (1,-5000) [-5000|5000] "Nm"  CCU,CCURT1,CCURT2,RT1_C1,VDC
 SG_ ADC_ActTrqReqEnable_B : 71|1@0+ (1,0) [0|1] ""  CCU,CCURT1,CCURT2,RT1_C1,VDC
 SG_ ADC_VLCSt_B : 70|2@0+ (1,0) [0|2] ""  CCU,CCURT1,CCURT2,RT1_C1,VDC
 SG_ ADC_ICMWarnCardSt_B : 68|4@0+ (1,0) [0|15] ""  CCU,CCURT1,CCURT2,IDC
 SG_ ADC_ICMPromptWarn_B : 64|1@0+ (1,0) [0|1] ""  CCU,CCURT1,CCURT2,IDC
 SG_ ADC_StrAngleReq_B : 79|16@0+ (0.1,-780) [-780|779.9] "deg"  CCU,CCURT1,CCURT2,EPS
 SG_ ADC_SACMotorTorLimExtMax_B : 95|8@0+ (0.02,0) [0|5.08] "Nm"  CCU,CCURT1,CCURT2,EPS
 SG_ ADC_SACMotorTorLimExtMin_B : 103|8@0+ (0.02,-5.08) [-5.08|0] "Nm"  CCU,CCURT1,CCURT2,EPS
 SG_ ADC_AngReqRdntReq_B : 111|1@0+ (1,0) [0|1] ""  CCU,CCURT1,CCURT2,EPS
 SG_ ADC_AngReqSt_B : 110|2@0+ (1,0) [0|3] ""  CCU,CCURT1,CCURT2,EPS
 SG_ ADC_AssistParaSwitchReq_B : 108|1@0+ (1,0) [0|1] ""  CCU,CCURT1,CCURT2,EPS
 SG_ ADC_PAAGrarLvlReq_B : 106|3@0+ (1,0) [0|7] ""  CCU,CCURT1,CCURT2,RT1_C1,VDC
 SG_ ADC_PAAGrarLvlReqEnable_B : 107|1@0+ (1,0) [0|1] ""  CCU,CCURT1,CCURT2,RT1_C1,VDC
 SG_ ADC_ElecBrkFnSwitch_B : 120|1@0+ (1,0) [0|1] ""  CCU,CCURT1,CCURT2,RT1_C1,VDC
 SG_ ADC_LongCtrlDriveOff_B : 121|1@0+ (1,0) [0|1] ""  CCU,CCURT1,CCURT2,RBM,IBCS,IXCU
 SG_ ADC_AEBDecelCtrlReq_B : 122|1@0+ (1,0) [0|1] ""  CCU,CCURT1,CCURT2,RBM,IBCS,IXCU
 SG_ ADC_AEBTargetDecel_B : 119|12@0+ (0.008,-16) [-16|16] "m/s2"  CCU,CCURT1,CCURT2,RBM,IBCS,IXCU
 SG_ ADC_ABPReq_B : 123|1@0+ (1,0) [0|1] ""  CCU,CCURT1,CCURT2,RBM,IBCS,IXCU
 SG_ ADC_ComfstopReq_B : 134|1@0+ (1,0) [0|1] ""  CCU,IBCS
 SG_ ADC_CSM_HoldReq_B : 135|1@0+ (1,0) [0|1] ""  CCU,IBCS
 SG_ Reserved1 : 440|1@0+ (1,0) [0|0] ""  CCU

BO_ 361 ADC_4_B: 64 ADC
 SG_ ADC_4_B_CRC : 7|16@0+ (1,0) [0|65535] ""  CCU,CCURT1,CCURT2,RT1_C1,VDC,EPS,IBCS,ECS,EPB,IXCU
 SG_ ADC_4_B_Counter : 23|8@0+ (1,0) [0|255] ""  CCU,CCURT1,CCURT2,RT1_C1,VDC,EPS,IBCS,ECS,EPB,IXCU
 SG_ ADC_AngReqFunction_B1 : 29|2@0+ (1,0) [0|3] ""  CCU,CCURT1,CCURT2,EPS
 SG_ ADC_BrakeLightReq_B1 : 27|2@0+ (1,0) [0|3] ""  CCU,CCURT1,CCURT2
 SG_ ADC_AngReqSt_A_B1 : 31|2@0+ (1,0) [0|3] ""  EPS
 SG_ ADC_StrAngleReq_A_B1 : 39|16@0+ (0.1,-780) [-780|780] "deg"  EPS
 SG_ ADC_SACMotorTorLimExtMax_A_B1 : 55|8@0+ (0.02,0) [0|5.08] "Nm"  EPS
 SG_ ADC_SACMotorTorLimExtMin_A_B1 : 63|8@0+ (0.02,-5.08) [-5.08|0] "Nm"  EPS
 SG_ ADC_StrgWhlVibrWarnLevel_B1 : 68|2@0+ (1,0) [0|3] ""  EPS
 SG_ ADC_SteerGainLevel_B1 : 79|8@0+ (1,0) [0|254] "%"  EPS
 SG_ ADC_EvsSteerReq_B1 : 87|1@0+ (1,0) [0|1] ""  EPS
 SG_ ADC_StrgWhlVibrWarnReq_B1 : 86|1@0+ (1,0) [0|1] ""  EPS
 SG_ ADC_LongCtrlTypReq_B1 : 143|1@0+ (1,0) [0|1] ""  IBCS,IXCU
 SG_ ADC_ABAReq_B1 : 258|1@0+ (1,0) [0|1] ""  IBCS,IXCU
 SG_ ADC_ABALevel_B1 : 257|2@0+ (1,0) [0|3] ""  IBCS,IXCU
 SG_ ADC_AWBReq_B1 : 271|1@0+ (1,0) [0|1] ""  IBCS,IXCU
 SG_ ADC_ABPReq_B1 : 270|1@0+ (1,0) [0|1] ""  IBCS,IXCU
 SG_ ADC_AWBLevel_B1 : 269|3@0+ (1,0) [0|7] ""  IBCS,IXCU
 SG_ ADC_EpbModReq_B1 : 281|2@0+ (1,0) [0|3] ""  EPB,IXCU
 SG_ ADC_EpbModReqEna_B1 : 294|1@0+ (1,0) [0|1] ""  EPB,IXCU
 SG_ ADC_BrkTarTqEna_B1 : 125|1@0+ (1,0) [0|1] ""  IBCS,IXCU
 SG_ ADC_BrkTarTqMod_B1 : 25|2@0+ (1,0) [0|3] ""  IBCS,IXCU
 SG_ ADC_AebBrkTarTq_B1 : 111|16@0+ (1,0) [0|65535] "Nm"  IBCS,IXCU
 SG_ ADC_EpbModReqVld_B1 : 126|1@0+ (1,0) [0|1] ""  EPB,IXCU
 SG_ ADC_RWUEna_B1 : 127|1@0+ (1,0) [0|1] ""  EPB
 SG_ ADC_BrkHoldReq_B1 : 279|2@0+ (1,0) [0|3] ""  IBCS,IXCU
 SG_ ADC_AngReqAvl_B1 : 340|1@0+ (1,0) [0|1] ""  EPS
 SG_ ADC_BrkTarTqVld_B1 : 328|1@0+ (1,0) [0|1] ""  IBCS,IXCU
 SG_ ADC_AebBrkTarTqVld_B1 : 305|1@0+ (1,0) [0|1] ""  IBCS,IXCU
 SG_ ADC_AebBrkTarTqEna_B1 : 306|1@0+ (1,0) [0|1] ""  CCU,CCURT1,CCURT2,IBCS,IXCU
 SG_ ADC_ElecBrkFnSwitch_B1 : 307|1@0+ (1,0) [0|1] ""  CCU,CCURT1,CCURT2,RT1_C1,VDC,IBCS,IXCU
 SG_ ADC_RWUVld_B1 : 400|1@0+ (1,0) [0|1] ""  EPB
 SG_ ADC_DriverPresent_B1 : 309|2@0+ (1,0) [0|3] ""  CCU,CCURT1,CCURT2,RT2_C3,IBCS,EPB,IXCU
 SG_ ADC_BrkTarTq_B1 : 439|16@0+ (1,0) [0|65535] "Nm"  IBCS,IXCU
 SG_ ADC_AssistParaSwitchReq_B1 : 71|1@0+ (1,0) [0|1] ""  CCU,CCURT1,CCURT2,EPS,IBCS,IXCU
 SG_ ADC_AngReqRdntReq_A_B1 : 70|1@0+ (1,0) [0|1] ""  CCU,CCURT1,CCURT2,EPS
 SG_ ADC_SteerGainReq_B1 : 69|1@0+ (1,0) [0|1] ""  CCU,CCURT1,CCURT2,EPS
 SG_ ADC_ActTrqReqEnable_B1 : 66|1@0+ (1,0) [0|1] ""  CCU,CCURT1,CCURT2,RT1_C1,VDC,IXCU
 SG_ ADC_VLCSt_B1 : 65|2@0+ (1,0) [0|2] ""  CCU,CCURT1,CCURT2
 SG_ ADC_ActTrqReq_B1 : 85|14@0+ (1,-5000) [-5000|5000] "Nm"  CCU,CCURT1,CCURT2,RT1_C1,VDC
 SG_ ADC_ADASLongCtrlFuncMode_B1 : 135|3@0+ (1,0) [0|7] ""  CCU,CCURT1,CCURT2,IBCS,IXCU
 SG_ ADC_LongCtrlAvailability_B1 : 132|1@0+ (1,0) [0|1] ""  CCU,CCURT1,CCURT2,EPS,IBCS,IXCU
 SG_ ADC_LongCtrlModeForBrkSys_B1 : 131|3@0+ (1,0) [0|7] ""  CCU,CCURT1,CCURT2,IBCS,IXCU
 SG_ ADC_LongCtrlTargetAxReq_B1 : 128|1@0+ (1,0) [0|1] ""  CCU,CCURT1,CCURT2,IBCS,IXCU
 SG_ ADC_LongCtrlDecToStopReq_B1 : 142|1@0+ (1,0) [0|1] ""  CCU,CCURT1,CCURT2,IBCS,IXCU
 SG_ ADC_LongCtrlDriveOff_B1 : 141|1@0+ (1,0) [0|1] ""  CCU,CCURT1,CCURT2,IBCS,IXCU
 SG_ ADC_LongctrlSecureReq_B1 : 140|1@0+ (1,0) [0|1] ""  CCU,CCURT1,CCURT2,IBCS,IXCU
 SG_ ADC_ShifttoAVHReq_B1 : 139|1@0+ (1,0) [0|1] ""  CCU,CCURT1,CCURT2,IBCS,IXCU
 SG_ ADC_LongCtrlTargetAx_B1 : 138|11@0+ (0.01,-10) [-10|10] "m/s2"  CCU,CCURT1,CCURT2,IBCS,IXCU
 SG_ ADC_TrkTargt0St_B1 : 159|1@0+ (1,0) [0|1] ""  CCU,CCURT1,CCURT2
 SG_ ADC_TrkTargt0longPos_B1 : 158|10@0+ (0.2,0) [0|204.4] "m"  CCU,CCURT1,CCURT2
 SG_ ADC_TrkTargt0latPos_B1 : 164|10@0+ (0.1,-51.2) [-51.2|51.1] "m"  CCU,CCURT1,CCURT2
 SG_ ADC_TrkTargt0LatRelSpd_B1 : 170|9@0+ (0.1,-25.5) [-25.5|25.5] "m/s"  CCU,CCURT1,CCURT2
 SG_ ADC_TrkTargt0LongRelSpd_B1 : 177|10@0+ (0.1,-51.2) [-51.2|51.1] "m/s"  CCU,CCURT1,CCURT2
 SG_ ADC_AS_pauseReq_B1 : 199|1@0+ (1,0) [0|1] ""  CCU,CCURT1,CCURT2,EPS,ECS
 SG_ ADC_AS_calibrationReq_B1 : 198|3@0+ (1,0) [0|5] ""  CCU,CCURT1,CCURT2,EPS,ECS
 SG_ ADC_AS_exitcurrentlevelReq_B1 : 195|1@0+ (1,0) [0|1] ""  CCU,CCURT1,CCURT2,EPS,ECS
 SG_ ADC_AS_ReqToadjust_B1 : 194|3@0+ (1,0) [0|5] ""  CCU,CCURT1,CCURT2,EPS,ECS
 SG_ ADC_ASActiveSt_B : 206|1@0+ (1,0) [0|1] ""  CCU,CCURT1,CCURT2,RT1_C1,VDC
 SG_ ADC_AS_UnsafelevelunableReq_B1 : 207|1@0+ (1,0) [0|1] ""  CCU,CCURT1,CCURT2,EPS,ECS
 SG_ ADC_FcsActiveStatus_B : 205|1@0+ (1,0) [0|1] ""  CCU,CCURT1,CCURT2,RT1_C1,VDC
 SG_ ADC_AEBTargetDecel_B1 : 243|12@0+ (0.008,-16) [-16|16] "m/s2"  CCU,CCURT1,CCURT2,IBCS,IXCU
 SG_ ADC_AEBFaultSt_B1 : 263|1@0+ (1,0) [0|1] ""  CCU,CCURT1,CCURT2,IBCS,IXCU
 SG_ ADC_AEBOffSt_B1 : 262|1@0+ (1,0) [0|1] ""  CCU,CCURT1,CCURT2,IBCS,IXCU
 SG_ ADC_AEBInterventionSt_B1 : 261|1@0+ (1,0) [0|1] ""  CCU,CCURT1,CCURT2,IBCS,IXCU
 SG_ ADC_AEBDecelCtrlReq_B1 : 260|1@0+ (1,0) [0|1] ""  CCU,CCURT1,CCURT2,IBCS,IXCU
 SG_ ADC_AEBLVehHoldReq_B1 : 259|1@0+ (1,0) [0|1] ""  CCU,CCURT1,CCURT2,IBCS,IXCU
 SG_ ADC_AEBTarCalss_B1 : 266|3@0+ (1,0) [0|7] ""  CCU,CCURT1,CCURT2,IBCS,IXCU
 SG_ ADC_AEBTarDetSensor_B1 : 277|2@0+ (1,0) [0|3] ""  CCU,CCURT1,CCURT2,IBCS,IXCU
 SG_ ADC_TurnLightReq_B1 : 275|3@0+ (1,0) [0|7] ""  CCU,CCURT1,CCURT2
 SG_ ADC_PAA2ESPAxReqEnable_B1 : 272|1@0+ (1,0) [0|1] ""  CCU,CCURT1,CCURT2,IBCS,IXCU
 SG_ ADC_PAA2ESPBrakeFunctionMode_B1 : 287|3@0+ (1,0) [0|7] ""  CCU,CCURT1,CCURT2,IBCS,IXCU
 SG_ ADC_PAA2ESPEpbReq_B1 : 284|2@0+ (1,0) [0|2] ""  CCU,CCURT1,CCURT2,IBCS,IXCU
 SG_ ADC_PAA2ESPEpbReqSt_B1 : 282|1@0+ (1,0) [0|1] ""  CCU,CCURT1,CCURT2
 SG_ ADC_ESPSwitchReq_B1 : 295|1@0+ (1,0) [0|1] ""  CCU,CCURT1,CCURT2
 SG_ ADC_PAA2EPBBrakeFunctionMode_B1 : 293|1@0+ (1,0) [0|1] ""  CCU,CCURT1,CCURT2,EPB
 SG_ ADC_PAA2ESPApEmgyBrkReq_B1 : 292|1@0+ (1,0) [0|1] ""  CCU,CCURT1,CCURT2,IBCS,IXCU
 SG_ ADC_PAA2ESPComfBrakeReq_B1 : 291|2@0+ (1,0) [0|3] ""  CCU,CCURT1,CCURT2,IBCS,IXCU
 SG_ ADC_PAA2ESPApDriveOffReq_B1 : 289|1@0+ (1,0) [0|1] ""  CCU,CCURT1,CCURT2,IBCS,IXCU
 SG_ ADC_PAA2ESPApStandstillReq_B1 : 311|1@0+ (1,0) [0|1] ""  CCU,CCURT1,CCURT2,IBCS,IXCU
 SG_ ADC_PAA2ESPApPrefillReq_B1 : 310|1@0+ (1,0) [0|1] ""  CCU,CCURT1,CCURT2,IBCS,IXCU
 SG_ ADC_PAA2ESPAxReq_B1 : 327|14@0+ (0.001,-10) [-10|6] "m/s2"  CCU,CCURT1,CCURT2,IBCS,IXCU
 SG_ ADC_EPBReq_B1 : 329|1@0+ (1,0) [0|1] ""  CCU,CCURT1,CCURT2,IBCS,IXCU
 SG_ ADC_PAA2ESPDistoStop_B1 : 339|12@0+ (1,0) [0|4095] "cm"  CCU,CCURT1,CCURT2,IBCS,IXCU
 SG_ ADC_PAA2ESPTarTorquePTDriveoff_B1 : 359|16@0+ (1,-30000) [-30000|30000] "Nm"  CCU,CCURT1,CCURT2,IBCS,IXCU
 SG_ ADC_VehTorqLimit_B1 : 375|16@0+ (1,-5000) [-5000|5000] "Nm"  CCU,CCURT1,CCURT2
 SG_ ADC_VehTorqReqValue_B1 : 391|16@0+ (1,-5000) [-5000|5000] "Nm"  CCU,CCURT1,CCURT2
 SG_ ADC_VehTorqLimitEnable_B1 : 407|1@0+ (1,0) [0|1] ""  CCU,CCURT1,CCURT2
 SG_ ADC_VehTorqReqEnable_B1 : 406|1@0+ (1,0) [0|1] ""  CCU,CCURT1,CCURT2
 SG_ ADC_PAAPwrModeReq_B1 : 405|1@0+ (1,0) [0|1] ""  CCU,CCURT1,CCURT2
 SG_ ADC_PAAGrarLvlReq_B1 : 404|3@0+ (1,0) [0|7] ""  CCU,CCURT1,CCURT2,RT1_C1,VDC
 SG_ ADC_PAAGrarLvlReqEnable_B1 : 401|1@0+ (1,0) [0|1] ""  CCU,CCURT1,CCURT2,RT1_C1,VDC
 SG_ ADC_ActTrqReqVD_B1 : 341|1@0+ (1,0) [0|1] ""  CCU,CCURT1,CCURT2,RT1_C1,VDC
 SG_ ADC_RCTBTargetDecel_B1 : 411|8@0+ (0.05,-10) [-10|2.75] "m/s2"  CCU,CCURT1,CCURT2,IBCS,IXCU
 SG_ ADC_RCTBBrkReq_B1 : 419|1@0+ (1,0) [0|1] ""  CCU,CCURT1,CCURT2,IBCS,IXCU
 SG_ ADC_TarGearReqVld_B1 : 342|1@0+ (1,0) [0|1] ""  CCU,CCURT1,CCURT2,RT1_C1,VDC
 SG_ ADC_FctSts_B1 : 343|1@0+ (1,0) [0|1] ""  CCU,CCURT1,CCURT2,RT1_C1,VDC

CM_ SG_ 368 DCU_1_CRC "E2E Profile 5 CRC";
CM_ SG_ 368 DCU_1_Counter "E2E Profile 5 Counter";
CM_ SG_ 368 DCU_RotSpdAct "actual rotation speed of drvie motor";
CM_ SG_ 368 DCU_ModeSt "mode status of drive motor";
CM_ SG_ 368 DCU_ADC_MCUBlkst "DCU block state";
CM_ SG_ 368 DCU_ADC_SpdSvModAvl "DCU speed mode available state";
CM_ SG_ 368 DCU_ADC_MCUStandstill "DCU standstill state";
CM_ SG_ 368 DCU_ADC_MCUSpdSVModFit "DCU speed mode fault";
CM_ SG_ 368 DCU_ADC_MCUVehSldSt "DCU detect vehicle slide state";
CM_ SG_ 368 DCU_ADC_MCUReqTq "DCU innner request torque";
CM_ SG_ 368 DCU_RotSpdAct_Raw "actual rotation speed of drvie motor without filter";
CM_ SG_ 704 IPS_1_CRC "E2E Profile 5 CRC";
CM_ SG_ 704 IPS_1_Counter "E2E Profile 5 Counter";
CM_ SG_ 704 IPS_DCDCModeSt "mode status of DCDC";
CM_ SG_ 824 VCU_2_CRC "E2E Profile 5 CRC";
CM_ SG_ 824 VCU_2_Counter "E2E Profile 5 Counter";
CM_ SG_ 824 VCU_GearLvlDisp "Gear lever for display";
CM_ SG_ 824 VCU_VehDrvMod "Drive mode for display";
CM_ SG_ 824 VCU_VehRdySt "HEV system ready status";
CM_ SG_ 824 VCU_GearLvl "Gear lever for PEPS";
CM_ SG_ 824 VCU_PlgConnSt "Charge connector? connected Status";
CM_ SG_ 824 VCU_SwapHvBattRdySt "VCU swap Hvbattery ready status(driver agree swap)";
CM_ SG_ 824 VCU_SwapHvBattCompSt "VCU judge swap Hvbattery complete.";
CM_ SG_ 824 VCU_SwapHvBattModeSt "VCU swap Hvbattery mode status";
CM_ SG_ 824 VCU_SwapHvBattModeStVD "VCU swap Hvbattery mode statue VD";
CM_ SG_ 824 VCU_RoadMod "Road mode for display";
CM_ SG_ 653 VCU_5_CRC "E2E Profile 5 CRC";
CM_ SG_ 653 VCU_5_Counter "E2E Profile 5 Counter";
CM_ SG_ 653 VCU_AccButtInfo "ACC Button Information";
CM_ SG_ 653 VCU_LateralAssistBtnInfo "Lateral assist button Information";
CM_ SG_ 653 VCU_LateralAssistBtnInfoVD "Lateral assist button Information valid data";
CM_ SG_ 653 VCU_EMS_AccPedalActPst "Current accelerate pedal actual position";
CM_ SG_ 653 VCU_EMS_BrkPedalSt "Brake pedal status";
CM_ SG_ 653 VCU_EMS_BrkPedalStVD "VCU_EMS_BrakePedSt valid data";
CM_ SG_ 653 VCU_EMS_AccPedalActPstVD "Current accelerate pedal actual position validity";
CM_ SG_ 653 VCU_DCU_ActRotSpd "Actual rotation speed DCU";
CM_ SG_ 653 VCU_BrkPedPstVD "Current brake pedal position valid data";
CM_ SG_ 653 VCU_CrntGearLvl "VCU current carry out gear level";
CM_ SG_ 653 VCU_BrkPedPst "Current brake pedal position";
CM_ SG_ 653 VCU_APAGasPedalIntv "VCU judge if? the driver intervened base the accelerator pedal position";
CM_ SG_ 653 VCU_APAAvailable "Whether VCU is available for APA function";
CM_ SG_ 653 VCU_ACCMaxRecpDecel "Current maximum recuperation deceleration of generator";
CM_ SG_ 653 VCU_ACCLimitOperatingSt "Operation status of ACC Limit mode, When VCU Enter the power-saving mode，";
CM_ SG_ 653 VCU_ACCMaxRecpDecelVD "VCU_ACCMaxRecpDecel valid validity";
CM_ SG_ 653 VCU_APA_Resp "VCU response to APA if VCU is response the gear shif and torque request";
CM_ SG_ 653 VCU_APAGearIntervern "During parking, If there is a request from GSM to change the gearlevel, this signal will be set to 1:with intervention (GSM gearlevel invalid will also be regard as a gearlevel request)";
CM_ SG_ 653 VCU_ActVehWheelTorq "Actual effective engine torque on wheel level";
CM_ SG_ 653 VCU_ACCmaxSpdLimit "When VCU Enter the power-saving mode，the maximum ACC target speed limited by VCU";
CM_ SG_ 653 VCU_VehWheelTorqMax "Actual effective maximum adjustable torque on wheel level";
CM_ SG_ 653 VCU_RecpTorqVD "Status of recuperation torque of generator";
CM_ SG_ 653 VCU_RecpTorq "Current recuperation torque of generator";
CM_ SG_ 653 VCU_CrntGearLvlVD "Valid bit for ActualGearPosition.";
CM_ SG_ 653 EMS_GasPedalActPstforMRRVD_D "EMS_GasPedalActPstforMRR Valid Data";
CM_ SG_ 644 VCU_7_CRC "E2E Profile 5 CRC";
CM_ SG_ 644 VCU_7_Counter "E2E Profile 5 Counter";
CM_ SG_ 644 EMS_GasPedalActPstforMRRVD "EMS_GasPedalActPstforMRR Valid Data";
CM_ SG_ 644 VCU_AccTMCFail "Indicating VCU in limp-home (error) mode.";
CM_ SG_ 644 VCU_AccElecECFail "Indicate the error state of electronic engine control.";
CM_ SG_ 644 VCU_AccDriverOrvd "Indicating the torque demanded by the driver is higher than the torque demanded by ACC.";
CM_ SG_ 644 EMS_GasPedalActPstforMRR "EMS_GasPedalActPstforMRR";
CM_ SG_ 644 VCU_AccSpareCanError "ACC Space CAN Error";
CM_ SG_ 644 VCU_IFCFailureSt "IFC Failure Status";
CM_ SG_ 644 VCU_AccDriverOrvdVD "Indicating the torque demanded by the driver is higher than the torque demanded by ACC.";
CM_ SG_ 644 VCU_TorqDriverReq "the driver torque request";
CM_ SG_ 393 VCU_9_CRC "E2E Profile 5 CRC";
CM_ SG_ 393 VCU_9_Counter "E2E Profile 5 Counter";
CM_ SG_ 393 VCU_ErrorFb "Indicate the error state for VCU";
CM_ SG_ 393 VCU_VehWhlReqTqVld "Validity of Actual effective engine torque on wheel level";
CM_ SG_ 393 VCU_MotorRegenTrqLmtlnDVaild "整车最大允许制动能量回收扭矩轮端扭矩有效位";
CM_ SG_ 393 VCU_GearShiftAvl "档位切换可用状态";
CM_ SG_ 393 VCU_PtTqAvl "Indicate the available statusof Power system torque";
CM_ SG_ 393 VCU_PtTqActvSts "VCU扭矩响应状态";
CM_ SG_ 393 VCU_MotorRegenTorqueLmtlnD "Current maximum available recuperation torque of generator";
CM_ SG_ 393 VCU_DriverTorqueDesired "the driver torque request";
CM_ SG_ 393 VCU_VehWhlReqTq "Vehicle demand for wheel torque request";
CM_ SG_ 393 VCU_TargetRecpTorqSt "Status of  Target cuperation torque of generator";
CM_ SG_ 393 VCU_TargetRecpTorqNm "Current target recuperation torque of generator";
CM_ SG_ 393 VCU_TargetRecpTorqFA_Hyb "Target cuperation torque of generator for front axel";
CM_ SG_ 393 VCU_TargetRecpTorqRA_Hyb "Target cuperation torque of generator for rear axel";
CM_ SG_ 393 VCU_TorqDriverReqFA_Hyb "the driver torque request for front axel";
CM_ SG_ 393 VCU_TorqDriverReqRA_Hyb "the driver torque request for rear axel ";
CM_ SG_ 393 VCU_VehActDrvTorqFA_Hyb "Vehicle actual drive torque for front axel ";
CM_ SG_ 393 VCU_VehActDrvTorqRA_Hyb "Vehicle actual drive torque for rear axel ";
CM_ SG_ 393 VCU_TargetRecpTorqFAVD_Hyb "Status of Target cuperation torque of generator for front axel ";
CM_ SG_ 393 VCU_TargetRecpTorqRAVD_Hyb "Status of Target cuperation torque of generator for rear axel";
CM_ SG_ 393 VCU_TorqDriverReqFAVD "Status of the driver torque request for front axel";
CM_ SG_ 393 VCU_TorqDriverReqRAVD "Status of the driver torque request for rear axel";
CM_ SG_ 393 VCU_VehActDrvTorqFAVD_Hyb "Vehicle actual drive torque valid data for front axel ";
CM_ SG_ 393 VCU_VehActDrvTorqRAVD_Hyb "Vehicle actual drive torque valid data for rear axel ";
CM_ SG_ 393 VCU_BcsDecelReq "target deceleration to BCS by AVDC";
CM_ SG_ 393 VCU_BcsDecelVD "Quality/Fault of AVDC deceleration to BCS";
CM_ SG_ 393 VCU_BcsDecelEnable "AVDC deceleration to BCS enable";
CM_ SG_ 393 VCU_CrntGearNoTrans "VCU Gear Lever send to ADS without trans";
CM_ SG_ 393 VCU_RecpTorqSt "Status of recuperation torque of generator";
CM_ SG_ 393 VCU_RecpTorqNm "Current recuperation torque of generator";
CM_ SG_ 393 VCU_RecpTorqFAVD_Hyb "Status of front axel maximum recuperation torque of generator";
CM_ SG_ 393 VCU_RecpTorqRAVD_Hyb "Status of rear axel maximum recuperation torque of generator";
CM_ SG_ 393 VCU_MaxRecpTorqFAVD_Hyb "Status of front axel maximum recuperation torque of generator";
CM_ SG_ 393 VCU_MaxRecpTorqRAVD_Hyb "Status of front axel maximum recuperation torque of generator";
CM_ SG_ 393 VCU_RecpTorqFA_Hyb "Current recuperation torque of generator FA";
CM_ SG_ 393 VCU_RecpTorqRA_Hyb "Current recuperation torque of generator RA";
CM_ SG_ 393 VCU_MaxRecpTorqFA_Hyb "Current maximum available recuperation torque of generator FA";
CM_ SG_ 393 VCU_MaxRecpTorqRA_Hyb "Current maximum available recuperation torque of generator RA";
CM_ SG_ 393 VCU_VehWheelTorqMinNm "Actual effective minimum adjustable torque on wheel level";
CM_ SG_ 393 VCU_VehWheelTorqMaxNmVD "Actual effective maximum adjustable torque on wheel level validity";
CM_ SG_ 393 VCU_VehWheelTorqMaxNm "Actual effective maximum adjustable torque on wheel level";
CM_ SG_ 393 VCU_ActVehWheelTorqNm "Actual effective engine torque on wheel level";
CM_ SG_ 393 VCU_APAWheelTorqDriverReqNm "The driver torque on wheel request to APA";
CM_ SG_ 404 ADC_1_B_CRC "E2E Profile 5 CRC";
CM_ SG_ 404 ADC_1_B_Counter "E2E Profile 5 Counter";
CM_ SG_ 404 ADC_LongCtrlAvailability_B "Main ADC Vehicle motion control availability (The longitudinal controller will avoid to erroneously perform the requests from a ADC not indicated as available).";
CM_ SG_ 404 ADC_LongCtrlModeForBrkSys_B "Main ADC Longitudinal Control Mode For BrakeSys.Off mode: ADAS Not engage.L2 Active: ADAS working in L2 Function.L2++ Active: ADAS working in L2++ or Advance Cruise ,Brake system has a redundant actuator.";
CM_ SG_ 404 ADC_LongCtrlTargetAx_B "Main ADC Longitudinal Control acceleration forBrakeSystem";
CM_ SG_ 404 ADC_LongCtrlTargetAxReq_B "Main ADC Request from the Longitudinal Control acceleration to BrakeSys";
CM_ SG_ 404 ADC_LongCtrlTypReq_B "Main ADC  Longitudinal Control Brake type.Comfort Mode : The controller and brake system will consider NVH limitations, carefully reaction for good driving feeling, etc.Emergency Mode: the controller react fast and the brake system will achieve maximum performance (No limitations, eg. NVH limitations, HW protection).";
CM_ SG_ 404 ADC_LongCtrlDecToStopReq_B "Main ADC LongitudinalControl requires deceleration to stop";
CM_ SG_ 404 ADC_LongctrlSecureReq_B "Main ADC L2++ system request secure the vehicle, such as use case: L2++ fail operation active, driver no take over, need to stop in emergency lane, request secure vehicle at standstill by EPB Applied.";
CM_ SG_ 404 ADC_ActTrqReq_B "VLC Request Effective target torque on wheel level to VCU";
CM_ SG_ 404 ADC_ActTrqReqEnable_B "Enable flag for VCU for realization of target torque ActTrqReq";
CM_ SG_ 404 ADC_VLCSt_B "Vehicle Longitudinal Power Control status of ADAS to VCU/EMS";
CM_ SG_ 404 ADC_ICMWarnCardSt_B "ICM Warn Card State";
CM_ SG_ 404 ADC_ICMPromptWarn_B "ICM Prompt Warn";
CM_ SG_ 404 ADC_StrAngleReq_B "Steering Angle Request Value";
CM_ SG_ 404 ADC_SACMotorTorLimExtMax_B "Maximum Motor External Torque Limitation of Angle Following";
CM_ SG_ 404 ADC_SACMotorTorLimExtMin_B "Minimum Motor External Torque Limitation of Angle Following";
CM_ SG_ 404 ADC_AngReqRdntReq_B "Angle following control redundancy request";
CM_ SG_ 404 ADC_AngReqSt_B "Lateral control Function Request State";
CM_ SG_ 404 ADC_AssistParaSwitchReq_B "Request EPS Switch Assist Parameter to LKAmode";
CM_ SG_ 404 ADC_PAAGrarLvlReq_B "Gear lever position request for the vehicle mo-tion control";
CM_ SG_ 404 ADC_PAAGrarLvlReqEnable_B "enable flag to control the gear box";
CM_ SG_ 404 ADC_ElecBrkFnSwitch_B "The switch for regenerative brake and hydraulic brake.Off : The ESP/IPB can not assign regenerative brake torque to VCU/DCU.On : The ESP/IPB can assign regenerative brake torque to the VCU/DCU.";
CM_ SG_ 404 ADC_LongCtrlDriveOff_B "Backup ADC LongitudinalControl requires driving off";
CM_ SG_ 404 ADC_AEBDecelCtrlReq_B "AEB deceleration activation request from VIU";
CM_ SG_ 404 ADC_AEBTargetDecel_B "AEB target deceleration request from VIU";
CM_ SG_ 404 ADC_ABPReq_B "Prefill request";
CM_ SG_ 404 ADC_ComfstopReq_B "Comfort Stop function Switch require";
CM_ SG_ 404 ADC_CSM_HoldReq_B "CSM_Hold Require";
CM_ SG_ 361 ADC_4_B_CRC "E2E Profile 5 CRC";
CM_ SG_ 361 ADC_4_B_Counter "E2E Profile 5 Counter";
CM_ SG_ 361 ADC_AngReqFunction_B1 "Indicates which function request angle control";
CM_ SG_ 361 ADC_BrakeLightReq_B1 "Brake Light Request?";
CM_ SG_ 361 ADC_AngReqSt_A_B1 "Lateral control Function Request State";
CM_ SG_ 361 ADC_StrAngleReq_A_B1 "Steering Angle Request Value";
CM_ SG_ 361 ADC_SACMotorTorLimExtMax_A_B1 "Maximum Motor External Torque Limitation of Angle Following";
CM_ SG_ 361 ADC_SACMotorTorLimExtMin_A_B1 "Minimum Motor External Torque Limitation of Angle Following";
CM_ SG_ 361 ADC_StrgWhlVibrWarnLevel_B1 "Steering wheel vibratio Warn Frequency";
CM_ SG_ 361 ADC_SteerGainLevel_B1 "Driver steering gain request value";
CM_ SG_ 361 ADC_EvsSteerReq_B1 "Emergency Collision avoidance steering mode request";
CM_ SG_ 361 ADC_StrgWhlVibrWarnReq_B1 "Steering wheel vibration Warn request";
CM_ SG_ 361 ADC_LongCtrlTypReq_B1 "Main ADC  Longitudinal Control Brake type.Comfort Mode : The controller and brake system will consider NVH limitations, carefully reaction for good driving feeling, etc.Emergency Mode: the controller react fast and the brake system will achieve maximum performance (No limitations, eg. NVH limitations, HW protection).";
CM_ SG_ 361 ADC_ABAReq_B1 "Request of the ABA support from ESP";
CM_ SG_ 361 ADC_ABALevel_B1 "ABA(Adaptive Brake Assistance) level to the ESP HBA";
CM_ SG_ 361 ADC_AWBReq_B1 "Request of the brake jerk warning to ESP";
CM_ SG_ 361 ADC_ABPReq_B1 "Request of the Prefill to ESP";
CM_ SG_ 361 ADC_AWBLevel_B1 "Different level request of the brake jerk";
CM_ SG_ 361 ADC_EpbModReq_B1 "The  request from the ADAS/ADS to the EPB";
CM_ SG_ 361 ADC_EpbModReqEna_B1 "The enable status  of the  request from the ADAS/ADS to the  EPB";
CM_ SG_ 361 ADC_BrkTarTqEna_B1 "The enable status  of total target brake torque";
CM_ SG_ 361 ADC_BrkTarTqMod_B1 "This signal indicates which function the total target brake torque is used for，cruise or parking function.";
CM_ SG_ 361 ADC_AebBrkTarTq_B1 "Total taget brake torque of the AEB";
CM_ SG_ 361 ADC_EpbModReqVld_B1 "The validity of the  request from the ADAS/ADS to the  EPB";
CM_ SG_ 361 ADC_RWUEna_B1 "The enable status of the  RWU";
CM_ SG_ 361 ADC_BrkHoldReq_B1 "The AVH request from the ADAS/ADS to the ESP/IPB.Not active：AVH no activeActive：AVH active";
CM_ SG_ 361 ADC_AngReqAvl_B1 "Steering angle request avaliable state";
CM_ SG_ 361 ADC_BrkTarTqVld_B1 "The validity of total  target brake torque";
CM_ SG_ 361 ADC_AebBrkTarTqVld_B1 "The validity of total target brake torque of the AEB";
CM_ SG_ 361 ADC_AebBrkTarTqEna_B1 "The enable status  of total  target brake torque of the AEB";
CM_ SG_ 361 ADC_ElecBrkFnSwitch_B1 "The switch for regenerative brake and hydraulic brake。Off：The ESP/IPB can not assign regenerative brake torque to the VCU/DCU。On：The ESP/IPB can assign regenerative brake torque to the VCUDCU。";
CM_ SG_ 361 ADC_RWUVld_B1 "The validity  of the RWU";
CM_ SG_ 361 ADC_DriverPresent_B1 "It indicates whether someone is in the driver's seat.";
CM_ SG_ 361 ADC_BrkTarTq_B1 "Total target brake torque for cruise and parking function ";
CM_ SG_ 361 ADC_AssistParaSwitchReq_B1 "Request EPS Switch Assist Parameter to LKAmode";
CM_ SG_ 361 ADC_AngReqRdntReq_A_B1 "Angle following control redundancy request";
CM_ SG_ 361 ADC_SteerGainReq_B1 "Driver steering  gain request signal";
CM_ SG_ 361 ADC_ActTrqReqEnable_B1 "Enable flag for VCU for realization of target torque ActTrqReq";
CM_ SG_ 361 ADC_VLCSt_B1 "Vehicle Longitudinal Power Control status of ADAS to VCU/EMS";
CM_ SG_ 361 ADC_ActTrqReq_B1 "VLC Request Effective target torque on wheel level to VCU";
CM_ SG_ 361 ADC_ADASLongCtrlFuncMode_B1 "This signal indicates ADC Longitudinal Control acceleration belongs to which function (ACC or APA)";
CM_ SG_ 361 ADC_LongCtrlAvailability_B1 "Main ADC Vehicle motion control availability (The longitudinal controller will avoid to erroneously perform the requests from a ADC not indicated as available).";
CM_ SG_ 361 ADC_LongCtrlModeForBrkSys_B1 "Main ADC Longitudinal Control Mode For BrakeSys.Off mode: ADAS Not engage.L2 Active: ADAS working in L2 Function.L2++ Active: ADAS working in L2++ or Advance Cruise ,Brake system has a redundant actuator.";
CM_ SG_ 361 ADC_LongCtrlTargetAxReq_B1 "Main ADC Request from the Longitudinal Control acceleration to BrakeSys";
CM_ SG_ 361 ADC_LongCtrlDecToStopReq_B1 "Main ADC LongitudinalControl requires deceleration to stop";
CM_ SG_ 361 ADC_LongCtrlDriveOff_B1 "Main ADC LongitudinalControl requires driving off";
CM_ SG_ 361 ADC_LongctrlSecureReq_B1 "Main ADC L2++ system request secure the vehicle, such as use case: L2++ fail operation active, driver no take over, need to stop in emergency lane, request secure vehicle at standstill by EPB Applied.";
CM_ SG_ 361 ADC_ShifttoAVHReq_B1 "Request Brake System Change to AVH From ACC Standstill Hold State";
CM_ SG_ 361 ADC_LongCtrlTargetAx_B1 "Main ADC Longitudinal Control acceleration forBrakeSystem";
CM_ SG_ 361 ADC_TrkTargt0St_B1 "Front Track Target 0（Closest Same Lane）detection state";
CM_ SG_ 361 ADC_TrkTargt0longPos_B1 "Track Target 0（Closest Same Lane）Longitudinal Position";
CM_ SG_ 361 ADC_TrkTargt0latPos_B1 "Track Target 0（Closest Same Lane）Lateral Position";
CM_ SG_ 361 ADC_TrkTargt0LatRelSpd_B1 "Track Target 0（Closest Same Lane）Lateral Relative Speed";
CM_ SG_ 361 ADC_TrkTargt0LongRelSpd_B1 "Track Target 0（Closest Same Lane）Longitudinal Relative Speed";
CM_ SG_ 361 ADC_AS_pauseReq_B1 "Inhibit suspension adjustment requests";
CM_ SG_ 361 ADC_AS_calibrationReq_B1 "Suspension adjustment is requested during calibration";
CM_ SG_ 361 ADC_AS_exitcurrentlevelReq_B1 "Parking request air spring out of the current height Level signal";
CM_ SG_ 361 ADC_AS_ReqToadjust_B1 "For specific parking functions, the AS is requested to be adjusted to the specific suspension level";
CM_ SG_ 361 ADC_ASActiveSt_B "This signal indicates if the ActiveSafe Acitve torqure control for VCU/EMS";
CM_ SG_ 361 ADC_AS_UnsafelevelunableReq_B1 "Parking request no air spring into unsafe Level height signal";
CM_ SG_ 361 ADC_FcsActiveStatus_B "indicate ADS Fuction is Active for energe save mode";
CM_ SG_ 361 ADC_AEBTargetDecel_B1 "Target deceleration value from AEB(Automatic Emergency Braking)/EBA(Emergence Braking Assist)";
CM_ SG_ 361 ADC_AEBFaultSt_B1 "This signal indicates the AEB(Auto Emerrgency Braking) fault status";
CM_ SG_ 361 ADC_AEBOffSt_B1 "This signal indicates if the AEB(Auto Emerrgency Braking) is deactivated";
CM_ SG_ 361 ADC_AEBInterventionSt_B1 "This signal indicates if the AEB(Auto Emerrgency Braking) intervents";
CM_ SG_ 361 ADC_AEBDecelCtrlReq_B1 "Request of the AEB/EBA/FCTB/RCTB deceleration control";
CM_ SG_ 361 ADC_AEBLVehHoldReq_B1 "Request ESP to hold vehilce if AEB active and vehilce stopped";
CM_ SG_ 361 ADC_AEBTarCalss_B1 "AEB Target Object Class";
CM_ SG_ 361 ADC_AEBTarDetSensor_B1 "AEB Target Property Detected by Sensor with Fusion or not.";
CM_ SG_ 361 ADC_TurnLightReq_B1 "Turn Lamp and Hazard Lamp Request?";
CM_ SG_ 361 ADC_PAA2ESPAxReqEnable_B1 "Target Ax value request enable";
CM_ SG_ 361 ADC_PAA2ESPBrakeFunctionMode_B1 "Indicate APA or RPA or AVP";
CM_ SG_ 361 ADC_PAA2ESPEpbReq_B1 "PAA to ESP to do EPB request";
CM_ SG_ 361 ADC_PAA2ESPEpbReqSt_B1 "PAA to ESP to do EPB request  status";
CM_ SG_ 361 ADC_ESPSwitchReq_B1 "ADAS ESP Switch to full function Request";
CM_ SG_ 361 ADC_PAA2EPBBrakeFunctionMode_B1 "Brake Function Mode";
CM_ SG_ 361 ADC_PAA2ESPApEmgyBrkReq_B1 "Emergency brake request";
CM_ SG_ 361 ADC_PAA2ESPComfBrakeReq_B1 "comfort brake request";
CM_ SG_ 361 ADC_PAA2ESPApDriveOffReq_B1 "Drive off request";
CM_ SG_ 361 ADC_PAA2ESPApStandstillReq_B1 "Vechile standstill request";
CM_ SG_ 361 ADC_PAA2ESPApPrefillReq_B1 "Prefill request";
CM_ SG_ 361 ADC_PAA2ESPAxReq_B1 "Target Ax value";
CM_ SG_ 361 ADC_EPBReq_B1 "ADAS EPB Request";
CM_ SG_ 361 ADC_PAA2ESPDistoStop_B1 "Distance to target stop point";
CM_ SG_ 361 ADC_PAA2ESPTarTorquePTDriveoff_B1 "target propulsive torque for drive off";
CM_ SG_ 361 ADC_VehTorqLimit_B1 "Torque limit to VCU";
CM_ SG_ 361 ADC_VehTorqReqValue_B1 "Torque request to VCU";
CM_ SG_ 361 ADC_VehTorqLimitEnable_B1 "Torque limit enable status to VCU";
CM_ SG_ 361 ADC_VehTorqReqEnable_B1 "Torque request enable status to VCU";
CM_ SG_ 361 ADC_PAAPwrModeReq_B1 "PAA Powertrain Request";
CM_ SG_ 361 ADC_PAAGrarLvlReq_B1 "Gear lever position request for the vehicle mo-tion control";
CM_ SG_ 361 ADC_PAAGrarLvlReqEnable_B1 "enable flag to control the gear box";
CM_ SG_ 361 ADC_ActTrqReqVD_B1 "The validity of ADC torque request to VCU";
CM_ SG_ 361 ADC_RCTBTargetDecel_B1 "target deceleration value from RCTB";
CM_ SG_ 361 ADC_RCTBBrkReq_B1 "RCTB brake request";
CM_ SG_ 361 ADC_TarGearReqVld_B1 "Gear lever request validity";
CM_ SG_ 361 ADC_FctSts_B1 "ADAS active status";

BA_DEF_ BO_  "GenMsgCycleTime" INT 0 0;
BA_DEF_ BO_  "GenMsgCycleTimeFast" INT 0 0;
BA_DEF_ BO_  "GenMsgSendType" ENUM  "Periodic","Event","IfActive","POE","PA","FixedPeriodic","Event","EnabledPeriodic","NotUsed","NotUsed","EventPeriodic","NotUsed","NotUsed","NoMsgSendType";
BA_DEF_ BO_  "VFrameFormat" ENUM  "StandardCAN","ExtendedCAN","reserved","reserved","reserved","reserved","reserved","reserved","reserved","reserved","reserved","reserved","reserved","reserved","StandardCAN_FD","ExtendedCAN_FD";
BA_DEF_ BO_  "CANFD_BRS" ENUM  "0","1";
BA_DEF_ SG_  "EventCommandSignal" ENUM  "No","Yes";
BA_DEF_ SG_  "GatewayedSignals" ENUM  "No","Yes";
BA_DEF_ SG_  "GenSigInactiveValue" HEX 0 0;
BA_DEF_ SG_  "GenSigInvalidValue" HEX 0 0;
BA_DEF_ SG_  "GenSigSendType" ENUM  "Trigger","Passive","Cyclic","OnWrite","OnWriteWithRepetition","OnChange","OnChangeWithRepetition","IfActive","IfActiveWithRepetition","NoSigSendType";
BA_DEF_ SG_  "GenSigStartValue" HEX 0 0;
BA_DEF_ SG_  "GenSigTimeoutValue" HEX 0 0;
BA_DEF_ SG_  "Remark" STRING ;
BA_ "GenMsgCycleTime" BO_ 368 10;
BA_ "GenMsgCycleTimeFast" BO_ 368 0;
BA_ "GenMsgSendType" BO_ 368 0;
BA_ "VFrameFormat" BO_ 368 14;
BA_ "CANFD_BRS" BO_ 368 1;
BA_ "GenMsgCycleTime" BO_ 368 10;
BA_ "GenMsgCycleTimeFast" BO_ 368 0;
BA_ "GenMsgSendType" BO_ 368 0;
BA_ "VFrameFormat" BO_ 368 14;
BA_ "CANFD_BRS" BO_ 368 1;
BA_ "GenMsgCycleTime" BO_ 368 10;
BA_ "GenMsgCycleTimeFast" BO_ 368 0;
BA_ "GenMsgSendType" BO_ 368 0;
BA_ "VFrameFormat" BO_ 368 14;
BA_ "CANFD_BRS" BO_ 368 1;
BA_ "GenMsgCycleTime" BO_ 368 10;
BA_ "GenMsgCycleTimeFast" BO_ 368 0;
BA_ "GenMsgSendType" BO_ 368 0;
BA_ "VFrameFormat" BO_ 368 14;
BA_ "CANFD_BRS" BO_ 368 1;
BA_ "GenMsgCycleTime" BO_ 368 10;
BA_ "GenMsgCycleTimeFast" BO_ 368 0;
BA_ "GenMsgSendType" BO_ 368 0;
BA_ "VFrameFormat" BO_ 368 14;
BA_ "CANFD_BRS" BO_ 368 1;
BA_ "GenMsgCycleTime" BO_ 368 10;
BA_ "GenMsgCycleTimeFast" BO_ 368 0;
BA_ "GenMsgSendType" BO_ 368 0;
BA_ "VFrameFormat" BO_ 368 14;
BA_ "CANFD_BRS" BO_ 368 1;
BA_ "GenMsgCycleTime" BO_ 368 10;
BA_ "GenMsgCycleTimeFast" BO_ 368 0;
BA_ "GenMsgSendType" BO_ 368 0;
BA_ "VFrameFormat" BO_ 368 14;
BA_ "CANFD_BRS" BO_ 368 1;
BA_ "GenMsgCycleTime" BO_ 368 10;
BA_ "GenMsgCycleTimeFast" BO_ 368 0;
BA_ "GenMsgSendType" BO_ 368 0;
BA_ "VFrameFormat" BO_ 368 14;
BA_ "CANFD_BRS" BO_ 368 1;
BA_ "GenMsgCycleTime" BO_ 368 10;
BA_ "GenMsgCycleTimeFast" BO_ 368 0;
BA_ "GenMsgSendType" BO_ 368 0;
BA_ "VFrameFormat" BO_ 368 14;
BA_ "CANFD_BRS" BO_ 368 1;
BA_ "GenMsgCycleTime" BO_ 368 10;
BA_ "GenMsgCycleTimeFast" BO_ 368 0;
BA_ "GenMsgSendType" BO_ 368 0;
BA_ "VFrameFormat" BO_ 368 14;
BA_ "CANFD_BRS" BO_ 368 1;
BA_ "GenMsgCycleTime" BO_ 368 10;
BA_ "GenMsgCycleTimeFast" BO_ 368 0;
BA_ "GenMsgSendType" BO_ 368 0;
BA_ "VFrameFormat" BO_ 368 14;
BA_ "CANFD_BRS" BO_ 368 1;
BA_ "GenMsgCycleTime" BO_ 704 200;
BA_ "GenMsgCycleTimeFast" BO_ 704 0;
BA_ "GenMsgSendType" BO_ 704 0;
BA_ "VFrameFormat" BO_ 704 14;
BA_ "CANFD_BRS" BO_ 704 1;
BA_ "GenMsgCycleTime" BO_ 704 200;
BA_ "GenMsgCycleTimeFast" BO_ 704 0;
BA_ "GenMsgSendType" BO_ 704 0;
BA_ "VFrameFormat" BO_ 704 14;
BA_ "CANFD_BRS" BO_ 704 1;
BA_ "GenMsgCycleTime" BO_ 704 200;
BA_ "GenMsgCycleTimeFast" BO_ 704 0;
BA_ "GenMsgSendType" BO_ 704 0;
BA_ "VFrameFormat" BO_ 704 14;
BA_ "CANFD_BRS" BO_ 704 1;
BA_ "GenMsgCycleTime" BO_ 824 100;
BA_ "GenMsgCycleTimeFast" BO_ 824 0;
BA_ "GenMsgSendType" BO_ 824 0;
BA_ "VFrameFormat" BO_ 824 14;
BA_ "CANFD_BRS" BO_ 824 1;
BA_ "GenMsgCycleTime" BO_ 824 100;
BA_ "GenMsgCycleTimeFast" BO_ 824 0;
BA_ "GenMsgSendType" BO_ 824 0;
BA_ "VFrameFormat" BO_ 824 14;
BA_ "CANFD_BRS" BO_ 824 1;
BA_ "GenMsgCycleTime" BO_ 824 100;
BA_ "GenMsgCycleTimeFast" BO_ 824 0;
BA_ "GenMsgSendType" BO_ 824 0;
BA_ "VFrameFormat" BO_ 824 14;
BA_ "CANFD_BRS" BO_ 824 1;
BA_ "GenMsgCycleTime" BO_ 824 100;
BA_ "GenMsgCycleTimeFast" BO_ 824 0;
BA_ "GenMsgSendType" BO_ 824 0;
BA_ "VFrameFormat" BO_ 824 14;
BA_ "CANFD_BRS" BO_ 824 1;
BA_ "GenMsgCycleTime" BO_ 824 100;
BA_ "GenMsgCycleTimeFast" BO_ 824 0;
BA_ "GenMsgSendType" BO_ 824 0;
BA_ "VFrameFormat" BO_ 824 14;
BA_ "CANFD_BRS" BO_ 824 1;
BA_ "GenMsgCycleTime" BO_ 824 100;
BA_ "GenMsgCycleTimeFast" BO_ 824 0;
BA_ "GenMsgSendType" BO_ 824 0;
BA_ "VFrameFormat" BO_ 824 14;
BA_ "CANFD_BRS" BO_ 824 1;
BA_ "GenMsgCycleTime" BO_ 824 100;
BA_ "GenMsgCycleTimeFast" BO_ 824 0;
BA_ "GenMsgSendType" BO_ 824 0;
BA_ "VFrameFormat" BO_ 824 14;
BA_ "CANFD_BRS" BO_ 824 1;
BA_ "GenMsgCycleTime" BO_ 824 100;
BA_ "GenMsgCycleTimeFast" BO_ 824 0;
BA_ "GenMsgSendType" BO_ 824 0;
BA_ "VFrameFormat" BO_ 824 14;
BA_ "CANFD_BRS" BO_ 824 1;
BA_ "GenMsgCycleTime" BO_ 824 100;
BA_ "GenMsgCycleTimeFast" BO_ 824 0;
BA_ "GenMsgSendType" BO_ 824 0;
BA_ "VFrameFormat" BO_ 824 14;
BA_ "CANFD_BRS" BO_ 824 1;
BA_ "GenMsgCycleTime" BO_ 824 100;
BA_ "GenMsgCycleTimeFast" BO_ 824 0;
BA_ "GenMsgSendType" BO_ 824 0;
BA_ "VFrameFormat" BO_ 824 14;
BA_ "CANFD_BRS" BO_ 824 1;
BA_ "GenMsgCycleTime" BO_ 824 100;
BA_ "GenMsgCycleTimeFast" BO_ 824 0;
BA_ "GenMsgSendType" BO_ 824 0;
BA_ "VFrameFormat" BO_ 824 14;
BA_ "CANFD_BRS" BO_ 824 1;
BA_ "GenMsgCycleTime" BO_ 824 100;
BA_ "GenMsgCycleTimeFast" BO_ 824 0;
BA_ "GenMsgSendType" BO_ 824 0;
BA_ "VFrameFormat" BO_ 824 14;
BA_ "CANFD_BRS" BO_ 824 1;
BA_ "GenMsgCycleTime" BO_ 653 20;
BA_ "GenMsgCycleTimeFast" BO_ 653 0;
BA_ "GenMsgSendType" BO_ 653 0;
BA_ "VFrameFormat" BO_ 653 14;
BA_ "CANFD_BRS" BO_ 653 1;
BA_ "GenMsgCycleTime" BO_ 653 20;
BA_ "GenMsgCycleTimeFast" BO_ 653 0;
BA_ "GenMsgSendType" BO_ 653 0;
BA_ "VFrameFormat" BO_ 653 14;
BA_ "CANFD_BRS" BO_ 653 1;
BA_ "GenMsgCycleTime" BO_ 653 20;
BA_ "GenMsgCycleTimeFast" BO_ 653 0;
BA_ "GenMsgSendType" BO_ 653 0;
BA_ "VFrameFormat" BO_ 653 14;
BA_ "CANFD_BRS" BO_ 653 1;
BA_ "GenMsgCycleTime" BO_ 653 20;
BA_ "GenMsgCycleTimeFast" BO_ 653 0;
BA_ "GenMsgSendType" BO_ 653 0;
BA_ "VFrameFormat" BO_ 653 14;
BA_ "CANFD_BRS" BO_ 653 1;
BA_ "GenMsgCycleTime" BO_ 653 20;
BA_ "GenMsgCycleTimeFast" BO_ 653 0;
BA_ "GenMsgSendType" BO_ 653 0;
BA_ "VFrameFormat" BO_ 653 14;
BA_ "CANFD_BRS" BO_ 653 1;
BA_ "GenMsgCycleTime" BO_ 653 20;
BA_ "GenMsgCycleTimeFast" BO_ 653 0;
BA_ "GenMsgSendType" BO_ 653 0;
BA_ "VFrameFormat" BO_ 653 14;
BA_ "CANFD_BRS" BO_ 653 1;
BA_ "GenMsgCycleTime" BO_ 653 20;
BA_ "GenMsgCycleTimeFast" BO_ 653 0;
BA_ "GenMsgSendType" BO_ 653 0;
BA_ "VFrameFormat" BO_ 653 14;
BA_ "CANFD_BRS" BO_ 653 1;
BA_ "GenMsgCycleTime" BO_ 653 20;
BA_ "GenMsgCycleTimeFast" BO_ 653 0;
BA_ "GenMsgSendType" BO_ 653 0;
BA_ "VFrameFormat" BO_ 653 14;
BA_ "CANFD_BRS" BO_ 653 1;
BA_ "GenMsgCycleTime" BO_ 653 20;
BA_ "GenMsgCycleTimeFast" BO_ 653 0;
BA_ "GenMsgSendType" BO_ 653 0;
BA_ "VFrameFormat" BO_ 653 14;
BA_ "CANFD_BRS" BO_ 653 1;
BA_ "GenMsgCycleTime" BO_ 653 20;
BA_ "GenMsgCycleTimeFast" BO_ 653 0;
BA_ "GenMsgSendType" BO_ 653 0;
BA_ "VFrameFormat" BO_ 653 14;
BA_ "CANFD_BRS" BO_ 653 1;
BA_ "GenMsgCycleTime" BO_ 653 20;
BA_ "GenMsgCycleTimeFast" BO_ 653 0;
BA_ "GenMsgSendType" BO_ 653 0;
BA_ "VFrameFormat" BO_ 653 14;
BA_ "CANFD_BRS" BO_ 653 1;
BA_ "GenMsgCycleTime" BO_ 653 20;
BA_ "GenMsgCycleTimeFast" BO_ 653 0;
BA_ "GenMsgSendType" BO_ 653 0;
BA_ "VFrameFormat" BO_ 653 14;
BA_ "CANFD_BRS" BO_ 653 1;
BA_ "GenMsgCycleTime" BO_ 653 20;
BA_ "GenMsgCycleTimeFast" BO_ 653 0;
BA_ "GenMsgSendType" BO_ 653 0;
BA_ "VFrameFormat" BO_ 653 14;
BA_ "CANFD_BRS" BO_ 653 1;
BA_ "GenMsgCycleTime" BO_ 653 20;
BA_ "GenMsgCycleTimeFast" BO_ 653 0;
BA_ "GenMsgSendType" BO_ 653 0;
BA_ "VFrameFormat" BO_ 653 14;
BA_ "CANFD_BRS" BO_ 653 1;
BA_ "GenMsgCycleTime" BO_ 653 20;
BA_ "GenMsgCycleTimeFast" BO_ 653 0;
BA_ "GenMsgSendType" BO_ 653 0;
BA_ "VFrameFormat" BO_ 653 14;
BA_ "CANFD_BRS" BO_ 653 1;
BA_ "GenMsgCycleTime" BO_ 653 20;
BA_ "GenMsgCycleTimeFast" BO_ 653 0;
BA_ "GenMsgSendType" BO_ 653 0;
BA_ "VFrameFormat" BO_ 653 14;
BA_ "CANFD_BRS" BO_ 653 1;
BA_ "GenMsgCycleTime" BO_ 653 20;
BA_ "GenMsgCycleTimeFast" BO_ 653 0;
BA_ "GenMsgSendType" BO_ 653 0;
BA_ "VFrameFormat" BO_ 653 14;
BA_ "CANFD_BRS" BO_ 653 1;
BA_ "GenMsgCycleTime" BO_ 653 20;
BA_ "GenMsgCycleTimeFast" BO_ 653 0;
BA_ "GenMsgSendType" BO_ 653 0;
BA_ "VFrameFormat" BO_ 653 14;
BA_ "CANFD_BRS" BO_ 653 1;
BA_ "GenMsgCycleTime" BO_ 653 20;
BA_ "GenMsgCycleTimeFast" BO_ 653 0;
BA_ "GenMsgSendType" BO_ 653 0;
BA_ "VFrameFormat" BO_ 653 14;
BA_ "CANFD_BRS" BO_ 653 1;
BA_ "GenMsgCycleTime" BO_ 653 20;
BA_ "GenMsgCycleTimeFast" BO_ 653 0;
BA_ "GenMsgSendType" BO_ 653 0;
BA_ "VFrameFormat" BO_ 653 14;
BA_ "CANFD_BRS" BO_ 653 1;
BA_ "GenMsgCycleTime" BO_ 653 20;
BA_ "GenMsgCycleTimeFast" BO_ 653 0;
BA_ "GenMsgSendType" BO_ 653 0;
BA_ "VFrameFormat" BO_ 653 14;
BA_ "CANFD_BRS" BO_ 653 1;
BA_ "GenMsgCycleTime" BO_ 653 20;
BA_ "GenMsgCycleTimeFast" BO_ 653 0;
BA_ "GenMsgSendType" BO_ 653 0;
BA_ "VFrameFormat" BO_ 653 14;
BA_ "CANFD_BRS" BO_ 653 1;
BA_ "GenMsgCycleTime" BO_ 653 20;
BA_ "GenMsgCycleTimeFast" BO_ 653 0;
BA_ "GenMsgSendType" BO_ 653 0;
BA_ "VFrameFormat" BO_ 653 14;
BA_ "CANFD_BRS" BO_ 653 1;
BA_ "GenMsgCycleTime" BO_ 653 20;
BA_ "GenMsgCycleTimeFast" BO_ 653 0;
BA_ "GenMsgSendType" BO_ 653 0;
BA_ "VFrameFormat" BO_ 653 14;
BA_ "CANFD_BRS" BO_ 653 1;
BA_ "GenMsgCycleTime" BO_ 653 20;
BA_ "GenMsgCycleTimeFast" BO_ 653 0;
BA_ "GenMsgSendType" BO_ 653 0;
BA_ "VFrameFormat" BO_ 653 14;
BA_ "CANFD_BRS" BO_ 653 1;
BA_ "GenMsgCycleTime" BO_ 653 20;
BA_ "GenMsgCycleTimeFast" BO_ 653 0;
BA_ "GenMsgSendType" BO_ 653 0;
BA_ "VFrameFormat" BO_ 653 14;
BA_ "CANFD_BRS" BO_ 653 1;
BA_ "GenMsgCycleTime" BO_ 653 20;
BA_ "GenMsgCycleTimeFast" BO_ 653 0;
BA_ "GenMsgSendType" BO_ 653 0;
BA_ "VFrameFormat" BO_ 653 14;
BA_ "CANFD_BRS" BO_ 653 1;
BA_ "GenMsgCycleTime" BO_ 644 10;
BA_ "GenMsgCycleTimeFast" BO_ 644 0;
BA_ "GenMsgSendType" BO_ 644 0;
BA_ "VFrameFormat" BO_ 644 14;
BA_ "CANFD_BRS" BO_ 644 1;
BA_ "GenMsgCycleTime" BO_ 644 10;
BA_ "GenMsgCycleTimeFast" BO_ 644 0;
BA_ "GenMsgSendType" BO_ 644 0;
BA_ "VFrameFormat" BO_ 644 14;
BA_ "CANFD_BRS" BO_ 644 1;
BA_ "GenMsgCycleTime" BO_ 644 10;
BA_ "GenMsgCycleTimeFast" BO_ 644 0;
BA_ "GenMsgSendType" BO_ 644 0;
BA_ "VFrameFormat" BO_ 644 14;
BA_ "CANFD_BRS" BO_ 644 1;
BA_ "GenMsgCycleTime" BO_ 644 10;
BA_ "GenMsgCycleTimeFast" BO_ 644 0;
BA_ "GenMsgSendType" BO_ 644 0;
BA_ "VFrameFormat" BO_ 644 14;
BA_ "CANFD_BRS" BO_ 644 1;
BA_ "GenMsgCycleTime" BO_ 644 10;
BA_ "GenMsgCycleTimeFast" BO_ 644 0;
BA_ "GenMsgSendType" BO_ 644 0;
BA_ "VFrameFormat" BO_ 644 14;
BA_ "CANFD_BRS" BO_ 644 1;
BA_ "GenMsgCycleTime" BO_ 644 10;
BA_ "GenMsgCycleTimeFast" BO_ 644 0;
BA_ "GenMsgSendType" BO_ 644 0;
BA_ "VFrameFormat" BO_ 644 14;
BA_ "CANFD_BRS" BO_ 644 1;
BA_ "GenMsgCycleTime" BO_ 644 10;
BA_ "GenMsgCycleTimeFast" BO_ 644 0;
BA_ "GenMsgSendType" BO_ 644 0;
BA_ "VFrameFormat" BO_ 644 14;
BA_ "CANFD_BRS" BO_ 644 1;
BA_ "GenMsgCycleTime" BO_ 644 10;
BA_ "GenMsgCycleTimeFast" BO_ 644 0;
BA_ "GenMsgSendType" BO_ 644 0;
BA_ "VFrameFormat" BO_ 644 14;
BA_ "CANFD_BRS" BO_ 644 1;
BA_ "GenMsgCycleTime" BO_ 644 10;
BA_ "GenMsgCycleTimeFast" BO_ 644 0;
BA_ "GenMsgSendType" BO_ 644 0;
BA_ "VFrameFormat" BO_ 644 14;
BA_ "CANFD_BRS" BO_ 644 1;
BA_ "GenMsgCycleTime" BO_ 644 10;
BA_ "GenMsgCycleTimeFast" BO_ 644 0;
BA_ "GenMsgSendType" BO_ 644 0;
BA_ "VFrameFormat" BO_ 644 14;
BA_ "CANFD_BRS" BO_ 644 1;
BA_ "GenMsgCycleTime" BO_ 644 10;
BA_ "GenMsgCycleTimeFast" BO_ 644 0;
BA_ "GenMsgSendType" BO_ 644 0;
BA_ "VFrameFormat" BO_ 644 14;
BA_ "CANFD_BRS" BO_ 644 1;
BA_ "GenMsgCycleTime" BO_ 393 10;
BA_ "GenMsgCycleTimeFast" BO_ 393 0;
BA_ "GenMsgSendType" BO_ 393 0;
BA_ "VFrameFormat" BO_ 393 14;
BA_ "CANFD_BRS" BO_ 393 1;
BA_ "GenMsgCycleTime" BO_ 393 10;
BA_ "GenMsgCycleTimeFast" BO_ 393 0;
BA_ "GenMsgSendType" BO_ 393 0;
BA_ "VFrameFormat" BO_ 393 14;
BA_ "CANFD_BRS" BO_ 393 1;
BA_ "GenMsgCycleTime" BO_ 393 10;
BA_ "GenMsgCycleTimeFast" BO_ 393 0;
BA_ "GenMsgSendType" BO_ 393 0;
BA_ "VFrameFormat" BO_ 393 14;
BA_ "CANFD_BRS" BO_ 393 1;
BA_ "GenMsgCycleTime" BO_ 393 10;
BA_ "GenMsgCycleTimeFast" BO_ 393 0;
BA_ "GenMsgSendType" BO_ 393 0;
BA_ "VFrameFormat" BO_ 393 14;
BA_ "CANFD_BRS" BO_ 393 1;
BA_ "GenMsgCycleTime" BO_ 393 10;
BA_ "GenMsgCycleTimeFast" BO_ 393 0;
BA_ "GenMsgSendType" BO_ 393 0;
BA_ "VFrameFormat" BO_ 393 14;
BA_ "CANFD_BRS" BO_ 393 1;
BA_ "GenMsgCycleTime" BO_ 393 10;
BA_ "GenMsgCycleTimeFast" BO_ 393 0;
BA_ "GenMsgSendType" BO_ 393 0;
BA_ "VFrameFormat" BO_ 393 14;
BA_ "CANFD_BRS" BO_ 393 1;
BA_ "GenMsgCycleTime" BO_ 393 10;
BA_ "GenMsgCycleTimeFast" BO_ 393 0;
BA_ "GenMsgSendType" BO_ 393 0;
BA_ "VFrameFormat" BO_ 393 14;
BA_ "CANFD_BRS" BO_ 393 1;
BA_ "GenMsgCycleTime" BO_ 393 10;
BA_ "GenMsgCycleTimeFast" BO_ 393 0;
BA_ "GenMsgSendType" BO_ 393 0;
BA_ "VFrameFormat" BO_ 393 14;
BA_ "CANFD_BRS" BO_ 393 1;
BA_ "GenMsgCycleTime" BO_ 393 10;
BA_ "GenMsgCycleTimeFast" BO_ 393 0;
BA_ "GenMsgSendType" BO_ 393 0;
BA_ "VFrameFormat" BO_ 393 14;
BA_ "CANFD_BRS" BO_ 393 1;
BA_ "GenMsgCycleTime" BO_ 393 10;
BA_ "GenMsgCycleTimeFast" BO_ 393 0;
BA_ "GenMsgSendType" BO_ 393 0;
BA_ "VFrameFormat" BO_ 393 14;
BA_ "CANFD_BRS" BO_ 393 1;
BA_ "GenMsgCycleTime" BO_ 393 10;
BA_ "GenMsgCycleTimeFast" BO_ 393 0;
BA_ "GenMsgSendType" BO_ 393 0;
BA_ "VFrameFormat" BO_ 393 14;
BA_ "CANFD_BRS" BO_ 393 1;
BA_ "GenMsgCycleTime" BO_ 393 10;
BA_ "GenMsgCycleTimeFast" BO_ 393 0;
BA_ "GenMsgSendType" BO_ 393 0;
BA_ "VFrameFormat" BO_ 393 14;
BA_ "CANFD_BRS" BO_ 393 1;
BA_ "GenMsgCycleTime" BO_ 393 10;
BA_ "GenMsgCycleTimeFast" BO_ 393 0;
BA_ "GenMsgSendType" BO_ 393 0;
BA_ "VFrameFormat" BO_ 393 14;
BA_ "CANFD_BRS" BO_ 393 1;
BA_ "GenMsgCycleTime" BO_ 393 10;
BA_ "GenMsgCycleTimeFast" BO_ 393 0;
BA_ "GenMsgSendType" BO_ 393 0;
BA_ "VFrameFormat" BO_ 393 14;
BA_ "CANFD_BRS" BO_ 393 1;
BA_ "GenMsgCycleTime" BO_ 393 10;
BA_ "GenMsgCycleTimeFast" BO_ 393 0;
BA_ "GenMsgSendType" BO_ 393 0;
BA_ "VFrameFormat" BO_ 393 14;
BA_ "CANFD_BRS" BO_ 393 1;
BA_ "GenMsgCycleTime" BO_ 393 10;
BA_ "GenMsgCycleTimeFast" BO_ 393 0;
BA_ "GenMsgSendType" BO_ 393 0;
BA_ "VFrameFormat" BO_ 393 14;
BA_ "CANFD_BRS" BO_ 393 1;
BA_ "GenMsgCycleTime" BO_ 393 10;
BA_ "GenMsgCycleTimeFast" BO_ 393 0;
BA_ "GenMsgSendType" BO_ 393 0;
BA_ "VFrameFormat" BO_ 393 14;
BA_ "CANFD_BRS" BO_ 393 1;
BA_ "GenMsgCycleTime" BO_ 393 10;
BA_ "GenMsgCycleTimeFast" BO_ 393 0;
BA_ "GenMsgSendType" BO_ 393 0;
BA_ "VFrameFormat" BO_ 393 14;
BA_ "CANFD_BRS" BO_ 393 1;
BA_ "GenMsgCycleTime" BO_ 393 10;
BA_ "GenMsgCycleTimeFast" BO_ 393 0;
BA_ "GenMsgSendType" BO_ 393 0;
BA_ "VFrameFormat" BO_ 393 14;
BA_ "CANFD_BRS" BO_ 393 1;
BA_ "GenMsgCycleTime" BO_ 393 10;
BA_ "GenMsgCycleTimeFast" BO_ 393 0;
BA_ "GenMsgSendType" BO_ 393 0;
BA_ "VFrameFormat" BO_ 393 14;
BA_ "CANFD_BRS" BO_ 393 1;
BA_ "GenMsgCycleTime" BO_ 393 10;
BA_ "GenMsgCycleTimeFast" BO_ 393 0;
BA_ "GenMsgSendType" BO_ 393 0;
BA_ "VFrameFormat" BO_ 393 14;
BA_ "CANFD_BRS" BO_ 393 1;
BA_ "GenMsgCycleTime" BO_ 393 10;
BA_ "GenMsgCycleTimeFast" BO_ 393 0;
BA_ "GenMsgSendType" BO_ 393 0;
BA_ "VFrameFormat" BO_ 393 14;
BA_ "CANFD_BRS" BO_ 393 1;
BA_ "GenMsgCycleTime" BO_ 393 10;
BA_ "GenMsgCycleTimeFast" BO_ 393 0;
BA_ "GenMsgSendType" BO_ 393 0;
BA_ "VFrameFormat" BO_ 393 14;
BA_ "CANFD_BRS" BO_ 393 1;
BA_ "GenMsgCycleTime" BO_ 393 10;
BA_ "GenMsgCycleTimeFast" BO_ 393 0;
BA_ "GenMsgSendType" BO_ 393 0;
BA_ "VFrameFormat" BO_ 393 14;
BA_ "CANFD_BRS" BO_ 393 1;
BA_ "GenMsgCycleTime" BO_ 393 10;
BA_ "GenMsgCycleTimeFast" BO_ 393 0;
BA_ "GenMsgSendType" BO_ 393 0;
BA_ "VFrameFormat" BO_ 393 14;
BA_ "CANFD_BRS" BO_ 393 1;
BA_ "GenMsgCycleTime" BO_ 393 10;
BA_ "GenMsgCycleTimeFast" BO_ 393 0;
BA_ "GenMsgSendType" BO_ 393 0;
BA_ "VFrameFormat" BO_ 393 14;
BA_ "CANFD_BRS" BO_ 393 1;
BA_ "GenMsgCycleTime" BO_ 393 10;
BA_ "GenMsgCycleTimeFast" BO_ 393 0;
BA_ "GenMsgSendType" BO_ 393 0;
BA_ "VFrameFormat" BO_ 393 14;
BA_ "CANFD_BRS" BO_ 393 1;
BA_ "GenMsgCycleTime" BO_ 393 10;
BA_ "GenMsgCycleTimeFast" BO_ 393 0;
BA_ "GenMsgSendType" BO_ 393 0;
BA_ "VFrameFormat" BO_ 393 14;
BA_ "CANFD_BRS" BO_ 393 1;
BA_ "GenMsgCycleTime" BO_ 393 10;
BA_ "GenMsgCycleTimeFast" BO_ 393 0;
BA_ "GenMsgSendType" BO_ 393 0;
BA_ "VFrameFormat" BO_ 393 14;
BA_ "CANFD_BRS" BO_ 393 1;
BA_ "GenMsgCycleTime" BO_ 393 10;
BA_ "GenMsgCycleTimeFast" BO_ 393 0;
BA_ "GenMsgSendType" BO_ 393 0;
BA_ "VFrameFormat" BO_ 393 14;
BA_ "CANFD_BRS" BO_ 393 1;
BA_ "GenMsgCycleTime" BO_ 393 10;
BA_ "GenMsgCycleTimeFast" BO_ 393 0;
BA_ "GenMsgSendType" BO_ 393 0;
BA_ "VFrameFormat" BO_ 393 14;
BA_ "CANFD_BRS" BO_ 393 1;
BA_ "GenMsgCycleTime" BO_ 393 10;
BA_ "GenMsgCycleTimeFast" BO_ 393 0;
BA_ "GenMsgSendType" BO_ 393 0;
BA_ "VFrameFormat" BO_ 393 14;
BA_ "CANFD_BRS" BO_ 393 1;
BA_ "GenMsgCycleTime" BO_ 393 10;
BA_ "GenMsgCycleTimeFast" BO_ 393 0;
BA_ "GenMsgSendType" BO_ 393 0;
BA_ "VFrameFormat" BO_ 393 14;
BA_ "CANFD_BRS" BO_ 393 1;
BA_ "GenMsgCycleTime" BO_ 393 10;
BA_ "GenMsgCycleTimeFast" BO_ 393 0;
BA_ "GenMsgSendType" BO_ 393 0;
BA_ "VFrameFormat" BO_ 393 14;
BA_ "CANFD_BRS" BO_ 393 1;
BA_ "GenMsgCycleTime" BO_ 393 10;
BA_ "GenMsgCycleTimeFast" BO_ 393 0;
BA_ "GenMsgSendType" BO_ 393 0;
BA_ "VFrameFormat" BO_ 393 14;
BA_ "CANFD_BRS" BO_ 393 1;
BA_ "GenMsgCycleTime" BO_ 393 10;
BA_ "GenMsgCycleTimeFast" BO_ 393 0;
BA_ "GenMsgSendType" BO_ 393 0;
BA_ "VFrameFormat" BO_ 393 14;
BA_ "CANFD_BRS" BO_ 393 1;
BA_ "GenMsgCycleTime" BO_ 393 10;
BA_ "GenMsgCycleTimeFast" BO_ 393 0;
BA_ "GenMsgSendType" BO_ 393 0;
BA_ "VFrameFormat" BO_ 393 14;
BA_ "CANFD_BRS" BO_ 393 1;
BA_ "GenMsgCycleTime" BO_ 393 10;
BA_ "GenMsgCycleTimeFast" BO_ 393 0;
BA_ "GenMsgSendType" BO_ 393 0;
BA_ "VFrameFormat" BO_ 393 14;
BA_ "CANFD_BRS" BO_ 393 1;
BA_ "GenMsgCycleTime" BO_ 393 10;
BA_ "GenMsgCycleTimeFast" BO_ 393 0;
BA_ "GenMsgSendType" BO_ 393 0;
BA_ "VFrameFormat" BO_ 393 14;
BA_ "CANFD_BRS" BO_ 393 1;
BA_ "GenMsgCycleTime" BO_ 393 10;
BA_ "GenMsgCycleTimeFast" BO_ 393 0;
BA_ "GenMsgSendType" BO_ 393 0;
BA_ "VFrameFormat" BO_ 393 14;
BA_ "CANFD_BRS" BO_ 393 1;
BA_ "GenMsgCycleTime" BO_ 393 10;
BA_ "GenMsgCycleTimeFast" BO_ 393 0;
BA_ "GenMsgSendType" BO_ 393 0;
BA_ "VFrameFormat" BO_ 393 14;
BA_ "CANFD_BRS" BO_ 393 1;
BA_ "GenMsgCycleTime" BO_ 393 10;
BA_ "GenMsgCycleTimeFast" BO_ 393 0;
BA_ "GenMsgSendType" BO_ 393 0;
BA_ "VFrameFormat" BO_ 393 14;
BA_ "CANFD_BRS" BO_ 393 1;
BA_ "GenMsgCycleTime" BO_ 393 10;
BA_ "GenMsgCycleTimeFast" BO_ 393 0;
BA_ "GenMsgSendType" BO_ 393 0;
BA_ "VFrameFormat" BO_ 393 14;
BA_ "CANFD_BRS" BO_ 393 1;
BA_ "GenMsgCycleTime" BO_ 393 10;
BA_ "GenMsgCycleTimeFast" BO_ 393 0;
BA_ "GenMsgSendType" BO_ 393 0;
BA_ "VFrameFormat" BO_ 393 14;
BA_ "CANFD_BRS" BO_ 393 1;
BA_ "GenMsgCycleTime" BO_ 404 10;
BA_ "GenMsgCycleTimeFast" BO_ 404 0;
BA_ "GenMsgSendType" BO_ 404 0;
BA_ "VFrameFormat" BO_ 404 14;
BA_ "CANFD_BRS" BO_ 404 1;
BA_ "GenMsgCycleTime" BO_ 404 10;
BA_ "GenMsgCycleTimeFast" BO_ 404 0;
BA_ "GenMsgSendType" BO_ 404 0;
BA_ "VFrameFormat" BO_ 404 14;
BA_ "CANFD_BRS" BO_ 404 1;
BA_ "GenMsgCycleTime" BO_ 404 10;
BA_ "GenMsgCycleTimeFast" BO_ 404 0;
BA_ "GenMsgSendType" BO_ 404 0;
BA_ "VFrameFormat" BO_ 404 14;
BA_ "CANFD_BRS" BO_ 404 1;
BA_ "GenMsgCycleTime" BO_ 404 10;
BA_ "GenMsgCycleTimeFast" BO_ 404 0;
BA_ "GenMsgSendType" BO_ 404 0;
BA_ "VFrameFormat" BO_ 404 14;
BA_ "CANFD_BRS" BO_ 404 1;
BA_ "GenMsgCycleTime" BO_ 404 10;
BA_ "GenMsgCycleTimeFast" BO_ 404 0;
BA_ "GenMsgSendType" BO_ 404 0;
BA_ "VFrameFormat" BO_ 404 14;
BA_ "CANFD_BRS" BO_ 404 1;
BA_ "GenMsgCycleTime" BO_ 404 10;
BA_ "GenMsgCycleTimeFast" BO_ 404 0;
BA_ "GenMsgSendType" BO_ 404 0;
BA_ "VFrameFormat" BO_ 404 14;
BA_ "CANFD_BRS" BO_ 404 1;
BA_ "GenMsgCycleTime" BO_ 404 10;
BA_ "GenMsgCycleTimeFast" BO_ 404 0;
BA_ "GenMsgSendType" BO_ 404 0;
BA_ "VFrameFormat" BO_ 404 14;
BA_ "CANFD_BRS" BO_ 404 1;
BA_ "GenMsgCycleTime" BO_ 404 10;
BA_ "GenMsgCycleTimeFast" BO_ 404 0;
BA_ "GenMsgSendType" BO_ 404 0;
BA_ "VFrameFormat" BO_ 404 14;
BA_ "CANFD_BRS" BO_ 404 1;
BA_ "GenMsgCycleTime" BO_ 404 10;
BA_ "GenMsgCycleTimeFast" BO_ 404 0;
BA_ "GenMsgSendType" BO_ 404 0;
BA_ "VFrameFormat" BO_ 404 14;
BA_ "CANFD_BRS" BO_ 404 1;
BA_ "GenMsgCycleTime" BO_ 404 10;
BA_ "GenMsgCycleTimeFast" BO_ 404 0;
BA_ "GenMsgSendType" BO_ 404 0;
BA_ "VFrameFormat" BO_ 404 14;
BA_ "CANFD_BRS" BO_ 404 1;
BA_ "GenMsgCycleTime" BO_ 404 10;
BA_ "GenMsgCycleTimeFast" BO_ 404 0;
BA_ "GenMsgSendType" BO_ 404 0;
BA_ "VFrameFormat" BO_ 404 14;
BA_ "CANFD_BRS" BO_ 404 1;
BA_ "GenMsgCycleTime" BO_ 404 10;
BA_ "GenMsgCycleTimeFast" BO_ 404 0;
BA_ "GenMsgSendType" BO_ 404 0;
BA_ "VFrameFormat" BO_ 404 14;
BA_ "CANFD_BRS" BO_ 404 1;
BA_ "GenMsgCycleTime" BO_ 404 10;
BA_ "GenMsgCycleTimeFast" BO_ 404 0;
BA_ "GenMsgSendType" BO_ 404 0;
BA_ "VFrameFormat" BO_ 404 14;
BA_ "CANFD_BRS" BO_ 404 1;
BA_ "GenMsgCycleTime" BO_ 404 10;
BA_ "GenMsgCycleTimeFast" BO_ 404 0;
BA_ "GenMsgSendType" BO_ 404 0;
BA_ "VFrameFormat" BO_ 404 14;
BA_ "CANFD_BRS" BO_ 404 1;
BA_ "GenMsgCycleTime" BO_ 404 10;
BA_ "GenMsgCycleTimeFast" BO_ 404 0;
BA_ "GenMsgSendType" BO_ 404 0;
BA_ "VFrameFormat" BO_ 404 14;
BA_ "CANFD_BRS" BO_ 404 1;
BA_ "GenMsgCycleTime" BO_ 404 10;
BA_ "GenMsgCycleTimeFast" BO_ 404 0;
BA_ "GenMsgSendType" BO_ 404 0;
BA_ "VFrameFormat" BO_ 404 14;
BA_ "CANFD_BRS" BO_ 404 1;
BA_ "GenMsgCycleTime" BO_ 404 10;
BA_ "GenMsgCycleTimeFast" BO_ 404 0;
BA_ "GenMsgSendType" BO_ 404 0;
BA_ "VFrameFormat" BO_ 404 14;
BA_ "CANFD_BRS" BO_ 404 1;
BA_ "GenMsgCycleTime" BO_ 404 10;
BA_ "GenMsgCycleTimeFast" BO_ 404 0;
BA_ "GenMsgSendType" BO_ 404 0;
BA_ "VFrameFormat" BO_ 404 14;
BA_ "CANFD_BRS" BO_ 404 1;
BA_ "GenMsgCycleTime" BO_ 404 10;
BA_ "GenMsgCycleTimeFast" BO_ 404 0;
BA_ "GenMsgSendType" BO_ 404 0;
BA_ "VFrameFormat" BO_ 404 14;
BA_ "CANFD_BRS" BO_ 404 1;
BA_ "GenMsgCycleTime" BO_ 404 10;
BA_ "GenMsgCycleTimeFast" BO_ 404 0;
BA_ "GenMsgSendType" BO_ 404 0;
BA_ "VFrameFormat" BO_ 404 14;
BA_ "CANFD_BRS" BO_ 404 1;
BA_ "GenMsgCycleTime" BO_ 404 10;
BA_ "GenMsgCycleTimeFast" BO_ 404 0;
BA_ "GenMsgSendType" BO_ 404 0;
BA_ "VFrameFormat" BO_ 404 14;
BA_ "CANFD_BRS" BO_ 404 1;
BA_ "GenMsgCycleTime" BO_ 404 10;
BA_ "GenMsgCycleTimeFast" BO_ 404 0;
BA_ "GenMsgSendType" BO_ 404 0;
BA_ "VFrameFormat" BO_ 404 14;
BA_ "CANFD_BRS" BO_ 404 1;
BA_ "GenMsgCycleTime" BO_ 404 10;
BA_ "GenMsgCycleTimeFast" BO_ 404 0;
BA_ "GenMsgSendType" BO_ 404 0;
BA_ "VFrameFormat" BO_ 404 14;
BA_ "CANFD_BRS" BO_ 404 1;
BA_ "GenMsgCycleTime" BO_ 404 10;
BA_ "GenMsgCycleTimeFast" BO_ 404 0;
BA_ "GenMsgSendType" BO_ 404 0;
BA_ "VFrameFormat" BO_ 404 14;
BA_ "CANFD_BRS" BO_ 404 1;
BA_ "GenMsgCycleTime" BO_ 404 10;
BA_ "GenMsgCycleTimeFast" BO_ 404 0;
BA_ "GenMsgSendType" BO_ 404 0;
BA_ "VFrameFormat" BO_ 404 14;
BA_ "CANFD_BRS" BO_ 404 1;
BA_ "GenMsgCycleTime" BO_ 404 10;
BA_ "GenMsgCycleTimeFast" BO_ 404 0;
BA_ "GenMsgSendType" BO_ 404 0;
BA_ "VFrameFormat" BO_ 404 14;
BA_ "CANFD_BRS" BO_ 404 1;
BA_ "GenMsgCycleTime" BO_ 404 10;
BA_ "GenMsgCycleTimeFast" BO_ 404 0;
BA_ "GenMsgSendType" BO_ 404 0;
BA_ "VFrameFormat" BO_ 404 14;
BA_ "CANFD_BRS" BO_ 404 1;
BA_ "GenMsgCycleTime" BO_ 404 10;
BA_ "GenMsgCycleTimeFast" BO_ 404 0;
BA_ "GenMsgSendType" BO_ 404 0;
BA_ "VFrameFormat" BO_ 404 14;
BA_ "CANFD_BRS" BO_ 404 1;
BA_ "GenMsgCycleTime" BO_ 404 10;
BA_ "GenMsgCycleTimeFast" BO_ 404 0;
BA_ "GenMsgSendType" BO_ 404 0;
BA_ "VFrameFormat" BO_ 404 14;
BA_ "CANFD_BRS" BO_ 404 1;
BA_ "GenMsgCycleTime" BO_ 404 10;
BA_ "GenMsgCycleTimeFast" BO_ 404 0;
BA_ "GenMsgSendType" BO_ 404 0;
BA_ "VFrameFormat" BO_ 404 14;
BA_ "CANFD_BRS" BO_ 404 1;
BA_ "GenMsgCycleTime" BO_ 361 10;
BA_ "GenMsgCycleTimeFast" BO_ 361 0;
BA_ "GenMsgSendType" BO_ 361 0;
BA_ "VFrameFormat" BO_ 361 14;
BA_ "CANFD_BRS" BO_ 361 1;
BA_ "GenMsgCycleTime" BO_ 361 10;
BA_ "GenMsgCycleTimeFast" BO_ 361 0;
BA_ "GenMsgSendType" BO_ 361 0;
BA_ "VFrameFormat" BO_ 361 14;
BA_ "CANFD_BRS" BO_ 361 1;
BA_ "GenMsgCycleTime" BO_ 361 10;
BA_ "GenMsgCycleTimeFast" BO_ 361 0;
BA_ "GenMsgSendType" BO_ 361 0;
BA_ "VFrameFormat" BO_ 361 14;
BA_ "CANFD_BRS" BO_ 361 1;
BA_ "GenMsgCycleTime" BO_ 361 10;
BA_ "GenMsgCycleTimeFast" BO_ 361 0;
BA_ "GenMsgSendType" BO_ 361 0;
BA_ "VFrameFormat" BO_ 361 14;
BA_ "CANFD_BRS" BO_ 361 1;
BA_ "GenMsgCycleTime" BO_ 361 10;
BA_ "GenMsgCycleTimeFast" BO_ 361 0;
BA_ "GenMsgSendType" BO_ 361 0;
BA_ "VFrameFormat" BO_ 361 14;
BA_ "CANFD_BRS" BO_ 361 1;
BA_ "GenMsgCycleTime" BO_ 361 10;
BA_ "GenMsgCycleTimeFast" BO_ 361 0;
BA_ "GenMsgSendType" BO_ 361 0;
BA_ "VFrameFormat" BO_ 361 14;
BA_ "CANFD_BRS" BO_ 361 1;
BA_ "GenMsgCycleTime" BO_ 361 10;
BA_ "GenMsgCycleTimeFast" BO_ 361 0;
BA_ "GenMsgSendType" BO_ 361 0;
BA_ "VFrameFormat" BO_ 361 14;
BA_ "CANFD_BRS" BO_ 361 1;
BA_ "GenMsgCycleTime" BO_ 361 10;
BA_ "GenMsgCycleTimeFast" BO_ 361 0;
BA_ "GenMsgSendType" BO_ 361 0;
BA_ "VFrameFormat" BO_ 361 14;
BA_ "CANFD_BRS" BO_ 361 1;
BA_ "GenMsgCycleTime" BO_ 361 10;
BA_ "GenMsgCycleTimeFast" BO_ 361 0;
BA_ "GenMsgSendType" BO_ 361 0;
BA_ "VFrameFormat" BO_ 361 14;
BA_ "CANFD_BRS" BO_ 361 1;
BA_ "GenMsgCycleTime" BO_ 361 10;
BA_ "GenMsgCycleTimeFast" BO_ 361 0;
BA_ "GenMsgSendType" BO_ 361 0;
BA_ "VFrameFormat" BO_ 361 14;
BA_ "CANFD_BRS" BO_ 361 1;
BA_ "GenMsgCycleTime" BO_ 361 10;
BA_ "GenMsgCycleTimeFast" BO_ 361 0;
BA_ "GenMsgSendType" BO_ 361 0;
BA_ "VFrameFormat" BO_ 361 14;
BA_ "CANFD_BRS" BO_ 361 1;
BA_ "GenMsgCycleTime" BO_ 361 10;
BA_ "GenMsgCycleTimeFast" BO_ 361 0;
BA_ "GenMsgSendType" BO_ 361 0;
BA_ "VFrameFormat" BO_ 361 14;
BA_ "CANFD_BRS" BO_ 361 1;
BA_ "GenMsgCycleTime" BO_ 361 10;
BA_ "GenMsgCycleTimeFast" BO_ 361 0;
BA_ "GenMsgSendType" BO_ 361 0;
BA_ "VFrameFormat" BO_ 361 14;
BA_ "CANFD_BRS" BO_ 361 1;
BA_ "GenMsgCycleTime" BO_ 361 10;
BA_ "GenMsgCycleTimeFast" BO_ 361 0;
BA_ "GenMsgSendType" BO_ 361 0;
BA_ "VFrameFormat" BO_ 361 14;
BA_ "CANFD_BRS" BO_ 361 1;
BA_ "GenMsgCycleTime" BO_ 361 10;
BA_ "GenMsgCycleTimeFast" BO_ 361 0;
BA_ "GenMsgSendType" BO_ 361 0;
BA_ "VFrameFormat" BO_ 361 14;
BA_ "CANFD_BRS" BO_ 361 1;
BA_ "GenMsgCycleTime" BO_ 361 10;
BA_ "GenMsgCycleTimeFast" BO_ 361 0;
BA_ "GenMsgSendType" BO_ 361 0;
BA_ "VFrameFormat" BO_ 361 14;
BA_ "CANFD_BRS" BO_ 361 1;
BA_ "GenMsgCycleTime" BO_ 361 10;
BA_ "GenMsgCycleTimeFast" BO_ 361 0;
BA_ "GenMsgSendType" BO_ 361 0;
BA_ "VFrameFormat" BO_ 361 14;
BA_ "CANFD_BRS" BO_ 361 1;
BA_ "GenMsgCycleTime" BO_ 361 10;
BA_ "GenMsgCycleTimeFast" BO_ 361 0;
BA_ "GenMsgSendType" BO_ 361 0;
BA_ "VFrameFormat" BO_ 361 14;
BA_ "CANFD_BRS" BO_ 361 1;
BA_ "GenMsgCycleTime" BO_ 361 10;
BA_ "GenMsgCycleTimeFast" BO_ 361 0;
BA_ "GenMsgSendType" BO_ 361 0;
BA_ "VFrameFormat" BO_ 361 14;
BA_ "CANFD_BRS" BO_ 361 1;
BA_ "GenMsgCycleTime" BO_ 361 10;
BA_ "GenMsgCycleTimeFast" BO_ 361 0;
BA_ "GenMsgSendType" BO_ 361 0;
BA_ "VFrameFormat" BO_ 361 14;
BA_ "CANFD_BRS" BO_ 361 1;
BA_ "GenMsgCycleTime" BO_ 361 10;
BA_ "GenMsgCycleTimeFast" BO_ 361 0;
BA_ "GenMsgSendType" BO_ 361 0;
BA_ "VFrameFormat" BO_ 361 14;
BA_ "CANFD_BRS" BO_ 361 1;
BA_ "GenMsgCycleTime" BO_ 361 10;
BA_ "GenMsgCycleTimeFast" BO_ 361 0;
BA_ "GenMsgSendType" BO_ 361 0;
BA_ "VFrameFormat" BO_ 361 14;
BA_ "CANFD_BRS" BO_ 361 1;
BA_ "GenMsgCycleTime" BO_ 361 10;
BA_ "GenMsgCycleTimeFast" BO_ 361 0;
BA_ "GenMsgSendType" BO_ 361 0;
BA_ "VFrameFormat" BO_ 361 14;
BA_ "CANFD_BRS" BO_ 361 1;
BA_ "GenMsgCycleTime" BO_ 361 10;
BA_ "GenMsgCycleTimeFast" BO_ 361 0;
BA_ "GenMsgSendType" BO_ 361 0;
BA_ "VFrameFormat" BO_ 361 14;
BA_ "CANFD_BRS" BO_ 361 1;
BA_ "GenMsgCycleTime" BO_ 361 10;
BA_ "GenMsgCycleTimeFast" BO_ 361 0;
BA_ "GenMsgSendType" BO_ 361 0;
BA_ "VFrameFormat" BO_ 361 14;
BA_ "CANFD_BRS" BO_ 361 1;
BA_ "GenMsgCycleTime" BO_ 361 10;
BA_ "GenMsgCycleTimeFast" BO_ 361 0;
BA_ "GenMsgSendType" BO_ 361 0;
BA_ "VFrameFormat" BO_ 361 14;
BA_ "CANFD_BRS" BO_ 361 1;
BA_ "GenMsgCycleTime" BO_ 361 10;
BA_ "GenMsgCycleTimeFast" BO_ 361 0;
BA_ "GenMsgSendType" BO_ 361 0;
BA_ "VFrameFormat" BO_ 361 14;
BA_ "CANFD_BRS" BO_ 361 1;
BA_ "GenMsgCycleTime" BO_ 361 10;
BA_ "GenMsgCycleTimeFast" BO_ 361 0;
BA_ "GenMsgSendType" BO_ 361 0;
BA_ "VFrameFormat" BO_ 361 14;
BA_ "CANFD_BRS" BO_ 361 1;
BA_ "GenMsgCycleTime" BO_ 361 10;
BA_ "GenMsgCycleTimeFast" BO_ 361 0;
BA_ "GenMsgSendType" BO_ 361 0;
BA_ "VFrameFormat" BO_ 361 14;
BA_ "CANFD_BRS" BO_ 361 1;
BA_ "GenMsgCycleTime" BO_ 361 10;
BA_ "GenMsgCycleTimeFast" BO_ 361 0;
BA_ "GenMsgSendType" BO_ 361 0;
BA_ "VFrameFormat" BO_ 361 14;
BA_ "CANFD_BRS" BO_ 361 1;
BA_ "GenMsgCycleTime" BO_ 361 10;
BA_ "GenMsgCycleTimeFast" BO_ 361 0;
BA_ "GenMsgSendType" BO_ 361 0;
BA_ "VFrameFormat" BO_ 361 14;
BA_ "CANFD_BRS" BO_ 361 1;
BA_ "GenMsgCycleTime" BO_ 361 10;
BA_ "GenMsgCycleTimeFast" BO_ 361 0;
BA_ "GenMsgSendType" BO_ 361 0;
BA_ "VFrameFormat" BO_ 361 14;
BA_ "CANFD_BRS" BO_ 361 1;
BA_ "GenMsgCycleTime" BO_ 361 10;
BA_ "GenMsgCycleTimeFast" BO_ 361 0;
BA_ "GenMsgSendType" BO_ 361 0;
BA_ "VFrameFormat" BO_ 361 14;
BA_ "CANFD_BRS" BO_ 361 1;
BA_ "GenMsgCycleTime" BO_ 361 10;
BA_ "GenMsgCycleTimeFast" BO_ 361 0;
BA_ "GenMsgSendType" BO_ 361 0;
BA_ "VFrameFormat" BO_ 361 14;
BA_ "CANFD_BRS" BO_ 361 1;
BA_ "GenMsgCycleTime" BO_ 361 10;
BA_ "GenMsgCycleTimeFast" BO_ 361 0;
BA_ "GenMsgSendType" BO_ 361 0;
BA_ "VFrameFormat" BO_ 361 14;
BA_ "CANFD_BRS" BO_ 361 1;
BA_ "GenMsgCycleTime" BO_ 361 10;
BA_ "GenMsgCycleTimeFast" BO_ 361 0;
BA_ "GenMsgSendType" BO_ 361 0;
BA_ "VFrameFormat" BO_ 361 14;
BA_ "CANFD_BRS" BO_ 361 1;
BA_ "GenMsgCycleTime" BO_ 361 10;
BA_ "GenMsgCycleTimeFast" BO_ 361 0;
BA_ "GenMsgSendType" BO_ 361 0;
BA_ "VFrameFormat" BO_ 361 14;
BA_ "CANFD_BRS" BO_ 361 1;
BA_ "GenMsgCycleTime" BO_ 361 10;
BA_ "GenMsgCycleTimeFast" BO_ 361 0;
BA_ "GenMsgSendType" BO_ 361 0;
BA_ "VFrameFormat" BO_ 361 14;
BA_ "CANFD_BRS" BO_ 361 1;
BA_ "GenMsgCycleTime" BO_ 361 10;
BA_ "GenMsgCycleTimeFast" BO_ 361 0;
BA_ "GenMsgSendType" BO_ 361 0;
BA_ "VFrameFormat" BO_ 361 14;
BA_ "CANFD_BRS" BO_ 361 1;
BA_ "GenMsgCycleTime" BO_ 361 10;
BA_ "GenMsgCycleTimeFast" BO_ 361 0;
BA_ "GenMsgSendType" BO_ 361 0;
BA_ "VFrameFormat" BO_ 361 14;
BA_ "CANFD_BRS" BO_ 361 1;
BA_ "GenMsgCycleTime" BO_ 361 10;
BA_ "GenMsgCycleTimeFast" BO_ 361 0;
BA_ "GenMsgSendType" BO_ 361 0;
BA_ "VFrameFormat" BO_ 361 14;
BA_ "CANFD_BRS" BO_ 361 1;
BA_ "GenMsgCycleTime" BO_ 361 10;
BA_ "GenMsgCycleTimeFast" BO_ 361 0;
BA_ "GenMsgSendType" BO_ 361 0;
BA_ "VFrameFormat" BO_ 361 14;
BA_ "CANFD_BRS" BO_ 361 1;
BA_ "GenMsgCycleTime" BO_ 361 10;
BA_ "GenMsgCycleTimeFast" BO_ 361 0;
BA_ "GenMsgSendType" BO_ 361 0;
BA_ "VFrameFormat" BO_ 361 14;
BA_ "CANFD_BRS" BO_ 361 1;
BA_ "GenMsgCycleTime" BO_ 361 10;
BA_ "GenMsgCycleTimeFast" BO_ 361 0;
BA_ "GenMsgSendType" BO_ 361 0;
BA_ "VFrameFormat" BO_ 361 14;
BA_ "CANFD_BRS" BO_ 361 1;
BA_ "GenMsgCycleTime" BO_ 361 10;
BA_ "GenMsgCycleTimeFast" BO_ 361 0;
BA_ "GenMsgSendType" BO_ 361 0;
BA_ "VFrameFormat" BO_ 361 14;
BA_ "CANFD_BRS" BO_ 361 1;
BA_ "GenMsgCycleTime" BO_ 361 10;
BA_ "GenMsgCycleTimeFast" BO_ 361 0;
BA_ "GenMsgSendType" BO_ 361 0;
BA_ "VFrameFormat" BO_ 361 14;
BA_ "CANFD_BRS" BO_ 361 1;
BA_ "GenMsgCycleTime" BO_ 361 10;
BA_ "GenMsgCycleTimeFast" BO_ 361 0;
BA_ "GenMsgSendType" BO_ 361 0;
BA_ "VFrameFormat" BO_ 361 14;
BA_ "CANFD_BRS" BO_ 361 1;
BA_ "GenMsgCycleTime" BO_ 361 10;
BA_ "GenMsgCycleTimeFast" BO_ 361 0;
BA_ "GenMsgSendType" BO_ 361 0;
BA_ "VFrameFormat" BO_ 361 14;
BA_ "CANFD_BRS" BO_ 361 1;
BA_ "GenMsgCycleTime" BO_ 361 10;
BA_ "GenMsgCycleTimeFast" BO_ 361 0;
BA_ "GenMsgSendType" BO_ 361 0;
BA_ "VFrameFormat" BO_ 361 14;
BA_ "CANFD_BRS" BO_ 361 1;
BA_ "GenMsgCycleTime" BO_ 361 10;
BA_ "GenMsgCycleTimeFast" BO_ 361 0;
BA_ "GenMsgSendType" BO_ 361 0;
BA_ "VFrameFormat" BO_ 361 14;
BA_ "CANFD_BRS" BO_ 361 1;
BA_ "GenMsgCycleTime" BO_ 361 10;
BA_ "GenMsgCycleTimeFast" BO_ 361 0;
BA_ "GenMsgSendType" BO_ 361 0;
BA_ "VFrameFormat" BO_ 361 14;
BA_ "CANFD_BRS" BO_ 361 1;
BA_ "GenMsgCycleTime" BO_ 361 10;
BA_ "GenMsgCycleTimeFast" BO_ 361 0;
BA_ "GenMsgSendType" BO_ 361 0;
BA_ "VFrameFormat" BO_ 361 14;
BA_ "CANFD_BRS" BO_ 361 1;
BA_ "GenMsgCycleTime" BO_ 361 10;
BA_ "GenMsgCycleTimeFast" BO_ 361 0;
BA_ "GenMsgSendType" BO_ 361 0;
BA_ "VFrameFormat" BO_ 361 14;
BA_ "CANFD_BRS" BO_ 361 1;
BA_ "GenMsgCycleTime" BO_ 361 10;
BA_ "GenMsgCycleTimeFast" BO_ 361 0;
BA_ "GenMsgSendType" BO_ 361 0;
BA_ "VFrameFormat" BO_ 361 14;
BA_ "CANFD_BRS" BO_ 361 1;
BA_ "GenMsgCycleTime" BO_ 361 10;
BA_ "GenMsgCycleTimeFast" BO_ 361 0;
BA_ "GenMsgSendType" BO_ 361 0;
BA_ "VFrameFormat" BO_ 361 14;
BA_ "CANFD_BRS" BO_ 361 1;
BA_ "GenMsgCycleTime" BO_ 361 10;
BA_ "GenMsgCycleTimeFast" BO_ 361 0;
BA_ "GenMsgSendType" BO_ 361 0;
BA_ "VFrameFormat" BO_ 361 14;
BA_ "CANFD_BRS" BO_ 361 1;
BA_ "GenMsgCycleTime" BO_ 361 10;
BA_ "GenMsgCycleTimeFast" BO_ 361 0;
BA_ "GenMsgSendType" BO_ 361 0;
BA_ "VFrameFormat" BO_ 361 14;
BA_ "CANFD_BRS" BO_ 361 1;
BA_ "GenMsgCycleTime" BO_ 361 10;
BA_ "GenMsgCycleTimeFast" BO_ 361 0;
BA_ "GenMsgSendType" BO_ 361 0;
BA_ "VFrameFormat" BO_ 361 14;
BA_ "CANFD_BRS" BO_ 361 1;
BA_ "GenMsgCycleTime" BO_ 361 10;
BA_ "GenMsgCycleTimeFast" BO_ 361 0;
BA_ "GenMsgSendType" BO_ 361 0;
BA_ "VFrameFormat" BO_ 361 14;
BA_ "CANFD_BRS" BO_ 361 1;
BA_ "GenMsgCycleTime" BO_ 361 10;
BA_ "GenMsgCycleTimeFast" BO_ 361 0;
BA_ "GenMsgSendType" BO_ 361 0;
BA_ "VFrameFormat" BO_ 361 14;
BA_ "CANFD_BRS" BO_ 361 1;
BA_ "GenMsgCycleTime" BO_ 361 10;
BA_ "GenMsgCycleTimeFast" BO_ 361 0;
BA_ "GenMsgSendType" BO_ 361 0;
BA_ "VFrameFormat" BO_ 361 14;
BA_ "CANFD_BRS" BO_ 361 1;
BA_ "GenMsgCycleTime" BO_ 361 10;
BA_ "GenMsgCycleTimeFast" BO_ 361 0;
BA_ "GenMsgSendType" BO_ 361 0;
BA_ "VFrameFormat" BO_ 361 14;
BA_ "CANFD_BRS" BO_ 361 1;
BA_ "GenMsgCycleTime" BO_ 361 10;
BA_ "GenMsgCycleTimeFast" BO_ 361 0;
BA_ "GenMsgSendType" BO_ 361 0;
BA_ "VFrameFormat" BO_ 361 14;
BA_ "CANFD_BRS" BO_ 361 1;
BA_ "GenMsgCycleTime" BO_ 361 10;
BA_ "GenMsgCycleTimeFast" BO_ 361 0;
BA_ "GenMsgSendType" BO_ 361 0;
BA_ "VFrameFormat" BO_ 361 14;
BA_ "CANFD_BRS" BO_ 361 1;
BA_ "GenMsgCycleTime" BO_ 361 10;
BA_ "GenMsgCycleTimeFast" BO_ 361 0;
BA_ "GenMsgSendType" BO_ 361 0;
BA_ "VFrameFormat" BO_ 361 14;
BA_ "CANFD_BRS" BO_ 361 1;
BA_ "GenMsgCycleTime" BO_ 361 10;
BA_ "GenMsgCycleTimeFast" BO_ 361 0;
BA_ "GenMsgSendType" BO_ 361 0;
BA_ "VFrameFormat" BO_ 361 14;
BA_ "CANFD_BRS" BO_ 361 1;
BA_ "GenMsgCycleTime" BO_ 361 10;
BA_ "GenMsgCycleTimeFast" BO_ 361 0;
BA_ "GenMsgSendType" BO_ 361 0;
BA_ "VFrameFormat" BO_ 361 14;
BA_ "CANFD_BRS" BO_ 361 1;
BA_ "GenMsgCycleTime" BO_ 361 10;
BA_ "GenMsgCycleTimeFast" BO_ 361 0;
BA_ "GenMsgSendType" BO_ 361 0;
BA_ "VFrameFormat" BO_ 361 14;
BA_ "CANFD_BRS" BO_ 361 1;
BA_ "GenMsgCycleTime" BO_ 361 10;
BA_ "GenMsgCycleTimeFast" BO_ 361 0;
BA_ "GenMsgSendType" BO_ 361 0;
BA_ "VFrameFormat" BO_ 361 14;
BA_ "CANFD_BRS" BO_ 361 1;
BA_ "GenMsgCycleTime" BO_ 361 10;
BA_ "GenMsgCycleTimeFast" BO_ 361 0;
BA_ "GenMsgSendType" BO_ 361 0;
BA_ "VFrameFormat" BO_ 361 14;
BA_ "CANFD_BRS" BO_ 361 1;
BA_ "GenMsgCycleTime" BO_ 361 10;
BA_ "GenMsgCycleTimeFast" BO_ 361 0;
BA_ "GenMsgSendType" BO_ 361 0;
BA_ "VFrameFormat" BO_ 361 14;
BA_ "CANFD_BRS" BO_ 361 1;
BA_ "GenMsgCycleTime" BO_ 361 10;
BA_ "GenMsgCycleTimeFast" BO_ 361 0;
BA_ "GenMsgSendType" BO_ 361 0;
BA_ "VFrameFormat" BO_ 361 14;
BA_ "CANFD_BRS" BO_ 361 1;
BA_ "GenMsgCycleTime" BO_ 361 10;
BA_ "GenMsgCycleTimeFast" BO_ 361 0;
BA_ "GenMsgSendType" BO_ 361 0;
BA_ "VFrameFormat" BO_ 361 14;
BA_ "CANFD_BRS" BO_ 361 1;
BA_ "GenMsgCycleTime" BO_ 361 10;
BA_ "GenMsgCycleTimeFast" BO_ 361 0;
BA_ "GenMsgSendType" BO_ 361 0;
BA_ "VFrameFormat" BO_ 361 14;
BA_ "CANFD_BRS" BO_ 361 1;
BA_ "GenMsgCycleTime" BO_ 361 10;
BA_ "GenMsgCycleTimeFast" BO_ 361 0;
BA_ "GenMsgSendType" BO_ 361 0;
BA_ "VFrameFormat" BO_ 361 14;
BA_ "CANFD_BRS" BO_ 361 1;
BA_ "GenMsgCycleTime" BO_ 361 10;
BA_ "GenMsgCycleTimeFast" BO_ 361 0;
BA_ "GenMsgSendType" BO_ 361 0;
BA_ "VFrameFormat" BO_ 361 14;
BA_ "CANFD_BRS" BO_ 361 1;
BA_ "GenMsgCycleTime" BO_ 361 10;
BA_ "GenMsgCycleTimeFast" BO_ 361 0;
BA_ "GenMsgSendType" BO_ 361 0;
BA_ "VFrameFormat" BO_ 361 14;
BA_ "CANFD_BRS" BO_ 361 1;
BA_ "GenMsgCycleTime" BO_ 361 10;
BA_ "GenMsgCycleTimeFast" BO_ 361 0;
BA_ "GenMsgSendType" BO_ 361 0;
BA_ "VFrameFormat" BO_ 361 14;
BA_ "CANFD_BRS" BO_ 361 1;
BA_ "GenMsgCycleTime" BO_ 361 10;
BA_ "GenMsgCycleTimeFast" BO_ 361 0;
BA_ "GenMsgSendType" BO_ 361 0;
BA_ "VFrameFormat" BO_ 361 14;
BA_ "CANFD_BRS" BO_ 361 1;
BA_ "GenMsgCycleTime" BO_ 361 10;
BA_ "GenMsgCycleTimeFast" BO_ 361 0;
BA_ "GenMsgSendType" BO_ 361 0;
BA_ "VFrameFormat" BO_ 361 14;
BA_ "CANFD_BRS" BO_ 361 1;
BA_ "GenMsgCycleTime" BO_ 361 10;
BA_ "GenMsgCycleTimeFast" BO_ 361 0;
BA_ "GenMsgSendType" BO_ 361 0;
BA_ "VFrameFormat" BO_ 361 14;
BA_ "CANFD_BRS" BO_ 361 1;
BA_ "GenMsgCycleTime" BO_ 361 10;
BA_ "GenMsgCycleTimeFast" BO_ 361 0;
BA_ "GenMsgSendType" BO_ 361 0;
BA_ "VFrameFormat" BO_ 361 14;
BA_ "CANFD_BRS" BO_ 361 1;
BA_ "GenMsgCycleTime" BO_ 361 10;
BA_ "GenMsgCycleTimeFast" BO_ 361 0;
BA_ "GenMsgSendType" BO_ 361 0;
BA_ "VFrameFormat" BO_ 361 14;
BA_ "CANFD_BRS" BO_ 361 1;
BA_ "GenMsgCycleTime" BO_ 361 10;
BA_ "GenMsgCycleTimeFast" BO_ 361 0;
BA_ "GenMsgSendType" BO_ 361 0;
BA_ "VFrameFormat" BO_ 361 14;
BA_ "CANFD_BRS" BO_ 361 1;
BA_ "GenMsgCycleTime" BO_ 361 10;
BA_ "GenMsgCycleTimeFast" BO_ 361 0;
BA_ "GenMsgSendType" BO_ 361 0;
BA_ "VFrameFormat" BO_ 361 14;
BA_ "CANFD_BRS" BO_ 361 1;
BA_ "GenMsgCycleTime" BO_ 361 10;
BA_ "GenMsgCycleTimeFast" BO_ 361 0;
BA_ "GenMsgSendType" BO_ 361 0;
BA_ "VFrameFormat" BO_ 361 14;
BA_ "CANFD_BRS" BO_ 361 1;
BA_ "GenMsgCycleTime" BO_ 361 10;
BA_ "GenMsgCycleTimeFast" BO_ 361 0;
BA_ "GenMsgSendType" BO_ 361 0;
BA_ "VFrameFormat" BO_ 361 14;
BA_ "CANFD_BRS" BO_ 361 1;
BA_ "GenMsgCycleTime" BO_ 361 10;
BA_ "GenMsgCycleTimeFast" BO_ 361 0;
BA_ "GenMsgSendType" BO_ 361 0;
BA_ "VFrameFormat" BO_ 361 14;
BA_ "CANFD_BRS" BO_ 361 1;
BA_ "GenMsgCycleTime" BO_ 361 10;
BA_ "GenMsgCycleTimeFast" BO_ 361 0;
BA_ "GenMsgSendType" BO_ 361 0;
BA_ "VFrameFormat" BO_ 361 14;
BA_ "CANFD_BRS" BO_ 361 1;
BA_ "GenMsgCycleTime" BO_ 361 10;
BA_ "GenMsgCycleTimeFast" BO_ 361 0;
BA_ "GenMsgSendType" BO_ 361 0;
BA_ "VFrameFormat" BO_ 361 14;
BA_ "CANFD_BRS" BO_ 361 1;
BA_ "GenMsgCycleTime" BO_ 361 10;
BA_ "GenMsgCycleTimeFast" BO_ 361 0;
BA_ "GenMsgSendType" BO_ 361 0;
BA_ "VFrameFormat" BO_ 361 14;
BA_ "CANFD_BRS" BO_ 361 1;
BA_ "GenMsgCycleTime" BO_ 361 10;
BA_ "GenMsgCycleTimeFast" BO_ 361 0;
BA_ "GenMsgSendType" BO_ 361 0;
BA_ "VFrameFormat" BO_ 361 14;
BA_ "CANFD_BRS" BO_ 361 1;
BA_ "GenMsgCycleTime" BO_ 361 10;
BA_ "GenMsgCycleTimeFast" BO_ 361 0;
BA_ "GenMsgSendType" BO_ 361 0;
BA_ "VFrameFormat" BO_ 361 14;
BA_ "CANFD_BRS" BO_ 361 1;
BA_ "GenMsgCycleTime" BO_ 361 10;
BA_ "GenMsgCycleTimeFast" BO_ 361 0;
BA_ "GenMsgSendType" BO_ 361 0;
BA_ "VFrameFormat" BO_ 361 14;
BA_ "CANFD_BRS" BO_ 361 1;
BA_ "GenMsgCycleTime" BO_ 361 10;
BA_ "GenMsgCycleTimeFast" BO_ 361 0;
BA_ "GenMsgSendType" BO_ 361 0;
BA_ "VFrameFormat" BO_ 361 14;
BA_ "CANFD_BRS" BO_ 361 1;
BA_ "GenMsgCycleTime" BO_ 361 10;
BA_ "GenMsgCycleTimeFast" BO_ 361 0;
BA_ "GenMsgSendType" BO_ 361 0;
BA_ "VFrameFormat" BO_ 361 14;
BA_ "CANFD_BRS" BO_ 361 1;
BA_ "GenMsgCycleTime" BO_ 361 10;
BA_ "GenMsgCycleTimeFast" BO_ 361 0;
BA_ "GenMsgSendType" BO_ 361 0;
BA_ "VFrameFormat" BO_ 361 14;
BA_ "CANFD_BRS" BO_ 361 1;
BA_ "EventCommandSignal" SG_ 368 DCU_1_CRC 0;
BA_ "GatewayedSignals" SG_ 368 DCU_1_CRC 0;
BA_ "GenSigInactiveValue" SG_ 368 DCU_1_CRC 0;
BA_ "GenSigInvalidValue" SG_ 368 DCU_1_CRC 0;
BA_ "GenSigSendType" SG_ 368 DCU_1_CRC 1;
BA_ "GenSigStartValue" SG_ 368 DCU_1_CRC 0;
BA_ "GenSigTimeoutValue" SG_ 368 DCU_1_CRC 0;
BA_ "Remark" SG_ 368 DCU_1_CRC "";
BA_ "EventCommandSignal" SG_ 368 DCU_1_Counter 0;
BA_ "GatewayedSignals" SG_ 368 DCU_1_Counter 0;
BA_ "GenSigInactiveValue" SG_ 368 DCU_1_Counter 0;
BA_ "GenSigInvalidValue" SG_ 368 DCU_1_Counter 0;
BA_ "GenSigSendType" SG_ 368 DCU_1_Counter 1;
BA_ "GenSigStartValue" SG_ 368 DCU_1_Counter 0;
BA_ "GenSigTimeoutValue" SG_ 368 DCU_1_Counter 0;
BA_ "Remark" SG_ 368 DCU_1_Counter "";
BA_ "EventCommandSignal" SG_ 368 DCU_RotSpdAct 0;
BA_ "GatewayedSignals" SG_ 368 DCU_RotSpdAct 0;
BA_ "GenSigInactiveValue" SG_ 368 DCU_RotSpdAct 0;
BA_ "GenSigInvalidValue" SG_ 368 DCU_RotSpdAct 65535;
BA_ "GenSigSendType" SG_ 368 DCU_RotSpdAct 1;
BA_ "GenSigStartValue" SG_ 368 DCU_RotSpdAct 32767;
BA_ "GenSigTimeoutValue" SG_ 368 DCU_RotSpdAct 0;
BA_ "Remark" SG_ 368 DCU_RotSpdAct "";
BA_ "EventCommandSignal" SG_ 368 DCU_ModeSt 0;
BA_ "GatewayedSignals" SG_ 368 DCU_ModeSt 0;
BA_ "GenSigInactiveValue" SG_ 368 DCU_ModeSt 0;
BA_ "GenSigInvalidValue" SG_ 368 DCU_ModeSt 0;
BA_ "GenSigSendType" SG_ 368 DCU_ModeSt 1;
BA_ "GenSigStartValue" SG_ 368 DCU_ModeSt 1;
BA_ "GenSigTimeoutValue" SG_ 368 DCU_ModeSt 0;
BA_ "Remark" SG_ 368 DCU_ModeSt "";
BA_ "EventCommandSignal" SG_ 368 DCU_ADC_MCUBlkst 0;
BA_ "GatewayedSignals" SG_ 368 DCU_ADC_MCUBlkst 0;
BA_ "GenSigInactiveValue" SG_ 368 DCU_ADC_MCUBlkst 0;
BA_ "GenSigInvalidValue" SG_ 368 DCU_ADC_MCUBlkst 7;
BA_ "GenSigSendType" SG_ 368 DCU_ADC_MCUBlkst 1;
BA_ "GenSigStartValue" SG_ 368 DCU_ADC_MCUBlkst 0;
BA_ "GenSigTimeoutValue" SG_ 368 DCU_ADC_MCUBlkst 0;
BA_ "Remark" SG_ 368 DCU_ADC_MCUBlkst "";
BA_ "EventCommandSignal" SG_ 368 DCU_ADC_SpdSvModAvl 0;
BA_ "GatewayedSignals" SG_ 368 DCU_ADC_SpdSvModAvl 0;
BA_ "GenSigInactiveValue" SG_ 368 DCU_ADC_SpdSvModAvl 0;
BA_ "GenSigInvalidValue" SG_ 368 DCU_ADC_SpdSvModAvl 1;
BA_ "GenSigSendType" SG_ 368 DCU_ADC_SpdSvModAvl 1;
BA_ "GenSigStartValue" SG_ 368 DCU_ADC_SpdSvModAvl 0;
BA_ "GenSigTimeoutValue" SG_ 368 DCU_ADC_SpdSvModAvl 0;
BA_ "Remark" SG_ 368 DCU_ADC_SpdSvModAvl "";
BA_ "EventCommandSignal" SG_ 368 DCU_ADC_MCUStandstill 0;
BA_ "GatewayedSignals" SG_ 368 DCU_ADC_MCUStandstill 0;
BA_ "GenSigInactiveValue" SG_ 368 DCU_ADC_MCUStandstill 0;
BA_ "GenSigInvalidValue" SG_ 368 DCU_ADC_MCUStandstill 1;
BA_ "GenSigSendType" SG_ 368 DCU_ADC_MCUStandstill 1;
BA_ "GenSigStartValue" SG_ 368 DCU_ADC_MCUStandstill 0;
BA_ "GenSigTimeoutValue" SG_ 368 DCU_ADC_MCUStandstill 0;
BA_ "Remark" SG_ 368 DCU_ADC_MCUStandstill "";
BA_ "EventCommandSignal" SG_ 368 DCU_ADC_MCUSpdSVModFit 0;
BA_ "GatewayedSignals" SG_ 368 DCU_ADC_MCUSpdSVModFit 0;
BA_ "GenSigInactiveValue" SG_ 368 DCU_ADC_MCUSpdSVModFit 0;
BA_ "GenSigInvalidValue" SG_ 368 DCU_ADC_MCUSpdSVModFit 7;
BA_ "GenSigSendType" SG_ 368 DCU_ADC_MCUSpdSVModFit 1;
BA_ "GenSigStartValue" SG_ 368 DCU_ADC_MCUSpdSVModFit 0;
BA_ "GenSigTimeoutValue" SG_ 368 DCU_ADC_MCUSpdSVModFit 0;
BA_ "Remark" SG_ 368 DCU_ADC_MCUSpdSVModFit "";
BA_ "EventCommandSignal" SG_ 368 DCU_ADC_MCUVehSldSt 0;
BA_ "GatewayedSignals" SG_ 368 DCU_ADC_MCUVehSldSt 0;
BA_ "GenSigInactiveValue" SG_ 368 DCU_ADC_MCUVehSldSt 0;
BA_ "GenSigInvalidValue" SG_ 368 DCU_ADC_MCUVehSldSt 1;
BA_ "GenSigSendType" SG_ 368 DCU_ADC_MCUVehSldSt 1;
BA_ "GenSigStartValue" SG_ 368 DCU_ADC_MCUVehSldSt 0;
BA_ "GenSigTimeoutValue" SG_ 368 DCU_ADC_MCUVehSldSt 0;
BA_ "Remark" SG_ 368 DCU_ADC_MCUVehSldSt "";
BA_ "EventCommandSignal" SG_ 368 DCU_ADC_MCUReqTq 0;
BA_ "GatewayedSignals" SG_ 368 DCU_ADC_MCUReqTq 0;
BA_ "GenSigInactiveValue" SG_ 368 DCU_ADC_MCUReqTq 0;
BA_ "GenSigInvalidValue" SG_ 368 DCU_ADC_MCUReqTq 2047;
BA_ "GenSigSendType" SG_ 368 DCU_ADC_MCUReqTq 1;
BA_ "GenSigStartValue" SG_ 368 DCU_ADC_MCUReqTq 1023;
BA_ "GenSigTimeoutValue" SG_ 368 DCU_ADC_MCUReqTq 0;
BA_ "Remark" SG_ 368 DCU_ADC_MCUReqTq "";
BA_ "EventCommandSignal" SG_ 368 DCU_RotSpdAct_Raw 0;
BA_ "GatewayedSignals" SG_ 368 DCU_RotSpdAct_Raw 0;
BA_ "GenSigInactiveValue" SG_ 368 DCU_RotSpdAct_Raw 0;
BA_ "GenSigInvalidValue" SG_ 368 DCU_RotSpdAct_Raw 65535;
BA_ "GenSigSendType" SG_ 368 DCU_RotSpdAct_Raw 1;
BA_ "GenSigStartValue" SG_ 368 DCU_RotSpdAct_Raw 32767;
BA_ "GenSigTimeoutValue" SG_ 368 DCU_RotSpdAct_Raw 0;
BA_ "Remark" SG_ 368 DCU_RotSpdAct_Raw "";
BA_ "EventCommandSignal" SG_ 704 IPS_1_CRC 0;
BA_ "GatewayedSignals" SG_ 704 IPS_1_CRC 0;
BA_ "GenSigInactiveValue" SG_ 704 IPS_1_CRC 0;
BA_ "GenSigInvalidValue" SG_ 704 IPS_1_CRC 0;
BA_ "GenSigSendType" SG_ 704 IPS_1_CRC 1;
BA_ "GenSigStartValue" SG_ 704 IPS_1_CRC 0;
BA_ "GenSigTimeoutValue" SG_ 704 IPS_1_CRC 0;
BA_ "Remark" SG_ 704 IPS_1_CRC "源报文周期20ms，转发后报文周期200ms，转发后的counter值发送会不连续";
BA_ "EventCommandSignal" SG_ 704 IPS_1_Counter 0;
BA_ "GatewayedSignals" SG_ 704 IPS_1_Counter 0;
BA_ "GenSigInactiveValue" SG_ 704 IPS_1_Counter 0;
BA_ "GenSigInvalidValue" SG_ 704 IPS_1_Counter 0;
BA_ "GenSigSendType" SG_ 704 IPS_1_Counter 1;
BA_ "GenSigStartValue" SG_ 704 IPS_1_Counter 0;
BA_ "GenSigTimeoutValue" SG_ 704 IPS_1_Counter 0;
BA_ "Remark" SG_ 704 IPS_1_Counter "源报文周期20ms，转发后报文周期200ms，转发后的counter值发送会不连续";
BA_ "EventCommandSignal" SG_ 704 IPS_DCDCModeSt 0;
BA_ "GatewayedSignals" SG_ 704 IPS_DCDCModeSt 0;
BA_ "GenSigInactiveValue" SG_ 704 IPS_DCDCModeSt 0;
BA_ "GenSigInvalidValue" SG_ 704 IPS_DCDCModeSt 0;
BA_ "GenSigSendType" SG_ 704 IPS_DCDCModeSt 1;
BA_ "GenSigStartValue" SG_ 704 IPS_DCDCModeSt 0;
BA_ "GenSigTimeoutValue" SG_ 704 IPS_DCDCModeSt 0;
BA_ "Remark" SG_ 704 IPS_DCDCModeSt "源报文周期20ms，转发后报文周期200ms，转发后的counter值发送会不连续";
BA_ "EventCommandSignal" SG_ 824 VCU_2_CRC 0;
BA_ "GatewayedSignals" SG_ 824 VCU_2_CRC 0;
BA_ "GenSigInactiveValue" SG_ 824 VCU_2_CRC 0;
BA_ "GenSigInvalidValue" SG_ 824 VCU_2_CRC 0;
BA_ "GenSigSendType" SG_ 824 VCU_2_CRC 1;
BA_ "GenSigStartValue" SG_ 824 VCU_2_CRC 0;
BA_ "GenSigTimeoutValue" SG_ 824 VCU_2_CRC 0;
BA_ "Remark" SG_ 824 VCU_2_CRC "";
BA_ "EventCommandSignal" SG_ 824 VCU_2_Counter 0;
BA_ "GatewayedSignals" SG_ 824 VCU_2_Counter 0;
BA_ "GenSigInactiveValue" SG_ 824 VCU_2_Counter 0;
BA_ "GenSigInvalidValue" SG_ 824 VCU_2_Counter 0;
BA_ "GenSigSendType" SG_ 824 VCU_2_Counter 1;
BA_ "GenSigStartValue" SG_ 824 VCU_2_Counter 0;
BA_ "GenSigTimeoutValue" SG_ 824 VCU_2_Counter 0;
BA_ "Remark" SG_ 824 VCU_2_Counter "";
BA_ "EventCommandSignal" SG_ 824 VCU_GearLvlDisp 0;
BA_ "GatewayedSignals" SG_ 824 VCU_GearLvlDisp 0;
BA_ "GenSigInactiveValue" SG_ 824 VCU_GearLvlDisp 0;
BA_ "GenSigInvalidValue" SG_ 824 VCU_GearLvlDisp 0;
BA_ "GenSigSendType" SG_ 824 VCU_GearLvlDisp 1;
BA_ "GenSigStartValue" SG_ 824 VCU_GearLvlDisp 0;
BA_ "GenSigTimeoutValue" SG_ 824 VCU_GearLvlDisp 0;
BA_ "Remark" SG_ 824 VCU_GearLvlDisp "";
BA_ "EventCommandSignal" SG_ 824 VCU_VehDrvMod 0;
BA_ "GatewayedSignals" SG_ 824 VCU_VehDrvMod 0;
BA_ "GenSigInactiveValue" SG_ 824 VCU_VehDrvMod 0;
BA_ "GenSigInvalidValue" SG_ 824 VCU_VehDrvMod 0;
BA_ "GenSigSendType" SG_ 824 VCU_VehDrvMod 1;
BA_ "GenSigStartValue" SG_ 824 VCU_VehDrvMod 0;
BA_ "GenSigTimeoutValue" SG_ 824 VCU_VehDrvMod 0;
BA_ "Remark" SG_ 824 VCU_VehDrvMod "";
BA_ "EventCommandSignal" SG_ 824 VCU_VehRdySt 0;
BA_ "GatewayedSignals" SG_ 824 VCU_VehRdySt 0;
BA_ "GenSigInactiveValue" SG_ 824 VCU_VehRdySt 0;
BA_ "GenSigInvalidValue" SG_ 824 VCU_VehRdySt 0;
BA_ "GenSigSendType" SG_ 824 VCU_VehRdySt 1;
BA_ "GenSigStartValue" SG_ 824 VCU_VehRdySt 0;
BA_ "GenSigTimeoutValue" SG_ 824 VCU_VehRdySt 0;
BA_ "Remark" SG_ 824 VCU_VehRdySt "";
BA_ "EventCommandSignal" SG_ 824 VCU_GearLvl 0;
BA_ "GatewayedSignals" SG_ 824 VCU_GearLvl 0;
BA_ "GenSigInactiveValue" SG_ 824 VCU_GearLvl 0;
BA_ "GenSigInvalidValue" SG_ 824 VCU_GearLvl 0;
BA_ "GenSigSendType" SG_ 824 VCU_GearLvl 1;
BA_ "GenSigStartValue" SG_ 824 VCU_GearLvl 0;
BA_ "GenSigTimeoutValue" SG_ 824 VCU_GearLvl 0;
BA_ "Remark" SG_ 824 VCU_GearLvl "";
BA_ "EventCommandSignal" SG_ 824 VCU_PlgConnSt 0;
BA_ "GatewayedSignals" SG_ 824 VCU_PlgConnSt 0;
BA_ "GenSigInactiveValue" SG_ 824 VCU_PlgConnSt 0;
BA_ "GenSigInvalidValue" SG_ 824 VCU_PlgConnSt 0;
BA_ "GenSigSendType" SG_ 824 VCU_PlgConnSt 1;
BA_ "GenSigStartValue" SG_ 824 VCU_PlgConnSt 0;
BA_ "GenSigTimeoutValue" SG_ 824 VCU_PlgConnSt 0;
BA_ "Remark" SG_ 824 VCU_PlgConnSt "";
BA_ "EventCommandSignal" SG_ 824 VCU_SwapHvBattRdySt 0;
BA_ "GatewayedSignals" SG_ 824 VCU_SwapHvBattRdySt 0;
BA_ "GenSigInactiveValue" SG_ 824 VCU_SwapHvBattRdySt 0;
BA_ "GenSigInvalidValue" SG_ 824 VCU_SwapHvBattRdySt 0;
BA_ "GenSigSendType" SG_ 824 VCU_SwapHvBattRdySt 1;
BA_ "GenSigStartValue" SG_ 824 VCU_SwapHvBattRdySt 0;
BA_ "GenSigTimeoutValue" SG_ 824 VCU_SwapHvBattRdySt 0;
BA_ "Remark" SG_ 824 VCU_SwapHvBattRdySt "";
BA_ "EventCommandSignal" SG_ 824 VCU_SwapHvBattCompSt 0;
BA_ "GatewayedSignals" SG_ 824 VCU_SwapHvBattCompSt 0;
BA_ "GenSigInactiveValue" SG_ 824 VCU_SwapHvBattCompSt 0;
BA_ "GenSigInvalidValue" SG_ 824 VCU_SwapHvBattCompSt 0;
BA_ "GenSigSendType" SG_ 824 VCU_SwapHvBattCompSt 1;
BA_ "GenSigStartValue" SG_ 824 VCU_SwapHvBattCompSt 0;
BA_ "GenSigTimeoutValue" SG_ 824 VCU_SwapHvBattCompSt 0;
BA_ "Remark" SG_ 824 VCU_SwapHvBattCompSt "";
BA_ "EventCommandSignal" SG_ 824 VCU_SwapHvBattModeSt 0;
BA_ "GatewayedSignals" SG_ 824 VCU_SwapHvBattModeSt 0;
BA_ "GenSigInactiveValue" SG_ 824 VCU_SwapHvBattModeSt 0;
BA_ "GenSigInvalidValue" SG_ 824 VCU_SwapHvBattModeSt 0;
BA_ "GenSigSendType" SG_ 824 VCU_SwapHvBattModeSt 1;
BA_ "GenSigStartValue" SG_ 824 VCU_SwapHvBattModeSt 0;
BA_ "GenSigTimeoutValue" SG_ 824 VCU_SwapHvBattModeSt 0;
BA_ "Remark" SG_ 824 VCU_SwapHvBattModeSt "";
BA_ "EventCommandSignal" SG_ 824 VCU_SwapHvBattModeStVD 0;
BA_ "GatewayedSignals" SG_ 824 VCU_SwapHvBattModeStVD 0;
BA_ "GenSigInactiveValue" SG_ 824 VCU_SwapHvBattModeStVD 0;
BA_ "GenSigInvalidValue" SG_ 824 VCU_SwapHvBattModeStVD 0;
BA_ "GenSigSendType" SG_ 824 VCU_SwapHvBattModeStVD 1;
BA_ "GenSigStartValue" SG_ 824 VCU_SwapHvBattModeStVD 0;
BA_ "GenSigTimeoutValue" SG_ 824 VCU_SwapHvBattModeStVD 0;
BA_ "Remark" SG_ 824 VCU_SwapHvBattModeStVD "";
BA_ "EventCommandSignal" SG_ 824 VCU_RoadMod 0;
BA_ "GatewayedSignals" SG_ 824 VCU_RoadMod 0;
BA_ "GenSigInactiveValue" SG_ 824 VCU_RoadMod 0;
BA_ "GenSigInvalidValue" SG_ 824 VCU_RoadMod 0;
BA_ "GenSigSendType" SG_ 824 VCU_RoadMod 1;
BA_ "GenSigStartValue" SG_ 824 VCU_RoadMod 0;
BA_ "GenSigTimeoutValue" SG_ 824 VCU_RoadMod 0;
BA_ "Remark" SG_ 824 VCU_RoadMod "";
BA_ "EventCommandSignal" SG_ 653 VCU_5_CRC 0;
BA_ "GatewayedSignals" SG_ 653 VCU_5_CRC 0;
BA_ "GenSigInactiveValue" SG_ 653 VCU_5_CRC 0;
BA_ "GenSigInvalidValue" SG_ 653 VCU_5_CRC 0;
BA_ "GenSigSendType" SG_ 653 VCU_5_CRC 1;
BA_ "GenSigStartValue" SG_ 653 VCU_5_CRC 0;
BA_ "GenSigTimeoutValue" SG_ 653 VCU_5_CRC 0;
BA_ "Remark" SG_ 653 VCU_5_CRC "";
BA_ "EventCommandSignal" SG_ 653 VCU_5_Counter 0;
BA_ "GatewayedSignals" SG_ 653 VCU_5_Counter 0;
BA_ "GenSigInactiveValue" SG_ 653 VCU_5_Counter 0;
BA_ "GenSigInvalidValue" SG_ 653 VCU_5_Counter 0;
BA_ "GenSigSendType" SG_ 653 VCU_5_Counter 1;
BA_ "GenSigStartValue" SG_ 653 VCU_5_Counter 0;
BA_ "GenSigTimeoutValue" SG_ 653 VCU_5_Counter 0;
BA_ "Remark" SG_ 653 VCU_5_Counter "";
BA_ "EventCommandSignal" SG_ 653 VCU_AccButtInfo 0;
BA_ "GatewayedSignals" SG_ 653 VCU_AccButtInfo 0;
BA_ "GenSigInactiveValue" SG_ 653 VCU_AccButtInfo 0;
BA_ "GenSigInvalidValue" SG_ 653 VCU_AccButtInfo 0;
BA_ "GenSigSendType" SG_ 653 VCU_AccButtInfo 1;
BA_ "GenSigStartValue" SG_ 653 VCU_AccButtInfo 0;
BA_ "GenSigTimeoutValue" SG_ 653 VCU_AccButtInfo 0;
BA_ "Remark" SG_ 653 VCU_AccButtInfo "";
BA_ "EventCommandSignal" SG_ 653 VCU_LateralAssistBtnInfo 0;
BA_ "GatewayedSignals" SG_ 653 VCU_LateralAssistBtnInfo 0;
BA_ "GenSigInactiveValue" SG_ 653 VCU_LateralAssistBtnInfo 0;
BA_ "GenSigInvalidValue" SG_ 653 VCU_LateralAssistBtnInfo 0;
BA_ "GenSigSendType" SG_ 653 VCU_LateralAssistBtnInfo 1;
BA_ "GenSigStartValue" SG_ 653 VCU_LateralAssistBtnInfo 0;
BA_ "GenSigTimeoutValue" SG_ 653 VCU_LateralAssistBtnInfo 0;
BA_ "Remark" SG_ 653 VCU_LateralAssistBtnInfo "";
BA_ "EventCommandSignal" SG_ 653 VCU_LateralAssistBtnInfoVD 0;
BA_ "GatewayedSignals" SG_ 653 VCU_LateralAssistBtnInfoVD 0;
BA_ "GenSigInactiveValue" SG_ 653 VCU_LateralAssistBtnInfoVD 0;
BA_ "GenSigInvalidValue" SG_ 653 VCU_LateralAssistBtnInfoVD 0;
BA_ "GenSigSendType" SG_ 653 VCU_LateralAssistBtnInfoVD 1;
BA_ "GenSigStartValue" SG_ 653 VCU_LateralAssistBtnInfoVD 0;
BA_ "GenSigTimeoutValue" SG_ 653 VCU_LateralAssistBtnInfoVD 0;
BA_ "Remark" SG_ 653 VCU_LateralAssistBtnInfoVD "";
BA_ "EventCommandSignal" SG_ 653 VCU_EMS_AccPedalActPst 0;
BA_ "GatewayedSignals" SG_ 653 VCU_EMS_AccPedalActPst 0;
BA_ "GenSigInactiveValue" SG_ 653 VCU_EMS_AccPedalActPst 0;
BA_ "GenSigInvalidValue" SG_ 653 VCU_EMS_AccPedalActPst 0;
BA_ "GenSigSendType" SG_ 653 VCU_EMS_AccPedalActPst 1;
BA_ "GenSigStartValue" SG_ 653 VCU_EMS_AccPedalActPst 0;
BA_ "GenSigTimeoutValue" SG_ 653 VCU_EMS_AccPedalActPst 0;
BA_ "Remark" SG_ 653 VCU_EMS_AccPedalActPst "";
BA_ "EventCommandSignal" SG_ 653 VCU_EMS_BrkPedalSt 0;
BA_ "GatewayedSignals" SG_ 653 VCU_EMS_BrkPedalSt 0;
BA_ "GenSigInactiveValue" SG_ 653 VCU_EMS_BrkPedalSt 0;
BA_ "GenSigInvalidValue" SG_ 653 VCU_EMS_BrkPedalSt 0;
BA_ "GenSigSendType" SG_ 653 VCU_EMS_BrkPedalSt 1;
BA_ "GenSigStartValue" SG_ 653 VCU_EMS_BrkPedalSt 0;
BA_ "GenSigTimeoutValue" SG_ 653 VCU_EMS_BrkPedalSt 0;
BA_ "Remark" SG_ 653 VCU_EMS_BrkPedalSt "";
BA_ "EventCommandSignal" SG_ 653 VCU_EMS_BrkPedalStVD 0;
BA_ "GatewayedSignals" SG_ 653 VCU_EMS_BrkPedalStVD 0;
BA_ "GenSigInactiveValue" SG_ 653 VCU_EMS_BrkPedalStVD 0;
BA_ "GenSigInvalidValue" SG_ 653 VCU_EMS_BrkPedalStVD 0;
BA_ "GenSigSendType" SG_ 653 VCU_EMS_BrkPedalStVD 1;
BA_ "GenSigStartValue" SG_ 653 VCU_EMS_BrkPedalStVD 0;
BA_ "GenSigTimeoutValue" SG_ 653 VCU_EMS_BrkPedalStVD 0;
BA_ "Remark" SG_ 653 VCU_EMS_BrkPedalStVD "";
BA_ "EventCommandSignal" SG_ 653 VCU_EMS_AccPedalActPstVD 0;
BA_ "GatewayedSignals" SG_ 653 VCU_EMS_AccPedalActPstVD 0;
BA_ "GenSigInactiveValue" SG_ 653 VCU_EMS_AccPedalActPstVD 0;
BA_ "GenSigInvalidValue" SG_ 653 VCU_EMS_AccPedalActPstVD 0;
BA_ "GenSigSendType" SG_ 653 VCU_EMS_AccPedalActPstVD 1;
BA_ "GenSigStartValue" SG_ 653 VCU_EMS_AccPedalActPstVD 0;
BA_ "GenSigTimeoutValue" SG_ 653 VCU_EMS_AccPedalActPstVD 0;
BA_ "Remark" SG_ 653 VCU_EMS_AccPedalActPstVD "";
BA_ "EventCommandSignal" SG_ 653 VCU_DCU_ActRotSpd 0;
BA_ "GatewayedSignals" SG_ 653 VCU_DCU_ActRotSpd 0;
BA_ "GenSigInactiveValue" SG_ 653 VCU_DCU_ActRotSpd 0;
BA_ "GenSigInvalidValue" SG_ 653 VCU_DCU_ActRotSpd 65535;
BA_ "GenSigSendType" SG_ 653 VCU_DCU_ActRotSpd 1;
BA_ "GenSigStartValue" SG_ 653 VCU_DCU_ActRotSpd 65534;
BA_ "GenSigTimeoutValue" SG_ 653 VCU_DCU_ActRotSpd 0;
BA_ "Remark" SG_ 653 VCU_DCU_ActRotSpd "";
BA_ "EventCommandSignal" SG_ 653 VCU_BrkPedPstVD 0;
BA_ "GatewayedSignals" SG_ 653 VCU_BrkPedPstVD 0;
BA_ "GenSigInactiveValue" SG_ 653 VCU_BrkPedPstVD 0;
BA_ "GenSigInvalidValue" SG_ 653 VCU_BrkPedPstVD 0;
BA_ "GenSigSendType" SG_ 653 VCU_BrkPedPstVD 1;
BA_ "GenSigStartValue" SG_ 653 VCU_BrkPedPstVD 0;
BA_ "GenSigTimeoutValue" SG_ 653 VCU_BrkPedPstVD 0;
BA_ "Remark" SG_ 653 VCU_BrkPedPstVD "";
BA_ "EventCommandSignal" SG_ 653 VCU_CrntGearLvl 0;
BA_ "GatewayedSignals" SG_ 653 VCU_CrntGearLvl 0;
BA_ "GenSigInactiveValue" SG_ 653 VCU_CrntGearLvl 0;
BA_ "GenSigInvalidValue" SG_ 653 VCU_CrntGearLvl 0;
BA_ "GenSigSendType" SG_ 653 VCU_CrntGearLvl 1;
BA_ "GenSigStartValue" SG_ 653 VCU_CrntGearLvl 0;
BA_ "GenSigTimeoutValue" SG_ 653 VCU_CrntGearLvl 0;
BA_ "Remark" SG_ 653 VCU_CrntGearLvl "";
BA_ "EventCommandSignal" SG_ 653 VCU_BrkPedPst 0;
BA_ "GatewayedSignals" SG_ 653 VCU_BrkPedPst 0;
BA_ "GenSigInactiveValue" SG_ 653 VCU_BrkPedPst 0;
BA_ "GenSigInvalidValue" SG_ 653 VCU_BrkPedPst 0;
BA_ "GenSigSendType" SG_ 653 VCU_BrkPedPst 1;
BA_ "GenSigStartValue" SG_ 653 VCU_BrkPedPst 0;
BA_ "GenSigTimeoutValue" SG_ 653 VCU_BrkPedPst 0;
BA_ "Remark" SG_ 653 VCU_BrkPedPst "";
BA_ "EventCommandSignal" SG_ 653 VCU_APAGasPedalIntv 0;
BA_ "GatewayedSignals" SG_ 653 VCU_APAGasPedalIntv 0;
BA_ "GenSigInactiveValue" SG_ 653 VCU_APAGasPedalIntv 0;
BA_ "GenSigInvalidValue" SG_ 653 VCU_APAGasPedalIntv 0;
BA_ "GenSigSendType" SG_ 653 VCU_APAGasPedalIntv 1;
BA_ "GenSigStartValue" SG_ 653 VCU_APAGasPedalIntv 0;
BA_ "GenSigTimeoutValue" SG_ 653 VCU_APAGasPedalIntv 0;
BA_ "Remark" SG_ 653 VCU_APAGasPedalIntv "";
BA_ "EventCommandSignal" SG_ 653 VCU_APAAvailable 0;
BA_ "GatewayedSignals" SG_ 653 VCU_APAAvailable 0;
BA_ "GenSigInactiveValue" SG_ 653 VCU_APAAvailable 0;
BA_ "GenSigInvalidValue" SG_ 653 VCU_APAAvailable 0;
BA_ "GenSigSendType" SG_ 653 VCU_APAAvailable 1;
BA_ "GenSigStartValue" SG_ 653 VCU_APAAvailable 0;
BA_ "GenSigTimeoutValue" SG_ 653 VCU_APAAvailable 0;
BA_ "Remark" SG_ 653 VCU_APAAvailable "";
BA_ "EventCommandSignal" SG_ 653 VCU_ACCMaxRecpDecel 0;
BA_ "GatewayedSignals" SG_ 653 VCU_ACCMaxRecpDecel 0;
BA_ "GenSigInactiveValue" SG_ 653 VCU_ACCMaxRecpDecel 0;
BA_ "GenSigInvalidValue" SG_ 653 VCU_ACCMaxRecpDecel 0;
BA_ "GenSigSendType" SG_ 653 VCU_ACCMaxRecpDecel 1;
BA_ "GenSigStartValue" SG_ 653 VCU_ACCMaxRecpDecel 0;
BA_ "GenSigTimeoutValue" SG_ 653 VCU_ACCMaxRecpDecel 0;
BA_ "Remark" SG_ 653 VCU_ACCMaxRecpDecel "";
BA_ "EventCommandSignal" SG_ 653 VCU_ACCLimitOperatingSt 0;
BA_ "GatewayedSignals" SG_ 653 VCU_ACCLimitOperatingSt 0;
BA_ "GenSigInactiveValue" SG_ 653 VCU_ACCLimitOperatingSt 0;
BA_ "GenSigInvalidValue" SG_ 653 VCU_ACCLimitOperatingSt 0;
BA_ "GenSigSendType" SG_ 653 VCU_ACCLimitOperatingSt 1;
BA_ "GenSigStartValue" SG_ 653 VCU_ACCLimitOperatingSt 0;
BA_ "GenSigTimeoutValue" SG_ 653 VCU_ACCLimitOperatingSt 0;
BA_ "Remark" SG_ 653 VCU_ACCLimitOperatingSt "";
BA_ "EventCommandSignal" SG_ 653 VCU_ACCMaxRecpDecelVD 0;
BA_ "GatewayedSignals" SG_ 653 VCU_ACCMaxRecpDecelVD 0;
BA_ "GenSigInactiveValue" SG_ 653 VCU_ACCMaxRecpDecelVD 0;
BA_ "GenSigInvalidValue" SG_ 653 VCU_ACCMaxRecpDecelVD 0;
BA_ "GenSigSendType" SG_ 653 VCU_ACCMaxRecpDecelVD 1;
BA_ "GenSigStartValue" SG_ 653 VCU_ACCMaxRecpDecelVD 0;
BA_ "GenSigTimeoutValue" SG_ 653 VCU_ACCMaxRecpDecelVD 0;
BA_ "Remark" SG_ 653 VCU_ACCMaxRecpDecelVD "";
BA_ "EventCommandSignal" SG_ 653 VCU_APA_Resp 0;
BA_ "GatewayedSignals" SG_ 653 VCU_APA_Resp 0;
BA_ "GenSigInactiveValue" SG_ 653 VCU_APA_Resp 0;
BA_ "GenSigInvalidValue" SG_ 653 VCU_APA_Resp 0;
BA_ "GenSigSendType" SG_ 653 VCU_APA_Resp 1;
BA_ "GenSigStartValue" SG_ 653 VCU_APA_Resp 0;
BA_ "GenSigTimeoutValue" SG_ 653 VCU_APA_Resp 0;
BA_ "Remark" SG_ 653 VCU_APA_Resp "";
BA_ "EventCommandSignal" SG_ 653 VCU_APAGearIntervern 0;
BA_ "GatewayedSignals" SG_ 653 VCU_APAGearIntervern 0;
BA_ "GenSigInactiveValue" SG_ 653 VCU_APAGearIntervern 0;
BA_ "GenSigInvalidValue" SG_ 653 VCU_APAGearIntervern 0;
BA_ "GenSigSendType" SG_ 653 VCU_APAGearIntervern 1;
BA_ "GenSigStartValue" SG_ 653 VCU_APAGearIntervern 0;
BA_ "GenSigTimeoutValue" SG_ 653 VCU_APAGearIntervern 0;
BA_ "Remark" SG_ 653 VCU_APAGearIntervern "";
BA_ "EventCommandSignal" SG_ 653 VCU_ActVehWheelTorq 0;
BA_ "GatewayedSignals" SG_ 653 VCU_ActVehWheelTorq 0;
BA_ "GenSigInactiveValue" SG_ 653 VCU_ActVehWheelTorq 0;
BA_ "GenSigInvalidValue" SG_ 653 VCU_ActVehWheelTorq 0;
BA_ "GenSigSendType" SG_ 653 VCU_ActVehWheelTorq 1;
BA_ "GenSigStartValue" SG_ 653 VCU_ActVehWheelTorq 0;
BA_ "GenSigTimeoutValue" SG_ 653 VCU_ActVehWheelTorq 0;
BA_ "Remark" SG_ 653 VCU_ActVehWheelTorq "";
BA_ "EventCommandSignal" SG_ 653 VCU_ACCmaxSpdLimit 0;
BA_ "GatewayedSignals" SG_ 653 VCU_ACCmaxSpdLimit 0;
BA_ "GenSigInactiveValue" SG_ 653 VCU_ACCmaxSpdLimit 0;
BA_ "GenSigInvalidValue" SG_ 653 VCU_ACCmaxSpdLimit 0;
BA_ "GenSigSendType" SG_ 653 VCU_ACCmaxSpdLimit 1;
BA_ "GenSigStartValue" SG_ 653 VCU_ACCmaxSpdLimit 0;
BA_ "GenSigTimeoutValue" SG_ 653 VCU_ACCmaxSpdLimit 0;
BA_ "Remark" SG_ 653 VCU_ACCmaxSpdLimit "";
BA_ "EventCommandSignal" SG_ 653 VCU_VehWheelTorqMax 0;
BA_ "GatewayedSignals" SG_ 653 VCU_VehWheelTorqMax 0;
BA_ "GenSigInactiveValue" SG_ 653 VCU_VehWheelTorqMax 0;
BA_ "GenSigInvalidValue" SG_ 653 VCU_VehWheelTorqMax 0;
BA_ "GenSigSendType" SG_ 653 VCU_VehWheelTorqMax 1;
BA_ "GenSigStartValue" SG_ 653 VCU_VehWheelTorqMax 0;
BA_ "GenSigTimeoutValue" SG_ 653 VCU_VehWheelTorqMax 0;
BA_ "Remark" SG_ 653 VCU_VehWheelTorqMax "";
BA_ "EventCommandSignal" SG_ 653 VCU_RecpTorqVD 0;
BA_ "GatewayedSignals" SG_ 653 VCU_RecpTorqVD 0;
BA_ "GenSigInactiveValue" SG_ 653 VCU_RecpTorqVD 0;
BA_ "GenSigInvalidValue" SG_ 653 VCU_RecpTorqVD 0;
BA_ "GenSigSendType" SG_ 653 VCU_RecpTorqVD 1;
BA_ "GenSigStartValue" SG_ 653 VCU_RecpTorqVD 0;
BA_ "GenSigTimeoutValue" SG_ 653 VCU_RecpTorqVD 0;
BA_ "Remark" SG_ 653 VCU_RecpTorqVD "";
BA_ "EventCommandSignal" SG_ 653 VCU_RecpTorq 0;
BA_ "GatewayedSignals" SG_ 653 VCU_RecpTorq 0;
BA_ "GenSigInactiveValue" SG_ 653 VCU_RecpTorq 0;
BA_ "GenSigInvalidValue" SG_ 653 VCU_RecpTorq 0;
BA_ "GenSigSendType" SG_ 653 VCU_RecpTorq 1;
BA_ "GenSigStartValue" SG_ 653 VCU_RecpTorq 0;
BA_ "GenSigTimeoutValue" SG_ 653 VCU_RecpTorq 0;
BA_ "Remark" SG_ 653 VCU_RecpTorq "";
BA_ "EventCommandSignal" SG_ 653 VCU_CrntGearLvlVD 0;
BA_ "GatewayedSignals" SG_ 653 VCU_CrntGearLvlVD 0;
BA_ "GenSigInactiveValue" SG_ 653 VCU_CrntGearLvlVD 0;
BA_ "GenSigInvalidValue" SG_ 653 VCU_CrntGearLvlVD 0;
BA_ "GenSigSendType" SG_ 653 VCU_CrntGearLvlVD 1;
BA_ "GenSigStartValue" SG_ 653 VCU_CrntGearLvlVD 0;
BA_ "GenSigTimeoutValue" SG_ 653 VCU_CrntGearLvlVD 0;
BA_ "Remark" SG_ 653 VCU_CrntGearLvlVD "";
BA_ "EventCommandSignal" SG_ 653 EMS_GasPedalActPstforMRRVD_D 0;
BA_ "GatewayedSignals" SG_ 653 EMS_GasPedalActPstforMRRVD_D 0;
BA_ "GenSigInactiveValue" SG_ 653 EMS_GasPedalActPstforMRRVD_D 0;
BA_ "GenSigInvalidValue" SG_ 653 EMS_GasPedalActPstforMRRVD_D 0;
BA_ "GenSigSendType" SG_ 653 EMS_GasPedalActPstforMRRVD_D 1;
BA_ "GenSigStartValue" SG_ 653 EMS_GasPedalActPstforMRRVD_D 0;
BA_ "GenSigTimeoutValue" SG_ 653 EMS_GasPedalActPstforMRRVD_D 0;
BA_ "Remark" SG_ 653 EMS_GasPedalActPstforMRRVD_D "";
BA_ "EventCommandSignal" SG_ 644 VCU_7_CRC 0;
BA_ "GatewayedSignals" SG_ 644 VCU_7_CRC 0;
BA_ "GenSigInactiveValue" SG_ 644 VCU_7_CRC 0;
BA_ "GenSigInvalidValue" SG_ 644 VCU_7_CRC 0;
BA_ "GenSigSendType" SG_ 644 VCU_7_CRC 1;
BA_ "GenSigStartValue" SG_ 644 VCU_7_CRC 0;
BA_ "GenSigTimeoutValue" SG_ 644 VCU_7_CRC 0;
BA_ "Remark" SG_ 644 VCU_7_CRC "";
BA_ "EventCommandSignal" SG_ 644 VCU_7_Counter 0;
BA_ "GatewayedSignals" SG_ 644 VCU_7_Counter 0;
BA_ "GenSigInactiveValue" SG_ 644 VCU_7_Counter 0;
BA_ "GenSigInvalidValue" SG_ 644 VCU_7_Counter 0;
BA_ "GenSigSendType" SG_ 644 VCU_7_Counter 1;
BA_ "GenSigStartValue" SG_ 644 VCU_7_Counter 0;
BA_ "GenSigTimeoutValue" SG_ 644 VCU_7_Counter 0;
BA_ "Remark" SG_ 644 VCU_7_Counter "";
BA_ "EventCommandSignal" SG_ 644 EMS_GasPedalActPstforMRRVD 0;
BA_ "GatewayedSignals" SG_ 644 EMS_GasPedalActPstforMRRVD 0;
BA_ "GenSigInactiveValue" SG_ 644 EMS_GasPedalActPstforMRRVD 0;
BA_ "GenSigInvalidValue" SG_ 644 EMS_GasPedalActPstforMRRVD 0;
BA_ "GenSigSendType" SG_ 644 EMS_GasPedalActPstforMRRVD 1;
BA_ "GenSigStartValue" SG_ 644 EMS_GasPedalActPstforMRRVD 0;
BA_ "GenSigTimeoutValue" SG_ 644 EMS_GasPedalActPstforMRRVD 0;
BA_ "Remark" SG_ 644 EMS_GasPedalActPstforMRRVD "";
BA_ "EventCommandSignal" SG_ 644 VCU_AccTMCFail 0;
BA_ "GatewayedSignals" SG_ 644 VCU_AccTMCFail 0;
BA_ "GenSigInactiveValue" SG_ 644 VCU_AccTMCFail 0;
BA_ "GenSigInvalidValue" SG_ 644 VCU_AccTMCFail 0;
BA_ "GenSigSendType" SG_ 644 VCU_AccTMCFail 1;
BA_ "GenSigStartValue" SG_ 644 VCU_AccTMCFail 0;
BA_ "GenSigTimeoutValue" SG_ 644 VCU_AccTMCFail 0;
BA_ "Remark" SG_ 644 VCU_AccTMCFail "";
BA_ "EventCommandSignal" SG_ 644 VCU_AccElecECFail 0;
BA_ "GatewayedSignals" SG_ 644 VCU_AccElecECFail 0;
BA_ "GenSigInactiveValue" SG_ 644 VCU_AccElecECFail 0;
BA_ "GenSigInvalidValue" SG_ 644 VCU_AccElecECFail 0;
BA_ "GenSigSendType" SG_ 644 VCU_AccElecECFail 1;
BA_ "GenSigStartValue" SG_ 644 VCU_AccElecECFail 0;
BA_ "GenSigTimeoutValue" SG_ 644 VCU_AccElecECFail 0;
BA_ "Remark" SG_ 644 VCU_AccElecECFail "";
BA_ "EventCommandSignal" SG_ 644 VCU_AccDriverOrvd 0;
BA_ "GatewayedSignals" SG_ 644 VCU_AccDriverOrvd 0;
BA_ "GenSigInactiveValue" SG_ 644 VCU_AccDriverOrvd 0;
BA_ "GenSigInvalidValue" SG_ 644 VCU_AccDriverOrvd 0;
BA_ "GenSigSendType" SG_ 644 VCU_AccDriverOrvd 1;
BA_ "GenSigStartValue" SG_ 644 VCU_AccDriverOrvd 0;
BA_ "GenSigTimeoutValue" SG_ 644 VCU_AccDriverOrvd 0;
BA_ "Remark" SG_ 644 VCU_AccDriverOrvd "";
BA_ "EventCommandSignal" SG_ 644 EMS_GasPedalActPstforMRR 0;
BA_ "GatewayedSignals" SG_ 644 EMS_GasPedalActPstforMRR 0;
BA_ "GenSigInactiveValue" SG_ 644 EMS_GasPedalActPstforMRR 0;
BA_ "GenSigInvalidValue" SG_ 644 EMS_GasPedalActPstforMRR 0;
BA_ "GenSigSendType" SG_ 644 EMS_GasPedalActPstforMRR 1;
BA_ "GenSigStartValue" SG_ 644 EMS_GasPedalActPstforMRR 0;
BA_ "GenSigTimeoutValue" SG_ 644 EMS_GasPedalActPstforMRR 0;
BA_ "Remark" SG_ 644 EMS_GasPedalActPstforMRR "";
BA_ "EventCommandSignal" SG_ 644 VCU_AccSpareCanError 0;
BA_ "GatewayedSignals" SG_ 644 VCU_AccSpareCanError 0;
BA_ "GenSigInactiveValue" SG_ 644 VCU_AccSpareCanError 0;
BA_ "GenSigInvalidValue" SG_ 644 VCU_AccSpareCanError 0;
BA_ "GenSigSendType" SG_ 644 VCU_AccSpareCanError 1;
BA_ "GenSigStartValue" SG_ 644 VCU_AccSpareCanError 0;
BA_ "GenSigTimeoutValue" SG_ 644 VCU_AccSpareCanError 0;
BA_ "Remark" SG_ 644 VCU_AccSpareCanError "";
BA_ "EventCommandSignal" SG_ 644 VCU_IFCFailureSt 0;
BA_ "GatewayedSignals" SG_ 644 VCU_IFCFailureSt 0;
BA_ "GenSigInactiveValue" SG_ 644 VCU_IFCFailureSt 0;
BA_ "GenSigInvalidValue" SG_ 644 VCU_IFCFailureSt 0;
BA_ "GenSigSendType" SG_ 644 VCU_IFCFailureSt 1;
BA_ "GenSigStartValue" SG_ 644 VCU_IFCFailureSt 0;
BA_ "GenSigTimeoutValue" SG_ 644 VCU_IFCFailureSt 0;
BA_ "Remark" SG_ 644 VCU_IFCFailureSt "";
BA_ "EventCommandSignal" SG_ 644 VCU_AccDriverOrvdVD 0;
BA_ "GatewayedSignals" SG_ 644 VCU_AccDriverOrvdVD 0;
BA_ "GenSigInactiveValue" SG_ 644 VCU_AccDriverOrvdVD 0;
BA_ "GenSigInvalidValue" SG_ 644 VCU_AccDriverOrvdVD 0;
BA_ "GenSigSendType" SG_ 644 VCU_AccDriverOrvdVD 1;
BA_ "GenSigStartValue" SG_ 644 VCU_AccDriverOrvdVD 0;
BA_ "GenSigTimeoutValue" SG_ 644 VCU_AccDriverOrvdVD 0;
BA_ "Remark" SG_ 644 VCU_AccDriverOrvdVD "";
BA_ "EventCommandSignal" SG_ 644 VCU_TorqDriverReq 0;
BA_ "GatewayedSignals" SG_ 644 VCU_TorqDriverReq 0;
BA_ "GenSigInactiveValue" SG_ 644 VCU_TorqDriverReq 0;
BA_ "GenSigInvalidValue" SG_ 644 VCU_TorqDriverReq 0;
BA_ "GenSigSendType" SG_ 644 VCU_TorqDriverReq 1;
BA_ "GenSigStartValue" SG_ 644 VCU_TorqDriverReq 0;
BA_ "GenSigTimeoutValue" SG_ 644 VCU_TorqDriverReq 0;
BA_ "Remark" SG_ 644 VCU_TorqDriverReq "";
BA_ "EventCommandSignal" SG_ 393 VCU_9_CRC 0;
BA_ "GatewayedSignals" SG_ 393 VCU_9_CRC 0;
BA_ "GenSigInactiveValue" SG_ 393 VCU_9_CRC 0;
BA_ "GenSigInvalidValue" SG_ 393 VCU_9_CRC 0;
BA_ "GenSigSendType" SG_ 393 VCU_9_CRC 1;
BA_ "GenSigStartValue" SG_ 393 VCU_9_CRC 0;
BA_ "GenSigTimeoutValue" SG_ 393 VCU_9_CRC 0;
BA_ "Remark" SG_ 393 VCU_9_CRC "";
BA_ "EventCommandSignal" SG_ 393 VCU_9_Counter 0;
BA_ "GatewayedSignals" SG_ 393 VCU_9_Counter 0;
BA_ "GenSigInactiveValue" SG_ 393 VCU_9_Counter 0;
BA_ "GenSigInvalidValue" SG_ 393 VCU_9_Counter 0;
BA_ "GenSigSendType" SG_ 393 VCU_9_Counter 1;
BA_ "GenSigStartValue" SG_ 393 VCU_9_Counter 0;
BA_ "GenSigTimeoutValue" SG_ 393 VCU_9_Counter 0;
BA_ "Remark" SG_ 393 VCU_9_Counter "";
BA_ "EventCommandSignal" SG_ 393 VCU_ErrorFb 0;
BA_ "GatewayedSignals" SG_ 393 VCU_ErrorFb 0;
BA_ "GenSigInactiveValue" SG_ 393 VCU_ErrorFb 0;
BA_ "GenSigInvalidValue" SG_ 393 VCU_ErrorFb 0;
BA_ "GenSigSendType" SG_ 393 VCU_ErrorFb 1;
BA_ "GenSigStartValue" SG_ 393 VCU_ErrorFb 0;
BA_ "GenSigTimeoutValue" SG_ 393 VCU_ErrorFb 0;
BA_ "Remark" SG_ 393 VCU_ErrorFb "";
BA_ "EventCommandSignal" SG_ 393 VCU_VehWhlReqTqVld 0;
BA_ "GatewayedSignals" SG_ 393 VCU_VehWhlReqTqVld 0;
BA_ "GenSigInactiveValue" SG_ 393 VCU_VehWhlReqTqVld 0;
BA_ "GenSigInvalidValue" SG_ 393 VCU_VehWhlReqTqVld 0;
BA_ "GenSigSendType" SG_ 393 VCU_VehWhlReqTqVld 1;
BA_ "GenSigStartValue" SG_ 393 VCU_VehWhlReqTqVld 0;
BA_ "GenSigTimeoutValue" SG_ 393 VCU_VehWhlReqTqVld 0;
BA_ "Remark" SG_ 393 VCU_VehWhlReqTqVld "";
BA_ "EventCommandSignal" SG_ 393 VCU_MotorRegenTrqLmtlnDVaild 0;
BA_ "GatewayedSignals" SG_ 393 VCU_MotorRegenTrqLmtlnDVaild 0;
BA_ "GenSigInactiveValue" SG_ 393 VCU_MotorRegenTrqLmtlnDVaild 0;
BA_ "GenSigInvalidValue" SG_ 393 VCU_MotorRegenTrqLmtlnDVaild 0;
BA_ "GenSigSendType" SG_ 393 VCU_MotorRegenTrqLmtlnDVaild 1;
BA_ "GenSigStartValue" SG_ 393 VCU_MotorRegenTrqLmtlnDVaild 0;
BA_ "GenSigTimeoutValue" SG_ 393 VCU_MotorRegenTrqLmtlnDVaild 0;
BA_ "Remark" SG_ 393 VCU_MotorRegenTrqLmtlnDVaild "";
BA_ "EventCommandSignal" SG_ 393 VCU_GearShiftAvl 0;
BA_ "GatewayedSignals" SG_ 393 VCU_GearShiftAvl 0;
BA_ "GenSigInactiveValue" SG_ 393 VCU_GearShiftAvl 0;
BA_ "GenSigInvalidValue" SG_ 393 VCU_GearShiftAvl 0;
BA_ "GenSigSendType" SG_ 393 VCU_GearShiftAvl 1;
BA_ "GenSigStartValue" SG_ 393 VCU_GearShiftAvl 0;
BA_ "GenSigTimeoutValue" SG_ 393 VCU_GearShiftAvl 0;
BA_ "Remark" SG_ 393 VCU_GearShiftAvl "";
BA_ "EventCommandSignal" SG_ 393 VCU_PtTqAvl 0;
BA_ "GatewayedSignals" SG_ 393 VCU_PtTqAvl 0;
BA_ "GenSigInactiveValue" SG_ 393 VCU_PtTqAvl 0;
BA_ "GenSigInvalidValue" SG_ 393 VCU_PtTqAvl 0;
BA_ "GenSigSendType" SG_ 393 VCU_PtTqAvl 1;
BA_ "GenSigStartValue" SG_ 393 VCU_PtTqAvl 0;
BA_ "GenSigTimeoutValue" SG_ 393 VCU_PtTqAvl 0;
BA_ "Remark" SG_ 393 VCU_PtTqAvl "";
BA_ "EventCommandSignal" SG_ 393 VCU_PtTqActvSts 0;
BA_ "GatewayedSignals" SG_ 393 VCU_PtTqActvSts 0;
BA_ "GenSigInactiveValue" SG_ 393 VCU_PtTqActvSts 0;
BA_ "GenSigInvalidValue" SG_ 393 VCU_PtTqActvSts 0;
BA_ "GenSigSendType" SG_ 393 VCU_PtTqActvSts 1;
BA_ "GenSigStartValue" SG_ 393 VCU_PtTqActvSts 0;
BA_ "GenSigTimeoutValue" SG_ 393 VCU_PtTqActvSts 0;
BA_ "Remark" SG_ 393 VCU_PtTqActvSts "";
BA_ "EventCommandSignal" SG_ 393 VCU_MotorRegenTorqueLmtlnD 0;
BA_ "GatewayedSignals" SG_ 393 VCU_MotorRegenTorqueLmtlnD 0;
BA_ "GenSigInactiveValue" SG_ 393 VCU_MotorRegenTorqueLmtlnD 0;
BA_ "GenSigInvalidValue" SG_ 393 VCU_MotorRegenTorqueLmtlnD 0;
BA_ "GenSigSendType" SG_ 393 VCU_MotorRegenTorqueLmtlnD 1;
BA_ "GenSigStartValue" SG_ 393 VCU_MotorRegenTorqueLmtlnD 8191;
BA_ "GenSigTimeoutValue" SG_ 393 VCU_MotorRegenTorqueLmtlnD 0;
BA_ "Remark" SG_ 393 VCU_MotorRegenTorqueLmtlnD "";
BA_ "EventCommandSignal" SG_ 393 VCU_DriverTorqueDesired 0;
BA_ "GatewayedSignals" SG_ 393 VCU_DriverTorqueDesired 0;
BA_ "GenSigInactiveValue" SG_ 393 VCU_DriverTorqueDesired 0;
BA_ "GenSigInvalidValue" SG_ 393 VCU_DriverTorqueDesired 0;
BA_ "GenSigSendType" SG_ 393 VCU_DriverTorqueDesired 1;
BA_ "GenSigStartValue" SG_ 393 VCU_DriverTorqueDesired 32768;
BA_ "GenSigTimeoutValue" SG_ 393 VCU_DriverTorqueDesired 0;
BA_ "Remark" SG_ 393 VCU_DriverTorqueDesired "";
BA_ "EventCommandSignal" SG_ 393 VCU_VehWhlReqTq 0;
BA_ "GatewayedSignals" SG_ 393 VCU_VehWhlReqTq 0;
BA_ "GenSigInactiveValue" SG_ 393 VCU_VehWhlReqTq 0;
BA_ "GenSigInvalidValue" SG_ 393 VCU_VehWhlReqTq 0;
BA_ "GenSigSendType" SG_ 393 VCU_VehWhlReqTq 1;
BA_ "GenSigStartValue" SG_ 393 VCU_VehWhlReqTq 32768;
BA_ "GenSigTimeoutValue" SG_ 393 VCU_VehWhlReqTq 0;
BA_ "Remark" SG_ 393 VCU_VehWhlReqTq "";
BA_ "EventCommandSignal" SG_ 393 VCU_TargetRecpTorqSt 0;
BA_ "GatewayedSignals" SG_ 393 VCU_TargetRecpTorqSt 0;
BA_ "GenSigInactiveValue" SG_ 393 VCU_TargetRecpTorqSt 0;
BA_ "GenSigInvalidValue" SG_ 393 VCU_TargetRecpTorqSt 0;
BA_ "GenSigSendType" SG_ 393 VCU_TargetRecpTorqSt 1;
BA_ "GenSigStartValue" SG_ 393 VCU_TargetRecpTorqSt 0;
BA_ "GenSigTimeoutValue" SG_ 393 VCU_TargetRecpTorqSt 0;
BA_ "Remark" SG_ 393 VCU_TargetRecpTorqSt "";
BA_ "EventCommandSignal" SG_ 393 VCU_TargetRecpTorqNm 0;
BA_ "GatewayedSignals" SG_ 393 VCU_TargetRecpTorqNm 0;
BA_ "GenSigInactiveValue" SG_ 393 VCU_TargetRecpTorqNm 0;
BA_ "GenSigInvalidValue" SG_ 393 VCU_TargetRecpTorqNm 0;
BA_ "GenSigSendType" SG_ 393 VCU_TargetRecpTorqNm 1;
BA_ "GenSigStartValue" SG_ 393 VCU_TargetRecpTorqNm 0;
BA_ "GenSigTimeoutValue" SG_ 393 VCU_TargetRecpTorqNm 0;
BA_ "Remark" SG_ 393 VCU_TargetRecpTorqNm "";
BA_ "EventCommandSignal" SG_ 393 VCU_TargetRecpTorqFA_Hyb 0;
BA_ "GatewayedSignals" SG_ 393 VCU_TargetRecpTorqFA_Hyb 0;
BA_ "GenSigInactiveValue" SG_ 393 VCU_TargetRecpTorqFA_Hyb 0;
BA_ "GenSigInvalidValue" SG_ 393 VCU_TargetRecpTorqFA_Hyb 0;
BA_ "GenSigSendType" SG_ 393 VCU_TargetRecpTorqFA_Hyb 1;
BA_ "GenSigStartValue" SG_ 393 VCU_TargetRecpTorqFA_Hyb 0;
BA_ "GenSigTimeoutValue" SG_ 393 VCU_TargetRecpTorqFA_Hyb 0;
BA_ "Remark" SG_ 393 VCU_TargetRecpTorqFA_Hyb "";
BA_ "EventCommandSignal" SG_ 393 VCU_TargetRecpTorqRA_Hyb 0;
BA_ "GatewayedSignals" SG_ 393 VCU_TargetRecpTorqRA_Hyb 0;
BA_ "GenSigInactiveValue" SG_ 393 VCU_TargetRecpTorqRA_Hyb 0;
BA_ "GenSigInvalidValue" SG_ 393 VCU_TargetRecpTorqRA_Hyb 0;
BA_ "GenSigSendType" SG_ 393 VCU_TargetRecpTorqRA_Hyb 1;
BA_ "GenSigStartValue" SG_ 393 VCU_TargetRecpTorqRA_Hyb 0;
BA_ "GenSigTimeoutValue" SG_ 393 VCU_TargetRecpTorqRA_Hyb 0;
BA_ "Remark" SG_ 393 VCU_TargetRecpTorqRA_Hyb "";
BA_ "EventCommandSignal" SG_ 393 VCU_TorqDriverReqFA_Hyb 0;
BA_ "GatewayedSignals" SG_ 393 VCU_TorqDriverReqFA_Hyb 0;
BA_ "GenSigInactiveValue" SG_ 393 VCU_TorqDriverReqFA_Hyb 0;
BA_ "GenSigInvalidValue" SG_ 393 VCU_TorqDriverReqFA_Hyb 0;
BA_ "GenSigSendType" SG_ 393 VCU_TorqDriverReqFA_Hyb 1;
BA_ "GenSigStartValue" SG_ 393 VCU_TorqDriverReqFA_Hyb 0;
BA_ "GenSigTimeoutValue" SG_ 393 VCU_TorqDriverReqFA_Hyb 0;
BA_ "Remark" SG_ 393 VCU_TorqDriverReqFA_Hyb "";
BA_ "EventCommandSignal" SG_ 393 VCU_TorqDriverReqRA_Hyb 0;
BA_ "GatewayedSignals" SG_ 393 VCU_TorqDriverReqRA_Hyb 0;
BA_ "GenSigInactiveValue" SG_ 393 VCU_TorqDriverReqRA_Hyb 0;
BA_ "GenSigInvalidValue" SG_ 393 VCU_TorqDriverReqRA_Hyb 0;
BA_ "GenSigSendType" SG_ 393 VCU_TorqDriverReqRA_Hyb 1;
BA_ "GenSigStartValue" SG_ 393 VCU_TorqDriverReqRA_Hyb 0;
BA_ "GenSigTimeoutValue" SG_ 393 VCU_TorqDriverReqRA_Hyb 0;
BA_ "Remark" SG_ 393 VCU_TorqDriverReqRA_Hyb "";
BA_ "EventCommandSignal" SG_ 393 VCU_VehActDrvTorqFA_Hyb 0;
BA_ "GatewayedSignals" SG_ 393 VCU_VehActDrvTorqFA_Hyb 0;
BA_ "GenSigInactiveValue" SG_ 393 VCU_VehActDrvTorqFA_Hyb 0;
BA_ "GenSigInvalidValue" SG_ 393 VCU_VehActDrvTorqFA_Hyb 0;
BA_ "GenSigSendType" SG_ 393 VCU_VehActDrvTorqFA_Hyb 1;
BA_ "GenSigStartValue" SG_ 393 VCU_VehActDrvTorqFA_Hyb 0;
BA_ "GenSigTimeoutValue" SG_ 393 VCU_VehActDrvTorqFA_Hyb 0;
BA_ "Remark" SG_ 393 VCU_VehActDrvTorqFA_Hyb "";
BA_ "EventCommandSignal" SG_ 393 VCU_VehActDrvTorqRA_Hyb 0;
BA_ "GatewayedSignals" SG_ 393 VCU_VehActDrvTorqRA_Hyb 0;
BA_ "GenSigInactiveValue" SG_ 393 VCU_VehActDrvTorqRA_Hyb 0;
BA_ "GenSigInvalidValue" SG_ 393 VCU_VehActDrvTorqRA_Hyb 0;
BA_ "GenSigSendType" SG_ 393 VCU_VehActDrvTorqRA_Hyb 1;
BA_ "GenSigStartValue" SG_ 393 VCU_VehActDrvTorqRA_Hyb 0;
BA_ "GenSigTimeoutValue" SG_ 393 VCU_VehActDrvTorqRA_Hyb 0;
BA_ "Remark" SG_ 393 VCU_VehActDrvTorqRA_Hyb "";
BA_ "EventCommandSignal" SG_ 393 VCU_TargetRecpTorqFAVD_Hyb 0;
BA_ "GatewayedSignals" SG_ 393 VCU_TargetRecpTorqFAVD_Hyb 0;
BA_ "GenSigInactiveValue" SG_ 393 VCU_TargetRecpTorqFAVD_Hyb 0;
BA_ "GenSigInvalidValue" SG_ 393 VCU_TargetRecpTorqFAVD_Hyb 0;
BA_ "GenSigSendType" SG_ 393 VCU_TargetRecpTorqFAVD_Hyb 1;
BA_ "GenSigStartValue" SG_ 393 VCU_TargetRecpTorqFAVD_Hyb 0;
BA_ "GenSigTimeoutValue" SG_ 393 VCU_TargetRecpTorqFAVD_Hyb 0;
BA_ "Remark" SG_ 393 VCU_TargetRecpTorqFAVD_Hyb "";
BA_ "EventCommandSignal" SG_ 393 VCU_TargetRecpTorqRAVD_Hyb 0;
BA_ "GatewayedSignals" SG_ 393 VCU_TargetRecpTorqRAVD_Hyb 0;
BA_ "GenSigInactiveValue" SG_ 393 VCU_TargetRecpTorqRAVD_Hyb 0;
BA_ "GenSigInvalidValue" SG_ 393 VCU_TargetRecpTorqRAVD_Hyb 0;
BA_ "GenSigSendType" SG_ 393 VCU_TargetRecpTorqRAVD_Hyb 1;
BA_ "GenSigStartValue" SG_ 393 VCU_TargetRecpTorqRAVD_Hyb 0;
BA_ "GenSigTimeoutValue" SG_ 393 VCU_TargetRecpTorqRAVD_Hyb 0;
BA_ "Remark" SG_ 393 VCU_TargetRecpTorqRAVD_Hyb "";
BA_ "EventCommandSignal" SG_ 393 VCU_TorqDriverReqFAVD 0;
BA_ "GatewayedSignals" SG_ 393 VCU_TorqDriverReqFAVD 0;
BA_ "GenSigInactiveValue" SG_ 393 VCU_TorqDriverReqFAVD 0;
BA_ "GenSigInvalidValue" SG_ 393 VCU_TorqDriverReqFAVD 0;
BA_ "GenSigSendType" SG_ 393 VCU_TorqDriverReqFAVD 1;
BA_ "GenSigStartValue" SG_ 393 VCU_TorqDriverReqFAVD 0;
BA_ "GenSigTimeoutValue" SG_ 393 VCU_TorqDriverReqFAVD 0;
BA_ "Remark" SG_ 393 VCU_TorqDriverReqFAVD "";
BA_ "EventCommandSignal" SG_ 393 VCU_TorqDriverReqRAVD 0;
BA_ "GatewayedSignals" SG_ 393 VCU_TorqDriverReqRAVD 0;
BA_ "GenSigInactiveValue" SG_ 393 VCU_TorqDriverReqRAVD 0;
BA_ "GenSigInvalidValue" SG_ 393 VCU_TorqDriverReqRAVD 0;
BA_ "GenSigSendType" SG_ 393 VCU_TorqDriverReqRAVD 1;
BA_ "GenSigStartValue" SG_ 393 VCU_TorqDriverReqRAVD 0;
BA_ "GenSigTimeoutValue" SG_ 393 VCU_TorqDriverReqRAVD 0;
BA_ "Remark" SG_ 393 VCU_TorqDriverReqRAVD "";
BA_ "EventCommandSignal" SG_ 393 VCU_VehActDrvTorqFAVD_Hyb 0;
BA_ "GatewayedSignals" SG_ 393 VCU_VehActDrvTorqFAVD_Hyb 0;
BA_ "GenSigInactiveValue" SG_ 393 VCU_VehActDrvTorqFAVD_Hyb 0;
BA_ "GenSigInvalidValue" SG_ 393 VCU_VehActDrvTorqFAVD_Hyb 0;
BA_ "GenSigSendType" SG_ 393 VCU_VehActDrvTorqFAVD_Hyb 1;
BA_ "GenSigStartValue" SG_ 393 VCU_VehActDrvTorqFAVD_Hyb 0;
BA_ "GenSigTimeoutValue" SG_ 393 VCU_VehActDrvTorqFAVD_Hyb 0;
BA_ "Remark" SG_ 393 VCU_VehActDrvTorqFAVD_Hyb "";
BA_ "EventCommandSignal" SG_ 393 VCU_VehActDrvTorqRAVD_Hyb 0;
BA_ "GatewayedSignals" SG_ 393 VCU_VehActDrvTorqRAVD_Hyb 0;
BA_ "GenSigInactiveValue" SG_ 393 VCU_VehActDrvTorqRAVD_Hyb 0;
BA_ "GenSigInvalidValue" SG_ 393 VCU_VehActDrvTorqRAVD_Hyb 0;
BA_ "GenSigSendType" SG_ 393 VCU_VehActDrvTorqRAVD_Hyb 1;
BA_ "GenSigStartValue" SG_ 393 VCU_VehActDrvTorqRAVD_Hyb 0;
BA_ "GenSigTimeoutValue" SG_ 393 VCU_VehActDrvTorqRAVD_Hyb 0;
BA_ "Remark" SG_ 393 VCU_VehActDrvTorqRAVD_Hyb "";
BA_ "EventCommandSignal" SG_ 393 VCU_BcsDecelReq 0;
BA_ "GatewayedSignals" SG_ 393 VCU_BcsDecelReq 0;
BA_ "GenSigInactiveValue" SG_ 393 VCU_BcsDecelReq 0;
BA_ "GenSigInvalidValue" SG_ 393 VCU_BcsDecelReq 0;
BA_ "GenSigSendType" SG_ 393 VCU_BcsDecelReq 1;
BA_ "GenSigStartValue" SG_ 393 VCU_BcsDecelReq 15;
BA_ "GenSigTimeoutValue" SG_ 393 VCU_BcsDecelReq 0;
BA_ "Remark" SG_ 393 VCU_BcsDecelReq "";
BA_ "EventCommandSignal" SG_ 393 VCU_BcsDecelVD 0;
BA_ "GatewayedSignals" SG_ 393 VCU_BcsDecelVD 0;
BA_ "GenSigInactiveValue" SG_ 393 VCU_BcsDecelVD 0;
BA_ "GenSigInvalidValue" SG_ 393 VCU_BcsDecelVD 0;
BA_ "GenSigSendType" SG_ 393 VCU_BcsDecelVD 1;
BA_ "GenSigStartValue" SG_ 393 VCU_BcsDecelVD 0;
BA_ "GenSigTimeoutValue" SG_ 393 VCU_BcsDecelVD 0;
BA_ "Remark" SG_ 393 VCU_BcsDecelVD "";
BA_ "EventCommandSignal" SG_ 393 VCU_BcsDecelEnable 0;
BA_ "GatewayedSignals" SG_ 393 VCU_BcsDecelEnable 0;
BA_ "GenSigInactiveValue" SG_ 393 VCU_BcsDecelEnable 0;
BA_ "GenSigInvalidValue" SG_ 393 VCU_BcsDecelEnable 0;
BA_ "GenSigSendType" SG_ 393 VCU_BcsDecelEnable 1;
BA_ "GenSigStartValue" SG_ 393 VCU_BcsDecelEnable 0;
BA_ "GenSigTimeoutValue" SG_ 393 VCU_BcsDecelEnable 0;
BA_ "Remark" SG_ 393 VCU_BcsDecelEnable "";
BA_ "EventCommandSignal" SG_ 393 VCU_CrntGearNoTrans 0;
BA_ "GatewayedSignals" SG_ 393 VCU_CrntGearNoTrans 0;
BA_ "GenSigInactiveValue" SG_ 393 VCU_CrntGearNoTrans 0;
BA_ "GenSigInvalidValue" SG_ 393 VCU_CrntGearNoTrans 0;
BA_ "GenSigSendType" SG_ 393 VCU_CrntGearNoTrans 1;
BA_ "GenSigStartValue" SG_ 393 VCU_CrntGearNoTrans 0;
BA_ "GenSigTimeoutValue" SG_ 393 VCU_CrntGearNoTrans 0;
BA_ "Remark" SG_ 393 VCU_CrntGearNoTrans "";
BA_ "EventCommandSignal" SG_ 393 VCU_RecpTorqSt 0;
BA_ "GatewayedSignals" SG_ 393 VCU_RecpTorqSt 0;
BA_ "GenSigInactiveValue" SG_ 393 VCU_RecpTorqSt 0;
BA_ "GenSigInvalidValue" SG_ 393 VCU_RecpTorqSt 0;
BA_ "GenSigSendType" SG_ 393 VCU_RecpTorqSt 1;
BA_ "GenSigStartValue" SG_ 393 VCU_RecpTorqSt 0;
BA_ "GenSigTimeoutValue" SG_ 393 VCU_RecpTorqSt 0;
BA_ "Remark" SG_ 393 VCU_RecpTorqSt "";
BA_ "EventCommandSignal" SG_ 393 VCU_RecpTorqNm 0;
BA_ "GatewayedSignals" SG_ 393 VCU_RecpTorqNm 0;
BA_ "GenSigInactiveValue" SG_ 393 VCU_RecpTorqNm 0;
BA_ "GenSigInvalidValue" SG_ 393 VCU_RecpTorqNm 0;
BA_ "GenSigSendType" SG_ 393 VCU_RecpTorqNm 1;
BA_ "GenSigStartValue" SG_ 393 VCU_RecpTorqNm 0;
BA_ "GenSigTimeoutValue" SG_ 393 VCU_RecpTorqNm 0;
BA_ "Remark" SG_ 393 VCU_RecpTorqNm "";
BA_ "EventCommandSignal" SG_ 393 VCU_RecpTorqFAVD_Hyb 0;
BA_ "GatewayedSignals" SG_ 393 VCU_RecpTorqFAVD_Hyb 0;
BA_ "GenSigInactiveValue" SG_ 393 VCU_RecpTorqFAVD_Hyb 0;
BA_ "GenSigInvalidValue" SG_ 393 VCU_RecpTorqFAVD_Hyb 0;
BA_ "GenSigSendType" SG_ 393 VCU_RecpTorqFAVD_Hyb 1;
BA_ "GenSigStartValue" SG_ 393 VCU_RecpTorqFAVD_Hyb 0;
BA_ "GenSigTimeoutValue" SG_ 393 VCU_RecpTorqFAVD_Hyb 0;
BA_ "Remark" SG_ 393 VCU_RecpTorqFAVD_Hyb "";
BA_ "EventCommandSignal" SG_ 393 VCU_RecpTorqRAVD_Hyb 0;
BA_ "GatewayedSignals" SG_ 393 VCU_RecpTorqRAVD_Hyb 0;
BA_ "GenSigInactiveValue" SG_ 393 VCU_RecpTorqRAVD_Hyb 0;
BA_ "GenSigInvalidValue" SG_ 393 VCU_RecpTorqRAVD_Hyb 0;
BA_ "GenSigSendType" SG_ 393 VCU_RecpTorqRAVD_Hyb 1;
BA_ "GenSigStartValue" SG_ 393 VCU_RecpTorqRAVD_Hyb 0;
BA_ "GenSigTimeoutValue" SG_ 393 VCU_RecpTorqRAVD_Hyb 0;
BA_ "Remark" SG_ 393 VCU_RecpTorqRAVD_Hyb "";
BA_ "EventCommandSignal" SG_ 393 VCU_MaxRecpTorqFAVD_Hyb 0;
BA_ "GatewayedSignals" SG_ 393 VCU_MaxRecpTorqFAVD_Hyb 0;
BA_ "GenSigInactiveValue" SG_ 393 VCU_MaxRecpTorqFAVD_Hyb 0;
BA_ "GenSigInvalidValue" SG_ 393 VCU_MaxRecpTorqFAVD_Hyb 0;
BA_ "GenSigSendType" SG_ 393 VCU_MaxRecpTorqFAVD_Hyb 1;
BA_ "GenSigStartValue" SG_ 393 VCU_MaxRecpTorqFAVD_Hyb 0;
BA_ "GenSigTimeoutValue" SG_ 393 VCU_MaxRecpTorqFAVD_Hyb 0;
BA_ "Remark" SG_ 393 VCU_MaxRecpTorqFAVD_Hyb "";
BA_ "EventCommandSignal" SG_ 393 VCU_MaxRecpTorqRAVD_Hyb 0;
BA_ "GatewayedSignals" SG_ 393 VCU_MaxRecpTorqRAVD_Hyb 0;
BA_ "GenSigInactiveValue" SG_ 393 VCU_MaxRecpTorqRAVD_Hyb 0;
BA_ "GenSigInvalidValue" SG_ 393 VCU_MaxRecpTorqRAVD_Hyb 0;
BA_ "GenSigSendType" SG_ 393 VCU_MaxRecpTorqRAVD_Hyb 1;
BA_ "GenSigStartValue" SG_ 393 VCU_MaxRecpTorqRAVD_Hyb 0;
BA_ "GenSigTimeoutValue" SG_ 393 VCU_MaxRecpTorqRAVD_Hyb 0;
BA_ "Remark" SG_ 393 VCU_MaxRecpTorqRAVD_Hyb "";
BA_ "EventCommandSignal" SG_ 393 VCU_RecpTorqFA_Hyb 0;
BA_ "GatewayedSignals" SG_ 393 VCU_RecpTorqFA_Hyb 0;
BA_ "GenSigInactiveValue" SG_ 393 VCU_RecpTorqFA_Hyb 0;
BA_ "GenSigInvalidValue" SG_ 393 VCU_RecpTorqFA_Hyb 0;
BA_ "GenSigSendType" SG_ 393 VCU_RecpTorqFA_Hyb 1;
BA_ "GenSigStartValue" SG_ 393 VCU_RecpTorqFA_Hyb 0;
BA_ "GenSigTimeoutValue" SG_ 393 VCU_RecpTorqFA_Hyb 0;
BA_ "Remark" SG_ 393 VCU_RecpTorqFA_Hyb "";
BA_ "EventCommandSignal" SG_ 393 VCU_RecpTorqRA_Hyb 0;
BA_ "GatewayedSignals" SG_ 393 VCU_RecpTorqRA_Hyb 0;
BA_ "GenSigInactiveValue" SG_ 393 VCU_RecpTorqRA_Hyb 0;
BA_ "GenSigInvalidValue" SG_ 393 VCU_RecpTorqRA_Hyb 0;
BA_ "GenSigSendType" SG_ 393 VCU_RecpTorqRA_Hyb 1;
BA_ "GenSigStartValue" SG_ 393 VCU_RecpTorqRA_Hyb 0;
BA_ "GenSigTimeoutValue" SG_ 393 VCU_RecpTorqRA_Hyb 0;
BA_ "Remark" SG_ 393 VCU_RecpTorqRA_Hyb "";
BA_ "EventCommandSignal" SG_ 393 VCU_MaxRecpTorqFA_Hyb 0;
BA_ "GatewayedSignals" SG_ 393 VCU_MaxRecpTorqFA_Hyb 0;
BA_ "GenSigInactiveValue" SG_ 393 VCU_MaxRecpTorqFA_Hyb 0;
BA_ "GenSigInvalidValue" SG_ 393 VCU_MaxRecpTorqFA_Hyb 0;
BA_ "GenSigSendType" SG_ 393 VCU_MaxRecpTorqFA_Hyb 1;
BA_ "GenSigStartValue" SG_ 393 VCU_MaxRecpTorqFA_Hyb 0;
BA_ "GenSigTimeoutValue" SG_ 393 VCU_MaxRecpTorqFA_Hyb 0;
BA_ "Remark" SG_ 393 VCU_MaxRecpTorqFA_Hyb "";
BA_ "EventCommandSignal" SG_ 393 VCU_MaxRecpTorqRA_Hyb 0;
BA_ "GatewayedSignals" SG_ 393 VCU_MaxRecpTorqRA_Hyb 0;
BA_ "GenSigInactiveValue" SG_ 393 VCU_MaxRecpTorqRA_Hyb 0;
BA_ "GenSigInvalidValue" SG_ 393 VCU_MaxRecpTorqRA_Hyb 0;
BA_ "GenSigSendType" SG_ 393 VCU_MaxRecpTorqRA_Hyb 1;
BA_ "GenSigStartValue" SG_ 393 VCU_MaxRecpTorqRA_Hyb 0;
BA_ "GenSigTimeoutValue" SG_ 393 VCU_MaxRecpTorqRA_Hyb 0;
BA_ "Remark" SG_ 393 VCU_MaxRecpTorqRA_Hyb "";
BA_ "EventCommandSignal" SG_ 393 VCU_VehWheelTorqMinNm 0;
BA_ "GatewayedSignals" SG_ 393 VCU_VehWheelTorqMinNm 0;
BA_ "GenSigInactiveValue" SG_ 393 VCU_VehWheelTorqMinNm 0;
BA_ "GenSigInvalidValue" SG_ 393 VCU_VehWheelTorqMinNm 32767;
BA_ "GenSigSendType" SG_ 393 VCU_VehWheelTorqMinNm 1;
BA_ "GenSigStartValue" SG_ 393 VCU_VehWheelTorqMinNm 32766;
BA_ "GenSigTimeoutValue" SG_ 393 VCU_VehWheelTorqMinNm 0;
BA_ "Remark" SG_ 393 VCU_VehWheelTorqMinNm "";
BA_ "EventCommandSignal" SG_ 393 VCU_VehWheelTorqMaxNmVD 0;
BA_ "GatewayedSignals" SG_ 393 VCU_VehWheelTorqMaxNmVD 0;
BA_ "GenSigInactiveValue" SG_ 393 VCU_VehWheelTorqMaxNmVD 0;
BA_ "GenSigInvalidValue" SG_ 393 VCU_VehWheelTorqMaxNmVD 0;
BA_ "GenSigSendType" SG_ 393 VCU_VehWheelTorqMaxNmVD 1;
BA_ "GenSigStartValue" SG_ 393 VCU_VehWheelTorqMaxNmVD 0;
BA_ "GenSigTimeoutValue" SG_ 393 VCU_VehWheelTorqMaxNmVD 0;
BA_ "Remark" SG_ 393 VCU_VehWheelTorqMaxNmVD "";
BA_ "EventCommandSignal" SG_ 393 VCU_VehWheelTorqMaxNm 0;
BA_ "GatewayedSignals" SG_ 393 VCU_VehWheelTorqMaxNm 0;
BA_ "GenSigInactiveValue" SG_ 393 VCU_VehWheelTorqMaxNm 0;
BA_ "GenSigInvalidValue" SG_ 393 VCU_VehWheelTorqMaxNm 32767;
BA_ "GenSigSendType" SG_ 393 VCU_VehWheelTorqMaxNm 1;
BA_ "GenSigStartValue" SG_ 393 VCU_VehWheelTorqMaxNm 32766;
BA_ "GenSigTimeoutValue" SG_ 393 VCU_VehWheelTorqMaxNm 0;
BA_ "Remark" SG_ 393 VCU_VehWheelTorqMaxNm "";
BA_ "EventCommandSignal" SG_ 393 VCU_ActVehWheelTorqNm 0;
BA_ "GatewayedSignals" SG_ 393 VCU_ActVehWheelTorqNm 0;
BA_ "GenSigInactiveValue" SG_ 393 VCU_ActVehWheelTorqNm 0;
BA_ "GenSigInvalidValue" SG_ 393 VCU_ActVehWheelTorqNm 0;
BA_ "GenSigSendType" SG_ 393 VCU_ActVehWheelTorqNm 1;
BA_ "GenSigStartValue" SG_ 393 VCU_ActVehWheelTorqNm 32766;
BA_ "GenSigTimeoutValue" SG_ 393 VCU_ActVehWheelTorqNm 0;
BA_ "Remark" SG_ 393 VCU_ActVehWheelTorqNm "";
BA_ "EventCommandSignal" SG_ 393 VCU_APAWheelTorqDriverReqNm 0;
BA_ "GatewayedSignals" SG_ 393 VCU_APAWheelTorqDriverReqNm 0;
BA_ "GenSigInactiveValue" SG_ 393 VCU_APAWheelTorqDriverReqNm 0;
BA_ "GenSigInvalidValue" SG_ 393 VCU_APAWheelTorqDriverReqNm 32767;
BA_ "GenSigSendType" SG_ 393 VCU_APAWheelTorqDriverReqNm 1;
BA_ "GenSigStartValue" SG_ 393 VCU_APAWheelTorqDriverReqNm 32766;
BA_ "GenSigTimeoutValue" SG_ 393 VCU_APAWheelTorqDriverReqNm 0;
BA_ "Remark" SG_ 393 VCU_APAWheelTorqDriverReqNm "";
BA_ "EventCommandSignal" SG_ 404 ADC_1_B_CRC 0;
BA_ "GatewayedSignals" SG_ 404 ADC_1_B_CRC 0;
BA_ "GenSigInactiveValue" SG_ 404 ADC_1_B_CRC 0;
BA_ "GenSigInvalidValue" SG_ 404 ADC_1_B_CRC 0;
BA_ "GenSigSendType" SG_ 404 ADC_1_B_CRC 1;
BA_ "GenSigStartValue" SG_ 404 ADC_1_B_CRC 0;
BA_ "GenSigTimeoutValue" SG_ 404 ADC_1_B_CRC 0;
BA_ "Remark" SG_ 404 ADC_1_B_CRC "";
BA_ "EventCommandSignal" SG_ 404 ADC_1_B_Counter 0;
BA_ "GatewayedSignals" SG_ 404 ADC_1_B_Counter 0;
BA_ "GenSigInactiveValue" SG_ 404 ADC_1_B_Counter 0;
BA_ "GenSigInvalidValue" SG_ 404 ADC_1_B_Counter 0;
BA_ "GenSigSendType" SG_ 404 ADC_1_B_Counter 1;
BA_ "GenSigStartValue" SG_ 404 ADC_1_B_Counter 0;
BA_ "GenSigTimeoutValue" SG_ 404 ADC_1_B_Counter 0;
BA_ "Remark" SG_ 404 ADC_1_B_Counter "";
BA_ "EventCommandSignal" SG_ 404 ADC_LongCtrlAvailability_B 0;
BA_ "GatewayedSignals" SG_ 404 ADC_LongCtrlAvailability_B 0;
BA_ "GenSigInactiveValue" SG_ 404 ADC_LongCtrlAvailability_B 0;
BA_ "GenSigInvalidValue" SG_ 404 ADC_LongCtrlAvailability_B 0;
BA_ "GenSigSendType" SG_ 404 ADC_LongCtrlAvailability_B 1;
BA_ "GenSigStartValue" SG_ 404 ADC_LongCtrlAvailability_B 0;
BA_ "GenSigTimeoutValue" SG_ 404 ADC_LongCtrlAvailability_B 0;
BA_ "Remark" SG_ 404 ADC_LongCtrlAvailability_B "";
BA_ "EventCommandSignal" SG_ 404 ADC_LongCtrlModeForBrkSys_B 0;
BA_ "GatewayedSignals" SG_ 404 ADC_LongCtrlModeForBrkSys_B 0;
BA_ "GenSigInactiveValue" SG_ 404 ADC_LongCtrlModeForBrkSys_B 0;
BA_ "GenSigInvalidValue" SG_ 404 ADC_LongCtrlModeForBrkSys_B 0;
BA_ "GenSigSendType" SG_ 404 ADC_LongCtrlModeForBrkSys_B 1;
BA_ "GenSigStartValue" SG_ 404 ADC_LongCtrlModeForBrkSys_B 0;
BA_ "GenSigTimeoutValue" SG_ 404 ADC_LongCtrlModeForBrkSys_B 0;
BA_ "Remark" SG_ 404 ADC_LongCtrlModeForBrkSys_B "";
BA_ "EventCommandSignal" SG_ 404 ADC_LongCtrlTargetAx_B 0;
BA_ "GatewayedSignals" SG_ 404 ADC_LongCtrlTargetAx_B 0;
BA_ "GenSigInactiveValue" SG_ 404 ADC_LongCtrlTargetAx_B 0;
BA_ "GenSigInvalidValue" SG_ 404 ADC_LongCtrlTargetAx_B 0;
BA_ "GenSigSendType" SG_ 404 ADC_LongCtrlTargetAx_B 1;
BA_ "GenSigStartValue" SG_ 404 ADC_LongCtrlTargetAx_B 0;
BA_ "GenSigTimeoutValue" SG_ 404 ADC_LongCtrlTargetAx_B 0;
BA_ "Remark" SG_ 404 ADC_LongCtrlTargetAx_B "";
BA_ "EventCommandSignal" SG_ 404 ADC_LongCtrlTargetAxReq_B 0;
BA_ "GatewayedSignals" SG_ 404 ADC_LongCtrlTargetAxReq_B 0;
BA_ "GenSigInactiveValue" SG_ 404 ADC_LongCtrlTargetAxReq_B 0;
BA_ "GenSigInvalidValue" SG_ 404 ADC_LongCtrlTargetAxReq_B 0;
BA_ "GenSigSendType" SG_ 404 ADC_LongCtrlTargetAxReq_B 1;
BA_ "GenSigStartValue" SG_ 404 ADC_LongCtrlTargetAxReq_B 0;
BA_ "GenSigTimeoutValue" SG_ 404 ADC_LongCtrlTargetAxReq_B 0;
BA_ "Remark" SG_ 404 ADC_LongCtrlTargetAxReq_B "";
BA_ "EventCommandSignal" SG_ 404 ADC_LongCtrlTypReq_B 0;
BA_ "GatewayedSignals" SG_ 404 ADC_LongCtrlTypReq_B 0;
BA_ "GenSigInactiveValue" SG_ 404 ADC_LongCtrlTypReq_B 0;
BA_ "GenSigInvalidValue" SG_ 404 ADC_LongCtrlTypReq_B 0;
BA_ "GenSigSendType" SG_ 404 ADC_LongCtrlTypReq_B 1;
BA_ "GenSigStartValue" SG_ 404 ADC_LongCtrlTypReq_B 0;
BA_ "GenSigTimeoutValue" SG_ 404 ADC_LongCtrlTypReq_B 0;
BA_ "Remark" SG_ 404 ADC_LongCtrlTypReq_B "";
BA_ "EventCommandSignal" SG_ 404 ADC_LongCtrlDecToStopReq_B 0;
BA_ "GatewayedSignals" SG_ 404 ADC_LongCtrlDecToStopReq_B 0;
BA_ "GenSigInactiveValue" SG_ 404 ADC_LongCtrlDecToStopReq_B 0;
BA_ "GenSigInvalidValue" SG_ 404 ADC_LongCtrlDecToStopReq_B 0;
BA_ "GenSigSendType" SG_ 404 ADC_LongCtrlDecToStopReq_B 1;
BA_ "GenSigStartValue" SG_ 404 ADC_LongCtrlDecToStopReq_B 0;
BA_ "GenSigTimeoutValue" SG_ 404 ADC_LongCtrlDecToStopReq_B 0;
BA_ "Remark" SG_ 404 ADC_LongCtrlDecToStopReq_B "";
BA_ "EventCommandSignal" SG_ 404 ADC_LongctrlSecureReq_B 0;
BA_ "GatewayedSignals" SG_ 404 ADC_LongctrlSecureReq_B 0;
BA_ "GenSigInactiveValue" SG_ 404 ADC_LongctrlSecureReq_B 0;
BA_ "GenSigInvalidValue" SG_ 404 ADC_LongctrlSecureReq_B 0;
BA_ "GenSigSendType" SG_ 404 ADC_LongctrlSecureReq_B 1;
BA_ "GenSigStartValue" SG_ 404 ADC_LongctrlSecureReq_B 0;
BA_ "GenSigTimeoutValue" SG_ 404 ADC_LongctrlSecureReq_B 0;
BA_ "Remark" SG_ 404 ADC_LongctrlSecureReq_B "";
BA_ "EventCommandSignal" SG_ 404 ADC_ActTrqReq_B 0;
BA_ "GatewayedSignals" SG_ 404 ADC_ActTrqReq_B 0;
BA_ "GenSigInactiveValue" SG_ 404 ADC_ActTrqReq_B 0;
BA_ "GenSigInvalidValue" SG_ 404 ADC_ActTrqReq_B 0;
BA_ "GenSigSendType" SG_ 404 ADC_ActTrqReq_B 1;
BA_ "GenSigStartValue" SG_ 404 ADC_ActTrqReq_B 0;
BA_ "GenSigTimeoutValue" SG_ 404 ADC_ActTrqReq_B 0;
BA_ "Remark" SG_ 404 ADC_ActTrqReq_B "";
BA_ "EventCommandSignal" SG_ 404 ADC_ActTrqReqEnable_B 0;
BA_ "GatewayedSignals" SG_ 404 ADC_ActTrqReqEnable_B 0;
BA_ "GenSigInactiveValue" SG_ 404 ADC_ActTrqReqEnable_B 0;
BA_ "GenSigInvalidValue" SG_ 404 ADC_ActTrqReqEnable_B 0;
BA_ "GenSigSendType" SG_ 404 ADC_ActTrqReqEnable_B 1;
BA_ "GenSigStartValue" SG_ 404 ADC_ActTrqReqEnable_B 0;
BA_ "GenSigTimeoutValue" SG_ 404 ADC_ActTrqReqEnable_B 0;
BA_ "Remark" SG_ 404 ADC_ActTrqReqEnable_B "";
BA_ "EventCommandSignal" SG_ 404 ADC_VLCSt_B 0;
BA_ "GatewayedSignals" SG_ 404 ADC_VLCSt_B 0;
BA_ "GenSigInactiveValue" SG_ 404 ADC_VLCSt_B 0;
BA_ "GenSigInvalidValue" SG_ 404 ADC_VLCSt_B 0;
BA_ "GenSigSendType" SG_ 404 ADC_VLCSt_B 1;
BA_ "GenSigStartValue" SG_ 404 ADC_VLCSt_B 0;
BA_ "GenSigTimeoutValue" SG_ 404 ADC_VLCSt_B 0;
BA_ "Remark" SG_ 404 ADC_VLCSt_B "";
BA_ "EventCommandSignal" SG_ 404 ADC_ICMWarnCardSt_B 0;
BA_ "GatewayedSignals" SG_ 404 ADC_ICMWarnCardSt_B 0;
BA_ "GenSigInactiveValue" SG_ 404 ADC_ICMWarnCardSt_B 0;
BA_ "GenSigInvalidValue" SG_ 404 ADC_ICMWarnCardSt_B 0;
BA_ "GenSigSendType" SG_ 404 ADC_ICMWarnCardSt_B 1;
BA_ "GenSigStartValue" SG_ 404 ADC_ICMWarnCardSt_B 0;
BA_ "GenSigTimeoutValue" SG_ 404 ADC_ICMWarnCardSt_B 0;
BA_ "Remark" SG_ 404 ADC_ICMWarnCardSt_B "";
BA_ "EventCommandSignal" SG_ 404 ADC_ICMPromptWarn_B 0;
BA_ "GatewayedSignals" SG_ 404 ADC_ICMPromptWarn_B 0;
BA_ "GenSigInactiveValue" SG_ 404 ADC_ICMPromptWarn_B 0;
BA_ "GenSigInvalidValue" SG_ 404 ADC_ICMPromptWarn_B 0;
BA_ "GenSigSendType" SG_ 404 ADC_ICMPromptWarn_B 1;
BA_ "GenSigStartValue" SG_ 404 ADC_ICMPromptWarn_B 0;
BA_ "GenSigTimeoutValue" SG_ 404 ADC_ICMPromptWarn_B 0;
BA_ "Remark" SG_ 404 ADC_ICMPromptWarn_B "";
BA_ "EventCommandSignal" SG_ 404 ADC_StrAngleReq_B 0;
BA_ "GatewayedSignals" SG_ 404 ADC_StrAngleReq_B 0;
BA_ "GenSigInactiveValue" SG_ 404 ADC_StrAngleReq_B 0;
BA_ "EventCommandSignal" SG_ 404 ADC_SACMotorTorLimExtMax_B 0;
BA_ "GatewayedSignals" SG_ 404 ADC_SACMotorTorLimExtMax_B 0;
BA_ "GenSigInactiveValue" SG_ 404 ADC_SACMotorTorLimExtMax_B 0;
BA_ "GenSigInvalidValue" SG_ 404 ADC_SACMotorTorLimExtMax_B 255;
BA_ "GenSigSendType" SG_ 404 ADC_SACMotorTorLimExtMax_B 1;
BA_ "GenSigStartValue" SG_ 404 ADC_SACMotorTorLimExtMax_B 254;
BA_ "GenSigTimeoutValue" SG_ 404 ADC_SACMotorTorLimExtMax_B 255;
BA_ "Remark" SG_ 404 ADC_SACMotorTorLimExtMax_B "";
BA_ "EventCommandSignal" SG_ 404 ADC_SACMotorTorLimExtMin_B 0;
BA_ "GatewayedSignals" SG_ 404 ADC_SACMotorTorLimExtMin_B 0;
BA_ "GenSigInactiveValue" SG_ 404 ADC_SACMotorTorLimExtMin_B 0;
BA_ "GenSigInvalidValue" SG_ 404 ADC_SACMotorTorLimExtMin_B 255;
BA_ "GenSigSendType" SG_ 404 ADC_SACMotorTorLimExtMin_B 1;
BA_ "GenSigStartValue" SG_ 404 ADC_SACMotorTorLimExtMin_B 0;
BA_ "GenSigTimeoutValue" SG_ 404 ADC_SACMotorTorLimExtMin_B 255;
BA_ "Remark" SG_ 404 ADC_SACMotorTorLimExtMin_B "";
BA_ "EventCommandSignal" SG_ 404 ADC_AngReqRdntReq_B 0;
BA_ "GatewayedSignals" SG_ 404 ADC_AngReqRdntReq_B 0;
BA_ "GenSigInactiveValue" SG_ 404 ADC_AngReqRdntReq_B 0;
BA_ "GenSigInvalidValue" SG_ 404 ADC_AngReqRdntReq_B 0;
BA_ "GenSigSendType" SG_ 404 ADC_AngReqRdntReq_B 1;
BA_ "GenSigStartValue" SG_ 404 ADC_AngReqRdntReq_B 0;
BA_ "GenSigTimeoutValue" SG_ 404 ADC_AngReqRdntReq_B 0;
BA_ "Remark" SG_ 404 ADC_AngReqRdntReq_B "";
BA_ "EventCommandSignal" SG_ 404 ADC_AngReqSt_B 0;
BA_ "GatewayedSignals" SG_ 404 ADC_AngReqSt_B 0;
BA_ "GenSigInactiveValue" SG_ 404 ADC_AngReqSt_B 0;
BA_ "GenSigInvalidValue" SG_ 404 ADC_AngReqSt_B 0;
BA_ "GenSigSendType" SG_ 404 ADC_AngReqSt_B 1;
BA_ "GenSigStartValue" SG_ 404 ADC_AngReqSt_B 0;
BA_ "GenSigTimeoutValue" SG_ 404 ADC_AngReqSt_B 0;
BA_ "Remark" SG_ 404 ADC_AngReqSt_B "";
BA_ "EventCommandSignal" SG_ 404 ADC_AssistParaSwitchReq_B 0;
BA_ "GatewayedSignals" SG_ 404 ADC_AssistParaSwitchReq_B 0;
BA_ "GenSigInactiveValue" SG_ 404 ADC_AssistParaSwitchReq_B 0;
BA_ "GenSigInvalidValue" SG_ 404 ADC_AssistParaSwitchReq_B 0;
BA_ "GenSigSendType" SG_ 404 ADC_AssistParaSwitchReq_B 1;
BA_ "GenSigStartValue" SG_ 404 ADC_AssistParaSwitchReq_B 0;
BA_ "GenSigTimeoutValue" SG_ 404 ADC_AssistParaSwitchReq_B 0;
BA_ "Remark" SG_ 404 ADC_AssistParaSwitchReq_B "";
BA_ "EventCommandSignal" SG_ 404 ADC_PAAGrarLvlReq_B 0;
BA_ "GatewayedSignals" SG_ 404 ADC_PAAGrarLvlReq_B 0;
BA_ "GenSigInactiveValue" SG_ 404 ADC_PAAGrarLvlReq_B 0;
BA_ "GenSigInvalidValue" SG_ 404 ADC_PAAGrarLvlReq_B 0;
BA_ "GenSigSendType" SG_ 404 ADC_PAAGrarLvlReq_B 1;
BA_ "GenSigStartValue" SG_ 404 ADC_PAAGrarLvlReq_B 0;
BA_ "GenSigTimeoutValue" SG_ 404 ADC_PAAGrarLvlReq_B 0;
BA_ "Remark" SG_ 404 ADC_PAAGrarLvlReq_B "";
BA_ "EventCommandSignal" SG_ 404 ADC_PAAGrarLvlReqEnable_B 0;
BA_ "GatewayedSignals" SG_ 404 ADC_PAAGrarLvlReqEnable_B 0;
BA_ "GenSigInactiveValue" SG_ 404 ADC_PAAGrarLvlReqEnable_B 0;
BA_ "GenSigInvalidValue" SG_ 404 ADC_PAAGrarLvlReqEnable_B 0;
BA_ "GenSigSendType" SG_ 404 ADC_PAAGrarLvlReqEnable_B 1;
BA_ "GenSigStartValue" SG_ 404 ADC_PAAGrarLvlReqEnable_B 0;
BA_ "GenSigTimeoutValue" SG_ 404 ADC_PAAGrarLvlReqEnable_B 0;
BA_ "Remark" SG_ 404 ADC_PAAGrarLvlReqEnable_B "";
BA_ "EventCommandSignal" SG_ 404 ADC_ElecBrkFnSwitch_B 0;
BA_ "GatewayedSignals" SG_ 404 ADC_ElecBrkFnSwitch_B 0;
BA_ "GenSigInactiveValue" SG_ 404 ADC_ElecBrkFnSwitch_B 0;
BA_ "GenSigInvalidValue" SG_ 404 ADC_ElecBrkFnSwitch_B 0;
BA_ "GenSigSendType" SG_ 404 ADC_ElecBrkFnSwitch_B 1;
BA_ "GenSigStartValue" SG_ 404 ADC_ElecBrkFnSwitch_B 0;
BA_ "GenSigTimeoutValue" SG_ 404 ADC_ElecBrkFnSwitch_B 0;
BA_ "Remark" SG_ 404 ADC_ElecBrkFnSwitch_B "";
BA_ "EventCommandSignal" SG_ 404 ADC_LongCtrlDriveOff_B 0;
BA_ "GatewayedSignals" SG_ 404 ADC_LongCtrlDriveOff_B 0;
BA_ "GenSigInactiveValue" SG_ 404 ADC_LongCtrlDriveOff_B 0;
BA_ "GenSigInvalidValue" SG_ 404 ADC_LongCtrlDriveOff_B 0;
BA_ "GenSigSendType" SG_ 404 ADC_LongCtrlDriveOff_B 1;
BA_ "GenSigStartValue" SG_ 404 ADC_LongCtrlDriveOff_B 0;
BA_ "GenSigTimeoutValue" SG_ 404 ADC_LongCtrlDriveOff_B 0;
BA_ "Remark" SG_ 404 ADC_LongCtrlDriveOff_B "";
BA_ "EventCommandSignal" SG_ 404 ADC_AEBDecelCtrlReq_B 0;
BA_ "GatewayedSignals" SG_ 404 ADC_AEBDecelCtrlReq_B 0;
BA_ "GenSigInactiveValue" SG_ 404 ADC_AEBDecelCtrlReq_B 0;
BA_ "GenSigInvalidValue" SG_ 404 ADC_AEBDecelCtrlReq_B 0;
BA_ "GenSigSendType" SG_ 404 ADC_AEBDecelCtrlReq_B 1;
BA_ "GenSigStartValue" SG_ 404 ADC_AEBDecelCtrlReq_B 0;
BA_ "GenSigTimeoutValue" SG_ 404 ADC_AEBDecelCtrlReq_B 0;
BA_ "Remark" SG_ 404 ADC_AEBDecelCtrlReq_B "";
BA_ "EventCommandSignal" SG_ 404 ADC_AEBTargetDecel_B 0;
BA_ "GatewayedSignals" SG_ 404 ADC_AEBTargetDecel_B 0;
BA_ "GenSigInactiveValue" SG_ 404 ADC_AEBTargetDecel_B 0;
BA_ "GenSigInvalidValue" SG_ 404 ADC_AEBTargetDecel_B 0;
BA_ "GenSigSendType" SG_ 404 ADC_AEBTargetDecel_B 1;
BA_ "GenSigStartValue" SG_ 404 ADC_AEBTargetDecel_B 0;
BA_ "GenSigTimeoutValue" SG_ 404 ADC_AEBTargetDecel_B 0;
BA_ "Remark" SG_ 404 ADC_AEBTargetDecel_B "";
BA_ "EventCommandSignal" SG_ 404 ADC_ABPReq_B 0;
BA_ "GatewayedSignals" SG_ 404 ADC_ABPReq_B 0;
BA_ "GenSigInactiveValue" SG_ 404 ADC_ABPReq_B 0;
BA_ "GenSigInvalidValue" SG_ 404 ADC_ABPReq_B 0;
BA_ "GenSigSendType" SG_ 404 ADC_ABPReq_B 1;
BA_ "GenSigStartValue" SG_ 404 ADC_ABPReq_B 0;
BA_ "GenSigTimeoutValue" SG_ 404 ADC_ABPReq_B 0;
BA_ "Remark" SG_ 404 ADC_ABPReq_B "";
BA_ "EventCommandSignal" SG_ 404 ADC_ComfstopReq_B 0;
BA_ "GatewayedSignals" SG_ 404 ADC_ComfstopReq_B 0;
BA_ "GenSigInactiveValue" SG_ 404 ADC_ComfstopReq_B 0;
BA_ "GenSigInvalidValue" SG_ 404 ADC_ComfstopReq_B 0;
BA_ "GenSigSendType" SG_ 404 ADC_ComfstopReq_B 1;
BA_ "GenSigStartValue" SG_ 404 ADC_ComfstopReq_B 0;
BA_ "GenSigTimeoutValue" SG_ 404 ADC_ComfstopReq_B 0;
BA_ "Remark" SG_ 404 ADC_ComfstopReq_B "";
BA_ "EventCommandSignal" SG_ 404 ADC_CSM_HoldReq_B 0;
BA_ "GatewayedSignals" SG_ 404 ADC_CSM_HoldReq_B 0;
BA_ "GenSigInactiveValue" SG_ 404 ADC_CSM_HoldReq_B 0;
BA_ "GenSigInvalidValue" SG_ 404 ADC_CSM_HoldReq_B 0;
BA_ "GenSigSendType" SG_ 404 ADC_CSM_HoldReq_B 1;
BA_ "GenSigStartValue" SG_ 404 ADC_CSM_HoldReq_B 0;
BA_ "GenSigTimeoutValue" SG_ 404 ADC_CSM_HoldReq_B 0;
BA_ "Remark" SG_ 404 ADC_CSM_HoldReq_B "";
BA_ "EventCommandSignal" SG_ 404 Reserved1 0;
BA_ "GatewayedSignals" SG_ 404 Reserved1 0;
BA_ "GenSigInactiveValue" SG_ 404 Reserved1 0;
BA_ "GenSigInvalidValue" SG_ 404 Reserved1 0;
BA_ "GenSigSendType" SG_ 404 Reserved1 1;
BA_ "GenSigStartValue" SG_ 404 Reserved1 0;
BA_ "GenSigTimeoutValue" SG_ 404 Reserved1 0;
BA_ "Remark" SG_ 404 Reserved1 "";
BA_ "EventCommandSignal" SG_ 361 ADC_4_B_CRC 0;
BA_ "GatewayedSignals" SG_ 361 ADC_4_B_CRC 0;
BA_ "GenSigInactiveValue" SG_ 361 ADC_4_B_CRC 0;
BA_ "GenSigInvalidValue" SG_ 361 ADC_4_B_CRC 0;
BA_ "GenSigSendType" SG_ 361 ADC_4_B_CRC 1;
BA_ "GenSigStartValue" SG_ 361 ADC_4_B_CRC 0;
BA_ "GenSigTimeoutValue" SG_ 361 ADC_4_B_CRC 0;
BA_ "Remark" SG_ 361 ADC_4_B_CRC "";
BA_ "EventCommandSignal" SG_ 361 ADC_4_B_Counter 0;
BA_ "GatewayedSignals" SG_ 361 ADC_4_B_Counter 0;
BA_ "GenSigInactiveValue" SG_ 361 ADC_4_B_Counter 0;
BA_ "GenSigInvalidValue" SG_ 361 ADC_4_B_Counter 0;
BA_ "GenSigSendType" SG_ 361 ADC_4_B_Counter 1;
BA_ "GenSigStartValue" SG_ 361 ADC_4_B_Counter 0;
BA_ "GenSigTimeoutValue" SG_ 361 ADC_4_B_Counter 0;
BA_ "Remark" SG_ 361 ADC_4_B_Counter "";
BA_ "EventCommandSignal" SG_ 361 ADC_AngReqFunction_B1 0;
BA_ "GatewayedSignals" SG_ 361 ADC_AngReqFunction_B1 0;
BA_ "GenSigInactiveValue" SG_ 361 ADC_AngReqFunction_B1 0;
BA_ "GenSigInvalidValue" SG_ 361 ADC_AngReqFunction_B1 0;
BA_ "GenSigSendType" SG_ 361 ADC_AngReqFunction_B1 1;
BA_ "GenSigStartValue" SG_ 361 ADC_AngReqFunction_B1 0;
BA_ "GenSigTimeoutValue" SG_ 361 ADC_AngReqFunction_B1 0;
BA_ "Remark" SG_ 361 ADC_AngReqFunction_B1 "";
BA_ "EventCommandSignal" SG_ 361 ADC_BrakeLightReq_B1 0;
BA_ "GatewayedSignals" SG_ 361 ADC_BrakeLightReq_B1 0;
BA_ "GenSigInactiveValue" SG_ 361 ADC_BrakeLightReq_B1 0;
BA_ "GenSigInvalidValue" SG_ 361 ADC_BrakeLightReq_B1 0;
BA_ "GenSigSendType" SG_ 361 ADC_BrakeLightReq_B1 1;
BA_ "GenSigStartValue" SG_ 361 ADC_BrakeLightReq_B1 0;
BA_ "GenSigTimeoutValue" SG_ 361 ADC_BrakeLightReq_B1 0;
BA_ "Remark" SG_ 361 ADC_BrakeLightReq_B1 "";
BA_ "EventCommandSignal" SG_ 361 ADC_AngReqSt_A_B1 0;
BA_ "GatewayedSignals" SG_ 361 ADC_AngReqSt_A_B1 0;
BA_ "GenSigInactiveValue" SG_ 361 ADC_AngReqSt_A_B1 0;
BA_ "GenSigInvalidValue" SG_ 361 ADC_AngReqSt_A_B1 0;
BA_ "GenSigSendType" SG_ 361 ADC_AngReqSt_A_B1 1;
BA_ "GenSigStartValue" SG_ 361 ADC_AngReqSt_A_B1 0;
BA_ "GenSigTimeoutValue" SG_ 361 ADC_AngReqSt_A_B1 0;
BA_ "Remark" SG_ 361 ADC_AngReqSt_A_B1 "";
BA_ "EventCommandSignal" SG_ 361 ADC_StrAngleReq_A_B1 0;
BA_ "GatewayedSignals" SG_ 361 ADC_StrAngleReq_A_B1 0;
BA_ "GenSigInactiveValue" SG_ 361 ADC_StrAngleReq_A_B1 0;
BA_ "GenSigInvalidValue" SG_ 361 ADC_StrAngleReq_A_B1 65535;
BA_ "GenSigSendType" SG_ 361 ADC_StrAngleReq_A_B1 1;
BA_ "GenSigStartValue" SG_ 361 ADC_StrAngleReq_A_B1 7800;
BA_ "GenSigTimeoutValue" SG_ 361 ADC_StrAngleReq_A_B1 65535;
BA_ "Remark" SG_ 361 ADC_StrAngleReq_A_B1 "";
BA_ "EventCommandSignal" SG_ 361 ADC_SACMotorTorLimExtMax_A_B1 0;
BA_ "GatewayedSignals" SG_ 361 ADC_SACMotorTorLimExtMax_A_B1 0;
BA_ "GenSigInactiveValue" SG_ 361 ADC_SACMotorTorLimExtMax_A_B1 0;
BA_ "GenSigInvalidValue" SG_ 361 ADC_SACMotorTorLimExtMax_A_B1 255;
BA_ "GenSigSendType" SG_ 361 ADC_SACMotorTorLimExtMax_A_B1 1;
BA_ "GenSigStartValue" SG_ 361 ADC_SACMotorTorLimExtMax_A_B1 254;
BA_ "GenSigTimeoutValue" SG_ 361 ADC_SACMotorTorLimExtMax_A_B1 255;
BA_ "Remark" SG_ 361 ADC_SACMotorTorLimExtMax_A_B1 "";
BA_ "EventCommandSignal" SG_ 361 ADC_SACMotorTorLimExtMin_A_B1 0;
BA_ "GatewayedSignals" SG_ 361 ADC_SACMotorTorLimExtMin_A_B1 0;
BA_ "GenSigInactiveValue" SG_ 361 ADC_SACMotorTorLimExtMin_A_B1 0;
BA_ "GenSigInvalidValue" SG_ 361 ADC_SACMotorTorLimExtMin_A_B1 255;
BA_ "GenSigSendType" SG_ 361 ADC_SACMotorTorLimExtMin_A_B1 1;
BA_ "GenSigStartValue" SG_ 361 ADC_SACMotorTorLimExtMin_A_B1 0;
BA_ "GenSigTimeoutValue" SG_ 361 ADC_SACMotorTorLimExtMin_A_B1 255;
BA_ "Remark" SG_ 361 ADC_SACMotorTorLimExtMin_A_B1 "";
BA_ "EventCommandSignal" SG_ 361 ADC_StrgWhlVibrWarnLevel_B1 0;
BA_ "GatewayedSignals" SG_ 361 ADC_StrgWhlVibrWarnLevel_B1 0;
BA_ "GenSigInactiveValue" SG_ 361 ADC_StrgWhlVibrWarnLevel_B1 0;
BA_ "GenSigInvalidValue" SG_ 361 ADC_StrgWhlVibrWarnLevel_B1 0;
BA_ "GenSigSendType" SG_ 361 ADC_StrgWhlVibrWarnLevel_B1 1;
BA_ "GenSigStartValue" SG_ 361 ADC_StrgWhlVibrWarnLevel_B1 0;
BA_ "GenSigTimeoutValue" SG_ 361 ADC_StrgWhlVibrWarnLevel_B1 0;
BA_ "Remark" SG_ 361 ADC_StrgWhlVibrWarnLevel_B1 "";
BA_ "EventCommandSignal" SG_ 361 ADC_SteerGainLevel_B1 0;
BA_ "GatewayedSignals" SG_ 361 ADC_SteerGainLevel_B1 0;
BA_ "GenSigInactiveValue" SG_ 361 ADC_SteerGainLevel_B1 0;
BA_ "GenSigInvalidValue" SG_ 361 ADC_SteerGainLevel_B1 255;
BA_ "GenSigSendType" SG_ 361 ADC_SteerGainLevel_B1 1;
BA_ "GenSigStartValue" SG_ 361 ADC_SteerGainLevel_B1 0;
BA_ "GenSigTimeoutValue" SG_ 361 ADC_SteerGainLevel_B1 100;
BA_ "Remark" SG_ 361 ADC_SteerGainLevel_B1 "";
BA_ "EventCommandSignal" SG_ 361 ADC_EvsSteerReq_B1 0;
BA_ "GatewayedSignals" SG_ 361 ADC_EvsSteerReq_B1 0;
BA_ "GenSigInactiveValue" SG_ 361 ADC_EvsSteerReq_B1 0;
BA_ "GenSigInvalidValue" SG_ 361 ADC_EvsSteerReq_B1 0;
BA_ "GenSigSendType" SG_ 361 ADC_EvsSteerReq_B1 1;
BA_ "GenSigStartValue" SG_ 361 ADC_EvsSteerReq_B1 0;
BA_ "GenSigTimeoutValue" SG_ 361 ADC_EvsSteerReq_B1 0;
BA_ "Remark" SG_ 361 ADC_EvsSteerReq_B1 "";
BA_ "EventCommandSignal" SG_ 361 ADC_StrgWhlVibrWarnReq_B1 0;
BA_ "GatewayedSignals" SG_ 361 ADC_StrgWhlVibrWarnReq_B1 0;
BA_ "GenSigInactiveValue" SG_ 361 ADC_StrgWhlVibrWarnReq_B1 0;
BA_ "GenSigInvalidValue" SG_ 361 ADC_StrgWhlVibrWarnReq_B1 0;
BA_ "GenSigSendType" SG_ 361 ADC_StrgWhlVibrWarnReq_B1 1;
BA_ "GenSigStartValue" SG_ 361 ADC_StrgWhlVibrWarnReq_B1 0;
BA_ "GenSigTimeoutValue" SG_ 361 ADC_StrgWhlVibrWarnReq_B1 0;
BA_ "Remark" SG_ 361 ADC_StrgWhlVibrWarnReq_B1 "";
BA_ "EventCommandSignal" SG_ 361 ADC_LongCtrlTypReq_B1 0;
BA_ "GatewayedSignals" SG_ 361 ADC_LongCtrlTypReq_B1 0;
BA_ "GenSigInactiveValue" SG_ 361 ADC_LongCtrlTypReq_B1 0;
BA_ "GenSigInvalidValue" SG_ 361 ADC_LongCtrlTypReq_B1 0;
BA_ "GenSigSendType" SG_ 361 ADC_LongCtrlTypReq_B1 1;
BA_ "GenSigStartValue" SG_ 361 ADC_LongCtrlTypReq_B1 0;
BA_ "GenSigTimeoutValue" SG_ 361 ADC_LongCtrlTypReq_B1 0;
BA_ "Remark" SG_ 361 ADC_LongCtrlTypReq_B1 "";
BA_ "EventCommandSignal" SG_ 361 ADC_ABAReq_B1 0;
BA_ "GatewayedSignals" SG_ 361 ADC_ABAReq_B1 0;
BA_ "GenSigInactiveValue" SG_ 361 ADC_ABAReq_B1 0;
BA_ "GenSigInvalidValue" SG_ 361 ADC_ABAReq_B1 0;
BA_ "GenSigSendType" SG_ 361 ADC_ABAReq_B1 1;
BA_ "GenSigStartValue" SG_ 361 ADC_ABAReq_B1 0;
BA_ "GenSigTimeoutValue" SG_ 361 ADC_ABAReq_B1 0;
BA_ "Remark" SG_ 361 ADC_ABAReq_B1 "";
BA_ "EventCommandSignal" SG_ 361 ADC_ABALevel_B1 0;
BA_ "GatewayedSignals" SG_ 361 ADC_ABALevel_B1 0;
BA_ "GenSigInactiveValue" SG_ 361 ADC_ABALevel_B1 0;
BA_ "GenSigInvalidValue" SG_ 361 ADC_ABALevel_B1 0;
BA_ "GenSigSendType" SG_ 361 ADC_ABALevel_B1 1;
BA_ "GenSigStartValue" SG_ 361 ADC_ABALevel_B1 0;
BA_ "GenSigTimeoutValue" SG_ 361 ADC_ABALevel_B1 0;
BA_ "Remark" SG_ 361 ADC_ABALevel_B1 "";
BA_ "EventCommandSignal" SG_ 361 ADC_AWBReq_B1 0;
BA_ "GatewayedSignals" SG_ 361 ADC_AWBReq_B1 0;
BA_ "GenSigInactiveValue" SG_ 361 ADC_AWBReq_B1 0;
BA_ "GenSigInvalidValue" SG_ 361 ADC_AWBReq_B1 0;
BA_ "GenSigSendType" SG_ 361 ADC_AWBReq_B1 1;
BA_ "GenSigStartValue" SG_ 361 ADC_AWBReq_B1 0;
BA_ "GenSigTimeoutValue" SG_ 361 ADC_AWBReq_B1 0;
BA_ "Remark" SG_ 361 ADC_AWBReq_B1 "";
BA_ "EventCommandSignal" SG_ 361 ADC_ABPReq_B1 0;
BA_ "GatewayedSignals" SG_ 361 ADC_ABPReq_B1 0;
BA_ "GenSigInactiveValue" SG_ 361 ADC_ABPReq_B1 0;
BA_ "GenSigInvalidValue" SG_ 361 ADC_ABPReq_B1 0;
BA_ "GenSigSendType" SG_ 361 ADC_ABPReq_B1 1;
BA_ "GenSigStartValue" SG_ 361 ADC_ABPReq_B1 0;
BA_ "GenSigTimeoutValue" SG_ 361 ADC_ABPReq_B1 0;
BA_ "Remark" SG_ 361 ADC_ABPReq_B1 "";
BA_ "EventCommandSignal" SG_ 361 ADC_AWBLevel_B1 0;
BA_ "GatewayedSignals" SG_ 361 ADC_AWBLevel_B1 0;
BA_ "GenSigInactiveValue" SG_ 361 ADC_AWBLevel_B1 0;
BA_ "GenSigInvalidValue" SG_ 361 ADC_AWBLevel_B1 0;
BA_ "GenSigSendType" SG_ 361 ADC_AWBLevel_B1 1;
BA_ "GenSigStartValue" SG_ 361 ADC_AWBLevel_B1 0;
BA_ "GenSigTimeoutValue" SG_ 361 ADC_AWBLevel_B1 0;
BA_ "Remark" SG_ 361 ADC_AWBLevel_B1 "";
BA_ "EventCommandSignal" SG_ 361 ADC_EpbModReq_B1 0;
BA_ "GatewayedSignals" SG_ 361 ADC_EpbModReq_B1 0;
BA_ "GenSigInactiveValue" SG_ 361 ADC_EpbModReq_B1 0;
BA_ "GenSigInvalidValue" SG_ 361 ADC_EpbModReq_B1 0;
BA_ "GenSigSendType" SG_ 361 ADC_EpbModReq_B1 1;
BA_ "GenSigStartValue" SG_ 361 ADC_EpbModReq_B1 0;
BA_ "GenSigTimeoutValue" SG_ 361 ADC_EpbModReq_B1 0;
BA_ "Remark" SG_ 361 ADC_EpbModReq_B1 "";
BA_ "EventCommandSignal" SG_ 361 ADC_EpbModReqEna_B1 0;
BA_ "GatewayedSignals" SG_ 361 ADC_EpbModReqEna_B1 0;
BA_ "GenSigInactiveValue" SG_ 361 ADC_EpbModReqEna_B1 0;
BA_ "GenSigInvalidValue" SG_ 361 ADC_EpbModReqEna_B1 0;
BA_ "GenSigSendType" SG_ 361 ADC_EpbModReqEna_B1 1;
BA_ "GenSigStartValue" SG_ 361 ADC_EpbModReqEna_B1 0;
BA_ "GenSigTimeoutValue" SG_ 361 ADC_EpbModReqEna_B1 0;
BA_ "Remark" SG_ 361 ADC_EpbModReqEna_B1 "";
BA_ "EventCommandSignal" SG_ 361 ADC_BrkTarTqEna_B1 0;
BA_ "GatewayedSignals" SG_ 361 ADC_BrkTarTqEna_B1 0;
BA_ "GenSigInactiveValue" SG_ 361 ADC_BrkTarTqEna_B1 0;
BA_ "GenSigInvalidValue" SG_ 361 ADC_BrkTarTqEna_B1 0;
BA_ "GenSigSendType" SG_ 361 ADC_BrkTarTqEna_B1 1;
BA_ "GenSigStartValue" SG_ 361 ADC_BrkTarTqEna_B1 0;
BA_ "GenSigTimeoutValue" SG_ 361 ADC_BrkTarTqEna_B1 0;
BA_ "Remark" SG_ 361 ADC_BrkTarTqEna_B1 "";
BA_ "EventCommandSignal" SG_ 361 ADC_BrkTarTqMod_B1 0;
BA_ "GatewayedSignals" SG_ 361 ADC_BrkTarTqMod_B1 0;
BA_ "GenSigInactiveValue" SG_ 361 ADC_BrkTarTqMod_B1 0;
BA_ "GenSigInvalidValue" SG_ 361 ADC_BrkTarTqMod_B1 0;
BA_ "GenSigSendType" SG_ 361 ADC_BrkTarTqMod_B1 1;
BA_ "GenSigStartValue" SG_ 361 ADC_BrkTarTqMod_B1 0;
BA_ "GenSigTimeoutValue" SG_ 361 ADC_BrkTarTqMod_B1 0;
BA_ "Remark" SG_ 361 ADC_BrkTarTqMod_B1 "";
BA_ "EventCommandSignal" SG_ 361 ADC_AebBrkTarTq_B1 0;
BA_ "GatewayedSignals" SG_ 361 ADC_AebBrkTarTq_B1 0;
BA_ "GenSigInactiveValue" SG_ 361 ADC_AebBrkTarTq_B1 0;
BA_ "GenSigInvalidValue" SG_ 361 ADC_AebBrkTarTq_B1 0;
BA_ "GenSigSendType" SG_ 361 ADC_AebBrkTarTq_B1 1;
BA_ "GenSigStartValue" SG_ 361 ADC_AebBrkTarTq_B1 0;
BA_ "GenSigTimeoutValue" SG_ 361 ADC_AebBrkTarTq_B1 0;
BA_ "Remark" SG_ 361 ADC_AebBrkTarTq_B1 "";
BA_ "EventCommandSignal" SG_ 361 ADC_EpbModReqVld_B1 0;
BA_ "GatewayedSignals" SG_ 361 ADC_EpbModReqVld_B1 0;
BA_ "GenSigInactiveValue" SG_ 361 ADC_EpbModReqVld_B1 0;
BA_ "GenSigInvalidValue" SG_ 361 ADC_EpbModReqVld_B1 0;
BA_ "GenSigSendType" SG_ 361 ADC_EpbModReqVld_B1 1;
BA_ "GenSigStartValue" SG_ 361 ADC_EpbModReqVld_B1 0;
BA_ "GenSigTimeoutValue" SG_ 361 ADC_EpbModReqVld_B1 0;
BA_ "Remark" SG_ 361 ADC_EpbModReqVld_B1 "";
BA_ "EventCommandSignal" SG_ 361 ADC_RWUEna_B1 0;
BA_ "GatewayedSignals" SG_ 361 ADC_RWUEna_B1 0;
BA_ "GenSigInactiveValue" SG_ 361 ADC_RWUEna_B1 0;
BA_ "GenSigInvalidValue" SG_ 361 ADC_RWUEna_B1 0;
BA_ "GenSigSendType" SG_ 361 ADC_RWUEna_B1 1;
BA_ "GenSigStartValue" SG_ 361 ADC_RWUEna_B1 0;
BA_ "GenSigTimeoutValue" SG_ 361 ADC_RWUEna_B1 0;
BA_ "Remark" SG_ 361 ADC_RWUEna_B1 "";
BA_ "EventCommandSignal" SG_ 361 ADC_BrkHoldReq_B1 0;
BA_ "GatewayedSignals" SG_ 361 ADC_BrkHoldReq_B1 0;
BA_ "GenSigInactiveValue" SG_ 361 ADC_BrkHoldReq_B1 0;
BA_ "GenSigInvalidValue" SG_ 361 ADC_BrkHoldReq_B1 0;
BA_ "GenSigSendType" SG_ 361 ADC_BrkHoldReq_B1 1;
BA_ "GenSigStartValue" SG_ 361 ADC_BrkHoldReq_B1 0;
BA_ "GenSigTimeoutValue" SG_ 361 ADC_BrkHoldReq_B1 0;
BA_ "Remark" SG_ 361 ADC_BrkHoldReq_B1 "";
BA_ "EventCommandSignal" SG_ 361 ADC_AngReqAvl_B1 0;
BA_ "GatewayedSignals" SG_ 361 ADC_AngReqAvl_B1 0;
BA_ "GenSigInactiveValue" SG_ 361 ADC_AngReqAvl_B1 0;
BA_ "GenSigInvalidValue" SG_ 361 ADC_AngReqAvl_B1 0;
BA_ "GenSigSendType" SG_ 361 ADC_AngReqAvl_B1 1;
BA_ "GenSigStartValue" SG_ 361 ADC_AngReqAvl_B1 0;
BA_ "GenSigTimeoutValue" SG_ 361 ADC_AngReqAvl_B1 0;
BA_ "Remark" SG_ 361 ADC_AngReqAvl_B1 "";
BA_ "EventCommandSignal" SG_ 361 ADC_BrkTarTqVld_B1 0;
BA_ "GatewayedSignals" SG_ 361 ADC_BrkTarTqVld_B1 0;
BA_ "GenSigInactiveValue" SG_ 361 ADC_BrkTarTqVld_B1 0;
BA_ "GenSigInvalidValue" SG_ 361 ADC_BrkTarTqVld_B1 0;
BA_ "GenSigSendType" SG_ 361 ADC_BrkTarTqVld_B1 1;
BA_ "GenSigStartValue" SG_ 361 ADC_BrkTarTqVld_B1 0;
BA_ "GenSigTimeoutValue" SG_ 361 ADC_BrkTarTqVld_B1 0;
BA_ "Remark" SG_ 361 ADC_BrkTarTqVld_B1 "";
BA_ "EventCommandSignal" SG_ 361 ADC_AebBrkTarTqVld_B1 0;
BA_ "GatewayedSignals" SG_ 361 ADC_AebBrkTarTqVld_B1 0;
BA_ "GenSigInactiveValue" SG_ 361 ADC_AebBrkTarTqVld_B1 0;
BA_ "GenSigInvalidValue" SG_ 361 ADC_AebBrkTarTqVld_B1 0;
BA_ "GenSigSendType" SG_ 361 ADC_AebBrkTarTqVld_B1 1;
BA_ "GenSigStartValue" SG_ 361 ADC_AebBrkTarTqVld_B1 0;
BA_ "GenSigTimeoutValue" SG_ 361 ADC_AebBrkTarTqVld_B1 0;
BA_ "Remark" SG_ 361 ADC_AebBrkTarTqVld_B1 "";
BA_ "EventCommandSignal" SG_ 361 ADC_AebBrkTarTqEna_B1 0;
BA_ "GatewayedSignals" SG_ 361 ADC_AebBrkTarTqEna_B1 0;
BA_ "GenSigInactiveValue" SG_ 361 ADC_AebBrkTarTqEna_B1 0;
BA_ "GenSigInvalidValue" SG_ 361 ADC_AebBrkTarTqEna_B1 0;
BA_ "GenSigSendType" SG_ 361 ADC_AebBrkTarTqEna_B1 1;
BA_ "GenSigStartValue" SG_ 361 ADC_AebBrkTarTqEna_B1 0;
BA_ "GenSigTimeoutValue" SG_ 361 ADC_AebBrkTarTqEna_B1 0;
BA_ "Remark" SG_ 361 ADC_AebBrkTarTqEna_B1 "";
BA_ "EventCommandSignal" SG_ 361 ADC_ElecBrkFnSwitch_B1 0;
BA_ "GatewayedSignals" SG_ 361 ADC_ElecBrkFnSwitch_B1 0;
BA_ "GenSigInactiveValue" SG_ 361 ADC_ElecBrkFnSwitch_B1 0;
BA_ "GenSigInvalidValue" SG_ 361 ADC_ElecBrkFnSwitch_B1 0;
BA_ "GenSigSendType" SG_ 361 ADC_ElecBrkFnSwitch_B1 1;
BA_ "GenSigStartValue" SG_ 361 ADC_ElecBrkFnSwitch_B1 0;
BA_ "GenSigTimeoutValue" SG_ 361 ADC_ElecBrkFnSwitch_B1 0;
BA_ "Remark" SG_ 361 ADC_ElecBrkFnSwitch_B1 "";
BA_ "EventCommandSignal" SG_ 361 ADC_RWUVld_B1 0;
BA_ "GatewayedSignals" SG_ 361 ADC_RWUVld_B1 0;
BA_ "GenSigInactiveValue" SG_ 361 ADC_RWUVld_B1 0;
BA_ "GenSigInvalidValue" SG_ 361 ADC_RWUVld_B1 0;
BA_ "GenSigSendType" SG_ 361 ADC_RWUVld_B1 1;
BA_ "GenSigStartValue" SG_ 361 ADC_RWUVld_B1 0;
BA_ "GenSigTimeoutValue" SG_ 361 ADC_RWUVld_B1 0;
BA_ "Remark" SG_ 361 ADC_RWUVld_B1 "";
BA_ "EventCommandSignal" SG_ 361 ADC_DriverPresent_B1 0;
BA_ "GatewayedSignals" SG_ 361 ADC_DriverPresent_B1 0;
BA_ "GenSigInactiveValue" SG_ 361 ADC_DriverPresent_B1 0;
BA_ "GenSigInvalidValue" SG_ 361 ADC_DriverPresent_B1 0;
BA_ "GenSigSendType" SG_ 361 ADC_DriverPresent_B1 1;
BA_ "GenSigStartValue" SG_ 361 ADC_DriverPresent_B1 0;
BA_ "GenSigTimeoutValue" SG_ 361 ADC_DriverPresent_B1 0;
BA_ "Remark" SG_ 361 ADC_DriverPresent_B1 "";
BA_ "EventCommandSignal" SG_ 361 ADC_BrkTarTq_B1 0;
BA_ "GatewayedSignals" SG_ 361 ADC_BrkTarTq_B1 0;
BA_ "GenSigInactiveValue" SG_ 361 ADC_BrkTarTq_B1 0;
BA_ "GenSigInvalidValue" SG_ 361 ADC_BrkTarTq_B1 0;
BA_ "GenSigSendType" SG_ 361 ADC_BrkTarTq_B1 1;
BA_ "GenSigStartValue" SG_ 361 ADC_BrkTarTq_B1 0;
BA_ "GenSigTimeoutValue" SG_ 361 ADC_BrkTarTq_B1 0;
BA_ "Remark" SG_ 361 ADC_BrkTarTq_B1 "";
BA_ "EventCommandSignal" SG_ 361 ADC_AssistParaSwitchReq_B1 0;
BA_ "GatewayedSignals" SG_ 361 ADC_AssistParaSwitchReq_B1 0;
BA_ "GenSigInactiveValue" SG_ 361 ADC_AssistParaSwitchReq_B1 0;
BA_ "GenSigInvalidValue" SG_ 361 ADC_AssistParaSwitchReq_B1 0;
BA_ "GenSigSendType" SG_ 361 ADC_AssistParaSwitchReq_B1 1;
BA_ "GenSigStartValue" SG_ 361 ADC_AssistParaSwitchReq_B1 0;
BA_ "GenSigTimeoutValue" SG_ 361 ADC_AssistParaSwitchReq_B1 0;
BA_ "Remark" SG_ 361 ADC_AssistParaSwitchReq_B1 "";
BA_ "EventCommandSignal" SG_ 361 ADC_AngReqRdntReq_A_B1 0;
BA_ "GatewayedSignals" SG_ 361 ADC_AngReqRdntReq_A_B1 0;
BA_ "GenSigInactiveValue" SG_ 361 ADC_AngReqRdntReq_A_B1 0;
BA_ "GenSigInvalidValue" SG_ 361 ADC_AngReqRdntReq_A_B1 0;
BA_ "GenSigSendType" SG_ 361 ADC_AngReqRdntReq_A_B1 1;
BA_ "GenSigStartValue" SG_ 361 ADC_AngReqRdntReq_A_B1 0;
BA_ "GenSigTimeoutValue" SG_ 361 ADC_AngReqRdntReq_A_B1 0;
BA_ "Remark" SG_ 361 ADC_AngReqRdntReq_A_B1 "";
BA_ "EventCommandSignal" SG_ 361 ADC_SteerGainReq_B1 0;
BA_ "GatewayedSignals" SG_ 361 ADC_SteerGainReq_B1 0;
BA_ "GenSigInactiveValue" SG_ 361 ADC_SteerGainReq_B1 0;
BA_ "GenSigInvalidValue" SG_ 361 ADC_SteerGainReq_B1 0;
BA_ "GenSigSendType" SG_ 361 ADC_SteerGainReq_B1 1;
BA_ "GenSigStartValue" SG_ 361 ADC_SteerGainReq_B1 0;
BA_ "GenSigTimeoutValue" SG_ 361 ADC_SteerGainReq_B1 0;
BA_ "Remark" SG_ 361 ADC_SteerGainReq_B1 "";
BA_ "EventCommandSignal" SG_ 361 ADC_ActTrqReqEnable_B1 0;
BA_ "GatewayedSignals" SG_ 361 ADC_ActTrqReqEnable_B1 0;
BA_ "GenSigInactiveValue" SG_ 361 ADC_ActTrqReqEnable_B1 0;
BA_ "GenSigInvalidValue" SG_ 361 ADC_ActTrqReqEnable_B1 0;
BA_ "GenSigSendType" SG_ 361 ADC_ActTrqReqEnable_B1 1;
BA_ "GenSigStartValue" SG_ 361 ADC_ActTrqReqEnable_B1 0;
BA_ "GenSigTimeoutValue" SG_ 361 ADC_ActTrqReqEnable_B1 0;
BA_ "Remark" SG_ 361 ADC_ActTrqReqEnable_B1 "";
BA_ "EventCommandSignal" SG_ 361 ADC_VLCSt_B1 0;
BA_ "GatewayedSignals" SG_ 361 ADC_VLCSt_B1 0;
BA_ "GenSigInactiveValue" SG_ 361 ADC_VLCSt_B1 0;
BA_ "GenSigInvalidValue" SG_ 361 ADC_VLCSt_B1 0;
BA_ "GenSigSendType" SG_ 361 ADC_VLCSt_B1 1;
BA_ "GenSigStartValue" SG_ 361 ADC_VLCSt_B1 0;
BA_ "GenSigTimeoutValue" SG_ 361 ADC_VLCSt_B1 0;
BA_ "Remark" SG_ 361 ADC_VLCSt_B1 "";
BA_ "EventCommandSignal" SG_ 361 ADC_ActTrqReq_B1 0;
BA_ "GatewayedSignals" SG_ 361 ADC_ActTrqReq_B1 0;
BA_ "GenSigInactiveValue" SG_ 361 ADC_ActTrqReq_B1 0;
BA_ "GenSigInvalidValue" SG_ 361 ADC_ActTrqReq_B1 0;
BA_ "GenSigSendType" SG_ 361 ADC_ActTrqReq_B1 1;
BA_ "GenSigStartValue" SG_ 361 ADC_ActTrqReq_B1 0;
BA_ "GenSigTimeoutValue" SG_ 361 ADC_ActTrqReq_B1 0;
BA_ "Remark" SG_ 361 ADC_ActTrqReq_B1 "";
BA_ "EventCommandSignal" SG_ 361 ADC_ADASLongCtrlFuncMode_B1 0;
BA_ "GatewayedSignals" SG_ 361 ADC_ADASLongCtrlFuncMode_B1 0;
BA_ "GenSigInactiveValue" SG_ 361 ADC_ADASLongCtrlFuncMode_B1 0;
BA_ "GenSigInvalidValue" SG_ 361 ADC_ADASLongCtrlFuncMode_B1 0;
BA_ "GenSigSendType" SG_ 361 ADC_ADASLongCtrlFuncMode_B1 1;
BA_ "GenSigStartValue" SG_ 361 ADC_ADASLongCtrlFuncMode_B1 0;
BA_ "GenSigTimeoutValue" SG_ 361 ADC_ADASLongCtrlFuncMode_B1 0;
BA_ "Remark" SG_ 361 ADC_ADASLongCtrlFuncMode_B1 "";
BA_ "EventCommandSignal" SG_ 361 ADC_LongCtrlAvailability_B1 0;
BA_ "GatewayedSignals" SG_ 361 ADC_LongCtrlAvailability_B1 0;
BA_ "GenSigInactiveValue" SG_ 361 ADC_LongCtrlAvailability_B1 0;
BA_ "GenSigInvalidValue" SG_ 361 ADC_LongCtrlAvailability_B1 0;
BA_ "GenSigSendType" SG_ 361 ADC_LongCtrlAvailability_B1 1;
BA_ "GenSigStartValue" SG_ 361 ADC_LongCtrlAvailability_B1 0;
BA_ "GenSigTimeoutValue" SG_ 361 ADC_LongCtrlAvailability_B1 0;
BA_ "Remark" SG_ 361 ADC_LongCtrlAvailability_B1 "";
BA_ "EventCommandSignal" SG_ 361 ADC_LongCtrlModeForBrkSys_B1 0;
BA_ "GatewayedSignals" SG_ 361 ADC_LongCtrlModeForBrkSys_B1 0;
BA_ "GenSigInactiveValue" SG_ 361 ADC_LongCtrlModeForBrkSys_B1 0;
BA_ "GenSigInvalidValue" SG_ 361 ADC_LongCtrlModeForBrkSys_B1 0;
BA_ "GenSigSendType" SG_ 361 ADC_LongCtrlModeForBrkSys_B1 1;
BA_ "GenSigStartValue" SG_ 361 ADC_LongCtrlModeForBrkSys_B1 0;
BA_ "GenSigTimeoutValue" SG_ 361 ADC_LongCtrlModeForBrkSys_B1 0;
BA_ "Remark" SG_ 361 ADC_LongCtrlModeForBrkSys_B1 "";
BA_ "EventCommandSignal" SG_ 361 ADC_LongCtrlTargetAxReq_B1 0;
BA_ "GatewayedSignals" SG_ 361 ADC_LongCtrlTargetAxReq_B1 0;
BA_ "GenSigInactiveValue" SG_ 361 ADC_LongCtrlTargetAxReq_B1 0;
BA_ "GenSigInvalidValue" SG_ 361 ADC_LongCtrlTargetAxReq_B1 0;
BA_ "GenSigSendType" SG_ 361 ADC_LongCtrlTargetAxReq_B1 1;
BA_ "GenSigStartValue" SG_ 361 ADC_LongCtrlTargetAxReq_B1 0;
BA_ "GenSigTimeoutValue" SG_ 361 ADC_LongCtrlTargetAxReq_B1 0;
BA_ "Remark" SG_ 361 ADC_LongCtrlTargetAxReq_B1 "";
BA_ "EventCommandSignal" SG_ 361 ADC_LongCtrlDecToStopReq_B1 0;
BA_ "GatewayedSignals" SG_ 361 ADC_LongCtrlDecToStopReq_B1 0;
BA_ "GenSigInactiveValue" SG_ 361 ADC_LongCtrlDecToStopReq_B1 0;
BA_ "GenSigInvalidValue" SG_ 361 ADC_LongCtrlDecToStopReq_B1 0;
BA_ "GenSigSendType" SG_ 361 ADC_LongCtrlDecToStopReq_B1 1;
BA_ "GenSigStartValue" SG_ 361 ADC_LongCtrlDecToStopReq_B1 0;
BA_ "GenSigTimeoutValue" SG_ 361 ADC_LongCtrlDecToStopReq_B1 0;
BA_ "Remark" SG_ 361 ADC_LongCtrlDecToStopReq_B1 "";
BA_ "EventCommandSignal" SG_ 361 ADC_LongCtrlDriveOff_B1 0;
BA_ "GatewayedSignals" SG_ 361 ADC_LongCtrlDriveOff_B1 0;
BA_ "GenSigInactiveValue" SG_ 361 ADC_LongCtrlDriveOff_B1 0;
BA_ "GenSigInvalidValue" SG_ 361 ADC_LongCtrlDriveOff_B1 0;
BA_ "GenSigSendType" SG_ 361 ADC_LongCtrlDriveOff_B1 1;
BA_ "GenSigStartValue" SG_ 361 ADC_LongCtrlDriveOff_B1 0;
BA_ "GenSigTimeoutValue" SG_ 361 ADC_LongCtrlDriveOff_B1 0;
BA_ "Remark" SG_ 361 ADC_LongCtrlDriveOff_B1 "";
BA_ "EventCommandSignal" SG_ 361 ADC_LongctrlSecureReq_B1 0;
BA_ "GatewayedSignals" SG_ 361 ADC_LongctrlSecureReq_B1 0;
BA_ "GenSigInactiveValue" SG_ 361 ADC_LongctrlSecureReq_B1 0;
BA_ "GenSigInvalidValue" SG_ 361 ADC_LongctrlSecureReq_B1 0;
BA_ "GenSigSendType" SG_ 361 ADC_LongctrlSecureReq_B1 1;
BA_ "GenSigStartValue" SG_ 361 ADC_LongctrlSecureReq_B1 0;
BA_ "GenSigTimeoutValue" SG_ 361 ADC_LongctrlSecureReq_B1 0;
BA_ "Remark" SG_ 361 ADC_LongctrlSecureReq_B1 "";
BA_ "EventCommandSignal" SG_ 361 ADC_ShifttoAVHReq_B1 0;
BA_ "GatewayedSignals" SG_ 361 ADC_ShifttoAVHReq_B1 0;
BA_ "GenSigInactiveValue" SG_ 361 ADC_ShifttoAVHReq_B1 0;
BA_ "GenSigInvalidValue" SG_ 361 ADC_ShifttoAVHReq_B1 0;
BA_ "GenSigSendType" SG_ 361 ADC_ShifttoAVHReq_B1 1;
BA_ "GenSigStartValue" SG_ 361 ADC_ShifttoAVHReq_B1 0;
BA_ "GenSigTimeoutValue" SG_ 361 ADC_ShifttoAVHReq_B1 0;
BA_ "Remark" SG_ 361 ADC_ShifttoAVHReq_B1 "";
BA_ "EventCommandSignal" SG_ 361 ADC_LongCtrlTargetAx_B1 0;
BA_ "GatewayedSignals" SG_ 361 ADC_LongCtrlTargetAx_B1 0;
BA_ "GenSigInactiveValue" SG_ 361 ADC_LongCtrlTargetAx_B1 0;
BA_ "GenSigInvalidValue" SG_ 361 ADC_LongCtrlTargetAx_B1 0;
BA_ "GenSigSendType" SG_ 361 ADC_LongCtrlTargetAx_B1 1;
BA_ "GenSigStartValue" SG_ 361 ADC_LongCtrlTargetAx_B1 0;
BA_ "GenSigTimeoutValue" SG_ 361 ADC_LongCtrlTargetAx_B1 0;
BA_ "Remark" SG_ 361 ADC_LongCtrlTargetAx_B1 "";
BA_ "EventCommandSignal" SG_ 361 ADC_TrkTargt0St_B1 0;
BA_ "GatewayedSignals" SG_ 361 ADC_TrkTargt0St_B1 0;
BA_ "GenSigInactiveValue" SG_ 361 ADC_TrkTargt0St_B1 0;
BA_ "GenSigInvalidValue" SG_ 361 ADC_TrkTargt0St_B1 0;
BA_ "GenSigSendType" SG_ 361 ADC_TrkTargt0St_B1 1;
BA_ "GenSigStartValue" SG_ 361 ADC_TrkTargt0St_B1 0;
BA_ "GenSigTimeoutValue" SG_ 361 ADC_TrkTargt0St_B1 0;
BA_ "Remark" SG_ 361 ADC_TrkTargt0St_B1 "";
BA_ "EventCommandSignal" SG_ 361 ADC_TrkTargt0longPos_B1 0;
BA_ "GatewayedSignals" SG_ 361 ADC_TrkTargt0longPos_B1 0;
BA_ "GenSigInactiveValue" SG_ 361 ADC_TrkTargt0longPos_B1 0;
BA_ "GenSigInvalidValue" SG_ 361 ADC_TrkTargt0longPos_B1 1023;
BA_ "GenSigSendType" SG_ 361 ADC_TrkTargt0longPos_B1 1;
BA_ "GenSigStartValue" SG_ 361 ADC_TrkTargt0longPos_B1 0;
BA_ "GenSigTimeoutValue" SG_ 361 ADC_TrkTargt0longPos_B1 0;
BA_ "Remark" SG_ 361 ADC_TrkTargt0longPos_B1 "";
BA_ "EventCommandSignal" SG_ 361 ADC_TrkTargt0latPos_B1 0;
BA_ "GatewayedSignals" SG_ 361 ADC_TrkTargt0latPos_B1 0;
BA_ "GenSigInactiveValue" SG_ 361 ADC_TrkTargt0latPos_B1 0;
BA_ "GenSigInvalidValue" SG_ 361 ADC_TrkTargt0latPos_B1 0;
BA_ "GenSigSendType" SG_ 361 ADC_TrkTargt0latPos_B1 1;
BA_ "GenSigStartValue" SG_ 361 ADC_TrkTargt0latPos_B1 512;
BA_ "GenSigTimeoutValue" SG_ 361 ADC_TrkTargt0latPos_B1 0;
BA_ "Remark" SG_ 361 ADC_TrkTargt0latPos_B1 "";
BA_ "EventCommandSignal" SG_ 361 ADC_TrkTargt0LatRelSpd_B1 0;
BA_ "GatewayedSignals" SG_ 361 ADC_TrkTargt0LatRelSpd_B1 0;
BA_ "GenSigInactiveValue" SG_ 361 ADC_TrkTargt0LatRelSpd_B1 0;
BA_ "GenSigInvalidValue" SG_ 361 ADC_TrkTargt0LatRelSpd_B1 511;
BA_ "GenSigSendType" SG_ 361 ADC_TrkTargt0LatRelSpd_B1 1;
BA_ "GenSigStartValue" SG_ 361 ADC_TrkTargt0LatRelSpd_B1 0;
BA_ "GenSigTimeoutValue" SG_ 361 ADC_TrkTargt0LatRelSpd_B1 0;
BA_ "Remark" SG_ 361 ADC_TrkTargt0LatRelSpd_B1 "";
BA_ "EventCommandSignal" SG_ 361 ADC_TrkTargt0LongRelSpd_B1 0;
BA_ "GatewayedSignals" SG_ 361 ADC_TrkTargt0LongRelSpd_B1 0;
BA_ "GenSigInactiveValue" SG_ 361 ADC_TrkTargt0LongRelSpd_B1 0;
BA_ "GenSigInvalidValue" SG_ 361 ADC_TrkTargt0LongRelSpd_B1 0;
BA_ "GenSigSendType" SG_ 361 ADC_TrkTargt0LongRelSpd_B1 1;
BA_ "GenSigStartValue" SG_ 361 ADC_TrkTargt0LongRelSpd_B1 0;
BA_ "GenSigTimeoutValue" SG_ 361 ADC_TrkTargt0LongRelSpd_B1 0;
BA_ "Remark" SG_ 361 ADC_TrkTargt0LongRelSpd_B1 "";
BA_ "EventCommandSignal" SG_ 361 ADC_AS_pauseReq_B1 0;
BA_ "GatewayedSignals" SG_ 361 ADC_AS_pauseReq_B1 0;
BA_ "GenSigInactiveValue" SG_ 361 ADC_AS_pauseReq_B1 0;
BA_ "GenSigInvalidValue" SG_ 361 ADC_AS_pauseReq_B1 0;
BA_ "GenSigSendType" SG_ 361 ADC_AS_pauseReq_B1 1;
BA_ "GenSigStartValue" SG_ 361 ADC_AS_pauseReq_B1 0;
BA_ "GenSigTimeoutValue" SG_ 361 ADC_AS_pauseReq_B1 0;
BA_ "Remark" SG_ 361 ADC_AS_pauseReq_B1 "";
BA_ "EventCommandSignal" SG_ 361 ADC_AS_calibrationReq_B1 0;
BA_ "GatewayedSignals" SG_ 361 ADC_AS_calibrationReq_B1 0;
BA_ "GenSigInactiveValue" SG_ 361 ADC_AS_calibrationReq_B1 0;
BA_ "GenSigInvalidValue" SG_ 361 ADC_AS_calibrationReq_B1 0;
BA_ "GenSigSendType" SG_ 361 ADC_AS_calibrationReq_B1 1;
BA_ "GenSigStartValue" SG_ 361 ADC_AS_calibrationReq_B1 0;
BA_ "GenSigTimeoutValue" SG_ 361 ADC_AS_calibrationReq_B1 0;
BA_ "Remark" SG_ 361 ADC_AS_calibrationReq_B1 "";
BA_ "EventCommandSignal" SG_ 361 ADC_AS_exitcurrentlevelReq_B1 0;
BA_ "GatewayedSignals" SG_ 361 ADC_AS_exitcurrentlevelReq_B1 0;
BA_ "GenSigInactiveValue" SG_ 361 ADC_AS_exitcurrentlevelReq_B1 0;
BA_ "GenSigInvalidValue" SG_ 361 ADC_AS_exitcurrentlevelReq_B1 0;
BA_ "GenSigSendType" SG_ 361 ADC_AS_exitcurrentlevelReq_B1 1;
BA_ "GenSigStartValue" SG_ 361 ADC_AS_exitcurrentlevelReq_B1 0;
BA_ "GenSigTimeoutValue" SG_ 361 ADC_AS_exitcurrentlevelReq_B1 0;
BA_ "Remark" SG_ 361 ADC_AS_exitcurrentlevelReq_B1 "";
BA_ "EventCommandSignal" SG_ 361 ADC_AS_ReqToadjust_B1 0;
BA_ "GatewayedSignals" SG_ 361 ADC_AS_ReqToadjust_B1 0;
BA_ "GenSigInactiveValue" SG_ 361 ADC_AS_ReqToadjust_B1 0;
BA_ "GenSigInvalidValue" SG_ 361 ADC_AS_ReqToadjust_B1 0;
BA_ "GenSigSendType" SG_ 361 ADC_AS_ReqToadjust_B1 1;
BA_ "GenSigStartValue" SG_ 361 ADC_AS_ReqToadjust_B1 0;
BA_ "GenSigTimeoutValue" SG_ 361 ADC_AS_ReqToadjust_B1 0;
BA_ "Remark" SG_ 361 ADC_AS_ReqToadjust_B1 "";
BA_ "EventCommandSignal" SG_ 361 ADC_ASActiveSt_B 0;
BA_ "GatewayedSignals" SG_ 361 ADC_ASActiveSt_B 0;
BA_ "GenSigInactiveValue" SG_ 361 ADC_ASActiveSt_B 0;
BA_ "GenSigInvalidValue" SG_ 361 ADC_ASActiveSt_B 0;
BA_ "GenSigSendType" SG_ 361 ADC_ASActiveSt_B 1;
BA_ "GenSigStartValue" SG_ 361 ADC_ASActiveSt_B 0;
BA_ "GenSigTimeoutValue" SG_ 361 ADC_ASActiveSt_B 0;
BA_ "Remark" SG_ 361 ADC_ASActiveSt_B "";
BA_ "EventCommandSignal" SG_ 361 ADC_AS_UnsafelevelunableReq_B1 0;
BA_ "GatewayedSignals" SG_ 361 ADC_AS_UnsafelevelunableReq_B1 0;
BA_ "GenSigInactiveValue" SG_ 361 ADC_AS_UnsafelevelunableReq_B1 0;
BA_ "GenSigInvalidValue" SG_ 361 ADC_AS_UnsafelevelunableReq_B1 0;
BA_ "GenSigSendType" SG_ 361 ADC_AS_UnsafelevelunableReq_B1 1;
BA_ "GenSigStartValue" SG_ 361 ADC_AS_UnsafelevelunableReq_B1 0;
BA_ "GenSigTimeoutValue" SG_ 361 ADC_AS_UnsafelevelunableReq_B1 0;
BA_ "Remark" SG_ 361 ADC_AS_UnsafelevelunableReq_B1 "";
BA_ "EventCommandSignal" SG_ 361 ADC_FcsActiveStatus_B 0;
BA_ "GatewayedSignals" SG_ 361 ADC_FcsActiveStatus_B 0;
BA_ "GenSigInactiveValue" SG_ 361 ADC_FcsActiveStatus_B 0;
BA_ "GenSigInvalidValue" SG_ 361 ADC_FcsActiveStatus_B 0;
BA_ "GenSigSendType" SG_ 361 ADC_FcsActiveStatus_B 1;
BA_ "GenSigStartValue" SG_ 361 ADC_FcsActiveStatus_B 0;
BA_ "GenSigTimeoutValue" SG_ 361 ADC_FcsActiveStatus_B 0;
BA_ "Remark" SG_ 361 ADC_FcsActiveStatus_B "";
BA_ "EventCommandSignal" SG_ 361 ADC_AEBTargetDecel_B1 0;
BA_ "GatewayedSignals" SG_ 361 ADC_AEBTargetDecel_B1 0;
BA_ "GenSigInactiveValue" SG_ 361 ADC_AEBTargetDecel_B1 0;
BA_ "GenSigInvalidValue" SG_ 361 ADC_AEBTargetDecel_B1 0;
BA_ "GenSigSendType" SG_ 361 ADC_AEBTargetDecel_B1 1;
BA_ "GenSigStartValue" SG_ 361 ADC_AEBTargetDecel_B1 0;
BA_ "GenSigTimeoutValue" SG_ 361 ADC_AEBTargetDecel_B1 0;
BA_ "Remark" SG_ 361 ADC_AEBTargetDecel_B1 "";
BA_ "EventCommandSignal" SG_ 361 ADC_AEBFaultSt_B1 0;
BA_ "GatewayedSignals" SG_ 361 ADC_AEBFaultSt_B1 0;
BA_ "GenSigInactiveValue" SG_ 361 ADC_AEBFaultSt_B1 0;
BA_ "GenSigInvalidValue" SG_ 361 ADC_AEBFaultSt_B1 0;
BA_ "GenSigSendType" SG_ 361 ADC_AEBFaultSt_B1 1;
BA_ "GenSigStartValue" SG_ 361 ADC_AEBFaultSt_B1 0;
BA_ "GenSigTimeoutValue" SG_ 361 ADC_AEBFaultSt_B1 1;
BA_ "Remark" SG_ 361 ADC_AEBFaultSt_B1 "";
BA_ "EventCommandSignal" SG_ 361 ADC_AEBOffSt_B1 0;
BA_ "GatewayedSignals" SG_ 361 ADC_AEBOffSt_B1 0;
BA_ "GenSigInactiveValue" SG_ 361 ADC_AEBOffSt_B1 0;
BA_ "GenSigInvalidValue" SG_ 361 ADC_AEBOffSt_B1 0;
BA_ "GenSigSendType" SG_ 361 ADC_AEBOffSt_B1 1;
BA_ "GenSigStartValue" SG_ 361 ADC_AEBOffSt_B1 0;
BA_ "GenSigTimeoutValue" SG_ 361 ADC_AEBOffSt_B1 1;
BA_ "Remark" SG_ 361 ADC_AEBOffSt_B1 "";
BA_ "EventCommandSignal" SG_ 361 ADC_AEBInterventionSt_B1 0;
BA_ "GatewayedSignals" SG_ 361 ADC_AEBInterventionSt_B1 0;
BA_ "GenSigInactiveValue" SG_ 361 ADC_AEBInterventionSt_B1 0;
BA_ "GenSigInvalidValue" SG_ 361 ADC_AEBInterventionSt_B1 0;
BA_ "GenSigSendType" SG_ 361 ADC_AEBInterventionSt_B1 1;
BA_ "GenSigStartValue" SG_ 361 ADC_AEBInterventionSt_B1 0;
BA_ "GenSigTimeoutValue" SG_ 361 ADC_AEBInterventionSt_B1 0;
BA_ "Remark" SG_ 361 ADC_AEBInterventionSt_B1 "";
BA_ "EventCommandSignal" SG_ 361 ADC_AEBDecelCtrlReq_B1 0;
BA_ "GatewayedSignals" SG_ 361 ADC_AEBDecelCtrlReq_B1 0;
BA_ "GenSigInactiveValue" SG_ 361 ADC_AEBDecelCtrlReq_B1 0;
BA_ "GenSigInvalidValue" SG_ 361 ADC_AEBDecelCtrlReq_B1 0;
BA_ "GenSigSendType" SG_ 361 ADC_AEBDecelCtrlReq_B1 1;
BA_ "GenSigStartValue" SG_ 361 ADC_AEBDecelCtrlReq_B1 0;
BA_ "GenSigTimeoutValue" SG_ 361 ADC_AEBDecelCtrlReq_B1 0;
BA_ "Remark" SG_ 361 ADC_AEBDecelCtrlReq_B1 "";
BA_ "EventCommandSignal" SG_ 361 ADC_AEBLVehHoldReq_B1 0;
BA_ "GatewayedSignals" SG_ 361 ADC_AEBLVehHoldReq_B1 0;
BA_ "GenSigInactiveValue" SG_ 361 ADC_AEBLVehHoldReq_B1 0;
BA_ "GenSigInvalidValue" SG_ 361 ADC_AEBLVehHoldReq_B1 0;
BA_ "GenSigSendType" SG_ 361 ADC_AEBLVehHoldReq_B1 1;
BA_ "GenSigStartValue" SG_ 361 ADC_AEBLVehHoldReq_B1 0;
BA_ "GenSigTimeoutValue" SG_ 361 ADC_AEBLVehHoldReq_B1 0;
BA_ "Remark" SG_ 361 ADC_AEBLVehHoldReq_B1 "";
BA_ "EventCommandSignal" SG_ 361 ADC_AEBTarCalss_B1 0;
BA_ "GatewayedSignals" SG_ 361 ADC_AEBTarCalss_B1 0;
BA_ "GenSigInactiveValue" SG_ 361 ADC_AEBTarCalss_B1 0;
BA_ "GenSigInvalidValue" SG_ 361 ADC_AEBTarCalss_B1 0;
BA_ "GenSigSendType" SG_ 361 ADC_AEBTarCalss_B1 1;
BA_ "GenSigStartValue" SG_ 361 ADC_AEBTarCalss_B1 0;
BA_ "GenSigTimeoutValue" SG_ 361 ADC_AEBTarCalss_B1 0;
BA_ "Remark" SG_ 361 ADC_AEBTarCalss_B1 "";
BA_ "EventCommandSignal" SG_ 361 ADC_AEBTarDetSensor_B1 0;
BA_ "GatewayedSignals" SG_ 361 ADC_AEBTarDetSensor_B1 0;
BA_ "GenSigInactiveValue" SG_ 361 ADC_AEBTarDetSensor_B1 0;
BA_ "GenSigInvalidValue" SG_ 361 ADC_AEBTarDetSensor_B1 0;
BA_ "GenSigSendType" SG_ 361 ADC_AEBTarDetSensor_B1 1;
BA_ "GenSigStartValue" SG_ 361 ADC_AEBTarDetSensor_B1 0;
BA_ "GenSigTimeoutValue" SG_ 361 ADC_AEBTarDetSensor_B1 0;
BA_ "Remark" SG_ 361 ADC_AEBTarDetSensor_B1 "";
BA_ "EventCommandSignal" SG_ 361 ADC_TurnLightReq_B1 0;
BA_ "GatewayedSignals" SG_ 361 ADC_TurnLightReq_B1 0;
BA_ "GenSigInactiveValue" SG_ 361 ADC_TurnLightReq_B1 0;
BA_ "GenSigInvalidValue" SG_ 361 ADC_TurnLightReq_B1 0;
BA_ "GenSigSendType" SG_ 361 ADC_TurnLightReq_B1 1;
BA_ "GenSigStartValue" SG_ 361 ADC_TurnLightReq_B1 0;
BA_ "GenSigTimeoutValue" SG_ 361 ADC_TurnLightReq_B1 0;
BA_ "Remark" SG_ 361 ADC_TurnLightReq_B1 "";
BA_ "EventCommandSignal" SG_ 361 ADC_PAA2ESPAxReqEnable_B1 0;
BA_ "GatewayedSignals" SG_ 361 ADC_PAA2ESPAxReqEnable_B1 0;
BA_ "GenSigInactiveValue" SG_ 361 ADC_PAA2ESPAxReqEnable_B1 0;
BA_ "GenSigInvalidValue" SG_ 361 ADC_PAA2ESPAxReqEnable_B1 0;
BA_ "GenSigSendType" SG_ 361 ADC_PAA2ESPAxReqEnable_B1 1;
BA_ "GenSigStartValue" SG_ 361 ADC_PAA2ESPAxReqEnable_B1 0;
BA_ "GenSigTimeoutValue" SG_ 361 ADC_PAA2ESPAxReqEnable_B1 0;
BA_ "Remark" SG_ 361 ADC_PAA2ESPAxReqEnable_B1 "";
BA_ "EventCommandSignal" SG_ 361 ADC_PAA2ESPBrakeFunctionMode_B1 0;
BA_ "GatewayedSignals" SG_ 361 ADC_PAA2ESPBrakeFunctionMode_B1 0;
BA_ "GenSigInactiveValue" SG_ 361 ADC_PAA2ESPBrakeFunctionMode_B1 0;
BA_ "GenSigInvalidValue" SG_ 361 ADC_PAA2ESPBrakeFunctionMode_B1 0;
BA_ "GenSigSendType" SG_ 361 ADC_PAA2ESPBrakeFunctionMode_B1 1;
BA_ "GenSigStartValue" SG_ 361 ADC_PAA2ESPBrakeFunctionMode_B1 0;
BA_ "GenSigTimeoutValue" SG_ 361 ADC_PAA2ESPBrakeFunctionMode_B1 0;
BA_ "Remark" SG_ 361 ADC_PAA2ESPBrakeFunctionMode_B1 "";
BA_ "EventCommandSignal" SG_ 361 ADC_PAA2ESPEpbReq_B1 0;
BA_ "GatewayedSignals" SG_ 361 ADC_PAA2ESPEpbReq_B1 0;
BA_ "GenSigInactiveValue" SG_ 361 ADC_PAA2ESPEpbReq_B1 0;
BA_ "GenSigInvalidValue" SG_ 361 ADC_PAA2ESPEpbReq_B1 0;
BA_ "GenSigSendType" SG_ 361 ADC_PAA2ESPEpbReq_B1 1;
BA_ "GenSigStartValue" SG_ 361 ADC_PAA2ESPEpbReq_B1 0;
BA_ "GenSigTimeoutValue" SG_ 361 ADC_PAA2ESPEpbReq_B1 0;
BA_ "Remark" SG_ 361 ADC_PAA2ESPEpbReq_B1 "";
BA_ "EventCommandSignal" SG_ 361 ADC_PAA2ESPEpbReqSt_B1 0;
BA_ "GatewayedSignals" SG_ 361 ADC_PAA2ESPEpbReqSt_B1 0;
BA_ "GenSigInactiveValue" SG_ 361 ADC_PAA2ESPEpbReqSt_B1 0;
BA_ "GenSigInvalidValue" SG_ 361 ADC_PAA2ESPEpbReqSt_B1 0;
BA_ "GenSigSendType" SG_ 361 ADC_PAA2ESPEpbReqSt_B1 1;
BA_ "GenSigStartValue" SG_ 361 ADC_PAA2ESPEpbReqSt_B1 0;
BA_ "GenSigTimeoutValue" SG_ 361 ADC_PAA2ESPEpbReqSt_B1 0;
BA_ "Remark" SG_ 361 ADC_PAA2ESPEpbReqSt_B1 "";
BA_ "EventCommandSignal" SG_ 361 ADC_ESPSwitchReq_B1 0;
BA_ "GatewayedSignals" SG_ 361 ADC_ESPSwitchReq_B1 0;
BA_ "GenSigInactiveValue" SG_ 361 ADC_ESPSwitchReq_B1 0;
BA_ "GenSigInvalidValue" SG_ 361 ADC_ESPSwitchReq_B1 0;
BA_ "GenSigSendType" SG_ 361 ADC_ESPSwitchReq_B1 1;
BA_ "GenSigStartValue" SG_ 361 ADC_ESPSwitchReq_B1 0;
BA_ "GenSigTimeoutValue" SG_ 361 ADC_ESPSwitchReq_B1 0;
BA_ "Remark" SG_ 361 ADC_ESPSwitchReq_B1 "";
BA_ "EventCommandSignal" SG_ 361 ADC_PAA2EPBBrakeFunctionMode_B1 0;
BA_ "GatewayedSignals" SG_ 361 ADC_PAA2EPBBrakeFunctionMode_B1 0;
BA_ "GenSigInactiveValue" SG_ 361 ADC_PAA2EPBBrakeFunctionMode_B1 0;
BA_ "GenSigInvalidValue" SG_ 361 ADC_PAA2EPBBrakeFunctionMode_B1 0;
BA_ "GenSigSendType" SG_ 361 ADC_PAA2EPBBrakeFunctionMode_B1 1;
BA_ "GenSigStartValue" SG_ 361 ADC_PAA2EPBBrakeFunctionMode_B1 0;
BA_ "GenSigTimeoutValue" SG_ 361 ADC_PAA2EPBBrakeFunctionMode_B1 0;
BA_ "Remark" SG_ 361 ADC_PAA2EPBBrakeFunctionMode_B1 "";
BA_ "EventCommandSignal" SG_ 361 ADC_PAA2ESPApEmgyBrkReq_B1 0;
BA_ "GatewayedSignals" SG_ 361 ADC_PAA2ESPApEmgyBrkReq_B1 0;
BA_ "GenSigInactiveValue" SG_ 361 ADC_PAA2ESPApEmgyBrkReq_B1 0;
BA_ "GenSigInvalidValue" SG_ 361 ADC_PAA2ESPApEmgyBrkReq_B1 0;
BA_ "GenSigSendType" SG_ 361 ADC_PAA2ESPApEmgyBrkReq_B1 1;
BA_ "GenSigStartValue" SG_ 361 ADC_PAA2ESPApEmgyBrkReq_B1 0;
BA_ "GenSigTimeoutValue" SG_ 361 ADC_PAA2ESPApEmgyBrkReq_B1 0;
BA_ "Remark" SG_ 361 ADC_PAA2ESPApEmgyBrkReq_B1 "";
BA_ "EventCommandSignal" SG_ 361 ADC_PAA2ESPComfBrakeReq_B1 0;
BA_ "GatewayedSignals" SG_ 361 ADC_PAA2ESPComfBrakeReq_B1 0;
BA_ "GenSigInactiveValue" SG_ 361 ADC_PAA2ESPComfBrakeReq_B1 0;
BA_ "GenSigInvalidValue" SG_ 361 ADC_PAA2ESPComfBrakeReq_B1 0;
BA_ "GenSigSendType" SG_ 361 ADC_PAA2ESPComfBrakeReq_B1 1;
BA_ "GenSigStartValue" SG_ 361 ADC_PAA2ESPComfBrakeReq_B1 0;
BA_ "GenSigTimeoutValue" SG_ 361 ADC_PAA2ESPComfBrakeReq_B1 0;
BA_ "Remark" SG_ 361 ADC_PAA2ESPComfBrakeReq_B1 "";
BA_ "EventCommandSignal" SG_ 361 ADC_PAA2ESPApDriveOffReq_B1 0;
BA_ "GatewayedSignals" SG_ 361 ADC_PAA2ESPApDriveOffReq_B1 0;
BA_ "GenSigInactiveValue" SG_ 361 ADC_PAA2ESPApDriveOffReq_B1 0;
BA_ "GenSigInvalidValue" SG_ 361 ADC_PAA2ESPApDriveOffReq_B1 0;
BA_ "GenSigSendType" SG_ 361 ADC_PAA2ESPApDriveOffReq_B1 1;
BA_ "GenSigStartValue" SG_ 361 ADC_PAA2ESPApDriveOffReq_B1 0;
BA_ "GenSigTimeoutValue" SG_ 361 ADC_PAA2ESPApDriveOffReq_B1 0;
BA_ "Remark" SG_ 361 ADC_PAA2ESPApDriveOffReq_B1 "";
BA_ "EventCommandSignal" SG_ 361 ADC_PAA2ESPApStandstillReq_B1 0;
BA_ "GatewayedSignals" SG_ 361 ADC_PAA2ESPApStandstillReq_B1 0;
BA_ "GenSigInactiveValue" SG_ 361 ADC_PAA2ESPApStandstillReq_B1 0;
BA_ "GenSigInvalidValue" SG_ 361 ADC_PAA2ESPApStandstillReq_B1 0;
BA_ "GenSigSendType" SG_ 361 ADC_PAA2ESPApStandstillReq_B1 1;
BA_ "GenSigStartValue" SG_ 361 ADC_PAA2ESPApStandstillReq_B1 0;
BA_ "GenSigTimeoutValue" SG_ 361 ADC_PAA2ESPApStandstillReq_B1 0;
BA_ "Remark" SG_ 361 ADC_PAA2ESPApStandstillReq_B1 "";
BA_ "EventCommandSignal" SG_ 361 ADC_PAA2ESPApPrefillReq_B1 0;
BA_ "GatewayedSignals" SG_ 361 ADC_PAA2ESPApPrefillReq_B1 0;
BA_ "GenSigInactiveValue" SG_ 361 ADC_PAA2ESPApPrefillReq_B1 0;
BA_ "GenSigInvalidValue" SG_ 361 ADC_PAA2ESPApPrefillReq_B1 0;
BA_ "GenSigSendType" SG_ 361 ADC_PAA2ESPApPrefillReq_B1 1;
BA_ "GenSigStartValue" SG_ 361 ADC_PAA2ESPApPrefillReq_B1 0;
BA_ "GenSigTimeoutValue" SG_ 361 ADC_PAA2ESPApPrefillReq_B1 0;
BA_ "Remark" SG_ 361 ADC_PAA2ESPApPrefillReq_B1 "";
BA_ "EventCommandSignal" SG_ 361 ADC_PAA2ESPAxReq_B1 0;
BA_ "GatewayedSignals" SG_ 361 ADC_PAA2ESPAxReq_B1 0;
BA_ "GenSigInactiveValue" SG_ 361 ADC_PAA2ESPAxReq_B1 0;
BA_ "GenSigInvalidValue" SG_ 361 ADC_PAA2ESPAxReq_B1 0;
BA_ "GenSigSendType" SG_ 361 ADC_PAA2ESPAxReq_B1 1;
BA_ "GenSigStartValue" SG_ 361 ADC_PAA2ESPAxReq_B1 0;
BA_ "GenSigTimeoutValue" SG_ 361 ADC_PAA2ESPAxReq_B1 0;
BA_ "Remark" SG_ 361 ADC_PAA2ESPAxReq_B1 "";
BA_ "EventCommandSignal" SG_ 361 ADC_EPBReq_B1 0;
BA_ "GatewayedSignals" SG_ 361 ADC_EPBReq_B1 0;
BA_ "GenSigInactiveValue" SG_ 361 ADC_EPBReq_B1 0;
BA_ "GenSigInvalidValue" SG_ 361 ADC_EPBReq_B1 0;
BA_ "GenSigSendType" SG_ 361 ADC_EPBReq_B1 1;
BA_ "GenSigStartValue" SG_ 361 ADC_EPBReq_B1 0;
BA_ "GenSigTimeoutValue" SG_ 361 ADC_EPBReq_B1 0;
BA_ "Remark" SG_ 361 ADC_EPBReq_B1 "";
BA_ "EventCommandSignal" SG_ 361 ADC_PAA2ESPDistoStop_B1 0;
BA_ "GatewayedSignals" SG_ 361 ADC_PAA2ESPDistoStop_B1 0;
BA_ "GenSigInactiveValue" SG_ 361 ADC_PAA2ESPDistoStop_B1 0;
BA_ "GenSigInvalidValue" SG_ 361 ADC_PAA2ESPDistoStop_B1 0;
BA_ "GenSigSendType" SG_ 361 ADC_PAA2ESPDistoStop_B1 1;
BA_ "GenSigStartValue" SG_ 361 ADC_PAA2ESPDistoStop_B1 0;
BA_ "GenSigTimeoutValue" SG_ 361 ADC_PAA2ESPDistoStop_B1 0;
BA_ "Remark" SG_ 361 ADC_PAA2ESPDistoStop_B1 "";
BA_ "EventCommandSignal" SG_ 361 ADC_PAA2ESPTarTorquePTDriveoff_B1 0;
BA_ "GatewayedSignals" SG_ 361 ADC_PAA2ESPTarTorquePTDriveoff_B1 0;
BA_ "GenSigInactiveValue" SG_ 361 ADC_PAA2ESPTarTorquePTDriveoff_B1 0;
BA_ "GenSigInvalidValue" SG_ 361 ADC_PAA2ESPTarTorquePTDriveoff_B1 0;
BA_ "GenSigSendType" SG_ 361 ADC_PAA2ESPTarTorquePTDriveoff_B1 1;
BA_ "GenSigStartValue" SG_ 361 ADC_PAA2ESPTarTorquePTDriveoff_B1 0;
BA_ "GenSigTimeoutValue" SG_ 361 ADC_PAA2ESPTarTorquePTDriveoff_B1 0;
BA_ "Remark" SG_ 361 ADC_PAA2ESPTarTorquePTDriveoff_B1 "";
BA_ "EventCommandSignal" SG_ 361 ADC_VehTorqLimit_B1 0;
BA_ "GatewayedSignals" SG_ 361 ADC_VehTorqLimit_B1 0;
BA_ "GenSigInactiveValue" SG_ 361 ADC_VehTorqLimit_B1 0;
BA_ "GenSigInvalidValue" SG_ 361 ADC_VehTorqLimit_B1 0;
BA_ "GenSigSendType" SG_ 361 ADC_VehTorqLimit_B1 1;
BA_ "GenSigStartValue" SG_ 361 ADC_VehTorqLimit_B1 0;
BA_ "GenSigTimeoutValue" SG_ 361 ADC_VehTorqLimit_B1 0;
BA_ "Remark" SG_ 361 ADC_VehTorqLimit_B1 "";
BA_ "EventCommandSignal" SG_ 361 ADC_VehTorqReqValue_B1 0;
BA_ "GatewayedSignals" SG_ 361 ADC_VehTorqReqValue_B1 0;
BA_ "GenSigInactiveValue" SG_ 361 ADC_VehTorqReqValue_B1 0;
BA_ "GenSigInvalidValue" SG_ 361 ADC_VehTorqReqValue_B1 0;
BA_ "GenSigSendType" SG_ 361 ADC_VehTorqReqValue_B1 1;
BA_ "GenSigStartValue" SG_ 361 ADC_VehTorqReqValue_B1 0;
BA_ "GenSigTimeoutValue" SG_ 361 ADC_VehTorqReqValue_B1 0;
BA_ "Remark" SG_ 361 ADC_VehTorqReqValue_B1 "";
BA_ "EventCommandSignal" SG_ 361 ADC_VehTorqLimitEnable_B1 0;
BA_ "GatewayedSignals" SG_ 361 ADC_VehTorqLimitEnable_B1 0;
BA_ "GenSigInactiveValue" SG_ 361 ADC_VehTorqLimitEnable_B1 0;
BA_ "GenSigInvalidValue" SG_ 361 ADC_VehTorqLimitEnable_B1 0;
BA_ "GenSigSendType" SG_ 361 ADC_VehTorqLimitEnable_B1 1;
BA_ "GenSigStartValue" SG_ 361 ADC_VehTorqLimitEnable_B1 0;
BA_ "GenSigTimeoutValue" SG_ 361 ADC_VehTorqLimitEnable_B1 0;
BA_ "Remark" SG_ 361 ADC_VehTorqLimitEnable_B1 "";
BA_ "EventCommandSignal" SG_ 361 ADC_VehTorqReqEnable_B1 0;
BA_ "GatewayedSignals" SG_ 361 ADC_VehTorqReqEnable_B1 0;
BA_ "GenSigInactiveValue" SG_ 361 ADC_VehTorqReqEnable_B1 0;
BA_ "GenSigInvalidValue" SG_ 361 ADC_VehTorqReqEnable_B1 0;
BA_ "GenSigSendType" SG_ 361 ADC_VehTorqReqEnable_B1 1;
BA_ "GenSigStartValue" SG_ 361 ADC_VehTorqReqEnable_B1 0;
BA_ "GenSigTimeoutValue" SG_ 361 ADC_VehTorqReqEnable_B1 0;
BA_ "Remark" SG_ 361 ADC_VehTorqReqEnable_B1 "";
BA_ "EventCommandSignal" SG_ 361 ADC_PAAPwrModeReq_B1 0;
BA_ "GatewayedSignals" SG_ 361 ADC_PAAPwrModeReq_B1 0;
BA_ "GenSigInactiveValue" SG_ 361 ADC_PAAPwrModeReq_B1 0;
BA_ "GenSigInvalidValue" SG_ 361 ADC_PAAPwrModeReq_B1 0;
BA_ "GenSigSendType" SG_ 361 ADC_PAAPwrModeReq_B1 1;
BA_ "GenSigStartValue" SG_ 361 ADC_PAAPwrModeReq_B1 0;
BA_ "GenSigTimeoutValue" SG_ 361 ADC_PAAPwrModeReq_B1 0;
BA_ "Remark" SG_ 361 ADC_PAAPwrModeReq_B1 "";
BA_ "EventCommandSignal" SG_ 361 ADC_PAAGrarLvlReq_B1 0;
BA_ "GatewayedSignals" SG_ 361 ADC_PAAGrarLvlReq_B1 0;
BA_ "GenSigInactiveValue" SG_ 361 ADC_PAAGrarLvlReq_B1 0;
BA_ "GenSigInvalidValue" SG_ 361 ADC_PAAGrarLvlReq_B1 0;
BA_ "GenSigSendType" SG_ 361 ADC_PAAGrarLvlReq_B1 1;
BA_ "GenSigStartValue" SG_ 361 ADC_PAAGrarLvlReq_B1 0;
BA_ "GenSigTimeoutValue" SG_ 361 ADC_PAAGrarLvlReq_B1 0;
BA_ "Remark" SG_ 361 ADC_PAAGrarLvlReq_B1 "";
BA_ "EventCommandSignal" SG_ 361 ADC_PAAGrarLvlReqEnable_B1 0;
BA_ "GatewayedSignals" SG_ 361 ADC_PAAGrarLvlReqEnable_B1 0;
BA_ "GenSigInactiveValue" SG_ 361 ADC_PAAGrarLvlReqEnable_B1 0;
BA_ "GenSigInvalidValue" SG_ 361 ADC_PAAGrarLvlReqEnable_B1 0;
BA_ "GenSigSendType" SG_ 361 ADC_PAAGrarLvlReqEnable_B1 1;
BA_ "GenSigStartValue" SG_ 361 ADC_PAAGrarLvlReqEnable_B1 0;
BA_ "GenSigTimeoutValue" SG_ 361 ADC_PAAGrarLvlReqEnable_B1 0;
BA_ "Remark" SG_ 361 ADC_PAAGrarLvlReqEnable_B1 "";
BA_ "EventCommandSignal" SG_ 361 ADC_ActTrqReqVD_B1 0;
BA_ "GatewayedSignals" SG_ 361 ADC_ActTrqReqVD_B1 0;
BA_ "GenSigInactiveValue" SG_ 361 ADC_ActTrqReqVD_B1 0;
BA_ "GenSigInvalidValue" SG_ 361 ADC_ActTrqReqVD_B1 0;
BA_ "GenSigSendType" SG_ 361 ADC_ActTrqReqVD_B1 1;
BA_ "GenSigStartValue" SG_ 361 ADC_ActTrqReqVD_B1 0;
BA_ "GenSigTimeoutValue" SG_ 361 ADC_ActTrqReqVD_B1 0;
BA_ "Remark" SG_ 361 ADC_ActTrqReqVD_B1 "";
BA_ "EventCommandSignal" SG_ 361 ADC_RCTBTargetDecel_B1 0;
BA_ "GatewayedSignals" SG_ 361 ADC_RCTBTargetDecel_B1 0;
BA_ "GenSigInactiveValue" SG_ 361 ADC_RCTBTargetDecel_B1 0;
BA_ "GenSigInvalidValue" SG_ 361 ADC_RCTBTargetDecel_B1 0;
BA_ "GenSigSendType" SG_ 361 ADC_RCTBTargetDecel_B1 1;
BA_ "GenSigStartValue" SG_ 361 ADC_RCTBTargetDecel_B1 0;
BA_ "GenSigTimeoutValue" SG_ 361 ADC_RCTBTargetDecel_B1 0;
BA_ "Remark" SG_ 361 ADC_RCTBTargetDecel_B1 "";
BA_ "EventCommandSignal" SG_ 361 ADC_RCTBBrkReq_B1 0;
BA_ "GatewayedSignals" SG_ 361 ADC_RCTBBrkReq_B1 0;
BA_ "GenSigInactiveValue" SG_ 361 ADC_RCTBBrkReq_B1 0;
BA_ "GenSigInvalidValue" SG_ 361 ADC_RCTBBrkReq_B1 0;
BA_ "GenSigSendType" SG_ 361 ADC_RCTBBrkReq_B1 1;
BA_ "GenSigStartValue" SG_ 361 ADC_RCTBBrkReq_B1 0;
BA_ "GenSigTimeoutValue" SG_ 361 ADC_RCTBBrkReq_B1 0;
BA_ "Remark" SG_ 361 ADC_RCTBBrkReq_B1 "";
BA_ "EventCommandSignal" SG_ 361 ADC_TarGearReqVld_B1 0;
BA_ "GatewayedSignals" SG_ 361 ADC_TarGearReqVld_B1 0;
BA_ "GenSigInactiveValue" SG_ 361 ADC_TarGearReqVld_B1 0;
BA_ "GenSigInvalidValue" SG_ 361 ADC_TarGearReqVld_B1 0;
BA_ "GenSigSendType" SG_ 361 ADC_TarGearReqVld_B1 1;
BA_ "GenSigStartValue" SG_ 361 ADC_TarGearReqVld_B1 0;
BA_ "GenSigTimeoutValue" SG_ 361 ADC_TarGearReqVld_B1 0;
BA_ "Remark" SG_ 361 ADC_TarGearReqVld_B1 "";
BA_ "EventCommandSignal" SG_ 361 ADC_FctSts_B1 0;
BA_ "GatewayedSignals" SG_ 361 ADC_FctSts_B1 0;
BA_ "GenSigInactiveValue" SG_ 361 ADC_FctSts_B1 0;
BA_ "GenSigInvalidValue" SG_ 361 ADC_FctSts_B1 0;
BA_ "GenSigSendType" SG_ 361 ADC_FctSts_B1 1;
BA_ "GenSigStartValue" SG_ 361 ADC_FctSts_B1 0;
BA_ "GenSigTimeoutValue" SG_ 361 ADC_FctSts_B1 0;
BA_ "Remark" SG_ 361 ADC_FctSts_B1 "";
VAL_ 368 DCU_ModeSt 15 "Emer_Discharge;" 14 "CapDischarge;" 13 "BuckDischarge;" 12 "Boost Charge;" 11 "CapPrecharge;" 10 "Power off;" 9 "Offsetcal;" 8 "Failure;" 7 "AHF;" 6 "Discharge;" 5 "HillholdCtrl or  SpdCtrl;" 4 "TrqCtrl;" 3 "Ready;" 2 "Standby;" 1 "Init;" 0 "Reserved;"  ;
VAL_ 368 DCU_ADC_MCUBlkst 0 "no block" 1 "block" 2 "reserved"  ;
VAL_ 368 DCU_ADC_SpdSvModAvl 0 "not available" 1 "available"  ;
VAL_ 368 DCU_ADC_MCUStandstill 0 "not standstill" 1 "standstill"  ;
VAL_ 368 DCU_ADC_MCUSpdSVModFit 0 "no fault" 1 "excessive output torque fault"  ;
VAL_ 368 DCU_ADC_MCUVehSldSt 0 "not slide" 1 "slide"  ;
VAL_ 704 IPS_DCDCModeSt 7 "Failure;" 3 "Active - Buck Mode;" 2 "Connected (HV is active);" 1 "Disconnected;" 0 "Init;- others : reserved;"  ;
VAL_ 824 VCU_GearLvlDisp 4 "'P' Park gear;" 3 "'R' Reverse gear;" 2 "'N' Neutral gear;" 1 "'D' Drive gear;" 0 "Invalid;- others : reserved;"  ;
VAL_ 824 VCU_VehDrvMod 7 "Individual；" 6 "I-pedal Mode;" 5 "SPORT Mode;" 4 "Driving Mode;" 3 "Comfort Mode;" 2 "ECO Mode;" 1 "ECO+ Mode;" 0 "Invalid;"  ;
VAL_ 824 VCU_VehRdySt 1 "Ready;" 0 "Not ready;"  ;
VAL_ 824 VCU_GearLvl 4 "'P' Park gear;" 3 "'R' Reverse gear;" 2 "'N' Neutral gear;" 1 "'D' Drive gear;" 0 "Invalid;- others : reserved;"  ;
VAL_ 824 VCU_PlgConnSt 1 "Plug connector connected;" 0 "Not connected;"  ;
VAL_ 824 VCU_SwapHvBattCompSt 0 "Invalid,not in swap mode;" 1 "Swap not complete;" 2 "Swap Complete, vcu complete hv power up;" 3 "Swap Complete,but can not power up due to hv battery error" 4 "Swap Complete,but can not power up due to others error"  ;
VAL_ 824 VCU_SwapHvBattModeSt 0 "Invalid" 1 "Not Swap mode" 2 "Swap mode" 3 "Swap mode (Hv power down)"  ;
VAL_ 824 VCU_SwapHvBattModeStVD 0 "Not valid" 1 "Valid"  ;
VAL_ 824 VCU_RoadMod 7 "Off;" 5 "Slippery Mode;" 4 "Offroad Mode;" 3 "Sand Mode;" 2 "Snow Mode;" 1 "Mud Mode;" 0 "Invalid;"  ;
VAL_ 653 VCU_AccButtInfo 0 "not press" 1 "press" 0 "not press" 1 "press" 0 "not press" 1 "press" 0 "not press" 1 "press" 0 "not press" 1 "press" 0 "Normal" 1 "Abnormal"  ;
VAL_ 653 VCU_LateralAssistBtnInfo 0 "Not pressed" 1 "Pressed"  ;
VAL_ 653 VCU_LateralAssistBtnInfoVD 0 "Invalid" 1 "Valid"  ;
VAL_ 653 VCU_EMS_BrkPedalSt 1 "Pressed;" 0 "Not pressed;"  ;
VAL_ 653 VCU_EMS_BrkPedalStVD 1 "Valid;" 0 "Not valid;"  ;
VAL_ 653 VCU_EMS_AccPedalActPstVD 1 "Valid;" 0 "Not valid;"  ;
VAL_ 653 VCU_BrkPedPstVD 1 "Valid;" 0 "Not valid;"  ;
VAL_ 653 VCU_CrntGearLvl 4 "'P' Park gear;" 3 "'R' Reverse gear;" 2 "'N' Neutral gear;" 1 "'D' Drive gear;" 0 "Invalid;- others : reserved;"  ;
VAL_ 653 VCU_APAGasPedalIntv 1 "With intervention;" 0 "With not intervention;"  ;
VAL_ 653 VCU_APAAvailable 1 "Available;" 0 "Not available;"  ;
VAL_ 653 VCU_ACCLimitOperatingSt 1 "active;" 0 "Not active;"  ;
VAL_ 653 VCU_ACCMaxRecpDecelVD 1 "Valid;" 0 "Not valid;"  ;
VAL_ 653 VCU_APA_Resp 1 "Yes;" 0 "No;"  ;
VAL_ 653 VCU_APAGearIntervern 1 "with intervention;" 0 "with not intervention;"  ;
VAL_ 653 VCU_ACCmaxSpdLimit 14 "140 Km/h;" 13 "130 Km/h;" 12 "120 Km/h;" 11 "110 Km/h;" 10 "100 Km/h;" 9 "90 Km/h;" 8 "80 Km/h;" 7 "70 Km/h;" 6 "60 Km/h;" 5 "50 Km/h;" 4 "40 Km/h;" 3 "30 Km/h;" 2 "20 Km/h;" 1 "10 Km/h;" 0 "No Limit;"  ;
VAL_ 653 VCU_RecpTorqVD 1 "Valid;" 0 "Invalid;"  ;
VAL_ 653 VCU_CrntGearLvlVD 1 "Valid;" 0 "Not valid;"  ;
VAL_ 653 EMS_GasPedalActPstforMRRVD_D 1 "Valid;" 0 "Invalid;"  ;
VAL_ 644 EMS_GasPedalActPstforMRRVD 1 "Valid;" 0 "Invalid;"  ;
VAL_ 644 VCU_AccTMCFail 1 "In limp-home mode;" 0 "Normal mode;"  ;
VAL_ 644 VCU_AccElecECFail 1 "Failure;" 0 "No failure;"  ;
VAL_ 644 VCU_AccDriverOrvd 1 "Driver override;" 0 "No override;"  ;
VAL_ 644 VCU_AccSpareCanError 0 "No Error" 1 "Error"  ;
VAL_ 644 VCU_IFCFailureSt 0 "Not Failure" 1 "Failure"  ;
VAL_ 644 VCU_AccDriverOrvdVD 0 "Invalid" 1 "Valid"  ;
VAL_ 393 VCU_ErrorFb 0 "No error" 1 "ADS request error" 2 "High Voltage Fault" 3 "MCU error" 4 "BMS error" 7 "ADS E2E error or time out"  ;
VAL_ 393 VCU_VehWhlReqTqVld 0 "Invalid" 1 "Valid"  ;
VAL_ 393 VCU_MotorRegenTrqLmtlnDVaild 0 "Invalid" 1 "Valid"  ;
VAL_ 393 VCU_GearShiftAvl 0 "not available" 1 "available"  ;
VAL_ 393 VCU_PtTqAvl 0 "not available" 1 "available" 2 "available degraded"  ;
VAL_ 393 VCU_PtTqActvSts 0 "Not response" 1 "Response"  ;
VAL_ 393 VCU_TargetRecpTorqSt 0 "NotIntialized" 1 "Normal" 2 "Faulty" 3 "Reserved"  ;
VAL_ 393 VCU_TargetRecpTorqFAVD_Hyb 1 "Valid;" 0 "Invalid;"  ;
VAL_ 393 VCU_TargetRecpTorqRAVD_Hyb 1 "Valid;" 0 "Invalid;"  ;
VAL_ 393 VCU_TorqDriverReqFAVD 1 "Valid;" 0 "Invalid;"  ;
VAL_ 393 VCU_TorqDriverReqRAVD 1 "Valid;" 0 "Invalid;"  ;
VAL_ 393 VCU_VehActDrvTorqFAVD_Hyb 1 "Valid;" 0 "Invalid;"  ;
VAL_ 393 VCU_VehActDrvTorqRAVD_Hyb 1 "Valid;" 0 "Invalid;"  ;
VAL_ 393 VCU_BcsDecelVD 0 "Invalid" 1 "Valid"  ;
VAL_ 393 VCU_BcsDecelEnable 0 "Not active" 1 "Active"  ;
VAL_ 393 VCU_CrntGearNoTrans 4 "'P' Park gear;" 3 "'R' Reverse gear;" 2 "'N' Neutral gear;" 1 "'D' Drive gear;" 0 "Invalid;"  ;
VAL_ 393 VCU_RecpTorqSt 0 "NotIntialized" 1 "Normal" 2 "Faulty" 3 "Reserved"  ;
VAL_ 393 VCU_RecpTorqFAVD_Hyb 1 "Valid;" 0 "Invalid;"  ;
VAL_ 393 VCU_RecpTorqRAVD_Hyb 1 "Valid;" 0 "Invalid;"  ;
VAL_ 393 VCU_MaxRecpTorqFAVD_Hyb 1 "Valid;" 0 "Not valid;"  ;
VAL_ 393 VCU_MaxRecpTorqRAVD_Hyb 1 "Valid;" 0 "Not valid;"  ;
VAL_ 393 VCU_VehWheelTorqMaxNmVD 0 "Not valid" 1 "Valid"  ;
VAL_ 404 ADC_LongCtrlAvailability_B 0 "Not available" 1 "Available"  ;
VAL_ 404 ADC_LongCtrlModeForBrkSys_B 0 "Off mode" 1 "L2 Active" 2 "L2++ Active" 3 "Not used" 4 "Not used" 5 "Not used" 6 "Not used" 7 "Not used"  ;
VAL_ 404 ADC_LongCtrlTargetAxReq_B 0 "No request" 1 "Request"  ;
VAL_ 404 ADC_LongCtrlTypReq_B 0 "Comfort Mode" 1 "Emergency Mode"  ;
VAL_ 404 ADC_LongCtrlDecToStopReq_B 0 "No request" 1 "Request"  ;
VAL_ 404 ADC_LongctrlSecureReq_B 0 "NoRequest" 1 "Request"  ;
VAL_ 404 ADC_ActTrqReqEnable_B 0 "Disable" 1 "Enable"  ;
VAL_ 404 ADC_VLCSt_B 0 "VLC not working" 1 "VLC Override possible" 2 "VLC Override impossible" 3 "Reserve"  ;
VAL_ 404 ADC_ICMWarnCardSt_B 0 "HORValue_None" 1 "HORValue_Level1" 2 "HORValue_Level2" 3 "HORValue_Level3" 4 "FORValue_Level1" 5 "FORValue_Level2" 6 "FORValue_Level3" 7 "TORValueLong_level1" 8 "TORValueLong_level2" 9 "TORValueLong_level3" 10 "TORValueLat_level1" 11 "TORValueLat_level2" 12 "TORValueLat_level3" 13 "TORValue_Stopping" 14 "TORValue_Stopped"  ;
VAL_ 404 ADC_ICMPromptWarn_B 0 "None" 1 "TOR request"  ;
VAL_ 404 ADC_AngReqRdntReq_B 0 "No request" 1 "Request"  ;
VAL_ 404 ADC_AngReqSt_B 0 "Inhibited" 1 "Ready" 2 "Active" 3 "Failed"  ;
VAL_ 404 ADC_AssistParaSwitchReq_B 0 "No request" 1 "Request"  ;
VAL_ 404 ADC_PAAGrarLvlReq_B 0 "No Request" 1 "Park" 2 "Reversed" 3 "Neutral" 4 "Drive" 5 "Reversed" 6 "Reversed" 7 "Reversed"  ;
VAL_ 404 ADC_PAAGrarLvlReqEnable_B 0 "No request" 1 "Gear shift request"  ;
VAL_ 404 ADC_ElecBrkFnSwitch_B 0 "On" 1 "Off"  ;
VAL_ 404 ADC_LongCtrlDriveOff_B 0 "Norequest" 1 "Request"  ;
VAL_ 404 ADC_AEBDecelCtrlReq_B 0 "Norequest" 1 "Request"  ;
VAL_ 404 ADC_ABPReq_B 0 "Norequest" 1 "Request"  ;
VAL_ 404 ADC_ComfstopReq_B 0 "Turn Off" 1 "Turn On"  ;
VAL_ 404 ADC_CSM_HoldReq_B 0 "No request" 1 "Request"  ;
VAL_ 361 ADC_AngReqFunction_B1 0 "No request" 1 "Request by LKAS" 2 "Request by PAS" 3 "Reserved"  ;
VAL_ 361 ADC_BrakeLightReq_B1 0 "No Request" 1 "turn on" 2 "turn off"  ;
VAL_ 361 ADC_AngReqSt_A_B1 0 "Inhibited" 1 "Ready" 2 "Active" 3 "Failed"  ;
VAL_ 361 ADC_StrgWhlVibrWarnLevel_B1 0 "No request" 1 "Request level 1" 2 "Request level 2" 3 "Request level 3"  ;
VAL_ 361 ADC_EvsSteerReq_B1 0 "No request" 1 "Request"  ;
VAL_ 361 ADC_StrgWhlVibrWarnReq_B1 0 "No request" 1 "Request"  ;
VAL_ 361 ADC_LongCtrlTypReq_B1 0 "Comfort Mode" 1 "Emergency Mode"  ;
VAL_ 361 ADC_ABAReq_B1 0 "No request" 1 "Request"  ;
VAL_ 361 ADC_ABALevel_B1 0 "Level 0" 1 "Level 1" 2 "Level 2" 3 "Level 3"  ;
VAL_ 361 ADC_AWBReq_B1 0 "No request" 1 "Request"  ;
VAL_ 361 ADC_ABPReq_B1 0 "No request" 1 "Request"  ;
VAL_ 361 ADC_AWBLevel_B1 0 "No level" 1 "Level 1" 2 "Level 2" 3 "Level 3" 4 "Level 4" 5 "Not used" 6 "Not used" 7 "Not used"  ;
VAL_ 361 ADC_EpbModReq_B1 0 "No request" 1 "lock" 2 "release" 3 "reserved"  ;
VAL_ 361 ADC_EpbModReqEna_B1 0 "disable" 1 "enable"  ;
VAL_ 361 ADC_BrkTarTqEna_B1 0 "disable" 1 "enable"  ;
VAL_ 361 ADC_BrkTarTqMod_B1 0 "no request" 1 "Cruise function" 2 "Parking function" 3 "Reserved"  ;
VAL_ 361 ADC_EpbModReqVld_B1 0 "Invalid" 1 "Valid"  ;
VAL_ 361 ADC_RWUEna_B1 0 "disable" 1 "enable"  ;
VAL_ 361 ADC_BrkHoldReq_B1 0 "No request" 1 "Not active" 2 "Active" 3 "Reserved"  ;
VAL_ 361 ADC_AngReqAvl_B1 0 "Not available" 1 "Available"  ;
VAL_ 361 ADC_BrkTarTqVld_B1 0 "Invalid" 1 "Valid"  ;
VAL_ 361 ADC_AebBrkTarTqVld_B1 0 "Invalid" 1 "Valid"  ;
VAL_ 361 ADC_AebBrkTarTqEna_B1 0 "disable" 1 "enable"  ;
VAL_ 361 ADC_ElecBrkFnSwitch_B1 0 "ON" 1 "OFF"  ;
VAL_ 361 ADC_RWUVld_B1 0 "Invalid" 1 "Valid"  ;
VAL_ 361 ADC_DriverPresent_B1 0 "Undefined" 1 "Driver  Not Present" 2 "Driver  Present" 3 "Failure"  ;
VAL_ 361 ADC_AssistParaSwitchReq_B1 0 "No request" 1 "Request"  ;
VAL_ 361 ADC_AngReqRdntReq_A_B1 0 "No request" 1 "Request"  ;
VAL_ 361 ADC_SteerGainReq_B1 0 "No request" 1 "Request"  ;
VAL_ 361 ADC_ActTrqReqEnable_B1 0 "Disable" 1 "Enable"  ;
VAL_ 361 ADC_VLCSt_B1 0 "VLC not working" 1 "VLC Override possible" 2 "VLC Override impossible" 3 "Reserve"  ;
VAL_ 361 ADC_ADASLongCtrlFuncMode_B1 0 "Cruise" 1 "APA" 2 "Reserve" 3 "Reserve" 4 "Reserve" 5 "Reserve" 6 "Reserve" 7 "Reserve"  ;
VAL_ 361 ADC_LongCtrlAvailability_B1 0 "Not available" 1 "Available"  ;
VAL_ 361 ADC_LongCtrlModeForBrkSys_B1 0 "Off mode" 1 "L2 Active" 2 "L2++ Active" 3 "Not used" 4 "Not used" 5 "Not used" 6 "Not used" 7 "Not used"  ;
VAL_ 361 ADC_LongCtrlTargetAxReq_B1 0 "No request" 1 "Request"  ;
VAL_ 361 ADC_LongCtrlDecToStopReq_B1 0 "No request" 1 "Request"  ;
VAL_ 361 ADC_LongCtrlDriveOff_B1 0 "No request" 1 "Request"  ;
VAL_ 361 ADC_LongctrlSecureReq_B1 0 "NoRequest" 1 "Request"  ;
VAL_ 361 ADC_ShifttoAVHReq_B1 0 "Not active" 1 "Active"  ;
VAL_ 361 ADC_TrkTargt0St_B1 0 "not dectected" 1 "dectected"  ;
VAL_ 361 ADC_AS_pauseReq_B1 0 "No request" 1 "request"  ;
VAL_ 361 ADC_AS_calibrationReq_B1 0 "Invalid" 1 "Request to Very high level" 2 "Request to High level" 3 "Request to Normal level" 4 "Request to Low level" 5 "Request to Very low level"  ;
VAL_ 361 ADC_AS_exitcurrentlevelReq_B1 0 "No request" 1 "request"  ;
VAL_ 361 ADC_AS_ReqToadjust_B1 0 "Invalid" 1 "PAS Request to Very high level" 2 "PAS Request to High level" 3 "PAS Request to Normal level" 4 "PAS Request to Low level" 5 "PAS Request to Very low level"  ;
VAL_ 361 ADC_ASActiveSt_B 0 "Not Active" 1 "Active"  ;
VAL_ 361 ADC_AS_UnsafelevelunableReq_B1 0 "No request" 1 "request"  ;
VAL_ 361 ADC_FcsActiveStatus_B 0 "No Active" 1 "Active"  ;
VAL_ 361 ADC_AEBFaultSt_B1 0 "Not fault" 1 "Fault"  ;
VAL_ 361 ADC_AEBOffSt_B1 0 "On" 1 "Off"  ;
VAL_ 361 ADC_AEBInterventionSt_B1 0 "No intervention" 1 "Intervention"  ;
VAL_ 361 ADC_AEBDecelCtrlReq_B1 0 "No request" 1 "Request"  ;
VAL_ 361 ADC_AEBLVehHoldReq_B1 0 "No request" 1 "Request"  ;
VAL_ 361 ADC_AEBTarCalss_B1 0 "Not dectected" 1 "Car" 2 "Pedestrian" 3 "Two wheels" 4 "Motorcycle" 5 "Truck" 6 "Unknown" 7 "Reserve"  ;
VAL_ 361 ADC_AEBTarDetSensor_B1 0 "Invalid" 1 "Not Fusion" 2 "Not used" 3 "Fusion"  ;
VAL_ 361 ADC_TurnLightReq_B1 0 "No Request" 1 "turn off" 2 "turn on left turn lamp" 3 "turn on right turn lamp" 4 "turn on Hazard Lamp" 5 "turn on RCW Hazard Lamp(4HZ)"  ;
VAL_ 361 ADC_PAA2ESPAxReqEnable_B1 0 "Flase" 1 "True"  ;
VAL_ 361 ADC_PAA2ESPBrakeFunctionMode_B1 0 "None" 1 "APA" 2 "RPA" 3 "AVP" 4 "Dynamic AVP"  ;
VAL_ 361 ADC_PAA2ESPEpbReq_B1 0 "None" 1 "ReleaseReq" 2 "ApplyReq"  ;
VAL_ 361 ADC_PAA2ESPEpbReqSt_B1 0 "No request" 1 "Request"  ;
VAL_ 361 ADC_ESPSwitchReq_B1 0 "Not Request" 1 "Request"  ;
VAL_ 361 ADC_PAA2EPBBrakeFunctionMode_B1 0 "Not active" 1 "Active"  ;
VAL_ 361 ADC_PAA2ESPApEmgyBrkReq_B1 0 "Flase" 1 "True"  ;
VAL_ 361 ADC_PAA2ESPComfBrakeReq_B1 0 "ComfBrakeReq_NoReq" 1 "ComfBrakeReq_Type1" 2 "ComfBrakeReq_Type2"  ;
VAL_ 361 ADC_PAA2ESPApDriveOffReq_B1 0 "Flase" 1 "True"  ;
VAL_ 361 ADC_PAA2ESPApStandstillReq_B1 0 "Flase" 1 "True"  ;
VAL_ 361 ADC_PAA2ESPApPrefillReq_B1 0 "Flase" 1 "True"  ;
VAL_ 361 ADC_EPBReq_B1 0 "Not Request" 1 "Request"  ;
VAL_ 361 ADC_VehTorqLimitEnable_B1 0 "Not enable" 1 "Enable"  ;
VAL_ 361 ADC_VehTorqReqEnable_B1 0 "Not enable" 1 "Enable"  ;
VAL_ 361 ADC_PAAPwrModeReq_B1 0 "No Request" 1 "Power On Request (PTready)"  ;
VAL_ 361 ADC_PAAGrarLvlReq_B1 0 "No Request" 1 "Park" 2 "Reversed" 3 "Neutral" 4 "Drive" 5 "Reversed" 6 "Reversed" 7 "Reversed"  ;
VAL_ 361 ADC_PAAGrarLvlReqEnable_B1 0 "No request" 1 "Gear shift request"  ;
VAL_ 361 ADC_ActTrqReqVD_B1 0 "invalid" 1 "valid"  ;
VAL_ 361 ADC_RCTBBrkReq_B1 0 "No request" 1 "Request"  ;
VAL_ 361 ADC_TarGearReqVld_B1 0 "Invalid" 1 "Valid"  ;
VAL_ 361 ADC_FctSts_B1 0 "Off" 1 "On"  ;
