VERSION "Version"

NS_ :

BS_:

BU_: CCU IBCS IXCU RBM EPS ADC IBCS_IXCU IDU Tester CCURT2 RT2_C3 OTAWL ZCUF ZCUL ZCUR ZCUT IPS DCU NIDU RLBMS CBM WACUFL IDC IID VIU CCURT1 RT1_C0 RT1_C1 AVAS FLLCM FRLCM RLLCMA RRLCMA RLLCMB RRLCMB LBMS LBMSAD MFS FCP ITS BCB DCDC PCU EOP DCU2 BMS TMC SRS ECS CD AMP WHUD IMR FIMR FAPA FLR FRR RLR RRR IFC PAS INU SBM WCM ETC TBOX TBOX2 DSM FLPDM FRPDM RLPDM RRPDM HVSMR SCMRL SCMRR EBU EPB PCS V2XOBU EVCC VDC ADM PLGM FBLCM RLISD RRISD RCP RFR WCMFR SCMR TFOAR TROAR HVSPRL HVSPRR

BO_ 360 BCS_6_C: 64 IBCS
 SG_ BCS_6_CRC : 7|16@0+ (1,0) [0|65535] ""  CCU,ADC
 SG_ BCS_6_Counter : 23|8@0+ (1,0) [0|255] ""  CCU,ADC
 SG_ BCS_HydBrkActvTq_FL : 31|16@0+ (1,-32768) [-32768|32767] "Nm"  CCU,CCURT1,ADC
 SG_ BCS_HydBrkActvTq_FR : 47|16@0+ (1,-32768) [-32768|32767] "Nm"  CCU,CCURT1,ADC
 SG_ BCS_HydBrkActvTq_RL : 63|16@0+ (1,-32768) [-32768|32767] "Nm"  CCU,CCURT1,ADC
 SG_ BCS_HydBrkActvTq_RR : 79|16@0+ (1,-32768) [-32768|32767] "Nm"  CCU,CCURT1,ADC
 SG_ BCS_HydBrkReqTq : 95|16@0+ (1,-32768) [-32768|32767] "Nm"  CCU,ADC
 SG_ BCS_BrkActvTq : 111|16@0+ (1,-32768) [-32768|32767] "Nm"  CCU,ADC
 SG_ BCS_HydBrkActvTq : 127|16@0+ (1,-32768) [-32768|32767] "Nm"  CCU,ADC
 SG_ BCS_DycESCActTq : 143|16@0+ (1,-32768) [-32768|32767] "Nm"  CCU,ADC
 SG_ BCS_BrkTqCtrlAvlDriving : 159|3@0+ (1,0) [0|7] ""  CCU,ADC
 SG_ BCS_BrkTqCtrlAvlParking : 173|2@0+ (1,0) [0|3] ""  CCU,ADC
 SG_ BCS_BrkTqCtrlActv : 175|2@0+ (1,0) [0|3] ""  CCU,ADC
 SG_ BCS_DycEscTarTqCtrlAvl : 191|1@0+ (1,0) [0|1] ""  CCU,ADC
 SG_ BCS_DrvrBrkOvrd : 217|1@0+ (1,0) [0|1] ""  CCU,ADC
 SG_ BCS_DrvrBrkOvrdVld : 218|1@0+ (1,0) [0|1] ""  CCU,ADC
 SG_ BCS_DycEscTarTqActv : 219|1@0+ (1,0) [0|1] ""  CCU,ADC
 SG_ BCS_DrvrTqDes : 231|16@0+ (1,-32768) [-32768|32767] "Nm"  CCU,ADC
 SG_ BCS_ERV_VehSpd : 156|13@0+ (0.05625,0) [0|240] "km/h"  CCU,ADC
 SG_ BCS_ERV_VehSpdVld : 188|1@0+ (1,0) [0|1] ""  CCU,ADC
 SG_ BCS_EspFailrSts : 189|1@0+ (1,0) [0|1] ""  CCU,ADC
 SG_ BCS_ActvSts : 190|1@0+ (1,0) [0|1] ""  CCU,ADC
 SG_ BCS_BDCActive : 209|2@0+ (1,0) [0|3] ""  CCU,ADC
 SG_ BCS_DTCActvSts : 211|2@0+ (1,0) [0|3] ""  CCU,ADC
 SG_ BCS_errorFb : 215|4@0+ (1,0) [0|15] ""  CCU,ADC
 SG_ BCS_WheelSlipFLValid : 220|1@0+ (1,0) [0|1] ""  CCU,ADC
 SG_ BCS_WheelSlipFRValid : 221|1@0+ (1,0) [0|1] ""  CCU,ADC
 SG_ BCS_WheelSlipRLValid : 222|1@0+ (1,0) [0|1] ""  CCU,ADC
 SG_ BCS_WheelSlipRRValid : 223|1@0+ (1,0) [0|1] ""  CCU,ADC
 SG_ BCS_CrbsTarRecpTorqRqFA : 247|14@0+ (1,-6000) [-6000|10380] "Nm"  CCU,ADC
 SG_ BCS_CrbsTarRecpTorqRqFASt : 249|2@0+ (1,0) [0|3] ""  CCU,ADC
 SG_ BCS_CrbsTarRecpTorqRqRA : 263|14@0+ (1,-6000) [-6000|10380] "Nm"  CCU,ADC
 SG_ BCS_CrbsTarRecpTorqRqRASt : 265|2@0+ (1,0) [0|3] ""  CCU,ADC
 SG_ BCS_CrbsTarRecpTorqRqSum : 279|14@0+ (1,-6000) [-6000|10380] "Nm"  CCU,ADC
 SG_ BCS_CrbsTarRecpTorqRqSumSt : 281|2@0+ (1,0) [0|3] ""  CCU,ADC
 SG_ BCS_WheelSlipFL : 199|8@0+ (0.004,0) [0|1.002] ""  CCU,ADC
 SG_ BCS_WheelSlipFR : 207|8@0+ (0.004,0) [0|1.002] ""  CCU,ADC
 SG_ BCS_WheelSlipRL : 343|8@0+ (0.004,0) [0|1.002] ""  CCU,ADC
 SG_ BCS_WheelSlipRR : 351|8@0+ (0.004,0) [0|1.002] ""  CCU,ADC

BO_ 618 EPB_1: 32 IXCU
 SG_ EPB_1_CRC : 7|16@0+ (1,0) [0|65535] ""  CCU,CCURT1,CCURT2,RT1_C1,RT2_C3,ZCUR,VDC,RBM,IBCS,EBU,ADC
 SG_ EPB_1_Counter : 23|8@0+ (1,0) [0|255] ""  CCU,CCURT1,CCURT2,RT1_C1,RT2_C3,ZCUR,VDC,RBM,IBCS,EBU,ADC
 SG_ EPB_SwitchSt : 31|2@0+ (1,0) [0|3] ""  CCU,CCURT1,CCURT2,RT1_C0,RT1_C1,ZCUR,VDC,SRS,RBM,IBCS,ADC
 SG_ EPB_SwitchStVD : 29|1@0+ (1,0) [0|1] ""  CCU,CCURT1,CCURT2,RT1_C0,RT1_C1,ZCUR,VDC,SRS,RBM,IBCS,ADC
 SG_ EPB_SysSt : 28|3@0+ (1,0) [0|7] ""  CCU,CCURT1,CCURT2,RT1_C0,RT1_C1,VDC,SRS,RBM,IBCS,EBU,IDC,ADC
 SG_ EPB_FailSt : 39|1@0+ (1,0) [0|1] ""  CCU,CCURT1,CCURT2,RT1_C0,RT1_C1,VDC,SRS,RBM,IBCS,IDC,ADC
 SG_ EPB_ExtAvailable : 47|2@0+ (1,0) [0|3] ""  CCU,CCURT1,CCURT2,RT1_C1,VDC,RBM,IBCS,ADC
 SG_ EPB_DynamicApplySt : 82|3@0+ (1,0) [0|7] ""  CCU,CCURT1,CCURT2,RT1_C1,VDC,RBM,IBCS,ADC
 SG_ EPB_ActuatorSt_R : 107|4@0+ (1,0) [0|15] ""  CCU,CCURT1,CCURT2,RT1_C1,VDC,RBM,IBCS,ADC
 SG_ EPB_RWUActvSts : 109|2@0+ (1,0) [0|3] ""  CCU,CCURT1,CCURT2,ADC
 SG_ EPB_RWUAvl : 111|2@0+ (1,0) [0|3] ""  CCU,CCURT1,CCURT2,ADC
 SG_ EPB_EpbAvl : 119|2@0+ (1,0) [0|3] ""  CCU,CCURT1,CCURT2,ADC
 SG_ EPB_RPAAVPAvailability : 129|2@0+ (1,0) [0|3] ""  CCU,CCURT1,CCURT2,ADC
 SG_ EPB_APAAvailability : 143|1@0+ (1,0) [0|1] ""  CCU,CCURT1,CCURT2,IBCS,ADC
 SG_ EPB_ActuatorSt_L_1 : 141|4@0+ (1,0) [0|15] ""  CCU,CCURT1,CCURT2,RT1_C1,VDC,IBCS,ADC
 SG_ EPB_MotorCurrent_L_1 : 137|10@0+ (0.1,-51.1) [-51.1|51.1] "A"  CCU,CCURT1,CCURT2,IBCS,ADC

BO_ 446 RBM_1_C: 64 RBM
 SG_ RBM_BATResultSt : 81|1@0+ (1,0) [0|1] ""  IBCS,ADC
 SG_ RBU_VehSpdVD : 138|1@0+ (1,0) [0|1] ""  IBCS,ADC,VIU
 SG_ RBU_VehSpd : 135|13@0+ (0.05625,0) [0|240] "km/h"  IBCS,ADC,VIU
 SG_ RBU_SeconBrkCDAAvailableSt : 151|3@0+ (1,0) [0|7] ""  IBCS,ADC,VIU
 SG_ RBU_SeconBrkCommuniSt : 148|1@0+ (1,0) [0|1] ""  IBCS,ADC,VIU
 SG_ RBU_SeconBrkCDAActiveSt : 147|1@0+ (1,0) [0|1] ""  IBCS,ADC,VIU
 SG_ RBU_SeconBrkEPBst : 146|3@0+ (1,0) [0|7] ""  IBCS,ADC,VIU
 SG_ RBU_SeconBrkComChannel : 159|2@0+ (1,0) [0|3] ""  IBCS,ADC,VIU
 SG_ RBU_FourwhlsBrkTrq : 157|14@0+ (1,0) [0|10230] "N"  IBCS,ADC,VIU
 SG_ RBU_FLWheelSpdEdgesSum : 175|12@0+ (1,0) [0|4095] ""  IBCS,ADC,VIU
 SG_ RBU_FRWheelSpdEdgesSum : 179|12@0+ (1,0) [0|4095] ""  IBCS,ADC,VIU
 SG_ RBU_RLWheelSpdEdgesSum : 199|12@0+ (1,0) [0|4095] ""  IBCS,ADC,VIU
 SG_ RBU_RRWheelSpdEdgesSum : 203|12@0+ (1,0) [0|4095] ""  IBCS,ADC,VIU
 SG_ RBU_FLWheelSpd : 223|13@0+ (0.05625,0) [0|240] "km/h"  IBCS,ADC,VIU
 SG_ RBU_FLWheelSpdVD : 226|1@0+ (1,0) [0|1] ""  IBCS,ADC,VIU
 SG_ RBU_RLWheelRotatedDirection : 225|1@0+ (1,0) [0|1] ""  IBCS,ADC,VIU
 SG_ RBU_RLWheelRotatedDirectionVD : 224|1@0+ (1,0) [0|1] ""  IBCS,ADC,VIU
 SG_ RBU_FRWheelSpd : 239|13@0+ (0.05625,0) [0|240] "km/h"  IBCS,ADC,VIU
 SG_ RBU_FRWheelSpdVD : 242|1@0+ (1,0) [0|1] ""  IBCS,ADC,VIU
 SG_ RBU_RRWheelRotatedDirection : 241|1@0+ (1,0) [0|1] ""  IBCS,ADC,VIU
 SG_ RBU_RRWheelRotatedDirectionVD : 240|1@0+ (1,0) [0|1] ""  IBCS,ADC,VIU
 SG_ RBU_RLWheelSpd : 255|13@0+ (0.05625,0) [0|240] "km/h"  IBCS,ADC,VIU
 SG_ RBU_RLWheelSpdVD : 258|1@0+ (1,0) [0|1] ""  IBCS,ADC,VIU
 SG_ RBU_RRWheelSpd : 271|13@0+ (0.05625,0) [0|240] "km/h"  IBCS,ADC,VIU
 SG_ RBU_RRWheelSpdVD : 274|1@0+ (1,0) [0|1] ""  IBCS,ADC,VIU
 SG_ RBU_FLWheelSpdEdgesSumVD : 287|1@0+ (1,0) [0|1] ""  IBCS,ADC,VIU
 SG_ RBU_FRWheelSpdEdgesSumVD : 286|1@0+ (1,0) [0|1] ""  IBCS,ADC,VIU
 SG_ RBU_RLWheelSpdEdgesSumVD : 285|1@0+ (1,0) [0|1] ""  IBCS,ADC,VIU
 SG_ RBU_RRWheelSpdEdgesSumVD : 284|1@0+ (1,0) [0|1] ""  IBCS,ADC,VIU
 SG_ RBU_FLWheelRotatedDirection : 283|1@0+ (1,0) [0|1] ""  IBCS,ADC,VIU
 SG_ RBU_FLWheelRotatedDirectionVD : 282|1@0+ (1,0) [0|1] ""  IBCS,ADC,VIU
 SG_ RBU_FRWheelRotatedDirection : 281|1@0+ (1,0) [0|1] ""  IBCS,ADC,VIU
 SG_ RBU_FRWheelRotatedDirectionVD : 280|1@0+ (1,0) [0|1] ""  IBCS,ADC,VIU

BO_ 430 CCU_SRS_1: 64 CCU
 SG_ SRS_1_CRC_1 : 7|16@0+ (1,0) [0|65535] ""  ZCUF,ZCUT,LBMS,IDU,ADC,FAPA,VIU,IFC,TBOX,TBOX2
 SG_ SRS_1_Counter_1 : 23|8@0+ (1,0) [0|255] ""  ZCUF,ZCUT,LBMS,IDU,ADC,FAPA,VIU,IFC,TBOX,TBOX2
 SG_ SRS_CrashOutputSt : 31|8@0+ (1,0) [0|160] ""  ZCUF,ZCUL,ZCUR,ZCUT,LBMS,IDU,ADC,FAPA,VIU,IFC,TBOX,TBOX2
 SG_ SRS_Front_CrashOutputSt : 39|1@0+ (1,0) [0|1] ""  ZCUF,ZCUL,ZCUR,ZCUT,IDC,ADC,FAPA,VIU,IFC,TBOX,TBOX2
 SG_ SRS_DriverSide_CrashOutputSt : 38|1@0+ (1,0) [0|1] ""  ZCUF,ZCUL,ZCUR,ZCUT,IDC,ADC,FAPA,VIU,IFC,TBOX,TBOX2
 SG_ SRS_PassengerSide_CrashOutputSt : 37|1@0+ (1,0) [0|1] ""  ZCUF,ZCUL,ZCUR,ZCUT,IDC,ADC,FAPA,VIU,IFC,TBOX,TBOX2
 SG_ SRS_Rear_CrashOutputSt : 36|1@0+ (1,0) [0|1] ""  ZCUF,ZCUL,ZCUR,ZCUT,IDU,IDC,ADC,FAPA,VIU,IFC,TBOX,TBOX2
 SG_ SRS_RolloverCrashOutputSt : 35|1@0+ (1,0) [0|1] ""  ZCUF,ZCUL,ZCUR,ZCUT,IDC,ADC,FAPA,VIU,IFC,TBOX,TBOX2
 SG_ SRS_NearCrashOutputSt : 34|1@0+ (1,0) [0|1] ""  ZCUF,ZCUL,ZCUR,ZCUT,IDC,ADC,FAPA,VIU,IFC,TBOX,TBOX2
 SG_ SRS_1_CRC_2 : 111|16@0+ (1,0) [0|65535] ""  ZCUF,ZCUT,EPS,EPB,ADC,FAPA,FLR,FRR,RLR,RRR,VIU,IFC
 SG_ SRS_1_Counter_2 : 127|8@0+ (1,0) [0|255] ""  ZCUF,ZCUT,EPS,EPB,ADC,FAPA,FLR,FRR,RLR,RRR,VIU,IFC
 SG_ SRS_YawSnsCalibSt : 135|1@0+ (1,0) [0|1] ""  ZCUL,ZCUR,ZCUT,ADC,FAPA,FLR,FRR,RLR,RRR,VIU,IFC
 SG_ SRS_VehLongAccelVD : 134|2@0+ (1,0) [0|3] ""  ZCUF,ZCUL,ZCUR,ZCUT,DCU,NIDU,EPS,EPB,IXCU,IDC,ADC,FAPA,FLR,FRR,RLR,RRR,VIU,IFC,PCS,TBOX,V2XOBU
 SG_ SRS_VehLatrlAccelVD : 132|2@0+ (1,0) [0|3] ""  ZCUL,ZCUR,ZCUT,DCU,NIDU,EPS,IXCU,IDC,ADC,FAPA,FLR,FRR,RLR,RRR,VIU,IFC,PCS,TBOX,V2XOBU
 SG_ SRS_YawRateVD : 130|2@0+ (1,0) [0|3] ""  ZCUL,ZCUR,ZCUT,DCU,NIDU,EPS,IXCU,ADC,FAPA,FLR,FRR,RLR,RRR,VIU,IFC,PCS,TBOX,V2XOBU
 SG_ SRS_VehLongAccel : 143|12@0+ (0.001,-2) [-2|2] "g"  ZCUF,ZCUL,ZCUR,ZCUT,DCU,NIDU,EPS,EPB,IXCU,IDC,ADC,FAPA,FLR,FRR,RLR,RRR,VIU,IFC,PCS,TBOX,V2XOBU
 SG_ SRS_VehLatrlAccel : 147|12@0+ (0.001,-2) [-2|2] "g"  ZCUL,ZCUR,ZCUT,DCU,NIDU,EPS,IXCU,IDC,ADC,FAPA,FLR,FRR,RLR,RRR,VIU,IFC,PCS,TBOX,V2XOBU
 SG_ SRS_YawRate : 167|16@0+ (0.01,-180) [-180|180] "deg/s"  ZCUL,ZCUR,ZCUT,DCU,NIDU,EPS,IXCU,IDC,ADC,FAPA,FLR,FRR,RLR,RRR,VIU,IFC,PCS,TBOX,V2XOBU

BO_ 939 CCU_SRS_2: 32 CCU
 SG_ SRS_PsngrSeatBeltSt : 31|2@0+ (1,0) [0|3] ""  IDC,ADC,FAPA,FLR,FRR,VIU,TBOX,TBOX2
 SG_ SRS_DriverSeatBeltSt : 29|2@0+ (1,0) [0|3] ""  ZCUF,ZCUT,EPB,IXCU,IDC,ADC,FAPA,FLR,FRR,VIU,TBOX,TBOX2
 SG_ SRS_RearLeftSeatBeltSt : 27|2@0+ (1,0) [0|3] ""  IDC,ADC,FAPA,VIU,TBOX,TBOX2
 SG_ SRS_AirbagFaultSt : 25|1@0+ (1,0) [0|1] ""  IDC,ADC,FAPA,VIU,IFC,TBOX,V2XOBU
 SG_ SRS_RearRightSeatBeltSt : 39|2@0+ (1,0) [0|3] ""  IDC,ADC,FAPA,VIU,TBOX,TBOX2
 SG_ SRS_RearMiddleSeatBeltSt : 37|2@0+ (1,0) [0|3] ""  IDC,ADC,FAPA,VIU,TBOX,TBOX2

BO_ 363 EPS_1_C: 64 EPS
 SG_ EPS_1_CRC : 7|16@0+ (1,0) [0|65535] ""  CCU,CCURT1,CCURT2,RT1_C1,RT2_C3,VDC,RBM,IBCS,ECS,IXCU,ADC,IFC
 SG_ EPS_1_Counter : 23|8@0+ (1,0) [0|255] ""  CCU,CCURT1,CCURT2,RT1_C1,RT2_C3,VDC,RBM,IBCS,ECS,IXCU,ADC,IFC
 SG_ EPS_StrngWhlTorqVD : 31|1@0+ (1,0) [0|1] ""  CCU,CCURT1,CCURT2,RT1_C0,ADC,IFC
 SG_ EPS_StrngWhlTorq : 30|12@0+ (0.01,-15) [-15|15] "Nm"  CCU,CCURT1,CCURT2,RT1_C0,ADC,IFC
 SG_ TAS_CalibratedSt : 34|1@0+ (1,0) [0|1] ""  CCU,CCURT1,CCURT2,RT1_C0,RT1_C1,VDC,SRS,RBM,IBCS,ECS,IXCU,ADC,IFC
 SG_ EPS_SteeringAngleSpdVD : 32|1@0+ (1,0) [0|1] ""  CCU,CCURT1,CCURT2,RT1_C0,RT1_C1,RT2_C3,VDC,SRS,RBM,IBCS,ECS,IXCU,ADC,IFC
 SG_ EPS_SteeringAngleSpd : 47|8@0+ (4,0) [0|1016] "deg/sec"  CCU,CCURT1,CCURT2,RT1_C0,RT1_C1,RT2_C3,VDC,SRS,RBM,IBCS,ECS,IXCU,ADC,IFC
 SG_ EPS_SteeringAngle : 55|16@0+ (0.1,-780) [-780|780] "deg"  CCU,CCURT1,CCURT2,RT1_C0,RT1_C1,RT2_C3,VDC,SRS,RBM,IBCS,ECS,IXCU,ADC,IFC
 SG_ EPS_SteeringAngleVD : 71|1@0+ (1,0) [0|1] ""  CCU,CCURT1,CCURT2,RT1_C0,RT1_C1,RT2_C3,VDC,SRS,RBM,IBCS,ECS,IXCU,ADC,IFC
 SG_ EPS_ThermalSt : 69|2@0+ (1,0) [0|3] ""  CCU,CCURT1,CCURT2,ADC,IFC
 SG_ EPS_VMCErrFeedback : 84|4@0+ (1,0) [0|15] ""  CCU,CCURT1,CCURT2,RT1_C0,ADC
 SG_ EPS_PstOverlaySt_SideA : 95|2@0+ (1,0) [0|3] ""  CCU,CCURT1,CCURT2,ADC,IFC
 SG_ EPS_PstOverlaySt_SideB : 93|2@0+ (1,0) [0|3] ""  CCU,CCURT1,CCURT2,ADC,IFC
 SG_ EPS_HealthySt_SideA : 91|2@0+ (1,0) [0|3] ""  CCU,CCURT1,CCURT2,ADC,IFC
 SG_ EPS_HealthySt_SideB : 89|2@0+ (1,0) [0|3] ""  CCU,CCURT1,CCURT2,ADC,IFC
 SG_ EPS_PstOverlaySt : 103|3@0+ (1,0) [0|7] ""  CCU,CCURT1,CCURT2,ADC,IFC
 SG_ EPS_HealthySt_DualSide : 100|2@0+ (1,0) [0|3] ""  CCU,CCURT1,CCURT2,ADC,IFC
 SG_ EPS_PstOverLayRdntSt : 98|1@0+ (1,0) [0|1] ""  CCU,CCURT1,CCURT2,ADC,IFC
 SG_ EPS_VibrationWarnSt_A : 97|2@0+ (1,0) [0|3] ""  CCU,CCURT1,CCURT2,ADC,IFC
 SG_ SAC_ErrFeedback_SideA : 111|4@0+ (1,0) [0|15] ""  CCU,CCURT1,CCURT2,ADC,IFC
 SG_ SAC_ErrFeedback_SideB : 107|4@0+ (1,0) [0|15] ""  CCU,CCURT1,CCURT2,ADC,IFC
 SG_ EPS_ADASTargetAngle : 119|16@0+ (0.1,-780) [-780|780] "deg"  CCU,CCURT1,CCURT2,ADC,IFC
 SG_ EPS_PDC_CtrlSt : 129|2@0+ (1,0) [0|3] ""  CCU,CCURT1,CCURT2,SRS,ADC
 SG_ EPS_Shimmy_Compensation_CtrlSt : 131|2@0+ (1,0) [0|3] ""  CCU,CCURT1,CCURT2,ADC
 SG_ EPS_FunctionStyleSt : 135|2@0+ (1,0) [0|3] ""  CCU,CCURT1,CCURT2,RT1_C0,RT1_C1,IDC,ADC,IFC
 SG_ EPS_SteeringModeSt : 133|2@0+ (1,0) [0|3] ""  CCU,CCURT1,CCURT2,RT1_C0,RT1_C1,RT2_C3,IDC,ADC,IFC
 SG_ EPS_ActEffectiveChannel : 143|3@0+ (1,0) [0|7] ""  CCU,CCURT1,CCURT2,ADC,IFC
 SG_ EPS_ReqAngOverRange : 140|1@0+ (1,0) [0|1] ""  CCU,CCURT1,CCURT2,ADC,IFC
 SG_ EPS_SACMotorTorAct : 139|12@0+ (0.01,-6) [-6|6] "Nm"  CCU,CCURT1,CCURT2,ADC,IFC
 SG_ EPS_SACMotorTorLimInt : 159|11@0+ (0.01,0) [0|6] "Nm"  CCU,CCURT1,CCURT2,ADC,IFC
 SG_ EPS_ReqAngSpdOverRange : 164|1@0+ (1,0) [0|1] ""  CCU,CCURT1,CCURT2,ADC,IFC
 SG_ EPS_AssistPraSwitchToLKA : 163|1@0+ (1,0) [0|1] ""  CCU,CCURT1,CCURT2,RT1_C0,RT1_C1,VDC,ADC,IFC
 SG_ EPS_SteerGainEnable : 162|1@0+ (1,0) [0|1] ""  CCU,CCURT1,CCURT2,ADC,IFC
 SG_ EPS_EmSteerEnbale : 161|1@0+ (1,0) [0|1] ""  CCU,CCURT1,CCURT2,ADC,IFC
 SG_ EPS_SG_ErrFeedback : 175|4@0+ (1,0) [0|15] ""  CCU,CCURT1,CCURT2,ADC,IFC
 SG_ EPS_EM_ErrFeedback : 171|4@0+ (1,0) [0|15] ""  CCU,CCURT1,CCURT2,ADC,IFC
 SG_ EPS_VW_ErrFeedback : 183|4@0+ (1,0) [0|15] ""  CCU,CCURT1,CCURT2,ADC,IFC
 SG_ EPS_SACMotorTorActMot : 191|12@0+ (0.01,-6) [-6|6] "Nm"  CCU,CCURT1,CCURT2,ADC,IFC
 SG_ EPS_SACMotorTorLimIntMot : 194|11@0+ (0.01,0) [0|6] "Nm"  CCU,CCURT1,CCURT2,ADC,IFC
 SG_ EPS_SG_ActualLevel : 215|8@0+ (1,0) [0|254] "%"  CCU,CCURT1,CCURT2,ADC,IFC
 SG_ EPS_MotorTorSum : 219|12@0+ (0.01,-6) [-6|6] "Nm"  CCU,CCURT1,CCURT2,RT1_C0,ADC
 SG_ EPS_WarnLamp : 242|2@0+ (1,0) [0|3] ""  CCU,CCURT1,CCURT2,RT1_C0,IDC,ADC,IFC
 SG_ EPS_AssistPercentage : 255|8@0+ (1,0) [0|255] "%"  CCU,CCURT1,CCURT2,ADC,IFC
 SG_ EPS_AssistRatio : 263|8@0+ (1,0) [0|255] ""  CCU,CCURT1,CCURT2,ADC,IFC
 SG_ EPS_SteeringWhlTorFlt : 271|12@0+ (0.01,-15) [-15|15] "Nm"  CCU,CCURT1,CCURT2,RT1_C0,RT2_C3,ADC,IFC
 SG_ EPS_SteeringWhlTorFltVD : 275|2@0+ (1,0) [0|3] ""  CCU,CCURT1,CCURT2,RT1_C0,RT2_C3,ADC,IFC
 SG_ EPS_SteeringAngleRate : 273|14@0+ (0.2,-1600) [-1600|1600] "deg/s"  CCU,CCURT1,CCURT2,RT2_C3,ADC
 SG_ EPS_TqCtrlSt : 291|2@0+ (1,0) [0|3] ""  CCU,CCURT1,CCURT2,ADC
 SG_ EPS_MotorTorForDrv : 239|12@0+ (0.01,-20) [-20|20] "Nm"  CCU,CCURT1,CCURT2,IXCU,ADC
 SG_ EPS_TqCtrlAvl : 221|2@0+ (1,0) [0|3] ""  CCU,CCURT1,CCURT2,ADC
 SG_ EPS_AgCtrlAvl : 223|2@0+ (1,0) [0|3] ""  CCU,CCURT1,CCURT2,ADC
 SG_ EPS_MotorTorSumVD : 243|1@0+ (1,0) [0|1] ""  CCU,CCURT1,CCURT2,RT1_C0,ADC
 SG_ EPS_DrvOveRideSt : 160|1@0+ (1,0) [0|1] ""  CCU,CCURT1,CCURT2,ADC
 SG_ EPS_DrvOveRideVD : 176|1@0+ (1,0) [0|1] ""  CCU,CCURT1,CCURT2,ADC
 SG_ EPS_SteerVibrlAvl : 195|1@0+ (1,0) [0|1] ""  CCU,CCURT1,CCURT2,ADC
 SG_ EPS_HandsOffDetStVD : 240|1@0+ (1,0) [0|1] ""  CCU,CCURT1,CCURT2,ADC
 SG_ EPS_HandsOffDetSt : 289|2@0+ (1,0) [0|3] ""  CCU,CCURT1,CCURT2,ADC
 SG_ EPS_SteerMod : 303|3@0+ (1,0) [0|7] ""  CCU,CCURT1,CCURT2,ADC
 SG_ EPS_PDC_CtrltotalValue : 300|11@0+ (0.01,-10.24) [-10.24|10.23] "Nm"  CCU,CCURT1,CCURT2,ADC
 SG_ EPS_PDC_CtrllongtermValue : 305|11@0+ (0.01,-10.24) [-10.24|10.23] "Nm"  CCU,CCURT1,CCURT2,ADC
 SG_ EPS_PDC_CtrlshorttermValue : 326|11@0+ (0.01,-10.24) [-10.24|10.23] "Nm"  CCU,CCURT1,CCURT2,ADC
 SG_ EPS_Shimmy_Compensation_Value : 331|11@0+ (0.01,-10.24) [-10.24|10.23] "Nm"  CCU,CCURT1,CCURT2,ADC
 SG_ EPS_EpsSelfChkSts : 344|1@0+ (1,0) [0|1] ""  CCU,ADC
 SG_ EPS_ADCNetErrorFb : 359|3@0+ (1,0) [0|7] ""  CCU,CCURT1,CCURT2,ADC
 SG_ EPS_NetModeResp : 356|2@0+ (1,0) [0|3] ""  CCU,CCURT1,CCURT2,ADC
 SG_ EPS_ThermProtnMax : 367|8@0+ (1,0) [0|200] ""  CCU,ADC

BO_ 362 EPS_1_B: 64 EPS
 SG_ EPSB_1_CRC : 7|16@0+ (1,0) [0|65535] ""  CCU,RBM,IBCS,IXCU,ADC,VIU
 SG_ EPSB_1_Counter : 23|8@0+ (1,0) [0|255] ""  CCU,RBM,IBCS,IXCU,ADC,VIU
 SG_ EPSB_StrngWhlTorqVD : 31|1@0+ (1,0) [0|1] ""  CCU,ADC,VIU
 SG_ EPSB_StrngWhlTorq : 30|12@0+ (0.01,-15) [-15|15] "Nm"  CCU,CCURT1,CCURT2,ADC,VIU
 SG_ EPSB_TAS_CalibratedSt : 34|1@0+ (1,0) [0|1] ""  CCU,SRS,RBM,IBCS,IXCU,ADC,VIU
 SG_ EPSB_SteeringAngleSpdVD : 32|1@0+ (1,0) [0|1] ""  CCU,RT2_C3,SRS,RBM,IBCS,IXCU,ADC,VIU
 SG_ EPSB_SteeringAngleSpd : 47|8@0+ (4,0) [0|1016] "deg/sec"  CCU,RT2_C3,SRS,RBM,IBCS,IXCU,ADC,VIU
 SG_ EPSB_SteeringAngle : 55|16@0+ (0.1,-780) [-780|780] "deg"  CCU,RT2_C3,SRS,RBM,IBCS,IXCU,ADC,VIU
 SG_ EPSB_SteeringAngleVD : 71|1@0+ (1,0) [0|1] ""  CCU,RT2_C3,SRS,RBM,IBCS,IXCU,ADC,VIU
 SG_ EPSB_ThermalSt : 69|2@0+ (1,0) [0|3] ""  CCU,ADC,VIU
 SG_ EPSB_PstOverlaySt_SideA : 95|2@0+ (1,0) [0|3] ""  CCU,ADC,VIU
 SG_ EPSB_PstOverlaySt_SideB : 93|2@0+ (1,0) [0|3] ""  CCU,ADC,VIU
 SG_ EPSB_HealthySt_SideA : 91|2@0+ (1,0) [0|3] ""  CCU,ADC,VIU
 SG_ EPSB_HealthySt_SideB : 89|2@0+ (1,0) [0|3] ""  CCU,ADC,VIU
 SG_ EPSB_PstOverlaySt : 103|3@0+ (1,0) [0|7] ""  CCU,ADC,VIU
 SG_ EPSB_HealthySt_DualSide : 100|2@0+ (1,0) [0|3] ""  CCU,ADC,VIU
 SG_ EPSB_PstOverLayRdntSt : 98|1@0+ (1,0) [0|1] ""  CCU,ADC,VIU
 SG_ EPSB_VibrationWarnSt : 97|2@0+ (1,0) [0|3] ""  CCU,ADC,VIU
 SG_ EPSB_SAC_ErrFeedback_SideA : 111|4@0+ (1,0) [0|15] ""  CCU,ADC,VIU
 SG_ EPSB_SAC_ErrFeedback_SideB : 107|4@0+ (1,0) [0|15] ""  CCU,ADC,VIU
 SG_ EPSB_ADASTargetAngle : 119|16@0+ (0.1,-780) [-780|779.9] "deg"  CCU,ADC,VIU
 SG_ EPSB_FunctionStyleSt : 135|2@0+ (1,0) [0|3] ""  CCU,IDC,ADC,VIU
 SG_ EPSB_SteeringModeSt : 133|2@0+ (1,0) [0|3] ""  CCU,RT2_C3,IDC,ADC,VIU
 SG_ EPSB_ActEffectiveChannel : 143|3@0+ (1,0) [0|7] ""  CCU,ADC,VIU
 SG_ EPSB_ReqAngOverRange : 140|1@0+ (1,0) [0|1] ""  CCU,ADC,VIU
 SG_ EPSB_SACMotorTorAct : 139|12@0+ (0.01,-6) [-10|10] "Nm"  CCU,ADC,VIU
 SG_ EPSB_SACMotorTorLimInt : 159|11@0+ (0.01,0) [0|6] "Nm"  CCU,ADC,VIU
 SG_ EPSB_ReqAngSpdOverRange : 164|1@0+ (1,0) [0|1] ""  CCU,ADC,VIU
 SG_ EPSB_AssistPraSwitchToLKA : 163|1@0+ (1,0) [0|1] ""  CCU,ADC,VIU
 SG_ EPSB_SteerGainEnable : 162|1@0+ (1,0) [0|1] ""  CCU,ADC,VIU
 SG_ EPSB_EmSteerEnbale : 161|1@0+ (1,0) [0|1] ""  CCU,ADC,VIU
 SG_ EPSB_SG_ErrFeedback : 175|4@0+ (1,0) [0|15] ""  CCU,ADC,VIU
 SG_ EPSB_EM_ErrFeedback : 171|4@0+ (1,0) [0|15] ""  CCU,ADC,VIU
 SG_ EPSB_VW_ErrFeedback : 183|4@0+ (1,0) [0|15] ""  CCU,ADC,VIU
 SG_ EPSB_SACMotorTorActMot : 191|12@0+ (0.01,-6) [-6|6] "Nm"  CCU,ADC,VIU
 SG_ EPSB_SACMotorTorLimIntMot : 194|11@0+ (0.01,0) [0|6] "Nm"  CCU,ADC,VIU
 SG_ EPSB_SG_ActualLevel : 215|8@0+ (1,0) [0|254] "Nm"  CCU,ADC,VIU
 SG_ EPSB_MotorTorSum : 219|12@0+ (0.01,-6) [-6|6] "Nm"  CCU,ADC,VIU
 SG_ EPSB_WarnLamp : 242|2@0+ (1,0) [0|3] ""  CCU,IDC,ADC,VIU
 SG_ EPSB_MotorTorForDrv : 239|12@0+ (0.01,-20) [-20|20] "Nm"  CCU,CCURT1,CCURT2,ADC
 SG_ EPSB_AssistPercentage : 255|8@0+ (1,0) [0|255] "%"  CCU,ADC,VIU
 SG_ EPSB_AssistRatio : 263|8@0+ (1,0) [0|255] ""  CCU,ADC,VIU
 SG_ EPSB_StrngWhlTorqFlt : 271|12@0+ (0.01,-15) [-15|15] "Nm"  CCU,ADC,VIU
 SG_ EPSB_SteeringWhlTorFltVD : 275|2@0+ (1,0) [0|3] ""  CCU,RT2_C3,ADC,VIU
 SG_ EPSB_EpsSelfChkSts : 344|1@0+ (1,0) [0|1] ""  CCU,ADC
 SG_ EPSB_ThermProtnMax : 367|8@0+ (1,0) [0|200] ""  CCU,ADC

CM_ SG_ 360 BCS_6_CRC "E2E Profile 5 CRC";
CM_ SG_ 360 BCS_6_Counter "E2E Profile 5 Counter";
CM_ SG_ 360 BCS_HydBrkActvTq_FL "Hydraulic brake torque of the  front left wheel";
CM_ SG_ 360 BCS_HydBrkActvTq_FR "Hydraulic brake torque of the  front right wheel";
CM_ SG_ 360 BCS_HydBrkActvTq_RL "Hydraulic brake torque of the  rear left wheel";
CM_ SG_ 360 BCS_HydBrkActvTq_RR "Hydraulic brake torque of the  rear right wheel";
CM_ SG_ 360 BCS_HydBrkReqTq "It is the target brake torque to hydraulic brake";
CM_ SG_ 360 BCS_BrkActvTq "It is the real total brake  torque carried out by electric motor（ recuperation torque or electric brake torque）and ESP/IPB（hydraulic braketorque）.";
CM_ SG_ 360 BCS_HydBrkActvTq "It is the real hydraulic brake  torque carried out by ESP/IPB.";
CM_ SG_ 360 BCS_DycESCActTq "The real  DYC(Direct  yaw moment control)  of the ESP/IPB";
CM_ SG_ 360 BCS_BrkTqCtrlAvlDriving "It indicates  whether  ESP/IPB is available for cruise function.";
CM_ SG_ 360 BCS_BrkTqCtrlAvlParking "It indicates  whether  ESP/IPB is available for parking function.";
CM_ SG_ 360 BCS_BrkTqCtrlActv "It indicates  whether  ESP/IPB is  responsed for the brake request of ADAS.";
CM_ SG_ 360 BCS_DycEscTarTqCtrlAvl "The validity  of the DYC(Direct  yaw moment control)  of the ESP/IPB";
CM_ SG_ 360 BCS_DrvrBrkOvrd "Indicate driver brakes torque more than the ADAS/ADS. ";
CM_ SG_ 360 BCS_DrvrBrkOvrdVld "The validity  of  BCS_DrvrBrkOvrd";
CM_ SG_ 360 BCS_DycEscTarTqActv "Indicates the DYC of the ESP/IPB in active or not";
CM_ SG_ 360 BCS_DrvrTqDes "When driver prsees brake pedal，It is the brake torque calculated by ESP/IPB corresponding to  inputRod stroke.";
CM_ SG_ 360 BCS_ERV_VehSpd "Vehicle reference speed ";
CM_ SG_ 360 BCS_ERV_VehSpdVld "Quality/fault information to vehicle  reference speed ";
CM_ SG_ 360 BCS_EspFailrSts "It indicates whether ESP/IPB is error.When any function of ESP/IPB is error ，it will be error。";
CM_ SG_ 360 BCS_ActvSts "It indicates whether ESP/IPB is active. When any function of ESP/IPB is active ，it will be active。";
CM_ SG_ 360 BCS_BDCActive "Indicates Brake Disc Cleaning in active or not";
CM_ SG_ 360 BCS_DTCActvSts "Dragging Torque Control activation status";
CM_ SG_ 360 BCS_errorFb "Errors related to the braking system(ESP/IPB).It indicates the braking system can not respond to the deceleration request（brake torque） of the ADAS。";
CM_ SG_ 360 BCS_WheelSlipFLValid "The validity  of slip ratio of the  front left wheel";
CM_ SG_ 360 BCS_WheelSlipFRValid "The validity of slip ratio of the  front right wheel";
CM_ SG_ 360 BCS_WheelSlipRLValid "The validity of slip ratio of the  rear left wheel";
CM_ SG_ 360 BCS_WheelSlipRRValid "The validity of slip ratio of the  rear right wheel";
CM_ SG_ 360 BCS_CrbsTarRecpTorqRqFA "CRBS target recuperation torque requested by BCS to generator,applies to  front wheel drive ";
CM_ SG_ 360 BCS_CrbsTarRecpTorqRqFASt "Status of  BCS_CrbsTarRecpTorqRqFA";
CM_ SG_ 360 BCS_CrbsTarRecpTorqRqRA "CRBS target recuperation torque requested by BCS to generator,applies to  rear wheel drive ";
CM_ SG_ 360 BCS_CrbsTarRecpTorqRqRASt "Status of  BCS_CrbsTarRecpTorqRqRA";
CM_ SG_ 360 BCS_CrbsTarRecpTorqRqSum "CRBS target recuperation torque requested by BCS to generator,applies to 4WD and front wheel drive /rear wheel drive";
CM_ SG_ 360 BCS_CrbsTarRecpTorqRqSumSt "CRBS target recuperation torque requested by BCS to generator,applies to 4WD and front wheel drive /rear wheel drive";
CM_ SG_ 360 BCS_WheelSlipFL "Slip ratio of the  front left wheel";
CM_ SG_ 360 BCS_WheelSlipFR "Slip ratio of the  front right wheel";
CM_ SG_ 360 BCS_WheelSlipRL "Slip ratio of the  rear left wheel";
CM_ SG_ 360 BCS_WheelSlipRR "Slip ratio of the  rear right wheel";
CM_ SG_ 618 EPB_1_CRC "E2E Profile 5 CRC";
CM_ SG_ 618 EPB_1_Counter "E2E Profile 5 Counter";
CM_ SG_ 618 EPB_SwitchSt "EPB switch status ";
CM_ SG_ 618 EPB_SwitchStVD "EPB switch status validity";
CM_ SG_ 618 EPB_SysSt "EPB system status";
CM_ SG_ 618 EPB_FailSt "EPB fail status,to indicate wether EPB can response to external apply  request or not";
CM_ SG_ 618 EPB_ExtAvailable "EPB  status,to indicate wetherEPB can response to externalapply request or not";
CM_ SG_ 618 EPB_DynamicApplySt "EPB dynamic apply status";
CM_ SG_ 618 EPB_ActuatorSt_R "EPB right  actuator status";
CM_ SG_ 618 EPB_RWUActvSts "It indicates whether the RWU  of the ESP/IPB is active";
CM_ SG_ 618 EPB_RWUAvl "It indicates whether the RWU  of the EPB  is available";
CM_ SG_ 618 EPB_EpbAvl "The validity  of  EPB";
CM_ SG_ 618 EPB_RPAAVPAvailability "Flag indicate  RPA AVP availability for EPB control";
CM_ SG_ 618 EPB_APAAvailability "Flag indicate  APA availability for EPB control";
CM_ SG_ 618 EPB_ActuatorSt_L_1 "EPB left  actuator status";
CM_ SG_ 618 EPB_MotorCurrent_L_1 "EPB left motor current ";
CM_ SG_ 446 RBM_BATResultSt "Indicates the BAT(Brake Actuator Test) result status of the brake control system.";
CM_ SG_ 446 RBU_VehSpdVD "Quality/fault information to vehicle speed";
CM_ SG_ 446 RBU_VehSpd "Vehicle speed";
CM_ SG_ 446 RBU_SeconBrkCDAAvailableSt "Secondary brake actuator L2++ Cruise funtion interface healthy status .CDA NotAvailable: not available for L2++ system due to not initialization or failure.CDA NotAvailable By Situation: not available for L2++ system due to rules not fulfilled.CDA Available With Fault: L2++ system active with failure.CDA Available With Situation: L2++ system active with rules not fulfilled.CDA Available: No failure detected, pre-conditions for activing L2++ are fulfilled";
CM_ SG_ 446 RBU_SeconBrkCommuniSt "Secondary brake actuator communication healthy status.If ADC and Primary brake actuator relevant network communication is invalid , ADC need to receive the brake actuator signals from RBU.";
CM_ SG_ 446 RBU_SeconBrkCDAActiveSt "Secondary brake actuator working status in L2++.CDA (Controlled Deceleration for Automated Driving) for L2++ or Advance Cruise。L2++ Active: Secondary brake actuator working in L2++ or Advance Cruise.";
CM_ SG_ 446 RBU_SeconBrkEPBst "Secondary brake actuator-EPB system status.";
CM_ SG_ 446 RBU_SeconBrkComChannel "Secondary brake actuator Feekback which communication channel is used for ADC Control";
CM_ SG_ 446 RBU_FourwhlsBrkTrq "The total brake friction wheel_torque at four wheels.";
CM_ SG_ 446 RBU_FLWheelSpdEdgesSum "Accumulated sum of rising and falling edges of front left wheel speed sensor output·since IGN ON( the wheel plate have 43 teeth/cycle,the edge is 86)";
CM_ SG_ 446 RBU_FRWheelSpdEdgesSum "Accumulated sum of rising and falling edges of front right wheel speed sensor output·since IGN ON( the wheel plate have 43 teeth/cycle,the edge is 86)";
CM_ SG_ 446 RBU_RLWheelSpdEdgesSum "Accumulated sum of rising and falling edges of rear left wheel speed sensor output·since IGN ON( the wheel plate have 43teeth/cycle,the edge is 86)";
CM_ SG_ 446 RBU_RRWheelSpdEdgesSum "Accumulated sum of rising and falling edges of  rear right wheel speed sensor output·since IGN ON( the wheel plate have 43 teeth/cycle,the edge is 86)";
CM_ SG_ 446 RBU_FLWheelSpd "Current wheel speed information of front left wheel";
CM_ SG_ 446 RBU_FLWheelSpdVD "Quality/fault information to current wheel speed of front left wheel,be used for validity of BCS_FLWheelSpd and BCS_FLWheelSpdEdgesSum signal";
CM_ SG_ 446 RBU_RLWheelRotatedDirection "RL wheel rotate direction";
CM_ SG_ 446 RBU_RLWheelRotatedDirectionVD "RL wheel rotate direction validity";
CM_ SG_ 446 RBU_FRWheelSpd "Current wheel speed information of front right wheel";
CM_ SG_ 446 RBU_FRWheelSpdVD "Quality/fault information to current wheel speed of front left wheel,be used for validity of BCS_FRWheelSpd and BCS_FRWheelSpdEdgesSum signal";
CM_ SG_ 446 RBU_RRWheelRotatedDirection "RR wheel rotate direction";
CM_ SG_ 446 RBU_RRWheelRotatedDirectionVD "RR wheel rotate direction validity";
CM_ SG_ 446 RBU_RLWheelSpd "Current wheel speed information of rear left wheel";
CM_ SG_ 446 RBU_RLWheelSpdVD "Quality/fault information to current wheel speed of front left wheel,be used for validity of BCS_RLWheelSpd and BCS_RLWheelSpdEdgesSum signal";
CM_ SG_ 446 RBU_RRWheelSpd "Current wheel speed information of rear right wheel";
CM_ SG_ 446 RBU_RRWheelSpdVD "Quality/fault information to current wheel speed of RRont left wheel,be used for validity of BCS_RRWheelSpd and BCS_RRWheelSpdEdgesSum signal";
CM_ SG_ 446 RBU_FLWheelSpdEdgesSumVD "Quality/fault information to current wheel speed edges sum of front left wheel";
CM_ SG_ 446 RBU_FRWheelSpdEdgesSumVD "Quality/fault information to current wheel speed edges sum of front right wheel";
CM_ SG_ 446 RBU_RLWheelSpdEdgesSumVD "Quality/fault information to current wheel speed edges sum of rear left wheel";
CM_ SG_ 446 RBU_RRWheelSpdEdgesSumVD "Quality/fault information to current wheel speed edges sum of rear right wheel";
CM_ SG_ 446 RBU_FLWheelRotatedDirection "FL wheel rotate direction";
CM_ SG_ 446 RBU_FLWheelRotatedDirectionVD "FL wheel rotate direction validity";
CM_ SG_ 446 RBU_FRWheelRotatedDirection "FR wheel rotate direction";
CM_ SG_ 446 RBU_FRWheelRotatedDirectionVD "FR wheel rotate direction validity";
CM_ SG_ 430 SRS_1_CRC_1 "E2E Profile 5 CRC";
CM_ SG_ 430 SRS_1_Counter_1 "E2E Profile 5 Counter";
CM_ SG_ 430 SRS_CrashOutputSt "To inform there's crash event happened in last 2 seconds.After 2 seconds, the signal will turn to 0(crash here means any one of the 5 status defined below)";
CM_ SG_ 430 SRS_Front_CrashOutputSt "To inform there's front crash event happened in last 2 seconds. After 2 seconds, the signal will turn to 0.";
CM_ SG_ 430 SRS_DriverSide_CrashOutputSt "To inform there's driver side crash event happened in last 2 seconds. After 2 seconds, the signal will turn to 0.(Driver side is the left side for the left-hand-drive vehicle, the right side for the right-hand-drive one. )";
CM_ SG_ 430 SRS_PassengerSide_CrashOutputSt "To inform there's passenger side crash event happened in last 2 seconds. After 2 seconds, the signal will turn to 0.(Passenger side is the right side for the left-hand-drive vehicle, the left side for the right-hand-drive one. )";
CM_ SG_ 430 SRS_Rear_CrashOutputSt "To inform there's rear crash event happened in last 2 seconds. After 2 seconds, the signal will turn to 0.";
CM_ SG_ 430 SRS_RolloverCrashOutputSt "To inform there's rollover crash event happened in last 2 seconds. After 2 seconds, the signal will turn to 0.";
CM_ SG_ 430 SRS_NearCrashOutputSt "To inform there's near crash event happened in last 2 seconds.After 2 seconds, the signal will turn to 0";
CM_ SG_ 430 SRS_1_CRC_2 "E2E Profile 5 CRC";
CM_ SG_ 430 SRS_1_Counter_2 "E2E Profile 5 Counter";
CM_ SG_ 430 SRS_YawSnsCalibSt "To indicates  yaw sensor calibration state";
CM_ SG_ 430 SRS_VehLongAccelVD "To indicate vehicle longitudinal acceleration valid state";
CM_ SG_ 430 SRS_VehLatrlAccelVD "To indicate vehicle lateral acceleration valid state";
CM_ SG_ 430 SRS_YawRateVD "To indicate yaw rate valid state";
CM_ SG_ 430 SRS_VehLongAccel "To indicate vehicle longitudinal acceleration";
CM_ SG_ 430 SRS_VehLatrlAccel "To indicate vehicle lateral acceleration";
CM_ SG_ 430 SRS_YawRate "To indicate vehicle yaw rate";
CM_ SG_ 939 SRS_PsngrSeatBeltSt "To identify whether first row passenger seat belt is buckled.(Passenger side is the right side for the left-hand-drive vehicle, the left side for the right-hand-drive one. )";
CM_ SG_ 939 SRS_DriverSeatBeltSt "To identify whether first row driver seat belt is buckled.(Driver side is the left side for the left-hand-drive vehicle, the right side for the right-hand-drive one. )";
CM_ SG_ 939 SRS_RearLeftSeatBeltSt "To identify whetherRearLeftSeatBelt is buckled";
CM_ SG_ 939 SRS_AirbagFaultSt "To illuminate or turn off airbag warning indicator";
CM_ SG_ 939 SRS_RearRightSeatBeltSt "To identify  whetherRearRightSeatBelt is buckled";
CM_ SG_ 939 SRS_RearMiddleSeatBeltSt "To identify whetherRearMiddleSeatBelt is buckled";
CM_ SG_ 363 EPS_1_CRC "E2E Profile 5 CRC";
CM_ SG_ 363 EPS_1_Counter "E2E Profile 5 Counter";
CM_ SG_ 363 EPS_StrngWhlTorqVD "Steering Wheel Torque valid value";
CM_ SG_ 363 EPS_StrngWhlTorq "Steering wheel Torque ";
CM_ SG_ 363 TAS_CalibratedSt "The calibration information of steering angle sensor";
CM_ SG_ 363 EPS_SteeringAngleSpd "steering wheel angle speed";
CM_ SG_ 363 EPS_SteeringAngle "steering wheel angle";
CM_ SG_ 363 EPS_SteeringAngleVD "indicate that Angle VD";
CM_ SG_ 363 EPS_ThermalSt "EPS over thermal limit state";
CM_ SG_ 363 EPS_VMCErrFeedback "EPS Error reason feedback to VMC";
CM_ SG_ 363 EPS_PstOverlaySt_SideA "EPS_A Position Overlay Contrlo State";
CM_ SG_ 363 EPS_PstOverlaySt_SideB "EPS_B Position Overlay Contrlo State";
CM_ SG_ 363 EPS_HealthySt_SideA "EPS_A Healthy State";
CM_ SG_ 363 EPS_HealthySt_SideB "EPS_B Healthy State";
CM_ SG_ 363 EPS_PstOverlaySt "Overall EPS Position Overlay Control State";
CM_ SG_ 363 EPS_HealthySt_DualSide "Overall EPS Healthy States";
CM_ SG_ 363 EPS_PstOverLayRdntSt "EPS Position Overlay Control Redundant state";
CM_ SG_ 363 EPS_VibrationWarnSt_A "Vibration Warn State";
CM_ SG_ 363 SAC_ErrFeedback_SideA "EPS_A Errer Feedback";
CM_ SG_ 363 SAC_ErrFeedback_SideB "EPS_B Errer Feedback";
CM_ SG_ 363 EPS_ADASTargetAngle "EPS's target Angle after the safety limit";
CM_ SG_ 363 EPS_PDC_CtrlSt "EPS PDC cotrol status";
CM_ SG_ 363 EPS_Shimmy_Compensation_CtrlSt "EPS Shimmy cotrol status";
CM_ SG_ 363 EPS_FunctionStyleSt "EPS function style state";
CM_ SG_ 363 EPS_SteeringModeSt "EPS steering mode status";
CM_ SG_ 363 EPS_ActEffectiveChannel "Which Channel is controlling EPS";
CM_ SG_ 363 EPS_ReqAngOverRange "target angle received from ADAS/IFC over the safety range";
CM_ SG_ 363 EPS_SACMotorTorAct "SAC Actural motor torque";
CM_ SG_ 363 EPS_SACMotorTorLimInt "EPS’s internal safety limit of SAC motor torque";
CM_ SG_ 363 EPS_ReqAngSpdOverRange "Angular speed of target angle received from ADAS/IFC over the safety range";
CM_ SG_ 363 EPS_AssistPraSwitchToLKA "Indicate EPS Swithinto fixed steering parameters";
CM_ SG_ 363 EPS_SteerGainEnable "Steering Gain Enable";
CM_ SG_ 363 EPS_EmSteerEnbale "Emergency Steering Enable";
CM_ SG_ 363 EPS_SG_ErrFeedback "Steering Gain Enable Error Feedback";
CM_ SG_ 363 EPS_EM_ErrFeedback "Emergency Steering Enable Feedback";
CM_ SG_ 363 EPS_VW_ErrFeedback "Vibration Warn Enable Feedback";
CM_ SG_ 363 EPS_SACMotorTorActMot "SAC Actural motor torque";
CM_ SG_ 363 EPS_MotorTorSum "EPS Motor output Torque  (including SAC and driver steering) ";
CM_ SG_ 363 EPS_WarnLamp "Streering Warning Lamp";
CM_ SG_ 363 EPS_AssistPercentage "Current Assit divide the max desige assistant，for single ECU";
CM_ SG_ 363 EPS_AssistRatio "feedback to IDC the assist ratio ";
CM_ SG_ 363 EPS_SteeringWhlTorFlt "Steering wheel torque after Elfa filtering";
CM_ SG_ 363 EPS_SteeringWhlTorFltVD "indicate that EPS_SteeringWhlTorFlt Valid or not";
CM_ SG_ 363 EPS_SteeringAngleRate "steering wheel angle rate";
CM_ SG_ 363 EPS_TqCtrlSt "ESP response state for ADAS moter torque request";
CM_ SG_ 363 EPS_MotorTorForDrv "EPS motor Torque value for driver steering";
CM_ SG_ 363 EPS_TqCtrlAvl "EPS moter torque control available state for ADAS";
CM_ SG_ 363 EPS_AgCtrlAvl "EPS steer angle control available state for ADAS";
CM_ SG_ 363 EPS_MotorTorSumVD "EPS motor torque valid state of driver steering";
CM_ SG_ 363 EPS_DrvOveRideSt "Driver override detection state";
CM_ SG_ 363 EPS_DrvOveRideVD "Driver override detection valid state";
CM_ SG_ 363 EPS_SteerVibrlAvl "EPS steer vibration control available state for ADAS";
CM_ SG_ 363 EPS_HandsOffDetStVD "Hands Off Detected States valid value";
CM_ SG_ 363 EPS_HandsOffDetSt "Hands Off Detected States";
CM_ SG_ 363 EPS_SteerMod "EPS working mode";
CM_ SG_ 363 EPS_PDC_CtrltotalValue "EPS PDC Compensation total actual Value";
CM_ SG_ 363 EPS_PDC_CtrllongtermValue "EPS PDC Compensation longterm requirement Value";
CM_ SG_ 363 EPS_PDC_CtrlshorttermValue "EPS PDC Compensation short term actual Value";
CM_ SG_ 363 EPS_Shimmy_Compensation_Value "EPS Shimmy  Control  actual Value";
CM_ SG_ 363 EPS_EpsSelfChkSts "EPS self check Status";
CM_ SG_ 363 EPS_ADCNetErrorFb "ADC Network Fault Feedback";
CM_ SG_ 363 EPS_NetModeResp "EPS Net Mode Response";
CM_ SG_ 363 EPS_ThermProtnMax "EPS overtemperature protection";
CM_ SG_ 362 EPSB_1_CRC "E2E Profile 5 CRC";
CM_ SG_ 362 EPSB_1_Counter "E2E Profile 5 Counter";
CM_ SG_ 362 EPSB_StrngWhlTorqVD "Steering Wheel Torque valid value";
CM_ SG_ 362 EPSB_StrngWhlTorq "Steering wheel Torque ";
CM_ SG_ 362 EPSB_TAS_CalibratedSt "The calibration information of steering angle sensor";
CM_ SG_ 362 EPSB_SteeringAngleSpd "steering wheel angle speed";
CM_ SG_ 362 EPSB_SteeringAngle "steering wheel angle";
CM_ SG_ 362 EPSB_SteeringAngleVD "indicate that Angle VD";
CM_ SG_ 362 EPSB_ThermalSt "EPS over thermal limit state";
CM_ SG_ 362 EPSB_PstOverlaySt_SideA "EPS_A Position Overlay Contrlo State";
CM_ SG_ 362 EPSB_PstOverlaySt_SideB "EPS_B Position Overlay Contrlo State";
CM_ SG_ 362 EPSB_HealthySt_SideA "EPS_A Healthy State";
CM_ SG_ 362 EPSB_HealthySt_SideB "EPS_B Healthy State";
CM_ SG_ 362 EPSB_PstOverlaySt "Overall EPS Position Overlay Control State";
CM_ SG_ 362 EPSB_HealthySt_DualSide "Overall EPS Healthy States";
CM_ SG_ 362 EPSB_PstOverLayRdntSt "EPS Position Overlay Control Redundant state";
CM_ SG_ 362 EPSB_VibrationWarnSt "Vibration Warn State";
CM_ SG_ 362 EPSB_SAC_ErrFeedback_SideA "EPS_A Errer Feedback";
CM_ SG_ 362 EPSB_SAC_ErrFeedback_SideB "EPS_B Errer Feedback";
CM_ SG_ 362 EPSB_ADASTargetAngle "EPS's target Angle after the safety limit";
CM_ SG_ 362 EPSB_FunctionStyleSt "EPS function style state";
CM_ SG_ 362 EPSB_SteeringModeSt "EPS steering mode status";
CM_ SG_ 362 EPSB_ActEffectiveChannel "Which Channel is controlling EPS";
CM_ SG_ 362 EPSB_ReqAngOverRange "target angle received from ADAS/IFC over the safety range";
CM_ SG_ 362 EPSB_SACMotorTorAct "SAC Actural motor torque";
CM_ SG_ 362 EPSB_SACMotorTorLimInt "EPS’s internal safety limit of SAC motor torque";
CM_ SG_ 362 EPSB_ReqAngSpdOverRange "Angular speed of target angle received from ADAS/IFC over the safety range";
CM_ SG_ 362 EPSB_AssistPraSwitchToLKA "Indicate EPS Swithinto fixed steering parameters";
CM_ SG_ 362 EPSB_SteerGainEnable "Steering Gain Enable";
CM_ SG_ 362 EPSB_EmSteerEnbale "Emergency Steering Enable";
CM_ SG_ 362 EPSB_SG_ErrFeedback "Steering Gain Enable Error Feedback";
CM_ SG_ 362 EPSB_EM_ErrFeedback "Emergency Steering Enable Feedback";
CM_ SG_ 362 EPSB_VW_ErrFeedback "Vibration Warn Enable Feedback";
CM_ SG_ 362 EPSB_SACMotorTorActMot "SAC Actural motor torque";
CM_ SG_ 362 EPSB_MotorTorSum "EPS Motor output Torque  (including SAC and driver steering) ";
CM_ SG_ 362 EPSB_WarnLamp "Streering Warning Lamp";
CM_ SG_ 362 EPSB_MotorTorForDrv "EPS motor Torque value for driver steering";
CM_ SG_ 362 EPSB_AssistPercentage "Current Assit divide the max desige assistant，for single ECU";
CM_ SG_ 362 EPSB_AssistRatio "feedback to IDC the assist ratio ";
CM_ SG_ 362 EPSB_StrngWhlTorqFlt "Steering wheel torque after Elfa filtering";
CM_ SG_ 362 EPSB_SteeringWhlTorFltVD "indicate that EPS_SteeringWhlTorFlt Valid or not";
CM_ SG_ 362 EPSB_EpsSelfChkSts "EPSB self check Status";
CM_ SG_ 362 EPSB_ThermProtnMax "EPS overtemperature protection";

BA_DEF_ BO_  "GenMsgCycleTime" INT 0 0;
BA_DEF_ BO_  "GenMsgCycleTimeFast" INT 0 0;
BA_DEF_ BO_  "GenMsgSendType" ENUM  "Periodic","Event","IfActive","POE","PA","FixedPeriodic","Event","EnabledPeriodic","NotUsed","NotUsed","EventPeriodic","NotUsed","NotUsed","NoMsgSendType";
BA_DEF_ BO_  "VFrameFormat" ENUM  "StandardCAN","ExtendedCAN","reserved","reserved","reserved","reserved","reserved","reserved","reserved","reserved","reserved","reserved","reserved","reserved","StandardCAN_FD","ExtendedCAN_FD";
BA_DEF_ BO_  "CANFD_BRS" ENUM  "0","1";
BA_DEF_ SG_  "EventCommandSignal" ENUM  "No","Yes";
BA_DEF_ SG_  "GatewayedSignals" ENUM  "No","Yes";
BA_DEF_ SG_  "GenSigInactiveValue" HEX 0 0;
BA_DEF_ SG_  "GenSigInvalidValue" HEX 0 0;
BA_DEF_ SG_  "GenSigSendType" ENUM  "Trigger","Passive","Cyclic","OnWrite","OnWriteWithRepetition","OnChange","OnChangeWithRepetition","IfActive","IfActiveWithRepetition","NoSigSendType";
BA_DEF_ SG_  "GenSigStartValue" HEX 0 0;
BA_DEF_ SG_  "GenSigTimeoutValue" HEX 0 0;
BA_DEF_ SG_  "Remark" STRING ;
BA_ "GenMsgCycleTime" BO_ 360 10;
BA_ "GenMsgCycleTimeFast" BO_ 360 0;
BA_ "GenMsgSendType" BO_ 360 0;
BA_ "VFrameFormat" BO_ 360 14;
BA_ "CANFD_BRS" BO_ 360 1;
BA_ "GenMsgCycleTime" BO_ 360 10;
BA_ "GenMsgCycleTimeFast" BO_ 360 0;
BA_ "GenMsgSendType" BO_ 360 0;
BA_ "VFrameFormat" BO_ 360 14;
BA_ "CANFD_BRS" BO_ 360 1;
BA_ "GenMsgCycleTime" BO_ 360 10;
BA_ "GenMsgCycleTimeFast" BO_ 360 0;
BA_ "GenMsgSendType" BO_ 360 0;
BA_ "VFrameFormat" BO_ 360 14;
BA_ "CANFD_BRS" BO_ 360 1;
BA_ "GenMsgCycleTime" BO_ 360 10;
BA_ "GenMsgCycleTimeFast" BO_ 360 0;
BA_ "GenMsgSendType" BO_ 360 0;
BA_ "VFrameFormat" BO_ 360 14;
BA_ "CANFD_BRS" BO_ 360 1;
BA_ "GenMsgCycleTime" BO_ 360 10;
BA_ "GenMsgCycleTimeFast" BO_ 360 0;
BA_ "GenMsgSendType" BO_ 360 0;
BA_ "VFrameFormat" BO_ 360 14;
BA_ "CANFD_BRS" BO_ 360 1;
BA_ "GenMsgCycleTime" BO_ 360 10;
BA_ "GenMsgCycleTimeFast" BO_ 360 0;
BA_ "GenMsgSendType" BO_ 360 0;
BA_ "VFrameFormat" BO_ 360 14;
BA_ "CANFD_BRS" BO_ 360 1;
BA_ "GenMsgCycleTime" BO_ 360 10;
BA_ "GenMsgCycleTimeFast" BO_ 360 0;
BA_ "GenMsgSendType" BO_ 360 0;
BA_ "VFrameFormat" BO_ 360 14;
BA_ "CANFD_BRS" BO_ 360 1;
BA_ "GenMsgCycleTime" BO_ 360 10;
BA_ "GenMsgCycleTimeFast" BO_ 360 0;
BA_ "GenMsgSendType" BO_ 360 0;
BA_ "VFrameFormat" BO_ 360 14;
BA_ "CANFD_BRS" BO_ 360 1;
BA_ "GenMsgCycleTime" BO_ 360 10;
BA_ "GenMsgCycleTimeFast" BO_ 360 0;
BA_ "GenMsgSendType" BO_ 360 0;
BA_ "VFrameFormat" BO_ 360 14;
BA_ "CANFD_BRS" BO_ 360 1;
BA_ "GenMsgCycleTime" BO_ 360 10;
BA_ "GenMsgCycleTimeFast" BO_ 360 0;
BA_ "GenMsgSendType" BO_ 360 0;
BA_ "VFrameFormat" BO_ 360 14;
BA_ "CANFD_BRS" BO_ 360 1;
BA_ "GenMsgCycleTime" BO_ 360 10;
BA_ "GenMsgCycleTimeFast" BO_ 360 0;
BA_ "GenMsgSendType" BO_ 360 0;
BA_ "VFrameFormat" BO_ 360 14;
BA_ "CANFD_BRS" BO_ 360 1;
BA_ "GenMsgCycleTime" BO_ 360 10;
BA_ "GenMsgCycleTimeFast" BO_ 360 0;
BA_ "GenMsgSendType" BO_ 360 0;
BA_ "VFrameFormat" BO_ 360 14;
BA_ "CANFD_BRS" BO_ 360 1;
BA_ "GenMsgCycleTime" BO_ 360 10;
BA_ "GenMsgCycleTimeFast" BO_ 360 0;
BA_ "GenMsgSendType" BO_ 360 0;
BA_ "VFrameFormat" BO_ 360 14;
BA_ "CANFD_BRS" BO_ 360 1;
BA_ "GenMsgCycleTime" BO_ 360 10;
BA_ "GenMsgCycleTimeFast" BO_ 360 0;
BA_ "GenMsgSendType" BO_ 360 0;
BA_ "VFrameFormat" BO_ 360 14;
BA_ "CANFD_BRS" BO_ 360 1;
BA_ "GenMsgCycleTime" BO_ 360 10;
BA_ "GenMsgCycleTimeFast" BO_ 360 0;
BA_ "GenMsgSendType" BO_ 360 0;
BA_ "VFrameFormat" BO_ 360 14;
BA_ "CANFD_BRS" BO_ 360 1;
BA_ "GenMsgCycleTime" BO_ 360 10;
BA_ "GenMsgCycleTimeFast" BO_ 360 0;
BA_ "GenMsgSendType" BO_ 360 0;
BA_ "VFrameFormat" BO_ 360 14;
BA_ "CANFD_BRS" BO_ 360 1;
BA_ "GenMsgCycleTime" BO_ 360 10;
BA_ "GenMsgCycleTimeFast" BO_ 360 0;
BA_ "GenMsgSendType" BO_ 360 0;
BA_ "VFrameFormat" BO_ 360 14;
BA_ "CANFD_BRS" BO_ 360 1;
BA_ "GenMsgCycleTime" BO_ 360 10;
BA_ "GenMsgCycleTimeFast" BO_ 360 0;
BA_ "GenMsgSendType" BO_ 360 0;
BA_ "VFrameFormat" BO_ 360 14;
BA_ "CANFD_BRS" BO_ 360 1;
BA_ "GenMsgCycleTime" BO_ 360 10;
BA_ "GenMsgCycleTimeFast" BO_ 360 0;
BA_ "GenMsgSendType" BO_ 360 0;
BA_ "VFrameFormat" BO_ 360 14;
BA_ "CANFD_BRS" BO_ 360 1;
BA_ "GenMsgCycleTime" BO_ 360 10;
BA_ "GenMsgCycleTimeFast" BO_ 360 0;
BA_ "GenMsgSendType" BO_ 360 0;
BA_ "VFrameFormat" BO_ 360 14;
BA_ "CANFD_BRS" BO_ 360 1;
BA_ "GenMsgCycleTime" BO_ 360 10;
BA_ "GenMsgCycleTimeFast" BO_ 360 0;
BA_ "GenMsgSendType" BO_ 360 0;
BA_ "VFrameFormat" BO_ 360 14;
BA_ "CANFD_BRS" BO_ 360 1;
BA_ "GenMsgCycleTime" BO_ 360 10;
BA_ "GenMsgCycleTimeFast" BO_ 360 0;
BA_ "GenMsgSendType" BO_ 360 0;
BA_ "VFrameFormat" BO_ 360 14;
BA_ "CANFD_BRS" BO_ 360 1;
BA_ "GenMsgCycleTime" BO_ 360 10;
BA_ "GenMsgCycleTimeFast" BO_ 360 0;
BA_ "GenMsgSendType" BO_ 360 0;
BA_ "VFrameFormat" BO_ 360 14;
BA_ "CANFD_BRS" BO_ 360 1;
BA_ "GenMsgCycleTime" BO_ 360 10;
BA_ "GenMsgCycleTimeFast" BO_ 360 0;
BA_ "GenMsgSendType" BO_ 360 0;
BA_ "VFrameFormat" BO_ 360 14;
BA_ "CANFD_BRS" BO_ 360 1;
BA_ "GenMsgCycleTime" BO_ 360 10;
BA_ "GenMsgCycleTimeFast" BO_ 360 0;
BA_ "GenMsgSendType" BO_ 360 0;
BA_ "VFrameFormat" BO_ 360 14;
BA_ "CANFD_BRS" BO_ 360 1;
BA_ "GenMsgCycleTime" BO_ 360 10;
BA_ "GenMsgCycleTimeFast" BO_ 360 0;
BA_ "GenMsgSendType" BO_ 360 0;
BA_ "VFrameFormat" BO_ 360 14;
BA_ "CANFD_BRS" BO_ 360 1;
BA_ "GenMsgCycleTime" BO_ 360 10;
BA_ "GenMsgCycleTimeFast" BO_ 360 0;
BA_ "GenMsgSendType" BO_ 360 0;
BA_ "VFrameFormat" BO_ 360 14;
BA_ "CANFD_BRS" BO_ 360 1;
BA_ "GenMsgCycleTime" BO_ 360 10;
BA_ "GenMsgCycleTimeFast" BO_ 360 0;
BA_ "GenMsgSendType" BO_ 360 0;
BA_ "VFrameFormat" BO_ 360 14;
BA_ "CANFD_BRS" BO_ 360 1;
BA_ "GenMsgCycleTime" BO_ 360 10;
BA_ "GenMsgCycleTimeFast" BO_ 360 0;
BA_ "GenMsgSendType" BO_ 360 0;
BA_ "VFrameFormat" BO_ 360 14;
BA_ "CANFD_BRS" BO_ 360 1;
BA_ "GenMsgCycleTime" BO_ 360 10;
BA_ "GenMsgCycleTimeFast" BO_ 360 0;
BA_ "GenMsgSendType" BO_ 360 0;
BA_ "VFrameFormat" BO_ 360 14;
BA_ "CANFD_BRS" BO_ 360 1;
BA_ "GenMsgCycleTime" BO_ 360 10;
BA_ "GenMsgCycleTimeFast" BO_ 360 0;
BA_ "GenMsgSendType" BO_ 360 0;
BA_ "VFrameFormat" BO_ 360 14;
BA_ "CANFD_BRS" BO_ 360 1;
BA_ "GenMsgCycleTime" BO_ 360 10;
BA_ "GenMsgCycleTimeFast" BO_ 360 0;
BA_ "GenMsgSendType" BO_ 360 0;
BA_ "VFrameFormat" BO_ 360 14;
BA_ "CANFD_BRS" BO_ 360 1;
BA_ "GenMsgCycleTime" BO_ 360 10;
BA_ "GenMsgCycleTimeFast" BO_ 360 0;
BA_ "GenMsgSendType" BO_ 360 0;
BA_ "VFrameFormat" BO_ 360 14;
BA_ "CANFD_BRS" BO_ 360 1;
BA_ "GenMsgCycleTime" BO_ 360 10;
BA_ "GenMsgCycleTimeFast" BO_ 360 0;
BA_ "GenMsgSendType" BO_ 360 0;
BA_ "VFrameFormat" BO_ 360 14;
BA_ "CANFD_BRS" BO_ 360 1;
BA_ "GenMsgCycleTime" BO_ 360 10;
BA_ "GenMsgCycleTimeFast" BO_ 360 0;
BA_ "GenMsgSendType" BO_ 360 0;
BA_ "VFrameFormat" BO_ 360 14;
BA_ "CANFD_BRS" BO_ 360 1;
BA_ "GenMsgCycleTime" BO_ 360 10;
BA_ "GenMsgCycleTimeFast" BO_ 360 0;
BA_ "GenMsgSendType" BO_ 360 0;
BA_ "VFrameFormat" BO_ 360 14;
BA_ "CANFD_BRS" BO_ 360 1;
BA_ "GenMsgCycleTime" BO_ 360 10;
BA_ "GenMsgCycleTimeFast" BO_ 360 0;
BA_ "GenMsgSendType" BO_ 360 0;
BA_ "VFrameFormat" BO_ 360 14;
BA_ "CANFD_BRS" BO_ 360 1;
BA_ "GenMsgCycleTime" BO_ 360 10;
BA_ "GenMsgCycleTimeFast" BO_ 360 0;
BA_ "GenMsgSendType" BO_ 360 0;
BA_ "VFrameFormat" BO_ 360 14;
BA_ "CANFD_BRS" BO_ 360 1;
BA_ "GenMsgCycleTime" BO_ 360 10;
BA_ "GenMsgCycleTimeFast" BO_ 360 0;
BA_ "GenMsgSendType" BO_ 360 0;
BA_ "VFrameFormat" BO_ 360 14;
BA_ "CANFD_BRS" BO_ 360 1;
BA_ "GenMsgCycleTime" BO_ 618 20;
BA_ "GenMsgCycleTimeFast" BO_ 618 0;
BA_ "GenMsgSendType" BO_ 618 0;
BA_ "VFrameFormat" BO_ 618 14;
BA_ "CANFD_BRS" BO_ 618 1;
BA_ "GenMsgCycleTime" BO_ 618 20;
BA_ "GenMsgCycleTimeFast" BO_ 618 0;
BA_ "GenMsgSendType" BO_ 618 0;
BA_ "VFrameFormat" BO_ 618 14;
BA_ "CANFD_BRS" BO_ 618 1;
BA_ "GenMsgCycleTime" BO_ 618 20;
BA_ "GenMsgCycleTimeFast" BO_ 618 0;
BA_ "GenMsgSendType" BO_ 618 0;
BA_ "VFrameFormat" BO_ 618 14;
BA_ "CANFD_BRS" BO_ 618 1;
BA_ "GenMsgCycleTime" BO_ 618 20;
BA_ "GenMsgCycleTimeFast" BO_ 618 0;
BA_ "GenMsgSendType" BO_ 618 0;
BA_ "VFrameFormat" BO_ 618 14;
BA_ "CANFD_BRS" BO_ 618 1;
BA_ "GenMsgCycleTime" BO_ 618 20;
BA_ "GenMsgCycleTimeFast" BO_ 618 0;
BA_ "GenMsgSendType" BO_ 618 0;
BA_ "VFrameFormat" BO_ 618 14;
BA_ "CANFD_BRS" BO_ 618 1;
BA_ "GenMsgCycleTime" BO_ 618 20;
BA_ "GenMsgCycleTimeFast" BO_ 618 0;
BA_ "GenMsgSendType" BO_ 618 0;
BA_ "VFrameFormat" BO_ 618 14;
BA_ "CANFD_BRS" BO_ 618 1;
BA_ "GenMsgCycleTime" BO_ 618 20;
BA_ "GenMsgCycleTimeFast" BO_ 618 0;
BA_ "GenMsgSendType" BO_ 618 0;
BA_ "VFrameFormat" BO_ 618 14;
BA_ "CANFD_BRS" BO_ 618 1;
BA_ "GenMsgCycleTime" BO_ 618 20;
BA_ "GenMsgCycleTimeFast" BO_ 618 0;
BA_ "GenMsgSendType" BO_ 618 0;
BA_ "VFrameFormat" BO_ 618 14;
BA_ "CANFD_BRS" BO_ 618 1;
BA_ "GenMsgCycleTime" BO_ 618 20;
BA_ "GenMsgCycleTimeFast" BO_ 618 0;
BA_ "GenMsgSendType" BO_ 618 0;
BA_ "VFrameFormat" BO_ 618 14;
BA_ "CANFD_BRS" BO_ 618 1;
BA_ "GenMsgCycleTime" BO_ 618 20;
BA_ "GenMsgCycleTimeFast" BO_ 618 0;
BA_ "GenMsgSendType" BO_ 618 0;
BA_ "VFrameFormat" BO_ 618 14;
BA_ "CANFD_BRS" BO_ 618 1;
BA_ "GenMsgCycleTime" BO_ 618 20;
BA_ "GenMsgCycleTimeFast" BO_ 618 0;
BA_ "GenMsgSendType" BO_ 618 0;
BA_ "VFrameFormat" BO_ 618 14;
BA_ "CANFD_BRS" BO_ 618 1;
BA_ "GenMsgCycleTime" BO_ 618 20;
BA_ "GenMsgCycleTimeFast" BO_ 618 0;
BA_ "GenMsgSendType" BO_ 618 0;
BA_ "VFrameFormat" BO_ 618 14;
BA_ "CANFD_BRS" BO_ 618 1;
BA_ "GenMsgCycleTime" BO_ 618 20;
BA_ "GenMsgCycleTimeFast" BO_ 618 0;
BA_ "GenMsgSendType" BO_ 618 0;
BA_ "VFrameFormat" BO_ 618 14;
BA_ "CANFD_BRS" BO_ 618 1;
BA_ "GenMsgCycleTime" BO_ 618 20;
BA_ "GenMsgCycleTimeFast" BO_ 618 0;
BA_ "GenMsgSendType" BO_ 618 0;
BA_ "VFrameFormat" BO_ 618 14;
BA_ "CANFD_BRS" BO_ 618 1;
BA_ "GenMsgCycleTime" BO_ 618 20;
BA_ "GenMsgCycleTimeFast" BO_ 618 0;
BA_ "GenMsgSendType" BO_ 618 0;
BA_ "VFrameFormat" BO_ 618 14;
BA_ "CANFD_BRS" BO_ 618 1;
BA_ "GenMsgCycleTime" BO_ 618 20;
BA_ "GenMsgCycleTimeFast" BO_ 618 0;
BA_ "GenMsgSendType" BO_ 618 0;
BA_ "VFrameFormat" BO_ 618 14;
BA_ "CANFD_BRS" BO_ 618 1;
BA_ "GenMsgCycleTime" BO_ 446 10;
BA_ "GenMsgCycleTimeFast" BO_ 446 0;
BA_ "GenMsgSendType" BO_ 446 0;
BA_ "VFrameFormat" BO_ 446 14;
BA_ "CANFD_BRS" BO_ 446 1;
BA_ "GenMsgCycleTime" BO_ 446 10;
BA_ "GenMsgCycleTimeFast" BO_ 446 0;
BA_ "GenMsgSendType" BO_ 446 0;
BA_ "VFrameFormat" BO_ 446 14;
BA_ "CANFD_BRS" BO_ 446 1;
BA_ "GenMsgCycleTime" BO_ 446 10;
BA_ "GenMsgCycleTimeFast" BO_ 446 0;
BA_ "GenMsgSendType" BO_ 446 0;
BA_ "VFrameFormat" BO_ 446 14;
BA_ "CANFD_BRS" BO_ 446 1;
BA_ "GenMsgCycleTime" BO_ 446 10;
BA_ "GenMsgCycleTimeFast" BO_ 446 0;
BA_ "GenMsgSendType" BO_ 446 0;
BA_ "VFrameFormat" BO_ 446 14;
BA_ "CANFD_BRS" BO_ 446 1;
BA_ "GenMsgCycleTime" BO_ 446 10;
BA_ "GenMsgCycleTimeFast" BO_ 446 0;
BA_ "GenMsgSendType" BO_ 446 0;
BA_ "VFrameFormat" BO_ 446 14;
BA_ "CANFD_BRS" BO_ 446 1;
BA_ "GenMsgCycleTime" BO_ 446 10;
BA_ "GenMsgCycleTimeFast" BO_ 446 0;
BA_ "GenMsgSendType" BO_ 446 0;
BA_ "VFrameFormat" BO_ 446 14;
BA_ "CANFD_BRS" BO_ 446 1;
BA_ "GenMsgCycleTime" BO_ 446 10;
BA_ "GenMsgCycleTimeFast" BO_ 446 0;
BA_ "GenMsgSendType" BO_ 446 0;
BA_ "VFrameFormat" BO_ 446 14;
BA_ "CANFD_BRS" BO_ 446 1;
BA_ "GenMsgCycleTime" BO_ 446 10;
BA_ "GenMsgCycleTimeFast" BO_ 446 0;
BA_ "GenMsgSendType" BO_ 446 0;
BA_ "VFrameFormat" BO_ 446 14;
BA_ "CANFD_BRS" BO_ 446 1;
BA_ "GenMsgCycleTime" BO_ 446 10;
BA_ "GenMsgCycleTimeFast" BO_ 446 0;
BA_ "GenMsgSendType" BO_ 446 0;
BA_ "VFrameFormat" BO_ 446 14;
BA_ "CANFD_BRS" BO_ 446 1;
BA_ "GenMsgCycleTime" BO_ 446 10;
BA_ "GenMsgCycleTimeFast" BO_ 446 0;
BA_ "GenMsgSendType" BO_ 446 0;
BA_ "VFrameFormat" BO_ 446 14;
BA_ "CANFD_BRS" BO_ 446 1;
BA_ "GenMsgCycleTime" BO_ 446 10;
BA_ "GenMsgCycleTimeFast" BO_ 446 0;
BA_ "GenMsgSendType" BO_ 446 0;
BA_ "VFrameFormat" BO_ 446 14;
BA_ "CANFD_BRS" BO_ 446 1;
BA_ "GenMsgCycleTime" BO_ 446 10;
BA_ "GenMsgCycleTimeFast" BO_ 446 0;
BA_ "GenMsgSendType" BO_ 446 0;
BA_ "VFrameFormat" BO_ 446 14;
BA_ "CANFD_BRS" BO_ 446 1;
BA_ "GenMsgCycleTime" BO_ 446 10;
BA_ "GenMsgCycleTimeFast" BO_ 446 0;
BA_ "GenMsgSendType" BO_ 446 0;
BA_ "VFrameFormat" BO_ 446 14;
BA_ "CANFD_BRS" BO_ 446 1;
BA_ "GenMsgCycleTime" BO_ 446 10;
BA_ "GenMsgCycleTimeFast" BO_ 446 0;
BA_ "GenMsgSendType" BO_ 446 0;
BA_ "VFrameFormat" BO_ 446 14;
BA_ "CANFD_BRS" BO_ 446 1;
BA_ "GenMsgCycleTime" BO_ 446 10;
BA_ "GenMsgCycleTimeFast" BO_ 446 0;
BA_ "GenMsgSendType" BO_ 446 0;
BA_ "VFrameFormat" BO_ 446 14;
BA_ "CANFD_BRS" BO_ 446 1;
BA_ "GenMsgCycleTime" BO_ 446 10;
BA_ "GenMsgCycleTimeFast" BO_ 446 0;
BA_ "GenMsgSendType" BO_ 446 0;
BA_ "VFrameFormat" BO_ 446 14;
BA_ "CANFD_BRS" BO_ 446 1;
BA_ "GenMsgCycleTime" BO_ 446 10;
BA_ "GenMsgCycleTimeFast" BO_ 446 0;
BA_ "GenMsgSendType" BO_ 446 0;
BA_ "VFrameFormat" BO_ 446 14;
BA_ "CANFD_BRS" BO_ 446 1;
BA_ "GenMsgCycleTime" BO_ 446 10;
BA_ "GenMsgCycleTimeFast" BO_ 446 0;
BA_ "GenMsgSendType" BO_ 446 0;
BA_ "VFrameFormat" BO_ 446 14;
BA_ "CANFD_BRS" BO_ 446 1;
BA_ "GenMsgCycleTime" BO_ 446 10;
BA_ "GenMsgCycleTimeFast" BO_ 446 0;
BA_ "GenMsgSendType" BO_ 446 0;
BA_ "VFrameFormat" BO_ 446 14;
BA_ "CANFD_BRS" BO_ 446 1;
BA_ "GenMsgCycleTime" BO_ 446 10;
BA_ "GenMsgCycleTimeFast" BO_ 446 0;
BA_ "GenMsgSendType" BO_ 446 0;
BA_ "VFrameFormat" BO_ 446 14;
BA_ "CANFD_BRS" BO_ 446 1;
BA_ "GenMsgCycleTime" BO_ 446 10;
BA_ "GenMsgCycleTimeFast" BO_ 446 0;
BA_ "GenMsgSendType" BO_ 446 0;
BA_ "VFrameFormat" BO_ 446 14;
BA_ "CANFD_BRS" BO_ 446 1;
BA_ "GenMsgCycleTime" BO_ 446 10;
BA_ "GenMsgCycleTimeFast" BO_ 446 0;
BA_ "GenMsgSendType" BO_ 446 0;
BA_ "VFrameFormat" BO_ 446 14;
BA_ "CANFD_BRS" BO_ 446 1;
BA_ "GenMsgCycleTime" BO_ 446 10;
BA_ "GenMsgCycleTimeFast" BO_ 446 0;
BA_ "GenMsgSendType" BO_ 446 0;
BA_ "VFrameFormat" BO_ 446 14;
BA_ "CANFD_BRS" BO_ 446 1;
BA_ "GenMsgCycleTime" BO_ 446 10;
BA_ "GenMsgCycleTimeFast" BO_ 446 0;
BA_ "GenMsgSendType" BO_ 446 0;
BA_ "VFrameFormat" BO_ 446 14;
BA_ "CANFD_BRS" BO_ 446 1;
BA_ "GenMsgCycleTime" BO_ 446 10;
BA_ "GenMsgCycleTimeFast" BO_ 446 0;
BA_ "GenMsgSendType" BO_ 446 0;
BA_ "VFrameFormat" BO_ 446 14;
BA_ "CANFD_BRS" BO_ 446 1;
BA_ "GenMsgCycleTime" BO_ 446 10;
BA_ "GenMsgCycleTimeFast" BO_ 446 0;
BA_ "GenMsgSendType" BO_ 446 0;
BA_ "VFrameFormat" BO_ 446 14;
BA_ "CANFD_BRS" BO_ 446 1;
BA_ "GenMsgCycleTime" BO_ 446 10;
BA_ "GenMsgCycleTimeFast" BO_ 446 0;
BA_ "GenMsgSendType" BO_ 446 0;
BA_ "VFrameFormat" BO_ 446 14;
BA_ "CANFD_BRS" BO_ 446 1;
BA_ "GenMsgCycleTime" BO_ 446 10;
BA_ "GenMsgCycleTimeFast" BO_ 446 0;
BA_ "GenMsgSendType" BO_ 446 0;
BA_ "VFrameFormat" BO_ 446 14;
BA_ "CANFD_BRS" BO_ 446 1;
BA_ "GenMsgCycleTime" BO_ 446 10;
BA_ "GenMsgCycleTimeFast" BO_ 446 0;
BA_ "GenMsgSendType" BO_ 446 0;
BA_ "VFrameFormat" BO_ 446 14;
BA_ "CANFD_BRS" BO_ 446 1;
BA_ "GenMsgCycleTime" BO_ 446 10;
BA_ "GenMsgCycleTimeFast" BO_ 446 0;
BA_ "GenMsgSendType" BO_ 446 0;
BA_ "VFrameFormat" BO_ 446 14;
BA_ "CANFD_BRS" BO_ 446 1;
BA_ "GenMsgCycleTime" BO_ 446 10;
BA_ "GenMsgCycleTimeFast" BO_ 446 0;
BA_ "GenMsgSendType" BO_ 446 0;
BA_ "VFrameFormat" BO_ 446 14;
BA_ "CANFD_BRS" BO_ 446 1;
BA_ "GenMsgCycleTime" BO_ 446 10;
BA_ "GenMsgCycleTimeFast" BO_ 446 0;
BA_ "GenMsgSendType" BO_ 446 0;
BA_ "VFrameFormat" BO_ 446 14;
BA_ "CANFD_BRS" BO_ 446 1;
BA_ "GenMsgCycleTime" BO_ 446 10;
BA_ "GenMsgCycleTimeFast" BO_ 446 0;
BA_ "GenMsgSendType" BO_ 446 0;
BA_ "VFrameFormat" BO_ 446 14;
BA_ "CANFD_BRS" BO_ 446 1;
BA_ "GenMsgCycleTime" BO_ 430 20;
BA_ "GenMsgCycleTimeFast" BO_ 430 0;
BA_ "GenMsgSendType" BO_ 430 0;
BA_ "VFrameFormat" BO_ 430 14;
BA_ "CANFD_BRS" BO_ 430 1;
BA_ "GenMsgCycleTime" BO_ 430 20;
BA_ "GenMsgCycleTimeFast" BO_ 430 0;
BA_ "GenMsgSendType" BO_ 430 0;
BA_ "VFrameFormat" BO_ 430 14;
BA_ "CANFD_BRS" BO_ 430 1;
BA_ "GenMsgCycleTime" BO_ 430 20;
BA_ "GenMsgCycleTimeFast" BO_ 430 0;
BA_ "GenMsgSendType" BO_ 430 0;
BA_ "VFrameFormat" BO_ 430 14;
BA_ "CANFD_BRS" BO_ 430 1;
BA_ "GenMsgCycleTime" BO_ 430 20;
BA_ "GenMsgCycleTimeFast" BO_ 430 0;
BA_ "GenMsgSendType" BO_ 430 0;
BA_ "VFrameFormat" BO_ 430 14;
BA_ "CANFD_BRS" BO_ 430 1;
BA_ "GenMsgCycleTime" BO_ 430 20;
BA_ "GenMsgCycleTimeFast" BO_ 430 0;
BA_ "GenMsgSendType" BO_ 430 0;
BA_ "VFrameFormat" BO_ 430 14;
BA_ "CANFD_BRS" BO_ 430 1;
BA_ "GenMsgCycleTime" BO_ 430 20;
BA_ "GenMsgCycleTimeFast" BO_ 430 0;
BA_ "GenMsgSendType" BO_ 430 0;
BA_ "VFrameFormat" BO_ 430 14;
BA_ "CANFD_BRS" BO_ 430 1;
BA_ "GenMsgCycleTime" BO_ 430 20;
BA_ "GenMsgCycleTimeFast" BO_ 430 0;
BA_ "GenMsgSendType" BO_ 430 0;
BA_ "VFrameFormat" BO_ 430 14;
BA_ "CANFD_BRS" BO_ 430 1;
BA_ "GenMsgCycleTime" BO_ 430 20;
BA_ "GenMsgCycleTimeFast" BO_ 430 0;
BA_ "GenMsgSendType" BO_ 430 0;
BA_ "VFrameFormat" BO_ 430 14;
BA_ "CANFD_BRS" BO_ 430 1;
BA_ "GenMsgCycleTime" BO_ 430 20;
BA_ "GenMsgCycleTimeFast" BO_ 430 0;
BA_ "GenMsgSendType" BO_ 430 0;
BA_ "VFrameFormat" BO_ 430 14;
BA_ "CANFD_BRS" BO_ 430 1;
BA_ "GenMsgCycleTime" BO_ 430 20;
BA_ "GenMsgCycleTimeFast" BO_ 430 0;
BA_ "GenMsgSendType" BO_ 430 0;
BA_ "VFrameFormat" BO_ 430 14;
BA_ "CANFD_BRS" BO_ 430 1;
BA_ "GenMsgCycleTime" BO_ 430 20;
BA_ "GenMsgCycleTimeFast" BO_ 430 0;
BA_ "GenMsgSendType" BO_ 430 0;
BA_ "VFrameFormat" BO_ 430 14;
BA_ "CANFD_BRS" BO_ 430 1;
BA_ "GenMsgCycleTime" BO_ 430 20;
BA_ "GenMsgCycleTimeFast" BO_ 430 0;
BA_ "GenMsgSendType" BO_ 430 0;
BA_ "VFrameFormat" BO_ 430 14;
BA_ "CANFD_BRS" BO_ 430 1;
BA_ "GenMsgCycleTime" BO_ 430 20;
BA_ "GenMsgCycleTimeFast" BO_ 430 0;
BA_ "GenMsgSendType" BO_ 430 0;
BA_ "VFrameFormat" BO_ 430 14;
BA_ "CANFD_BRS" BO_ 430 1;
BA_ "GenMsgCycleTime" BO_ 430 20;
BA_ "GenMsgCycleTimeFast" BO_ 430 0;
BA_ "GenMsgSendType" BO_ 430 0;
BA_ "VFrameFormat" BO_ 430 14;
BA_ "CANFD_BRS" BO_ 430 1;
BA_ "GenMsgCycleTime" BO_ 430 20;
BA_ "GenMsgCycleTimeFast" BO_ 430 0;
BA_ "GenMsgSendType" BO_ 430 0;
BA_ "VFrameFormat" BO_ 430 14;
BA_ "CANFD_BRS" BO_ 430 1;
BA_ "GenMsgCycleTime" BO_ 430 20;
BA_ "GenMsgCycleTimeFast" BO_ 430 0;
BA_ "GenMsgSendType" BO_ 430 0;
BA_ "VFrameFormat" BO_ 430 14;
BA_ "CANFD_BRS" BO_ 430 1;
BA_ "GenMsgCycleTime" BO_ 430 20;
BA_ "GenMsgCycleTimeFast" BO_ 430 0;
BA_ "GenMsgSendType" BO_ 430 0;
BA_ "VFrameFormat" BO_ 430 14;
BA_ "CANFD_BRS" BO_ 430 1;
BA_ "GenMsgCycleTime" BO_ 430 20;
BA_ "GenMsgCycleTimeFast" BO_ 430 0;
BA_ "GenMsgSendType" BO_ 430 0;
BA_ "VFrameFormat" BO_ 430 14;
BA_ "CANFD_BRS" BO_ 430 1;
BA_ "GenMsgCycleTime" BO_ 939 100;
BA_ "GenMsgCycleTimeFast" BO_ 939 0;
BA_ "GenMsgSendType" BO_ 939 0;
BA_ "VFrameFormat" BO_ 939 14;
BA_ "CANFD_BRS" BO_ 939 1;
BA_ "GenMsgCycleTime" BO_ 939 100;
BA_ "GenMsgCycleTimeFast" BO_ 939 0;
BA_ "GenMsgSendType" BO_ 939 0;
BA_ "VFrameFormat" BO_ 939 14;
BA_ "CANFD_BRS" BO_ 939 1;
BA_ "GenMsgCycleTime" BO_ 939 100;
BA_ "GenMsgCycleTimeFast" BO_ 939 0;
BA_ "GenMsgSendType" BO_ 939 0;
BA_ "VFrameFormat" BO_ 939 14;
BA_ "CANFD_BRS" BO_ 939 1;
BA_ "GenMsgCycleTime" BO_ 939 100;
BA_ "GenMsgCycleTimeFast" BO_ 939 0;
BA_ "GenMsgSendType" BO_ 939 0;
BA_ "VFrameFormat" BO_ 939 14;
BA_ "CANFD_BRS" BO_ 939 1;
BA_ "GenMsgCycleTime" BO_ 939 100;
BA_ "GenMsgCycleTimeFast" BO_ 939 0;
BA_ "GenMsgSendType" BO_ 939 0;
BA_ "VFrameFormat" BO_ 939 14;
BA_ "CANFD_BRS" BO_ 939 1;
BA_ "GenMsgCycleTime" BO_ 939 100;
BA_ "GenMsgCycleTimeFast" BO_ 939 0;
BA_ "GenMsgSendType" BO_ 939 0;
BA_ "VFrameFormat" BO_ 939 14;
BA_ "CANFD_BRS" BO_ 939 1;
BA_ "GenMsgCycleTime" BO_ 363 10;
BA_ "GenMsgCycleTimeFast" BO_ 363 0;
BA_ "GenMsgSendType" BO_ 363 0;
BA_ "VFrameFormat" BO_ 363 14;
BA_ "CANFD_BRS" BO_ 363 1;
BA_ "GenMsgCycleTime" BO_ 363 10;
BA_ "GenMsgCycleTimeFast" BO_ 363 0;
BA_ "GenMsgSendType" BO_ 363 0;
BA_ "VFrameFormat" BO_ 363 14;
BA_ "CANFD_BRS" BO_ 363 1;
BA_ "GenMsgCycleTime" BO_ 363 10;
BA_ "GenMsgCycleTimeFast" BO_ 363 0;
BA_ "GenMsgSendType" BO_ 363 0;
BA_ "VFrameFormat" BO_ 363 14;
BA_ "CANFD_BRS" BO_ 363 1;
BA_ "GenMsgCycleTime" BO_ 363 10;
BA_ "GenMsgCycleTimeFast" BO_ 363 0;
BA_ "GenMsgSendType" BO_ 363 0;
BA_ "VFrameFormat" BO_ 363 14;
BA_ "CANFD_BRS" BO_ 363 1;
BA_ "GenMsgCycleTime" BO_ 363 10;
BA_ "GenMsgCycleTimeFast" BO_ 363 0;
BA_ "GenMsgSendType" BO_ 363 0;
BA_ "VFrameFormat" BO_ 363 14;
BA_ "CANFD_BRS" BO_ 363 1;
BA_ "GenMsgCycleTime" BO_ 363 10;
BA_ "GenMsgCycleTimeFast" BO_ 363 0;
BA_ "GenMsgSendType" BO_ 363 0;
BA_ "VFrameFormat" BO_ 363 14;
BA_ "CANFD_BRS" BO_ 363 1;
BA_ "GenMsgCycleTime" BO_ 363 10;
BA_ "GenMsgCycleTimeFast" BO_ 363 0;
BA_ "GenMsgSendType" BO_ 363 0;
BA_ "VFrameFormat" BO_ 363 14;
BA_ "CANFD_BRS" BO_ 363 1;
BA_ "GenMsgCycleTime" BO_ 363 10;
BA_ "GenMsgCycleTimeFast" BO_ 363 0;
BA_ "GenMsgSendType" BO_ 363 0;
BA_ "VFrameFormat" BO_ 363 14;
BA_ "CANFD_BRS" BO_ 363 1;
BA_ "GenMsgCycleTime" BO_ 363 10;
BA_ "GenMsgCycleTimeFast" BO_ 363 0;
BA_ "GenMsgSendType" BO_ 363 0;
BA_ "VFrameFormat" BO_ 363 14;
BA_ "CANFD_BRS" BO_ 363 1;
BA_ "GenMsgCycleTime" BO_ 363 10;
BA_ "GenMsgCycleTimeFast" BO_ 363 0;
BA_ "GenMsgSendType" BO_ 363 0;
BA_ "VFrameFormat" BO_ 363 14;
BA_ "CANFD_BRS" BO_ 363 1;
BA_ "GenMsgCycleTime" BO_ 363 10;
BA_ "GenMsgCycleTimeFast" BO_ 363 0;
BA_ "GenMsgSendType" BO_ 363 0;
BA_ "VFrameFormat" BO_ 363 14;
BA_ "CANFD_BRS" BO_ 363 1;
BA_ "GenMsgCycleTime" BO_ 363 10;
BA_ "GenMsgCycleTimeFast" BO_ 363 0;
BA_ "GenMsgSendType" BO_ 363 0;
BA_ "VFrameFormat" BO_ 363 14;
BA_ "CANFD_BRS" BO_ 363 1;
BA_ "GenMsgCycleTime" BO_ 363 10;
BA_ "GenMsgCycleTimeFast" BO_ 363 0;
BA_ "GenMsgSendType" BO_ 363 0;
BA_ "VFrameFormat" BO_ 363 14;
BA_ "CANFD_BRS" BO_ 363 1;
BA_ "GenMsgCycleTime" BO_ 363 10;
BA_ "GenMsgCycleTimeFast" BO_ 363 0;
BA_ "GenMsgSendType" BO_ 363 0;
BA_ "VFrameFormat" BO_ 363 14;
BA_ "CANFD_BRS" BO_ 363 1;
BA_ "GenMsgCycleTime" BO_ 363 10;
BA_ "GenMsgCycleTimeFast" BO_ 363 0;
BA_ "GenMsgSendType" BO_ 363 0;
BA_ "VFrameFormat" BO_ 363 14;
BA_ "CANFD_BRS" BO_ 363 1;
BA_ "GenMsgCycleTime" BO_ 363 10;
BA_ "GenMsgCycleTimeFast" BO_ 363 0;
BA_ "GenMsgSendType" BO_ 363 0;
BA_ "VFrameFormat" BO_ 363 14;
BA_ "CANFD_BRS" BO_ 363 1;
BA_ "GenMsgCycleTime" BO_ 363 10;
BA_ "GenMsgCycleTimeFast" BO_ 363 0;
BA_ "GenMsgSendType" BO_ 363 0;
BA_ "VFrameFormat" BO_ 363 14;
BA_ "CANFD_BRS" BO_ 363 1;
BA_ "GenMsgCycleTime" BO_ 363 10;
BA_ "GenMsgCycleTimeFast" BO_ 363 0;
BA_ "GenMsgSendType" BO_ 363 0;
BA_ "VFrameFormat" BO_ 363 14;
BA_ "CANFD_BRS" BO_ 363 1;
BA_ "GenMsgCycleTime" BO_ 363 10;
BA_ "GenMsgCycleTimeFast" BO_ 363 0;
BA_ "GenMsgSendType" BO_ 363 0;
BA_ "VFrameFormat" BO_ 363 14;
BA_ "CANFD_BRS" BO_ 363 1;
BA_ "GenMsgCycleTime" BO_ 363 10;
BA_ "GenMsgCycleTimeFast" BO_ 363 0;
BA_ "GenMsgSendType" BO_ 363 0;
BA_ "VFrameFormat" BO_ 363 14;
BA_ "CANFD_BRS" BO_ 363 1;
BA_ "GenMsgCycleTime" BO_ 363 10;
BA_ "GenMsgCycleTimeFast" BO_ 363 0;
BA_ "GenMsgSendType" BO_ 363 0;
BA_ "VFrameFormat" BO_ 363 14;
BA_ "CANFD_BRS" BO_ 363 1;
BA_ "GenMsgCycleTime" BO_ 363 10;
BA_ "GenMsgCycleTimeFast" BO_ 363 0;
BA_ "GenMsgSendType" BO_ 363 0;
BA_ "VFrameFormat" BO_ 363 14;
BA_ "CANFD_BRS" BO_ 363 1;
BA_ "GenMsgCycleTime" BO_ 363 10;
BA_ "GenMsgCycleTimeFast" BO_ 363 0;
BA_ "GenMsgSendType" BO_ 363 0;
BA_ "VFrameFormat" BO_ 363 14;
BA_ "CANFD_BRS" BO_ 363 1;
BA_ "GenMsgCycleTime" BO_ 363 10;
BA_ "GenMsgCycleTimeFast" BO_ 363 0;
BA_ "GenMsgSendType" BO_ 363 0;
BA_ "VFrameFormat" BO_ 363 14;
BA_ "CANFD_BRS" BO_ 363 1;
BA_ "GenMsgCycleTime" BO_ 363 10;
BA_ "GenMsgCycleTimeFast" BO_ 363 0;
BA_ "GenMsgSendType" BO_ 363 0;
BA_ "VFrameFormat" BO_ 363 14;
BA_ "CANFD_BRS" BO_ 363 1;
BA_ "GenMsgCycleTime" BO_ 363 10;
BA_ "GenMsgCycleTimeFast" BO_ 363 0;
BA_ "GenMsgSendType" BO_ 363 0;
BA_ "VFrameFormat" BO_ 363 14;
BA_ "CANFD_BRS" BO_ 363 1;
BA_ "GenMsgCycleTime" BO_ 363 10;
BA_ "GenMsgCycleTimeFast" BO_ 363 0;
BA_ "GenMsgSendType" BO_ 363 0;
BA_ "VFrameFormat" BO_ 363 14;
BA_ "CANFD_BRS" BO_ 363 1;
BA_ "GenMsgCycleTime" BO_ 363 10;
BA_ "GenMsgCycleTimeFast" BO_ 363 0;
BA_ "GenMsgSendType" BO_ 363 0;
BA_ "VFrameFormat" BO_ 363 14;
BA_ "CANFD_BRS" BO_ 363 1;
BA_ "GenMsgCycleTime" BO_ 363 10;
BA_ "GenMsgCycleTimeFast" BO_ 363 0;
BA_ "GenMsgSendType" BO_ 363 0;
BA_ "VFrameFormat" BO_ 363 14;
BA_ "CANFD_BRS" BO_ 363 1;
BA_ "GenMsgCycleTime" BO_ 363 10;
BA_ "GenMsgCycleTimeFast" BO_ 363 0;
BA_ "GenMsgSendType" BO_ 363 0;
BA_ "VFrameFormat" BO_ 363 14;
BA_ "CANFD_BRS" BO_ 363 1;
BA_ "GenMsgCycleTime" BO_ 363 10;
BA_ "GenMsgCycleTimeFast" BO_ 363 0;
BA_ "GenMsgSendType" BO_ 363 0;
BA_ "VFrameFormat" BO_ 363 14;
BA_ "CANFD_BRS" BO_ 363 1;
BA_ "GenMsgCycleTime" BO_ 363 10;
BA_ "GenMsgCycleTimeFast" BO_ 363 0;
BA_ "GenMsgSendType" BO_ 363 0;
BA_ "VFrameFormat" BO_ 363 14;
BA_ "CANFD_BRS" BO_ 363 1;
BA_ "GenMsgCycleTime" BO_ 363 10;
BA_ "GenMsgCycleTimeFast" BO_ 363 0;
BA_ "GenMsgSendType" BO_ 363 0;
BA_ "VFrameFormat" BO_ 363 14;
BA_ "CANFD_BRS" BO_ 363 1;
BA_ "GenMsgCycleTime" BO_ 363 10;
BA_ "GenMsgCycleTimeFast" BO_ 363 0;
BA_ "GenMsgSendType" BO_ 363 0;
BA_ "VFrameFormat" BO_ 363 14;
BA_ "CANFD_BRS" BO_ 363 1;
BA_ "GenMsgCycleTime" BO_ 363 10;
BA_ "GenMsgCycleTimeFast" BO_ 363 0;
BA_ "GenMsgSendType" BO_ 363 0;
BA_ "VFrameFormat" BO_ 363 14;
BA_ "CANFD_BRS" BO_ 363 1;
BA_ "GenMsgCycleTime" BO_ 363 10;
BA_ "GenMsgCycleTimeFast" BO_ 363 0;
BA_ "GenMsgSendType" BO_ 363 0;
BA_ "VFrameFormat" BO_ 363 14;
BA_ "CANFD_BRS" BO_ 363 1;
BA_ "GenMsgCycleTime" BO_ 363 10;
BA_ "GenMsgCycleTimeFast" BO_ 363 0;
BA_ "GenMsgSendType" BO_ 363 0;
BA_ "VFrameFormat" BO_ 363 14;
BA_ "CANFD_BRS" BO_ 363 1;
BA_ "GenMsgCycleTime" BO_ 363 10;
BA_ "GenMsgCycleTimeFast" BO_ 363 0;
BA_ "GenMsgSendType" BO_ 363 0;
BA_ "VFrameFormat" BO_ 363 14;
BA_ "CANFD_BRS" BO_ 363 1;
BA_ "GenMsgCycleTime" BO_ 363 10;
BA_ "GenMsgCycleTimeFast" BO_ 363 0;
BA_ "GenMsgSendType" BO_ 363 0;
BA_ "VFrameFormat" BO_ 363 14;
BA_ "CANFD_BRS" BO_ 363 1;
BA_ "GenMsgCycleTime" BO_ 363 10;
BA_ "GenMsgCycleTimeFast" BO_ 363 0;
BA_ "GenMsgSendType" BO_ 363 0;
BA_ "VFrameFormat" BO_ 363 14;
BA_ "CANFD_BRS" BO_ 363 1;
BA_ "GenMsgCycleTime" BO_ 363 10;
BA_ "GenMsgCycleTimeFast" BO_ 363 0;
BA_ "GenMsgSendType" BO_ 363 0;
BA_ "VFrameFormat" BO_ 363 14;
BA_ "CANFD_BRS" BO_ 363 1;
BA_ "GenMsgCycleTime" BO_ 363 10;
BA_ "GenMsgCycleTimeFast" BO_ 363 0;
BA_ "GenMsgSendType" BO_ 363 0;
BA_ "VFrameFormat" BO_ 363 14;
BA_ "CANFD_BRS" BO_ 363 1;
BA_ "GenMsgCycleTime" BO_ 363 10;
BA_ "GenMsgCycleTimeFast" BO_ 363 0;
BA_ "GenMsgSendType" BO_ 363 0;
BA_ "VFrameFormat" BO_ 363 14;
BA_ "CANFD_BRS" BO_ 363 1;
BA_ "GenMsgCycleTime" BO_ 363 10;
BA_ "GenMsgCycleTimeFast" BO_ 363 0;
BA_ "GenMsgSendType" BO_ 363 0;
BA_ "VFrameFormat" BO_ 363 14;
BA_ "CANFD_BRS" BO_ 363 1;
BA_ "GenMsgCycleTime" BO_ 363 10;
BA_ "GenMsgCycleTimeFast" BO_ 363 0;
BA_ "GenMsgSendType" BO_ 363 0;
BA_ "VFrameFormat" BO_ 363 14;
BA_ "CANFD_BRS" BO_ 363 1;
BA_ "GenMsgCycleTime" BO_ 363 10;
BA_ "GenMsgCycleTimeFast" BO_ 363 0;
BA_ "GenMsgSendType" BO_ 363 0;
BA_ "VFrameFormat" BO_ 363 14;
BA_ "CANFD_BRS" BO_ 363 1;
BA_ "GenMsgCycleTime" BO_ 363 10;
BA_ "GenMsgCycleTimeFast" BO_ 363 0;
BA_ "GenMsgSendType" BO_ 363 0;
BA_ "VFrameFormat" BO_ 363 14;
BA_ "CANFD_BRS" BO_ 363 1;
BA_ "GenMsgCycleTime" BO_ 363 10;
BA_ "GenMsgCycleTimeFast" BO_ 363 0;
BA_ "GenMsgSendType" BO_ 363 0;
BA_ "VFrameFormat" BO_ 363 14;
BA_ "CANFD_BRS" BO_ 363 1;
BA_ "GenMsgCycleTime" BO_ 363 10;
BA_ "GenMsgCycleTimeFast" BO_ 363 0;
BA_ "GenMsgSendType" BO_ 363 0;
BA_ "VFrameFormat" BO_ 363 14;
BA_ "CANFD_BRS" BO_ 363 1;
BA_ "GenMsgCycleTime" BO_ 363 10;
BA_ "GenMsgCycleTimeFast" BO_ 363 0;
BA_ "GenMsgSendType" BO_ 363 0;
BA_ "VFrameFormat" BO_ 363 14;
BA_ "CANFD_BRS" BO_ 363 1;
BA_ "GenMsgCycleTime" BO_ 363 10;
BA_ "GenMsgCycleTimeFast" BO_ 363 0;
BA_ "GenMsgSendType" BO_ 363 0;
BA_ "VFrameFormat" BO_ 363 14;
BA_ "CANFD_BRS" BO_ 363 1;
BA_ "GenMsgCycleTime" BO_ 363 10;
BA_ "GenMsgCycleTimeFast" BO_ 363 0;
BA_ "GenMsgSendType" BO_ 363 0;
BA_ "VFrameFormat" BO_ 363 14;
BA_ "CANFD_BRS" BO_ 363 1;
BA_ "GenMsgCycleTime" BO_ 363 10;
BA_ "GenMsgCycleTimeFast" BO_ 363 0;
BA_ "GenMsgSendType" BO_ 363 0;
BA_ "VFrameFormat" BO_ 363 14;
BA_ "CANFD_BRS" BO_ 363 1;
BA_ "GenMsgCycleTime" BO_ 363 10;
BA_ "GenMsgCycleTimeFast" BO_ 363 0;
BA_ "GenMsgSendType" BO_ 363 0;
BA_ "VFrameFormat" BO_ 363 14;
BA_ "CANFD_BRS" BO_ 363 1;
BA_ "GenMsgCycleTime" BO_ 363 10;
BA_ "GenMsgCycleTimeFast" BO_ 363 0;
BA_ "GenMsgSendType" BO_ 363 0;
BA_ "VFrameFormat" BO_ 363 14;
BA_ "CANFD_BRS" BO_ 363 1;
BA_ "GenMsgCycleTime" BO_ 363 10;
BA_ "GenMsgCycleTimeFast" BO_ 363 0;
BA_ "GenMsgSendType" BO_ 363 0;
BA_ "VFrameFormat" BO_ 363 14;
BA_ "CANFD_BRS" BO_ 363 1;
BA_ "GenMsgCycleTime" BO_ 363 10;
BA_ "GenMsgCycleTimeFast" BO_ 363 0;
BA_ "GenMsgSendType" BO_ 363 0;
BA_ "VFrameFormat" BO_ 363 14;
BA_ "CANFD_BRS" BO_ 363 1;
BA_ "GenMsgCycleTime" BO_ 363 10;
BA_ "GenMsgCycleTimeFast" BO_ 363 0;
BA_ "GenMsgSendType" BO_ 363 0;
BA_ "VFrameFormat" BO_ 363 14;
BA_ "CANFD_BRS" BO_ 363 1;
BA_ "GenMsgCycleTime" BO_ 363 10;
BA_ "GenMsgCycleTimeFast" BO_ 363 0;
BA_ "GenMsgSendType" BO_ 363 0;
BA_ "VFrameFormat" BO_ 363 14;
BA_ "CANFD_BRS" BO_ 363 1;
BA_ "GenMsgCycleTime" BO_ 363 10;
BA_ "GenMsgCycleTimeFast" BO_ 363 0;
BA_ "GenMsgSendType" BO_ 363 0;
BA_ "VFrameFormat" BO_ 363 14;
BA_ "CANFD_BRS" BO_ 363 1;
BA_ "GenMsgCycleTime" BO_ 363 10;
BA_ "GenMsgCycleTimeFast" BO_ 363 0;
BA_ "GenMsgSendType" BO_ 363 0;
BA_ "VFrameFormat" BO_ 363 14;
BA_ "CANFD_BRS" BO_ 363 1;
BA_ "GenMsgCycleTime" BO_ 363 10;
BA_ "GenMsgCycleTimeFast" BO_ 363 0;
BA_ "GenMsgSendType" BO_ 363 0;
BA_ "VFrameFormat" BO_ 363 14;
BA_ "CANFD_BRS" BO_ 363 1;
BA_ "GenMsgCycleTime" BO_ 363 10;
BA_ "GenMsgCycleTimeFast" BO_ 363 0;
BA_ "GenMsgSendType" BO_ 363 0;
BA_ "VFrameFormat" BO_ 363 14;
BA_ "CANFD_BRS" BO_ 363 1;
BA_ "GenMsgCycleTime" BO_ 363 10;
BA_ "GenMsgCycleTimeFast" BO_ 363 0;
BA_ "GenMsgSendType" BO_ 363 0;
BA_ "VFrameFormat" BO_ 363 14;
BA_ "CANFD_BRS" BO_ 363 1;
BA_ "GenMsgCycleTime" BO_ 363 10;
BA_ "GenMsgCycleTimeFast" BO_ 363 0;
BA_ "GenMsgSendType" BO_ 363 0;
BA_ "VFrameFormat" BO_ 363 14;
BA_ "CANFD_BRS" BO_ 363 1;
BA_ "GenMsgCycleTime" BO_ 363 10;
BA_ "GenMsgCycleTimeFast" BO_ 363 0;
BA_ "GenMsgSendType" BO_ 363 0;
BA_ "VFrameFormat" BO_ 363 14;
BA_ "CANFD_BRS" BO_ 363 1;
BA_ "GenMsgCycleTime" BO_ 362 10;
BA_ "GenMsgCycleTimeFast" BO_ 362 0;
BA_ "GenMsgSendType" BO_ 362 0;
BA_ "VFrameFormat" BO_ 362 14;
BA_ "CANFD_BRS" BO_ 362 1;
BA_ "GenMsgCycleTime" BO_ 362 10;
BA_ "GenMsgCycleTimeFast" BO_ 362 0;
BA_ "GenMsgSendType" BO_ 362 0;
BA_ "VFrameFormat" BO_ 362 14;
BA_ "CANFD_BRS" BO_ 362 1;
BA_ "GenMsgCycleTime" BO_ 362 10;
BA_ "GenMsgCycleTimeFast" BO_ 362 0;
BA_ "GenMsgSendType" BO_ 362 0;
BA_ "VFrameFormat" BO_ 362 14;
BA_ "CANFD_BRS" BO_ 362 1;
BA_ "GenMsgCycleTime" BO_ 362 10;
BA_ "GenMsgCycleTimeFast" BO_ 362 0;
BA_ "GenMsgSendType" BO_ 362 0;
BA_ "VFrameFormat" BO_ 362 14;
BA_ "CANFD_BRS" BO_ 362 1;
BA_ "GenMsgCycleTime" BO_ 362 10;
BA_ "GenMsgCycleTimeFast" BO_ 362 0;
BA_ "GenMsgSendType" BO_ 362 0;
BA_ "VFrameFormat" BO_ 362 14;
BA_ "CANFD_BRS" BO_ 362 1;
BA_ "GenMsgCycleTime" BO_ 362 10;
BA_ "GenMsgCycleTimeFast" BO_ 362 0;
BA_ "GenMsgSendType" BO_ 362 0;
BA_ "VFrameFormat" BO_ 362 14;
BA_ "CANFD_BRS" BO_ 362 1;
BA_ "GenMsgCycleTime" BO_ 362 10;
BA_ "GenMsgCycleTimeFast" BO_ 362 0;
BA_ "GenMsgSendType" BO_ 362 0;
BA_ "VFrameFormat" BO_ 362 14;
BA_ "CANFD_BRS" BO_ 362 1;
BA_ "GenMsgCycleTime" BO_ 362 10;
BA_ "GenMsgCycleTimeFast" BO_ 362 0;
BA_ "GenMsgSendType" BO_ 362 0;
BA_ "VFrameFormat" BO_ 362 14;
BA_ "CANFD_BRS" BO_ 362 1;
BA_ "GenMsgCycleTime" BO_ 362 10;
BA_ "GenMsgCycleTimeFast" BO_ 362 0;
BA_ "GenMsgSendType" BO_ 362 0;
BA_ "VFrameFormat" BO_ 362 14;
BA_ "CANFD_BRS" BO_ 362 1;
BA_ "GenMsgCycleTime" BO_ 362 10;
BA_ "GenMsgCycleTimeFast" BO_ 362 0;
BA_ "GenMsgSendType" BO_ 362 0;
BA_ "VFrameFormat" BO_ 362 14;
BA_ "CANFD_BRS" BO_ 362 1;
BA_ "GenMsgCycleTime" BO_ 362 10;
BA_ "GenMsgCycleTimeFast" BO_ 362 0;
BA_ "GenMsgSendType" BO_ 362 0;
BA_ "VFrameFormat" BO_ 362 14;
BA_ "CANFD_BRS" BO_ 362 1;
BA_ "GenMsgCycleTime" BO_ 362 10;
BA_ "GenMsgCycleTimeFast" BO_ 362 0;
BA_ "GenMsgSendType" BO_ 362 0;
BA_ "VFrameFormat" BO_ 362 14;
BA_ "CANFD_BRS" BO_ 362 1;
BA_ "GenMsgCycleTime" BO_ 362 10;
BA_ "GenMsgCycleTimeFast" BO_ 362 0;
BA_ "GenMsgSendType" BO_ 362 0;
BA_ "VFrameFormat" BO_ 362 14;
BA_ "CANFD_BRS" BO_ 362 1;
BA_ "GenMsgCycleTime" BO_ 362 10;
BA_ "GenMsgCycleTimeFast" BO_ 362 0;
BA_ "GenMsgSendType" BO_ 362 0;
BA_ "VFrameFormat" BO_ 362 14;
BA_ "CANFD_BRS" BO_ 362 1;
BA_ "GenMsgCycleTime" BO_ 362 10;
BA_ "GenMsgCycleTimeFast" BO_ 362 0;
BA_ "GenMsgSendType" BO_ 362 0;
BA_ "VFrameFormat" BO_ 362 14;
BA_ "CANFD_BRS" BO_ 362 1;
BA_ "GenMsgCycleTime" BO_ 362 10;
BA_ "GenMsgCycleTimeFast" BO_ 362 0;
BA_ "GenMsgSendType" BO_ 362 0;
BA_ "VFrameFormat" BO_ 362 14;
BA_ "CANFD_BRS" BO_ 362 1;
BA_ "GenMsgCycleTime" BO_ 362 10;
BA_ "GenMsgCycleTimeFast" BO_ 362 0;
BA_ "GenMsgSendType" BO_ 362 0;
BA_ "VFrameFormat" BO_ 362 14;
BA_ "CANFD_BRS" BO_ 362 1;
BA_ "GenMsgCycleTime" BO_ 362 10;
BA_ "GenMsgCycleTimeFast" BO_ 362 0;
BA_ "GenMsgSendType" BO_ 362 0;
BA_ "VFrameFormat" BO_ 362 14;
BA_ "CANFD_BRS" BO_ 362 1;
BA_ "GenMsgCycleTime" BO_ 362 10;
BA_ "GenMsgCycleTimeFast" BO_ 362 0;
BA_ "GenMsgSendType" BO_ 362 0;
BA_ "VFrameFormat" BO_ 362 14;
BA_ "CANFD_BRS" BO_ 362 1;
BA_ "GenMsgCycleTime" BO_ 362 10;
BA_ "GenMsgCycleTimeFast" BO_ 362 0;
BA_ "GenMsgSendType" BO_ 362 0;
BA_ "VFrameFormat" BO_ 362 14;
BA_ "CANFD_BRS" BO_ 362 1;
BA_ "GenMsgCycleTime" BO_ 362 10;
BA_ "GenMsgCycleTimeFast" BO_ 362 0;
BA_ "GenMsgSendType" BO_ 362 0;
BA_ "VFrameFormat" BO_ 362 14;
BA_ "CANFD_BRS" BO_ 362 1;
BA_ "GenMsgCycleTime" BO_ 362 10;
BA_ "GenMsgCycleTimeFast" BO_ 362 0;
BA_ "GenMsgSendType" BO_ 362 0;
BA_ "VFrameFormat" BO_ 362 14;
BA_ "CANFD_BRS" BO_ 362 1;
BA_ "GenMsgCycleTime" BO_ 362 10;
BA_ "GenMsgCycleTimeFast" BO_ 362 0;
BA_ "GenMsgSendType" BO_ 362 0;
BA_ "VFrameFormat" BO_ 362 14;
BA_ "CANFD_BRS" BO_ 362 1;
BA_ "GenMsgCycleTime" BO_ 362 10;
BA_ "GenMsgCycleTimeFast" BO_ 362 0;
BA_ "GenMsgSendType" BO_ 362 0;
BA_ "VFrameFormat" BO_ 362 14;
BA_ "CANFD_BRS" BO_ 362 1;
BA_ "GenMsgCycleTime" BO_ 362 10;
BA_ "GenMsgCycleTimeFast" BO_ 362 0;
BA_ "GenMsgSendType" BO_ 362 0;
BA_ "VFrameFormat" BO_ 362 14;
BA_ "CANFD_BRS" BO_ 362 1;
BA_ "GenMsgCycleTime" BO_ 362 10;
BA_ "GenMsgCycleTimeFast" BO_ 362 0;
BA_ "GenMsgSendType" BO_ 362 0;
BA_ "VFrameFormat" BO_ 362 14;
BA_ "CANFD_BRS" BO_ 362 1;
BA_ "GenMsgCycleTime" BO_ 362 10;
BA_ "GenMsgCycleTimeFast" BO_ 362 0;
BA_ "GenMsgSendType" BO_ 362 0;
BA_ "VFrameFormat" BO_ 362 14;
BA_ "CANFD_BRS" BO_ 362 1;
BA_ "GenMsgCycleTime" BO_ 362 10;
BA_ "GenMsgCycleTimeFast" BO_ 362 0;
BA_ "GenMsgSendType" BO_ 362 0;
BA_ "VFrameFormat" BO_ 362 14;
BA_ "CANFD_BRS" BO_ 362 1;
BA_ "GenMsgCycleTime" BO_ 362 10;
BA_ "GenMsgCycleTimeFast" BO_ 362 0;
BA_ "GenMsgSendType" BO_ 362 0;
BA_ "VFrameFormat" BO_ 362 14;
BA_ "CANFD_BRS" BO_ 362 1;
BA_ "GenMsgCycleTime" BO_ 362 10;
BA_ "GenMsgCycleTimeFast" BO_ 362 0;
BA_ "GenMsgSendType" BO_ 362 0;
BA_ "VFrameFormat" BO_ 362 14;
BA_ "CANFD_BRS" BO_ 362 1;
BA_ "GenMsgCycleTime" BO_ 362 10;
BA_ "GenMsgCycleTimeFast" BO_ 362 0;
BA_ "GenMsgSendType" BO_ 362 0;
BA_ "VFrameFormat" BO_ 362 14;
BA_ "CANFD_BRS" BO_ 362 1;
BA_ "GenMsgCycleTime" BO_ 362 10;
BA_ "GenMsgCycleTimeFast" BO_ 362 0;
BA_ "GenMsgSendType" BO_ 362 0;
BA_ "VFrameFormat" BO_ 362 14;
BA_ "CANFD_BRS" BO_ 362 1;
BA_ "GenMsgCycleTime" BO_ 362 10;
BA_ "GenMsgCycleTimeFast" BO_ 362 0;
BA_ "GenMsgSendType" BO_ 362 0;
BA_ "VFrameFormat" BO_ 362 14;
BA_ "CANFD_BRS" BO_ 362 1;
BA_ "GenMsgCycleTime" BO_ 362 10;
BA_ "GenMsgCycleTimeFast" BO_ 362 0;
BA_ "GenMsgSendType" BO_ 362 0;
BA_ "VFrameFormat" BO_ 362 14;
BA_ "CANFD_BRS" BO_ 362 1;
BA_ "GenMsgCycleTime" BO_ 362 10;
BA_ "GenMsgCycleTimeFast" BO_ 362 0;
BA_ "GenMsgSendType" BO_ 362 0;
BA_ "VFrameFormat" BO_ 362 14;
BA_ "CANFD_BRS" BO_ 362 1;
BA_ "GenMsgCycleTime" BO_ 362 10;
BA_ "GenMsgCycleTimeFast" BO_ 362 0;
BA_ "GenMsgSendType" BO_ 362 0;
BA_ "VFrameFormat" BO_ 362 14;
BA_ "CANFD_BRS" BO_ 362 1;
BA_ "GenMsgCycleTime" BO_ 362 10;
BA_ "GenMsgCycleTimeFast" BO_ 362 0;
BA_ "GenMsgSendType" BO_ 362 0;
BA_ "VFrameFormat" BO_ 362 14;
BA_ "CANFD_BRS" BO_ 362 1;
BA_ "GenMsgCycleTime" BO_ 362 10;
BA_ "GenMsgCycleTimeFast" BO_ 362 0;
BA_ "GenMsgSendType" BO_ 362 0;
BA_ "VFrameFormat" BO_ 362 14;
BA_ "CANFD_BRS" BO_ 362 1;
BA_ "GenMsgCycleTime" BO_ 362 10;
BA_ "GenMsgCycleTimeFast" BO_ 362 0;
BA_ "GenMsgSendType" BO_ 362 0;
BA_ "VFrameFormat" BO_ 362 14;
BA_ "CANFD_BRS" BO_ 362 1;
BA_ "GenMsgCycleTime" BO_ 362 10;
BA_ "GenMsgCycleTimeFast" BO_ 362 0;
BA_ "GenMsgSendType" BO_ 362 0;
BA_ "VFrameFormat" BO_ 362 14;
BA_ "CANFD_BRS" BO_ 362 1;
BA_ "GenMsgCycleTime" BO_ 362 10;
BA_ "GenMsgCycleTimeFast" BO_ 362 0;
BA_ "GenMsgSendType" BO_ 362 0;
BA_ "VFrameFormat" BO_ 362 14;
BA_ "CANFD_BRS" BO_ 362 1;
BA_ "GenMsgCycleTime" BO_ 362 10;
BA_ "GenMsgCycleTimeFast" BO_ 362 0;
BA_ "GenMsgSendType" BO_ 362 0;
BA_ "VFrameFormat" BO_ 362 14;
BA_ "CANFD_BRS" BO_ 362 1;
BA_ "GenMsgCycleTime" BO_ 362 10;
BA_ "GenMsgCycleTimeFast" BO_ 362 0;
BA_ "GenMsgSendType" BO_ 362 0;
BA_ "VFrameFormat" BO_ 362 14;
BA_ "CANFD_BRS" BO_ 362 1;
BA_ "GenMsgCycleTime" BO_ 362 10;
BA_ "GenMsgCycleTimeFast" BO_ 362 0;
BA_ "GenMsgSendType" BO_ 362 0;
BA_ "VFrameFormat" BO_ 362 14;
BA_ "CANFD_BRS" BO_ 362 1;
BA_ "GenMsgCycleTime" BO_ 362 10;
BA_ "GenMsgCycleTimeFast" BO_ 362 0;
BA_ "GenMsgSendType" BO_ 362 0;
BA_ "VFrameFormat" BO_ 362 14;
BA_ "CANFD_BRS" BO_ 362 1;
BA_ "GenMsgCycleTime" BO_ 362 10;
BA_ "GenMsgCycleTimeFast" BO_ 362 0;
BA_ "GenMsgSendType" BO_ 362 0;
BA_ "VFrameFormat" BO_ 362 14;
BA_ "CANFD_BRS" BO_ 362 1;
BA_ "EventCommandSignal" SG_ 360 BCS_6_CRC 0;
BA_ "GatewayedSignals" SG_ 360 BCS_6_CRC 0;
BA_ "GenSigInactiveValue" SG_ 360 BCS_6_CRC 0;
BA_ "GenSigInvalidValue" SG_ 360 BCS_6_CRC 0;
BA_ "GenSigSendType" SG_ 360 BCS_6_CRC 1;
BA_ "GenSigStartValue" SG_ 360 BCS_6_CRC 0;
BA_ "GenSigTimeoutValue" SG_ 360 BCS_6_CRC 0;
BA_ "Remark" SG_ 360 BCS_6_CRC "";
BA_ "EventCommandSignal" SG_ 360 BCS_6_Counter 0;
BA_ "GatewayedSignals" SG_ 360 BCS_6_Counter 0;
BA_ "GenSigInactiveValue" SG_ 360 BCS_6_Counter 0;
BA_ "GenSigInvalidValue" SG_ 360 BCS_6_Counter 0;
BA_ "GenSigSendType" SG_ 360 BCS_6_Counter 1;
BA_ "GenSigStartValue" SG_ 360 BCS_6_Counter 0;
BA_ "GenSigTimeoutValue" SG_ 360 BCS_6_Counter 0;
BA_ "Remark" SG_ 360 BCS_6_Counter "";
BA_ "EventCommandSignal" SG_ 360 BCS_HydBrkActvTq_FL 0;
BA_ "GatewayedSignals" SG_ 360 BCS_HydBrkActvTq_FL 0;
BA_ "GenSigInactiveValue" SG_ 360 BCS_HydBrkActvTq_FL 0;
BA_ "GenSigInvalidValue" SG_ 360 BCS_HydBrkActvTq_FL 0;
BA_ "GenSigSendType" SG_ 360 BCS_HydBrkActvTq_FL 1;
BA_ "GenSigStartValue" SG_ 360 BCS_HydBrkActvTq_FL 0;
BA_ "GenSigTimeoutValue" SG_ 360 BCS_HydBrkActvTq_FL 0;
BA_ "Remark" SG_ 360 BCS_HydBrkActvTq_FL "";
BA_ "EventCommandSignal" SG_ 360 BCS_HydBrkActvTq_FR 0;
BA_ "GatewayedSignals" SG_ 360 BCS_HydBrkActvTq_FR 0;
BA_ "GenSigInactiveValue" SG_ 360 BCS_HydBrkActvTq_FR 0;
BA_ "GenSigInvalidValue" SG_ 360 BCS_HydBrkActvTq_FR 0;
BA_ "GenSigSendType" SG_ 360 BCS_HydBrkActvTq_FR 1;
BA_ "GenSigStartValue" SG_ 360 BCS_HydBrkActvTq_FR 0;
BA_ "GenSigTimeoutValue" SG_ 360 BCS_HydBrkActvTq_FR 0;
BA_ "Remark" SG_ 360 BCS_HydBrkActvTq_FR "";
BA_ "EventCommandSignal" SG_ 360 BCS_HydBrkActvTq_RL 0;
BA_ "GatewayedSignals" SG_ 360 BCS_HydBrkActvTq_RL 0;
BA_ "GenSigInactiveValue" SG_ 360 BCS_HydBrkActvTq_RL 0;
BA_ "GenSigInvalidValue" SG_ 360 BCS_HydBrkActvTq_RL 0;
BA_ "GenSigSendType" SG_ 360 BCS_HydBrkActvTq_RL 1;
BA_ "GenSigStartValue" SG_ 360 BCS_HydBrkActvTq_RL 0;
BA_ "GenSigTimeoutValue" SG_ 360 BCS_HydBrkActvTq_RL 0;
BA_ "Remark" SG_ 360 BCS_HydBrkActvTq_RL "";
BA_ "EventCommandSignal" SG_ 360 BCS_HydBrkActvTq_RR 0;
BA_ "GatewayedSignals" SG_ 360 BCS_HydBrkActvTq_RR 0;
BA_ "GenSigInactiveValue" SG_ 360 BCS_HydBrkActvTq_RR 0;
BA_ "GenSigInvalidValue" SG_ 360 BCS_HydBrkActvTq_RR 0;
BA_ "GenSigSendType" SG_ 360 BCS_HydBrkActvTq_RR 1;
BA_ "GenSigStartValue" SG_ 360 BCS_HydBrkActvTq_RR 0;
BA_ "GenSigTimeoutValue" SG_ 360 BCS_HydBrkActvTq_RR 0;
BA_ "Remark" SG_ 360 BCS_HydBrkActvTq_RR "";
BA_ "EventCommandSignal" SG_ 360 BCS_HydBrkReqTq 0;
BA_ "GatewayedSignals" SG_ 360 BCS_HydBrkReqTq 0;
BA_ "GenSigInactiveValue" SG_ 360 BCS_HydBrkReqTq 0;
BA_ "GenSigInvalidValue" SG_ 360 BCS_HydBrkReqTq 0;
BA_ "GenSigSendType" SG_ 360 BCS_HydBrkReqTq 1;
BA_ "GenSigStartValue" SG_ 360 BCS_HydBrkReqTq 0;
BA_ "GenSigTimeoutValue" SG_ 360 BCS_HydBrkReqTq 0;
BA_ "Remark" SG_ 360 BCS_HydBrkReqTq "";
BA_ "EventCommandSignal" SG_ 360 BCS_BrkActvTq 0;
BA_ "GatewayedSignals" SG_ 360 BCS_BrkActvTq 0;
BA_ "GenSigInactiveValue" SG_ 360 BCS_BrkActvTq 0;
BA_ "GenSigInvalidValue" SG_ 360 BCS_BrkActvTq 0;
BA_ "GenSigSendType" SG_ 360 BCS_BrkActvTq 1;
BA_ "GenSigStartValue" SG_ 360 BCS_BrkActvTq 0;
BA_ "GenSigTimeoutValue" SG_ 360 BCS_BrkActvTq 0;
BA_ "Remark" SG_ 360 BCS_BrkActvTq "";
BA_ "EventCommandSignal" SG_ 360 BCS_HydBrkActvTq 0;
BA_ "GatewayedSignals" SG_ 360 BCS_HydBrkActvTq 0;
BA_ "GenSigInactiveValue" SG_ 360 BCS_HydBrkActvTq 0;
BA_ "GenSigInvalidValue" SG_ 360 BCS_HydBrkActvTq 0;
BA_ "GenSigSendType" SG_ 360 BCS_HydBrkActvTq 1;
BA_ "GenSigStartValue" SG_ 360 BCS_HydBrkActvTq 0;
BA_ "GenSigTimeoutValue" SG_ 360 BCS_HydBrkActvTq 0;
BA_ "Remark" SG_ 360 BCS_HydBrkActvTq "";
BA_ "EventCommandSignal" SG_ 360 BCS_DycESCActTq 0;
BA_ "GatewayedSignals" SG_ 360 BCS_DycESCActTq 0;
BA_ "GenSigInactiveValue" SG_ 360 BCS_DycESCActTq 0;
BA_ "GenSigInvalidValue" SG_ 360 BCS_DycESCActTq 0;
BA_ "GenSigSendType" SG_ 360 BCS_DycESCActTq 1;
BA_ "GenSigStartValue" SG_ 360 BCS_DycESCActTq 0;
BA_ "GenSigTimeoutValue" SG_ 360 BCS_DycESCActTq 0;
BA_ "Remark" SG_ 360 BCS_DycESCActTq "";
BA_ "EventCommandSignal" SG_ 360 BCS_BrkTqCtrlAvlDriving 0;
BA_ "GatewayedSignals" SG_ 360 BCS_BrkTqCtrlAvlDriving 0;
BA_ "GenSigInactiveValue" SG_ 360 BCS_BrkTqCtrlAvlDriving 0;
BA_ "GenSigInvalidValue" SG_ 360 BCS_BrkTqCtrlAvlDriving 0;
BA_ "GenSigSendType" SG_ 360 BCS_BrkTqCtrlAvlDriving 1;
BA_ "GenSigStartValue" SG_ 360 BCS_BrkTqCtrlAvlDriving 0;
BA_ "GenSigTimeoutValue" SG_ 360 BCS_BrkTqCtrlAvlDriving 0;
BA_ "Remark" SG_ 360 BCS_BrkTqCtrlAvlDriving "";
BA_ "EventCommandSignal" SG_ 360 BCS_BrkTqCtrlAvlParking 0;
BA_ "GatewayedSignals" SG_ 360 BCS_BrkTqCtrlAvlParking 0;
BA_ "GenSigInactiveValue" SG_ 360 BCS_BrkTqCtrlAvlParking 0;
BA_ "GenSigInvalidValue" SG_ 360 BCS_BrkTqCtrlAvlParking 0;
BA_ "GenSigSendType" SG_ 360 BCS_BrkTqCtrlAvlParking 1;
BA_ "GenSigStartValue" SG_ 360 BCS_BrkTqCtrlAvlParking 0;
BA_ "GenSigTimeoutValue" SG_ 360 BCS_BrkTqCtrlAvlParking 0;
BA_ "Remark" SG_ 360 BCS_BrkTqCtrlAvlParking "";
BA_ "EventCommandSignal" SG_ 360 BCS_BrkTqCtrlActv 0;
BA_ "GatewayedSignals" SG_ 360 BCS_BrkTqCtrlActv 0;
BA_ "GenSigInactiveValue" SG_ 360 BCS_BrkTqCtrlActv 0;
BA_ "GenSigInvalidValue" SG_ 360 BCS_BrkTqCtrlActv 0;
BA_ "GenSigSendType" SG_ 360 BCS_BrkTqCtrlActv 1;
BA_ "GenSigStartValue" SG_ 360 BCS_BrkTqCtrlActv 0;
BA_ "GenSigTimeoutValue" SG_ 360 BCS_BrkTqCtrlActv 0;
BA_ "Remark" SG_ 360 BCS_BrkTqCtrlActv "";
BA_ "EventCommandSignal" SG_ 360 BCS_DycEscTarTqCtrlAvl 0;
BA_ "GatewayedSignals" SG_ 360 BCS_DycEscTarTqCtrlAvl 0;
BA_ "GenSigInactiveValue" SG_ 360 BCS_DycEscTarTqCtrlAvl 0;
BA_ "GenSigInvalidValue" SG_ 360 BCS_DycEscTarTqCtrlAvl 0;
BA_ "GenSigSendType" SG_ 360 BCS_DycEscTarTqCtrlAvl 1;
BA_ "GenSigStartValue" SG_ 360 BCS_DycEscTarTqCtrlAvl 0;
BA_ "GenSigTimeoutValue" SG_ 360 BCS_DycEscTarTqCtrlAvl 0;
BA_ "Remark" SG_ 360 BCS_DycEscTarTqCtrlAvl "";
BA_ "EventCommandSignal" SG_ 360 BCS_DrvrBrkOvrd 0;
BA_ "GatewayedSignals" SG_ 360 BCS_DrvrBrkOvrd 0;
BA_ "GenSigInactiveValue" SG_ 360 BCS_DrvrBrkOvrd 0;
BA_ "GenSigInvalidValue" SG_ 360 BCS_DrvrBrkOvrd 0;
BA_ "GenSigSendType" SG_ 360 BCS_DrvrBrkOvrd 1;
BA_ "GenSigStartValue" SG_ 360 BCS_DrvrBrkOvrd 0;
BA_ "GenSigTimeoutValue" SG_ 360 BCS_DrvrBrkOvrd 0;
BA_ "Remark" SG_ 360 BCS_DrvrBrkOvrd "";
BA_ "EventCommandSignal" SG_ 360 BCS_DrvrBrkOvrdVld 0;
BA_ "GatewayedSignals" SG_ 360 BCS_DrvrBrkOvrdVld 0;
BA_ "GenSigInactiveValue" SG_ 360 BCS_DrvrBrkOvrdVld 0;
BA_ "GenSigInvalidValue" SG_ 360 BCS_DrvrBrkOvrdVld 0;
BA_ "GenSigSendType" SG_ 360 BCS_DrvrBrkOvrdVld 1;
BA_ "GenSigStartValue" SG_ 360 BCS_DrvrBrkOvrdVld 0;
BA_ "GenSigTimeoutValue" SG_ 360 BCS_DrvrBrkOvrdVld 0;
BA_ "Remark" SG_ 360 BCS_DrvrBrkOvrdVld "";
BA_ "EventCommandSignal" SG_ 360 BCS_DycEscTarTqActv 0;
BA_ "GatewayedSignals" SG_ 360 BCS_DycEscTarTqActv 0;
BA_ "GenSigInactiveValue" SG_ 360 BCS_DycEscTarTqActv 0;
BA_ "GenSigInvalidValue" SG_ 360 BCS_DycEscTarTqActv 0;
BA_ "GenSigSendType" SG_ 360 BCS_DycEscTarTqActv 1;
BA_ "GenSigStartValue" SG_ 360 BCS_DycEscTarTqActv 0;
BA_ "GenSigTimeoutValue" SG_ 360 BCS_DycEscTarTqActv 0;
BA_ "Remark" SG_ 360 BCS_DycEscTarTqActv "";
BA_ "EventCommandSignal" SG_ 360 BCS_DrvrTqDes 0;
BA_ "GatewayedSignals" SG_ 360 BCS_DrvrTqDes 0;
BA_ "GenSigInactiveValue" SG_ 360 BCS_DrvrTqDes 0;
BA_ "GenSigInvalidValue" SG_ 360 BCS_DrvrTqDes 0;
BA_ "GenSigSendType" SG_ 360 BCS_DrvrTqDes 1;
BA_ "GenSigStartValue" SG_ 360 BCS_DrvrTqDes 0;
BA_ "GenSigTimeoutValue" SG_ 360 BCS_DrvrTqDes 0;
BA_ "Remark" SG_ 360 BCS_DrvrTqDes "";
BA_ "EventCommandSignal" SG_ 360 BCS_ERV_VehSpd 0;
BA_ "GatewayedSignals" SG_ 360 BCS_ERV_VehSpd 0;
BA_ "GenSigInactiveValue" SG_ 360 BCS_ERV_VehSpd 0;
BA_ "GenSigInvalidValue" SG_ 360 BCS_ERV_VehSpd 0;
BA_ "GenSigSendType" SG_ 360 BCS_ERV_VehSpd 1;
BA_ "GenSigStartValue" SG_ 360 BCS_ERV_VehSpd 0;
BA_ "GenSigTimeoutValue" SG_ 360 BCS_ERV_VehSpd 0;
BA_ "Remark" SG_ 360 BCS_ERV_VehSpd "";
BA_ "EventCommandSignal" SG_ 360 BCS_ERV_VehSpdVld 0;
BA_ "GatewayedSignals" SG_ 360 BCS_ERV_VehSpdVld 0;
BA_ "GenSigInactiveValue" SG_ 360 BCS_ERV_VehSpdVld 0;
BA_ "GenSigInvalidValue" SG_ 360 BCS_ERV_VehSpdVld 0;
BA_ "GenSigSendType" SG_ 360 BCS_ERV_VehSpdVld 1;
BA_ "GenSigStartValue" SG_ 360 BCS_ERV_VehSpdVld 0;
BA_ "GenSigTimeoutValue" SG_ 360 BCS_ERV_VehSpdVld 0;
BA_ "Remark" SG_ 360 BCS_ERV_VehSpdVld "";
BA_ "EventCommandSignal" SG_ 360 BCS_EspFailrSts 0;
BA_ "GatewayedSignals" SG_ 360 BCS_EspFailrSts 0;
BA_ "GenSigInactiveValue" SG_ 360 BCS_EspFailrSts 0;
BA_ "GenSigInvalidValue" SG_ 360 BCS_EspFailrSts 0;
BA_ "GenSigSendType" SG_ 360 BCS_EspFailrSts 1;
BA_ "GenSigStartValue" SG_ 360 BCS_EspFailrSts 1;
BA_ "GenSigTimeoutValue" SG_ 360 BCS_EspFailrSts 1;
BA_ "Remark" SG_ 360 BCS_EspFailrSts "";
BA_ "EventCommandSignal" SG_ 360 BCS_ActvSts 0;
BA_ "GatewayedSignals" SG_ 360 BCS_ActvSts 0;
BA_ "GenSigInactiveValue" SG_ 360 BCS_ActvSts 0;
BA_ "GenSigInvalidValue" SG_ 360 BCS_ActvSts 0;
BA_ "GenSigSendType" SG_ 360 BCS_ActvSts 1;
BA_ "GenSigStartValue" SG_ 360 BCS_ActvSts 0;
BA_ "GenSigTimeoutValue" SG_ 360 BCS_ActvSts 0;
BA_ "Remark" SG_ 360 BCS_ActvSts "";
BA_ "EventCommandSignal" SG_ 360 BCS_BDCActive 0;
BA_ "GatewayedSignals" SG_ 360 BCS_BDCActive 0;
BA_ "GenSigInactiveValue" SG_ 360 BCS_BDCActive 0;
BA_ "GenSigInvalidValue" SG_ 360 BCS_BDCActive 0;
BA_ "GenSigSendType" SG_ 360 BCS_BDCActive 1;
BA_ "GenSigStartValue" SG_ 360 BCS_BDCActive 0;
BA_ "GenSigTimeoutValue" SG_ 360 BCS_BDCActive 0;
BA_ "Remark" SG_ 360 BCS_BDCActive "";
BA_ "EventCommandSignal" SG_ 360 BCS_DTCActvSts 0;
BA_ "GatewayedSignals" SG_ 360 BCS_DTCActvSts 0;
BA_ "GenSigInactiveValue" SG_ 360 BCS_DTCActvSts 0;
BA_ "GenSigInvalidValue" SG_ 360 BCS_DTCActvSts 0;
BA_ "GenSigSendType" SG_ 360 BCS_DTCActvSts 1;
BA_ "GenSigStartValue" SG_ 360 BCS_DTCActvSts 0;
BA_ "GenSigTimeoutValue" SG_ 360 BCS_DTCActvSts 0;
BA_ "Remark" SG_ 360 BCS_DTCActvSts "";
BA_ "EventCommandSignal" SG_ 360 BCS_errorFb 0;
BA_ "GatewayedSignals" SG_ 360 BCS_errorFb 0;
BA_ "GenSigInactiveValue" SG_ 360 BCS_errorFb 0;
BA_ "GenSigInvalidValue" SG_ 360 BCS_errorFb 0;
BA_ "GenSigSendType" SG_ 360 BCS_errorFb 1;
BA_ "GenSigStartValue" SG_ 360 BCS_errorFb 0;
BA_ "GenSigTimeoutValue" SG_ 360 BCS_errorFb 0;
BA_ "Remark" SG_ 360 BCS_errorFb "";
BA_ "EventCommandSignal" SG_ 360 BCS_WheelSlipFLValid 0;
BA_ "GatewayedSignals" SG_ 360 BCS_WheelSlipFLValid 0;
BA_ "GenSigInactiveValue" SG_ 360 BCS_WheelSlipFLValid 0;
BA_ "GenSigInvalidValue" SG_ 360 BCS_WheelSlipFLValid 0;
BA_ "GenSigSendType" SG_ 360 BCS_WheelSlipFLValid 1;
BA_ "GenSigStartValue" SG_ 360 BCS_WheelSlipFLValid 0;
BA_ "GenSigTimeoutValue" SG_ 360 BCS_WheelSlipFLValid 0;
BA_ "Remark" SG_ 360 BCS_WheelSlipFLValid "";
BA_ "EventCommandSignal" SG_ 360 BCS_WheelSlipFRValid 0;
BA_ "GatewayedSignals" SG_ 360 BCS_WheelSlipFRValid 0;
BA_ "GenSigInactiveValue" SG_ 360 BCS_WheelSlipFRValid 0;
BA_ "GenSigInvalidValue" SG_ 360 BCS_WheelSlipFRValid 0;
BA_ "GenSigSendType" SG_ 360 BCS_WheelSlipFRValid 1;
BA_ "GenSigStartValue" SG_ 360 BCS_WheelSlipFRValid 0;
BA_ "GenSigTimeoutValue" SG_ 360 BCS_WheelSlipFRValid 0;
BA_ "Remark" SG_ 360 BCS_WheelSlipFRValid "";
BA_ "EventCommandSignal" SG_ 360 BCS_WheelSlipRLValid 0;
BA_ "GatewayedSignals" SG_ 360 BCS_WheelSlipRLValid 0;
BA_ "GenSigInactiveValue" SG_ 360 BCS_WheelSlipRLValid 0;
BA_ "GenSigInvalidValue" SG_ 360 BCS_WheelSlipRLValid 0;
BA_ "GenSigSendType" SG_ 360 BCS_WheelSlipRLValid 1;
BA_ "GenSigStartValue" SG_ 360 BCS_WheelSlipRLValid 0;
BA_ "GenSigTimeoutValue" SG_ 360 BCS_WheelSlipRLValid 0;
BA_ "Remark" SG_ 360 BCS_WheelSlipRLValid "";
BA_ "EventCommandSignal" SG_ 360 BCS_WheelSlipRRValid 0;
BA_ "GatewayedSignals" SG_ 360 BCS_WheelSlipRRValid 0;
BA_ "GenSigInactiveValue" SG_ 360 BCS_WheelSlipRRValid 0;
BA_ "GenSigInvalidValue" SG_ 360 BCS_WheelSlipRRValid 0;
BA_ "GenSigSendType" SG_ 360 BCS_WheelSlipRRValid 1;
BA_ "GenSigStartValue" SG_ 360 BCS_WheelSlipRRValid 0;
BA_ "GenSigTimeoutValue" SG_ 360 BCS_WheelSlipRRValid 0;
BA_ "Remark" SG_ 360 BCS_WheelSlipRRValid "";
BA_ "EventCommandSignal" SG_ 360 BCS_CrbsTarRecpTorqRqFA 0;
BA_ "GatewayedSignals" SG_ 360 BCS_CrbsTarRecpTorqRqFA 0;
BA_ "GenSigInactiveValue" SG_ 360 BCS_CrbsTarRecpTorqRqFA 0;
BA_ "GenSigInvalidValue" SG_ 360 BCS_CrbsTarRecpTorqRqFA 0;
BA_ "GenSigSendType" SG_ 360 BCS_CrbsTarRecpTorqRqFA 1;
BA_ "GenSigStartValue" SG_ 360 BCS_CrbsTarRecpTorqRqFA 6000;
BA_ "GenSigTimeoutValue" SG_ 360 BCS_CrbsTarRecpTorqRqFA 0;
BA_ "Remark" SG_ 360 BCS_CrbsTarRecpTorqRqFA "";
BA_ "EventCommandSignal" SG_ 360 BCS_CrbsTarRecpTorqRqFASt 0;
BA_ "GatewayedSignals" SG_ 360 BCS_CrbsTarRecpTorqRqFASt 0;
BA_ "GenSigInactiveValue" SG_ 360 BCS_CrbsTarRecpTorqRqFASt 0;
BA_ "GenSigInvalidValue" SG_ 360 BCS_CrbsTarRecpTorqRqFASt 0;
BA_ "GenSigSendType" SG_ 360 BCS_CrbsTarRecpTorqRqFASt 1;
BA_ "GenSigStartValue" SG_ 360 BCS_CrbsTarRecpTorqRqFASt 0;
BA_ "GenSigTimeoutValue" SG_ 360 BCS_CrbsTarRecpTorqRqFASt 0;
BA_ "Remark" SG_ 360 BCS_CrbsTarRecpTorqRqFASt "";
BA_ "EventCommandSignal" SG_ 360 BCS_CrbsTarRecpTorqRqRA 0;
BA_ "GatewayedSignals" SG_ 360 BCS_CrbsTarRecpTorqRqRA 0;
BA_ "GenSigInactiveValue" SG_ 360 BCS_CrbsTarRecpTorqRqRA 0;
BA_ "GenSigInvalidValue" SG_ 360 BCS_CrbsTarRecpTorqRqRA 0;
BA_ "GenSigSendType" SG_ 360 BCS_CrbsTarRecpTorqRqRA 1;
BA_ "GenSigStartValue" SG_ 360 BCS_CrbsTarRecpTorqRqRA 6000;
BA_ "GenSigTimeoutValue" SG_ 360 BCS_CrbsTarRecpTorqRqRA 0;
BA_ "Remark" SG_ 360 BCS_CrbsTarRecpTorqRqRA "";
BA_ "EventCommandSignal" SG_ 360 BCS_CrbsTarRecpTorqRqRASt 0;
BA_ "GatewayedSignals" SG_ 360 BCS_CrbsTarRecpTorqRqRASt 0;
BA_ "GenSigInactiveValue" SG_ 360 BCS_CrbsTarRecpTorqRqRASt 0;
BA_ "GenSigInvalidValue" SG_ 360 BCS_CrbsTarRecpTorqRqRASt 0;
BA_ "GenSigSendType" SG_ 360 BCS_CrbsTarRecpTorqRqRASt 1;
BA_ "GenSigStartValue" SG_ 360 BCS_CrbsTarRecpTorqRqRASt 0;
BA_ "GenSigTimeoutValue" SG_ 360 BCS_CrbsTarRecpTorqRqRASt 0;
BA_ "Remark" SG_ 360 BCS_CrbsTarRecpTorqRqRASt "";
BA_ "EventCommandSignal" SG_ 360 BCS_CrbsTarRecpTorqRqSum 0;
BA_ "GatewayedSignals" SG_ 360 BCS_CrbsTarRecpTorqRqSum 0;
BA_ "GenSigInactiveValue" SG_ 360 BCS_CrbsTarRecpTorqRqSum 0;
BA_ "GenSigInvalidValue" SG_ 360 BCS_CrbsTarRecpTorqRqSum 0;
BA_ "GenSigSendType" SG_ 360 BCS_CrbsTarRecpTorqRqSum 1;
BA_ "GenSigStartValue" SG_ 360 BCS_CrbsTarRecpTorqRqSum 6000;
BA_ "GenSigTimeoutValue" SG_ 360 BCS_CrbsTarRecpTorqRqSum 0;
BA_ "Remark" SG_ 360 BCS_CrbsTarRecpTorqRqSum "";
BA_ "EventCommandSignal" SG_ 360 BCS_CrbsTarRecpTorqRqSumSt 0;
BA_ "GatewayedSignals" SG_ 360 BCS_CrbsTarRecpTorqRqSumSt 0;
BA_ "GenSigInactiveValue" SG_ 360 BCS_CrbsTarRecpTorqRqSumSt 0;
BA_ "GenSigInvalidValue" SG_ 360 BCS_CrbsTarRecpTorqRqSumSt 0;
BA_ "GenSigSendType" SG_ 360 BCS_CrbsTarRecpTorqRqSumSt 1;
BA_ "GenSigStartValue" SG_ 360 BCS_CrbsTarRecpTorqRqSumSt 0;
BA_ "GenSigTimeoutValue" SG_ 360 BCS_CrbsTarRecpTorqRqSumSt 0;
BA_ "Remark" SG_ 360 BCS_CrbsTarRecpTorqRqSumSt "";
BA_ "EventCommandSignal" SG_ 360 BCS_WheelSlipFL 0;
BA_ "GatewayedSignals" SG_ 360 BCS_WheelSlipFL 0;
BA_ "GenSigInactiveValue" SG_ 360 BCS_WheelSlipFL 0;
BA_ "GenSigInvalidValue" SG_ 360 BCS_WheelSlipFL 0;
BA_ "GenSigSendType" SG_ 360 BCS_WheelSlipFL 1;
BA_ "GenSigStartValue" SG_ 360 BCS_WheelSlipFL 0;
BA_ "GenSigTimeoutValue" SG_ 360 BCS_WheelSlipFL 0;
BA_ "Remark" SG_ 360 BCS_WheelSlipFL "";
BA_ "EventCommandSignal" SG_ 360 BCS_WheelSlipFR 0;
BA_ "GatewayedSignals" SG_ 360 BCS_WheelSlipFR 0;
BA_ "GenSigInactiveValue" SG_ 360 BCS_WheelSlipFR 0;
BA_ "GenSigInvalidValue" SG_ 360 BCS_WheelSlipFR 0;
BA_ "GenSigSendType" SG_ 360 BCS_WheelSlipFR 1;
BA_ "GenSigStartValue" SG_ 360 BCS_WheelSlipFR 0;
BA_ "GenSigTimeoutValue" SG_ 360 BCS_WheelSlipFR 0;
BA_ "Remark" SG_ 360 BCS_WheelSlipFR "";
BA_ "EventCommandSignal" SG_ 360 BCS_WheelSlipRL 0;
BA_ "GatewayedSignals" SG_ 360 BCS_WheelSlipRL 0;
BA_ "GenSigInactiveValue" SG_ 360 BCS_WheelSlipRL 0;
BA_ "GenSigInvalidValue" SG_ 360 BCS_WheelSlipRL 0;
BA_ "GenSigSendType" SG_ 360 BCS_WheelSlipRL 1;
BA_ "GenSigStartValue" SG_ 360 BCS_WheelSlipRL 0;
BA_ "GenSigTimeoutValue" SG_ 360 BCS_WheelSlipRL 0;
BA_ "Remark" SG_ 360 BCS_WheelSlipRL "";
BA_ "EventCommandSignal" SG_ 360 BCS_WheelSlipRR 0;
BA_ "GatewayedSignals" SG_ 360 BCS_WheelSlipRR 0;
BA_ "GenSigInactiveValue" SG_ 360 BCS_WheelSlipRR 0;
BA_ "GenSigInvalidValue" SG_ 360 BCS_WheelSlipRR 0;
BA_ "GenSigSendType" SG_ 360 BCS_WheelSlipRR 1;
BA_ "GenSigStartValue" SG_ 360 BCS_WheelSlipRR 0;
BA_ "GenSigTimeoutValue" SG_ 360 BCS_WheelSlipRR 0;
BA_ "Remark" SG_ 360 BCS_WheelSlipRR "";
BA_ "EventCommandSignal" SG_ 618 EPB_1_CRC 0;
BA_ "GatewayedSignals" SG_ 618 EPB_1_CRC 0;
BA_ "GenSigInactiveValue" SG_ 618 EPB_1_CRC 0;
BA_ "GenSigInvalidValue" SG_ 618 EPB_1_CRC 0;
BA_ "GenSigSendType" SG_ 618 EPB_1_CRC 1;
BA_ "GenSigStartValue" SG_ 618 EPB_1_CRC 0;
BA_ "GenSigTimeoutValue" SG_ 618 EPB_1_CRC 0;
BA_ "Remark" SG_ 618 EPB_1_CRC "";
BA_ "EventCommandSignal" SG_ 618 EPB_1_Counter 0;
BA_ "GatewayedSignals" SG_ 618 EPB_1_Counter 0;
BA_ "GenSigInactiveValue" SG_ 618 EPB_1_Counter 0;
BA_ "GenSigInvalidValue" SG_ 618 EPB_1_Counter 0;
BA_ "GenSigSendType" SG_ 618 EPB_1_Counter 1;
BA_ "GenSigStartValue" SG_ 618 EPB_1_Counter 0;
BA_ "GenSigTimeoutValue" SG_ 618 EPB_1_Counter 0;
BA_ "Remark" SG_ 618 EPB_1_Counter "";
BA_ "EventCommandSignal" SG_ 618 EPB_SwitchSt 0;
BA_ "GatewayedSignals" SG_ 618 EPB_SwitchSt 0;
BA_ "GenSigInactiveValue" SG_ 618 EPB_SwitchSt 0;
BA_ "GenSigInvalidValue" SG_ 618 EPB_SwitchSt 0;
BA_ "GenSigSendType" SG_ 618 EPB_SwitchSt 1;
BA_ "GenSigStartValue" SG_ 618 EPB_SwitchSt 0;
BA_ "GenSigTimeoutValue" SG_ 618 EPB_SwitchSt 0;
BA_ "Remark" SG_ 618 EPB_SwitchSt "";
BA_ "EventCommandSignal" SG_ 618 EPB_SwitchStVD 0;
BA_ "GatewayedSignals" SG_ 618 EPB_SwitchStVD 0;
BA_ "GenSigInactiveValue" SG_ 618 EPB_SwitchStVD 0;
BA_ "GenSigInvalidValue" SG_ 618 EPB_SwitchStVD 0;
BA_ "GenSigSendType" SG_ 618 EPB_SwitchStVD 1;
BA_ "GenSigStartValue" SG_ 618 EPB_SwitchStVD 0;
BA_ "GenSigTimeoutValue" SG_ 618 EPB_SwitchStVD 0;
BA_ "Remark" SG_ 618 EPB_SwitchStVD "";
BA_ "EventCommandSignal" SG_ 618 EPB_SysSt 0;
BA_ "GatewayedSignals" SG_ 618 EPB_SysSt 0;
BA_ "GenSigInactiveValue" SG_ 618 EPB_SysSt 0;
BA_ "GenSigInvalidValue" SG_ 618 EPB_SysSt 0;
BA_ "GenSigSendType" SG_ 618 EPB_SysSt 1;
BA_ "GenSigStartValue" SG_ 618 EPB_SysSt 0;
BA_ "GenSigTimeoutValue" SG_ 618 EPB_SysSt 7;
BA_ "Remark" SG_ 618 EPB_SysSt "";
BA_ "EventCommandSignal" SG_ 618 EPB_FailSt 0;
BA_ "GatewayedSignals" SG_ 618 EPB_FailSt 0;
BA_ "GenSigInactiveValue" SG_ 618 EPB_FailSt 0;
BA_ "GenSigInvalidValue" SG_ 618 EPB_FailSt 0;
BA_ "GenSigSendType" SG_ 618 EPB_FailSt 1;
BA_ "GenSigStartValue" SG_ 618 EPB_FailSt 0;
BA_ "GenSigTimeoutValue" SG_ 618 EPB_FailSt 1;
BA_ "Remark" SG_ 618 EPB_FailSt "";
BA_ "EventCommandSignal" SG_ 618 EPB_ExtAvailable 0;
BA_ "GatewayedSignals" SG_ 618 EPB_ExtAvailable 0;
BA_ "GenSigInactiveValue" SG_ 618 EPB_ExtAvailable 0;
BA_ "GenSigInvalidValue" SG_ 618 EPB_ExtAvailable 0;
BA_ "GenSigSendType" SG_ 618 EPB_ExtAvailable 1;
BA_ "GenSigStartValue" SG_ 618 EPB_ExtAvailable 0;
BA_ "GenSigTimeoutValue" SG_ 618 EPB_ExtAvailable 0;
BA_ "Remark" SG_ 618 EPB_ExtAvailable "";
BA_ "EventCommandSignal" SG_ 618 EPB_DynamicApplySt 0;
BA_ "GatewayedSignals" SG_ 618 EPB_DynamicApplySt 0;
BA_ "GenSigInactiveValue" SG_ 618 EPB_DynamicApplySt 0;
BA_ "GenSigInvalidValue" SG_ 618 EPB_DynamicApplySt 0;
BA_ "GenSigSendType" SG_ 618 EPB_DynamicApplySt 1;
BA_ "GenSigStartValue" SG_ 618 EPB_DynamicApplySt 0;
BA_ "GenSigTimeoutValue" SG_ 618 EPB_DynamicApplySt 0;
BA_ "Remark" SG_ 618 EPB_DynamicApplySt "";
BA_ "EventCommandSignal" SG_ 618 EPB_ActuatorSt_R 0;
BA_ "GatewayedSignals" SG_ 618 EPB_ActuatorSt_R 0;
BA_ "GenSigInactiveValue" SG_ 618 EPB_ActuatorSt_R 0;
BA_ "GenSigInvalidValue" SG_ 618 EPB_ActuatorSt_R 0;
BA_ "GenSigSendType" SG_ 618 EPB_ActuatorSt_R 1;
BA_ "GenSigStartValue" SG_ 618 EPB_ActuatorSt_R 0;
BA_ "GenSigTimeoutValue" SG_ 618 EPB_ActuatorSt_R 0;
BA_ "Remark" SG_ 618 EPB_ActuatorSt_R "";
BA_ "EventCommandSignal" SG_ 618 EPB_RWUActvSts 0;
BA_ "GatewayedSignals" SG_ 618 EPB_RWUActvSts 0;
BA_ "GenSigInactiveValue" SG_ 618 EPB_RWUActvSts 0;
BA_ "GenSigInvalidValue" SG_ 618 EPB_RWUActvSts 0;
BA_ "GenSigSendType" SG_ 618 EPB_RWUActvSts 1;
BA_ "GenSigStartValue" SG_ 618 EPB_RWUActvSts 0;
BA_ "GenSigTimeoutValue" SG_ 618 EPB_RWUActvSts 0;
BA_ "Remark" SG_ 618 EPB_RWUActvSts "";
BA_ "EventCommandSignal" SG_ 618 EPB_RWUAvl 0;
BA_ "GatewayedSignals" SG_ 618 EPB_RWUAvl 0;
BA_ "GenSigInactiveValue" SG_ 618 EPB_RWUAvl 0;
BA_ "GenSigInvalidValue" SG_ 618 EPB_RWUAvl 0;
BA_ "GenSigSendType" SG_ 618 EPB_RWUAvl 1;
BA_ "GenSigStartValue" SG_ 618 EPB_RWUAvl 0;
BA_ "GenSigTimeoutValue" SG_ 618 EPB_RWUAvl 0;
BA_ "Remark" SG_ 618 EPB_RWUAvl "";
BA_ "EventCommandSignal" SG_ 618 EPB_EpbAvl 0;
BA_ "GatewayedSignals" SG_ 618 EPB_EpbAvl 0;
BA_ "GenSigInactiveValue" SG_ 618 EPB_EpbAvl 0;
BA_ "GenSigInvalidValue" SG_ 618 EPB_EpbAvl 0;
BA_ "GenSigSendType" SG_ 618 EPB_EpbAvl 1;
BA_ "GenSigStartValue" SG_ 618 EPB_EpbAvl 0;
BA_ "GenSigTimeoutValue" SG_ 618 EPB_EpbAvl 0;
BA_ "Remark" SG_ 618 EPB_EpbAvl "";
BA_ "EventCommandSignal" SG_ 618 EPB_RPAAVPAvailability 0;
BA_ "GatewayedSignals" SG_ 618 EPB_RPAAVPAvailability 0;
BA_ "GenSigInactiveValue" SG_ 618 EPB_RPAAVPAvailability 0;
BA_ "GenSigInvalidValue" SG_ 618 EPB_RPAAVPAvailability 0;
BA_ "GenSigSendType" SG_ 618 EPB_RPAAVPAvailability 1;
BA_ "GenSigStartValue" SG_ 618 EPB_RPAAVPAvailability 0;
BA_ "GenSigTimeoutValue" SG_ 618 EPB_RPAAVPAvailability 0;
BA_ "Remark" SG_ 618 EPB_RPAAVPAvailability "";
BA_ "EventCommandSignal" SG_ 618 EPB_APAAvailability 0;
BA_ "GatewayedSignals" SG_ 618 EPB_APAAvailability 0;
BA_ "GenSigInactiveValue" SG_ 618 EPB_APAAvailability 0;
BA_ "GenSigInvalidValue" SG_ 618 EPB_APAAvailability 0;
BA_ "GenSigSendType" SG_ 618 EPB_APAAvailability 1;
BA_ "GenSigStartValue" SG_ 618 EPB_APAAvailability 0;
BA_ "GenSigTimeoutValue" SG_ 618 EPB_APAAvailability 0;
BA_ "Remark" SG_ 618 EPB_APAAvailability "";
BA_ "EventCommandSignal" SG_ 618 EPB_ActuatorSt_L_1 0;
BA_ "GatewayedSignals" SG_ 618 EPB_ActuatorSt_L_1 0;
BA_ "GenSigInactiveValue" SG_ 618 EPB_ActuatorSt_L_1 0;
BA_ "GenSigInvalidValue" SG_ 618 EPB_ActuatorSt_L_1 0;
BA_ "GenSigSendType" SG_ 618 EPB_ActuatorSt_L_1 1;
BA_ "GenSigStartValue" SG_ 618 EPB_ActuatorSt_L_1 0;
BA_ "GenSigTimeoutValue" SG_ 618 EPB_ActuatorSt_L_1 0;
BA_ "Remark" SG_ 618 EPB_ActuatorSt_L_1 "";
BA_ "EventCommandSignal" SG_ 618 EPB_MotorCurrent_L_1 0;
BA_ "GatewayedSignals" SG_ 618 EPB_MotorCurrent_L_1 0;
BA_ "GenSigInactiveValue" SG_ 618 EPB_MotorCurrent_L_1 0;
BA_ "GenSigInvalidValue" SG_ 618 EPB_MotorCurrent_L_1 0;
BA_ "GenSigSendType" SG_ 618 EPB_MotorCurrent_L_1 1;
BA_ "GenSigStartValue" SG_ 618 EPB_MotorCurrent_L_1 0;
BA_ "GenSigTimeoutValue" SG_ 618 EPB_MotorCurrent_L_1 0;
BA_ "Remark" SG_ 618 EPB_MotorCurrent_L_1 "";
BA_ "EventCommandSignal" SG_ 446 RBM_BATResultSt 0;
BA_ "GatewayedSignals" SG_ 446 RBM_BATResultSt 0;
BA_ "GenSigInactiveValue" SG_ 446 RBM_BATResultSt 0;
BA_ "GenSigInvalidValue" SG_ 446 RBM_BATResultSt 0;
BA_ "GenSigSendType" SG_ 446 RBM_BATResultSt 1;
BA_ "GenSigStartValue" SG_ 446 RBM_BATResultSt 0;
BA_ "GenSigTimeoutValue" SG_ 446 RBM_BATResultSt 0;
BA_ "Remark" SG_ 446 RBM_BATResultSt "";
BA_ "EventCommandSignal" SG_ 446 RBU_VehSpdVD 0;
BA_ "GatewayedSignals" SG_ 446 RBU_VehSpdVD 0;
BA_ "GenSigInactiveValue" SG_ 446 RBU_VehSpdVD 0;
BA_ "GenSigInvalidValue" SG_ 446 RBU_VehSpdVD 0;
BA_ "GenSigSendType" SG_ 446 RBU_VehSpdVD 1;
BA_ "GenSigStartValue" SG_ 446 RBU_VehSpdVD 0;
BA_ "GenSigTimeoutValue" SG_ 446 RBU_VehSpdVD 0;
BA_ "Remark" SG_ 446 RBU_VehSpdVD "";
BA_ "EventCommandSignal" SG_ 446 RBU_VehSpd 0;
BA_ "GatewayedSignals" SG_ 446 RBU_VehSpd 0;
BA_ "GenSigInactiveValue" SG_ 446 RBU_VehSpd 0;
BA_ "GenSigInvalidValue" SG_ 446 RBU_VehSpd 0;
BA_ "GenSigSendType" SG_ 446 RBU_VehSpd 1;
BA_ "GenSigStartValue" SG_ 446 RBU_VehSpd 0;
BA_ "GenSigTimeoutValue" SG_ 446 RBU_VehSpd 0;
BA_ "Remark" SG_ 446 RBU_VehSpd "";
BA_ "EventCommandSignal" SG_ 446 RBU_SeconBrkCDAAvailableSt 0;
BA_ "GatewayedSignals" SG_ 446 RBU_SeconBrkCDAAvailableSt 0;
BA_ "GenSigInactiveValue" SG_ 446 RBU_SeconBrkCDAAvailableSt 0;
BA_ "GenSigInvalidValue" SG_ 446 RBU_SeconBrkCDAAvailableSt 0;
BA_ "GenSigSendType" SG_ 446 RBU_SeconBrkCDAAvailableSt 1;
BA_ "GenSigStartValue" SG_ 446 RBU_SeconBrkCDAAvailableSt 0;
BA_ "GenSigTimeoutValue" SG_ 446 RBU_SeconBrkCDAAvailableSt 0;
BA_ "Remark" SG_ 446 RBU_SeconBrkCDAAvailableSt "";
BA_ "EventCommandSignal" SG_ 446 RBU_SeconBrkCommuniSt 0;
BA_ "GatewayedSignals" SG_ 446 RBU_SeconBrkCommuniSt 0;
BA_ "GenSigInactiveValue" SG_ 446 RBU_SeconBrkCommuniSt 0;
BA_ "GenSigInvalidValue" SG_ 446 RBU_SeconBrkCommuniSt 0;
BA_ "GenSigSendType" SG_ 446 RBU_SeconBrkCommuniSt 1;
BA_ "GenSigStartValue" SG_ 446 RBU_SeconBrkCommuniSt 0;
BA_ "GenSigTimeoutValue" SG_ 446 RBU_SeconBrkCommuniSt 0;
BA_ "Remark" SG_ 446 RBU_SeconBrkCommuniSt "";
BA_ "EventCommandSignal" SG_ 446 RBU_SeconBrkCDAActiveSt 0;
BA_ "GatewayedSignals" SG_ 446 RBU_SeconBrkCDAActiveSt 0;
BA_ "GenSigInactiveValue" SG_ 446 RBU_SeconBrkCDAActiveSt 0;
BA_ "GenSigInvalidValue" SG_ 446 RBU_SeconBrkCDAActiveSt 0;
BA_ "GenSigSendType" SG_ 446 RBU_SeconBrkCDAActiveSt 1;
BA_ "GenSigStartValue" SG_ 446 RBU_SeconBrkCDAActiveSt 0;
BA_ "GenSigTimeoutValue" SG_ 446 RBU_SeconBrkCDAActiveSt 0;
BA_ "Remark" SG_ 446 RBU_SeconBrkCDAActiveSt "";
BA_ "EventCommandSignal" SG_ 446 RBU_SeconBrkEPBst 0;
BA_ "GatewayedSignals" SG_ 446 RBU_SeconBrkEPBst 0;
BA_ "GenSigInactiveValue" SG_ 446 RBU_SeconBrkEPBst 0;
BA_ "GenSigInvalidValue" SG_ 446 RBU_SeconBrkEPBst 0;
BA_ "GenSigSendType" SG_ 446 RBU_SeconBrkEPBst 1;
BA_ "GenSigStartValue" SG_ 446 RBU_SeconBrkEPBst 0;
BA_ "GenSigTimeoutValue" SG_ 446 RBU_SeconBrkEPBst 0;
BA_ "Remark" SG_ 446 RBU_SeconBrkEPBst "";
BA_ "EventCommandSignal" SG_ 446 RBU_SeconBrkComChannel 0;
BA_ "GatewayedSignals" SG_ 446 RBU_SeconBrkComChannel 0;
BA_ "GenSigInactiveValue" SG_ 446 RBU_SeconBrkComChannel 0;
BA_ "GenSigInvalidValue" SG_ 446 RBU_SeconBrkComChannel 0;
BA_ "GenSigSendType" SG_ 446 RBU_SeconBrkComChannel 1;
BA_ "GenSigStartValue" SG_ 446 RBU_SeconBrkComChannel 0;
BA_ "GenSigTimeoutValue" SG_ 446 RBU_SeconBrkComChannel 0;
BA_ "Remark" SG_ 446 RBU_SeconBrkComChannel "";
BA_ "EventCommandSignal" SG_ 446 RBU_FourwhlsBrkTrq 0;
BA_ "GatewayedSignals" SG_ 446 RBU_FourwhlsBrkTrq 0;
BA_ "GenSigInactiveValue" SG_ 446 RBU_FourwhlsBrkTrq 0;
BA_ "GenSigInvalidValue" SG_ 446 RBU_FourwhlsBrkTrq 0;
BA_ "GenSigSendType" SG_ 446 RBU_FourwhlsBrkTrq 1;
BA_ "GenSigStartValue" SG_ 446 RBU_FourwhlsBrkTrq 0;
BA_ "GenSigTimeoutValue" SG_ 446 RBU_FourwhlsBrkTrq 0;
BA_ "Remark" SG_ 446 RBU_FourwhlsBrkTrq "";
BA_ "EventCommandSignal" SG_ 446 RBU_FLWheelSpdEdgesSum 0;
BA_ "GatewayedSignals" SG_ 446 RBU_FLWheelSpdEdgesSum 0;
BA_ "GenSigInactiveValue" SG_ 446 RBU_FLWheelSpdEdgesSum 0;
BA_ "GenSigInvalidValue" SG_ 446 RBU_FLWheelSpdEdgesSum 0;
BA_ "GenSigSendType" SG_ 446 RBU_FLWheelSpdEdgesSum 1;
BA_ "GenSigStartValue" SG_ 446 RBU_FLWheelSpdEdgesSum 0;
BA_ "GenSigTimeoutValue" SG_ 446 RBU_FLWheelSpdEdgesSum 0;
BA_ "Remark" SG_ 446 RBU_FLWheelSpdEdgesSum "";
BA_ "EventCommandSignal" SG_ 446 RBU_FRWheelSpdEdgesSum 0;
BA_ "GatewayedSignals" SG_ 446 RBU_FRWheelSpdEdgesSum 0;
BA_ "GenSigInactiveValue" SG_ 446 RBU_FRWheelSpdEdgesSum 0;
BA_ "GenSigInvalidValue" SG_ 446 RBU_FRWheelSpdEdgesSum 0;
BA_ "GenSigSendType" SG_ 446 RBU_FRWheelSpdEdgesSum 1;
BA_ "GenSigStartValue" SG_ 446 RBU_FRWheelSpdEdgesSum 0;
BA_ "GenSigTimeoutValue" SG_ 446 RBU_FRWheelSpdEdgesSum 0;
BA_ "Remark" SG_ 446 RBU_FRWheelSpdEdgesSum "";
BA_ "EventCommandSignal" SG_ 446 RBU_RLWheelSpdEdgesSum 0;
BA_ "GatewayedSignals" SG_ 446 RBU_RLWheelSpdEdgesSum 0;
BA_ "GenSigInactiveValue" SG_ 446 RBU_RLWheelSpdEdgesSum 0;
BA_ "GenSigInvalidValue" SG_ 446 RBU_RLWheelSpdEdgesSum 0;
BA_ "GenSigSendType" SG_ 446 RBU_RLWheelSpdEdgesSum 1;
BA_ "GenSigStartValue" SG_ 446 RBU_RLWheelSpdEdgesSum 0;
BA_ "GenSigTimeoutValue" SG_ 446 RBU_RLWheelSpdEdgesSum 0;
BA_ "Remark" SG_ 446 RBU_RLWheelSpdEdgesSum "";
BA_ "EventCommandSignal" SG_ 446 RBU_RRWheelSpdEdgesSum 0;
BA_ "GatewayedSignals" SG_ 446 RBU_RRWheelSpdEdgesSum 0;
BA_ "GenSigInactiveValue" SG_ 446 RBU_RRWheelSpdEdgesSum 0;
BA_ "GenSigInvalidValue" SG_ 446 RBU_RRWheelSpdEdgesSum 0;
BA_ "GenSigSendType" SG_ 446 RBU_RRWheelSpdEdgesSum 1;
BA_ "GenSigStartValue" SG_ 446 RBU_RRWheelSpdEdgesSum 0;
BA_ "GenSigTimeoutValue" SG_ 446 RBU_RRWheelSpdEdgesSum 0;
BA_ "Remark" SG_ 446 RBU_RRWheelSpdEdgesSum "";
BA_ "EventCommandSignal" SG_ 446 RBU_FLWheelSpd 0;
BA_ "GatewayedSignals" SG_ 446 RBU_FLWheelSpd 0;
BA_ "GenSigInactiveValue" SG_ 446 RBU_FLWheelSpd 0;
BA_ "GenSigInvalidValue" SG_ 446 RBU_FLWheelSpd 0;
BA_ "GenSigSendType" SG_ 446 RBU_FLWheelSpd 1;
BA_ "GenSigStartValue" SG_ 446 RBU_FLWheelSpd 0;
BA_ "GenSigTimeoutValue" SG_ 446 RBU_FLWheelSpd 0;
BA_ "Remark" SG_ 446 RBU_FLWheelSpd "";
BA_ "EventCommandSignal" SG_ 446 RBU_FLWheelSpdVD 0;
BA_ "GatewayedSignals" SG_ 446 RBU_FLWheelSpdVD 0;
BA_ "GenSigInactiveValue" SG_ 446 RBU_FLWheelSpdVD 0;
BA_ "GenSigInvalidValue" SG_ 446 RBU_FLWheelSpdVD 0;
BA_ "GenSigSendType" SG_ 446 RBU_FLWheelSpdVD 1;
BA_ "GenSigStartValue" SG_ 446 RBU_FLWheelSpdVD 0;
BA_ "GenSigTimeoutValue" SG_ 446 RBU_FLWheelSpdVD 0;
BA_ "Remark" SG_ 446 RBU_FLWheelSpdVD "";
BA_ "EventCommandSignal" SG_ 446 RBU_RLWheelRotatedDirection 0;
BA_ "GatewayedSignals" SG_ 446 RBU_RLWheelRotatedDirection 0;
BA_ "GenSigInactiveValue" SG_ 446 RBU_RLWheelRotatedDirection 0;
BA_ "GenSigInvalidValue" SG_ 446 RBU_RLWheelRotatedDirection 0;
BA_ "GenSigSendType" SG_ 446 RBU_RLWheelRotatedDirection 1;
BA_ "GenSigStartValue" SG_ 446 RBU_RLWheelRotatedDirection 0;
BA_ "GenSigTimeoutValue" SG_ 446 RBU_RLWheelRotatedDirection 0;
BA_ "Remark" SG_ 446 RBU_RLWheelRotatedDirection "";
BA_ "EventCommandSignal" SG_ 446 RBU_RLWheelRotatedDirectionVD 0;
BA_ "GatewayedSignals" SG_ 446 RBU_RLWheelRotatedDirectionVD 0;
BA_ "GenSigInactiveValue" SG_ 446 RBU_RLWheelRotatedDirectionVD 0;
BA_ "GenSigInvalidValue" SG_ 446 RBU_RLWheelRotatedDirectionVD 0;
BA_ "GenSigSendType" SG_ 446 RBU_RLWheelRotatedDirectionVD 1;
BA_ "GenSigStartValue" SG_ 446 RBU_RLWheelRotatedDirectionVD 0;
BA_ "GenSigTimeoutValue" SG_ 446 RBU_RLWheelRotatedDirectionVD 0;
BA_ "Remark" SG_ 446 RBU_RLWheelRotatedDirectionVD "";
BA_ "EventCommandSignal" SG_ 446 RBU_FRWheelSpd 0;
BA_ "GatewayedSignals" SG_ 446 RBU_FRWheelSpd 0;
BA_ "GenSigInactiveValue" SG_ 446 RBU_FRWheelSpd 0;
BA_ "GenSigInvalidValue" SG_ 446 RBU_FRWheelSpd 0;
BA_ "GenSigSendType" SG_ 446 RBU_FRWheelSpd 1;
BA_ "GenSigStartValue" SG_ 446 RBU_FRWheelSpd 0;
BA_ "GenSigTimeoutValue" SG_ 446 RBU_FRWheelSpd 0;
BA_ "Remark" SG_ 446 RBU_FRWheelSpd "";
BA_ "EventCommandSignal" SG_ 446 RBU_FRWheelSpdVD 0;
BA_ "GatewayedSignals" SG_ 446 RBU_FRWheelSpdVD 0;
BA_ "GenSigInactiveValue" SG_ 446 RBU_FRWheelSpdVD 0;
BA_ "GenSigInvalidValue" SG_ 446 RBU_FRWheelSpdVD 0;
BA_ "GenSigSendType" SG_ 446 RBU_FRWheelSpdVD 1;
BA_ "GenSigStartValue" SG_ 446 RBU_FRWheelSpdVD 0;
BA_ "GenSigTimeoutValue" SG_ 446 RBU_FRWheelSpdVD 0;
BA_ "Remark" SG_ 446 RBU_FRWheelSpdVD "";
BA_ "EventCommandSignal" SG_ 446 RBU_RRWheelRotatedDirection 0;
BA_ "GatewayedSignals" SG_ 446 RBU_RRWheelRotatedDirection 0;
BA_ "GenSigInactiveValue" SG_ 446 RBU_RRWheelRotatedDirection 0;
BA_ "GenSigInvalidValue" SG_ 446 RBU_RRWheelRotatedDirection 0;
BA_ "GenSigSendType" SG_ 446 RBU_RRWheelRotatedDirection 1;
BA_ "GenSigStartValue" SG_ 446 RBU_RRWheelRotatedDirection 0;
BA_ "GenSigTimeoutValue" SG_ 446 RBU_RRWheelRotatedDirection 0;
BA_ "Remark" SG_ 446 RBU_RRWheelRotatedDirection "";
BA_ "EventCommandSignal" SG_ 446 RBU_RRWheelRotatedDirectionVD 0;
BA_ "GatewayedSignals" SG_ 446 RBU_RRWheelRotatedDirectionVD 0;
BA_ "GenSigInactiveValue" SG_ 446 RBU_RRWheelRotatedDirectionVD 0;
BA_ "GenSigInvalidValue" SG_ 446 RBU_RRWheelRotatedDirectionVD 0;
BA_ "GenSigSendType" SG_ 446 RBU_RRWheelRotatedDirectionVD 1;
BA_ "GenSigStartValue" SG_ 446 RBU_RRWheelRotatedDirectionVD 0;
BA_ "GenSigTimeoutValue" SG_ 446 RBU_RRWheelRotatedDirectionVD 0;
BA_ "Remark" SG_ 446 RBU_RRWheelRotatedDirectionVD "";
BA_ "EventCommandSignal" SG_ 446 RBU_RLWheelSpd 0;
BA_ "GatewayedSignals" SG_ 446 RBU_RLWheelSpd 0;
BA_ "GenSigInactiveValue" SG_ 446 RBU_RLWheelSpd 0;
BA_ "GenSigInvalidValue" SG_ 446 RBU_RLWheelSpd 0;
BA_ "GenSigSendType" SG_ 446 RBU_RLWheelSpd 1;
BA_ "GenSigStartValue" SG_ 446 RBU_RLWheelSpd 0;
BA_ "GenSigTimeoutValue" SG_ 446 RBU_RLWheelSpd 0;
BA_ "Remark" SG_ 446 RBU_RLWheelSpd "";
BA_ "EventCommandSignal" SG_ 446 RBU_RLWheelSpdVD 0;
BA_ "GatewayedSignals" SG_ 446 RBU_RLWheelSpdVD 0;
BA_ "GenSigInactiveValue" SG_ 446 RBU_RLWheelSpdVD 0;
BA_ "GenSigInvalidValue" SG_ 446 RBU_RLWheelSpdVD 0;
BA_ "GenSigSendType" SG_ 446 RBU_RLWheelSpdVD 1;
BA_ "GenSigStartValue" SG_ 446 RBU_RLWheelSpdVD 0;
BA_ "GenSigTimeoutValue" SG_ 446 RBU_RLWheelSpdVD 0;
BA_ "Remark" SG_ 446 RBU_RLWheelSpdVD "";
BA_ "EventCommandSignal" SG_ 446 RBU_RRWheelSpd 0;
BA_ "GatewayedSignals" SG_ 446 RBU_RRWheelSpd 0;
BA_ "GenSigInactiveValue" SG_ 446 RBU_RRWheelSpd 0;
BA_ "GenSigInvalidValue" SG_ 446 RBU_RRWheelSpd 0;
BA_ "GenSigSendType" SG_ 446 RBU_RRWheelSpd 1;
BA_ "GenSigStartValue" SG_ 446 RBU_RRWheelSpd 0;
BA_ "GenSigTimeoutValue" SG_ 446 RBU_RRWheelSpd 0;
BA_ "Remark" SG_ 446 RBU_RRWheelSpd "";
BA_ "EventCommandSignal" SG_ 446 RBU_RRWheelSpdVD 0;
BA_ "GatewayedSignals" SG_ 446 RBU_RRWheelSpdVD 0;
BA_ "GenSigInactiveValue" SG_ 446 RBU_RRWheelSpdVD 0;
BA_ "GenSigInvalidValue" SG_ 446 RBU_RRWheelSpdVD 0;
BA_ "GenSigSendType" SG_ 446 RBU_RRWheelSpdVD 1;
BA_ "GenSigStartValue" SG_ 446 RBU_RRWheelSpdVD 0;
BA_ "GenSigTimeoutValue" SG_ 446 RBU_RRWheelSpdVD 0;
BA_ "Remark" SG_ 446 RBU_RRWheelSpdVD "";
BA_ "EventCommandSignal" SG_ 446 RBU_FLWheelSpdEdgesSumVD 0;
BA_ "GatewayedSignals" SG_ 446 RBU_FLWheelSpdEdgesSumVD 0;
BA_ "GenSigInactiveValue" SG_ 446 RBU_FLWheelSpdEdgesSumVD 0;
BA_ "GenSigInvalidValue" SG_ 446 RBU_FLWheelSpdEdgesSumVD 0;
BA_ "GenSigSendType" SG_ 446 RBU_FLWheelSpdEdgesSumVD 1;
BA_ "GenSigStartValue" SG_ 446 RBU_FLWheelSpdEdgesSumVD 0;
BA_ "GenSigTimeoutValue" SG_ 446 RBU_FLWheelSpdEdgesSumVD 0;
BA_ "Remark" SG_ 446 RBU_FLWheelSpdEdgesSumVD "";
BA_ "EventCommandSignal" SG_ 446 RBU_FRWheelSpdEdgesSumVD 0;
BA_ "GatewayedSignals" SG_ 446 RBU_FRWheelSpdEdgesSumVD 0;
BA_ "GenSigInactiveValue" SG_ 446 RBU_FRWheelSpdEdgesSumVD 0;
BA_ "GenSigInvalidValue" SG_ 446 RBU_FRWheelSpdEdgesSumVD 0;
BA_ "GenSigSendType" SG_ 446 RBU_FRWheelSpdEdgesSumVD 1;
BA_ "GenSigStartValue" SG_ 446 RBU_FRWheelSpdEdgesSumVD 0;
BA_ "GenSigTimeoutValue" SG_ 446 RBU_FRWheelSpdEdgesSumVD 0;
BA_ "Remark" SG_ 446 RBU_FRWheelSpdEdgesSumVD "";
BA_ "EventCommandSignal" SG_ 446 RBU_RLWheelSpdEdgesSumVD 0;
BA_ "GatewayedSignals" SG_ 446 RBU_RLWheelSpdEdgesSumVD 0;
BA_ "GenSigInactiveValue" SG_ 446 RBU_RLWheelSpdEdgesSumVD 0;
BA_ "GenSigInvalidValue" SG_ 446 RBU_RLWheelSpdEdgesSumVD 0;
BA_ "GenSigSendType" SG_ 446 RBU_RLWheelSpdEdgesSumVD 1;
BA_ "GenSigStartValue" SG_ 446 RBU_RLWheelSpdEdgesSumVD 0;
BA_ "GenSigTimeoutValue" SG_ 446 RBU_RLWheelSpdEdgesSumVD 0;
BA_ "Remark" SG_ 446 RBU_RLWheelSpdEdgesSumVD "";
BA_ "EventCommandSignal" SG_ 446 RBU_RRWheelSpdEdgesSumVD 0;
BA_ "GatewayedSignals" SG_ 446 RBU_RRWheelSpdEdgesSumVD 0;
BA_ "GenSigInactiveValue" SG_ 446 RBU_RRWheelSpdEdgesSumVD 0;
BA_ "GenSigInvalidValue" SG_ 446 RBU_RRWheelSpdEdgesSumVD 0;
BA_ "GenSigSendType" SG_ 446 RBU_RRWheelSpdEdgesSumVD 1;
BA_ "GenSigStartValue" SG_ 446 RBU_RRWheelSpdEdgesSumVD 0;
BA_ "GenSigTimeoutValue" SG_ 446 RBU_RRWheelSpdEdgesSumVD 0;
BA_ "Remark" SG_ 446 RBU_RRWheelSpdEdgesSumVD "";
BA_ "EventCommandSignal" SG_ 446 RBU_FLWheelRotatedDirection 0;
BA_ "GatewayedSignals" SG_ 446 RBU_FLWheelRotatedDirection 0;
BA_ "GenSigInactiveValue" SG_ 446 RBU_FLWheelRotatedDirection 0;
BA_ "GenSigInvalidValue" SG_ 446 RBU_FLWheelRotatedDirection 0;
BA_ "GenSigSendType" SG_ 446 RBU_FLWheelRotatedDirection 1;
BA_ "GenSigStartValue" SG_ 446 RBU_FLWheelRotatedDirection 0;
BA_ "GenSigTimeoutValue" SG_ 446 RBU_FLWheelRotatedDirection 0;
BA_ "Remark" SG_ 446 RBU_FLWheelRotatedDirection "";
BA_ "EventCommandSignal" SG_ 446 RBU_FLWheelRotatedDirectionVD 0;
BA_ "GatewayedSignals" SG_ 446 RBU_FLWheelRotatedDirectionVD 0;
BA_ "GenSigInactiveValue" SG_ 446 RBU_FLWheelRotatedDirectionVD 0;
BA_ "GenSigInvalidValue" SG_ 446 RBU_FLWheelRotatedDirectionVD 0;
BA_ "GenSigSendType" SG_ 446 RBU_FLWheelRotatedDirectionVD 1;
BA_ "GenSigStartValue" SG_ 446 RBU_FLWheelRotatedDirectionVD 0;
BA_ "GenSigTimeoutValue" SG_ 446 RBU_FLWheelRotatedDirectionVD 0;
BA_ "Remark" SG_ 446 RBU_FLWheelRotatedDirectionVD "";
BA_ "EventCommandSignal" SG_ 446 RBU_FRWheelRotatedDirection 0;
BA_ "GatewayedSignals" SG_ 446 RBU_FRWheelRotatedDirection 0;
BA_ "GenSigInactiveValue" SG_ 446 RBU_FRWheelRotatedDirection 0;
BA_ "GenSigInvalidValue" SG_ 446 RBU_FRWheelRotatedDirection 0;
BA_ "GenSigSendType" SG_ 446 RBU_FRWheelRotatedDirection 1;
BA_ "GenSigStartValue" SG_ 446 RBU_FRWheelRotatedDirection 0;
BA_ "GenSigTimeoutValue" SG_ 446 RBU_FRWheelRotatedDirection 0;
BA_ "Remark" SG_ 446 RBU_FRWheelRotatedDirection "";
BA_ "EventCommandSignal" SG_ 446 RBU_FRWheelRotatedDirectionVD 0;
BA_ "GatewayedSignals" SG_ 446 RBU_FRWheelRotatedDirectionVD 0;
BA_ "GenSigInactiveValue" SG_ 446 RBU_FRWheelRotatedDirectionVD 0;
BA_ "GenSigInvalidValue" SG_ 446 RBU_FRWheelRotatedDirectionVD 0;
BA_ "GenSigSendType" SG_ 446 RBU_FRWheelRotatedDirectionVD 1;
BA_ "GenSigStartValue" SG_ 446 RBU_FRWheelRotatedDirectionVD 0;
BA_ "GenSigTimeoutValue" SG_ 446 RBU_FRWheelRotatedDirectionVD 0;
BA_ "Remark" SG_ 446 RBU_FRWheelRotatedDirectionVD "";
BA_ "EventCommandSignal" SG_ 430 SRS_1_CRC_1 0;
BA_ "GatewayedSignals" SG_ 430 SRS_1_CRC_1 0;
BA_ "GenSigInactiveValue" SG_ 430 SRS_1_CRC_1 0;
BA_ "GenSigInvalidValue" SG_ 430 SRS_1_CRC_1 0;
BA_ "GenSigSendType" SG_ 430 SRS_1_CRC_1 1;
BA_ "GenSigStartValue" SG_ 430 SRS_1_CRC_1 0;
BA_ "GenSigTimeoutValue" SG_ 430 SRS_1_CRC_1 0;
BA_ "Remark" SG_ 430 SRS_1_CRC_1 "";
BA_ "EventCommandSignal" SG_ 430 SRS_1_Counter_1 0;
BA_ "GatewayedSignals" SG_ 430 SRS_1_Counter_1 0;
BA_ "GenSigInactiveValue" SG_ 430 SRS_1_Counter_1 0;
BA_ "GenSigInvalidValue" SG_ 430 SRS_1_Counter_1 0;
BA_ "GenSigSendType" SG_ 430 SRS_1_Counter_1 1;
BA_ "GenSigStartValue" SG_ 430 SRS_1_Counter_1 0;
BA_ "GenSigTimeoutValue" SG_ 430 SRS_1_Counter_1 0;
BA_ "Remark" SG_ 430 SRS_1_Counter_1 "";
BA_ "EventCommandSignal" SG_ 430 SRS_CrashOutputSt 0;
BA_ "GatewayedSignals" SG_ 430 SRS_CrashOutputSt 0;
BA_ "GenSigInactiveValue" SG_ 430 SRS_CrashOutputSt 0;
BA_ "GenSigInvalidValue" SG_ 430 SRS_CrashOutputSt 0;
BA_ "GenSigSendType" SG_ 430 SRS_CrashOutputSt 0;
BA_ "GenSigStartValue" SG_ 430 SRS_CrashOutputSt 0;
BA_ "GenSigTimeoutValue" SG_ 430 SRS_CrashOutputSt 0;
BA_ "Remark" SG_ 430 SRS_CrashOutputSt "";
BA_ "EventCommandSignal" SG_ 430 SRS_Front_CrashOutputSt 0;
BA_ "GatewayedSignals" SG_ 430 SRS_Front_CrashOutputSt 0;
BA_ "GenSigInactiveValue" SG_ 430 SRS_Front_CrashOutputSt 0;
BA_ "GenSigInvalidValue" SG_ 430 SRS_Front_CrashOutputSt 0;
BA_ "GenSigSendType" SG_ 430 SRS_Front_CrashOutputSt 0;
BA_ "GenSigStartValue" SG_ 430 SRS_Front_CrashOutputSt 0;
BA_ "GenSigTimeoutValue" SG_ 430 SRS_Front_CrashOutputSt 0;
BA_ "Remark" SG_ 430 SRS_Front_CrashOutputSt "";
BA_ "EventCommandSignal" SG_ 430 SRS_DriverSide_CrashOutputSt 0;
BA_ "GatewayedSignals" SG_ 430 SRS_DriverSide_CrashOutputSt 0;
BA_ "GenSigInactiveValue" SG_ 430 SRS_DriverSide_CrashOutputSt 0;
BA_ "GenSigInvalidValue" SG_ 430 SRS_DriverSide_CrashOutputSt 0;
BA_ "GenSigSendType" SG_ 430 SRS_DriverSide_CrashOutputSt 0;
BA_ "GenSigStartValue" SG_ 430 SRS_DriverSide_CrashOutputSt 0;
BA_ "GenSigTimeoutValue" SG_ 430 SRS_DriverSide_CrashOutputSt 0;
BA_ "Remark" SG_ 430 SRS_DriverSide_CrashOutputSt "";
BA_ "EventCommandSignal" SG_ 430 SRS_PassengerSide_CrashOutputSt 0;
BA_ "GatewayedSignals" SG_ 430 SRS_PassengerSide_CrashOutputSt 0;
BA_ "GenSigInactiveValue" SG_ 430 SRS_PassengerSide_CrashOutputSt 0;
BA_ "GenSigInvalidValue" SG_ 430 SRS_PassengerSide_CrashOutputSt 0;
BA_ "GenSigSendType" SG_ 430 SRS_PassengerSide_CrashOutputSt 0;
BA_ "GenSigStartValue" SG_ 430 SRS_PassengerSide_CrashOutputSt 0;
BA_ "GenSigTimeoutValue" SG_ 430 SRS_PassengerSide_CrashOutputSt 0;
BA_ "Remark" SG_ 430 SRS_PassengerSide_CrashOutputSt "";
BA_ "EventCommandSignal" SG_ 430 SRS_Rear_CrashOutputSt 0;
BA_ "GatewayedSignals" SG_ 430 SRS_Rear_CrashOutputSt 0;
BA_ "GenSigInactiveValue" SG_ 430 SRS_Rear_CrashOutputSt 0;
BA_ "GenSigInvalidValue" SG_ 430 SRS_Rear_CrashOutputSt 0;
BA_ "GenSigSendType" SG_ 430 SRS_Rear_CrashOutputSt 0;
BA_ "GenSigStartValue" SG_ 430 SRS_Rear_CrashOutputSt 0;
BA_ "GenSigTimeoutValue" SG_ 430 SRS_Rear_CrashOutputSt 0;
BA_ "Remark" SG_ 430 SRS_Rear_CrashOutputSt "";
BA_ "EventCommandSignal" SG_ 430 SRS_RolloverCrashOutputSt 0;
BA_ "GatewayedSignals" SG_ 430 SRS_RolloverCrashOutputSt 0;
BA_ "GenSigInactiveValue" SG_ 430 SRS_RolloverCrashOutputSt 0;
BA_ "GenSigInvalidValue" SG_ 430 SRS_RolloverCrashOutputSt 0;
BA_ "GenSigSendType" SG_ 430 SRS_RolloverCrashOutputSt 0;
BA_ "GenSigStartValue" SG_ 430 SRS_RolloverCrashOutputSt 0;
BA_ "GenSigTimeoutValue" SG_ 430 SRS_RolloverCrashOutputSt 0;
BA_ "Remark" SG_ 430 SRS_RolloverCrashOutputSt "";
BA_ "EventCommandSignal" SG_ 430 SRS_NearCrashOutputSt 0;
BA_ "GatewayedSignals" SG_ 430 SRS_NearCrashOutputSt 0;
BA_ "GenSigInactiveValue" SG_ 430 SRS_NearCrashOutputSt 0;
BA_ "GenSigInvalidValue" SG_ 430 SRS_NearCrashOutputSt 0;
BA_ "GenSigSendType" SG_ 430 SRS_NearCrashOutputSt 0;
BA_ "GenSigStartValue" SG_ 430 SRS_NearCrashOutputSt 0;
BA_ "GenSigTimeoutValue" SG_ 430 SRS_NearCrashOutputSt 0;
BA_ "Remark" SG_ 430 SRS_NearCrashOutputSt "";
BA_ "EventCommandSignal" SG_ 430 SRS_1_CRC_2 0;
BA_ "GatewayedSignals" SG_ 430 SRS_1_CRC_2 0;
BA_ "GenSigInactiveValue" SG_ 430 SRS_1_CRC_2 0;
BA_ "GenSigInvalidValue" SG_ 430 SRS_1_CRC_2 0;
BA_ "GenSigSendType" SG_ 430 SRS_1_CRC_2 1;
BA_ "GenSigStartValue" SG_ 430 SRS_1_CRC_2 0;
BA_ "GenSigTimeoutValue" SG_ 430 SRS_1_CRC_2 0;
BA_ "Remark" SG_ 430 SRS_1_CRC_2 "";
BA_ "EventCommandSignal" SG_ 430 SRS_1_Counter_2 0;
BA_ "GatewayedSignals" SG_ 430 SRS_1_Counter_2 0;
BA_ "GenSigInactiveValue" SG_ 430 SRS_1_Counter_2 0;
BA_ "GenSigInvalidValue" SG_ 430 SRS_1_Counter_2 0;
BA_ "GenSigSendType" SG_ 430 SRS_1_Counter_2 1;
BA_ "GenSigStartValue" SG_ 430 SRS_1_Counter_2 0;
BA_ "GenSigTimeoutValue" SG_ 430 SRS_1_Counter_2 0;
BA_ "Remark" SG_ 430 SRS_1_Counter_2 "";
BA_ "EventCommandSignal" SG_ 430 SRS_YawSnsCalibSt 0;
BA_ "GatewayedSignals" SG_ 430 SRS_YawSnsCalibSt 0;
BA_ "GenSigInactiveValue" SG_ 430 SRS_YawSnsCalibSt 0;
BA_ "GenSigInvalidValue" SG_ 430 SRS_YawSnsCalibSt 0;
BA_ "GenSigSendType" SG_ 430 SRS_YawSnsCalibSt 1;
BA_ "GenSigStartValue" SG_ 430 SRS_YawSnsCalibSt 0;
BA_ "GenSigTimeoutValue" SG_ 430 SRS_YawSnsCalibSt 0;
BA_ "Remark" SG_ 430 SRS_YawSnsCalibSt "";
BA_ "EventCommandSignal" SG_ 430 SRS_VehLongAccelVD 0;
BA_ "GatewayedSignals" SG_ 430 SRS_VehLongAccelVD 0;
BA_ "GenSigInactiveValue" SG_ 430 SRS_VehLongAccelVD 0;
BA_ "GenSigInvalidValue" SG_ 430 SRS_VehLongAccelVD 0;
BA_ "GenSigSendType" SG_ 430 SRS_VehLongAccelVD 1;
BA_ "GenSigStartValue" SG_ 430 SRS_VehLongAccelVD 0;
BA_ "GenSigTimeoutValue" SG_ 430 SRS_VehLongAccelVD 2;
BA_ "Remark" SG_ 430 SRS_VehLongAccelVD "";
BA_ "EventCommandSignal" SG_ 430 SRS_VehLatrlAccelVD 0;
BA_ "GatewayedSignals" SG_ 430 SRS_VehLatrlAccelVD 0;
BA_ "GenSigInactiveValue" SG_ 430 SRS_VehLatrlAccelVD 0;
BA_ "GenSigInvalidValue" SG_ 430 SRS_VehLatrlAccelVD 0;
BA_ "GenSigSendType" SG_ 430 SRS_VehLatrlAccelVD 1;
BA_ "GenSigStartValue" SG_ 430 SRS_VehLatrlAccelVD 0;
BA_ "GenSigTimeoutValue" SG_ 430 SRS_VehLatrlAccelVD 2;
BA_ "Remark" SG_ 430 SRS_VehLatrlAccelVD "";
BA_ "EventCommandSignal" SG_ 430 SRS_YawRateVD 0;
BA_ "GatewayedSignals" SG_ 430 SRS_YawRateVD 0;
BA_ "GenSigInactiveValue" SG_ 430 SRS_YawRateVD 0;
BA_ "GenSigInvalidValue" SG_ 430 SRS_YawRateVD 0;
BA_ "GenSigSendType" SG_ 430 SRS_YawRateVD 1;
BA_ "GenSigStartValue" SG_ 430 SRS_YawRateVD 0;
BA_ "GenSigTimeoutValue" SG_ 430 SRS_YawRateVD 2;
BA_ "Remark" SG_ 430 SRS_YawRateVD "";
BA_ "EventCommandSignal" SG_ 430 SRS_VehLongAccel 0;
BA_ "GatewayedSignals" SG_ 430 SRS_VehLongAccel 0;
BA_ "GenSigInactiveValue" SG_ 430 SRS_VehLongAccel 0;
BA_ "EventCommandSignal" SG_ 430 SRS_VehLatrlAccel 0;
BA_ "GatewayedSignals" SG_ 430 SRS_VehLatrlAccel 0;
BA_ "GenSigInactiveValue" SG_ 430 SRS_VehLatrlAccel 0;
BA_ "EventCommandSignal" SG_ 430 SRS_YawRate 0;
BA_ "GatewayedSignals" SG_ 430 SRS_YawRate 0;
BA_ "GenSigInactiveValue" SG_ 430 SRS_YawRate 0;
BA_ "EventCommandSignal" SG_ 939 SRS_PsngrSeatBeltSt 0;
BA_ "GatewayedSignals" SG_ 939 SRS_PsngrSeatBeltSt 0;
BA_ "GenSigInactiveValue" SG_ 939 SRS_PsngrSeatBeltSt 0;
BA_ "GenSigInvalidValue" SG_ 939 SRS_PsngrSeatBeltSt 3;
BA_ "GenSigSendType" SG_ 939 SRS_PsngrSeatBeltSt 1;
BA_ "GenSigStartValue" SG_ 939 SRS_PsngrSeatBeltSt 0;
BA_ "GenSigTimeoutValue" SG_ 939 SRS_PsngrSeatBeltSt 3;
BA_ "Remark" SG_ 939 SRS_PsngrSeatBeltSt "";
BA_ "EventCommandSignal" SG_ 939 SRS_DriverSeatBeltSt 0;
BA_ "GatewayedSignals" SG_ 939 SRS_DriverSeatBeltSt 0;
BA_ "GenSigInactiveValue" SG_ 939 SRS_DriverSeatBeltSt 0;
BA_ "GenSigInvalidValue" SG_ 939 SRS_DriverSeatBeltSt 3;
BA_ "GenSigSendType" SG_ 939 SRS_DriverSeatBeltSt 1;
BA_ "GenSigStartValue" SG_ 939 SRS_DriverSeatBeltSt 0;
BA_ "GenSigTimeoutValue" SG_ 939 SRS_DriverSeatBeltSt 3;
BA_ "Remark" SG_ 939 SRS_DriverSeatBeltSt "";
BA_ "EventCommandSignal" SG_ 939 SRS_RearLeftSeatBeltSt 0;
BA_ "GatewayedSignals" SG_ 939 SRS_RearLeftSeatBeltSt 0;
BA_ "GenSigInactiveValue" SG_ 939 SRS_RearLeftSeatBeltSt 0;
BA_ "GenSigInvalidValue" SG_ 939 SRS_RearLeftSeatBeltSt 3;
BA_ "GenSigSendType" SG_ 939 SRS_RearLeftSeatBeltSt 1;
BA_ "GenSigStartValue" SG_ 939 SRS_RearLeftSeatBeltSt 0;
BA_ "GenSigTimeoutValue" SG_ 939 SRS_RearLeftSeatBeltSt 3;
BA_ "Remark" SG_ 939 SRS_RearLeftSeatBeltSt "";
BA_ "EventCommandSignal" SG_ 939 SRS_AirbagFaultSt 0;
BA_ "GatewayedSignals" SG_ 939 SRS_AirbagFaultSt 0;
BA_ "GenSigInactiveValue" SG_ 939 SRS_AirbagFaultSt 0;
BA_ "GenSigInvalidValue" SG_ 939 SRS_AirbagFaultSt 0;
BA_ "GenSigSendType" SG_ 939 SRS_AirbagFaultSt 1;
BA_ "GenSigStartValue" SG_ 939 SRS_AirbagFaultSt 0;
BA_ "GenSigTimeoutValue" SG_ 939 SRS_AirbagFaultSt 1;
BA_ "Remark" SG_ 939 SRS_AirbagFaultSt "";
BA_ "EventCommandSignal" SG_ 939 SRS_RearRightSeatBeltSt 0;
BA_ "GatewayedSignals" SG_ 939 SRS_RearRightSeatBeltSt 0;
BA_ "GenSigInactiveValue" SG_ 939 SRS_RearRightSeatBeltSt 0;
BA_ "GenSigInvalidValue" SG_ 939 SRS_RearRightSeatBeltSt 3;
BA_ "GenSigSendType" SG_ 939 SRS_RearRightSeatBeltSt 1;
BA_ "GenSigStartValue" SG_ 939 SRS_RearRightSeatBeltSt 0;
BA_ "GenSigTimeoutValue" SG_ 939 SRS_RearRightSeatBeltSt 3;
BA_ "Remark" SG_ 939 SRS_RearRightSeatBeltSt "";
BA_ "EventCommandSignal" SG_ 939 SRS_RearMiddleSeatBeltSt 0;
BA_ "GatewayedSignals" SG_ 939 SRS_RearMiddleSeatBeltSt 0;
BA_ "GenSigInactiveValue" SG_ 939 SRS_RearMiddleSeatBeltSt 0;
BA_ "GenSigInvalidValue" SG_ 939 SRS_RearMiddleSeatBeltSt 3;
BA_ "GenSigSendType" SG_ 939 SRS_RearMiddleSeatBeltSt 1;
BA_ "GenSigStartValue" SG_ 939 SRS_RearMiddleSeatBeltSt 0;
BA_ "GenSigTimeoutValue" SG_ 939 SRS_RearMiddleSeatBeltSt 3;
BA_ "Remark" SG_ 939 SRS_RearMiddleSeatBeltSt "";
BA_ "EventCommandSignal" SG_ 363 EPS_1_CRC 0;
BA_ "GatewayedSignals" SG_ 363 EPS_1_CRC 0;
BA_ "GenSigInactiveValue" SG_ 363 EPS_1_CRC 0;
BA_ "GenSigInvalidValue" SG_ 363 EPS_1_CRC 0;
BA_ "GenSigSendType" SG_ 363 EPS_1_CRC 1;
BA_ "GenSigStartValue" SG_ 363 EPS_1_CRC 0;
BA_ "GenSigTimeoutValue" SG_ 363 EPS_1_CRC 0;
BA_ "Remark" SG_ 363 EPS_1_CRC "";
BA_ "EventCommandSignal" SG_ 363 EPS_1_Counter 0;
BA_ "GatewayedSignals" SG_ 363 EPS_1_Counter 0;
BA_ "GenSigInactiveValue" SG_ 363 EPS_1_Counter 0;
BA_ "GenSigInvalidValue" SG_ 363 EPS_1_Counter 0;
BA_ "GenSigSendType" SG_ 363 EPS_1_Counter 1;
BA_ "GenSigStartValue" SG_ 363 EPS_1_Counter 0;
BA_ "GenSigTimeoutValue" SG_ 363 EPS_1_Counter 0;
BA_ "Remark" SG_ 363 EPS_1_Counter "";
BA_ "EventCommandSignal" SG_ 363 EPS_StrngWhlTorqVD 0;
BA_ "GatewayedSignals" SG_ 363 EPS_StrngWhlTorqVD 0;
BA_ "GenSigInactiveValue" SG_ 363 EPS_StrngWhlTorqVD 0;
BA_ "GenSigInvalidValue" SG_ 363 EPS_StrngWhlTorqVD 0;
BA_ "GenSigSendType" SG_ 363 EPS_StrngWhlTorqVD 1;
BA_ "GenSigStartValue" SG_ 363 EPS_StrngWhlTorqVD 0;
BA_ "GenSigTimeoutValue" SG_ 363 EPS_StrngWhlTorqVD 0;
BA_ "Remark" SG_ 363 EPS_StrngWhlTorqVD "";
BA_ "EventCommandSignal" SG_ 363 EPS_StrngWhlTorq 0;
BA_ "GatewayedSignals" SG_ 363 EPS_StrngWhlTorq 0;
BA_ "GenSigInactiveValue" SG_ 363 EPS_StrngWhlTorq 0;
BA_ "GenSigInvalidValue" SG_ 363 EPS_StrngWhlTorq 4095;
BA_ "GenSigSendType" SG_ 363 EPS_StrngWhlTorq 1;
BA_ "GenSigStartValue" SG_ 363 EPS_StrngWhlTorq 1500;
BA_ "GenSigTimeoutValue" SG_ 363 EPS_StrngWhlTorq 4095;
BA_ "Remark" SG_ 363 EPS_StrngWhlTorq "";
BA_ "EventCommandSignal" SG_ 363 TAS_CalibratedSt 0;
BA_ "GatewayedSignals" SG_ 363 TAS_CalibratedSt 0;
BA_ "GenSigInactiveValue" SG_ 363 TAS_CalibratedSt 0;
BA_ "GenSigInvalidValue" SG_ 363 TAS_CalibratedSt 0;
BA_ "GenSigSendType" SG_ 363 TAS_CalibratedSt 1;
BA_ "GenSigStartValue" SG_ 363 TAS_CalibratedSt 0;
BA_ "GenSigTimeoutValue" SG_ 363 TAS_CalibratedSt 0;
BA_ "Remark" SG_ 363 TAS_CalibratedSt "";
BA_ "EventCommandSignal" SG_ 363 EPS_SteeringAngleSpdVD 0;
BA_ "GatewayedSignals" SG_ 363 EPS_SteeringAngleSpdVD 0;
BA_ "GenSigInactiveValue" SG_ 363 EPS_SteeringAngleSpdVD 0;
BA_ "GenSigInvalidValue" SG_ 363 EPS_SteeringAngleSpdVD 0;
BA_ "GenSigSendType" SG_ 363 EPS_SteeringAngleSpdVD 1;
BA_ "GenSigStartValue" SG_ 363 EPS_SteeringAngleSpdVD 0;
BA_ "GenSigTimeoutValue" SG_ 363 EPS_SteeringAngleSpdVD 0;
BA_ "Remark" SG_ 363 EPS_SteeringAngleSpdVD "";
BA_ "EventCommandSignal" SG_ 363 EPS_SteeringAngleSpd 0;
BA_ "GatewayedSignals" SG_ 363 EPS_SteeringAngleSpd 0;
BA_ "GenSigInactiveValue" SG_ 363 EPS_SteeringAngleSpd 0;
BA_ "GenSigInvalidValue" SG_ 363 EPS_SteeringAngleSpd 255;
BA_ "GenSigSendType" SG_ 363 EPS_SteeringAngleSpd 1;
BA_ "GenSigStartValue" SG_ 363 EPS_SteeringAngleSpd 0;
BA_ "GenSigTimeoutValue" SG_ 363 EPS_SteeringAngleSpd 255;
BA_ "Remark" SG_ 363 EPS_SteeringAngleSpd "";
BA_ "EventCommandSignal" SG_ 363 EPS_SteeringAngle 0;
BA_ "GatewayedSignals" SG_ 363 EPS_SteeringAngle 0;
BA_ "GenSigInactiveValue" SG_ 363 EPS_SteeringAngle 0;
BA_ "GenSigInvalidValue" SG_ 363 EPS_SteeringAngle 65535;
BA_ "GenSigSendType" SG_ 363 EPS_SteeringAngle 1;
BA_ "GenSigStartValue" SG_ 363 EPS_SteeringAngle 7800;
BA_ "GenSigTimeoutValue" SG_ 363 EPS_SteeringAngle 65535;
BA_ "Remark" SG_ 363 EPS_SteeringAngle "";
BA_ "EventCommandSignal" SG_ 363 EPS_SteeringAngleVD 0;
BA_ "GatewayedSignals" SG_ 363 EPS_SteeringAngleVD 0;
BA_ "GenSigInactiveValue" SG_ 363 EPS_SteeringAngleVD 0;
BA_ "GenSigInvalidValue" SG_ 363 EPS_SteeringAngleVD 0;
BA_ "GenSigSendType" SG_ 363 EPS_SteeringAngleVD 1;
BA_ "GenSigStartValue" SG_ 363 EPS_SteeringAngleVD 0;
BA_ "GenSigTimeoutValue" SG_ 363 EPS_SteeringAngleVD 0;
BA_ "Remark" SG_ 363 EPS_SteeringAngleVD "";
BA_ "EventCommandSignal" SG_ 363 EPS_ThermalSt 0;
BA_ "GatewayedSignals" SG_ 363 EPS_ThermalSt 0;
BA_ "GenSigInactiveValue" SG_ 363 EPS_ThermalSt 0;
BA_ "GenSigInvalidValue" SG_ 363 EPS_ThermalSt 0;
BA_ "GenSigSendType" SG_ 363 EPS_ThermalSt 1;
BA_ "GenSigStartValue" SG_ 363 EPS_ThermalSt 0;
BA_ "GenSigTimeoutValue" SG_ 363 EPS_ThermalSt 0;
BA_ "Remark" SG_ 363 EPS_ThermalSt "";
BA_ "EventCommandSignal" SG_ 363 EPS_VMCErrFeedback 0;
BA_ "GatewayedSignals" SG_ 363 EPS_VMCErrFeedback 0;
BA_ "GenSigInactiveValue" SG_ 363 EPS_VMCErrFeedback 0;
BA_ "GenSigInvalidValue" SG_ 363 EPS_VMCErrFeedback 0;
BA_ "GenSigSendType" SG_ 363 EPS_VMCErrFeedback 1;
BA_ "GenSigStartValue" SG_ 363 EPS_VMCErrFeedback 0;
BA_ "GenSigTimeoutValue" SG_ 363 EPS_VMCErrFeedback 0;
BA_ "Remark" SG_ 363 EPS_VMCErrFeedback "";
BA_ "EventCommandSignal" SG_ 363 EPS_PstOverlaySt_SideA 0;
BA_ "GatewayedSignals" SG_ 363 EPS_PstOverlaySt_SideA 0;
BA_ "GenSigInactiveValue" SG_ 363 EPS_PstOverlaySt_SideA 0;
BA_ "GenSigInvalidValue" SG_ 363 EPS_PstOverlaySt_SideA 0;
BA_ "GenSigSendType" SG_ 363 EPS_PstOverlaySt_SideA 1;
BA_ "GenSigStartValue" SG_ 363 EPS_PstOverlaySt_SideA 0;
BA_ "GenSigTimeoutValue" SG_ 363 EPS_PstOverlaySt_SideA 0;
BA_ "Remark" SG_ 363 EPS_PstOverlaySt_SideA "";
BA_ "EventCommandSignal" SG_ 363 EPS_PstOverlaySt_SideB 0;
BA_ "GatewayedSignals" SG_ 363 EPS_PstOverlaySt_SideB 0;
BA_ "GenSigInactiveValue" SG_ 363 EPS_PstOverlaySt_SideB 0;
BA_ "GenSigInvalidValue" SG_ 363 EPS_PstOverlaySt_SideB 0;
BA_ "GenSigSendType" SG_ 363 EPS_PstOverlaySt_SideB 1;
BA_ "GenSigStartValue" SG_ 363 EPS_PstOverlaySt_SideB 0;
BA_ "GenSigTimeoutValue" SG_ 363 EPS_PstOverlaySt_SideB 0;
BA_ "Remark" SG_ 363 EPS_PstOverlaySt_SideB "";
BA_ "EventCommandSignal" SG_ 363 EPS_HealthySt_SideA 0;
BA_ "GatewayedSignals" SG_ 363 EPS_HealthySt_SideA 0;
BA_ "GenSigInactiveValue" SG_ 363 EPS_HealthySt_SideA 0;
BA_ "GenSigInvalidValue" SG_ 363 EPS_HealthySt_SideA 0;
BA_ "GenSigSendType" SG_ 363 EPS_HealthySt_SideA 1;
BA_ "GenSigStartValue" SG_ 363 EPS_HealthySt_SideA 0;
BA_ "GenSigTimeoutValue" SG_ 363 EPS_HealthySt_SideA 0;
BA_ "Remark" SG_ 363 EPS_HealthySt_SideA "";
BA_ "EventCommandSignal" SG_ 363 EPS_HealthySt_SideB 0;
BA_ "GatewayedSignals" SG_ 363 EPS_HealthySt_SideB 0;
BA_ "GenSigInactiveValue" SG_ 363 EPS_HealthySt_SideB 0;
BA_ "GenSigInvalidValue" SG_ 363 EPS_HealthySt_SideB 0;
BA_ "GenSigSendType" SG_ 363 EPS_HealthySt_SideB 1;
BA_ "GenSigStartValue" SG_ 363 EPS_HealthySt_SideB 0;
BA_ "GenSigTimeoutValue" SG_ 363 EPS_HealthySt_SideB 0;
BA_ "Remark" SG_ 363 EPS_HealthySt_SideB "";
BA_ "EventCommandSignal" SG_ 363 EPS_PstOverlaySt 0;
BA_ "GatewayedSignals" SG_ 363 EPS_PstOverlaySt 0;
BA_ "GenSigInactiveValue" SG_ 363 EPS_PstOverlaySt 0;
BA_ "GenSigInvalidValue" SG_ 363 EPS_PstOverlaySt 0;
BA_ "GenSigSendType" SG_ 363 EPS_PstOverlaySt 1;
BA_ "GenSigStartValue" SG_ 363 EPS_PstOverlaySt 0;
BA_ "GenSigTimeoutValue" SG_ 363 EPS_PstOverlaySt 0;
BA_ "Remark" SG_ 363 EPS_PstOverlaySt "";
BA_ "EventCommandSignal" SG_ 363 EPS_HealthySt_DualSide 0;
BA_ "GatewayedSignals" SG_ 363 EPS_HealthySt_DualSide 0;
BA_ "GenSigInactiveValue" SG_ 363 EPS_HealthySt_DualSide 0;
BA_ "GenSigInvalidValue" SG_ 363 EPS_HealthySt_DualSide 0;
BA_ "GenSigSendType" SG_ 363 EPS_HealthySt_DualSide 1;
BA_ "GenSigStartValue" SG_ 363 EPS_HealthySt_DualSide 0;
BA_ "GenSigTimeoutValue" SG_ 363 EPS_HealthySt_DualSide 0;
BA_ "Remark" SG_ 363 EPS_HealthySt_DualSide "";
BA_ "EventCommandSignal" SG_ 363 EPS_PstOverLayRdntSt 0;
BA_ "GatewayedSignals" SG_ 363 EPS_PstOverLayRdntSt 0;
BA_ "GenSigInactiveValue" SG_ 363 EPS_PstOverLayRdntSt 0;
BA_ "GenSigInvalidValue" SG_ 363 EPS_PstOverLayRdntSt 0;
BA_ "GenSigSendType" SG_ 363 EPS_PstOverLayRdntSt 1;
BA_ "GenSigStartValue" SG_ 363 EPS_PstOverLayRdntSt 0;
BA_ "GenSigTimeoutValue" SG_ 363 EPS_PstOverLayRdntSt 0;
BA_ "Remark" SG_ 363 EPS_PstOverLayRdntSt "";
BA_ "EventCommandSignal" SG_ 363 EPS_VibrationWarnSt_A 0;
BA_ "GatewayedSignals" SG_ 363 EPS_VibrationWarnSt_A 0;
BA_ "GenSigInactiveValue" SG_ 363 EPS_VibrationWarnSt_A 0;
BA_ "GenSigInvalidValue" SG_ 363 EPS_VibrationWarnSt_A 0;
BA_ "GenSigSendType" SG_ 363 EPS_VibrationWarnSt_A 1;
BA_ "GenSigStartValue" SG_ 363 EPS_VibrationWarnSt_A 0;
BA_ "GenSigTimeoutValue" SG_ 363 EPS_VibrationWarnSt_A 0;
BA_ "Remark" SG_ 363 EPS_VibrationWarnSt_A "";
BA_ "EventCommandSignal" SG_ 363 SAC_ErrFeedback_SideA 0;
BA_ "GatewayedSignals" SG_ 363 SAC_ErrFeedback_SideA 0;
BA_ "GenSigInactiveValue" SG_ 363 SAC_ErrFeedback_SideA 0;
BA_ "GenSigInvalidValue" SG_ 363 SAC_ErrFeedback_SideA 0;
BA_ "GenSigSendType" SG_ 363 SAC_ErrFeedback_SideA 1;
BA_ "GenSigStartValue" SG_ 363 SAC_ErrFeedback_SideA 0;
BA_ "GenSigTimeoutValue" SG_ 363 SAC_ErrFeedback_SideA 0;
BA_ "Remark" SG_ 363 SAC_ErrFeedback_SideA "";
BA_ "EventCommandSignal" SG_ 363 SAC_ErrFeedback_SideB 0;
BA_ "GatewayedSignals" SG_ 363 SAC_ErrFeedback_SideB 0;
BA_ "GenSigInactiveValue" SG_ 363 SAC_ErrFeedback_SideB 0;
BA_ "GenSigInvalidValue" SG_ 363 SAC_ErrFeedback_SideB 0;
BA_ "GenSigSendType" SG_ 363 SAC_ErrFeedback_SideB 1;
BA_ "GenSigStartValue" SG_ 363 SAC_ErrFeedback_SideB 0;
BA_ "GenSigTimeoutValue" SG_ 363 SAC_ErrFeedback_SideB 0;
BA_ "Remark" SG_ 363 SAC_ErrFeedback_SideB "";
BA_ "EventCommandSignal" SG_ 363 EPS_ADASTargetAngle 0;
BA_ "GatewayedSignals" SG_ 363 EPS_ADASTargetAngle 0;
BA_ "GenSigInactiveValue" SG_ 363 EPS_ADASTargetAngle 0;
BA_ "GenSigInvalidValue" SG_ 363 EPS_ADASTargetAngle 0;
BA_ "GenSigSendType" SG_ 363 EPS_ADASTargetAngle 1;
BA_ "GenSigStartValue" SG_ 363 EPS_ADASTargetAngle 7800;
BA_ "GenSigTimeoutValue" SG_ 363 EPS_ADASTargetAngle 7800;
BA_ "Remark" SG_ 363 EPS_ADASTargetAngle "";
BA_ "EventCommandSignal" SG_ 363 EPS_PDC_CtrlSt 0;
BA_ "GatewayedSignals" SG_ 363 EPS_PDC_CtrlSt 0;
BA_ "GenSigInactiveValue" SG_ 363 EPS_PDC_CtrlSt 0;
BA_ "GenSigInvalidValue" SG_ 363 EPS_PDC_CtrlSt 0;
BA_ "GenSigSendType" SG_ 363 EPS_PDC_CtrlSt 1;
BA_ "GenSigStartValue" SG_ 363 EPS_PDC_CtrlSt 0;
BA_ "GenSigTimeoutValue" SG_ 363 EPS_PDC_CtrlSt 0;
BA_ "Remark" SG_ 363 EPS_PDC_CtrlSt "";
BA_ "EventCommandSignal" SG_ 363 EPS_Shimmy_Compensation_CtrlSt 0;
BA_ "GatewayedSignals" SG_ 363 EPS_Shimmy_Compensation_CtrlSt 0;
BA_ "GenSigInactiveValue" SG_ 363 EPS_Shimmy_Compensation_CtrlSt 0;
BA_ "GenSigInvalidValue" SG_ 363 EPS_Shimmy_Compensation_CtrlSt 0;
BA_ "GenSigSendType" SG_ 363 EPS_Shimmy_Compensation_CtrlSt 1;
BA_ "GenSigStartValue" SG_ 363 EPS_Shimmy_Compensation_CtrlSt 0;
BA_ "GenSigTimeoutValue" SG_ 363 EPS_Shimmy_Compensation_CtrlSt 0;
BA_ "Remark" SG_ 363 EPS_Shimmy_Compensation_CtrlSt "";
BA_ "EventCommandSignal" SG_ 363 EPS_FunctionStyleSt 0;
BA_ "GatewayedSignals" SG_ 363 EPS_FunctionStyleSt 0;
BA_ "GenSigInactiveValue" SG_ 363 EPS_FunctionStyleSt 0;
BA_ "GenSigInvalidValue" SG_ 363 EPS_FunctionStyleSt 0;
BA_ "GenSigSendType" SG_ 363 EPS_FunctionStyleSt 1;
BA_ "GenSigStartValue" SG_ 363 EPS_FunctionStyleSt 0;
BA_ "GenSigTimeoutValue" SG_ 363 EPS_FunctionStyleSt 0;
BA_ "Remark" SG_ 363 EPS_FunctionStyleSt "";
BA_ "EventCommandSignal" SG_ 363 EPS_SteeringModeSt 0;
BA_ "GatewayedSignals" SG_ 363 EPS_SteeringModeSt 0;
BA_ "GenSigInactiveValue" SG_ 363 EPS_SteeringModeSt 0;
BA_ "GenSigInvalidValue" SG_ 363 EPS_SteeringModeSt 0;
BA_ "GenSigSendType" SG_ 363 EPS_SteeringModeSt 1;
BA_ "GenSigStartValue" SG_ 363 EPS_SteeringModeSt 0;
BA_ "GenSigTimeoutValue" SG_ 363 EPS_SteeringModeSt 0;
BA_ "Remark" SG_ 363 EPS_SteeringModeSt "";
BA_ "EventCommandSignal" SG_ 363 EPS_ActEffectiveChannel 0;
BA_ "GatewayedSignals" SG_ 363 EPS_ActEffectiveChannel 0;
BA_ "GenSigInactiveValue" SG_ 363 EPS_ActEffectiveChannel 0;
BA_ "GenSigInvalidValue" SG_ 363 EPS_ActEffectiveChannel 0;
BA_ "GenSigSendType" SG_ 363 EPS_ActEffectiveChannel 1;
BA_ "GenSigStartValue" SG_ 363 EPS_ActEffectiveChannel 0;
BA_ "GenSigTimeoutValue" SG_ 363 EPS_ActEffectiveChannel 0;
BA_ "Remark" SG_ 363 EPS_ActEffectiveChannel "";
BA_ "EventCommandSignal" SG_ 363 EPS_ReqAngOverRange 0;
BA_ "GatewayedSignals" SG_ 363 EPS_ReqAngOverRange 0;
BA_ "GenSigInactiveValue" SG_ 363 EPS_ReqAngOverRange 0;
BA_ "GenSigInvalidValue" SG_ 363 EPS_ReqAngOverRange 0;
BA_ "GenSigSendType" SG_ 363 EPS_ReqAngOverRange 1;
BA_ "GenSigStartValue" SG_ 363 EPS_ReqAngOverRange 0;
BA_ "GenSigTimeoutValue" SG_ 363 EPS_ReqAngOverRange 0;
BA_ "Remark" SG_ 363 EPS_ReqAngOverRange "";
BA_ "EventCommandSignal" SG_ 363 EPS_SACMotorTorAct 0;
BA_ "GatewayedSignals" SG_ 363 EPS_SACMotorTorAct 0;
BA_ "GenSigInactiveValue" SG_ 363 EPS_SACMotorTorAct 0;
BA_ "GenSigInvalidValue" SG_ 363 EPS_SACMotorTorAct 0;
BA_ "GenSigSendType" SG_ 363 EPS_SACMotorTorAct 1;
BA_ "GenSigStartValue" SG_ 363 EPS_SACMotorTorAct 600;
BA_ "GenSigTimeoutValue" SG_ 363 EPS_SACMotorTorAct 600;
BA_ "Remark" SG_ 363 EPS_SACMotorTorAct "";
BA_ "EventCommandSignal" SG_ 363 EPS_SACMotorTorLimInt 0;
BA_ "GatewayedSignals" SG_ 363 EPS_SACMotorTorLimInt 0;
BA_ "GenSigInactiveValue" SG_ 363 EPS_SACMotorTorLimInt 0;
BA_ "GenSigInvalidValue" SG_ 363 EPS_SACMotorTorLimInt 2047;
BA_ "GenSigSendType" SG_ 363 EPS_SACMotorTorLimInt 1;
BA_ "GenSigStartValue" SG_ 363 EPS_SACMotorTorLimInt 0;
BA_ "GenSigTimeoutValue" SG_ 363 EPS_SACMotorTorLimInt 2047;
BA_ "Remark" SG_ 363 EPS_SACMotorTorLimInt "";
BA_ "EventCommandSignal" SG_ 363 EPS_ReqAngSpdOverRange 0;
BA_ "GatewayedSignals" SG_ 363 EPS_ReqAngSpdOverRange 0;
BA_ "GenSigInactiveValue" SG_ 363 EPS_ReqAngSpdOverRange 0;
BA_ "GenSigInvalidValue" SG_ 363 EPS_ReqAngSpdOverRange 0;
BA_ "GenSigSendType" SG_ 363 EPS_ReqAngSpdOverRange 1;
BA_ "GenSigStartValue" SG_ 363 EPS_ReqAngSpdOverRange 0;
BA_ "GenSigTimeoutValue" SG_ 363 EPS_ReqAngSpdOverRange 0;
BA_ "Remark" SG_ 363 EPS_ReqAngSpdOverRange "";
BA_ "EventCommandSignal" SG_ 363 EPS_AssistPraSwitchToLKA 0;
BA_ "GatewayedSignals" SG_ 363 EPS_AssistPraSwitchToLKA 0;
BA_ "GenSigInactiveValue" SG_ 363 EPS_AssistPraSwitchToLKA 0;
BA_ "GenSigInvalidValue" SG_ 363 EPS_AssistPraSwitchToLKA 0;
BA_ "GenSigSendType" SG_ 363 EPS_AssistPraSwitchToLKA 1;
BA_ "GenSigStartValue" SG_ 363 EPS_AssistPraSwitchToLKA 0;
BA_ "GenSigTimeoutValue" SG_ 363 EPS_AssistPraSwitchToLKA 0;
BA_ "Remark" SG_ 363 EPS_AssistPraSwitchToLKA "";
BA_ "EventCommandSignal" SG_ 363 EPS_SteerGainEnable 0;
BA_ "GatewayedSignals" SG_ 363 EPS_SteerGainEnable 0;
BA_ "GenSigInactiveValue" SG_ 363 EPS_SteerGainEnable 0;
BA_ "GenSigInvalidValue" SG_ 363 EPS_SteerGainEnable 0;
BA_ "GenSigSendType" SG_ 363 EPS_SteerGainEnable 1;
BA_ "GenSigStartValue" SG_ 363 EPS_SteerGainEnable 0;
BA_ "GenSigTimeoutValue" SG_ 363 EPS_SteerGainEnable 0;
BA_ "Remark" SG_ 363 EPS_SteerGainEnable "";
BA_ "EventCommandSignal" SG_ 363 EPS_EmSteerEnbale 0;
BA_ "GatewayedSignals" SG_ 363 EPS_EmSteerEnbale 0;
BA_ "GenSigInactiveValue" SG_ 363 EPS_EmSteerEnbale 0;
BA_ "GenSigInvalidValue" SG_ 363 EPS_EmSteerEnbale 0;
BA_ "GenSigSendType" SG_ 363 EPS_EmSteerEnbale 1;
BA_ "GenSigStartValue" SG_ 363 EPS_EmSteerEnbale 0;
BA_ "GenSigTimeoutValue" SG_ 363 EPS_EmSteerEnbale 0;
BA_ "Remark" SG_ 363 EPS_EmSteerEnbale "";
BA_ "EventCommandSignal" SG_ 363 EPS_SG_ErrFeedback 0;
BA_ "GatewayedSignals" SG_ 363 EPS_SG_ErrFeedback 0;
BA_ "GenSigInactiveValue" SG_ 363 EPS_SG_ErrFeedback 0;
BA_ "GenSigInvalidValue" SG_ 363 EPS_SG_ErrFeedback 0;
BA_ "GenSigSendType" SG_ 363 EPS_SG_ErrFeedback 1;
BA_ "GenSigStartValue" SG_ 363 EPS_SG_ErrFeedback 0;
BA_ "GenSigTimeoutValue" SG_ 363 EPS_SG_ErrFeedback 0;
BA_ "Remark" SG_ 363 EPS_SG_ErrFeedback "";
BA_ "EventCommandSignal" SG_ 363 EPS_EM_ErrFeedback 0;
BA_ "GatewayedSignals" SG_ 363 EPS_EM_ErrFeedback 0;
BA_ "GenSigInactiveValue" SG_ 363 EPS_EM_ErrFeedback 0;
BA_ "GenSigInvalidValue" SG_ 363 EPS_EM_ErrFeedback 0;
BA_ "GenSigSendType" SG_ 363 EPS_EM_ErrFeedback 1;
BA_ "GenSigStartValue" SG_ 363 EPS_EM_ErrFeedback 0;
BA_ "GenSigTimeoutValue" SG_ 363 EPS_EM_ErrFeedback 0;
BA_ "Remark" SG_ 363 EPS_EM_ErrFeedback "";
BA_ "EventCommandSignal" SG_ 363 EPS_VW_ErrFeedback 0;
BA_ "GatewayedSignals" SG_ 363 EPS_VW_ErrFeedback 0;
BA_ "GenSigInactiveValue" SG_ 363 EPS_VW_ErrFeedback 0;
BA_ "GenSigInvalidValue" SG_ 363 EPS_VW_ErrFeedback 0;
BA_ "GenSigSendType" SG_ 363 EPS_VW_ErrFeedback 1;
BA_ "GenSigStartValue" SG_ 363 EPS_VW_ErrFeedback 0;
BA_ "GenSigTimeoutValue" SG_ 363 EPS_VW_ErrFeedback 0;
BA_ "Remark" SG_ 363 EPS_VW_ErrFeedback "";
BA_ "EventCommandSignal" SG_ 363 EPS_SACMotorTorActMot 0;
BA_ "GatewayedSignals" SG_ 363 EPS_SACMotorTorActMot 0;
BA_ "GenSigInactiveValue" SG_ 363 EPS_SACMotorTorActMot 0;
BA_ "GenSigInvalidValue" SG_ 363 EPS_SACMotorTorActMot 0;
BA_ "GenSigSendType" SG_ 363 EPS_SACMotorTorActMot 1;
BA_ "GenSigStartValue" SG_ 363 EPS_SACMotorTorActMot 600;
BA_ "GenSigTimeoutValue" SG_ 363 EPS_SACMotorTorActMot 600;
BA_ "Remark" SG_ 363 EPS_SACMotorTorActMot "";
BA_ "EventCommandSignal" SG_ 363 EPS_SACMotorTorLimIntMot 0;
BA_ "GatewayedSignals" SG_ 363 EPS_SACMotorTorLimIntMot 0;
BA_ "GenSigInactiveValue" SG_ 363 EPS_SACMotorTorLimIntMot 0;
BA_ "GenSigInvalidValue" SG_ 363 EPS_SACMotorTorLimIntMot 2047;
BA_ "GenSigSendType" SG_ 363 EPS_SACMotorTorLimIntMot 1;
BA_ "GenSigStartValue" SG_ 363 EPS_SACMotorTorLimIntMot 0;
BA_ "GenSigTimeoutValue" SG_ 363 EPS_SACMotorTorLimIntMot 2047;
BA_ "Remark" SG_ 363 EPS_SACMotorTorLimIntMot "";
BA_ "EventCommandSignal" SG_ 363 EPS_SG_ActualLevel 0;
BA_ "GatewayedSignals" SG_ 363 EPS_SG_ActualLevel 0;
BA_ "GenSigInactiveValue" SG_ 363 EPS_SG_ActualLevel 0;
BA_ "GenSigInvalidValue" SG_ 363 EPS_SG_ActualLevel 255;
BA_ "GenSigSendType" SG_ 363 EPS_SG_ActualLevel 1;
BA_ "GenSigStartValue" SG_ 363 EPS_SG_ActualLevel 100;
BA_ "GenSigTimeoutValue" SG_ 363 EPS_SG_ActualLevel 0;
BA_ "Remark" SG_ 363 EPS_SG_ActualLevel "";
BA_ "EventCommandSignal" SG_ 363 EPS_MotorTorSum 0;
BA_ "GatewayedSignals" SG_ 363 EPS_MotorTorSum 0;
BA_ "GenSigInactiveValue" SG_ 363 EPS_MotorTorSum 0;
BA_ "GenSigInvalidValue" SG_ 363 EPS_MotorTorSum 0;
BA_ "GenSigSendType" SG_ 363 EPS_MotorTorSum 1;
BA_ "GenSigStartValue" SG_ 363 EPS_MotorTorSum 600;
BA_ "GenSigTimeoutValue" SG_ 363 EPS_MotorTorSum 600;
BA_ "Remark" SG_ 363 EPS_MotorTorSum "";
BA_ "EventCommandSignal" SG_ 363 EPS_WarnLamp 0;
BA_ "GatewayedSignals" SG_ 363 EPS_WarnLamp 0;
BA_ "GenSigInactiveValue" SG_ 363 EPS_WarnLamp 0;
BA_ "GenSigInvalidValue" SG_ 363 EPS_WarnLamp 0;
BA_ "GenSigSendType" SG_ 363 EPS_WarnLamp 1;
BA_ "GenSigStartValue" SG_ 363 EPS_WarnLamp 0;
BA_ "GenSigTimeoutValue" SG_ 363 EPS_WarnLamp 2;
BA_ "Remark" SG_ 363 EPS_WarnLamp "";
BA_ "EventCommandSignal" SG_ 363 EPS_AssistPercentage 0;
BA_ "GatewayedSignals" SG_ 363 EPS_AssistPercentage 0;
BA_ "GenSigInactiveValue" SG_ 363 EPS_AssistPercentage 0;
BA_ "GenSigInvalidValue" SG_ 363 EPS_AssistPercentage 0;
BA_ "GenSigSendType" SG_ 363 EPS_AssistPercentage 1;
BA_ "GenSigStartValue" SG_ 363 EPS_AssistPercentage 0;
BA_ "GenSigTimeoutValue" SG_ 363 EPS_AssistPercentage 0;
BA_ "Remark" SG_ 363 EPS_AssistPercentage "";
BA_ "EventCommandSignal" SG_ 363 EPS_AssistRatio 0;
BA_ "GatewayedSignals" SG_ 363 EPS_AssistRatio 0;
BA_ "GenSigInactiveValue" SG_ 363 EPS_AssistRatio 0;
BA_ "GenSigInvalidValue" SG_ 363 EPS_AssistRatio 50;
BA_ "GenSigSendType" SG_ 363 EPS_AssistRatio 1;
BA_ "GenSigStartValue" SG_ 363 EPS_AssistRatio 50;
BA_ "GenSigTimeoutValue" SG_ 363 EPS_AssistRatio 0;
BA_ "Remark" SG_ 363 EPS_AssistRatio "AY项目不发";
BA_ "EventCommandSignal" SG_ 363 EPS_SteeringWhlTorFlt 0;
BA_ "GatewayedSignals" SG_ 363 EPS_SteeringWhlTorFlt 0;
BA_ "GenSigInactiveValue" SG_ 363 EPS_SteeringWhlTorFlt 0;
BA_ "GenSigInvalidValue" SG_ 363 EPS_SteeringWhlTorFlt 4095;
BA_ "GenSigSendType" SG_ 363 EPS_SteeringWhlTorFlt 1;
BA_ "GenSigStartValue" SG_ 363 EPS_SteeringWhlTorFlt 1500;
BA_ "GenSigTimeoutValue" SG_ 363 EPS_SteeringWhlTorFlt 4095;
BA_ "Remark" SG_ 363 EPS_SteeringWhlTorFlt "";
BA_ "EventCommandSignal" SG_ 363 EPS_SteeringWhlTorFltVD 0;
BA_ "GatewayedSignals" SG_ 363 EPS_SteeringWhlTorFltVD 0;
BA_ "GenSigInactiveValue" SG_ 363 EPS_SteeringWhlTorFltVD 0;
BA_ "GenSigInvalidValue" SG_ 363 EPS_SteeringWhlTorFltVD 0;
BA_ "GenSigSendType" SG_ 363 EPS_SteeringWhlTorFltVD 1;
BA_ "GenSigStartValue" SG_ 363 EPS_SteeringWhlTorFltVD 0;
BA_ "GenSigTimeoutValue" SG_ 363 EPS_SteeringWhlTorFltVD 0;
BA_ "Remark" SG_ 363 EPS_SteeringWhlTorFltVD "";
BA_ "EventCommandSignal" SG_ 363 EPS_SteeringAngleRate 0;
BA_ "GatewayedSignals" SG_ 363 EPS_SteeringAngleRate 0;
BA_ "GenSigInactiveValue" SG_ 363 EPS_SteeringAngleRate 0;
BA_ "GenSigInvalidValue" SG_ 363 EPS_SteeringAngleRate 0;
BA_ "GenSigSendType" SG_ 363 EPS_SteeringAngleRate 1;
BA_ "GenSigStartValue" SG_ 363 EPS_SteeringAngleRate 0;
BA_ "GenSigTimeoutValue" SG_ 363 EPS_SteeringAngleRate 0;
BA_ "Remark" SG_ 363 EPS_SteeringAngleRate "";
BA_ "EventCommandSignal" SG_ 363 EPS_TqCtrlSt 0;
BA_ "GatewayedSignals" SG_ 363 EPS_TqCtrlSt 0;
BA_ "GenSigInactiveValue" SG_ 363 EPS_TqCtrlSt 0;
BA_ "GenSigInvalidValue" SG_ 363 EPS_TqCtrlSt 0;
BA_ "GenSigSendType" SG_ 363 EPS_TqCtrlSt 1;
BA_ "GenSigStartValue" SG_ 363 EPS_TqCtrlSt 0;
BA_ "GenSigTimeoutValue" SG_ 363 EPS_TqCtrlSt 0;
BA_ "Remark" SG_ 363 EPS_TqCtrlSt "";
BA_ "EventCommandSignal" SG_ 363 EPS_MotorTorForDrv 0;
BA_ "GatewayedSignals" SG_ 363 EPS_MotorTorForDrv 0;
BA_ "GenSigInactiveValue" SG_ 363 EPS_MotorTorForDrv 0;
BA_ "GenSigInvalidValue" SG_ 363 EPS_MotorTorForDrv 4095;
BA_ "GenSigSendType" SG_ 363 EPS_MotorTorForDrv 1;
BA_ "GenSigStartValue" SG_ 363 EPS_MotorTorForDrv 2000;
BA_ "GenSigTimeoutValue" SG_ 363 EPS_MotorTorForDrv 4095;
BA_ "Remark" SG_ 363 EPS_MotorTorForDrv "";
BA_ "EventCommandSignal" SG_ 363 EPS_TqCtrlAvl 0;
BA_ "GatewayedSignals" SG_ 363 EPS_TqCtrlAvl 0;
BA_ "GenSigInactiveValue" SG_ 363 EPS_TqCtrlAvl 0;
BA_ "GenSigInvalidValue" SG_ 363 EPS_TqCtrlAvl 0;
BA_ "GenSigSendType" SG_ 363 EPS_TqCtrlAvl 1;
BA_ "GenSigStartValue" SG_ 363 EPS_TqCtrlAvl 0;
BA_ "GenSigTimeoutValue" SG_ 363 EPS_TqCtrlAvl 0;
BA_ "Remark" SG_ 363 EPS_TqCtrlAvl "";
BA_ "EventCommandSignal" SG_ 363 EPS_AgCtrlAvl 0;
BA_ "GatewayedSignals" SG_ 363 EPS_AgCtrlAvl 0;
BA_ "GenSigInactiveValue" SG_ 363 EPS_AgCtrlAvl 0;
BA_ "GenSigInvalidValue" SG_ 363 EPS_AgCtrlAvl 0;
BA_ "GenSigSendType" SG_ 363 EPS_AgCtrlAvl 1;
BA_ "GenSigStartValue" SG_ 363 EPS_AgCtrlAvl 0;
BA_ "GenSigTimeoutValue" SG_ 363 EPS_AgCtrlAvl 0;
BA_ "Remark" SG_ 363 EPS_AgCtrlAvl "";
BA_ "EventCommandSignal" SG_ 363 EPS_MotorTorSumVD 0;
BA_ "GatewayedSignals" SG_ 363 EPS_MotorTorSumVD 0;
BA_ "GenSigInactiveValue" SG_ 363 EPS_MotorTorSumVD 0;
BA_ "GenSigInvalidValue" SG_ 363 EPS_MotorTorSumVD 0;
BA_ "GenSigSendType" SG_ 363 EPS_MotorTorSumVD 1;
BA_ "GenSigStartValue" SG_ 363 EPS_MotorTorSumVD 0;
BA_ "GenSigTimeoutValue" SG_ 363 EPS_MotorTorSumVD 0;
BA_ "Remark" SG_ 363 EPS_MotorTorSumVD "";
BA_ "EventCommandSignal" SG_ 363 EPS_DrvOveRideSt 0;
BA_ "GatewayedSignals" SG_ 363 EPS_DrvOveRideSt 0;
BA_ "GenSigInactiveValue" SG_ 363 EPS_DrvOveRideSt 0;
BA_ "GenSigInvalidValue" SG_ 363 EPS_DrvOveRideSt 0;
BA_ "GenSigSendType" SG_ 363 EPS_DrvOveRideSt 1;
BA_ "GenSigStartValue" SG_ 363 EPS_DrvOveRideSt 0;
BA_ "GenSigTimeoutValue" SG_ 363 EPS_DrvOveRideSt 0;
BA_ "Remark" SG_ 363 EPS_DrvOveRideSt "";
BA_ "EventCommandSignal" SG_ 363 EPS_DrvOveRideVD 0;
BA_ "GatewayedSignals" SG_ 363 EPS_DrvOveRideVD 0;
BA_ "GenSigInactiveValue" SG_ 363 EPS_DrvOveRideVD 0;
BA_ "GenSigInvalidValue" SG_ 363 EPS_DrvOveRideVD 0;
BA_ "GenSigSendType" SG_ 363 EPS_DrvOveRideVD 1;
BA_ "GenSigStartValue" SG_ 363 EPS_DrvOveRideVD 0;
BA_ "GenSigTimeoutValue" SG_ 363 EPS_DrvOveRideVD 0;
BA_ "Remark" SG_ 363 EPS_DrvOveRideVD "";
BA_ "EventCommandSignal" SG_ 363 EPS_SteerVibrlAvl 0;
BA_ "GatewayedSignals" SG_ 363 EPS_SteerVibrlAvl 0;
BA_ "GenSigInactiveValue" SG_ 363 EPS_SteerVibrlAvl 0;
BA_ "GenSigInvalidValue" SG_ 363 EPS_SteerVibrlAvl 0;
BA_ "GenSigSendType" SG_ 363 EPS_SteerVibrlAvl 1;
BA_ "GenSigStartValue" SG_ 363 EPS_SteerVibrlAvl 0;
BA_ "GenSigTimeoutValue" SG_ 363 EPS_SteerVibrlAvl 0;
BA_ "Remark" SG_ 363 EPS_SteerVibrlAvl "";
BA_ "EventCommandSignal" SG_ 363 EPS_HandsOffDetStVD 0;
BA_ "GatewayedSignals" SG_ 363 EPS_HandsOffDetStVD 0;
BA_ "GenSigInactiveValue" SG_ 363 EPS_HandsOffDetStVD 0;
BA_ "GenSigInvalidValue" SG_ 363 EPS_HandsOffDetStVD 0;
BA_ "GenSigSendType" SG_ 363 EPS_HandsOffDetStVD 1;
BA_ "GenSigStartValue" SG_ 363 EPS_HandsOffDetStVD 0;
BA_ "GenSigTimeoutValue" SG_ 363 EPS_HandsOffDetStVD 0;
BA_ "Remark" SG_ 363 EPS_HandsOffDetStVD "";
BA_ "EventCommandSignal" SG_ 363 EPS_HandsOffDetSt 0;
BA_ "GatewayedSignals" SG_ 363 EPS_HandsOffDetSt 0;
BA_ "GenSigInactiveValue" SG_ 363 EPS_HandsOffDetSt 0;
BA_ "GenSigInvalidValue" SG_ 363 EPS_HandsOffDetSt 0;
BA_ "GenSigSendType" SG_ 363 EPS_HandsOffDetSt 1;
BA_ "GenSigStartValue" SG_ 363 EPS_HandsOffDetSt 0;
BA_ "GenSigTimeoutValue" SG_ 363 EPS_HandsOffDetSt 0;
BA_ "Remark" SG_ 363 EPS_HandsOffDetSt "";
BA_ "EventCommandSignal" SG_ 363 EPS_SteerMod 0;
BA_ "GatewayedSignals" SG_ 363 EPS_SteerMod 0;
BA_ "GenSigInactiveValue" SG_ 363 EPS_SteerMod 0;
BA_ "GenSigInvalidValue" SG_ 363 EPS_SteerMod 0;
BA_ "GenSigSendType" SG_ 363 EPS_SteerMod 1;
BA_ "GenSigStartValue" SG_ 363 EPS_SteerMod 0;
BA_ "GenSigTimeoutValue" SG_ 363 EPS_SteerMod 0;
BA_ "Remark" SG_ 363 EPS_SteerMod "";
BA_ "EventCommandSignal" SG_ 363 EPS_PDC_CtrltotalValue 0;
BA_ "GatewayedSignals" SG_ 363 EPS_PDC_CtrltotalValue 0;
BA_ "GenSigInactiveValue" SG_ 363 EPS_PDC_CtrltotalValue 0;
BA_ "GenSigInvalidValue" SG_ 363 EPS_PDC_CtrltotalValue 0;
BA_ "GenSigSendType" SG_ 363 EPS_PDC_CtrltotalValue 1;
BA_ "GenSigStartValue" SG_ 363 EPS_PDC_CtrltotalValue 1024;
BA_ "GenSigTimeoutValue" SG_ 363 EPS_PDC_CtrltotalValue 0;
BA_ "Remark" SG_ 363 EPS_PDC_CtrltotalValue "";
BA_ "EventCommandSignal" SG_ 363 EPS_PDC_CtrllongtermValue 0;
BA_ "GatewayedSignals" SG_ 363 EPS_PDC_CtrllongtermValue 0;
BA_ "GenSigInactiveValue" SG_ 363 EPS_PDC_CtrllongtermValue 0;
BA_ "GenSigInvalidValue" SG_ 363 EPS_PDC_CtrllongtermValue 0;
BA_ "GenSigSendType" SG_ 363 EPS_PDC_CtrllongtermValue 1;
BA_ "GenSigStartValue" SG_ 363 EPS_PDC_CtrllongtermValue 1024;
BA_ "GenSigTimeoutValue" SG_ 363 EPS_PDC_CtrllongtermValue 0;
BA_ "Remark" SG_ 363 EPS_PDC_CtrllongtermValue "";
BA_ "EventCommandSignal" SG_ 363 EPS_PDC_CtrlshorttermValue 0;
BA_ "GatewayedSignals" SG_ 363 EPS_PDC_CtrlshorttermValue 0;
BA_ "GenSigInactiveValue" SG_ 363 EPS_PDC_CtrlshorttermValue 0;
BA_ "GenSigInvalidValue" SG_ 363 EPS_PDC_CtrlshorttermValue 0;
BA_ "GenSigSendType" SG_ 363 EPS_PDC_CtrlshorttermValue 1;
BA_ "GenSigStartValue" SG_ 363 EPS_PDC_CtrlshorttermValue 1024;
BA_ "GenSigTimeoutValue" SG_ 363 EPS_PDC_CtrlshorttermValue 0;
BA_ "Remark" SG_ 363 EPS_PDC_CtrlshorttermValue "";
BA_ "EventCommandSignal" SG_ 363 EPS_Shimmy_Compensation_Value 0;
BA_ "GatewayedSignals" SG_ 363 EPS_Shimmy_Compensation_Value 0;
BA_ "GenSigInactiveValue" SG_ 363 EPS_Shimmy_Compensation_Value 0;
BA_ "GenSigInvalidValue" SG_ 363 EPS_Shimmy_Compensation_Value 0;
BA_ "GenSigSendType" SG_ 363 EPS_Shimmy_Compensation_Value 1;
BA_ "GenSigStartValue" SG_ 363 EPS_Shimmy_Compensation_Value 1024;
BA_ "GenSigTimeoutValue" SG_ 363 EPS_Shimmy_Compensation_Value 0;
BA_ "Remark" SG_ 363 EPS_Shimmy_Compensation_Value "";
BA_ "EventCommandSignal" SG_ 363 EPS_EpsSelfChkSts 0;
BA_ "GatewayedSignals" SG_ 363 EPS_EpsSelfChkSts 0;
BA_ "GenSigInactiveValue" SG_ 363 EPS_EpsSelfChkSts 0;
BA_ "GenSigInvalidValue" SG_ 363 EPS_EpsSelfChkSts 0;
BA_ "GenSigSendType" SG_ 363 EPS_EpsSelfChkSts 1;
BA_ "GenSigStartValue" SG_ 363 EPS_EpsSelfChkSts 0;
BA_ "GenSigTimeoutValue" SG_ 363 EPS_EpsSelfChkSts 0;
BA_ "Remark" SG_ 363 EPS_EpsSelfChkSts "";
BA_ "EventCommandSignal" SG_ 363 EPS_ADCNetErrorFb 0;
BA_ "GatewayedSignals" SG_ 363 EPS_ADCNetErrorFb 0;
BA_ "GenSigInactiveValue" SG_ 363 EPS_ADCNetErrorFb 0;
BA_ "GenSigInvalidValue" SG_ 363 EPS_ADCNetErrorFb 0;
BA_ "GenSigSendType" SG_ 363 EPS_ADCNetErrorFb 1;
BA_ "GenSigStartValue" SG_ 363 EPS_ADCNetErrorFb 0;
BA_ "GenSigTimeoutValue" SG_ 363 EPS_ADCNetErrorFb 0;
BA_ "Remark" SG_ 363 EPS_ADCNetErrorFb "";
BA_ "EventCommandSignal" SG_ 363 EPS_NetModeResp 0;
BA_ "GatewayedSignals" SG_ 363 EPS_NetModeResp 0;
BA_ "GenSigInactiveValue" SG_ 363 EPS_NetModeResp 0;
BA_ "GenSigInvalidValue" SG_ 363 EPS_NetModeResp 0;
BA_ "GenSigSendType" SG_ 363 EPS_NetModeResp 1;
BA_ "GenSigStartValue" SG_ 363 EPS_NetModeResp 0;
BA_ "GenSigTimeoutValue" SG_ 363 EPS_NetModeResp 0;
BA_ "Remark" SG_ 363 EPS_NetModeResp "";
BA_ "EventCommandSignal" SG_ 363 EPS_ThermProtnMax 0;
BA_ "GatewayedSignals" SG_ 363 EPS_ThermProtnMax 0;
BA_ "GenSigInactiveValue" SG_ 363 EPS_ThermProtnMax 0;
BA_ "GenSigInvalidValue" SG_ 363 EPS_ThermProtnMax 0;
BA_ "GenSigSendType" SG_ 363 EPS_ThermProtnMax 1;
BA_ "GenSigStartValue" SG_ 363 EPS_ThermProtnMax 200;
BA_ "GenSigTimeoutValue" SG_ 363 EPS_ThermProtnMax 0;
BA_ "Remark" SG_ 363 EPS_ThermProtnMax "";
BA_ "EventCommandSignal" SG_ 362 EPSB_1_CRC 0;
BA_ "GatewayedSignals" SG_ 362 EPSB_1_CRC 0;
BA_ "GenSigInactiveValue" SG_ 362 EPSB_1_CRC 0;
BA_ "GenSigInvalidValue" SG_ 362 EPSB_1_CRC 0;
BA_ "GenSigSendType" SG_ 362 EPSB_1_CRC 1;
BA_ "GenSigStartValue" SG_ 362 EPSB_1_CRC 0;
BA_ "GenSigTimeoutValue" SG_ 362 EPSB_1_CRC 0;
BA_ "Remark" SG_ 362 EPSB_1_CRC "";
BA_ "EventCommandSignal" SG_ 362 EPSB_1_Counter 0;
BA_ "GatewayedSignals" SG_ 362 EPSB_1_Counter 0;
BA_ "GenSigInactiveValue" SG_ 362 EPSB_1_Counter 0;
BA_ "GenSigInvalidValue" SG_ 362 EPSB_1_Counter 0;
BA_ "GenSigSendType" SG_ 362 EPSB_1_Counter 1;
BA_ "GenSigStartValue" SG_ 362 EPSB_1_Counter 0;
BA_ "GenSigTimeoutValue" SG_ 362 EPSB_1_Counter 0;
BA_ "Remark" SG_ 362 EPSB_1_Counter "";
BA_ "EventCommandSignal" SG_ 362 EPSB_StrngWhlTorqVD 0;
BA_ "GatewayedSignals" SG_ 362 EPSB_StrngWhlTorqVD 0;
BA_ "GenSigInactiveValue" SG_ 362 EPSB_StrngWhlTorqVD 0;
BA_ "GenSigInvalidValue" SG_ 362 EPSB_StrngWhlTorqVD 0;
BA_ "GenSigSendType" SG_ 362 EPSB_StrngWhlTorqVD 1;
BA_ "GenSigStartValue" SG_ 362 EPSB_StrngWhlTorqVD 0;
BA_ "GenSigTimeoutValue" SG_ 362 EPSB_StrngWhlTorqVD 0;
BA_ "Remark" SG_ 362 EPSB_StrngWhlTorqVD "";
BA_ "EventCommandSignal" SG_ 362 EPSB_StrngWhlTorq 0;
BA_ "GatewayedSignals" SG_ 362 EPSB_StrngWhlTorq 0;
BA_ "GenSigInactiveValue" SG_ 362 EPSB_StrngWhlTorq 0;
BA_ "GenSigInvalidValue" SG_ 362 EPSB_StrngWhlTorq 4095;
BA_ "GenSigSendType" SG_ 362 EPSB_StrngWhlTorq 1;
BA_ "GenSigStartValue" SG_ 362 EPSB_StrngWhlTorq 1500;
BA_ "GenSigTimeoutValue" SG_ 362 EPSB_StrngWhlTorq 4095;
BA_ "Remark" SG_ 362 EPSB_StrngWhlTorq "";
BA_ "EventCommandSignal" SG_ 362 EPSB_TAS_CalibratedSt 0;
BA_ "GatewayedSignals" SG_ 362 EPSB_TAS_CalibratedSt 0;
BA_ "GenSigInactiveValue" SG_ 362 EPSB_TAS_CalibratedSt 0;
BA_ "GenSigInvalidValue" SG_ 362 EPSB_TAS_CalibratedSt 0;
BA_ "GenSigSendType" SG_ 362 EPSB_TAS_CalibratedSt 1;
BA_ "GenSigStartValue" SG_ 362 EPSB_TAS_CalibratedSt 0;
BA_ "GenSigTimeoutValue" SG_ 362 EPSB_TAS_CalibratedSt 0;
BA_ "Remark" SG_ 362 EPSB_TAS_CalibratedSt "";
BA_ "EventCommandSignal" SG_ 362 EPSB_SteeringAngleSpdVD 0;
BA_ "GatewayedSignals" SG_ 362 EPSB_SteeringAngleSpdVD 0;
BA_ "GenSigInactiveValue" SG_ 362 EPSB_SteeringAngleSpdVD 0;
BA_ "GenSigInvalidValue" SG_ 362 EPSB_SteeringAngleSpdVD 0;
BA_ "GenSigSendType" SG_ 362 EPSB_SteeringAngleSpdVD 1;
BA_ "GenSigStartValue" SG_ 362 EPSB_SteeringAngleSpdVD 0;
BA_ "GenSigTimeoutValue" SG_ 362 EPSB_SteeringAngleSpdVD 0;
BA_ "Remark" SG_ 362 EPSB_SteeringAngleSpdVD "";
BA_ "EventCommandSignal" SG_ 362 EPSB_SteeringAngleSpd 0;
BA_ "GatewayedSignals" SG_ 362 EPSB_SteeringAngleSpd 0;
BA_ "GenSigInactiveValue" SG_ 362 EPSB_SteeringAngleSpd 0;
BA_ "GenSigInvalidValue" SG_ 362 EPSB_SteeringAngleSpd 255;
BA_ "GenSigSendType" SG_ 362 EPSB_SteeringAngleSpd 1;
BA_ "GenSigStartValue" SG_ 362 EPSB_SteeringAngleSpd 0;
BA_ "GenSigTimeoutValue" SG_ 362 EPSB_SteeringAngleSpd 255;
BA_ "Remark" SG_ 362 EPSB_SteeringAngleSpd "";
BA_ "EventCommandSignal" SG_ 362 EPSB_SteeringAngle 0;
BA_ "GatewayedSignals" SG_ 362 EPSB_SteeringAngle 0;
BA_ "GenSigInactiveValue" SG_ 362 EPSB_SteeringAngle 0;
BA_ "GenSigInvalidValue" SG_ 362 EPSB_SteeringAngle 65535;
BA_ "GenSigSendType" SG_ 362 EPSB_SteeringAngle 1;
BA_ "GenSigStartValue" SG_ 362 EPSB_SteeringAngle 7800;
BA_ "GenSigTimeoutValue" SG_ 362 EPSB_SteeringAngle 65535;
BA_ "Remark" SG_ 362 EPSB_SteeringAngle "";
BA_ "EventCommandSignal" SG_ 362 EPSB_SteeringAngleVD 0;
BA_ "GatewayedSignals" SG_ 362 EPSB_SteeringAngleVD 0;
BA_ "GenSigInactiveValue" SG_ 362 EPSB_SteeringAngleVD 0;
BA_ "GenSigInvalidValue" SG_ 362 EPSB_SteeringAngleVD 0;
BA_ "GenSigSendType" SG_ 362 EPSB_SteeringAngleVD 1;
BA_ "GenSigStartValue" SG_ 362 EPSB_SteeringAngleVD 0;
BA_ "GenSigTimeoutValue" SG_ 362 EPSB_SteeringAngleVD 0;
BA_ "Remark" SG_ 362 EPSB_SteeringAngleVD "";
BA_ "EventCommandSignal" SG_ 362 EPSB_ThermalSt 0;
BA_ "GatewayedSignals" SG_ 362 EPSB_ThermalSt 0;
BA_ "GenSigInactiveValue" SG_ 362 EPSB_ThermalSt 0;
BA_ "GenSigInvalidValue" SG_ 362 EPSB_ThermalSt 0;
BA_ "GenSigSendType" SG_ 362 EPSB_ThermalSt 1;
BA_ "GenSigStartValue" SG_ 362 EPSB_ThermalSt 0;
BA_ "GenSigTimeoutValue" SG_ 362 EPSB_ThermalSt 0;
BA_ "Remark" SG_ 362 EPSB_ThermalSt "";
BA_ "EventCommandSignal" SG_ 362 EPSB_PstOverlaySt_SideA 0;
BA_ "GatewayedSignals" SG_ 362 EPSB_PstOverlaySt_SideA 0;
BA_ "GenSigInactiveValue" SG_ 362 EPSB_PstOverlaySt_SideA 0;
BA_ "GenSigInvalidValue" SG_ 362 EPSB_PstOverlaySt_SideA 0;
BA_ "GenSigSendType" SG_ 362 EPSB_PstOverlaySt_SideA 1;
BA_ "GenSigStartValue" SG_ 362 EPSB_PstOverlaySt_SideA 0;
BA_ "GenSigTimeoutValue" SG_ 362 EPSB_PstOverlaySt_SideA 0;
BA_ "Remark" SG_ 362 EPSB_PstOverlaySt_SideA "";
BA_ "EventCommandSignal" SG_ 362 EPSB_PstOverlaySt_SideB 0;
BA_ "GatewayedSignals" SG_ 362 EPSB_PstOverlaySt_SideB 0;
BA_ "GenSigInactiveValue" SG_ 362 EPSB_PstOverlaySt_SideB 0;
BA_ "GenSigInvalidValue" SG_ 362 EPSB_PstOverlaySt_SideB 0;
BA_ "GenSigSendType" SG_ 362 EPSB_PstOverlaySt_SideB 1;
BA_ "GenSigStartValue" SG_ 362 EPSB_PstOverlaySt_SideB 0;
BA_ "GenSigTimeoutValue" SG_ 362 EPSB_PstOverlaySt_SideB 0;
BA_ "Remark" SG_ 362 EPSB_PstOverlaySt_SideB "";
BA_ "EventCommandSignal" SG_ 362 EPSB_HealthySt_SideA 0;
BA_ "GatewayedSignals" SG_ 362 EPSB_HealthySt_SideA 0;
BA_ "GenSigInactiveValue" SG_ 362 EPSB_HealthySt_SideA 0;
BA_ "GenSigInvalidValue" SG_ 362 EPSB_HealthySt_SideA 0;
BA_ "GenSigSendType" SG_ 362 EPSB_HealthySt_SideA 1;
BA_ "GenSigStartValue" SG_ 362 EPSB_HealthySt_SideA 0;
BA_ "GenSigTimeoutValue" SG_ 362 EPSB_HealthySt_SideA 0;
BA_ "Remark" SG_ 362 EPSB_HealthySt_SideA "";
BA_ "EventCommandSignal" SG_ 362 EPSB_HealthySt_SideB 0;
BA_ "GatewayedSignals" SG_ 362 EPSB_HealthySt_SideB 0;
BA_ "GenSigInactiveValue" SG_ 362 EPSB_HealthySt_SideB 0;
BA_ "GenSigInvalidValue" SG_ 362 EPSB_HealthySt_SideB 0;
BA_ "GenSigSendType" SG_ 362 EPSB_HealthySt_SideB 1;
BA_ "GenSigStartValue" SG_ 362 EPSB_HealthySt_SideB 0;
BA_ "GenSigTimeoutValue" SG_ 362 EPSB_HealthySt_SideB 0;
BA_ "Remark" SG_ 362 EPSB_HealthySt_SideB "";
BA_ "EventCommandSignal" SG_ 362 EPSB_PstOverlaySt 0;
BA_ "GatewayedSignals" SG_ 362 EPSB_PstOverlaySt 0;
BA_ "GenSigInactiveValue" SG_ 362 EPSB_PstOverlaySt 0;
BA_ "GenSigInvalidValue" SG_ 362 EPSB_PstOverlaySt 0;
BA_ "GenSigSendType" SG_ 362 EPSB_PstOverlaySt 1;
BA_ "GenSigStartValue" SG_ 362 EPSB_PstOverlaySt 0;
BA_ "GenSigTimeoutValue" SG_ 362 EPSB_PstOverlaySt 0;
BA_ "Remark" SG_ 362 EPSB_PstOverlaySt "";
BA_ "EventCommandSignal" SG_ 362 EPSB_HealthySt_DualSide 0;
BA_ "GatewayedSignals" SG_ 362 EPSB_HealthySt_DualSide 0;
BA_ "GenSigInactiveValue" SG_ 362 EPSB_HealthySt_DualSide 0;
BA_ "GenSigInvalidValue" SG_ 362 EPSB_HealthySt_DualSide 0;
BA_ "GenSigSendType" SG_ 362 EPSB_HealthySt_DualSide 1;
BA_ "GenSigStartValue" SG_ 362 EPSB_HealthySt_DualSide 0;
BA_ "GenSigTimeoutValue" SG_ 362 EPSB_HealthySt_DualSide 0;
BA_ "Remark" SG_ 362 EPSB_HealthySt_DualSide "";
BA_ "EventCommandSignal" SG_ 362 EPSB_PstOverLayRdntSt 0;
BA_ "GatewayedSignals" SG_ 362 EPSB_PstOverLayRdntSt 0;
BA_ "GenSigInactiveValue" SG_ 362 EPSB_PstOverLayRdntSt 0;
BA_ "GenSigInvalidValue" SG_ 362 EPSB_PstOverLayRdntSt 0;
BA_ "GenSigSendType" SG_ 362 EPSB_PstOverLayRdntSt 1;
BA_ "GenSigStartValue" SG_ 362 EPSB_PstOverLayRdntSt 0;
BA_ "GenSigTimeoutValue" SG_ 362 EPSB_PstOverLayRdntSt 0;
BA_ "Remark" SG_ 362 EPSB_PstOverLayRdntSt "";
BA_ "EventCommandSignal" SG_ 362 EPSB_VibrationWarnSt 0;
BA_ "GatewayedSignals" SG_ 362 EPSB_VibrationWarnSt 0;
BA_ "GenSigInactiveValue" SG_ 362 EPSB_VibrationWarnSt 0;
BA_ "GenSigInvalidValue" SG_ 362 EPSB_VibrationWarnSt 0;
BA_ "GenSigSendType" SG_ 362 EPSB_VibrationWarnSt 1;
BA_ "GenSigStartValue" SG_ 362 EPSB_VibrationWarnSt 0;
BA_ "GenSigTimeoutValue" SG_ 362 EPSB_VibrationWarnSt 0;
BA_ "Remark" SG_ 362 EPSB_VibrationWarnSt "";
BA_ "EventCommandSignal" SG_ 362 EPSB_SAC_ErrFeedback_SideA 0;
BA_ "GatewayedSignals" SG_ 362 EPSB_SAC_ErrFeedback_SideA 0;
BA_ "GenSigInactiveValue" SG_ 362 EPSB_SAC_ErrFeedback_SideA 0;
BA_ "GenSigInvalidValue" SG_ 362 EPSB_SAC_ErrFeedback_SideA 0;
BA_ "GenSigSendType" SG_ 362 EPSB_SAC_ErrFeedback_SideA 1;
BA_ "GenSigStartValue" SG_ 362 EPSB_SAC_ErrFeedback_SideA 0;
BA_ "GenSigTimeoutValue" SG_ 362 EPSB_SAC_ErrFeedback_SideA 0;
BA_ "Remark" SG_ 362 EPSB_SAC_ErrFeedback_SideA "";
BA_ "EventCommandSignal" SG_ 362 EPSB_SAC_ErrFeedback_SideB 0;
BA_ "GatewayedSignals" SG_ 362 EPSB_SAC_ErrFeedback_SideB 0;
BA_ "GenSigInactiveValue" SG_ 362 EPSB_SAC_ErrFeedback_SideB 0;
BA_ "GenSigInvalidValue" SG_ 362 EPSB_SAC_ErrFeedback_SideB 0;
BA_ "GenSigSendType" SG_ 362 EPSB_SAC_ErrFeedback_SideB 1;
BA_ "GenSigStartValue" SG_ 362 EPSB_SAC_ErrFeedback_SideB 0;
BA_ "GenSigTimeoutValue" SG_ 362 EPSB_SAC_ErrFeedback_SideB 0;
BA_ "Remark" SG_ 362 EPSB_SAC_ErrFeedback_SideB "";
BA_ "EventCommandSignal" SG_ 362 EPSB_ADASTargetAngle 0;
BA_ "GatewayedSignals" SG_ 362 EPSB_ADASTargetAngle 0;
BA_ "GenSigInactiveValue" SG_ 362 EPSB_ADASTargetAngle 0;
BA_ "GenSigInvalidValue" SG_ 362 EPSB_ADASTargetAngle 7800;
BA_ "GenSigSendType" SG_ 362 EPSB_ADASTargetAngle 1;
BA_ "GenSigStartValue" SG_ 362 EPSB_ADASTargetAngle 0;
BA_ "GenSigTimeoutValue" SG_ 362 EPSB_ADASTargetAngle 65535;
BA_ "Remark" SG_ 362 EPSB_ADASTargetAngle "";
BA_ "EventCommandSignal" SG_ 362 EPSB_FunctionStyleSt 0;
BA_ "GatewayedSignals" SG_ 362 EPSB_FunctionStyleSt 0;
BA_ "GenSigInactiveValue" SG_ 362 EPSB_FunctionStyleSt 0;
BA_ "GenSigInvalidValue" SG_ 362 EPSB_FunctionStyleSt 0;
BA_ "GenSigSendType" SG_ 362 EPSB_FunctionStyleSt 1;
BA_ "GenSigStartValue" SG_ 362 EPSB_FunctionStyleSt 0;
BA_ "GenSigTimeoutValue" SG_ 362 EPSB_FunctionStyleSt 0;
BA_ "Remark" SG_ 362 EPSB_FunctionStyleSt "";
BA_ "EventCommandSignal" SG_ 362 EPSB_SteeringModeSt 0;
BA_ "GatewayedSignals" SG_ 362 EPSB_SteeringModeSt 0;
BA_ "GenSigInactiveValue" SG_ 362 EPSB_SteeringModeSt 0;
BA_ "GenSigInvalidValue" SG_ 362 EPSB_SteeringModeSt 0;
BA_ "GenSigSendType" SG_ 362 EPSB_SteeringModeSt 1;
BA_ "GenSigStartValue" SG_ 362 EPSB_SteeringModeSt 0;
BA_ "GenSigTimeoutValue" SG_ 362 EPSB_SteeringModeSt 0;
BA_ "Remark" SG_ 362 EPSB_SteeringModeSt "";
BA_ "EventCommandSignal" SG_ 362 EPSB_ActEffectiveChannel 0;
BA_ "GatewayedSignals" SG_ 362 EPSB_ActEffectiveChannel 0;
BA_ "GenSigInactiveValue" SG_ 362 EPSB_ActEffectiveChannel 0;
BA_ "GenSigInvalidValue" SG_ 362 EPSB_ActEffectiveChannel 0;
BA_ "GenSigSendType" SG_ 362 EPSB_ActEffectiveChannel 1;
BA_ "GenSigStartValue" SG_ 362 EPSB_ActEffectiveChannel 0;
BA_ "GenSigTimeoutValue" SG_ 362 EPSB_ActEffectiveChannel 0;
BA_ "Remark" SG_ 362 EPSB_ActEffectiveChannel "";
BA_ "EventCommandSignal" SG_ 362 EPSB_ReqAngOverRange 0;
BA_ "GatewayedSignals" SG_ 362 EPSB_ReqAngOverRange 0;
BA_ "GenSigInactiveValue" SG_ 362 EPSB_ReqAngOverRange 0;
BA_ "GenSigInvalidValue" SG_ 362 EPSB_ReqAngOverRange 0;
BA_ "GenSigSendType" SG_ 362 EPSB_ReqAngOverRange 1;
BA_ "GenSigStartValue" SG_ 362 EPSB_ReqAngOverRange 0;
BA_ "GenSigTimeoutValue" SG_ 362 EPSB_ReqAngOverRange 0;
BA_ "Remark" SG_ 362 EPSB_ReqAngOverRange "";
BA_ "EventCommandSignal" SG_ 362 EPSB_SACMotorTorAct 0;
BA_ "GatewayedSignals" SG_ 362 EPSB_SACMotorTorAct 0;
BA_ "GenSigInactiveValue" SG_ 362 EPSB_SACMotorTorAct 0;
BA_ "GenSigInvalidValue" SG_ 362 EPSB_SACMotorTorAct 0;
BA_ "GenSigSendType" SG_ 362 EPSB_SACMotorTorAct 1;
BA_ "GenSigStartValue" SG_ 362 EPSB_SACMotorTorAct 0;
BA_ "GenSigTimeoutValue" SG_ 362 EPSB_SACMotorTorAct 0;
BA_ "Remark" SG_ 362 EPSB_SACMotorTorAct "";
BA_ "EventCommandSignal" SG_ 362 EPSB_SACMotorTorLimInt 0;
BA_ "GatewayedSignals" SG_ 362 EPSB_SACMotorTorLimInt 0;
BA_ "GenSigInactiveValue" SG_ 362 EPSB_SACMotorTorLimInt 0;
BA_ "GenSigInvalidValue" SG_ 362 EPSB_SACMotorTorLimInt 2047;
BA_ "GenSigSendType" SG_ 362 EPSB_SACMotorTorLimInt 1;
BA_ "GenSigStartValue" SG_ 362 EPSB_SACMotorTorLimInt 0;
BA_ "GenSigTimeoutValue" SG_ 362 EPSB_SACMotorTorLimInt 2047;
BA_ "Remark" SG_ 362 EPSB_SACMotorTorLimInt "";
BA_ "EventCommandSignal" SG_ 362 EPSB_ReqAngSpdOverRange 0;
BA_ "GatewayedSignals" SG_ 362 EPSB_ReqAngSpdOverRange 0;
BA_ "GenSigInactiveValue" SG_ 362 EPSB_ReqAngSpdOverRange 0;
BA_ "GenSigInvalidValue" SG_ 362 EPSB_ReqAngSpdOverRange 0;
BA_ "GenSigSendType" SG_ 362 EPSB_ReqAngSpdOverRange 1;
BA_ "GenSigStartValue" SG_ 362 EPSB_ReqAngSpdOverRange 0;
BA_ "GenSigTimeoutValue" SG_ 362 EPSB_ReqAngSpdOverRange 0;
BA_ "Remark" SG_ 362 EPSB_ReqAngSpdOverRange "";
BA_ "EventCommandSignal" SG_ 362 EPSB_AssistPraSwitchToLKA 0;
BA_ "GatewayedSignals" SG_ 362 EPSB_AssistPraSwitchToLKA 0;
BA_ "GenSigInactiveValue" SG_ 362 EPSB_AssistPraSwitchToLKA 0;
BA_ "GenSigInvalidValue" SG_ 362 EPSB_AssistPraSwitchToLKA 0;
BA_ "GenSigSendType" SG_ 362 EPSB_AssistPraSwitchToLKA 1;
BA_ "GenSigStartValue" SG_ 362 EPSB_AssistPraSwitchToLKA 0;
BA_ "GenSigTimeoutValue" SG_ 362 EPSB_AssistPraSwitchToLKA 0;
BA_ "Remark" SG_ 362 EPSB_AssistPraSwitchToLKA "";
BA_ "EventCommandSignal" SG_ 362 EPSB_SteerGainEnable 0;
BA_ "GatewayedSignals" SG_ 362 EPSB_SteerGainEnable 0;
BA_ "GenSigInactiveValue" SG_ 362 EPSB_SteerGainEnable 0;
BA_ "GenSigInvalidValue" SG_ 362 EPSB_SteerGainEnable 0;
BA_ "GenSigSendType" SG_ 362 EPSB_SteerGainEnable 1;
BA_ "GenSigStartValue" SG_ 362 EPSB_SteerGainEnable 0;
BA_ "GenSigTimeoutValue" SG_ 362 EPSB_SteerGainEnable 0;
BA_ "Remark" SG_ 362 EPSB_SteerGainEnable "";
BA_ "EventCommandSignal" SG_ 362 EPSB_EmSteerEnbale 0;
BA_ "GatewayedSignals" SG_ 362 EPSB_EmSteerEnbale 0;
BA_ "GenSigInactiveValue" SG_ 362 EPSB_EmSteerEnbale 0;
BA_ "GenSigInvalidValue" SG_ 362 EPSB_EmSteerEnbale 0;
BA_ "GenSigSendType" SG_ 362 EPSB_EmSteerEnbale 1;
BA_ "GenSigStartValue" SG_ 362 EPSB_EmSteerEnbale 0;
BA_ "GenSigTimeoutValue" SG_ 362 EPSB_EmSteerEnbale 0;
BA_ "Remark" SG_ 362 EPSB_EmSteerEnbale "";
BA_ "EventCommandSignal" SG_ 362 EPSB_SG_ErrFeedback 0;
BA_ "GatewayedSignals" SG_ 362 EPSB_SG_ErrFeedback 0;
BA_ "GenSigInactiveValue" SG_ 362 EPSB_SG_ErrFeedback 0;
BA_ "GenSigInvalidValue" SG_ 362 EPSB_SG_ErrFeedback 0;
BA_ "GenSigSendType" SG_ 362 EPSB_SG_ErrFeedback 1;
BA_ "GenSigStartValue" SG_ 362 EPSB_SG_ErrFeedback 0;
BA_ "GenSigTimeoutValue" SG_ 362 EPSB_SG_ErrFeedback 0;
BA_ "Remark" SG_ 362 EPSB_SG_ErrFeedback "";
BA_ "EventCommandSignal" SG_ 362 EPSB_EM_ErrFeedback 0;
BA_ "GatewayedSignals" SG_ 362 EPSB_EM_ErrFeedback 0;
BA_ "GenSigInactiveValue" SG_ 362 EPSB_EM_ErrFeedback 0;
BA_ "GenSigInvalidValue" SG_ 362 EPSB_EM_ErrFeedback 0;
BA_ "GenSigSendType" SG_ 362 EPSB_EM_ErrFeedback 1;
BA_ "GenSigStartValue" SG_ 362 EPSB_EM_ErrFeedback 0;
BA_ "GenSigTimeoutValue" SG_ 362 EPSB_EM_ErrFeedback 0;
BA_ "Remark" SG_ 362 EPSB_EM_ErrFeedback "";
BA_ "EventCommandSignal" SG_ 362 EPSB_VW_ErrFeedback 0;
BA_ "GatewayedSignals" SG_ 362 EPSB_VW_ErrFeedback 0;
BA_ "GenSigInactiveValue" SG_ 362 EPSB_VW_ErrFeedback 0;
BA_ "GenSigInvalidValue" SG_ 362 EPSB_VW_ErrFeedback 0;
BA_ "GenSigSendType" SG_ 362 EPSB_VW_ErrFeedback 1;
BA_ "GenSigStartValue" SG_ 362 EPSB_VW_ErrFeedback 0;
BA_ "GenSigTimeoutValue" SG_ 362 EPSB_VW_ErrFeedback 0;
BA_ "Remark" SG_ 362 EPSB_VW_ErrFeedback "";
BA_ "EventCommandSignal" SG_ 362 EPSB_SACMotorTorActMot 0;
BA_ "GatewayedSignals" SG_ 362 EPSB_SACMotorTorActMot 0;
BA_ "GenSigInactiveValue" SG_ 362 EPSB_SACMotorTorActMot 0;
BA_ "GenSigInvalidValue" SG_ 362 EPSB_SACMotorTorActMot 0;
BA_ "GenSigSendType" SG_ 362 EPSB_SACMotorTorActMot 1;
BA_ "GenSigStartValue" SG_ 362 EPSB_SACMotorTorActMot 600;
BA_ "GenSigTimeoutValue" SG_ 362 EPSB_SACMotorTorActMot 600;
BA_ "Remark" SG_ 362 EPSB_SACMotorTorActMot "";
BA_ "EventCommandSignal" SG_ 362 EPSB_SACMotorTorLimIntMot 0;
BA_ "GatewayedSignals" SG_ 362 EPSB_SACMotorTorLimIntMot 0;
BA_ "GenSigInactiveValue" SG_ 362 EPSB_SACMotorTorLimIntMot 0;
BA_ "GenSigInvalidValue" SG_ 362 EPSB_SACMotorTorLimIntMot 2047;
BA_ "GenSigSendType" SG_ 362 EPSB_SACMotorTorLimIntMot 1;
BA_ "GenSigStartValue" SG_ 362 EPSB_SACMotorTorLimIntMot 0;
BA_ "GenSigTimeoutValue" SG_ 362 EPSB_SACMotorTorLimIntMot 2047;
BA_ "Remark" SG_ 362 EPSB_SACMotorTorLimIntMot "";
BA_ "EventCommandSignal" SG_ 362 EPSB_SG_ActualLevel 0;
BA_ "GatewayedSignals" SG_ 362 EPSB_SG_ActualLevel 0;
BA_ "GenSigInactiveValue" SG_ 362 EPSB_SG_ActualLevel 0;
BA_ "GenSigInvalidValue" SG_ 362 EPSB_SG_ActualLevel 255;
BA_ "GenSigSendType" SG_ 362 EPSB_SG_ActualLevel 1;
BA_ "GenSigStartValue" SG_ 362 EPSB_SG_ActualLevel 0;
BA_ "GenSigTimeoutValue" SG_ 362 EPSB_SG_ActualLevel 0;
BA_ "Remark" SG_ 362 EPSB_SG_ActualLevel "";
BA_ "EventCommandSignal" SG_ 362 EPSB_MotorTorSum 0;
BA_ "GatewayedSignals" SG_ 362 EPSB_MotorTorSum 0;
BA_ "GenSigInactiveValue" SG_ 362 EPSB_MotorTorSum 0;
BA_ "GenSigInvalidValue" SG_ 362 EPSB_MotorTorSum 0;
BA_ "GenSigSendType" SG_ 362 EPSB_MotorTorSum 1;
BA_ "GenSigStartValue" SG_ 362 EPSB_MotorTorSum 600;
BA_ "GenSigTimeoutValue" SG_ 362 EPSB_MotorTorSum 600;
BA_ "Remark" SG_ 362 EPSB_MotorTorSum "";
BA_ "EventCommandSignal" SG_ 362 EPSB_WarnLamp 0;
BA_ "GatewayedSignals" SG_ 362 EPSB_WarnLamp 0;
BA_ "GenSigInactiveValue" SG_ 362 EPSB_WarnLamp 0;
BA_ "GenSigInvalidValue" SG_ 362 EPSB_WarnLamp 0;
BA_ "GenSigSendType" SG_ 362 EPSB_WarnLamp 1;
BA_ "GenSigStartValue" SG_ 362 EPSB_WarnLamp 0;
BA_ "GenSigTimeoutValue" SG_ 362 EPSB_WarnLamp 3;
BA_ "Remark" SG_ 362 EPSB_WarnLamp "";
BA_ "EventCommandSignal" SG_ 362 EPSB_MotorTorForDrv 0;
BA_ "GatewayedSignals" SG_ 362 EPSB_MotorTorForDrv 0;
BA_ "GenSigInactiveValue" SG_ 362 EPSB_MotorTorForDrv 0;
BA_ "GenSigInvalidValue" SG_ 362 EPSB_MotorTorForDrv 4095;
BA_ "GenSigSendType" SG_ 362 EPSB_MotorTorForDrv 1;
BA_ "GenSigStartValue" SG_ 362 EPSB_MotorTorForDrv 2000;
BA_ "GenSigTimeoutValue" SG_ 362 EPSB_MotorTorForDrv 4095;
BA_ "Remark" SG_ 362 EPSB_MotorTorForDrv "";
BA_ "EventCommandSignal" SG_ 362 EPSB_AssistPercentage 0;
BA_ "GatewayedSignals" SG_ 362 EPSB_AssistPercentage 0;
BA_ "GenSigInactiveValue" SG_ 362 EPSB_AssistPercentage 0;
BA_ "GenSigInvalidValue" SG_ 362 EPSB_AssistPercentage 0;
BA_ "GenSigSendType" SG_ 362 EPSB_AssistPercentage 1;
BA_ "GenSigStartValue" SG_ 362 EPSB_AssistPercentage 0;
BA_ "GenSigTimeoutValue" SG_ 362 EPSB_AssistPercentage 0;
BA_ "Remark" SG_ 362 EPSB_AssistPercentage "";
BA_ "EventCommandSignal" SG_ 362 EPSB_AssistRatio 0;
BA_ "GatewayedSignals" SG_ 362 EPSB_AssistRatio 0;
BA_ "GenSigInactiveValue" SG_ 362 EPSB_AssistRatio 0;
BA_ "GenSigInvalidValue" SG_ 362 EPSB_AssistRatio 50;
BA_ "GenSigSendType" SG_ 362 EPSB_AssistRatio 1;
BA_ "GenSigStartValue" SG_ 362 EPSB_AssistRatio 50;
BA_ "GenSigTimeoutValue" SG_ 362 EPSB_AssistRatio 0;
BA_ "Remark" SG_ 362 EPSB_AssistRatio "";
BA_ "EventCommandSignal" SG_ 362 EPSB_StrngWhlTorqFlt 0;
BA_ "GatewayedSignals" SG_ 362 EPSB_StrngWhlTorqFlt 0;
BA_ "GenSigInactiveValue" SG_ 362 EPSB_StrngWhlTorqFlt 0;
BA_ "GenSigInvalidValue" SG_ 362 EPSB_StrngWhlTorqFlt 4095;
BA_ "GenSigSendType" SG_ 362 EPSB_StrngWhlTorqFlt 1;
BA_ "GenSigStartValue" SG_ 362 EPSB_StrngWhlTorqFlt 1500;
BA_ "GenSigTimeoutValue" SG_ 362 EPSB_StrngWhlTorqFlt 4095;
BA_ "Remark" SG_ 362 EPSB_StrngWhlTorqFlt "";
BA_ "EventCommandSignal" SG_ 362 EPSB_SteeringWhlTorFltVD 0;
BA_ "GatewayedSignals" SG_ 362 EPSB_SteeringWhlTorFltVD 0;
BA_ "GenSigInactiveValue" SG_ 362 EPSB_SteeringWhlTorFltVD 0;
BA_ "GenSigInvalidValue" SG_ 362 EPSB_SteeringWhlTorFltVD 0;
BA_ "GenSigSendType" SG_ 362 EPSB_SteeringWhlTorFltVD 1;
BA_ "GenSigStartValue" SG_ 362 EPSB_SteeringWhlTorFltVD 0;
BA_ "GenSigTimeoutValue" SG_ 362 EPSB_SteeringWhlTorFltVD 0;
BA_ "Remark" SG_ 362 EPSB_SteeringWhlTorFltVD "";
BA_ "EventCommandSignal" SG_ 362 EPSB_EpsSelfChkSts 0;
BA_ "GatewayedSignals" SG_ 362 EPSB_EpsSelfChkSts 0;
BA_ "GenSigInactiveValue" SG_ 362 EPSB_EpsSelfChkSts 0;
BA_ "GenSigInvalidValue" SG_ 362 EPSB_EpsSelfChkSts 0;
BA_ "GenSigSendType" SG_ 362 EPSB_EpsSelfChkSts 1;
BA_ "GenSigStartValue" SG_ 362 EPSB_EpsSelfChkSts 0;
BA_ "GenSigTimeoutValue" SG_ 362 EPSB_EpsSelfChkSts 0;
BA_ "Remark" SG_ 362 EPSB_EpsSelfChkSts "";
BA_ "EventCommandSignal" SG_ 362 EPSB_ThermProtnMax 0;
BA_ "GatewayedSignals" SG_ 362 EPSB_ThermProtnMax 0;
BA_ "GenSigInactiveValue" SG_ 362 EPSB_ThermProtnMax 0;
BA_ "GenSigInvalidValue" SG_ 362 EPSB_ThermProtnMax 0;
BA_ "GenSigSendType" SG_ 362 EPSB_ThermProtnMax 1;
BA_ "GenSigStartValue" SG_ 362 EPSB_ThermProtnMax 200;
BA_ "GenSigTimeoutValue" SG_ 362 EPSB_ThermProtnMax 0;
BA_ "Remark" SG_ 362 EPSB_ThermProtnMax "";
VAL_ 360 BCS_BrkTqCtrlAvlDriving 0 "Not available" 1 "Available" 2 "Available degraded1（Redundant Project）" 3 "Available degraded2 （Redundant Project）" 4 "Reserved" 5 "Reserved" 6 "Reserved" 7 "Reserved"  ;
VAL_ 360 BCS_BrkTqCtrlAvlParking 0 "Not available" 1 "available" 2 "parking overspeed--for BOSCH ADAS" 3 "Reserved"  ;
VAL_ 360 BCS_BrkTqCtrlActv 0 "NotActive" 1 "APA Active" 2 "ACC Active" 3 "Reserved"  ;
VAL_ 360 BCS_DycEscTarTqCtrlAvl 0 "Not available" 1 "Available"  ;
VAL_ 360 BCS_DrvrBrkOvrd 0 "Not override" 1 "Override"  ;
VAL_ 360 BCS_DrvrBrkOvrdVld 0 "Invalid" 1 "Valid"  ;
VAL_ 360 BCS_DycEscTarTqActv 0 "NotActive" 1 "Active"  ;
VAL_ 360 BCS_ERV_VehSpdVld 0 "Invalid" 1 "Valid"  ;
VAL_ 360 BCS_EspFailrSts 0 "No error" 1 "Error"  ;
VAL_ 360 BCS_ActvSts 0 "Not active" 1 "Active"  ;
VAL_ 360 BCS_BDCActive 0 "Not active" 1 "Active"  ;
VAL_ 360 BCS_DTCActvSts 0 "Not active" 1 "Active"  ;
VAL_ 360 BCS_errorFb 0 "No error" 1 "Invalid Request of ADAS" 2 "Fault related to wheelspd" 2 "Fault related to steeringangel" 3 "Fault related to powertrain" 4 "Fault related to EPB" 7 "ADAS E2E fault or timeoutt"  ;
VAL_ 360 BCS_WheelSlipFLValid 0 "Invalid" 1 "Valid"  ;
VAL_ 360 BCS_WheelSlipFRValid 0 "Invalid" 1 "Valid"  ;
VAL_ 360 BCS_WheelSlipRLValid 0 "Invalid" 1 "Valid"  ;
VAL_ 360 BCS_WheelSlipRRValid 0 "Invalid" 1 "Valid"  ;
VAL_ 360 BCS_CrbsTarRecpTorqRqFASt 0 "NotIntialized" 1 "Normal（valid）" 2 "Faulty（invalid）" 3 "Reserved"  ;
VAL_ 360 BCS_CrbsTarRecpTorqRqRASt 0 "NotIntialized" 1 "Normal（valid）" 2 "Faulty（invalid）" 3 "Reserved"  ;
VAL_ 360 BCS_CrbsTarRecpTorqRqSumSt 0 "NotIntialized" 1 "Normal（valid）" 2 "Faulty（invalid）" 3 "Reserved"  ;
VAL_ 618 EPB_SwitchSt 0 "Not active" 1 "Released" 2 "Applied" 3 "Not used"  ;
VAL_ 618 EPB_SwitchStVD 0 "Not valid" 1 "Valid"  ;
VAL_ 618 EPB_SysSt 0 "Release (fully released)" 1 "Apply (fully applied)" 2 "Releasing" 3 "Applying" 4 "Disengaged" 5 "Not used" 6 "Not used" 7 "Fault(not sure position)"  ;
VAL_ 618 EPB_FailSt 0 "No error" 1 "Error"  ;
VAL_ 618 EPB_ExtAvailable 0 "Apply and release" 1 "Only apply" 2 "Only release" 3 "None"  ;
VAL_ 618 EPB_DynamicApplySt 0 "Not active" 1 "BCS dynamic apply" 2 "Anti-Lock Apply" 3 "EPB degraded apply" 4 "Not used" 5 "Not used" 6 "Not used" 7 "Not used"  ;
VAL_ 618 EPB_ActuatorSt_R 0 "PbcActuatorState_Applied" 1 "PbcActuatorState_Released" 2 "PbcActuatorState_Applying" 3 "PbcActuatorState_Releasing" 4 "PbcActuatorState_Unknown" 5 "PbcActuatorState_HoldApplied" 6 "PbcActuatorState_CompletelyReleased" 7 "Not used" 8 "Not used" 9 "Not used" 10 "Not used" 11 "Not used" 12 "Not used" 13 "Not used" 14 "Not used" 15 "Not used"  ;
VAL_ 618 EPB_RWUActvSts 0 "Not active" 1 "CDP active" 2 "RWU active" 3 "Limp home"  ;
VAL_ 618 EPB_RWUAvl 0 "Not available" 1 "Reserved" 2 "RWU available" 3 "Limp home available"  ;
VAL_ 618 EPB_EpbAvl 0 "not available" 1 "available" 2 "available degraed（lone side is available，left or right）"  ;
VAL_ 618 EPB_RPAAVPAvailability 0 "NotAvailable" 1 "Available" 2 "TestPending"  ;
VAL_ 618 EPB_APAAvailability 0 "NotAvailable" 1 "Available"  ;
VAL_ 618 EPB_ActuatorSt_L_1 0 "PbcActuatorState_Applied" 1 "PbcActuatorState_Released" 2 "PbcActuatorState_Applying" 3 "PbcActuatorState_Releasing" 4 "PbcActuatorState_Unknown" 5 "PbcActuatorState_HoldApplied" 6 "PbcActuatorState_CompletelyReleased" 7 "Not used" 8 "Not used" 9 "Not used" 10 "Not used" 11 "Not used" 12 "Not used" 13 "Not used" 14 "Not used" 15 "Not used"  ;
VAL_ 446 RBM_BATResultSt 0 "BAT Fail" 1 "BAT Pass"  ;
VAL_ 446 RBU_SeconBrkCDAAvailableSt 0 "CDA NotAvailable" 1 "CDA NotAvailable By Situation" 2 "CDA active With Fault" 3 "CDA active With Situation" 4 "CDA Available" 5 "Not used" 6 "Not used" 7 "Not used"  ;
VAL_ 446 RBU_SeconBrkCommuniSt 0 "Valid" 1 "Invalid"  ;
VAL_ 446 RBU_SeconBrkCDAActiveSt 0 "L2++ NotActive" 1 "L2++ Active"  ;
VAL_ 446 RBU_SeconBrkEPBst 0 "ParkBrakeState_Unknown" 1 "ParkBrakeState_Applying" 2 "ParkBrakeState_Applied" 3 "ParkBrakeState_Releasing" 4 "ParkBrakeState_Released" 5 "Not used" 6 "Not used" 7 "Not used"  ;
VAL_ 446 RBU_SeconBrkComChannel 0 "No Channel used" 1 "Main ADC and Main bus Used" 2 "Main ADC and Back bus Used" 3 "Back up ADC and Main Bus Used"  ;
VAL_ 446 RBU_FLWheelSpdVD 0 "Not valid" 1 "Valid"  ;
VAL_ 446 RBU_RLWheelRotatedDirection 0 "Forward" 1 "Backward"  ;
VAL_ 446 RBU_RLWheelRotatedDirectionVD 0 "Not valid" 1 "Valid"  ;
VAL_ 446 RBU_FRWheelSpdVD 0 "Not valid" 1 "Valid"  ;
VAL_ 446 RBU_RRWheelRotatedDirection 0 "Forward" 1 "Backward"  ;
VAL_ 446 RBU_RRWheelRotatedDirectionVD 0 "Not valid" 1 "Valid"  ;
VAL_ 446 RBU_RLWheelSpdVD 0 "Not valid" 1 "Valid"  ;
VAL_ 446 RBU_RRWheelSpdVD 0 "Not valid" 1 "Valid"  ;
VAL_ 446 RBU_FLWheelSpdEdgesSumVD 0 "Not valid" 1 "Valid"  ;
VAL_ 446 RBU_FRWheelSpdEdgesSumVD 0 "Not valid" 1 "Valid"  ;
VAL_ 446 RBU_RLWheelSpdEdgesSumVD 0 "Not valid" 1 "Valid"  ;
VAL_ 446 RBU_RRWheelSpdEdgesSumVD 0 "Not valid" 1 "Valid"  ;
VAL_ 446 RBU_FLWheelRotatedDirection 0 "Forward" 1 "Backward"  ;
VAL_ 446 RBU_FLWheelRotatedDirectionVD 0 "Not valid" 1 "Valid"  ;
VAL_ 446 RBU_FRWheelRotatedDirection 0 "Forward" 1 "Backward"  ;
VAL_ 446 RBU_FRWheelRotatedDirectionVD 0 "Not valid" 1 "Valid"  ;
VAL_ 430 SRS_CrashOutputSt 0 "No crash,"  ;
VAL_ 430 SRS_Front_CrashOutputSt 0 "No crash," 1 "Crash happen in last 2 sec.(transition lasts for 2sec)"  ;
VAL_ 430 SRS_DriverSide_CrashOutputSt 0 "No crash," 1 "Crash happen in last 2 sec.(transition lasts for 2sec)"  ;
VAL_ 430 SRS_PassengerSide_CrashOutputSt 0 "No crash," 1 "Crash happen in last 2 sec. (transition lasts for 2sec)"  ;
VAL_ 430 SRS_Rear_CrashOutputSt 0 "No crash," 1 "Crash happen in last 2 sec.(transition lasts for 2sec)"  ;
VAL_ 430 SRS_RolloverCrashOutputSt 0 "No crash," 1 "Crash happen in last 2 sec.(transition lasts for 2sec)"  ;
VAL_ 430 SRS_NearCrashOutputSt 0 "No crash," 1 "Crash happen in last 2 sec.(transition lasts for 2sec)"  ;
VAL_ 430 SRS_YawSnsCalibSt 0 "Sensor Not Calibrated" 1 "Sensor Calibrated"  ;
VAL_ 430 SRS_VehLongAccelVD 0 "Initializing" 1 "Valid" 2 "Invalid" 3 "Reserved"  ;
VAL_ 430 SRS_VehLatrlAccelVD 0 "Initializing" 1 "Valid" 2 "Invalid" 3 "Reserved"  ;
VAL_ 430 SRS_YawRateVD 0 "Initializing" 1 "Valid" 2 "Invalid" 3 "Reserved"  ;
VAL_ 939 SRS_PsngrSeatBeltSt 0 "Fastened" 1 "Unfastened" 2 "Not used" 3 "Invalid"  ;
VAL_ 939 SRS_DriverSeatBeltSt 0 "Fastened" 1 "Unfastened" 2 "Not used" 3 "Invalid"  ;
VAL_ 939 SRS_RearLeftSeatBeltSt 0 "Fastened" 1 "Unfastened" 2 "Not used" 3 "Invalid"  ;
VAL_ 939 SRS_AirbagFaultSt 0 "Not fault" 1 "Fault"  ;
VAL_ 939 SRS_RearRightSeatBeltSt 0 "Fastened" 1 "Unfastened" 2 "Not used" 3 "Invalid"  ;
VAL_ 939 SRS_RearMiddleSeatBeltSt 0 "Fastened" 1 "Unfastened" 2 "Not used" 3 "Invalid"  ;
VAL_ 363 EPS_StrngWhlTorqVD 0 "Not valid" 1 "Valid"  ;
VAL_ 363 TAS_CalibratedSt 0 "Not calibrated" 1 "Calibrated"  ;
VAL_ 363 EPS_SteeringAngleSpdVD 0 "Not valid" 1 "Valid"  ;
VAL_ 363 EPS_SteeringAngleVD 0 "Not valid" 1 "Valid"  ;
VAL_ 363 EPS_VMCErrFeedback 0 "No interruption" 1 "LKA Interruption" 2 "APA Interruption" 3 "Vehicle Speed Invalid" 4 "VMC Activation request error" 5 "VMC ECU Signal error" 6 "EPS Temp error" 7 "Request Torque Slope over limit" 8 "Request Torque Value over limit" 9 "Failed Temp Time Over Limit" 10 "EPS Permanently error" 11 "VMC Triggered safety monitor module" 12 "Drive Override" 13 "Reserved" 14 "Reserved" 15 "Reserved"  ;
VAL_ 363 EPS_PstOverlaySt_SideA 0 "Not Ready" 1 "Ready" 2 "Active" 3 "Failed"  ;
VAL_ 363 EPS_PstOverlaySt_SideB 0 "Not Ready" 1 "Ready" 2 "Active" 3 "Failed"  ;
VAL_ 363 EPS_HealthySt_SideA 0 "Healthy;" 1 "Slightly failure;" 2 "Abnormal;" 3 "Shut off;"  ;
VAL_ 363 EPS_HealthySt_SideB 0 "Healthy;" 1 "Slightly failure;" 2 "Abnormal;" 3 "Shut off;"  ;
VAL_ 363 EPS_PstOverlaySt 0 "Not Ready;" 1 "Ready;" 2 "100% Active;" 3 "50% Active;" 4 "Failed;" 5 "Reserved" 6 "Reserved" 7 "Reserved"  ;
VAL_ 363 EPS_HealthySt_DualSide 0 "Healthy;" 1 "Slightly failure;" 2 "Abnormal;" 3 "Shut off;"  ;
VAL_ 363 EPS_PstOverLayRdntSt 0 "Not Reduntant" 1 "Redundant"  ;
VAL_ 363 EPS_VibrationWarnSt_A 0 "Not Acitve" 1 "Active level 1" 2 "Active level 2" 3 "Active level 3"  ;
VAL_ 363 SAC_ErrFeedback_SideA 0 "No  interruption；" 1 "ADAS TqRateReq Over rangenge" 2 "Driver Override" 3 "Vehicle Speed Invalid" 4 "Activation Requestrian Error" 5 "ADC Channel A signal Error" 6 "EPS Error" 7 "IFC Signal Error" 8 "ADAS AngleReq Over range" 9 "ADAS AngleSpdReq Over range" 10 "ADAS TqReq Over range" 11 "Both ADAS Channel Error" 12 "ADC Channel B signal Error；" 13 "Reserved；" 14 "Reserved；" 15 "Reserved；"  ;
VAL_ 363 SAC_ErrFeedback_SideB 0 "No  interruption；" 1 "Reserved" 2 "Driver Override" 3 "Vehicle Speed Invalid" 4 "Activation Requestrian Error" 5 "Adas Channel A signal Error" 6 "EPS Error" 7 "IFC Signal Error" 8 "Adas AngleReq Over range" 9 "Reserved；" 10 "Reserved；" 11 "Both ADAS Channel Error" 12 "ADAS Channel B signal Error；" 13 "Reserved；" 14 "Reserved；" 15 "Reserved；"  ;
VAL_ 363 EPS_PDC_CtrlSt 0 "PDC Not Acitve" 1 "PDC Active (Short term active and triggered warn lamp threshold Value)" 2 "Reserved" 3 "Reserved"  ;
VAL_ 363 EPS_Shimmy_Compensation_CtrlSt 0 "Shimmy compensation Not Acitve" 1 "Shimmy compensation Active" 2 "Reserved" 3 "Reserved"  ;
VAL_ 363 EPS_FunctionStyleSt 0 "Unknow" 1 "light" 2 "Comfort" 3 "Sport"  ;
VAL_ 363 EPS_SteeringModeSt 0 "Not ready" 1 "Ready" 2 "In transition" 3 "Fault"  ;
VAL_ 363 EPS_ActEffectiveChannel 0 "None；" 1 "Channel A （main-Channel）from ADC" 2 "Channel B（Sub-Channel） from ADC" 3 "Channel C（main-Channel） from IFC" 4 "Reserved" 5 "Reserved" 6 "Reserved" 7 "Reserved"  ;
VAL_ 363 EPS_ReqAngOverRange 0 "Not Over Range；" 1 "Over range"  ;
VAL_ 363 EPS_ReqAngSpdOverRange 0 "Not Over Range；" 1 "Over range"  ;
VAL_ 363 EPS_AssistPraSwitchToLKA 0 "Not in LAK mode；" 1 "In LKA Mode；"  ;
VAL_ 363 EPS_SteerGainEnable 0 "Disable；" 1 "Enable；"  ;
VAL_ 363 EPS_EmSteerEnbale 0 "Disable；" 1 "Enable；"  ;
VAL_ 363 EPS_SG_ErrFeedback 0 "No  interruption；" 1 "Premise fun abort" 2 "Invalid request" 3 "Reserved" 4 "Reserved" 5 "Reserved" 6 "Reserved" 7 "Reserved" 8 "Reserved" 9 "Reserved" 10 "Reserved" 11 "Reserved" 12 "Reserved" 13 "Reserved" 14 "Reserved" 15 "Reserved"  ;
VAL_ 363 EPS_EM_ErrFeedback 0 "No interruption" 1 "Reserved" 2 "Reserved" 3 "Reserved" 4 "Reserved" 5 "ADAS Signal err" 6 "EPS error" 7 "Duration time over"  ;
VAL_ 363 EPS_VW_ErrFeedback 0 "No interruption" 1 "Reserved" 2 "Reserved" 3 "Reserved" 4 "Invalid request" 5 "ADC Signal err" 6 "EPS error"  ;
VAL_ 363 EPS_WarnLamp 0 "No Fault" 1 "Slight Fault" 2 "Urgency Fault" 3 "Severity Urgency Fault"  ;
VAL_ 363 EPS_SteeringWhlTorFltVD 0 "No Valid" 1 "Valid with fault detected" 2 "Valid and healthy" 3 "Unkown"  ;
VAL_ 363 EPS_TqCtrlSt 0 "No active" 1 "Ready" 2 "Active" 3 "Failed"  ;
VAL_ 363 EPS_TqCtrlAvl 0 "Not available" 1 "Available" 2 "Available degraded" 3 "Reseved"  ;
VAL_ 363 EPS_AgCtrlAvl 0 "Not available" 1 "Available" 2 "Available degraded" 3 "Reseved"  ;
VAL_ 363 EPS_MotorTorSumVD 0 "Invalid" 1 "Valid"  ;
VAL_ 363 EPS_DrvOveRideSt 0 "Not override" 1 "Override"  ;
VAL_ 363 EPS_DrvOveRideVD 0 "Invalid" 1 "Valid"  ;
VAL_ 363 EPS_SteerVibrlAvl 0 "Not available" 1 "Available"  ;
VAL_ 363 EPS_HandsOffDetStVD 0 "Invalid" 1 "Valid"  ;
VAL_ 363 EPS_HandsOffDetSt 0 "Not detected" 1 "Hands off" 2 "Hands on" 3 "Reserved"  ;
VAL_ 363 EPS_SteerMod 0 "Initial" 1 "Power steer" 2 "Angle control(Normal）" 3 "Angle control(Emergency)" 4 "Torque control(Normal）" 5 "Torque control(Emergency)" 6 "Failure" 7 "Reserved"  ;
VAL_ 363 EPS_EpsSelfChkSts 0 "Not completed" 1 "completed"  ;
VAL_ 363 EPS_ADCNetErrorFb 0 "No Error" 1 "Main Net E2E Error" 2 "Sub Net E2E Error" 3 "Both Net E2E Error" 4 "Reserved" 5 "Reserved" 6 "Reserved" 7 "Reserved"  ;
VAL_ 363 EPS_NetModeResp 0 "None" 1 "Main/sub Net active" 2 "Main/sub Net active with error" 3 "Reserved"  ;
VAL_ 362 EPSB_StrngWhlTorqVD 0 "Not valid" 1 "Valid"  ;
VAL_ 362 EPSB_TAS_CalibratedSt 0 "Not calibrated" 1 "Calibrated"  ;
VAL_ 362 EPSB_SteeringAngleSpdVD 0 "Not valid" 1 "Valid"  ;
VAL_ 362 EPSB_SteeringAngleVD 0 "Not valid" 1 "Valid"  ;
VAL_ 362 EPSB_PstOverlaySt_SideA 0 "Not Ready" 1 "Ready" 2 "Active" 3 "Failed"  ;
VAL_ 362 EPSB_PstOverlaySt_SideB 0 "Not Ready" 1 "Ready" 2 "Active" 3 "Failed"  ;
VAL_ 362 EPSB_HealthySt_SideA 0 "Healthy;" 1 "Slightly failure;" 2 "Abnormal;" 3 "Shut off;"  ;
VAL_ 362 EPSB_HealthySt_SideB 0 "Healthy;" 1 "Slightly failure;" 2 "Abnormal;" 3 "Shut off;"  ;
VAL_ 362 EPSB_PstOverlaySt 0 "Not Ready;" 1 "Ready;" 2 "100% Active;" 3 "50% Active;" 4 "Failed;" 5 "Reserved" 6 "Reserved" 7 "Reserved"  ;
VAL_ 362 EPSB_HealthySt_DualSide 0 "Healthy;" 1 "Slightly failure;" 2 "Abnormal;" 3 "Shut off;"  ;
VAL_ 362 EPSB_PstOverLayRdntSt 0 "Not Reduntant" 1 "Redundant"  ;
VAL_ 362 EPSB_VibrationWarnSt 0 "Not Acitve" 1 "Active level 1" 2 "Active level 2" 3 "Active level 3"  ;
VAL_ 362 EPSB_SAC_ErrFeedback_SideA 0 "No  interruption；" 1 "Reserved" 2 "Driver Override" 3 "Vehicle Speed Invalid" 4 "Activation Requestrian Error" 5 "ADC Channel A signal Error" 6 "EPS Error" 7 "IFC Signal Error" 8 "Adas AngleReq Over range" 9 "Reserved；" 10 "Reserved；" 11 "Both ADAS Channel Error" 12 "ADC Channel B signal Error；" 13 "Reserved；" 14 "Reserved；" 15 "Reserved；"  ;
VAL_ 362 EPSB_SAC_ErrFeedback_SideB 0 "No  interruption" 1 "Reserved" 2 "Driver Override" 3 "Vehicle Speed Invalid" 4 "Activation Requestrian Error" 5 "Adas Channel A signal Error" 6 "EPS Error" 7 "IFC Signal Error" 8 "Adas AngleReq Over range" 9 "Reserved" 10 "Reserved" 11 "Both ADAS Channel Error" 12 "ADAS Channel B signal Error" 13 "Reserved" 14 "Reserved" 15 "Reserved"  ;
VAL_ 362 EPSB_FunctionStyleSt 0 "Unknow" 1 "light" 2 "Comfort" 3 "Sport"  ;
VAL_ 362 EPSB_SteeringModeSt 0 "Not ready" 1 "Ready" 2 "In transition" 3 "Reserved"  ;
VAL_ 362 EPSB_ActEffectiveChannel 0 "None；" 1 "Channel A （main-Channel）from ADC" 2 "Channel B（Sub-Channel） from ADC" 3 "Channel C（main-Channel） from IFC"  ;
VAL_ 362 EPSB_ReqAngOverRange 0 "Not Over Range；" 1 "Over range"  ;
VAL_ 362 EPSB_ReqAngSpdOverRange 0 "Not Over Range；" 1 "Over range"  ;
VAL_ 362 EPSB_AssistPraSwitchToLKA 0 "Not in LAK mode；" 1 "In LKA Mode；"  ;
VAL_ 362 EPSB_SteerGainEnable 0 "Disable；" 1 "Enable；"  ;
VAL_ 362 EPSB_EmSteerEnbale 0 "Disable；" 1 "Enable；"  ;
VAL_ 362 EPSB_SG_ErrFeedback 0 "No  interruption；" 1 "Premise fun abort" 2 "Invalid request" 3 "Reserved" 4 "Reserved" 5 "Reserved" 6 "Reserved" 7 "Reserved" 8 "Reserved" 9 "Reserved" 10 "Reserved" 11 "Reserved" 12 "Reserved" 13 "Reserved" 14 "Reserved" 15 "Reserved"  ;
VAL_ 362 EPSB_EM_ErrFeedback 0 "No interruption" 1 "Reserved" 2 "Reserved" 3 "Reserved" 4 "Reserved" 5 "ADAS Signal err" 6 "EPS error" 7 "Duration time over"  ;
VAL_ 362 EPSB_VW_ErrFeedback 0 "No interruption" 1 "Reserved" 2 "Reserved" 3 "Reserved" 4 "Invalid request" 5 "ADC Signal err" 6 "EPS error"  ;
VAL_ 362 EPSB_WarnLamp 0 "No Fault" 1 "Slight Fault" 2 "Urgency Fault" 3 "Severity Urgency Fault"  ;
VAL_ 362 EPSB_SteeringWhlTorFltVD 1 "Valid with fault detected" 2 "Valid and healthy" 3 "Unkown"  ;
VAL_ 362 EPSB_EpsSelfChkSts 0 "Not completed" 1 "completed"  ;
