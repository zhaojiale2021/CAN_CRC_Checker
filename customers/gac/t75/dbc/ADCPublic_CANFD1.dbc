VERSION "Version"

NS_ :

BS_:

BU_: Tester CCU ADC CCU_CCURT1 CCU_CCURT2 RLR RRR ZCUF ZCUL ZCUR ZCUT EMS IDM DCDC IPS NIDU DCUR OBC OPC LPC CPC EMCM GCU DCUF IPU BMS EOPR EVCC DCDC2 EDL SRS ECS EPS EPB RBM IBCS ICM IID IDC PHUDD AMP WHUD IMR INU IFC FAPA PAS PCS SCMR SCMRL SCMRR SCMRM MFS WSM DRM IDU FCP LBMSAD AVAS ATSS DLPFL FBLCM FLISD FLLCM FRLCM RLLCMA RLLCMB RRLCMA RRLCMB RLISD DLPML DLPMR TRM PSDL PSDR HVSPRL HVSPRR RFR SBM WCM ETC TBOX2 TBOX IDUR CBM PLGM TMC LPC2 SCMT RCP RRISD LBMS RLBMS CCURT1 CCURT2 RT1_C1 RT2_C3 RT1_C0 OTAWL RAS EBB RCICP WCMFR WCMRL SAS CD

BO_ 780 CCU_IDC_15: 64 CCU
 SG_ ACU_ISACountryID : 7|10@0+ (1,0) [0|1023] ""  ADC,IFC
 SG_ ACU_ISARoadTyp : 13|4@0+ (1,0) [0|15] ""  ADC,IFC
 SG_ ACU_ISARoadSpdLimit : 23|8@0+ (1,0) [0|255] ""  ADC,IFC
 SG_ ACU_ISASpdLimitUnit : 9|2@0+ (1,0) [0|3] ""  ADC,IFC
 SG_ ACU_ISASpdLimitTyp : 49|2@0+ (1,0) [0|3] ""  ADC,IFC
 SG_ ACU_ISARampTyp : 77|2@0+ (1,0) [0|3] ""  ADC,IFC
 SG_ ACU_ISARampDist : 31|10@0+ (1,0) [0|1023] "m"  ADC,IFC
 SG_ ACU_ISAJunctDist : 37|10@0+ (1,0) [0|1023] ""  ADC,IFC
 SG_ ACU_ISARDBDist : 43|10@0+ (1,0) [0|1023] ""  ADC,IFC
 SG_ ACU_ISACondSpdLimit : 63|8@0+ (1,0) [0|255] ""  ADC,IFC
 SG_ ACU_ISACondSpdLimitTyp : 71|4@0+ (1,0) [0|15] ""  ADC,IFC
 SG_ ACU_ISACondSpdLimitVd : 79|2@0+ (1,0) [0|3] ""  ADC,IFC
 SG_ ACU_ISASupplierInfo : 67|4@0+ (1,0) [0|15] ""  ADC,IFC
 SG_ ACU_ISAServiceWorkSt : 75|3@0+ (1,0) [0|7] ""  ADC,IFC

BO_ 1269 FL_DiagCode: 64 ADC
 SG_ FL_DTCCode : 7|512@0+ (1,0) [0|0] ""  CCU

BO_ 778 CCU_ZCUR_11: 64 CCU
 SG_ ZCUR_11_CRC : 7|16@0+ (1,0) [0|65535] ""  ADC
 SG_ ZCUR_11_Counter : 23|8@0+ (1,0) [0|255] ""  ADC
 SG_ EL_SideBrkLightSt : 44|1@0+ (1,0) [0|1] ""  ADC
 SG_ EL_SideBrkLightFaultSt : 43|1@0+ (1,0) [0|1] ""  ADC
 SG_ EL_CHMSLSt : 42|1@0+ (1,0) [0|1] ""  ADC
 SG_ EL_CHMSLFaultSt : 41|1@0+ (1,0) [0|1] ""  ADC
 SG_ EL_RLTurnLightSt : 63|2@0+ (1,0) [0|3] ""  ADC
 SG_ EL_RLTurnLightFaultSt : 48|1@0+ (1,0) [0|1] ""  ADC
 SG_ EL_RRTurnLightSt : 61|2@0+ (1,0) [0|3] ""  ADC
 SG_ EL_RRTurnLightFaultSt : 59|1@0+ (1,0) [0|1] ""  ADC
 SG_ EL_RADASLightSt : 223|2@0+ (1,0) [0|3] ""  ADC

BO_ 704 CCU_IPS_1: 64 CCU
 SG_ IPS_1_CRC : 7|16@0+ (1,0) [0|65535] ""  BMS,ADC
 SG_ IPS_1_Counter : 23|8@0+ (1,0) [0|255] ""  BMS,ADC
 SG_ IPS_DCDCModeSt : 39|3@0+ (1,0) [0|7] ""  ADC

BO_ 794 CCU_LBMSAD_1: 64 CCU
 SG_ LBMSAD_1_CRC : 7|16@0+ (1,0) [0|65535] ""  ADC,LBMS
 SG_ LBMSAD_1_Counter : 23|8@0+ (1,0) [0|255] ""  ADC,LBMS
 SG_ LBMSAD_SOFVD : 28|1@0+ (1,0) [0|1] ""  ADC,LBMS
 SG_ LBMSAD_SOFEN : 30|2@0+ (1,0) [0|3] ""  ADC,LBMS

BO_ 958 CCU_TMC_4_New: 64 CCU
 SG_ HVACPmp_MotWPSt : 401|2@0+ (1,0) [0|3] ""  EMS,NIDU,DCUR,DCUF,IPU,BMS,IDC,ADC
 SG_ HVACPmp_MotWPErrCode : 415|20@0+ (1,0) [0|1048576] ""  NIDU,DCUR,DCUF,IPU,ADC
 SG_ HVACSns_MotorInTVD : 402|1@0+ (1,0) [0|1] ""  NIDU,DCUR,DCUF,IPU,BMS,IDC,ADC
 SG_ HVACSns_MotorInT : 427|9@0+ (0.5,-50) [-50|200] "degC"  EMS,NIDU,DCUR,DCUF,IPU,BMS,IDC,ADC
 SG_ HVACPmp_MotWPActDuty : 447|8@0+ (1,0) [0|100] "%"  NIDU,DCUR,DCUF,IPU,IDC,ADC

BO_ 709 TMS_5_New: 32 CCU_CCURT1
 SG_ HVAC_AutoFogFlt : 26|1@0+ (1,0) [0|1] ""  ADC
 SG_ HVAC_AutoFogSts : 27|1@0+ (1,0) [0|1] ""  ADC
 SG_ HVAC_CorrectedCabinTemp : 39|8@0+ (0.5,-40) [-40|87.5] "°C"  CCURT2,RT2_C3,TMC,IDC,ADC
 SG_ HVAC_CorrectedCabinTempVD : 28|1@0+ (1,0) [0|1] ""  CCURT2,RT2_C3,TMC,IDC,ADC
 SG_ HVAC_CorrectedExterTemp : 47|8@0+ (0.5,-40) [-40|87.5] "°C"  CCURT2,RT2_C3,OTAWL,TMC,ZCUL,ZCUR,EMS,IPS,NIDU,DCUR,OBC,GCU,DCUF,IPU,BMS,ECS,IBCS,IID,IDC,AMP,ADC,IFC,PAS,WSM
 SG_ HVAC_CorrectedExterTempFault : 30|2@0+ (1,0) [0|3] ""  CCURT2,RT2_C3,OTAWL,TMC,ZCUL,ZCUR,EMS,IPS,NIDU,DCUR,OBC,GCU,DCUF,IPU,BMS,ECS,IBCS,IID,IDC,AMP,ADC,IFC,PAS,WSM
 SG_ HVAC_CorrectedExterTempVD : 31|1@0+ (1,0) [0|1] ""  CCURT2,RT2_C3,OTAWL,TMC,ZCUL,ZCUR,EMS,IPS,NIDU,DCUR,OBC,GCU,DCUF,IPU,BMS,ECS,IBCS,IID,IDC,AMP,ADC,IFC,PAS,WSM
 SG_ HVAC_MotWtrPmpSt : 51|2@0+ (1,0) [0|3] ""  TMC,ZCUL,ZCUR,EMS,NIDU,DCUR,DCUF,IPU,IDC,ADC,FCP
 SG_ HVAC_RearDefrostSt : 116|1@0+ (1,0) [0|1] ""  ZCUL,ZCUR,IDC,RCICP,AMP,ADC,IFC,FCP,RCP,HVSPRL,HVSPRR
 SG_ HVAC_WindExitMode : 122|3@0+ (1,0) [0|7] ""  ZCUL,ZCUR,EMS,IDC,ADC,IFC

CM_ SG_ 780 ACU_ISACountryID "country ID refer to ISO 3166-1";
CM_ SG_ 780 ACU_ISARoadTyp "indicate the road type";
CM_ SG_ 780 ACU_ISARoadSpdLimit "road speed limit value";
CM_ SG_ 780 ACU_ISASpdLimitUnit "road speed limit unit";
CM_ SG_ 780 ACU_ISASpdLimitTyp "speed limit type";
CM_ SG_ 780 ACU_ISARampTyp "indicate the front nearest ramp type within 1km";
CM_ SG_ 780 ACU_ISARampDist "indicate the front nearest ramp distance within 1km";
CM_ SG_ 780 ACU_ISAJunctDist "indicate the front nearest junction distance within 1km";
CM_ SG_ 780 ACU_ISARDBDist "indicate the front nearest roundabout distance within 1km";
CM_ SG_ 780 ACU_ISACondSpdLimit "condition speed limit value";
CM_ SG_ 780 ACU_ISACondSpdLimitTyp "indicate the condition speed limit type";
CM_ SG_ 780 ACU_ISACondSpdLimitVd "condition speed limit validity";
CM_ SG_ 780 ACU_ISASupplierInfo "ISA supplier information";
CM_ SG_ 780 ACU_ISAServiceWorkSt "indicate the work status of the map service";
CM_ SG_ 1269 FL_DTCCode "FL DTC and status Sent To CCU";
CM_ SG_ 778 ZCUR_11_CRC "E2E Profile 5 CRC";
CM_ SG_ 778 ZCUR_11_Counter "E2E Profile 5 Counter";
CM_ SG_ 778 EL_SideBrkLightSt "Side brake light status";
CM_ SG_ 778 EL_SideBrkLightFaultSt "Side brake light fault status";
CM_ SG_ 778 EL_CHMSLSt "Centre high mounted stop lamp status";
CM_ SG_ 778 EL_CHMSLFaultSt "Centre high mounted stop lamp fault status";
CM_ SG_ 778 EL_RLTurnLightSt "Rear left turn light status";
CM_ SG_ 778 EL_RLTurnLightFaultSt "Rear left turn light fault status";
CM_ SG_ 778 EL_RRTurnLightSt "Rear right turn light status";
CM_ SG_ 778 EL_RRTurnLightFaultSt "Rear right turn light fault status";
CM_ SG_ 778 EL_RADASLightSt "Rear ADAS light status";
CM_ SG_ 704 IPS_1_CRC "E2E Profile 5 CRC";
CM_ SG_ 704 IPS_1_Counter "E2E Profile 5 Counter";
CM_ SG_ 704 IPS_DCDCModeSt "mode status of DCDC";
CM_ SG_ 794 LBMSAD_1_CRC "E2E Profile 5 CRC";
CM_ SG_ 794 LBMSAD_1_Counter "E2E Profile 5 Counter";
CM_ SG_ 794 LBMSAD_SOFVD "LBMSAD Validity of SOF";
CM_ SG_ 794 LBMSAD_SOFEN "LBMSAD  State of Function Enable";
CM_ SG_ 958 HVACPmp_MotWPSt " motor  Water Pump State";
CM_ SG_ 958 HVACPmp_MotWPErrCode " motor  Water Pump fault";
CM_ SG_ 958 HVACSns_MotorInTVD " Motor Inlet water temperature valid flag";
CM_ SG_ 958 HVACSns_MotorInT " Motor Inlet water temperature";
CM_ SG_ 958 HVACPmp_MotWPActDuty "  motor Water Pump duty feedback";
CM_ SG_ 709 HVAC_AutoFogFlt "Auto Fog Function Fault Flag";
CM_ SG_ 709 HVAC_AutoFogSts "Auto Fog Function Status";
CM_ SG_ 709 HVAC_CorrectedCabinTemp "Corrected cabin temperature";
CM_ SG_ 709 HVAC_CorrectedCabinTempVD "Signal CorrectedCabinTemp validity";
CM_ SG_ 709 HVAC_CorrectedExterTemp "Corrected External temperature";
CM_ SG_ 709 HVAC_CorrectedExterTempFault "ExterTemp Fault Status";
CM_ SG_ 709 HVAC_CorrectedExterTempVD "External temperature valid data";
CM_ SG_ 709 HVAC_MotWtrPmpSt " motor Water Pump fault";
CM_ SG_ 709 HVAC_RearDefrostSt "Rear window and mirror heater activation status";
CM_ SG_ 709 HVAC_WindExitMode "The wind exit mode";

BA_DEF_ BO_  "GenMsgCycleTime" INT 0 0;
BA_DEF_ BO_  "GenMsgCycleTimeFast" INT 0 0;
BA_DEF_ BO_  "GenMsgSendType" ENUM  "Periodic","Event","IfActive","POE","PA","FixedPeriodic","Event","EnabledPeriodic","NotUsed","NotUsed","EventPeriodic","NotUsed","NotUsed","NoMsgSendType";
BA_DEF_ BO_  "VFrameFormat" ENUM  "StandardCAN","ExtendedCAN","reserved","reserved","reserved","reserved","reserved","reserved","reserved","reserved","reserved","reserved","reserved","reserved","StandardCAN_FD","ExtendedCAN_FD";
BA_DEF_ BO_  "CANFD_BRS" ENUM  "0","1";
BA_DEF_ SG_  "EventCommandSignal" ENUM  "No","Yes";
BA_DEF_ SG_  "GatewayedSignals" ENUM  "No","Yes";
BA_DEF_ SG_  "GenSigInactiveValue" HEX 0 0;
BA_DEF_ SG_  "GenSigInvalidValue" HEX 0 0;
BA_DEF_ SG_  "GenSigSendType" ENUM  "Trigger","Passive","Cyclic","OnWrite","OnWriteWithRepetition","OnChange","OnChangeWithRepetition","IfActive","IfActiveWithRepetition","NoSigSendType";
BA_DEF_ SG_  "GenSigStartValue" HEX 0 0;
BA_DEF_ SG_  "GenSigTimeoutValue" HEX 0 0;
BA_DEF_ SG_  "Remark" STRING ;
BA_ "GenMsgCycleTime" BO_ 780 100;
BA_ "GenMsgCycleTimeFast" BO_ 780 0;
BA_ "GenMsgSendType" BO_ 780 0;
BA_ "VFrameFormat" BO_ 780 14;
BA_ "CANFD_BRS" BO_ 780 1;
BA_ "GenMsgCycleTime" BO_ 780 100;
BA_ "GenMsgCycleTimeFast" BO_ 780 0;
BA_ "GenMsgSendType" BO_ 780 0;
BA_ "VFrameFormat" BO_ 780 14;
BA_ "CANFD_BRS" BO_ 780 1;
BA_ "GenMsgCycleTime" BO_ 780 100;
BA_ "GenMsgCycleTimeFast" BO_ 780 0;
BA_ "GenMsgSendType" BO_ 780 0;
BA_ "VFrameFormat" BO_ 780 14;
BA_ "CANFD_BRS" BO_ 780 1;
BA_ "GenMsgCycleTime" BO_ 780 100;
BA_ "GenMsgCycleTimeFast" BO_ 780 0;
BA_ "GenMsgSendType" BO_ 780 0;
BA_ "VFrameFormat" BO_ 780 14;
BA_ "CANFD_BRS" BO_ 780 1;
BA_ "GenMsgCycleTime" BO_ 780 100;
BA_ "GenMsgCycleTimeFast" BO_ 780 0;
BA_ "GenMsgSendType" BO_ 780 0;
BA_ "VFrameFormat" BO_ 780 14;
BA_ "CANFD_BRS" BO_ 780 1;
BA_ "GenMsgCycleTime" BO_ 780 100;
BA_ "GenMsgCycleTimeFast" BO_ 780 0;
BA_ "GenMsgSendType" BO_ 780 0;
BA_ "VFrameFormat" BO_ 780 14;
BA_ "CANFD_BRS" BO_ 780 1;
BA_ "GenMsgCycleTime" BO_ 780 100;
BA_ "GenMsgCycleTimeFast" BO_ 780 0;
BA_ "GenMsgSendType" BO_ 780 0;
BA_ "VFrameFormat" BO_ 780 14;
BA_ "CANFD_BRS" BO_ 780 1;
BA_ "GenMsgCycleTime" BO_ 780 100;
BA_ "GenMsgCycleTimeFast" BO_ 780 0;
BA_ "GenMsgSendType" BO_ 780 0;
BA_ "VFrameFormat" BO_ 780 14;
BA_ "CANFD_BRS" BO_ 780 1;
BA_ "GenMsgCycleTime" BO_ 780 100;
BA_ "GenMsgCycleTimeFast" BO_ 780 0;
BA_ "GenMsgSendType" BO_ 780 0;
BA_ "VFrameFormat" BO_ 780 14;
BA_ "CANFD_BRS" BO_ 780 1;
BA_ "GenMsgCycleTime" BO_ 780 100;
BA_ "GenMsgCycleTimeFast" BO_ 780 0;
BA_ "GenMsgSendType" BO_ 780 0;
BA_ "VFrameFormat" BO_ 780 14;
BA_ "CANFD_BRS" BO_ 780 1;
BA_ "GenMsgCycleTime" BO_ 780 100;
BA_ "GenMsgCycleTimeFast" BO_ 780 0;
BA_ "GenMsgSendType" BO_ 780 0;
BA_ "VFrameFormat" BO_ 780 14;
BA_ "CANFD_BRS" BO_ 780 1;
BA_ "GenMsgCycleTime" BO_ 780 100;
BA_ "GenMsgCycleTimeFast" BO_ 780 0;
BA_ "GenMsgSendType" BO_ 780 0;
BA_ "VFrameFormat" BO_ 780 14;
BA_ "CANFD_BRS" BO_ 780 1;
BA_ "GenMsgCycleTime" BO_ 780 100;
BA_ "GenMsgCycleTimeFast" BO_ 780 0;
BA_ "GenMsgSendType" BO_ 780 0;
BA_ "VFrameFormat" BO_ 780 14;
BA_ "CANFD_BRS" BO_ 780 1;
BA_ "GenMsgCycleTime" BO_ 780 100;
BA_ "GenMsgCycleTimeFast" BO_ 780 0;
BA_ "GenMsgSendType" BO_ 780 0;
BA_ "VFrameFormat" BO_ 780 14;
BA_ "CANFD_BRS" BO_ 780 1;
BA_ "GenMsgCycleTime" BO_ 1269 0;
BA_ "GenMsgCycleTimeFast" BO_ 1269 0;
BA_ "GenMsgSendType" BO_ 1269 1;
BA_ "VFrameFormat" BO_ 1269 14;
BA_ "CANFD_BRS" BO_ 1269 1;
BA_ "GenMsgCycleTime" BO_ 778 100;
BA_ "GenMsgCycleTimeFast" BO_ 778 0;
BA_ "GenMsgSendType" BO_ 778 0;
BA_ "VFrameFormat" BO_ 778 14;
BA_ "CANFD_BRS" BO_ 778 1;
BA_ "GenMsgCycleTime" BO_ 778 100;
BA_ "GenMsgCycleTimeFast" BO_ 778 0;
BA_ "GenMsgSendType" BO_ 778 0;
BA_ "VFrameFormat" BO_ 778 14;
BA_ "CANFD_BRS" BO_ 778 1;
BA_ "GenMsgCycleTime" BO_ 778 100;
BA_ "GenMsgCycleTimeFast" BO_ 778 0;
BA_ "GenMsgSendType" BO_ 778 0;
BA_ "VFrameFormat" BO_ 778 14;
BA_ "CANFD_BRS" BO_ 778 1;
BA_ "GenMsgCycleTime" BO_ 778 100;
BA_ "GenMsgCycleTimeFast" BO_ 778 0;
BA_ "GenMsgSendType" BO_ 778 0;
BA_ "VFrameFormat" BO_ 778 14;
BA_ "CANFD_BRS" BO_ 778 1;
BA_ "GenMsgCycleTime" BO_ 778 100;
BA_ "GenMsgCycleTimeFast" BO_ 778 0;
BA_ "GenMsgSendType" BO_ 778 0;
BA_ "VFrameFormat" BO_ 778 14;
BA_ "CANFD_BRS" BO_ 778 1;
BA_ "GenMsgCycleTime" BO_ 778 100;
BA_ "GenMsgCycleTimeFast" BO_ 778 0;
BA_ "GenMsgSendType" BO_ 778 0;
BA_ "VFrameFormat" BO_ 778 14;
BA_ "CANFD_BRS" BO_ 778 1;
BA_ "GenMsgCycleTime" BO_ 778 100;
BA_ "GenMsgCycleTimeFast" BO_ 778 0;
BA_ "GenMsgSendType" BO_ 778 0;
BA_ "VFrameFormat" BO_ 778 14;
BA_ "CANFD_BRS" BO_ 778 1;
BA_ "GenMsgCycleTime" BO_ 778 100;
BA_ "GenMsgCycleTimeFast" BO_ 778 0;
BA_ "GenMsgSendType" BO_ 778 0;
BA_ "VFrameFormat" BO_ 778 14;
BA_ "CANFD_BRS" BO_ 778 1;
BA_ "GenMsgCycleTime" BO_ 778 100;
BA_ "GenMsgCycleTimeFast" BO_ 778 0;
BA_ "GenMsgSendType" BO_ 778 0;
BA_ "VFrameFormat" BO_ 778 14;
BA_ "CANFD_BRS" BO_ 778 1;
BA_ "GenMsgCycleTime" BO_ 778 100;
BA_ "GenMsgCycleTimeFast" BO_ 778 0;
BA_ "GenMsgSendType" BO_ 778 0;
BA_ "VFrameFormat" BO_ 778 14;
BA_ "CANFD_BRS" BO_ 778 1;
BA_ "GenMsgCycleTime" BO_ 778 100;
BA_ "GenMsgCycleTimeFast" BO_ 778 0;
BA_ "GenMsgSendType" BO_ 778 0;
BA_ "VFrameFormat" BO_ 778 14;
BA_ "CANFD_BRS" BO_ 778 1;
BA_ "GenMsgCycleTime" BO_ 704 20;
BA_ "GenMsgCycleTimeFast" BO_ 704 0;
BA_ "GenMsgSendType" BO_ 704 0;
BA_ "VFrameFormat" BO_ 704 14;
BA_ "CANFD_BRS" BO_ 704 1;
BA_ "GenMsgCycleTime" BO_ 704 20;
BA_ "GenMsgCycleTimeFast" BO_ 704 0;
BA_ "GenMsgSendType" BO_ 704 0;
BA_ "VFrameFormat" BO_ 704 14;
BA_ "CANFD_BRS" BO_ 704 1;
BA_ "GenMsgCycleTime" BO_ 704 20;
BA_ "GenMsgCycleTimeFast" BO_ 704 0;
BA_ "GenMsgSendType" BO_ 704 0;
BA_ "VFrameFormat" BO_ 704 14;
BA_ "CANFD_BRS" BO_ 704 1;
BA_ "GenMsgCycleTime" BO_ 794 100;
BA_ "GenMsgCycleTimeFast" BO_ 794 0;
BA_ "GenMsgSendType" BO_ 794 0;
BA_ "VFrameFormat" BO_ 794 14;
BA_ "CANFD_BRS" BO_ 794 1;
BA_ "GenMsgCycleTime" BO_ 794 100;
BA_ "GenMsgCycleTimeFast" BO_ 794 0;
BA_ "GenMsgSendType" BO_ 794 0;
BA_ "VFrameFormat" BO_ 794 14;
BA_ "CANFD_BRS" BO_ 794 1;
BA_ "GenMsgCycleTime" BO_ 794 100;
BA_ "GenMsgCycleTimeFast" BO_ 794 0;
BA_ "GenMsgSendType" BO_ 794 0;
BA_ "VFrameFormat" BO_ 794 14;
BA_ "CANFD_BRS" BO_ 794 1;
BA_ "GenMsgCycleTime" BO_ 794 100;
BA_ "GenMsgCycleTimeFast" BO_ 794 0;
BA_ "GenMsgSendType" BO_ 794 0;
BA_ "VFrameFormat" BO_ 794 14;
BA_ "CANFD_BRS" BO_ 794 1;
BA_ "GenMsgCycleTime" BO_ 958 200;
BA_ "GenMsgCycleTimeFast" BO_ 958 0;
BA_ "GenMsgSendType" BO_ 958 0;
BA_ "VFrameFormat" BO_ 958 14;
BA_ "CANFD_BRS" BO_ 958 1;
BA_ "GenMsgCycleTime" BO_ 958 200;
BA_ "GenMsgCycleTimeFast" BO_ 958 0;
BA_ "GenMsgSendType" BO_ 958 0;
BA_ "VFrameFormat" BO_ 958 14;
BA_ "CANFD_BRS" BO_ 958 1;
BA_ "GenMsgCycleTime" BO_ 958 200;
BA_ "GenMsgCycleTimeFast" BO_ 958 0;
BA_ "GenMsgSendType" BO_ 958 0;
BA_ "VFrameFormat" BO_ 958 14;
BA_ "CANFD_BRS" BO_ 958 1;
BA_ "GenMsgCycleTime" BO_ 958 200;
BA_ "GenMsgCycleTimeFast" BO_ 958 0;
BA_ "GenMsgSendType" BO_ 958 0;
BA_ "VFrameFormat" BO_ 958 14;
BA_ "CANFD_BRS" BO_ 958 1;
BA_ "GenMsgCycleTime" BO_ 958 200;
BA_ "GenMsgCycleTimeFast" BO_ 958 0;
BA_ "GenMsgSendType" BO_ 958 0;
BA_ "VFrameFormat" BO_ 958 14;
BA_ "CANFD_BRS" BO_ 958 1;
BA_ "GenMsgCycleTime" BO_ 709 100;
BA_ "GenMsgCycleTimeFast" BO_ 709 0;
BA_ "GenMsgSendType" BO_ 709 0;
BA_ "VFrameFormat" BO_ 709 14;
BA_ "CANFD_BRS" BO_ 709 1;
BA_ "GenMsgCycleTime" BO_ 709 100;
BA_ "GenMsgCycleTimeFast" BO_ 709 0;
BA_ "GenMsgSendType" BO_ 709 0;
BA_ "VFrameFormat" BO_ 709 14;
BA_ "CANFD_BRS" BO_ 709 1;
BA_ "GenMsgCycleTime" BO_ 709 100;
BA_ "GenMsgCycleTimeFast" BO_ 709 0;
BA_ "GenMsgSendType" BO_ 709 0;
BA_ "VFrameFormat" BO_ 709 14;
BA_ "CANFD_BRS" BO_ 709 1;
BA_ "GenMsgCycleTime" BO_ 709 100;
BA_ "GenMsgCycleTimeFast" BO_ 709 0;
BA_ "GenMsgSendType" BO_ 709 0;
BA_ "VFrameFormat" BO_ 709 14;
BA_ "CANFD_BRS" BO_ 709 1;
BA_ "GenMsgCycleTime" BO_ 709 100;
BA_ "GenMsgCycleTimeFast" BO_ 709 0;
BA_ "GenMsgSendType" BO_ 709 0;
BA_ "VFrameFormat" BO_ 709 14;
BA_ "CANFD_BRS" BO_ 709 1;
BA_ "GenMsgCycleTime" BO_ 709 100;
BA_ "GenMsgCycleTimeFast" BO_ 709 0;
BA_ "GenMsgSendType" BO_ 709 0;
BA_ "VFrameFormat" BO_ 709 14;
BA_ "CANFD_BRS" BO_ 709 1;
BA_ "GenMsgCycleTime" BO_ 709 100;
BA_ "GenMsgCycleTimeFast" BO_ 709 0;
BA_ "GenMsgSendType" BO_ 709 0;
BA_ "VFrameFormat" BO_ 709 14;
BA_ "CANFD_BRS" BO_ 709 1;
BA_ "GenMsgCycleTime" BO_ 709 100;
BA_ "GenMsgCycleTimeFast" BO_ 709 0;
BA_ "GenMsgSendType" BO_ 709 0;
BA_ "VFrameFormat" BO_ 709 14;
BA_ "CANFD_BRS" BO_ 709 1;
BA_ "GenMsgCycleTime" BO_ 709 100;
BA_ "GenMsgCycleTimeFast" BO_ 709 0;
BA_ "GenMsgSendType" BO_ 709 0;
BA_ "VFrameFormat" BO_ 709 14;
BA_ "CANFD_BRS" BO_ 709 1;
BA_ "GenMsgCycleTime" BO_ 709 100;
BA_ "GenMsgCycleTimeFast" BO_ 709 0;
BA_ "GenMsgSendType" BO_ 709 0;
BA_ "VFrameFormat" BO_ 709 14;
BA_ "CANFD_BRS" BO_ 709 1;
BA_ "EventCommandSignal" SG_ 780 ACU_ISACountryID 0;
BA_ "GatewayedSignals" SG_ 780 ACU_ISACountryID 0;
BA_ "GenSigInactiveValue" SG_ 780 ACU_ISACountryID 0;
BA_ "GenSigInvalidValue" SG_ 780 ACU_ISACountryID 0;
BA_ "GenSigSendType" SG_ 780 ACU_ISACountryID 1;
BA_ "GenSigStartValue" SG_ 780 ACU_ISACountryID 0;
BA_ "GenSigTimeoutValue" SG_ 780 ACU_ISACountryID 0;
BA_ "Remark" SG_ 780 ACU_ISACountryID "";
BA_ "EventCommandSignal" SG_ 780 ACU_ISARoadTyp 0;
BA_ "GatewayedSignals" SG_ 780 ACU_ISARoadTyp 0;
BA_ "GenSigInactiveValue" SG_ 780 ACU_ISARoadTyp 0;
BA_ "GenSigInvalidValue" SG_ 780 ACU_ISARoadTyp 0;
BA_ "GenSigSendType" SG_ 780 ACU_ISARoadTyp 1;
BA_ "GenSigStartValue" SG_ 780 ACU_ISARoadTyp 0;
BA_ "GenSigTimeoutValue" SG_ 780 ACU_ISARoadTyp 0;
BA_ "Remark" SG_ 780 ACU_ISARoadTyp "";
BA_ "EventCommandSignal" SG_ 780 ACU_ISARoadSpdLimit 0;
BA_ "GatewayedSignals" SG_ 780 ACU_ISARoadSpdLimit 0;
BA_ "GenSigInactiveValue" SG_ 780 ACU_ISARoadSpdLimit 0;
BA_ "GenSigInvalidValue" SG_ 780 ACU_ISARoadSpdLimit 0;
BA_ "GenSigSendType" SG_ 780 ACU_ISARoadSpdLimit 1;
BA_ "GenSigStartValue" SG_ 780 ACU_ISARoadSpdLimit 0;
BA_ "GenSigTimeoutValue" SG_ 780 ACU_ISARoadSpdLimit 0;
BA_ "Remark" SG_ 780 ACU_ISARoadSpdLimit "";
BA_ "EventCommandSignal" SG_ 780 ACU_ISASpdLimitUnit 0;
BA_ "GatewayedSignals" SG_ 780 ACU_ISASpdLimitUnit 0;
BA_ "GenSigInactiveValue" SG_ 780 ACU_ISASpdLimitUnit 0;
BA_ "GenSigInvalidValue" SG_ 780 ACU_ISASpdLimitUnit 0;
BA_ "GenSigSendType" SG_ 780 ACU_ISASpdLimitUnit 1;
BA_ "GenSigStartValue" SG_ 780 ACU_ISASpdLimitUnit 0;
BA_ "GenSigTimeoutValue" SG_ 780 ACU_ISASpdLimitUnit 0;
BA_ "Remark" SG_ 780 ACU_ISASpdLimitUnit "";
BA_ "EventCommandSignal" SG_ 780 ACU_ISASpdLimitTyp 0;
BA_ "GatewayedSignals" SG_ 780 ACU_ISASpdLimitTyp 0;
BA_ "GenSigInactiveValue" SG_ 780 ACU_ISASpdLimitTyp 0;
BA_ "GenSigInvalidValue" SG_ 780 ACU_ISASpdLimitTyp 0;
BA_ "GenSigSendType" SG_ 780 ACU_ISASpdLimitTyp 1;
BA_ "GenSigStartValue" SG_ 780 ACU_ISASpdLimitTyp 0;
BA_ "GenSigTimeoutValue" SG_ 780 ACU_ISASpdLimitTyp 0;
BA_ "Remark" SG_ 780 ACU_ISASpdLimitTyp "";
BA_ "EventCommandSignal" SG_ 780 ACU_ISARampTyp 0;
BA_ "GatewayedSignals" SG_ 780 ACU_ISARampTyp 0;
BA_ "GenSigInactiveValue" SG_ 780 ACU_ISARampTyp 0;
BA_ "GenSigInvalidValue" SG_ 780 ACU_ISARampTyp 0;
BA_ "GenSigSendType" SG_ 780 ACU_ISARampTyp 1;
BA_ "GenSigStartValue" SG_ 780 ACU_ISARampTyp 0;
BA_ "GenSigTimeoutValue" SG_ 780 ACU_ISARampTyp 0;
BA_ "Remark" SG_ 780 ACU_ISARampTyp "";
BA_ "EventCommandSignal" SG_ 780 ACU_ISARampDist 0;
BA_ "GatewayedSignals" SG_ 780 ACU_ISARampDist 0;
BA_ "GenSigInactiveValue" SG_ 780 ACU_ISARampDist 0;
BA_ "GenSigInvalidValue" SG_ 780 ACU_ISARampDist 0;
BA_ "GenSigSendType" SG_ 780 ACU_ISARampDist 1;
BA_ "GenSigStartValue" SG_ 780 ACU_ISARampDist 0;
BA_ "GenSigTimeoutValue" SG_ 780 ACU_ISARampDist 0;
BA_ "Remark" SG_ 780 ACU_ISARampDist "";
BA_ "EventCommandSignal" SG_ 780 ACU_ISAJunctDist 0;
BA_ "GatewayedSignals" SG_ 780 ACU_ISAJunctDist 0;
BA_ "GenSigInactiveValue" SG_ 780 ACU_ISAJunctDist 0;
BA_ "GenSigInvalidValue" SG_ 780 ACU_ISAJunctDist 0;
BA_ "GenSigSendType" SG_ 780 ACU_ISAJunctDist 1;
BA_ "GenSigStartValue" SG_ 780 ACU_ISAJunctDist 0;
BA_ "GenSigTimeoutValue" SG_ 780 ACU_ISAJunctDist 0;
BA_ "Remark" SG_ 780 ACU_ISAJunctDist "";
BA_ "EventCommandSignal" SG_ 780 ACU_ISARDBDist 0;
BA_ "GatewayedSignals" SG_ 780 ACU_ISARDBDist 0;
BA_ "GenSigInactiveValue" SG_ 780 ACU_ISARDBDist 0;
BA_ "GenSigInvalidValue" SG_ 780 ACU_ISARDBDist 0;
BA_ "GenSigSendType" SG_ 780 ACU_ISARDBDist 1;
BA_ "GenSigStartValue" SG_ 780 ACU_ISARDBDist 0;
BA_ "GenSigTimeoutValue" SG_ 780 ACU_ISARDBDist 0;
BA_ "Remark" SG_ 780 ACU_ISARDBDist "";
BA_ "EventCommandSignal" SG_ 780 ACU_ISACondSpdLimit 0;
BA_ "GatewayedSignals" SG_ 780 ACU_ISACondSpdLimit 0;
BA_ "GenSigInactiveValue" SG_ 780 ACU_ISACondSpdLimit 0;
BA_ "GenSigInvalidValue" SG_ 780 ACU_ISACondSpdLimit 0;
BA_ "GenSigSendType" SG_ 780 ACU_ISACondSpdLimit 1;
BA_ "GenSigStartValue" SG_ 780 ACU_ISACondSpdLimit 0;
BA_ "GenSigTimeoutValue" SG_ 780 ACU_ISACondSpdLimit 0;
BA_ "Remark" SG_ 780 ACU_ISACondSpdLimit "";
BA_ "EventCommandSignal" SG_ 780 ACU_ISACondSpdLimitTyp 0;
BA_ "GatewayedSignals" SG_ 780 ACU_ISACondSpdLimitTyp 0;
BA_ "GenSigInactiveValue" SG_ 780 ACU_ISACondSpdLimitTyp 0;
BA_ "GenSigInvalidValue" SG_ 780 ACU_ISACondSpdLimitTyp 0;
BA_ "GenSigSendType" SG_ 780 ACU_ISACondSpdLimitTyp 1;
BA_ "GenSigStartValue" SG_ 780 ACU_ISACondSpdLimitTyp 0;
BA_ "GenSigTimeoutValue" SG_ 780 ACU_ISACondSpdLimitTyp 0;
BA_ "Remark" SG_ 780 ACU_ISACondSpdLimitTyp "";
BA_ "EventCommandSignal" SG_ 780 ACU_ISACondSpdLimitVd 0;
BA_ "GatewayedSignals" SG_ 780 ACU_ISACondSpdLimitVd 0;
BA_ "GenSigInactiveValue" SG_ 780 ACU_ISACondSpdLimitVd 0;
BA_ "GenSigInvalidValue" SG_ 780 ACU_ISACondSpdLimitVd 0;
BA_ "GenSigSendType" SG_ 780 ACU_ISACondSpdLimitVd 1;
BA_ "GenSigStartValue" SG_ 780 ACU_ISACondSpdLimitVd 0;
BA_ "GenSigTimeoutValue" SG_ 780 ACU_ISACondSpdLimitVd 0;
BA_ "Remark" SG_ 780 ACU_ISACondSpdLimitVd "";
BA_ "EventCommandSignal" SG_ 780 ACU_ISASupplierInfo 0;
BA_ "GatewayedSignals" SG_ 780 ACU_ISASupplierInfo 0;
BA_ "GenSigInactiveValue" SG_ 780 ACU_ISASupplierInfo 0;
BA_ "GenSigInvalidValue" SG_ 780 ACU_ISASupplierInfo 0;
BA_ "GenSigSendType" SG_ 780 ACU_ISASupplierInfo 1;
BA_ "GenSigStartValue" SG_ 780 ACU_ISASupplierInfo 0;
BA_ "GenSigTimeoutValue" SG_ 780 ACU_ISASupplierInfo 0;
BA_ "Remark" SG_ 780 ACU_ISASupplierInfo "";
BA_ "EventCommandSignal" SG_ 780 ACU_ISAServiceWorkSt 0;
BA_ "GatewayedSignals" SG_ 780 ACU_ISAServiceWorkSt 0;
BA_ "GenSigInactiveValue" SG_ 780 ACU_ISAServiceWorkSt 0;
BA_ "GenSigInvalidValue" SG_ 780 ACU_ISAServiceWorkSt 0;
BA_ "GenSigSendType" SG_ 780 ACU_ISAServiceWorkSt 1;
BA_ "GenSigStartValue" SG_ 780 ACU_ISAServiceWorkSt 0;
BA_ "GenSigTimeoutValue" SG_ 780 ACU_ISAServiceWorkSt 0;
BA_ "Remark" SG_ 780 ACU_ISAServiceWorkSt "";
BA_ "EventCommandSignal" SG_ 1269 FL_DTCCode 1;
BA_ "GatewayedSignals" SG_ 1269 FL_DTCCode 0;
BA_ "GenSigInactiveValue" SG_ 1269 FL_DTCCode 0;
BA_ "GenSigInvalidValue" SG_ 1269 FL_DTCCode 0;
BA_ "GenSigSendType" SG_ 1269 FL_DTCCode 0;
BA_ "GenSigStartValue" SG_ 1269 FL_DTCCode 0;
BA_ "GenSigTimeoutValue" SG_ 1269 FL_DTCCode 0;
BA_ "Remark" SG_ 1269 FL_DTCCode "";
BA_ "EventCommandSignal" SG_ 778 ZCUR_11_CRC 0;
BA_ "GatewayedSignals" SG_ 778 ZCUR_11_CRC 0;
BA_ "GenSigInactiveValue" SG_ 778 ZCUR_11_CRC 0;
BA_ "GenSigInvalidValue" SG_ 778 ZCUR_11_CRC 0;
BA_ "GenSigSendType" SG_ 778 ZCUR_11_CRC 1;
BA_ "GenSigStartValue" SG_ 778 ZCUR_11_CRC 0;
BA_ "GenSigTimeoutValue" SG_ 778 ZCUR_11_CRC 0;
BA_ "Remark" SG_ 778 ZCUR_11_CRC "";
BA_ "EventCommandSignal" SG_ 778 ZCUR_11_Counter 0;
BA_ "GatewayedSignals" SG_ 778 ZCUR_11_Counter 0;
BA_ "GenSigInactiveValue" SG_ 778 ZCUR_11_Counter 0;
BA_ "GenSigInvalidValue" SG_ 778 ZCUR_11_Counter 0;
BA_ "GenSigSendType" SG_ 778 ZCUR_11_Counter 1;
BA_ "GenSigStartValue" SG_ 778 ZCUR_11_Counter 0;
BA_ "GenSigTimeoutValue" SG_ 778 ZCUR_11_Counter 0;
BA_ "Remark" SG_ 778 ZCUR_11_Counter "";
BA_ "EventCommandSignal" SG_ 778 EL_SideBrkLightSt 0;
BA_ "GatewayedSignals" SG_ 778 EL_SideBrkLightSt 0;
BA_ "GenSigInactiveValue" SG_ 778 EL_SideBrkLightSt 0;
BA_ "GenSigInvalidValue" SG_ 778 EL_SideBrkLightSt 0;
BA_ "GenSigSendType" SG_ 778 EL_SideBrkLightSt 1;
BA_ "GenSigStartValue" SG_ 778 EL_SideBrkLightSt 0;
BA_ "GenSigTimeoutValue" SG_ 778 EL_SideBrkLightSt 0;
BA_ "Remark" SG_ 778 EL_SideBrkLightSt "";
BA_ "EventCommandSignal" SG_ 778 EL_SideBrkLightFaultSt 0;
BA_ "GatewayedSignals" SG_ 778 EL_SideBrkLightFaultSt 0;
BA_ "GenSigInactiveValue" SG_ 778 EL_SideBrkLightFaultSt 0;
BA_ "GenSigInvalidValue" SG_ 778 EL_SideBrkLightFaultSt 0;
BA_ "GenSigSendType" SG_ 778 EL_SideBrkLightFaultSt 1;
BA_ "GenSigStartValue" SG_ 778 EL_SideBrkLightFaultSt 0;
BA_ "GenSigTimeoutValue" SG_ 778 EL_SideBrkLightFaultSt 0;
BA_ "Remark" SG_ 778 EL_SideBrkLightFaultSt "";
BA_ "EventCommandSignal" SG_ 778 EL_CHMSLSt 0;
BA_ "GatewayedSignals" SG_ 778 EL_CHMSLSt 0;
BA_ "GenSigInactiveValue" SG_ 778 EL_CHMSLSt 0;
BA_ "GenSigInvalidValue" SG_ 778 EL_CHMSLSt 0;
BA_ "GenSigSendType" SG_ 778 EL_CHMSLSt 1;
BA_ "GenSigStartValue" SG_ 778 EL_CHMSLSt 0;
BA_ "GenSigTimeoutValue" SG_ 778 EL_CHMSLSt 0;
BA_ "Remark" SG_ 778 EL_CHMSLSt "";
BA_ "EventCommandSignal" SG_ 778 EL_CHMSLFaultSt 0;
BA_ "GatewayedSignals" SG_ 778 EL_CHMSLFaultSt 0;
BA_ "GenSigInactiveValue" SG_ 778 EL_CHMSLFaultSt 0;
BA_ "GenSigInvalidValue" SG_ 778 EL_CHMSLFaultSt 0;
BA_ "GenSigSendType" SG_ 778 EL_CHMSLFaultSt 1;
BA_ "GenSigStartValue" SG_ 778 EL_CHMSLFaultSt 0;
BA_ "GenSigTimeoutValue" SG_ 778 EL_CHMSLFaultSt 0;
BA_ "Remark" SG_ 778 EL_CHMSLFaultSt "";
BA_ "EventCommandSignal" SG_ 778 EL_RLTurnLightSt 0;
BA_ "GatewayedSignals" SG_ 778 EL_RLTurnLightSt 0;
BA_ "GenSigInactiveValue" SG_ 778 EL_RLTurnLightSt 0;
BA_ "GenSigInvalidValue" SG_ 778 EL_RLTurnLightSt 0;
BA_ "GenSigSendType" SG_ 778 EL_RLTurnLightSt 1;
BA_ "GenSigStartValue" SG_ 778 EL_RLTurnLightSt 0;
BA_ "GenSigTimeoutValue" SG_ 778 EL_RLTurnLightSt 0;
BA_ "Remark" SG_ 778 EL_RLTurnLightSt "";
BA_ "EventCommandSignal" SG_ 778 EL_RLTurnLightFaultSt 0;
BA_ "GatewayedSignals" SG_ 778 EL_RLTurnLightFaultSt 0;
BA_ "GenSigInactiveValue" SG_ 778 EL_RLTurnLightFaultSt 0;
BA_ "GenSigInvalidValue" SG_ 778 EL_RLTurnLightFaultSt 0;
BA_ "GenSigSendType" SG_ 778 EL_RLTurnLightFaultSt 1;
BA_ "GenSigStartValue" SG_ 778 EL_RLTurnLightFaultSt 0;
BA_ "GenSigTimeoutValue" SG_ 778 EL_RLTurnLightFaultSt 0;
BA_ "Remark" SG_ 778 EL_RLTurnLightFaultSt "";
BA_ "EventCommandSignal" SG_ 778 EL_RRTurnLightSt 0;
BA_ "GatewayedSignals" SG_ 778 EL_RRTurnLightSt 0;
BA_ "GenSigInactiveValue" SG_ 778 EL_RRTurnLightSt 0;
BA_ "GenSigInvalidValue" SG_ 778 EL_RRTurnLightSt 0;
BA_ "GenSigSendType" SG_ 778 EL_RRTurnLightSt 1;
BA_ "GenSigStartValue" SG_ 778 EL_RRTurnLightSt 0;
BA_ "GenSigTimeoutValue" SG_ 778 EL_RRTurnLightSt 0;
BA_ "Remark" SG_ 778 EL_RRTurnLightSt "";
BA_ "EventCommandSignal" SG_ 778 EL_RRTurnLightFaultSt 0;
BA_ "GatewayedSignals" SG_ 778 EL_RRTurnLightFaultSt 0;
BA_ "GenSigInactiveValue" SG_ 778 EL_RRTurnLightFaultSt 0;
BA_ "GenSigInvalidValue" SG_ 778 EL_RRTurnLightFaultSt 0;
BA_ "GenSigSendType" SG_ 778 EL_RRTurnLightFaultSt 1;
BA_ "GenSigStartValue" SG_ 778 EL_RRTurnLightFaultSt 0;
BA_ "GenSigTimeoutValue" SG_ 778 EL_RRTurnLightFaultSt 0;
BA_ "Remark" SG_ 778 EL_RRTurnLightFaultSt "";
BA_ "EventCommandSignal" SG_ 778 EL_RADASLightSt 0;
BA_ "GatewayedSignals" SG_ 778 EL_RADASLightSt 0;
BA_ "GenSigInactiveValue" SG_ 778 EL_RADASLightSt 0;
BA_ "GenSigInvalidValue" SG_ 778 EL_RADASLightSt 0;
BA_ "GenSigSendType" SG_ 778 EL_RADASLightSt 1;
BA_ "GenSigStartValue" SG_ 778 EL_RADASLightSt 0;
BA_ "GenSigTimeoutValue" SG_ 778 EL_RADASLightSt 0;
BA_ "Remark" SG_ 778 EL_RADASLightSt "";
BA_ "EventCommandSignal" SG_ 704 IPS_1_CRC 0;
BA_ "GatewayedSignals" SG_ 704 IPS_1_CRC 0;
BA_ "GenSigInactiveValue" SG_ 704 IPS_1_CRC 0;
BA_ "GenSigInvalidValue" SG_ 704 IPS_1_CRC 0;
BA_ "GenSigSendType" SG_ 704 IPS_1_CRC 1;
BA_ "GenSigStartValue" SG_ 704 IPS_1_CRC 0;
BA_ "GenSigTimeoutValue" SG_ 704 IPS_1_CRC 0;
BA_ "Remark" SG_ 704 IPS_1_CRC "";
BA_ "EventCommandSignal" SG_ 704 IPS_1_Counter 0;
BA_ "GatewayedSignals" SG_ 704 IPS_1_Counter 0;
BA_ "GenSigInactiveValue" SG_ 704 IPS_1_Counter 0;
BA_ "GenSigInvalidValue" SG_ 704 IPS_1_Counter 0;
BA_ "GenSigSendType" SG_ 704 IPS_1_Counter 1;
BA_ "GenSigStartValue" SG_ 704 IPS_1_Counter 0;
BA_ "GenSigTimeoutValue" SG_ 704 IPS_1_Counter 0;
BA_ "Remark" SG_ 704 IPS_1_Counter "";
BA_ "EventCommandSignal" SG_ 704 IPS_DCDCModeSt 0;
BA_ "GatewayedSignals" SG_ 704 IPS_DCDCModeSt 0;
BA_ "GenSigInactiveValue" SG_ 704 IPS_DCDCModeSt 0;
BA_ "GenSigInvalidValue" SG_ 704 IPS_DCDCModeSt 0;
BA_ "GenSigSendType" SG_ 704 IPS_DCDCModeSt 1;
BA_ "GenSigStartValue" SG_ 704 IPS_DCDCModeSt 0;
BA_ "GenSigTimeoutValue" SG_ 704 IPS_DCDCModeSt 0;
BA_ "Remark" SG_ 704 IPS_DCDCModeSt "";
BA_ "EventCommandSignal" SG_ 794 LBMSAD_1_CRC 0;
BA_ "GatewayedSignals" SG_ 794 LBMSAD_1_CRC 0;
BA_ "GenSigInactiveValue" SG_ 794 LBMSAD_1_CRC 0;
BA_ "GenSigInvalidValue" SG_ 794 LBMSAD_1_CRC 0;
BA_ "GenSigSendType" SG_ 794 LBMSAD_1_CRC 1;
BA_ "GenSigStartValue" SG_ 794 LBMSAD_1_CRC 0;
BA_ "GenSigTimeoutValue" SG_ 794 LBMSAD_1_CRC 0;
BA_ "Remark" SG_ 794 LBMSAD_1_CRC "";
BA_ "EventCommandSignal" SG_ 794 LBMSAD_1_Counter 0;
BA_ "GatewayedSignals" SG_ 794 LBMSAD_1_Counter 0;
BA_ "GenSigInactiveValue" SG_ 794 LBMSAD_1_Counter 0;
BA_ "GenSigInvalidValue" SG_ 794 LBMSAD_1_Counter 0;
BA_ "GenSigSendType" SG_ 794 LBMSAD_1_Counter 1;
BA_ "GenSigStartValue" SG_ 794 LBMSAD_1_Counter 0;
BA_ "GenSigTimeoutValue" SG_ 794 LBMSAD_1_Counter 0;
BA_ "Remark" SG_ 794 LBMSAD_1_Counter "";
BA_ "EventCommandSignal" SG_ 794 LBMSAD_SOFVD 0;
BA_ "GatewayedSignals" SG_ 794 LBMSAD_SOFVD 0;
BA_ "GenSigInactiveValue" SG_ 794 LBMSAD_SOFVD 0;
BA_ "GenSigInvalidValue" SG_ 794 LBMSAD_SOFVD 0;
BA_ "GenSigSendType" SG_ 794 LBMSAD_SOFVD 1;
BA_ "GenSigStartValue" SG_ 794 LBMSAD_SOFVD 0;
BA_ "GenSigTimeoutValue" SG_ 794 LBMSAD_SOFVD 0;
BA_ "Remark" SG_ 794 LBMSAD_SOFVD "";
BA_ "EventCommandSignal" SG_ 794 LBMSAD_SOFEN 0;
BA_ "GatewayedSignals" SG_ 794 LBMSAD_SOFEN 0;
BA_ "GenSigInactiveValue" SG_ 794 LBMSAD_SOFEN 0;
BA_ "GenSigInvalidValue" SG_ 794 LBMSAD_SOFEN 0;
BA_ "GenSigSendType" SG_ 794 LBMSAD_SOFEN 1;
BA_ "GenSigStartValue" SG_ 794 LBMSAD_SOFEN 0;
BA_ "GenSigTimeoutValue" SG_ 794 LBMSAD_SOFEN 0;
BA_ "Remark" SG_ 794 LBMSAD_SOFEN "";
BA_ "EventCommandSignal" SG_ 958 HVACPmp_MotWPSt 0;
BA_ "GatewayedSignals" SG_ 958 HVACPmp_MotWPSt 0;
BA_ "GenSigInactiveValue" SG_ 958 HVACPmp_MotWPSt 0;
BA_ "GenSigInvalidValue" SG_ 958 HVACPmp_MotWPSt 0;
BA_ "GenSigSendType" SG_ 958 HVACPmp_MotWPSt 1;
BA_ "GenSigStartValue" SG_ 958 HVACPmp_MotWPSt 0;
BA_ "GenSigTimeoutValue" SG_ 958 HVACPmp_MotWPSt 0;
BA_ "Remark" SG_ 958 HVACPmp_MotWPSt "";
BA_ "EventCommandSignal" SG_ 958 HVACPmp_MotWPErrCode 0;
BA_ "GatewayedSignals" SG_ 958 HVACPmp_MotWPErrCode 0;
BA_ "GenSigInactiveValue" SG_ 958 HVACPmp_MotWPErrCode 0;
BA_ "GenSigInvalidValue" SG_ 958 HVACPmp_MotWPErrCode 0;
BA_ "GenSigSendType" SG_ 958 HVACPmp_MotWPErrCode 1;
BA_ "GenSigStartValue" SG_ 958 HVACPmp_MotWPErrCode 0;
BA_ "GenSigTimeoutValue" SG_ 958 HVACPmp_MotWPErrCode 0;
BA_ "Remark" SG_ 958 HVACPmp_MotWPErrCode "";
BA_ "EventCommandSignal" SG_ 958 HVACSns_MotorInTVD 0;
BA_ "GatewayedSignals" SG_ 958 HVACSns_MotorInTVD 0;
BA_ "GenSigInactiveValue" SG_ 958 HVACSns_MotorInTVD 0;
BA_ "GenSigInvalidValue" SG_ 958 HVACSns_MotorInTVD 0;
BA_ "GenSigSendType" SG_ 958 HVACSns_MotorInTVD 1;
BA_ "GenSigStartValue" SG_ 958 HVACSns_MotorInTVD 0;
BA_ "GenSigTimeoutValue" SG_ 958 HVACSns_MotorInTVD 0;
BA_ "Remark" SG_ 958 HVACSns_MotorInTVD "";
BA_ "EventCommandSignal" SG_ 958 HVACSns_MotorInT 0;
BA_ "GatewayedSignals" SG_ 958 HVACSns_MotorInT 0;
BA_ "GenSigInactiveValue" SG_ 958 HVACSns_MotorInT 0;
BA_ "GenSigInvalidValue" SG_ 958 HVACSns_MotorInT 0;
BA_ "GenSigSendType" SG_ 958 HVACSns_MotorInT 1;
BA_ "GenSigStartValue" SG_ 958 HVACSns_MotorInT 130;
BA_ "GenSigTimeoutValue" SG_ 958 HVACSns_MotorInT 130;
BA_ "Remark" SG_ 958 HVACSns_MotorInT "";
BA_ "EventCommandSignal" SG_ 958 HVACPmp_MotWPActDuty 0;
BA_ "GatewayedSignals" SG_ 958 HVACPmp_MotWPActDuty 0;
BA_ "GenSigInactiveValue" SG_ 958 HVACPmp_MotWPActDuty 0;
BA_ "GenSigInvalidValue" SG_ 958 HVACPmp_MotWPActDuty 0;
BA_ "GenSigSendType" SG_ 958 HVACPmp_MotWPActDuty 1;
BA_ "GenSigStartValue" SG_ 958 HVACPmp_MotWPActDuty 0;
BA_ "GenSigTimeoutValue" SG_ 958 HVACPmp_MotWPActDuty 0;
BA_ "Remark" SG_ 958 HVACPmp_MotWPActDuty "";
BA_ "EventCommandSignal" SG_ 709 HVAC_AutoFogFlt 0;
BA_ "GatewayedSignals" SG_ 709 HVAC_AutoFogFlt 0;
BA_ "GenSigInactiveValue" SG_ 709 HVAC_AutoFogFlt 0;
BA_ "GenSigInvalidValue" SG_ 709 HVAC_AutoFogFlt 0;
BA_ "GenSigSendType" SG_ 709 HVAC_AutoFogFlt 1;
BA_ "GenSigStartValue" SG_ 709 HVAC_AutoFogFlt 0;
BA_ "GenSigTimeoutValue" SG_ 709 HVAC_AutoFogFlt 0;
BA_ "Remark" SG_ 709 HVAC_AutoFogFlt "";
BA_ "EventCommandSignal" SG_ 709 HVAC_AutoFogSts 0;
BA_ "GatewayedSignals" SG_ 709 HVAC_AutoFogSts 0;
BA_ "GenSigInactiveValue" SG_ 709 HVAC_AutoFogSts 0;
BA_ "GenSigInvalidValue" SG_ 709 HVAC_AutoFogSts 0;
BA_ "GenSigSendType" SG_ 709 HVAC_AutoFogSts 1;
BA_ "GenSigStartValue" SG_ 709 HVAC_AutoFogSts 0;
BA_ "GenSigTimeoutValue" SG_ 709 HVAC_AutoFogSts 0;
BA_ "Remark" SG_ 709 HVAC_AutoFogSts "";
BA_ "EventCommandSignal" SG_ 709 HVAC_CorrectedCabinTemp 0;
BA_ "GatewayedSignals" SG_ 709 HVAC_CorrectedCabinTemp 0;
BA_ "GenSigInactiveValue" SG_ 709 HVAC_CorrectedCabinTemp 0;
BA_ "GenSigInvalidValue" SG_ 709 HVAC_CorrectedCabinTemp 0;
BA_ "GenSigSendType" SG_ 709 HVAC_CorrectedCabinTemp 1;
BA_ "GenSigStartValue" SG_ 709 HVAC_CorrectedCabinTemp 120;
BA_ "GenSigTimeoutValue" SG_ 709 HVAC_CorrectedCabinTemp 120;
BA_ "Remark" SG_ 709 HVAC_CorrectedCabinTemp "";
BA_ "EventCommandSignal" SG_ 709 HVAC_CorrectedCabinTempVD 0;
BA_ "GatewayedSignals" SG_ 709 HVAC_CorrectedCabinTempVD 0;
BA_ "GenSigInactiveValue" SG_ 709 HVAC_CorrectedCabinTempVD 0;
BA_ "GenSigInvalidValue" SG_ 709 HVAC_CorrectedCabinTempVD 0;
BA_ "GenSigSendType" SG_ 709 HVAC_CorrectedCabinTempVD 1;
BA_ "GenSigStartValue" SG_ 709 HVAC_CorrectedCabinTempVD 0;
BA_ "GenSigTimeoutValue" SG_ 709 HVAC_CorrectedCabinTempVD 0;
BA_ "Remark" SG_ 709 HVAC_CorrectedCabinTempVD "";
BA_ "EventCommandSignal" SG_ 709 HVAC_CorrectedExterTemp 0;
BA_ "GatewayedSignals" SG_ 709 HVAC_CorrectedExterTemp 0;
BA_ "GenSigInactiveValue" SG_ 709 HVAC_CorrectedExterTemp 0;
BA_ "GenSigInvalidValue" SG_ 709 HVAC_CorrectedExterTemp 0;
BA_ "GenSigSendType" SG_ 709 HVAC_CorrectedExterTemp 1;
BA_ "GenSigStartValue" SG_ 709 HVAC_CorrectedExterTemp 120;
BA_ "GenSigTimeoutValue" SG_ 709 HVAC_CorrectedExterTemp 120;
BA_ "Remark" SG_ 709 HVAC_CorrectedExterTemp "";
BA_ "EventCommandSignal" SG_ 709 HVAC_CorrectedExterTempFault 0;
BA_ "GatewayedSignals" SG_ 709 HVAC_CorrectedExterTempFault 0;
BA_ "GenSigInactiveValue" SG_ 709 HVAC_CorrectedExterTempFault 0;
BA_ "GenSigInvalidValue" SG_ 709 HVAC_CorrectedExterTempFault 0;
BA_ "GenSigSendType" SG_ 709 HVAC_CorrectedExterTempFault 1;
BA_ "GenSigStartValue" SG_ 709 HVAC_CorrectedExterTempFault 0;
BA_ "GenSigTimeoutValue" SG_ 709 HVAC_CorrectedExterTempFault 1;
BA_ "Remark" SG_ 709 HVAC_CorrectedExterTempFault "";
BA_ "EventCommandSignal" SG_ 709 HVAC_CorrectedExterTempVD 0;
BA_ "GatewayedSignals" SG_ 709 HVAC_CorrectedExterTempVD 0;
BA_ "GenSigInactiveValue" SG_ 709 HVAC_CorrectedExterTempVD 0;
BA_ "GenSigInvalidValue" SG_ 709 HVAC_CorrectedExterTempVD 0;
BA_ "GenSigSendType" SG_ 709 HVAC_CorrectedExterTempVD 1;
BA_ "GenSigStartValue" SG_ 709 HVAC_CorrectedExterTempVD 0;
BA_ "GenSigTimeoutValue" SG_ 709 HVAC_CorrectedExterTempVD 0;
BA_ "Remark" SG_ 709 HVAC_CorrectedExterTempVD "";
BA_ "EventCommandSignal" SG_ 709 HVAC_MotWtrPmpSt 0;
BA_ "GatewayedSignals" SG_ 709 HVAC_MotWtrPmpSt 0;
BA_ "GenSigInactiveValue" SG_ 709 HVAC_MotWtrPmpSt 0;
BA_ "GenSigInvalidValue" SG_ 709 HVAC_MotWtrPmpSt 0;
BA_ "GenSigSendType" SG_ 709 HVAC_MotWtrPmpSt 1;
BA_ "GenSigStartValue" SG_ 709 HVAC_MotWtrPmpSt 0;
BA_ "GenSigTimeoutValue" SG_ 709 HVAC_MotWtrPmpSt 0;
BA_ "Remark" SG_ 709 HVAC_MotWtrPmpSt "";
BA_ "EventCommandSignal" SG_ 709 HVAC_RearDefrostSt 0;
BA_ "GatewayedSignals" SG_ 709 HVAC_RearDefrostSt 0;
BA_ "GenSigInactiveValue" SG_ 709 HVAC_RearDefrostSt 0;
BA_ "GenSigInvalidValue" SG_ 709 HVAC_RearDefrostSt 0;
BA_ "GenSigSendType" SG_ 709 HVAC_RearDefrostSt 1;
BA_ "GenSigStartValue" SG_ 709 HVAC_RearDefrostSt 0;
BA_ "GenSigTimeoutValue" SG_ 709 HVAC_RearDefrostSt 0;
BA_ "Remark" SG_ 709 HVAC_RearDefrostSt "";
BA_ "EventCommandSignal" SG_ 709 HVAC_WindExitMode 0;
BA_ "GatewayedSignals" SG_ 709 HVAC_WindExitMode 0;
BA_ "GenSigInactiveValue" SG_ 709 HVAC_WindExitMode 0;
BA_ "GenSigInvalidValue" SG_ 709 HVAC_WindExitMode 0;
BA_ "GenSigSendType" SG_ 709 HVAC_WindExitMode 1;
BA_ "GenSigStartValue" SG_ 709 HVAC_WindExitMode 0;
BA_ "GenSigTimeoutValue" SG_ 709 HVAC_WindExitMode 0;
BA_ "Remark" SG_ 709 HVAC_WindExitMode "";
VAL_ 780 ACU_ISARoadTyp 0 "unknown" 1 "High way" 2 "National road" 3 "Provincial road" 4 "County road" 5 "Village road" 6 "City express way" 7 "Major urban road" 8 "Secondary urban road" 9 "Normal urban road" 10 "Non-Navigation Road" 11 "Ramp" 12 "Residential" 13 "Inter-Urban" 14 "Reserved" 15 "Reserved"  ;
VAL_ 780 ACU_ISARoadSpdLimit 0 "UnknownSPL" 1 "SPL5" 2 "SPL10" 3 "SPL15" 4 "SPL20" 29 "SPL145" 30 "SPL150" 255 "UnLimited"  ;
VAL_ 780 ACU_ISASpdLimitUnit 0 "Invalid" 1 "KPH" 2 "MPH" 3 "Reserved"  ;
VAL_ 780 ACU_ISASpdLimitTyp 0 "Invalid" 1 "Explicit" 2 "Implicit" 3 "Reserved"  ;
VAL_ 780 ACU_ISARampTyp 0 "Invalid" 1 "HW to HW" 2 "HW to NonHW" 3 "HW to ServiceArea"  ;
VAL_ 780 ACU_ISACondSpdLimit 0 "UnknownSPL" 1 "SPL5" 2 "SPL10" 3 "SPL15" 4 "SPL20" 29 "SPL145" 30 "SPL150" 255 "UnLimited"  ;
VAL_ 780 ACU_ISACondSpdLimitTyp 0 "Default" 1 "TIME" 2 "DISTANCE" 3 "RAIN" 4 "SNOW" 5 "FOG" 6 "VEHICLE" 7 "TRAILER" 8 "ARROW"  ;
VAL_ 780 ACU_ISACondSpdLimitVd 0 "Default" 1 "YES" 2 "NO" 3 "Reserved"  ;
VAL_ 780 ACU_ISASupplierInfo 0 "Default" 1 "高德" 2 "百度" 3 "腾讯" 4 "四维" 5 "Neusoft" 6 "泰为" 7 "梦擎" 8 "Here" 9 "Tomtom" 10 "Reserved" 11 "Reserved" 12 "Reserved" 13 "Reserved" 14 "Reserved" 15 "Reserved"  ;
VAL_ 780 ACU_ISAServiceWorkSt 0 "Not available" 1 "Normal" 2 "GPS week" 3 "No map data" 4 "ISA-APK Fault" 5 "Reserved" 6 "Reserved" 7 "Reserved"  ;
VAL_ 778 EL_SideBrkLightSt 0 "OFF" 1 "ON"  ;
VAL_ 778 EL_SideBrkLightFaultSt 0 "Not fault" 1 "Fault"  ;
VAL_ 778 EL_CHMSLSt 0 "OFF" 1 "ON"  ;
VAL_ 778 EL_CHMSLFaultSt 0 "Not fault" 1 "Fault"  ;
VAL_ 778 EL_RLTurnLightSt 0 "Not active" 1 "OFF" 2 "ON" 3 "Not used"  ;
VAL_ 778 EL_RLTurnLightFaultSt 0 "Not fault" 1 "Fault"  ;
VAL_ 778 EL_RRTurnLightSt 0 "Not active" 1 "OFF" 2 "ON" 3 "Not used"  ;
VAL_ 778 EL_RRTurnLightFaultSt 0 "Not fault" 1 "Fault"  ;
VAL_ 778 EL_RADASLightSt 0 "Off" 1 "On" 2 "Fault" 3 "Not used"  ;
VAL_ 704 IPS_DCDCModeSt 7 "Failure;" 3 "Active - Buck Mode;" 2 "Connected (HV is active);" 1 "Disconnected;" 0 "Init;"  ;
VAL_ 794 LBMSAD_SOFVD 0 "Invalid" 1 "Valid"  ;
VAL_ 794 LBMSAD_SOFEN 0 "Keep to the side parking False,Original lane parking False" 1 "Keep to the side parking True,Original lane parking False" 2 "Keep to the side parking False,Original lane parking True" 3 "Keep to the side parking True,Original lane parking True"  ;
VAL_ 958 HVACSns_MotorInTVD 0 "Invalid" 1 "Valid"  ;
VAL_ 709 HVAC_AutoFogFlt 0 "No Fault" 1 "Fault"  ;
VAL_ 709 HVAC_AutoFogSts 0 "Not Active" 1 "Active"  ;
VAL_ 709 HVAC_CorrectedCabinTempVD 0 "Not valid" 1 "Valid"  ;
VAL_ 709 HVAC_CorrectedExterTempFault 0 "Normal" 1 "circuit short to ground" 2 "circuit short to battery or open" 3 "reserve"  ;
VAL_ 709 HVAC_CorrectedExterTempVD 0 "Not valid" 1 "Valid"  ;
VAL_ 709 HVAC_RearDefrostSt 0 "Not acitve" 1 "Active"  ;
VAL_ 709 HVAC_WindExitMode 0 "Invalid" 1 "Face" 2 "Face/Foot" 3 "Foot" 4 "Foot/Defrost" 5 "Defrost" 6 "Face/DEF" 7 "Face/Foot/DEF"  ;
