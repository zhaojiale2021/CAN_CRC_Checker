VERSION "Version"

NS_ :

BS_:

BU_: Tester CCU ADC CCU_CCURT1 CCU_CCURT2 RLR RRR ZCUF ZCUL ZCUR ZCUT EMS IDM DCDC IPS NIDU DCUR OBC OPC LPC CPC EMCM GCU DCUF IPU BMS EOPR EVCC DCDC2 EDL SRS ECS EPS EPB RBM IBCS ICM IID IDC PHUDD AMP WHUD IMR INU IFC FAPA PAS PCS SCMR SCMRL SCMRR SCMRM MFS WSM DRM IDU FCP LBMSAD AVAS ATSS DLPFL FBLCM FLISD FLLCM FRLCM RLLCMA RLLCMB RRLCMA RRLCMB RLISD DLPML DLPMR TRM PSDL PSDR HVSPRL HVSPRR RFR SBM WCM ETC TBOX2 TBOX IDUR CBM PLGM TMC LPC2 SCMT RCP RRISD LBMS RLBMS CCURT1 CCURT2 RT1_C1 RT2_C3 RT1_C0 OTAWL RAS EBB RCICP WCMFR WCMRL SAS CD

BO_ 971 ADC_16: 64 ADC
 SG_ ADC_MnvrOrintChng6 : 31|2@0+ (1,0) [0|3] ""  CCU
 SG_ ADC_TarParkSt_Posn6 : 29|3@0+ (1,0) [0|7] ""  CCU
 SG_ ADC_ParkChkSrc_Posn6 : 26|3@0+ (1,0) [0|3] ""  CCU
 SG_ ADC_ParkPosn7_ID : 39|4@0+ (1,0) [0|15] ""  CCU
 SG_ ADC_MnvrOrintChng7 : 35|2@0+ (1,0) [0|3] ""  CCU
 SG_ ADC_TarParkSt_Posn7 : 33|3@0+ (1,0) [0|7] ""  CCU
 SG_ ADC_ParkChkSrc_Posn7 : 46|3@0+ (1,0) [0|3] ""  CCU
 SG_ ADC_ParkPosn8_ID : 43|4@0+ (1,0) [0|15] ""  CCU
 SG_ ADC_MnvrOrintChng8 : 55|2@0+ (1,0) [0|3] ""  CCU
 SG_ ADC_TarParkSt_Posn8 : 53|3@0+ (1,0) [0|7] ""  CCU
 SG_ ADC_ParkChkSrc_Posn8 : 50|3@0+ (1,0) [0|3] ""  CCU
 SG_ ADC_ParkRelPos5_x1 : 63|10@0+ (0.1,-50) [-50|50] "m"  CCU
 SG_ ADC_ParkRelPos5_y1 : 69|10@0+ (0.1,-50) [-50|50] "m"  CCU
 SG_ ADC_ParkRelPos5_x2 : 75|10@0+ (0.1,-50) [-50|50] "m"  CCU
 SG_ ADC_ParkRelPos5_y2 : 81|10@0+ (0.1,-50) [-50|50] "m"  CCU
 SG_ ADC_ParkRelPos5_x3 : 103|10@0+ (0.1,-50) [-50|50] "m"  CCU
 SG_ ADC_ParkRelPos5_y3 : 109|10@0+ (0.1,-50) [-50|50] "m"  CCU
 SG_ ADC_ParkRelPos5_x4 : 115|10@0+ (0.1,-50) [-50|50] "m"  CCU
 SG_ ADC_ParkRelPos5_y4 : 121|10@0+ (0.1,-50) [-50|50] "m"  CCU
 SG_ ADC_ParkRelPos6_x1 : 143|10@0+ (0.1,-50) [-50|50] "m"  CCU
 SG_ ADC_ParkRelPos6_y1 : 149|10@0+ (0.1,-50) [-50|50] "m"  CCU
 SG_ ADC_ParkRelPos6_x2 : 155|10@0+ (0.1,-50) [-50|50] "m"  CCU
 SG_ ADC_ParkRelPos6_y2 : 161|10@0+ (0.1,-50) [-50|50] "m"  CCU
 SG_ ADC_ParkRelPos6_x3 : 183|10@0+ (0.1,-50) [-50|50] "m"  CCU
 SG_ ADC_ParkRelPos6_y3 : 189|10@0+ (0.1,-50) [-50|50] "m"  CCU
 SG_ ADC_ParkRelPos6_x4 : 195|10@0+ (0.1,-50) [-50|50] "m"  CCU
 SG_ ADC_ParkRelPos6_y4 : 201|10@0+ (0.1,-50) [-50|50] "m"  CCU
 SG_ ADC_ParkRelPos7_x1 : 223|10@0+ (0.1,-50) [-50|50] "m"  CCU
 SG_ ADC_ParkRelPos7_y1 : 229|10@0+ (0.1,-50) [-50|50] "m"  CCU
 SG_ ADC_ParkRelPos7_x2 : 235|10@0+ (0.1,-50) [-50|50] "m"  CCU
 SG_ ADC_ParkRelPos7_y2 : 241|10@0+ (0.1,-50) [-50|50] "m"  CCU
 SG_ ADC_ParkRelPos7_x3 : 263|10@0+ (0.1,-50) [-50|50] "m"  CCU
 SG_ ADC_ParkRelPos7_y3 : 269|10@0+ (0.1,-50) [-50|50] "m"  CCU
 SG_ ADC_ParkRelPos7_x4 : 275|10@0+ (0.1,-50) [-50|50] "m"  CCU
 SG_ ADC_ParkRelPos7_y4 : 281|10@0+ (0.1,-50) [-50|50] "m"  CCU
 SG_ ADC_ParkRelPos8_x1 : 303|10@0+ (0.1,-50) [-50|50] "m"  CCU
 SG_ ADC_ParkRelPos8_y1 : 309|10@0+ (0.1,-50) [-50|50] "m"  CCU
 SG_ ADC_ParkRelPos8_x2 : 315|10@0+ (0.1,-50) [-50|50] "m"  CCU
 SG_ ADC_ParkRelPos8_y2 : 321|10@0+ (0.1,-50) [-50|50] "m"  CCU
 SG_ ADC_ParkRelPos8_x3 : 343|10@0+ (0.1,-50) [-50|50] "m"  CCU
 SG_ ADC_ParkRelPos8_y3 : 349|10@0+ (0.1,-50) [-50|50] "m"  CCU
 SG_ ADC_ParkRelPos8_x4 : 355|10@0+ (0.1,-50) [-50|50] "m"  CCU
 SG_ ADC_ParkRelPos8_y4 : 361|10@0+ (0.1,-50) [-50|50] "m"  CCU
 SG_ ADC_ParkPosn5_ID : 383|4@0+ (1,0) [0|15] ""  CCU
 SG_ ADC_MnvrOrintChng5 : 379|2@0+ (1,0) [0|3] ""  CCU
 SG_ ADC_TarParkSt_Posn5 : 377|3@0+ (1,0) [0|7] ""  CCU
 SG_ ADC_ParkChkSrc_Posn5 : 390|3@0+ (1,0) [0|3] ""  CCU
 SG_ ADC_ParkPosn6_ID : 387|4@0+ (1,0) [0|15] ""  CCU

BO_ 1110 ADC_17: 64 ADC
 SG_ ADC_PktType : 7|8@0+ (1,0) [0|127] ""  CCU
 SG_ ADC_CANTRACEStatus0 : 15|8@0+ (1,0) [0|255] ""  CCU
 SG_ ADC_CANTRACEStatus1 : 23|8@0+ (1,0) [0|255] ""  CCU
 SG_ ADC_CANTRACEStatus2 : 31|8@0+ (1,0) [0|255] ""  CCU
 SG_ ADC_CANTRACEStatus3 : 39|8@0+ (1,0) [0|255] ""  CCU
 SG_ ADC_CANTRACEStatus4 : 47|8@0+ (1,0) [0|255] ""  CCU
 SG_ ADC_CANTRACEStatus5 : 55|8@0+ (1,0) [0|255] ""  CCU
 SG_ ADC_CANTRACEStatus6 : 63|8@0+ (1,0) [0|255] ""  CCU
 SG_ ADC_CANTRACEStatus7 : 71|8@0+ (1,0) [0|255] ""  CCU
 SG_ ADC_CANTRACEStatus8 : 79|8@0+ (1,0) [0|255] ""  CCU
 SG_ ADC_CANTRACEStatus9 : 87|8@0+ (1,0) [0|255] ""  CCU
 SG_ ADC_CANTRACEStatus10 : 95|8@0+ (1,0) [0|255] ""  CCU
 SG_ ADC_CANTRACEStatus11 : 103|8@0+ (1,0) [0|255] ""  CCU
 SG_ ADC_CANTRACEStatus12 : 111|8@0+ (1,0) [0|255] ""  CCU
 SG_ ADC_CANTRACEStatus13 : 119|8@0+ (1,0) [0|255] ""  CCU
 SG_ ADC_CANTRACEStatus14 : 127|8@0+ (1,0) [0|255] ""  CCU
 SG_ ADC_CANTRACEStatus15 : 135|8@0+ (1,0) [0|255] ""  CCU
 SG_ ADC_CANTRACEStatus16 : 143|8@0+ (1,0) [0|255] ""  CCU
 SG_ ADC_CANTRACEStatus17 : 151|8@0+ (1,0) [0|255] ""  CCU
 SG_ ADC_CANTRACEStatus18 : 159|8@0+ (1,0) [0|255] ""  CCU
 SG_ ADC_CANTRACEStatus19 : 167|8@0+ (1,0) [0|255] ""  CCU
 SG_ ADC_CANTRACEStatus20 : 175|8@0+ (1,0) [0|255] ""  CCU
 SG_ ADC_CANTRACEStatus21 : 183|8@0+ (1,0) [0|255] ""  CCU
 SG_ ADC_CANTRACEStatus22 : 191|8@0+ (1,0) [0|255] ""  CCU
 SG_ ADC_CANTRACEStatus23 : 199|8@0+ (1,0) [0|255] ""  CCU
 SG_ ADC_CANTRACEStatus24 : 207|8@0+ (1,0) [0|255] ""  CCU
 SG_ ADC_CANTRACEStatus25 : 215|8@0+ (1,0) [0|255] ""  CCU
 SG_ ADC_CANTRACEStatus26 : 223|8@0+ (1,0) [0|255] ""  CCU
 SG_ ADC_CANTRACEStatus27 : 231|8@0+ (1,0) [0|255] ""  CCU
 SG_ ADC_CANTRACEStatus28 : 239|8@0+ (1,0) [0|255] ""  CCU
 SG_ ADC_CANTRACEStatus29 : 247|8@0+ (1,0) [0|255] ""  CCU
 SG_ ADC_CANTRACEStatus30 : 255|8@0+ (1,0) [0|255] ""  CCU
 SG_ ADC_CANTRACEStatus31 : 263|8@0+ (1,0) [0|255] ""  CCU
 SG_ ADC_CANTRACEStatus32 : 271|8@0+ (1,0) [0|255] ""  CCU
 SG_ ADC_CANTRACEStatus33 : 279|8@0+ (1,0) [0|255] ""  CCU
 SG_ ADC_CANTRACEStatus34 : 287|8@0+ (1,0) [0|255] ""  CCU
 SG_ ADC_CANTRACEStatus35 : 295|8@0+ (1,0) [0|255] ""  CCU
 SG_ ADC_CANTRACEStatus36 : 303|8@0+ (1,0) [0|255] ""  CCU
 SG_ ADC_CANTRACEStatus37 : 311|8@0+ (1,0) [0|255] ""  CCU
 SG_ ADC_CANTRACEStatus38 : 319|8@0+ (1,0) [0|255] ""  CCU
 SG_ ADC_CANTRACEStatus39 : 327|8@0+ (1,0) [0|255] ""  CCU
 SG_ ADC_CANTRACEStatus40 : 335|8@0+ (1,0) [0|255] ""  CCU
 SG_ ADC_CANTRACEStatus41 : 343|8@0+ (1,0) [0|255] ""  CCU
 SG_ ADC_CANTRACEStatus42 : 351|8@0+ (1,0) [0|255] ""  CCU
 SG_ ADC_CANTRACEStatus43 : 359|8@0+ (1,0) [0|255] ""  CCU
 SG_ ADC_CANTRACEStatus44 : 367|8@0+ (1,0) [0|255] ""  CCU
 SG_ ADC_CANTRACEStatus45 : 375|8@0+ (1,0) [0|255] ""  CCU
 SG_ ADC_CANTRACEStatus46 : 383|8@0+ (1,0) [0|255] ""  CCU
 SG_ ADC_CANTRACEStatus47 : 391|8@0+ (1,0) [0|255] ""  CCU
 SG_ ADC_CANTRACEStatus48 : 399|8@0+ (1,0) [0|255] ""  CCU
 SG_ ADC_CANTRACEStatus49 : 407|8@0+ (1,0) [0|255] ""  CCU
 SG_ ADC_CANTRACEStatus50 : 415|8@0+ (1,0) [0|255] ""  CCU
 SG_ ADC_CANTRACEStatus51 : 423|8@0+ (1,0) [0|255] ""  CCU
 SG_ ADC_CANTRACEStatus52 : 431|8@0+ (1,0) [0|255] ""  CCU
 SG_ ADC_CANTRACEStatus53 : 439|8@0+ (1,0) [0|255] ""  CCU
 SG_ ADC_CANTRACEStatus54 : 447|8@0+ (1,0) [0|255] ""  CCU
 SG_ ADC_CANTRACEStatus55 : 455|8@0+ (1,0) [0|255] ""  CCU
 SG_ ADC_CANTRACEStatus56 : 463|8@0+ (1,0) [0|255] ""  CCU
 SG_ ADC_CANTRACEStatus57 : 471|8@0+ (1,0) [0|255] ""  CCU
 SG_ ADC_CANTRACEStatus58 : 479|8@0+ (1,0) [0|255] ""  CCU
 SG_ ADC_CANTRACEStatus59 : 487|8@0+ (1,0) [0|255] ""  CCU
 SG_ ADC_CANTRACEStatus60 : 495|8@0+ (1,0) [0|255] ""  CCU
 SG_ ADC_CANTRACEStatus61 : 503|8@0+ (1,0) [0|255] ""  CCU
 SG_ ADC_CANTRACEStatus62 : 511|8@0+ (1,0) [0|255] ""  CCU

BO_ 1111 ADC_18: 64 ADC
 SG_ ADC_AlarmPktType : 7|8@0+ (1,0) [0|255] ""  CCU
 SG_ ADC_AlarmTotal : 15|8@0+ (1,0) [0|255] ""  CCU
 SG_ ADC_AlarmNum : 23|8@0+ (1,0) [0|255] ""  CCU
 SG_ ADC_AlarmFaultId0 : 31|16@0+ (1,0) [0|65535] ""  CCU
 SG_ ADC_AlarmKeyPara0 : 47|16@0+ (1,0) [0|65535] ""  CCU
 SG_ ADC_AlarmFaultId1 : 63|16@0+ (1,0) [0|65535] ""  CCU
 SG_ ADC_AlarmKeyPara1 : 79|16@0+ (1,0) [0|65535] ""  CCU
 SG_ ADC_AlarmFaultId2 : 95|16@0+ (1,0) [0|65535] ""  CCU
 SG_ ADC_AlarmKeyPara2 : 111|16@0+ (1,0) [0|65535] ""  CCU
 SG_ ADC_AlarmFaultId3 : 127|16@0+ (1,0) [0|65535] ""  CCU
 SG_ ADC_AlarmKeyPara3 : 143|16@0+ (1,0) [0|65535] ""  CCU
 SG_ ADC_AlarmFaultId4 : 159|16@0+ (1,0) [0|65535] ""  CCU
 SG_ ADC_AlarmKeyPara4 : 175|16@0+ (1,0) [0|65535] ""  CCU
 SG_ ADC_AlarmFaultId5 : 191|16@0+ (1,0) [0|65535] ""  CCU
 SG_ ADC_AlarmKeyPara5 : 207|16@0+ (1,0) [0|65535] ""  CCU
 SG_ ADC_AlarmFaultId6 : 223|16@0+ (1,0) [0|65535] ""  CCU
 SG_ ADC_AlarmKeyPara6 : 239|16@0+ (1,0) [0|65535] ""  CCU
 SG_ ADC_AlarmFaultId7 : 255|16@0+ (1,0) [0|65535] ""  CCU
 SG_ ADC_AlarmKeyPara7 : 271|16@0+ (1,0) [0|65535] ""  CCU
 SG_ ADC_AlarmFaultId8 : 287|16@0+ (1,0) [0|65535] ""  CCU
 SG_ ADC_AlarmKeyPara8 : 303|16@0+ (1,0) [0|65535] ""  CCU
 SG_ ADC_AlarmFaultId9 : 319|16@0+ (1,0) [0|65535] ""  CCU
 SG_ ADC_AlarmKeyPara9 : 335|16@0+ (1,0) [0|65535] ""  CCU
 SG_ ADC_AlarmFaultId10 : 351|16@0+ (1,0) [0|65535] ""  CCU
 SG_ ADC_AlarmKeyPara10 : 367|16@0+ (1,0) [0|65535] ""  CCU
 SG_ ADC_AlarmFaultId11 : 383|16@0+ (1,0) [0|65535] ""  CCU
 SG_ ADC_AlarmKeyPara11 : 399|16@0+ (1,0) [0|65535] ""  CCU
 SG_ ADC_AlarmFaultId12 : 415|16@0+ (1,0) [0|65535] ""  CCU
 SG_ ADC_AlarmKeyPara12 : 431|16@0+ (1,0) [0|65535] ""  CCU
 SG_ ADC_AlarmFaultId13 : 447|16@0+ (1,0) [0|65535] ""  CCU
 SG_ ADC_AlarmKeyPara13 : 463|16@0+ (1,0) [0|65535] ""  CCU
 SG_ ADC_AlarmFaultId14 : 479|16@0+ (1,0) [0|65535] ""  CCU
 SG_ ADC_AlarmKeyPara14 : 495|16@0+ (1,0) [0|65535] ""  CCU
 SG_ ADC_AlarmCheckSum : 511|8@0+ (1,0) [0|255] ""  CCU

BO_ 365 ADC_19: 64 ADC
 SG_ ADC_19_CRC : 7|16@0+ (1,0) [0|65535] ""  CCU,CCURT2,RT2_C3
 SG_ ADC_19_Counter : 23|8@0+ (1,0) [0|255] ""  CCU,CCURT2,RT2_C3
 SG_ ADC_Obj02_ID : 411|6@0+ (1,0) [0|63] ""  CCU
 SG_ ADC_Obj03Dist : 55|12@0+ (0.1,0) [0|409.5] "m"  CCU
 SG_ ADC_Obj03HoztAngSpd : 264|10@0+ (0.2,-50) [-50|150] "deg/s"  CCU
 SG_ ADC_Obj03LeftAngle : 159|11@0+ (0.05,-40) [-40|40] "deg"  CCU
 SG_ ADC_Obj03RightAngle : 164|11@0+ (0.05,-40) [-40|40] "deg"  CCU
 SG_ ADC_Obj03BottomAngle : 346|7@0+ (0.2,-12) [-12|13.4] "deg"  CCU
 SG_ ADC_Obj03TopAngle : 355|7@0+ (0.2,-12) [-12|13.4] "deg"  CCU
 SG_ ADC_Obj04_ID : 425|6@0+ (1,0) [0|63] ""  CCU
 SG_ ADC_Obj01_ID : 421|6@0+ (1,0) [0|63] ""  CCU
 SG_ ADC_Obj04Dist : 59|12@0+ (0.1,0) [0|409.5] "m"  CCU
 SG_ ADC_Obj04HoztAngSpd : 286|10@0+ (0.2,-50) [-50|150] "deg/s"  CCU
 SG_ ADC_Obj04LeftAngle : 169|11@0+ (0.05,-40) [-40|40] "deg"  CCU
 SG_ ADC_Obj04RightAngle : 190|11@0+ (0.05,-40) [-40|40] "deg"  CCU
 SG_ ADC_Obj04BottomAngle : 364|7@0+ (0.2,-12) [-12|13.4] "deg"  CCU
 SG_ ADC_Obj04TopAngle : 373|7@0+ (0.2,-12) [-12|13.4] "deg"  CCU
 SG_ ADC_Obj03_ID : 431|6@0+ (1,0) [0|63] ""  CCU
 SG_ ADC_Obj06_ID : 435|6@0+ (1,0) [0|63] ""  CCU
 SG_ ADC_Obj01Dist : 31|12@0+ (0.1,0) [0|409.5] "m"  CCU
 SG_ ADC_Obj01HoztAngSpd : 252|10@0+ (0.2,-50) [-50|150] "deg/s"  CCU
 SG_ ADC_Obj01LeftAngle : 107|11@0+ (0.05,-40) [-40|40] "deg"  CCU
 SG_ ADC_Obj01RightAngle : 112|11@0+ (0.05,-40) [-40|40] "deg"  CCU
 SG_ ADC_Obj01BottomAngle : 326|7@0+ (0.2,-12) [-12|13.4] "deg"  CCU
 SG_ ADC_Obj01TopAngle : 335|7@0+ (0.2,-12) [-12|13.4] "deg"  CCU
 SG_ ADC_Obj05Dist : 79|12@0+ (0.1,0) [0|409.5] "m"  CCU
 SG_ ADC_Obj05HoztAngSpd : 292|10@0+ (0.2,-50) [-50|150] "deg/s"  CCU
 SG_ ADC_Obj05LeftAngle : 195|11@0+ (0.05,-40) [-40|40] "deg"  CCU
 SG_ ADC_Obj05RightAngle : 200|11@0+ (0.05,-40) [-40|40] "deg"  CCU
 SG_ ADC_Obj05BottomAngle : 382|7@0+ (0.2,-12) [-12|13.4] "deg"  CCU
 SG_ ADC_Obj05TopAngle : 391|7@0+ (0.2,-12) [-12|13.4] "deg"  CCU
 SG_ ADC_Obj06Dist : 83|12@0+ (0.1,0) [0|409.5] "m"  CCU
 SG_ ADC_Obj06HoztAngSpd : 298|10@0+ (0.2,-50) [-50|150] "deg/s"  CCU
 SG_ ADC_Obj06LeftAngle : 221|11@0+ (0.05,-40) [-40|40] "deg"  CCU
 SG_ ADC_Obj06RightAngle : 226|11@0+ (0.05,-40) [-40|40] "deg"  CCU
 SG_ ADC_Obj06BottomAngle : 384|7@0+ (0.2,-12) [-12|13.4] "deg"  CCU
 SG_ ADC_Obj02Dist : 35|12@0+ (0.1,0) [0|409.5] "m"  CCU
 SG_ ADC_Obj02HoztAngSpd : 258|10@0+ (0.2,-50) [-50|150] "deg/s"  CCU
 SG_ ADC_Obj02LeftAngle : 133|11@0+ (0.05,-40) [-40|40] "deg"  CCU
 SG_ ADC_Obj02RightAngle : 138|11@0+ (0.05,-40) [-40|40] "deg"  CCU
 SG_ ADC_Obj02BottomAngle : 328|7@0+ (0.2,-12) [-12|13.4] "deg"  CCU
 SG_ ADC_Obj02TopAngle : 337|7@0+ (0.2,-12) [-12|13.4] "deg"  CCU
 SG_ ADC_Obj06TopAngle : 393|7@0+ (0.2,-12) [-12|13.4] "deg"  CCU
 SG_ ADC_Obj07Dist : 103|12@0+ (0.1,0) [0|409.5] "m"  CCU
 SG_ ADC_Obj07HoztAngSpd : 304|10@0+ (0.2,-50) [-50|150] "deg/s"  CCU
 SG_ ADC_Obj07LeftAngle : 247|11@0+ (0.05,-40) [-40|40] "deg"  CCU
 SG_ ADC_Obj07BottomAngle : 402|7@0+ (0.2,-12) [-12|13.4] "deg"  CCU
 SG_ ADC_Obj05_ID : 445|6@0+ (1,0) [0|63] ""  CCU
 SG_ ADC_Obj04Typ : 467|4@0+ (1,0) [0|15] ""  CCU
 SG_ ADC_Obj04Dir : 511|2@0+ (1,0) [0|3] ""  CCU
 SG_ ADC_ADBCamSt : 463|4@0+ (1,0) [0|15] ""  CCU
 SG_ ADC_Obj03Dir : 499|2@0+ (1,0) [0|3] ""  CCU
 SG_ ADC_Obj02Dir : 497|2@0+ (1,0) [0|3] ""  CCU
 SG_ ADC_Obj02Typ : 503|4@0+ (1,0) [0|15] ""  CCU
 SG_ ADC_Obj03Typ : 459|4@0+ (1,0) [0|15] ""  CCU
 SG_ ADC_Obj01Typ : 495|4@0+ (1,0) [0|15] ""  CCU
 SG_ ADC_Obj01Dir : 449|2@0+ (1,0) [0|3] ""  CCU
 SG_ ADC_ObjNum : 471|4@0+ (1,0) [0|15] ""  CCU
 SG_ ADC_AmbLightCondition : 479|4@0+ (1,0) [0|15] ""  CCU,CCURT2,RT2_C3
 SG_ ADC_TrafficStyle : 487|4@0+ (1,0) [0|15] ""  CCU
 SG_ ADC_Obj05Typ : 475|4@0+ (1,0) [0|15] ""  CCU
 SG_ ADC_Obj05Dir : 509|2@0+ (1,0) [0|3] ""  CCU
 SG_ ADC_Obj06Typ : 483|4@0+ (1,0) [0|15] ""  CCU
 SG_ ADC_Obj06Dir : 507|2@0+ (1,0) [0|3] ""  CCU
 SG_ ADC_Obj07_ID : 455|6@0+ (1,0) [0|63] ""  CCU
 SG_ ADC_Obj07Typ : 491|4@0+ (1,0) [0|15] ""  CCU
 SG_ ADC_Obj07Dir : 505|2@0+ (1,0) [0|3] ""  CCU

BO_ 366 ADC_20: 32 ADC
 SG_ ADC_20_CRC : 7|16@0+ (1,0) [0|65535] ""  CCU
 SG_ ADC_20_Counter : 23|8@0+ (1,0) [0|255] ""  CCU
 SG_ ADC_Obj07RightAngle : 59|11@0+ (0.05,-40) [-40|40] "deg"  CCU
 SG_ ADC_Obj07TopAngle : 160|7@0+ (0.2,-12) [-12|13.4] "deg"  CCU
 SG_ ADC_Obj08_ID : 223|6@0+ (1,0) [0|63] ""  CCU
 SG_ ADC_Obj08Typ : 237|4@0+ (1,0) [0|15] ""  CCU
 SG_ ADC_Obj08Dir : 241|2@0+ (1,0) [0|3] ""  CCU
 SG_ ADC_Obj08Dist : 31|12@0+ (0.1,0) [0|409.5] "m"  CCU
 SG_ ADC_Obj08HoztAngSpd : 142|10@0+ (0.2,-50) [-50|150] "deg/s"  CCU
 SG_ ADC_Obj08LeftAngle : 64|11@0+ (0.05,-40) [-40|40] "deg"  CCU
 SG_ ADC_Obj08RightAngle : 85|11@0+ (0.05,-40) [-40|40] "deg"  CCU
 SG_ ADC_Obj08BottomAngle : 169|7@0+ (0.2,-12) [-12|13.4] "deg"  CCU
 SG_ ADC_Obj08TopAngle : 178|7@0+ (0.2,-12) [-12|13.4] "deg"  CCU
 SG_ ADC_Obj09_ID : 217|6@0+ (1,0) [0|63] ""  CCU
 SG_ ADC_Obj09Typ : 233|4@0+ (1,0) [0|15] ""  CCU
 SG_ ADC_Obj09Dir : 253|2@0+ (1,0) [0|3] ""  CCU
 SG_ ADC_Obj09Dist : 35|12@0+ (0.1,0) [0|409.5] "m"  CCU
 SG_ ADC_Obj09HoztAngSpd : 148|10@0+ (0.2,-50) [-50|150] "deg/s"  CCU
 SG_ ADC_Obj09LeftAngle : 90|11@0+ (0.05,-40) [-40|40] "deg"  CCU
 SG_ ADC_Obj09RightAngle : 111|11@0+ (0.05,-40) [-40|40] "deg"  CCU
 SG_ ADC_Obj09BottomAngle : 187|7@0+ (0.2,-12) [-12|13.4] "deg"  CCU
 SG_ ADC_Obj09TopAngle : 196|7@0+ (0.2,-12) [-12|13.4] "deg"  CCU
 SG_ ADC_Obj010_ID : 227|6@0+ (1,0) [0|63] ""  CCU
 SG_ ADC_Obj010Typ : 245|4@0+ (1,0) [0|15] ""  CCU
 SG_ ADC_Obj010Dir : 255|2@0+ (1,0) [0|3] ""  CCU
 SG_ ADC_Obj010Dist : 55|12@0+ (0.1,0) [0|409.5] "m"  CCU
 SG_ ADC_Obj010HoztAngSpd : 154|10@0+ (0.2,-50) [-50|150] "deg/s"  CCU
 SG_ ADC_Obj010LeftAngle : 116|11@0+ (0.05,-40) [-40|40] "deg"  CCU
 SG_ ADC_Obj010RightAngle : 121|11@0+ (0.05,-40) [-40|40] "deg"  CCU
 SG_ ADC_Obj010BottomAngle : 205|7@0+ (0.2,-12) [-12|13.4] "deg"  CCU
 SG_ ADC_Obj010TopAngle : 214|7@0+ (0.2,-12) [-12|13.4] "deg"  CCU

CM_ SG_ 971 ADC_MnvrOrintChng6 "ADC_MnvrOrintChng6";
CM_ SG_ 971 ADC_TarParkSt_Posn6 "ADC_TarParkSt_Posn6";
CM_ SG_ 971 ADC_ParkChkSrc_Posn6 "ADC_ParkChkSrc_Posn6";
CM_ SG_ 971 ADC_ParkPosn7_ID "ADC_ParkPosn7_ID";
CM_ SG_ 971 ADC_MnvrOrintChng7 "ADC_MnvrOrintChng7";
CM_ SG_ 971 ADC_TarParkSt_Posn7 "ADC_TarParkSt_Posn7";
CM_ SG_ 971 ADC_ParkChkSrc_Posn7 "ADC_ParkChkSrc_Posn7";
CM_ SG_ 971 ADC_ParkPosn8_ID "ADC_ParkPosn8_ID";
CM_ SG_ 971 ADC_MnvrOrintChng8 "ADC_MnvrOrintChng8";
CM_ SG_ 971 ADC_TarParkSt_Posn8 "ADC_TarParkSt_Posn8";
CM_ SG_ 971 ADC_ParkChkSrc_Posn8 "ADC_ParkChkSrc_Posn8";
CM_ SG_ 971 ADC_ParkRelPos5_x1 "ADC_ParkRelPos5_x1";
CM_ SG_ 971 ADC_ParkRelPos5_y1 "ADC_ParkRelPos5_y1";
CM_ SG_ 971 ADC_ParkRelPos5_x2 "ADC_ParkRelPos5_x2";
CM_ SG_ 971 ADC_ParkRelPos5_y2 "ADC_ParkRelPos5_y2";
CM_ SG_ 971 ADC_ParkRelPos5_x3 "ADC_ParkRelPos5_x3";
CM_ SG_ 971 ADC_ParkRelPos5_y3 "ADC_ParkRelPos5_y3";
CM_ SG_ 971 ADC_ParkRelPos5_x4 "ADC_ParkRelPos5_x4";
CM_ SG_ 971 ADC_ParkRelPos5_y4 "ADC_ParkRelPos5_y4";
CM_ SG_ 971 ADC_ParkRelPos6_x1 "ADC_ParkRelPos6_x1";
CM_ SG_ 971 ADC_ParkRelPos6_y1 "ADC_ParkRelPos6_y1";
CM_ SG_ 971 ADC_ParkRelPos6_x2 "ADC_ParkRelPos6_x2";
CM_ SG_ 971 ADC_ParkRelPos6_y2 "ADC_ParkRelPos6_y2";
CM_ SG_ 971 ADC_ParkRelPos6_x3 "ADC_ParkRelPos6_x3";
CM_ SG_ 971 ADC_ParkRelPos6_y3 "ADC_ParkRelPos6_y3";
CM_ SG_ 971 ADC_ParkRelPos6_x4 "ADC_ParkRelPos6_x4";
CM_ SG_ 971 ADC_ParkRelPos6_y4 "ADC_ParkRelPos6_y4";
CM_ SG_ 971 ADC_ParkRelPos7_x1 "ADC_ParkRelPos7_x1";
CM_ SG_ 971 ADC_ParkRelPos7_y1 "ADC_ParkRelPos7_y1";
CM_ SG_ 971 ADC_ParkRelPos7_x2 "ADC_ParkRelPos7_x2";
CM_ SG_ 971 ADC_ParkRelPos7_y2 "ADC_ParkRelPos7_y2";
CM_ SG_ 971 ADC_ParkRelPos7_x3 "ADC_ParkRelPos7_x3";
CM_ SG_ 971 ADC_ParkRelPos7_y3 "ADC_ParkRelPos7_y3";
CM_ SG_ 971 ADC_ParkRelPos7_x4 "ADC_ParkRelPos7_x4";
CM_ SG_ 971 ADC_ParkRelPos7_y4 "ADC_ParkRelPos7_y4";
CM_ SG_ 971 ADC_ParkRelPos8_x1 "ADC_ParkRelPos8_x1";
CM_ SG_ 971 ADC_ParkRelPos8_y1 "ADC_ParkRelPos8_y1";
CM_ SG_ 971 ADC_ParkRelPos8_x2 "ADC_ParkRelPos8_x2";
CM_ SG_ 971 ADC_ParkRelPos8_y2 "ADC_ParkRelPos8_y2";
CM_ SG_ 971 ADC_ParkRelPos8_x3 "ADC_ParkRelPos8_x3";
CM_ SG_ 971 ADC_ParkRelPos8_y3 "ADC_ParkRelPos8_y3";
CM_ SG_ 971 ADC_ParkRelPos8_x4 "ADC_ParkRelPos8_x4";
CM_ SG_ 971 ADC_ParkRelPos8_y4 "ADC_ParkRelPos8_y4";
CM_ SG_ 971 ADC_ParkPosn5_ID "ADC_ParkPosn5_ID";
CM_ SG_ 971 ADC_MnvrOrintChng5 "ADC_MnvrOrintChng5";
CM_ SG_ 971 ADC_TarParkSt_Posn5 "ADC_TarParkSt_Posn5";
CM_ SG_ 971 ADC_ParkChkSrc_Posn5 "ADC_ParkChkSrc_Posn5";
CM_ SG_ 971 ADC_ParkPosn6_ID "ADC_ParkPosn6_ID";
CM_ SG_ 1110 ADC_PktType "Messag type";
CM_ SG_ 1110 ADC_CANTRACEStatus0 "ADC_CANTRACE_Status0";
CM_ SG_ 1110 ADC_CANTRACEStatus1 "ADC_CANTRACE_Status1";
CM_ SG_ 1110 ADC_CANTRACEStatus2 "ADC_CANTRACE_Status2";
CM_ SG_ 1110 ADC_CANTRACEStatus3 "ADC_CANTRACE_Status3";
CM_ SG_ 1110 ADC_CANTRACEStatus4 "ADC_CANTRACE_Status4";
CM_ SG_ 1110 ADC_CANTRACEStatus5 "ADC_CANTRACE_Status5";
CM_ SG_ 1110 ADC_CANTRACEStatus6 "ADC_CANTRACE_Status6";
CM_ SG_ 1110 ADC_CANTRACEStatus7 "ADC_CANTRACE_Status7";
CM_ SG_ 1110 ADC_CANTRACEStatus8 "ADC_CANTRACE_Status8";
CM_ SG_ 1110 ADC_CANTRACEStatus9 "ADC_CANTRACE_Status9";
CM_ SG_ 1110 ADC_CANTRACEStatus10 "ADC_CANTRACE_Status10";
CM_ SG_ 1110 ADC_CANTRACEStatus11 "ADC_CANTRACE_Status11";
CM_ SG_ 1110 ADC_CANTRACEStatus12 "ADC_CANTRACE_Status12";
CM_ SG_ 1110 ADC_CANTRACEStatus13 "ADC_CANTRACE_Status13";
CM_ SG_ 1110 ADC_CANTRACEStatus14 "ADC_CANTRACE_Status14";
CM_ SG_ 1110 ADC_CANTRACEStatus15 "ADC_CANTRACE_Status15";
CM_ SG_ 1110 ADC_CANTRACEStatus16 "ADC_CANTRACE_Status16";
CM_ SG_ 1110 ADC_CANTRACEStatus17 "ADC_CANTRACE_Status17";
CM_ SG_ 1110 ADC_CANTRACEStatus18 "ADC_CANTRACE_Status18";
CM_ SG_ 1110 ADC_CANTRACEStatus19 "ADC_CANTRACE_Status19";
CM_ SG_ 1110 ADC_CANTRACEStatus20 "ADC_CANTRACE_Status20";
CM_ SG_ 1110 ADC_CANTRACEStatus21 "ADC_CANTRACE_Status21";
CM_ SG_ 1110 ADC_CANTRACEStatus22 "ADC_CANTRACE_Status22";
CM_ SG_ 1110 ADC_CANTRACEStatus23 "ADC_CANTRACE_Status23";
CM_ SG_ 1110 ADC_CANTRACEStatus24 "ADC_CANTRACE_Status24";
CM_ SG_ 1110 ADC_CANTRACEStatus25 "ADC_CANTRACE_Status25";
CM_ SG_ 1110 ADC_CANTRACEStatus26 "ADC_CANTRACE_Status26";
CM_ SG_ 1110 ADC_CANTRACEStatus27 "ADC_CANTRACE_Status27";
CM_ SG_ 1110 ADC_CANTRACEStatus28 "ADC_CANTRACE_Status28";
CM_ SG_ 1110 ADC_CANTRACEStatus29 "ADC_CANTRACE_Status29";
CM_ SG_ 1110 ADC_CANTRACEStatus30 "ADC_CANTRACE_Status30";
CM_ SG_ 1110 ADC_CANTRACEStatus31 "ADC_CANTRACE_Status31";
CM_ SG_ 1110 ADC_CANTRACEStatus32 "ADC_CANTRACE_Status32";
CM_ SG_ 1110 ADC_CANTRACEStatus33 "ADC_CANTRACE_Status33";
CM_ SG_ 1110 ADC_CANTRACEStatus34 "ADC_CANTRACE_Status34";
CM_ SG_ 1110 ADC_CANTRACEStatus35 "ADC_CANTRACE_Status35";
CM_ SG_ 1110 ADC_CANTRACEStatus36 "ADC_CANTRACE_Status36";
CM_ SG_ 1110 ADC_CANTRACEStatus37 "ADC_CANTRACE_Status37";
CM_ SG_ 1110 ADC_CANTRACEStatus38 "ADC_CANTRACE_Status38";
CM_ SG_ 1110 ADC_CANTRACEStatus39 "ADC_CANTRACE_Status39";
CM_ SG_ 1110 ADC_CANTRACEStatus40 "ADC_CANTRACE_Status40";
CM_ SG_ 1110 ADC_CANTRACEStatus41 "ADC_CANTRACE_Status41";
CM_ SG_ 1110 ADC_CANTRACEStatus42 "ADC_CANTRACE_Status42";
CM_ SG_ 1110 ADC_CANTRACEStatus43 "ADC_CANTRACE_Status43";
CM_ SG_ 1110 ADC_CANTRACEStatus44 "ADC_CANTRACE_Status44";
CM_ SG_ 1110 ADC_CANTRACEStatus45 "ADC_CANTRACE_Status45";
CM_ SG_ 1110 ADC_CANTRACEStatus46 "ADC_CANTRACE_Status46";
CM_ SG_ 1110 ADC_CANTRACEStatus47 "ADC_CANTRACE_Status47";
CM_ SG_ 1110 ADC_CANTRACEStatus48 "ADC_CANTRACE_Status48";
CM_ SG_ 1110 ADC_CANTRACEStatus49 "ADC_CANTRACE_Status49";
CM_ SG_ 1110 ADC_CANTRACEStatus50 "ADC_CANTRACE_Status50";
CM_ SG_ 1110 ADC_CANTRACEStatus51 "ADC_CANTRACE_Status51";
CM_ SG_ 1110 ADC_CANTRACEStatus52 "ADC_CANTRACE_Status52";
CM_ SG_ 1110 ADC_CANTRACEStatus53 "ADC_CANTRACE_Status53";
CM_ SG_ 1110 ADC_CANTRACEStatus54 "ADC_CANTRACE_Status54";
CM_ SG_ 1110 ADC_CANTRACEStatus55 "ADC_CANTRACE_Status55";
CM_ SG_ 1110 ADC_CANTRACEStatus56 "ADC_CANTRACE_Status56";
CM_ SG_ 1110 ADC_CANTRACEStatus57 "ADC_CANTRACE_Status57";
CM_ SG_ 1110 ADC_CANTRACEStatus58 "ADC_CANTRACE_Status58";
CM_ SG_ 1110 ADC_CANTRACEStatus59 "ADC_CANTRACE_Status59";
CM_ SG_ 1110 ADC_CANTRACEStatus60 "ADC_CANTRACE_Status60";
CM_ SG_ 1110 ADC_CANTRACEStatus61 "ADC_CANTRACE_Status61";
CM_ SG_ 1110 ADC_CANTRACEStatus62 "ADC_CANTRACE_Status62";
CM_ SG_ 1111 ADC_AlarmPktType "Messag type";
CM_ SG_ 1111 ADC_AlarmTotal "Alarm total";
CM_ SG_ 1111 ADC_AlarmNum "Alarm number";
CM_ SG_ 1111 ADC_AlarmFaultId0 "Alarm fault ID0";
CM_ SG_ 1111 ADC_AlarmKeyPara0 "Alarm key parameter0";
CM_ SG_ 1111 ADC_AlarmFaultId1 "Alarm fault ID1";
CM_ SG_ 1111 ADC_AlarmKeyPara1 "Alarm key parameter1";
CM_ SG_ 1111 ADC_AlarmFaultId2 "Alarm fault ID2";
CM_ SG_ 1111 ADC_AlarmKeyPara2 "Alarm key parameter2";
CM_ SG_ 1111 ADC_AlarmFaultId3 "Alarm fault ID3";
CM_ SG_ 1111 ADC_AlarmKeyPara3 "Alarm key parameter3";
CM_ SG_ 1111 ADC_AlarmFaultId4 "Alarm fault ID4";
CM_ SG_ 1111 ADC_AlarmKeyPara4 "Alarm key parameter4";
CM_ SG_ 1111 ADC_AlarmFaultId5 "Alarm fault ID5";
CM_ SG_ 1111 ADC_AlarmKeyPara5 "Alarm key parameter5";
CM_ SG_ 1111 ADC_AlarmFaultId6 "Alarm fault ID6";
CM_ SG_ 1111 ADC_AlarmKeyPara6 "Alarm key parameter6";
CM_ SG_ 1111 ADC_AlarmFaultId7 "Alarm fault ID7";
CM_ SG_ 1111 ADC_AlarmKeyPara7 "Alarm key parameter7";
CM_ SG_ 1111 ADC_AlarmFaultId8 "Alarm fault ID8";
CM_ SG_ 1111 ADC_AlarmKeyPara8 "Alarm key parameter8";
CM_ SG_ 1111 ADC_AlarmFaultId9 "Alarm fault ID9";
CM_ SG_ 1111 ADC_AlarmKeyPara9 "Alarm key parameter9";
CM_ SG_ 1111 ADC_AlarmFaultId10 "Alarm fault ID10";
CM_ SG_ 1111 ADC_AlarmKeyPara10 "Alarm key parameter10";
CM_ SG_ 1111 ADC_AlarmFaultId11 "Alarm fault ID11";
CM_ SG_ 1111 ADC_AlarmKeyPara11 "Alarm key parameter11";
CM_ SG_ 1111 ADC_AlarmFaultId12 "Alarm fault ID12";
CM_ SG_ 1111 ADC_AlarmKeyPara12 "Alarm key parameter12";
CM_ SG_ 1111 ADC_AlarmFaultId13 "Alarm fault ID13";
CM_ SG_ 1111 ADC_AlarmKeyPara13 "Alarm key parameter13";
CM_ SG_ 1111 ADC_AlarmFaultId14 "Alarm fault ID14";
CM_ SG_ 1111 ADC_AlarmKeyPara14 "Alarm key parameter14";
CM_ SG_ 1111 ADC_AlarmCheckSum "ADC_Alarm_CheckSum";
CM_ SG_ 365 ADC_19_CRC "E2E Profile 5 CRC";
CM_ SG_ 365 ADC_19_Counter "E2E Profile 5 Counter";
CM_ SG_ 365 ADC_Obj02_ID "ADC Adb Object2 ID";
CM_ SG_ 365 ADC_Obj03Dist "ADC Object3 Distance";
CM_ SG_ 365 ADC_Obj03HoztAngSpd "ADC Object3 Horizontal Angle Speed";
CM_ SG_ 365 ADC_Obj03LeftAngle "ADC Object3 Left Angle";
CM_ SG_ 365 ADC_Obj03RightAngle "ADC Object3 Right Angle";
CM_ SG_ 365 ADC_Obj03BottomAngle "ADC Object3 Bottom Angle";
CM_ SG_ 365 ADC_Obj03TopAngle "ADC Object3 Top Angle";
CM_ SG_ 365 ADC_Obj04_ID "ADC Adb Object4 ID";
CM_ SG_ 365 ADC_Obj01_ID "ADC Adb Object1 ID";
CM_ SG_ 365 ADC_Obj04Dist "ADC Object4 Distance";
CM_ SG_ 365 ADC_Obj04HoztAngSpd "ADC Object4 Horizontal Angle Speed";
CM_ SG_ 365 ADC_Obj04LeftAngle "ADC Object4 Left Angle";
CM_ SG_ 365 ADC_Obj04RightAngle "ADC Object4 Right Angle";
CM_ SG_ 365 ADC_Obj04BottomAngle "ADC Object4 Bottom Angle";
CM_ SG_ 365 ADC_Obj04TopAngle "ADC Object4 Top Angle";
CM_ SG_ 365 ADC_Obj03_ID "ADC Adb Object3 ID";
CM_ SG_ 365 ADC_Obj06_ID "ADC Adb Object6 ID";
CM_ SG_ 365 ADC_Obj01Dist "ADC Object1 Distance";
CM_ SG_ 365 ADC_Obj01HoztAngSpd "ADC Object1 Horizontal Angle Speed";
CM_ SG_ 365 ADC_Obj01LeftAngle "ADC Object1 Left Angle";
CM_ SG_ 365 ADC_Obj01RightAngle "ADC Object1 Right Angle";
CM_ SG_ 365 ADC_Obj01BottomAngle "ADC Object1 Bottom Angle";
CM_ SG_ 365 ADC_Obj01TopAngle "ADC Object1 Top Angle";
CM_ SG_ 365 ADC_Obj05Dist "ADC Object5 Distance";
CM_ SG_ 365 ADC_Obj05HoztAngSpd "ADC Object5 Horizontal Angle Speed";
CM_ SG_ 365 ADC_Obj05LeftAngle "ADC Object5 Left Angle";
CM_ SG_ 365 ADC_Obj05RightAngle "ADC Object5 Right Angle";
CM_ SG_ 365 ADC_Obj05BottomAngle "ADC Object5 Bottom Angle";
CM_ SG_ 365 ADC_Obj05TopAngle "ADC Object5 Top Angle";
CM_ SG_ 365 ADC_Obj06Dist "ADC Object6 Distance";
CM_ SG_ 365 ADC_Obj06HoztAngSpd "ADC Object6 Horizontal Angle Speed";
CM_ SG_ 365 ADC_Obj06LeftAngle "ADC Object6 Left Angle";
CM_ SG_ 365 ADC_Obj06RightAngle "ADC Object6 Right Angle";
CM_ SG_ 365 ADC_Obj06BottomAngle "ADC Object6 Bottom Angle";
CM_ SG_ 365 ADC_Obj02Dist "ADC Object2 Distance";
CM_ SG_ 365 ADC_Obj02HoztAngSpd "ADC Object2 Horizontal Angle Speed";
CM_ SG_ 365 ADC_Obj02LeftAngle "ADC Object2 Left Angle";
CM_ SG_ 365 ADC_Obj02RightAngle "ADC Object2 Right Angle";
CM_ SG_ 365 ADC_Obj02BottomAngle "ADC Object2 Bottom Angle";
CM_ SG_ 365 ADC_Obj02TopAngle "ADC Object2 Top Angle";
CM_ SG_ 365 ADC_Obj06TopAngle "ADC Object6 Top Angle";
CM_ SG_ 365 ADC_Obj07Dist "ADC Object7 Distance";
CM_ SG_ 365 ADC_Obj07HoztAngSpd "ADC Object7 Horizontal Angle Speed";
CM_ SG_ 365 ADC_Obj07LeftAngle "ADC Object7 Left Angle";
CM_ SG_ 365 ADC_Obj07BottomAngle "ADC Object7 Bottom Angle";
CM_ SG_ 365 ADC_Obj05_ID "ADC Adb Object5 ID";
CM_ SG_ 365 ADC_Obj04Typ "ADC Object4 Classification";
CM_ SG_ 365 ADC_Obj04Dir "ADC Object4 Direction";
CM_ SG_ 365 ADC_ADBCamSt "ADC Camera Status";
CM_ SG_ 365 ADC_Obj03Dir "ADC Object3 Direction";
CM_ SG_ 365 ADC_Obj02Dir "ADC Object2 Direction";
CM_ SG_ 365 ADC_Obj02Typ "ADC Object2 Classification";
CM_ SG_ 365 ADC_Obj03Typ "ADC Object3 Classification";
CM_ SG_ 365 ADC_Obj01Typ "ADC Object1 Classification";
CM_ SG_ 365 ADC_Obj01Dir "ADC Object1 Direction";
CM_ SG_ 365 ADC_ObjNum "ADC Object Number";
CM_ SG_ 365 ADC_AmbLightCondition "ADC Ambient Light Condition";
CM_ SG_ 365 ADC_TrafficStyle "ADC Object Traffic Style";
CM_ SG_ 365 ADC_Obj05Typ "ADC Object5 Classification";
CM_ SG_ 365 ADC_Obj05Dir "ADC Object5 Direction";
CM_ SG_ 365 ADC_Obj06Typ "ADC Object6 Classification";
CM_ SG_ 365 ADC_Obj06Dir "ADC Object6 Direction";
CM_ SG_ 365 ADC_Obj07_ID "ADC Adb Object7 ID";
CM_ SG_ 365 ADC_Obj07Typ "ADC Object7 Classification";
CM_ SG_ 365 ADC_Obj07Dir "ADC Object7 Direction";
CM_ SG_ 366 ADC_20_CRC "E2E Profile 5 CRC";
CM_ SG_ 366 ADC_20_Counter "E2E Profile 5 Counter";
CM_ SG_ 366 ADC_Obj07RightAngle "ADC Object7 Right Angle";
CM_ SG_ 366 ADC_Obj07TopAngle "ADC Object7 Top Angle";
CM_ SG_ 366 ADC_Obj08_ID "ADC Adb Object8 ID";
CM_ SG_ 366 ADC_Obj08Typ "ADC Object8 Classification";
CM_ SG_ 366 ADC_Obj08Dir "ADC Object8 Direction";
CM_ SG_ 366 ADC_Obj08Dist "ADC Object8 Distance";
CM_ SG_ 366 ADC_Obj08HoztAngSpd "ADC Object8 Horizontal Angle Speed";
CM_ SG_ 366 ADC_Obj08LeftAngle "ADC Object8 Left Angle";
CM_ SG_ 366 ADC_Obj08RightAngle "ADC Object8 Right Angle";
CM_ SG_ 366 ADC_Obj08BottomAngle "ADC Object8 Bottom Angle";
CM_ SG_ 366 ADC_Obj08TopAngle "ADC Object8 Top Angle";
CM_ SG_ 366 ADC_Obj09_ID "ADC Adb Object9 ID";
CM_ SG_ 366 ADC_Obj09Typ "ADC Object9 Classification";
CM_ SG_ 366 ADC_Obj09Dir "ADC Object9 Direction";
CM_ SG_ 366 ADC_Obj09Dist "ADC Object9 Distance";
CM_ SG_ 366 ADC_Obj09HoztAngSpd "ADC Object9 Horizontal Angle Speed";
CM_ SG_ 366 ADC_Obj09LeftAngle "ADC Object9 Left Angle";
CM_ SG_ 366 ADC_Obj09RightAngle "ADC Object9 Right Angle";
CM_ SG_ 366 ADC_Obj09BottomAngle "ADC Object9 Bottom Angle";
CM_ SG_ 366 ADC_Obj09TopAngle "ADC Object9 Top Angle";
CM_ SG_ 366 ADC_Obj010_ID "ADC Adb Object10 ID";
CM_ SG_ 366 ADC_Obj010Typ "ADC Object10 Classification";
CM_ SG_ 366 ADC_Obj010Dir "ADC Object10 Direction";
CM_ SG_ 366 ADC_Obj010Dist "ADC Object10 Distance";
CM_ SG_ 366 ADC_Obj010HoztAngSpd "ADC Object10 Horizontal Angle Speed";
CM_ SG_ 366 ADC_Obj010LeftAngle "ADC Object10 Left Angle";
CM_ SG_ 366 ADC_Obj010RightAngle "ADC Object10 Right Angle";
CM_ SG_ 366 ADC_Obj010BottomAngle "ADC Object10 Bottom Angle";
CM_ SG_ 366 ADC_Obj010TopAngle "ADC Object10 Top Angle";

BA_DEF_ BO_  "GenMsgCycleTime" INT 0 0;
BA_DEF_ BO_  "GenMsgCycleTimeFast" INT 0 0;
BA_DEF_ BO_  "GenMsgSendType" ENUM  "Periodic","Event","IfActive","POE","PA","FixedPeriodic","Event","EnabledPeriodic","NotUsed","NotUsed","EventPeriodic","NotUsed","NotUsed","NoMsgSendType";
BA_DEF_ BO_  "VFrameFormat" ENUM  "StandardCAN","ExtendedCAN","reserved","reserved","reserved","reserved","reserved","reserved","reserved","reserved","reserved","reserved","reserved","reserved","StandardCAN_FD","ExtendedCAN_FD";
BA_DEF_ BO_  "CANFD_BRS" ENUM  "0","1";
BA_DEF_ SG_  "EventCommandSignal" ENUM  "No","Yes";
BA_DEF_ SG_  "GatewayedSignals" ENUM  "No","Yes";
BA_DEF_ SG_  "GenSigInactiveValue" HEX 0 0;
BA_DEF_ SG_  "GenSigInvalidValue" HEX 0 0;
BA_DEF_ SG_  "GenSigSendType" ENUM  "Trigger","Passive","Cyclic","OnWrite","OnWriteWithRepetition","OnChange","OnChangeWithRepetition","IfActive","IfActiveWithRepetition","NoSigSendType";
BA_DEF_ SG_  "GenSigStartValue" HEX 0 0;
BA_DEF_ SG_  "GenSigTimeoutValue" HEX 0 0;
BA_DEF_ SG_  "Remark" STRING ;
BA_ "GenMsgCycleTime" BO_ 971 100;
BA_ "GenMsgCycleTimeFast" BO_ 971 0;
BA_ "GenMsgSendType" BO_ 971 0;
BA_ "VFrameFormat" BO_ 971 14;
BA_ "CANFD_BRS" BO_ 971 1;
BA_ "GenMsgCycleTime" BO_ 971 100;
BA_ "GenMsgCycleTimeFast" BO_ 971 0;
BA_ "GenMsgSendType" BO_ 971 0;
BA_ "VFrameFormat" BO_ 971 14;
BA_ "CANFD_BRS" BO_ 971 1;
BA_ "GenMsgCycleTime" BO_ 971 100;
BA_ "GenMsgCycleTimeFast" BO_ 971 0;
BA_ "GenMsgSendType" BO_ 971 0;
BA_ "VFrameFormat" BO_ 971 14;
BA_ "CANFD_BRS" BO_ 971 1;
BA_ "GenMsgCycleTime" BO_ 971 100;
BA_ "GenMsgCycleTimeFast" BO_ 971 0;
BA_ "GenMsgSendType" BO_ 971 0;
BA_ "VFrameFormat" BO_ 971 14;
BA_ "CANFD_BRS" BO_ 971 1;
BA_ "GenMsgCycleTime" BO_ 971 100;
BA_ "GenMsgCycleTimeFast" BO_ 971 0;
BA_ "GenMsgSendType" BO_ 971 0;
BA_ "VFrameFormat" BO_ 971 14;
BA_ "CANFD_BRS" BO_ 971 1;
BA_ "GenMsgCycleTime" BO_ 971 100;
BA_ "GenMsgCycleTimeFast" BO_ 971 0;
BA_ "GenMsgSendType" BO_ 971 0;
BA_ "VFrameFormat" BO_ 971 14;
BA_ "CANFD_BRS" BO_ 971 1;
BA_ "GenMsgCycleTime" BO_ 971 100;
BA_ "GenMsgCycleTimeFast" BO_ 971 0;
BA_ "GenMsgSendType" BO_ 971 0;
BA_ "VFrameFormat" BO_ 971 14;
BA_ "CANFD_BRS" BO_ 971 1;
BA_ "GenMsgCycleTime" BO_ 971 100;
BA_ "GenMsgCycleTimeFast" BO_ 971 0;
BA_ "GenMsgSendType" BO_ 971 0;
BA_ "VFrameFormat" BO_ 971 14;
BA_ "CANFD_BRS" BO_ 971 1;
BA_ "GenMsgCycleTime" BO_ 971 100;
BA_ "GenMsgCycleTimeFast" BO_ 971 0;
BA_ "GenMsgSendType" BO_ 971 0;
BA_ "VFrameFormat" BO_ 971 14;
BA_ "CANFD_BRS" BO_ 971 1;
BA_ "GenMsgCycleTime" BO_ 971 100;
BA_ "GenMsgCycleTimeFast" BO_ 971 0;
BA_ "GenMsgSendType" BO_ 971 0;
BA_ "VFrameFormat" BO_ 971 14;
BA_ "CANFD_BRS" BO_ 971 1;
BA_ "GenMsgCycleTime" BO_ 971 100;
BA_ "GenMsgCycleTimeFast" BO_ 971 0;
BA_ "GenMsgSendType" BO_ 971 0;
BA_ "VFrameFormat" BO_ 971 14;
BA_ "CANFD_BRS" BO_ 971 1;
BA_ "GenMsgCycleTime" BO_ 971 100;
BA_ "GenMsgCycleTimeFast" BO_ 971 0;
BA_ "GenMsgSendType" BO_ 971 0;
BA_ "VFrameFormat" BO_ 971 14;
BA_ "CANFD_BRS" BO_ 971 1;
BA_ "GenMsgCycleTime" BO_ 971 100;
BA_ "GenMsgCycleTimeFast" BO_ 971 0;
BA_ "GenMsgSendType" BO_ 971 0;
BA_ "VFrameFormat" BO_ 971 14;
BA_ "CANFD_BRS" BO_ 971 1;
BA_ "GenMsgCycleTime" BO_ 971 100;
BA_ "GenMsgCycleTimeFast" BO_ 971 0;
BA_ "GenMsgSendType" BO_ 971 0;
BA_ "VFrameFormat" BO_ 971 14;
BA_ "CANFD_BRS" BO_ 971 1;
BA_ "GenMsgCycleTime" BO_ 971 100;
BA_ "GenMsgCycleTimeFast" BO_ 971 0;
BA_ "GenMsgSendType" BO_ 971 0;
BA_ "VFrameFormat" BO_ 971 14;
BA_ "CANFD_BRS" BO_ 971 1;
BA_ "GenMsgCycleTime" BO_ 971 100;
BA_ "GenMsgCycleTimeFast" BO_ 971 0;
BA_ "GenMsgSendType" BO_ 971 0;
BA_ "VFrameFormat" BO_ 971 14;
BA_ "CANFD_BRS" BO_ 971 1;
BA_ "GenMsgCycleTime" BO_ 971 100;
BA_ "GenMsgCycleTimeFast" BO_ 971 0;
BA_ "GenMsgSendType" BO_ 971 0;
BA_ "VFrameFormat" BO_ 971 14;
BA_ "CANFD_BRS" BO_ 971 1;
BA_ "GenMsgCycleTime" BO_ 971 100;
BA_ "GenMsgCycleTimeFast" BO_ 971 0;
BA_ "GenMsgSendType" BO_ 971 0;
BA_ "VFrameFormat" BO_ 971 14;
BA_ "CANFD_BRS" BO_ 971 1;
BA_ "GenMsgCycleTime" BO_ 971 100;
BA_ "GenMsgCycleTimeFast" BO_ 971 0;
BA_ "GenMsgSendType" BO_ 971 0;
BA_ "VFrameFormat" BO_ 971 14;
BA_ "CANFD_BRS" BO_ 971 1;
BA_ "GenMsgCycleTime" BO_ 971 100;
BA_ "GenMsgCycleTimeFast" BO_ 971 0;
BA_ "GenMsgSendType" BO_ 971 0;
BA_ "VFrameFormat" BO_ 971 14;
BA_ "CANFD_BRS" BO_ 971 1;
BA_ "GenMsgCycleTime" BO_ 971 100;
BA_ "GenMsgCycleTimeFast" BO_ 971 0;
BA_ "GenMsgSendType" BO_ 971 0;
BA_ "VFrameFormat" BO_ 971 14;
BA_ "CANFD_BRS" BO_ 971 1;
BA_ "GenMsgCycleTime" BO_ 971 100;
BA_ "GenMsgCycleTimeFast" BO_ 971 0;
BA_ "GenMsgSendType" BO_ 971 0;
BA_ "VFrameFormat" BO_ 971 14;
BA_ "CANFD_BRS" BO_ 971 1;
BA_ "GenMsgCycleTime" BO_ 971 100;
BA_ "GenMsgCycleTimeFast" BO_ 971 0;
BA_ "GenMsgSendType" BO_ 971 0;
BA_ "VFrameFormat" BO_ 971 14;
BA_ "CANFD_BRS" BO_ 971 1;
BA_ "GenMsgCycleTime" BO_ 971 100;
BA_ "GenMsgCycleTimeFast" BO_ 971 0;
BA_ "GenMsgSendType" BO_ 971 0;
BA_ "VFrameFormat" BO_ 971 14;
BA_ "CANFD_BRS" BO_ 971 1;
BA_ "GenMsgCycleTime" BO_ 971 100;
BA_ "GenMsgCycleTimeFast" BO_ 971 0;
BA_ "GenMsgSendType" BO_ 971 0;
BA_ "VFrameFormat" BO_ 971 14;
BA_ "CANFD_BRS" BO_ 971 1;
BA_ "GenMsgCycleTime" BO_ 971 100;
BA_ "GenMsgCycleTimeFast" BO_ 971 0;
BA_ "GenMsgSendType" BO_ 971 0;
BA_ "VFrameFormat" BO_ 971 14;
BA_ "CANFD_BRS" BO_ 971 1;
BA_ "GenMsgCycleTime" BO_ 971 100;
BA_ "GenMsgCycleTimeFast" BO_ 971 0;
BA_ "GenMsgSendType" BO_ 971 0;
BA_ "VFrameFormat" BO_ 971 14;
BA_ "CANFD_BRS" BO_ 971 1;
BA_ "GenMsgCycleTime" BO_ 971 100;
BA_ "GenMsgCycleTimeFast" BO_ 971 0;
BA_ "GenMsgSendType" BO_ 971 0;
BA_ "VFrameFormat" BO_ 971 14;
BA_ "CANFD_BRS" BO_ 971 1;
BA_ "GenMsgCycleTime" BO_ 971 100;
BA_ "GenMsgCycleTimeFast" BO_ 971 0;
BA_ "GenMsgSendType" BO_ 971 0;
BA_ "VFrameFormat" BO_ 971 14;
BA_ "CANFD_BRS" BO_ 971 1;
BA_ "GenMsgCycleTime" BO_ 971 100;
BA_ "GenMsgCycleTimeFast" BO_ 971 0;
BA_ "GenMsgSendType" BO_ 971 0;
BA_ "VFrameFormat" BO_ 971 14;
BA_ "CANFD_BRS" BO_ 971 1;
BA_ "GenMsgCycleTime" BO_ 971 100;
BA_ "GenMsgCycleTimeFast" BO_ 971 0;
BA_ "GenMsgSendType" BO_ 971 0;
BA_ "VFrameFormat" BO_ 971 14;
BA_ "CANFD_BRS" BO_ 971 1;
BA_ "GenMsgCycleTime" BO_ 971 100;
BA_ "GenMsgCycleTimeFast" BO_ 971 0;
BA_ "GenMsgSendType" BO_ 971 0;
BA_ "VFrameFormat" BO_ 971 14;
BA_ "CANFD_BRS" BO_ 971 1;
BA_ "GenMsgCycleTime" BO_ 971 100;
BA_ "GenMsgCycleTimeFast" BO_ 971 0;
BA_ "GenMsgSendType" BO_ 971 0;
BA_ "VFrameFormat" BO_ 971 14;
BA_ "CANFD_BRS" BO_ 971 1;
BA_ "GenMsgCycleTime" BO_ 971 100;
BA_ "GenMsgCycleTimeFast" BO_ 971 0;
BA_ "GenMsgSendType" BO_ 971 0;
BA_ "VFrameFormat" BO_ 971 14;
BA_ "CANFD_BRS" BO_ 971 1;
BA_ "GenMsgCycleTime" BO_ 971 100;
BA_ "GenMsgCycleTimeFast" BO_ 971 0;
BA_ "GenMsgSendType" BO_ 971 0;
BA_ "VFrameFormat" BO_ 971 14;
BA_ "CANFD_BRS" BO_ 971 1;
BA_ "GenMsgCycleTime" BO_ 971 100;
BA_ "GenMsgCycleTimeFast" BO_ 971 0;
BA_ "GenMsgSendType" BO_ 971 0;
BA_ "VFrameFormat" BO_ 971 14;
BA_ "CANFD_BRS" BO_ 971 1;
BA_ "GenMsgCycleTime" BO_ 971 100;
BA_ "GenMsgCycleTimeFast" BO_ 971 0;
BA_ "GenMsgSendType" BO_ 971 0;
BA_ "VFrameFormat" BO_ 971 14;
BA_ "CANFD_BRS" BO_ 971 1;
BA_ "GenMsgCycleTime" BO_ 971 100;
BA_ "GenMsgCycleTimeFast" BO_ 971 0;
BA_ "GenMsgSendType" BO_ 971 0;
BA_ "VFrameFormat" BO_ 971 14;
BA_ "CANFD_BRS" BO_ 971 1;
BA_ "GenMsgCycleTime" BO_ 971 100;
BA_ "GenMsgCycleTimeFast" BO_ 971 0;
BA_ "GenMsgSendType" BO_ 971 0;
BA_ "VFrameFormat" BO_ 971 14;
BA_ "CANFD_BRS" BO_ 971 1;
BA_ "GenMsgCycleTime" BO_ 971 100;
BA_ "GenMsgCycleTimeFast" BO_ 971 0;
BA_ "GenMsgSendType" BO_ 971 0;
BA_ "VFrameFormat" BO_ 971 14;
BA_ "CANFD_BRS" BO_ 971 1;
BA_ "GenMsgCycleTime" BO_ 971 100;
BA_ "GenMsgCycleTimeFast" BO_ 971 0;
BA_ "GenMsgSendType" BO_ 971 0;
BA_ "VFrameFormat" BO_ 971 14;
BA_ "CANFD_BRS" BO_ 971 1;
BA_ "GenMsgCycleTime" BO_ 971 100;
BA_ "GenMsgCycleTimeFast" BO_ 971 0;
BA_ "GenMsgSendType" BO_ 971 0;
BA_ "VFrameFormat" BO_ 971 14;
BA_ "CANFD_BRS" BO_ 971 1;
BA_ "GenMsgCycleTime" BO_ 971 100;
BA_ "GenMsgCycleTimeFast" BO_ 971 0;
BA_ "GenMsgSendType" BO_ 971 0;
BA_ "VFrameFormat" BO_ 971 14;
BA_ "CANFD_BRS" BO_ 971 1;
BA_ "GenMsgCycleTime" BO_ 971 100;
BA_ "GenMsgCycleTimeFast" BO_ 971 0;
BA_ "GenMsgSendType" BO_ 971 0;
BA_ "VFrameFormat" BO_ 971 14;
BA_ "CANFD_BRS" BO_ 971 1;
BA_ "GenMsgCycleTime" BO_ 971 100;
BA_ "GenMsgCycleTimeFast" BO_ 971 0;
BA_ "GenMsgSendType" BO_ 971 0;
BA_ "VFrameFormat" BO_ 971 14;
BA_ "CANFD_BRS" BO_ 971 1;
BA_ "GenMsgCycleTime" BO_ 971 100;
BA_ "GenMsgCycleTimeFast" BO_ 971 0;
BA_ "GenMsgSendType" BO_ 971 0;
BA_ "VFrameFormat" BO_ 971 14;
BA_ "CANFD_BRS" BO_ 971 1;
BA_ "GenMsgCycleTime" BO_ 971 100;
BA_ "GenMsgCycleTimeFast" BO_ 971 0;
BA_ "GenMsgSendType" BO_ 971 0;
BA_ "VFrameFormat" BO_ 971 14;
BA_ "CANFD_BRS" BO_ 971 1;
BA_ "GenMsgCycleTime" BO_ 971 100;
BA_ "GenMsgCycleTimeFast" BO_ 971 0;
BA_ "GenMsgSendType" BO_ 971 0;
BA_ "VFrameFormat" BO_ 971 14;
BA_ "CANFD_BRS" BO_ 971 1;
BA_ "GenMsgCycleTime" BO_ 1110 1000;
BA_ "GenMsgCycleTimeFast" BO_ 1110 0;
BA_ "GenMsgSendType" BO_ 1110 0;
BA_ "VFrameFormat" BO_ 1110 14;
BA_ "CANFD_BRS" BO_ 1110 1;
BA_ "GenMsgCycleTime" BO_ 1110 1000;
BA_ "GenMsgCycleTimeFast" BO_ 1110 0;
BA_ "GenMsgSendType" BO_ 1110 0;
BA_ "VFrameFormat" BO_ 1110 14;
BA_ "CANFD_BRS" BO_ 1110 1;
BA_ "GenMsgCycleTime" BO_ 1110 1000;
BA_ "GenMsgCycleTimeFast" BO_ 1110 0;
BA_ "GenMsgSendType" BO_ 1110 0;
BA_ "VFrameFormat" BO_ 1110 14;
BA_ "CANFD_BRS" BO_ 1110 1;
BA_ "GenMsgCycleTime" BO_ 1110 1000;
BA_ "GenMsgCycleTimeFast" BO_ 1110 0;
BA_ "GenMsgSendType" BO_ 1110 0;
BA_ "VFrameFormat" BO_ 1110 14;
BA_ "CANFD_BRS" BO_ 1110 1;
BA_ "GenMsgCycleTime" BO_ 1110 1000;
BA_ "GenMsgCycleTimeFast" BO_ 1110 0;
BA_ "GenMsgSendType" BO_ 1110 0;
BA_ "VFrameFormat" BO_ 1110 14;
BA_ "CANFD_BRS" BO_ 1110 1;
BA_ "GenMsgCycleTime" BO_ 1110 1000;
BA_ "GenMsgCycleTimeFast" BO_ 1110 0;
BA_ "GenMsgSendType" BO_ 1110 0;
BA_ "VFrameFormat" BO_ 1110 14;
BA_ "CANFD_BRS" BO_ 1110 1;
BA_ "GenMsgCycleTime" BO_ 1110 1000;
BA_ "GenMsgCycleTimeFast" BO_ 1110 0;
BA_ "GenMsgSendType" BO_ 1110 0;
BA_ "VFrameFormat" BO_ 1110 14;
BA_ "CANFD_BRS" BO_ 1110 1;
BA_ "GenMsgCycleTime" BO_ 1110 1000;
BA_ "GenMsgCycleTimeFast" BO_ 1110 0;
BA_ "GenMsgSendType" BO_ 1110 0;
BA_ "VFrameFormat" BO_ 1110 14;
BA_ "CANFD_BRS" BO_ 1110 1;
BA_ "GenMsgCycleTime" BO_ 1110 1000;
BA_ "GenMsgCycleTimeFast" BO_ 1110 0;
BA_ "GenMsgSendType" BO_ 1110 0;
BA_ "VFrameFormat" BO_ 1110 14;
BA_ "CANFD_BRS" BO_ 1110 1;
BA_ "GenMsgCycleTime" BO_ 1110 1000;
BA_ "GenMsgCycleTimeFast" BO_ 1110 0;
BA_ "GenMsgSendType" BO_ 1110 0;
BA_ "VFrameFormat" BO_ 1110 14;
BA_ "CANFD_BRS" BO_ 1110 1;
BA_ "GenMsgCycleTime" BO_ 1110 1000;
BA_ "GenMsgCycleTimeFast" BO_ 1110 0;
BA_ "GenMsgSendType" BO_ 1110 0;
BA_ "VFrameFormat" BO_ 1110 14;
BA_ "CANFD_BRS" BO_ 1110 1;
BA_ "GenMsgCycleTime" BO_ 1110 1000;
BA_ "GenMsgCycleTimeFast" BO_ 1110 0;
BA_ "GenMsgSendType" BO_ 1110 0;
BA_ "VFrameFormat" BO_ 1110 14;
BA_ "CANFD_BRS" BO_ 1110 1;
BA_ "GenMsgCycleTime" BO_ 1110 1000;
BA_ "GenMsgCycleTimeFast" BO_ 1110 0;
BA_ "GenMsgSendType" BO_ 1110 0;
BA_ "VFrameFormat" BO_ 1110 14;
BA_ "CANFD_BRS" BO_ 1110 1;
BA_ "GenMsgCycleTime" BO_ 1110 1000;
BA_ "GenMsgCycleTimeFast" BO_ 1110 0;
BA_ "GenMsgSendType" BO_ 1110 0;
BA_ "VFrameFormat" BO_ 1110 14;
BA_ "CANFD_BRS" BO_ 1110 1;
BA_ "GenMsgCycleTime" BO_ 1110 1000;
BA_ "GenMsgCycleTimeFast" BO_ 1110 0;
BA_ "GenMsgSendType" BO_ 1110 0;
BA_ "VFrameFormat" BO_ 1110 14;
BA_ "CANFD_BRS" BO_ 1110 1;
BA_ "GenMsgCycleTime" BO_ 1110 1000;
BA_ "GenMsgCycleTimeFast" BO_ 1110 0;
BA_ "GenMsgSendType" BO_ 1110 0;
BA_ "VFrameFormat" BO_ 1110 14;
BA_ "CANFD_BRS" BO_ 1110 1;
BA_ "GenMsgCycleTime" BO_ 1110 1000;
BA_ "GenMsgCycleTimeFast" BO_ 1110 0;
BA_ "GenMsgSendType" BO_ 1110 0;
BA_ "VFrameFormat" BO_ 1110 14;
BA_ "CANFD_BRS" BO_ 1110 1;
BA_ "GenMsgCycleTime" BO_ 1110 1000;
BA_ "GenMsgCycleTimeFast" BO_ 1110 0;
BA_ "GenMsgSendType" BO_ 1110 0;
BA_ "VFrameFormat" BO_ 1110 14;
BA_ "CANFD_BRS" BO_ 1110 1;
BA_ "GenMsgCycleTime" BO_ 1110 1000;
BA_ "GenMsgCycleTimeFast" BO_ 1110 0;
BA_ "GenMsgSendType" BO_ 1110 0;
BA_ "VFrameFormat" BO_ 1110 14;
BA_ "CANFD_BRS" BO_ 1110 1;
BA_ "GenMsgCycleTime" BO_ 1110 1000;
BA_ "GenMsgCycleTimeFast" BO_ 1110 0;
BA_ "GenMsgSendType" BO_ 1110 0;
BA_ "VFrameFormat" BO_ 1110 14;
BA_ "CANFD_BRS" BO_ 1110 1;
BA_ "GenMsgCycleTime" BO_ 1110 1000;
BA_ "GenMsgCycleTimeFast" BO_ 1110 0;
BA_ "GenMsgSendType" BO_ 1110 0;
BA_ "VFrameFormat" BO_ 1110 14;
BA_ "CANFD_BRS" BO_ 1110 1;
BA_ "GenMsgCycleTime" BO_ 1110 1000;
BA_ "GenMsgCycleTimeFast" BO_ 1110 0;
BA_ "GenMsgSendType" BO_ 1110 0;
BA_ "VFrameFormat" BO_ 1110 14;
BA_ "CANFD_BRS" BO_ 1110 1;
BA_ "GenMsgCycleTime" BO_ 1110 1000;
BA_ "GenMsgCycleTimeFast" BO_ 1110 0;
BA_ "GenMsgSendType" BO_ 1110 0;
BA_ "VFrameFormat" BO_ 1110 14;
BA_ "CANFD_BRS" BO_ 1110 1;
BA_ "GenMsgCycleTime" BO_ 1110 1000;
BA_ "GenMsgCycleTimeFast" BO_ 1110 0;
BA_ "GenMsgSendType" BO_ 1110 0;
BA_ "VFrameFormat" BO_ 1110 14;
BA_ "CANFD_BRS" BO_ 1110 1;
BA_ "GenMsgCycleTime" BO_ 1110 1000;
BA_ "GenMsgCycleTimeFast" BO_ 1110 0;
BA_ "GenMsgSendType" BO_ 1110 0;
BA_ "VFrameFormat" BO_ 1110 14;
BA_ "CANFD_BRS" BO_ 1110 1;
BA_ "GenMsgCycleTime" BO_ 1110 1000;
BA_ "GenMsgCycleTimeFast" BO_ 1110 0;
BA_ "GenMsgSendType" BO_ 1110 0;
BA_ "VFrameFormat" BO_ 1110 14;
BA_ "CANFD_BRS" BO_ 1110 1;
BA_ "GenMsgCycleTime" BO_ 1110 1000;
BA_ "GenMsgCycleTimeFast" BO_ 1110 0;
BA_ "GenMsgSendType" BO_ 1110 0;
BA_ "VFrameFormat" BO_ 1110 14;
BA_ "CANFD_BRS" BO_ 1110 1;
BA_ "GenMsgCycleTime" BO_ 1110 1000;
BA_ "GenMsgCycleTimeFast" BO_ 1110 0;
BA_ "GenMsgSendType" BO_ 1110 0;
BA_ "VFrameFormat" BO_ 1110 14;
BA_ "CANFD_BRS" BO_ 1110 1;
BA_ "GenMsgCycleTime" BO_ 1110 1000;
BA_ "GenMsgCycleTimeFast" BO_ 1110 0;
BA_ "GenMsgSendType" BO_ 1110 0;
BA_ "VFrameFormat" BO_ 1110 14;
BA_ "CANFD_BRS" BO_ 1110 1;
BA_ "GenMsgCycleTime" BO_ 1110 1000;
BA_ "GenMsgCycleTimeFast" BO_ 1110 0;
BA_ "GenMsgSendType" BO_ 1110 0;
BA_ "VFrameFormat" BO_ 1110 14;
BA_ "CANFD_BRS" BO_ 1110 1;
BA_ "GenMsgCycleTime" BO_ 1110 1000;
BA_ "GenMsgCycleTimeFast" BO_ 1110 0;
BA_ "GenMsgSendType" BO_ 1110 0;
BA_ "VFrameFormat" BO_ 1110 14;
BA_ "CANFD_BRS" BO_ 1110 1;
BA_ "GenMsgCycleTime" BO_ 1110 1000;
BA_ "GenMsgCycleTimeFast" BO_ 1110 0;
BA_ "GenMsgSendType" BO_ 1110 0;
BA_ "VFrameFormat" BO_ 1110 14;
BA_ "CANFD_BRS" BO_ 1110 1;
BA_ "GenMsgCycleTime" BO_ 1110 1000;
BA_ "GenMsgCycleTimeFast" BO_ 1110 0;
BA_ "GenMsgSendType" BO_ 1110 0;
BA_ "VFrameFormat" BO_ 1110 14;
BA_ "CANFD_BRS" BO_ 1110 1;
BA_ "GenMsgCycleTime" BO_ 1110 1000;
BA_ "GenMsgCycleTimeFast" BO_ 1110 0;
BA_ "GenMsgSendType" BO_ 1110 0;
BA_ "VFrameFormat" BO_ 1110 14;
BA_ "CANFD_BRS" BO_ 1110 1;
BA_ "GenMsgCycleTime" BO_ 1110 1000;
BA_ "GenMsgCycleTimeFast" BO_ 1110 0;
BA_ "GenMsgSendType" BO_ 1110 0;
BA_ "VFrameFormat" BO_ 1110 14;
BA_ "CANFD_BRS" BO_ 1110 1;
BA_ "GenMsgCycleTime" BO_ 1110 1000;
BA_ "GenMsgCycleTimeFast" BO_ 1110 0;
BA_ "GenMsgSendType" BO_ 1110 0;
BA_ "VFrameFormat" BO_ 1110 14;
BA_ "CANFD_BRS" BO_ 1110 1;
BA_ "GenMsgCycleTime" BO_ 1110 1000;
BA_ "GenMsgCycleTimeFast" BO_ 1110 0;
BA_ "GenMsgSendType" BO_ 1110 0;
BA_ "VFrameFormat" BO_ 1110 14;
BA_ "CANFD_BRS" BO_ 1110 1;
BA_ "GenMsgCycleTime" BO_ 1110 1000;
BA_ "GenMsgCycleTimeFast" BO_ 1110 0;
BA_ "GenMsgSendType" BO_ 1110 0;
BA_ "VFrameFormat" BO_ 1110 14;
BA_ "CANFD_BRS" BO_ 1110 1;
BA_ "GenMsgCycleTime" BO_ 1110 1000;
BA_ "GenMsgCycleTimeFast" BO_ 1110 0;
BA_ "GenMsgSendType" BO_ 1110 0;
BA_ "VFrameFormat" BO_ 1110 14;
BA_ "CANFD_BRS" BO_ 1110 1;
BA_ "GenMsgCycleTime" BO_ 1110 1000;
BA_ "GenMsgCycleTimeFast" BO_ 1110 0;
BA_ "GenMsgSendType" BO_ 1110 0;
BA_ "VFrameFormat" BO_ 1110 14;
BA_ "CANFD_BRS" BO_ 1110 1;
BA_ "GenMsgCycleTime" BO_ 1110 1000;
BA_ "GenMsgCycleTimeFast" BO_ 1110 0;
BA_ "GenMsgSendType" BO_ 1110 0;
BA_ "VFrameFormat" BO_ 1110 14;
BA_ "CANFD_BRS" BO_ 1110 1;
BA_ "GenMsgCycleTime" BO_ 1110 1000;
BA_ "GenMsgCycleTimeFast" BO_ 1110 0;
BA_ "GenMsgSendType" BO_ 1110 0;
BA_ "VFrameFormat" BO_ 1110 14;
BA_ "CANFD_BRS" BO_ 1110 1;
BA_ "GenMsgCycleTime" BO_ 1110 1000;
BA_ "GenMsgCycleTimeFast" BO_ 1110 0;
BA_ "GenMsgSendType" BO_ 1110 0;
BA_ "VFrameFormat" BO_ 1110 14;
BA_ "CANFD_BRS" BO_ 1110 1;
BA_ "GenMsgCycleTime" BO_ 1110 1000;
BA_ "GenMsgCycleTimeFast" BO_ 1110 0;
BA_ "GenMsgSendType" BO_ 1110 0;
BA_ "VFrameFormat" BO_ 1110 14;
BA_ "CANFD_BRS" BO_ 1110 1;
BA_ "GenMsgCycleTime" BO_ 1110 1000;
BA_ "GenMsgCycleTimeFast" BO_ 1110 0;
BA_ "GenMsgSendType" BO_ 1110 0;
BA_ "VFrameFormat" BO_ 1110 14;
BA_ "CANFD_BRS" BO_ 1110 1;
BA_ "GenMsgCycleTime" BO_ 1110 1000;
BA_ "GenMsgCycleTimeFast" BO_ 1110 0;
BA_ "GenMsgSendType" BO_ 1110 0;
BA_ "VFrameFormat" BO_ 1110 14;
BA_ "CANFD_BRS" BO_ 1110 1;
BA_ "GenMsgCycleTime" BO_ 1110 1000;
BA_ "GenMsgCycleTimeFast" BO_ 1110 0;
BA_ "GenMsgSendType" BO_ 1110 0;
BA_ "VFrameFormat" BO_ 1110 14;
BA_ "CANFD_BRS" BO_ 1110 1;
BA_ "GenMsgCycleTime" BO_ 1110 1000;
BA_ "GenMsgCycleTimeFast" BO_ 1110 0;
BA_ "GenMsgSendType" BO_ 1110 0;
BA_ "VFrameFormat" BO_ 1110 14;
BA_ "CANFD_BRS" BO_ 1110 1;
BA_ "GenMsgCycleTime" BO_ 1110 1000;
BA_ "GenMsgCycleTimeFast" BO_ 1110 0;
BA_ "GenMsgSendType" BO_ 1110 0;
BA_ "VFrameFormat" BO_ 1110 14;
BA_ "CANFD_BRS" BO_ 1110 1;
BA_ "GenMsgCycleTime" BO_ 1110 1000;
BA_ "GenMsgCycleTimeFast" BO_ 1110 0;
BA_ "GenMsgSendType" BO_ 1110 0;
BA_ "VFrameFormat" BO_ 1110 14;
BA_ "CANFD_BRS" BO_ 1110 1;
BA_ "GenMsgCycleTime" BO_ 1110 1000;
BA_ "GenMsgCycleTimeFast" BO_ 1110 0;
BA_ "GenMsgSendType" BO_ 1110 0;
BA_ "VFrameFormat" BO_ 1110 14;
BA_ "CANFD_BRS" BO_ 1110 1;
BA_ "GenMsgCycleTime" BO_ 1110 1000;
BA_ "GenMsgCycleTimeFast" BO_ 1110 0;
BA_ "GenMsgSendType" BO_ 1110 0;
BA_ "VFrameFormat" BO_ 1110 14;
BA_ "CANFD_BRS" BO_ 1110 1;
BA_ "GenMsgCycleTime" BO_ 1110 1000;
BA_ "GenMsgCycleTimeFast" BO_ 1110 0;
BA_ "GenMsgSendType" BO_ 1110 0;
BA_ "VFrameFormat" BO_ 1110 14;
BA_ "CANFD_BRS" BO_ 1110 1;
BA_ "GenMsgCycleTime" BO_ 1110 1000;
BA_ "GenMsgCycleTimeFast" BO_ 1110 0;
BA_ "GenMsgSendType" BO_ 1110 0;
BA_ "VFrameFormat" BO_ 1110 14;
BA_ "CANFD_BRS" BO_ 1110 1;
BA_ "GenMsgCycleTime" BO_ 1110 1000;
BA_ "GenMsgCycleTimeFast" BO_ 1110 0;
BA_ "GenMsgSendType" BO_ 1110 0;
BA_ "VFrameFormat" BO_ 1110 14;
BA_ "CANFD_BRS" BO_ 1110 1;
BA_ "GenMsgCycleTime" BO_ 1110 1000;
BA_ "GenMsgCycleTimeFast" BO_ 1110 0;
BA_ "GenMsgSendType" BO_ 1110 0;
BA_ "VFrameFormat" BO_ 1110 14;
BA_ "CANFD_BRS" BO_ 1110 1;
BA_ "GenMsgCycleTime" BO_ 1110 1000;
BA_ "GenMsgCycleTimeFast" BO_ 1110 0;
BA_ "GenMsgSendType" BO_ 1110 0;
BA_ "VFrameFormat" BO_ 1110 14;
BA_ "CANFD_BRS" BO_ 1110 1;
BA_ "GenMsgCycleTime" BO_ 1110 1000;
BA_ "GenMsgCycleTimeFast" BO_ 1110 0;
BA_ "GenMsgSendType" BO_ 1110 0;
BA_ "VFrameFormat" BO_ 1110 14;
BA_ "CANFD_BRS" BO_ 1110 1;
BA_ "GenMsgCycleTime" BO_ 1110 1000;
BA_ "GenMsgCycleTimeFast" BO_ 1110 0;
BA_ "GenMsgSendType" BO_ 1110 0;
BA_ "VFrameFormat" BO_ 1110 14;
BA_ "CANFD_BRS" BO_ 1110 1;
BA_ "GenMsgCycleTime" BO_ 1110 1000;
BA_ "GenMsgCycleTimeFast" BO_ 1110 0;
BA_ "GenMsgSendType" BO_ 1110 0;
BA_ "VFrameFormat" BO_ 1110 14;
BA_ "CANFD_BRS" BO_ 1110 1;
BA_ "GenMsgCycleTime" BO_ 1110 1000;
BA_ "GenMsgCycleTimeFast" BO_ 1110 0;
BA_ "GenMsgSendType" BO_ 1110 0;
BA_ "VFrameFormat" BO_ 1110 14;
BA_ "CANFD_BRS" BO_ 1110 1;
BA_ "GenMsgCycleTime" BO_ 1110 1000;
BA_ "GenMsgCycleTimeFast" BO_ 1110 0;
BA_ "GenMsgSendType" BO_ 1110 0;
BA_ "VFrameFormat" BO_ 1110 14;
BA_ "CANFD_BRS" BO_ 1110 1;
BA_ "GenMsgCycleTime" BO_ 1110 1000;
BA_ "GenMsgCycleTimeFast" BO_ 1110 0;
BA_ "GenMsgSendType" BO_ 1110 0;
BA_ "VFrameFormat" BO_ 1110 14;
BA_ "CANFD_BRS" BO_ 1110 1;
BA_ "GenMsgCycleTime" BO_ 1110 1000;
BA_ "GenMsgCycleTimeFast" BO_ 1110 0;
BA_ "GenMsgSendType" BO_ 1110 0;
BA_ "VFrameFormat" BO_ 1110 14;
BA_ "CANFD_BRS" BO_ 1110 1;
BA_ "GenMsgCycleTime" BO_ 1111 1000;
BA_ "GenMsgCycleTimeFast" BO_ 1111 0;
BA_ "GenMsgSendType" BO_ 1111 0;
BA_ "VFrameFormat" BO_ 1111 14;
BA_ "CANFD_BRS" BO_ 1111 1;
BA_ "GenMsgCycleTime" BO_ 1111 1000;
BA_ "GenMsgCycleTimeFast" BO_ 1111 0;
BA_ "GenMsgSendType" BO_ 1111 0;
BA_ "VFrameFormat" BO_ 1111 14;
BA_ "CANFD_BRS" BO_ 1111 1;
BA_ "GenMsgCycleTime" BO_ 1111 1000;
BA_ "GenMsgCycleTimeFast" BO_ 1111 0;
BA_ "GenMsgSendType" BO_ 1111 0;
BA_ "VFrameFormat" BO_ 1111 14;
BA_ "CANFD_BRS" BO_ 1111 1;
BA_ "GenMsgCycleTime" BO_ 1111 1000;
BA_ "GenMsgCycleTimeFast" BO_ 1111 0;
BA_ "GenMsgSendType" BO_ 1111 0;
BA_ "VFrameFormat" BO_ 1111 14;
BA_ "CANFD_BRS" BO_ 1111 1;
BA_ "GenMsgCycleTime" BO_ 1111 1000;
BA_ "GenMsgCycleTimeFast" BO_ 1111 0;
BA_ "GenMsgSendType" BO_ 1111 0;
BA_ "VFrameFormat" BO_ 1111 14;
BA_ "CANFD_BRS" BO_ 1111 1;
BA_ "GenMsgCycleTime" BO_ 1111 1000;
BA_ "GenMsgCycleTimeFast" BO_ 1111 0;
BA_ "GenMsgSendType" BO_ 1111 0;
BA_ "VFrameFormat" BO_ 1111 14;
BA_ "CANFD_BRS" BO_ 1111 1;
BA_ "GenMsgCycleTime" BO_ 1111 1000;
BA_ "GenMsgCycleTimeFast" BO_ 1111 0;
BA_ "GenMsgSendType" BO_ 1111 0;
BA_ "VFrameFormat" BO_ 1111 14;
BA_ "CANFD_BRS" BO_ 1111 1;
BA_ "GenMsgCycleTime" BO_ 1111 1000;
BA_ "GenMsgCycleTimeFast" BO_ 1111 0;
BA_ "GenMsgSendType" BO_ 1111 0;
BA_ "VFrameFormat" BO_ 1111 14;
BA_ "CANFD_BRS" BO_ 1111 1;
BA_ "GenMsgCycleTime" BO_ 1111 1000;
BA_ "GenMsgCycleTimeFast" BO_ 1111 0;
BA_ "GenMsgSendType" BO_ 1111 0;
BA_ "VFrameFormat" BO_ 1111 14;
BA_ "CANFD_BRS" BO_ 1111 1;
BA_ "GenMsgCycleTime" BO_ 1111 1000;
BA_ "GenMsgCycleTimeFast" BO_ 1111 0;
BA_ "GenMsgSendType" BO_ 1111 0;
BA_ "VFrameFormat" BO_ 1111 14;
BA_ "CANFD_BRS" BO_ 1111 1;
BA_ "GenMsgCycleTime" BO_ 1111 1000;
BA_ "GenMsgCycleTimeFast" BO_ 1111 0;
BA_ "GenMsgSendType" BO_ 1111 0;
BA_ "VFrameFormat" BO_ 1111 14;
BA_ "CANFD_BRS" BO_ 1111 1;
BA_ "GenMsgCycleTime" BO_ 1111 1000;
BA_ "GenMsgCycleTimeFast" BO_ 1111 0;
BA_ "GenMsgSendType" BO_ 1111 0;
BA_ "VFrameFormat" BO_ 1111 14;
BA_ "CANFD_BRS" BO_ 1111 1;
BA_ "GenMsgCycleTime" BO_ 1111 1000;
BA_ "GenMsgCycleTimeFast" BO_ 1111 0;
BA_ "GenMsgSendType" BO_ 1111 0;
BA_ "VFrameFormat" BO_ 1111 14;
BA_ "CANFD_BRS" BO_ 1111 1;
BA_ "GenMsgCycleTime" BO_ 1111 1000;
BA_ "GenMsgCycleTimeFast" BO_ 1111 0;
BA_ "GenMsgSendType" BO_ 1111 0;
BA_ "VFrameFormat" BO_ 1111 14;
BA_ "CANFD_BRS" BO_ 1111 1;
BA_ "GenMsgCycleTime" BO_ 1111 1000;
BA_ "GenMsgCycleTimeFast" BO_ 1111 0;
BA_ "GenMsgSendType" BO_ 1111 0;
BA_ "VFrameFormat" BO_ 1111 14;
BA_ "CANFD_BRS" BO_ 1111 1;
BA_ "GenMsgCycleTime" BO_ 1111 1000;
BA_ "GenMsgCycleTimeFast" BO_ 1111 0;
BA_ "GenMsgSendType" BO_ 1111 0;
BA_ "VFrameFormat" BO_ 1111 14;
BA_ "CANFD_BRS" BO_ 1111 1;
BA_ "GenMsgCycleTime" BO_ 1111 1000;
BA_ "GenMsgCycleTimeFast" BO_ 1111 0;
BA_ "GenMsgSendType" BO_ 1111 0;
BA_ "VFrameFormat" BO_ 1111 14;
BA_ "CANFD_BRS" BO_ 1111 1;
BA_ "GenMsgCycleTime" BO_ 1111 1000;
BA_ "GenMsgCycleTimeFast" BO_ 1111 0;
BA_ "GenMsgSendType" BO_ 1111 0;
BA_ "VFrameFormat" BO_ 1111 14;
BA_ "CANFD_BRS" BO_ 1111 1;
BA_ "GenMsgCycleTime" BO_ 1111 1000;
BA_ "GenMsgCycleTimeFast" BO_ 1111 0;
BA_ "GenMsgSendType" BO_ 1111 0;
BA_ "VFrameFormat" BO_ 1111 14;
BA_ "CANFD_BRS" BO_ 1111 1;
BA_ "GenMsgCycleTime" BO_ 1111 1000;
BA_ "GenMsgCycleTimeFast" BO_ 1111 0;
BA_ "GenMsgSendType" BO_ 1111 0;
BA_ "VFrameFormat" BO_ 1111 14;
BA_ "CANFD_BRS" BO_ 1111 1;
BA_ "GenMsgCycleTime" BO_ 1111 1000;
BA_ "GenMsgCycleTimeFast" BO_ 1111 0;
BA_ "GenMsgSendType" BO_ 1111 0;
BA_ "VFrameFormat" BO_ 1111 14;
BA_ "CANFD_BRS" BO_ 1111 1;
BA_ "GenMsgCycleTime" BO_ 1111 1000;
BA_ "GenMsgCycleTimeFast" BO_ 1111 0;
BA_ "GenMsgSendType" BO_ 1111 0;
BA_ "VFrameFormat" BO_ 1111 14;
BA_ "CANFD_BRS" BO_ 1111 1;
BA_ "GenMsgCycleTime" BO_ 1111 1000;
BA_ "GenMsgCycleTimeFast" BO_ 1111 0;
BA_ "GenMsgSendType" BO_ 1111 0;
BA_ "VFrameFormat" BO_ 1111 14;
BA_ "CANFD_BRS" BO_ 1111 1;
BA_ "GenMsgCycleTime" BO_ 1111 1000;
BA_ "GenMsgCycleTimeFast" BO_ 1111 0;
BA_ "GenMsgSendType" BO_ 1111 0;
BA_ "VFrameFormat" BO_ 1111 14;
BA_ "CANFD_BRS" BO_ 1111 1;
BA_ "GenMsgCycleTime" BO_ 1111 1000;
BA_ "GenMsgCycleTimeFast" BO_ 1111 0;
BA_ "GenMsgSendType" BO_ 1111 0;
BA_ "VFrameFormat" BO_ 1111 14;
BA_ "CANFD_BRS" BO_ 1111 1;
BA_ "GenMsgCycleTime" BO_ 1111 1000;
BA_ "GenMsgCycleTimeFast" BO_ 1111 0;
BA_ "GenMsgSendType" BO_ 1111 0;
BA_ "VFrameFormat" BO_ 1111 14;
BA_ "CANFD_BRS" BO_ 1111 1;
BA_ "GenMsgCycleTime" BO_ 1111 1000;
BA_ "GenMsgCycleTimeFast" BO_ 1111 0;
BA_ "GenMsgSendType" BO_ 1111 0;
BA_ "VFrameFormat" BO_ 1111 14;
BA_ "CANFD_BRS" BO_ 1111 1;
BA_ "GenMsgCycleTime" BO_ 1111 1000;
BA_ "GenMsgCycleTimeFast" BO_ 1111 0;
BA_ "GenMsgSendType" BO_ 1111 0;
BA_ "VFrameFormat" BO_ 1111 14;
BA_ "CANFD_BRS" BO_ 1111 1;
BA_ "GenMsgCycleTime" BO_ 1111 1000;
BA_ "GenMsgCycleTimeFast" BO_ 1111 0;
BA_ "GenMsgSendType" BO_ 1111 0;
BA_ "VFrameFormat" BO_ 1111 14;
BA_ "CANFD_BRS" BO_ 1111 1;
BA_ "GenMsgCycleTime" BO_ 1111 1000;
BA_ "GenMsgCycleTimeFast" BO_ 1111 0;
BA_ "GenMsgSendType" BO_ 1111 0;
BA_ "VFrameFormat" BO_ 1111 14;
BA_ "CANFD_BRS" BO_ 1111 1;
BA_ "GenMsgCycleTime" BO_ 1111 1000;
BA_ "GenMsgCycleTimeFast" BO_ 1111 0;
BA_ "GenMsgSendType" BO_ 1111 0;
BA_ "VFrameFormat" BO_ 1111 14;
BA_ "CANFD_BRS" BO_ 1111 1;
BA_ "GenMsgCycleTime" BO_ 1111 1000;
BA_ "GenMsgCycleTimeFast" BO_ 1111 0;
BA_ "GenMsgSendType" BO_ 1111 0;
BA_ "VFrameFormat" BO_ 1111 14;
BA_ "CANFD_BRS" BO_ 1111 1;
BA_ "GenMsgCycleTime" BO_ 1111 1000;
BA_ "GenMsgCycleTimeFast" BO_ 1111 0;
BA_ "GenMsgSendType" BO_ 1111 0;
BA_ "VFrameFormat" BO_ 1111 14;
BA_ "CANFD_BRS" BO_ 1111 1;
BA_ "GenMsgCycleTime" BO_ 1111 1000;
BA_ "GenMsgCycleTimeFast" BO_ 1111 0;
BA_ "GenMsgSendType" BO_ 1111 0;
BA_ "VFrameFormat" BO_ 1111 14;
BA_ "CANFD_BRS" BO_ 1111 1;
BA_ "GenMsgCycleTime" BO_ 365 40;
BA_ "GenMsgCycleTimeFast" BO_ 365 0;
BA_ "GenMsgSendType" BO_ 365 0;
BA_ "VFrameFormat" BO_ 365 14;
BA_ "CANFD_BRS" BO_ 365 1;
BA_ "GenMsgCycleTime" BO_ 365 40;
BA_ "GenMsgCycleTimeFast" BO_ 365 0;
BA_ "GenMsgSendType" BO_ 365 0;
BA_ "VFrameFormat" BO_ 365 14;
BA_ "CANFD_BRS" BO_ 365 1;
BA_ "GenMsgCycleTime" BO_ 365 40;
BA_ "GenMsgCycleTimeFast" BO_ 365 0;
BA_ "GenMsgSendType" BO_ 365 0;
BA_ "VFrameFormat" BO_ 365 14;
BA_ "CANFD_BRS" BO_ 365 1;
BA_ "GenMsgCycleTime" BO_ 365 40;
BA_ "GenMsgCycleTimeFast" BO_ 365 0;
BA_ "GenMsgSendType" BO_ 365 0;
BA_ "VFrameFormat" BO_ 365 14;
BA_ "CANFD_BRS" BO_ 365 1;
BA_ "GenMsgCycleTime" BO_ 365 40;
BA_ "GenMsgCycleTimeFast" BO_ 365 0;
BA_ "GenMsgSendType" BO_ 365 0;
BA_ "VFrameFormat" BO_ 365 14;
BA_ "CANFD_BRS" BO_ 365 1;
BA_ "GenMsgCycleTime" BO_ 365 40;
BA_ "GenMsgCycleTimeFast" BO_ 365 0;
BA_ "GenMsgSendType" BO_ 365 0;
BA_ "VFrameFormat" BO_ 365 14;
BA_ "CANFD_BRS" BO_ 365 1;
BA_ "GenMsgCycleTime" BO_ 365 40;
BA_ "GenMsgCycleTimeFast" BO_ 365 0;
BA_ "GenMsgSendType" BO_ 365 0;
BA_ "VFrameFormat" BO_ 365 14;
BA_ "CANFD_BRS" BO_ 365 1;
BA_ "GenMsgCycleTime" BO_ 365 40;
BA_ "GenMsgCycleTimeFast" BO_ 365 0;
BA_ "GenMsgSendType" BO_ 365 0;
BA_ "VFrameFormat" BO_ 365 14;
BA_ "CANFD_BRS" BO_ 365 1;
BA_ "GenMsgCycleTime" BO_ 365 40;
BA_ "GenMsgCycleTimeFast" BO_ 365 0;
BA_ "GenMsgSendType" BO_ 365 0;
BA_ "VFrameFormat" BO_ 365 14;
BA_ "CANFD_BRS" BO_ 365 1;
BA_ "GenMsgCycleTime" BO_ 365 40;
BA_ "GenMsgCycleTimeFast" BO_ 365 0;
BA_ "GenMsgSendType" BO_ 365 0;
BA_ "VFrameFormat" BO_ 365 14;
BA_ "CANFD_BRS" BO_ 365 1;
BA_ "GenMsgCycleTime" BO_ 365 40;
BA_ "GenMsgCycleTimeFast" BO_ 365 0;
BA_ "GenMsgSendType" BO_ 365 0;
BA_ "VFrameFormat" BO_ 365 14;
BA_ "CANFD_BRS" BO_ 365 1;
BA_ "GenMsgCycleTime" BO_ 365 40;
BA_ "GenMsgCycleTimeFast" BO_ 365 0;
BA_ "GenMsgSendType" BO_ 365 0;
BA_ "VFrameFormat" BO_ 365 14;
BA_ "CANFD_BRS" BO_ 365 1;
BA_ "GenMsgCycleTime" BO_ 365 40;
BA_ "GenMsgCycleTimeFast" BO_ 365 0;
BA_ "GenMsgSendType" BO_ 365 0;
BA_ "VFrameFormat" BO_ 365 14;
BA_ "CANFD_BRS" BO_ 365 1;
BA_ "GenMsgCycleTime" BO_ 365 40;
BA_ "GenMsgCycleTimeFast" BO_ 365 0;
BA_ "GenMsgSendType" BO_ 365 0;
BA_ "VFrameFormat" BO_ 365 14;
BA_ "CANFD_BRS" BO_ 365 1;
BA_ "GenMsgCycleTime" BO_ 365 40;
BA_ "GenMsgCycleTimeFast" BO_ 365 0;
BA_ "GenMsgSendType" BO_ 365 0;
BA_ "VFrameFormat" BO_ 365 14;
BA_ "CANFD_BRS" BO_ 365 1;
BA_ "GenMsgCycleTime" BO_ 365 40;
BA_ "GenMsgCycleTimeFast" BO_ 365 0;
BA_ "GenMsgSendType" BO_ 365 0;
BA_ "VFrameFormat" BO_ 365 14;
BA_ "CANFD_BRS" BO_ 365 1;
BA_ "GenMsgCycleTime" BO_ 365 40;
BA_ "GenMsgCycleTimeFast" BO_ 365 0;
BA_ "GenMsgSendType" BO_ 365 0;
BA_ "VFrameFormat" BO_ 365 14;
BA_ "CANFD_BRS" BO_ 365 1;
BA_ "GenMsgCycleTime" BO_ 365 40;
BA_ "GenMsgCycleTimeFast" BO_ 365 0;
BA_ "GenMsgSendType" BO_ 365 0;
BA_ "VFrameFormat" BO_ 365 14;
BA_ "CANFD_BRS" BO_ 365 1;
BA_ "GenMsgCycleTime" BO_ 365 40;
BA_ "GenMsgCycleTimeFast" BO_ 365 0;
BA_ "GenMsgSendType" BO_ 365 0;
BA_ "VFrameFormat" BO_ 365 14;
BA_ "CANFD_BRS" BO_ 365 1;
BA_ "GenMsgCycleTime" BO_ 365 40;
BA_ "GenMsgCycleTimeFast" BO_ 365 0;
BA_ "GenMsgSendType" BO_ 365 0;
BA_ "VFrameFormat" BO_ 365 14;
BA_ "CANFD_BRS" BO_ 365 1;
BA_ "GenMsgCycleTime" BO_ 365 40;
BA_ "GenMsgCycleTimeFast" BO_ 365 0;
BA_ "GenMsgSendType" BO_ 365 0;
BA_ "VFrameFormat" BO_ 365 14;
BA_ "CANFD_BRS" BO_ 365 1;
BA_ "GenMsgCycleTime" BO_ 365 40;
BA_ "GenMsgCycleTimeFast" BO_ 365 0;
BA_ "GenMsgSendType" BO_ 365 0;
BA_ "VFrameFormat" BO_ 365 14;
BA_ "CANFD_BRS" BO_ 365 1;
BA_ "GenMsgCycleTime" BO_ 365 40;
BA_ "GenMsgCycleTimeFast" BO_ 365 0;
BA_ "GenMsgSendType" BO_ 365 0;
BA_ "VFrameFormat" BO_ 365 14;
BA_ "CANFD_BRS" BO_ 365 1;
BA_ "GenMsgCycleTime" BO_ 365 40;
BA_ "GenMsgCycleTimeFast" BO_ 365 0;
BA_ "GenMsgSendType" BO_ 365 0;
BA_ "VFrameFormat" BO_ 365 14;
BA_ "CANFD_BRS" BO_ 365 1;
BA_ "GenMsgCycleTime" BO_ 365 40;
BA_ "GenMsgCycleTimeFast" BO_ 365 0;
BA_ "GenMsgSendType" BO_ 365 0;
BA_ "VFrameFormat" BO_ 365 14;
BA_ "CANFD_BRS" BO_ 365 1;
BA_ "GenMsgCycleTime" BO_ 365 40;
BA_ "GenMsgCycleTimeFast" BO_ 365 0;
BA_ "GenMsgSendType" BO_ 365 0;
BA_ "VFrameFormat" BO_ 365 14;
BA_ "CANFD_BRS" BO_ 365 1;
BA_ "GenMsgCycleTime" BO_ 365 40;
BA_ "GenMsgCycleTimeFast" BO_ 365 0;
BA_ "GenMsgSendType" BO_ 365 0;
BA_ "VFrameFormat" BO_ 365 14;
BA_ "CANFD_BRS" BO_ 365 1;
BA_ "GenMsgCycleTime" BO_ 365 40;
BA_ "GenMsgCycleTimeFast" BO_ 365 0;
BA_ "GenMsgSendType" BO_ 365 0;
BA_ "VFrameFormat" BO_ 365 14;
BA_ "CANFD_BRS" BO_ 365 1;
BA_ "GenMsgCycleTime" BO_ 365 40;
BA_ "GenMsgCycleTimeFast" BO_ 365 0;
BA_ "GenMsgSendType" BO_ 365 0;
BA_ "VFrameFormat" BO_ 365 14;
BA_ "CANFD_BRS" BO_ 365 1;
BA_ "GenMsgCycleTime" BO_ 365 40;
BA_ "GenMsgCycleTimeFast" BO_ 365 0;
BA_ "GenMsgSendType" BO_ 365 0;
BA_ "VFrameFormat" BO_ 365 14;
BA_ "CANFD_BRS" BO_ 365 1;
BA_ "GenMsgCycleTime" BO_ 365 40;
BA_ "GenMsgCycleTimeFast" BO_ 365 0;
BA_ "GenMsgSendType" BO_ 365 0;
BA_ "VFrameFormat" BO_ 365 14;
BA_ "CANFD_BRS" BO_ 365 1;
BA_ "GenMsgCycleTime" BO_ 365 40;
BA_ "GenMsgCycleTimeFast" BO_ 365 0;
BA_ "GenMsgSendType" BO_ 365 0;
BA_ "VFrameFormat" BO_ 365 14;
BA_ "CANFD_BRS" BO_ 365 1;
BA_ "GenMsgCycleTime" BO_ 365 40;
BA_ "GenMsgCycleTimeFast" BO_ 365 0;
BA_ "GenMsgSendType" BO_ 365 0;
BA_ "VFrameFormat" BO_ 365 14;
BA_ "CANFD_BRS" BO_ 365 1;
BA_ "GenMsgCycleTime" BO_ 365 40;
BA_ "GenMsgCycleTimeFast" BO_ 365 0;
BA_ "GenMsgSendType" BO_ 365 0;
BA_ "VFrameFormat" BO_ 365 14;
BA_ "CANFD_BRS" BO_ 365 1;
BA_ "GenMsgCycleTime" BO_ 365 40;
BA_ "GenMsgCycleTimeFast" BO_ 365 0;
BA_ "GenMsgSendType" BO_ 365 0;
BA_ "VFrameFormat" BO_ 365 14;
BA_ "CANFD_BRS" BO_ 365 1;
BA_ "GenMsgCycleTime" BO_ 365 40;
BA_ "GenMsgCycleTimeFast" BO_ 365 0;
BA_ "GenMsgSendType" BO_ 365 0;
BA_ "VFrameFormat" BO_ 365 14;
BA_ "CANFD_BRS" BO_ 365 1;
BA_ "GenMsgCycleTime" BO_ 365 40;
BA_ "GenMsgCycleTimeFast" BO_ 365 0;
BA_ "GenMsgSendType" BO_ 365 0;
BA_ "VFrameFormat" BO_ 365 14;
BA_ "CANFD_BRS" BO_ 365 1;
BA_ "GenMsgCycleTime" BO_ 365 40;
BA_ "GenMsgCycleTimeFast" BO_ 365 0;
BA_ "GenMsgSendType" BO_ 365 0;
BA_ "VFrameFormat" BO_ 365 14;
BA_ "CANFD_BRS" BO_ 365 1;
BA_ "GenMsgCycleTime" BO_ 365 40;
BA_ "GenMsgCycleTimeFast" BO_ 365 0;
BA_ "GenMsgSendType" BO_ 365 0;
BA_ "VFrameFormat" BO_ 365 14;
BA_ "CANFD_BRS" BO_ 365 1;
BA_ "GenMsgCycleTime" BO_ 365 40;
BA_ "GenMsgCycleTimeFast" BO_ 365 0;
BA_ "GenMsgSendType" BO_ 365 0;
BA_ "VFrameFormat" BO_ 365 14;
BA_ "CANFD_BRS" BO_ 365 1;
BA_ "GenMsgCycleTime" BO_ 365 40;
BA_ "GenMsgCycleTimeFast" BO_ 365 0;
BA_ "GenMsgSendType" BO_ 365 0;
BA_ "VFrameFormat" BO_ 365 14;
BA_ "CANFD_BRS" BO_ 365 1;
BA_ "GenMsgCycleTime" BO_ 365 40;
BA_ "GenMsgCycleTimeFast" BO_ 365 0;
BA_ "GenMsgSendType" BO_ 365 0;
BA_ "VFrameFormat" BO_ 365 14;
BA_ "CANFD_BRS" BO_ 365 1;
BA_ "GenMsgCycleTime" BO_ 365 40;
BA_ "GenMsgCycleTimeFast" BO_ 365 0;
BA_ "GenMsgSendType" BO_ 365 0;
BA_ "VFrameFormat" BO_ 365 14;
BA_ "CANFD_BRS" BO_ 365 1;
BA_ "GenMsgCycleTime" BO_ 365 40;
BA_ "GenMsgCycleTimeFast" BO_ 365 0;
BA_ "GenMsgSendType" BO_ 365 0;
BA_ "VFrameFormat" BO_ 365 14;
BA_ "CANFD_BRS" BO_ 365 1;
BA_ "GenMsgCycleTime" BO_ 365 40;
BA_ "GenMsgCycleTimeFast" BO_ 365 0;
BA_ "GenMsgSendType" BO_ 365 0;
BA_ "VFrameFormat" BO_ 365 14;
BA_ "CANFD_BRS" BO_ 365 1;
BA_ "GenMsgCycleTime" BO_ 365 40;
BA_ "GenMsgCycleTimeFast" BO_ 365 0;
BA_ "GenMsgSendType" BO_ 365 0;
BA_ "VFrameFormat" BO_ 365 14;
BA_ "CANFD_BRS" BO_ 365 1;
BA_ "GenMsgCycleTime" BO_ 365 40;
BA_ "GenMsgCycleTimeFast" BO_ 365 0;
BA_ "GenMsgSendType" BO_ 365 0;
BA_ "VFrameFormat" BO_ 365 14;
BA_ "CANFD_BRS" BO_ 365 1;
BA_ "GenMsgCycleTime" BO_ 365 40;
BA_ "GenMsgCycleTimeFast" BO_ 365 0;
BA_ "GenMsgSendType" BO_ 365 0;
BA_ "VFrameFormat" BO_ 365 14;
BA_ "CANFD_BRS" BO_ 365 1;
BA_ "GenMsgCycleTime" BO_ 365 40;
BA_ "GenMsgCycleTimeFast" BO_ 365 0;
BA_ "GenMsgSendType" BO_ 365 0;
BA_ "VFrameFormat" BO_ 365 14;
BA_ "CANFD_BRS" BO_ 365 1;
BA_ "GenMsgCycleTime" BO_ 365 40;
BA_ "GenMsgCycleTimeFast" BO_ 365 0;
BA_ "GenMsgSendType" BO_ 365 0;
BA_ "VFrameFormat" BO_ 365 14;
BA_ "CANFD_BRS" BO_ 365 1;
BA_ "GenMsgCycleTime" BO_ 365 40;
BA_ "GenMsgCycleTimeFast" BO_ 365 0;
BA_ "GenMsgSendType" BO_ 365 0;
BA_ "VFrameFormat" BO_ 365 14;
BA_ "CANFD_BRS" BO_ 365 1;
BA_ "GenMsgCycleTime" BO_ 365 40;
BA_ "GenMsgCycleTimeFast" BO_ 365 0;
BA_ "GenMsgSendType" BO_ 365 0;
BA_ "VFrameFormat" BO_ 365 14;
BA_ "CANFD_BRS" BO_ 365 1;
BA_ "GenMsgCycleTime" BO_ 365 40;
BA_ "GenMsgCycleTimeFast" BO_ 365 0;
BA_ "GenMsgSendType" BO_ 365 0;
BA_ "VFrameFormat" BO_ 365 14;
BA_ "CANFD_BRS" BO_ 365 1;
BA_ "GenMsgCycleTime" BO_ 365 40;
BA_ "GenMsgCycleTimeFast" BO_ 365 0;
BA_ "GenMsgSendType" BO_ 365 0;
BA_ "VFrameFormat" BO_ 365 14;
BA_ "CANFD_BRS" BO_ 365 1;
BA_ "GenMsgCycleTime" BO_ 365 40;
BA_ "GenMsgCycleTimeFast" BO_ 365 0;
BA_ "GenMsgSendType" BO_ 365 0;
BA_ "VFrameFormat" BO_ 365 14;
BA_ "CANFD_BRS" BO_ 365 1;
BA_ "GenMsgCycleTime" BO_ 365 40;
BA_ "GenMsgCycleTimeFast" BO_ 365 0;
BA_ "GenMsgSendType" BO_ 365 0;
BA_ "VFrameFormat" BO_ 365 14;
BA_ "CANFD_BRS" BO_ 365 1;
BA_ "GenMsgCycleTime" BO_ 365 40;
BA_ "GenMsgCycleTimeFast" BO_ 365 0;
BA_ "GenMsgSendType" BO_ 365 0;
BA_ "VFrameFormat" BO_ 365 14;
BA_ "CANFD_BRS" BO_ 365 1;
BA_ "GenMsgCycleTime" BO_ 365 40;
BA_ "GenMsgCycleTimeFast" BO_ 365 0;
BA_ "GenMsgSendType" BO_ 365 0;
BA_ "VFrameFormat" BO_ 365 14;
BA_ "CANFD_BRS" BO_ 365 1;
BA_ "GenMsgCycleTime" BO_ 365 40;
BA_ "GenMsgCycleTimeFast" BO_ 365 0;
BA_ "GenMsgSendType" BO_ 365 0;
BA_ "VFrameFormat" BO_ 365 14;
BA_ "CANFD_BRS" BO_ 365 1;
BA_ "GenMsgCycleTime" BO_ 365 40;
BA_ "GenMsgCycleTimeFast" BO_ 365 0;
BA_ "GenMsgSendType" BO_ 365 0;
BA_ "VFrameFormat" BO_ 365 14;
BA_ "CANFD_BRS" BO_ 365 1;
BA_ "GenMsgCycleTime" BO_ 365 40;
BA_ "GenMsgCycleTimeFast" BO_ 365 0;
BA_ "GenMsgSendType" BO_ 365 0;
BA_ "VFrameFormat" BO_ 365 14;
BA_ "CANFD_BRS" BO_ 365 1;
BA_ "GenMsgCycleTime" BO_ 365 40;
BA_ "GenMsgCycleTimeFast" BO_ 365 0;
BA_ "GenMsgSendType" BO_ 365 0;
BA_ "VFrameFormat" BO_ 365 14;
BA_ "CANFD_BRS" BO_ 365 1;
BA_ "GenMsgCycleTime" BO_ 365 40;
BA_ "GenMsgCycleTimeFast" BO_ 365 0;
BA_ "GenMsgSendType" BO_ 365 0;
BA_ "VFrameFormat" BO_ 365 14;
BA_ "CANFD_BRS" BO_ 365 1;
BA_ "GenMsgCycleTime" BO_ 365 40;
BA_ "GenMsgCycleTimeFast" BO_ 365 0;
BA_ "GenMsgSendType" BO_ 365 0;
BA_ "VFrameFormat" BO_ 365 14;
BA_ "CANFD_BRS" BO_ 365 1;
BA_ "GenMsgCycleTime" BO_ 365 40;
BA_ "GenMsgCycleTimeFast" BO_ 365 0;
BA_ "GenMsgSendType" BO_ 365 0;
BA_ "VFrameFormat" BO_ 365 14;
BA_ "CANFD_BRS" BO_ 365 1;
BA_ "GenMsgCycleTime" BO_ 365 40;
BA_ "GenMsgCycleTimeFast" BO_ 365 0;
BA_ "GenMsgSendType" BO_ 365 0;
BA_ "VFrameFormat" BO_ 365 14;
BA_ "CANFD_BRS" BO_ 365 1;
BA_ "GenMsgCycleTime" BO_ 365 40;
BA_ "GenMsgCycleTimeFast" BO_ 365 0;
BA_ "GenMsgSendType" BO_ 365 0;
BA_ "VFrameFormat" BO_ 365 14;
BA_ "CANFD_BRS" BO_ 365 1;
BA_ "GenMsgCycleTime" BO_ 366 40;
BA_ "GenMsgCycleTimeFast" BO_ 366 0;
BA_ "GenMsgSendType" BO_ 366 0;
BA_ "VFrameFormat" BO_ 366 14;
BA_ "CANFD_BRS" BO_ 366 1;
BA_ "GenMsgCycleTime" BO_ 366 40;
BA_ "GenMsgCycleTimeFast" BO_ 366 0;
BA_ "GenMsgSendType" BO_ 366 0;
BA_ "VFrameFormat" BO_ 366 14;
BA_ "CANFD_BRS" BO_ 366 1;
BA_ "GenMsgCycleTime" BO_ 366 40;
BA_ "GenMsgCycleTimeFast" BO_ 366 0;
BA_ "GenMsgSendType" BO_ 366 0;
BA_ "VFrameFormat" BO_ 366 14;
BA_ "CANFD_BRS" BO_ 366 1;
BA_ "GenMsgCycleTime" BO_ 366 40;
BA_ "GenMsgCycleTimeFast" BO_ 366 0;
BA_ "GenMsgSendType" BO_ 366 0;
BA_ "VFrameFormat" BO_ 366 14;
BA_ "CANFD_BRS" BO_ 366 1;
BA_ "GenMsgCycleTime" BO_ 366 40;
BA_ "GenMsgCycleTimeFast" BO_ 366 0;
BA_ "GenMsgSendType" BO_ 366 0;
BA_ "VFrameFormat" BO_ 366 14;
BA_ "CANFD_BRS" BO_ 366 1;
BA_ "GenMsgCycleTime" BO_ 366 40;
BA_ "GenMsgCycleTimeFast" BO_ 366 0;
BA_ "GenMsgSendType" BO_ 366 0;
BA_ "VFrameFormat" BO_ 366 14;
BA_ "CANFD_BRS" BO_ 366 1;
BA_ "GenMsgCycleTime" BO_ 366 40;
BA_ "GenMsgCycleTimeFast" BO_ 366 0;
BA_ "GenMsgSendType" BO_ 366 0;
BA_ "VFrameFormat" BO_ 366 14;
BA_ "CANFD_BRS" BO_ 366 1;
BA_ "GenMsgCycleTime" BO_ 366 40;
BA_ "GenMsgCycleTimeFast" BO_ 366 0;
BA_ "GenMsgSendType" BO_ 366 0;
BA_ "VFrameFormat" BO_ 366 14;
BA_ "CANFD_BRS" BO_ 366 1;
BA_ "GenMsgCycleTime" BO_ 366 40;
BA_ "GenMsgCycleTimeFast" BO_ 366 0;
BA_ "GenMsgSendType" BO_ 366 0;
BA_ "VFrameFormat" BO_ 366 14;
BA_ "CANFD_BRS" BO_ 366 1;
BA_ "GenMsgCycleTime" BO_ 366 40;
BA_ "GenMsgCycleTimeFast" BO_ 366 0;
BA_ "GenMsgSendType" BO_ 366 0;
BA_ "VFrameFormat" BO_ 366 14;
BA_ "CANFD_BRS" BO_ 366 1;
BA_ "GenMsgCycleTime" BO_ 366 40;
BA_ "GenMsgCycleTimeFast" BO_ 366 0;
BA_ "GenMsgSendType" BO_ 366 0;
BA_ "VFrameFormat" BO_ 366 14;
BA_ "CANFD_BRS" BO_ 366 1;
BA_ "GenMsgCycleTime" BO_ 366 40;
BA_ "GenMsgCycleTimeFast" BO_ 366 0;
BA_ "GenMsgSendType" BO_ 366 0;
BA_ "VFrameFormat" BO_ 366 14;
BA_ "CANFD_BRS" BO_ 366 1;
BA_ "GenMsgCycleTime" BO_ 366 40;
BA_ "GenMsgCycleTimeFast" BO_ 366 0;
BA_ "GenMsgSendType" BO_ 366 0;
BA_ "VFrameFormat" BO_ 366 14;
BA_ "CANFD_BRS" BO_ 366 1;
BA_ "GenMsgCycleTime" BO_ 366 40;
BA_ "GenMsgCycleTimeFast" BO_ 366 0;
BA_ "GenMsgSendType" BO_ 366 0;
BA_ "VFrameFormat" BO_ 366 14;
BA_ "CANFD_BRS" BO_ 366 1;
BA_ "GenMsgCycleTime" BO_ 366 40;
BA_ "GenMsgCycleTimeFast" BO_ 366 0;
BA_ "GenMsgSendType" BO_ 366 0;
BA_ "VFrameFormat" BO_ 366 14;
BA_ "CANFD_BRS" BO_ 366 1;
BA_ "GenMsgCycleTime" BO_ 366 40;
BA_ "GenMsgCycleTimeFast" BO_ 366 0;
BA_ "GenMsgSendType" BO_ 366 0;
BA_ "VFrameFormat" BO_ 366 14;
BA_ "CANFD_BRS" BO_ 366 1;
BA_ "GenMsgCycleTime" BO_ 366 40;
BA_ "GenMsgCycleTimeFast" BO_ 366 0;
BA_ "GenMsgSendType" BO_ 366 0;
BA_ "VFrameFormat" BO_ 366 14;
BA_ "CANFD_BRS" BO_ 366 1;
BA_ "GenMsgCycleTime" BO_ 366 40;
BA_ "GenMsgCycleTimeFast" BO_ 366 0;
BA_ "GenMsgSendType" BO_ 366 0;
BA_ "VFrameFormat" BO_ 366 14;
BA_ "CANFD_BRS" BO_ 366 1;
BA_ "GenMsgCycleTime" BO_ 366 40;
BA_ "GenMsgCycleTimeFast" BO_ 366 0;
BA_ "GenMsgSendType" BO_ 366 0;
BA_ "VFrameFormat" BO_ 366 14;
BA_ "CANFD_BRS" BO_ 366 1;
BA_ "GenMsgCycleTime" BO_ 366 40;
BA_ "GenMsgCycleTimeFast" BO_ 366 0;
BA_ "GenMsgSendType" BO_ 366 0;
BA_ "VFrameFormat" BO_ 366 14;
BA_ "CANFD_BRS" BO_ 366 1;
BA_ "GenMsgCycleTime" BO_ 366 40;
BA_ "GenMsgCycleTimeFast" BO_ 366 0;
BA_ "GenMsgSendType" BO_ 366 0;
BA_ "VFrameFormat" BO_ 366 14;
BA_ "CANFD_BRS" BO_ 366 1;
BA_ "GenMsgCycleTime" BO_ 366 40;
BA_ "GenMsgCycleTimeFast" BO_ 366 0;
BA_ "GenMsgSendType" BO_ 366 0;
BA_ "VFrameFormat" BO_ 366 14;
BA_ "CANFD_BRS" BO_ 366 1;
BA_ "GenMsgCycleTime" BO_ 366 40;
BA_ "GenMsgCycleTimeFast" BO_ 366 0;
BA_ "GenMsgSendType" BO_ 366 0;
BA_ "VFrameFormat" BO_ 366 14;
BA_ "CANFD_BRS" BO_ 366 1;
BA_ "GenMsgCycleTime" BO_ 366 40;
BA_ "GenMsgCycleTimeFast" BO_ 366 0;
BA_ "GenMsgSendType" BO_ 366 0;
BA_ "VFrameFormat" BO_ 366 14;
BA_ "CANFD_BRS" BO_ 366 1;
BA_ "GenMsgCycleTime" BO_ 366 40;
BA_ "GenMsgCycleTimeFast" BO_ 366 0;
BA_ "GenMsgSendType" BO_ 366 0;
BA_ "VFrameFormat" BO_ 366 14;
BA_ "CANFD_BRS" BO_ 366 1;
BA_ "GenMsgCycleTime" BO_ 366 40;
BA_ "GenMsgCycleTimeFast" BO_ 366 0;
BA_ "GenMsgSendType" BO_ 366 0;
BA_ "VFrameFormat" BO_ 366 14;
BA_ "CANFD_BRS" BO_ 366 1;
BA_ "GenMsgCycleTime" BO_ 366 40;
BA_ "GenMsgCycleTimeFast" BO_ 366 0;
BA_ "GenMsgSendType" BO_ 366 0;
BA_ "VFrameFormat" BO_ 366 14;
BA_ "CANFD_BRS" BO_ 366 1;
BA_ "GenMsgCycleTime" BO_ 366 40;
BA_ "GenMsgCycleTimeFast" BO_ 366 0;
BA_ "GenMsgSendType" BO_ 366 0;
BA_ "VFrameFormat" BO_ 366 14;
BA_ "CANFD_BRS" BO_ 366 1;
BA_ "GenMsgCycleTime" BO_ 366 40;
BA_ "GenMsgCycleTimeFast" BO_ 366 0;
BA_ "GenMsgSendType" BO_ 366 0;
BA_ "VFrameFormat" BO_ 366 14;
BA_ "CANFD_BRS" BO_ 366 1;
BA_ "GenMsgCycleTime" BO_ 366 40;
BA_ "GenMsgCycleTimeFast" BO_ 366 0;
BA_ "GenMsgSendType" BO_ 366 0;
BA_ "VFrameFormat" BO_ 366 14;
BA_ "CANFD_BRS" BO_ 366 1;
BA_ "GenMsgCycleTime" BO_ 366 40;
BA_ "GenMsgCycleTimeFast" BO_ 366 0;
BA_ "GenMsgSendType" BO_ 366 0;
BA_ "VFrameFormat" BO_ 366 14;
BA_ "CANFD_BRS" BO_ 366 1;
BA_ "EventCommandSignal" SG_ 971 ADC_MnvrOrintChng6 0;
BA_ "GatewayedSignals" SG_ 971 ADC_MnvrOrintChng6 0;
BA_ "GenSigInactiveValue" SG_ 971 ADC_MnvrOrintChng6 0;
BA_ "GenSigInvalidValue" SG_ 971 ADC_MnvrOrintChng6 0;
BA_ "GenSigSendType" SG_ 971 ADC_MnvrOrintChng6 1;
BA_ "GenSigStartValue" SG_ 971 ADC_MnvrOrintChng6 0;
BA_ "GenSigTimeoutValue" SG_ 971 ADC_MnvrOrintChng6 0;
BA_ "Remark" SG_ 971 ADC_MnvrOrintChng6 "";
BA_ "EventCommandSignal" SG_ 971 ADC_TarParkSt_Posn6 0;
BA_ "GatewayedSignals" SG_ 971 ADC_TarParkSt_Posn6 0;
BA_ "GenSigInactiveValue" SG_ 971 ADC_TarParkSt_Posn6 0;
BA_ "GenSigInvalidValue" SG_ 971 ADC_TarParkSt_Posn6 0;
BA_ "GenSigSendType" SG_ 971 ADC_TarParkSt_Posn6 1;
BA_ "GenSigStartValue" SG_ 971 ADC_TarParkSt_Posn6 0;
BA_ "GenSigTimeoutValue" SG_ 971 ADC_TarParkSt_Posn6 0;
BA_ "Remark" SG_ 971 ADC_TarParkSt_Posn6 "";
BA_ "EventCommandSignal" SG_ 971 ADC_ParkChkSrc_Posn6 0;
BA_ "GatewayedSignals" SG_ 971 ADC_ParkChkSrc_Posn6 0;
BA_ "GenSigInactiveValue" SG_ 971 ADC_ParkChkSrc_Posn6 0;
BA_ "GenSigInvalidValue" SG_ 971 ADC_ParkChkSrc_Posn6 0;
BA_ "GenSigSendType" SG_ 971 ADC_ParkChkSrc_Posn6 1;
BA_ "GenSigStartValue" SG_ 971 ADC_ParkChkSrc_Posn6 0;
BA_ "GenSigTimeoutValue" SG_ 971 ADC_ParkChkSrc_Posn6 0;
BA_ "Remark" SG_ 971 ADC_ParkChkSrc_Posn6 "";
BA_ "EventCommandSignal" SG_ 971 ADC_ParkPosn7_ID 0;
BA_ "GatewayedSignals" SG_ 971 ADC_ParkPosn7_ID 0;
BA_ "GenSigInactiveValue" SG_ 971 ADC_ParkPosn7_ID 0;
BA_ "GenSigInvalidValue" SG_ 971 ADC_ParkPosn7_ID 0;
BA_ "GenSigSendType" SG_ 971 ADC_ParkPosn7_ID 1;
BA_ "GenSigStartValue" SG_ 971 ADC_ParkPosn7_ID 0;
BA_ "GenSigTimeoutValue" SG_ 971 ADC_ParkPosn7_ID 0;
BA_ "Remark" SG_ 971 ADC_ParkPosn7_ID "";
BA_ "EventCommandSignal" SG_ 971 ADC_MnvrOrintChng7 0;
BA_ "GatewayedSignals" SG_ 971 ADC_MnvrOrintChng7 0;
BA_ "GenSigInactiveValue" SG_ 971 ADC_MnvrOrintChng7 0;
BA_ "GenSigInvalidValue" SG_ 971 ADC_MnvrOrintChng7 0;
BA_ "GenSigSendType" SG_ 971 ADC_MnvrOrintChng7 1;
BA_ "GenSigStartValue" SG_ 971 ADC_MnvrOrintChng7 0;
BA_ "GenSigTimeoutValue" SG_ 971 ADC_MnvrOrintChng7 0;
BA_ "Remark" SG_ 971 ADC_MnvrOrintChng7 "";
BA_ "EventCommandSignal" SG_ 971 ADC_TarParkSt_Posn7 0;
BA_ "GatewayedSignals" SG_ 971 ADC_TarParkSt_Posn7 0;
BA_ "GenSigInactiveValue" SG_ 971 ADC_TarParkSt_Posn7 0;
BA_ "GenSigInvalidValue" SG_ 971 ADC_TarParkSt_Posn7 0;
BA_ "GenSigSendType" SG_ 971 ADC_TarParkSt_Posn7 1;
BA_ "GenSigStartValue" SG_ 971 ADC_TarParkSt_Posn7 0;
BA_ "GenSigTimeoutValue" SG_ 971 ADC_TarParkSt_Posn7 0;
BA_ "Remark" SG_ 971 ADC_TarParkSt_Posn7 "";
BA_ "EventCommandSignal" SG_ 971 ADC_ParkChkSrc_Posn7 0;
BA_ "GatewayedSignals" SG_ 971 ADC_ParkChkSrc_Posn7 0;
BA_ "GenSigInactiveValue" SG_ 971 ADC_ParkChkSrc_Posn7 0;
BA_ "GenSigInvalidValue" SG_ 971 ADC_ParkChkSrc_Posn7 0;
BA_ "GenSigSendType" SG_ 971 ADC_ParkChkSrc_Posn7 1;
BA_ "GenSigStartValue" SG_ 971 ADC_ParkChkSrc_Posn7 0;
BA_ "GenSigTimeoutValue" SG_ 971 ADC_ParkChkSrc_Posn7 0;
BA_ "Remark" SG_ 971 ADC_ParkChkSrc_Posn7 "";
BA_ "EventCommandSignal" SG_ 971 ADC_ParkPosn8_ID 0;
BA_ "GatewayedSignals" SG_ 971 ADC_ParkPosn8_ID 0;
BA_ "GenSigInactiveValue" SG_ 971 ADC_ParkPosn8_ID 0;
BA_ "GenSigInvalidValue" SG_ 971 ADC_ParkPosn8_ID 0;
BA_ "GenSigSendType" SG_ 971 ADC_ParkPosn8_ID 1;
BA_ "GenSigStartValue" SG_ 971 ADC_ParkPosn8_ID 0;
BA_ "GenSigTimeoutValue" SG_ 971 ADC_ParkPosn8_ID 0;
BA_ "Remark" SG_ 971 ADC_ParkPosn8_ID "";
BA_ "EventCommandSignal" SG_ 971 ADC_MnvrOrintChng8 0;
BA_ "GatewayedSignals" SG_ 971 ADC_MnvrOrintChng8 0;
BA_ "GenSigInactiveValue" SG_ 971 ADC_MnvrOrintChng8 0;
BA_ "GenSigInvalidValue" SG_ 971 ADC_MnvrOrintChng8 0;
BA_ "GenSigSendType" SG_ 971 ADC_MnvrOrintChng8 1;
BA_ "GenSigStartValue" SG_ 971 ADC_MnvrOrintChng8 0;
BA_ "GenSigTimeoutValue" SG_ 971 ADC_MnvrOrintChng8 0;
BA_ "Remark" SG_ 971 ADC_MnvrOrintChng8 "";
BA_ "EventCommandSignal" SG_ 971 ADC_TarParkSt_Posn8 0;
BA_ "GatewayedSignals" SG_ 971 ADC_TarParkSt_Posn8 0;
BA_ "GenSigInactiveValue" SG_ 971 ADC_TarParkSt_Posn8 0;
BA_ "GenSigInvalidValue" SG_ 971 ADC_TarParkSt_Posn8 0;
BA_ "GenSigSendType" SG_ 971 ADC_TarParkSt_Posn8 1;
BA_ "GenSigStartValue" SG_ 971 ADC_TarParkSt_Posn8 0;
BA_ "GenSigTimeoutValue" SG_ 971 ADC_TarParkSt_Posn8 0;
BA_ "Remark" SG_ 971 ADC_TarParkSt_Posn8 "";
BA_ "EventCommandSignal" SG_ 971 ADC_ParkChkSrc_Posn8 0;
BA_ "GatewayedSignals" SG_ 971 ADC_ParkChkSrc_Posn8 0;
BA_ "GenSigInactiveValue" SG_ 971 ADC_ParkChkSrc_Posn8 0;
BA_ "GenSigInvalidValue" SG_ 971 ADC_ParkChkSrc_Posn8 0;
BA_ "GenSigSendType" SG_ 971 ADC_ParkChkSrc_Posn8 1;
BA_ "GenSigStartValue" SG_ 971 ADC_ParkChkSrc_Posn8 0;
BA_ "GenSigTimeoutValue" SG_ 971 ADC_ParkChkSrc_Posn8 0;
BA_ "Remark" SG_ 971 ADC_ParkChkSrc_Posn8 "";
BA_ "EventCommandSignal" SG_ 971 ADC_ParkRelPos5_x1 0;
BA_ "GatewayedSignals" SG_ 971 ADC_ParkRelPos5_x1 0;
BA_ "GenSigInactiveValue" SG_ 971 ADC_ParkRelPos5_x1 0;
BA_ "GenSigInvalidValue" SG_ 971 ADC_ParkRelPos5_x1 0;
BA_ "GenSigSendType" SG_ 971 ADC_ParkRelPos5_x1 1;
BA_ "GenSigStartValue" SG_ 971 ADC_ParkRelPos5_x1 0;
BA_ "GenSigTimeoutValue" SG_ 971 ADC_ParkRelPos5_x1 0;
BA_ "Remark" SG_ 971 ADC_ParkRelPos5_x1 "";
BA_ "EventCommandSignal" SG_ 971 ADC_ParkRelPos5_y1 0;
BA_ "GatewayedSignals" SG_ 971 ADC_ParkRelPos5_y1 0;
BA_ "GenSigInactiveValue" SG_ 971 ADC_ParkRelPos5_y1 0;
BA_ "GenSigInvalidValue" SG_ 971 ADC_ParkRelPos5_y1 0;
BA_ "GenSigSendType" SG_ 971 ADC_ParkRelPos5_y1 1;
BA_ "GenSigStartValue" SG_ 971 ADC_ParkRelPos5_y1 0;
BA_ "GenSigTimeoutValue" SG_ 971 ADC_ParkRelPos5_y1 0;
BA_ "Remark" SG_ 971 ADC_ParkRelPos5_y1 "";
BA_ "EventCommandSignal" SG_ 971 ADC_ParkRelPos5_x2 0;
BA_ "GatewayedSignals" SG_ 971 ADC_ParkRelPos5_x2 0;
BA_ "GenSigInactiveValue" SG_ 971 ADC_ParkRelPos5_x2 0;
BA_ "GenSigInvalidValue" SG_ 971 ADC_ParkRelPos5_x2 0;
BA_ "GenSigSendType" SG_ 971 ADC_ParkRelPos5_x2 1;
BA_ "GenSigStartValue" SG_ 971 ADC_ParkRelPos5_x2 0;
BA_ "GenSigTimeoutValue" SG_ 971 ADC_ParkRelPos5_x2 0;
BA_ "Remark" SG_ 971 ADC_ParkRelPos5_x2 "";
BA_ "EventCommandSignal" SG_ 971 ADC_ParkRelPos5_y2 0;
BA_ "GatewayedSignals" SG_ 971 ADC_ParkRelPos5_y2 0;
BA_ "GenSigInactiveValue" SG_ 971 ADC_ParkRelPos5_y2 0;
BA_ "GenSigInvalidValue" SG_ 971 ADC_ParkRelPos5_y2 0;
BA_ "GenSigSendType" SG_ 971 ADC_ParkRelPos5_y2 1;
BA_ "GenSigStartValue" SG_ 971 ADC_ParkRelPos5_y2 0;
BA_ "GenSigTimeoutValue" SG_ 971 ADC_ParkRelPos5_y2 0;
BA_ "Remark" SG_ 971 ADC_ParkRelPos5_y2 "";
BA_ "EventCommandSignal" SG_ 971 ADC_ParkRelPos5_x3 0;
BA_ "GatewayedSignals" SG_ 971 ADC_ParkRelPos5_x3 0;
BA_ "GenSigInactiveValue" SG_ 971 ADC_ParkRelPos5_x3 0;
BA_ "GenSigInvalidValue" SG_ 971 ADC_ParkRelPos5_x3 0;
BA_ "GenSigSendType" SG_ 971 ADC_ParkRelPos5_x3 1;
BA_ "GenSigStartValue" SG_ 971 ADC_ParkRelPos5_x3 0;
BA_ "GenSigTimeoutValue" SG_ 971 ADC_ParkRelPos5_x3 0;
BA_ "Remark" SG_ 971 ADC_ParkRelPos5_x3 "";
BA_ "EventCommandSignal" SG_ 971 ADC_ParkRelPos5_y3 0;
BA_ "GatewayedSignals" SG_ 971 ADC_ParkRelPos5_y3 0;
BA_ "GenSigInactiveValue" SG_ 971 ADC_ParkRelPos5_y3 0;
BA_ "GenSigInvalidValue" SG_ 971 ADC_ParkRelPos5_y3 0;
BA_ "GenSigSendType" SG_ 971 ADC_ParkRelPos5_y3 1;
BA_ "GenSigStartValue" SG_ 971 ADC_ParkRelPos5_y3 0;
BA_ "GenSigTimeoutValue" SG_ 971 ADC_ParkRelPos5_y3 0;
BA_ "Remark" SG_ 971 ADC_ParkRelPos5_y3 "";
BA_ "EventCommandSignal" SG_ 971 ADC_ParkRelPos5_x4 0;
BA_ "GatewayedSignals" SG_ 971 ADC_ParkRelPos5_x4 0;
BA_ "GenSigInactiveValue" SG_ 971 ADC_ParkRelPos5_x4 0;
BA_ "GenSigInvalidValue" SG_ 971 ADC_ParkRelPos5_x4 0;
BA_ "GenSigSendType" SG_ 971 ADC_ParkRelPos5_x4 1;
BA_ "GenSigStartValue" SG_ 971 ADC_ParkRelPos5_x4 0;
BA_ "GenSigTimeoutValue" SG_ 971 ADC_ParkRelPos5_x4 0;
BA_ "Remark" SG_ 971 ADC_ParkRelPos5_x4 "";
BA_ "EventCommandSignal" SG_ 971 ADC_ParkRelPos5_y4 0;
BA_ "GatewayedSignals" SG_ 971 ADC_ParkRelPos5_y4 0;
BA_ "GenSigInactiveValue" SG_ 971 ADC_ParkRelPos5_y4 0;
BA_ "GenSigInvalidValue" SG_ 971 ADC_ParkRelPos5_y4 0;
BA_ "GenSigSendType" SG_ 971 ADC_ParkRelPos5_y4 1;
BA_ "GenSigStartValue" SG_ 971 ADC_ParkRelPos5_y4 0;
BA_ "GenSigTimeoutValue" SG_ 971 ADC_ParkRelPos5_y4 0;
BA_ "Remark" SG_ 971 ADC_ParkRelPos5_y4 "";
BA_ "EventCommandSignal" SG_ 971 ADC_ParkRelPos6_x1 0;
BA_ "GatewayedSignals" SG_ 971 ADC_ParkRelPos6_x1 0;
BA_ "GenSigInactiveValue" SG_ 971 ADC_ParkRelPos6_x1 0;
BA_ "GenSigInvalidValue" SG_ 971 ADC_ParkRelPos6_x1 0;
BA_ "GenSigSendType" SG_ 971 ADC_ParkRelPos6_x1 1;
BA_ "GenSigStartValue" SG_ 971 ADC_ParkRelPos6_x1 0;
BA_ "GenSigTimeoutValue" SG_ 971 ADC_ParkRelPos6_x1 0;
BA_ "Remark" SG_ 971 ADC_ParkRelPos6_x1 "";
BA_ "EventCommandSignal" SG_ 971 ADC_ParkRelPos6_y1 0;
BA_ "GatewayedSignals" SG_ 971 ADC_ParkRelPos6_y1 0;
BA_ "GenSigInactiveValue" SG_ 971 ADC_ParkRelPos6_y1 0;
BA_ "GenSigInvalidValue" SG_ 971 ADC_ParkRelPos6_y1 0;
BA_ "GenSigSendType" SG_ 971 ADC_ParkRelPos6_y1 1;
BA_ "GenSigStartValue" SG_ 971 ADC_ParkRelPos6_y1 0;
BA_ "GenSigTimeoutValue" SG_ 971 ADC_ParkRelPos6_y1 0;
BA_ "Remark" SG_ 971 ADC_ParkRelPos6_y1 "";
BA_ "EventCommandSignal" SG_ 971 ADC_ParkRelPos6_x2 0;
BA_ "GatewayedSignals" SG_ 971 ADC_ParkRelPos6_x2 0;
BA_ "GenSigInactiveValue" SG_ 971 ADC_ParkRelPos6_x2 0;
BA_ "GenSigInvalidValue" SG_ 971 ADC_ParkRelPos6_x2 0;
BA_ "GenSigSendType" SG_ 971 ADC_ParkRelPos6_x2 1;
BA_ "GenSigStartValue" SG_ 971 ADC_ParkRelPos6_x2 0;
BA_ "GenSigTimeoutValue" SG_ 971 ADC_ParkRelPos6_x2 0;
BA_ "Remark" SG_ 971 ADC_ParkRelPos6_x2 "";
BA_ "EventCommandSignal" SG_ 971 ADC_ParkRelPos6_y2 0;
BA_ "GatewayedSignals" SG_ 971 ADC_ParkRelPos6_y2 0;
BA_ "GenSigInactiveValue" SG_ 971 ADC_ParkRelPos6_y2 0;
BA_ "GenSigInvalidValue" SG_ 971 ADC_ParkRelPos6_y2 0;
BA_ "GenSigSendType" SG_ 971 ADC_ParkRelPos6_y2 1;
BA_ "GenSigStartValue" SG_ 971 ADC_ParkRelPos6_y2 0;
BA_ "GenSigTimeoutValue" SG_ 971 ADC_ParkRelPos6_y2 0;
BA_ "Remark" SG_ 971 ADC_ParkRelPos6_y2 "";
BA_ "EventCommandSignal" SG_ 971 ADC_ParkRelPos6_x3 0;
BA_ "GatewayedSignals" SG_ 971 ADC_ParkRelPos6_x3 0;
BA_ "GenSigInactiveValue" SG_ 971 ADC_ParkRelPos6_x3 0;
BA_ "GenSigInvalidValue" SG_ 971 ADC_ParkRelPos6_x3 0;
BA_ "GenSigSendType" SG_ 971 ADC_ParkRelPos6_x3 1;
BA_ "GenSigStartValue" SG_ 971 ADC_ParkRelPos6_x3 0;
BA_ "GenSigTimeoutValue" SG_ 971 ADC_ParkRelPos6_x3 0;
BA_ "Remark" SG_ 971 ADC_ParkRelPos6_x3 "";
BA_ "EventCommandSignal" SG_ 971 ADC_ParkRelPos6_y3 0;
BA_ "GatewayedSignals" SG_ 971 ADC_ParkRelPos6_y3 0;
BA_ "GenSigInactiveValue" SG_ 971 ADC_ParkRelPos6_y3 0;
BA_ "GenSigInvalidValue" SG_ 971 ADC_ParkRelPos6_y3 0;
BA_ "GenSigSendType" SG_ 971 ADC_ParkRelPos6_y3 1;
BA_ "GenSigStartValue" SG_ 971 ADC_ParkRelPos6_y3 0;
BA_ "GenSigTimeoutValue" SG_ 971 ADC_ParkRelPos6_y3 0;
BA_ "Remark" SG_ 971 ADC_ParkRelPos6_y3 "";
BA_ "EventCommandSignal" SG_ 971 ADC_ParkRelPos6_x4 0;
BA_ "GatewayedSignals" SG_ 971 ADC_ParkRelPos6_x4 0;
BA_ "GenSigInactiveValue" SG_ 971 ADC_ParkRelPos6_x4 0;
BA_ "GenSigInvalidValue" SG_ 971 ADC_ParkRelPos6_x4 0;
BA_ "GenSigSendType" SG_ 971 ADC_ParkRelPos6_x4 1;
BA_ "GenSigStartValue" SG_ 971 ADC_ParkRelPos6_x4 0;
BA_ "GenSigTimeoutValue" SG_ 971 ADC_ParkRelPos6_x4 0;
BA_ "Remark" SG_ 971 ADC_ParkRelPos6_x4 "";
BA_ "EventCommandSignal" SG_ 971 ADC_ParkRelPos6_y4 0;
BA_ "GatewayedSignals" SG_ 971 ADC_ParkRelPos6_y4 0;
BA_ "GenSigInactiveValue" SG_ 971 ADC_ParkRelPos6_y4 0;
BA_ "GenSigInvalidValue" SG_ 971 ADC_ParkRelPos6_y4 0;
BA_ "GenSigSendType" SG_ 971 ADC_ParkRelPos6_y4 1;
BA_ "GenSigStartValue" SG_ 971 ADC_ParkRelPos6_y4 0;
BA_ "GenSigTimeoutValue" SG_ 971 ADC_ParkRelPos6_y4 0;
BA_ "Remark" SG_ 971 ADC_ParkRelPos6_y4 "";
BA_ "EventCommandSignal" SG_ 971 ADC_ParkRelPos7_x1 0;
BA_ "GatewayedSignals" SG_ 971 ADC_ParkRelPos7_x1 0;
BA_ "GenSigInactiveValue" SG_ 971 ADC_ParkRelPos7_x1 0;
BA_ "GenSigInvalidValue" SG_ 971 ADC_ParkRelPos7_x1 0;
BA_ "GenSigSendType" SG_ 971 ADC_ParkRelPos7_x1 1;
BA_ "GenSigStartValue" SG_ 971 ADC_ParkRelPos7_x1 0;
BA_ "GenSigTimeoutValue" SG_ 971 ADC_ParkRelPos7_x1 0;
BA_ "Remark" SG_ 971 ADC_ParkRelPos7_x1 "";
BA_ "EventCommandSignal" SG_ 971 ADC_ParkRelPos7_y1 0;
BA_ "GatewayedSignals" SG_ 971 ADC_ParkRelPos7_y1 0;
BA_ "GenSigInactiveValue" SG_ 971 ADC_ParkRelPos7_y1 0;
BA_ "GenSigInvalidValue" SG_ 971 ADC_ParkRelPos7_y1 0;
BA_ "GenSigSendType" SG_ 971 ADC_ParkRelPos7_y1 1;
BA_ "GenSigStartValue" SG_ 971 ADC_ParkRelPos7_y1 0;
BA_ "GenSigTimeoutValue" SG_ 971 ADC_ParkRelPos7_y1 0;
BA_ "Remark" SG_ 971 ADC_ParkRelPos7_y1 "";
BA_ "EventCommandSignal" SG_ 971 ADC_ParkRelPos7_x2 0;
BA_ "GatewayedSignals" SG_ 971 ADC_ParkRelPos7_x2 0;
BA_ "GenSigInactiveValue" SG_ 971 ADC_ParkRelPos7_x2 0;
BA_ "GenSigInvalidValue" SG_ 971 ADC_ParkRelPos7_x2 0;
BA_ "GenSigSendType" SG_ 971 ADC_ParkRelPos7_x2 1;
BA_ "GenSigStartValue" SG_ 971 ADC_ParkRelPos7_x2 0;
BA_ "GenSigTimeoutValue" SG_ 971 ADC_ParkRelPos7_x2 0;
BA_ "Remark" SG_ 971 ADC_ParkRelPos7_x2 "";
BA_ "EventCommandSignal" SG_ 971 ADC_ParkRelPos7_y2 0;
BA_ "GatewayedSignals" SG_ 971 ADC_ParkRelPos7_y2 0;
BA_ "GenSigInactiveValue" SG_ 971 ADC_ParkRelPos7_y2 0;
BA_ "GenSigInvalidValue" SG_ 971 ADC_ParkRelPos7_y2 0;
BA_ "GenSigSendType" SG_ 971 ADC_ParkRelPos7_y2 1;
BA_ "GenSigStartValue" SG_ 971 ADC_ParkRelPos7_y2 0;
BA_ "GenSigTimeoutValue" SG_ 971 ADC_ParkRelPos7_y2 0;
BA_ "Remark" SG_ 971 ADC_ParkRelPos7_y2 "";
BA_ "EventCommandSignal" SG_ 971 ADC_ParkRelPos7_x3 0;
BA_ "GatewayedSignals" SG_ 971 ADC_ParkRelPos7_x3 0;
BA_ "GenSigInactiveValue" SG_ 971 ADC_ParkRelPos7_x3 0;
BA_ "GenSigInvalidValue" SG_ 971 ADC_ParkRelPos7_x3 0;
BA_ "GenSigSendType" SG_ 971 ADC_ParkRelPos7_x3 1;
BA_ "GenSigStartValue" SG_ 971 ADC_ParkRelPos7_x3 0;
BA_ "GenSigTimeoutValue" SG_ 971 ADC_ParkRelPos7_x3 0;
BA_ "Remark" SG_ 971 ADC_ParkRelPos7_x3 "";
BA_ "EventCommandSignal" SG_ 971 ADC_ParkRelPos7_y3 0;
BA_ "GatewayedSignals" SG_ 971 ADC_ParkRelPos7_y3 0;
BA_ "GenSigInactiveValue" SG_ 971 ADC_ParkRelPos7_y3 0;
BA_ "GenSigInvalidValue" SG_ 971 ADC_ParkRelPos7_y3 0;
BA_ "GenSigSendType" SG_ 971 ADC_ParkRelPos7_y3 1;
BA_ "GenSigStartValue" SG_ 971 ADC_ParkRelPos7_y3 0;
BA_ "GenSigTimeoutValue" SG_ 971 ADC_ParkRelPos7_y3 0;
BA_ "Remark" SG_ 971 ADC_ParkRelPos7_y3 "";
BA_ "EventCommandSignal" SG_ 971 ADC_ParkRelPos7_x4 0;
BA_ "GatewayedSignals" SG_ 971 ADC_ParkRelPos7_x4 0;
BA_ "GenSigInactiveValue" SG_ 971 ADC_ParkRelPos7_x4 0;
BA_ "GenSigInvalidValue" SG_ 971 ADC_ParkRelPos7_x4 0;
BA_ "GenSigSendType" SG_ 971 ADC_ParkRelPos7_x4 1;
BA_ "GenSigStartValue" SG_ 971 ADC_ParkRelPos7_x4 0;
BA_ "GenSigTimeoutValue" SG_ 971 ADC_ParkRelPos7_x4 0;
BA_ "Remark" SG_ 971 ADC_ParkRelPos7_x4 "";
BA_ "EventCommandSignal" SG_ 971 ADC_ParkRelPos7_y4 0;
BA_ "GatewayedSignals" SG_ 971 ADC_ParkRelPos7_y4 0;
BA_ "GenSigInactiveValue" SG_ 971 ADC_ParkRelPos7_y4 0;
BA_ "GenSigInvalidValue" SG_ 971 ADC_ParkRelPos7_y4 0;
BA_ "GenSigSendType" SG_ 971 ADC_ParkRelPos7_y4 1;
BA_ "GenSigStartValue" SG_ 971 ADC_ParkRelPos7_y4 0;
BA_ "GenSigTimeoutValue" SG_ 971 ADC_ParkRelPos7_y4 0;
BA_ "Remark" SG_ 971 ADC_ParkRelPos7_y4 "";
BA_ "EventCommandSignal" SG_ 971 ADC_ParkRelPos8_x1 0;
BA_ "GatewayedSignals" SG_ 971 ADC_ParkRelPos8_x1 0;
BA_ "GenSigInactiveValue" SG_ 971 ADC_ParkRelPos8_x1 0;
BA_ "GenSigInvalidValue" SG_ 971 ADC_ParkRelPos8_x1 0;
BA_ "GenSigSendType" SG_ 971 ADC_ParkRelPos8_x1 1;
BA_ "GenSigStartValue" SG_ 971 ADC_ParkRelPos8_x1 0;
BA_ "GenSigTimeoutValue" SG_ 971 ADC_ParkRelPos8_x1 0;
BA_ "Remark" SG_ 971 ADC_ParkRelPos8_x1 "";
BA_ "EventCommandSignal" SG_ 971 ADC_ParkRelPos8_y1 0;
BA_ "GatewayedSignals" SG_ 971 ADC_ParkRelPos8_y1 0;
BA_ "GenSigInactiveValue" SG_ 971 ADC_ParkRelPos8_y1 0;
BA_ "GenSigInvalidValue" SG_ 971 ADC_ParkRelPos8_y1 0;
BA_ "GenSigSendType" SG_ 971 ADC_ParkRelPos8_y1 1;
BA_ "GenSigStartValue" SG_ 971 ADC_ParkRelPos8_y1 0;
BA_ "GenSigTimeoutValue" SG_ 971 ADC_ParkRelPos8_y1 0;
BA_ "Remark" SG_ 971 ADC_ParkRelPos8_y1 "";
BA_ "EventCommandSignal" SG_ 971 ADC_ParkRelPos8_x2 0;
BA_ "GatewayedSignals" SG_ 971 ADC_ParkRelPos8_x2 0;
BA_ "GenSigInactiveValue" SG_ 971 ADC_ParkRelPos8_x2 0;
BA_ "GenSigInvalidValue" SG_ 971 ADC_ParkRelPos8_x2 0;
BA_ "GenSigSendType" SG_ 971 ADC_ParkRelPos8_x2 1;
BA_ "GenSigStartValue" SG_ 971 ADC_ParkRelPos8_x2 0;
BA_ "GenSigTimeoutValue" SG_ 971 ADC_ParkRelPos8_x2 0;
BA_ "Remark" SG_ 971 ADC_ParkRelPos8_x2 "";
BA_ "EventCommandSignal" SG_ 971 ADC_ParkRelPos8_y2 0;
BA_ "GatewayedSignals" SG_ 971 ADC_ParkRelPos8_y2 0;
BA_ "GenSigInactiveValue" SG_ 971 ADC_ParkRelPos8_y2 0;
BA_ "GenSigInvalidValue" SG_ 971 ADC_ParkRelPos8_y2 0;
BA_ "GenSigSendType" SG_ 971 ADC_ParkRelPos8_y2 1;
BA_ "GenSigStartValue" SG_ 971 ADC_ParkRelPos8_y2 0;
BA_ "GenSigTimeoutValue" SG_ 971 ADC_ParkRelPos8_y2 0;
BA_ "Remark" SG_ 971 ADC_ParkRelPos8_y2 "";
BA_ "EventCommandSignal" SG_ 971 ADC_ParkRelPos8_x3 0;
BA_ "GatewayedSignals" SG_ 971 ADC_ParkRelPos8_x3 0;
BA_ "GenSigInactiveValue" SG_ 971 ADC_ParkRelPos8_x3 0;
BA_ "GenSigInvalidValue" SG_ 971 ADC_ParkRelPos8_x3 0;
BA_ "GenSigSendType" SG_ 971 ADC_ParkRelPos8_x3 1;
BA_ "GenSigStartValue" SG_ 971 ADC_ParkRelPos8_x3 0;
BA_ "GenSigTimeoutValue" SG_ 971 ADC_ParkRelPos8_x3 0;
BA_ "Remark" SG_ 971 ADC_ParkRelPos8_x3 "";
BA_ "EventCommandSignal" SG_ 971 ADC_ParkRelPos8_y3 0;
BA_ "GatewayedSignals" SG_ 971 ADC_ParkRelPos8_y3 0;
BA_ "GenSigInactiveValue" SG_ 971 ADC_ParkRelPos8_y3 0;
BA_ "GenSigInvalidValue" SG_ 971 ADC_ParkRelPos8_y3 0;
BA_ "GenSigSendType" SG_ 971 ADC_ParkRelPos8_y3 1;
BA_ "GenSigStartValue" SG_ 971 ADC_ParkRelPos8_y3 0;
BA_ "GenSigTimeoutValue" SG_ 971 ADC_ParkRelPos8_y3 0;
BA_ "Remark" SG_ 971 ADC_ParkRelPos8_y3 "";
BA_ "EventCommandSignal" SG_ 971 ADC_ParkRelPos8_x4 0;
BA_ "GatewayedSignals" SG_ 971 ADC_ParkRelPos8_x4 0;
BA_ "GenSigInactiveValue" SG_ 971 ADC_ParkRelPos8_x4 0;
BA_ "GenSigInvalidValue" SG_ 971 ADC_ParkRelPos8_x4 0;
BA_ "GenSigSendType" SG_ 971 ADC_ParkRelPos8_x4 1;
BA_ "GenSigStartValue" SG_ 971 ADC_ParkRelPos8_x4 0;
BA_ "GenSigTimeoutValue" SG_ 971 ADC_ParkRelPos8_x4 0;
BA_ "Remark" SG_ 971 ADC_ParkRelPos8_x4 "";
BA_ "EventCommandSignal" SG_ 971 ADC_ParkRelPos8_y4 0;
BA_ "GatewayedSignals" SG_ 971 ADC_ParkRelPos8_y4 0;
BA_ "GenSigInactiveValue" SG_ 971 ADC_ParkRelPos8_y4 0;
BA_ "GenSigInvalidValue" SG_ 971 ADC_ParkRelPos8_y4 0;
BA_ "GenSigSendType" SG_ 971 ADC_ParkRelPos8_y4 1;
BA_ "GenSigStartValue" SG_ 971 ADC_ParkRelPos8_y4 0;
BA_ "GenSigTimeoutValue" SG_ 971 ADC_ParkRelPos8_y4 0;
BA_ "Remark" SG_ 971 ADC_ParkRelPos8_y4 "";
BA_ "EventCommandSignal" SG_ 971 ADC_ParkPosn5_ID 0;
BA_ "GatewayedSignals" SG_ 971 ADC_ParkPosn5_ID 0;
BA_ "GenSigInactiveValue" SG_ 971 ADC_ParkPosn5_ID 0;
BA_ "GenSigInvalidValue" SG_ 971 ADC_ParkPosn5_ID 0;
BA_ "GenSigSendType" SG_ 971 ADC_ParkPosn5_ID 1;
BA_ "GenSigStartValue" SG_ 971 ADC_ParkPosn5_ID 0;
BA_ "GenSigTimeoutValue" SG_ 971 ADC_ParkPosn5_ID 0;
BA_ "Remark" SG_ 971 ADC_ParkPosn5_ID "";
BA_ "EventCommandSignal" SG_ 971 ADC_MnvrOrintChng5 0;
BA_ "GatewayedSignals" SG_ 971 ADC_MnvrOrintChng5 0;
BA_ "GenSigInactiveValue" SG_ 971 ADC_MnvrOrintChng5 0;
BA_ "GenSigInvalidValue" SG_ 971 ADC_MnvrOrintChng5 0;
BA_ "GenSigSendType" SG_ 971 ADC_MnvrOrintChng5 1;
BA_ "GenSigStartValue" SG_ 971 ADC_MnvrOrintChng5 0;
BA_ "GenSigTimeoutValue" SG_ 971 ADC_MnvrOrintChng5 0;
BA_ "Remark" SG_ 971 ADC_MnvrOrintChng5 "";
BA_ "EventCommandSignal" SG_ 971 ADC_TarParkSt_Posn5 0;
BA_ "GatewayedSignals" SG_ 971 ADC_TarParkSt_Posn5 0;
BA_ "GenSigInactiveValue" SG_ 971 ADC_TarParkSt_Posn5 0;
BA_ "GenSigInvalidValue" SG_ 971 ADC_TarParkSt_Posn5 0;
BA_ "GenSigSendType" SG_ 971 ADC_TarParkSt_Posn5 1;
BA_ "GenSigStartValue" SG_ 971 ADC_TarParkSt_Posn5 0;
BA_ "GenSigTimeoutValue" SG_ 971 ADC_TarParkSt_Posn5 0;
BA_ "Remark" SG_ 971 ADC_TarParkSt_Posn5 "";
BA_ "EventCommandSignal" SG_ 971 ADC_ParkChkSrc_Posn5 0;
BA_ "GatewayedSignals" SG_ 971 ADC_ParkChkSrc_Posn5 0;
BA_ "GenSigInactiveValue" SG_ 971 ADC_ParkChkSrc_Posn5 0;
BA_ "GenSigInvalidValue" SG_ 971 ADC_ParkChkSrc_Posn5 0;
BA_ "GenSigSendType" SG_ 971 ADC_ParkChkSrc_Posn5 1;
BA_ "GenSigStartValue" SG_ 971 ADC_ParkChkSrc_Posn5 0;
BA_ "GenSigTimeoutValue" SG_ 971 ADC_ParkChkSrc_Posn5 0;
BA_ "Remark" SG_ 971 ADC_ParkChkSrc_Posn5 "";
BA_ "EventCommandSignal" SG_ 971 ADC_ParkPosn6_ID 0;
BA_ "GatewayedSignals" SG_ 971 ADC_ParkPosn6_ID 0;
BA_ "GenSigInactiveValue" SG_ 971 ADC_ParkPosn6_ID 0;
BA_ "GenSigInvalidValue" SG_ 971 ADC_ParkPosn6_ID 0;
BA_ "GenSigSendType" SG_ 971 ADC_ParkPosn6_ID 1;
BA_ "GenSigStartValue" SG_ 971 ADC_ParkPosn6_ID 0;
BA_ "GenSigTimeoutValue" SG_ 971 ADC_ParkPosn6_ID 0;
BA_ "Remark" SG_ 971 ADC_ParkPosn6_ID "";
BA_ "EventCommandSignal" SG_ 1110 ADC_PktType 0;
BA_ "GatewayedSignals" SG_ 1110 ADC_PktType 0;
BA_ "GenSigInactiveValue" SG_ 1110 ADC_PktType 0;
BA_ "GenSigInvalidValue" SG_ 1110 ADC_PktType 255;
BA_ "GenSigSendType" SG_ 1110 ADC_PktType 1;
BA_ "GenSigStartValue" SG_ 1110 ADC_PktType 0;
BA_ "GenSigTimeoutValue" SG_ 1110 ADC_PktType 0;
BA_ "Remark" SG_ 1110 ADC_PktType "";
BA_ "EventCommandSignal" SG_ 1110 ADC_CANTRACEStatus0 0;
BA_ "GatewayedSignals" SG_ 1110 ADC_CANTRACEStatus0 0;
BA_ "GenSigInactiveValue" SG_ 1110 ADC_CANTRACEStatus0 0;
BA_ "GenSigInvalidValue" SG_ 1110 ADC_CANTRACEStatus0 255;
BA_ "GenSigSendType" SG_ 1110 ADC_CANTRACEStatus0 1;
BA_ "GenSigStartValue" SG_ 1110 ADC_CANTRACEStatus0 0;
BA_ "GenSigTimeoutValue" SG_ 1110 ADC_CANTRACEStatus0 0;
BA_ "Remark" SG_ 1110 ADC_CANTRACEStatus0 "";
BA_ "EventCommandSignal" SG_ 1110 ADC_CANTRACEStatus1 0;
BA_ "GatewayedSignals" SG_ 1110 ADC_CANTRACEStatus1 0;
BA_ "GenSigInactiveValue" SG_ 1110 ADC_CANTRACEStatus1 0;
BA_ "GenSigInvalidValue" SG_ 1110 ADC_CANTRACEStatus1 255;
BA_ "GenSigSendType" SG_ 1110 ADC_CANTRACEStatus1 1;
BA_ "GenSigStartValue" SG_ 1110 ADC_CANTRACEStatus1 0;
BA_ "GenSigTimeoutValue" SG_ 1110 ADC_CANTRACEStatus1 0;
BA_ "Remark" SG_ 1110 ADC_CANTRACEStatus1 "";
BA_ "EventCommandSignal" SG_ 1110 ADC_CANTRACEStatus2 0;
BA_ "GatewayedSignals" SG_ 1110 ADC_CANTRACEStatus2 0;
BA_ "GenSigInactiveValue" SG_ 1110 ADC_CANTRACEStatus2 0;
BA_ "GenSigInvalidValue" SG_ 1110 ADC_CANTRACEStatus2 255;
BA_ "GenSigSendType" SG_ 1110 ADC_CANTRACEStatus2 1;
BA_ "GenSigStartValue" SG_ 1110 ADC_CANTRACEStatus2 0;
BA_ "GenSigTimeoutValue" SG_ 1110 ADC_CANTRACEStatus2 0;
BA_ "Remark" SG_ 1110 ADC_CANTRACEStatus2 "";
BA_ "EventCommandSignal" SG_ 1110 ADC_CANTRACEStatus3 0;
BA_ "GatewayedSignals" SG_ 1110 ADC_CANTRACEStatus3 0;
BA_ "GenSigInactiveValue" SG_ 1110 ADC_CANTRACEStatus3 0;
BA_ "GenSigInvalidValue" SG_ 1110 ADC_CANTRACEStatus3 255;
BA_ "GenSigSendType" SG_ 1110 ADC_CANTRACEStatus3 1;
BA_ "GenSigStartValue" SG_ 1110 ADC_CANTRACEStatus3 0;
BA_ "GenSigTimeoutValue" SG_ 1110 ADC_CANTRACEStatus3 0;
BA_ "Remark" SG_ 1110 ADC_CANTRACEStatus3 "";
BA_ "EventCommandSignal" SG_ 1110 ADC_CANTRACEStatus4 0;
BA_ "GatewayedSignals" SG_ 1110 ADC_CANTRACEStatus4 0;
BA_ "GenSigInactiveValue" SG_ 1110 ADC_CANTRACEStatus4 0;
BA_ "GenSigInvalidValue" SG_ 1110 ADC_CANTRACEStatus4 255;
BA_ "GenSigSendType" SG_ 1110 ADC_CANTRACEStatus4 1;
BA_ "GenSigStartValue" SG_ 1110 ADC_CANTRACEStatus4 0;
BA_ "GenSigTimeoutValue" SG_ 1110 ADC_CANTRACEStatus4 0;
BA_ "Remark" SG_ 1110 ADC_CANTRACEStatus4 "";
BA_ "EventCommandSignal" SG_ 1110 ADC_CANTRACEStatus5 0;
BA_ "GatewayedSignals" SG_ 1110 ADC_CANTRACEStatus5 0;
BA_ "GenSigInactiveValue" SG_ 1110 ADC_CANTRACEStatus5 0;
BA_ "GenSigInvalidValue" SG_ 1110 ADC_CANTRACEStatus5 255;
BA_ "GenSigSendType" SG_ 1110 ADC_CANTRACEStatus5 1;
BA_ "GenSigStartValue" SG_ 1110 ADC_CANTRACEStatus5 0;
BA_ "GenSigTimeoutValue" SG_ 1110 ADC_CANTRACEStatus5 0;
BA_ "Remark" SG_ 1110 ADC_CANTRACEStatus5 "";
BA_ "EventCommandSignal" SG_ 1110 ADC_CANTRACEStatus6 0;
BA_ "GatewayedSignals" SG_ 1110 ADC_CANTRACEStatus6 0;
BA_ "GenSigInactiveValue" SG_ 1110 ADC_CANTRACEStatus6 0;
BA_ "GenSigInvalidValue" SG_ 1110 ADC_CANTRACEStatus6 255;
BA_ "GenSigSendType" SG_ 1110 ADC_CANTRACEStatus6 1;
BA_ "GenSigStartValue" SG_ 1110 ADC_CANTRACEStatus6 0;
BA_ "GenSigTimeoutValue" SG_ 1110 ADC_CANTRACEStatus6 0;
BA_ "Remark" SG_ 1110 ADC_CANTRACEStatus6 "";
BA_ "EventCommandSignal" SG_ 1110 ADC_CANTRACEStatus7 0;
BA_ "GatewayedSignals" SG_ 1110 ADC_CANTRACEStatus7 0;
BA_ "GenSigInactiveValue" SG_ 1110 ADC_CANTRACEStatus7 0;
BA_ "GenSigInvalidValue" SG_ 1110 ADC_CANTRACEStatus7 255;
BA_ "GenSigSendType" SG_ 1110 ADC_CANTRACEStatus7 1;
BA_ "GenSigStartValue" SG_ 1110 ADC_CANTRACEStatus7 0;
BA_ "GenSigTimeoutValue" SG_ 1110 ADC_CANTRACEStatus7 0;
BA_ "Remark" SG_ 1110 ADC_CANTRACEStatus7 "";
BA_ "EventCommandSignal" SG_ 1110 ADC_CANTRACEStatus8 0;
BA_ "GatewayedSignals" SG_ 1110 ADC_CANTRACEStatus8 0;
BA_ "GenSigInactiveValue" SG_ 1110 ADC_CANTRACEStatus8 0;
BA_ "GenSigInvalidValue" SG_ 1110 ADC_CANTRACEStatus8 255;
BA_ "GenSigSendType" SG_ 1110 ADC_CANTRACEStatus8 1;
BA_ "GenSigStartValue" SG_ 1110 ADC_CANTRACEStatus8 0;
BA_ "GenSigTimeoutValue" SG_ 1110 ADC_CANTRACEStatus8 0;
BA_ "Remark" SG_ 1110 ADC_CANTRACEStatus8 "";
BA_ "EventCommandSignal" SG_ 1110 ADC_CANTRACEStatus9 0;
BA_ "GatewayedSignals" SG_ 1110 ADC_CANTRACEStatus9 0;
BA_ "GenSigInactiveValue" SG_ 1110 ADC_CANTRACEStatus9 0;
BA_ "GenSigInvalidValue" SG_ 1110 ADC_CANTRACEStatus9 255;
BA_ "GenSigSendType" SG_ 1110 ADC_CANTRACEStatus9 1;
BA_ "GenSigStartValue" SG_ 1110 ADC_CANTRACEStatus9 0;
BA_ "GenSigTimeoutValue" SG_ 1110 ADC_CANTRACEStatus9 0;
BA_ "Remark" SG_ 1110 ADC_CANTRACEStatus9 "";
BA_ "EventCommandSignal" SG_ 1110 ADC_CANTRACEStatus10 0;
BA_ "GatewayedSignals" SG_ 1110 ADC_CANTRACEStatus10 0;
BA_ "GenSigInactiveValue" SG_ 1110 ADC_CANTRACEStatus10 0;
BA_ "GenSigInvalidValue" SG_ 1110 ADC_CANTRACEStatus10 255;
BA_ "GenSigSendType" SG_ 1110 ADC_CANTRACEStatus10 1;
BA_ "GenSigStartValue" SG_ 1110 ADC_CANTRACEStatus10 0;
BA_ "GenSigTimeoutValue" SG_ 1110 ADC_CANTRACEStatus10 0;
BA_ "Remark" SG_ 1110 ADC_CANTRACEStatus10 "";
BA_ "EventCommandSignal" SG_ 1110 ADC_CANTRACEStatus11 0;
BA_ "GatewayedSignals" SG_ 1110 ADC_CANTRACEStatus11 0;
BA_ "GenSigInactiveValue" SG_ 1110 ADC_CANTRACEStatus11 0;
BA_ "GenSigInvalidValue" SG_ 1110 ADC_CANTRACEStatus11 255;
BA_ "GenSigSendType" SG_ 1110 ADC_CANTRACEStatus11 1;
BA_ "GenSigStartValue" SG_ 1110 ADC_CANTRACEStatus11 0;
BA_ "GenSigTimeoutValue" SG_ 1110 ADC_CANTRACEStatus11 0;
BA_ "Remark" SG_ 1110 ADC_CANTRACEStatus11 "";
BA_ "EventCommandSignal" SG_ 1110 ADC_CANTRACEStatus12 0;
BA_ "GatewayedSignals" SG_ 1110 ADC_CANTRACEStatus12 0;
BA_ "GenSigInactiveValue" SG_ 1110 ADC_CANTRACEStatus12 0;
BA_ "GenSigInvalidValue" SG_ 1110 ADC_CANTRACEStatus12 255;
BA_ "GenSigSendType" SG_ 1110 ADC_CANTRACEStatus12 1;
BA_ "GenSigStartValue" SG_ 1110 ADC_CANTRACEStatus12 0;
BA_ "GenSigTimeoutValue" SG_ 1110 ADC_CANTRACEStatus12 0;
BA_ "Remark" SG_ 1110 ADC_CANTRACEStatus12 "";
BA_ "EventCommandSignal" SG_ 1110 ADC_CANTRACEStatus13 0;
BA_ "GatewayedSignals" SG_ 1110 ADC_CANTRACEStatus13 0;
BA_ "GenSigInactiveValue" SG_ 1110 ADC_CANTRACEStatus13 0;
BA_ "GenSigInvalidValue" SG_ 1110 ADC_CANTRACEStatus13 255;
BA_ "GenSigSendType" SG_ 1110 ADC_CANTRACEStatus13 1;
BA_ "GenSigStartValue" SG_ 1110 ADC_CANTRACEStatus13 0;
BA_ "GenSigTimeoutValue" SG_ 1110 ADC_CANTRACEStatus13 0;
BA_ "Remark" SG_ 1110 ADC_CANTRACEStatus13 "";
BA_ "EventCommandSignal" SG_ 1110 ADC_CANTRACEStatus14 0;
BA_ "GatewayedSignals" SG_ 1110 ADC_CANTRACEStatus14 0;
BA_ "GenSigInactiveValue" SG_ 1110 ADC_CANTRACEStatus14 0;
BA_ "GenSigInvalidValue" SG_ 1110 ADC_CANTRACEStatus14 255;
BA_ "GenSigSendType" SG_ 1110 ADC_CANTRACEStatus14 1;
BA_ "GenSigStartValue" SG_ 1110 ADC_CANTRACEStatus14 0;
BA_ "GenSigTimeoutValue" SG_ 1110 ADC_CANTRACEStatus14 0;
BA_ "Remark" SG_ 1110 ADC_CANTRACEStatus14 "";
BA_ "EventCommandSignal" SG_ 1110 ADC_CANTRACEStatus15 0;
BA_ "GatewayedSignals" SG_ 1110 ADC_CANTRACEStatus15 0;
BA_ "GenSigInactiveValue" SG_ 1110 ADC_CANTRACEStatus15 0;
BA_ "GenSigInvalidValue" SG_ 1110 ADC_CANTRACEStatus15 255;
BA_ "GenSigSendType" SG_ 1110 ADC_CANTRACEStatus15 1;
BA_ "GenSigStartValue" SG_ 1110 ADC_CANTRACEStatus15 0;
BA_ "GenSigTimeoutValue" SG_ 1110 ADC_CANTRACEStatus15 0;
BA_ "Remark" SG_ 1110 ADC_CANTRACEStatus15 "";
BA_ "EventCommandSignal" SG_ 1110 ADC_CANTRACEStatus16 0;
BA_ "GatewayedSignals" SG_ 1110 ADC_CANTRACEStatus16 0;
BA_ "GenSigInactiveValue" SG_ 1110 ADC_CANTRACEStatus16 0;
BA_ "GenSigInvalidValue" SG_ 1110 ADC_CANTRACEStatus16 255;
BA_ "GenSigSendType" SG_ 1110 ADC_CANTRACEStatus16 1;
BA_ "GenSigStartValue" SG_ 1110 ADC_CANTRACEStatus16 0;
BA_ "GenSigTimeoutValue" SG_ 1110 ADC_CANTRACEStatus16 0;
BA_ "Remark" SG_ 1110 ADC_CANTRACEStatus16 "";
BA_ "EventCommandSignal" SG_ 1110 ADC_CANTRACEStatus17 0;
BA_ "GatewayedSignals" SG_ 1110 ADC_CANTRACEStatus17 0;
BA_ "GenSigInactiveValue" SG_ 1110 ADC_CANTRACEStatus17 0;
BA_ "GenSigInvalidValue" SG_ 1110 ADC_CANTRACEStatus17 255;
BA_ "GenSigSendType" SG_ 1110 ADC_CANTRACEStatus17 1;
BA_ "GenSigStartValue" SG_ 1110 ADC_CANTRACEStatus17 0;
BA_ "GenSigTimeoutValue" SG_ 1110 ADC_CANTRACEStatus17 0;
BA_ "Remark" SG_ 1110 ADC_CANTRACEStatus17 "";
BA_ "EventCommandSignal" SG_ 1110 ADC_CANTRACEStatus18 0;
BA_ "GatewayedSignals" SG_ 1110 ADC_CANTRACEStatus18 0;
BA_ "GenSigInactiveValue" SG_ 1110 ADC_CANTRACEStatus18 0;
BA_ "GenSigInvalidValue" SG_ 1110 ADC_CANTRACEStatus18 255;
BA_ "GenSigSendType" SG_ 1110 ADC_CANTRACEStatus18 1;
BA_ "GenSigStartValue" SG_ 1110 ADC_CANTRACEStatus18 0;
BA_ "GenSigTimeoutValue" SG_ 1110 ADC_CANTRACEStatus18 0;
BA_ "Remark" SG_ 1110 ADC_CANTRACEStatus18 "";
BA_ "EventCommandSignal" SG_ 1110 ADC_CANTRACEStatus19 0;
BA_ "GatewayedSignals" SG_ 1110 ADC_CANTRACEStatus19 0;
BA_ "GenSigInactiveValue" SG_ 1110 ADC_CANTRACEStatus19 0;
BA_ "GenSigInvalidValue" SG_ 1110 ADC_CANTRACEStatus19 255;
BA_ "GenSigSendType" SG_ 1110 ADC_CANTRACEStatus19 1;
BA_ "GenSigStartValue" SG_ 1110 ADC_CANTRACEStatus19 0;
BA_ "GenSigTimeoutValue" SG_ 1110 ADC_CANTRACEStatus19 0;
BA_ "Remark" SG_ 1110 ADC_CANTRACEStatus19 "";
BA_ "EventCommandSignal" SG_ 1110 ADC_CANTRACEStatus20 0;
BA_ "GatewayedSignals" SG_ 1110 ADC_CANTRACEStatus20 0;
BA_ "GenSigInactiveValue" SG_ 1110 ADC_CANTRACEStatus20 0;
BA_ "GenSigInvalidValue" SG_ 1110 ADC_CANTRACEStatus20 255;
BA_ "GenSigSendType" SG_ 1110 ADC_CANTRACEStatus20 1;
BA_ "GenSigStartValue" SG_ 1110 ADC_CANTRACEStatus20 0;
BA_ "GenSigTimeoutValue" SG_ 1110 ADC_CANTRACEStatus20 0;
BA_ "Remark" SG_ 1110 ADC_CANTRACEStatus20 "";
BA_ "EventCommandSignal" SG_ 1110 ADC_CANTRACEStatus21 0;
BA_ "GatewayedSignals" SG_ 1110 ADC_CANTRACEStatus21 0;
BA_ "GenSigInactiveValue" SG_ 1110 ADC_CANTRACEStatus21 0;
BA_ "GenSigInvalidValue" SG_ 1110 ADC_CANTRACEStatus21 255;
BA_ "GenSigSendType" SG_ 1110 ADC_CANTRACEStatus21 1;
BA_ "GenSigStartValue" SG_ 1110 ADC_CANTRACEStatus21 0;
BA_ "GenSigTimeoutValue" SG_ 1110 ADC_CANTRACEStatus21 0;
BA_ "Remark" SG_ 1110 ADC_CANTRACEStatus21 "";
BA_ "EventCommandSignal" SG_ 1110 ADC_CANTRACEStatus22 0;
BA_ "GatewayedSignals" SG_ 1110 ADC_CANTRACEStatus22 0;
BA_ "GenSigInactiveValue" SG_ 1110 ADC_CANTRACEStatus22 0;
BA_ "GenSigInvalidValue" SG_ 1110 ADC_CANTRACEStatus22 255;
BA_ "GenSigSendType" SG_ 1110 ADC_CANTRACEStatus22 1;
BA_ "GenSigStartValue" SG_ 1110 ADC_CANTRACEStatus22 0;
BA_ "GenSigTimeoutValue" SG_ 1110 ADC_CANTRACEStatus22 0;
BA_ "Remark" SG_ 1110 ADC_CANTRACEStatus22 "";
BA_ "EventCommandSignal" SG_ 1110 ADC_CANTRACEStatus23 0;
BA_ "GatewayedSignals" SG_ 1110 ADC_CANTRACEStatus23 0;
BA_ "GenSigInactiveValue" SG_ 1110 ADC_CANTRACEStatus23 0;
BA_ "GenSigInvalidValue" SG_ 1110 ADC_CANTRACEStatus23 255;
BA_ "GenSigSendType" SG_ 1110 ADC_CANTRACEStatus23 1;
BA_ "GenSigStartValue" SG_ 1110 ADC_CANTRACEStatus23 0;
BA_ "GenSigTimeoutValue" SG_ 1110 ADC_CANTRACEStatus23 0;
BA_ "Remark" SG_ 1110 ADC_CANTRACEStatus23 "";
BA_ "EventCommandSignal" SG_ 1110 ADC_CANTRACEStatus24 0;
BA_ "GatewayedSignals" SG_ 1110 ADC_CANTRACEStatus24 0;
BA_ "GenSigInactiveValue" SG_ 1110 ADC_CANTRACEStatus24 0;
BA_ "GenSigInvalidValue" SG_ 1110 ADC_CANTRACEStatus24 255;
BA_ "GenSigSendType" SG_ 1110 ADC_CANTRACEStatus24 1;
BA_ "GenSigStartValue" SG_ 1110 ADC_CANTRACEStatus24 0;
BA_ "GenSigTimeoutValue" SG_ 1110 ADC_CANTRACEStatus24 0;
BA_ "Remark" SG_ 1110 ADC_CANTRACEStatus24 "";
BA_ "EventCommandSignal" SG_ 1110 ADC_CANTRACEStatus25 0;
BA_ "GatewayedSignals" SG_ 1110 ADC_CANTRACEStatus25 0;
BA_ "GenSigInactiveValue" SG_ 1110 ADC_CANTRACEStatus25 0;
BA_ "GenSigInvalidValue" SG_ 1110 ADC_CANTRACEStatus25 255;
BA_ "GenSigSendType" SG_ 1110 ADC_CANTRACEStatus25 1;
BA_ "GenSigStartValue" SG_ 1110 ADC_CANTRACEStatus25 0;
BA_ "GenSigTimeoutValue" SG_ 1110 ADC_CANTRACEStatus25 0;
BA_ "Remark" SG_ 1110 ADC_CANTRACEStatus25 "";
BA_ "EventCommandSignal" SG_ 1110 ADC_CANTRACEStatus26 0;
BA_ "GatewayedSignals" SG_ 1110 ADC_CANTRACEStatus26 0;
BA_ "GenSigInactiveValue" SG_ 1110 ADC_CANTRACEStatus26 0;
BA_ "GenSigInvalidValue" SG_ 1110 ADC_CANTRACEStatus26 255;
BA_ "GenSigSendType" SG_ 1110 ADC_CANTRACEStatus26 1;
BA_ "GenSigStartValue" SG_ 1110 ADC_CANTRACEStatus26 0;
BA_ "GenSigTimeoutValue" SG_ 1110 ADC_CANTRACEStatus26 0;
BA_ "Remark" SG_ 1110 ADC_CANTRACEStatus26 "";
BA_ "EventCommandSignal" SG_ 1110 ADC_CANTRACEStatus27 0;
BA_ "GatewayedSignals" SG_ 1110 ADC_CANTRACEStatus27 0;
BA_ "GenSigInactiveValue" SG_ 1110 ADC_CANTRACEStatus27 0;
BA_ "GenSigInvalidValue" SG_ 1110 ADC_CANTRACEStatus27 255;
BA_ "GenSigSendType" SG_ 1110 ADC_CANTRACEStatus27 1;
BA_ "GenSigStartValue" SG_ 1110 ADC_CANTRACEStatus27 0;
BA_ "GenSigTimeoutValue" SG_ 1110 ADC_CANTRACEStatus27 0;
BA_ "Remark" SG_ 1110 ADC_CANTRACEStatus27 "";
BA_ "EventCommandSignal" SG_ 1110 ADC_CANTRACEStatus28 0;
BA_ "GatewayedSignals" SG_ 1110 ADC_CANTRACEStatus28 0;
BA_ "GenSigInactiveValue" SG_ 1110 ADC_CANTRACEStatus28 0;
BA_ "GenSigInvalidValue" SG_ 1110 ADC_CANTRACEStatus28 255;
BA_ "GenSigSendType" SG_ 1110 ADC_CANTRACEStatus28 1;
BA_ "GenSigStartValue" SG_ 1110 ADC_CANTRACEStatus28 0;
BA_ "GenSigTimeoutValue" SG_ 1110 ADC_CANTRACEStatus28 0;
BA_ "Remark" SG_ 1110 ADC_CANTRACEStatus28 "";
BA_ "EventCommandSignal" SG_ 1110 ADC_CANTRACEStatus29 0;
BA_ "GatewayedSignals" SG_ 1110 ADC_CANTRACEStatus29 0;
BA_ "GenSigInactiveValue" SG_ 1110 ADC_CANTRACEStatus29 0;
BA_ "GenSigInvalidValue" SG_ 1110 ADC_CANTRACEStatus29 255;
BA_ "GenSigSendType" SG_ 1110 ADC_CANTRACEStatus29 1;
BA_ "GenSigStartValue" SG_ 1110 ADC_CANTRACEStatus29 0;
BA_ "GenSigTimeoutValue" SG_ 1110 ADC_CANTRACEStatus29 0;
BA_ "Remark" SG_ 1110 ADC_CANTRACEStatus29 "";
BA_ "EventCommandSignal" SG_ 1110 ADC_CANTRACEStatus30 0;
BA_ "GatewayedSignals" SG_ 1110 ADC_CANTRACEStatus30 0;
BA_ "GenSigInactiveValue" SG_ 1110 ADC_CANTRACEStatus30 0;
BA_ "GenSigInvalidValue" SG_ 1110 ADC_CANTRACEStatus30 255;
BA_ "GenSigSendType" SG_ 1110 ADC_CANTRACEStatus30 1;
BA_ "GenSigStartValue" SG_ 1110 ADC_CANTRACEStatus30 0;
BA_ "GenSigTimeoutValue" SG_ 1110 ADC_CANTRACEStatus30 0;
BA_ "Remark" SG_ 1110 ADC_CANTRACEStatus30 "";
BA_ "EventCommandSignal" SG_ 1110 ADC_CANTRACEStatus31 0;
BA_ "GatewayedSignals" SG_ 1110 ADC_CANTRACEStatus31 0;
BA_ "GenSigInactiveValue" SG_ 1110 ADC_CANTRACEStatus31 0;
BA_ "GenSigInvalidValue" SG_ 1110 ADC_CANTRACEStatus31 255;
BA_ "GenSigSendType" SG_ 1110 ADC_CANTRACEStatus31 1;
BA_ "GenSigStartValue" SG_ 1110 ADC_CANTRACEStatus31 0;
BA_ "GenSigTimeoutValue" SG_ 1110 ADC_CANTRACEStatus31 0;
BA_ "Remark" SG_ 1110 ADC_CANTRACEStatus31 "";
BA_ "EventCommandSignal" SG_ 1110 ADC_CANTRACEStatus32 0;
BA_ "GatewayedSignals" SG_ 1110 ADC_CANTRACEStatus32 0;
BA_ "GenSigInactiveValue" SG_ 1110 ADC_CANTRACEStatus32 0;
BA_ "GenSigInvalidValue" SG_ 1110 ADC_CANTRACEStatus32 255;
BA_ "GenSigSendType" SG_ 1110 ADC_CANTRACEStatus32 1;
BA_ "GenSigStartValue" SG_ 1110 ADC_CANTRACEStatus32 0;
BA_ "GenSigTimeoutValue" SG_ 1110 ADC_CANTRACEStatus32 0;
BA_ "Remark" SG_ 1110 ADC_CANTRACEStatus32 "";
BA_ "EventCommandSignal" SG_ 1110 ADC_CANTRACEStatus33 0;
BA_ "GatewayedSignals" SG_ 1110 ADC_CANTRACEStatus33 0;
BA_ "GenSigInactiveValue" SG_ 1110 ADC_CANTRACEStatus33 0;
BA_ "GenSigInvalidValue" SG_ 1110 ADC_CANTRACEStatus33 255;
BA_ "GenSigSendType" SG_ 1110 ADC_CANTRACEStatus33 1;
BA_ "GenSigStartValue" SG_ 1110 ADC_CANTRACEStatus33 0;
BA_ "GenSigTimeoutValue" SG_ 1110 ADC_CANTRACEStatus33 0;
BA_ "Remark" SG_ 1110 ADC_CANTRACEStatus33 "";
BA_ "EventCommandSignal" SG_ 1110 ADC_CANTRACEStatus34 0;
BA_ "GatewayedSignals" SG_ 1110 ADC_CANTRACEStatus34 0;
BA_ "GenSigInactiveValue" SG_ 1110 ADC_CANTRACEStatus34 0;
BA_ "GenSigInvalidValue" SG_ 1110 ADC_CANTRACEStatus34 255;
BA_ "GenSigSendType" SG_ 1110 ADC_CANTRACEStatus34 1;
BA_ "GenSigStartValue" SG_ 1110 ADC_CANTRACEStatus34 0;
BA_ "GenSigTimeoutValue" SG_ 1110 ADC_CANTRACEStatus34 0;
BA_ "Remark" SG_ 1110 ADC_CANTRACEStatus34 "";
BA_ "EventCommandSignal" SG_ 1110 ADC_CANTRACEStatus35 0;
BA_ "GatewayedSignals" SG_ 1110 ADC_CANTRACEStatus35 0;
BA_ "GenSigInactiveValue" SG_ 1110 ADC_CANTRACEStatus35 0;
BA_ "GenSigInvalidValue" SG_ 1110 ADC_CANTRACEStatus35 255;
BA_ "GenSigSendType" SG_ 1110 ADC_CANTRACEStatus35 1;
BA_ "GenSigStartValue" SG_ 1110 ADC_CANTRACEStatus35 0;
BA_ "GenSigTimeoutValue" SG_ 1110 ADC_CANTRACEStatus35 0;
BA_ "Remark" SG_ 1110 ADC_CANTRACEStatus35 "";
BA_ "EventCommandSignal" SG_ 1110 ADC_CANTRACEStatus36 0;
BA_ "GatewayedSignals" SG_ 1110 ADC_CANTRACEStatus36 0;
BA_ "GenSigInactiveValue" SG_ 1110 ADC_CANTRACEStatus36 0;
BA_ "GenSigInvalidValue" SG_ 1110 ADC_CANTRACEStatus36 255;
BA_ "GenSigSendType" SG_ 1110 ADC_CANTRACEStatus36 1;
BA_ "GenSigStartValue" SG_ 1110 ADC_CANTRACEStatus36 0;
BA_ "GenSigTimeoutValue" SG_ 1110 ADC_CANTRACEStatus36 0;
BA_ "Remark" SG_ 1110 ADC_CANTRACEStatus36 "";
BA_ "EventCommandSignal" SG_ 1110 ADC_CANTRACEStatus37 0;
BA_ "GatewayedSignals" SG_ 1110 ADC_CANTRACEStatus37 0;
BA_ "GenSigInactiveValue" SG_ 1110 ADC_CANTRACEStatus37 0;
BA_ "GenSigInvalidValue" SG_ 1110 ADC_CANTRACEStatus37 255;
BA_ "GenSigSendType" SG_ 1110 ADC_CANTRACEStatus37 1;
BA_ "GenSigStartValue" SG_ 1110 ADC_CANTRACEStatus37 0;
BA_ "GenSigTimeoutValue" SG_ 1110 ADC_CANTRACEStatus37 0;
BA_ "Remark" SG_ 1110 ADC_CANTRACEStatus37 "";
BA_ "EventCommandSignal" SG_ 1110 ADC_CANTRACEStatus38 0;
BA_ "GatewayedSignals" SG_ 1110 ADC_CANTRACEStatus38 0;
BA_ "GenSigInactiveValue" SG_ 1110 ADC_CANTRACEStatus38 0;
BA_ "GenSigInvalidValue" SG_ 1110 ADC_CANTRACEStatus38 255;
BA_ "GenSigSendType" SG_ 1110 ADC_CANTRACEStatus38 1;
BA_ "GenSigStartValue" SG_ 1110 ADC_CANTRACEStatus38 0;
BA_ "GenSigTimeoutValue" SG_ 1110 ADC_CANTRACEStatus38 0;
BA_ "Remark" SG_ 1110 ADC_CANTRACEStatus38 "";
BA_ "EventCommandSignal" SG_ 1110 ADC_CANTRACEStatus39 0;
BA_ "GatewayedSignals" SG_ 1110 ADC_CANTRACEStatus39 0;
BA_ "GenSigInactiveValue" SG_ 1110 ADC_CANTRACEStatus39 0;
BA_ "GenSigInvalidValue" SG_ 1110 ADC_CANTRACEStatus39 255;
BA_ "GenSigSendType" SG_ 1110 ADC_CANTRACEStatus39 1;
BA_ "GenSigStartValue" SG_ 1110 ADC_CANTRACEStatus39 0;
BA_ "GenSigTimeoutValue" SG_ 1110 ADC_CANTRACEStatus39 0;
BA_ "Remark" SG_ 1110 ADC_CANTRACEStatus39 "";
BA_ "EventCommandSignal" SG_ 1110 ADC_CANTRACEStatus40 0;
BA_ "GatewayedSignals" SG_ 1110 ADC_CANTRACEStatus40 0;
BA_ "GenSigInactiveValue" SG_ 1110 ADC_CANTRACEStatus40 0;
BA_ "GenSigInvalidValue" SG_ 1110 ADC_CANTRACEStatus40 255;
BA_ "GenSigSendType" SG_ 1110 ADC_CANTRACEStatus40 1;
BA_ "GenSigStartValue" SG_ 1110 ADC_CANTRACEStatus40 0;
BA_ "GenSigTimeoutValue" SG_ 1110 ADC_CANTRACEStatus40 0;
BA_ "Remark" SG_ 1110 ADC_CANTRACEStatus40 "";
BA_ "EventCommandSignal" SG_ 1110 ADC_CANTRACEStatus41 0;
BA_ "GatewayedSignals" SG_ 1110 ADC_CANTRACEStatus41 0;
BA_ "GenSigInactiveValue" SG_ 1110 ADC_CANTRACEStatus41 0;
BA_ "GenSigInvalidValue" SG_ 1110 ADC_CANTRACEStatus41 255;
BA_ "GenSigSendType" SG_ 1110 ADC_CANTRACEStatus41 1;
BA_ "GenSigStartValue" SG_ 1110 ADC_CANTRACEStatus41 0;
BA_ "GenSigTimeoutValue" SG_ 1110 ADC_CANTRACEStatus41 0;
BA_ "Remark" SG_ 1110 ADC_CANTRACEStatus41 "";
BA_ "EventCommandSignal" SG_ 1110 ADC_CANTRACEStatus42 0;
BA_ "GatewayedSignals" SG_ 1110 ADC_CANTRACEStatus42 0;
BA_ "GenSigInactiveValue" SG_ 1110 ADC_CANTRACEStatus42 0;
BA_ "GenSigInvalidValue" SG_ 1110 ADC_CANTRACEStatus42 255;
BA_ "GenSigSendType" SG_ 1110 ADC_CANTRACEStatus42 1;
BA_ "GenSigStartValue" SG_ 1110 ADC_CANTRACEStatus42 0;
BA_ "GenSigTimeoutValue" SG_ 1110 ADC_CANTRACEStatus42 0;
BA_ "Remark" SG_ 1110 ADC_CANTRACEStatus42 "";
BA_ "EventCommandSignal" SG_ 1110 ADC_CANTRACEStatus43 0;
BA_ "GatewayedSignals" SG_ 1110 ADC_CANTRACEStatus43 0;
BA_ "GenSigInactiveValue" SG_ 1110 ADC_CANTRACEStatus43 0;
BA_ "GenSigInvalidValue" SG_ 1110 ADC_CANTRACEStatus43 255;
BA_ "GenSigSendType" SG_ 1110 ADC_CANTRACEStatus43 1;
BA_ "GenSigStartValue" SG_ 1110 ADC_CANTRACEStatus43 0;
BA_ "GenSigTimeoutValue" SG_ 1110 ADC_CANTRACEStatus43 0;
BA_ "Remark" SG_ 1110 ADC_CANTRACEStatus43 "";
BA_ "EventCommandSignal" SG_ 1110 ADC_CANTRACEStatus44 0;
BA_ "GatewayedSignals" SG_ 1110 ADC_CANTRACEStatus44 0;
BA_ "GenSigInactiveValue" SG_ 1110 ADC_CANTRACEStatus44 0;
BA_ "GenSigInvalidValue" SG_ 1110 ADC_CANTRACEStatus44 255;
BA_ "GenSigSendType" SG_ 1110 ADC_CANTRACEStatus44 1;
BA_ "GenSigStartValue" SG_ 1110 ADC_CANTRACEStatus44 0;
BA_ "GenSigTimeoutValue" SG_ 1110 ADC_CANTRACEStatus44 0;
BA_ "Remark" SG_ 1110 ADC_CANTRACEStatus44 "";
BA_ "EventCommandSignal" SG_ 1110 ADC_CANTRACEStatus45 0;
BA_ "GatewayedSignals" SG_ 1110 ADC_CANTRACEStatus45 0;
BA_ "GenSigInactiveValue" SG_ 1110 ADC_CANTRACEStatus45 0;
BA_ "GenSigInvalidValue" SG_ 1110 ADC_CANTRACEStatus45 255;
BA_ "GenSigSendType" SG_ 1110 ADC_CANTRACEStatus45 1;
BA_ "GenSigStartValue" SG_ 1110 ADC_CANTRACEStatus45 0;
BA_ "GenSigTimeoutValue" SG_ 1110 ADC_CANTRACEStatus45 0;
BA_ "Remark" SG_ 1110 ADC_CANTRACEStatus45 "";
BA_ "EventCommandSignal" SG_ 1110 ADC_CANTRACEStatus46 0;
BA_ "GatewayedSignals" SG_ 1110 ADC_CANTRACEStatus46 0;
BA_ "GenSigInactiveValue" SG_ 1110 ADC_CANTRACEStatus46 0;
BA_ "GenSigInvalidValue" SG_ 1110 ADC_CANTRACEStatus46 255;
BA_ "GenSigSendType" SG_ 1110 ADC_CANTRACEStatus46 1;
BA_ "GenSigStartValue" SG_ 1110 ADC_CANTRACEStatus46 0;
BA_ "GenSigTimeoutValue" SG_ 1110 ADC_CANTRACEStatus46 0;
BA_ "Remark" SG_ 1110 ADC_CANTRACEStatus46 "";
BA_ "EventCommandSignal" SG_ 1110 ADC_CANTRACEStatus47 0;
BA_ "GatewayedSignals" SG_ 1110 ADC_CANTRACEStatus47 0;
BA_ "GenSigInactiveValue" SG_ 1110 ADC_CANTRACEStatus47 0;
BA_ "GenSigInvalidValue" SG_ 1110 ADC_CANTRACEStatus47 255;
BA_ "GenSigSendType" SG_ 1110 ADC_CANTRACEStatus47 1;
BA_ "GenSigStartValue" SG_ 1110 ADC_CANTRACEStatus47 0;
BA_ "GenSigTimeoutValue" SG_ 1110 ADC_CANTRACEStatus47 0;
BA_ "Remark" SG_ 1110 ADC_CANTRACEStatus47 "";
BA_ "EventCommandSignal" SG_ 1110 ADC_CANTRACEStatus48 0;
BA_ "GatewayedSignals" SG_ 1110 ADC_CANTRACEStatus48 0;
BA_ "GenSigInactiveValue" SG_ 1110 ADC_CANTRACEStatus48 0;
BA_ "GenSigInvalidValue" SG_ 1110 ADC_CANTRACEStatus48 255;
BA_ "GenSigSendType" SG_ 1110 ADC_CANTRACEStatus48 1;
BA_ "GenSigStartValue" SG_ 1110 ADC_CANTRACEStatus48 0;
BA_ "GenSigTimeoutValue" SG_ 1110 ADC_CANTRACEStatus48 0;
BA_ "Remark" SG_ 1110 ADC_CANTRACEStatus48 "";
BA_ "EventCommandSignal" SG_ 1110 ADC_CANTRACEStatus49 0;
BA_ "GatewayedSignals" SG_ 1110 ADC_CANTRACEStatus49 0;
BA_ "GenSigInactiveValue" SG_ 1110 ADC_CANTRACEStatus49 0;
BA_ "GenSigInvalidValue" SG_ 1110 ADC_CANTRACEStatus49 255;
BA_ "GenSigSendType" SG_ 1110 ADC_CANTRACEStatus49 1;
BA_ "GenSigStartValue" SG_ 1110 ADC_CANTRACEStatus49 0;
BA_ "GenSigTimeoutValue" SG_ 1110 ADC_CANTRACEStatus49 0;
BA_ "Remark" SG_ 1110 ADC_CANTRACEStatus49 "";
BA_ "EventCommandSignal" SG_ 1110 ADC_CANTRACEStatus50 0;
BA_ "GatewayedSignals" SG_ 1110 ADC_CANTRACEStatus50 0;
BA_ "GenSigInactiveValue" SG_ 1110 ADC_CANTRACEStatus50 0;
BA_ "GenSigInvalidValue" SG_ 1110 ADC_CANTRACEStatus50 255;
BA_ "GenSigSendType" SG_ 1110 ADC_CANTRACEStatus50 1;
BA_ "GenSigStartValue" SG_ 1110 ADC_CANTRACEStatus50 0;
BA_ "GenSigTimeoutValue" SG_ 1110 ADC_CANTRACEStatus50 0;
BA_ "Remark" SG_ 1110 ADC_CANTRACEStatus50 "";
BA_ "EventCommandSignal" SG_ 1110 ADC_CANTRACEStatus51 0;
BA_ "GatewayedSignals" SG_ 1110 ADC_CANTRACEStatus51 0;
BA_ "GenSigInactiveValue" SG_ 1110 ADC_CANTRACEStatus51 0;
BA_ "GenSigInvalidValue" SG_ 1110 ADC_CANTRACEStatus51 255;
BA_ "GenSigSendType" SG_ 1110 ADC_CANTRACEStatus51 1;
BA_ "GenSigStartValue" SG_ 1110 ADC_CANTRACEStatus51 0;
BA_ "GenSigTimeoutValue" SG_ 1110 ADC_CANTRACEStatus51 0;
BA_ "Remark" SG_ 1110 ADC_CANTRACEStatus51 "";
BA_ "EventCommandSignal" SG_ 1110 ADC_CANTRACEStatus52 0;
BA_ "GatewayedSignals" SG_ 1110 ADC_CANTRACEStatus52 0;
BA_ "GenSigInactiveValue" SG_ 1110 ADC_CANTRACEStatus52 0;
BA_ "GenSigInvalidValue" SG_ 1110 ADC_CANTRACEStatus52 255;
BA_ "GenSigSendType" SG_ 1110 ADC_CANTRACEStatus52 1;
BA_ "GenSigStartValue" SG_ 1110 ADC_CANTRACEStatus52 0;
BA_ "GenSigTimeoutValue" SG_ 1110 ADC_CANTRACEStatus52 0;
BA_ "Remark" SG_ 1110 ADC_CANTRACEStatus52 "";
BA_ "EventCommandSignal" SG_ 1110 ADC_CANTRACEStatus53 0;
BA_ "GatewayedSignals" SG_ 1110 ADC_CANTRACEStatus53 0;
BA_ "GenSigInactiveValue" SG_ 1110 ADC_CANTRACEStatus53 0;
BA_ "GenSigInvalidValue" SG_ 1110 ADC_CANTRACEStatus53 255;
BA_ "GenSigSendType" SG_ 1110 ADC_CANTRACEStatus53 1;
BA_ "GenSigStartValue" SG_ 1110 ADC_CANTRACEStatus53 0;
BA_ "GenSigTimeoutValue" SG_ 1110 ADC_CANTRACEStatus53 0;
BA_ "Remark" SG_ 1110 ADC_CANTRACEStatus53 "";
BA_ "EventCommandSignal" SG_ 1110 ADC_CANTRACEStatus54 0;
BA_ "GatewayedSignals" SG_ 1110 ADC_CANTRACEStatus54 0;
BA_ "GenSigInactiveValue" SG_ 1110 ADC_CANTRACEStatus54 0;
BA_ "GenSigInvalidValue" SG_ 1110 ADC_CANTRACEStatus54 255;
BA_ "GenSigSendType" SG_ 1110 ADC_CANTRACEStatus54 1;
BA_ "GenSigStartValue" SG_ 1110 ADC_CANTRACEStatus54 0;
BA_ "GenSigTimeoutValue" SG_ 1110 ADC_CANTRACEStatus54 0;
BA_ "Remark" SG_ 1110 ADC_CANTRACEStatus54 "";
BA_ "EventCommandSignal" SG_ 1110 ADC_CANTRACEStatus55 0;
BA_ "GatewayedSignals" SG_ 1110 ADC_CANTRACEStatus55 0;
BA_ "GenSigInactiveValue" SG_ 1110 ADC_CANTRACEStatus55 0;
BA_ "GenSigInvalidValue" SG_ 1110 ADC_CANTRACEStatus55 255;
BA_ "GenSigSendType" SG_ 1110 ADC_CANTRACEStatus55 1;
BA_ "GenSigStartValue" SG_ 1110 ADC_CANTRACEStatus55 0;
BA_ "GenSigTimeoutValue" SG_ 1110 ADC_CANTRACEStatus55 0;
BA_ "Remark" SG_ 1110 ADC_CANTRACEStatus55 "";
BA_ "EventCommandSignal" SG_ 1110 ADC_CANTRACEStatus56 0;
BA_ "GatewayedSignals" SG_ 1110 ADC_CANTRACEStatus56 0;
BA_ "GenSigInactiveValue" SG_ 1110 ADC_CANTRACEStatus56 0;
BA_ "GenSigInvalidValue" SG_ 1110 ADC_CANTRACEStatus56 255;
BA_ "GenSigSendType" SG_ 1110 ADC_CANTRACEStatus56 1;
BA_ "GenSigStartValue" SG_ 1110 ADC_CANTRACEStatus56 0;
BA_ "GenSigTimeoutValue" SG_ 1110 ADC_CANTRACEStatus56 0;
BA_ "Remark" SG_ 1110 ADC_CANTRACEStatus56 "";
BA_ "EventCommandSignal" SG_ 1110 ADC_CANTRACEStatus57 0;
BA_ "GatewayedSignals" SG_ 1110 ADC_CANTRACEStatus57 0;
BA_ "GenSigInactiveValue" SG_ 1110 ADC_CANTRACEStatus57 0;
BA_ "GenSigInvalidValue" SG_ 1110 ADC_CANTRACEStatus57 255;
BA_ "GenSigSendType" SG_ 1110 ADC_CANTRACEStatus57 1;
BA_ "GenSigStartValue" SG_ 1110 ADC_CANTRACEStatus57 0;
BA_ "GenSigTimeoutValue" SG_ 1110 ADC_CANTRACEStatus57 0;
BA_ "Remark" SG_ 1110 ADC_CANTRACEStatus57 "";
BA_ "EventCommandSignal" SG_ 1110 ADC_CANTRACEStatus58 0;
BA_ "GatewayedSignals" SG_ 1110 ADC_CANTRACEStatus58 0;
BA_ "GenSigInactiveValue" SG_ 1110 ADC_CANTRACEStatus58 0;
BA_ "GenSigInvalidValue" SG_ 1110 ADC_CANTRACEStatus58 255;
BA_ "GenSigSendType" SG_ 1110 ADC_CANTRACEStatus58 1;
BA_ "GenSigStartValue" SG_ 1110 ADC_CANTRACEStatus58 0;
BA_ "GenSigTimeoutValue" SG_ 1110 ADC_CANTRACEStatus58 0;
BA_ "Remark" SG_ 1110 ADC_CANTRACEStatus58 "";
BA_ "EventCommandSignal" SG_ 1110 ADC_CANTRACEStatus59 0;
BA_ "GatewayedSignals" SG_ 1110 ADC_CANTRACEStatus59 0;
BA_ "GenSigInactiveValue" SG_ 1110 ADC_CANTRACEStatus59 0;
BA_ "GenSigInvalidValue" SG_ 1110 ADC_CANTRACEStatus59 255;
BA_ "GenSigSendType" SG_ 1110 ADC_CANTRACEStatus59 1;
BA_ "GenSigStartValue" SG_ 1110 ADC_CANTRACEStatus59 0;
BA_ "GenSigTimeoutValue" SG_ 1110 ADC_CANTRACEStatus59 0;
BA_ "Remark" SG_ 1110 ADC_CANTRACEStatus59 "";
BA_ "EventCommandSignal" SG_ 1110 ADC_CANTRACEStatus60 0;
BA_ "GatewayedSignals" SG_ 1110 ADC_CANTRACEStatus60 0;
BA_ "GenSigInactiveValue" SG_ 1110 ADC_CANTRACEStatus60 0;
BA_ "GenSigInvalidValue" SG_ 1110 ADC_CANTRACEStatus60 255;
BA_ "GenSigSendType" SG_ 1110 ADC_CANTRACEStatus60 1;
BA_ "GenSigStartValue" SG_ 1110 ADC_CANTRACEStatus60 0;
BA_ "GenSigTimeoutValue" SG_ 1110 ADC_CANTRACEStatus60 0;
BA_ "Remark" SG_ 1110 ADC_CANTRACEStatus60 "";
BA_ "EventCommandSignal" SG_ 1110 ADC_CANTRACEStatus61 0;
BA_ "GatewayedSignals" SG_ 1110 ADC_CANTRACEStatus61 0;
BA_ "GenSigInactiveValue" SG_ 1110 ADC_CANTRACEStatus61 0;
BA_ "GenSigInvalidValue" SG_ 1110 ADC_CANTRACEStatus61 255;
BA_ "GenSigSendType" SG_ 1110 ADC_CANTRACEStatus61 1;
BA_ "GenSigStartValue" SG_ 1110 ADC_CANTRACEStatus61 0;
BA_ "GenSigTimeoutValue" SG_ 1110 ADC_CANTRACEStatus61 0;
BA_ "Remark" SG_ 1110 ADC_CANTRACEStatus61 "";
BA_ "EventCommandSignal" SG_ 1110 ADC_CANTRACEStatus62 0;
BA_ "GatewayedSignals" SG_ 1110 ADC_CANTRACEStatus62 0;
BA_ "GenSigInactiveValue" SG_ 1110 ADC_CANTRACEStatus62 0;
BA_ "GenSigInvalidValue" SG_ 1110 ADC_CANTRACEStatus62 255;
BA_ "GenSigSendType" SG_ 1110 ADC_CANTRACEStatus62 1;
BA_ "GenSigStartValue" SG_ 1110 ADC_CANTRACEStatus62 0;
BA_ "GenSigTimeoutValue" SG_ 1110 ADC_CANTRACEStatus62 0;
BA_ "Remark" SG_ 1110 ADC_CANTRACEStatus62 "";
BA_ "EventCommandSignal" SG_ 1111 ADC_AlarmPktType 0;
BA_ "GatewayedSignals" SG_ 1111 ADC_AlarmPktType 0;
BA_ "GenSigInactiveValue" SG_ 1111 ADC_AlarmPktType 0;
BA_ "GenSigInvalidValue" SG_ 1111 ADC_AlarmPktType 255;
BA_ "GenSigSendType" SG_ 1111 ADC_AlarmPktType 1;
BA_ "GenSigStartValue" SG_ 1111 ADC_AlarmPktType 0;
BA_ "GenSigTimeoutValue" SG_ 1111 ADC_AlarmPktType 0;
BA_ "Remark" SG_ 1111 ADC_AlarmPktType "";
BA_ "EventCommandSignal" SG_ 1111 ADC_AlarmTotal 0;
BA_ "GatewayedSignals" SG_ 1111 ADC_AlarmTotal 0;
BA_ "GenSigInactiveValue" SG_ 1111 ADC_AlarmTotal 0;
BA_ "GenSigInvalidValue" SG_ 1111 ADC_AlarmTotal 255;
BA_ "GenSigSendType" SG_ 1111 ADC_AlarmTotal 1;
BA_ "GenSigStartValue" SG_ 1111 ADC_AlarmTotal 0;
BA_ "GenSigTimeoutValue" SG_ 1111 ADC_AlarmTotal 0;
BA_ "Remark" SG_ 1111 ADC_AlarmTotal "";
BA_ "EventCommandSignal" SG_ 1111 ADC_AlarmNum 0;
BA_ "GatewayedSignals" SG_ 1111 ADC_AlarmNum 0;
BA_ "GenSigInactiveValue" SG_ 1111 ADC_AlarmNum 0;
BA_ "GenSigInvalidValue" SG_ 1111 ADC_AlarmNum 255;
BA_ "GenSigSendType" SG_ 1111 ADC_AlarmNum 1;
BA_ "GenSigStartValue" SG_ 1111 ADC_AlarmNum 0;
BA_ "GenSigTimeoutValue" SG_ 1111 ADC_AlarmNum 0;
BA_ "Remark" SG_ 1111 ADC_AlarmNum "";
BA_ "EventCommandSignal" SG_ 1111 ADC_AlarmFaultId0 0;
BA_ "GatewayedSignals" SG_ 1111 ADC_AlarmFaultId0 0;
BA_ "GenSigInactiveValue" SG_ 1111 ADC_AlarmFaultId0 0;
BA_ "GenSigInvalidValue" SG_ 1111 ADC_AlarmFaultId0 65535;
BA_ "GenSigSendType" SG_ 1111 ADC_AlarmFaultId0 1;
BA_ "GenSigStartValue" SG_ 1111 ADC_AlarmFaultId0 0;
BA_ "GenSigTimeoutValue" SG_ 1111 ADC_AlarmFaultId0 0;
BA_ "Remark" SG_ 1111 ADC_AlarmFaultId0 "";
BA_ "EventCommandSignal" SG_ 1111 ADC_AlarmKeyPara0 0;
BA_ "GatewayedSignals" SG_ 1111 ADC_AlarmKeyPara0 0;
BA_ "GenSigInactiveValue" SG_ 1111 ADC_AlarmKeyPara0 0;
BA_ "GenSigInvalidValue" SG_ 1111 ADC_AlarmKeyPara0 65535;
BA_ "GenSigSendType" SG_ 1111 ADC_AlarmKeyPara0 1;
BA_ "GenSigStartValue" SG_ 1111 ADC_AlarmKeyPara0 0;
BA_ "GenSigTimeoutValue" SG_ 1111 ADC_AlarmKeyPara0 0;
BA_ "Remark" SG_ 1111 ADC_AlarmKeyPara0 "";
BA_ "EventCommandSignal" SG_ 1111 ADC_AlarmFaultId1 0;
BA_ "GatewayedSignals" SG_ 1111 ADC_AlarmFaultId1 0;
BA_ "GenSigInactiveValue" SG_ 1111 ADC_AlarmFaultId1 0;
BA_ "GenSigInvalidValue" SG_ 1111 ADC_AlarmFaultId1 65535;
BA_ "GenSigSendType" SG_ 1111 ADC_AlarmFaultId1 1;
BA_ "GenSigStartValue" SG_ 1111 ADC_AlarmFaultId1 0;
BA_ "GenSigTimeoutValue" SG_ 1111 ADC_AlarmFaultId1 0;
BA_ "Remark" SG_ 1111 ADC_AlarmFaultId1 "";
BA_ "EventCommandSignal" SG_ 1111 ADC_AlarmKeyPara1 0;
BA_ "GatewayedSignals" SG_ 1111 ADC_AlarmKeyPara1 0;
BA_ "GenSigInactiveValue" SG_ 1111 ADC_AlarmKeyPara1 0;
BA_ "GenSigInvalidValue" SG_ 1111 ADC_AlarmKeyPara1 65535;
BA_ "GenSigSendType" SG_ 1111 ADC_AlarmKeyPara1 1;
BA_ "GenSigStartValue" SG_ 1111 ADC_AlarmKeyPara1 0;
BA_ "GenSigTimeoutValue" SG_ 1111 ADC_AlarmKeyPara1 0;
BA_ "Remark" SG_ 1111 ADC_AlarmKeyPara1 "";
BA_ "EventCommandSignal" SG_ 1111 ADC_AlarmFaultId2 0;
BA_ "GatewayedSignals" SG_ 1111 ADC_AlarmFaultId2 0;
BA_ "GenSigInactiveValue" SG_ 1111 ADC_AlarmFaultId2 0;
BA_ "GenSigInvalidValue" SG_ 1111 ADC_AlarmFaultId2 65535;
BA_ "GenSigSendType" SG_ 1111 ADC_AlarmFaultId2 1;
BA_ "GenSigStartValue" SG_ 1111 ADC_AlarmFaultId2 0;
BA_ "GenSigTimeoutValue" SG_ 1111 ADC_AlarmFaultId2 0;
BA_ "Remark" SG_ 1111 ADC_AlarmFaultId2 "";
BA_ "EventCommandSignal" SG_ 1111 ADC_AlarmKeyPara2 0;
BA_ "GatewayedSignals" SG_ 1111 ADC_AlarmKeyPara2 0;
BA_ "GenSigInactiveValue" SG_ 1111 ADC_AlarmKeyPara2 0;
BA_ "GenSigInvalidValue" SG_ 1111 ADC_AlarmKeyPara2 65535;
BA_ "GenSigSendType" SG_ 1111 ADC_AlarmKeyPara2 1;
BA_ "GenSigStartValue" SG_ 1111 ADC_AlarmKeyPara2 0;
BA_ "GenSigTimeoutValue" SG_ 1111 ADC_AlarmKeyPara2 0;
BA_ "Remark" SG_ 1111 ADC_AlarmKeyPara2 "";
BA_ "EventCommandSignal" SG_ 1111 ADC_AlarmFaultId3 0;
BA_ "GatewayedSignals" SG_ 1111 ADC_AlarmFaultId3 0;
BA_ "GenSigInactiveValue" SG_ 1111 ADC_AlarmFaultId3 0;
BA_ "GenSigInvalidValue" SG_ 1111 ADC_AlarmFaultId3 65535;
BA_ "GenSigSendType" SG_ 1111 ADC_AlarmFaultId3 1;
BA_ "GenSigStartValue" SG_ 1111 ADC_AlarmFaultId3 0;
BA_ "GenSigTimeoutValue" SG_ 1111 ADC_AlarmFaultId3 0;
BA_ "Remark" SG_ 1111 ADC_AlarmFaultId3 "";
BA_ "EventCommandSignal" SG_ 1111 ADC_AlarmKeyPara3 0;
BA_ "GatewayedSignals" SG_ 1111 ADC_AlarmKeyPara3 0;
BA_ "GenSigInactiveValue" SG_ 1111 ADC_AlarmKeyPara3 0;
BA_ "GenSigInvalidValue" SG_ 1111 ADC_AlarmKeyPara3 65535;
BA_ "GenSigSendType" SG_ 1111 ADC_AlarmKeyPara3 1;
BA_ "GenSigStartValue" SG_ 1111 ADC_AlarmKeyPara3 0;
BA_ "GenSigTimeoutValue" SG_ 1111 ADC_AlarmKeyPara3 0;
BA_ "Remark" SG_ 1111 ADC_AlarmKeyPara3 "";
BA_ "EventCommandSignal" SG_ 1111 ADC_AlarmFaultId4 0;
BA_ "GatewayedSignals" SG_ 1111 ADC_AlarmFaultId4 0;
BA_ "GenSigInactiveValue" SG_ 1111 ADC_AlarmFaultId4 0;
BA_ "GenSigInvalidValue" SG_ 1111 ADC_AlarmFaultId4 65535;
BA_ "GenSigSendType" SG_ 1111 ADC_AlarmFaultId4 1;
BA_ "GenSigStartValue" SG_ 1111 ADC_AlarmFaultId4 0;
BA_ "GenSigTimeoutValue" SG_ 1111 ADC_AlarmFaultId4 0;
BA_ "Remark" SG_ 1111 ADC_AlarmFaultId4 "";
BA_ "EventCommandSignal" SG_ 1111 ADC_AlarmKeyPara4 0;
BA_ "GatewayedSignals" SG_ 1111 ADC_AlarmKeyPara4 0;
BA_ "GenSigInactiveValue" SG_ 1111 ADC_AlarmKeyPara4 0;
BA_ "GenSigInvalidValue" SG_ 1111 ADC_AlarmKeyPara4 65535;
BA_ "GenSigSendType" SG_ 1111 ADC_AlarmKeyPara4 1;
BA_ "GenSigStartValue" SG_ 1111 ADC_AlarmKeyPara4 0;
BA_ "GenSigTimeoutValue" SG_ 1111 ADC_AlarmKeyPara4 0;
BA_ "Remark" SG_ 1111 ADC_AlarmKeyPara4 "";
BA_ "EventCommandSignal" SG_ 1111 ADC_AlarmFaultId5 0;
BA_ "GatewayedSignals" SG_ 1111 ADC_AlarmFaultId5 0;
BA_ "GenSigInactiveValue" SG_ 1111 ADC_AlarmFaultId5 0;
BA_ "GenSigInvalidValue" SG_ 1111 ADC_AlarmFaultId5 65535;
BA_ "GenSigSendType" SG_ 1111 ADC_AlarmFaultId5 1;
BA_ "GenSigStartValue" SG_ 1111 ADC_AlarmFaultId5 0;
BA_ "GenSigTimeoutValue" SG_ 1111 ADC_AlarmFaultId5 0;
BA_ "Remark" SG_ 1111 ADC_AlarmFaultId5 "";
BA_ "EventCommandSignal" SG_ 1111 ADC_AlarmKeyPara5 0;
BA_ "GatewayedSignals" SG_ 1111 ADC_AlarmKeyPara5 0;
BA_ "GenSigInactiveValue" SG_ 1111 ADC_AlarmKeyPara5 0;
BA_ "GenSigInvalidValue" SG_ 1111 ADC_AlarmKeyPara5 65535;
BA_ "GenSigSendType" SG_ 1111 ADC_AlarmKeyPara5 1;
BA_ "GenSigStartValue" SG_ 1111 ADC_AlarmKeyPara5 0;
BA_ "GenSigTimeoutValue" SG_ 1111 ADC_AlarmKeyPara5 0;
BA_ "Remark" SG_ 1111 ADC_AlarmKeyPara5 "";
BA_ "EventCommandSignal" SG_ 1111 ADC_AlarmFaultId6 0;
BA_ "GatewayedSignals" SG_ 1111 ADC_AlarmFaultId6 0;
BA_ "GenSigInactiveValue" SG_ 1111 ADC_AlarmFaultId6 0;
BA_ "GenSigInvalidValue" SG_ 1111 ADC_AlarmFaultId6 65535;
BA_ "GenSigSendType" SG_ 1111 ADC_AlarmFaultId6 1;
BA_ "GenSigStartValue" SG_ 1111 ADC_AlarmFaultId6 0;
BA_ "GenSigTimeoutValue" SG_ 1111 ADC_AlarmFaultId6 0;
BA_ "Remark" SG_ 1111 ADC_AlarmFaultId6 "";
BA_ "EventCommandSignal" SG_ 1111 ADC_AlarmKeyPara6 0;
BA_ "GatewayedSignals" SG_ 1111 ADC_AlarmKeyPara6 0;
BA_ "GenSigInactiveValue" SG_ 1111 ADC_AlarmKeyPara6 0;
BA_ "GenSigInvalidValue" SG_ 1111 ADC_AlarmKeyPara6 65535;
BA_ "GenSigSendType" SG_ 1111 ADC_AlarmKeyPara6 1;
BA_ "GenSigStartValue" SG_ 1111 ADC_AlarmKeyPara6 0;
BA_ "GenSigTimeoutValue" SG_ 1111 ADC_AlarmKeyPara6 0;
BA_ "Remark" SG_ 1111 ADC_AlarmKeyPara6 "";
BA_ "EventCommandSignal" SG_ 1111 ADC_AlarmFaultId7 0;
BA_ "GatewayedSignals" SG_ 1111 ADC_AlarmFaultId7 0;
BA_ "GenSigInactiveValue" SG_ 1111 ADC_AlarmFaultId7 0;
BA_ "GenSigInvalidValue" SG_ 1111 ADC_AlarmFaultId7 65535;
BA_ "GenSigSendType" SG_ 1111 ADC_AlarmFaultId7 1;
BA_ "GenSigStartValue" SG_ 1111 ADC_AlarmFaultId7 0;
BA_ "GenSigTimeoutValue" SG_ 1111 ADC_AlarmFaultId7 0;
BA_ "Remark" SG_ 1111 ADC_AlarmFaultId7 "";
BA_ "EventCommandSignal" SG_ 1111 ADC_AlarmKeyPara7 0;
BA_ "GatewayedSignals" SG_ 1111 ADC_AlarmKeyPara7 0;
BA_ "GenSigInactiveValue" SG_ 1111 ADC_AlarmKeyPara7 0;
BA_ "GenSigInvalidValue" SG_ 1111 ADC_AlarmKeyPara7 65535;
BA_ "GenSigSendType" SG_ 1111 ADC_AlarmKeyPara7 1;
BA_ "GenSigStartValue" SG_ 1111 ADC_AlarmKeyPara7 0;
BA_ "GenSigTimeoutValue" SG_ 1111 ADC_AlarmKeyPara7 0;
BA_ "Remark" SG_ 1111 ADC_AlarmKeyPara7 "";
BA_ "EventCommandSignal" SG_ 1111 ADC_AlarmFaultId8 0;
BA_ "GatewayedSignals" SG_ 1111 ADC_AlarmFaultId8 0;
BA_ "GenSigInactiveValue" SG_ 1111 ADC_AlarmFaultId8 0;
BA_ "GenSigInvalidValue" SG_ 1111 ADC_AlarmFaultId8 65535;
BA_ "GenSigSendType" SG_ 1111 ADC_AlarmFaultId8 1;
BA_ "GenSigStartValue" SG_ 1111 ADC_AlarmFaultId8 0;
BA_ "GenSigTimeoutValue" SG_ 1111 ADC_AlarmFaultId8 0;
BA_ "Remark" SG_ 1111 ADC_AlarmFaultId8 "";
BA_ "EventCommandSignal" SG_ 1111 ADC_AlarmKeyPara8 0;
BA_ "GatewayedSignals" SG_ 1111 ADC_AlarmKeyPara8 0;
BA_ "GenSigInactiveValue" SG_ 1111 ADC_AlarmKeyPara8 0;
BA_ "GenSigInvalidValue" SG_ 1111 ADC_AlarmKeyPara8 65535;
BA_ "GenSigSendType" SG_ 1111 ADC_AlarmKeyPara8 1;
BA_ "GenSigStartValue" SG_ 1111 ADC_AlarmKeyPara8 0;
BA_ "GenSigTimeoutValue" SG_ 1111 ADC_AlarmKeyPara8 0;
BA_ "Remark" SG_ 1111 ADC_AlarmKeyPara8 "";
BA_ "EventCommandSignal" SG_ 1111 ADC_AlarmFaultId9 0;
BA_ "GatewayedSignals" SG_ 1111 ADC_AlarmFaultId9 0;
BA_ "GenSigInactiveValue" SG_ 1111 ADC_AlarmFaultId9 0;
BA_ "GenSigInvalidValue" SG_ 1111 ADC_AlarmFaultId9 65535;
BA_ "GenSigSendType" SG_ 1111 ADC_AlarmFaultId9 1;
BA_ "GenSigStartValue" SG_ 1111 ADC_AlarmFaultId9 0;
BA_ "GenSigTimeoutValue" SG_ 1111 ADC_AlarmFaultId9 0;
BA_ "Remark" SG_ 1111 ADC_AlarmFaultId9 "";
BA_ "EventCommandSignal" SG_ 1111 ADC_AlarmKeyPara9 0;
BA_ "GatewayedSignals" SG_ 1111 ADC_AlarmKeyPara9 0;
BA_ "GenSigInactiveValue" SG_ 1111 ADC_AlarmKeyPara9 0;
BA_ "GenSigInvalidValue" SG_ 1111 ADC_AlarmKeyPara9 65535;
BA_ "GenSigSendType" SG_ 1111 ADC_AlarmKeyPara9 1;
BA_ "GenSigStartValue" SG_ 1111 ADC_AlarmKeyPara9 0;
BA_ "GenSigTimeoutValue" SG_ 1111 ADC_AlarmKeyPara9 0;
BA_ "Remark" SG_ 1111 ADC_AlarmKeyPara9 "";
BA_ "EventCommandSignal" SG_ 1111 ADC_AlarmFaultId10 0;
BA_ "GatewayedSignals" SG_ 1111 ADC_AlarmFaultId10 0;
BA_ "GenSigInactiveValue" SG_ 1111 ADC_AlarmFaultId10 0;
BA_ "GenSigInvalidValue" SG_ 1111 ADC_AlarmFaultId10 65535;
BA_ "GenSigSendType" SG_ 1111 ADC_AlarmFaultId10 1;
BA_ "GenSigStartValue" SG_ 1111 ADC_AlarmFaultId10 0;
BA_ "GenSigTimeoutValue" SG_ 1111 ADC_AlarmFaultId10 0;
BA_ "Remark" SG_ 1111 ADC_AlarmFaultId10 "";
BA_ "EventCommandSignal" SG_ 1111 ADC_AlarmKeyPara10 0;
BA_ "GatewayedSignals" SG_ 1111 ADC_AlarmKeyPara10 0;
BA_ "GenSigInactiveValue" SG_ 1111 ADC_AlarmKeyPara10 0;
BA_ "GenSigInvalidValue" SG_ 1111 ADC_AlarmKeyPara10 65535;
BA_ "GenSigSendType" SG_ 1111 ADC_AlarmKeyPara10 1;
BA_ "GenSigStartValue" SG_ 1111 ADC_AlarmKeyPara10 0;
BA_ "GenSigTimeoutValue" SG_ 1111 ADC_AlarmKeyPara10 0;
BA_ "Remark" SG_ 1111 ADC_AlarmKeyPara10 "";
BA_ "EventCommandSignal" SG_ 1111 ADC_AlarmFaultId11 0;
BA_ "GatewayedSignals" SG_ 1111 ADC_AlarmFaultId11 0;
BA_ "GenSigInactiveValue" SG_ 1111 ADC_AlarmFaultId11 0;
BA_ "GenSigInvalidValue" SG_ 1111 ADC_AlarmFaultId11 65535;
BA_ "GenSigSendType" SG_ 1111 ADC_AlarmFaultId11 1;
BA_ "GenSigStartValue" SG_ 1111 ADC_AlarmFaultId11 0;
BA_ "GenSigTimeoutValue" SG_ 1111 ADC_AlarmFaultId11 0;
BA_ "Remark" SG_ 1111 ADC_AlarmFaultId11 "";
BA_ "EventCommandSignal" SG_ 1111 ADC_AlarmKeyPara11 0;
BA_ "GatewayedSignals" SG_ 1111 ADC_AlarmKeyPara11 0;
BA_ "GenSigInactiveValue" SG_ 1111 ADC_AlarmKeyPara11 0;
BA_ "GenSigInvalidValue" SG_ 1111 ADC_AlarmKeyPara11 65535;
BA_ "GenSigSendType" SG_ 1111 ADC_AlarmKeyPara11 1;
BA_ "GenSigStartValue" SG_ 1111 ADC_AlarmKeyPara11 0;
BA_ "GenSigTimeoutValue" SG_ 1111 ADC_AlarmKeyPara11 0;
BA_ "Remark" SG_ 1111 ADC_AlarmKeyPara11 "";
BA_ "EventCommandSignal" SG_ 1111 ADC_AlarmFaultId12 0;
BA_ "GatewayedSignals" SG_ 1111 ADC_AlarmFaultId12 0;
BA_ "GenSigInactiveValue" SG_ 1111 ADC_AlarmFaultId12 0;
BA_ "GenSigInvalidValue" SG_ 1111 ADC_AlarmFaultId12 65535;
BA_ "GenSigSendType" SG_ 1111 ADC_AlarmFaultId12 1;
BA_ "GenSigStartValue" SG_ 1111 ADC_AlarmFaultId12 0;
BA_ "GenSigTimeoutValue" SG_ 1111 ADC_AlarmFaultId12 0;
BA_ "Remark" SG_ 1111 ADC_AlarmFaultId12 "";
BA_ "EventCommandSignal" SG_ 1111 ADC_AlarmKeyPara12 0;
BA_ "GatewayedSignals" SG_ 1111 ADC_AlarmKeyPara12 0;
BA_ "GenSigInactiveValue" SG_ 1111 ADC_AlarmKeyPara12 0;
BA_ "GenSigInvalidValue" SG_ 1111 ADC_AlarmKeyPara12 65535;
BA_ "GenSigSendType" SG_ 1111 ADC_AlarmKeyPara12 1;
BA_ "GenSigStartValue" SG_ 1111 ADC_AlarmKeyPara12 0;
BA_ "GenSigTimeoutValue" SG_ 1111 ADC_AlarmKeyPara12 0;
BA_ "Remark" SG_ 1111 ADC_AlarmKeyPara12 "";
BA_ "EventCommandSignal" SG_ 1111 ADC_AlarmFaultId13 0;
BA_ "GatewayedSignals" SG_ 1111 ADC_AlarmFaultId13 0;
BA_ "GenSigInactiveValue" SG_ 1111 ADC_AlarmFaultId13 0;
BA_ "GenSigInvalidValue" SG_ 1111 ADC_AlarmFaultId13 65535;
BA_ "GenSigSendType" SG_ 1111 ADC_AlarmFaultId13 1;
BA_ "GenSigStartValue" SG_ 1111 ADC_AlarmFaultId13 0;
BA_ "GenSigTimeoutValue" SG_ 1111 ADC_AlarmFaultId13 0;
BA_ "Remark" SG_ 1111 ADC_AlarmFaultId13 "";
BA_ "EventCommandSignal" SG_ 1111 ADC_AlarmKeyPara13 0;
BA_ "GatewayedSignals" SG_ 1111 ADC_AlarmKeyPara13 0;
BA_ "GenSigInactiveValue" SG_ 1111 ADC_AlarmKeyPara13 0;
BA_ "GenSigInvalidValue" SG_ 1111 ADC_AlarmKeyPara13 65535;
BA_ "GenSigSendType" SG_ 1111 ADC_AlarmKeyPara13 1;
BA_ "GenSigStartValue" SG_ 1111 ADC_AlarmKeyPara13 0;
BA_ "GenSigTimeoutValue" SG_ 1111 ADC_AlarmKeyPara13 0;
BA_ "Remark" SG_ 1111 ADC_AlarmKeyPara13 "";
BA_ "EventCommandSignal" SG_ 1111 ADC_AlarmFaultId14 0;
BA_ "GatewayedSignals" SG_ 1111 ADC_AlarmFaultId14 0;
BA_ "GenSigInactiveValue" SG_ 1111 ADC_AlarmFaultId14 0;
BA_ "GenSigInvalidValue" SG_ 1111 ADC_AlarmFaultId14 65535;
BA_ "GenSigSendType" SG_ 1111 ADC_AlarmFaultId14 1;
BA_ "GenSigStartValue" SG_ 1111 ADC_AlarmFaultId14 0;
BA_ "GenSigTimeoutValue" SG_ 1111 ADC_AlarmFaultId14 0;
BA_ "Remark" SG_ 1111 ADC_AlarmFaultId14 "";
BA_ "EventCommandSignal" SG_ 1111 ADC_AlarmKeyPara14 0;
BA_ "GatewayedSignals" SG_ 1111 ADC_AlarmKeyPara14 0;
BA_ "GenSigInactiveValue" SG_ 1111 ADC_AlarmKeyPara14 0;
BA_ "GenSigInvalidValue" SG_ 1111 ADC_AlarmKeyPara14 65535;
BA_ "GenSigSendType" SG_ 1111 ADC_AlarmKeyPara14 1;
BA_ "GenSigStartValue" SG_ 1111 ADC_AlarmKeyPara14 0;
BA_ "GenSigTimeoutValue" SG_ 1111 ADC_AlarmKeyPara14 0;
BA_ "Remark" SG_ 1111 ADC_AlarmKeyPara14 "";
BA_ "EventCommandSignal" SG_ 1111 ADC_AlarmCheckSum 0;
BA_ "GatewayedSignals" SG_ 1111 ADC_AlarmCheckSum 0;
BA_ "GenSigInactiveValue" SG_ 1111 ADC_AlarmCheckSum 0;
BA_ "GenSigInvalidValue" SG_ 1111 ADC_AlarmCheckSum 255;
BA_ "GenSigSendType" SG_ 1111 ADC_AlarmCheckSum 1;
BA_ "GenSigStartValue" SG_ 1111 ADC_AlarmCheckSum 0;
BA_ "GenSigTimeoutValue" SG_ 1111 ADC_AlarmCheckSum 0;
BA_ "Remark" SG_ 1111 ADC_AlarmCheckSum "";
BA_ "EventCommandSignal" SG_ 365 ADC_19_CRC 0;
BA_ "GatewayedSignals" SG_ 365 ADC_19_CRC 0;
BA_ "GenSigInactiveValue" SG_ 365 ADC_19_CRC 0;
BA_ "GenSigInvalidValue" SG_ 365 ADC_19_CRC 0;
BA_ "GenSigSendType" SG_ 365 ADC_19_CRC 1;
BA_ "GenSigStartValue" SG_ 365 ADC_19_CRC 0;
BA_ "GenSigTimeoutValue" SG_ 365 ADC_19_CRC 0;
BA_ "Remark" SG_ 365 ADC_19_CRC "";
BA_ "EventCommandSignal" SG_ 365 ADC_19_Counter 0;
BA_ "GatewayedSignals" SG_ 365 ADC_19_Counter 0;
BA_ "GenSigInactiveValue" SG_ 365 ADC_19_Counter 0;
BA_ "GenSigInvalidValue" SG_ 365 ADC_19_Counter 0;
BA_ "GenSigSendType" SG_ 365 ADC_19_Counter 1;
BA_ "GenSigStartValue" SG_ 365 ADC_19_Counter 0;
BA_ "GenSigTimeoutValue" SG_ 365 ADC_19_Counter 0;
BA_ "Remark" SG_ 365 ADC_19_Counter "";
BA_ "EventCommandSignal" SG_ 365 ADC_Obj02_ID 0;
BA_ "GatewayedSignals" SG_ 365 ADC_Obj02_ID 0;
BA_ "GenSigInactiveValue" SG_ 365 ADC_Obj02_ID 0;
BA_ "GenSigInvalidValue" SG_ 365 ADC_Obj02_ID 0;
BA_ "GenSigSendType" SG_ 365 ADC_Obj02_ID 1;
BA_ "GenSigStartValue" SG_ 365 ADC_Obj02_ID 0;
BA_ "GenSigTimeoutValue" SG_ 365 ADC_Obj02_ID 0;
BA_ "Remark" SG_ 365 ADC_Obj02_ID "";
BA_ "EventCommandSignal" SG_ 365 ADC_Obj03Dist 0;
BA_ "GatewayedSignals" SG_ 365 ADC_Obj03Dist 0;
BA_ "GenSigInactiveValue" SG_ 365 ADC_Obj03Dist 0;
BA_ "GenSigInvalidValue" SG_ 365 ADC_Obj03Dist 0;
BA_ "GenSigSendType" SG_ 365 ADC_Obj03Dist 1;
BA_ "GenSigStartValue" SG_ 365 ADC_Obj03Dist 0;
BA_ "GenSigTimeoutValue" SG_ 365 ADC_Obj03Dist 0;
BA_ "Remark" SG_ 365 ADC_Obj03Dist "";
BA_ "EventCommandSignal" SG_ 365 ADC_Obj03HoztAngSpd 0;
BA_ "GatewayedSignals" SG_ 365 ADC_Obj03HoztAngSpd 0;
BA_ "GenSigInactiveValue" SG_ 365 ADC_Obj03HoztAngSpd 0;
BA_ "GenSigInvalidValue" SG_ 365 ADC_Obj03HoztAngSpd 0;
BA_ "GenSigSendType" SG_ 365 ADC_Obj03HoztAngSpd 1;
BA_ "GenSigStartValue" SG_ 365 ADC_Obj03HoztAngSpd 0;
BA_ "GenSigTimeoutValue" SG_ 365 ADC_Obj03HoztAngSpd 0;
BA_ "Remark" SG_ 365 ADC_Obj03HoztAngSpd "";
BA_ "EventCommandSignal" SG_ 365 ADC_Obj03LeftAngle 0;
BA_ "GatewayedSignals" SG_ 365 ADC_Obj03LeftAngle 0;
BA_ "GenSigInactiveValue" SG_ 365 ADC_Obj03LeftAngle 0;
BA_ "GenSigInvalidValue" SG_ 365 ADC_Obj03LeftAngle 0;
BA_ "GenSigSendType" SG_ 365 ADC_Obj03LeftAngle 1;
BA_ "GenSigStartValue" SG_ 365 ADC_Obj03LeftAngle 0;
BA_ "GenSigTimeoutValue" SG_ 365 ADC_Obj03LeftAngle 0;
BA_ "Remark" SG_ 365 ADC_Obj03LeftAngle "";
BA_ "EventCommandSignal" SG_ 365 ADC_Obj03RightAngle 0;
BA_ "GatewayedSignals" SG_ 365 ADC_Obj03RightAngle 0;
BA_ "GenSigInactiveValue" SG_ 365 ADC_Obj03RightAngle 0;
BA_ "GenSigInvalidValue" SG_ 365 ADC_Obj03RightAngle 0;
BA_ "GenSigSendType" SG_ 365 ADC_Obj03RightAngle 1;
BA_ "GenSigStartValue" SG_ 365 ADC_Obj03RightAngle 0;
BA_ "GenSigTimeoutValue" SG_ 365 ADC_Obj03RightAngle 0;
BA_ "Remark" SG_ 365 ADC_Obj03RightAngle "";
BA_ "EventCommandSignal" SG_ 365 ADC_Obj03BottomAngle 0;
BA_ "GatewayedSignals" SG_ 365 ADC_Obj03BottomAngle 0;
BA_ "GenSigInactiveValue" SG_ 365 ADC_Obj03BottomAngle 0;
BA_ "GenSigInvalidValue" SG_ 365 ADC_Obj03BottomAngle 0;
BA_ "GenSigSendType" SG_ 365 ADC_Obj03BottomAngle 1;
BA_ "GenSigStartValue" SG_ 365 ADC_Obj03BottomAngle 0;
BA_ "GenSigTimeoutValue" SG_ 365 ADC_Obj03BottomAngle 0;
BA_ "Remark" SG_ 365 ADC_Obj03BottomAngle "";
BA_ "EventCommandSignal" SG_ 365 ADC_Obj03TopAngle 0;
BA_ "GatewayedSignals" SG_ 365 ADC_Obj03TopAngle 0;
BA_ "GenSigInactiveValue" SG_ 365 ADC_Obj03TopAngle 0;
BA_ "GenSigInvalidValue" SG_ 365 ADC_Obj03TopAngle 0;
BA_ "GenSigSendType" SG_ 365 ADC_Obj03TopAngle 1;
BA_ "GenSigStartValue" SG_ 365 ADC_Obj03TopAngle 0;
BA_ "GenSigTimeoutValue" SG_ 365 ADC_Obj03TopAngle 0;
BA_ "Remark" SG_ 365 ADC_Obj03TopAngle "";
BA_ "EventCommandSignal" SG_ 365 ADC_Obj04_ID 0;
BA_ "GatewayedSignals" SG_ 365 ADC_Obj04_ID 0;
BA_ "GenSigInactiveValue" SG_ 365 ADC_Obj04_ID 0;
BA_ "GenSigInvalidValue" SG_ 365 ADC_Obj04_ID 0;
BA_ "GenSigSendType" SG_ 365 ADC_Obj04_ID 1;
BA_ "GenSigStartValue" SG_ 365 ADC_Obj04_ID 0;
BA_ "GenSigTimeoutValue" SG_ 365 ADC_Obj04_ID 0;
BA_ "Remark" SG_ 365 ADC_Obj04_ID "";
BA_ "EventCommandSignal" SG_ 365 ADC_Obj01_ID 0;
BA_ "GatewayedSignals" SG_ 365 ADC_Obj01_ID 0;
BA_ "GenSigInactiveValue" SG_ 365 ADC_Obj01_ID 0;
BA_ "GenSigInvalidValue" SG_ 365 ADC_Obj01_ID 0;
BA_ "GenSigSendType" SG_ 365 ADC_Obj01_ID 1;
BA_ "GenSigStartValue" SG_ 365 ADC_Obj01_ID 0;
BA_ "GenSigTimeoutValue" SG_ 365 ADC_Obj01_ID 0;
BA_ "Remark" SG_ 365 ADC_Obj01_ID "";
BA_ "EventCommandSignal" SG_ 365 ADC_Obj04Dist 0;
BA_ "GatewayedSignals" SG_ 365 ADC_Obj04Dist 0;
BA_ "GenSigInactiveValue" SG_ 365 ADC_Obj04Dist 0;
BA_ "GenSigInvalidValue" SG_ 365 ADC_Obj04Dist 0;
BA_ "GenSigSendType" SG_ 365 ADC_Obj04Dist 1;
BA_ "GenSigStartValue" SG_ 365 ADC_Obj04Dist 0;
BA_ "GenSigTimeoutValue" SG_ 365 ADC_Obj04Dist 0;
BA_ "Remark" SG_ 365 ADC_Obj04Dist "";
BA_ "EventCommandSignal" SG_ 365 ADC_Obj04HoztAngSpd 0;
BA_ "GatewayedSignals" SG_ 365 ADC_Obj04HoztAngSpd 0;
BA_ "GenSigInactiveValue" SG_ 365 ADC_Obj04HoztAngSpd 0;
BA_ "GenSigInvalidValue" SG_ 365 ADC_Obj04HoztAngSpd 0;
BA_ "GenSigSendType" SG_ 365 ADC_Obj04HoztAngSpd 1;
BA_ "GenSigStartValue" SG_ 365 ADC_Obj04HoztAngSpd 0;
BA_ "GenSigTimeoutValue" SG_ 365 ADC_Obj04HoztAngSpd 0;
BA_ "Remark" SG_ 365 ADC_Obj04HoztAngSpd "";
BA_ "EventCommandSignal" SG_ 365 ADC_Obj04LeftAngle 0;
BA_ "GatewayedSignals" SG_ 365 ADC_Obj04LeftAngle 0;
BA_ "GenSigInactiveValue" SG_ 365 ADC_Obj04LeftAngle 0;
BA_ "GenSigInvalidValue" SG_ 365 ADC_Obj04LeftAngle 0;
BA_ "GenSigSendType" SG_ 365 ADC_Obj04LeftAngle 1;
BA_ "GenSigStartValue" SG_ 365 ADC_Obj04LeftAngle 0;
BA_ "GenSigTimeoutValue" SG_ 365 ADC_Obj04LeftAngle 0;
BA_ "Remark" SG_ 365 ADC_Obj04LeftAngle "";
BA_ "EventCommandSignal" SG_ 365 ADC_Obj04RightAngle 0;
BA_ "GatewayedSignals" SG_ 365 ADC_Obj04RightAngle 0;
BA_ "GenSigInactiveValue" SG_ 365 ADC_Obj04RightAngle 0;
BA_ "GenSigInvalidValue" SG_ 365 ADC_Obj04RightAngle 0;
BA_ "GenSigSendType" SG_ 365 ADC_Obj04RightAngle 1;
BA_ "GenSigStartValue" SG_ 365 ADC_Obj04RightAngle 0;
BA_ "GenSigTimeoutValue" SG_ 365 ADC_Obj04RightAngle 0;
BA_ "Remark" SG_ 365 ADC_Obj04RightAngle "";
BA_ "EventCommandSignal" SG_ 365 ADC_Obj04BottomAngle 0;
BA_ "GatewayedSignals" SG_ 365 ADC_Obj04BottomAngle 0;
BA_ "GenSigInactiveValue" SG_ 365 ADC_Obj04BottomAngle 0;
BA_ "GenSigInvalidValue" SG_ 365 ADC_Obj04BottomAngle 0;
BA_ "GenSigSendType" SG_ 365 ADC_Obj04BottomAngle 1;
BA_ "GenSigStartValue" SG_ 365 ADC_Obj04BottomAngle 0;
BA_ "GenSigTimeoutValue" SG_ 365 ADC_Obj04BottomAngle 0;
BA_ "Remark" SG_ 365 ADC_Obj04BottomAngle "";
BA_ "EventCommandSignal" SG_ 365 ADC_Obj04TopAngle 0;
BA_ "GatewayedSignals" SG_ 365 ADC_Obj04TopAngle 0;
BA_ "GenSigInactiveValue" SG_ 365 ADC_Obj04TopAngle 0;
BA_ "GenSigInvalidValue" SG_ 365 ADC_Obj04TopAngle 0;
BA_ "GenSigSendType" SG_ 365 ADC_Obj04TopAngle 1;
BA_ "GenSigStartValue" SG_ 365 ADC_Obj04TopAngle 0;
BA_ "GenSigTimeoutValue" SG_ 365 ADC_Obj04TopAngle 0;
BA_ "Remark" SG_ 365 ADC_Obj04TopAngle "";
BA_ "EventCommandSignal" SG_ 365 ADC_Obj03_ID 0;
BA_ "GatewayedSignals" SG_ 365 ADC_Obj03_ID 0;
BA_ "GenSigInactiveValue" SG_ 365 ADC_Obj03_ID 0;
BA_ "GenSigInvalidValue" SG_ 365 ADC_Obj03_ID 0;
BA_ "GenSigSendType" SG_ 365 ADC_Obj03_ID 1;
BA_ "GenSigStartValue" SG_ 365 ADC_Obj03_ID 0;
BA_ "GenSigTimeoutValue" SG_ 365 ADC_Obj03_ID 0;
BA_ "Remark" SG_ 365 ADC_Obj03_ID "";
BA_ "EventCommandSignal" SG_ 365 ADC_Obj06_ID 0;
BA_ "GatewayedSignals" SG_ 365 ADC_Obj06_ID 0;
BA_ "GenSigInactiveValue" SG_ 365 ADC_Obj06_ID 0;
BA_ "GenSigInvalidValue" SG_ 365 ADC_Obj06_ID 0;
BA_ "GenSigSendType" SG_ 365 ADC_Obj06_ID 1;
BA_ "GenSigStartValue" SG_ 365 ADC_Obj06_ID 0;
BA_ "GenSigTimeoutValue" SG_ 365 ADC_Obj06_ID 0;
BA_ "Remark" SG_ 365 ADC_Obj06_ID "";
BA_ "EventCommandSignal" SG_ 365 ADC_Obj01Dist 0;
BA_ "GatewayedSignals" SG_ 365 ADC_Obj01Dist 0;
BA_ "GenSigInactiveValue" SG_ 365 ADC_Obj01Dist 0;
BA_ "GenSigInvalidValue" SG_ 365 ADC_Obj01Dist 0;
BA_ "GenSigSendType" SG_ 365 ADC_Obj01Dist 1;
BA_ "GenSigStartValue" SG_ 365 ADC_Obj01Dist 0;
BA_ "GenSigTimeoutValue" SG_ 365 ADC_Obj01Dist 0;
BA_ "Remark" SG_ 365 ADC_Obj01Dist "";
BA_ "EventCommandSignal" SG_ 365 ADC_Obj01HoztAngSpd 0;
BA_ "GatewayedSignals" SG_ 365 ADC_Obj01HoztAngSpd 0;
BA_ "GenSigInactiveValue" SG_ 365 ADC_Obj01HoztAngSpd 0;
BA_ "GenSigInvalidValue" SG_ 365 ADC_Obj01HoztAngSpd 0;
BA_ "GenSigSendType" SG_ 365 ADC_Obj01HoztAngSpd 1;
BA_ "GenSigStartValue" SG_ 365 ADC_Obj01HoztAngSpd 0;
BA_ "GenSigTimeoutValue" SG_ 365 ADC_Obj01HoztAngSpd 0;
BA_ "Remark" SG_ 365 ADC_Obj01HoztAngSpd "";
BA_ "EventCommandSignal" SG_ 365 ADC_Obj01LeftAngle 0;
BA_ "GatewayedSignals" SG_ 365 ADC_Obj01LeftAngle 0;
BA_ "GenSigInactiveValue" SG_ 365 ADC_Obj01LeftAngle 0;
BA_ "GenSigInvalidValue" SG_ 365 ADC_Obj01LeftAngle 0;
BA_ "GenSigSendType" SG_ 365 ADC_Obj01LeftAngle 1;
BA_ "GenSigStartValue" SG_ 365 ADC_Obj01LeftAngle 0;
BA_ "GenSigTimeoutValue" SG_ 365 ADC_Obj01LeftAngle 0;
BA_ "Remark" SG_ 365 ADC_Obj01LeftAngle "";
BA_ "EventCommandSignal" SG_ 365 ADC_Obj01RightAngle 0;
BA_ "GatewayedSignals" SG_ 365 ADC_Obj01RightAngle 0;
BA_ "GenSigInactiveValue" SG_ 365 ADC_Obj01RightAngle 0;
BA_ "GenSigInvalidValue" SG_ 365 ADC_Obj01RightAngle 0;
BA_ "GenSigSendType" SG_ 365 ADC_Obj01RightAngle 1;
BA_ "GenSigStartValue" SG_ 365 ADC_Obj01RightAngle 0;
BA_ "GenSigTimeoutValue" SG_ 365 ADC_Obj01RightAngle 0;
BA_ "Remark" SG_ 365 ADC_Obj01RightAngle "";
BA_ "EventCommandSignal" SG_ 365 ADC_Obj01BottomAngle 0;
BA_ "GatewayedSignals" SG_ 365 ADC_Obj01BottomAngle 0;
BA_ "GenSigInactiveValue" SG_ 365 ADC_Obj01BottomAngle 0;
BA_ "GenSigInvalidValue" SG_ 365 ADC_Obj01BottomAngle 0;
BA_ "GenSigSendType" SG_ 365 ADC_Obj01BottomAngle 1;
BA_ "GenSigStartValue" SG_ 365 ADC_Obj01BottomAngle 0;
BA_ "GenSigTimeoutValue" SG_ 365 ADC_Obj01BottomAngle 0;
BA_ "Remark" SG_ 365 ADC_Obj01BottomAngle "";
BA_ "EventCommandSignal" SG_ 365 ADC_Obj01TopAngle 0;
BA_ "GatewayedSignals" SG_ 365 ADC_Obj01TopAngle 0;
BA_ "GenSigInactiveValue" SG_ 365 ADC_Obj01TopAngle 0;
BA_ "GenSigInvalidValue" SG_ 365 ADC_Obj01TopAngle 0;
BA_ "GenSigSendType" SG_ 365 ADC_Obj01TopAngle 1;
BA_ "GenSigStartValue" SG_ 365 ADC_Obj01TopAngle 0;
BA_ "GenSigTimeoutValue" SG_ 365 ADC_Obj01TopAngle 0;
BA_ "Remark" SG_ 365 ADC_Obj01TopAngle "";
BA_ "EventCommandSignal" SG_ 365 ADC_Obj05Dist 0;
BA_ "GatewayedSignals" SG_ 365 ADC_Obj05Dist 0;
BA_ "GenSigInactiveValue" SG_ 365 ADC_Obj05Dist 0;
BA_ "GenSigInvalidValue" SG_ 365 ADC_Obj05Dist 0;
BA_ "GenSigSendType" SG_ 365 ADC_Obj05Dist 1;
BA_ "GenSigStartValue" SG_ 365 ADC_Obj05Dist 0;
BA_ "GenSigTimeoutValue" SG_ 365 ADC_Obj05Dist 0;
BA_ "Remark" SG_ 365 ADC_Obj05Dist "";
BA_ "EventCommandSignal" SG_ 365 ADC_Obj05HoztAngSpd 0;
BA_ "GatewayedSignals" SG_ 365 ADC_Obj05HoztAngSpd 0;
BA_ "GenSigInactiveValue" SG_ 365 ADC_Obj05HoztAngSpd 0;
BA_ "GenSigInvalidValue" SG_ 365 ADC_Obj05HoztAngSpd 0;
BA_ "GenSigSendType" SG_ 365 ADC_Obj05HoztAngSpd 1;
BA_ "GenSigStartValue" SG_ 365 ADC_Obj05HoztAngSpd 0;
BA_ "GenSigTimeoutValue" SG_ 365 ADC_Obj05HoztAngSpd 0;
BA_ "Remark" SG_ 365 ADC_Obj05HoztAngSpd "";
BA_ "EventCommandSignal" SG_ 365 ADC_Obj05LeftAngle 0;
BA_ "GatewayedSignals" SG_ 365 ADC_Obj05LeftAngle 0;
BA_ "GenSigInactiveValue" SG_ 365 ADC_Obj05LeftAngle 0;
BA_ "GenSigInvalidValue" SG_ 365 ADC_Obj05LeftAngle 0;
BA_ "GenSigSendType" SG_ 365 ADC_Obj05LeftAngle 1;
BA_ "GenSigStartValue" SG_ 365 ADC_Obj05LeftAngle 0;
BA_ "GenSigTimeoutValue" SG_ 365 ADC_Obj05LeftAngle 0;
BA_ "Remark" SG_ 365 ADC_Obj05LeftAngle "";
BA_ "EventCommandSignal" SG_ 365 ADC_Obj05RightAngle 0;
BA_ "GatewayedSignals" SG_ 365 ADC_Obj05RightAngle 0;
BA_ "GenSigInactiveValue" SG_ 365 ADC_Obj05RightAngle 0;
BA_ "GenSigInvalidValue" SG_ 365 ADC_Obj05RightAngle 0;
BA_ "GenSigSendType" SG_ 365 ADC_Obj05RightAngle 1;
BA_ "GenSigStartValue" SG_ 365 ADC_Obj05RightAngle 0;
BA_ "GenSigTimeoutValue" SG_ 365 ADC_Obj05RightAngle 0;
BA_ "Remark" SG_ 365 ADC_Obj05RightAngle "";
BA_ "EventCommandSignal" SG_ 365 ADC_Obj05BottomAngle 0;
BA_ "GatewayedSignals" SG_ 365 ADC_Obj05BottomAngle 0;
BA_ "GenSigInactiveValue" SG_ 365 ADC_Obj05BottomAngle 0;
BA_ "GenSigInvalidValue" SG_ 365 ADC_Obj05BottomAngle 0;
BA_ "GenSigSendType" SG_ 365 ADC_Obj05BottomAngle 1;
BA_ "GenSigStartValue" SG_ 365 ADC_Obj05BottomAngle 0;
BA_ "GenSigTimeoutValue" SG_ 365 ADC_Obj05BottomAngle 0;
BA_ "Remark" SG_ 365 ADC_Obj05BottomAngle "";
BA_ "EventCommandSignal" SG_ 365 ADC_Obj05TopAngle 0;
BA_ "GatewayedSignals" SG_ 365 ADC_Obj05TopAngle 0;
BA_ "GenSigInactiveValue" SG_ 365 ADC_Obj05TopAngle 0;
BA_ "GenSigInvalidValue" SG_ 365 ADC_Obj05TopAngle 0;
BA_ "GenSigSendType" SG_ 365 ADC_Obj05TopAngle 1;
BA_ "GenSigStartValue" SG_ 365 ADC_Obj05TopAngle 0;
BA_ "GenSigTimeoutValue" SG_ 365 ADC_Obj05TopAngle 0;
BA_ "Remark" SG_ 365 ADC_Obj05TopAngle "";
BA_ "EventCommandSignal" SG_ 365 ADC_Obj06Dist 0;
BA_ "GatewayedSignals" SG_ 365 ADC_Obj06Dist 0;
BA_ "GenSigInactiveValue" SG_ 365 ADC_Obj06Dist 0;
BA_ "GenSigInvalidValue" SG_ 365 ADC_Obj06Dist 0;
BA_ "GenSigSendType" SG_ 365 ADC_Obj06Dist 1;
BA_ "GenSigStartValue" SG_ 365 ADC_Obj06Dist 0;
BA_ "GenSigTimeoutValue" SG_ 365 ADC_Obj06Dist 0;
BA_ "Remark" SG_ 365 ADC_Obj06Dist "";
BA_ "EventCommandSignal" SG_ 365 ADC_Obj06HoztAngSpd 0;
BA_ "GatewayedSignals" SG_ 365 ADC_Obj06HoztAngSpd 0;
BA_ "GenSigInactiveValue" SG_ 365 ADC_Obj06HoztAngSpd 0;
BA_ "GenSigInvalidValue" SG_ 365 ADC_Obj06HoztAngSpd 0;
BA_ "GenSigSendType" SG_ 365 ADC_Obj06HoztAngSpd 1;
BA_ "GenSigStartValue" SG_ 365 ADC_Obj06HoztAngSpd 0;
BA_ "GenSigTimeoutValue" SG_ 365 ADC_Obj06HoztAngSpd 0;
BA_ "Remark" SG_ 365 ADC_Obj06HoztAngSpd "";
BA_ "EventCommandSignal" SG_ 365 ADC_Obj06LeftAngle 0;
BA_ "GatewayedSignals" SG_ 365 ADC_Obj06LeftAngle 0;
BA_ "GenSigInactiveValue" SG_ 365 ADC_Obj06LeftAngle 0;
BA_ "GenSigInvalidValue" SG_ 365 ADC_Obj06LeftAngle 0;
BA_ "GenSigSendType" SG_ 365 ADC_Obj06LeftAngle 1;
BA_ "GenSigStartValue" SG_ 365 ADC_Obj06LeftAngle 0;
BA_ "GenSigTimeoutValue" SG_ 365 ADC_Obj06LeftAngle 0;
BA_ "Remark" SG_ 365 ADC_Obj06LeftAngle "";
BA_ "EventCommandSignal" SG_ 365 ADC_Obj06RightAngle 0;
BA_ "GatewayedSignals" SG_ 365 ADC_Obj06RightAngle 0;
BA_ "GenSigInactiveValue" SG_ 365 ADC_Obj06RightAngle 0;
BA_ "GenSigInvalidValue" SG_ 365 ADC_Obj06RightAngle 0;
BA_ "GenSigSendType" SG_ 365 ADC_Obj06RightAngle 1;
BA_ "GenSigStartValue" SG_ 365 ADC_Obj06RightAngle 0;
BA_ "GenSigTimeoutValue" SG_ 365 ADC_Obj06RightAngle 0;
BA_ "Remark" SG_ 365 ADC_Obj06RightAngle "";
BA_ "EventCommandSignal" SG_ 365 ADC_Obj06BottomAngle 0;
BA_ "GatewayedSignals" SG_ 365 ADC_Obj06BottomAngle 0;
BA_ "GenSigInactiveValue" SG_ 365 ADC_Obj06BottomAngle 0;
BA_ "GenSigInvalidValue" SG_ 365 ADC_Obj06BottomAngle 0;
BA_ "GenSigSendType" SG_ 365 ADC_Obj06BottomAngle 1;
BA_ "GenSigStartValue" SG_ 365 ADC_Obj06BottomAngle 0;
BA_ "GenSigTimeoutValue" SG_ 365 ADC_Obj06BottomAngle 0;
BA_ "Remark" SG_ 365 ADC_Obj06BottomAngle "";
BA_ "EventCommandSignal" SG_ 365 ADC_Obj02Dist 0;
BA_ "GatewayedSignals" SG_ 365 ADC_Obj02Dist 0;
BA_ "GenSigInactiveValue" SG_ 365 ADC_Obj02Dist 0;
BA_ "GenSigInvalidValue" SG_ 365 ADC_Obj02Dist 0;
BA_ "GenSigSendType" SG_ 365 ADC_Obj02Dist 1;
BA_ "GenSigStartValue" SG_ 365 ADC_Obj02Dist 0;
BA_ "GenSigTimeoutValue" SG_ 365 ADC_Obj02Dist 0;
BA_ "Remark" SG_ 365 ADC_Obj02Dist "";
BA_ "EventCommandSignal" SG_ 365 ADC_Obj02HoztAngSpd 0;
BA_ "GatewayedSignals" SG_ 365 ADC_Obj02HoztAngSpd 0;
BA_ "GenSigInactiveValue" SG_ 365 ADC_Obj02HoztAngSpd 0;
BA_ "GenSigInvalidValue" SG_ 365 ADC_Obj02HoztAngSpd 0;
BA_ "GenSigSendType" SG_ 365 ADC_Obj02HoztAngSpd 1;
BA_ "GenSigStartValue" SG_ 365 ADC_Obj02HoztAngSpd 0;
BA_ "GenSigTimeoutValue" SG_ 365 ADC_Obj02HoztAngSpd 0;
BA_ "Remark" SG_ 365 ADC_Obj02HoztAngSpd "";
BA_ "EventCommandSignal" SG_ 365 ADC_Obj02LeftAngle 0;
BA_ "GatewayedSignals" SG_ 365 ADC_Obj02LeftAngle 0;
BA_ "GenSigInactiveValue" SG_ 365 ADC_Obj02LeftAngle 0;
BA_ "GenSigInvalidValue" SG_ 365 ADC_Obj02LeftAngle 0;
BA_ "GenSigSendType" SG_ 365 ADC_Obj02LeftAngle 1;
BA_ "GenSigStartValue" SG_ 365 ADC_Obj02LeftAngle 0;
BA_ "GenSigTimeoutValue" SG_ 365 ADC_Obj02LeftAngle 0;
BA_ "Remark" SG_ 365 ADC_Obj02LeftAngle "";
BA_ "EventCommandSignal" SG_ 365 ADC_Obj02RightAngle 0;
BA_ "GatewayedSignals" SG_ 365 ADC_Obj02RightAngle 0;
BA_ "GenSigInactiveValue" SG_ 365 ADC_Obj02RightAngle 0;
BA_ "GenSigInvalidValue" SG_ 365 ADC_Obj02RightAngle 0;
BA_ "GenSigSendType" SG_ 365 ADC_Obj02RightAngle 1;
BA_ "GenSigStartValue" SG_ 365 ADC_Obj02RightAngle 0;
BA_ "GenSigTimeoutValue" SG_ 365 ADC_Obj02RightAngle 0;
BA_ "Remark" SG_ 365 ADC_Obj02RightAngle "";
BA_ "EventCommandSignal" SG_ 365 ADC_Obj02BottomAngle 0;
BA_ "GatewayedSignals" SG_ 365 ADC_Obj02BottomAngle 0;
BA_ "GenSigInactiveValue" SG_ 365 ADC_Obj02BottomAngle 0;
BA_ "GenSigInvalidValue" SG_ 365 ADC_Obj02BottomAngle 0;
BA_ "GenSigSendType" SG_ 365 ADC_Obj02BottomAngle 1;
BA_ "GenSigStartValue" SG_ 365 ADC_Obj02BottomAngle 0;
BA_ "GenSigTimeoutValue" SG_ 365 ADC_Obj02BottomAngle 0;
BA_ "Remark" SG_ 365 ADC_Obj02BottomAngle "";
BA_ "EventCommandSignal" SG_ 365 ADC_Obj02TopAngle 0;
BA_ "GatewayedSignals" SG_ 365 ADC_Obj02TopAngle 0;
BA_ "GenSigInactiveValue" SG_ 365 ADC_Obj02TopAngle 0;
BA_ "GenSigInvalidValue" SG_ 365 ADC_Obj02TopAngle 0;
BA_ "GenSigSendType" SG_ 365 ADC_Obj02TopAngle 1;
BA_ "GenSigStartValue" SG_ 365 ADC_Obj02TopAngle 0;
BA_ "GenSigTimeoutValue" SG_ 365 ADC_Obj02TopAngle 0;
BA_ "Remark" SG_ 365 ADC_Obj02TopAngle "";
BA_ "EventCommandSignal" SG_ 365 ADC_Obj06TopAngle 0;
BA_ "GatewayedSignals" SG_ 365 ADC_Obj06TopAngle 0;
BA_ "GenSigInactiveValue" SG_ 365 ADC_Obj06TopAngle 0;
BA_ "GenSigInvalidValue" SG_ 365 ADC_Obj06TopAngle 0;
BA_ "GenSigSendType" SG_ 365 ADC_Obj06TopAngle 1;
BA_ "GenSigStartValue" SG_ 365 ADC_Obj06TopAngle 0;
BA_ "GenSigTimeoutValue" SG_ 365 ADC_Obj06TopAngle 0;
BA_ "Remark" SG_ 365 ADC_Obj06TopAngle "";
BA_ "EventCommandSignal" SG_ 365 ADC_Obj07Dist 0;
BA_ "GatewayedSignals" SG_ 365 ADC_Obj07Dist 0;
BA_ "GenSigInactiveValue" SG_ 365 ADC_Obj07Dist 0;
BA_ "GenSigInvalidValue" SG_ 365 ADC_Obj07Dist 0;
BA_ "GenSigSendType" SG_ 365 ADC_Obj07Dist 1;
BA_ "GenSigStartValue" SG_ 365 ADC_Obj07Dist 0;
BA_ "GenSigTimeoutValue" SG_ 365 ADC_Obj07Dist 0;
BA_ "Remark" SG_ 365 ADC_Obj07Dist "";
BA_ "EventCommandSignal" SG_ 365 ADC_Obj07HoztAngSpd 0;
BA_ "GatewayedSignals" SG_ 365 ADC_Obj07HoztAngSpd 0;
BA_ "GenSigInactiveValue" SG_ 365 ADC_Obj07HoztAngSpd 0;
BA_ "GenSigInvalidValue" SG_ 365 ADC_Obj07HoztAngSpd 0;
BA_ "GenSigSendType" SG_ 365 ADC_Obj07HoztAngSpd 1;
BA_ "GenSigStartValue" SG_ 365 ADC_Obj07HoztAngSpd 0;
BA_ "GenSigTimeoutValue" SG_ 365 ADC_Obj07HoztAngSpd 0;
BA_ "Remark" SG_ 365 ADC_Obj07HoztAngSpd "";
BA_ "EventCommandSignal" SG_ 365 ADC_Obj07LeftAngle 0;
BA_ "GatewayedSignals" SG_ 365 ADC_Obj07LeftAngle 0;
BA_ "GenSigInactiveValue" SG_ 365 ADC_Obj07LeftAngle 0;
BA_ "GenSigInvalidValue" SG_ 365 ADC_Obj07LeftAngle 0;
BA_ "GenSigSendType" SG_ 365 ADC_Obj07LeftAngle 1;
BA_ "GenSigStartValue" SG_ 365 ADC_Obj07LeftAngle 0;
BA_ "GenSigTimeoutValue" SG_ 365 ADC_Obj07LeftAngle 0;
BA_ "Remark" SG_ 365 ADC_Obj07LeftAngle "";
BA_ "EventCommandSignal" SG_ 365 ADC_Obj07BottomAngle 0;
BA_ "GatewayedSignals" SG_ 365 ADC_Obj07BottomAngle 0;
BA_ "GenSigInactiveValue" SG_ 365 ADC_Obj07BottomAngle 0;
BA_ "GenSigInvalidValue" SG_ 365 ADC_Obj07BottomAngle 0;
BA_ "GenSigSendType" SG_ 365 ADC_Obj07BottomAngle 1;
BA_ "GenSigStartValue" SG_ 365 ADC_Obj07BottomAngle 0;
BA_ "GenSigTimeoutValue" SG_ 365 ADC_Obj07BottomAngle 0;
BA_ "Remark" SG_ 365 ADC_Obj07BottomAngle "";
BA_ "EventCommandSignal" SG_ 365 ADC_Obj05_ID 0;
BA_ "GatewayedSignals" SG_ 365 ADC_Obj05_ID 0;
BA_ "GenSigInactiveValue" SG_ 365 ADC_Obj05_ID 0;
BA_ "GenSigInvalidValue" SG_ 365 ADC_Obj05_ID 0;
BA_ "GenSigSendType" SG_ 365 ADC_Obj05_ID 1;
BA_ "GenSigStartValue" SG_ 365 ADC_Obj05_ID 0;
BA_ "GenSigTimeoutValue" SG_ 365 ADC_Obj05_ID 0;
BA_ "Remark" SG_ 365 ADC_Obj05_ID "";
BA_ "EventCommandSignal" SG_ 365 ADC_Obj04Typ 0;
BA_ "GatewayedSignals" SG_ 365 ADC_Obj04Typ 0;
BA_ "GenSigInactiveValue" SG_ 365 ADC_Obj04Typ 0;
BA_ "GenSigInvalidValue" SG_ 365 ADC_Obj04Typ 0;
BA_ "GenSigSendType" SG_ 365 ADC_Obj04Typ 1;
BA_ "GenSigStartValue" SG_ 365 ADC_Obj04Typ 0;
BA_ "GenSigTimeoutValue" SG_ 365 ADC_Obj04Typ 0;
BA_ "Remark" SG_ 365 ADC_Obj04Typ "";
BA_ "EventCommandSignal" SG_ 365 ADC_Obj04Dir 0;
BA_ "GatewayedSignals" SG_ 365 ADC_Obj04Dir 0;
BA_ "GenSigInactiveValue" SG_ 365 ADC_Obj04Dir 0;
BA_ "GenSigInvalidValue" SG_ 365 ADC_Obj04Dir 0;
BA_ "GenSigSendType" SG_ 365 ADC_Obj04Dir 1;
BA_ "GenSigStartValue" SG_ 365 ADC_Obj04Dir 0;
BA_ "GenSigTimeoutValue" SG_ 365 ADC_Obj04Dir 0;
BA_ "Remark" SG_ 365 ADC_Obj04Dir "";
BA_ "EventCommandSignal" SG_ 365 ADC_ADBCamSt 0;
BA_ "GatewayedSignals" SG_ 365 ADC_ADBCamSt 0;
BA_ "GenSigInactiveValue" SG_ 365 ADC_ADBCamSt 0;
BA_ "GenSigInvalidValue" SG_ 365 ADC_ADBCamSt 0;
BA_ "GenSigSendType" SG_ 365 ADC_ADBCamSt 1;
BA_ "GenSigStartValue" SG_ 365 ADC_ADBCamSt 15;
BA_ "GenSigTimeoutValue" SG_ 365 ADC_ADBCamSt 0;
BA_ "Remark" SG_ 365 ADC_ADBCamSt "";
BA_ "EventCommandSignal" SG_ 365 ADC_Obj03Dir 0;
BA_ "GatewayedSignals" SG_ 365 ADC_Obj03Dir 0;
BA_ "GenSigInactiveValue" SG_ 365 ADC_Obj03Dir 0;
BA_ "GenSigInvalidValue" SG_ 365 ADC_Obj03Dir 0;
BA_ "GenSigSendType" SG_ 365 ADC_Obj03Dir 1;
BA_ "GenSigStartValue" SG_ 365 ADC_Obj03Dir 0;
BA_ "GenSigTimeoutValue" SG_ 365 ADC_Obj03Dir 0;
BA_ "Remark" SG_ 365 ADC_Obj03Dir "";
BA_ "EventCommandSignal" SG_ 365 ADC_Obj02Dir 0;
BA_ "GatewayedSignals" SG_ 365 ADC_Obj02Dir 0;
BA_ "GenSigInactiveValue" SG_ 365 ADC_Obj02Dir 0;
BA_ "GenSigInvalidValue" SG_ 365 ADC_Obj02Dir 0;
BA_ "GenSigSendType" SG_ 365 ADC_Obj02Dir 1;
BA_ "GenSigStartValue" SG_ 365 ADC_Obj02Dir 0;
BA_ "GenSigTimeoutValue" SG_ 365 ADC_Obj02Dir 0;
BA_ "Remark" SG_ 365 ADC_Obj02Dir "";
BA_ "EventCommandSignal" SG_ 365 ADC_Obj02Typ 0;
BA_ "GatewayedSignals" SG_ 365 ADC_Obj02Typ 0;
BA_ "GenSigInactiveValue" SG_ 365 ADC_Obj02Typ 0;
BA_ "GenSigInvalidValue" SG_ 365 ADC_Obj02Typ 0;
BA_ "GenSigSendType" SG_ 365 ADC_Obj02Typ 1;
BA_ "GenSigStartValue" SG_ 365 ADC_Obj02Typ 0;
BA_ "GenSigTimeoutValue" SG_ 365 ADC_Obj02Typ 0;
BA_ "Remark" SG_ 365 ADC_Obj02Typ "";
BA_ "EventCommandSignal" SG_ 365 ADC_Obj03Typ 0;
BA_ "GatewayedSignals" SG_ 365 ADC_Obj03Typ 0;
BA_ "GenSigInactiveValue" SG_ 365 ADC_Obj03Typ 0;
BA_ "GenSigInvalidValue" SG_ 365 ADC_Obj03Typ 0;
BA_ "GenSigSendType" SG_ 365 ADC_Obj03Typ 1;
BA_ "GenSigStartValue" SG_ 365 ADC_Obj03Typ 0;
BA_ "GenSigTimeoutValue" SG_ 365 ADC_Obj03Typ 0;
BA_ "Remark" SG_ 365 ADC_Obj03Typ "";
BA_ "EventCommandSignal" SG_ 365 ADC_Obj01Typ 0;
BA_ "GatewayedSignals" SG_ 365 ADC_Obj01Typ 0;
BA_ "GenSigInactiveValue" SG_ 365 ADC_Obj01Typ 0;
BA_ "GenSigInvalidValue" SG_ 365 ADC_Obj01Typ 0;
BA_ "GenSigSendType" SG_ 365 ADC_Obj01Typ 1;
BA_ "GenSigStartValue" SG_ 365 ADC_Obj01Typ 0;
BA_ "GenSigTimeoutValue" SG_ 365 ADC_Obj01Typ 0;
BA_ "Remark" SG_ 365 ADC_Obj01Typ "";
BA_ "EventCommandSignal" SG_ 365 ADC_Obj01Dir 0;
BA_ "GatewayedSignals" SG_ 365 ADC_Obj01Dir 0;
BA_ "GenSigInactiveValue" SG_ 365 ADC_Obj01Dir 0;
BA_ "GenSigInvalidValue" SG_ 365 ADC_Obj01Dir 0;
BA_ "GenSigSendType" SG_ 365 ADC_Obj01Dir 1;
BA_ "GenSigStartValue" SG_ 365 ADC_Obj01Dir 0;
BA_ "GenSigTimeoutValue" SG_ 365 ADC_Obj01Dir 0;
BA_ "Remark" SG_ 365 ADC_Obj01Dir "";
BA_ "EventCommandSignal" SG_ 365 ADC_ObjNum 0;
BA_ "GatewayedSignals" SG_ 365 ADC_ObjNum 0;
BA_ "GenSigInactiveValue" SG_ 365 ADC_ObjNum 0;
BA_ "GenSigInvalidValue" SG_ 365 ADC_ObjNum 0;
BA_ "GenSigSendType" SG_ 365 ADC_ObjNum 1;
BA_ "GenSigStartValue" SG_ 365 ADC_ObjNum 0;
BA_ "GenSigTimeoutValue" SG_ 365 ADC_ObjNum 0;
BA_ "Remark" SG_ 365 ADC_ObjNum "";
BA_ "EventCommandSignal" SG_ 365 ADC_AmbLightCondition 0;
BA_ "GatewayedSignals" SG_ 365 ADC_AmbLightCondition 0;
BA_ "GenSigInactiveValue" SG_ 365 ADC_AmbLightCondition 0;
BA_ "GenSigInvalidValue" SG_ 365 ADC_AmbLightCondition 0;
BA_ "GenSigSendType" SG_ 365 ADC_AmbLightCondition 1;
BA_ "GenSigStartValue" SG_ 365 ADC_AmbLightCondition 0;
BA_ "GenSigTimeoutValue" SG_ 365 ADC_AmbLightCondition 0;
BA_ "Remark" SG_ 365 ADC_AmbLightCondition "";
BA_ "EventCommandSignal" SG_ 365 ADC_TrafficStyle 0;
BA_ "GatewayedSignals" SG_ 365 ADC_TrafficStyle 0;
BA_ "GenSigInactiveValue" SG_ 365 ADC_TrafficStyle 0;
BA_ "GenSigInvalidValue" SG_ 365 ADC_TrafficStyle 0;
BA_ "GenSigSendType" SG_ 365 ADC_TrafficStyle 1;
BA_ "GenSigStartValue" SG_ 365 ADC_TrafficStyle 0;
BA_ "GenSigTimeoutValue" SG_ 365 ADC_TrafficStyle 0;
BA_ "Remark" SG_ 365 ADC_TrafficStyle "";
BA_ "EventCommandSignal" SG_ 365 ADC_Obj05Typ 0;
BA_ "GatewayedSignals" SG_ 365 ADC_Obj05Typ 0;
BA_ "GenSigInactiveValue" SG_ 365 ADC_Obj05Typ 0;
BA_ "GenSigInvalidValue" SG_ 365 ADC_Obj05Typ 0;
BA_ "GenSigSendType" SG_ 365 ADC_Obj05Typ 1;
BA_ "GenSigStartValue" SG_ 365 ADC_Obj05Typ 0;
BA_ "GenSigTimeoutValue" SG_ 365 ADC_Obj05Typ 0;
BA_ "Remark" SG_ 365 ADC_Obj05Typ "";
BA_ "EventCommandSignal" SG_ 365 ADC_Obj05Dir 0;
BA_ "GatewayedSignals" SG_ 365 ADC_Obj05Dir 0;
BA_ "GenSigInactiveValue" SG_ 365 ADC_Obj05Dir 0;
BA_ "GenSigInvalidValue" SG_ 365 ADC_Obj05Dir 0;
BA_ "GenSigSendType" SG_ 365 ADC_Obj05Dir 1;
BA_ "GenSigStartValue" SG_ 365 ADC_Obj05Dir 0;
BA_ "GenSigTimeoutValue" SG_ 365 ADC_Obj05Dir 0;
BA_ "Remark" SG_ 365 ADC_Obj05Dir "";
BA_ "EventCommandSignal" SG_ 365 ADC_Obj06Typ 0;
BA_ "GatewayedSignals" SG_ 365 ADC_Obj06Typ 0;
BA_ "GenSigInactiveValue" SG_ 365 ADC_Obj06Typ 0;
BA_ "GenSigInvalidValue" SG_ 365 ADC_Obj06Typ 0;
BA_ "GenSigSendType" SG_ 365 ADC_Obj06Typ 1;
BA_ "GenSigStartValue" SG_ 365 ADC_Obj06Typ 0;
BA_ "GenSigTimeoutValue" SG_ 365 ADC_Obj06Typ 0;
BA_ "Remark" SG_ 365 ADC_Obj06Typ "";
BA_ "EventCommandSignal" SG_ 365 ADC_Obj06Dir 0;
BA_ "GatewayedSignals" SG_ 365 ADC_Obj06Dir 0;
BA_ "GenSigInactiveValue" SG_ 365 ADC_Obj06Dir 0;
BA_ "GenSigInvalidValue" SG_ 365 ADC_Obj06Dir 0;
BA_ "GenSigSendType" SG_ 365 ADC_Obj06Dir 1;
BA_ "GenSigStartValue" SG_ 365 ADC_Obj06Dir 0;
BA_ "GenSigTimeoutValue" SG_ 365 ADC_Obj06Dir 0;
BA_ "Remark" SG_ 365 ADC_Obj06Dir "";
BA_ "EventCommandSignal" SG_ 365 ADC_Obj07_ID 0;
BA_ "GatewayedSignals" SG_ 365 ADC_Obj07_ID 0;
BA_ "GenSigInactiveValue" SG_ 365 ADC_Obj07_ID 0;
BA_ "GenSigInvalidValue" SG_ 365 ADC_Obj07_ID 0;
BA_ "GenSigSendType" SG_ 365 ADC_Obj07_ID 1;
BA_ "GenSigStartValue" SG_ 365 ADC_Obj07_ID 0;
BA_ "GenSigTimeoutValue" SG_ 365 ADC_Obj07_ID 0;
BA_ "Remark" SG_ 365 ADC_Obj07_ID "";
BA_ "EventCommandSignal" SG_ 365 ADC_Obj07Typ 0;
BA_ "GatewayedSignals" SG_ 365 ADC_Obj07Typ 0;
BA_ "GenSigInactiveValue" SG_ 365 ADC_Obj07Typ 0;
BA_ "GenSigInvalidValue" SG_ 365 ADC_Obj07Typ 0;
BA_ "GenSigSendType" SG_ 365 ADC_Obj07Typ 1;
BA_ "GenSigStartValue" SG_ 365 ADC_Obj07Typ 0;
BA_ "GenSigTimeoutValue" SG_ 365 ADC_Obj07Typ 0;
BA_ "Remark" SG_ 365 ADC_Obj07Typ "";
BA_ "EventCommandSignal" SG_ 365 ADC_Obj07Dir 0;
BA_ "GatewayedSignals" SG_ 365 ADC_Obj07Dir 0;
BA_ "GenSigInactiveValue" SG_ 365 ADC_Obj07Dir 0;
BA_ "GenSigInvalidValue" SG_ 365 ADC_Obj07Dir 0;
BA_ "GenSigSendType" SG_ 365 ADC_Obj07Dir 1;
BA_ "GenSigStartValue" SG_ 365 ADC_Obj07Dir 0;
BA_ "GenSigTimeoutValue" SG_ 365 ADC_Obj07Dir 0;
BA_ "Remark" SG_ 365 ADC_Obj07Dir "";
BA_ "EventCommandSignal" SG_ 366 ADC_20_CRC 0;
BA_ "GatewayedSignals" SG_ 366 ADC_20_CRC 0;
BA_ "GenSigInactiveValue" SG_ 366 ADC_20_CRC 0;
BA_ "GenSigInvalidValue" SG_ 366 ADC_20_CRC 0;
BA_ "GenSigSendType" SG_ 366 ADC_20_CRC 1;
BA_ "GenSigStartValue" SG_ 366 ADC_20_CRC 0;
BA_ "GenSigTimeoutValue" SG_ 366 ADC_20_CRC 0;
BA_ "Remark" SG_ 366 ADC_20_CRC "";
BA_ "EventCommandSignal" SG_ 366 ADC_20_Counter 0;
BA_ "GatewayedSignals" SG_ 366 ADC_20_Counter 0;
BA_ "GenSigInactiveValue" SG_ 366 ADC_20_Counter 0;
BA_ "GenSigInvalidValue" SG_ 366 ADC_20_Counter 0;
BA_ "GenSigSendType" SG_ 366 ADC_20_Counter 1;
BA_ "GenSigStartValue" SG_ 366 ADC_20_Counter 0;
BA_ "GenSigTimeoutValue" SG_ 366 ADC_20_Counter 0;
BA_ "Remark" SG_ 366 ADC_20_Counter "";
BA_ "EventCommandSignal" SG_ 366 ADC_Obj07RightAngle 0;
BA_ "GatewayedSignals" SG_ 366 ADC_Obj07RightAngle 0;
BA_ "GenSigInactiveValue" SG_ 366 ADC_Obj07RightAngle 0;
BA_ "GenSigInvalidValue" SG_ 366 ADC_Obj07RightAngle 0;
BA_ "GenSigSendType" SG_ 366 ADC_Obj07RightAngle 1;
BA_ "GenSigStartValue" SG_ 366 ADC_Obj07RightAngle 0;
BA_ "GenSigTimeoutValue" SG_ 366 ADC_Obj07RightAngle 0;
BA_ "Remark" SG_ 366 ADC_Obj07RightAngle "";
BA_ "EventCommandSignal" SG_ 366 ADC_Obj07TopAngle 0;
BA_ "GatewayedSignals" SG_ 366 ADC_Obj07TopAngle 0;
BA_ "GenSigInactiveValue" SG_ 366 ADC_Obj07TopAngle 0;
BA_ "GenSigInvalidValue" SG_ 366 ADC_Obj07TopAngle 0;
BA_ "GenSigSendType" SG_ 366 ADC_Obj07TopAngle 1;
BA_ "GenSigStartValue" SG_ 366 ADC_Obj07TopAngle 0;
BA_ "GenSigTimeoutValue" SG_ 366 ADC_Obj07TopAngle 0;
BA_ "Remark" SG_ 366 ADC_Obj07TopAngle "";
BA_ "EventCommandSignal" SG_ 366 ADC_Obj08_ID 0;
BA_ "GatewayedSignals" SG_ 366 ADC_Obj08_ID 0;
BA_ "GenSigInactiveValue" SG_ 366 ADC_Obj08_ID 0;
BA_ "GenSigInvalidValue" SG_ 366 ADC_Obj08_ID 0;
BA_ "GenSigSendType" SG_ 366 ADC_Obj08_ID 1;
BA_ "GenSigStartValue" SG_ 366 ADC_Obj08_ID 0;
BA_ "GenSigTimeoutValue" SG_ 366 ADC_Obj08_ID 0;
BA_ "Remark" SG_ 366 ADC_Obj08_ID "";
BA_ "EventCommandSignal" SG_ 366 ADC_Obj08Typ 0;
BA_ "GatewayedSignals" SG_ 366 ADC_Obj08Typ 0;
BA_ "GenSigInactiveValue" SG_ 366 ADC_Obj08Typ 0;
BA_ "GenSigInvalidValue" SG_ 366 ADC_Obj08Typ 0;
BA_ "GenSigSendType" SG_ 366 ADC_Obj08Typ 1;
BA_ "GenSigStartValue" SG_ 366 ADC_Obj08Typ 0;
BA_ "GenSigTimeoutValue" SG_ 366 ADC_Obj08Typ 0;
BA_ "Remark" SG_ 366 ADC_Obj08Typ "";
BA_ "EventCommandSignal" SG_ 366 ADC_Obj08Dir 0;
BA_ "GatewayedSignals" SG_ 366 ADC_Obj08Dir 0;
BA_ "GenSigInactiveValue" SG_ 366 ADC_Obj08Dir 0;
BA_ "GenSigInvalidValue" SG_ 366 ADC_Obj08Dir 0;
BA_ "GenSigSendType" SG_ 366 ADC_Obj08Dir 1;
BA_ "GenSigStartValue" SG_ 366 ADC_Obj08Dir 0;
BA_ "GenSigTimeoutValue" SG_ 366 ADC_Obj08Dir 0;
BA_ "Remark" SG_ 366 ADC_Obj08Dir "";
BA_ "EventCommandSignal" SG_ 366 ADC_Obj08Dist 0;
BA_ "GatewayedSignals" SG_ 366 ADC_Obj08Dist 0;
BA_ "GenSigInactiveValue" SG_ 366 ADC_Obj08Dist 0;
BA_ "GenSigInvalidValue" SG_ 366 ADC_Obj08Dist 0;
BA_ "GenSigSendType" SG_ 366 ADC_Obj08Dist 1;
BA_ "GenSigStartValue" SG_ 366 ADC_Obj08Dist 0;
BA_ "GenSigTimeoutValue" SG_ 366 ADC_Obj08Dist 0;
BA_ "Remark" SG_ 366 ADC_Obj08Dist "";
BA_ "EventCommandSignal" SG_ 366 ADC_Obj08HoztAngSpd 0;
BA_ "GatewayedSignals" SG_ 366 ADC_Obj08HoztAngSpd 0;
BA_ "GenSigInactiveValue" SG_ 366 ADC_Obj08HoztAngSpd 0;
BA_ "GenSigInvalidValue" SG_ 366 ADC_Obj08HoztAngSpd 0;
BA_ "GenSigSendType" SG_ 366 ADC_Obj08HoztAngSpd 1;
BA_ "GenSigStartValue" SG_ 366 ADC_Obj08HoztAngSpd 0;
BA_ "GenSigTimeoutValue" SG_ 366 ADC_Obj08HoztAngSpd 0;
BA_ "Remark" SG_ 366 ADC_Obj08HoztAngSpd "";
BA_ "EventCommandSignal" SG_ 366 ADC_Obj08LeftAngle 0;
BA_ "GatewayedSignals" SG_ 366 ADC_Obj08LeftAngle 0;
BA_ "GenSigInactiveValue" SG_ 366 ADC_Obj08LeftAngle 0;
BA_ "GenSigInvalidValue" SG_ 366 ADC_Obj08LeftAngle 0;
BA_ "GenSigSendType" SG_ 366 ADC_Obj08LeftAngle 1;
BA_ "GenSigStartValue" SG_ 366 ADC_Obj08LeftAngle 0;
BA_ "GenSigTimeoutValue" SG_ 366 ADC_Obj08LeftAngle 0;
BA_ "Remark" SG_ 366 ADC_Obj08LeftAngle "";
BA_ "EventCommandSignal" SG_ 366 ADC_Obj08RightAngle 0;
BA_ "GatewayedSignals" SG_ 366 ADC_Obj08RightAngle 0;
BA_ "GenSigInactiveValue" SG_ 366 ADC_Obj08RightAngle 0;
BA_ "GenSigInvalidValue" SG_ 366 ADC_Obj08RightAngle 0;
BA_ "GenSigSendType" SG_ 366 ADC_Obj08RightAngle 1;
BA_ "GenSigStartValue" SG_ 366 ADC_Obj08RightAngle 0;
BA_ "GenSigTimeoutValue" SG_ 366 ADC_Obj08RightAngle 0;
BA_ "Remark" SG_ 366 ADC_Obj08RightAngle "";
BA_ "EventCommandSignal" SG_ 366 ADC_Obj08BottomAngle 0;
BA_ "GatewayedSignals" SG_ 366 ADC_Obj08BottomAngle 0;
BA_ "GenSigInactiveValue" SG_ 366 ADC_Obj08BottomAngle 0;
BA_ "GenSigInvalidValue" SG_ 366 ADC_Obj08BottomAngle 0;
BA_ "GenSigSendType" SG_ 366 ADC_Obj08BottomAngle 1;
BA_ "GenSigStartValue" SG_ 366 ADC_Obj08BottomAngle 0;
BA_ "GenSigTimeoutValue" SG_ 366 ADC_Obj08BottomAngle 0;
BA_ "Remark" SG_ 366 ADC_Obj08BottomAngle "";
BA_ "EventCommandSignal" SG_ 366 ADC_Obj08TopAngle 0;
BA_ "GatewayedSignals" SG_ 366 ADC_Obj08TopAngle 0;
BA_ "GenSigInactiveValue" SG_ 366 ADC_Obj08TopAngle 0;
BA_ "GenSigInvalidValue" SG_ 366 ADC_Obj08TopAngle 0;
BA_ "GenSigSendType" SG_ 366 ADC_Obj08TopAngle 1;
BA_ "GenSigStartValue" SG_ 366 ADC_Obj08TopAngle 0;
BA_ "GenSigTimeoutValue" SG_ 366 ADC_Obj08TopAngle 0;
BA_ "Remark" SG_ 366 ADC_Obj08TopAngle "";
BA_ "EventCommandSignal" SG_ 366 ADC_Obj09_ID 0;
BA_ "GatewayedSignals" SG_ 366 ADC_Obj09_ID 0;
BA_ "GenSigInactiveValue" SG_ 366 ADC_Obj09_ID 0;
BA_ "GenSigInvalidValue" SG_ 366 ADC_Obj09_ID 0;
BA_ "GenSigSendType" SG_ 366 ADC_Obj09_ID 1;
BA_ "GenSigStartValue" SG_ 366 ADC_Obj09_ID 0;
BA_ "GenSigTimeoutValue" SG_ 366 ADC_Obj09_ID 0;
BA_ "Remark" SG_ 366 ADC_Obj09_ID "";
BA_ "EventCommandSignal" SG_ 366 ADC_Obj09Typ 0;
BA_ "GatewayedSignals" SG_ 366 ADC_Obj09Typ 0;
BA_ "GenSigInactiveValue" SG_ 366 ADC_Obj09Typ 0;
BA_ "GenSigInvalidValue" SG_ 366 ADC_Obj09Typ 0;
BA_ "GenSigSendType" SG_ 366 ADC_Obj09Typ 1;
BA_ "GenSigStartValue" SG_ 366 ADC_Obj09Typ 0;
BA_ "GenSigTimeoutValue" SG_ 366 ADC_Obj09Typ 0;
BA_ "Remark" SG_ 366 ADC_Obj09Typ "";
BA_ "EventCommandSignal" SG_ 366 ADC_Obj09Dir 0;
BA_ "GatewayedSignals" SG_ 366 ADC_Obj09Dir 0;
BA_ "GenSigInactiveValue" SG_ 366 ADC_Obj09Dir 0;
BA_ "GenSigInvalidValue" SG_ 366 ADC_Obj09Dir 0;
BA_ "GenSigSendType" SG_ 366 ADC_Obj09Dir 1;
BA_ "GenSigStartValue" SG_ 366 ADC_Obj09Dir 0;
BA_ "GenSigTimeoutValue" SG_ 366 ADC_Obj09Dir 0;
BA_ "Remark" SG_ 366 ADC_Obj09Dir "";
BA_ "EventCommandSignal" SG_ 366 ADC_Obj09Dist 0;
BA_ "GatewayedSignals" SG_ 366 ADC_Obj09Dist 0;
BA_ "GenSigInactiveValue" SG_ 366 ADC_Obj09Dist 0;
BA_ "GenSigInvalidValue" SG_ 366 ADC_Obj09Dist 0;
BA_ "GenSigSendType" SG_ 366 ADC_Obj09Dist 1;
BA_ "GenSigStartValue" SG_ 366 ADC_Obj09Dist 0;
BA_ "GenSigTimeoutValue" SG_ 366 ADC_Obj09Dist 0;
BA_ "Remark" SG_ 366 ADC_Obj09Dist "";
BA_ "EventCommandSignal" SG_ 366 ADC_Obj09HoztAngSpd 0;
BA_ "GatewayedSignals" SG_ 366 ADC_Obj09HoztAngSpd 0;
BA_ "GenSigInactiveValue" SG_ 366 ADC_Obj09HoztAngSpd 0;
BA_ "GenSigInvalidValue" SG_ 366 ADC_Obj09HoztAngSpd 0;
BA_ "GenSigSendType" SG_ 366 ADC_Obj09HoztAngSpd 1;
BA_ "GenSigStartValue" SG_ 366 ADC_Obj09HoztAngSpd 0;
BA_ "GenSigTimeoutValue" SG_ 366 ADC_Obj09HoztAngSpd 0;
BA_ "Remark" SG_ 366 ADC_Obj09HoztAngSpd "";
BA_ "EventCommandSignal" SG_ 366 ADC_Obj09LeftAngle 0;
BA_ "GatewayedSignals" SG_ 366 ADC_Obj09LeftAngle 0;
BA_ "GenSigInactiveValue" SG_ 366 ADC_Obj09LeftAngle 0;
BA_ "GenSigInvalidValue" SG_ 366 ADC_Obj09LeftAngle 0;
BA_ "GenSigSendType" SG_ 366 ADC_Obj09LeftAngle 1;
BA_ "GenSigStartValue" SG_ 366 ADC_Obj09LeftAngle 0;
BA_ "GenSigTimeoutValue" SG_ 366 ADC_Obj09LeftAngle 0;
BA_ "Remark" SG_ 366 ADC_Obj09LeftAngle "";
BA_ "EventCommandSignal" SG_ 366 ADC_Obj09RightAngle 0;
BA_ "GatewayedSignals" SG_ 366 ADC_Obj09RightAngle 0;
BA_ "GenSigInactiveValue" SG_ 366 ADC_Obj09RightAngle 0;
BA_ "GenSigInvalidValue" SG_ 366 ADC_Obj09RightAngle 0;
BA_ "GenSigSendType" SG_ 366 ADC_Obj09RightAngle 1;
BA_ "GenSigStartValue" SG_ 366 ADC_Obj09RightAngle 0;
BA_ "GenSigTimeoutValue" SG_ 366 ADC_Obj09RightAngle 0;
BA_ "Remark" SG_ 366 ADC_Obj09RightAngle "";
BA_ "EventCommandSignal" SG_ 366 ADC_Obj09BottomAngle 0;
BA_ "GatewayedSignals" SG_ 366 ADC_Obj09BottomAngle 0;
BA_ "GenSigInactiveValue" SG_ 366 ADC_Obj09BottomAngle 0;
BA_ "GenSigInvalidValue" SG_ 366 ADC_Obj09BottomAngle 0;
BA_ "GenSigSendType" SG_ 366 ADC_Obj09BottomAngle 1;
BA_ "GenSigStartValue" SG_ 366 ADC_Obj09BottomAngle 0;
BA_ "GenSigTimeoutValue" SG_ 366 ADC_Obj09BottomAngle 0;
BA_ "Remark" SG_ 366 ADC_Obj09BottomAngle "";
BA_ "EventCommandSignal" SG_ 366 ADC_Obj09TopAngle 0;
BA_ "GatewayedSignals" SG_ 366 ADC_Obj09TopAngle 0;
BA_ "GenSigInactiveValue" SG_ 366 ADC_Obj09TopAngle 0;
BA_ "GenSigInvalidValue" SG_ 366 ADC_Obj09TopAngle 0;
BA_ "GenSigSendType" SG_ 366 ADC_Obj09TopAngle 1;
BA_ "GenSigStartValue" SG_ 366 ADC_Obj09TopAngle 0;
BA_ "GenSigTimeoutValue" SG_ 366 ADC_Obj09TopAngle 0;
BA_ "Remark" SG_ 366 ADC_Obj09TopAngle "";
BA_ "EventCommandSignal" SG_ 366 ADC_Obj010_ID 0;
BA_ "GatewayedSignals" SG_ 366 ADC_Obj010_ID 0;
BA_ "GenSigInactiveValue" SG_ 366 ADC_Obj010_ID 0;
BA_ "GenSigInvalidValue" SG_ 366 ADC_Obj010_ID 0;
BA_ "GenSigSendType" SG_ 366 ADC_Obj010_ID 1;
BA_ "GenSigStartValue" SG_ 366 ADC_Obj010_ID 0;
BA_ "GenSigTimeoutValue" SG_ 366 ADC_Obj010_ID 0;
BA_ "Remark" SG_ 366 ADC_Obj010_ID "";
BA_ "EventCommandSignal" SG_ 366 ADC_Obj010Typ 0;
BA_ "GatewayedSignals" SG_ 366 ADC_Obj010Typ 0;
BA_ "GenSigInactiveValue" SG_ 366 ADC_Obj010Typ 0;
BA_ "GenSigInvalidValue" SG_ 366 ADC_Obj010Typ 0;
BA_ "GenSigSendType" SG_ 366 ADC_Obj010Typ 1;
BA_ "GenSigStartValue" SG_ 366 ADC_Obj010Typ 0;
BA_ "GenSigTimeoutValue" SG_ 366 ADC_Obj010Typ 0;
BA_ "Remark" SG_ 366 ADC_Obj010Typ "";
BA_ "EventCommandSignal" SG_ 366 ADC_Obj010Dir 0;
BA_ "GatewayedSignals" SG_ 366 ADC_Obj010Dir 0;
BA_ "GenSigInactiveValue" SG_ 366 ADC_Obj010Dir 0;
BA_ "GenSigInvalidValue" SG_ 366 ADC_Obj010Dir 0;
BA_ "GenSigSendType" SG_ 366 ADC_Obj010Dir 1;
BA_ "GenSigStartValue" SG_ 366 ADC_Obj010Dir 0;
BA_ "GenSigTimeoutValue" SG_ 366 ADC_Obj010Dir 0;
BA_ "Remark" SG_ 366 ADC_Obj010Dir "";
BA_ "EventCommandSignal" SG_ 366 ADC_Obj010Dist 0;
BA_ "GatewayedSignals" SG_ 366 ADC_Obj010Dist 0;
BA_ "GenSigInactiveValue" SG_ 366 ADC_Obj010Dist 0;
BA_ "GenSigInvalidValue" SG_ 366 ADC_Obj010Dist 0;
BA_ "GenSigSendType" SG_ 366 ADC_Obj010Dist 1;
BA_ "GenSigStartValue" SG_ 366 ADC_Obj010Dist 0;
BA_ "GenSigTimeoutValue" SG_ 366 ADC_Obj010Dist 0;
BA_ "Remark" SG_ 366 ADC_Obj010Dist "";
BA_ "EventCommandSignal" SG_ 366 ADC_Obj010HoztAngSpd 0;
BA_ "GatewayedSignals" SG_ 366 ADC_Obj010HoztAngSpd 0;
BA_ "GenSigInactiveValue" SG_ 366 ADC_Obj010HoztAngSpd 0;
BA_ "GenSigInvalidValue" SG_ 366 ADC_Obj010HoztAngSpd 0;
BA_ "GenSigSendType" SG_ 366 ADC_Obj010HoztAngSpd 1;
BA_ "GenSigStartValue" SG_ 366 ADC_Obj010HoztAngSpd 0;
BA_ "GenSigTimeoutValue" SG_ 366 ADC_Obj010HoztAngSpd 0;
BA_ "Remark" SG_ 366 ADC_Obj010HoztAngSpd "";
BA_ "EventCommandSignal" SG_ 366 ADC_Obj010LeftAngle 0;
BA_ "GatewayedSignals" SG_ 366 ADC_Obj010LeftAngle 0;
BA_ "GenSigInactiveValue" SG_ 366 ADC_Obj010LeftAngle 0;
BA_ "GenSigInvalidValue" SG_ 366 ADC_Obj010LeftAngle 0;
BA_ "GenSigSendType" SG_ 366 ADC_Obj010LeftAngle 1;
BA_ "GenSigStartValue" SG_ 366 ADC_Obj010LeftAngle 0;
BA_ "GenSigTimeoutValue" SG_ 366 ADC_Obj010LeftAngle 0;
BA_ "Remark" SG_ 366 ADC_Obj010LeftAngle "";
BA_ "EventCommandSignal" SG_ 366 ADC_Obj010RightAngle 0;
BA_ "GatewayedSignals" SG_ 366 ADC_Obj010RightAngle 0;
BA_ "GenSigInactiveValue" SG_ 366 ADC_Obj010RightAngle 0;
BA_ "GenSigInvalidValue" SG_ 366 ADC_Obj010RightAngle 0;
BA_ "GenSigSendType" SG_ 366 ADC_Obj010RightAngle 1;
BA_ "GenSigStartValue" SG_ 366 ADC_Obj010RightAngle 0;
BA_ "GenSigTimeoutValue" SG_ 366 ADC_Obj010RightAngle 0;
BA_ "Remark" SG_ 366 ADC_Obj010RightAngle "";
BA_ "EventCommandSignal" SG_ 366 ADC_Obj010BottomAngle 0;
BA_ "GatewayedSignals" SG_ 366 ADC_Obj010BottomAngle 0;
BA_ "GenSigInactiveValue" SG_ 366 ADC_Obj010BottomAngle 0;
BA_ "GenSigInvalidValue" SG_ 366 ADC_Obj010BottomAngle 0;
BA_ "GenSigSendType" SG_ 366 ADC_Obj010BottomAngle 1;
BA_ "GenSigStartValue" SG_ 366 ADC_Obj010BottomAngle 0;
BA_ "GenSigTimeoutValue" SG_ 366 ADC_Obj010BottomAngle 0;
BA_ "Remark" SG_ 366 ADC_Obj010BottomAngle "";
BA_ "EventCommandSignal" SG_ 366 ADC_Obj010TopAngle 0;
BA_ "GatewayedSignals" SG_ 366 ADC_Obj010TopAngle 0;
BA_ "GenSigInactiveValue" SG_ 366 ADC_Obj010TopAngle 0;
BA_ "GenSigInvalidValue" SG_ 366 ADC_Obj010TopAngle 0;
BA_ "GenSigSendType" SG_ 366 ADC_Obj010TopAngle 1;
BA_ "GenSigStartValue" SG_ 366 ADC_Obj010TopAngle 0;
BA_ "GenSigTimeoutValue" SG_ 366 ADC_Obj010TopAngle 0;
BA_ "Remark" SG_ 366 ADC_Obj010TopAngle "";
VAL_ 971 ADC_MnvrOrintChng6 0 "None" 1 "Parallel" 2 "Cross" 3 "Oblique"  ;
VAL_ 971 ADC_TarParkSt_Posn6 0 "None" 1 "Invalid" 2 "Valid" 3 "Selectable" 4 "Selected" 5 "Reserved" 6 "Reserved" 7 "Reserved"  ;
VAL_ 971 ADC_ParkChkSrc_Posn6 0 "None" 1 "camera" 2 "lidar" 3 "mixed" 4 "Reserved" 5 "Reserved" 6 "Reserved" 7 "Reserved"  ;
VAL_ 971 ADC_MnvrOrintChng7 0 "None" 1 "Parallel" 2 "Cross" 3 "Oblique"  ;
VAL_ 971 ADC_TarParkSt_Posn7 0 "None" 1 "Invalid" 2 "Valid" 3 "Selectable" 4 "Selected" 5 "Reserved" 6 "Reserved" 7 "Reserved"  ;
VAL_ 971 ADC_ParkChkSrc_Posn7 0 "None" 1 "camera" 2 "lidar" 3 "mixed" 4 "Reserved" 5 "Reserved" 6 "Reserved" 7 "Reserved"  ;
VAL_ 971 ADC_MnvrOrintChng8 0 "None" 1 "Parallel" 2 "Cross" 3 "Oblique"  ;
VAL_ 971 ADC_TarParkSt_Posn8 0 "None" 1 "Invalid" 2 "Valid" 3 "Selectable" 4 "Selected" 5 "Reserved" 6 "Reserved" 7 "Reserved"  ;
VAL_ 971 ADC_ParkChkSrc_Posn8 0 "None" 1 "camera" 2 "lidar" 3 "mixed" 4 "Reserved" 5 "Reserved" 6 "Reserved" 7 "Reserved"  ;
VAL_ 971 ADC_MnvrOrintChng5 0 "None" 1 "Parallel" 2 "Cross" 3 "Oblique"  ;
VAL_ 971 ADC_TarParkSt_Posn5 0 "None" 1 "Invalid" 2 "Valid" 3 "Selectable" 4 "Selected" 5 "Reserved" 6 "Reserved" 7 "Reserved"  ;
VAL_ 971 ADC_ParkChkSrc_Posn5 0 "None" 1 "camera" 2 "lidar" 3 "mixed" 4 "Reserved" 5 "Reserved" 6 "Reserved" 7 "Reserved"  ;
VAL_ 1111 ADC_AlarmPktType 128 "AlarmType" 255 "Invalid"  ;
VAL_ 1111 ADC_AlarmTotal 255 "Invalid"  ;
VAL_ 1111 ADC_AlarmNum 255 "Invalid"  ;
VAL_ 1111 ADC_AlarmFaultId0 65535 "Invalid"  ;
VAL_ 1111 ADC_AlarmKeyPara0 65535 "Invalid"  ;
VAL_ 1111 ADC_AlarmFaultId1 65535 "Invalid"  ;
VAL_ 1111 ADC_AlarmKeyPara1 65535 "Invalid"  ;
VAL_ 1111 ADC_AlarmFaultId2 65535 "Invalid"  ;
VAL_ 1111 ADC_AlarmKeyPara2 65535 "Invalid"  ;
VAL_ 1111 ADC_AlarmFaultId3 65535 "Invalid"  ;
VAL_ 1111 ADC_AlarmKeyPara3 65535 "Invalid"  ;
VAL_ 1111 ADC_AlarmFaultId4 65535 "Invalid"  ;
VAL_ 1111 ADC_AlarmKeyPara4 65535 "Invalid"  ;
VAL_ 1111 ADC_AlarmFaultId5 65535 "Invalid"  ;
VAL_ 1111 ADC_AlarmKeyPara5 65535 "Invalid"  ;
VAL_ 1111 ADC_AlarmFaultId6 65535 "Invalid"  ;
VAL_ 1111 ADC_AlarmKeyPara6 65535 "Invalid"  ;
VAL_ 1111 ADC_AlarmFaultId7 65535 "Invalid"  ;
VAL_ 1111 ADC_AlarmKeyPara7 65535 "Invalid"  ;
VAL_ 1111 ADC_AlarmFaultId8 65535 "Invalid"  ;
VAL_ 1111 ADC_AlarmKeyPara8 65535 "Invalid"  ;
VAL_ 1111 ADC_AlarmFaultId9 65535 "Invalid"  ;
VAL_ 1111 ADC_AlarmKeyPara9 65535 "Invalid"  ;
VAL_ 1111 ADC_AlarmFaultId10 65535 "Invalid"  ;
VAL_ 1111 ADC_AlarmKeyPara10 65535 "Invalid"  ;
VAL_ 1111 ADC_AlarmFaultId11 65535 "Invalid"  ;
VAL_ 1111 ADC_AlarmKeyPara11 65535 "Invalid"  ;
VAL_ 1111 ADC_AlarmFaultId12 65535 "Invalid"  ;
VAL_ 1111 ADC_AlarmKeyPara12 65535 "Invalid"  ;
VAL_ 1111 ADC_AlarmFaultId13 65535 "Invalid"  ;
VAL_ 1111 ADC_AlarmKeyPara13 65535 "Invalid"  ;
VAL_ 1111 ADC_AlarmFaultId14 65535 "Invalid"  ;
VAL_ 1111 ADC_AlarmKeyPara14 65535 "Invalid"  ;
VAL_ 1111 ADC_AlarmCheckSum 255 "Invalid"  ;
VAL_ 365 ADC_Obj02_ID 0 "No Object" 62 "Initating" 63 "Not Available"  ;
VAL_ 365 ADC_Obj04_ID 0 "No Object" 62 "Initating" 63 "Not Available"  ;
VAL_ 365 ADC_Obj01_ID 0 "No Object" 62 "Initating" 63 "Not Available"  ;
VAL_ 365 ADC_Obj03_ID 0 "No Object" 62 "Initating" 63 "Not Available"  ;
VAL_ 365 ADC_Obj06_ID 0 "No Object" 62 "Initating" 63 "Not Available"  ;
VAL_ 365 ADC_Obj05_ID 0 "No Object" 62 "Initating" 63 "Not Available"  ;
VAL_ 365 ADC_Obj04Typ 0 "NoVehicle" 1 "Car" 2 "Truck" 3 "Bus" 4 "Bike" 5 "Pedestrain" 6 "Mixed" 7 "Billboard" 8 "Unknown" 9 "Front single lamp" 10 "Front double lamp" 11 "Tail single lamp" 12 "Tail double lamp"  ;
VAL_ 365 ADC_Obj04Dir 0 "Idle" 1 "Oncoming" 2 "Preceding" 3 "Others"  ;
VAL_ 365 ADC_ADBCamSt 0 "On Passive" 1 "On Active" 2 "On Reduced Sight" 3 "On Faliure" 4 "Off" 5 "Reserved" 6 "Reserved" 7 "Reserved" 8 "Reserved" 9 "Reserved" 10 "Reserved" 11 "Reserved" 12 "Reserved" 13 "Reserved" 14 "Initating" 15 "Not Available"  ;
VAL_ 365 ADC_Obj03Dir 0 "Idle" 1 "Oncoming" 2 "Preceding" 3 "Others"  ;
VAL_ 365 ADC_Obj02Dir 0 "Idle" 1 "Oncoming" 2 "Preceding" 3 "Others"  ;
VAL_ 365 ADC_Obj02Typ 0 "NoVehicle" 1 "Car" 2 "Truck" 3 "Bus" 4 "Bike" 5 "Pedestrain" 6 "Mixed" 7 "Billboard" 8 "Unknown" 9 "Front single lamp" 10 "Front double lamp" 11 "Tail single lamp" 12 "Tail double lamp"  ;
VAL_ 365 ADC_Obj03Typ 0 "NoVehicle" 1 "Car" 2 "Truck" 3 "Bus" 4 "Bike" 5 "Pedestrain" 6 "Mixed" 7 "Billboard" 8 "Unknown" 9 "Front single lamp" 10 "Front double lamp" 11 "Tail single lamp" 12 "Tail double lamp"  ;
VAL_ 365 ADC_Obj01Typ 0 "NoVehicle" 1 "Car" 2 "Truck" 3 "Bus" 4 "Bike" 5 "Pedestrain" 6 "Mixed" 7 "Billboard" 8 "Unknown" 9 "Front single lamp" 10 "Front double lamp" 11 "Tail single lamp" 12 "Tail double lamp"  ;
VAL_ 365 ADC_Obj01Dir 0 "Idle" 1 "Oncoming" 2 "Preceding" 3 "Others"  ;
VAL_ 365 ADC_ObjNum 0 "No Object Detected" 1 "1 Object Detected" 2 "2 Object Detected" 3 "3 Object Detected" 4 "4 Object Detected" 5 "5 Object Detected" 6 "6 Object Detected" 7 "7 Object Detected" 8 "8 Object Detected" 9 "9 Object Detected" 10 "10 Object Detected" 11 ">10 Object Detected" 12 "Reserved" 13 "Reserved" 14 "Initating" 15 "Not Available"  ;
VAL_ 365 ADC_AmbLightCondition 0 "No Object Detected" 1 "Day" 2 "Night with Road Lamp" 3 "Night without Road Lamp" 4 "Reserved" 5 "Reserved" 6 "Reserved" 7 "Reserved" 8 "Reserved" 9 "Reserved" 10 "Reserved" 11 "Reserved" 12 "Reserved" 13 "Reserved" 14 "Initating" 15 "Not Available"  ;
VAL_ 365 ADC_TrafficStyle 0 "Unknow" 1 "Right Hand Traffic" 2 "Left Hand Traffic" 3 "Reserved" 4 "Reserved" 5 "Reserved" 6 "Reserved" 7 "Reserved" 8 "Reserved" 9 "Reserved" 10 "Reserved" 11 "Reserved" 12 "Reserved" 13 "Reserved" 14 "Initating" 15 "Not Available"  ;
VAL_ 365 ADC_Obj05Typ 0 "NoVehicle" 1 "Car" 2 "Truck" 3 "Bus" 4 "Bike" 5 "Pedestrain" 6 "Mixed" 7 "Billboard" 8 "Unknown" 9 "Front single lamp" 10 "Front double lamp" 11 "Tail single lamp" 12 "Tail double lamp"  ;
VAL_ 365 ADC_Obj05Dir 0 "Idle" 1 "Oncoming" 2 "Preceding" 3 "Others"  ;
VAL_ 365 ADC_Obj06Typ 0 "NoVehicle" 1 "Car" 2 "Truck" 3 "Bus" 4 "Bike" 5 "Pedestrain" 6 "Mixed" 7 "Billboard" 8 "Unknown" 9 "Front single lamp" 10 "Front double lamp" 11 "Tail single lamp" 12 "Tail double lamp"  ;
VAL_ 365 ADC_Obj06Dir 0 "Idle" 1 "Oncoming" 2 "Preceding" 3 "Others"  ;
VAL_ 365 ADC_Obj07_ID 0 "No Object" 62 "Initating" 63 "Not Available"  ;
VAL_ 365 ADC_Obj07Typ 0 "NoVehicle" 1 "Car" 2 "Truck" 3 "Bus" 4 "Bike" 5 "Pedestrain" 6 "Mixed" 7 "Billboard" 8 "Unknown" 9 "Front single lamp" 10 "Front double lamp" 11 "Tail single lamp" 12 "Tail double lamp"  ;
VAL_ 365 ADC_Obj07Dir 0 "Idle" 1 "Oncoming" 2 "Preceding" 3 "Others"  ;
VAL_ 366 ADC_Obj08_ID 0 "No Object" 62 "Initating" 63 "Not Available"  ;
VAL_ 366 ADC_Obj08Typ 0 "NoVehicle" 1 "Car" 2 "Truck" 3 "Bus" 4 "Bike" 5 "Pedestrain" 6 "Mixed" 7 "Billboard" 8 "Unknown" 9 "Front single lamp" 10 "Front double lamp" 11 "Tail single lamp" 12 "Tail double lamp"  ;
VAL_ 366 ADC_Obj08Dir 0 "Idle" 1 "Oncoming" 2 "Preceding" 3 "Others"  ;
VAL_ 366 ADC_Obj09_ID 0 "No Object" 62 "Initating" 63 "Not Available"  ;
VAL_ 366 ADC_Obj09Typ 0 "NoVehicle" 1 "Car" 2 "Truck" 3 "Bus" 4 "Bike" 5 "Pedestrain" 6 "Mixed" 7 "Billboard" 8 "Unknown" 9 "Front single lamp" 10 "Front double lamp" 11 "Tail single lamp" 12 "Tail double lamp"  ;
VAL_ 366 ADC_Obj09Dir 0 "Idle" 1 "Oncoming" 2 "Preceding" 3 "Others"  ;
VAL_ 366 ADC_Obj010_ID 0 "No Object" 62 "Initating" 63 "Not Available"  ;
VAL_ 366 ADC_Obj010Typ 0 "NoVehicle" 1 "Car" 2 "Truck" 3 "Bus" 4 "Bike" 5 "Pedestrain" 6 "Mixed" 7 "Billboard" 8 "Unknown" 9 "Front single lamp" 10 "Front double lamp" 11 "Tail single lamp" 12 "Tail double lamp"  ;
VAL_ 366 ADC_Obj010Dir 0 "Idle" 1 "Oncoming" 2 "Preceding" 3 "Others"  ;
