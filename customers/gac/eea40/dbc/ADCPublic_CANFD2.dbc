VERSION "Version"

NS_ :

BS_:

BU_: Tester IBCS EPS ADC CCU CCU_CCURT1 CCU_CCURT2 EPB_IBCS EBB ZCUF ZCUL ZCUR ZCUT EMS IDM DCDC IPS NIDU NIDUF DCUR OBC OPC LPC CPC EMCM GCU DCUF IPU BMS EOPF EOPR EVCC DCDC2 EDL SRS ECS EPB RBM ICM IID IDC PHUDD AMP WHUD IMR INU IFC FAPA RRR RLR PAS PCS SCMR SCMRL SCMRR HVSMR SCMRM MFS WSM DRM IDU FCP LBMSAD AVAS ATSS DLPFL FBLCM FLISD FLLCM FRLCM RLLCMA RLLCMB RRLCMA RRLCMB RLISD DLPML DLPMR TRM PSDL PSDR HVSPRL HVSPRR RFR SBM WCM ETC TBOX2 TBOX CCURT1 CCURT2 RT1_C0 RT1_C1 RT2_C3 CBM RAS TMC SCMT PLGM LBMS RLBMS IDUR OTAWL RCICP WCMFR WCMRL LPC2 SAS CD RCP RRISD

BO_ 618 CCU_EPB_1: 32 CCU
 SG_ EPB_1_CRC : 7|16@0+ (1,0) [0|65535] ""  ZCUF,ZCUL,ZCUR,IBCS,ICM,IDC,ADC,IFC,FAPA,RRR,RLR,PAS
 SG_ EPB_1_Counter : 23|8@0+ (1,0) [0|255] ""  ZCUF,ZCUL,ZCUR,IBCS,ICM,IDC,ADC,IFC,FAPA,RRR,RLR,PAS
 SG_ EPB_SwitchSt : 31|2@0+ (1,0) [0|3] ""  ZCUF,ZCUL,ZCUR,SRS,IBCS,IDC,ADC,IFC,FAPA,RRR,RLR,PAS
 SG_ EPB_SwitchStVD : 29|1@0+ (1,0) [0|1] ""  ZCUF,ZCUL,ZCUR,SRS,IBCS,ADC,IFC,FAPA,RRR,RLR,PAS
 SG_ EPB_SysSt : 28|3@0+ (1,0) [0|7] ""  ZCUF,ZCUL,ZCUR,SRS,IBCS,ICM,IDC,ADC,IFC,FAPA,RRR,RLR,PAS
 SG_ EPB_FailSt : 39|1@0+ (1,0) [0|1] ""  ZCUF,ZCUL,SRS,IBCS,ICM,IID,IDC,PHUDD,ADC,IFC,FAPA,RRR,RLR,PAS
 SG_ EPB_ExtAvailable : 47|2@0+ (1,0) [0|3] ""  ZCUF,ZCUL,IBCS,ADC,IFC,FAPA,RRR,RLR
 SG_ EPB_DynamicApplySt : 82|3@0+ (1,0) [0|7] ""  ZCUF,ZCUL,IBCS,ADC,IFC,FAPA
 SG_ EPB_ActuatorSt_R : 107|4@0+ (1,0) [0|15] ""  ZCUF,ZCUL,IBCS,ADC,IFC,FAPA,RRR,RLR
 SG_ EPB_RWUActvSts : 109|2@0+ (1,0) [0|3] ""  ADC,FAPA
 SG_ EPB_RWUAvl : 111|2@0+ (1,0) [0|3] ""  ADC,IFC,FAPA
 SG_ EPB_RPAAVPAvailability : 129|2@0+ (1,0) [0|3] ""  ADC,FAPA
 SG_ EPB_APAAvailability : 143|1@0+ (1,0) [0|1] ""  ADC,FAPA

BO_ 904 CCU_GwMsg_4: 64 CCU_CCURT2
 SG_ ACU_PCS_SVM_MODCmd : 96|1@0+ (1,0) [0|1] ""  ADC,IFC,FAPA
 SG_ ACU_HeadLightVirtualSwSt : 99|3@0+ (1,0) [0|7] ""  ADC,IFC,FAPA
 SG_ ACU_FrontFogLightVirtualSwSt : 144|1@0+ (1,0) [0|1] ""  ADC,IFC,FAPA
 SG_ ACU_RearFogLightVirtualSwSt : 145|1@0+ (1,0) [0|1] ""  ADC,IFC,FAPA
 SG_ ACU_Account_Uid : 151|4@0+ (1,0) [0|15] ""  ADC,IFC,FAPA
 SG_ ACU_IHBC_SwitchReq : 147|2@0+ (1,0) [0|3] ""  ADC,IFC,FAPA
 SG_ ACU_NDASwitchReq : 153|2@0+ (1,0) [0|3] ""  ADC,IFC,FAPA
 SG_ ACU_NDALCConSwitchReq : 155|2@0+ (1,0) [0|3] ""  ADC,IFC,FAPA
 SG_ ACU_NDALCStySwitchReq : 157|2@0+ (1,0) [0|3] ""  ADC,IFC,FAPA
 SG_ ACU_ADASWarnTypeSwitch : 159|2@0+ (1,0) [0|3] ""  ADC,IFC,FAPA
 SG_ ACU_iACC_StyleConfirmSwitchReq : 177|2@0+ (1,0) [0|3] ""  ADC,IFC,FAPA
 SG_ ACU_IFC_SpeedLimit : 167|8@0+ (1,0) [0|255] "km/h"  ADC,IFC,FAPA
 SG_ ACU_IFC_ISDRestOfdis : 175|8@0+ (0.1,0) [0|70] "km"  ADC,IFC,FAPA
 SG_ ACU_IFC_SpeedLimitUnit : 183|2@0+ (1,0) [0|3] ""  ADC,IFC,FAPA
 SG_ ACU_ThemeType : 196|1@0+ (1,0) [0|1] ""  ADC,IFC,FAPA
 SG_ ACU_IFC_SpeedLimtType : 187|4@0+ (1,0) [0|15] ""  ADC,IFC,FAPA
 SG_ ACU_IFC_RoadType : 191|4@0+ (1,0) [0|15] ""  ADC,IFC,FAPA
 SG_ ACU_IFC_ZoneCode : 199|3@0+ (1,0) [0|7] ""  ADC,IFC,FAPA
 SG_ ACU_IFC_NaviSt : 195|2@0+ (1,0) [0|3] ""  ADC,IFC,FAPA
 SG_ ACU_IFC_NaviCorp : 207|3@0+ (1,0) [0|7] ""  ADC,IFC,FAPA
 SG_ ACU_IFC_NaviNewIconDis : 204|5@0+ (0.1,0) [0|2] "km"  ADC,IFC,FAPA
 SG_ ACU_IFC_OfframpSt : 192|1@0+ (1,0) [0|1] ""  ADC,IFC,FAPA
 SG_ ACU_IFC_NaviNewIcon : 211|4@0+ (1,0) [0|15] ""  ADC,IFC,FAPA
 SG_ ACU_IFC_SLCAheadDis : 223|8@0+ (5,0) [0|1250] "m"  ADC,IFC,FAPA
 SG_ ACU_DVR_Switch : 193|1@0+ (1,0) [0|1] ""  ADC,IFC,FAPA
 SG_ ACU_IFC_OfframpDis : 231|8@0+ (10,0) [0|2000] "m"  ADC,IFC,FAPA
 SG_ SSW_DRSeatSlideCurrentPst : 239|8@0+ (0.5,0) [0|100] "%"  ADC,FAPA
 SG_ SSW_DRSeatHeightCurrentPst : 247|8@0+ (0.5,0) [0|100] "%"  ADC,FAPA
 SG_ SSW_DRSeatBackrestCurrentPst : 255|8@0+ (0.5,0) [0|100] "%"  ADC,FAPA
 SG_ DrvrSideMotResp : 263|4@0+ (1,0) [0|15] ""  ADC,IFC,FAPA
 SG_ IPDS_BAT1PowerSt : 280|1@0+ (1,0) [0|1] ""  ADC,FAPA
 SG_ IPDS_BAT2PowerSt : 299|1@0+ (1,0) [0|1] ""  ADC,FAPA
 SG_ IPDS_DCDC2PowerSt : 311|1@0+ (1,0) [0|1] ""  ADC,FAPA
 SG_ IPDS_GridIsoPowerSt : 310|1@0+ (1,0) [0|1] ""  ADC,FAPA

BO_ 391 CCU_DCUR_1: 64 CCU
 SG_ DCUR_1_CRC : 7|16@0+ (1,0) [0|65535] ""  ADC
 SG_ DCUR_1_Counter : 23|8@0+ (1,0) [0|255] ""  ADC
 SG_ DCUR_RotSpdAct : 31|16@0+ (1,-32767) [-32767|32766] "rpm"  ADC
 SG_ DCUR_DiagErrCode : 125|6@0+ (1,0) [0|63] ""  ADC
 SG_ DCUR_ModeSt : 135|5@0+ (1,0) [0|31] ""  ADC
 SG_ DCUR_ADC_MCUBlkst : 268|3@0+ (1,0) [0|7] ""  ADC
 SG_ DCUR_ADC_SpdSvModAvl : 256|1@0+ (1,0) [0|1] ""  ADC
 SG_ DCUR_ADC_MCUStandstill : 257|1@0+ (1,0) [0|1] ""  ADC
 SG_ DCUR_ADC_MCUSpdSVModFlt : 271|3@0+ (1,0) [0|7] ""  ADC
 SG_ DCUR_ADC_MCUVehSldSt : 258|1@0+ (1,0) [0|1] ""  ADC
 SG_ DCUR_ADC_MCUReqTq : 253|11@0+ (1,-1023) [-1023|1023] "Nm"  ADC

BO_ 728 CCU_ECS_1: 64 CCU
 SG_ ECS_1_CRC : 7|16@0+ (1,0) [0|65535] ""  ADC
 SG_ ECS_1_Counter : 23|8@0+ (1,0) [0|255] ""  ADC
 SG_ CDC_ADCCtrlAvl : 38|1@0+ (1,0) [0|1] ""  ADC
 SG_ CDC_ADCCtrlRespSts : 39|1@0+ (1,0) [0|1] ""  ADC
 SG_ CDC_ADCModState : 287|3@0+ (1,0) [0|7] ""  ADC

BO_ 459 CCU_ECS_2: 48 CCU
 SG_ ECS_2_CRC : 7|16@0+ (1,0) [0|65535] ""  ADC
 SG_ ECS_2_Counter : 23|8@0+ (1,0) [0|255] ""  ADC
 SG_ AS_SuspHeightFL : 31|12@0+ (0.1,-150) [-150|150] "mm"  ADC
 SG_ AS_SuspHeightFR : 35|12@0+ (0.1,-150) [-150|150] "mm"  ADC
 SG_ AS_SuspHeightRL : 55|12@0+ (0.1,-150) [-150|150] "mm"  ADC
 SG_ AS_SuspHeightRR : 59|12@0+ (0.1,-150) [-150|150] "mm"  ADC
 SG_ AS_SuspHeightFLVD : 72|1@0+ (1,0) [0|1] ""  ADC
 SG_ AS_SuspHeightFRVD : 73|1@0+ (1,0) [0|1] ""  ADC
 SG_ AS_SuspHeightRLVD : 74|1@0+ (1,0) [0|1] ""  ADC
 SG_ AS_SuspHeightRRVD : 75|1@0+ (1,0) [0|1] ""  ADC
 SG_ AS_SuspHeightSensorFLSt : 76|1@0+ (1,0) [0|1] ""  ADC
 SG_ AS_SuspHeightSensorFRSt : 77|1@0+ (1,0) [0|1] ""  ADC
 SG_ AS_SuspHeightSensorRLSt : 78|1@0+ (1,0) [0|1] ""  ADC
 SG_ AS_SuspHeightSensoRRSt : 79|1@0+ (1,0) [0|1] ""  ADC
 SG_ AS_MaintanceModeSt : 97|2@0+ (1,0) [0|3] ""  ADC
 SG_ ECS_AVDCReqModeAvailable : 113|1@0+ (1,0) [0|1] ""  ADC
 SG_ ECS_AVDCReqMode : 116|3@0+ (1,0) [0|7] ""  ADC
 SG_ AS_FrontAxleSuspSt : 112|2@0+ (1,0) [0|3] ""  ADC
 SG_ AS_RearAxleSuspSt : 126|2@0+ (1,0) [0|3] ""  ADC
 SG_ AS_HeightWarningSt : 124|3@0+ (1,0) [0|7] ""  ADC
 SG_ AS_CurrentLevel : 131|4@0+ (1,0) [0|15] ""  ADC
 SG_ AS_ASMode : 138|3@0+ (1,0) [0|7] ""  ADC
 SG_ AS_SysFaultSt : 141|3@0+ (1,0) [0|7] ""  ADC
 SG_ AS_ADCLevelingState : 152|1@0+ (1,0) [0|1] ""  ADC
 SG_ AS_SysOperationSt : 159|4@0+ (1,0) [0|15] ""  ADC
 SG_ AS_ADCStfnCtrlAvl : 151|1@0+ (1,0) [0|1] ""  ADC
 SG_ AS_ADCStfnState : 146|3@0+ (1,0) [0|7] ""  ADC

BO_ 935 CCU_SRM_1: 8 CCU_CCURT1
 SG_ SR_SunroofCurrentPst : 7|8@0+ (0.5,0) [0|255] "%"  ZCUR,IDC,IMR,ADC,SBM

BO_ 776 CCU_ZCUL_3: 64 CCU
 SG_ ZCUL_3_CRC : 7|16@0+ (1,0) [0|65535] ""  ADC,IFC
 SG_ ZCUL_3_Counter : 23|8@0+ (1,0) [0|255] ""  ADC,IFC
 SG_ EL_LeftBSDIndicatorSt : 26|1@0+ (1,0) [0|1] ""  ADC,IFC
 SG_ UINM_HazardLightSwSt : 39|1@0+ (1,0) [0|1] ""  ICM,IDC,ADC,IFC
 SG_ EL_MLTurnLightSt : 35|2@0+ (1,0) [0|3] ""  ICM,IDC,ADC,IFC
 SG_ EL_MLTurnLightFaultSt : 33|1@0+ (1,0) [0|1] ""  ICM,IDC,ADC,IFC
 SG_ EL_LeftBSDIndicatorFaultSt : 48|1@0+ (1,0) [0|1] ""  ADC,IFC
 SG_ EL_MLADASLightSt : 211|2@0+ (1,0) [0|3] ""  ADC,IFC
 SG_ ZCUL_FrtWindshildHeatSt : 249|2@0+ (1,0) [0|3] ""  ADC,IFC

BO_ 793 CCU_LBMS_1: 64 CCU
 SG_ LBMS_1_CRC : 7|16@0+ (1,0) [0|65535] ""  ADC
 SG_ LBMS_1_Counter : 23|8@0+ (1,0) [0|255] ""  ADC
 SG_ LBMS_SOFVD : 28|1@0+ (1,0) [0|1] ""  ADC
 SG_ LBMS_SOFEN : 30|2@0+ (1,0) [0|3] ""  ADC

BO_ 620 CCU_PADS_2: 32 CCU_CCURT1
 SG_ CCU_PADS_2_CRC : 7|16@0+ (1,0) [0|65535] ""  ADC,IFC,FAPA
 SG_ CCU_PADS_2_Counter : 23|8@0+ (1,0) [0|255] ""  ADC,IFC,FAPA
 SG_ UINM_PADS_ResponseErr : 28|1@0+ (1,0) [0|1] ""  ADC,IFC,FAPA
 SG_ UINM_PADS_CustomSWSt : 41|1@0+ (1,0) [0|1] ""  ICM,IDC,ADC,IFC,FAPA
 SG_ UINM_PADS_CustomSWStVD : 42|1@0+ (1,0) [0|1] ""  ICM,IDC,ADC,IFC,FAPA
 SG_ UINM_PADS_CustomSWstuck : 43|1@0+ (1,0) [0|1] ""  ICM,IDC,ADC,IFC,FAPA
 SG_ UINM_PADS_IDC_PlaySWSt : 58|1@0+ (1,0) [0|1] ""  ICM,IDC,ADC,IFC,FAPA
 SG_ UINM_PADS_IDC_PlaySWStVD : 59|1@0+ (1,0) [0|1] ""  ICM,IDC,ADC,IFC,FAPA
 SG_ UINM_PADS_CruSetSpeedRollerRotatedDir : 62|2@0+ (1,0) [0|3] ""  ICM,IDC,ADC,IFC,FAPA
 SG_ UINM_PADS_FolDistIncSWSt : 63|1@0+ (1,0) [0|1] ""  ICM,IDC,ADC,IFC,FAPA
 SG_ UINM_PADS_CruSetSpeedRollerSt : 69|6@0+ (1,0) [0|63] ""  ICM,IDC,ADC,IFC,FAPA
 SG_ UINM_PADS_FolDistIncSWStVD : 70|1@0+ (1,0) [0|1] ""  ICM,IDC,ADC,IFC,FAPA
 SG_ UINM_PADS_FolDistIncSWStuckSt : 71|1@0+ (1,0) [0|1] ""  ICM,IDC,ADC,IFC,FAPA
 SG_ UINM_PADS_FolDistDecSWStVD : 73|1@0+ (1,0) [0|1] ""  ICM,IDC,ADC,IFC,FAPA
 SG_ UINM_PADS_FolDistDecSWStuckSt : 74|1@0+ (1,0) [0|1] ""  ICM,IDC,ADC,IFC,FAPA
 SG_ UINM_PADS_OKSWSt : 75|1@0+ (1,0) [0|1] ""  ICM,IDC,ADC,IFC,FAPA
 SG_ UINM_PADS_OKSWStVD : 76|1@0+ (1,0) [0|1] ""  ICM,IDC,ADC,IFC,FAPA
 SG_ UINM_PADS_OKSWStuckSt : 77|1@0+ (1,0) [0|1] ""  ICM,IDC,ADC,IFC,FAPA
 SG_ UINM_PADS_CruSetSpeedRollerVD : 79|1@0+ (1,0) [0|1] ""  IDC,ADC,IFC,FAPA
 SG_ UINM_PADS_FolDistDecSWSt : 72|1@0+ (1,0) [0|1] ""  ICM,IDC,ADC,IFC,FAPA
 SG_ IL_PADS_LightbarErrSt : 140|1@0+ (1,0) [0|1] "/"  ADC,FAPA
 SG_ UINM_PADS_CruSWSt : 107|1@0+ (1,0) [0|1] ""  ADC,IFC,FAPA
 SG_ UINM_PADS_CruSWStVD : 108|1@0+ (1,0) [0|1] ""  ADC,IFC,FAPA
 SG_ UINM_PADS_CruSWStuckSt : 109|1@0+ (1,0) [0|1] ""  ADC,IFC,FAPA
 SG_ UINM_PADS_CruSpeedDecSWSt : 110|1@0+ (1,0) [0|1] ""  ADC,IFC,FAPA
 SG_ UINM_PADS_CruSpeedDecSWStVD : 111|1@0+ (1,0) [0|1] ""  ADC,IFC,FAPA
 SG_ UINM_PADS_CruSpeedDecSWStuckSt : 112|1@0+ (1,0) [0|1] ""  ADC,IFC,FAPA
 SG_ UINM_PADS_CruResumeSpeedIncSWSt : 113|1@0+ (1,0) [0|1] ""  ADC,IFC,FAPA
 SG_ UINM_PADS_CruResumeSpeedIncSWStVD : 114|1@0+ (1,0) [0|1] ""  ADC,IFC,FAPA
 SG_ UINM_PADS_CruResumeSpeedIncSWStuckSt : 115|1@0+ (1,0) [0|1] ""  ADC,IFC,FAPA
 SG_ UINM_PADS_CruTJAICASWSt : 119|1@0+ (1,0) [0|1] ""  ADC,IFC,FAPA
 SG_ UINM_PADS_CruTJAICASWStVD : 120|1@0+ (1,0) [0|1] ""  ADC,IFC,FAPA
 SG_ UINM_PADS_CruTJAICASWStuckSt : 121|1@0+ (1,0) [0|1] ""  ADC,IFC,FAPA
 SG_ UINM_PADS_Custom2SWSt : 125|1@0+ (1,0) [0|1] ""  IDC,ADC,IFC,FAPA
 SG_ UINM_PADS_Custom2SWStVD : 126|1@0+ (1,0) [0|1] ""  IDC,ADC,IFC,FAPA
 SG_ UINM_PADS_Custom2SWStuckSt : 127|1@0+ (1,0) [0|1] ""  IDC,ADC,IFC,FAPA
 SG_ UINM_PADS_ACCSWSt : 129|2@0+ (1,0) [0|3] ""  ADC,IFC,FAPA
 SG_ UINM_PADS_VoltageFaultSt : 131|2@0+ (1,0) [0|3] ""  ADC,IFC,FAPA
 SG_ UINM_PADS_L3SWSt : 133|2@0+ (1,0) [0|3] ""  ADC
 SG_ UINM_PADS_L3SWStVD : 134|1@0+ (1,0) [0|1] ""  ADC
 SG_ UINM_PADS_L3SWStuckSt : 135|1@0+ (1,0) [0|1] ""  ADC
 SG_ IL_PADS_LightbarSt : 139|4@0+ (1,0) [0|15] "/"  ADC,FAPA

BO_ 380 CCU_DCUF_1: 64 CCU
 SG_ DCUF_1_CRC : 7|16@0+ (1,0) [0|65535] ""  ADC
 SG_ DCUF_1_Counter : 23|8@0+ (1,0) [0|255] ""  ADC
 SG_ DCUF_RotSpdAct : 31|16@0+ (1,-32767) [-32767|32766] "rpm"  EMCM,EPB,ADC
 SG_ DCUF_DiagErrCode : 125|6@0+ (1,0) [0|63] ""  ADC
 SG_ DCUF_ModeSt : 135|5@0+ (1,0) [0|31] ""  ADC
 SG_ DCUF_TorqAct : 169|13@0+ (0.2,-819) [-819|819] "Nm"  ADC
 SG_ DCUF_ADC_MCUBlkst : 268|3@0+ (1,0) [0|7] ""  ADC
 SG_ DCUF_ADC_SpdSvModAvl : 256|1@0+ (1,0) [0|1] ""  ADC
 SG_ DCUF_ADC_MCUStandstill : 257|1@0+ (1,0) [0|1] ""  ADC
 SG_ DCUF_ADC_MCUSpdSVModFlt : 271|3@0+ (1,0) [0|7] ""  ADC
 SG_ DCUF_ADC_MCUVehSldSt : 258|1@0+ (1,0) [0|1] ""  ADC
 SG_ DCUF_ADC_MCUReqTq : 253|11@0+ (1,-1023) [-1023|1023] "Nm"  ADC

BO_ 778 CCU_ZCUR_11: 64 CCU
 SG_ ZCUR_11_CRC : 7|16@0+ (1,0) [0|65535] ""  ADC
 SG_ ZCUR_11_Counter : 23|8@0+ (1,0) [0|255] ""  ADC
 SG_ EL_SideBrkLightSt : 44|1@0+ (1,0) [0|1] ""  ADC
 SG_ EL_SideBrkLightFaultSt : 43|1@0+ (1,0) [0|1] ""  ADC
 SG_ EL_CHMSLSt : 42|1@0+ (1,0) [0|1] ""  ADC
 SG_ EL_CHMSLFaultSt : 41|1@0+ (1,0) [0|1] ""  ADC
 SG_ EL_RLTurnLightSt : 63|2@0+ (1,0) [0|3] ""  ADC
 SG_ EL_RLTurnLightFaultSt : 48|1@0+ (1,0) [0|1] ""  ADC
 SG_ EL_RRTurnLightSt : 61|2@0+ (1,0) [0|3] ""  ADC
 SG_ EL_RRTurnLightFaultSt : 59|1@0+ (1,0) [0|1] ""  ADC
 SG_ EL_RADASLightSt : 223|2@0+ (1,0) [0|3] ""  ADC

BO_ 704 CCU_IPS_1: 64 CCU
 SG_ IPS_1_CRC : 7|16@0+ (1,0) [0|65535] ""  BMS,ADC
 SG_ IPS_1_Counter : 23|8@0+ (1,0) [0|255] ""  BMS,ADC
 SG_ IPS_DCDCModeSt : 39|3@0+ (1,0) [0|7] ""  ADC

BO_ 794 CCU_LBMSAD_1: 64 CCU
 SG_ LBMSAD_1_CRC : 7|16@0+ (1,0) [0|65535] ""  ADC,LBMS
 SG_ LBMSAD_1_Counter : 23|8@0+ (1,0) [0|255] ""  ADC,LBMS
 SG_ LBMSAD_SOFVD : 28|1@0+ (1,0) [0|1] ""  ADC,LBMS
 SG_ LBMSAD_SOFEN : 30|2@0+ (1,0) [0|3] ""  ADC,LBMS

BO_ 619 EPB_2: 32 EPB_IBCS
 SG_ EPB_SwitchSt_L : 89|2@0+ (1,0) [0|3] ""  CCU,CCURT1,RT1_C1,ADC
 SG_ EPB_SwitchStVD_L : 90|1@0+ (1,0) [0|1] ""  CCU,CCURT1,RT1_C1,ADC

BO_ 529 EBB_1: 32 EBB
 SG_ EBB_BrkPedalAppliedSt : 39|2@0+ (1,0) [0|3] ""  CCU,EPB,IBCS,ADC
 SG_ EBB_BrkPedalApplied : 24|1@0+ (1,0) [0|1] ""  CCU,EPB,IBCS,ADC
 SG_ EBB_ActOutputRodTravelSt : 65|2@0+ (1,0) [0|3] ""  CCU,CCURT1,RT1_C1,IBCS,ADC
 SG_ EBB_ActOutputRodTravel : 76|12@0+ (0.015625,-5) [-5|47] "mm"  CCU,CCURT1,RT1_C1,IBCS,ADC
 SG_ EBB_PlungerPressure : 103|10@0+ (0.3,-5) [-5.0|301.9] "bar"  CCU,CCURT1,RT1_C1,EPB,IBCS,ADC
 SG_ EBB_PlungerPressureSt : 109|1@0+ (1,0) [0|1] ""  CCU,CCURT1,RT1_C1,EPB,IBCS,ADC
 SG_ EBB_SimulatorPressure : 108|10@0+ (0.3,-5) [-5.0|301.9] "bar"  CCU,IBCS,ADC
 SG_ EBB_SimulatorPressureSt : 114|1@0+ (1,0) [0|1] ""  CCU,IBCS,ADC
 SG_ EBB_DriverRequestTorq : 127|11@0+ (64,-131008) [-131008|0] "Nm"  CCU,IBCS,ADC
 SG_ EBB_DriverRequestTorqVD : 132|2@0+ (1,0) [0|3] "Nm"  CCU,IBCS,ADC
 SG_ EBB_ABAactive_B : 145|1@0+ (1,0) [0|1] ""  CCU,IBCS,ADC
 SG_ EBB_ABAavailable_B : 144|1@0+ (1,0) [0|1] ""  CCU,IBCS,ADC

BO_ 720 EBB_2: 16 EBB
 SG_ EBB_FWAWarning : 26|2@0+ (1,0) [0|2] ""  CCU,IBCS,ADC

BO_ 445 CCU_EMS_2: 48 CCU
 SG_ EMS_TorqControlInhibit : 63|1@0+ (1,0) [0|1] ""  ADC

BO_ 462 CCU_P_1: 32 CCU
 SG_ EMS_stEngTrqLmt : 151|8@0+ (1,0) [0|255] ""  ADC

CM_ SG_ 618 EPB_1_CRC "E2E Profile 5 CRC";
CM_ SG_ 618 EPB_1_Counter "E2E Profile 5 Counter";
CM_ SG_ 618 EPB_SwitchSt "EPB switch status ";
CM_ SG_ 618 EPB_SwitchStVD "EPB switch status validity";
CM_ SG_ 618 EPB_SysSt "EPB system status";
CM_ SG_ 618 EPB_FailSt "EPB fail status,to indicate wether EPB can response to external apply  request or not";
CM_ SG_ 618 EPB_ExtAvailable "EPB  status,to indicate wetherEPB can response to externalapply request or not";
CM_ SG_ 618 EPB_DynamicApplySt "EPB dynamic apply status";
CM_ SG_ 618 EPB_ActuatorSt_R "EPB right  actuator status";
CM_ SG_ 618 EPB_RWUActvSts "It indicates whether the RWU  of the ESP/IPB is active";
CM_ SG_ 618 EPB_RWUAvl "It indicates whether the RWU  of the EPB  is available";
CM_ SG_ 618 EPB_RPAAVPAvailability "Flag indicate  RPA AVP availability for EPB control";
CM_ SG_ 618 EPB_APAAvailability "Flag indicate  APA availability for EPB control";
CM_ SG_ 904 ACU_PCS_SVM_MODCmd "Panorama function setting option MOD function switch";
CM_ SG_ 904 ACU_HeadLightVirtualSwSt "HeadLight virtual switch status";
CM_ SG_ 904 ACU_FrontFogLightVirtualSwSt "Front fog light virtual switch status";
CM_ SG_ 904 ACU_RearFogLightVirtualSwSt "Rear fog light virtual switch status";
CM_ SG_ 904 ACU_Account_Uid "Account_Uid";
CM_ SG_ 904 ACU_IHBC_SwitchReq "IHBC(Intelligent High Beam Control) switch signal";
CM_ SG_ 904 ACU_NDASwitchReq "NDA main switch request";
CM_ SG_ 904 ACU_NDALCConSwitchReq "NDA lane change driver confirm switch request";
CM_ SG_ 904 ACU_NDALCStySwitchReq "NDA lane change style switch request";
CM_ SG_ 904 ACU_ADASWarnTypeSwitch "ADAS warning type switch signal";
CM_ SG_ 904 ACU_iACC_StyleConfirmSwitchReq "iACC Style confirm switch";
CM_ SG_ 904 ACU_IFC_SpeedLimit "Speed limit value from navigation map dataand GPS location.";
CM_ SG_ 904 ACU_IFC_ISDRestOfdis "Interval speed detection rest of distacne.Once navigation jduge vehicle run in aninterval speed detection area of road, thissignal begin to send specific value,otherwise keep sending 0x0.";
CM_ SG_ 904 ACU_IFC_SpeedLimitUnit "Speed limit unit ";
CM_ SG_ 904 ACU_ThemeType "AVNT theme type";
CM_ SG_ 904 ACU_IFC_SpeedLimtType "speed limit type from navigation map dataand GPS location.";
CM_ SG_ 904 ACU_IFC_RoadType "Road type from navigation map data andGPS location.";
CM_ SG_ 904 ACU_IFC_ZoneCode "Zone code ";
CM_ SG_ 904 ACU_IFC_NaviSt "Navigation state ";
CM_ SG_ 904 ACU_IFC_NaviCorp "the working navigation map corporation ";
CM_ SG_ 904 ACU_IFC_NaviNewIconDis "the remain distances of navigation newIcon ";
CM_ SG_ 904 ACU_IFC_OfframpSt "The front is off-ramp or not whennavigation";
CM_ SG_ 904 ACU_IFC_NaviNewIcon "indication the navigation newIcon ";
CM_ SG_ 904 ACU_IFC_SLCAheadDis "speed limit camera ahead distacne. Oncenavigation jduge there is a speed limitcamera ahead that the vehicle will pass by,this signal begin to send specific value,otherwise keep sending 0x0.";
CM_ SG_ 904 ACU_DVR_Switch "DVR Function Switch";
CM_ SG_ 904 ACU_IFC_OfframpDis "The distance to front off-ramp ";
CM_ SG_ 904 SSW_DRSeatSlideCurrentPst "Driver Seat Slide Current  Position Percentage";
CM_ SG_ 904 SSW_DRSeatHeightCurrentPst "Driver Seat Height Current  Position Percentage ";
CM_ SG_ 904 SSW_DRSeatBackrestCurrentPst "Driver Seat Backrest Current  Position Percentage ";
CM_ SG_ 904 DrvrSideMotResp "Driver Side Seat Belt Motor Response";
CM_ SG_ 904 IPDS_BAT1PowerSt "BAT1 power  state";
CM_ SG_ 904 IPDS_BAT2PowerSt "BAT2 power  state";
CM_ SG_ 904 IPDS_DCDC2PowerSt "DCDC2 power  state";
CM_ SG_ 904 IPDS_GridIsoPowerSt "Grid Isolation Power State";
CM_ SG_ 391 DCUR_1_CRC "E2E Profile 5 CRC";
CM_ SG_ 391 DCUR_1_Counter "E2E Profile 5 Counter";
CM_ SG_ 391 DCUR_RotSpdAct "actual rotation speed of drvie motor";
CM_ SG_ 391 DCUR_DiagErrCode "DCU diagnostics error code";
CM_ SG_ 391 DCUR_ModeSt "mode status of drive motor";
CM_ SG_ 391 DCUR_ADC_MCUBlkst "DCU2 block state";
CM_ SG_ 391 DCUR_ADC_SpdSvModAvl "DCU2 speed mode available state";
CM_ SG_ 391 DCUR_ADC_MCUStandstill "DCU2 standstill state";
CM_ SG_ 391 DCUR_ADC_MCUSpdSVModFlt "DCU2 speed mode fault";
CM_ SG_ 391 DCUR_ADC_MCUVehSldSt "DCU2 detect vehicle slide state";
CM_ SG_ 391 DCUR_ADC_MCUReqTq "DCU2 innner request torque";
CM_ SG_ 728 ECS_1_CRC "E2E Profile 5 CRC";
CM_ SG_ 728 ECS_1_Counter "E2E Profile 5 Counter";
CM_ SG_ 728 CDC_ADCCtrlAvl "CDC control available signal";
CM_ SG_ 728 CDC_ADCCtrlRespSts "CDC control response signal";
CM_ SG_ 728 CDC_ADCModState "CDC current damped state feedback";
CM_ SG_ 459 ECS_2_CRC "E2E Profile 5 CRC";
CM_ SG_ 459 ECS_2_Counter "E2E Profile 5 Counter";
CM_ SG_ 459 AS_SuspHeightFL "Height of front left wheel";
CM_ SG_ 459 AS_SuspHeightFR "Height of front right wheel";
CM_ SG_ 459 AS_SuspHeightRL "Height of rear left wheel";
CM_ SG_ 459 AS_SuspHeightRR "Height of rear right wheel";
CM_ SG_ 459 AS_SuspHeightFLVD "Height of front left wheel validity";
CM_ SG_ 459 AS_SuspHeightFRVD "Height of front right wheel validity";
CM_ SG_ 459 AS_SuspHeightRLVD "Height of rear left wheel validity";
CM_ SG_ 459 AS_SuspHeightRRVD "Height of rear right wheel validity";
CM_ SG_ 459 AS_SuspHeightSensorFLSt "Front left suspension height sensor fault status";
CM_ SG_ 459 AS_SuspHeightSensorFRSt "Front right suspension height sensor fault status";
CM_ SG_ 459 AS_SuspHeightSensorRLSt "Rear left suspension height sensor fault status";
CM_ SG_ 459 AS_SuspHeightSensoRRSt "Rear right suspension height sensor fault status";
CM_ SG_ 459 AS_MaintanceModeSt "Air spring maintance mode status";
CM_ SG_ 459 ECS_AVDCReqMode "Electronic control suspension internal mode for AVDC电子控制悬架AVDC执行状态";
CM_ SG_ 459 AS_FrontAxleSuspSt "Height adjustment of the front axle";
CM_ SG_ 459 AS_RearAxleSuspSt "Height adjustment status of rear axle";
CM_ SG_ 459 AS_HeightWarningSt "Vehicle height warning";
CM_ SG_ 459 AS_CurrentLevel "Vehicle current height level";
CM_ SG_ 459 AS_ASMode "Air spring opreation mode";
CM_ SG_ 459 AS_SysFaultSt "Air Spring system fault";
CM_ SG_ 459 AS_ADCLevelingState "Feedback on the activation status of the dynamic leveling strategy requested by the intelligent driving system";
CM_ SG_ 459 AS_SysOperationSt "Air Spring operation status";
CM_ SG_ 459 AS_ADCStfnCtrlAvl "Available signals for suspension stiffness control";
CM_ SG_ 459 AS_ADCStfnState "Suspension stiffness state feedback signal";
CM_ SG_ 935 SR_SunroofCurrentPst "Sunroof current Position";
CM_ SG_ 776 ZCUL_3_CRC "E2E Profile 5 CRC";
CM_ SG_ 776 ZCUL_3_Counter "E2E Profile 5 Counter";
CM_ SG_ 776 EL_LeftBSDIndicatorSt "Left BSD indicator status";
CM_ SG_ 776 UINM_HazardLightSwSt "Hazard light switch status";
CM_ SG_ 776 EL_MLTurnLightSt "Middle left turn light status";
CM_ SG_ 776 EL_MLTurnLightFaultSt "Middle left turn light fault status";
CM_ SG_ 776 EL_LeftBSDIndicatorFaultSt "Left BSD indicator fault status";
CM_ SG_ 776 EL_MLADASLightSt "Middle left ADAS light status";
CM_ SG_ 776 ZCUL_FrtWindshildHeatSt "Front windshield heating status";
CM_ SG_ 793 LBMS_1_CRC "E2E Profile 5 CRC";
CM_ SG_ 793 LBMS_1_Counter "E2E Profile 5 Counter";
CM_ SG_ 793 LBMS_SOFVD "LBMS Validity of SOF";
CM_ SG_ 793 LBMS_SOFEN "LBMS  State of Function Enable";
CM_ SG_ 620 CCU_PADS_2_CRC "E2E Profile 5 CRC";
CM_ SG_ 620 CCU_PADS_2_Counter "E2E Profile 5 Counter";
CM_ SG_ 620 UINM_PADS_ResponseErr "LIN response error";
CM_ SG_ 620 UINM_PADS_CustomSWSt "PADS Custom  swtich state";
CM_ SG_ 620 UINM_PADS_CustomSWStVD "PADS_CustomSWSt validity";
CM_ SG_ 620 UINM_PADS_CustomSWstuck "PADS Custom  swtich stuck state";
CM_ SG_ 620 UINM_PADS_IDC_PlaySWSt "Indicates PADS Play swtich state";
CM_ SG_ 620 UINM_PADS_IDC_PlaySWStVD "Indicates PADS_IDC_PlaySWSt validity";
CM_ SG_ 620 UINM_PADS_CruSetSpeedRollerRotatedDir "indicate PADS curise  roller rotating direction";
CM_ SG_ 620 UINM_PADS_FolDistIncSWSt "PADS Following distance level increase  swtich state";
CM_ SG_ 620 UINM_PADS_CruSetSpeedRollerSt "indicate PADS curise  roller rotating steps";
CM_ SG_ 620 UINM_PADS_FolDistIncSWStVD "Indicates PADS_FolDistIncSWSt validity";
CM_ SG_ 620 UINM_PADS_FolDistIncSWStuckSt "Indicates PADS's   distance level increase swtich stuck state";
CM_ SG_ 620 UINM_PADS_FolDistDecSWStVD "Indicates PADS_FolDistDecSWSt validity";
CM_ SG_ 620 UINM_PADS_FolDistDecSWStuckSt "Indicates PADS's   distance level decrease swtich stuck state";
CM_ SG_ 620 UINM_PADS_OKSWSt "PADS OK swtich state";
CM_ SG_ 620 UINM_PADS_OKSWStVD "Indicates PADS_OKSWSt validity";
CM_ SG_ 620 UINM_PADS_OKSWStuckSt "PADS OK swtich Stuck state";
CM_ SG_ 620 UINM_PADS_CruSetSpeedRollerVD "Indicates PADS's CruSetSpeed singal  validity";
CM_ SG_ 620 UINM_PADS_FolDistDecSWSt "PADS Following distance level decrease  swtich state";
CM_ SG_ 620 IL_PADS_LightbarErrSt "Steering wheel ambient light bar error feedback ";
CM_ SG_ 620 UINM_PADS_CruSWSt "Indicates PADS's Cruise On or Off swtich state";
CM_ SG_ 620 UINM_PADS_CruSWStVD "Indicates PADS_CruSWSt validity";
CM_ SG_ 620 UINM_PADS_CruSWStuckSt "Indicates PADS's Cruise On or Off swtich  stuck state";
CM_ SG_ 620 UINM_PADS_CruSpeedDecSWSt "Indicates PADS's Cruise Speed decrease swtich state";
CM_ SG_ 620 UINM_PADS_CruSpeedDecSWStVD "Indicates PADS_CruSpeedDecSWSt validity";
CM_ SG_ 620 UINM_PADS_CruSpeedDecSWStuckSt "Indicates PADS's Cruise Speed decrease swtich stcuk state";
CM_ SG_ 620 UINM_PADS_CruResumeSpeedIncSWSt "Indicates PADS's Cruise Resume&Speed increase or resume swtich state";
CM_ SG_ 620 UINM_PADS_CruResumeSpeedIncSWStVD "Indicates PADS_CruResumeSpeedIncSWSt validity";
CM_ SG_ 620 UINM_PADS_CruResumeSpeedIncSWStuckSt "Indicates PADS's Cruise Resume&Speed increase or resume swtich state";
CM_ SG_ 620 UINM_PADS_CruTJAICASWSt "Indicates PADS's Trafiic Jam Assist or Integrated Cruise Assit  swtich state";
CM_ SG_ 620 UINM_PADS_CruTJAICASWStVD "Indicates PADS_CruTJAICASWSt validity";
CM_ SG_ 620 UINM_PADS_CruTJAICASWStuckSt "Indicates PADS's Trafiic Jam Assist or Integrated Cruise Assit  swtich Stuck state";
CM_ SG_ 620 UINM_PADS_Custom2SWSt "PADS Custom2  swtich state";
CM_ SG_ 620 UINM_PADS_Custom2SWStVD "PADS_Custom2SWSt validity";
CM_ SG_ 620 UINM_PADS_Custom2SWStuckSt "PADS Custom2  swtich stuck state";
CM_ SG_ 620 UINM_PADS_ACCSWSt "Indicates PADS's ACC swtich state";
CM_ SG_ 620 UINM_PADS_VoltageFaultSt "Indicates PADS's Supply voltage fault state";
CM_ SG_ 620 UINM_PADS_L3SWSt "Indicates PADS's L3 swtich state";
CM_ SG_ 620 UINM_PADS_L3SWStVD "Indicates PADS's L3 swtich state Validity";
CM_ SG_ 620 UINM_PADS_L3SWStuckSt "Indicates PADS's IDC MODE swtich stuck state";
CM_ SG_ 620 IL_PADS_LightbarSt "Steering wheel ambient light bar current status";
CM_ SG_ 380 DCUF_1_CRC "E2E Profile 5 CRC";
CM_ SG_ 380 DCUF_1_Counter "E2E Profile 5 Counter";
CM_ SG_ 380 DCUF_RotSpdAct "actual rotation speed of drvie motor";
CM_ SG_ 380 DCUF_DiagErrCode "DCU diagnostics error code";
CM_ SG_ 380 DCUF_ModeSt "mode status of drive motor";
CM_ SG_ 380 DCUF_TorqAct "actual torque of drive motor";
CM_ SG_ 380 DCUF_ADC_MCUBlkst "DCU block state";
CM_ SG_ 380 DCUF_ADC_SpdSvModAvl "DCU speed mode available state";
CM_ SG_ 380 DCUF_ADC_MCUStandstill "DCU standstill state";
CM_ SG_ 380 DCUF_ADC_MCUSpdSVModFlt "DCU speed mode fault";
CM_ SG_ 380 DCUF_ADC_MCUVehSldSt "DCU detect vehicle slide state";
CM_ SG_ 380 DCUF_ADC_MCUReqTq "DCU innner request torque";
CM_ SG_ 778 ZCUR_11_CRC "E2E Profile 5 CRC";
CM_ SG_ 778 ZCUR_11_Counter "E2E Profile 5 Counter";
CM_ SG_ 778 EL_SideBrkLightSt "Side brake light status";
CM_ SG_ 778 EL_SideBrkLightFaultSt "Side brake light fault status";
CM_ SG_ 778 EL_CHMSLSt "Centre high mounted stop lamp status";
CM_ SG_ 778 EL_CHMSLFaultSt "Centre high mounted stop lamp fault status";
CM_ SG_ 778 EL_RLTurnLightSt "Rear left turn light status";
CM_ SG_ 778 EL_RLTurnLightFaultSt "Rear left turn light fault status";
CM_ SG_ 778 EL_RRTurnLightSt "Rear right turn light status";
CM_ SG_ 778 EL_RRTurnLightFaultSt "Rear right turn light fault status";
CM_ SG_ 778 EL_RADASLightSt "Rear ADAS light status";
CM_ SG_ 704 IPS_1_CRC "E2E Profile 5 CRC";
CM_ SG_ 704 IPS_1_Counter "E2E Profile 5 Counter";
CM_ SG_ 704 IPS_DCDCModeSt "mode status of DCDC";
CM_ SG_ 794 LBMSAD_1_CRC "E2E Profile 5 CRC";
CM_ SG_ 794 LBMSAD_1_Counter "E2E Profile 5 Counter";
CM_ SG_ 794 LBMSAD_SOFVD "LBMSAD Validity of SOF";
CM_ SG_ 794 LBMSAD_SOFEN "LBMSAD  State of Function Enable";
CM_ SG_ 619 EPB_SwitchSt_L "EPB switch status ";
CM_ SG_ 619 EPB_SwitchStVD_L "EPB switch status validity";
CM_ SG_ 529 EBB_BrkPedalAppliedSt "The qualifier of brake pedal applied";
CM_ SG_ 529 EBB_BrkPedalApplied "Brake pedal applied";
CM_ SG_ 529 EBB_ActOutputRodTravelSt "Status of EBB_ActOutputRodTravel";
CM_ SG_ 529 EBB_ActOutputRodTravel "Current value for output rod in EBB indicates the shifted volume in master cylinder. Gives information, if the compensation port is closed. Includes e.g. the pedal force compensation control for Hev.";
CM_ SG_ 529 EBB_PlungerPressure "Indicate plunger pressure 助力电机建立压力";
CM_ SG_ 529 EBB_PlungerPressureSt "Indicate plunger pressure 助力电机建压状态";
CM_ SG_ 529 EBB_SimulatorPressure "Indicate Simulator pressure 模拟器压力";
CM_ SG_ 529 EBB_SimulatorPressureSt "Indicate Simulator pressure 模拟器压力有效性";
CM_ SG_ 529 EBB_DriverRequestTorq "Fx request from driver calculated out of Inputrod and PS_SC  驾驶员目标制动力";
CM_ SG_ 529 EBB_DriverRequestTorqVD "FxTargetDriver Qualifier  驾驶员目标制动力有效位";
CM_ SG_ 529 EBB_ABAactive_B "ABA(Adaptive Brake Assistance) is active";
CM_ SG_ 529 EBB_ABAavailable_B "The ABA(Adaptive Brake Assistance)  function is available";
CM_ SG_ 720 EBB_FWAWarning "Indicate FWA state, dashboard need warn driver";
CM_ SG_ 445 EMS_TorqControlInhibit "Set when a torque request can not be fulfilled. Fail safe operation";
CM_ SG_ 462 EMS_stEngTrqLmt "The state of engine torque limitation";

BA_DEF_ BO_  "GenMsgCycleTime" INT 0 0;
BA_DEF_ BO_  "GenMsgCycleTimeFast" INT 0 0;
BA_DEF_ BO_  "GenMsgSendType" ENUM  "Periodic","Event","IfActive","POE","PA","FixedPeriodic","Event","EnabledPeriodic","NotUsed","NotUsed","EventPeriodic","NotUsed","NotUsed","NoMsgSendType";
BA_DEF_ BO_  "VFrameFormat" ENUM  "StandardCAN","ExtendedCAN","reserved","reserved","reserved","reserved","reserved","reserved","reserved","reserved","reserved","reserved","reserved","reserved","StandardCAN_FD","ExtendedCAN_FD";
BA_DEF_ BO_  "CANFD_BRS" ENUM  "0","1";
BA_DEF_ SG_  "EventCommandSignal" ENUM  "No","Yes";
BA_DEF_ SG_  "GatewayedSignals" ENUM  "No","Yes";
BA_DEF_ SG_  "GenSigInactiveValue" HEX 0 0;
BA_DEF_ SG_  "GenSigInvalidValue" HEX 0 0;
BA_DEF_ SG_  "GenSigSendType" ENUM  "Trigger","Passive","Cyclic","OnWrite","OnWriteWithRepetition","OnChange","OnChangeWithRepetition","IfActive","IfActiveWithRepetition","NoSigSendType";
BA_DEF_ SG_  "GenSigStartValue" HEX 0 0;
BA_DEF_ SG_  "GenSigTimeoutValue" HEX 0 0;
BA_DEF_ SG_  "Remark" STRING ;
BA_ "GenMsgCycleTime" BO_ 618 20;
BA_ "GenMsgCycleTimeFast" BO_ 618 0;
BA_ "GenMsgSendType" BO_ 618 0;
BA_ "VFrameFormat" BO_ 618 14;
BA_ "CANFD_BRS" BO_ 618 1;
BA_ "GenMsgCycleTime" BO_ 618 20;
BA_ "GenMsgCycleTimeFast" BO_ 618 0;
BA_ "GenMsgSendType" BO_ 618 0;
BA_ "VFrameFormat" BO_ 618 14;
BA_ "CANFD_BRS" BO_ 618 1;
BA_ "GenMsgCycleTime" BO_ 618 20;
BA_ "GenMsgCycleTimeFast" BO_ 618 0;
BA_ "GenMsgSendType" BO_ 618 0;
BA_ "VFrameFormat" BO_ 618 14;
BA_ "CANFD_BRS" BO_ 618 1;
BA_ "GenMsgCycleTime" BO_ 618 20;
BA_ "GenMsgCycleTimeFast" BO_ 618 0;
BA_ "GenMsgSendType" BO_ 618 0;
BA_ "VFrameFormat" BO_ 618 14;
BA_ "CANFD_BRS" BO_ 618 1;
BA_ "GenMsgCycleTime" BO_ 618 20;
BA_ "GenMsgCycleTimeFast" BO_ 618 0;
BA_ "GenMsgSendType" BO_ 618 0;
BA_ "VFrameFormat" BO_ 618 14;
BA_ "CANFD_BRS" BO_ 618 1;
BA_ "GenMsgCycleTime" BO_ 618 20;
BA_ "GenMsgCycleTimeFast" BO_ 618 0;
BA_ "GenMsgSendType" BO_ 618 0;
BA_ "VFrameFormat" BO_ 618 14;
BA_ "CANFD_BRS" BO_ 618 1;
BA_ "GenMsgCycleTime" BO_ 618 20;
BA_ "GenMsgCycleTimeFast" BO_ 618 0;
BA_ "GenMsgSendType" BO_ 618 0;
BA_ "VFrameFormat" BO_ 618 14;
BA_ "CANFD_BRS" BO_ 618 1;
BA_ "GenMsgCycleTime" BO_ 618 20;
BA_ "GenMsgCycleTimeFast" BO_ 618 0;
BA_ "GenMsgSendType" BO_ 618 0;
BA_ "VFrameFormat" BO_ 618 14;
BA_ "CANFD_BRS" BO_ 618 1;
BA_ "GenMsgCycleTime" BO_ 618 20;
BA_ "GenMsgCycleTimeFast" BO_ 618 0;
BA_ "GenMsgSendType" BO_ 618 0;
BA_ "VFrameFormat" BO_ 618 14;
BA_ "CANFD_BRS" BO_ 618 1;
BA_ "GenMsgCycleTime" BO_ 618 20;
BA_ "GenMsgCycleTimeFast" BO_ 618 0;
BA_ "GenMsgSendType" BO_ 618 0;
BA_ "VFrameFormat" BO_ 618 14;
BA_ "CANFD_BRS" BO_ 618 1;
BA_ "GenMsgCycleTime" BO_ 618 20;
BA_ "GenMsgCycleTimeFast" BO_ 618 0;
BA_ "GenMsgSendType" BO_ 618 0;
BA_ "VFrameFormat" BO_ 618 14;
BA_ "CANFD_BRS" BO_ 618 1;
BA_ "GenMsgCycleTime" BO_ 618 20;
BA_ "GenMsgCycleTimeFast" BO_ 618 0;
BA_ "GenMsgSendType" BO_ 618 0;
BA_ "VFrameFormat" BO_ 618 14;
BA_ "CANFD_BRS" BO_ 618 1;
BA_ "GenMsgCycleTime" BO_ 618 20;
BA_ "GenMsgCycleTimeFast" BO_ 618 0;
BA_ "GenMsgSendType" BO_ 618 0;
BA_ "VFrameFormat" BO_ 618 14;
BA_ "CANFD_BRS" BO_ 618 1;
BA_ "GenMsgCycleTime" BO_ 904 100;
BA_ "GenMsgCycleTimeFast" BO_ 904 0;
BA_ "GenMsgSendType" BO_ 904 0;
BA_ "VFrameFormat" BO_ 904 14;
BA_ "CANFD_BRS" BO_ 904 1;
BA_ "GenMsgCycleTime" BO_ 904 100;
BA_ "GenMsgCycleTimeFast" BO_ 904 0;
BA_ "GenMsgSendType" BO_ 904 0;
BA_ "VFrameFormat" BO_ 904 14;
BA_ "CANFD_BRS" BO_ 904 1;
BA_ "GenMsgCycleTime" BO_ 904 100;
BA_ "GenMsgCycleTimeFast" BO_ 904 0;
BA_ "GenMsgSendType" BO_ 904 0;
BA_ "VFrameFormat" BO_ 904 14;
BA_ "CANFD_BRS" BO_ 904 1;
BA_ "GenMsgCycleTime" BO_ 904 100;
BA_ "GenMsgCycleTimeFast" BO_ 904 0;
BA_ "GenMsgSendType" BO_ 904 0;
BA_ "VFrameFormat" BO_ 904 14;
BA_ "CANFD_BRS" BO_ 904 1;
BA_ "GenMsgCycleTime" BO_ 904 100;
BA_ "GenMsgCycleTimeFast" BO_ 904 0;
BA_ "GenMsgSendType" BO_ 904 0;
BA_ "VFrameFormat" BO_ 904 14;
BA_ "CANFD_BRS" BO_ 904 1;
BA_ "GenMsgCycleTime" BO_ 904 100;
BA_ "GenMsgCycleTimeFast" BO_ 904 0;
BA_ "GenMsgSendType" BO_ 904 0;
BA_ "VFrameFormat" BO_ 904 14;
BA_ "CANFD_BRS" BO_ 904 1;
BA_ "GenMsgCycleTime" BO_ 904 100;
BA_ "GenMsgCycleTimeFast" BO_ 904 0;
BA_ "GenMsgSendType" BO_ 904 0;
BA_ "VFrameFormat" BO_ 904 14;
BA_ "CANFD_BRS" BO_ 904 1;
BA_ "GenMsgCycleTime" BO_ 904 100;
BA_ "GenMsgCycleTimeFast" BO_ 904 0;
BA_ "GenMsgSendType" BO_ 904 0;
BA_ "VFrameFormat" BO_ 904 14;
BA_ "CANFD_BRS" BO_ 904 1;
BA_ "GenMsgCycleTime" BO_ 904 100;
BA_ "GenMsgCycleTimeFast" BO_ 904 0;
BA_ "GenMsgSendType" BO_ 904 0;
BA_ "VFrameFormat" BO_ 904 14;
BA_ "CANFD_BRS" BO_ 904 1;
BA_ "GenMsgCycleTime" BO_ 904 100;
BA_ "GenMsgCycleTimeFast" BO_ 904 0;
BA_ "GenMsgSendType" BO_ 904 0;
BA_ "VFrameFormat" BO_ 904 14;
BA_ "CANFD_BRS" BO_ 904 1;
BA_ "GenMsgCycleTime" BO_ 904 100;
BA_ "GenMsgCycleTimeFast" BO_ 904 0;
BA_ "GenMsgSendType" BO_ 904 0;
BA_ "VFrameFormat" BO_ 904 14;
BA_ "CANFD_BRS" BO_ 904 1;
BA_ "GenMsgCycleTime" BO_ 904 100;
BA_ "GenMsgCycleTimeFast" BO_ 904 0;
BA_ "GenMsgSendType" BO_ 904 0;
BA_ "VFrameFormat" BO_ 904 14;
BA_ "CANFD_BRS" BO_ 904 1;
BA_ "GenMsgCycleTime" BO_ 904 100;
BA_ "GenMsgCycleTimeFast" BO_ 904 0;
BA_ "GenMsgSendType" BO_ 904 0;
BA_ "VFrameFormat" BO_ 904 14;
BA_ "CANFD_BRS" BO_ 904 1;
BA_ "GenMsgCycleTime" BO_ 904 100;
BA_ "GenMsgCycleTimeFast" BO_ 904 0;
BA_ "GenMsgSendType" BO_ 904 0;
BA_ "VFrameFormat" BO_ 904 14;
BA_ "CANFD_BRS" BO_ 904 1;
BA_ "GenMsgCycleTime" BO_ 904 100;
BA_ "GenMsgCycleTimeFast" BO_ 904 0;
BA_ "GenMsgSendType" BO_ 904 0;
BA_ "VFrameFormat" BO_ 904 14;
BA_ "CANFD_BRS" BO_ 904 1;
BA_ "GenMsgCycleTime" BO_ 904 100;
BA_ "GenMsgCycleTimeFast" BO_ 904 0;
BA_ "GenMsgSendType" BO_ 904 0;
BA_ "VFrameFormat" BO_ 904 14;
BA_ "CANFD_BRS" BO_ 904 1;
BA_ "GenMsgCycleTime" BO_ 904 100;
BA_ "GenMsgCycleTimeFast" BO_ 904 0;
BA_ "GenMsgSendType" BO_ 904 0;
BA_ "VFrameFormat" BO_ 904 14;
BA_ "CANFD_BRS" BO_ 904 1;
BA_ "GenMsgCycleTime" BO_ 904 100;
BA_ "GenMsgCycleTimeFast" BO_ 904 0;
BA_ "GenMsgSendType" BO_ 904 0;
BA_ "VFrameFormat" BO_ 904 14;
BA_ "CANFD_BRS" BO_ 904 1;
BA_ "GenMsgCycleTime" BO_ 904 100;
BA_ "GenMsgCycleTimeFast" BO_ 904 0;
BA_ "GenMsgSendType" BO_ 904 0;
BA_ "VFrameFormat" BO_ 904 14;
BA_ "CANFD_BRS" BO_ 904 1;
BA_ "GenMsgCycleTime" BO_ 904 100;
BA_ "GenMsgCycleTimeFast" BO_ 904 0;
BA_ "GenMsgSendType" BO_ 904 0;
BA_ "VFrameFormat" BO_ 904 14;
BA_ "CANFD_BRS" BO_ 904 1;
BA_ "GenMsgCycleTime" BO_ 904 100;
BA_ "GenMsgCycleTimeFast" BO_ 904 0;
BA_ "GenMsgSendType" BO_ 904 0;
BA_ "VFrameFormat" BO_ 904 14;
BA_ "CANFD_BRS" BO_ 904 1;
BA_ "GenMsgCycleTime" BO_ 904 100;
BA_ "GenMsgCycleTimeFast" BO_ 904 0;
BA_ "GenMsgSendType" BO_ 904 0;
BA_ "VFrameFormat" BO_ 904 14;
BA_ "CANFD_BRS" BO_ 904 1;
BA_ "GenMsgCycleTime" BO_ 904 100;
BA_ "GenMsgCycleTimeFast" BO_ 904 0;
BA_ "GenMsgSendType" BO_ 904 0;
BA_ "VFrameFormat" BO_ 904 14;
BA_ "CANFD_BRS" BO_ 904 1;
BA_ "GenMsgCycleTime" BO_ 904 100;
BA_ "GenMsgCycleTimeFast" BO_ 904 0;
BA_ "GenMsgSendType" BO_ 904 0;
BA_ "VFrameFormat" BO_ 904 14;
BA_ "CANFD_BRS" BO_ 904 1;
BA_ "GenMsgCycleTime" BO_ 904 100;
BA_ "GenMsgCycleTimeFast" BO_ 904 0;
BA_ "GenMsgSendType" BO_ 904 0;
BA_ "VFrameFormat" BO_ 904 14;
BA_ "CANFD_BRS" BO_ 904 1;
BA_ "GenMsgCycleTime" BO_ 904 100;
BA_ "GenMsgCycleTimeFast" BO_ 904 0;
BA_ "GenMsgSendType" BO_ 904 0;
BA_ "VFrameFormat" BO_ 904 14;
BA_ "CANFD_BRS" BO_ 904 1;
BA_ "GenMsgCycleTime" BO_ 904 100;
BA_ "GenMsgCycleTimeFast" BO_ 904 0;
BA_ "GenMsgSendType" BO_ 904 0;
BA_ "VFrameFormat" BO_ 904 14;
BA_ "CANFD_BRS" BO_ 904 1;
BA_ "GenMsgCycleTime" BO_ 904 100;
BA_ "GenMsgCycleTimeFast" BO_ 904 0;
BA_ "GenMsgSendType" BO_ 904 0;
BA_ "VFrameFormat" BO_ 904 14;
BA_ "CANFD_BRS" BO_ 904 1;
BA_ "GenMsgCycleTime" BO_ 904 100;
BA_ "GenMsgCycleTimeFast" BO_ 904 0;
BA_ "GenMsgSendType" BO_ 904 0;
BA_ "VFrameFormat" BO_ 904 14;
BA_ "CANFD_BRS" BO_ 904 1;
BA_ "GenMsgCycleTime" BO_ 904 100;
BA_ "GenMsgCycleTimeFast" BO_ 904 0;
BA_ "GenMsgSendType" BO_ 904 0;
BA_ "VFrameFormat" BO_ 904 14;
BA_ "CANFD_BRS" BO_ 904 1;
BA_ "GenMsgCycleTime" BO_ 904 100;
BA_ "GenMsgCycleTimeFast" BO_ 904 0;
BA_ "GenMsgSendType" BO_ 904 0;
BA_ "VFrameFormat" BO_ 904 14;
BA_ "CANFD_BRS" BO_ 904 1;
BA_ "GenMsgCycleTime" BO_ 904 100;
BA_ "GenMsgCycleTimeFast" BO_ 904 0;
BA_ "GenMsgSendType" BO_ 904 0;
BA_ "VFrameFormat" BO_ 904 14;
BA_ "CANFD_BRS" BO_ 904 1;
BA_ "GenMsgCycleTime" BO_ 904 100;
BA_ "GenMsgCycleTimeFast" BO_ 904 0;
BA_ "GenMsgSendType" BO_ 904 0;
BA_ "VFrameFormat" BO_ 904 14;
BA_ "CANFD_BRS" BO_ 904 1;
BA_ "GenMsgCycleTime" BO_ 904 100;
BA_ "GenMsgCycleTimeFast" BO_ 904 0;
BA_ "GenMsgSendType" BO_ 904 0;
BA_ "VFrameFormat" BO_ 904 14;
BA_ "CANFD_BRS" BO_ 904 1;
BA_ "GenMsgCycleTime" BO_ 391 10;
BA_ "GenMsgCycleTimeFast" BO_ 391 0;
BA_ "GenMsgSendType" BO_ 391 0;
BA_ "VFrameFormat" BO_ 391 14;
BA_ "CANFD_BRS" BO_ 391 1;
BA_ "GenMsgCycleTime" BO_ 391 10;
BA_ "GenMsgCycleTimeFast" BO_ 391 0;
BA_ "GenMsgSendType" BO_ 391 0;
BA_ "VFrameFormat" BO_ 391 14;
BA_ "CANFD_BRS" BO_ 391 1;
BA_ "GenMsgCycleTime" BO_ 391 10;
BA_ "GenMsgCycleTimeFast" BO_ 391 0;
BA_ "GenMsgSendType" BO_ 391 0;
BA_ "VFrameFormat" BO_ 391 14;
BA_ "CANFD_BRS" BO_ 391 1;
BA_ "GenMsgCycleTime" BO_ 391 10;
BA_ "GenMsgCycleTimeFast" BO_ 391 0;
BA_ "GenMsgSendType" BO_ 391 0;
BA_ "VFrameFormat" BO_ 391 14;
BA_ "CANFD_BRS" BO_ 391 1;
BA_ "GenMsgCycleTime" BO_ 391 10;
BA_ "GenMsgCycleTimeFast" BO_ 391 0;
BA_ "GenMsgSendType" BO_ 391 0;
BA_ "VFrameFormat" BO_ 391 14;
BA_ "CANFD_BRS" BO_ 391 1;
BA_ "GenMsgCycleTime" BO_ 391 10;
BA_ "GenMsgCycleTimeFast" BO_ 391 0;
BA_ "GenMsgSendType" BO_ 391 0;
BA_ "VFrameFormat" BO_ 391 14;
BA_ "CANFD_BRS" BO_ 391 1;
BA_ "GenMsgCycleTime" BO_ 391 10;
BA_ "GenMsgCycleTimeFast" BO_ 391 0;
BA_ "GenMsgSendType" BO_ 391 0;
BA_ "VFrameFormat" BO_ 391 14;
BA_ "CANFD_BRS" BO_ 391 1;
BA_ "GenMsgCycleTime" BO_ 391 10;
BA_ "GenMsgCycleTimeFast" BO_ 391 0;
BA_ "GenMsgSendType" BO_ 391 0;
BA_ "VFrameFormat" BO_ 391 14;
BA_ "CANFD_BRS" BO_ 391 1;
BA_ "GenMsgCycleTime" BO_ 391 10;
BA_ "GenMsgCycleTimeFast" BO_ 391 0;
BA_ "GenMsgSendType" BO_ 391 0;
BA_ "VFrameFormat" BO_ 391 14;
BA_ "CANFD_BRS" BO_ 391 1;
BA_ "GenMsgCycleTime" BO_ 391 10;
BA_ "GenMsgCycleTimeFast" BO_ 391 0;
BA_ "GenMsgSendType" BO_ 391 0;
BA_ "VFrameFormat" BO_ 391 14;
BA_ "CANFD_BRS" BO_ 391 1;
BA_ "GenMsgCycleTime" BO_ 391 10;
BA_ "GenMsgCycleTimeFast" BO_ 391 0;
BA_ "GenMsgSendType" BO_ 391 0;
BA_ "VFrameFormat" BO_ 391 14;
BA_ "CANFD_BRS" BO_ 391 1;
BA_ "GenMsgCycleTime" BO_ 728 100;
BA_ "GenMsgCycleTimeFast" BO_ 728 0;
BA_ "GenMsgSendType" BO_ 728 0;
BA_ "VFrameFormat" BO_ 728 14;
BA_ "CANFD_BRS" BO_ 728 1;
BA_ "GenMsgCycleTime" BO_ 728 100;
BA_ "GenMsgCycleTimeFast" BO_ 728 0;
BA_ "GenMsgSendType" BO_ 728 0;
BA_ "VFrameFormat" BO_ 728 14;
BA_ "CANFD_BRS" BO_ 728 1;
BA_ "GenMsgCycleTime" BO_ 728 100;
BA_ "GenMsgCycleTimeFast" BO_ 728 0;
BA_ "GenMsgSendType" BO_ 728 0;
BA_ "VFrameFormat" BO_ 728 14;
BA_ "CANFD_BRS" BO_ 728 1;
BA_ "GenMsgCycleTime" BO_ 728 100;
BA_ "GenMsgCycleTimeFast" BO_ 728 0;
BA_ "GenMsgSendType" BO_ 728 0;
BA_ "VFrameFormat" BO_ 728 14;
BA_ "CANFD_BRS" BO_ 728 1;
BA_ "GenMsgCycleTime" BO_ 728 100;
BA_ "GenMsgCycleTimeFast" BO_ 728 0;
BA_ "GenMsgSendType" BO_ 728 0;
BA_ "VFrameFormat" BO_ 728 14;
BA_ "CANFD_BRS" BO_ 728 1;
BA_ "GenMsgCycleTime" BO_ 459 20;
BA_ "GenMsgCycleTimeFast" BO_ 459 0;
BA_ "GenMsgSendType" BO_ 459 0;
BA_ "VFrameFormat" BO_ 459 14;
BA_ "CANFD_BRS" BO_ 459 1;
BA_ "GenMsgCycleTime" BO_ 459 20;
BA_ "GenMsgCycleTimeFast" BO_ 459 0;
BA_ "GenMsgSendType" BO_ 459 0;
BA_ "VFrameFormat" BO_ 459 14;
BA_ "CANFD_BRS" BO_ 459 1;
BA_ "GenMsgCycleTime" BO_ 459 20;
BA_ "GenMsgCycleTimeFast" BO_ 459 0;
BA_ "GenMsgSendType" BO_ 459 0;
BA_ "VFrameFormat" BO_ 459 14;
BA_ "CANFD_BRS" BO_ 459 1;
BA_ "GenMsgCycleTime" BO_ 459 20;
BA_ "GenMsgCycleTimeFast" BO_ 459 0;
BA_ "GenMsgSendType" BO_ 459 0;
BA_ "VFrameFormat" BO_ 459 14;
BA_ "CANFD_BRS" BO_ 459 1;
BA_ "GenMsgCycleTime" BO_ 459 20;
BA_ "GenMsgCycleTimeFast" BO_ 459 0;
BA_ "GenMsgSendType" BO_ 459 0;
BA_ "VFrameFormat" BO_ 459 14;
BA_ "CANFD_BRS" BO_ 459 1;
BA_ "GenMsgCycleTime" BO_ 459 20;
BA_ "GenMsgCycleTimeFast" BO_ 459 0;
BA_ "GenMsgSendType" BO_ 459 0;
BA_ "VFrameFormat" BO_ 459 14;
BA_ "CANFD_BRS" BO_ 459 1;
BA_ "GenMsgCycleTime" BO_ 459 20;
BA_ "GenMsgCycleTimeFast" BO_ 459 0;
BA_ "GenMsgSendType" BO_ 459 0;
BA_ "VFrameFormat" BO_ 459 14;
BA_ "CANFD_BRS" BO_ 459 1;
BA_ "GenMsgCycleTime" BO_ 459 20;
BA_ "GenMsgCycleTimeFast" BO_ 459 0;
BA_ "GenMsgSendType" BO_ 459 0;
BA_ "VFrameFormat" BO_ 459 14;
BA_ "CANFD_BRS" BO_ 459 1;
BA_ "GenMsgCycleTime" BO_ 459 20;
BA_ "GenMsgCycleTimeFast" BO_ 459 0;
BA_ "GenMsgSendType" BO_ 459 0;
BA_ "VFrameFormat" BO_ 459 14;
BA_ "CANFD_BRS" BO_ 459 1;
BA_ "GenMsgCycleTime" BO_ 459 20;
BA_ "GenMsgCycleTimeFast" BO_ 459 0;
BA_ "GenMsgSendType" BO_ 459 0;
BA_ "VFrameFormat" BO_ 459 14;
BA_ "CANFD_BRS" BO_ 459 1;
BA_ "GenMsgCycleTime" BO_ 459 20;
BA_ "GenMsgCycleTimeFast" BO_ 459 0;
BA_ "GenMsgSendType" BO_ 459 0;
BA_ "VFrameFormat" BO_ 459 14;
BA_ "CANFD_BRS" BO_ 459 1;
BA_ "GenMsgCycleTime" BO_ 459 20;
BA_ "GenMsgCycleTimeFast" BO_ 459 0;
BA_ "GenMsgSendType" BO_ 459 0;
BA_ "VFrameFormat" BO_ 459 14;
BA_ "CANFD_BRS" BO_ 459 1;
BA_ "GenMsgCycleTime" BO_ 459 20;
BA_ "GenMsgCycleTimeFast" BO_ 459 0;
BA_ "GenMsgSendType" BO_ 459 0;
BA_ "VFrameFormat" BO_ 459 14;
BA_ "CANFD_BRS" BO_ 459 1;
BA_ "GenMsgCycleTime" BO_ 459 20;
BA_ "GenMsgCycleTimeFast" BO_ 459 0;
BA_ "GenMsgSendType" BO_ 459 0;
BA_ "VFrameFormat" BO_ 459 14;
BA_ "CANFD_BRS" BO_ 459 1;
BA_ "GenMsgCycleTime" BO_ 459 20;
BA_ "GenMsgCycleTimeFast" BO_ 459 0;
BA_ "GenMsgSendType" BO_ 459 0;
BA_ "VFrameFormat" BO_ 459 14;
BA_ "CANFD_BRS" BO_ 459 1;
BA_ "GenMsgCycleTime" BO_ 459 20;
BA_ "GenMsgCycleTimeFast" BO_ 459 0;
BA_ "GenMsgSendType" BO_ 459 0;
BA_ "VFrameFormat" BO_ 459 14;
BA_ "CANFD_BRS" BO_ 459 1;
BA_ "GenMsgCycleTime" BO_ 459 20;
BA_ "GenMsgCycleTimeFast" BO_ 459 0;
BA_ "GenMsgSendType" BO_ 459 0;
BA_ "VFrameFormat" BO_ 459 14;
BA_ "CANFD_BRS" BO_ 459 1;
BA_ "GenMsgCycleTime" BO_ 459 20;
BA_ "GenMsgCycleTimeFast" BO_ 459 0;
BA_ "GenMsgSendType" BO_ 459 0;
BA_ "VFrameFormat" BO_ 459 14;
BA_ "CANFD_BRS" BO_ 459 1;
BA_ "GenMsgCycleTime" BO_ 459 20;
BA_ "GenMsgCycleTimeFast" BO_ 459 0;
BA_ "GenMsgSendType" BO_ 459 0;
BA_ "VFrameFormat" BO_ 459 14;
BA_ "CANFD_BRS" BO_ 459 1;
BA_ "GenMsgCycleTime" BO_ 459 20;
BA_ "GenMsgCycleTimeFast" BO_ 459 0;
BA_ "GenMsgSendType" BO_ 459 0;
BA_ "VFrameFormat" BO_ 459 14;
BA_ "CANFD_BRS" BO_ 459 1;
BA_ "GenMsgCycleTime" BO_ 459 20;
BA_ "GenMsgCycleTimeFast" BO_ 459 0;
BA_ "GenMsgSendType" BO_ 459 0;
BA_ "VFrameFormat" BO_ 459 14;
BA_ "CANFD_BRS" BO_ 459 1;
BA_ "GenMsgCycleTime" BO_ 459 20;
BA_ "GenMsgCycleTimeFast" BO_ 459 0;
BA_ "GenMsgSendType" BO_ 459 0;
BA_ "VFrameFormat" BO_ 459 14;
BA_ "CANFD_BRS" BO_ 459 1;
BA_ "GenMsgCycleTime" BO_ 459 20;
BA_ "GenMsgCycleTimeFast" BO_ 459 0;
BA_ "GenMsgSendType" BO_ 459 0;
BA_ "VFrameFormat" BO_ 459 14;
BA_ "CANFD_BRS" BO_ 459 1;
BA_ "GenMsgCycleTime" BO_ 459 20;
BA_ "GenMsgCycleTimeFast" BO_ 459 0;
BA_ "GenMsgSendType" BO_ 459 0;
BA_ "VFrameFormat" BO_ 459 14;
BA_ "CANFD_BRS" BO_ 459 1;
BA_ "GenMsgCycleTime" BO_ 459 20;
BA_ "GenMsgCycleTimeFast" BO_ 459 0;
BA_ "GenMsgSendType" BO_ 459 0;
BA_ "VFrameFormat" BO_ 459 14;
BA_ "CANFD_BRS" BO_ 459 1;
BA_ "GenMsgCycleTime" BO_ 459 20;
BA_ "GenMsgCycleTimeFast" BO_ 459 0;
BA_ "GenMsgSendType" BO_ 459 0;
BA_ "VFrameFormat" BO_ 459 14;
BA_ "CANFD_BRS" BO_ 459 1;
BA_ "GenMsgCycleTime" BO_ 459 20;
BA_ "GenMsgCycleTimeFast" BO_ 459 0;
BA_ "GenMsgSendType" BO_ 459 0;
BA_ "VFrameFormat" BO_ 459 14;
BA_ "CANFD_BRS" BO_ 459 1;
BA_ "GenMsgCycleTime" BO_ 935 120;
BA_ "GenMsgCycleTimeFast" BO_ 935 0;
BA_ "GenMsgSendType" BO_ 935 0;
BA_ "VFrameFormat" BO_ 935 14;
BA_ "CANFD_BRS" BO_ 935 1;
BA_ "GenMsgCycleTime" BO_ 776 100;
BA_ "GenMsgCycleTimeFast" BO_ 776 0;
BA_ "GenMsgSendType" BO_ 776 0;
BA_ "VFrameFormat" BO_ 776 14;
BA_ "CANFD_BRS" BO_ 776 1;
BA_ "GenMsgCycleTime" BO_ 776 100;
BA_ "GenMsgCycleTimeFast" BO_ 776 0;
BA_ "GenMsgSendType" BO_ 776 0;
BA_ "VFrameFormat" BO_ 776 14;
BA_ "CANFD_BRS" BO_ 776 1;
BA_ "GenMsgCycleTime" BO_ 776 100;
BA_ "GenMsgCycleTimeFast" BO_ 776 0;
BA_ "GenMsgSendType" BO_ 776 0;
BA_ "VFrameFormat" BO_ 776 14;
BA_ "CANFD_BRS" BO_ 776 1;
BA_ "GenMsgCycleTime" BO_ 776 100;
BA_ "GenMsgCycleTimeFast" BO_ 776 0;
BA_ "GenMsgSendType" BO_ 776 0;
BA_ "VFrameFormat" BO_ 776 14;
BA_ "CANFD_BRS" BO_ 776 1;
BA_ "GenMsgCycleTime" BO_ 776 100;
BA_ "GenMsgCycleTimeFast" BO_ 776 0;
BA_ "GenMsgSendType" BO_ 776 0;
BA_ "VFrameFormat" BO_ 776 14;
BA_ "CANFD_BRS" BO_ 776 1;
BA_ "GenMsgCycleTime" BO_ 776 100;
BA_ "GenMsgCycleTimeFast" BO_ 776 0;
BA_ "GenMsgSendType" BO_ 776 0;
BA_ "VFrameFormat" BO_ 776 14;
BA_ "CANFD_BRS" BO_ 776 1;
BA_ "GenMsgCycleTime" BO_ 776 100;
BA_ "GenMsgCycleTimeFast" BO_ 776 0;
BA_ "GenMsgSendType" BO_ 776 0;
BA_ "VFrameFormat" BO_ 776 14;
BA_ "CANFD_BRS" BO_ 776 1;
BA_ "GenMsgCycleTime" BO_ 776 100;
BA_ "GenMsgCycleTimeFast" BO_ 776 0;
BA_ "GenMsgSendType" BO_ 776 0;
BA_ "VFrameFormat" BO_ 776 14;
BA_ "CANFD_BRS" BO_ 776 1;
BA_ "GenMsgCycleTime" BO_ 776 100;
BA_ "GenMsgCycleTimeFast" BO_ 776 0;
BA_ "GenMsgSendType" BO_ 776 0;
BA_ "VFrameFormat" BO_ 776 14;
BA_ "CANFD_BRS" BO_ 776 1;
BA_ "GenMsgCycleTime" BO_ 793 100;
BA_ "GenMsgCycleTimeFast" BO_ 793 0;
BA_ "GenMsgSendType" BO_ 793 0;
BA_ "VFrameFormat" BO_ 793 14;
BA_ "CANFD_BRS" BO_ 793 1;
BA_ "GenMsgCycleTime" BO_ 793 100;
BA_ "GenMsgCycleTimeFast" BO_ 793 0;
BA_ "GenMsgSendType" BO_ 793 0;
BA_ "VFrameFormat" BO_ 793 14;
BA_ "CANFD_BRS" BO_ 793 1;
BA_ "GenMsgCycleTime" BO_ 793 100;
BA_ "GenMsgCycleTimeFast" BO_ 793 0;
BA_ "GenMsgSendType" BO_ 793 0;
BA_ "VFrameFormat" BO_ 793 14;
BA_ "CANFD_BRS" BO_ 793 1;
BA_ "GenMsgCycleTime" BO_ 793 100;
BA_ "GenMsgCycleTimeFast" BO_ 793 0;
BA_ "GenMsgSendType" BO_ 793 0;
BA_ "VFrameFormat" BO_ 793 14;
BA_ "CANFD_BRS" BO_ 793 1;
BA_ "GenMsgCycleTime" BO_ 620 60;
BA_ "GenMsgCycleTimeFast" BO_ 620 0;
BA_ "GenMsgSendType" BO_ 620 0;
BA_ "VFrameFormat" BO_ 620 14;
BA_ "CANFD_BRS" BO_ 620 1;
BA_ "GenMsgCycleTime" BO_ 620 60;
BA_ "GenMsgCycleTimeFast" BO_ 620 0;
BA_ "GenMsgSendType" BO_ 620 0;
BA_ "VFrameFormat" BO_ 620 14;
BA_ "CANFD_BRS" BO_ 620 1;
BA_ "GenMsgCycleTime" BO_ 620 60;
BA_ "GenMsgCycleTimeFast" BO_ 620 0;
BA_ "GenMsgSendType" BO_ 620 0;
BA_ "VFrameFormat" BO_ 620 14;
BA_ "CANFD_BRS" BO_ 620 1;
BA_ "GenMsgCycleTime" BO_ 620 60;
BA_ "GenMsgCycleTimeFast" BO_ 620 0;
BA_ "GenMsgSendType" BO_ 620 0;
BA_ "VFrameFormat" BO_ 620 14;
BA_ "CANFD_BRS" BO_ 620 1;
BA_ "GenMsgCycleTime" BO_ 620 60;
BA_ "GenMsgCycleTimeFast" BO_ 620 0;
BA_ "GenMsgSendType" BO_ 620 0;
BA_ "VFrameFormat" BO_ 620 14;
BA_ "CANFD_BRS" BO_ 620 1;
BA_ "GenMsgCycleTime" BO_ 620 60;
BA_ "GenMsgCycleTimeFast" BO_ 620 0;
BA_ "GenMsgSendType" BO_ 620 0;
BA_ "VFrameFormat" BO_ 620 14;
BA_ "CANFD_BRS" BO_ 620 1;
BA_ "GenMsgCycleTime" BO_ 620 60;
BA_ "GenMsgCycleTimeFast" BO_ 620 0;
BA_ "GenMsgSendType" BO_ 620 0;
BA_ "VFrameFormat" BO_ 620 14;
BA_ "CANFD_BRS" BO_ 620 1;
BA_ "GenMsgCycleTime" BO_ 620 60;
BA_ "GenMsgCycleTimeFast" BO_ 620 0;
BA_ "GenMsgSendType" BO_ 620 0;
BA_ "VFrameFormat" BO_ 620 14;
BA_ "CANFD_BRS" BO_ 620 1;
BA_ "GenMsgCycleTime" BO_ 620 60;
BA_ "GenMsgCycleTimeFast" BO_ 620 0;
BA_ "GenMsgSendType" BO_ 620 0;
BA_ "VFrameFormat" BO_ 620 14;
BA_ "CANFD_BRS" BO_ 620 1;
BA_ "GenMsgCycleTime" BO_ 620 60;
BA_ "GenMsgCycleTimeFast" BO_ 620 0;
BA_ "GenMsgSendType" BO_ 620 0;
BA_ "VFrameFormat" BO_ 620 14;
BA_ "CANFD_BRS" BO_ 620 1;
BA_ "GenMsgCycleTime" BO_ 620 60;
BA_ "GenMsgCycleTimeFast" BO_ 620 0;
BA_ "GenMsgSendType" BO_ 620 0;
BA_ "VFrameFormat" BO_ 620 14;
BA_ "CANFD_BRS" BO_ 620 1;
BA_ "GenMsgCycleTime" BO_ 620 60;
BA_ "GenMsgCycleTimeFast" BO_ 620 0;
BA_ "GenMsgSendType" BO_ 620 0;
BA_ "VFrameFormat" BO_ 620 14;
BA_ "CANFD_BRS" BO_ 620 1;
BA_ "GenMsgCycleTime" BO_ 620 60;
BA_ "GenMsgCycleTimeFast" BO_ 620 0;
BA_ "GenMsgSendType" BO_ 620 0;
BA_ "VFrameFormat" BO_ 620 14;
BA_ "CANFD_BRS" BO_ 620 1;
BA_ "GenMsgCycleTime" BO_ 620 60;
BA_ "GenMsgCycleTimeFast" BO_ 620 0;
BA_ "GenMsgSendType" BO_ 620 0;
BA_ "VFrameFormat" BO_ 620 14;
BA_ "CANFD_BRS" BO_ 620 1;
BA_ "GenMsgCycleTime" BO_ 620 60;
BA_ "GenMsgCycleTimeFast" BO_ 620 0;
BA_ "GenMsgSendType" BO_ 620 0;
BA_ "VFrameFormat" BO_ 620 14;
BA_ "CANFD_BRS" BO_ 620 1;
BA_ "GenMsgCycleTime" BO_ 620 60;
BA_ "GenMsgCycleTimeFast" BO_ 620 0;
BA_ "GenMsgSendType" BO_ 620 0;
BA_ "VFrameFormat" BO_ 620 14;
BA_ "CANFD_BRS" BO_ 620 1;
BA_ "GenMsgCycleTime" BO_ 620 60;
BA_ "GenMsgCycleTimeFast" BO_ 620 0;
BA_ "GenMsgSendType" BO_ 620 0;
BA_ "VFrameFormat" BO_ 620 14;
BA_ "CANFD_BRS" BO_ 620 1;
BA_ "GenMsgCycleTime" BO_ 620 60;
BA_ "GenMsgCycleTimeFast" BO_ 620 0;
BA_ "GenMsgSendType" BO_ 620 0;
BA_ "VFrameFormat" BO_ 620 14;
BA_ "CANFD_BRS" BO_ 620 1;
BA_ "GenMsgCycleTime" BO_ 620 60;
BA_ "GenMsgCycleTimeFast" BO_ 620 0;
BA_ "GenMsgSendType" BO_ 620 0;
BA_ "VFrameFormat" BO_ 620 14;
BA_ "CANFD_BRS" BO_ 620 1;
BA_ "GenMsgCycleTime" BO_ 620 60;
BA_ "GenMsgCycleTimeFast" BO_ 620 0;
BA_ "GenMsgSendType" BO_ 620 0;
BA_ "VFrameFormat" BO_ 620 14;
BA_ "CANFD_BRS" BO_ 620 1;
BA_ "GenMsgCycleTime" BO_ 620 60;
BA_ "GenMsgCycleTimeFast" BO_ 620 0;
BA_ "GenMsgSendType" BO_ 620 0;
BA_ "VFrameFormat" BO_ 620 14;
BA_ "CANFD_BRS" BO_ 620 1;
BA_ "GenMsgCycleTime" BO_ 620 60;
BA_ "GenMsgCycleTimeFast" BO_ 620 0;
BA_ "GenMsgSendType" BO_ 620 0;
BA_ "VFrameFormat" BO_ 620 14;
BA_ "CANFD_BRS" BO_ 620 1;
BA_ "GenMsgCycleTime" BO_ 620 60;
BA_ "GenMsgCycleTimeFast" BO_ 620 0;
BA_ "GenMsgSendType" BO_ 620 0;
BA_ "VFrameFormat" BO_ 620 14;
BA_ "CANFD_BRS" BO_ 620 1;
BA_ "GenMsgCycleTime" BO_ 620 60;
BA_ "GenMsgCycleTimeFast" BO_ 620 0;
BA_ "GenMsgSendType" BO_ 620 0;
BA_ "VFrameFormat" BO_ 620 14;
BA_ "CANFD_BRS" BO_ 620 1;
BA_ "GenMsgCycleTime" BO_ 620 60;
BA_ "GenMsgCycleTimeFast" BO_ 620 0;
BA_ "GenMsgSendType" BO_ 620 0;
BA_ "VFrameFormat" BO_ 620 14;
BA_ "CANFD_BRS" BO_ 620 1;
BA_ "GenMsgCycleTime" BO_ 620 60;
BA_ "GenMsgCycleTimeFast" BO_ 620 0;
BA_ "GenMsgSendType" BO_ 620 0;
BA_ "VFrameFormat" BO_ 620 14;
BA_ "CANFD_BRS" BO_ 620 1;
BA_ "GenMsgCycleTime" BO_ 620 60;
BA_ "GenMsgCycleTimeFast" BO_ 620 0;
BA_ "GenMsgSendType" BO_ 620 0;
BA_ "VFrameFormat" BO_ 620 14;
BA_ "CANFD_BRS" BO_ 620 1;
BA_ "GenMsgCycleTime" BO_ 620 60;
BA_ "GenMsgCycleTimeFast" BO_ 620 0;
BA_ "GenMsgSendType" BO_ 620 0;
BA_ "VFrameFormat" BO_ 620 14;
BA_ "CANFD_BRS" BO_ 620 1;
BA_ "GenMsgCycleTime" BO_ 620 60;
BA_ "GenMsgCycleTimeFast" BO_ 620 0;
BA_ "GenMsgSendType" BO_ 620 0;
BA_ "VFrameFormat" BO_ 620 14;
BA_ "CANFD_BRS" BO_ 620 1;
BA_ "GenMsgCycleTime" BO_ 620 60;
BA_ "GenMsgCycleTimeFast" BO_ 620 0;
BA_ "GenMsgSendType" BO_ 620 0;
BA_ "VFrameFormat" BO_ 620 14;
BA_ "CANFD_BRS" BO_ 620 1;
BA_ "GenMsgCycleTime" BO_ 620 60;
BA_ "GenMsgCycleTimeFast" BO_ 620 0;
BA_ "GenMsgSendType" BO_ 620 0;
BA_ "VFrameFormat" BO_ 620 14;
BA_ "CANFD_BRS" BO_ 620 1;
BA_ "GenMsgCycleTime" BO_ 620 60;
BA_ "GenMsgCycleTimeFast" BO_ 620 0;
BA_ "GenMsgSendType" BO_ 620 0;
BA_ "VFrameFormat" BO_ 620 14;
BA_ "CANFD_BRS" BO_ 620 1;
BA_ "GenMsgCycleTime" BO_ 620 60;
BA_ "GenMsgCycleTimeFast" BO_ 620 0;
BA_ "GenMsgSendType" BO_ 620 0;
BA_ "VFrameFormat" BO_ 620 14;
BA_ "CANFD_BRS" BO_ 620 1;
BA_ "GenMsgCycleTime" BO_ 620 60;
BA_ "GenMsgCycleTimeFast" BO_ 620 0;
BA_ "GenMsgSendType" BO_ 620 0;
BA_ "VFrameFormat" BO_ 620 14;
BA_ "CANFD_BRS" BO_ 620 1;
BA_ "GenMsgCycleTime" BO_ 620 60;
BA_ "GenMsgCycleTimeFast" BO_ 620 0;
BA_ "GenMsgSendType" BO_ 620 0;
BA_ "VFrameFormat" BO_ 620 14;
BA_ "CANFD_BRS" BO_ 620 1;
BA_ "GenMsgCycleTime" BO_ 620 60;
BA_ "GenMsgCycleTimeFast" BO_ 620 0;
BA_ "GenMsgSendType" BO_ 620 0;
BA_ "VFrameFormat" BO_ 620 14;
BA_ "CANFD_BRS" BO_ 620 1;
BA_ "GenMsgCycleTime" BO_ 620 60;
BA_ "GenMsgCycleTimeFast" BO_ 620 0;
BA_ "GenMsgSendType" BO_ 620 0;
BA_ "VFrameFormat" BO_ 620 14;
BA_ "CANFD_BRS" BO_ 620 1;
BA_ "GenMsgCycleTime" BO_ 620 60;
BA_ "GenMsgCycleTimeFast" BO_ 620 0;
BA_ "GenMsgSendType" BO_ 620 0;
BA_ "VFrameFormat" BO_ 620 14;
BA_ "CANFD_BRS" BO_ 620 1;
BA_ "GenMsgCycleTime" BO_ 620 60;
BA_ "GenMsgCycleTimeFast" BO_ 620 0;
BA_ "GenMsgSendType" BO_ 620 0;
BA_ "VFrameFormat" BO_ 620 14;
BA_ "CANFD_BRS" BO_ 620 1;
BA_ "GenMsgCycleTime" BO_ 620 60;
BA_ "GenMsgCycleTimeFast" BO_ 620 0;
BA_ "GenMsgSendType" BO_ 620 0;
BA_ "VFrameFormat" BO_ 620 14;
BA_ "CANFD_BRS" BO_ 620 1;
BA_ "GenMsgCycleTime" BO_ 620 60;
BA_ "GenMsgCycleTimeFast" BO_ 620 0;
BA_ "GenMsgSendType" BO_ 620 0;
BA_ "VFrameFormat" BO_ 620 14;
BA_ "CANFD_BRS" BO_ 620 1;
BA_ "GenMsgCycleTime" BO_ 620 60;
BA_ "GenMsgCycleTimeFast" BO_ 620 0;
BA_ "GenMsgSendType" BO_ 620 0;
BA_ "VFrameFormat" BO_ 620 14;
BA_ "CANFD_BRS" BO_ 620 1;
BA_ "GenMsgCycleTime" BO_ 380 10;
BA_ "GenMsgCycleTimeFast" BO_ 380 0;
BA_ "GenMsgSendType" BO_ 380 0;
BA_ "VFrameFormat" BO_ 380 14;
BA_ "CANFD_BRS" BO_ 380 1;
BA_ "GenMsgCycleTime" BO_ 380 10;
BA_ "GenMsgCycleTimeFast" BO_ 380 0;
BA_ "GenMsgSendType" BO_ 380 0;
BA_ "VFrameFormat" BO_ 380 14;
BA_ "CANFD_BRS" BO_ 380 1;
BA_ "GenMsgCycleTime" BO_ 380 10;
BA_ "GenMsgCycleTimeFast" BO_ 380 0;
BA_ "GenMsgSendType" BO_ 380 0;
BA_ "VFrameFormat" BO_ 380 14;
BA_ "CANFD_BRS" BO_ 380 1;
BA_ "GenMsgCycleTime" BO_ 380 10;
BA_ "GenMsgCycleTimeFast" BO_ 380 0;
BA_ "GenMsgSendType" BO_ 380 0;
BA_ "VFrameFormat" BO_ 380 14;
BA_ "CANFD_BRS" BO_ 380 1;
BA_ "GenMsgCycleTime" BO_ 380 10;
BA_ "GenMsgCycleTimeFast" BO_ 380 0;
BA_ "GenMsgSendType" BO_ 380 0;
BA_ "VFrameFormat" BO_ 380 14;
BA_ "CANFD_BRS" BO_ 380 1;
BA_ "GenMsgCycleTime" BO_ 380 10;
BA_ "GenMsgCycleTimeFast" BO_ 380 0;
BA_ "GenMsgSendType" BO_ 380 0;
BA_ "VFrameFormat" BO_ 380 14;
BA_ "CANFD_BRS" BO_ 380 1;
BA_ "GenMsgCycleTime" BO_ 380 10;
BA_ "GenMsgCycleTimeFast" BO_ 380 0;
BA_ "GenMsgSendType" BO_ 380 0;
BA_ "VFrameFormat" BO_ 380 14;
BA_ "CANFD_BRS" BO_ 380 1;
BA_ "GenMsgCycleTime" BO_ 380 10;
BA_ "GenMsgCycleTimeFast" BO_ 380 0;
BA_ "GenMsgSendType" BO_ 380 0;
BA_ "VFrameFormat" BO_ 380 14;
BA_ "CANFD_BRS" BO_ 380 1;
BA_ "GenMsgCycleTime" BO_ 380 10;
BA_ "GenMsgCycleTimeFast" BO_ 380 0;
BA_ "GenMsgSendType" BO_ 380 0;
BA_ "VFrameFormat" BO_ 380 14;
BA_ "CANFD_BRS" BO_ 380 1;
BA_ "GenMsgCycleTime" BO_ 380 10;
BA_ "GenMsgCycleTimeFast" BO_ 380 0;
BA_ "GenMsgSendType" BO_ 380 0;
BA_ "VFrameFormat" BO_ 380 14;
BA_ "CANFD_BRS" BO_ 380 1;
BA_ "GenMsgCycleTime" BO_ 380 10;
BA_ "GenMsgCycleTimeFast" BO_ 380 0;
BA_ "GenMsgSendType" BO_ 380 0;
BA_ "VFrameFormat" BO_ 380 14;
BA_ "CANFD_BRS" BO_ 380 1;
BA_ "GenMsgCycleTime" BO_ 380 10;
BA_ "GenMsgCycleTimeFast" BO_ 380 0;
BA_ "GenMsgSendType" BO_ 380 0;
BA_ "VFrameFormat" BO_ 380 14;
BA_ "CANFD_BRS" BO_ 380 1;
BA_ "GenMsgCycleTime" BO_ 778 100;
BA_ "GenMsgCycleTimeFast" BO_ 778 0;
BA_ "GenMsgSendType" BO_ 778 0;
BA_ "VFrameFormat" BO_ 778 14;
BA_ "CANFD_BRS" BO_ 778 1;
BA_ "GenMsgCycleTime" BO_ 778 100;
BA_ "GenMsgCycleTimeFast" BO_ 778 0;
BA_ "GenMsgSendType" BO_ 778 0;
BA_ "VFrameFormat" BO_ 778 14;
BA_ "CANFD_BRS" BO_ 778 1;
BA_ "GenMsgCycleTime" BO_ 778 100;
BA_ "GenMsgCycleTimeFast" BO_ 778 0;
BA_ "GenMsgSendType" BO_ 778 0;
BA_ "VFrameFormat" BO_ 778 14;
BA_ "CANFD_BRS" BO_ 778 1;
BA_ "GenMsgCycleTime" BO_ 778 100;
BA_ "GenMsgCycleTimeFast" BO_ 778 0;
BA_ "GenMsgSendType" BO_ 778 0;
BA_ "VFrameFormat" BO_ 778 14;
BA_ "CANFD_BRS" BO_ 778 1;
BA_ "GenMsgCycleTime" BO_ 778 100;
BA_ "GenMsgCycleTimeFast" BO_ 778 0;
BA_ "GenMsgSendType" BO_ 778 0;
BA_ "VFrameFormat" BO_ 778 14;
BA_ "CANFD_BRS" BO_ 778 1;
BA_ "GenMsgCycleTime" BO_ 778 100;
BA_ "GenMsgCycleTimeFast" BO_ 778 0;
BA_ "GenMsgSendType" BO_ 778 0;
BA_ "VFrameFormat" BO_ 778 14;
BA_ "CANFD_BRS" BO_ 778 1;
BA_ "GenMsgCycleTime" BO_ 778 100;
BA_ "GenMsgCycleTimeFast" BO_ 778 0;
BA_ "GenMsgSendType" BO_ 778 0;
BA_ "VFrameFormat" BO_ 778 14;
BA_ "CANFD_BRS" BO_ 778 1;
BA_ "GenMsgCycleTime" BO_ 778 100;
BA_ "GenMsgCycleTimeFast" BO_ 778 0;
BA_ "GenMsgSendType" BO_ 778 0;
BA_ "VFrameFormat" BO_ 778 14;
BA_ "CANFD_BRS" BO_ 778 1;
BA_ "GenMsgCycleTime" BO_ 778 100;
BA_ "GenMsgCycleTimeFast" BO_ 778 0;
BA_ "GenMsgSendType" BO_ 778 0;
BA_ "VFrameFormat" BO_ 778 14;
BA_ "CANFD_BRS" BO_ 778 1;
BA_ "GenMsgCycleTime" BO_ 778 100;
BA_ "GenMsgCycleTimeFast" BO_ 778 0;
BA_ "GenMsgSendType" BO_ 778 0;
BA_ "VFrameFormat" BO_ 778 14;
BA_ "CANFD_BRS" BO_ 778 1;
BA_ "GenMsgCycleTime" BO_ 778 100;
BA_ "GenMsgCycleTimeFast" BO_ 778 0;
BA_ "GenMsgSendType" BO_ 778 0;
BA_ "VFrameFormat" BO_ 778 14;
BA_ "CANFD_BRS" BO_ 778 1;
BA_ "GenMsgCycleTime" BO_ 704 20;
BA_ "GenMsgCycleTimeFast" BO_ 704 0;
BA_ "GenMsgSendType" BO_ 704 0;
BA_ "VFrameFormat" BO_ 704 14;
BA_ "CANFD_BRS" BO_ 704 1;
BA_ "GenMsgCycleTime" BO_ 704 20;
BA_ "GenMsgCycleTimeFast" BO_ 704 0;
BA_ "GenMsgSendType" BO_ 704 0;
BA_ "VFrameFormat" BO_ 704 14;
BA_ "CANFD_BRS" BO_ 704 1;
BA_ "GenMsgCycleTime" BO_ 704 20;
BA_ "GenMsgCycleTimeFast" BO_ 704 0;
BA_ "GenMsgSendType" BO_ 704 0;
BA_ "VFrameFormat" BO_ 704 14;
BA_ "CANFD_BRS" BO_ 704 1;
BA_ "GenMsgCycleTime" BO_ 794 100;
BA_ "GenMsgCycleTimeFast" BO_ 794 0;
BA_ "GenMsgSendType" BO_ 794 0;
BA_ "VFrameFormat" BO_ 794 14;
BA_ "CANFD_BRS" BO_ 794 1;
BA_ "GenMsgCycleTime" BO_ 794 100;
BA_ "GenMsgCycleTimeFast" BO_ 794 0;
BA_ "GenMsgSendType" BO_ 794 0;
BA_ "VFrameFormat" BO_ 794 14;
BA_ "CANFD_BRS" BO_ 794 1;
BA_ "GenMsgCycleTime" BO_ 794 100;
BA_ "GenMsgCycleTimeFast" BO_ 794 0;
BA_ "GenMsgSendType" BO_ 794 0;
BA_ "VFrameFormat" BO_ 794 14;
BA_ "CANFD_BRS" BO_ 794 1;
BA_ "GenMsgCycleTime" BO_ 794 100;
BA_ "GenMsgCycleTimeFast" BO_ 794 0;
BA_ "GenMsgSendType" BO_ 794 0;
BA_ "VFrameFormat" BO_ 794 14;
BA_ "CANFD_BRS" BO_ 794 1;
BA_ "GenMsgCycleTime" BO_ 619 20;
BA_ "GenMsgCycleTimeFast" BO_ 619 0;
BA_ "GenMsgSendType" BO_ 619 0;
BA_ "VFrameFormat" BO_ 619 14;
BA_ "CANFD_BRS" BO_ 619 1;
BA_ "GenMsgCycleTime" BO_ 619 20;
BA_ "GenMsgCycleTimeFast" BO_ 619 0;
BA_ "GenMsgSendType" BO_ 619 0;
BA_ "VFrameFormat" BO_ 619 14;
BA_ "CANFD_BRS" BO_ 619 1;
BA_ "GenMsgCycleTime" BO_ 529 10;
BA_ "GenMsgCycleTimeFast" BO_ 529 0;
BA_ "GenMsgSendType" BO_ 529 0;
BA_ "VFrameFormat" BO_ 529 14;
BA_ "CANFD_BRS" BO_ 529 1;
BA_ "GenMsgCycleTime" BO_ 529 10;
BA_ "GenMsgCycleTimeFast" BO_ 529 0;
BA_ "GenMsgSendType" BO_ 529 0;
BA_ "VFrameFormat" BO_ 529 14;
BA_ "CANFD_BRS" BO_ 529 1;
BA_ "GenMsgCycleTime" BO_ 529 10;
BA_ "GenMsgCycleTimeFast" BO_ 529 0;
BA_ "GenMsgSendType" BO_ 529 0;
BA_ "VFrameFormat" BO_ 529 14;
BA_ "CANFD_BRS" BO_ 529 1;
BA_ "GenMsgCycleTime" BO_ 529 10;
BA_ "GenMsgCycleTimeFast" BO_ 529 0;
BA_ "GenMsgSendType" BO_ 529 0;
BA_ "VFrameFormat" BO_ 529 14;
BA_ "CANFD_BRS" BO_ 529 1;
BA_ "GenMsgCycleTime" BO_ 529 10;
BA_ "GenMsgCycleTimeFast" BO_ 529 0;
BA_ "GenMsgSendType" BO_ 529 0;
BA_ "VFrameFormat" BO_ 529 14;
BA_ "CANFD_BRS" BO_ 529 1;
BA_ "GenMsgCycleTime" BO_ 529 10;
BA_ "GenMsgCycleTimeFast" BO_ 529 0;
BA_ "GenMsgSendType" BO_ 529 0;
BA_ "VFrameFormat" BO_ 529 14;
BA_ "CANFD_BRS" BO_ 529 1;
BA_ "GenMsgCycleTime" BO_ 529 10;
BA_ "GenMsgCycleTimeFast" BO_ 529 0;
BA_ "GenMsgSendType" BO_ 529 0;
BA_ "VFrameFormat" BO_ 529 14;
BA_ "CANFD_BRS" BO_ 529 1;
BA_ "GenMsgCycleTime" BO_ 529 10;
BA_ "GenMsgCycleTimeFast" BO_ 529 0;
BA_ "GenMsgSendType" BO_ 529 0;
BA_ "VFrameFormat" BO_ 529 14;
BA_ "CANFD_BRS" BO_ 529 1;
BA_ "GenMsgCycleTime" BO_ 529 10;
BA_ "GenMsgCycleTimeFast" BO_ 529 0;
BA_ "GenMsgSendType" BO_ 529 0;
BA_ "VFrameFormat" BO_ 529 14;
BA_ "CANFD_BRS" BO_ 529 1;
BA_ "GenMsgCycleTime" BO_ 529 10;
BA_ "GenMsgCycleTimeFast" BO_ 529 0;
BA_ "GenMsgSendType" BO_ 529 0;
BA_ "VFrameFormat" BO_ 529 14;
BA_ "CANFD_BRS" BO_ 529 1;
BA_ "GenMsgCycleTime" BO_ 529 10;
BA_ "GenMsgCycleTimeFast" BO_ 529 0;
BA_ "GenMsgSendType" BO_ 529 0;
BA_ "VFrameFormat" BO_ 529 14;
BA_ "CANFD_BRS" BO_ 529 1;
BA_ "GenMsgCycleTime" BO_ 529 10;
BA_ "GenMsgCycleTimeFast" BO_ 529 0;
BA_ "GenMsgSendType" BO_ 529 0;
BA_ "VFrameFormat" BO_ 529 14;
BA_ "CANFD_BRS" BO_ 529 1;
BA_ "GenMsgCycleTime" BO_ 720 100;
BA_ "GenMsgCycleTimeFast" BO_ 720 0;
BA_ "GenMsgSendType" BO_ 720 0;
BA_ "VFrameFormat" BO_ 720 14;
BA_ "CANFD_BRS" BO_ 720 1;
BA_ "GenMsgCycleTime" BO_ 445 10;
BA_ "GenMsgCycleTimeFast" BO_ 445 0;
BA_ "GenMsgSendType" BO_ 445 0;
BA_ "VFrameFormat" BO_ 445 14;
BA_ "CANFD_BRS" BO_ 445 1;
BA_ "GenMsgCycleTime" BO_ 462 10;
BA_ "GenMsgCycleTimeFast" BO_ 462 0;
BA_ "GenMsgSendType" BO_ 462 0;
BA_ "VFrameFormat" BO_ 462 14;
BA_ "CANFD_BRS" BO_ 462 1;
BA_ "EventCommandSignal" SG_ 618 EPB_1_CRC 0;
BA_ "GatewayedSignals" SG_ 618 EPB_1_CRC 0;
BA_ "GenSigInactiveValue" SG_ 618 EPB_1_CRC 0;
BA_ "GenSigInvalidValue" SG_ 618 EPB_1_CRC 0;
BA_ "GenSigSendType" SG_ 618 EPB_1_CRC 1;
BA_ "GenSigStartValue" SG_ 618 EPB_1_CRC 0;
BA_ "GenSigTimeoutValue" SG_ 618 EPB_1_CRC 0;
BA_ "Remark" SG_ 618 EPB_1_CRC "涉及ID管理表";
BA_ "EventCommandSignal" SG_ 618 EPB_1_Counter 0;
BA_ "GatewayedSignals" SG_ 618 EPB_1_Counter 0;
BA_ "GenSigInactiveValue" SG_ 618 EPB_1_Counter 0;
BA_ "GenSigInvalidValue" SG_ 618 EPB_1_Counter 0;
BA_ "GenSigSendType" SG_ 618 EPB_1_Counter 1;
BA_ "GenSigStartValue" SG_ 618 EPB_1_Counter 0;
BA_ "GenSigTimeoutValue" SG_ 618 EPB_1_Counter 0;
BA_ "Remark" SG_ 618 EPB_1_Counter "涉及ID管理表";
BA_ "EventCommandSignal" SG_ 618 EPB_SwitchSt 0;
BA_ "GatewayedSignals" SG_ 618 EPB_SwitchSt 0;
BA_ "GenSigInactiveValue" SG_ 618 EPB_SwitchSt 0;
BA_ "GenSigInvalidValue" SG_ 618 EPB_SwitchSt 0;
BA_ "GenSigSendType" SG_ 618 EPB_SwitchSt 1;
BA_ "GenSigStartValue" SG_ 618 EPB_SwitchSt 0;
BA_ "GenSigTimeoutValue" SG_ 618 EPB_SwitchSt 0;
BA_ "Remark" SG_ 618 EPB_SwitchSt "涉及ID管理表";
BA_ "EventCommandSignal" SG_ 618 EPB_SwitchStVD 0;
BA_ "GatewayedSignals" SG_ 618 EPB_SwitchStVD 0;
BA_ "GenSigInactiveValue" SG_ 618 EPB_SwitchStVD 0;
BA_ "GenSigInvalidValue" SG_ 618 EPB_SwitchStVD 0;
BA_ "GenSigSendType" SG_ 618 EPB_SwitchStVD 1;
BA_ "GenSigStartValue" SG_ 618 EPB_SwitchStVD 0;
BA_ "GenSigTimeoutValue" SG_ 618 EPB_SwitchStVD 0;
BA_ "Remark" SG_ 618 EPB_SwitchStVD "涉及ID管理表";
BA_ "EventCommandSignal" SG_ 618 EPB_SysSt 0;
BA_ "GatewayedSignals" SG_ 618 EPB_SysSt 0;
BA_ "GenSigInactiveValue" SG_ 618 EPB_SysSt 0;
BA_ "GenSigInvalidValue" SG_ 618 EPB_SysSt 0;
BA_ "GenSigSendType" SG_ 618 EPB_SysSt 1;
BA_ "GenSigStartValue" SG_ 618 EPB_SysSt 0;
BA_ "GenSigTimeoutValue" SG_ 618 EPB_SysSt 7;
BA_ "Remark" SG_ 618 EPB_SysSt "涉及ID管理表";
BA_ "EventCommandSignal" SG_ 618 EPB_FailSt 0;
BA_ "GatewayedSignals" SG_ 618 EPB_FailSt 0;
BA_ "GenSigInactiveValue" SG_ 618 EPB_FailSt 0;
BA_ "GenSigInvalidValue" SG_ 618 EPB_FailSt 0;
BA_ "GenSigSendType" SG_ 618 EPB_FailSt 1;
BA_ "GenSigStartValue" SG_ 618 EPB_FailSt 0;
BA_ "GenSigTimeoutValue" SG_ 618 EPB_FailSt 1;
BA_ "Remark" SG_ 618 EPB_FailSt "涉及ID管理表";
BA_ "EventCommandSignal" SG_ 618 EPB_ExtAvailable 0;
BA_ "GatewayedSignals" SG_ 618 EPB_ExtAvailable 0;
BA_ "GenSigInactiveValue" SG_ 618 EPB_ExtAvailable 0;
BA_ "GenSigInvalidValue" SG_ 618 EPB_ExtAvailable 0;
BA_ "GenSigSendType" SG_ 618 EPB_ExtAvailable 1;
BA_ "GenSigStartValue" SG_ 618 EPB_ExtAvailable 0;
BA_ "GenSigTimeoutValue" SG_ 618 EPB_ExtAvailable 0;
BA_ "Remark" SG_ 618 EPB_ExtAvailable "涉及ID管理表";
BA_ "EventCommandSignal" SG_ 618 EPB_DynamicApplySt 0;
BA_ "GatewayedSignals" SG_ 618 EPB_DynamicApplySt 0;
BA_ "GenSigInactiveValue" SG_ 618 EPB_DynamicApplySt 0;
BA_ "GenSigInvalidValue" SG_ 618 EPB_DynamicApplySt 0;
BA_ "GenSigSendType" SG_ 618 EPB_DynamicApplySt 1;
BA_ "GenSigStartValue" SG_ 618 EPB_DynamicApplySt 0;
BA_ "GenSigTimeoutValue" SG_ 618 EPB_DynamicApplySt 0;
BA_ "Remark" SG_ 618 EPB_DynamicApplySt "涉及ID管理表";
BA_ "EventCommandSignal" SG_ 618 EPB_ActuatorSt_R 0;
BA_ "GatewayedSignals" SG_ 618 EPB_ActuatorSt_R 0;
BA_ "GenSigInactiveValue" SG_ 618 EPB_ActuatorSt_R 0;
BA_ "GenSigInvalidValue" SG_ 618 EPB_ActuatorSt_R 0;
BA_ "GenSigSendType" SG_ 618 EPB_ActuatorSt_R 1;
BA_ "GenSigStartValue" SG_ 618 EPB_ActuatorSt_R 0;
BA_ "GenSigTimeoutValue" SG_ 618 EPB_ActuatorSt_R 0;
BA_ "Remark" SG_ 618 EPB_ActuatorSt_R "涉及ID管理表";
BA_ "EventCommandSignal" SG_ 618 EPB_RWUActvSts 0;
BA_ "GatewayedSignals" SG_ 618 EPB_RWUActvSts 0;
BA_ "GenSigInactiveValue" SG_ 618 EPB_RWUActvSts 0;
BA_ "GenSigInvalidValue" SG_ 618 EPB_RWUActvSts 0;
BA_ "GenSigSendType" SG_ 618 EPB_RWUActvSts 1;
BA_ "GenSigStartValue" SG_ 618 EPB_RWUActvSts 0;
BA_ "GenSigTimeoutValue" SG_ 618 EPB_RWUActvSts 0;
BA_ "Remark" SG_ 618 EPB_RWUActvSts "涉及ID管理表";
BA_ "EventCommandSignal" SG_ 618 EPB_RWUAvl 0;
BA_ "GatewayedSignals" SG_ 618 EPB_RWUAvl 0;
BA_ "GenSigInactiveValue" SG_ 618 EPB_RWUAvl 0;
BA_ "GenSigInvalidValue" SG_ 618 EPB_RWUAvl 0;
BA_ "GenSigSendType" SG_ 618 EPB_RWUAvl 1;
BA_ "GenSigStartValue" SG_ 618 EPB_RWUAvl 0;
BA_ "GenSigTimeoutValue" SG_ 618 EPB_RWUAvl 0;
BA_ "Remark" SG_ 618 EPB_RWUAvl "涉及ID管理表";
BA_ "EventCommandSignal" SG_ 618 EPB_RPAAVPAvailability 0;
BA_ "GatewayedSignals" SG_ 618 EPB_RPAAVPAvailability 0;
BA_ "GenSigInactiveValue" SG_ 618 EPB_RPAAVPAvailability 0;
BA_ "GenSigInvalidValue" SG_ 618 EPB_RPAAVPAvailability 0;
BA_ "GenSigSendType" SG_ 618 EPB_RPAAVPAvailability 1;
BA_ "GenSigStartValue" SG_ 618 EPB_RPAAVPAvailability 0;
BA_ "GenSigTimeoutValue" SG_ 618 EPB_RPAAVPAvailability 0;
BA_ "Remark" SG_ 618 EPB_RPAAVPAvailability "涉及ID管理表";
BA_ "EventCommandSignal" SG_ 618 EPB_APAAvailability 0;
BA_ "GatewayedSignals" SG_ 618 EPB_APAAvailability 0;
BA_ "GenSigInactiveValue" SG_ 618 EPB_APAAvailability 0;
BA_ "GenSigInvalidValue" SG_ 618 EPB_APAAvailability 0;
BA_ "GenSigSendType" SG_ 618 EPB_APAAvailability 1;
BA_ "GenSigStartValue" SG_ 618 EPB_APAAvailability 0;
BA_ "GenSigTimeoutValue" SG_ 618 EPB_APAAvailability 0;
BA_ "Remark" SG_ 618 EPB_APAAvailability "涉及ID管理表";
BA_ "EventCommandSignal" SG_ 904 ACU_PCS_SVM_MODCmd 0;
BA_ "GatewayedSignals" SG_ 904 ACU_PCS_SVM_MODCmd 0;
BA_ "GenSigInactiveValue" SG_ 904 ACU_PCS_SVM_MODCmd 0;
BA_ "GenSigInvalidValue" SG_ 904 ACU_PCS_SVM_MODCmd 0;
BA_ "GenSigSendType" SG_ 904 ACU_PCS_SVM_MODCmd 1;
BA_ "GenSigStartValue" SG_ 904 ACU_PCS_SVM_MODCmd 0;
BA_ "GenSigTimeoutValue" SG_ 904 ACU_PCS_SVM_MODCmd 0;
BA_ "Remark" SG_ 904 ACU_PCS_SVM_MODCmd "";
BA_ "EventCommandSignal" SG_ 904 ACU_HeadLightVirtualSwSt 0;
BA_ "GatewayedSignals" SG_ 904 ACU_HeadLightVirtualSwSt 0;
BA_ "GenSigInactiveValue" SG_ 904 ACU_HeadLightVirtualSwSt 0;
BA_ "GenSigInvalidValue" SG_ 904 ACU_HeadLightVirtualSwSt 0;
BA_ "GenSigSendType" SG_ 904 ACU_HeadLightVirtualSwSt 1;
BA_ "GenSigStartValue" SG_ 904 ACU_HeadLightVirtualSwSt 0;
BA_ "GenSigTimeoutValue" SG_ 904 ACU_HeadLightVirtualSwSt 0;
BA_ "Remark" SG_ 904 ACU_HeadLightVirtualSwSt "";
BA_ "EventCommandSignal" SG_ 904 ACU_FrontFogLightVirtualSwSt 0;
BA_ "GatewayedSignals" SG_ 904 ACU_FrontFogLightVirtualSwSt 0;
BA_ "GenSigInactiveValue" SG_ 904 ACU_FrontFogLightVirtualSwSt 0;
BA_ "GenSigInvalidValue" SG_ 904 ACU_FrontFogLightVirtualSwSt 0;
BA_ "GenSigSendType" SG_ 904 ACU_FrontFogLightVirtualSwSt 1;
BA_ "GenSigStartValue" SG_ 904 ACU_FrontFogLightVirtualSwSt 0;
BA_ "GenSigTimeoutValue" SG_ 904 ACU_FrontFogLightVirtualSwSt 0;
BA_ "Remark" SG_ 904 ACU_FrontFogLightVirtualSwSt "";
BA_ "EventCommandSignal" SG_ 904 ACU_RearFogLightVirtualSwSt 0;
BA_ "GatewayedSignals" SG_ 904 ACU_RearFogLightVirtualSwSt 0;
BA_ "GenSigInactiveValue" SG_ 904 ACU_RearFogLightVirtualSwSt 0;
BA_ "GenSigInvalidValue" SG_ 904 ACU_RearFogLightVirtualSwSt 0;
BA_ "GenSigSendType" SG_ 904 ACU_RearFogLightVirtualSwSt 1;
BA_ "GenSigStartValue" SG_ 904 ACU_RearFogLightVirtualSwSt 0;
BA_ "GenSigTimeoutValue" SG_ 904 ACU_RearFogLightVirtualSwSt 0;
BA_ "Remark" SG_ 904 ACU_RearFogLightVirtualSwSt "";
BA_ "EventCommandSignal" SG_ 904 ACU_Account_Uid 0;
BA_ "GatewayedSignals" SG_ 904 ACU_Account_Uid 0;
BA_ "GenSigInactiveValue" SG_ 904 ACU_Account_Uid 0;
BA_ "GenSigInvalidValue" SG_ 904 ACU_Account_Uid 0;
BA_ "GenSigSendType" SG_ 904 ACU_Account_Uid 1;
BA_ "GenSigStartValue" SG_ 904 ACU_Account_Uid 0;
BA_ "GenSigTimeoutValue" SG_ 904 ACU_Account_Uid 0;
BA_ "Remark" SG_ 904 ACU_Account_Uid "";
BA_ "EventCommandSignal" SG_ 904 ACU_IHBC_SwitchReq 0;
BA_ "GatewayedSignals" SG_ 904 ACU_IHBC_SwitchReq 0;
BA_ "GenSigInactiveValue" SG_ 904 ACU_IHBC_SwitchReq 0;
BA_ "GenSigInvalidValue" SG_ 904 ACU_IHBC_SwitchReq 0;
BA_ "GenSigSendType" SG_ 904 ACU_IHBC_SwitchReq 1;
BA_ "GenSigStartValue" SG_ 904 ACU_IHBC_SwitchReq 0;
BA_ "GenSigTimeoutValue" SG_ 904 ACU_IHBC_SwitchReq 0;
BA_ "Remark" SG_ 904 ACU_IHBC_SwitchReq "";
BA_ "EventCommandSignal" SG_ 904 ACU_NDASwitchReq 0;
BA_ "GatewayedSignals" SG_ 904 ACU_NDASwitchReq 0;
BA_ "GenSigInactiveValue" SG_ 904 ACU_NDASwitchReq 0;
BA_ "GenSigInvalidValue" SG_ 904 ACU_NDASwitchReq 0;
BA_ "GenSigSendType" SG_ 904 ACU_NDASwitchReq 1;
BA_ "GenSigStartValue" SG_ 904 ACU_NDASwitchReq 0;
BA_ "GenSigTimeoutValue" SG_ 904 ACU_NDASwitchReq 0;
BA_ "Remark" SG_ 904 ACU_NDASwitchReq "";
BA_ "EventCommandSignal" SG_ 904 ACU_NDALCConSwitchReq 0;
BA_ "GatewayedSignals" SG_ 904 ACU_NDALCConSwitchReq 0;
BA_ "GenSigInactiveValue" SG_ 904 ACU_NDALCConSwitchReq 0;
BA_ "GenSigInvalidValue" SG_ 904 ACU_NDALCConSwitchReq 0;
BA_ "GenSigSendType" SG_ 904 ACU_NDALCConSwitchReq 1;
BA_ "GenSigStartValue" SG_ 904 ACU_NDALCConSwitchReq 0;
BA_ "GenSigTimeoutValue" SG_ 904 ACU_NDALCConSwitchReq 0;
BA_ "Remark" SG_ 904 ACU_NDALCConSwitchReq "";
BA_ "EventCommandSignal" SG_ 904 ACU_NDALCStySwitchReq 0;
BA_ "GatewayedSignals" SG_ 904 ACU_NDALCStySwitchReq 0;
BA_ "GenSigInactiveValue" SG_ 904 ACU_NDALCStySwitchReq 0;
BA_ "GenSigInvalidValue" SG_ 904 ACU_NDALCStySwitchReq 0;
BA_ "GenSigSendType" SG_ 904 ACU_NDALCStySwitchReq 1;
BA_ "GenSigStartValue" SG_ 904 ACU_NDALCStySwitchReq 0;
BA_ "GenSigTimeoutValue" SG_ 904 ACU_NDALCStySwitchReq 0;
BA_ "Remark" SG_ 904 ACU_NDALCStySwitchReq "";
BA_ "EventCommandSignal" SG_ 904 ACU_ADASWarnTypeSwitch 0;
BA_ "GatewayedSignals" SG_ 904 ACU_ADASWarnTypeSwitch 0;
BA_ "GenSigInactiveValue" SG_ 904 ACU_ADASWarnTypeSwitch 0;
BA_ "GenSigInvalidValue" SG_ 904 ACU_ADASWarnTypeSwitch 0;
BA_ "GenSigSendType" SG_ 904 ACU_ADASWarnTypeSwitch 1;
BA_ "GenSigStartValue" SG_ 904 ACU_ADASWarnTypeSwitch 0;
BA_ "GenSigTimeoutValue" SG_ 904 ACU_ADASWarnTypeSwitch 0;
BA_ "Remark" SG_ 904 ACU_ADASWarnTypeSwitch "";
BA_ "EventCommandSignal" SG_ 904 ACU_iACC_StyleConfirmSwitchReq 0;
BA_ "GatewayedSignals" SG_ 904 ACU_iACC_StyleConfirmSwitchReq 0;
BA_ "GenSigInactiveValue" SG_ 904 ACU_iACC_StyleConfirmSwitchReq 0;
BA_ "GenSigInvalidValue" SG_ 904 ACU_iACC_StyleConfirmSwitchReq 0;
BA_ "GenSigSendType" SG_ 904 ACU_iACC_StyleConfirmSwitchReq 1;
BA_ "GenSigStartValue" SG_ 904 ACU_iACC_StyleConfirmSwitchReq 3;
BA_ "GenSigTimeoutValue" SG_ 904 ACU_iACC_StyleConfirmSwitchReq 0;
BA_ "Remark" SG_ 904 ACU_iACC_StyleConfirmSwitchReq "";
BA_ "EventCommandSignal" SG_ 904 ACU_IFC_SpeedLimit 0;
BA_ "GatewayedSignals" SG_ 904 ACU_IFC_SpeedLimit 0;
BA_ "GenSigInactiveValue" SG_ 904 ACU_IFC_SpeedLimit 0;
BA_ "GenSigInvalidValue" SG_ 904 ACU_IFC_SpeedLimit 0;
BA_ "GenSigSendType" SG_ 904 ACU_IFC_SpeedLimit 1;
BA_ "GenSigStartValue" SG_ 904 ACU_IFC_SpeedLimit 0;
BA_ "GenSigTimeoutValue" SG_ 904 ACU_IFC_SpeedLimit 0;
BA_ "Remark" SG_ 904 ACU_IFC_SpeedLimit "";
BA_ "EventCommandSignal" SG_ 904 ACU_IFC_ISDRestOfdis 0;
BA_ "GatewayedSignals" SG_ 904 ACU_IFC_ISDRestOfdis 0;
BA_ "GenSigInactiveValue" SG_ 904 ACU_IFC_ISDRestOfdis 0;
BA_ "GenSigInvalidValue" SG_ 904 ACU_IFC_ISDRestOfdis 0;
BA_ "GenSigSendType" SG_ 904 ACU_IFC_ISDRestOfdis 1;
BA_ "GenSigStartValue" SG_ 904 ACU_IFC_ISDRestOfdis 0;
BA_ "GenSigTimeoutValue" SG_ 904 ACU_IFC_ISDRestOfdis 0;
BA_ "Remark" SG_ 904 ACU_IFC_ISDRestOfdis "";
BA_ "EventCommandSignal" SG_ 904 ACU_IFC_SpeedLimitUnit 0;
BA_ "GatewayedSignals" SG_ 904 ACU_IFC_SpeedLimitUnit 0;
BA_ "GenSigInactiveValue" SG_ 904 ACU_IFC_SpeedLimitUnit 0;
BA_ "GenSigInvalidValue" SG_ 904 ACU_IFC_SpeedLimitUnit 0;
BA_ "GenSigSendType" SG_ 904 ACU_IFC_SpeedLimitUnit 1;
BA_ "GenSigStartValue" SG_ 904 ACU_IFC_SpeedLimitUnit 0;
BA_ "GenSigTimeoutValue" SG_ 904 ACU_IFC_SpeedLimitUnit 1;
BA_ "Remark" SG_ 904 ACU_IFC_SpeedLimitUnit "";
BA_ "EventCommandSignal" SG_ 904 ACU_ThemeType 0;
BA_ "GatewayedSignals" SG_ 904 ACU_ThemeType 0;
BA_ "GenSigInactiveValue" SG_ 904 ACU_ThemeType 0;
BA_ "GenSigInvalidValue" SG_ 904 ACU_ThemeType 0;
BA_ "GenSigSendType" SG_ 904 ACU_ThemeType 1;
BA_ "GenSigStartValue" SG_ 904 ACU_ThemeType 0;
BA_ "GenSigTimeoutValue" SG_ 904 ACU_ThemeType 0;
BA_ "Remark" SG_ 904 ACU_ThemeType "";
BA_ "EventCommandSignal" SG_ 904 ACU_IFC_SpeedLimtType 0;
BA_ "GatewayedSignals" SG_ 904 ACU_IFC_SpeedLimtType 0;
BA_ "GenSigInactiveValue" SG_ 904 ACU_IFC_SpeedLimtType 0;
BA_ "GenSigInvalidValue" SG_ 904 ACU_IFC_SpeedLimtType 0;
BA_ "GenSigSendType" SG_ 904 ACU_IFC_SpeedLimtType 1;
BA_ "GenSigStartValue" SG_ 904 ACU_IFC_SpeedLimtType 0;
BA_ "GenSigTimeoutValue" SG_ 904 ACU_IFC_SpeedLimtType 0;
BA_ "Remark" SG_ 904 ACU_IFC_SpeedLimtType "";
BA_ "EventCommandSignal" SG_ 904 ACU_IFC_RoadType 0;
BA_ "GatewayedSignals" SG_ 904 ACU_IFC_RoadType 0;
BA_ "GenSigInactiveValue" SG_ 904 ACU_IFC_RoadType 0;
BA_ "GenSigInvalidValue" SG_ 904 ACU_IFC_RoadType 0;
BA_ "GenSigSendType" SG_ 904 ACU_IFC_RoadType 1;
BA_ "GenSigStartValue" SG_ 904 ACU_IFC_RoadType 0;
BA_ "GenSigTimeoutValue" SG_ 904 ACU_IFC_RoadType 0;
BA_ "Remark" SG_ 904 ACU_IFC_RoadType "";
BA_ "EventCommandSignal" SG_ 904 ACU_IFC_ZoneCode 0;
BA_ "GatewayedSignals" SG_ 904 ACU_IFC_ZoneCode 0;
BA_ "GenSigInactiveValue" SG_ 904 ACU_IFC_ZoneCode 0;
BA_ "GenSigInvalidValue" SG_ 904 ACU_IFC_ZoneCode 0;
BA_ "GenSigSendType" SG_ 904 ACU_IFC_ZoneCode 1;
BA_ "GenSigStartValue" SG_ 904 ACU_IFC_ZoneCode 0;
BA_ "GenSigTimeoutValue" SG_ 904 ACU_IFC_ZoneCode 1;
BA_ "Remark" SG_ 904 ACU_IFC_ZoneCode "";
BA_ "EventCommandSignal" SG_ 904 ACU_IFC_NaviSt 0;
BA_ "GatewayedSignals" SG_ 904 ACU_IFC_NaviSt 0;
BA_ "GenSigInactiveValue" SG_ 904 ACU_IFC_NaviSt 0;
BA_ "GenSigInvalidValue" SG_ 904 ACU_IFC_NaviSt 0;
BA_ "GenSigSendType" SG_ 904 ACU_IFC_NaviSt 1;
BA_ "GenSigStartValue" SG_ 904 ACU_IFC_NaviSt 0;
BA_ "GenSigTimeoutValue" SG_ 904 ACU_IFC_NaviSt 0;
BA_ "Remark" SG_ 904 ACU_IFC_NaviSt "";
BA_ "EventCommandSignal" SG_ 904 ACU_IFC_NaviCorp 0;
BA_ "GatewayedSignals" SG_ 904 ACU_IFC_NaviCorp 0;
BA_ "GenSigInactiveValue" SG_ 904 ACU_IFC_NaviCorp 0;
BA_ "GenSigInvalidValue" SG_ 904 ACU_IFC_NaviCorp 0;
BA_ "GenSigSendType" SG_ 904 ACU_IFC_NaviCorp 1;
BA_ "GenSigStartValue" SG_ 904 ACU_IFC_NaviCorp 0;
BA_ "GenSigTimeoutValue" SG_ 904 ACU_IFC_NaviCorp 0;
BA_ "Remark" SG_ 904 ACU_IFC_NaviCorp "";
BA_ "EventCommandSignal" SG_ 904 ACU_IFC_NaviNewIconDis 0;
BA_ "GatewayedSignals" SG_ 904 ACU_IFC_NaviNewIconDis 0;
BA_ "GenSigInactiveValue" SG_ 904 ACU_IFC_NaviNewIconDis 0;
BA_ "GenSigInvalidValue" SG_ 904 ACU_IFC_NaviNewIconDis 0;
BA_ "GenSigSendType" SG_ 904 ACU_IFC_NaviNewIconDis 1;
BA_ "GenSigStartValue" SG_ 904 ACU_IFC_NaviNewIconDis 0;
BA_ "GenSigTimeoutValue" SG_ 904 ACU_IFC_NaviNewIconDis 0;
BA_ "Remark" SG_ 904 ACU_IFC_NaviNewIconDis "";
BA_ "EventCommandSignal" SG_ 904 ACU_IFC_OfframpSt 0;
BA_ "GatewayedSignals" SG_ 904 ACU_IFC_OfframpSt 0;
BA_ "GenSigInactiveValue" SG_ 904 ACU_IFC_OfframpSt 0;
BA_ "GenSigInvalidValue" SG_ 904 ACU_IFC_OfframpSt 0;
BA_ "GenSigSendType" SG_ 904 ACU_IFC_OfframpSt 1;
BA_ "GenSigStartValue" SG_ 904 ACU_IFC_OfframpSt 0;
BA_ "GenSigTimeoutValue" SG_ 904 ACU_IFC_OfframpSt 0;
BA_ "Remark" SG_ 904 ACU_IFC_OfframpSt "";
BA_ "EventCommandSignal" SG_ 904 ACU_IFC_NaviNewIcon 0;
BA_ "GatewayedSignals" SG_ 904 ACU_IFC_NaviNewIcon 0;
BA_ "GenSigInactiveValue" SG_ 904 ACU_IFC_NaviNewIcon 0;
BA_ "GenSigInvalidValue" SG_ 904 ACU_IFC_NaviNewIcon 0;
BA_ "GenSigSendType" SG_ 904 ACU_IFC_NaviNewIcon 1;
BA_ "GenSigStartValue" SG_ 904 ACU_IFC_NaviNewIcon 0;
BA_ "GenSigTimeoutValue" SG_ 904 ACU_IFC_NaviNewIcon 0;
BA_ "Remark" SG_ 904 ACU_IFC_NaviNewIcon "";
BA_ "EventCommandSignal" SG_ 904 ACU_IFC_SLCAheadDis 0;
BA_ "GatewayedSignals" SG_ 904 ACU_IFC_SLCAheadDis 0;
BA_ "GenSigInactiveValue" SG_ 904 ACU_IFC_SLCAheadDis 0;
BA_ "GenSigInvalidValue" SG_ 904 ACU_IFC_SLCAheadDis 0;
BA_ "GenSigSendType" SG_ 904 ACU_IFC_SLCAheadDis 1;
BA_ "GenSigStartValue" SG_ 904 ACU_IFC_SLCAheadDis 0;
BA_ "GenSigTimeoutValue" SG_ 904 ACU_IFC_SLCAheadDis 0;
BA_ "Remark" SG_ 904 ACU_IFC_SLCAheadDis "";
BA_ "EventCommandSignal" SG_ 904 ACU_DVR_Switch 0;
BA_ "GatewayedSignals" SG_ 904 ACU_DVR_Switch 0;
BA_ "GenSigInactiveValue" SG_ 904 ACU_DVR_Switch 0;
BA_ "GenSigInvalidValue" SG_ 904 ACU_DVR_Switch 0;
BA_ "GenSigSendType" SG_ 904 ACU_DVR_Switch 1;
BA_ "GenSigStartValue" SG_ 904 ACU_DVR_Switch 0;
BA_ "GenSigTimeoutValue" SG_ 904 ACU_DVR_Switch 0;
BA_ "Remark" SG_ 904 ACU_DVR_Switch "";
BA_ "EventCommandSignal" SG_ 904 ACU_IFC_OfframpDis 0;
BA_ "GatewayedSignals" SG_ 904 ACU_IFC_OfframpDis 0;
BA_ "GenSigInactiveValue" SG_ 904 ACU_IFC_OfframpDis 0;
BA_ "GenSigInvalidValue" SG_ 904 ACU_IFC_OfframpDis 0;
BA_ "GenSigSendType" SG_ 904 ACU_IFC_OfframpDis 1;
BA_ "GenSigStartValue" SG_ 904 ACU_IFC_OfframpDis 254;
BA_ "GenSigTimeoutValue" SG_ 904 ACU_IFC_OfframpDis 254;
BA_ "Remark" SG_ 904 ACU_IFC_OfframpDis "";
BA_ "EventCommandSignal" SG_ 904 SSW_DRSeatSlideCurrentPst 0;
BA_ "GatewayedSignals" SG_ 904 SSW_DRSeatSlideCurrentPst 0;
BA_ "GenSigInactiveValue" SG_ 904 SSW_DRSeatSlideCurrentPst 0;
BA_ "GenSigInvalidValue" SG_ 904 SSW_DRSeatSlideCurrentPst 0;
BA_ "GenSigSendType" SG_ 904 SSW_DRSeatSlideCurrentPst 1;
BA_ "GenSigStartValue" SG_ 904 SSW_DRSeatSlideCurrentPst 255;
BA_ "GenSigTimeoutValue" SG_ 904 SSW_DRSeatSlideCurrentPst 0;
BA_ "Remark" SG_ 904 SSW_DRSeatSlideCurrentPst "";
BA_ "EventCommandSignal" SG_ 904 SSW_DRSeatHeightCurrentPst 0;
BA_ "GatewayedSignals" SG_ 904 SSW_DRSeatHeightCurrentPst 0;
BA_ "GenSigInactiveValue" SG_ 904 SSW_DRSeatHeightCurrentPst 0;
BA_ "GenSigInvalidValue" SG_ 904 SSW_DRSeatHeightCurrentPst 0;
BA_ "GenSigSendType" SG_ 904 SSW_DRSeatHeightCurrentPst 1;
BA_ "GenSigStartValue" SG_ 904 SSW_DRSeatHeightCurrentPst 255;
BA_ "GenSigTimeoutValue" SG_ 904 SSW_DRSeatHeightCurrentPst 0;
BA_ "Remark" SG_ 904 SSW_DRSeatHeightCurrentPst "";
BA_ "EventCommandSignal" SG_ 904 SSW_DRSeatBackrestCurrentPst 0;
BA_ "GatewayedSignals" SG_ 904 SSW_DRSeatBackrestCurrentPst 0;
BA_ "GenSigInactiveValue" SG_ 904 SSW_DRSeatBackrestCurrentPst 0;
BA_ "GenSigInvalidValue" SG_ 904 SSW_DRSeatBackrestCurrentPst 0;
BA_ "GenSigSendType" SG_ 904 SSW_DRSeatBackrestCurrentPst 1;
BA_ "GenSigStartValue" SG_ 904 SSW_DRSeatBackrestCurrentPst 255;
BA_ "GenSigTimeoutValue" SG_ 904 SSW_DRSeatBackrestCurrentPst 0;
BA_ "Remark" SG_ 904 SSW_DRSeatBackrestCurrentPst "";
BA_ "EventCommandSignal" SG_ 904 DrvrSideMotResp 0;
BA_ "GatewayedSignals" SG_ 904 DrvrSideMotResp 0;
BA_ "GenSigInactiveValue" SG_ 904 DrvrSideMotResp 0;
BA_ "GenSigInvalidValue" SG_ 904 DrvrSideMotResp 0;
BA_ "GenSigSendType" SG_ 904 DrvrSideMotResp 1;
BA_ "GenSigStartValue" SG_ 904 DrvrSideMotResp 0;
BA_ "GenSigTimeoutValue" SG_ 904 DrvrSideMotResp 15;
BA_ "Remark" SG_ 904 DrvrSideMotResp "";
BA_ "EventCommandSignal" SG_ 904 IPDS_BAT1PowerSt 0;
BA_ "GatewayedSignals" SG_ 904 IPDS_BAT1PowerSt 0;
BA_ "GenSigInactiveValue" SG_ 904 IPDS_BAT1PowerSt 0;
BA_ "GenSigInvalidValue" SG_ 904 IPDS_BAT1PowerSt 0;
BA_ "GenSigSendType" SG_ 904 IPDS_BAT1PowerSt 1;
BA_ "GenSigStartValue" SG_ 904 IPDS_BAT1PowerSt 1;
BA_ "GenSigTimeoutValue" SG_ 904 IPDS_BAT1PowerSt 0;
BA_ "Remark" SG_ 904 IPDS_BAT1PowerSt "";
BA_ "EventCommandSignal" SG_ 904 IPDS_BAT2PowerSt 0;
BA_ "GatewayedSignals" SG_ 904 IPDS_BAT2PowerSt 0;
BA_ "GenSigInactiveValue" SG_ 904 IPDS_BAT2PowerSt 0;
BA_ "GenSigInvalidValue" SG_ 904 IPDS_BAT2PowerSt 0;
BA_ "GenSigSendType" SG_ 904 IPDS_BAT2PowerSt 1;
BA_ "GenSigStartValue" SG_ 904 IPDS_BAT2PowerSt 1;
BA_ "GenSigTimeoutValue" SG_ 904 IPDS_BAT2PowerSt 0;
BA_ "Remark" SG_ 904 IPDS_BAT2PowerSt "";
BA_ "EventCommandSignal" SG_ 904 IPDS_DCDC2PowerSt 0;
BA_ "GatewayedSignals" SG_ 904 IPDS_DCDC2PowerSt 0;
BA_ "GenSigInactiveValue" SG_ 904 IPDS_DCDC2PowerSt 0;
BA_ "GenSigInvalidValue" SG_ 904 IPDS_DCDC2PowerSt 0;
BA_ "GenSigSendType" SG_ 904 IPDS_DCDC2PowerSt 1;
BA_ "GenSigStartValue" SG_ 904 IPDS_DCDC2PowerSt 1;
BA_ "GenSigTimeoutValue" SG_ 904 IPDS_DCDC2PowerSt 0;
BA_ "Remark" SG_ 904 IPDS_DCDC2PowerSt "";
BA_ "EventCommandSignal" SG_ 904 IPDS_GridIsoPowerSt 0;
BA_ "GatewayedSignals" SG_ 904 IPDS_GridIsoPowerSt 0;
BA_ "GenSigInactiveValue" SG_ 904 IPDS_GridIsoPowerSt 0;
BA_ "GenSigInvalidValue" SG_ 904 IPDS_GridIsoPowerSt 0;
BA_ "GenSigSendType" SG_ 904 IPDS_GridIsoPowerSt 1;
BA_ "GenSigStartValue" SG_ 904 IPDS_GridIsoPowerSt 1;
BA_ "GenSigTimeoutValue" SG_ 904 IPDS_GridIsoPowerSt 1;
BA_ "Remark" SG_ 904 IPDS_GridIsoPowerSt "";
BA_ "EventCommandSignal" SG_ 391 DCUR_1_CRC 0;
BA_ "GatewayedSignals" SG_ 391 DCUR_1_CRC 0;
BA_ "GenSigInactiveValue" SG_ 391 DCUR_1_CRC 0;
BA_ "GenSigInvalidValue" SG_ 391 DCUR_1_CRC 0;
BA_ "GenSigSendType" SG_ 391 DCUR_1_CRC 1;
BA_ "GenSigStartValue" SG_ 391 DCUR_1_CRC 0;
BA_ "GenSigTimeoutValue" SG_ 391 DCUR_1_CRC 0;
BA_ "Remark" SG_ 391 DCUR_1_CRC "";
BA_ "EventCommandSignal" SG_ 391 DCUR_1_Counter 0;
BA_ "GatewayedSignals" SG_ 391 DCUR_1_Counter 0;
BA_ "GenSigInactiveValue" SG_ 391 DCUR_1_Counter 0;
BA_ "GenSigInvalidValue" SG_ 391 DCUR_1_Counter 0;
BA_ "GenSigSendType" SG_ 391 DCUR_1_Counter 1;
BA_ "GenSigStartValue" SG_ 391 DCUR_1_Counter 0;
BA_ "GenSigTimeoutValue" SG_ 391 DCUR_1_Counter 0;
BA_ "Remark" SG_ 391 DCUR_1_Counter "";
BA_ "EventCommandSignal" SG_ 391 DCUR_RotSpdAct 0;
BA_ "GatewayedSignals" SG_ 391 DCUR_RotSpdAct 0;
BA_ "GenSigInactiveValue" SG_ 391 DCUR_RotSpdAct 0;
BA_ "GenSigInvalidValue" SG_ 391 DCUR_RotSpdAct 65535;
BA_ "GenSigSendType" SG_ 391 DCUR_RotSpdAct 1;
BA_ "GenSigStartValue" SG_ 391 DCUR_RotSpdAct 32767;
BA_ "GenSigTimeoutValue" SG_ 391 DCUR_RotSpdAct 0;
BA_ "Remark" SG_ 391 DCUR_RotSpdAct "";
BA_ "EventCommandSignal" SG_ 391 DCUR_DiagErrCode 0;
BA_ "GatewayedSignals" SG_ 391 DCUR_DiagErrCode 0;
BA_ "GenSigInactiveValue" SG_ 391 DCUR_DiagErrCode 0;
BA_ "GenSigInvalidValue" SG_ 391 DCUR_DiagErrCode 0;
BA_ "GenSigSendType" SG_ 391 DCUR_DiagErrCode 1;
BA_ "GenSigStartValue" SG_ 391 DCUR_DiagErrCode 0;
BA_ "GenSigTimeoutValue" SG_ 391 DCUR_DiagErrCode 0;
BA_ "Remark" SG_ 391 DCUR_DiagErrCode "";
BA_ "EventCommandSignal" SG_ 391 DCUR_ModeSt 0;
BA_ "GatewayedSignals" SG_ 391 DCUR_ModeSt 0;
BA_ "GenSigInactiveValue" SG_ 391 DCUR_ModeSt 0;
BA_ "GenSigInvalidValue" SG_ 391 DCUR_ModeSt 0;
BA_ "GenSigSendType" SG_ 391 DCUR_ModeSt 1;
BA_ "GenSigStartValue" SG_ 391 DCUR_ModeSt 1;
BA_ "GenSigTimeoutValue" SG_ 391 DCUR_ModeSt 0;
BA_ "Remark" SG_ 391 DCUR_ModeSt "";
BA_ "EventCommandSignal" SG_ 391 DCUR_ADC_MCUBlkst 0;
BA_ "GatewayedSignals" SG_ 391 DCUR_ADC_MCUBlkst 0;
BA_ "GenSigInactiveValue" SG_ 391 DCUR_ADC_MCUBlkst 0;
BA_ "GenSigInvalidValue" SG_ 391 DCUR_ADC_MCUBlkst 7;
BA_ "GenSigSendType" SG_ 391 DCUR_ADC_MCUBlkst 1;
BA_ "GenSigStartValue" SG_ 391 DCUR_ADC_MCUBlkst 0;
BA_ "GenSigTimeoutValue" SG_ 391 DCUR_ADC_MCUBlkst 0;
BA_ "Remark" SG_ 391 DCUR_ADC_MCUBlkst "";
BA_ "EventCommandSignal" SG_ 391 DCUR_ADC_SpdSvModAvl 0;
BA_ "GatewayedSignals" SG_ 391 DCUR_ADC_SpdSvModAvl 0;
BA_ "GenSigInactiveValue" SG_ 391 DCUR_ADC_SpdSvModAvl 0;
BA_ "GenSigInvalidValue" SG_ 391 DCUR_ADC_SpdSvModAvl 1;
BA_ "GenSigSendType" SG_ 391 DCUR_ADC_SpdSvModAvl 1;
BA_ "GenSigStartValue" SG_ 391 DCUR_ADC_SpdSvModAvl 0;
BA_ "GenSigTimeoutValue" SG_ 391 DCUR_ADC_SpdSvModAvl 0;
BA_ "Remark" SG_ 391 DCUR_ADC_SpdSvModAvl "";
BA_ "EventCommandSignal" SG_ 391 DCUR_ADC_MCUStandstill 0;
BA_ "GatewayedSignals" SG_ 391 DCUR_ADC_MCUStandstill 0;
BA_ "GenSigInactiveValue" SG_ 391 DCUR_ADC_MCUStandstill 0;
BA_ "GenSigInvalidValue" SG_ 391 DCUR_ADC_MCUStandstill 1;
BA_ "GenSigSendType" SG_ 391 DCUR_ADC_MCUStandstill 1;
BA_ "GenSigStartValue" SG_ 391 DCUR_ADC_MCUStandstill 0;
BA_ "GenSigTimeoutValue" SG_ 391 DCUR_ADC_MCUStandstill 0;
BA_ "Remark" SG_ 391 DCUR_ADC_MCUStandstill "";
BA_ "EventCommandSignal" SG_ 391 DCUR_ADC_MCUSpdSVModFlt 0;
BA_ "GatewayedSignals" SG_ 391 DCUR_ADC_MCUSpdSVModFlt 0;
BA_ "GenSigInactiveValue" SG_ 391 DCUR_ADC_MCUSpdSVModFlt 0;
BA_ "GenSigInvalidValue" SG_ 391 DCUR_ADC_MCUSpdSVModFlt 7;
BA_ "GenSigSendType" SG_ 391 DCUR_ADC_MCUSpdSVModFlt 1;
BA_ "GenSigStartValue" SG_ 391 DCUR_ADC_MCUSpdSVModFlt 0;
BA_ "GenSigTimeoutValue" SG_ 391 DCUR_ADC_MCUSpdSVModFlt 0;
BA_ "Remark" SG_ 391 DCUR_ADC_MCUSpdSVModFlt "";
BA_ "EventCommandSignal" SG_ 391 DCUR_ADC_MCUVehSldSt 0;
BA_ "GatewayedSignals" SG_ 391 DCUR_ADC_MCUVehSldSt 0;
BA_ "GenSigInactiveValue" SG_ 391 DCUR_ADC_MCUVehSldSt 0;
BA_ "GenSigInvalidValue" SG_ 391 DCUR_ADC_MCUVehSldSt 1;
BA_ "GenSigSendType" SG_ 391 DCUR_ADC_MCUVehSldSt 1;
BA_ "GenSigStartValue" SG_ 391 DCUR_ADC_MCUVehSldSt 0;
BA_ "GenSigTimeoutValue" SG_ 391 DCUR_ADC_MCUVehSldSt 0;
BA_ "Remark" SG_ 391 DCUR_ADC_MCUVehSldSt "";
BA_ "EventCommandSignal" SG_ 391 DCUR_ADC_MCUReqTq 0;
BA_ "GatewayedSignals" SG_ 391 DCUR_ADC_MCUReqTq 0;
BA_ "GenSigInactiveValue" SG_ 391 DCUR_ADC_MCUReqTq 0;
BA_ "GenSigInvalidValue" SG_ 391 DCUR_ADC_MCUReqTq 2047;
BA_ "GenSigSendType" SG_ 391 DCUR_ADC_MCUReqTq 1;
BA_ "GenSigStartValue" SG_ 391 DCUR_ADC_MCUReqTq 1023;
BA_ "GenSigTimeoutValue" SG_ 391 DCUR_ADC_MCUReqTq 0;
BA_ "Remark" SG_ 391 DCUR_ADC_MCUReqTq "";
BA_ "EventCommandSignal" SG_ 728 ECS_1_CRC 0;
BA_ "GatewayedSignals" SG_ 728 ECS_1_CRC 0;
BA_ "GenSigInactiveValue" SG_ 728 ECS_1_CRC 0;
BA_ "GenSigInvalidValue" SG_ 728 ECS_1_CRC 0;
BA_ "GenSigSendType" SG_ 728 ECS_1_CRC 1;
BA_ "GenSigStartValue" SG_ 728 ECS_1_CRC 0;
BA_ "GenSigTimeoutValue" SG_ 728 ECS_1_CRC 0;
BA_ "Remark" SG_ 728 ECS_1_CRC "";
BA_ "EventCommandSignal" SG_ 728 ECS_1_Counter 0;
BA_ "GatewayedSignals" SG_ 728 ECS_1_Counter 0;
BA_ "GenSigInactiveValue" SG_ 728 ECS_1_Counter 0;
BA_ "GenSigInvalidValue" SG_ 728 ECS_1_Counter 0;
BA_ "GenSigSendType" SG_ 728 ECS_1_Counter 1;
BA_ "GenSigStartValue" SG_ 728 ECS_1_Counter 0;
BA_ "GenSigTimeoutValue" SG_ 728 ECS_1_Counter 0;
BA_ "Remark" SG_ 728 ECS_1_Counter "";
BA_ "EventCommandSignal" SG_ 728 CDC_ADCCtrlAvl 0;
BA_ "GatewayedSignals" SG_ 728 CDC_ADCCtrlAvl 0;
BA_ "GenSigInactiveValue" SG_ 728 CDC_ADCCtrlAvl 0;
BA_ "GenSigInvalidValue" SG_ 728 CDC_ADCCtrlAvl 0;
BA_ "GenSigSendType" SG_ 728 CDC_ADCCtrlAvl 1;
BA_ "GenSigStartValue" SG_ 728 CDC_ADCCtrlAvl 0;
BA_ "GenSigTimeoutValue" SG_ 728 CDC_ADCCtrlAvl 0;
BA_ "Remark" SG_ 728 CDC_ADCCtrlAvl "";
BA_ "EventCommandSignal" SG_ 728 CDC_ADCCtrlRespSts 0;
BA_ "GatewayedSignals" SG_ 728 CDC_ADCCtrlRespSts 0;
BA_ "GenSigInactiveValue" SG_ 728 CDC_ADCCtrlRespSts 0;
BA_ "GenSigInvalidValue" SG_ 728 CDC_ADCCtrlRespSts 0;
BA_ "GenSigSendType" SG_ 728 CDC_ADCCtrlRespSts 1;
BA_ "GenSigStartValue" SG_ 728 CDC_ADCCtrlRespSts 0;
BA_ "GenSigTimeoutValue" SG_ 728 CDC_ADCCtrlRespSts 0;
BA_ "Remark" SG_ 728 CDC_ADCCtrlRespSts "";
BA_ "EventCommandSignal" SG_ 728 CDC_ADCModState 0;
BA_ "GatewayedSignals" SG_ 728 CDC_ADCModState 0;
BA_ "GenSigInactiveValue" SG_ 728 CDC_ADCModState 0;
BA_ "GenSigInvalidValue" SG_ 728 CDC_ADCModState 0;
BA_ "GenSigSendType" SG_ 728 CDC_ADCModState 1;
BA_ "GenSigStartValue" SG_ 728 CDC_ADCModState 0;
BA_ "GenSigTimeoutValue" SG_ 728 CDC_ADCModState 0;
BA_ "Remark" SG_ 728 CDC_ADCModState "";
BA_ "EventCommandSignal" SG_ 459 ECS_2_CRC 0;
BA_ "GatewayedSignals" SG_ 459 ECS_2_CRC 0;
BA_ "GenSigInactiveValue" SG_ 459 ECS_2_CRC 0;
BA_ "GenSigInvalidValue" SG_ 459 ECS_2_CRC 0;
BA_ "GenSigSendType" SG_ 459 ECS_2_CRC 1;
BA_ "GenSigStartValue" SG_ 459 ECS_2_CRC 0;
BA_ "GenSigTimeoutValue" SG_ 459 ECS_2_CRC 0;
BA_ "Remark" SG_ 459 ECS_2_CRC "";
BA_ "EventCommandSignal" SG_ 459 ECS_2_Counter 0;
BA_ "GatewayedSignals" SG_ 459 ECS_2_Counter 0;
BA_ "GenSigInactiveValue" SG_ 459 ECS_2_Counter 0;
BA_ "GenSigInvalidValue" SG_ 459 ECS_2_Counter 0;
BA_ "GenSigSendType" SG_ 459 ECS_2_Counter 1;
BA_ "GenSigStartValue" SG_ 459 ECS_2_Counter 0;
BA_ "GenSigTimeoutValue" SG_ 459 ECS_2_Counter 0;
BA_ "Remark" SG_ 459 ECS_2_Counter "";
BA_ "EventCommandSignal" SG_ 459 AS_SuspHeightFL 0;
BA_ "GatewayedSignals" SG_ 459 AS_SuspHeightFL 0;
BA_ "GenSigInactiveValue" SG_ 459 AS_SuspHeightFL 0;
BA_ "GenSigInvalidValue" SG_ 459 AS_SuspHeightFL 4095;
BA_ "GenSigSendType" SG_ 459 AS_SuspHeightFL 1;
BA_ "GenSigStartValue" SG_ 459 AS_SuspHeightFL 0;
BA_ "GenSigTimeoutValue" SG_ 459 AS_SuspHeightFL 1500;
BA_ "Remark" SG_ 459 AS_SuspHeightFL "";
BA_ "EventCommandSignal" SG_ 459 AS_SuspHeightFR 0;
BA_ "GatewayedSignals" SG_ 459 AS_SuspHeightFR 0;
BA_ "GenSigInactiveValue" SG_ 459 AS_SuspHeightFR 0;
BA_ "GenSigInvalidValue" SG_ 459 AS_SuspHeightFR 4095;
BA_ "GenSigSendType" SG_ 459 AS_SuspHeightFR 1;
BA_ "GenSigStartValue" SG_ 459 AS_SuspHeightFR 0;
BA_ "GenSigTimeoutValue" SG_ 459 AS_SuspHeightFR 1500;
BA_ "Remark" SG_ 459 AS_SuspHeightFR "";
BA_ "EventCommandSignal" SG_ 459 AS_SuspHeightRL 0;
BA_ "GatewayedSignals" SG_ 459 AS_SuspHeightRL 0;
BA_ "GenSigInactiveValue" SG_ 459 AS_SuspHeightRL 0;
BA_ "GenSigInvalidValue" SG_ 459 AS_SuspHeightRL 4095;
BA_ "GenSigSendType" SG_ 459 AS_SuspHeightRL 1;
BA_ "GenSigStartValue" SG_ 459 AS_SuspHeightRL 0;
BA_ "GenSigTimeoutValue" SG_ 459 AS_SuspHeightRL 1500;
BA_ "Remark" SG_ 459 AS_SuspHeightRL "";
BA_ "EventCommandSignal" SG_ 459 AS_SuspHeightRR 0;
BA_ "GatewayedSignals" SG_ 459 AS_SuspHeightRR 0;
BA_ "GenSigInactiveValue" SG_ 459 AS_SuspHeightRR 0;
BA_ "GenSigInvalidValue" SG_ 459 AS_SuspHeightRR 4095;
BA_ "GenSigSendType" SG_ 459 AS_SuspHeightRR 1;
BA_ "GenSigStartValue" SG_ 459 AS_SuspHeightRR 0;
BA_ "GenSigTimeoutValue" SG_ 459 AS_SuspHeightRR 1500;
BA_ "Remark" SG_ 459 AS_SuspHeightRR "";
BA_ "EventCommandSignal" SG_ 459 AS_SuspHeightFLVD 0;
BA_ "GatewayedSignals" SG_ 459 AS_SuspHeightFLVD 0;
BA_ "GenSigInactiveValue" SG_ 459 AS_SuspHeightFLVD 0;
BA_ "GenSigInvalidValue" SG_ 459 AS_SuspHeightFLVD 0;
BA_ "GenSigSendType" SG_ 459 AS_SuspHeightFLVD 1;
BA_ "GenSigStartValue" SG_ 459 AS_SuspHeightFLVD 1;
BA_ "GenSigTimeoutValue" SG_ 459 AS_SuspHeightFLVD 0;
BA_ "Remark" SG_ 459 AS_SuspHeightFLVD "";
BA_ "EventCommandSignal" SG_ 459 AS_SuspHeightFRVD 0;
BA_ "GatewayedSignals" SG_ 459 AS_SuspHeightFRVD 0;
BA_ "GenSigInactiveValue" SG_ 459 AS_SuspHeightFRVD 0;
BA_ "GenSigInvalidValue" SG_ 459 AS_SuspHeightFRVD 0;
BA_ "GenSigSendType" SG_ 459 AS_SuspHeightFRVD 1;
BA_ "GenSigStartValue" SG_ 459 AS_SuspHeightFRVD 1;
BA_ "GenSigTimeoutValue" SG_ 459 AS_SuspHeightFRVD 0;
BA_ "Remark" SG_ 459 AS_SuspHeightFRVD "";
BA_ "EventCommandSignal" SG_ 459 AS_SuspHeightRLVD 0;
BA_ "GatewayedSignals" SG_ 459 AS_SuspHeightRLVD 0;
BA_ "GenSigInactiveValue" SG_ 459 AS_SuspHeightRLVD 0;
BA_ "GenSigInvalidValue" SG_ 459 AS_SuspHeightRLVD 0;
BA_ "GenSigSendType" SG_ 459 AS_SuspHeightRLVD 1;
BA_ "GenSigStartValue" SG_ 459 AS_SuspHeightRLVD 1;
BA_ "GenSigTimeoutValue" SG_ 459 AS_SuspHeightRLVD 0;
BA_ "Remark" SG_ 459 AS_SuspHeightRLVD "";
BA_ "EventCommandSignal" SG_ 459 AS_SuspHeightRRVD 0;
BA_ "GatewayedSignals" SG_ 459 AS_SuspHeightRRVD 0;
BA_ "GenSigInactiveValue" SG_ 459 AS_SuspHeightRRVD 0;
BA_ "GenSigInvalidValue" SG_ 459 AS_SuspHeightRRVD 0;
BA_ "GenSigSendType" SG_ 459 AS_SuspHeightRRVD 1;
BA_ "GenSigStartValue" SG_ 459 AS_SuspHeightRRVD 1;
BA_ "GenSigTimeoutValue" SG_ 459 AS_SuspHeightRRVD 0;
BA_ "Remark" SG_ 459 AS_SuspHeightRRVD "";
BA_ "EventCommandSignal" SG_ 459 AS_SuspHeightSensorFLSt 0;
BA_ "GatewayedSignals" SG_ 459 AS_SuspHeightSensorFLSt 0;
BA_ "GenSigInactiveValue" SG_ 459 AS_SuspHeightSensorFLSt 0;
BA_ "GenSigInvalidValue" SG_ 459 AS_SuspHeightSensorFLSt 0;
BA_ "GenSigSendType" SG_ 459 AS_SuspHeightSensorFLSt 1;
BA_ "GenSigStartValue" SG_ 459 AS_SuspHeightSensorFLSt 0;
BA_ "GenSigTimeoutValue" SG_ 459 AS_SuspHeightSensorFLSt 1;
BA_ "Remark" SG_ 459 AS_SuspHeightSensorFLSt "";
BA_ "EventCommandSignal" SG_ 459 AS_SuspHeightSensorFRSt 0;
BA_ "GatewayedSignals" SG_ 459 AS_SuspHeightSensorFRSt 0;
BA_ "GenSigInactiveValue" SG_ 459 AS_SuspHeightSensorFRSt 0;
BA_ "GenSigInvalidValue" SG_ 459 AS_SuspHeightSensorFRSt 0;
BA_ "GenSigSendType" SG_ 459 AS_SuspHeightSensorFRSt 1;
BA_ "GenSigStartValue" SG_ 459 AS_SuspHeightSensorFRSt 0;
BA_ "GenSigTimeoutValue" SG_ 459 AS_SuspHeightSensorFRSt 1;
BA_ "Remark" SG_ 459 AS_SuspHeightSensorFRSt "";
BA_ "EventCommandSignal" SG_ 459 AS_SuspHeightSensorRLSt 0;
BA_ "GatewayedSignals" SG_ 459 AS_SuspHeightSensorRLSt 0;
BA_ "GenSigInactiveValue" SG_ 459 AS_SuspHeightSensorRLSt 0;
BA_ "GenSigInvalidValue" SG_ 459 AS_SuspHeightSensorRLSt 0;
BA_ "GenSigSendType" SG_ 459 AS_SuspHeightSensorRLSt 1;
BA_ "GenSigStartValue" SG_ 459 AS_SuspHeightSensorRLSt 0;
BA_ "GenSigTimeoutValue" SG_ 459 AS_SuspHeightSensorRLSt 1;
BA_ "Remark" SG_ 459 AS_SuspHeightSensorRLSt "";
BA_ "EventCommandSignal" SG_ 459 AS_SuspHeightSensoRRSt 0;
BA_ "GatewayedSignals" SG_ 459 AS_SuspHeightSensoRRSt 0;
BA_ "GenSigInactiveValue" SG_ 459 AS_SuspHeightSensoRRSt 0;
BA_ "GenSigInvalidValue" SG_ 459 AS_SuspHeightSensoRRSt 0;
BA_ "GenSigSendType" SG_ 459 AS_SuspHeightSensoRRSt 1;
BA_ "GenSigStartValue" SG_ 459 AS_SuspHeightSensoRRSt 0;
BA_ "GenSigTimeoutValue" SG_ 459 AS_SuspHeightSensoRRSt 1;
BA_ "Remark" SG_ 459 AS_SuspHeightSensoRRSt "";
BA_ "EventCommandSignal" SG_ 459 AS_MaintanceModeSt 0;
BA_ "GatewayedSignals" SG_ 459 AS_MaintanceModeSt 0;
BA_ "GenSigInactiveValue" SG_ 459 AS_MaintanceModeSt 0;
BA_ "GenSigInvalidValue" SG_ 459 AS_MaintanceModeSt 0;
BA_ "GenSigSendType" SG_ 459 AS_MaintanceModeSt 1;
BA_ "GenSigStartValue" SG_ 459 AS_MaintanceModeSt 0;
BA_ "GenSigTimeoutValue" SG_ 459 AS_MaintanceModeSt 0;
BA_ "Remark" SG_ 459 AS_MaintanceModeSt "";
BA_ "EventCommandSignal" SG_ 459 ECS_AVDCReqModeAvailable 0;
BA_ "GatewayedSignals" SG_ 459 ECS_AVDCReqModeAvailable 0;
BA_ "GenSigInactiveValue" SG_ 459 ECS_AVDCReqModeAvailable 0;
BA_ "GenSigInvalidValue" SG_ 459 ECS_AVDCReqModeAvailable 0;
BA_ "GenSigSendType" SG_ 459 ECS_AVDCReqModeAvailable 1;
BA_ "GenSigStartValue" SG_ 459 ECS_AVDCReqModeAvailable 0;
BA_ "GenSigTimeoutValue" SG_ 459 ECS_AVDCReqModeAvailable 0;
BA_ "Remark" SG_ 459 ECS_AVDCReqModeAvailable "";
BA_ "EventCommandSignal" SG_ 459 ECS_AVDCReqMode 0;
BA_ "GatewayedSignals" SG_ 459 ECS_AVDCReqMode 0;
BA_ "GenSigInactiveValue" SG_ 459 ECS_AVDCReqMode 0;
BA_ "GenSigInvalidValue" SG_ 459 ECS_AVDCReqMode 0;
BA_ "GenSigSendType" SG_ 459 ECS_AVDCReqMode 1;
BA_ "GenSigStartValue" SG_ 459 ECS_AVDCReqMode 0;
BA_ "GenSigTimeoutValue" SG_ 459 ECS_AVDCReqMode 0;
BA_ "Remark" SG_ 459 ECS_AVDCReqMode "";
BA_ "EventCommandSignal" SG_ 459 AS_FrontAxleSuspSt 0;
BA_ "GatewayedSignals" SG_ 459 AS_FrontAxleSuspSt 0;
BA_ "GenSigInactiveValue" SG_ 459 AS_FrontAxleSuspSt 0;
BA_ "GenSigInvalidValue" SG_ 459 AS_FrontAxleSuspSt 0;
BA_ "GenSigSendType" SG_ 459 AS_FrontAxleSuspSt 1;
BA_ "GenSigStartValue" SG_ 459 AS_FrontAxleSuspSt 0;
BA_ "GenSigTimeoutValue" SG_ 459 AS_FrontAxleSuspSt 0;
BA_ "Remark" SG_ 459 AS_FrontAxleSuspSt "";
BA_ "EventCommandSignal" SG_ 459 AS_RearAxleSuspSt 0;
BA_ "GatewayedSignals" SG_ 459 AS_RearAxleSuspSt 0;
BA_ "GenSigInactiveValue" SG_ 459 AS_RearAxleSuspSt 0;
BA_ "GenSigInvalidValue" SG_ 459 AS_RearAxleSuspSt 0;
BA_ "GenSigSendType" SG_ 459 AS_RearAxleSuspSt 1;
BA_ "GenSigStartValue" SG_ 459 AS_RearAxleSuspSt 0;
BA_ "GenSigTimeoutValue" SG_ 459 AS_RearAxleSuspSt 0;
BA_ "Remark" SG_ 459 AS_RearAxleSuspSt "";
BA_ "EventCommandSignal" SG_ 459 AS_HeightWarningSt 0;
BA_ "GatewayedSignals" SG_ 459 AS_HeightWarningSt 0;
BA_ "GenSigInactiveValue" SG_ 459 AS_HeightWarningSt 0;
BA_ "GenSigInvalidValue" SG_ 459 AS_HeightWarningSt 0;
BA_ "GenSigSendType" SG_ 459 AS_HeightWarningSt 1;
BA_ "GenSigStartValue" SG_ 459 AS_HeightWarningSt 0;
BA_ "GenSigTimeoutValue" SG_ 459 AS_HeightWarningSt 0;
BA_ "Remark" SG_ 459 AS_HeightWarningSt "";
BA_ "EventCommandSignal" SG_ 459 AS_CurrentLevel 0;
BA_ "GatewayedSignals" SG_ 459 AS_CurrentLevel 0;
BA_ "GenSigInactiveValue" SG_ 459 AS_CurrentLevel 0;
BA_ "GenSigInvalidValue" SG_ 459 AS_CurrentLevel 0;
BA_ "GenSigSendType" SG_ 459 AS_CurrentLevel 1;
BA_ "GenSigStartValue" SG_ 459 AS_CurrentLevel 0;
BA_ "GenSigTimeoutValue" SG_ 459 AS_CurrentLevel 0;
BA_ "Remark" SG_ 459 AS_CurrentLevel "";
BA_ "EventCommandSignal" SG_ 459 AS_ASMode 0;
BA_ "GatewayedSignals" SG_ 459 AS_ASMode 0;
BA_ "GenSigInactiveValue" SG_ 459 AS_ASMode 0;
BA_ "GenSigInvalidValue" SG_ 459 AS_ASMode 0;
BA_ "GenSigSendType" SG_ 459 AS_ASMode 1;
BA_ "GenSigStartValue" SG_ 459 AS_ASMode 0;
BA_ "GenSigTimeoutValue" SG_ 459 AS_ASMode 0;
BA_ "Remark" SG_ 459 AS_ASMode "";
BA_ "EventCommandSignal" SG_ 459 AS_SysFaultSt 0;
BA_ "GatewayedSignals" SG_ 459 AS_SysFaultSt 0;
BA_ "GenSigInactiveValue" SG_ 459 AS_SysFaultSt 0;
BA_ "GenSigInvalidValue" SG_ 459 AS_SysFaultSt 0;
BA_ "GenSigSendType" SG_ 459 AS_SysFaultSt 1;
BA_ "GenSigStartValue" SG_ 459 AS_SysFaultSt 0;
BA_ "GenSigTimeoutValue" SG_ 459 AS_SysFaultSt 2;
BA_ "Remark" SG_ 459 AS_SysFaultSt "";
BA_ "EventCommandSignal" SG_ 459 AS_ADCLevelingState 0;
BA_ "GatewayedSignals" SG_ 459 AS_ADCLevelingState 0;
BA_ "GenSigInactiveValue" SG_ 459 AS_ADCLevelingState 0;
BA_ "GenSigInvalidValue" SG_ 459 AS_ADCLevelingState 0;
BA_ "GenSigSendType" SG_ 459 AS_ADCLevelingState 1;
BA_ "GenSigStartValue" SG_ 459 AS_ADCLevelingState 0;
BA_ "GenSigTimeoutValue" SG_ 459 AS_ADCLevelingState 0;
BA_ "Remark" SG_ 459 AS_ADCLevelingState "";
BA_ "EventCommandSignal" SG_ 459 AS_SysOperationSt 0;
BA_ "GatewayedSignals" SG_ 459 AS_SysOperationSt 0;
BA_ "GenSigInactiveValue" SG_ 459 AS_SysOperationSt 0;
BA_ "GenSigInvalidValue" SG_ 459 AS_SysOperationSt 0;
BA_ "GenSigSendType" SG_ 459 AS_SysOperationSt 1;
BA_ "GenSigStartValue" SG_ 459 AS_SysOperationSt 0;
BA_ "GenSigTimeoutValue" SG_ 459 AS_SysOperationSt 0;
BA_ "Remark" SG_ 459 AS_SysOperationSt "";
BA_ "EventCommandSignal" SG_ 459 AS_ADCStfnCtrlAvl 0;
BA_ "GatewayedSignals" SG_ 459 AS_ADCStfnCtrlAvl 0;
BA_ "GenSigInactiveValue" SG_ 459 AS_ADCStfnCtrlAvl 0;
BA_ "GenSigInvalidValue" SG_ 459 AS_ADCStfnCtrlAvl 0;
BA_ "GenSigSendType" SG_ 459 AS_ADCStfnCtrlAvl 1;
BA_ "GenSigStartValue" SG_ 459 AS_ADCStfnCtrlAvl 0;
BA_ "GenSigTimeoutValue" SG_ 459 AS_ADCStfnCtrlAvl 0;
BA_ "Remark" SG_ 459 AS_ADCStfnCtrlAvl "";
BA_ "EventCommandSignal" SG_ 459 AS_ADCStfnState 0;
BA_ "GatewayedSignals" SG_ 459 AS_ADCStfnState 0;
BA_ "GenSigInactiveValue" SG_ 459 AS_ADCStfnState 0;
BA_ "GenSigInvalidValue" SG_ 459 AS_ADCStfnState 0;
BA_ "GenSigSendType" SG_ 459 AS_ADCStfnState 1;
BA_ "GenSigStartValue" SG_ 459 AS_ADCStfnState 0;
BA_ "GenSigTimeoutValue" SG_ 459 AS_ADCStfnState 0;
BA_ "Remark" SG_ 459 AS_ADCStfnState "";
BA_ "EventCommandSignal" SG_ 935 SR_SunroofCurrentPst 0;
BA_ "GatewayedSignals" SG_ 935 SR_SunroofCurrentPst 0;
BA_ "GenSigInactiveValue" SG_ 935 SR_SunroofCurrentPst 0;
BA_ "GenSigInvalidValue" SG_ 935 SR_SunroofCurrentPst 0;
BA_ "GenSigSendType" SG_ 935 SR_SunroofCurrentPst 1;
BA_ "GenSigStartValue" SG_ 935 SR_SunroofCurrentPst 255;
BA_ "GenSigTimeoutValue" SG_ 935 SR_SunroofCurrentPst 0;
BA_ "Remark" SG_ 935 SR_SunroofCurrentPst "";
BA_ "EventCommandSignal" SG_ 776 ZCUL_3_CRC 0;
BA_ "GatewayedSignals" SG_ 776 ZCUL_3_CRC 0;
BA_ "GenSigInactiveValue" SG_ 776 ZCUL_3_CRC 0;
BA_ "GenSigInvalidValue" SG_ 776 ZCUL_3_CRC 0;
BA_ "GenSigSendType" SG_ 776 ZCUL_3_CRC 1;
BA_ "GenSigStartValue" SG_ 776 ZCUL_3_CRC 0;
BA_ "GenSigTimeoutValue" SG_ 776 ZCUL_3_CRC 0;
BA_ "Remark" SG_ 776 ZCUL_3_CRC "";
BA_ "EventCommandSignal" SG_ 776 ZCUL_3_Counter 0;
BA_ "GatewayedSignals" SG_ 776 ZCUL_3_Counter 0;
BA_ "GenSigInactiveValue" SG_ 776 ZCUL_3_Counter 0;
BA_ "GenSigInvalidValue" SG_ 776 ZCUL_3_Counter 0;
BA_ "GenSigSendType" SG_ 776 ZCUL_3_Counter 1;
BA_ "GenSigStartValue" SG_ 776 ZCUL_3_Counter 0;
BA_ "GenSigTimeoutValue" SG_ 776 ZCUL_3_Counter 0;
BA_ "Remark" SG_ 776 ZCUL_3_Counter "";
BA_ "EventCommandSignal" SG_ 776 EL_LeftBSDIndicatorSt 0;
BA_ "GatewayedSignals" SG_ 776 EL_LeftBSDIndicatorSt 0;
BA_ "GenSigInactiveValue" SG_ 776 EL_LeftBSDIndicatorSt 0;
BA_ "GenSigInvalidValue" SG_ 776 EL_LeftBSDIndicatorSt 0;
BA_ "GenSigSendType" SG_ 776 EL_LeftBSDIndicatorSt 1;
BA_ "GenSigStartValue" SG_ 776 EL_LeftBSDIndicatorSt 0;
BA_ "GenSigTimeoutValue" SG_ 776 EL_LeftBSDIndicatorSt 0;
BA_ "Remark" SG_ 776 EL_LeftBSDIndicatorSt "";
BA_ "EventCommandSignal" SG_ 776 UINM_HazardLightSwSt 0;
BA_ "GatewayedSignals" SG_ 776 UINM_HazardLightSwSt 0;
BA_ "GenSigInactiveValue" SG_ 776 UINM_HazardLightSwSt 0;
BA_ "GenSigInvalidValue" SG_ 776 UINM_HazardLightSwSt 0;
BA_ "GenSigSendType" SG_ 776 UINM_HazardLightSwSt 1;
BA_ "GenSigStartValue" SG_ 776 UINM_HazardLightSwSt 0;
BA_ "GenSigTimeoutValue" SG_ 776 UINM_HazardLightSwSt 0;
BA_ "Remark" SG_ 776 UINM_HazardLightSwSt "";
BA_ "EventCommandSignal" SG_ 776 EL_MLTurnLightSt 0;
BA_ "GatewayedSignals" SG_ 776 EL_MLTurnLightSt 0;
BA_ "GenSigInactiveValue" SG_ 776 EL_MLTurnLightSt 0;
BA_ "GenSigInvalidValue" SG_ 776 EL_MLTurnLightSt 0;
BA_ "GenSigSendType" SG_ 776 EL_MLTurnLightSt 1;
BA_ "GenSigStartValue" SG_ 776 EL_MLTurnLightSt 0;
BA_ "GenSigTimeoutValue" SG_ 776 EL_MLTurnLightSt 0;
BA_ "Remark" SG_ 776 EL_MLTurnLightSt "";
BA_ "EventCommandSignal" SG_ 776 EL_MLTurnLightFaultSt 0;
BA_ "GatewayedSignals" SG_ 776 EL_MLTurnLightFaultSt 0;
BA_ "GenSigInactiveValue" SG_ 776 EL_MLTurnLightFaultSt 0;
BA_ "GenSigInvalidValue" SG_ 776 EL_MLTurnLightFaultSt 0;
BA_ "GenSigSendType" SG_ 776 EL_MLTurnLightFaultSt 1;
BA_ "GenSigStartValue" SG_ 776 EL_MLTurnLightFaultSt 0;
BA_ "GenSigTimeoutValue" SG_ 776 EL_MLTurnLightFaultSt 0;
BA_ "Remark" SG_ 776 EL_MLTurnLightFaultSt "";
BA_ "EventCommandSignal" SG_ 776 EL_LeftBSDIndicatorFaultSt 0;
BA_ "GatewayedSignals" SG_ 776 EL_LeftBSDIndicatorFaultSt 0;
BA_ "GenSigInactiveValue" SG_ 776 EL_LeftBSDIndicatorFaultSt 0;
BA_ "GenSigInvalidValue" SG_ 776 EL_LeftBSDIndicatorFaultSt 0;
BA_ "GenSigSendType" SG_ 776 EL_LeftBSDIndicatorFaultSt 1;
BA_ "GenSigStartValue" SG_ 776 EL_LeftBSDIndicatorFaultSt 0;
BA_ "GenSigTimeoutValue" SG_ 776 EL_LeftBSDIndicatorFaultSt 0;
BA_ "Remark" SG_ 776 EL_LeftBSDIndicatorFaultSt "";
BA_ "EventCommandSignal" SG_ 776 EL_MLADASLightSt 0;
BA_ "GatewayedSignals" SG_ 776 EL_MLADASLightSt 0;
BA_ "GenSigInactiveValue" SG_ 776 EL_MLADASLightSt 0;
BA_ "GenSigInvalidValue" SG_ 776 EL_MLADASLightSt 0;
BA_ "GenSigSendType" SG_ 776 EL_MLADASLightSt 1;
BA_ "GenSigStartValue" SG_ 776 EL_MLADASLightSt 0;
BA_ "GenSigTimeoutValue" SG_ 776 EL_MLADASLightSt 0;
BA_ "Remark" SG_ 776 EL_MLADASLightSt "";
BA_ "EventCommandSignal" SG_ 776 ZCUL_FrtWindshildHeatSt 0;
BA_ "GatewayedSignals" SG_ 776 ZCUL_FrtWindshildHeatSt 0;
BA_ "GenSigInactiveValue" SG_ 776 ZCUL_FrtWindshildHeatSt 0;
BA_ "GenSigInvalidValue" SG_ 776 ZCUL_FrtWindshildHeatSt 0;
BA_ "GenSigSendType" SG_ 776 ZCUL_FrtWindshildHeatSt 1;
BA_ "GenSigStartValue" SG_ 776 ZCUL_FrtWindshildHeatSt 0;
BA_ "GenSigTimeoutValue" SG_ 776 ZCUL_FrtWindshildHeatSt 0;
BA_ "Remark" SG_ 776 ZCUL_FrtWindshildHeatSt "";
BA_ "EventCommandSignal" SG_ 793 LBMS_1_CRC 0;
BA_ "GatewayedSignals" SG_ 793 LBMS_1_CRC 0;
BA_ "GenSigInactiveValue" SG_ 793 LBMS_1_CRC 0;
BA_ "GenSigInvalidValue" SG_ 793 LBMS_1_CRC 0;
BA_ "GenSigSendType" SG_ 793 LBMS_1_CRC 1;
BA_ "GenSigStartValue" SG_ 793 LBMS_1_CRC 0;
BA_ "GenSigTimeoutValue" SG_ 793 LBMS_1_CRC 0;
BA_ "Remark" SG_ 793 LBMS_1_CRC "";
BA_ "EventCommandSignal" SG_ 793 LBMS_1_Counter 0;
BA_ "GatewayedSignals" SG_ 793 LBMS_1_Counter 0;
BA_ "GenSigInactiveValue" SG_ 793 LBMS_1_Counter 0;
BA_ "GenSigInvalidValue" SG_ 793 LBMS_1_Counter 0;
BA_ "GenSigSendType" SG_ 793 LBMS_1_Counter 1;
BA_ "GenSigStartValue" SG_ 793 LBMS_1_Counter 0;
BA_ "GenSigTimeoutValue" SG_ 793 LBMS_1_Counter 0;
BA_ "Remark" SG_ 793 LBMS_1_Counter "";
BA_ "EventCommandSignal" SG_ 793 LBMS_SOFVD 0;
BA_ "GatewayedSignals" SG_ 793 LBMS_SOFVD 0;
BA_ "GenSigInactiveValue" SG_ 793 LBMS_SOFVD 0;
BA_ "GenSigInvalidValue" SG_ 793 LBMS_SOFVD 0;
BA_ "GenSigSendType" SG_ 793 LBMS_SOFVD 1;
BA_ "GenSigStartValue" SG_ 793 LBMS_SOFVD 0;
BA_ "GenSigTimeoutValue" SG_ 793 LBMS_SOFVD 0;
BA_ "Remark" SG_ 793 LBMS_SOFVD "";
BA_ "EventCommandSignal" SG_ 793 LBMS_SOFEN 0;
BA_ "GatewayedSignals" SG_ 793 LBMS_SOFEN 0;
BA_ "GenSigInactiveValue" SG_ 793 LBMS_SOFEN 0;
BA_ "GenSigInvalidValue" SG_ 793 LBMS_SOFEN 0;
BA_ "GenSigSendType" SG_ 793 LBMS_SOFEN 1;
BA_ "GenSigStartValue" SG_ 793 LBMS_SOFEN 0;
BA_ "GenSigTimeoutValue" SG_ 793 LBMS_SOFEN 0;
BA_ "Remark" SG_ 793 LBMS_SOFEN "";
BA_ "EventCommandSignal" SG_ 620 CCU_PADS_2_CRC 0;
BA_ "GatewayedSignals" SG_ 620 CCU_PADS_2_CRC 0;
BA_ "GenSigInactiveValue" SG_ 620 CCU_PADS_2_CRC 0;
BA_ "GenSigInvalidValue" SG_ 620 CCU_PADS_2_CRC 0;
BA_ "GenSigSendType" SG_ 620 CCU_PADS_2_CRC 1;
BA_ "GenSigStartValue" SG_ 620 CCU_PADS_2_CRC 0;
BA_ "GenSigTimeoutValue" SG_ 620 CCU_PADS_2_CRC 0;
BA_ "Remark" SG_ 620 CCU_PADS_2_CRC "";
BA_ "EventCommandSignal" SG_ 620 CCU_PADS_2_Counter 0;
BA_ "GatewayedSignals" SG_ 620 CCU_PADS_2_Counter 0;
BA_ "GenSigInactiveValue" SG_ 620 CCU_PADS_2_Counter 0;
BA_ "GenSigInvalidValue" SG_ 620 CCU_PADS_2_Counter 0;
BA_ "GenSigSendType" SG_ 620 CCU_PADS_2_Counter 1;
BA_ "GenSigStartValue" SG_ 620 CCU_PADS_2_Counter 0;
BA_ "GenSigTimeoutValue" SG_ 620 CCU_PADS_2_Counter 0;
BA_ "Remark" SG_ 620 CCU_PADS_2_Counter "";
BA_ "EventCommandSignal" SG_ 620 UINM_PADS_ResponseErr 0;
BA_ "GatewayedSignals" SG_ 620 UINM_PADS_ResponseErr 0;
BA_ "GenSigInactiveValue" SG_ 620 UINM_PADS_ResponseErr 0;
BA_ "GenSigInvalidValue" SG_ 620 UINM_PADS_ResponseErr 0;
BA_ "GenSigSendType" SG_ 620 UINM_PADS_ResponseErr 1;
BA_ "GenSigStartValue" SG_ 620 UINM_PADS_ResponseErr 0;
BA_ "GenSigTimeoutValue" SG_ 620 UINM_PADS_ResponseErr 0;
BA_ "Remark" SG_ 620 UINM_PADS_ResponseErr "";
BA_ "EventCommandSignal" SG_ 620 UINM_PADS_CustomSWSt 0;
BA_ "GatewayedSignals" SG_ 620 UINM_PADS_CustomSWSt 0;
BA_ "GenSigInactiveValue" SG_ 620 UINM_PADS_CustomSWSt 0;
BA_ "GenSigInvalidValue" SG_ 620 UINM_PADS_CustomSWSt 0;
BA_ "GenSigSendType" SG_ 620 UINM_PADS_CustomSWSt 1;
BA_ "GenSigStartValue" SG_ 620 UINM_PADS_CustomSWSt 0;
BA_ "GenSigTimeoutValue" SG_ 620 UINM_PADS_CustomSWSt 0;
BA_ "Remark" SG_ 620 UINM_PADS_CustomSWSt "";
BA_ "EventCommandSignal" SG_ 620 UINM_PADS_CustomSWStVD 0;
BA_ "GatewayedSignals" SG_ 620 UINM_PADS_CustomSWStVD 0;
BA_ "GenSigInactiveValue" SG_ 620 UINM_PADS_CustomSWStVD 0;
BA_ "GenSigInvalidValue" SG_ 620 UINM_PADS_CustomSWStVD 0;
BA_ "GenSigSendType" SG_ 620 UINM_PADS_CustomSWStVD 1;
BA_ "GenSigStartValue" SG_ 620 UINM_PADS_CustomSWStVD 0;
BA_ "GenSigTimeoutValue" SG_ 620 UINM_PADS_CustomSWStVD 0;
BA_ "Remark" SG_ 620 UINM_PADS_CustomSWStVD "";
BA_ "EventCommandSignal" SG_ 620 UINM_PADS_CustomSWstuck 0;
BA_ "GatewayedSignals" SG_ 620 UINM_PADS_CustomSWstuck 0;
BA_ "GenSigInactiveValue" SG_ 620 UINM_PADS_CustomSWstuck 0;
BA_ "GenSigInvalidValue" SG_ 620 UINM_PADS_CustomSWstuck 0;
BA_ "GenSigSendType" SG_ 620 UINM_PADS_CustomSWstuck 1;
BA_ "GenSigStartValue" SG_ 620 UINM_PADS_CustomSWstuck 0;
BA_ "GenSigTimeoutValue" SG_ 620 UINM_PADS_CustomSWstuck 0;
BA_ "Remark" SG_ 620 UINM_PADS_CustomSWstuck "";
BA_ "EventCommandSignal" SG_ 620 UINM_PADS_IDC_PlaySWSt 0;
BA_ "GatewayedSignals" SG_ 620 UINM_PADS_IDC_PlaySWSt 0;
BA_ "GenSigInactiveValue" SG_ 620 UINM_PADS_IDC_PlaySWSt 0;
BA_ "GenSigInvalidValue" SG_ 620 UINM_PADS_IDC_PlaySWSt 0;
BA_ "GenSigSendType" SG_ 620 UINM_PADS_IDC_PlaySWSt 1;
BA_ "GenSigStartValue" SG_ 620 UINM_PADS_IDC_PlaySWSt 0;
BA_ "GenSigTimeoutValue" SG_ 620 UINM_PADS_IDC_PlaySWSt 0;
BA_ "Remark" SG_ 620 UINM_PADS_IDC_PlaySWSt "";
BA_ "EventCommandSignal" SG_ 620 UINM_PADS_IDC_PlaySWStVD 0;
BA_ "GatewayedSignals" SG_ 620 UINM_PADS_IDC_PlaySWStVD 0;
BA_ "GenSigInactiveValue" SG_ 620 UINM_PADS_IDC_PlaySWStVD 0;
BA_ "GenSigInvalidValue" SG_ 620 UINM_PADS_IDC_PlaySWStVD 0;
BA_ "GenSigSendType" SG_ 620 UINM_PADS_IDC_PlaySWStVD 1;
BA_ "GenSigStartValue" SG_ 620 UINM_PADS_IDC_PlaySWStVD 0;
BA_ "GenSigTimeoutValue" SG_ 620 UINM_PADS_IDC_PlaySWStVD 0;
BA_ "Remark" SG_ 620 UINM_PADS_IDC_PlaySWStVD "";
BA_ "EventCommandSignal" SG_ 620 UINM_PADS_CruSetSpeedRollerRotatedDir 0;
BA_ "GatewayedSignals" SG_ 620 UINM_PADS_CruSetSpeedRollerRotatedDir 0;
BA_ "GenSigInactiveValue" SG_ 620 UINM_PADS_CruSetSpeedRollerRotatedDir 0;
BA_ "GenSigInvalidValue" SG_ 620 UINM_PADS_CruSetSpeedRollerRotatedDir 0;
BA_ "GenSigSendType" SG_ 620 UINM_PADS_CruSetSpeedRollerRotatedDir 1;
BA_ "GenSigStartValue" SG_ 620 UINM_PADS_CruSetSpeedRollerRotatedDir 0;
BA_ "GenSigTimeoutValue" SG_ 620 UINM_PADS_CruSetSpeedRollerRotatedDir 0;
BA_ "Remark" SG_ 620 UINM_PADS_CruSetSpeedRollerRotatedDir "";
BA_ "EventCommandSignal" SG_ 620 UINM_PADS_FolDistIncSWSt 0;
BA_ "GatewayedSignals" SG_ 620 UINM_PADS_FolDistIncSWSt 0;
BA_ "GenSigInactiveValue" SG_ 620 UINM_PADS_FolDistIncSWSt 0;
BA_ "GenSigInvalidValue" SG_ 620 UINM_PADS_FolDistIncSWSt 0;
BA_ "GenSigSendType" SG_ 620 UINM_PADS_FolDistIncSWSt 1;
BA_ "GenSigStartValue" SG_ 620 UINM_PADS_FolDistIncSWSt 0;
BA_ "GenSigTimeoutValue" SG_ 620 UINM_PADS_FolDistIncSWSt 0;
BA_ "Remark" SG_ 620 UINM_PADS_FolDistIncSWSt "";
BA_ "EventCommandSignal" SG_ 620 UINM_PADS_CruSetSpeedRollerSt 0;
BA_ "GatewayedSignals" SG_ 620 UINM_PADS_CruSetSpeedRollerSt 0;
BA_ "GenSigInactiveValue" SG_ 620 UINM_PADS_CruSetSpeedRollerSt 0;
BA_ "GenSigInvalidValue" SG_ 620 UINM_PADS_CruSetSpeedRollerSt 0;
BA_ "GenSigSendType" SG_ 620 UINM_PADS_CruSetSpeedRollerSt 1;
BA_ "GenSigStartValue" SG_ 620 UINM_PADS_CruSetSpeedRollerSt 0;
BA_ "GenSigTimeoutValue" SG_ 620 UINM_PADS_CruSetSpeedRollerSt 0;
BA_ "Remark" SG_ 620 UINM_PADS_CruSetSpeedRollerSt "";
BA_ "EventCommandSignal" SG_ 620 UINM_PADS_FolDistIncSWStVD 0;
BA_ "GatewayedSignals" SG_ 620 UINM_PADS_FolDistIncSWStVD 0;
BA_ "GenSigInactiveValue" SG_ 620 UINM_PADS_FolDistIncSWStVD 0;
BA_ "GenSigInvalidValue" SG_ 620 UINM_PADS_FolDistIncSWStVD 0;
BA_ "GenSigSendType" SG_ 620 UINM_PADS_FolDistIncSWStVD 1;
BA_ "GenSigStartValue" SG_ 620 UINM_PADS_FolDistIncSWStVD 0;
BA_ "GenSigTimeoutValue" SG_ 620 UINM_PADS_FolDistIncSWStVD 0;
BA_ "Remark" SG_ 620 UINM_PADS_FolDistIncSWStVD "";
BA_ "EventCommandSignal" SG_ 620 UINM_PADS_FolDistIncSWStuckSt 0;
BA_ "GatewayedSignals" SG_ 620 UINM_PADS_FolDistIncSWStuckSt 0;
BA_ "GenSigInactiveValue" SG_ 620 UINM_PADS_FolDistIncSWStuckSt 0;
BA_ "GenSigInvalidValue" SG_ 620 UINM_PADS_FolDistIncSWStuckSt 0;
BA_ "GenSigSendType" SG_ 620 UINM_PADS_FolDistIncSWStuckSt 1;
BA_ "GenSigStartValue" SG_ 620 UINM_PADS_FolDistIncSWStuckSt 0;
BA_ "GenSigTimeoutValue" SG_ 620 UINM_PADS_FolDistIncSWStuckSt 0;
BA_ "Remark" SG_ 620 UINM_PADS_FolDistIncSWStuckSt "";
BA_ "EventCommandSignal" SG_ 620 UINM_PADS_FolDistDecSWStVD 0;
BA_ "GatewayedSignals" SG_ 620 UINM_PADS_FolDistDecSWStVD 0;
BA_ "GenSigInactiveValue" SG_ 620 UINM_PADS_FolDistDecSWStVD 0;
BA_ "GenSigInvalidValue" SG_ 620 UINM_PADS_FolDistDecSWStVD 0;
BA_ "GenSigSendType" SG_ 620 UINM_PADS_FolDistDecSWStVD 1;
BA_ "GenSigStartValue" SG_ 620 UINM_PADS_FolDistDecSWStVD 0;
BA_ "GenSigTimeoutValue" SG_ 620 UINM_PADS_FolDistDecSWStVD 0;
BA_ "Remark" SG_ 620 UINM_PADS_FolDistDecSWStVD "";
BA_ "EventCommandSignal" SG_ 620 UINM_PADS_FolDistDecSWStuckSt 0;
BA_ "GatewayedSignals" SG_ 620 UINM_PADS_FolDistDecSWStuckSt 0;
BA_ "GenSigInactiveValue" SG_ 620 UINM_PADS_FolDistDecSWStuckSt 0;
BA_ "GenSigInvalidValue" SG_ 620 UINM_PADS_FolDistDecSWStuckSt 0;
BA_ "GenSigSendType" SG_ 620 UINM_PADS_FolDistDecSWStuckSt 1;
BA_ "GenSigStartValue" SG_ 620 UINM_PADS_FolDistDecSWStuckSt 0;
BA_ "GenSigTimeoutValue" SG_ 620 UINM_PADS_FolDistDecSWStuckSt 0;
BA_ "Remark" SG_ 620 UINM_PADS_FolDistDecSWStuckSt "";
BA_ "EventCommandSignal" SG_ 620 UINM_PADS_OKSWSt 0;
BA_ "GatewayedSignals" SG_ 620 UINM_PADS_OKSWSt 0;
BA_ "GenSigInactiveValue" SG_ 620 UINM_PADS_OKSWSt 0;
BA_ "GenSigInvalidValue" SG_ 620 UINM_PADS_OKSWSt 0;
BA_ "GenSigSendType" SG_ 620 UINM_PADS_OKSWSt 1;
BA_ "GenSigStartValue" SG_ 620 UINM_PADS_OKSWSt 0;
BA_ "GenSigTimeoutValue" SG_ 620 UINM_PADS_OKSWSt 0;
BA_ "Remark" SG_ 620 UINM_PADS_OKSWSt "";
BA_ "EventCommandSignal" SG_ 620 UINM_PADS_OKSWStVD 0;
BA_ "GatewayedSignals" SG_ 620 UINM_PADS_OKSWStVD 0;
BA_ "GenSigInactiveValue" SG_ 620 UINM_PADS_OKSWStVD 0;
BA_ "GenSigInvalidValue" SG_ 620 UINM_PADS_OKSWStVD 0;
BA_ "GenSigSendType" SG_ 620 UINM_PADS_OKSWStVD 1;
BA_ "GenSigStartValue" SG_ 620 UINM_PADS_OKSWStVD 0;
BA_ "GenSigTimeoutValue" SG_ 620 UINM_PADS_OKSWStVD 0;
BA_ "Remark" SG_ 620 UINM_PADS_OKSWStVD "";
BA_ "EventCommandSignal" SG_ 620 UINM_PADS_OKSWStuckSt 0;
BA_ "GatewayedSignals" SG_ 620 UINM_PADS_OKSWStuckSt 0;
BA_ "GenSigInactiveValue" SG_ 620 UINM_PADS_OKSWStuckSt 0;
BA_ "GenSigInvalidValue" SG_ 620 UINM_PADS_OKSWStuckSt 0;
BA_ "GenSigSendType" SG_ 620 UINM_PADS_OKSWStuckSt 1;
BA_ "GenSigStartValue" SG_ 620 UINM_PADS_OKSWStuckSt 0;
BA_ "GenSigTimeoutValue" SG_ 620 UINM_PADS_OKSWStuckSt 0;
BA_ "Remark" SG_ 620 UINM_PADS_OKSWStuckSt "";
BA_ "EventCommandSignal" SG_ 620 UINM_PADS_CruSetSpeedRollerVD 0;
BA_ "GatewayedSignals" SG_ 620 UINM_PADS_CruSetSpeedRollerVD 0;
BA_ "GenSigInactiveValue" SG_ 620 UINM_PADS_CruSetSpeedRollerVD 0;
BA_ "GenSigInvalidValue" SG_ 620 UINM_PADS_CruSetSpeedRollerVD 0;
BA_ "GenSigSendType" SG_ 620 UINM_PADS_CruSetSpeedRollerVD 1;
BA_ "GenSigStartValue" SG_ 620 UINM_PADS_CruSetSpeedRollerVD 0;
BA_ "GenSigTimeoutValue" SG_ 620 UINM_PADS_CruSetSpeedRollerVD 0;
BA_ "Remark" SG_ 620 UINM_PADS_CruSetSpeedRollerVD "";
BA_ "EventCommandSignal" SG_ 620 UINM_PADS_FolDistDecSWSt 0;
BA_ "GatewayedSignals" SG_ 620 UINM_PADS_FolDistDecSWSt 0;
BA_ "GenSigInactiveValue" SG_ 620 UINM_PADS_FolDistDecSWSt 0;
BA_ "GenSigInvalidValue" SG_ 620 UINM_PADS_FolDistDecSWSt 0;
BA_ "GenSigSendType" SG_ 620 UINM_PADS_FolDistDecSWSt 1;
BA_ "GenSigStartValue" SG_ 620 UINM_PADS_FolDistDecSWSt 0;
BA_ "GenSigTimeoutValue" SG_ 620 UINM_PADS_FolDistDecSWSt 0;
BA_ "Remark" SG_ 620 UINM_PADS_FolDistDecSWSt "";
BA_ "EventCommandSignal" SG_ 620 IL_PADS_LightbarErrSt 0;
BA_ "GatewayedSignals" SG_ 620 IL_PADS_LightbarErrSt 0;
BA_ "GenSigInactiveValue" SG_ 620 IL_PADS_LightbarErrSt 0;
BA_ "GenSigInvalidValue" SG_ 620 IL_PADS_LightbarErrSt 0;
BA_ "GenSigSendType" SG_ 620 IL_PADS_LightbarErrSt 1;
BA_ "GenSigStartValue" SG_ 620 IL_PADS_LightbarErrSt 0;
BA_ "GenSigTimeoutValue" SG_ 620 IL_PADS_LightbarErrSt 0;
BA_ "Remark" SG_ 620 IL_PADS_LightbarErrSt "";
BA_ "EventCommandSignal" SG_ 620 UINM_PADS_CruSWSt 0;
BA_ "GatewayedSignals" SG_ 620 UINM_PADS_CruSWSt 0;
BA_ "GenSigInactiveValue" SG_ 620 UINM_PADS_CruSWSt 0;
BA_ "GenSigInvalidValue" SG_ 620 UINM_PADS_CruSWSt 0;
BA_ "GenSigSendType" SG_ 620 UINM_PADS_CruSWSt 1;
BA_ "GenSigStartValue" SG_ 620 UINM_PADS_CruSWSt 0;
BA_ "GenSigTimeoutValue" SG_ 620 UINM_PADS_CruSWSt 0;
BA_ "Remark" SG_ 620 UINM_PADS_CruSWSt "";
BA_ "EventCommandSignal" SG_ 620 UINM_PADS_CruSWStVD 0;
BA_ "GatewayedSignals" SG_ 620 UINM_PADS_CruSWStVD 0;
BA_ "GenSigInactiveValue" SG_ 620 UINM_PADS_CruSWStVD 0;
BA_ "GenSigInvalidValue" SG_ 620 UINM_PADS_CruSWStVD 0;
BA_ "GenSigSendType" SG_ 620 UINM_PADS_CruSWStVD 1;
BA_ "GenSigStartValue" SG_ 620 UINM_PADS_CruSWStVD 0;
BA_ "GenSigTimeoutValue" SG_ 620 UINM_PADS_CruSWStVD 0;
BA_ "Remark" SG_ 620 UINM_PADS_CruSWStVD "";
BA_ "EventCommandSignal" SG_ 620 UINM_PADS_CruSWStuckSt 0;
BA_ "GatewayedSignals" SG_ 620 UINM_PADS_CruSWStuckSt 0;
BA_ "GenSigInactiveValue" SG_ 620 UINM_PADS_CruSWStuckSt 0;
BA_ "GenSigInvalidValue" SG_ 620 UINM_PADS_CruSWStuckSt 0;
BA_ "GenSigSendType" SG_ 620 UINM_PADS_CruSWStuckSt 1;
BA_ "GenSigStartValue" SG_ 620 UINM_PADS_CruSWStuckSt 0;
BA_ "GenSigTimeoutValue" SG_ 620 UINM_PADS_CruSWStuckSt 0;
BA_ "Remark" SG_ 620 UINM_PADS_CruSWStuckSt "";
BA_ "EventCommandSignal" SG_ 620 UINM_PADS_CruSpeedDecSWSt 0;
BA_ "GatewayedSignals" SG_ 620 UINM_PADS_CruSpeedDecSWSt 0;
BA_ "GenSigInactiveValue" SG_ 620 UINM_PADS_CruSpeedDecSWSt 0;
BA_ "GenSigInvalidValue" SG_ 620 UINM_PADS_CruSpeedDecSWSt 0;
BA_ "GenSigSendType" SG_ 620 UINM_PADS_CruSpeedDecSWSt 1;
BA_ "GenSigStartValue" SG_ 620 UINM_PADS_CruSpeedDecSWSt 0;
BA_ "GenSigTimeoutValue" SG_ 620 UINM_PADS_CruSpeedDecSWSt 0;
BA_ "Remark" SG_ 620 UINM_PADS_CruSpeedDecSWSt "";
BA_ "EventCommandSignal" SG_ 620 UINM_PADS_CruSpeedDecSWStVD 0;
BA_ "GatewayedSignals" SG_ 620 UINM_PADS_CruSpeedDecSWStVD 0;
BA_ "GenSigInactiveValue" SG_ 620 UINM_PADS_CruSpeedDecSWStVD 0;
BA_ "GenSigInvalidValue" SG_ 620 UINM_PADS_CruSpeedDecSWStVD 0;
BA_ "GenSigSendType" SG_ 620 UINM_PADS_CruSpeedDecSWStVD 1;
BA_ "GenSigStartValue" SG_ 620 UINM_PADS_CruSpeedDecSWStVD 0;
BA_ "GenSigTimeoutValue" SG_ 620 UINM_PADS_CruSpeedDecSWStVD 0;
BA_ "Remark" SG_ 620 UINM_PADS_CruSpeedDecSWStVD "";
BA_ "EventCommandSignal" SG_ 620 UINM_PADS_CruSpeedDecSWStuckSt 0;
BA_ "GatewayedSignals" SG_ 620 UINM_PADS_CruSpeedDecSWStuckSt 0;
BA_ "GenSigInactiveValue" SG_ 620 UINM_PADS_CruSpeedDecSWStuckSt 0;
BA_ "GenSigInvalidValue" SG_ 620 UINM_PADS_CruSpeedDecSWStuckSt 0;
BA_ "GenSigSendType" SG_ 620 UINM_PADS_CruSpeedDecSWStuckSt 1;
BA_ "GenSigStartValue" SG_ 620 UINM_PADS_CruSpeedDecSWStuckSt 0;
BA_ "GenSigTimeoutValue" SG_ 620 UINM_PADS_CruSpeedDecSWStuckSt 0;
BA_ "Remark" SG_ 620 UINM_PADS_CruSpeedDecSWStuckSt "";
BA_ "EventCommandSignal" SG_ 620 UINM_PADS_CruResumeSpeedIncSWSt 0;
BA_ "GatewayedSignals" SG_ 620 UINM_PADS_CruResumeSpeedIncSWSt 0;
BA_ "GenSigInactiveValue" SG_ 620 UINM_PADS_CruResumeSpeedIncSWSt 0;
BA_ "GenSigInvalidValue" SG_ 620 UINM_PADS_CruResumeSpeedIncSWSt 0;
BA_ "GenSigSendType" SG_ 620 UINM_PADS_CruResumeSpeedIncSWSt 1;
BA_ "GenSigStartValue" SG_ 620 UINM_PADS_CruResumeSpeedIncSWSt 0;
BA_ "GenSigTimeoutValue" SG_ 620 UINM_PADS_CruResumeSpeedIncSWSt 0;
BA_ "Remark" SG_ 620 UINM_PADS_CruResumeSpeedIncSWSt "";
BA_ "EventCommandSignal" SG_ 620 UINM_PADS_CruResumeSpeedIncSWStVD 0;
BA_ "GatewayedSignals" SG_ 620 UINM_PADS_CruResumeSpeedIncSWStVD 0;
BA_ "GenSigInactiveValue" SG_ 620 UINM_PADS_CruResumeSpeedIncSWStVD 0;
BA_ "GenSigInvalidValue" SG_ 620 UINM_PADS_CruResumeSpeedIncSWStVD 0;
BA_ "GenSigSendType" SG_ 620 UINM_PADS_CruResumeSpeedIncSWStVD 1;
BA_ "GenSigStartValue" SG_ 620 UINM_PADS_CruResumeSpeedIncSWStVD 0;
BA_ "GenSigTimeoutValue" SG_ 620 UINM_PADS_CruResumeSpeedIncSWStVD 0;
BA_ "Remark" SG_ 620 UINM_PADS_CruResumeSpeedIncSWStVD "";
BA_ "EventCommandSignal" SG_ 620 UINM_PADS_CruResumeSpeedIncSWStuckSt 0;
BA_ "GatewayedSignals" SG_ 620 UINM_PADS_CruResumeSpeedIncSWStuckSt 0;
BA_ "GenSigInactiveValue" SG_ 620 UINM_PADS_CruResumeSpeedIncSWStuckSt 0;
BA_ "GenSigInvalidValue" SG_ 620 UINM_PADS_CruResumeSpeedIncSWStuckSt 0;
BA_ "GenSigSendType" SG_ 620 UINM_PADS_CruResumeSpeedIncSWStuckSt 1;
BA_ "GenSigStartValue" SG_ 620 UINM_PADS_CruResumeSpeedIncSWStuckSt 0;
BA_ "GenSigTimeoutValue" SG_ 620 UINM_PADS_CruResumeSpeedIncSWStuckSt 0;
BA_ "Remark" SG_ 620 UINM_PADS_CruResumeSpeedIncSWStuckSt "";
BA_ "EventCommandSignal" SG_ 620 UINM_PADS_CruTJAICASWSt 0;
BA_ "GatewayedSignals" SG_ 620 UINM_PADS_CruTJAICASWSt 0;
BA_ "GenSigInactiveValue" SG_ 620 UINM_PADS_CruTJAICASWSt 0;
BA_ "GenSigInvalidValue" SG_ 620 UINM_PADS_CruTJAICASWSt 0;
BA_ "GenSigSendType" SG_ 620 UINM_PADS_CruTJAICASWSt 1;
BA_ "GenSigStartValue" SG_ 620 UINM_PADS_CruTJAICASWSt 0;
BA_ "GenSigTimeoutValue" SG_ 620 UINM_PADS_CruTJAICASWSt 0;
BA_ "Remark" SG_ 620 UINM_PADS_CruTJAICASWSt "";
BA_ "EventCommandSignal" SG_ 620 UINM_PADS_CruTJAICASWStVD 0;
BA_ "GatewayedSignals" SG_ 620 UINM_PADS_CruTJAICASWStVD 0;
BA_ "GenSigInactiveValue" SG_ 620 UINM_PADS_CruTJAICASWStVD 0;
BA_ "GenSigInvalidValue" SG_ 620 UINM_PADS_CruTJAICASWStVD 0;
BA_ "GenSigSendType" SG_ 620 UINM_PADS_CruTJAICASWStVD 1;
BA_ "GenSigStartValue" SG_ 620 UINM_PADS_CruTJAICASWStVD 0;
BA_ "GenSigTimeoutValue" SG_ 620 UINM_PADS_CruTJAICASWStVD 0;
BA_ "Remark" SG_ 620 UINM_PADS_CruTJAICASWStVD "";
BA_ "EventCommandSignal" SG_ 620 UINM_PADS_CruTJAICASWStuckSt 0;
BA_ "GatewayedSignals" SG_ 620 UINM_PADS_CruTJAICASWStuckSt 0;
BA_ "GenSigInactiveValue" SG_ 620 UINM_PADS_CruTJAICASWStuckSt 0;
BA_ "GenSigInvalidValue" SG_ 620 UINM_PADS_CruTJAICASWStuckSt 0;
BA_ "GenSigSendType" SG_ 620 UINM_PADS_CruTJAICASWStuckSt 1;
BA_ "GenSigStartValue" SG_ 620 UINM_PADS_CruTJAICASWStuckSt 0;
BA_ "GenSigTimeoutValue" SG_ 620 UINM_PADS_CruTJAICASWStuckSt 0;
BA_ "Remark" SG_ 620 UINM_PADS_CruTJAICASWStuckSt "";
BA_ "EventCommandSignal" SG_ 620 UINM_PADS_Custom2SWSt 0;
BA_ "GatewayedSignals" SG_ 620 UINM_PADS_Custom2SWSt 0;
BA_ "GenSigInactiveValue" SG_ 620 UINM_PADS_Custom2SWSt 0;
BA_ "GenSigInvalidValue" SG_ 620 UINM_PADS_Custom2SWSt 0;
BA_ "GenSigSendType" SG_ 620 UINM_PADS_Custom2SWSt 1;
BA_ "GenSigStartValue" SG_ 620 UINM_PADS_Custom2SWSt 0;
BA_ "GenSigTimeoutValue" SG_ 620 UINM_PADS_Custom2SWSt 0;
BA_ "Remark" SG_ 620 UINM_PADS_Custom2SWSt "";
BA_ "EventCommandSignal" SG_ 620 UINM_PADS_Custom2SWStVD 0;
BA_ "GatewayedSignals" SG_ 620 UINM_PADS_Custom2SWStVD 0;
BA_ "GenSigInactiveValue" SG_ 620 UINM_PADS_Custom2SWStVD 0;
BA_ "GenSigInvalidValue" SG_ 620 UINM_PADS_Custom2SWStVD 0;
BA_ "GenSigSendType" SG_ 620 UINM_PADS_Custom2SWStVD 1;
BA_ "GenSigStartValue" SG_ 620 UINM_PADS_Custom2SWStVD 0;
BA_ "GenSigTimeoutValue" SG_ 620 UINM_PADS_Custom2SWStVD 0;
BA_ "Remark" SG_ 620 UINM_PADS_Custom2SWStVD "";
BA_ "EventCommandSignal" SG_ 620 UINM_PADS_Custom2SWStuckSt 0;
BA_ "GatewayedSignals" SG_ 620 UINM_PADS_Custom2SWStuckSt 0;
BA_ "GenSigInactiveValue" SG_ 620 UINM_PADS_Custom2SWStuckSt 0;
BA_ "GenSigInvalidValue" SG_ 620 UINM_PADS_Custom2SWStuckSt 0;
BA_ "GenSigSendType" SG_ 620 UINM_PADS_Custom2SWStuckSt 1;
BA_ "GenSigStartValue" SG_ 620 UINM_PADS_Custom2SWStuckSt 0;
BA_ "GenSigTimeoutValue" SG_ 620 UINM_PADS_Custom2SWStuckSt 0;
BA_ "Remark" SG_ 620 UINM_PADS_Custom2SWStuckSt "";
BA_ "EventCommandSignal" SG_ 620 UINM_PADS_ACCSWSt 0;
BA_ "GatewayedSignals" SG_ 620 UINM_PADS_ACCSWSt 0;
BA_ "GenSigInactiveValue" SG_ 620 UINM_PADS_ACCSWSt 0;
BA_ "GenSigInvalidValue" SG_ 620 UINM_PADS_ACCSWSt 0;
BA_ "GenSigSendType" SG_ 620 UINM_PADS_ACCSWSt 1;
BA_ "GenSigStartValue" SG_ 620 UINM_PADS_ACCSWSt 0;
BA_ "GenSigTimeoutValue" SG_ 620 UINM_PADS_ACCSWSt 0;
BA_ "Remark" SG_ 620 UINM_PADS_ACCSWSt "";
BA_ "EventCommandSignal" SG_ 620 UINM_PADS_VoltageFaultSt 0;
BA_ "GatewayedSignals" SG_ 620 UINM_PADS_VoltageFaultSt 0;
BA_ "GenSigInactiveValue" SG_ 620 UINM_PADS_VoltageFaultSt 0;
BA_ "GenSigInvalidValue" SG_ 620 UINM_PADS_VoltageFaultSt 0;
BA_ "GenSigSendType" SG_ 620 UINM_PADS_VoltageFaultSt 1;
BA_ "GenSigStartValue" SG_ 620 UINM_PADS_VoltageFaultSt 0;
BA_ "GenSigTimeoutValue" SG_ 620 UINM_PADS_VoltageFaultSt 0;
BA_ "Remark" SG_ 620 UINM_PADS_VoltageFaultSt "";
BA_ "EventCommandSignal" SG_ 620 UINM_PADS_L3SWSt 0;
BA_ "GatewayedSignals" SG_ 620 UINM_PADS_L3SWSt 0;
BA_ "GenSigInactiveValue" SG_ 620 UINM_PADS_L3SWSt 0;
BA_ "GenSigInvalidValue" SG_ 620 UINM_PADS_L3SWSt 0;
BA_ "GenSigSendType" SG_ 620 UINM_PADS_L3SWSt 1;
BA_ "GenSigStartValue" SG_ 620 UINM_PADS_L3SWSt 0;
BA_ "GenSigTimeoutValue" SG_ 620 UINM_PADS_L3SWSt 0;
BA_ "Remark" SG_ 620 UINM_PADS_L3SWSt "";
BA_ "EventCommandSignal" SG_ 620 UINM_PADS_L3SWStVD 0;
BA_ "GatewayedSignals" SG_ 620 UINM_PADS_L3SWStVD 0;
BA_ "GenSigInactiveValue" SG_ 620 UINM_PADS_L3SWStVD 0;
BA_ "GenSigInvalidValue" SG_ 620 UINM_PADS_L3SWStVD 0;
BA_ "GenSigSendType" SG_ 620 UINM_PADS_L3SWStVD 1;
BA_ "GenSigStartValue" SG_ 620 UINM_PADS_L3SWStVD 0;
BA_ "GenSigTimeoutValue" SG_ 620 UINM_PADS_L3SWStVD 0;
BA_ "Remark" SG_ 620 UINM_PADS_L3SWStVD "";
BA_ "EventCommandSignal" SG_ 620 UINM_PADS_L3SWStuckSt 0;
BA_ "GatewayedSignals" SG_ 620 UINM_PADS_L3SWStuckSt 0;
BA_ "GenSigInactiveValue" SG_ 620 UINM_PADS_L3SWStuckSt 0;
BA_ "GenSigInvalidValue" SG_ 620 UINM_PADS_L3SWStuckSt 0;
BA_ "GenSigSendType" SG_ 620 UINM_PADS_L3SWStuckSt 1;
BA_ "GenSigStartValue" SG_ 620 UINM_PADS_L3SWStuckSt 0;
BA_ "GenSigTimeoutValue" SG_ 620 UINM_PADS_L3SWStuckSt 0;
BA_ "Remark" SG_ 620 UINM_PADS_L3SWStuckSt "";
BA_ "EventCommandSignal" SG_ 620 IL_PADS_LightbarSt 0;
BA_ "GatewayedSignals" SG_ 620 IL_PADS_LightbarSt 0;
BA_ "GenSigInactiveValue" SG_ 620 IL_PADS_LightbarSt 0;
BA_ "GenSigInvalidValue" SG_ 620 IL_PADS_LightbarSt 0;
BA_ "GenSigSendType" SG_ 620 IL_PADS_LightbarSt 1;
BA_ "GenSigStartValue" SG_ 620 IL_PADS_LightbarSt 0;
BA_ "GenSigTimeoutValue" SG_ 620 IL_PADS_LightbarSt 15;
BA_ "Remark" SG_ 620 IL_PADS_LightbarSt "";
BA_ "EventCommandSignal" SG_ 380 DCUF_1_CRC 0;
BA_ "GatewayedSignals" SG_ 380 DCUF_1_CRC 0;
BA_ "GenSigInactiveValue" SG_ 380 DCUF_1_CRC 0;
BA_ "GenSigInvalidValue" SG_ 380 DCUF_1_CRC 0;
BA_ "GenSigSendType" SG_ 380 DCUF_1_CRC 1;
BA_ "GenSigStartValue" SG_ 380 DCUF_1_CRC 0;
BA_ "GenSigTimeoutValue" SG_ 380 DCUF_1_CRC 0;
BA_ "Remark" SG_ 380 DCUF_1_CRC "涉及ID管理表";
BA_ "EventCommandSignal" SG_ 380 DCUF_1_Counter 0;
BA_ "GatewayedSignals" SG_ 380 DCUF_1_Counter 0;
BA_ "GenSigInactiveValue" SG_ 380 DCUF_1_Counter 0;
BA_ "GenSigInvalidValue" SG_ 380 DCUF_1_Counter 0;
BA_ "GenSigSendType" SG_ 380 DCUF_1_Counter 1;
BA_ "GenSigStartValue" SG_ 380 DCUF_1_Counter 0;
BA_ "GenSigTimeoutValue" SG_ 380 DCUF_1_Counter 0;
BA_ "Remark" SG_ 380 DCUF_1_Counter "涉及ID管理表";
BA_ "EventCommandSignal" SG_ 380 DCUF_RotSpdAct 0;
BA_ "GatewayedSignals" SG_ 380 DCUF_RotSpdAct 0;
BA_ "GenSigInactiveValue" SG_ 380 DCUF_RotSpdAct 0;
BA_ "GenSigInvalidValue" SG_ 380 DCUF_RotSpdAct 65535;
BA_ "GenSigSendType" SG_ 380 DCUF_RotSpdAct 1;
BA_ "GenSigStartValue" SG_ 380 DCUF_RotSpdAct 32767;
BA_ "GenSigTimeoutValue" SG_ 380 DCUF_RotSpdAct 0;
BA_ "Remark" SG_ 380 DCUF_RotSpdAct "涉及ID管理表";
BA_ "EventCommandSignal" SG_ 380 DCUF_DiagErrCode 0;
BA_ "GatewayedSignals" SG_ 380 DCUF_DiagErrCode 0;
BA_ "GenSigInactiveValue" SG_ 380 DCUF_DiagErrCode 0;
BA_ "GenSigInvalidValue" SG_ 380 DCUF_DiagErrCode 0;
BA_ "GenSigSendType" SG_ 380 DCUF_DiagErrCode 1;
BA_ "GenSigStartValue" SG_ 380 DCUF_DiagErrCode 0;
BA_ "GenSigTimeoutValue" SG_ 380 DCUF_DiagErrCode 0;
BA_ "Remark" SG_ 380 DCUF_DiagErrCode "涉及ID管理表";
BA_ "EventCommandSignal" SG_ 380 DCUF_ModeSt 0;
BA_ "GatewayedSignals" SG_ 380 DCUF_ModeSt 0;
BA_ "GenSigInactiveValue" SG_ 380 DCUF_ModeSt 0;
BA_ "GenSigInvalidValue" SG_ 380 DCUF_ModeSt 0;
BA_ "GenSigSendType" SG_ 380 DCUF_ModeSt 1;
BA_ "GenSigStartValue" SG_ 380 DCUF_ModeSt 1;
BA_ "GenSigTimeoutValue" SG_ 380 DCUF_ModeSt 0;
BA_ "Remark" SG_ 380 DCUF_ModeSt "涉及ID管理表";
BA_ "EventCommandSignal" SG_ 380 DCUF_TorqAct 0;
BA_ "GatewayedSignals" SG_ 380 DCUF_TorqAct 0;
BA_ "GenSigInactiveValue" SG_ 380 DCUF_TorqAct 0;
BA_ "GenSigInvalidValue" SG_ 380 DCUF_TorqAct 0;
BA_ "GenSigSendType" SG_ 380 DCUF_TorqAct 1;
BA_ "GenSigStartValue" SG_ 380 DCUF_TorqAct 4095;
BA_ "GenSigTimeoutValue" SG_ 380 DCUF_TorqAct 0;
BA_ "Remark" SG_ 380 DCUF_TorqAct "涉及ID管理表";
BA_ "EventCommandSignal" SG_ 380 DCUF_ADC_MCUBlkst 0;
BA_ "GatewayedSignals" SG_ 380 DCUF_ADC_MCUBlkst 0;
BA_ "GenSigInactiveValue" SG_ 380 DCUF_ADC_MCUBlkst 0;
BA_ "GenSigInvalidValue" SG_ 380 DCUF_ADC_MCUBlkst 7;
BA_ "GenSigSendType" SG_ 380 DCUF_ADC_MCUBlkst 1;
BA_ "GenSigStartValue" SG_ 380 DCUF_ADC_MCUBlkst 0;
BA_ "GenSigTimeoutValue" SG_ 380 DCUF_ADC_MCUBlkst 0;
BA_ "Remark" SG_ 380 DCUF_ADC_MCUBlkst "涉及ID管理表";
BA_ "EventCommandSignal" SG_ 380 DCUF_ADC_SpdSvModAvl 0;
BA_ "GatewayedSignals" SG_ 380 DCUF_ADC_SpdSvModAvl 0;
BA_ "GenSigInactiveValue" SG_ 380 DCUF_ADC_SpdSvModAvl 0;
BA_ "GenSigInvalidValue" SG_ 380 DCUF_ADC_SpdSvModAvl 1;
BA_ "GenSigSendType" SG_ 380 DCUF_ADC_SpdSvModAvl 1;
BA_ "GenSigStartValue" SG_ 380 DCUF_ADC_SpdSvModAvl 0;
BA_ "GenSigTimeoutValue" SG_ 380 DCUF_ADC_SpdSvModAvl 0;
BA_ "Remark" SG_ 380 DCUF_ADC_SpdSvModAvl "涉及ID管理表";
BA_ "EventCommandSignal" SG_ 380 DCUF_ADC_MCUStandstill 0;
BA_ "GatewayedSignals" SG_ 380 DCUF_ADC_MCUStandstill 0;
BA_ "GenSigInactiveValue" SG_ 380 DCUF_ADC_MCUStandstill 0;
BA_ "GenSigInvalidValue" SG_ 380 DCUF_ADC_MCUStandstill 1;
BA_ "GenSigSendType" SG_ 380 DCUF_ADC_MCUStandstill 1;
BA_ "GenSigStartValue" SG_ 380 DCUF_ADC_MCUStandstill 0;
BA_ "GenSigTimeoutValue" SG_ 380 DCUF_ADC_MCUStandstill 0;
BA_ "Remark" SG_ 380 DCUF_ADC_MCUStandstill "涉及ID管理表";
BA_ "EventCommandSignal" SG_ 380 DCUF_ADC_MCUSpdSVModFlt 0;
BA_ "GatewayedSignals" SG_ 380 DCUF_ADC_MCUSpdSVModFlt 0;
BA_ "GenSigInactiveValue" SG_ 380 DCUF_ADC_MCUSpdSVModFlt 0;
BA_ "GenSigInvalidValue" SG_ 380 DCUF_ADC_MCUSpdSVModFlt 7;
BA_ "GenSigSendType" SG_ 380 DCUF_ADC_MCUSpdSVModFlt 1;
BA_ "GenSigStartValue" SG_ 380 DCUF_ADC_MCUSpdSVModFlt 0;
BA_ "GenSigTimeoutValue" SG_ 380 DCUF_ADC_MCUSpdSVModFlt 0;
BA_ "Remark" SG_ 380 DCUF_ADC_MCUSpdSVModFlt "涉及ID管理表";
BA_ "EventCommandSignal" SG_ 380 DCUF_ADC_MCUVehSldSt 0;
BA_ "GatewayedSignals" SG_ 380 DCUF_ADC_MCUVehSldSt 0;
BA_ "GenSigInactiveValue" SG_ 380 DCUF_ADC_MCUVehSldSt 0;
BA_ "GenSigInvalidValue" SG_ 380 DCUF_ADC_MCUVehSldSt 1;
BA_ "GenSigSendType" SG_ 380 DCUF_ADC_MCUVehSldSt 1;
BA_ "GenSigStartValue" SG_ 380 DCUF_ADC_MCUVehSldSt 0;
BA_ "GenSigTimeoutValue" SG_ 380 DCUF_ADC_MCUVehSldSt 0;
BA_ "Remark" SG_ 380 DCUF_ADC_MCUVehSldSt "涉及ID管理表";
BA_ "EventCommandSignal" SG_ 380 DCUF_ADC_MCUReqTq 0;
BA_ "GatewayedSignals" SG_ 380 DCUF_ADC_MCUReqTq 0;
BA_ "GenSigInactiveValue" SG_ 380 DCUF_ADC_MCUReqTq 0;
BA_ "GenSigInvalidValue" SG_ 380 DCUF_ADC_MCUReqTq 2047;
BA_ "GenSigSendType" SG_ 380 DCUF_ADC_MCUReqTq 1;
BA_ "GenSigStartValue" SG_ 380 DCUF_ADC_MCUReqTq 1023;
BA_ "GenSigTimeoutValue" SG_ 380 DCUF_ADC_MCUReqTq 0;
BA_ "Remark" SG_ 380 DCUF_ADC_MCUReqTq "涉及ID管理表";
BA_ "EventCommandSignal" SG_ 778 ZCUR_11_CRC 0;
BA_ "GatewayedSignals" SG_ 778 ZCUR_11_CRC 0;
BA_ "GenSigInactiveValue" SG_ 778 ZCUR_11_CRC 0;
BA_ "GenSigInvalidValue" SG_ 778 ZCUR_11_CRC 0;
BA_ "GenSigSendType" SG_ 778 ZCUR_11_CRC 1;
BA_ "GenSigStartValue" SG_ 778 ZCUR_11_CRC 0;
BA_ "GenSigTimeoutValue" SG_ 778 ZCUR_11_CRC 0;
BA_ "Remark" SG_ 778 ZCUR_11_CRC "";
BA_ "EventCommandSignal" SG_ 778 ZCUR_11_Counter 0;
BA_ "GatewayedSignals" SG_ 778 ZCUR_11_Counter 0;
BA_ "GenSigInactiveValue" SG_ 778 ZCUR_11_Counter 0;
BA_ "GenSigInvalidValue" SG_ 778 ZCUR_11_Counter 0;
BA_ "GenSigSendType" SG_ 778 ZCUR_11_Counter 1;
BA_ "GenSigStartValue" SG_ 778 ZCUR_11_Counter 0;
BA_ "GenSigTimeoutValue" SG_ 778 ZCUR_11_Counter 0;
BA_ "Remark" SG_ 778 ZCUR_11_Counter "";
BA_ "EventCommandSignal" SG_ 778 EL_SideBrkLightSt 0;
BA_ "GatewayedSignals" SG_ 778 EL_SideBrkLightSt 0;
BA_ "GenSigInactiveValue" SG_ 778 EL_SideBrkLightSt 0;
BA_ "GenSigInvalidValue" SG_ 778 EL_SideBrkLightSt 0;
BA_ "GenSigSendType" SG_ 778 EL_SideBrkLightSt 1;
BA_ "GenSigStartValue" SG_ 778 EL_SideBrkLightSt 0;
BA_ "GenSigTimeoutValue" SG_ 778 EL_SideBrkLightSt 0;
BA_ "Remark" SG_ 778 EL_SideBrkLightSt "";
BA_ "EventCommandSignal" SG_ 778 EL_SideBrkLightFaultSt 0;
BA_ "GatewayedSignals" SG_ 778 EL_SideBrkLightFaultSt 0;
BA_ "GenSigInactiveValue" SG_ 778 EL_SideBrkLightFaultSt 0;
BA_ "GenSigInvalidValue" SG_ 778 EL_SideBrkLightFaultSt 0;
BA_ "GenSigSendType" SG_ 778 EL_SideBrkLightFaultSt 1;
BA_ "GenSigStartValue" SG_ 778 EL_SideBrkLightFaultSt 0;
BA_ "GenSigTimeoutValue" SG_ 778 EL_SideBrkLightFaultSt 0;
BA_ "Remark" SG_ 778 EL_SideBrkLightFaultSt "";
BA_ "EventCommandSignal" SG_ 778 EL_CHMSLSt 0;
BA_ "GatewayedSignals" SG_ 778 EL_CHMSLSt 0;
BA_ "GenSigInactiveValue" SG_ 778 EL_CHMSLSt 0;
BA_ "GenSigInvalidValue" SG_ 778 EL_CHMSLSt 0;
BA_ "GenSigSendType" SG_ 778 EL_CHMSLSt 1;
BA_ "GenSigStartValue" SG_ 778 EL_CHMSLSt 0;
BA_ "GenSigTimeoutValue" SG_ 778 EL_CHMSLSt 0;
BA_ "Remark" SG_ 778 EL_CHMSLSt "";
BA_ "EventCommandSignal" SG_ 778 EL_CHMSLFaultSt 0;
BA_ "GatewayedSignals" SG_ 778 EL_CHMSLFaultSt 0;
BA_ "GenSigInactiveValue" SG_ 778 EL_CHMSLFaultSt 0;
BA_ "GenSigInvalidValue" SG_ 778 EL_CHMSLFaultSt 0;
BA_ "GenSigSendType" SG_ 778 EL_CHMSLFaultSt 1;
BA_ "GenSigStartValue" SG_ 778 EL_CHMSLFaultSt 0;
BA_ "GenSigTimeoutValue" SG_ 778 EL_CHMSLFaultSt 0;
BA_ "Remark" SG_ 778 EL_CHMSLFaultSt "";
BA_ "EventCommandSignal" SG_ 778 EL_RLTurnLightSt 0;
BA_ "GatewayedSignals" SG_ 778 EL_RLTurnLightSt 0;
BA_ "GenSigInactiveValue" SG_ 778 EL_RLTurnLightSt 0;
BA_ "GenSigInvalidValue" SG_ 778 EL_RLTurnLightSt 0;
BA_ "GenSigSendType" SG_ 778 EL_RLTurnLightSt 1;
BA_ "GenSigStartValue" SG_ 778 EL_RLTurnLightSt 0;
BA_ "GenSigTimeoutValue" SG_ 778 EL_RLTurnLightSt 0;
BA_ "Remark" SG_ 778 EL_RLTurnLightSt "";
BA_ "EventCommandSignal" SG_ 778 EL_RLTurnLightFaultSt 0;
BA_ "GatewayedSignals" SG_ 778 EL_RLTurnLightFaultSt 0;
BA_ "GenSigInactiveValue" SG_ 778 EL_RLTurnLightFaultSt 0;
BA_ "GenSigInvalidValue" SG_ 778 EL_RLTurnLightFaultSt 0;
BA_ "GenSigSendType" SG_ 778 EL_RLTurnLightFaultSt 1;
BA_ "GenSigStartValue" SG_ 778 EL_RLTurnLightFaultSt 0;
BA_ "GenSigTimeoutValue" SG_ 778 EL_RLTurnLightFaultSt 0;
BA_ "Remark" SG_ 778 EL_RLTurnLightFaultSt "";
BA_ "EventCommandSignal" SG_ 778 EL_RRTurnLightSt 0;
BA_ "GatewayedSignals" SG_ 778 EL_RRTurnLightSt 0;
BA_ "GenSigInactiveValue" SG_ 778 EL_RRTurnLightSt 0;
BA_ "GenSigInvalidValue" SG_ 778 EL_RRTurnLightSt 0;
BA_ "GenSigSendType" SG_ 778 EL_RRTurnLightSt 1;
BA_ "GenSigStartValue" SG_ 778 EL_RRTurnLightSt 0;
BA_ "GenSigTimeoutValue" SG_ 778 EL_RRTurnLightSt 0;
BA_ "Remark" SG_ 778 EL_RRTurnLightSt "";
BA_ "EventCommandSignal" SG_ 778 EL_RRTurnLightFaultSt 0;
BA_ "GatewayedSignals" SG_ 778 EL_RRTurnLightFaultSt 0;
BA_ "GenSigInactiveValue" SG_ 778 EL_RRTurnLightFaultSt 0;
BA_ "GenSigInvalidValue" SG_ 778 EL_RRTurnLightFaultSt 0;
BA_ "GenSigSendType" SG_ 778 EL_RRTurnLightFaultSt 1;
BA_ "GenSigStartValue" SG_ 778 EL_RRTurnLightFaultSt 0;
BA_ "GenSigTimeoutValue" SG_ 778 EL_RRTurnLightFaultSt 0;
BA_ "Remark" SG_ 778 EL_RRTurnLightFaultSt "";
BA_ "EventCommandSignal" SG_ 778 EL_RADASLightSt 0;
BA_ "GatewayedSignals" SG_ 778 EL_RADASLightSt 0;
BA_ "GenSigInactiveValue" SG_ 778 EL_RADASLightSt 0;
BA_ "GenSigInvalidValue" SG_ 778 EL_RADASLightSt 0;
BA_ "GenSigSendType" SG_ 778 EL_RADASLightSt 1;
BA_ "GenSigStartValue" SG_ 778 EL_RADASLightSt 0;
BA_ "GenSigTimeoutValue" SG_ 778 EL_RADASLightSt 0;
BA_ "Remark" SG_ 778 EL_RADASLightSt "";
BA_ "EventCommandSignal" SG_ 704 IPS_1_CRC 0;
BA_ "GatewayedSignals" SG_ 704 IPS_1_CRC 0;
BA_ "GenSigInactiveValue" SG_ 704 IPS_1_CRC 0;
BA_ "GenSigInvalidValue" SG_ 704 IPS_1_CRC 0;
BA_ "GenSigSendType" SG_ 704 IPS_1_CRC 1;
BA_ "GenSigStartValue" SG_ 704 IPS_1_CRC 0;
BA_ "GenSigTimeoutValue" SG_ 704 IPS_1_CRC 0;
BA_ "Remark" SG_ 704 IPS_1_CRC "";
BA_ "EventCommandSignal" SG_ 704 IPS_1_Counter 0;
BA_ "GatewayedSignals" SG_ 704 IPS_1_Counter 0;
BA_ "GenSigInactiveValue" SG_ 704 IPS_1_Counter 0;
BA_ "GenSigInvalidValue" SG_ 704 IPS_1_Counter 0;
BA_ "GenSigSendType" SG_ 704 IPS_1_Counter 1;
BA_ "GenSigStartValue" SG_ 704 IPS_1_Counter 0;
BA_ "GenSigTimeoutValue" SG_ 704 IPS_1_Counter 0;
BA_ "Remark" SG_ 704 IPS_1_Counter "";
BA_ "EventCommandSignal" SG_ 704 IPS_DCDCModeSt 0;
BA_ "GatewayedSignals" SG_ 704 IPS_DCDCModeSt 0;
BA_ "GenSigInactiveValue" SG_ 704 IPS_DCDCModeSt 0;
BA_ "GenSigInvalidValue" SG_ 704 IPS_DCDCModeSt 0;
BA_ "GenSigSendType" SG_ 704 IPS_DCDCModeSt 1;
BA_ "GenSigStartValue" SG_ 704 IPS_DCDCModeSt 0;
BA_ "GenSigTimeoutValue" SG_ 704 IPS_DCDCModeSt 0;
BA_ "Remark" SG_ 704 IPS_DCDCModeSt "";
BA_ "EventCommandSignal" SG_ 794 LBMSAD_1_CRC 0;
BA_ "GatewayedSignals" SG_ 794 LBMSAD_1_CRC 0;
BA_ "GenSigInactiveValue" SG_ 794 LBMSAD_1_CRC 0;
BA_ "GenSigInvalidValue" SG_ 794 LBMSAD_1_CRC 0;
BA_ "GenSigSendType" SG_ 794 LBMSAD_1_CRC 1;
BA_ "GenSigStartValue" SG_ 794 LBMSAD_1_CRC 0;
BA_ "GenSigTimeoutValue" SG_ 794 LBMSAD_1_CRC 0;
BA_ "Remark" SG_ 794 LBMSAD_1_CRC "";
BA_ "EventCommandSignal" SG_ 794 LBMSAD_1_Counter 0;
BA_ "GatewayedSignals" SG_ 794 LBMSAD_1_Counter 0;
BA_ "GenSigInactiveValue" SG_ 794 LBMSAD_1_Counter 0;
BA_ "GenSigInvalidValue" SG_ 794 LBMSAD_1_Counter 0;
BA_ "GenSigSendType" SG_ 794 LBMSAD_1_Counter 1;
BA_ "GenSigStartValue" SG_ 794 LBMSAD_1_Counter 0;
BA_ "GenSigTimeoutValue" SG_ 794 LBMSAD_1_Counter 0;
BA_ "Remark" SG_ 794 LBMSAD_1_Counter "";
BA_ "EventCommandSignal" SG_ 794 LBMSAD_SOFVD 0;
BA_ "GatewayedSignals" SG_ 794 LBMSAD_SOFVD 0;
BA_ "GenSigInactiveValue" SG_ 794 LBMSAD_SOFVD 0;
BA_ "GenSigInvalidValue" SG_ 794 LBMSAD_SOFVD 0;
BA_ "GenSigSendType" SG_ 794 LBMSAD_SOFVD 1;
BA_ "GenSigStartValue" SG_ 794 LBMSAD_SOFVD 0;
BA_ "GenSigTimeoutValue" SG_ 794 LBMSAD_SOFVD 0;
BA_ "Remark" SG_ 794 LBMSAD_SOFVD "";
BA_ "EventCommandSignal" SG_ 794 LBMSAD_SOFEN 0;
BA_ "GatewayedSignals" SG_ 794 LBMSAD_SOFEN 0;
BA_ "GenSigInactiveValue" SG_ 794 LBMSAD_SOFEN 0;
BA_ "GenSigInvalidValue" SG_ 794 LBMSAD_SOFEN 0;
BA_ "GenSigSendType" SG_ 794 LBMSAD_SOFEN 1;
BA_ "GenSigStartValue" SG_ 794 LBMSAD_SOFEN 0;
BA_ "GenSigTimeoutValue" SG_ 794 LBMSAD_SOFEN 0;
BA_ "Remark" SG_ 794 LBMSAD_SOFEN "";
BA_ "EventCommandSignal" SG_ 619 EPB_SwitchSt_L 0;
BA_ "GatewayedSignals" SG_ 619 EPB_SwitchSt_L 0;
BA_ "GenSigInactiveValue" SG_ 619 EPB_SwitchSt_L 0;
BA_ "GenSigInvalidValue" SG_ 619 EPB_SwitchSt_L 0;
BA_ "GenSigSendType" SG_ 619 EPB_SwitchSt_L 1;
BA_ "GenSigStartValue" SG_ 619 EPB_SwitchSt_L 0;
BA_ "GenSigTimeoutValue" SG_ 619 EPB_SwitchSt_L 0;
BA_ "Remark" SG_ 619 EPB_SwitchSt_L "涉及ID管理表";
BA_ "EventCommandSignal" SG_ 619 EPB_SwitchStVD_L 0;
BA_ "GatewayedSignals" SG_ 619 EPB_SwitchStVD_L 0;
BA_ "GenSigInactiveValue" SG_ 619 EPB_SwitchStVD_L 0;
BA_ "GenSigInvalidValue" SG_ 619 EPB_SwitchStVD_L 0;
BA_ "GenSigSendType" SG_ 619 EPB_SwitchStVD_L 1;
BA_ "GenSigStartValue" SG_ 619 EPB_SwitchStVD_L 0;
BA_ "GenSigTimeoutValue" SG_ 619 EPB_SwitchStVD_L 0;
BA_ "Remark" SG_ 619 EPB_SwitchStVD_L "涉及ID管理表";
BA_ "EventCommandSignal" SG_ 529 EBB_BrkPedalAppliedSt 0;
BA_ "GatewayedSignals" SG_ 529 EBB_BrkPedalAppliedSt 0;
BA_ "GenSigInactiveValue" SG_ 529 EBB_BrkPedalAppliedSt 0;
BA_ "GenSigInvalidValue" SG_ 529 EBB_BrkPedalAppliedSt 0;
BA_ "GenSigSendType" SG_ 529 EBB_BrkPedalAppliedSt 1;
BA_ "GenSigStartValue" SG_ 529 EBB_BrkPedalAppliedSt 0;
BA_ "GenSigTimeoutValue" SG_ 529 EBB_BrkPedalAppliedSt 0;
BA_ "Remark" SG_ 529 EBB_BrkPedalAppliedSt "";
BA_ "EventCommandSignal" SG_ 529 EBB_BrkPedalApplied 0;
BA_ "GatewayedSignals" SG_ 529 EBB_BrkPedalApplied 0;
BA_ "GenSigInactiveValue" SG_ 529 EBB_BrkPedalApplied 0;
BA_ "GenSigInvalidValue" SG_ 529 EBB_BrkPedalApplied 0;
BA_ "GenSigSendType" SG_ 529 EBB_BrkPedalApplied 1;
BA_ "GenSigStartValue" SG_ 529 EBB_BrkPedalApplied 0;
BA_ "GenSigTimeoutValue" SG_ 529 EBB_BrkPedalApplied 0;
BA_ "Remark" SG_ 529 EBB_BrkPedalApplied "";
BA_ "EventCommandSignal" SG_ 529 EBB_ActOutputRodTravelSt 0;
BA_ "GatewayedSignals" SG_ 529 EBB_ActOutputRodTravelSt 0;
BA_ "GenSigInactiveValue" SG_ 529 EBB_ActOutputRodTravelSt 0;
BA_ "GenSigInvalidValue" SG_ 529 EBB_ActOutputRodTravelSt 0;
BA_ "GenSigSendType" SG_ 529 EBB_ActOutputRodTravelSt 1;
BA_ "GenSigStartValue" SG_ 529 EBB_ActOutputRodTravelSt 0;
BA_ "GenSigTimeoutValue" SG_ 529 EBB_ActOutputRodTravelSt 0;
BA_ "Remark" SG_ 529 EBB_ActOutputRodTravelSt "";
BA_ "EventCommandSignal" SG_ 529 EBB_ActOutputRodTravel 0;
BA_ "GatewayedSignals" SG_ 529 EBB_ActOutputRodTravel 0;
BA_ "GenSigInactiveValue" SG_ 529 EBB_ActOutputRodTravel 0;
BA_ "GenSigInvalidValue" SG_ 529 EBB_ActOutputRodTravel 0;
BA_ "GenSigSendType" SG_ 529 EBB_ActOutputRodTravel 1;
BA_ "GenSigStartValue" SG_ 529 EBB_ActOutputRodTravel 320;
BA_ "GenSigTimeoutValue" SG_ 529 EBB_ActOutputRodTravel 0;
BA_ "Remark" SG_ 529 EBB_ActOutputRodTravel "";
BA_ "EventCommandSignal" SG_ 529 EBB_PlungerPressure 0;
BA_ "GatewayedSignals" SG_ 529 EBB_PlungerPressure 0;
BA_ "GenSigInactiveValue" SG_ 529 EBB_PlungerPressure 0;
BA_ "GenSigInvalidValue" SG_ 529 EBB_PlungerPressure 0;
BA_ "GenSigSendType" SG_ 529 EBB_PlungerPressure 1;
BA_ "GenSigStartValue" SG_ 529 EBB_PlungerPressure 0;
BA_ "GenSigTimeoutValue" SG_ 529 EBB_PlungerPressure 0;
BA_ "Remark" SG_ 529 EBB_PlungerPressure "";
BA_ "EventCommandSignal" SG_ 529 EBB_PlungerPressureSt 0;
BA_ "GatewayedSignals" SG_ 529 EBB_PlungerPressureSt 0;
BA_ "GenSigInactiveValue" SG_ 529 EBB_PlungerPressureSt 0;
BA_ "GenSigInvalidValue" SG_ 529 EBB_PlungerPressureSt 0;
BA_ "GenSigSendType" SG_ 529 EBB_PlungerPressureSt 1;
BA_ "GenSigStartValue" SG_ 529 EBB_PlungerPressureSt 0;
BA_ "GenSigTimeoutValue" SG_ 529 EBB_PlungerPressureSt 0;
BA_ "Remark" SG_ 529 EBB_PlungerPressureSt "";
BA_ "EventCommandSignal" SG_ 529 EBB_SimulatorPressure 0;
BA_ "GatewayedSignals" SG_ 529 EBB_SimulatorPressure 0;
BA_ "GenSigInactiveValue" SG_ 529 EBB_SimulatorPressure 0;
BA_ "GenSigInvalidValue" SG_ 529 EBB_SimulatorPressure 0;
BA_ "GenSigSendType" SG_ 529 EBB_SimulatorPressure 1;
BA_ "GenSigStartValue" SG_ 529 EBB_SimulatorPressure 0;
BA_ "GenSigTimeoutValue" SG_ 529 EBB_SimulatorPressure 0;
BA_ "Remark" SG_ 529 EBB_SimulatorPressure "";
BA_ "EventCommandSignal" SG_ 529 EBB_SimulatorPressureSt 0;
BA_ "GatewayedSignals" SG_ 529 EBB_SimulatorPressureSt 0;
BA_ "GenSigInactiveValue" SG_ 529 EBB_SimulatorPressureSt 0;
BA_ "GenSigInvalidValue" SG_ 529 EBB_SimulatorPressureSt 0;
BA_ "GenSigSendType" SG_ 529 EBB_SimulatorPressureSt 1;
BA_ "GenSigStartValue" SG_ 529 EBB_SimulatorPressureSt 0;
BA_ "GenSigTimeoutValue" SG_ 529 EBB_SimulatorPressureSt 0;
BA_ "Remark" SG_ 529 EBB_SimulatorPressureSt "";
BA_ "EventCommandSignal" SG_ 529 EBB_DriverRequestTorq 0;
BA_ "GatewayedSignals" SG_ 529 EBB_DriverRequestTorq 0;
BA_ "GenSigInactiveValue" SG_ 529 EBB_DriverRequestTorq 0;
BA_ "GenSigInvalidValue" SG_ 529 EBB_DriverRequestTorq 0;
BA_ "GenSigSendType" SG_ 529 EBB_DriverRequestTorq 1;
BA_ "GenSigStartValue" SG_ 529 EBB_DriverRequestTorq 0;
BA_ "GenSigTimeoutValue" SG_ 529 EBB_DriverRequestTorq 0;
BA_ "Remark" SG_ 529 EBB_DriverRequestTorq "";
BA_ "EventCommandSignal" SG_ 529 EBB_DriverRequestTorqVD 0;
BA_ "GatewayedSignals" SG_ 529 EBB_DriverRequestTorqVD 0;
BA_ "GenSigInactiveValue" SG_ 529 EBB_DriverRequestTorqVD 0;
BA_ "GenSigInvalidValue" SG_ 529 EBB_DriverRequestTorqVD 0;
BA_ "GenSigSendType" SG_ 529 EBB_DriverRequestTorqVD 1;
BA_ "GenSigStartValue" SG_ 529 EBB_DriverRequestTorqVD 0;
BA_ "GenSigTimeoutValue" SG_ 529 EBB_DriverRequestTorqVD 0;
BA_ "Remark" SG_ 529 EBB_DriverRequestTorqVD "";
BA_ "EventCommandSignal" SG_ 529 EBB_ABAactive_B 0;
BA_ "GatewayedSignals" SG_ 529 EBB_ABAactive_B 0;
BA_ "GenSigInactiveValue" SG_ 529 EBB_ABAactive_B 0;
BA_ "GenSigInvalidValue" SG_ 529 EBB_ABAactive_B 0;
BA_ "GenSigSendType" SG_ 529 EBB_ABAactive_B 1;
BA_ "GenSigStartValue" SG_ 529 EBB_ABAactive_B 0;
BA_ "GenSigTimeoutValue" SG_ 529 EBB_ABAactive_B 0;
BA_ "Remark" SG_ 529 EBB_ABAactive_B "";
BA_ "EventCommandSignal" SG_ 529 EBB_ABAavailable_B 0;
BA_ "GatewayedSignals" SG_ 529 EBB_ABAavailable_B 0;
BA_ "GenSigInactiveValue" SG_ 529 EBB_ABAavailable_B 0;
BA_ "GenSigInvalidValue" SG_ 529 EBB_ABAavailable_B 0;
BA_ "GenSigSendType" SG_ 529 EBB_ABAavailable_B 1;
BA_ "GenSigStartValue" SG_ 529 EBB_ABAavailable_B 0;
BA_ "GenSigTimeoutValue" SG_ 529 EBB_ABAavailable_B 0;
BA_ "Remark" SG_ 529 EBB_ABAavailable_B "";
BA_ "EventCommandSignal" SG_ 720 EBB_FWAWarning 0;
BA_ "GatewayedSignals" SG_ 720 EBB_FWAWarning 0;
BA_ "GenSigInactiveValue" SG_ 720 EBB_FWAWarning 0;
BA_ "GenSigInvalidValue" SG_ 720 EBB_FWAWarning 0;
BA_ "GenSigSendType" SG_ 720 EBB_FWAWarning 1;
BA_ "GenSigStartValue" SG_ 720 EBB_FWAWarning 0;
BA_ "GenSigTimeoutValue" SG_ 720 EBB_FWAWarning 0;
BA_ "Remark" SG_ 720 EBB_FWAWarning "";
BA_ "EventCommandSignal" SG_ 445 EMS_TorqControlInhibit 0;
BA_ "GatewayedSignals" SG_ 445 EMS_TorqControlInhibit 0;
BA_ "GenSigInactiveValue" SG_ 445 EMS_TorqControlInhibit 0;
BA_ "GenSigInvalidValue" SG_ 445 EMS_TorqControlInhibit 0;
BA_ "GenSigSendType" SG_ 445 EMS_TorqControlInhibit 1;
BA_ "GenSigStartValue" SG_ 445 EMS_TorqControlInhibit 0;
BA_ "GenSigTimeoutValue" SG_ 445 EMS_TorqControlInhibit 0;
BA_ "Remark" SG_ 445 EMS_TorqControlInhibit "";
BA_ "EventCommandSignal" SG_ 462 EMS_stEngTrqLmt 0;
BA_ "GatewayedSignals" SG_ 462 EMS_stEngTrqLmt 0;
BA_ "GenSigInactiveValue" SG_ 462 EMS_stEngTrqLmt 0;
BA_ "GenSigInvalidValue" SG_ 462 EMS_stEngTrqLmt 0;
BA_ "GenSigSendType" SG_ 462 EMS_stEngTrqLmt 1;
BA_ "GenSigStartValue" SG_ 462 EMS_stEngTrqLmt 0;
BA_ "GenSigTimeoutValue" SG_ 462 EMS_stEngTrqLmt 0;
BA_ "Remark" SG_ 462 EMS_stEngTrqLmt "涉及ID管理表";
VAL_ 618 EPB_SwitchSt 0 "Not active" 1 "Released" 2 "Applied" 3 "Not used"  ;
VAL_ 618 EPB_SwitchStVD 0 "Not valid" 1 "Valid"  ;
VAL_ 618 EPB_SysSt 0 "Release (fully released)" 1 "Apply (fully applied)" 2 "Releasing" 3 "Applying" 4 "Disengaged" 5 "Not used" 6 "Not used" 7 "Fault(not sure position)"  ;
VAL_ 618 EPB_FailSt 0 "No error" 1 "Error"  ;
VAL_ 618 EPB_ExtAvailable 0 "Apply and release" 1 "Only apply" 2 "Only release" 3 "None"  ;
VAL_ 618 EPB_DynamicApplySt 0 "Not active" 1 "BCS dynamic apply" 2 "Anti-Lock Apply" 3 "EPB degraded apply" 4 "Not used" 5 "Not used" 6 "Not used" 7 "Not used"  ;
VAL_ 618 EPB_ActuatorSt_R 0 "PbcActuatorState_Applied" 1 "PbcActuatorState_Released" 2 "PbcActuatorState_Applying" 3 "PbcActuatorState_Releasing" 4 "PbcActuatorState_Unknown" 5 "PbcActuatorState_HoldApplied" 6 "PbcActuatorState_CompletelyReleased" 7 "Not used" 8 "Not used" 9 "Not used" 10 "Not used" 11 "Not used" 12 "Not used" 13 "Not used" 14 "Not used" 15 "Not used"  ;
VAL_ 618 EPB_RWUActvSts 0 "Not active" 1 "CDP active" 2 "RWU active" 3 "Limp home"  ;
VAL_ 618 EPB_RWUAvl 0 "Not available" 1 "Reserved" 2 "RWU available" 3 "Limp home available"  ;
VAL_ 618 EPB_RPAAVPAvailability 0 "NotAvailable" 1 "Available" 2 "TestPending"  ;
VAL_ 618 EPB_APAAvailability 0 "NotAvailable" 1 "Available"  ;
VAL_ 904 ACU_PCS_SVM_MODCmd 0 "Disable" 1 "Enalbe"  ;
VAL_ 904 ACU_HeadLightVirtualSwSt 0 "NotActive" 1 "PositionLight" 2 "LowBeam" 3 "AutoLight"  ;
VAL_ 904 ACU_FrontFogLightVirtualSwSt 0 "Not Active" 1 "Active"  ;
VAL_ 904 ACU_RearFogLightVirtualSwSt 0 "Not Active" 1 "Active"  ;
VAL_ 904 ACU_Account_Uid 0 "No command" 1 "account 0" 2 "account 1" 3 "account 2" 4 "account 3" 5 "account 4" 6 "account 5" 7 "account 6" 8 "account 7" 9 "account 8" 10 "Not used" 11 "Not used" 12 "Not used" 13 "Not used" 14 "Not used" 15 "Not used"  ;
VAL_ 904 ACU_IHBC_SwitchReq 0 "No command" 1 "Not active" 2 "Active" 3 "Not used"  ;
VAL_ 904 ACU_NDASwitchReq 0 "No command" 1 "Not active" 2 "Active" 3 "Not used"  ;
VAL_ 904 ACU_NDALCConSwitchReq 0 "No command" 1 "Need confirm" 2 "No need confirm" 3 "Not used"  ;
VAL_ 904 ACU_NDALCStySwitchReq 0 "No command" 1 "Standard" 2 "Radical" 3 "Not used"  ;
VAL_ 904 ACU_ADASWarnTypeSwitch 0 "No command" 1 "Sound" 2 "Voice" 3 "Seat vibration"  ;
VAL_ 904 ACU_iACC_StyleConfirmSwitchReq 0 "No Command" 1 "Need confirm" 2 "No need confirm" 3 "OFF"  ;
VAL_ 904 ACU_IFC_ISDRestOfdis 0 "not in ISD" 251 "over 70km"  ;
VAL_ 904 ACU_IFC_SpeedLimitUnit 0 "Not used" 1 "Km/h" 2 "Miles/h" 3 "Not used"  ;
VAL_ 904 ACU_ThemeType 0 "Day mode" 1 "Night mode"  ;
VAL_ 904 ACU_IFC_SpeedLimtType 0 "Not specific" 1 "Speed limit camera detection" 2 "Interval speed detectionlimit"  ;
VAL_ 904 ACU_IFC_RoadType 0 "unknown" 1 "High way" 2 "National road" 3 "Provincial road" 4 "County road" 5 "Village road" 6 "City express way" 7 "Major urban road" 8 "Secondary urban road" 9 "Normal urban road" 10 "Non-Navigation Road" 11 "Ramp" 12 "Reserve" 13 "Reserve" 14 "Reserve" 15 "Reserve"  ;
VAL_ 904 ACU_IFC_ZoneCode 0 "Not used" 1 "China"  ;
VAL_ 904 ACU_IFC_NaviSt 0 "Unknown" 1 "Cruise" 2 "Navigate" 3 "Failure"  ;
VAL_ 904 ACU_IFC_NaviCorp 0 "unknown" 1 "Gaode Map" 2 "Tescent Map" 3 "Baidu Map" 4 "Ruitu Map"  ;
VAL_ 904 ACU_IFC_NaviNewIconDis 0 "no newIcon ahead" 21 "over 2.0km"  ;
VAL_ 904 ACU_IFC_OfframpSt 0 "Not off-ramp" 1 "Off-ramp"  ;
VAL_ 904 ACU_IFC_NaviNewIcon 0 "unknown" 1 "left" 2 "right" 3 "left front" 4 "right front" 5 "left rear" 6 "right rear" 7 "left u-turn" 8 "right u-turn" 9 "go straight" 10 "roundabout entrance" 11 "roundabout exit" 12 "service area" 13 "toll station" 14 "tunnel" 15 "not used"  ;
VAL_ 904 ACU_IFC_SLCAheadDis 251 "over 1.25km"  ;
VAL_ 904 ACU_DVR_Switch 0 "Off" 1 "On"  ;
VAL_ 904 ACU_IFC_OfframpDis 254 "over 2km"  ;
VAL_ 904 DrvrSideMotResp 0 "No Action" 1 "Executing Retraction Assistance" 2 "Executing Clearance Removal 1" 3 "Executing Clearance Removal 2" 4 "Executing Dynamic Support 1" 5 "Executing Dynamic Support 2" 6 "Executing Pre-crash Protection" 7 "Executing Vibration Warning 1" 8 "Executing Vibration Warning 2" 9 "Reserved" 10 "Retraction Assistance Completed" 11 "Clearance Removal Completed" 12 "Executing Dynamic Support 3" 13 "Executing Dynamic Support 4" 14 "Executing Vibration Notification" 15 "Timeout"  ;
VAL_ 904 IPDS_BAT1PowerSt 0 "Not Active" 1 "Active"  ;
VAL_ 904 IPDS_BAT2PowerSt 0 "Not Active" 1 "Active"  ;
VAL_ 904 IPDS_DCDC2PowerSt 0 "Not Active" 1 "Active"  ;
VAL_ 904 IPDS_GridIsoPowerSt 0 "Not Active" 1 "Active"  ;
VAL_ 391 DCUR_ModeSt 17 "Pulse Heating" 16 "HillholdCtrl" 15 "Emer_Discharge" 14 "CapDischarge" 13 "BuckDischarge" 12 "Boost Charge" 11 "CapPrecharge" 10 "Reserved" 9 "Offsetcal" 8 "Reserved" 7 "AHF" 6 "Discharge" 5 "SpdCtrl" 4 "TrqCtrl" 3 "Ready" 2 "Standby" 1 "Init" 0 "Reserved"  ;
VAL_ 391 DCUR_ADC_MCUBlkst 0 "no block" 1 "block" 2 "reserved"  ;
VAL_ 391 DCUR_ADC_SpdSvModAvl 0 "not available" 1 "available"  ;
VAL_ 391 DCUR_ADC_MCUStandstill 0 "not standstill" 1 "standstill"  ;
VAL_ 391 DCUR_ADC_MCUSpdSVModFlt 0 "no fault" 1 "excessive output torque fault"  ;
VAL_ 391 DCUR_ADC_MCUVehSldSt 0 "not slide" 1 "slide"  ;
VAL_ 728 CDC_ADCCtrlAvl 0 "Not available" 1 "Available"  ;
VAL_ 728 CDC_ADCCtrlRespSts 0 "No active" 1 "Active"  ;
VAL_ 728 CDC_ADCModState 0 "Initializing" 1 "comfort（low）" 2 "comfort（middle）" 3 "comfort（high）" 4 "sport（low）" 5 "sport（middle）" 6 "sport（high）" 7 "reserve"  ;
VAL_ 459 AS_SuspHeightFLVD 0 "Invalid" 1 "Valid"  ;
VAL_ 459 AS_SuspHeightFRVD 0 "Invalid" 1 "Valid"  ;
VAL_ 459 AS_SuspHeightRLVD 0 "Invalid" 1 "Valid"  ;
VAL_ 459 AS_SuspHeightRRVD 0 "Invalid" 1 "Valid"  ;
VAL_ 459 AS_SuspHeightSensorFLSt 0 "No fault" 1 "Fault"  ;
VAL_ 459 AS_SuspHeightSensorFRSt 0 "No fault" 1 "Fault"  ;
VAL_ 459 AS_SuspHeightSensorRLSt 0 "No fault" 1 "Fault"  ;
VAL_ 459 AS_SuspHeightSensoRRSt 0 "No fault" 1 "Fault"  ;
VAL_ 459 AS_MaintanceModeSt 0 "Disabled" 1 "Inactive" 2 "User activation" 3 "Automatically  activation"  ;
VAL_ 459 ECS_AVDCReqModeAvailable 0 "not available" 1 "available"  ;
VAL_ 459 ECS_AVDCReqMode 0 "inactive" 1 "Small Control" 2 "Middle Control(reserved)" 3 "Big Control"  ;
VAL_ 459 AS_FrontAxleSuspSt 0 "Standby" 1 "Up" 2 "Down" 3 "Reserved"  ;
VAL_ 459 AS_RearAxleSuspSt 0 "Standby" 1 "Up" 2 "Down" 3 "Reserved"  ;
VAL_ 459 AS_HeightWarningSt 0 "Initializing" 1 "Normal" 2 "Too High" 3 "Too Low" 4 "Invalid"  ;
VAL_ 459 AS_CurrentLevel 0 "Invalid" 1 "Very high level" 2 "Between very high and high level" 3 "High level" 4 "Between high and normal level" 5 "Normal level" 6 "Between normal and low level" 7 "Low level" 8 "Between low and very low level" 9 "Very low level" 10 "Between previous level to easy-loading level" 11 "Easy-loading  level" 12 "Between previous level to showrom level" 13 "Showrom level" 14 "Reserved" 15 "Reserved"  ;
VAL_ 459 AS_ASMode 0 "Invalid" 1 "Very high base level (not used)" 2 "High level" 3 "Normal level" 4 "Low level" 5 "Very low  base level (not used)" 6 "Reserved" 7 "Reserved"  ;
VAL_ 459 AS_SysFaultSt 0 "No error" 1 "Fault Level1 (minor)" 2 "Fault Level 2 (seriously)" 3 "Fault Level 3 (Very seriously)" 4 "Reserved" 5 "Reserved" 6 "Reserved" 7 "Reserved"  ;
VAL_ 459 AS_ADCLevelingState 0 "Not active" 1 "Active"  ;
VAL_ 459 AS_SysOperationSt 0 "Invalid" 1 "Lifting" 2 "Lowering" 3 "Holding (current level" 4 "Prohibit adjusting (sub-function or external request prohibit adjusting or low pressure)" 5 "Shut down (overheating without enough pressure and system fault)" 6 "Easy-loading adjusting" 7 "Showrom adjusting" 8 "Reserved" 9 "Reserved" 10 "Reserved" 11 "Reserved" 12 "Reserved" 13 "Reserved" 14 "Reserved" 15 "Reserved"  ;
VAL_ 459 AS_ADCStfnCtrlAvl 0 "Not available" 1 "Available"  ;
VAL_ 459 AS_ADCStfnState 0 "Initializing" 1 "Soft" 2 "Hard"  ;
VAL_ 935 SR_SunroofCurrentPst 255 "Undefined Sunroof position"  ;
VAL_ 776 EL_LeftBSDIndicatorSt 0 "OFF" 1 "ON"  ;
VAL_ 776 UINM_HazardLightSwSt 0 "No Request" 1 "Request"  ;
VAL_ 776 EL_MLTurnLightSt 0 "Not active" 1 "OFF" 2 "ON" 3 "Not used"  ;
VAL_ 776 EL_MLTurnLightFaultSt 0 "Not fault" 1 "Fault"  ;
VAL_ 776 EL_LeftBSDIndicatorFaultSt 0 "Not fault" 1 "Fault"  ;
VAL_ 776 EL_MLADASLightSt 0 "Off" 1 "On" 2 "Fault" 3 "Not used"  ;
VAL_ 776 ZCUL_FrtWindshildHeatSt 0 "No" 1 "Heating" 2 "Fault" 3 "reserve"  ;
VAL_ 793 LBMS_SOFVD 0 "Invalid" 1 "Valid"  ;
VAL_ 793 LBMS_SOFEN 0 "Keep to the side parking False,Original lane parking False" 1 "Keep to the side parking True,Original lane parking False" 2 "Keep to the side parking False,Original lane parking True" 3 "Keep to the side parking True,Original lane parking True"  ;
VAL_ 620 UINM_PADS_ResponseErr 0 "No Error" 1 "Error"  ;
VAL_ 620 UINM_PADS_CustomSWSt 0 "not active;" 1 "active;"  ;
VAL_ 620 UINM_PADS_CustomSWStVD 0 "Not valid" 1 "Valid"  ;
VAL_ 620 UINM_PADS_CustomSWstuck 0 "Normal" 1 "stuck"  ;
VAL_ 620 UINM_PADS_IDC_PlaySWSt 0 "not active;" 1 "active;"  ;
VAL_ 620 UINM_PADS_IDC_PlaySWStVD 0 "Not valid" 1 "Valid"  ;
VAL_ 620 UINM_PADS_CruSetSpeedRollerRotatedDir 0 "Not rotated" 1 "Forward" 2 "Backward" 3 "Not used"  ;
VAL_ 620 UINM_PADS_FolDistIncSWSt 0 "not active;" 1 "active;"  ;
VAL_ 620 UINM_PADS_FolDistIncSWStVD 0 "Not valid" 1 "Valid"  ;
VAL_ 620 UINM_PADS_FolDistIncSWStuckSt 0 "Normal" 1 "stuck"  ;
VAL_ 620 UINM_PADS_FolDistDecSWStVD 0 "Not valid" 1 "Valid"  ;
VAL_ 620 UINM_PADS_FolDistDecSWStuckSt 0 "Normal" 1 "stuck"  ;
VAL_ 620 UINM_PADS_OKSWSt 0 "not active;" 1 "active;"  ;
VAL_ 620 UINM_PADS_OKSWStVD 0 "Not valid" 1 "Valid"  ;
VAL_ 620 UINM_PADS_OKSWStuckSt 0 "Normal" 1 "stuck"  ;
VAL_ 620 UINM_PADS_CruSetSpeedRollerVD 0 "Not valid" 1 "Valid"  ;
VAL_ 620 UINM_PADS_FolDistDecSWSt 0 "not active;" 1 "active;"  ;
VAL_ 620 IL_PADS_LightbarErrSt 0 "No Error" 1 "Error"  ;
VAL_ 620 UINM_PADS_CruSWSt 0 "not active;" 1 "active;"  ;
VAL_ 620 UINM_PADS_CruSWStVD 0 "Not valid" 1 "Valid"  ;
VAL_ 620 UINM_PADS_CruSWStuckSt 0 "Normal" 1 "stuck"  ;
VAL_ 620 UINM_PADS_CruSpeedDecSWSt 0 "not active;" 1 "active;"  ;
VAL_ 620 UINM_PADS_CruSpeedDecSWStVD 0 "Not valid" 1 "Valid"  ;
VAL_ 620 UINM_PADS_CruSpeedDecSWStuckSt 0 "Normal" 1 "stuck"  ;
VAL_ 620 UINM_PADS_CruResumeSpeedIncSWSt 0 "not active;" 1 "active;"  ;
VAL_ 620 UINM_PADS_CruResumeSpeedIncSWStVD 0 "Not valid" 1 "Valid"  ;
VAL_ 620 UINM_PADS_CruResumeSpeedIncSWStuckSt 0 "Normal" 1 "stuck"  ;
VAL_ 620 UINM_PADS_CruTJAICASWSt 0 "not active;" 1 "active;"  ;
VAL_ 620 UINM_PADS_CruTJAICASWStVD 0 "Not valid" 1 "Valid"  ;
VAL_ 620 UINM_PADS_CruTJAICASWStuckSt 0 "Normal" 1 "stuck"  ;
VAL_ 620 UINM_PADS_Custom2SWSt 0 "not active" 1 "active"  ;
VAL_ 620 UINM_PADS_Custom2SWStVD 0 "Not valid" 1 "Valid"  ;
VAL_ 620 UINM_PADS_Custom2SWStuckSt 0 "Normal" 1 "stuck"  ;
VAL_ 620 UINM_PADS_ACCSWSt 0 "not perssed" 1 "short pressed" 2 "long pressed" 3 "reserved"  ;
VAL_ 620 UINM_PADS_VoltageFaultSt 0 "No error" 1 "Low voltage" 2 "High voltage" 3 "Not used"  ;
VAL_ 620 UINM_PADS_L3SWSt 0 "Not Perssed" 1 "Short Pressed" 2 "Long Pressed" 3 "Reserved"  ;
VAL_ 620 UINM_PADS_L3SWStVD 0 "Not Valid" 1 "Valid"  ;
VAL_ 620 UINM_PADS_L3SWStuckSt 0 "Normal" 1 "Stuck"  ;
VAL_ 620 IL_PADS_LightbarSt 0 "Off;" 1 "White;" 2 "Blue;" 3 "Orange;" 4 "Red;" 5 "Reserved;" 6 "Reserved;" 7 "Reserved;" 8 "Reserved;" 9 "Reserved;" 10 "Reserved;" 11 "Reserved;" 12 "Reserved;" 13 "Reserved;" 14 "Reserved;" 15 "Invalid:"  ;
VAL_ 380 DCUF_ModeSt 18 "Self control" 17 "Pulse Heating" 16 "HillholdCtrl" 15 "Emer_Discharge" 14 "CapDischarge" 13 "BuckDischarge" 12 "Boost Charge" 11 "CapPrecharge" 10 "poweroff" 9 "Offsetcal" 8 "Failure" 7 "AHF" 6 "Discharge" 5 "SpdCtrl" 4 "TrqCtrl" 3 "Ready" 2 "Standby" 1 "Init" 0 "Reserved"  ;
VAL_ 380 DCUF_ADC_MCUBlkst 0 "no block" 1 "block" 2 "reserved"  ;
VAL_ 380 DCUF_ADC_SpdSvModAvl 0 "not available" 1 "available"  ;
VAL_ 380 DCUF_ADC_MCUStandstill 0 "not standstill" 1 "standstill"  ;
VAL_ 380 DCUF_ADC_MCUSpdSVModFlt 0 "no fault" 1 "excessive output torque fault"  ;
VAL_ 380 DCUF_ADC_MCUVehSldSt 0 "not slide" 1 "slide"  ;
VAL_ 778 EL_SideBrkLightSt 0 "OFF" 1 "ON"  ;
VAL_ 778 EL_SideBrkLightFaultSt 0 "Not fault" 1 "Fault"  ;
VAL_ 778 EL_CHMSLSt 0 "OFF" 1 "ON"  ;
VAL_ 778 EL_CHMSLFaultSt 0 "Not fault" 1 "Fault"  ;
VAL_ 778 EL_RLTurnLightSt 0 "Not active" 1 "OFF" 2 "ON" 3 "Not used"  ;
VAL_ 778 EL_RLTurnLightFaultSt 0 "Not fault" 1 "Fault"  ;
VAL_ 778 EL_RRTurnLightSt 0 "Not active" 1 "OFF" 2 "ON" 3 "Not used"  ;
VAL_ 778 EL_RRTurnLightFaultSt 0 "Not fault" 1 "Fault"  ;
VAL_ 778 EL_RADASLightSt 0 "Off" 1 "On" 2 "Fault" 3 "Not used"  ;
VAL_ 704 IPS_DCDCModeSt 7 "Failure;" 3 "Active - Buck Mode;" 2 "Connected (HV is active);" 1 "Disconnected;" 0 "Init;"  ;
VAL_ 794 LBMSAD_SOFVD 0 "Invalid" 1 "Valid"  ;
VAL_ 794 LBMSAD_SOFEN 0 "Keep to the side parking False,Original lane parking False" 1 "Keep to the side parking True,Original lane parking False" 2 "Keep to the side parking False,Original lane parking True" 3 "Keep to the side parking True,Original lane parking True"  ;
VAL_ 619 EPB_SwitchSt_L 0 "Not active" 1 "Released" 2 "Applied" 3 "Not used"  ;
VAL_ 619 EPB_SwitchStVD_L 0 "Not valid" 1 "Valid"  ;
VAL_ 529 EBB_ActOutputRodTravelSt 0 "NotInitialized" 1 "Normal" 2 "Faulty" 3 "Reserved"  ;
VAL_ 529 EBB_ABAactive_B 0 "Not active" 1 "Active"  ;
VAL_ 529 EBB_ABAavailable_B 0 "Not available" 1 "Available"  ;
VAL_ 720 EBB_FWAWarning 0 "no failure/Init/Default" 1 "Warnig level 1 for high Temp. of Brake system" 2 "Warnig level 2 for high Temp. of Brake system" 3 "reserved"  ;
VAL_ 445 EMS_TorqControlInhibit 0 "Not active" 1 "Active"  ;
VAL_ 462 EMS_stEngTrqLmt 0 "No limit" 1 "limit by high Engine temperature" 2 "limit by knock control" 3 "limit by high intake air temperature" 4 "limit by GPF" 5 "limit by EGR valve block" 6 "limit by high exhaust temperature" 7 "reserved" 255 "not used"  ;
