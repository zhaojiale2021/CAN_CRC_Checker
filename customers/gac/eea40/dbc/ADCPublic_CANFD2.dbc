VERSION "Version"

NS_ :

BS_:

BU_: Tester IBCS EPS ADC CCU CCU_CCURT1 CCU_CCURT2 EPB_IBCS EBB ZCUF ZCUL ZCUR ZCUT EMS IDM DCDC IPS NIDU NIDUF DCUR OBC OPC LPC CPC EMCM GCU DCUF IPU BMS EOPF EOPR EVCC DCDC2 EDL SRS ECS EPB RBM ICM IID IDC PHUDD AMP WHUD IMR INU IFC FAPA RRR RLR PAS PCS SCMR SCMRL SCMRR HVSMR SCMRM MFS WSM DRM IDU FCP LBMSAD AVAS ATSS DLPFL FBLCM FLISD FLLCM FRLCM RLLCMA RLLCMB RRLCMA RRLCMB RLISD DLPML DLPMR TRM PSDL PSDR HVSPRL HVSPRR RFR SBM WCM ETC TBOX2 TBOX CCURT1 CCURT2 RT1_C0 RT1_C1 RT2_C3 CBM RAS TMC SCMT PLGM LBMS RLBMS IDUR OTAWL RCICP WCMFR WCMRL LPC2 SAS CD RCP RRISD

BO_ 161 CCU_IDC_1: 64 CCU
 SG_ ACU_FaceID_Delete : 119|4@0+ (1,0) [0|15] ""  ADC,FAPA
 SG_ ACU_RegisterTriger : 115|4@0+ (1,0) [0|15] ""  ADC,FAPA
 SG_ ACU_VerifyTriger : 127|4@0+ (1,0) [0|15] ""  ADC,FAPA
 SG_ ACU_FaceIDQuit : 123|1@0+ (1,0) [0|1] ""  ADC,FAPA
 SG_ ACU_FaceIDSwitch : 122|2@0+ (1,0) [0|3] ""  ADC,FAPA
 SG_ ACU_AVAS_SwitchCfgReq : 273|2@0+ (1,0) [0|3] ""  ZCUF,ZCUL,ADC,FAPA,AVAS

BO_ 432 ICC_1: 64 CCU_CCURT1
 SG_ ICC_1_CRC : 7|16@0+ (1,0) [0|65535] ""  ECS,RAS,EPS,IBCS,ADC
 SG_ ICC_1_Counter : 23|8@0+ (1,0) [0|255] ""  ECS,RAS,EPS,IBCS,ADC
 SG_ ICC_FcnInfo : 87|12@0+ (1,0) [0|4095] ""  ECS,EPS,IBCS,ADC
 SG_ ICC_FaultSt : 91|12@0+ (1,0) [0|4095] ""  ECS,EPS,ADC
 SG_ ICC_ActorSt : 119|8@0+ (1,0) [0|255] ""  ECS,EPS,ADC
 SG_ ICC_FrontLeftTireBlowout : 345|2@0+ (1,0) [0|3] ""  IBCS,ADC
 SG_ ICC_FrontRightTireBlowout : 347|2@0+ (1,0) [0|3] ""  IBCS,ADC
 SG_ ICC_RearRightTireBlowout : 359|2@0+ (1,0) [0|3] ""  IBCS,ADC
 SG_ ICC_RearLeftTireBlowout : 357|2@0+ (1,0) [0|3] ""  IBCS,ADC
 SG_ ICC_RAS_AgCtrlAvl : 353|2@0+ (1,0) [0|3] "/"  ADC
 SG_ ICC_RAS_CalibratedSt : 360|1@0+ (1,1) [0|1] "/"  ADC
 SG_ ICC_RAS_ErrFeedback : 364|4@0+ (1,0) [0|15] "/"  ADC
 SG_ ICC_RAS_AngleVD : 365|1@0+ (1,0) [0|1] "/"  ADC
 SG_ ICC_RAS_PstOverlaySt : 367|2@0+ (1,0) [0|3] "/"  ADC
 SG_ ICC_RAS_SteerMod : 373|3@0+ (1,0) [0|7] "/"  ADC
 SG_ ICC_RAS_SteeringAngle : 370|11@0+ (0.01,-10.23) [-10.23|10.24] "deg"  ADC
 SG_ ICC_RAS_HealthyStForADC : 375|2@0+ (1,0) [0|3] "/"  ADC
 SG_ ICC_RAS_SteeringAngleSpdVD : 389|1@0+ (1,0) [0|1] "/"  ADC
 SG_ ICC_RAS_ThermalSt : 391|2@0+ (1,0) [0|3] "/"  ADC
 SG_ ICC_RAS_SteeringAngleRate : 388|13@0+ (0.01,-22.52) [-22.52|22.53] "°/s"  ADC
 SG_ ICC_RAS_WarnLamp : 411|2@0+ (1,0) [0|3] "/"  ADC
 SG_ ICC_RAS_MotorTorActMot : 407|12@0+ (0.01,-15) [-15|15] "Nm"  ADC
 SG_ ICC_RAS_ADASTargetAngle : 409|11@0+ (0.01,-10.23) [-10.23|10.24] "deg"  ADC

BO_ 433 CCU_GVS_3: 48 CCU_CCURT1
 SG_ CCU_GVS_3_CRC : 7|16@0+ (1,0) [0|65535] ""  ZCUF,ZCUL,ZCUR,ZCUT,EPB,IBCS,ADC,IFC,FAPA
 SG_ CCU_GVS_3_Counter : 23|8@0+ (1,0) [0|255] ""  ZCUF,ZCUL,ZCUR,ZCUT,EPB,IBCS,ADC,IFC,FAPA
 SG_ VCU_VehActDrvTorqRR : 33|14@0+ (1,0) [0|16000] "Nm"  IBCS,ADC,FAPA
 SG_ VCU_MotorRgnCaplTqWhl : 50|14@0+ (1,-16000) [-16000|0] "Nm"  ADC
 SG_ VCU_VehWhlReqTqFAVD : 80|1@0+ (1,0) [0|1] ""  ADC,FAPA
 SG_ VCU_VehWhlReqTqRRVD : 81|1@0+ (1,0) [0|1] ""  ADC,FAPA
 SG_ VCU_VehActDrvTorqRRVD : 189|1@0+ (1,0) [0|1] ""  IBCS,ADC,FAPA
 SG_ VCU_PreStableFlg : 202|1@0+ (1,0) [0|1] ""  ADC,FAPA
 SG_ VCU_VehWhlReqTqRLVD : 207|1@0+ (1,0) [0|1] ""  ADC,FAPA
 SG_ VCU_AccPedalActPstVD : 209|1@0+ (1,0) [0|1] ""  ZCUF,ZCUL,ZCUR,ZCUT,SRS,EPB,IBCS,IDC,ADC,IFC,FAPA
 SG_ VCU_AccPedalActPst : 216|9@0+ (0.2,0) [0|100] "%"  ZCUF,ZCUL,ZCUR,ZCUT,SRS,EPB,IBCS,IDC,ADC,IFC,FAPA
 SG_ VCU_VehWhlReqTqFA : 247|16@0+ (1,-32768) [-32768|32767] "Nm"  ADC,FAPA
 SG_ VCU_VehWhlReqTqRR : 263|16@0+ (1,-32768) [-32768|32767] "Nm"  ADC,FAPA
 SG_ VCU_VehWhlReqTqRL : 279|16@0+ (1,-32768) [-32768|32767] "Nm"  ADC,FAPA
 SG_ VCU_MotorDrvCaplTqWhlFA : 295|16@0+ (1,-32768) [-32768|32767] "Nm"  ADC,FAPA
 SG_ VCU_MotorRgnCaplTqWhlFA : 311|16@0+ (1,-32768) [-32768|32767] "Nm"  ADC,FAPA
 SG_ VCU_MotorDrvCaplTqWhlRL : 327|16@0+ (1,-32768) [-32768|32767] "Nm"  ADC,FAPA
 SG_ VCU_MotorRgnCaplTqWhlRL : 343|16@0+ (1,-32768) [-32768|32767] "Nm"  ADC,FAPA
 SG_ VCU_MotorDrvCaplTqWhlRR : 359|16@0+ (1,-32768) [-32768|32767] "Nm"  ADC,FAPA
 SG_ VCU_GearShiftAvl : 51|1@0+ (1,0) [0|1] ""  ADC,IFC,FAPA
 SG_ VCU_MotorRgnCaplTqWhlVD : 190|1@0+ (1,0) [0|1] ""  ADC,IFC,FAPA
 SG_ VCU_VehWhlReqTqVD : 200|1@0+ (1,0) [0|1] ""  ADC,IFC,FAPA
 SG_ VCU_ErrorFb : 206|4@0+ (1,0) [0|15] ""  ADC,IFC,FAPA
 SG_ VCU_PtTqActvSts : 201|1@0+ (1,0) [0|1] ""  ADC,IFC,FAPA
 SG_ VCU_PtTqAvl : 83|2@0+ (1,0) [0|3] ""  ADC,IFC,FAPA
 SG_ VCU_DriverTorqueDesired : 119|16@0+ (1,-32768) [-32768|32767] "Nm"  ADC,IFC,FAPA
 SG_ VCU_VehWhlReqTq : 135|16@0+ (1,-32768) [-32768|32767] "Nm"  ADC,IFC,FAPA
 SG_ VCU_MotorRgnCaplTqWhlRR : 375|16@0+ (1,-32768) [-32768|32767] "Nm"  ADC,FAPA

BO_ 791 CCU_ZCUL_12: 64 CCU
 SG_ ZCUL_12_CRC : 7|16@0+ (1,0) [0|65535] ""  ADC,IFC,FAPA
 SG_ ZCUL_12_Counter : 23|8@0+ (1,0) [0|255] ""  ADC,IFC,FAPA
 SG_ WW_FWPMotorSt : 27|3@0+ (1,0) [0|7] ""  ADC,IFC,FAPA
 SG_ WW_FWSHMotorSt : 39|2@0+ (1,0) [0|3] ""  ADC,IFC,FAPA
 SG_ HRN_HornRunningSt : 45|2@0+ (1,0) [0|3] ""  ADC,IFC,FAPA
 SG_ HRN_HornWorkingTemplet : 43|4@0+ (1,0) [0|15] ""  ADC,IFC,FAPA
 SG_ EL_FLPositionLightSt : 71|1@0+ (1,0) [0|1] ""  ICM,IDC,ADC,IFC,FAPA
 SG_ EL_FLPositionLightFaultSt : 70|1@0+ (1,0) [0|1] ""  ICM,IDC,ADC,IFC,FAPA
 SG_ EL_FRPositionLightSt : 69|1@0+ (1,0) [0|1] ""  ICM,IDC,ADC,IFC,FAPA
 SG_ EL_FRPositionLightFaultSt : 68|1@0+ (1,0) [0|1] ""  ICM,IDC,ADC,IFC,FAPA
 SG_ EL_LeftLowBeamSt : 67|1@0+ (1,0) [0|1] ""  ICM,IDC,WHUD,ADC,IFC,FAPA
 SG_ EL_LeftLowBeamFaultSt : 66|1@0+ (1,0) [0|1] ""  ICM,IDC,ADC,FAPA
 SG_ EL_RightLowBeamSt : 65|1@0+ (1,0) [0|1] ""  ICM,IDC,ADC,IFC,FAPA
 SG_ EL_RightLowBeamFaultSt : 64|1@0+ (1,0) [0|1] ""  ICM,IDC,ADC,IFC,FAPA
 SG_ EL_LeftHighBeamSt : 79|1@0+ (1,0) [0|1] ""  ICM,IDC,ADC,IFC,FAPA
 SG_ EL_LeftHighBeamFaultSt : 78|1@0+ (1,0) [0|1] ""  ICM,IDC,ADC,IFC,FAPA
 SG_ EL_RightHighBeamSt : 77|1@0+ (1,0) [0|1] ""  ICM,IDC,ADC,IFC,FAPA
 SG_ EL_RightHighBeamFaultSt : 76|1@0+ (1,0) [0|1] ""  ICM,IDC,ADC,IFC,FAPA
 SG_ EL_FLFogLightSt : 75|1@0+ (1,0) [0|1] ""  ICM,IDC,ADC,IFC,FAPA
 SG_ EL_FLFogLightFaultSt : 74|1@0+ (1,0) [0|1] ""  ICM,IDC,ADC,IFC,FAPA
 SG_ EL_FRFogLightSt : 73|1@0+ (1,0) [0|1] ""  ICM,IDC,ADC,IFC,FAPA
 SG_ EL_FRFogLightFaultSt : 72|1@0+ (1,0) [0|1] ""  ICM,IDC,ADC,IFC,FAPA
 SG_ EL_LeftDRLSt : 87|1@0+ (1,0) [0|1] ""  IDC,ADC,IFC,FAPA,PCS
 SG_ EL_LeftDRLFaultSt : 86|1@0+ (1,0) [0|1] ""  ICM,IDC,ADC,IFC,FAPA
 SG_ EL_RightDRLSt : 85|1@0+ (1,0) [0|1] ""  IDC,ADC,IFC,FAPA,PCS
 SG_ EL_RightDRLFaultSt : 84|1@0+ (1,0) [0|1] ""  ICM,IDC,ADC,IFC,FAPA
 SG_ EL_FLTurnLightSt : 95|2@0+ (1,0) [0|3] ""  SRS,ICM,IDC,ADC,IFC,FAPA
 SG_ EL_FLTurnLightFaultSt : 93|1@0+ (1,0) [0|1] ""  SRS,ICM,IDC,ADC,IFC,FAPA
 SG_ EL_FRTurnLightSt : 92|2@0+ (1,0) [0|3] ""  SRS,ICM,IDC,ADC,IFC,FAPA
 SG_ EL_FRTurnLightFaultSt : 90|1@0+ (1,0) [0|1] ""  SRS,ICM,IDC,ADC,IFC,FAPA
 SG_ WW_RWSHMotorSt : 103|2@0+ (1,0) [0|3] ""  ADC,IFC,FAPA
 SG_ EL_FADASLightSt : 127|2@0+ (1,0) [0|3] ""  ADC,IFC
 SG_ EBSF_BattVolt : 199|14@0+ (0.0009765625,3) [3|18] "V"  IDC,ADC,FAPA
 SG_ EBSF_CurrentRange : 201|2@0+ (1,0) [0|3] ""  ADC,FAPA
 SG_ EBSF_BattCurrent : 215|16@0+ (1,0) [-1500|1500] "A"  ADC,FAPA

BO_ 616 CCU_1: 64 CCU_CCURT1
 SG_ CCU_1_CRC : 7|16@0+ (1,0) [0|65535] ""  CCURT2,RT2_C3,OTAWL,ZCUF,ZCUL,ZCUR,ZCUT,NIDU,DCUR,BMS,CBM,RBM,ICM,IDC,PHUDD,ADC,IFC,FAPA,DRM,PLGM,TRM,RLBMS,TBOX
 SG_ CCU_1_Counter : 23|8@0+ (1,0) [0|255] ""  CCURT2,RT2_C3,OTAWL,ZCUF,ZCUL,ZCUR,ZCUT,NIDU,DCUR,BMS,CBM,RBM,ICM,IDC,PHUDD,ADC,IFC,FAPA,DRM,PLGM,TRM,RLBMS,TBOX
 SG_ UMM_UsageModeSt : 26|3@0+ (1,0) [0|7] ""  CCURT2,RT2_C3,OTAWL,TMC,ZCUF,ZCUL,ZCUR,ZCUT,EMS,IDM,DCDC,IPS,NIDU,NIDUF,DCUR,IDUR,OBC,OPC,LPC,LPC2,CPC,EMCM,GCU,DCUF,IPU,BMS,EOPF,EOPR,DCDC2,EDL,SRS,EBB,ECS,SAS,CBM,RAS,EPS,RBM,IBCS,ICM,IID,IDC,PHUDD,RCICP,AMP,WHUD,IMR,CD,INU,ADC,IFC,FAPA,RRR,RLR,PAS,PCS,SCMR,SCMRL,SCMRR,HVSMR,SCMRM,SCMT,MFS,WSM,DRM,IDU,FCP,RCP,LBMSAD,AVAS,ATSS,DLPFL,FBLCM,FLISD,FLLCM,FRLCM,RLLCMA,RLLCMB,RRLCMA,RRLCMB,RLISD,RRISD,DLPML,DLPMR,PLGM,TRM,PSDL,PSDR,HVSPRL,HVSPRR,LBMS,RLBMS,TBOX2,TBOX
 SG_ OTA_FuncReq_ADCWakeup : 45|3@0+ (1,0) [0|7] ""  ADC,FAPA
 SG_ UMM_FrontPassengerSeatSt : 57|2@0+ (1,0) [0|3] ""  OTAWL,ZCUR,SRS,EBB,IBCS,ICM,IDC,ADC,IFC,FAPA,RRR,RLR,TBOX
 SG_ UMM_DriverSeatSt : 59|2@0+ (1,0) [0|3] ""  OTAWL,ZCUR,SRS,EBB,IBCS,ICM,IDC,ADC,IFC,FAPA,RRR,RLR,TBOX
 SG_ VMM_VehModeSt : 159|4@0+ (1,0) [0|15] ""  CCURT2,RT2_C3,OTAWL,TMC,ZCUF,ZCUL,ZCUR,ZCUT,EMS,DCDC,IPS,NIDU,NIDUF,DCUR,IDUR,OBC,OPC,LPC,LPC2,CPC,EMCM,GCU,DCUF,IPU,BMS,EOPF,EOPR,DCDC2,EDL,SRS,EBB,ECS,SAS,EPS,EPB,RBM,IBCS,ICM,IDC,RCICP,AMP,WHUD,IMR,ADC,IFC,FAPA,RRR,RLR,PAS,SCMR,SCMRL,SCMRR,HVSMR,SCMRM,SCMT,MFS,IDU,FCP,RCP,LBMSAD,AVAS,ATSS,DLPFL,FBLCM,FLISD,FLLCM,FRLCM,RLLCMA,RLLCMB,RRLCMA,RRLCMB,RLISD,RRISD,DLPML,DLPMR,PLGM,TRM,PSDL,PSDR,HVSPRL,HVSPRR,LBMS,RLBMS,RFR,SBM,WCM,ETC,TBOX2,TBOX
 SG_ VMM_LastVehModeSt : 155|4@0+ (1,0) [0|15] ""  TMC,ZCUF,ZCUL,ZCUR,ZCUT,EMS,DCDC,IPS,NIDU,NIDUF,DCUR,IDUR,OBC,OPC,LPC,LPC2,CPC,EMCM,GCU,DCUF,IPU,BMS,DCDC2,EDL,SRS,EBB,EPS,EPB,RBM,IBCS,ICM,IDC,AMP,ADC,IFC,FAPA,PAS,SCMR,SCMRL,SCMRR,HVSMR,SCMRM,MFS,FCP,RCP,AVAS,ATSS,FLLCM,FRLCM,TRM,PSDL,RFR,SBM,WCM,ETC,TBOX
 SG_ VMM_OTAModeSt : 167|2@0+ (1,0) [0|3] ""  CCURT2,RT2_C3,OTAWL,ZCUF,ZCUL,ZCUR,ZCUT,EMS,IDM,DCDC,IPS,NIDU,NIDUF,DCUR,IDUR,OBC,OPC,LPC,LPC2,CPC,EMCM,GCU,DCUF,IPU,BMS,EOPF,EOPR,DCDC2,EDL,SRS,EBB,ECS,EPS,EPB,RBM,IBCS,ICM,IID,IDC,PHUDD,RCICP,AMP,WHUD,ADC,IFC,FAPA,RRR,RLR,PAS,SCMR,SCMRL,SCMRR,HVSMR,SCMRM,SCMT,MFS,FCP,RCP,LBMSAD,AVAS,ATSS,DLPFL,FBLCM,FLISD,FLLCM,FRLCM,RLLCMA,RLLCMB,RRLCMA,RRLCMB,RLISD,RRISD,DLPML,DLPMR,TRM,PSDL,PSDR,HVSPRL,HVSPRR,LBMS,RLBMS,RFR,SBM,WCM,ETC,TBOX
 SG_ CSM_RC_PAARequest : 287|4@0+ (1,0) [0|15] ""  ADC,FAPA
 SG_ IPDS_EnablePowerSup : 327|2@0+ (1,0) [0|3] ""  CCURT2,RT2_C3,ZCUF,ZCUL,ZCUR,ZCUT,EMS,IPS,NIDU,NIDUF,DCUR,IDUR,OBC,OPC,LPC,LPC2,CPC,EMCM,GCU,DCUF,IPU,BMS,EDL,SRS,EBB,ECS,EPB,RBM,IBCS,ICM,IID,IDC,PHUDD,ADC,FAPA,PCS,TBOX
 SG_ Time_Year : 343|8@0+ (1,2000) [2000|2255] "y"  CCURT2,RT2_C3,TMC,ZCUF,ZCUL,ZCUR,ZCUT,EMS,IDM,DCDC,IPS,NIDU,NIDUF,DCUR,IDUR,OBC,OPC,LPC,LPC2,CPC,EMCM,GCU,DCUF,IPU,BMS,EOPF,EOPR,EVCC,DCDC2,EDL,SRS,EBB,ECS,CBM,RAS,EPS,EPB,RBM,IBCS,RCICP,AMP,WHUD,IMR,INU,ADC,IFC,FAPA,RRR,RLR,PAS,PCS,SCMR,SCMRL,SCMRR,HVSMR,SCMRM,SCMT,MFS,WSM,DRM,FCP,RCP,LBMSAD,ATSS,DLPFL,FBLCM,FLISD,FLLCM,FRLCM,RLLCMA,RLLCMB,RRLCMA,RRLCMB,RLISD,RRISD,DLPML,DLPMR,PLGM,TRM,PSDL,PSDR,HVSPRL,HVSPRR,LBMS,RLBMS
 SG_ Time_Month : 351|4@0+ (1,0) [1|12] "m"  CCURT2,RT2_C3,TMC,ZCUF,ZCUL,ZCUR,ZCUT,EMS,IDM,DCDC,IPS,NIDU,NIDUF,DCUR,IDUR,OBC,OPC,LPC,LPC2,CPC,EMCM,GCU,DCUF,IPU,BMS,EOPF,EOPR,EVCC,DCDC2,EDL,SRS,EBB,ECS,CBM,RAS,EPS,EPB,RBM,IBCS,RCICP,AMP,WHUD,IMR,INU,ADC,IFC,FAPA,RRR,RLR,PAS,PCS,SCMR,SCMRL,SCMRR,HVSMR,SCMRM,SCMT,MFS,WSM,DRM,FCP,RCP,LBMSAD,ATSS,DLPFL,FBLCM,FLISD,FLLCM,FRLCM,RLLCMA,RLLCMB,RRLCMA,RRLCMB,RLISD,RRISD,DLPML,DLPMR,PLGM,TRM,PSDL,PSDR,HVSPRL,HVSPRR,LBMS,RLBMS
 SG_ Time_Day : 347|5@0+ (1,0) [1|31] "d"  CCURT2,RT2_C3,TMC,ZCUF,ZCUL,ZCUR,ZCUT,EMS,IDM,DCDC,IPS,NIDU,NIDUF,DCUR,IDUR,OBC,OPC,LPC,LPC2,CPC,EMCM,GCU,DCUF,IPU,BMS,EOPF,EOPR,EVCC,DCDC2,EDL,SRS,EBB,ECS,CBM,RAS,EPS,EPB,RBM,IBCS,RCICP,AMP,WHUD,IMR,INU,ADC,IFC,FAPA,RRR,RLR,PAS,PCS,SCMR,SCMRL,SCMRR,HVSMR,SCMRM,SCMT,MFS,WSM,DRM,FCP,RCP,LBMSAD,ATSS,DLPFL,FBLCM,FLISD,FLLCM,FRLCM,RLLCMA,RLLCMB,RRLCMA,RRLCMB,RLISD,RRISD,DLPML,DLPMR,PLGM,TRM,PSDL,PSDR,HVSPRL,HVSPRR,LBMS,RLBMS
 SG_ Time_Hour : 358|5@0+ (1,0) [0|23] "h"  CCURT2,RT2_C3,TMC,ZCUF,ZCUL,ZCUR,ZCUT,EMS,IDM,DCDC,IPS,NIDU,NIDUF,DCUR,IDUR,OBC,OPC,LPC,LPC2,CPC,EMCM,GCU,DCUF,IPU,BMS,EOPF,EOPR,EVCC,DCDC2,EDL,SRS,EBB,ECS,CBM,RAS,EPS,EPB,RBM,IBCS,RCICP,AMP,WHUD,IMR,INU,ADC,IFC,FAPA,RRR,RLR,PAS,PCS,SCMR,SCMRL,SCMRR,HVSMR,SCMRM,SCMT,MFS,WSM,DRM,FCP,RCP,LBMSAD,ATSS,DLPFL,FBLCM,FLISD,FLLCM,FRLCM,RLLCMA,RLLCMB,RRLCMA,RRLCMB,RLISD,RRISD,DLPML,DLPMR,PLGM,TRM,PSDL,PSDR,HVSPRL,HVSPRR,LBMS,RLBMS
 SG_ Time_Min : 353|6@0+ (1,0) [0|59] "min"  CCURT2,RT2_C3,TMC,ZCUF,ZCUL,ZCUR,ZCUT,EMS,IDM,DCDC,IPS,NIDU,NIDUF,DCUR,IDUR,OBC,OPC,LPC,LPC2,CPC,EMCM,GCU,DCUF,IPU,BMS,EOPF,EOPR,EVCC,DCDC2,EDL,SRS,EBB,ECS,CBM,RAS,EPS,EPB,RBM,IBCS,RCICP,AMP,WHUD,IMR,INU,ADC,IFC,FAPA,RRR,RLR,PAS,PCS,SCMR,SCMRL,SCMRR,HVSMR,SCMRM,SCMT,MFS,WSM,DRM,FCP,RCP,LBMSAD,ATSS,DLPFL,FBLCM,FLISD,FLLCM,FRLCM,RLLCMA,RLLCMB,RRLCMA,RRLCMB,RLISD,RRISD,DLPML,DLPMR,PLGM,TRM,PSDL,PSDR,HVSPRL,HVSPRR,LBMS,RLBMS
 SG_ Time_Sec : 363|6@0+ (1,0) [0|59] "s"  CCURT2,RT2_C3,TMC,ZCUF,ZCUL,ZCUR,ZCUT,EMS,IDM,DCDC,IPS,NIDU,NIDUF,DCUR,IDUR,OBC,OPC,LPC,LPC2,CPC,EMCM,GCU,DCUF,IPU,BMS,EOPF,EOPR,EVCC,DCDC2,EDL,SRS,EBB,ECS,CBM,RAS,EPS,EPB,RBM,IBCS,RCICP,AMP,WHUD,IMR,INU,ADC,IFC,FAPA,RRR,RLR,PAS,PCS,SCMR,SCMRL,SCMRR,HVSMR,SCMRM,SCMT,MFS,WSM,DRM,FCP,RCP,LBMSAD,ATSS,DLPFL,FBLCM,FLISD,FLLCM,FRLCM,RLLCMA,RLLCMB,RRLCMA,RRLCMB,RLISD,RRISD,DLPML,DLPMR,PLGM,TRM,PSDL,PSDR,HVSPRL,HVSPRR,LBMS,RLBMS
 SG_ CCU_DstFlag : 272|1@0+ (1,0) [0|1] ""  ZCUF,ZCUL,ZCUR,ZCUT,ADC,FAPA
 SG_ ASB_DriverActiveBeltFaultSt : 420|1@0+ (1,0) [0|1] ""  IDC,ADC,IFC,FAPA,TBOX
 SG_ IPDS_DCDCOpenCircuitSt : 377|2@0+ (1,0) [0|3] ""  IDC,ADC

BO_ 825 CCU_5: 64 CCU_CCURT2
 SG_ WW_FwpFaultSt : 34|1@0+ (1,0) [0|1] ""  ICM,IDC,ADC,IFC
 SG_ WW_RwpFaultSt : 33|1@0+ (1,0) [0|1] ""  ICM,IDC,ADC,IFC
 SG_ WW_FwshFaultSt : 32|1@0+ (1,0) [0|1] ""  ICM,IDC,ADC,IFC
 SG_ WW_RwshFaultSt : 47|1@0+ (1,0) [0|1] ""  ICM,IDC,ADC,IFC
 SG_ WW_FwpAutoModeSt : 46|1@0+ (1,0) [0|1] ""  ICM,IDC,ADC,IFC
 SG_ RLS_IRBrightness : 218|11@0+ (400,0) [0|818000] ""  WHUD,ADC
 SG_ WW_RainFallLevel : 391|4@0+ (1,0) [0|15] ""  CCURT1,RT1_C1,ZCUF,ZCUL,ZCUR,ZCUT,ICM,IDC,ADC,IFC
 SG_ RLS_LightOnReq : 387|1@0+ (1,0) [0|1] ""  ZCUL,ZCUR,IDC,ADC,IFC
 SG_ RLS_LampOnReqValid : 386|1@0+ (1,0) [0|1] ""  IDC,ADC,IFC
 SG_ RLS_WiperSpd : 385|4@0+ (1,0) [0|15] ""  IDC,ADC,IFC
 SG_ RLS_AMBBrightness : 298|14@0+ (6,0) [0|98286] "Lux"  IDC,WHUD,ADC,IFC
 SG_ RLS_FWBrightness : 413|14@0+ (6,0) [0|98286] ""  IDC,WHUD,ADC,IFC
 SG_ RLS_RainfallLevel : 439|4@0+ (1,0) [0|15] ""  ICM,IDC,ADC,IFC
 SG_ RLS_RSErr : 400|1@0+ (1,0) [0|1] ""  ICM,IDC,ADC,IFC
 SG_ RLS_LSErr : 401|1@0+ (1,0) [0|1] ""  ZCUR,ICM,IDC,ADC,IFC
 SG_ PM_AUTHPstState : 469|1@0+ (1,0) [0|1] ""  CCURT1,RT1_C0,ADC,IFC
 SG_ CCU_FuncReq_SentryMod : 146|1@0+ (1,0) [0|1] ""  IDC,ADC
 SG_ RLS_WindShieldHum : 119|8@0+ (0.5,-0.5) [0|100] "%"  ADC
 SG_ RLS_WindShieldTem : 127|8@0+ (0.5,-40) [-40|86.5] "℃"  ADC
 SG_ RLS_DewPoint : 135|8@0+ (0.5,-40) [-40|86.5] "℃"  ADC
 SG_ CCU_ModeSuppressSts : 369|2@0+ (1,0) [0|2] ""  IDC,ADC
 SG_ RLS_HUTErr : 426|1@0+ (1,0) [0|1] ""  ADC

BO_ 389 ADC_4_B_New: 64 ADC
 SG_ ADC_4_B_New_CRC : 7|16@0+ (1,0) [0|65535] ""  CCU,CCURT1,RT1_C1,ZCUL,ZCUR,EBB,EPS,EPB,IBCS
 SG_ ADC_4_B_New_Counter : 23|8@0+ (1,0) [0|255] ""  CCU,CCURT1,RT1_C1,ZCUL,ZCUR,EBB,EPS,EPB,IBCS
 SG_ ADC_AngReqSt_A_B1 : 31|2@0+ (1,0) [0|3] ""  CCU,CCURT1,RT1_C1,EPS
 SG_ ADC_AngReqFunction_B1 : 29|2@0+ (1,0) [0|3] ""  CCU,CCURT1,RT1_C1,EPS
 SG_ ADC_BrakeLightReq_B1 : 27|2@0+ (1,0) [0|3] ""  CCU
 SG_ ADC_StrAngleReq_A_B1 : 39|16@0+ (0.1,-780) [-780|780] "deg"  CCU,EPS
 SG_ ADC_SACMotorTorLimExtMax_A_B1 : 55|8@0+ (0.02,0) [0|5.08] "Nm"  CCU,EPS
 SG_ ADC_SACMotorTorLimExtMin_A_B1 : 63|8@0+ (0.02,-5.08) [-5.08|0] "Nm"  CCU,EPS
 SG_ ADC_AssistParaSwitchReq_B1 : 71|1@0+ (1,0) [0|1] ""  CCU,EPS
 SG_ ADC_SteerGainReq_B1 : 69|1@0+ (1,0) [0|1] ""  CCU,EPS
 SG_ ADC_StrgWhlVibrWarnLevel_B1 : 68|2@0+ (1,0) [0|3] ""  CCU,EPS
 SG_ ADC_ActTrqReqEnable_B1 : 66|1@0+ (1,0) [0|1] ""  CCU,CCURT1,RT1_C1
 SG_ ADC_SteerGainLevel_B1 : 79|8@0+ (1,0) [0|254] "%"  CCU,EPS
 SG_ ADC_EvsSteerReq_B1 : 87|1@0+ (1,0) [0|1] ""  CCU,EPS
 SG_ ADC_StrgWhlVibrWarnReq_B1 : 86|1@0+ (1,0) [0|1] ""  CCU,EPS
 SG_ ADC_ActTrqReq_B1 : 85|14@0+ (1,-5000) [-5000|5000] "Nm"  CCU,CCURT1,RT1_C1
 SG_ ADC_DrvTarTqMod2EPB_B : 124|2@0+ (1,0) [0|3] ""  CCU,ZCUL,ZCUR,EPB
 SG_ ADC_LongCtrlTypReq_B1 : 143|1@0+ (1,0) [0|1] ""  CCU,CCURT1,RT1_C1,EBB,IBCS
 SG_ ADC_AEBFaultSt_B1 : 263|1@0+ (1,0) [0|1] ""  CCU,CCURT1,RT1_C1,EBB,IBCS
 SG_ ADC_AEBOffSt_B1 : 262|1@0+ (1,0) [0|1] ""  CCU,CCURT1,RT1_C1,EBB,IBCS
 SG_ ADC_AEBInterventionSt_B1 : 261|1@0+ (1,0) [0|1] ""  CCU,EBB,IBCS
 SG_ ADC_AEBDecelCtrlReq_B1 : 260|1@0+ (1,0) [0|1] ""  CCU,CCURT1,RT1_C1,EBB,IBCS
 SG_ ADC_AEBLVehHoldReq_B1 : 259|1@0+ (1,0) [0|1] ""  CCU,CCURT1,RT1_C1,EBB,IBCS
 SG_ ADC_ABAReq_B1 : 258|1@0+ (1,0) [0|1] ""  CCU,EBB,IBCS
 SG_ ADC_ABALevel_B1 : 257|2@0+ (1,0) [0|3] ""  CCU,EBB,IBCS
 SG_ ADC_AWBReq_B1 : 271|1@0+ (1,0) [0|1] ""  CCU,IBCS
 SG_ ADC_ABPReq_B1 : 270|1@0+ (1,0) [0|1] ""  CCU,EBB,IBCS
 SG_ ADC_AWBLevel_B1 : 269|3@0+ (1,0) [0|7] ""  CCU,IBCS
 SG_ ADC_AEBTarCalss_B1 : 266|3@0+ (1,0) [0|7] ""  CCU,CCURT1,RT1_C1
 SG_ ADC_AEBTarDetSensor_B1 : 277|2@0+ (1,0) [0|3] ""  CCU,CCURT1,RT1_C1
 SG_ ADC_TurnLightReq_B1 : 275|3@0+ (1,0) [0|7] ""  CCU
 SG_ ADC_EpbModReq_B1 : 281|2@0+ (1,0) [0|3] ""  CCU,CCURT1,RT1_C1,ZCUL,ZCUR,EPB,IBCS
 SG_ ADS_VDCActvSt_B : 285|1@0+ (1,0) [0|1] ""  CCU,CCURT1,RT1_C1
 SG_ ADS_TCSActvSt_B : 286|1@0+ (1,0) [0|1] ""  CCU,CCURT1,RT1_C1
 SG_ ADS_DTCActvSt_B : 287|1@0+ (1,0) [0|1] ""  CCU,CCURT1,RT1_C1
 SG_ ADC_EpbModReqEna_B1 : 294|1@0+ (1,0) [0|1] ""  CCU,CCURT1,RT1_C1,ZCUL,ZCUR,EPB,IBCS
 SG_ ADC_AEBObjectTTC_B1 : 288|9@0+ (0.01,0) [0|5] "s"  CCU,CCURT1,RT1_C1
 SG_ ADC_AEBObjRelativeSpd_B1 : 304|9@0+ (0.1,0) [0|50] "m/s"  CCU,CCURT1,RT1_C1
 SG_ ADC_PAAPwrModeReq_B1 : 405|1@0+ (1,0) [0|1] ""  CCU,CCURT1,RT1_C1
 SG_ ADC_PAAGrarLvlReq_B1 : 404|3@0+ (1,0) [0|7] ""  CCU,CCURT1,RT1_C1
 SG_ ADC_PAAGrarLvlReqEnable_B1 : 401|1@0+ (1,0) [0|1] ""  CCU,CCURT1,RT1_C1
 SG_ ADC_ActTrqReqVD_B1 : 341|1@0+ (1,0) [0|1] ""  CCU,CCURT1,RT1_C1
 SG_ ADC_BrkTarTqEna_B1 : 125|1@0+ (1,0) [0|1] ""  CCU,CCURT1,RT1_C1,ZCUL,ZCUR,EPB,IBCS
 SG_ ADC_BrkTarTqMod_B1 : 25|2@0+ (1,0) [0|3] ""  CCU,CCURT1,RT1_C1,ZCUL,ZCUR,EPB,IBCS
 SG_ ADC_AebBrkTarTq_B1 : 111|16@0+ (1,0) [0|65535] "Nm"  CCU,EBB,IBCS
 SG_ ADC_EpbModReqVld_B1 : 126|1@0+ (1,0) [0|1] ""  CCU,ZCUL,ZCUR,EPB
 SG_ ADC_RWUEna_B1 : 127|1@0+ (1,0) [0|1] ""  CCU,ZCUL,ZCUR,EPB
 SG_ ADC_BrkHoldReq_B1 : 279|2@0+ (1,0) [0|3] ""  CCU,IBCS
 SG_ ADC_AngReqAvl_B1 : 340|1@0+ (1,0) [0|1] ""  CCU,EPS
 SG_ ADC_TarGearReqVld_B1 : 342|1@0+ (1,0) [0|1] ""  CCU,CCURT1,RT1_C1
 SG_ ADC_FctSts_B1 : 343|1@0+ (1,0) [0|1] ""  CCU,CCURT1,RT1_C1
 SG_ ADC_BrkTarTqVld_B1 : 328|1@0+ (1,0) [0|1] ""  CCU,IBCS
 SG_ ADC_AebBrkTarTqVld_B1 : 305|1@0+ (1,0) [0|1] ""  CCU,EBB,IBCS
 SG_ ADC_AebBrkTarTqEna_B1 : 306|1@0+ (1,0) [0|1] ""  CCU,CCURT1,RT1_C1,EBB,IBCS
 SG_ ADC_ElecBrkFnSwitch_B1 : 307|1@0+ (1,0) [0|1] ""  CCU,CCURT1,RT1_C1,IBCS
 SG_ ADC_RedundantSwt_B1 : 142|1@0+ (1,0) [0|1] ""  CCU,EPS,IBCS
 SG_ ADC_ImmediateStopEna_B1 : 295|1@0+ (1,0) [0|1] ""  IBCS
 SG_ ADC_RWUVld_B1 : 400|1@0+ (1,0) [0|1] ""  CCU,ZCUL,ZCUR,EPB
 SG_ ADC_DriverPresent_B1 : 309|2@0+ (1,0) [0|3] ""  CCU,ZCUL,ZCUR,EPB,IBCS
 SG_ ADC_AD_NetMode_B : 65|2@0+ (1,0) [0|3] "/"  CCU,CCURT1,RT1_C1,ZCUL,ZCUR,EPS,EPB,IBCS
 SG_ ADC_ChrgPwrMode_B : 70|1@0+ (1,0) [0|1] ""  CCU,CCURT1,RT1_C1
 SG_ ADC_FcsActiveStatus_B : 122|1@0+ (1,0) [0|1] ""  CCU,CCURT1,RT1_C1
 SG_ ADC_DriverSeatBeltPretightenReq_B : 120|1@0+ (1,0) [0|1] ""  CCU,CCURT1,RT1_C1
 SG_ ADC_SteerVibrAvl_B : 121|1@0+ (1,0) [0|1] ""  CCU,CCURT1,RT1_C1,EPS
 SG_ ADC_VehSpd_B : 140|13@0+ (0.05625,0) [0|240] "km/h"  CCU,CCURT1,RT1_C1,EPS
 SG_ ADC_VehSpdVD_B : 141|1@0+ (1,0) [0|1] ""  CCU,CCURT1,RT1_C1,EPS
 SG_ ADC_RasAngReqAvl_B1 : 251|2@0+ (1,0) [0|3] "/"  CCU,CCURT1,RT1_C1,EPS
 SG_ ADC_RasAngReqSt_A_B1 : 253|2@0+ (1,0) [0|3] "/"  CCU,CCURT1,RT1_C1,EPS
 SG_ ADC_RasModReq_B1 : 255|2@0+ (1,0) [0|3] "/"  CCU,CCURT1,RT1_C1,EPS
 SG_ ADC_RasAngleReq_A_B1 : 327|12@0+ (0.01,-20.48) [-20.48|20.48] "deg"  CCU,CCURT1,RT1_C1,EPS
 SG_ ADC_DriverSeatBeltVibrWarnReq_B : 293|3@0+ (1,0) [0|7] ""  CCU,CCURT1,RT1_C1
 SG_ ADC_TotalRefTorque : 159|16@0+ (1,-32768) [-32768|32767] "Nm"  CCU,CCURT1,RT1_C1
 SG_ ADC_MotTarSpd : 175|16@0+ (1,-32768) [-32768|32767] "rpm"  CCU,CCURT1,RT1_C1
 SG_ ADC_LimTqFactorK : 351|10@0+ (0.001,0) [0|1] ""  CCU,CCURT1,RT1_C1
 SG_ ADC_MotTqLimMin : 357|9@0+ (25,-6375) [-6375|6400] "Nm"  CCU,CCURT1,RT1_C1
 SG_ ADC_MotTqLimMax : 364|9@0+ (25,-6375) [-6375|6400] "Nm"  CCU,CCURT1,RT1_C1
 SG_ ADC_MotTqRateLimMin : 371|9@0+ (50,-12750) [-12750|12800] "Nm/s"  CCU,CCURT1,RT1_C1
 SG_ ADC_MotTqRateLimMax : 378|9@0+ (50,-12750) [-12750|12800] "Nm/s"  CCU,CCURT1,RT1_C1
 SG_ ADC_TqUnloadRate : 385|9@0+ (50,-12750) [-12750|12800] "Nm/s"  CCU,CCURT1,RT1_C1
 SG_ ADC_MotCtrlTar : 98|3@0+ (1,0) [0|7] ""  CCU,CCURT1,RT1_C1
 SG_ ADC_MotTarMod : 100|2@0+ (1,0) [0|3] ""  CCU,CCURT1,RT1_C1
 SG_ ADC_DrvTarTqMod : 102|2@0+ (1,0) [0|3] ""  CCU,CCURT1,RT1_C1,IBCS
 SG_ ADC_RapidRespEna : 103|1@0+ (1,0) [0|1] ""  CCU,CCURT1,RT1_C1
 SG_ ADC_LimTqEnable : 128|1@0+ (1,0) [0|1] ""  CCU,CCURT1,RT1_C1
 SG_ ADC_MotSpdCtrlEna : 129|1@0+ (1,0) [0|1] ""  CCU,CCURT1,RT1_C1
 SG_ ADC_TqUnloadEna : 130|1@0+ (1,0) [0|1] ""  CCU,CCURT1,RT1_C1
 SG_ ADC_MotTarSpdSvValid : 131|1@0+ (1,0) [0|1] ""  CCU,CCURT1,RT1_C1
 SG_ ADC_UrgentSteerFlg : 132|1@0+ (1,0) [0|1] ""  CCU,CCURT1,RT1_C1
 SG_ ADC_OneMotorCtrlEna : 134|2@0+ (1,0) [0|3] ""  CCU,CCURT1,RT1_C1
 SG_ ADC_MotorCtrlTqWhlRL : 191|16@0+ (1,-32768) [-32768|32767] "Nm"  CCU,CCURT1,RT1_C1
 SG_ ADC_MotorCtrlTqWhlRR : 207|16@0+ (1,-32768) [-32768|32767] "Nm"  CCU,CCURT1,RT1_C1
 SG_ ADC_MotorCtrlTqWhlFR : 223|16@0+ (1,-32768) [-32768|32767] "Nm"  CCU,CCURT1,RT1_C1
 SG_ ADC_MotorCtrlTqWhlFL : 239|16@0+ (1,-32768) [-32768|32767] "Nm"  CCU,CCURT1,RT1_C1
 SG_ ADC_BrkTarTq_B1 : 439|16@0+ (1,0) [0|65535] "Nm"  CCU,CCURT1,RT1_C1,ZCUL,ZCUR,EPB,IBCS

CM_ SG_ 161 ACU_FaceID_Delete "Delete_FaceID";
CM_ SG_ 161 ACU_RegisterTriger "FaceID register triger";
CM_ SG_ 161 ACU_VerifyTriger "FaceID verify triger";
CM_ SG_ 161 ACU_FaceIDQuit "FaceID quit triger";
CM_ SG_ 161 ACU_FaceIDSwitch "FaceID switch triger";
CM_ SG_ 161 ACU_AVAS_SwitchCfgReq "AVAS switch configuration require";
CM_ SG_ 432 ICC_1_CRC "E2E Profile 5 CRC";
CM_ SG_ 432 ICC_1_Counter "E2E Profile 5 Counter";
CM_ SG_ 432 ICC_FcnInfo "ICC system Function Action Information";
CM_ SG_ 432 ICC_FaultSt "ICC System Fault Status";
CM_ SG_ 432 ICC_ActorSt "ICC System Actor Status";
CM_ SG_ 432 ICC_FrontLeftTireBlowout "Front Left Tire Blow Out State";
CM_ SG_ 432 ICC_FrontRightTireBlowout "Front Right Tire Blow Out State";
CM_ SG_ 432 ICC_RearRightTireBlowout "Rear Right Tire Blow Out State";
CM_ SG_ 432 ICC_RearLeftTireBlowout "Rear Left Tire Blow Out State";
CM_ SG_ 432 ICC_RAS_AgCtrlAvl "RAS  Angle  control status";
CM_ SG_ 432 ICC_RAS_CalibratedSt "Calibration status of RAS sensors";
CM_ SG_ 432 ICC_RAS_ErrFeedback "RAS fault feedback";
CM_ SG_ 432 ICC_RAS_AngleVD "RAS Angle VD";
CM_ SG_ 432 ICC_RAS_PstOverlaySt "RAS  Angle  control status";
CM_ SG_ 432 ICC_RAS_SteerMod "The current working mode of RAS";
CM_ SG_ 432 ICC_RAS_SteeringAngle "The actual Angle of the rear wheel";
CM_ SG_ 432 ICC_RAS_HealthyStForADC "The health status of RAS's own software and hardware";
CM_ SG_ 432 ICC_RAS_SteeringAngleSpdVD "rear wheel angular velocity VD";
CM_ SG_ 432 ICC_RAS_ThermalSt "The overheating state of the RAS motor";
CM_ SG_ 432 ICC_RAS_SteeringAngleRate "Rear wheel rotation Angle speed";
CM_ SG_ 432 ICC_RAS_WarnLamp "The status of RAS fault light indicates";
CM_ SG_ 432 ICC_RAS_MotorTorActMot "RAS Actural motor torque";
CM_ SG_ 432 ICC_RAS_ADASTargetAngle "The target request Angle of ICC to RAS";
CM_ SG_ 433 CCU_GVS_3_CRC "E2E Profile 5 CRC";
CM_ SG_ 433 CCU_GVS_3_Counter "E2E Profile 5 Counter";
CM_ SG_ 433 VCU_VehActDrvTorqRR "Vehicle actual drive torque for right rear wheel hub motor";
CM_ SG_ 433 VCU_MotorRgnCaplTqWhl "整车最大允许制动能量回收扭矩轮端扭矩（扣滑行）";
CM_ SG_ 433 VCU_VehWhlReqTqFAVD "Required Torque for Front Axle or Front Left Motor Valid Bit";
CM_ SG_ 433 VCU_VehWhlReqTqRRVD "Required Torque for Rear Right Motor Valid Bit";
CM_ SG_ 433 VCU_VehActDrvTorqRRVD "Vehicle actual drive torque valid data for right rear wheel hub motor";
CM_ SG_ 433 VCU_PreStableFlg "VCU Pre Stable Flag";
CM_ SG_ 433 VCU_VehWhlReqTqRLVD "Required Torque for Rear Left(or Rear) Motor Valid Bit";
CM_ SG_ 433 VCU_AccPedalActPstVD "Current accelerate pedal actual position validity for MRR";
CM_ SG_ 433 VCU_AccPedalActPst "Current accelerate pedal actual position for MRR";
CM_ SG_ 433 VCU_VehWhlReqTqFA "Required Torque for Front Axle Motor(or Front Left )";
CM_ SG_ 433 VCU_VehWhlReqTqRR "Required Torque for Rear Right Motor";
CM_ SG_ 433 VCU_VehWhlReqTqRL "Required Torque for Rear Left(or Rear) motor";
CM_ SG_ 433 VCU_MotorDrvCaplTqWhlFA "Front Motor Wheel End Driving Torque Capability (or Front Left)";
CM_ SG_ 433 VCU_MotorRgnCaplTqWhlFA "Left Rear Motor Wheel End Negative Torque Capability(or Front Left)";
CM_ SG_ 433 VCU_MotorDrvCaplTqWhlRL "Left Rear(or Rear) Motor Wheel End Driving Torque Capability";
CM_ SG_ 433 VCU_MotorRgnCaplTqWhlRL "Left Rear(or Rear) Motor Wheel End Negative Torque Capability";
CM_ SG_ 433 VCU_MotorDrvCaplTqWhlRR "Right Rear Motor Wheel End Driving Torque Capability";
CM_ SG_ 433 VCU_GearShiftAvl "档位切换可用状态";
CM_ SG_ 433 VCU_MotorRgnCaplTqWhlVD "整车最大允许制动能量回收扭矩轮端扭矩有效位";
CM_ SG_ 433 VCU_VehWhlReqTqVD "整车需求轮端扭矩有效";
CM_ SG_ 433 VCU_ErrorFb "VCU上报故障原因";
CM_ SG_ 433 VCU_PtTqActvSts "VCU扭矩响应状态";
CM_ SG_ 433 VCU_PtTqAvl "动力系统扭矩可用状态";
CM_ SG_ 433 VCU_DriverTorqueDesired "驾驶员需求力矩（驾驶员油门对应的驱动力矩）";
CM_ SG_ 433 VCU_VehWhlReqTq "整车需求轮端扭矩（仲裁滤波后）";
CM_ SG_ 433 VCU_MotorRgnCaplTqWhlRR "Right Rear Motor Wheel End Negative Torque Capability";
CM_ SG_ 791 ZCUL_12_CRC "E2E Profile 5 CRC";
CM_ SG_ 791 ZCUL_12_Counter "E2E Profile 5 Counter";
CM_ SG_ 791 WW_FWPMotorSt "FrontWiper Motor status";
CM_ SG_ 791 WW_FWSHMotorSt "FrontWasher motor status";
CM_ SG_ 791 HRN_HornRunningSt "Horn Running status";
CM_ SG_ 791 HRN_HornWorkingTemplet "Horn Working Templet";
CM_ SG_ 791 EL_FLPositionLightSt "Front left position light status";
CM_ SG_ 791 EL_FLPositionLightFaultSt "Front left position light fault status";
CM_ SG_ 791 EL_FRPositionLightSt "Front Right position light status";
CM_ SG_ 791 EL_FRPositionLightFaultSt "Front Right position light fault status";
CM_ SG_ 791 EL_LeftLowBeamSt "Left low beam status";
CM_ SG_ 791 EL_LeftLowBeamFaultSt "Left low beam fault status";
CM_ SG_ 791 EL_RightLowBeamSt "Right low beam status";
CM_ SG_ 791 EL_RightLowBeamFaultSt "Right low beam fault status";
CM_ SG_ 791 EL_LeftHighBeamSt "Left high beam status";
CM_ SG_ 791 EL_LeftHighBeamFaultSt "Left high beam fault status";
CM_ SG_ 791 EL_RightHighBeamSt "Right high beam status";
CM_ SG_ 791 EL_RightHighBeamFaultSt "Right high beam fault status";
CM_ SG_ 791 EL_FLFogLightSt "Front left fog light status";
CM_ SG_ 791 EL_FLFogLightFaultSt "Front left fog light fault status";
CM_ SG_ 791 EL_FRFogLightSt "Front right fog light status";
CM_ SG_ 791 EL_FRFogLightFaultSt "Front right fog light fault status";
CM_ SG_ 791 EL_LeftDRLSt "Left day time running light status";
CM_ SG_ 791 EL_LeftDRLFaultSt "Left day time running light fault status";
CM_ SG_ 791 EL_RightDRLSt "Right day time running light status";
CM_ SG_ 791 EL_RightDRLFaultSt "Right day time running light fault status";
CM_ SG_ 791 EL_FLTurnLightSt "Front left turn light status";
CM_ SG_ 791 EL_FLTurnLightFaultSt "Front left turn light fault status";
CM_ SG_ 791 EL_FRTurnLightSt "Front right turn light status";
CM_ SG_ 791 EL_FRTurnLightFaultSt "Front right turn light fault status";
CM_ SG_ 791 WW_RWSHMotorSt "Rear washer motor status";
CM_ SG_ 791 EL_FADASLightSt "Front ADAS light status";
CM_ SG_ 791 EBSF_BattVolt "Battery voltage";
CM_ SG_ 791 EBSF_CurrentRange "Battery current range";
CM_ SG_ 791 EBSF_BattCurrent "Battery current ";
CM_ SG_ 616 CCU_1_CRC "E2E Profile 5 CRC";
CM_ SG_ 616 CCU_1_Counter "E2E Profile 5 Counter";
CM_ SG_ 616 UMM_UsageModeSt "Usage mode state";
CM_ SG_ 616 OTA_FuncReq_ADCWakeup "OTA Requset ADC to Wakeup";
CM_ SG_ 616 UMM_FrontPassengerSeatSt "Front Right Seat Sensor Status";
CM_ SG_ 616 UMM_DriverSeatSt "Front Left Seat Sensor Status";
CM_ SG_ 616 VMM_VehModeSt "Vehicle mode state";
CM_ SG_ 616 VMM_LastVehModeSt "Last time vehicle mode";
CM_ SG_ 616 VMM_OTAModeSt "OTA Mode state";
CM_ SG_ 616 CSM_RC_PAARequest "CSM_RC_Park request";
CM_ SG_ 616 IPDS_EnablePowerSup "Enable power supply";
CM_ SG_ 616 Time_Year "Year number";
CM_ SG_ 616 Time_Month "Month number";
CM_ SG_ 616 Time_Day "Day number";
CM_ SG_ 616 Time_Hour "Hour number";
CM_ SG_ 616 Time_Min "Minute number";
CM_ SG_ 616 Time_Sec "Second number";
CM_ SG_ 616 CCU_DstFlag "Daylight Saving Time Flag";
CM_ SG_ 616 ASB_DriverActiveBeltFaultSt "Driver Side Active Seat Belt Fault State";
CM_ SG_ 616 IPDS_DCDCOpenCircuitSt "DCDC Output Open Circuit Status";
CM_ SG_ 825 WW_FwpFaultSt "Front Wiper Fault state";
CM_ SG_ 825 WW_RwpFaultSt "Rear Wiper Fault state";
CM_ SG_ 825 WW_FwshFaultSt "Front Washer Fault state";
CM_ SG_ 825 WW_RwshFaultSt "Rear Washer Fault state";
CM_ SG_ 825 WW_FwpAutoModeSt "Front Wiper Auto Mode state";
CM_ SG_ 825 WW_RainFallLevel "Rain Fall Level";
CM_ SG_ 825 RLS_LightOnReq "Switch on/off low beam request";
CM_ SG_ 825 RLS_LampOnReqValid "Lamp On Request signal valid";
CM_ SG_ 825 RLS_WiperSpd "Wiper speed mode";
CM_ SG_ 825 RLS_AMBBrightness "Ambient Light Brightness";
CM_ SG_ 825 RLS_FWBrightness "Forward Light Brightness";
CM_ SG_ 825 RLS_RainfallLevel "Rain level";
CM_ SG_ 825 RLS_RSErr "Error status rain sensor";
CM_ SG_ 825 RLS_LSErr "Error status light sensor";
CM_ SG_ 825 PM_AUTHPstState "位置授权开关状态";
CM_ SG_ 825 CCU_FuncReq_SentryMod "Sentry Mode Wake SOC of MDC";
CM_ SG_ 825 RLS_WindShieldHum "Data windshield humidity";
CM_ SG_ 825 RLS_WindShieldTem "Temperature of the windscreen in ℃";
CM_ SG_ 825 RLS_DewPoint "Dew Temperature of the windscreen in ℃";
CM_ SG_ 825 CCU_ModeSuppressSts "Sentry Mode Suppress Status";
CM_ SG_ 825 RLS_HUTErr "HT sensor status";
CM_ SG_ 389 ADC_4_B_New_CRC "E2E Profile 5 CRC";
CM_ SG_ 389 ADC_4_B_New_Counter "E2E Profile 5 Counter";
CM_ SG_ 389 ADC_AngReqSt_A_B1 "Lateral control Function Request State";
CM_ SG_ 389 ADC_AngReqFunction_B1 "Indicates which function request angle control";
CM_ SG_ 389 ADC_BrakeLightReq_B1 "Brake Light Request?";
CM_ SG_ 389 ADC_StrAngleReq_A_B1 "Steering Angle Request Value";
CM_ SG_ 389 ADC_SACMotorTorLimExtMax_A_B1 "Maximum Motor External Torque Limitation of Angle Following";
CM_ SG_ 389 ADC_SACMotorTorLimExtMin_A_B1 "Minimum Motor External Torque Limitation of Angle Following";
CM_ SG_ 389 ADC_AssistParaSwitchReq_B1 "Request EPS Switch Assist Parameter to LKAmode";
CM_ SG_ 389 ADC_SteerGainReq_B1 "Driver steering  gain request signal";
CM_ SG_ 389 ADC_StrgWhlVibrWarnLevel_B1 "Steering wheel vibratio Warn Frequency";
CM_ SG_ 389 ADC_ActTrqReqEnable_B1 "Enable flag for VCU for realization of target torque ActTrqReq";
CM_ SG_ 389 ADC_SteerGainLevel_B1 "Driver steering gain request value";
CM_ SG_ 389 ADC_EvsSteerReq_B1 "Emergency Collision avoidance steering mode request";
CM_ SG_ 389 ADC_StrgWhlVibrWarnReq_B1 "Steering wheel vibration Warn request";
CM_ SG_ 389 ADC_ActTrqReq_B1 "VLC Request Effective target torque on wheel level to VCU";
CM_ SG_ 389 ADC_DrvTarTqMod2EPB_B "Drive torque mode to EPB";
CM_ SG_ 389 ADC_LongCtrlTypReq_B1 "Main ADC  Longitudinal Control Brake type.Comfort Mode : The controller and brake system will consider NVH limitations, carefully reaction for good driving feeling, etc.Emergency Mode: the controller react fast and the brake system will achieve maximum performance (No limitations, eg. NVH limitations, HW protection).";
CM_ SG_ 389 ADC_AEBFaultSt_B1 "This signal indicates the AEB(Auto Emerrgency Braking) fault status";
CM_ SG_ 389 ADC_AEBOffSt_B1 "This signal indicates if the AEB(Auto Emerrgency Braking) is deactivated";
CM_ SG_ 389 ADC_AEBInterventionSt_B1 "This signal indicates if the AEB(Auto Emerrgency Braking) intervents";
CM_ SG_ 389 ADC_AEBDecelCtrlReq_B1 "Request of the AEB/EBA/FCTB/RCTB deceleration control";
CM_ SG_ 389 ADC_AEBLVehHoldReq_B1 "Request ESP to hold vehilce if AEB active and vehilce stopped";
CM_ SG_ 389 ADC_ABAReq_B1 "Request of the ABA support from ESP";
CM_ SG_ 389 ADC_ABALevel_B1 "ABA(Adaptive Brake Assistance) level to the ESP HBA";
CM_ SG_ 389 ADC_AWBReq_B1 "Request of the brake jerk warning to ESP";
CM_ SG_ 389 ADC_ABPReq_B1 "Request of the Prefill to ESP";
CM_ SG_ 389 ADC_AWBLevel_B1 "Different level request of the brake jerk";
CM_ SG_ 389 ADC_AEBTarCalss_B1 "AEB Target Object Class";
CM_ SG_ 389 ADC_AEBTarDetSensor_B1 "AEB Target Property Detected by Sensor with Fusion or not.";
CM_ SG_ 389 ADC_TurnLightReq_B1 "Turn Lamp and Hazard Lamp Request?";
CM_ SG_ 389 ADC_EpbModReq_B1 "The  request from the ADAS/ADS to the EPB, ADC_PAA2EPBEpbReq redundant signal";
CM_ SG_ 389 ADS_VDCActvSt_B "ADS的VDC激活标志";
CM_ SG_ 389 ADS_TCSActvSt_B "ADS的TCS激活标志";
CM_ SG_ 389 ADS_DTCActvSt_B "ADS的稳定性控制激活标志";
CM_ SG_ 389 ADC_EpbModReqEna_B1 "The enable status  of the  request from the ADAS/ADS to the  EPB Status, ADC_PAA2EPBEpbReqSt_B redundant signal";
CM_ SG_ 389 ADC_AEBObjectTTC_B1 "Time-to-collision between ego vehicle and collision object, and the relative acceleration should be considered";
CM_ SG_ 389 ADC_AEBObjRelativeSpd_B1 "Relative Speed between ego vehicle and collision object. Means Ego speed > collision object speed situation";
CM_ SG_ 389 ADC_PAAPwrModeReq_B1 "PAA Powertrain Request";
CM_ SG_ 389 ADC_PAAGrarLvlReq_B1 "Gear lever position request for the vehicle mo-tion control";
CM_ SG_ 389 ADC_PAAGrarLvlReqEnable_B1 "enable flag to control the gear box";
CM_ SG_ 389 ADC_ActTrqReqVD_B1 "The validity of ADC torque request to VCU";
CM_ SG_ 389 ADC_BrkTarTqEna_B1 "The enable status  of total target brake torque";
CM_ SG_ 389 ADC_BrkTarTqMod_B1 "This signal indicates which function the total target brake torque is used for，cruise or parking function.";
CM_ SG_ 389 ADC_AebBrkTarTq_B1 "Total taget brake torque of the AEB";
CM_ SG_ 389 ADC_EpbModReqVld_B1 "The validity of the  request from the ADAS/ADS to the  EPB";
CM_ SG_ 389 ADC_RWUEna_B1 "The enable status of the  RWU";
CM_ SG_ 389 ADC_BrkHoldReq_B1 "The AVH request from the ADAS/ADS to the ESP/IPB.Not active：AVH no activeActive：AVH active";
CM_ SG_ 389 ADC_AngReqAvl_B1 "Steering angle request avaliable state";
CM_ SG_ 389 ADC_TarGearReqVld_B1 "Gear lever request validity";
CM_ SG_ 389 ADC_FctSts_B1 "ADAS active status";
CM_ SG_ 389 ADC_BrkTarTqVld_B1 "The validity of total  target brake torque";
CM_ SG_ 389 ADC_AebBrkTarTqVld_B1 "The validity of total target brake torque of the AEB";
CM_ SG_ 389 ADC_AebBrkTarTqEna_B1 "The enable status  of total  target brake torque of the AEB";
CM_ SG_ 389 ADC_ElecBrkFnSwitch_B1 "The switch for regenerative brake and hydraulic brake。Off：The ESP/IPB can not assign regenerative brake torque to the VCU/DCU。On：The ESP/IPB can assign regenerative brake torque to the VCUDCU。";
CM_ SG_ 389 ADC_RedundantSwt_B1 "It is the switch for the redundancy mode.";
CM_ SG_ 389 ADC_ImmediateStopEna_B1 "It indicates whether ESP is permitted to perform blind braking.（It indicates whether the ESP is permitted to immediately brake the vehicle to a stop.）";
CM_ SG_ 389 ADC_RWUVld_B1 "The validity  of the RWU";
CM_ SG_ 389 ADC_DriverPresent_B1 "It indicates whether someone is in the driver's seat.";
CM_ SG_ 389 ADC_AD_NetMode_B "Autonomous_Driving Request Net Mode";
CM_ SG_ 389 ADC_ChrgPwrMode_B "ADC VCU Torque Control Mode";
CM_ SG_ 389 ADC_FcsActiveStatus_B "indicate ADS Fuction is Active for energe save mode";
CM_ SG_ 389 ADC_DriverSeatBeltPretightenReq_B "Driver Seat Belt Pretighten Request";
CM_ SG_ 389 ADC_SteerVibrAvl_B "Steering wheel vibration warn available state";
CM_ SG_ 389 ADC_VehSpd_B "ADC Vehicle speed";
CM_ SG_ 389 ADC_VehSpdVD_B "ADC Quality/fault information to vehicle speed";
CM_ SG_ 389 ADC_RasAngReqAvl_B1 "Steering angle request avaliable state";
CM_ SG_ 389 ADC_RasAngReqSt_A_B1 "Steering angle control Request State";
CM_ SG_ 389 ADC_RasModReq_B1 "Emergency steering mode request";
CM_ SG_ 389 ADC_RasAngleReq_A_B1 "Steering Angle Request Value";
CM_ SG_ 389 ADC_DriverSeatBeltVibrWarnReq_B "ADAS active driver seat belt vibration warning request";
CM_ SG_ 389 ADC_TotalRefTorque "ADAS total  torque request";
CM_ SG_ 389 ADC_MotTarSpd "target motor speed";
CM_ SG_ 389 ADC_LimTqFactorK "Limit torque request factor";
CM_ SG_ 389 ADC_MotTqLimMin "Wheel torque lower limit";
CM_ SG_ 389 ADC_MotTqLimMax "Wheel torque upper limit";
CM_ SG_ 389 ADC_MotTqRateLimMin "Wheel torque rate lower limit";
CM_ SG_ 389 ADC_MotTqRateLimMax "Wheel torque rate upper limit";
CM_ SG_ 389 ADC_TqUnloadRate "Unload torque rate";
CM_ SG_ 389 ADC_MotCtrlTar "Target control motor";
CM_ SG_ 389 ADC_MotTarMod "Target motor working mode";
CM_ SG_ 389 ADC_DrvTarTqMod "Drive torque mode";
CM_ SG_ 389 ADC_RapidRespEna "Rapid response mode enable flag";
CM_ SG_ 389 ADC_LimTqEnable "Limit torque request enable flag";
CM_ SG_ 389 ADC_MotSpdCtrlEna "Speed mode control enable flag";
CM_ SG_ 389 ADC_TqUnloadEna "Unload torque request enable flag";
CM_ SG_ 389 ADC_MotTarSpdSvValid "Speed mode control validity";
CM_ SG_ 389 ADC_UrgentSteerFlg "Urgent Steering Flag of ADC";
CM_ SG_ 389 ADC_OneMotorCtrlEna "Motor Direct Control Enable Flag";
CM_ SG_ 389 ADC_MotorCtrlTqWhlRL "Target Drive Torque for Rear Left Motor";
CM_ SG_ 389 ADC_MotorCtrlTqWhlRR "Target Drive Torque for Rear Right Motor";
CM_ SG_ 389 ADC_MotorCtrlTqWhlFR "Target Drive Torque for Front Right Motor";
CM_ SG_ 389 ADC_MotorCtrlTqWhlFL "Target Drive Torque for Front Left Motor";
CM_ SG_ 389 ADC_BrkTarTq_B1 "Total target brake torque for cruise and parking function ";

BA_DEF_ BO_  "GenMsgCycleTime" INT 0 0;
BA_DEF_ BO_  "GenMsgCycleTimeFast" INT 0 0;
BA_DEF_ BO_  "GenMsgSendType" ENUM  "Periodic","Event","IfActive","POE","PA","FixedPeriodic","Event","EnabledPeriodic","NotUsed","NotUsed","EventPeriodic","NotUsed","NotUsed","NoMsgSendType";
BA_DEF_ BO_  "VFrameFormat" ENUM  "StandardCAN","ExtendedCAN","reserved","reserved","reserved","reserved","reserved","reserved","reserved","reserved","reserved","reserved","reserved","reserved","StandardCAN_FD","ExtendedCAN_FD";
BA_DEF_ BO_  "CANFD_BRS" ENUM  "0","1";
BA_DEF_ SG_  "EventCommandSignal" ENUM  "No","Yes";
BA_DEF_ SG_  "GatewayedSignals" ENUM  "No","Yes";
BA_DEF_ SG_  "GenSigInactiveValue" HEX 0 0;
BA_DEF_ SG_  "GenSigInvalidValue" HEX 0 0;
BA_DEF_ SG_  "GenSigSendType" ENUM  "Trigger","Passive","Cyclic","OnWrite","OnWriteWithRepetition","OnChange","OnChangeWithRepetition","IfActive","IfActiveWithRepetition","NoSigSendType";
BA_DEF_ SG_  "GenSigStartValue" HEX 0 0;
BA_DEF_ SG_  "GenSigTimeoutValue" HEX 0 0;
BA_DEF_ SG_  "Remark" STRING ;
BA_ "GenMsgCycleTime" BO_ 161 0;
BA_ "GenMsgCycleTimeFast" BO_ 161 0;
BA_ "GenMsgSendType" BO_ 161 1;
BA_ "VFrameFormat" BO_ 161 14;
BA_ "CANFD_BRS" BO_ 161 1;
BA_ "GenMsgCycleTime" BO_ 161 0;
BA_ "GenMsgCycleTimeFast" BO_ 161 0;
BA_ "GenMsgSendType" BO_ 161 1;
BA_ "VFrameFormat" BO_ 161 14;
BA_ "CANFD_BRS" BO_ 161 1;
BA_ "GenMsgCycleTime" BO_ 161 0;
BA_ "GenMsgCycleTimeFast" BO_ 161 0;
BA_ "GenMsgSendType" BO_ 161 1;
BA_ "VFrameFormat" BO_ 161 14;
BA_ "CANFD_BRS" BO_ 161 1;
BA_ "GenMsgCycleTime" BO_ 161 0;
BA_ "GenMsgCycleTimeFast" BO_ 161 0;
BA_ "GenMsgSendType" BO_ 161 1;
BA_ "VFrameFormat" BO_ 161 14;
BA_ "CANFD_BRS" BO_ 161 1;
BA_ "GenMsgCycleTime" BO_ 161 0;
BA_ "GenMsgCycleTimeFast" BO_ 161 0;
BA_ "GenMsgSendType" BO_ 161 1;
BA_ "VFrameFormat" BO_ 161 14;
BA_ "CANFD_BRS" BO_ 161 1;
BA_ "GenMsgCycleTime" BO_ 161 0;
BA_ "GenMsgCycleTimeFast" BO_ 161 0;
BA_ "GenMsgSendType" BO_ 161 1;
BA_ "VFrameFormat" BO_ 161 14;
BA_ "CANFD_BRS" BO_ 161 1;
BA_ "GenMsgCycleTime" BO_ 432 10;
BA_ "GenMsgCycleTimeFast" BO_ 432 0;
BA_ "GenMsgSendType" BO_ 432 0;
BA_ "VFrameFormat" BO_ 432 14;
BA_ "CANFD_BRS" BO_ 432 1;
BA_ "GenMsgCycleTime" BO_ 432 10;
BA_ "GenMsgCycleTimeFast" BO_ 432 0;
BA_ "GenMsgSendType" BO_ 432 0;
BA_ "VFrameFormat" BO_ 432 14;
BA_ "CANFD_BRS" BO_ 432 1;
BA_ "GenMsgCycleTime" BO_ 432 10;
BA_ "GenMsgCycleTimeFast" BO_ 432 0;
BA_ "GenMsgSendType" BO_ 432 0;
BA_ "VFrameFormat" BO_ 432 14;
BA_ "CANFD_BRS" BO_ 432 1;
BA_ "GenMsgCycleTime" BO_ 432 10;
BA_ "GenMsgCycleTimeFast" BO_ 432 0;
BA_ "GenMsgSendType" BO_ 432 0;
BA_ "VFrameFormat" BO_ 432 14;
BA_ "CANFD_BRS" BO_ 432 1;
BA_ "GenMsgCycleTime" BO_ 432 10;
BA_ "GenMsgCycleTimeFast" BO_ 432 0;
BA_ "GenMsgSendType" BO_ 432 0;
BA_ "VFrameFormat" BO_ 432 14;
BA_ "CANFD_BRS" BO_ 432 1;
BA_ "GenMsgCycleTime" BO_ 432 10;
BA_ "GenMsgCycleTimeFast" BO_ 432 0;
BA_ "GenMsgSendType" BO_ 432 0;
BA_ "VFrameFormat" BO_ 432 14;
BA_ "CANFD_BRS" BO_ 432 1;
BA_ "GenMsgCycleTime" BO_ 432 10;
BA_ "GenMsgCycleTimeFast" BO_ 432 0;
BA_ "GenMsgSendType" BO_ 432 0;
BA_ "VFrameFormat" BO_ 432 14;
BA_ "CANFD_BRS" BO_ 432 1;
BA_ "GenMsgCycleTime" BO_ 432 10;
BA_ "GenMsgCycleTimeFast" BO_ 432 0;
BA_ "GenMsgSendType" BO_ 432 0;
BA_ "VFrameFormat" BO_ 432 14;
BA_ "CANFD_BRS" BO_ 432 1;
BA_ "GenMsgCycleTime" BO_ 432 10;
BA_ "GenMsgCycleTimeFast" BO_ 432 0;
BA_ "GenMsgSendType" BO_ 432 0;
BA_ "VFrameFormat" BO_ 432 14;
BA_ "CANFD_BRS" BO_ 432 1;
BA_ "GenMsgCycleTime" BO_ 432 10;
BA_ "GenMsgCycleTimeFast" BO_ 432 0;
BA_ "GenMsgSendType" BO_ 432 0;
BA_ "VFrameFormat" BO_ 432 14;
BA_ "CANFD_BRS" BO_ 432 1;
BA_ "GenMsgCycleTime" BO_ 432 10;
BA_ "GenMsgCycleTimeFast" BO_ 432 0;
BA_ "GenMsgSendType" BO_ 432 0;
BA_ "VFrameFormat" BO_ 432 14;
BA_ "CANFD_BRS" BO_ 432 1;
BA_ "GenMsgCycleTime" BO_ 432 10;
BA_ "GenMsgCycleTimeFast" BO_ 432 0;
BA_ "GenMsgSendType" BO_ 432 0;
BA_ "VFrameFormat" BO_ 432 14;
BA_ "CANFD_BRS" BO_ 432 1;
BA_ "GenMsgCycleTime" BO_ 432 10;
BA_ "GenMsgCycleTimeFast" BO_ 432 0;
BA_ "GenMsgSendType" BO_ 432 0;
BA_ "VFrameFormat" BO_ 432 14;
BA_ "CANFD_BRS" BO_ 432 1;
BA_ "GenMsgCycleTime" BO_ 432 10;
BA_ "GenMsgCycleTimeFast" BO_ 432 0;
BA_ "GenMsgSendType" BO_ 432 0;
BA_ "VFrameFormat" BO_ 432 14;
BA_ "CANFD_BRS" BO_ 432 1;
BA_ "GenMsgCycleTime" BO_ 432 10;
BA_ "GenMsgCycleTimeFast" BO_ 432 0;
BA_ "GenMsgSendType" BO_ 432 0;
BA_ "VFrameFormat" BO_ 432 14;
BA_ "CANFD_BRS" BO_ 432 1;
BA_ "GenMsgCycleTime" BO_ 432 10;
BA_ "GenMsgCycleTimeFast" BO_ 432 0;
BA_ "GenMsgSendType" BO_ 432 0;
BA_ "VFrameFormat" BO_ 432 14;
BA_ "CANFD_BRS" BO_ 432 1;
BA_ "GenMsgCycleTime" BO_ 432 10;
BA_ "GenMsgCycleTimeFast" BO_ 432 0;
BA_ "GenMsgSendType" BO_ 432 0;
BA_ "VFrameFormat" BO_ 432 14;
BA_ "CANFD_BRS" BO_ 432 1;
BA_ "GenMsgCycleTime" BO_ 432 10;
BA_ "GenMsgCycleTimeFast" BO_ 432 0;
BA_ "GenMsgSendType" BO_ 432 0;
BA_ "VFrameFormat" BO_ 432 14;
BA_ "CANFD_BRS" BO_ 432 1;
BA_ "GenMsgCycleTime" BO_ 432 10;
BA_ "GenMsgCycleTimeFast" BO_ 432 0;
BA_ "GenMsgSendType" BO_ 432 0;
BA_ "VFrameFormat" BO_ 432 14;
BA_ "CANFD_BRS" BO_ 432 1;
BA_ "GenMsgCycleTime" BO_ 432 10;
BA_ "GenMsgCycleTimeFast" BO_ 432 0;
BA_ "GenMsgSendType" BO_ 432 0;
BA_ "VFrameFormat" BO_ 432 14;
BA_ "CANFD_BRS" BO_ 432 1;
BA_ "GenMsgCycleTime" BO_ 432 10;
BA_ "GenMsgCycleTimeFast" BO_ 432 0;
BA_ "GenMsgSendType" BO_ 432 0;
BA_ "VFrameFormat" BO_ 432 14;
BA_ "CANFD_BRS" BO_ 432 1;
BA_ "GenMsgCycleTime" BO_ 432 10;
BA_ "GenMsgCycleTimeFast" BO_ 432 0;
BA_ "GenMsgSendType" BO_ 432 0;
BA_ "VFrameFormat" BO_ 432 14;
BA_ "CANFD_BRS" BO_ 432 1;
BA_ "GenMsgCycleTime" BO_ 432 10;
BA_ "GenMsgCycleTimeFast" BO_ 432 0;
BA_ "GenMsgSendType" BO_ 432 0;
BA_ "VFrameFormat" BO_ 432 14;
BA_ "CANFD_BRS" BO_ 432 1;
BA_ "GenMsgCycleTime" BO_ 433 10;
BA_ "GenMsgCycleTimeFast" BO_ 433 0;
BA_ "GenMsgSendType" BO_ 433 0;
BA_ "VFrameFormat" BO_ 433 14;
BA_ "CANFD_BRS" BO_ 433 1;
BA_ "GenMsgCycleTime" BO_ 433 10;
BA_ "GenMsgCycleTimeFast" BO_ 433 0;
BA_ "GenMsgSendType" BO_ 433 0;
BA_ "VFrameFormat" BO_ 433 14;
BA_ "CANFD_BRS" BO_ 433 1;
BA_ "GenMsgCycleTime" BO_ 433 10;
BA_ "GenMsgCycleTimeFast" BO_ 433 0;
BA_ "GenMsgSendType" BO_ 433 0;
BA_ "VFrameFormat" BO_ 433 14;
BA_ "CANFD_BRS" BO_ 433 1;
BA_ "GenMsgCycleTime" BO_ 433 10;
BA_ "GenMsgCycleTimeFast" BO_ 433 0;
BA_ "GenMsgSendType" BO_ 433 0;
BA_ "VFrameFormat" BO_ 433 14;
BA_ "CANFD_BRS" BO_ 433 1;
BA_ "GenMsgCycleTime" BO_ 433 10;
BA_ "GenMsgCycleTimeFast" BO_ 433 0;
BA_ "GenMsgSendType" BO_ 433 0;
BA_ "VFrameFormat" BO_ 433 14;
BA_ "CANFD_BRS" BO_ 433 1;
BA_ "GenMsgCycleTime" BO_ 433 10;
BA_ "GenMsgCycleTimeFast" BO_ 433 0;
BA_ "GenMsgSendType" BO_ 433 0;
BA_ "VFrameFormat" BO_ 433 14;
BA_ "CANFD_BRS" BO_ 433 1;
BA_ "GenMsgCycleTime" BO_ 433 10;
BA_ "GenMsgCycleTimeFast" BO_ 433 0;
BA_ "GenMsgSendType" BO_ 433 0;
BA_ "VFrameFormat" BO_ 433 14;
BA_ "CANFD_BRS" BO_ 433 1;
BA_ "GenMsgCycleTime" BO_ 433 10;
BA_ "GenMsgCycleTimeFast" BO_ 433 0;
BA_ "GenMsgSendType" BO_ 433 0;
BA_ "VFrameFormat" BO_ 433 14;
BA_ "CANFD_BRS" BO_ 433 1;
BA_ "GenMsgCycleTime" BO_ 433 10;
BA_ "GenMsgCycleTimeFast" BO_ 433 0;
BA_ "GenMsgSendType" BO_ 433 0;
BA_ "VFrameFormat" BO_ 433 14;
BA_ "CANFD_BRS" BO_ 433 1;
BA_ "GenMsgCycleTime" BO_ 433 10;
BA_ "GenMsgCycleTimeFast" BO_ 433 0;
BA_ "GenMsgSendType" BO_ 433 0;
BA_ "VFrameFormat" BO_ 433 14;
BA_ "CANFD_BRS" BO_ 433 1;
BA_ "GenMsgCycleTime" BO_ 433 10;
BA_ "GenMsgCycleTimeFast" BO_ 433 0;
BA_ "GenMsgSendType" BO_ 433 0;
BA_ "VFrameFormat" BO_ 433 14;
BA_ "CANFD_BRS" BO_ 433 1;
BA_ "GenMsgCycleTime" BO_ 433 10;
BA_ "GenMsgCycleTimeFast" BO_ 433 0;
BA_ "GenMsgSendType" BO_ 433 0;
BA_ "VFrameFormat" BO_ 433 14;
BA_ "CANFD_BRS" BO_ 433 1;
BA_ "GenMsgCycleTime" BO_ 433 10;
BA_ "GenMsgCycleTimeFast" BO_ 433 0;
BA_ "GenMsgSendType" BO_ 433 0;
BA_ "VFrameFormat" BO_ 433 14;
BA_ "CANFD_BRS" BO_ 433 1;
BA_ "GenMsgCycleTime" BO_ 433 10;
BA_ "GenMsgCycleTimeFast" BO_ 433 0;
BA_ "GenMsgSendType" BO_ 433 0;
BA_ "VFrameFormat" BO_ 433 14;
BA_ "CANFD_BRS" BO_ 433 1;
BA_ "GenMsgCycleTime" BO_ 433 10;
BA_ "GenMsgCycleTimeFast" BO_ 433 0;
BA_ "GenMsgSendType" BO_ 433 0;
BA_ "VFrameFormat" BO_ 433 14;
BA_ "CANFD_BRS" BO_ 433 1;
BA_ "GenMsgCycleTime" BO_ 433 10;
BA_ "GenMsgCycleTimeFast" BO_ 433 0;
BA_ "GenMsgSendType" BO_ 433 0;
BA_ "VFrameFormat" BO_ 433 14;
BA_ "CANFD_BRS" BO_ 433 1;
BA_ "GenMsgCycleTime" BO_ 433 10;
BA_ "GenMsgCycleTimeFast" BO_ 433 0;
BA_ "GenMsgSendType" BO_ 433 0;
BA_ "VFrameFormat" BO_ 433 14;
BA_ "CANFD_BRS" BO_ 433 1;
BA_ "GenMsgCycleTime" BO_ 433 10;
BA_ "GenMsgCycleTimeFast" BO_ 433 0;
BA_ "GenMsgSendType" BO_ 433 0;
BA_ "VFrameFormat" BO_ 433 14;
BA_ "CANFD_BRS" BO_ 433 1;
BA_ "GenMsgCycleTime" BO_ 433 10;
BA_ "GenMsgCycleTimeFast" BO_ 433 0;
BA_ "GenMsgSendType" BO_ 433 0;
BA_ "VFrameFormat" BO_ 433 14;
BA_ "CANFD_BRS" BO_ 433 1;
BA_ "GenMsgCycleTime" BO_ 433 10;
BA_ "GenMsgCycleTimeFast" BO_ 433 0;
BA_ "GenMsgSendType" BO_ 433 0;
BA_ "VFrameFormat" BO_ 433 14;
BA_ "CANFD_BRS" BO_ 433 1;
BA_ "GenMsgCycleTime" BO_ 433 10;
BA_ "GenMsgCycleTimeFast" BO_ 433 0;
BA_ "GenMsgSendType" BO_ 433 0;
BA_ "VFrameFormat" BO_ 433 14;
BA_ "CANFD_BRS" BO_ 433 1;
BA_ "GenMsgCycleTime" BO_ 433 10;
BA_ "GenMsgCycleTimeFast" BO_ 433 0;
BA_ "GenMsgSendType" BO_ 433 0;
BA_ "VFrameFormat" BO_ 433 14;
BA_ "CANFD_BRS" BO_ 433 1;
BA_ "GenMsgCycleTime" BO_ 433 10;
BA_ "GenMsgCycleTimeFast" BO_ 433 0;
BA_ "GenMsgSendType" BO_ 433 0;
BA_ "VFrameFormat" BO_ 433 14;
BA_ "CANFD_BRS" BO_ 433 1;
BA_ "GenMsgCycleTime" BO_ 433 10;
BA_ "GenMsgCycleTimeFast" BO_ 433 0;
BA_ "GenMsgSendType" BO_ 433 0;
BA_ "VFrameFormat" BO_ 433 14;
BA_ "CANFD_BRS" BO_ 433 1;
BA_ "GenMsgCycleTime" BO_ 433 10;
BA_ "GenMsgCycleTimeFast" BO_ 433 0;
BA_ "GenMsgSendType" BO_ 433 0;
BA_ "VFrameFormat" BO_ 433 14;
BA_ "CANFD_BRS" BO_ 433 1;
BA_ "GenMsgCycleTime" BO_ 433 10;
BA_ "GenMsgCycleTimeFast" BO_ 433 0;
BA_ "GenMsgSendType" BO_ 433 0;
BA_ "VFrameFormat" BO_ 433 14;
BA_ "CANFD_BRS" BO_ 433 1;
BA_ "GenMsgCycleTime" BO_ 433 10;
BA_ "GenMsgCycleTimeFast" BO_ 433 0;
BA_ "GenMsgSendType" BO_ 433 0;
BA_ "VFrameFormat" BO_ 433 14;
BA_ "CANFD_BRS" BO_ 433 1;
BA_ "GenMsgCycleTime" BO_ 433 10;
BA_ "GenMsgCycleTimeFast" BO_ 433 0;
BA_ "GenMsgSendType" BO_ 433 0;
BA_ "VFrameFormat" BO_ 433 14;
BA_ "CANFD_BRS" BO_ 433 1;
BA_ "GenMsgCycleTime" BO_ 791 100;
BA_ "GenMsgCycleTimeFast" BO_ 791 0;
BA_ "GenMsgSendType" BO_ 791 0;
BA_ "VFrameFormat" BO_ 791 14;
BA_ "CANFD_BRS" BO_ 791 1;
BA_ "GenMsgCycleTime" BO_ 791 100;
BA_ "GenMsgCycleTimeFast" BO_ 791 0;
BA_ "GenMsgSendType" BO_ 791 0;
BA_ "VFrameFormat" BO_ 791 14;
BA_ "CANFD_BRS" BO_ 791 1;
BA_ "GenMsgCycleTime" BO_ 791 100;
BA_ "GenMsgCycleTimeFast" BO_ 791 0;
BA_ "GenMsgSendType" BO_ 791 0;
BA_ "VFrameFormat" BO_ 791 14;
BA_ "CANFD_BRS" BO_ 791 1;
BA_ "GenMsgCycleTime" BO_ 791 100;
BA_ "GenMsgCycleTimeFast" BO_ 791 0;
BA_ "GenMsgSendType" BO_ 791 0;
BA_ "VFrameFormat" BO_ 791 14;
BA_ "CANFD_BRS" BO_ 791 1;
BA_ "GenMsgCycleTime" BO_ 791 100;
BA_ "GenMsgCycleTimeFast" BO_ 791 0;
BA_ "GenMsgSendType" BO_ 791 0;
BA_ "VFrameFormat" BO_ 791 14;
BA_ "CANFD_BRS" BO_ 791 1;
BA_ "GenMsgCycleTime" BO_ 791 100;
BA_ "GenMsgCycleTimeFast" BO_ 791 0;
BA_ "GenMsgSendType" BO_ 791 0;
BA_ "VFrameFormat" BO_ 791 14;
BA_ "CANFD_BRS" BO_ 791 1;
BA_ "GenMsgCycleTime" BO_ 791 100;
BA_ "GenMsgCycleTimeFast" BO_ 791 0;
BA_ "GenMsgSendType" BO_ 791 0;
BA_ "VFrameFormat" BO_ 791 14;
BA_ "CANFD_BRS" BO_ 791 1;
BA_ "GenMsgCycleTime" BO_ 791 100;
BA_ "GenMsgCycleTimeFast" BO_ 791 0;
BA_ "GenMsgSendType" BO_ 791 0;
BA_ "VFrameFormat" BO_ 791 14;
BA_ "CANFD_BRS" BO_ 791 1;
BA_ "GenMsgCycleTime" BO_ 791 100;
BA_ "GenMsgCycleTimeFast" BO_ 791 0;
BA_ "GenMsgSendType" BO_ 791 0;
BA_ "VFrameFormat" BO_ 791 14;
BA_ "CANFD_BRS" BO_ 791 1;
BA_ "GenMsgCycleTime" BO_ 791 100;
BA_ "GenMsgCycleTimeFast" BO_ 791 0;
BA_ "GenMsgSendType" BO_ 791 0;
BA_ "VFrameFormat" BO_ 791 14;
BA_ "CANFD_BRS" BO_ 791 1;
BA_ "GenMsgCycleTime" BO_ 791 100;
BA_ "GenMsgCycleTimeFast" BO_ 791 0;
BA_ "GenMsgSendType" BO_ 791 0;
BA_ "VFrameFormat" BO_ 791 14;
BA_ "CANFD_BRS" BO_ 791 1;
BA_ "GenMsgCycleTime" BO_ 791 100;
BA_ "GenMsgCycleTimeFast" BO_ 791 0;
BA_ "GenMsgSendType" BO_ 791 0;
BA_ "VFrameFormat" BO_ 791 14;
BA_ "CANFD_BRS" BO_ 791 1;
BA_ "GenMsgCycleTime" BO_ 791 100;
BA_ "GenMsgCycleTimeFast" BO_ 791 0;
BA_ "GenMsgSendType" BO_ 791 0;
BA_ "VFrameFormat" BO_ 791 14;
BA_ "CANFD_BRS" BO_ 791 1;
BA_ "GenMsgCycleTime" BO_ 791 100;
BA_ "GenMsgCycleTimeFast" BO_ 791 0;
BA_ "GenMsgSendType" BO_ 791 0;
BA_ "VFrameFormat" BO_ 791 14;
BA_ "CANFD_BRS" BO_ 791 1;
BA_ "GenMsgCycleTime" BO_ 791 100;
BA_ "GenMsgCycleTimeFast" BO_ 791 0;
BA_ "GenMsgSendType" BO_ 791 0;
BA_ "VFrameFormat" BO_ 791 14;
BA_ "CANFD_BRS" BO_ 791 1;
BA_ "GenMsgCycleTime" BO_ 791 100;
BA_ "GenMsgCycleTimeFast" BO_ 791 0;
BA_ "GenMsgSendType" BO_ 791 0;
BA_ "VFrameFormat" BO_ 791 14;
BA_ "CANFD_BRS" BO_ 791 1;
BA_ "GenMsgCycleTime" BO_ 791 100;
BA_ "GenMsgCycleTimeFast" BO_ 791 0;
BA_ "GenMsgSendType" BO_ 791 0;
BA_ "VFrameFormat" BO_ 791 14;
BA_ "CANFD_BRS" BO_ 791 1;
BA_ "GenMsgCycleTime" BO_ 791 100;
BA_ "GenMsgCycleTimeFast" BO_ 791 0;
BA_ "GenMsgSendType" BO_ 791 0;
BA_ "VFrameFormat" BO_ 791 14;
BA_ "CANFD_BRS" BO_ 791 1;
BA_ "GenMsgCycleTime" BO_ 791 100;
BA_ "GenMsgCycleTimeFast" BO_ 791 0;
BA_ "GenMsgSendType" BO_ 791 0;
BA_ "VFrameFormat" BO_ 791 14;
BA_ "CANFD_BRS" BO_ 791 1;
BA_ "GenMsgCycleTime" BO_ 791 100;
BA_ "GenMsgCycleTimeFast" BO_ 791 0;
BA_ "GenMsgSendType" BO_ 791 0;
BA_ "VFrameFormat" BO_ 791 14;
BA_ "CANFD_BRS" BO_ 791 1;
BA_ "GenMsgCycleTime" BO_ 791 100;
BA_ "GenMsgCycleTimeFast" BO_ 791 0;
BA_ "GenMsgSendType" BO_ 791 0;
BA_ "VFrameFormat" BO_ 791 14;
BA_ "CANFD_BRS" BO_ 791 1;
BA_ "GenMsgCycleTime" BO_ 791 100;
BA_ "GenMsgCycleTimeFast" BO_ 791 0;
BA_ "GenMsgSendType" BO_ 791 0;
BA_ "VFrameFormat" BO_ 791 14;
BA_ "CANFD_BRS" BO_ 791 1;
BA_ "GenMsgCycleTime" BO_ 791 100;
BA_ "GenMsgCycleTimeFast" BO_ 791 0;
BA_ "GenMsgSendType" BO_ 791 0;
BA_ "VFrameFormat" BO_ 791 14;
BA_ "CANFD_BRS" BO_ 791 1;
BA_ "GenMsgCycleTime" BO_ 791 100;
BA_ "GenMsgCycleTimeFast" BO_ 791 0;
BA_ "GenMsgSendType" BO_ 791 0;
BA_ "VFrameFormat" BO_ 791 14;
BA_ "CANFD_BRS" BO_ 791 1;
BA_ "GenMsgCycleTime" BO_ 791 100;
BA_ "GenMsgCycleTimeFast" BO_ 791 0;
BA_ "GenMsgSendType" BO_ 791 0;
BA_ "VFrameFormat" BO_ 791 14;
BA_ "CANFD_BRS" BO_ 791 1;
BA_ "GenMsgCycleTime" BO_ 791 100;
BA_ "GenMsgCycleTimeFast" BO_ 791 0;
BA_ "GenMsgSendType" BO_ 791 0;
BA_ "VFrameFormat" BO_ 791 14;
BA_ "CANFD_BRS" BO_ 791 1;
BA_ "GenMsgCycleTime" BO_ 791 100;
BA_ "GenMsgCycleTimeFast" BO_ 791 0;
BA_ "GenMsgSendType" BO_ 791 0;
BA_ "VFrameFormat" BO_ 791 14;
BA_ "CANFD_BRS" BO_ 791 1;
BA_ "GenMsgCycleTime" BO_ 791 100;
BA_ "GenMsgCycleTimeFast" BO_ 791 0;
BA_ "GenMsgSendType" BO_ 791 0;
BA_ "VFrameFormat" BO_ 791 14;
BA_ "CANFD_BRS" BO_ 791 1;
BA_ "GenMsgCycleTime" BO_ 791 100;
BA_ "GenMsgCycleTimeFast" BO_ 791 0;
BA_ "GenMsgSendType" BO_ 791 0;
BA_ "VFrameFormat" BO_ 791 14;
BA_ "CANFD_BRS" BO_ 791 1;
BA_ "GenMsgCycleTime" BO_ 791 100;
BA_ "GenMsgCycleTimeFast" BO_ 791 0;
BA_ "GenMsgSendType" BO_ 791 0;
BA_ "VFrameFormat" BO_ 791 14;
BA_ "CANFD_BRS" BO_ 791 1;
BA_ "GenMsgCycleTime" BO_ 791 100;
BA_ "GenMsgCycleTimeFast" BO_ 791 0;
BA_ "GenMsgSendType" BO_ 791 0;
BA_ "VFrameFormat" BO_ 791 14;
BA_ "CANFD_BRS" BO_ 791 1;
BA_ "GenMsgCycleTime" BO_ 791 100;
BA_ "GenMsgCycleTimeFast" BO_ 791 0;
BA_ "GenMsgSendType" BO_ 791 0;
BA_ "VFrameFormat" BO_ 791 14;
BA_ "CANFD_BRS" BO_ 791 1;
BA_ "GenMsgCycleTime" BO_ 791 100;
BA_ "GenMsgCycleTimeFast" BO_ 791 0;
BA_ "GenMsgSendType" BO_ 791 0;
BA_ "VFrameFormat" BO_ 791 14;
BA_ "CANFD_BRS" BO_ 791 1;
BA_ "GenMsgCycleTime" BO_ 791 100;
BA_ "GenMsgCycleTimeFast" BO_ 791 0;
BA_ "GenMsgSendType" BO_ 791 0;
BA_ "VFrameFormat" BO_ 791 14;
BA_ "CANFD_BRS" BO_ 791 1;
BA_ "GenMsgCycleTime" BO_ 791 100;
BA_ "GenMsgCycleTimeFast" BO_ 791 0;
BA_ "GenMsgSendType" BO_ 791 0;
BA_ "VFrameFormat" BO_ 791 14;
BA_ "CANFD_BRS" BO_ 791 1;
BA_ "GenMsgCycleTime" BO_ 616 20;
BA_ "GenMsgCycleTimeFast" BO_ 616 0;
BA_ "GenMsgSendType" BO_ 616 0;
BA_ "VFrameFormat" BO_ 616 14;
BA_ "CANFD_BRS" BO_ 616 1;
BA_ "GenMsgCycleTime" BO_ 616 20;
BA_ "GenMsgCycleTimeFast" BO_ 616 0;
BA_ "GenMsgSendType" BO_ 616 0;
BA_ "VFrameFormat" BO_ 616 14;
BA_ "CANFD_BRS" BO_ 616 1;
BA_ "GenMsgCycleTime" BO_ 616 20;
BA_ "GenMsgCycleTimeFast" BO_ 616 0;
BA_ "GenMsgSendType" BO_ 616 0;
BA_ "VFrameFormat" BO_ 616 14;
BA_ "CANFD_BRS" BO_ 616 1;
BA_ "GenMsgCycleTime" BO_ 616 20;
BA_ "GenMsgCycleTimeFast" BO_ 616 0;
BA_ "GenMsgSendType" BO_ 616 0;
BA_ "VFrameFormat" BO_ 616 14;
BA_ "CANFD_BRS" BO_ 616 1;
BA_ "GenMsgCycleTime" BO_ 616 20;
BA_ "GenMsgCycleTimeFast" BO_ 616 0;
BA_ "GenMsgSendType" BO_ 616 0;
BA_ "VFrameFormat" BO_ 616 14;
BA_ "CANFD_BRS" BO_ 616 1;
BA_ "GenMsgCycleTime" BO_ 616 20;
BA_ "GenMsgCycleTimeFast" BO_ 616 0;
BA_ "GenMsgSendType" BO_ 616 0;
BA_ "VFrameFormat" BO_ 616 14;
BA_ "CANFD_BRS" BO_ 616 1;
BA_ "GenMsgCycleTime" BO_ 616 20;
BA_ "GenMsgCycleTimeFast" BO_ 616 0;
BA_ "GenMsgSendType" BO_ 616 0;
BA_ "VFrameFormat" BO_ 616 14;
BA_ "CANFD_BRS" BO_ 616 1;
BA_ "GenMsgCycleTime" BO_ 616 20;
BA_ "GenMsgCycleTimeFast" BO_ 616 0;
BA_ "GenMsgSendType" BO_ 616 0;
BA_ "VFrameFormat" BO_ 616 14;
BA_ "CANFD_BRS" BO_ 616 1;
BA_ "GenMsgCycleTime" BO_ 616 20;
BA_ "GenMsgCycleTimeFast" BO_ 616 0;
BA_ "GenMsgSendType" BO_ 616 0;
BA_ "VFrameFormat" BO_ 616 14;
BA_ "CANFD_BRS" BO_ 616 1;
BA_ "GenMsgCycleTime" BO_ 616 20;
BA_ "GenMsgCycleTimeFast" BO_ 616 0;
BA_ "GenMsgSendType" BO_ 616 0;
BA_ "VFrameFormat" BO_ 616 14;
BA_ "CANFD_BRS" BO_ 616 1;
BA_ "GenMsgCycleTime" BO_ 616 20;
BA_ "GenMsgCycleTimeFast" BO_ 616 0;
BA_ "GenMsgSendType" BO_ 616 0;
BA_ "VFrameFormat" BO_ 616 14;
BA_ "CANFD_BRS" BO_ 616 1;
BA_ "GenMsgCycleTime" BO_ 616 20;
BA_ "GenMsgCycleTimeFast" BO_ 616 0;
BA_ "GenMsgSendType" BO_ 616 0;
BA_ "VFrameFormat" BO_ 616 14;
BA_ "CANFD_BRS" BO_ 616 1;
BA_ "GenMsgCycleTime" BO_ 616 20;
BA_ "GenMsgCycleTimeFast" BO_ 616 0;
BA_ "GenMsgSendType" BO_ 616 0;
BA_ "VFrameFormat" BO_ 616 14;
BA_ "CANFD_BRS" BO_ 616 1;
BA_ "GenMsgCycleTime" BO_ 616 20;
BA_ "GenMsgCycleTimeFast" BO_ 616 0;
BA_ "GenMsgSendType" BO_ 616 0;
BA_ "VFrameFormat" BO_ 616 14;
BA_ "CANFD_BRS" BO_ 616 1;
BA_ "GenMsgCycleTime" BO_ 616 20;
BA_ "GenMsgCycleTimeFast" BO_ 616 0;
BA_ "GenMsgSendType" BO_ 616 0;
BA_ "VFrameFormat" BO_ 616 14;
BA_ "CANFD_BRS" BO_ 616 1;
BA_ "GenMsgCycleTime" BO_ 616 20;
BA_ "GenMsgCycleTimeFast" BO_ 616 0;
BA_ "GenMsgSendType" BO_ 616 0;
BA_ "VFrameFormat" BO_ 616 14;
BA_ "CANFD_BRS" BO_ 616 1;
BA_ "GenMsgCycleTime" BO_ 616 20;
BA_ "GenMsgCycleTimeFast" BO_ 616 0;
BA_ "GenMsgSendType" BO_ 616 0;
BA_ "VFrameFormat" BO_ 616 14;
BA_ "CANFD_BRS" BO_ 616 1;
BA_ "GenMsgCycleTime" BO_ 616 20;
BA_ "GenMsgCycleTimeFast" BO_ 616 0;
BA_ "GenMsgSendType" BO_ 616 0;
BA_ "VFrameFormat" BO_ 616 14;
BA_ "CANFD_BRS" BO_ 616 1;
BA_ "GenMsgCycleTime" BO_ 616 20;
BA_ "GenMsgCycleTimeFast" BO_ 616 0;
BA_ "GenMsgSendType" BO_ 616 0;
BA_ "VFrameFormat" BO_ 616 14;
BA_ "CANFD_BRS" BO_ 616 1;
BA_ "GenMsgCycleTime" BO_ 616 20;
BA_ "GenMsgCycleTimeFast" BO_ 616 0;
BA_ "GenMsgSendType" BO_ 616 0;
BA_ "VFrameFormat" BO_ 616 14;
BA_ "CANFD_BRS" BO_ 616 1;
BA_ "GenMsgCycleTime" BO_ 825 100;
BA_ "GenMsgCycleTimeFast" BO_ 825 0;
BA_ "GenMsgSendType" BO_ 825 0;
BA_ "VFrameFormat" BO_ 825 14;
BA_ "CANFD_BRS" BO_ 825 1;
BA_ "GenMsgCycleTime" BO_ 825 100;
BA_ "GenMsgCycleTimeFast" BO_ 825 0;
BA_ "GenMsgSendType" BO_ 825 0;
BA_ "VFrameFormat" BO_ 825 14;
BA_ "CANFD_BRS" BO_ 825 1;
BA_ "GenMsgCycleTime" BO_ 825 100;
BA_ "GenMsgCycleTimeFast" BO_ 825 0;
BA_ "GenMsgSendType" BO_ 825 0;
BA_ "VFrameFormat" BO_ 825 14;
BA_ "CANFD_BRS" BO_ 825 1;
BA_ "GenMsgCycleTime" BO_ 825 100;
BA_ "GenMsgCycleTimeFast" BO_ 825 0;
BA_ "GenMsgSendType" BO_ 825 0;
BA_ "VFrameFormat" BO_ 825 14;
BA_ "CANFD_BRS" BO_ 825 1;
BA_ "GenMsgCycleTime" BO_ 825 100;
BA_ "GenMsgCycleTimeFast" BO_ 825 0;
BA_ "GenMsgSendType" BO_ 825 0;
BA_ "VFrameFormat" BO_ 825 14;
BA_ "CANFD_BRS" BO_ 825 1;
BA_ "GenMsgCycleTime" BO_ 825 100;
BA_ "GenMsgCycleTimeFast" BO_ 825 0;
BA_ "GenMsgSendType" BO_ 825 0;
BA_ "VFrameFormat" BO_ 825 14;
BA_ "CANFD_BRS" BO_ 825 1;
BA_ "GenMsgCycleTime" BO_ 825 100;
BA_ "GenMsgCycleTimeFast" BO_ 825 0;
BA_ "GenMsgSendType" BO_ 825 0;
BA_ "VFrameFormat" BO_ 825 14;
BA_ "CANFD_BRS" BO_ 825 1;
BA_ "GenMsgCycleTime" BO_ 825 100;
BA_ "GenMsgCycleTimeFast" BO_ 825 0;
BA_ "GenMsgSendType" BO_ 825 0;
BA_ "VFrameFormat" BO_ 825 14;
BA_ "CANFD_BRS" BO_ 825 1;
BA_ "GenMsgCycleTime" BO_ 825 100;
BA_ "GenMsgCycleTimeFast" BO_ 825 0;
BA_ "GenMsgSendType" BO_ 825 0;
BA_ "VFrameFormat" BO_ 825 14;
BA_ "CANFD_BRS" BO_ 825 1;
BA_ "GenMsgCycleTime" BO_ 825 100;
BA_ "GenMsgCycleTimeFast" BO_ 825 0;
BA_ "GenMsgSendType" BO_ 825 0;
BA_ "VFrameFormat" BO_ 825 14;
BA_ "CANFD_BRS" BO_ 825 1;
BA_ "GenMsgCycleTime" BO_ 825 100;
BA_ "GenMsgCycleTimeFast" BO_ 825 0;
BA_ "GenMsgSendType" BO_ 825 0;
BA_ "VFrameFormat" BO_ 825 14;
BA_ "CANFD_BRS" BO_ 825 1;
BA_ "GenMsgCycleTime" BO_ 825 100;
BA_ "GenMsgCycleTimeFast" BO_ 825 0;
BA_ "GenMsgSendType" BO_ 825 0;
BA_ "VFrameFormat" BO_ 825 14;
BA_ "CANFD_BRS" BO_ 825 1;
BA_ "GenMsgCycleTime" BO_ 825 100;
BA_ "GenMsgCycleTimeFast" BO_ 825 0;
BA_ "GenMsgSendType" BO_ 825 0;
BA_ "VFrameFormat" BO_ 825 14;
BA_ "CANFD_BRS" BO_ 825 1;
BA_ "GenMsgCycleTime" BO_ 825 100;
BA_ "GenMsgCycleTimeFast" BO_ 825 0;
BA_ "GenMsgSendType" BO_ 825 0;
BA_ "VFrameFormat" BO_ 825 14;
BA_ "CANFD_BRS" BO_ 825 1;
BA_ "GenMsgCycleTime" BO_ 825 100;
BA_ "GenMsgCycleTimeFast" BO_ 825 0;
BA_ "GenMsgSendType" BO_ 825 0;
BA_ "VFrameFormat" BO_ 825 14;
BA_ "CANFD_BRS" BO_ 825 1;
BA_ "GenMsgCycleTime" BO_ 825 100;
BA_ "GenMsgCycleTimeFast" BO_ 825 0;
BA_ "GenMsgSendType" BO_ 825 0;
BA_ "VFrameFormat" BO_ 825 14;
BA_ "CANFD_BRS" BO_ 825 1;
BA_ "GenMsgCycleTime" BO_ 825 100;
BA_ "GenMsgCycleTimeFast" BO_ 825 0;
BA_ "GenMsgSendType" BO_ 825 0;
BA_ "VFrameFormat" BO_ 825 14;
BA_ "CANFD_BRS" BO_ 825 1;
BA_ "GenMsgCycleTime" BO_ 825 100;
BA_ "GenMsgCycleTimeFast" BO_ 825 0;
BA_ "GenMsgSendType" BO_ 825 0;
BA_ "VFrameFormat" BO_ 825 14;
BA_ "CANFD_BRS" BO_ 825 1;
BA_ "GenMsgCycleTime" BO_ 825 100;
BA_ "GenMsgCycleTimeFast" BO_ 825 0;
BA_ "GenMsgSendType" BO_ 825 0;
BA_ "VFrameFormat" BO_ 825 14;
BA_ "CANFD_BRS" BO_ 825 1;
BA_ "GenMsgCycleTime" BO_ 825 100;
BA_ "GenMsgCycleTimeFast" BO_ 825 0;
BA_ "GenMsgSendType" BO_ 825 0;
BA_ "VFrameFormat" BO_ 825 14;
BA_ "CANFD_BRS" BO_ 825 1;
BA_ "GenMsgCycleTime" BO_ 825 100;
BA_ "GenMsgCycleTimeFast" BO_ 825 0;
BA_ "GenMsgSendType" BO_ 825 0;
BA_ "VFrameFormat" BO_ 825 14;
BA_ "CANFD_BRS" BO_ 825 1;
BA_ "GenMsgCycleTime" BO_ 825 100;
BA_ "GenMsgCycleTimeFast" BO_ 825 0;
BA_ "GenMsgSendType" BO_ 825 0;
BA_ "VFrameFormat" BO_ 825 14;
BA_ "CANFD_BRS" BO_ 825 1;
BA_ "GenMsgCycleTime" BO_ 389 10;
BA_ "GenMsgCycleTimeFast" BO_ 389 0;
BA_ "GenMsgSendType" BO_ 389 0;
BA_ "VFrameFormat" BO_ 389 14;
BA_ "CANFD_BRS" BO_ 389 1;
BA_ "GenMsgCycleTime" BO_ 389 10;
BA_ "GenMsgCycleTimeFast" BO_ 389 0;
BA_ "GenMsgSendType" BO_ 389 0;
BA_ "VFrameFormat" BO_ 389 14;
BA_ "CANFD_BRS" BO_ 389 1;
BA_ "GenMsgCycleTime" BO_ 389 10;
BA_ "GenMsgCycleTimeFast" BO_ 389 0;
BA_ "GenMsgSendType" BO_ 389 0;
BA_ "VFrameFormat" BO_ 389 14;
BA_ "CANFD_BRS" BO_ 389 1;
BA_ "GenMsgCycleTime" BO_ 389 10;
BA_ "GenMsgCycleTimeFast" BO_ 389 0;
BA_ "GenMsgSendType" BO_ 389 0;
BA_ "VFrameFormat" BO_ 389 14;
BA_ "CANFD_BRS" BO_ 389 1;
BA_ "GenMsgCycleTime" BO_ 389 10;
BA_ "GenMsgCycleTimeFast" BO_ 389 0;
BA_ "GenMsgSendType" BO_ 389 0;
BA_ "VFrameFormat" BO_ 389 14;
BA_ "CANFD_BRS" BO_ 389 1;
BA_ "GenMsgCycleTime" BO_ 389 10;
BA_ "GenMsgCycleTimeFast" BO_ 389 0;
BA_ "GenMsgSendType" BO_ 389 0;
BA_ "VFrameFormat" BO_ 389 14;
BA_ "CANFD_BRS" BO_ 389 1;
BA_ "GenMsgCycleTime" BO_ 389 10;
BA_ "GenMsgCycleTimeFast" BO_ 389 0;
BA_ "GenMsgSendType" BO_ 389 0;
BA_ "VFrameFormat" BO_ 389 14;
BA_ "CANFD_BRS" BO_ 389 1;
BA_ "GenMsgCycleTime" BO_ 389 10;
BA_ "GenMsgCycleTimeFast" BO_ 389 0;
BA_ "GenMsgSendType" BO_ 389 0;
BA_ "VFrameFormat" BO_ 389 14;
BA_ "CANFD_BRS" BO_ 389 1;
BA_ "GenMsgCycleTime" BO_ 389 10;
BA_ "GenMsgCycleTimeFast" BO_ 389 0;
BA_ "GenMsgSendType" BO_ 389 0;
BA_ "VFrameFormat" BO_ 389 14;
BA_ "CANFD_BRS" BO_ 389 1;
BA_ "GenMsgCycleTime" BO_ 389 10;
BA_ "GenMsgCycleTimeFast" BO_ 389 0;
BA_ "GenMsgSendType" BO_ 389 0;
BA_ "VFrameFormat" BO_ 389 14;
BA_ "CANFD_BRS" BO_ 389 1;
BA_ "GenMsgCycleTime" BO_ 389 10;
BA_ "GenMsgCycleTimeFast" BO_ 389 0;
BA_ "GenMsgSendType" BO_ 389 0;
BA_ "VFrameFormat" BO_ 389 14;
BA_ "CANFD_BRS" BO_ 389 1;
BA_ "GenMsgCycleTime" BO_ 389 10;
BA_ "GenMsgCycleTimeFast" BO_ 389 0;
BA_ "GenMsgSendType" BO_ 389 0;
BA_ "VFrameFormat" BO_ 389 14;
BA_ "CANFD_BRS" BO_ 389 1;
BA_ "GenMsgCycleTime" BO_ 389 10;
BA_ "GenMsgCycleTimeFast" BO_ 389 0;
BA_ "GenMsgSendType" BO_ 389 0;
BA_ "VFrameFormat" BO_ 389 14;
BA_ "CANFD_BRS" BO_ 389 1;
BA_ "GenMsgCycleTime" BO_ 389 10;
BA_ "GenMsgCycleTimeFast" BO_ 389 0;
BA_ "GenMsgSendType" BO_ 389 0;
BA_ "VFrameFormat" BO_ 389 14;
BA_ "CANFD_BRS" BO_ 389 1;
BA_ "GenMsgCycleTime" BO_ 389 10;
BA_ "GenMsgCycleTimeFast" BO_ 389 0;
BA_ "GenMsgSendType" BO_ 389 0;
BA_ "VFrameFormat" BO_ 389 14;
BA_ "CANFD_BRS" BO_ 389 1;
BA_ "GenMsgCycleTime" BO_ 389 10;
BA_ "GenMsgCycleTimeFast" BO_ 389 0;
BA_ "GenMsgSendType" BO_ 389 0;
BA_ "VFrameFormat" BO_ 389 14;
BA_ "CANFD_BRS" BO_ 389 1;
BA_ "GenMsgCycleTime" BO_ 389 10;
BA_ "GenMsgCycleTimeFast" BO_ 389 0;
BA_ "GenMsgSendType" BO_ 389 0;
BA_ "VFrameFormat" BO_ 389 14;
BA_ "CANFD_BRS" BO_ 389 1;
BA_ "GenMsgCycleTime" BO_ 389 10;
BA_ "GenMsgCycleTimeFast" BO_ 389 0;
BA_ "GenMsgSendType" BO_ 389 0;
BA_ "VFrameFormat" BO_ 389 14;
BA_ "CANFD_BRS" BO_ 389 1;
BA_ "GenMsgCycleTime" BO_ 389 10;
BA_ "GenMsgCycleTimeFast" BO_ 389 0;
BA_ "GenMsgSendType" BO_ 389 0;
BA_ "VFrameFormat" BO_ 389 14;
BA_ "CANFD_BRS" BO_ 389 1;
BA_ "GenMsgCycleTime" BO_ 389 10;
BA_ "GenMsgCycleTimeFast" BO_ 389 0;
BA_ "GenMsgSendType" BO_ 389 0;
BA_ "VFrameFormat" BO_ 389 14;
BA_ "CANFD_BRS" BO_ 389 1;
BA_ "GenMsgCycleTime" BO_ 389 10;
BA_ "GenMsgCycleTimeFast" BO_ 389 0;
BA_ "GenMsgSendType" BO_ 389 0;
BA_ "VFrameFormat" BO_ 389 14;
BA_ "CANFD_BRS" BO_ 389 1;
BA_ "GenMsgCycleTime" BO_ 389 10;
BA_ "GenMsgCycleTimeFast" BO_ 389 0;
BA_ "GenMsgSendType" BO_ 389 0;
BA_ "VFrameFormat" BO_ 389 14;
BA_ "CANFD_BRS" BO_ 389 1;
BA_ "GenMsgCycleTime" BO_ 389 10;
BA_ "GenMsgCycleTimeFast" BO_ 389 0;
BA_ "GenMsgSendType" BO_ 389 0;
BA_ "VFrameFormat" BO_ 389 14;
BA_ "CANFD_BRS" BO_ 389 1;
BA_ "GenMsgCycleTime" BO_ 389 10;
BA_ "GenMsgCycleTimeFast" BO_ 389 0;
BA_ "GenMsgSendType" BO_ 389 0;
BA_ "VFrameFormat" BO_ 389 14;
BA_ "CANFD_BRS" BO_ 389 1;
BA_ "GenMsgCycleTime" BO_ 389 10;
BA_ "GenMsgCycleTimeFast" BO_ 389 0;
BA_ "GenMsgSendType" BO_ 389 0;
BA_ "VFrameFormat" BO_ 389 14;
BA_ "CANFD_BRS" BO_ 389 1;
BA_ "GenMsgCycleTime" BO_ 389 10;
BA_ "GenMsgCycleTimeFast" BO_ 389 0;
BA_ "GenMsgSendType" BO_ 389 0;
BA_ "VFrameFormat" BO_ 389 14;
BA_ "CANFD_BRS" BO_ 389 1;
BA_ "GenMsgCycleTime" BO_ 389 10;
BA_ "GenMsgCycleTimeFast" BO_ 389 0;
BA_ "GenMsgSendType" BO_ 389 0;
BA_ "VFrameFormat" BO_ 389 14;
BA_ "CANFD_BRS" BO_ 389 1;
BA_ "GenMsgCycleTime" BO_ 389 10;
BA_ "GenMsgCycleTimeFast" BO_ 389 0;
BA_ "GenMsgSendType" BO_ 389 0;
BA_ "VFrameFormat" BO_ 389 14;
BA_ "CANFD_BRS" BO_ 389 1;
BA_ "GenMsgCycleTime" BO_ 389 10;
BA_ "GenMsgCycleTimeFast" BO_ 389 0;
BA_ "GenMsgSendType" BO_ 389 0;
BA_ "VFrameFormat" BO_ 389 14;
BA_ "CANFD_BRS" BO_ 389 1;
BA_ "GenMsgCycleTime" BO_ 389 10;
BA_ "GenMsgCycleTimeFast" BO_ 389 0;
BA_ "GenMsgSendType" BO_ 389 0;
BA_ "VFrameFormat" BO_ 389 14;
BA_ "CANFD_BRS" BO_ 389 1;
BA_ "GenMsgCycleTime" BO_ 389 10;
BA_ "GenMsgCycleTimeFast" BO_ 389 0;
BA_ "GenMsgSendType" BO_ 389 0;
BA_ "VFrameFormat" BO_ 389 14;
BA_ "CANFD_BRS" BO_ 389 1;
BA_ "GenMsgCycleTime" BO_ 389 10;
BA_ "GenMsgCycleTimeFast" BO_ 389 0;
BA_ "GenMsgSendType" BO_ 389 0;
BA_ "VFrameFormat" BO_ 389 14;
BA_ "CANFD_BRS" BO_ 389 1;
BA_ "GenMsgCycleTime" BO_ 389 10;
BA_ "GenMsgCycleTimeFast" BO_ 389 0;
BA_ "GenMsgSendType" BO_ 389 0;
BA_ "VFrameFormat" BO_ 389 14;
BA_ "CANFD_BRS" BO_ 389 1;
BA_ "GenMsgCycleTime" BO_ 389 10;
BA_ "GenMsgCycleTimeFast" BO_ 389 0;
BA_ "GenMsgSendType" BO_ 389 0;
BA_ "VFrameFormat" BO_ 389 14;
BA_ "CANFD_BRS" BO_ 389 1;
BA_ "GenMsgCycleTime" BO_ 389 10;
BA_ "GenMsgCycleTimeFast" BO_ 389 0;
BA_ "GenMsgSendType" BO_ 389 0;
BA_ "VFrameFormat" BO_ 389 14;
BA_ "CANFD_BRS" BO_ 389 1;
BA_ "GenMsgCycleTime" BO_ 389 10;
BA_ "GenMsgCycleTimeFast" BO_ 389 0;
BA_ "GenMsgSendType" BO_ 389 0;
BA_ "VFrameFormat" BO_ 389 14;
BA_ "CANFD_BRS" BO_ 389 1;
BA_ "GenMsgCycleTime" BO_ 389 10;
BA_ "GenMsgCycleTimeFast" BO_ 389 0;
BA_ "GenMsgSendType" BO_ 389 0;
BA_ "VFrameFormat" BO_ 389 14;
BA_ "CANFD_BRS" BO_ 389 1;
BA_ "GenMsgCycleTime" BO_ 389 10;
BA_ "GenMsgCycleTimeFast" BO_ 389 0;
BA_ "GenMsgSendType" BO_ 389 0;
BA_ "VFrameFormat" BO_ 389 14;
BA_ "CANFD_BRS" BO_ 389 1;
BA_ "GenMsgCycleTime" BO_ 389 10;
BA_ "GenMsgCycleTimeFast" BO_ 389 0;
BA_ "GenMsgSendType" BO_ 389 0;
BA_ "VFrameFormat" BO_ 389 14;
BA_ "CANFD_BRS" BO_ 389 1;
BA_ "GenMsgCycleTime" BO_ 389 10;
BA_ "GenMsgCycleTimeFast" BO_ 389 0;
BA_ "GenMsgSendType" BO_ 389 0;
BA_ "VFrameFormat" BO_ 389 14;
BA_ "CANFD_BRS" BO_ 389 1;
BA_ "GenMsgCycleTime" BO_ 389 10;
BA_ "GenMsgCycleTimeFast" BO_ 389 0;
BA_ "GenMsgSendType" BO_ 389 0;
BA_ "VFrameFormat" BO_ 389 14;
BA_ "CANFD_BRS" BO_ 389 1;
BA_ "GenMsgCycleTime" BO_ 389 10;
BA_ "GenMsgCycleTimeFast" BO_ 389 0;
BA_ "GenMsgSendType" BO_ 389 0;
BA_ "VFrameFormat" BO_ 389 14;
BA_ "CANFD_BRS" BO_ 389 1;
BA_ "GenMsgCycleTime" BO_ 389 10;
BA_ "GenMsgCycleTimeFast" BO_ 389 0;
BA_ "GenMsgSendType" BO_ 389 0;
BA_ "VFrameFormat" BO_ 389 14;
BA_ "CANFD_BRS" BO_ 389 1;
BA_ "GenMsgCycleTime" BO_ 389 10;
BA_ "GenMsgCycleTimeFast" BO_ 389 0;
BA_ "GenMsgSendType" BO_ 389 0;
BA_ "VFrameFormat" BO_ 389 14;
BA_ "CANFD_BRS" BO_ 389 1;
BA_ "GenMsgCycleTime" BO_ 389 10;
BA_ "GenMsgCycleTimeFast" BO_ 389 0;
BA_ "GenMsgSendType" BO_ 389 0;
BA_ "VFrameFormat" BO_ 389 14;
BA_ "CANFD_BRS" BO_ 389 1;
BA_ "GenMsgCycleTime" BO_ 389 10;
BA_ "GenMsgCycleTimeFast" BO_ 389 0;
BA_ "GenMsgSendType" BO_ 389 0;
BA_ "VFrameFormat" BO_ 389 14;
BA_ "CANFD_BRS" BO_ 389 1;
BA_ "GenMsgCycleTime" BO_ 389 10;
BA_ "GenMsgCycleTimeFast" BO_ 389 0;
BA_ "GenMsgSendType" BO_ 389 0;
BA_ "VFrameFormat" BO_ 389 14;
BA_ "CANFD_BRS" BO_ 389 1;
BA_ "GenMsgCycleTime" BO_ 389 10;
BA_ "GenMsgCycleTimeFast" BO_ 389 0;
BA_ "GenMsgSendType" BO_ 389 0;
BA_ "VFrameFormat" BO_ 389 14;
BA_ "CANFD_BRS" BO_ 389 1;
BA_ "GenMsgCycleTime" BO_ 389 10;
BA_ "GenMsgCycleTimeFast" BO_ 389 0;
BA_ "GenMsgSendType" BO_ 389 0;
BA_ "VFrameFormat" BO_ 389 14;
BA_ "CANFD_BRS" BO_ 389 1;
BA_ "GenMsgCycleTime" BO_ 389 10;
BA_ "GenMsgCycleTimeFast" BO_ 389 0;
BA_ "GenMsgSendType" BO_ 389 0;
BA_ "VFrameFormat" BO_ 389 14;
BA_ "CANFD_BRS" BO_ 389 1;
BA_ "GenMsgCycleTime" BO_ 389 10;
BA_ "GenMsgCycleTimeFast" BO_ 389 0;
BA_ "GenMsgSendType" BO_ 389 0;
BA_ "VFrameFormat" BO_ 389 14;
BA_ "CANFD_BRS" BO_ 389 1;
BA_ "GenMsgCycleTime" BO_ 389 10;
BA_ "GenMsgCycleTimeFast" BO_ 389 0;
BA_ "GenMsgSendType" BO_ 389 0;
BA_ "VFrameFormat" BO_ 389 14;
BA_ "CANFD_BRS" BO_ 389 1;
BA_ "GenMsgCycleTime" BO_ 389 10;
BA_ "GenMsgCycleTimeFast" BO_ 389 0;
BA_ "GenMsgSendType" BO_ 389 0;
BA_ "VFrameFormat" BO_ 389 14;
BA_ "CANFD_BRS" BO_ 389 1;
BA_ "GenMsgCycleTime" BO_ 389 10;
BA_ "GenMsgCycleTimeFast" BO_ 389 0;
BA_ "GenMsgSendType" BO_ 389 0;
BA_ "VFrameFormat" BO_ 389 14;
BA_ "CANFD_BRS" BO_ 389 1;
BA_ "GenMsgCycleTime" BO_ 389 10;
BA_ "GenMsgCycleTimeFast" BO_ 389 0;
BA_ "GenMsgSendType" BO_ 389 0;
BA_ "VFrameFormat" BO_ 389 14;
BA_ "CANFD_BRS" BO_ 389 1;
BA_ "GenMsgCycleTime" BO_ 389 10;
BA_ "GenMsgCycleTimeFast" BO_ 389 0;
BA_ "GenMsgSendType" BO_ 389 0;
BA_ "VFrameFormat" BO_ 389 14;
BA_ "CANFD_BRS" BO_ 389 1;
BA_ "GenMsgCycleTime" BO_ 389 10;
BA_ "GenMsgCycleTimeFast" BO_ 389 0;
BA_ "GenMsgSendType" BO_ 389 0;
BA_ "VFrameFormat" BO_ 389 14;
BA_ "CANFD_BRS" BO_ 389 1;
BA_ "GenMsgCycleTime" BO_ 389 10;
BA_ "GenMsgCycleTimeFast" BO_ 389 0;
BA_ "GenMsgSendType" BO_ 389 0;
BA_ "VFrameFormat" BO_ 389 14;
BA_ "CANFD_BRS" BO_ 389 1;
BA_ "GenMsgCycleTime" BO_ 389 10;
BA_ "GenMsgCycleTimeFast" BO_ 389 0;
BA_ "GenMsgSendType" BO_ 389 0;
BA_ "VFrameFormat" BO_ 389 14;
BA_ "CANFD_BRS" BO_ 389 1;
BA_ "GenMsgCycleTime" BO_ 389 10;
BA_ "GenMsgCycleTimeFast" BO_ 389 0;
BA_ "GenMsgSendType" BO_ 389 0;
BA_ "VFrameFormat" BO_ 389 14;
BA_ "CANFD_BRS" BO_ 389 1;
BA_ "GenMsgCycleTime" BO_ 389 10;
BA_ "GenMsgCycleTimeFast" BO_ 389 0;
BA_ "GenMsgSendType" BO_ 389 0;
BA_ "VFrameFormat" BO_ 389 14;
BA_ "CANFD_BRS" BO_ 389 1;
BA_ "GenMsgCycleTime" BO_ 389 10;
BA_ "GenMsgCycleTimeFast" BO_ 389 0;
BA_ "GenMsgSendType" BO_ 389 0;
BA_ "VFrameFormat" BO_ 389 14;
BA_ "CANFD_BRS" BO_ 389 1;
BA_ "GenMsgCycleTime" BO_ 389 10;
BA_ "GenMsgCycleTimeFast" BO_ 389 0;
BA_ "GenMsgSendType" BO_ 389 0;
BA_ "VFrameFormat" BO_ 389 14;
BA_ "CANFD_BRS" BO_ 389 1;
BA_ "GenMsgCycleTime" BO_ 389 10;
BA_ "GenMsgCycleTimeFast" BO_ 389 0;
BA_ "GenMsgSendType" BO_ 389 0;
BA_ "VFrameFormat" BO_ 389 14;
BA_ "CANFD_BRS" BO_ 389 1;
BA_ "GenMsgCycleTime" BO_ 389 10;
BA_ "GenMsgCycleTimeFast" BO_ 389 0;
BA_ "GenMsgSendType" BO_ 389 0;
BA_ "VFrameFormat" BO_ 389 14;
BA_ "CANFD_BRS" BO_ 389 1;
BA_ "GenMsgCycleTime" BO_ 389 10;
BA_ "GenMsgCycleTimeFast" BO_ 389 0;
BA_ "GenMsgSendType" BO_ 389 0;
BA_ "VFrameFormat" BO_ 389 14;
BA_ "CANFD_BRS" BO_ 389 1;
BA_ "GenMsgCycleTime" BO_ 389 10;
BA_ "GenMsgCycleTimeFast" BO_ 389 0;
BA_ "GenMsgSendType" BO_ 389 0;
BA_ "VFrameFormat" BO_ 389 14;
BA_ "CANFD_BRS" BO_ 389 1;
BA_ "GenMsgCycleTime" BO_ 389 10;
BA_ "GenMsgCycleTimeFast" BO_ 389 0;
BA_ "GenMsgSendType" BO_ 389 0;
BA_ "VFrameFormat" BO_ 389 14;
BA_ "CANFD_BRS" BO_ 389 1;
BA_ "GenMsgCycleTime" BO_ 389 10;
BA_ "GenMsgCycleTimeFast" BO_ 389 0;
BA_ "GenMsgSendType" BO_ 389 0;
BA_ "VFrameFormat" BO_ 389 14;
BA_ "CANFD_BRS" BO_ 389 1;
BA_ "GenMsgCycleTime" BO_ 389 10;
BA_ "GenMsgCycleTimeFast" BO_ 389 0;
BA_ "GenMsgSendType" BO_ 389 0;
BA_ "VFrameFormat" BO_ 389 14;
BA_ "CANFD_BRS" BO_ 389 1;
BA_ "GenMsgCycleTime" BO_ 389 10;
BA_ "GenMsgCycleTimeFast" BO_ 389 0;
BA_ "GenMsgSendType" BO_ 389 0;
BA_ "VFrameFormat" BO_ 389 14;
BA_ "CANFD_BRS" BO_ 389 1;
BA_ "GenMsgCycleTime" BO_ 389 10;
BA_ "GenMsgCycleTimeFast" BO_ 389 0;
BA_ "GenMsgSendType" BO_ 389 0;
BA_ "VFrameFormat" BO_ 389 14;
BA_ "CANFD_BRS" BO_ 389 1;
BA_ "GenMsgCycleTime" BO_ 389 10;
BA_ "GenMsgCycleTimeFast" BO_ 389 0;
BA_ "GenMsgSendType" BO_ 389 0;
BA_ "VFrameFormat" BO_ 389 14;
BA_ "CANFD_BRS" BO_ 389 1;
BA_ "GenMsgCycleTime" BO_ 389 10;
BA_ "GenMsgCycleTimeFast" BO_ 389 0;
BA_ "GenMsgSendType" BO_ 389 0;
BA_ "VFrameFormat" BO_ 389 14;
BA_ "CANFD_BRS" BO_ 389 1;
BA_ "GenMsgCycleTime" BO_ 389 10;
BA_ "GenMsgCycleTimeFast" BO_ 389 0;
BA_ "GenMsgSendType" BO_ 389 0;
BA_ "VFrameFormat" BO_ 389 14;
BA_ "CANFD_BRS" BO_ 389 1;
BA_ "GenMsgCycleTime" BO_ 389 10;
BA_ "GenMsgCycleTimeFast" BO_ 389 0;
BA_ "GenMsgSendType" BO_ 389 0;
BA_ "VFrameFormat" BO_ 389 14;
BA_ "CANFD_BRS" BO_ 389 1;
BA_ "GenMsgCycleTime" BO_ 389 10;
BA_ "GenMsgCycleTimeFast" BO_ 389 0;
BA_ "GenMsgSendType" BO_ 389 0;
BA_ "VFrameFormat" BO_ 389 14;
BA_ "CANFD_BRS" BO_ 389 1;
BA_ "GenMsgCycleTime" BO_ 389 10;
BA_ "GenMsgCycleTimeFast" BO_ 389 0;
BA_ "GenMsgSendType" BO_ 389 0;
BA_ "VFrameFormat" BO_ 389 14;
BA_ "CANFD_BRS" BO_ 389 1;
BA_ "GenMsgCycleTime" BO_ 389 10;
BA_ "GenMsgCycleTimeFast" BO_ 389 0;
BA_ "GenMsgSendType" BO_ 389 0;
BA_ "VFrameFormat" BO_ 389 14;
BA_ "CANFD_BRS" BO_ 389 1;
BA_ "GenMsgCycleTime" BO_ 389 10;
BA_ "GenMsgCycleTimeFast" BO_ 389 0;
BA_ "GenMsgSendType" BO_ 389 0;
BA_ "VFrameFormat" BO_ 389 14;
BA_ "CANFD_BRS" BO_ 389 1;
BA_ "GenMsgCycleTime" BO_ 389 10;
BA_ "GenMsgCycleTimeFast" BO_ 389 0;
BA_ "GenMsgSendType" BO_ 389 0;
BA_ "VFrameFormat" BO_ 389 14;
BA_ "CANFD_BRS" BO_ 389 1;
BA_ "GenMsgCycleTime" BO_ 389 10;
BA_ "GenMsgCycleTimeFast" BO_ 389 0;
BA_ "GenMsgSendType" BO_ 389 0;
BA_ "VFrameFormat" BO_ 389 14;
BA_ "CANFD_BRS" BO_ 389 1;
BA_ "GenMsgCycleTime" BO_ 389 10;
BA_ "GenMsgCycleTimeFast" BO_ 389 0;
BA_ "GenMsgSendType" BO_ 389 0;
BA_ "VFrameFormat" BO_ 389 14;
BA_ "CANFD_BRS" BO_ 389 1;
BA_ "GenMsgCycleTime" BO_ 389 10;
BA_ "GenMsgCycleTimeFast" BO_ 389 0;
BA_ "GenMsgSendType" BO_ 389 0;
BA_ "VFrameFormat" BO_ 389 14;
BA_ "CANFD_BRS" BO_ 389 1;
BA_ "GenMsgCycleTime" BO_ 389 10;
BA_ "GenMsgCycleTimeFast" BO_ 389 0;
BA_ "GenMsgSendType" BO_ 389 0;
BA_ "VFrameFormat" BO_ 389 14;
BA_ "CANFD_BRS" BO_ 389 1;
BA_ "GenMsgCycleTime" BO_ 389 10;
BA_ "GenMsgCycleTimeFast" BO_ 389 0;
BA_ "GenMsgSendType" BO_ 389 0;
BA_ "VFrameFormat" BO_ 389 14;
BA_ "CANFD_BRS" BO_ 389 1;
BA_ "GenMsgCycleTime" BO_ 389 10;
BA_ "GenMsgCycleTimeFast" BO_ 389 0;
BA_ "GenMsgSendType" BO_ 389 0;
BA_ "VFrameFormat" BO_ 389 14;
BA_ "CANFD_BRS" BO_ 389 1;
BA_ "GenMsgCycleTime" BO_ 389 10;
BA_ "GenMsgCycleTimeFast" BO_ 389 0;
BA_ "GenMsgSendType" BO_ 389 0;
BA_ "VFrameFormat" BO_ 389 14;
BA_ "CANFD_BRS" BO_ 389 1;
BA_ "GenMsgCycleTime" BO_ 389 10;
BA_ "GenMsgCycleTimeFast" BO_ 389 0;
BA_ "GenMsgSendType" BO_ 389 0;
BA_ "VFrameFormat" BO_ 389 14;
BA_ "CANFD_BRS" BO_ 389 1;
BA_ "GenMsgCycleTime" BO_ 389 10;
BA_ "GenMsgCycleTimeFast" BO_ 389 0;
BA_ "GenMsgSendType" BO_ 389 0;
BA_ "VFrameFormat" BO_ 389 14;
BA_ "CANFD_BRS" BO_ 389 1;
BA_ "GenMsgCycleTime" BO_ 389 10;
BA_ "GenMsgCycleTimeFast" BO_ 389 0;
BA_ "GenMsgSendType" BO_ 389 0;
BA_ "VFrameFormat" BO_ 389 14;
BA_ "CANFD_BRS" BO_ 389 1;
BA_ "GenMsgCycleTime" BO_ 389 10;
BA_ "GenMsgCycleTimeFast" BO_ 389 0;
BA_ "GenMsgSendType" BO_ 389 0;
BA_ "VFrameFormat" BO_ 389 14;
BA_ "CANFD_BRS" BO_ 389 1;
BA_ "GenMsgCycleTime" BO_ 389 10;
BA_ "GenMsgCycleTimeFast" BO_ 389 0;
BA_ "GenMsgSendType" BO_ 389 0;
BA_ "VFrameFormat" BO_ 389 14;
BA_ "CANFD_BRS" BO_ 389 1;
BA_ "GenMsgCycleTime" BO_ 389 10;
BA_ "GenMsgCycleTimeFast" BO_ 389 0;
BA_ "GenMsgSendType" BO_ 389 0;
BA_ "VFrameFormat" BO_ 389 14;
BA_ "CANFD_BRS" BO_ 389 1;
BA_ "EventCommandSignal" SG_ 161 ACU_FaceID_Delete 1;
BA_ "GatewayedSignals" SG_ 161 ACU_FaceID_Delete 0;
BA_ "GenSigInactiveValue" SG_ 161 ACU_FaceID_Delete 0;
BA_ "GenSigInvalidValue" SG_ 161 ACU_FaceID_Delete 0;
BA_ "GenSigSendType" SG_ 161 ACU_FaceID_Delete 0;
BA_ "GenSigStartValue" SG_ 161 ACU_FaceID_Delete 0;
BA_ "GenSigTimeoutValue" SG_ 161 ACU_FaceID_Delete 0;
BA_ "Remark" SG_ 161 ACU_FaceID_Delete "";
BA_ "EventCommandSignal" SG_ 161 ACU_RegisterTriger 1;
BA_ "GatewayedSignals" SG_ 161 ACU_RegisterTriger 0;
BA_ "GenSigInactiveValue" SG_ 161 ACU_RegisterTriger 0;
BA_ "GenSigInvalidValue" SG_ 161 ACU_RegisterTriger 0;
BA_ "GenSigSendType" SG_ 161 ACU_RegisterTriger 0;
BA_ "GenSigStartValue" SG_ 161 ACU_RegisterTriger 0;
BA_ "GenSigTimeoutValue" SG_ 161 ACU_RegisterTriger 0;
BA_ "Remark" SG_ 161 ACU_RegisterTriger "";
BA_ "EventCommandSignal" SG_ 161 ACU_VerifyTriger 1;
BA_ "GatewayedSignals" SG_ 161 ACU_VerifyTriger 0;
BA_ "GenSigInactiveValue" SG_ 161 ACU_VerifyTriger 0;
BA_ "GenSigInvalidValue" SG_ 161 ACU_VerifyTriger 0;
BA_ "GenSigSendType" SG_ 161 ACU_VerifyTriger 0;
BA_ "GenSigStartValue" SG_ 161 ACU_VerifyTriger 0;
BA_ "GenSigTimeoutValue" SG_ 161 ACU_VerifyTriger 0;
BA_ "Remark" SG_ 161 ACU_VerifyTriger "";
BA_ "EventCommandSignal" SG_ 161 ACU_FaceIDQuit 1;
BA_ "GatewayedSignals" SG_ 161 ACU_FaceIDQuit 0;
BA_ "GenSigInactiveValue" SG_ 161 ACU_FaceIDQuit 0;
BA_ "GenSigInvalidValue" SG_ 161 ACU_FaceIDQuit 0;
BA_ "GenSigSendType" SG_ 161 ACU_FaceIDQuit 0;
BA_ "GenSigStartValue" SG_ 161 ACU_FaceIDQuit 0;
BA_ "GenSigTimeoutValue" SG_ 161 ACU_FaceIDQuit 0;
BA_ "Remark" SG_ 161 ACU_FaceIDQuit "";
BA_ "EventCommandSignal" SG_ 161 ACU_FaceIDSwitch 1;
BA_ "GatewayedSignals" SG_ 161 ACU_FaceIDSwitch 0;
BA_ "GenSigInactiveValue" SG_ 161 ACU_FaceIDSwitch 0;
BA_ "GenSigInvalidValue" SG_ 161 ACU_FaceIDSwitch 0;
BA_ "GenSigSendType" SG_ 161 ACU_FaceIDSwitch 0;
BA_ "GenSigStartValue" SG_ 161 ACU_FaceIDSwitch 0;
BA_ "GenSigTimeoutValue" SG_ 161 ACU_FaceIDSwitch 0;
BA_ "Remark" SG_ 161 ACU_FaceIDSwitch "";
BA_ "EventCommandSignal" SG_ 161 ACU_AVAS_SwitchCfgReq 1;
BA_ "GatewayedSignals" SG_ 161 ACU_AVAS_SwitchCfgReq 0;
BA_ "GenSigInactiveValue" SG_ 161 ACU_AVAS_SwitchCfgReq 0;
BA_ "GenSigInvalidValue" SG_ 161 ACU_AVAS_SwitchCfgReq 0;
BA_ "GenSigSendType" SG_ 161 ACU_AVAS_SwitchCfgReq 0;
BA_ "GenSigStartValue" SG_ 161 ACU_AVAS_SwitchCfgReq 0;
BA_ "GenSigTimeoutValue" SG_ 161 ACU_AVAS_SwitchCfgReq 0;
BA_ "Remark" SG_ 161 ACU_AVAS_SwitchCfgReq "";
BA_ "EventCommandSignal" SG_ 432 ICC_1_CRC 0;
BA_ "GatewayedSignals" SG_ 432 ICC_1_CRC 0;
BA_ "GenSigInactiveValue" SG_ 432 ICC_1_CRC 0;
BA_ "GenSigInvalidValue" SG_ 432 ICC_1_CRC 0;
BA_ "GenSigSendType" SG_ 432 ICC_1_CRC 1;
BA_ "GenSigStartValue" SG_ 432 ICC_1_CRC 0;
BA_ "GenSigTimeoutValue" SG_ 432 ICC_1_CRC 0;
BA_ "Remark" SG_ 432 ICC_1_CRC "";
BA_ "EventCommandSignal" SG_ 432 ICC_1_Counter 0;
BA_ "GatewayedSignals" SG_ 432 ICC_1_Counter 0;
BA_ "GenSigInactiveValue" SG_ 432 ICC_1_Counter 0;
BA_ "GenSigInvalidValue" SG_ 432 ICC_1_Counter 0;
BA_ "GenSigSendType" SG_ 432 ICC_1_Counter 1;
BA_ "GenSigStartValue" SG_ 432 ICC_1_Counter 0;
BA_ "GenSigTimeoutValue" SG_ 432 ICC_1_Counter 0;
BA_ "Remark" SG_ 432 ICC_1_Counter "";
BA_ "EventCommandSignal" SG_ 432 ICC_FcnInfo 0;
BA_ "GatewayedSignals" SG_ 432 ICC_FcnInfo 0;
BA_ "GenSigInactiveValue" SG_ 432 ICC_FcnInfo 0;
BA_ "GenSigInvalidValue" SG_ 432 ICC_FcnInfo 0;
BA_ "GenSigSendType" SG_ 432 ICC_FcnInfo 1;
BA_ "GenSigStartValue" SG_ 432 ICC_FcnInfo 0;
BA_ "GenSigTimeoutValue" SG_ 432 ICC_FcnInfo 0;
BA_ "Remark" SG_ 432 ICC_FcnInfo "";
BA_ "EventCommandSignal" SG_ 432 ICC_FaultSt 0;
BA_ "GatewayedSignals" SG_ 432 ICC_FaultSt 0;
BA_ "GenSigInactiveValue" SG_ 432 ICC_FaultSt 0;
BA_ "GenSigInvalidValue" SG_ 432 ICC_FaultSt 0;
BA_ "GenSigSendType" SG_ 432 ICC_FaultSt 1;
BA_ "GenSigStartValue" SG_ 432 ICC_FaultSt 0;
BA_ "GenSigTimeoutValue" SG_ 432 ICC_FaultSt 0;
BA_ "Remark" SG_ 432 ICC_FaultSt "";
BA_ "EventCommandSignal" SG_ 432 ICC_ActorSt 0;
BA_ "GatewayedSignals" SG_ 432 ICC_ActorSt 0;
BA_ "GenSigInactiveValue" SG_ 432 ICC_ActorSt 0;
BA_ "GenSigInvalidValue" SG_ 432 ICC_ActorSt 0;
BA_ "GenSigSendType" SG_ 432 ICC_ActorSt 1;
BA_ "GenSigStartValue" SG_ 432 ICC_ActorSt 0;
BA_ "GenSigTimeoutValue" SG_ 432 ICC_ActorSt 0;
BA_ "Remark" SG_ 432 ICC_ActorSt "";
BA_ "EventCommandSignal" SG_ 432 ICC_FrontLeftTireBlowout 0;
BA_ "GatewayedSignals" SG_ 432 ICC_FrontLeftTireBlowout 0;
BA_ "GenSigInactiveValue" SG_ 432 ICC_FrontLeftTireBlowout 0;
BA_ "GenSigInvalidValue" SG_ 432 ICC_FrontLeftTireBlowout 0;
BA_ "GenSigSendType" SG_ 432 ICC_FrontLeftTireBlowout 1;
BA_ "GenSigStartValue" SG_ 432 ICC_FrontLeftTireBlowout 0;
BA_ "GenSigTimeoutValue" SG_ 432 ICC_FrontLeftTireBlowout 0;
BA_ "Remark" SG_ 432 ICC_FrontLeftTireBlowout "";
BA_ "EventCommandSignal" SG_ 432 ICC_FrontRightTireBlowout 0;
BA_ "GatewayedSignals" SG_ 432 ICC_FrontRightTireBlowout 0;
BA_ "GenSigInactiveValue" SG_ 432 ICC_FrontRightTireBlowout 0;
BA_ "GenSigInvalidValue" SG_ 432 ICC_FrontRightTireBlowout 0;
BA_ "GenSigSendType" SG_ 432 ICC_FrontRightTireBlowout 1;
BA_ "GenSigStartValue" SG_ 432 ICC_FrontRightTireBlowout 0;
BA_ "GenSigTimeoutValue" SG_ 432 ICC_FrontRightTireBlowout 0;
BA_ "Remark" SG_ 432 ICC_FrontRightTireBlowout "";
BA_ "EventCommandSignal" SG_ 432 ICC_RearRightTireBlowout 0;
BA_ "GatewayedSignals" SG_ 432 ICC_RearRightTireBlowout 0;
BA_ "GenSigInactiveValue" SG_ 432 ICC_RearRightTireBlowout 0;
BA_ "GenSigInvalidValue" SG_ 432 ICC_RearRightTireBlowout 0;
BA_ "GenSigSendType" SG_ 432 ICC_RearRightTireBlowout 1;
BA_ "GenSigStartValue" SG_ 432 ICC_RearRightTireBlowout 0;
BA_ "GenSigTimeoutValue" SG_ 432 ICC_RearRightTireBlowout 0;
BA_ "Remark" SG_ 432 ICC_RearRightTireBlowout "";
BA_ "EventCommandSignal" SG_ 432 ICC_RearLeftTireBlowout 0;
BA_ "GatewayedSignals" SG_ 432 ICC_RearLeftTireBlowout 0;
BA_ "GenSigInactiveValue" SG_ 432 ICC_RearLeftTireBlowout 0;
BA_ "GenSigInvalidValue" SG_ 432 ICC_RearLeftTireBlowout 0;
BA_ "GenSigSendType" SG_ 432 ICC_RearLeftTireBlowout 1;
BA_ "GenSigStartValue" SG_ 432 ICC_RearLeftTireBlowout 0;
BA_ "GenSigTimeoutValue" SG_ 432 ICC_RearLeftTireBlowout 0;
BA_ "Remark" SG_ 432 ICC_RearLeftTireBlowout "";
BA_ "EventCommandSignal" SG_ 432 ICC_RAS_AgCtrlAvl 0;
BA_ "GatewayedSignals" SG_ 432 ICC_RAS_AgCtrlAvl 0;
BA_ "GenSigInactiveValue" SG_ 432 ICC_RAS_AgCtrlAvl 0;
BA_ "GenSigInvalidValue" SG_ 432 ICC_RAS_AgCtrlAvl 0;
BA_ "GenSigSendType" SG_ 432 ICC_RAS_AgCtrlAvl 1;
BA_ "GenSigStartValue" SG_ 432 ICC_RAS_AgCtrlAvl 0;
BA_ "GenSigTimeoutValue" SG_ 432 ICC_RAS_AgCtrlAvl 0;
BA_ "Remark" SG_ 432 ICC_RAS_AgCtrlAvl "";
BA_ "EventCommandSignal" SG_ 432 ICC_RAS_CalibratedSt 0;
BA_ "GatewayedSignals" SG_ 432 ICC_RAS_CalibratedSt 0;
BA_ "GenSigInactiveValue" SG_ 432 ICC_RAS_CalibratedSt 0;
BA_ "GenSigInvalidValue" SG_ 432 ICC_RAS_CalibratedSt 0;
BA_ "GenSigSendType" SG_ 432 ICC_RAS_CalibratedSt 1;
BA_ "GenSigStartValue" SG_ 432 ICC_RAS_CalibratedSt 1;
BA_ "GenSigTimeoutValue" SG_ 432 ICC_RAS_CalibratedSt 0;
BA_ "Remark" SG_ 432 ICC_RAS_CalibratedSt "";
BA_ "EventCommandSignal" SG_ 432 ICC_RAS_ErrFeedback 0;
BA_ "GatewayedSignals" SG_ 432 ICC_RAS_ErrFeedback 0;
BA_ "GenSigInactiveValue" SG_ 432 ICC_RAS_ErrFeedback 0;
BA_ "GenSigInvalidValue" SG_ 432 ICC_RAS_ErrFeedback 0;
BA_ "GenSigSendType" SG_ 432 ICC_RAS_ErrFeedback 1;
BA_ "GenSigStartValue" SG_ 432 ICC_RAS_ErrFeedback 0;
BA_ "GenSigTimeoutValue" SG_ 432 ICC_RAS_ErrFeedback 0;
BA_ "Remark" SG_ 432 ICC_RAS_ErrFeedback "";
BA_ "EventCommandSignal" SG_ 432 ICC_RAS_AngleVD 0;
BA_ "GatewayedSignals" SG_ 432 ICC_RAS_AngleVD 0;
BA_ "GenSigInactiveValue" SG_ 432 ICC_RAS_AngleVD 0;
BA_ "GenSigInvalidValue" SG_ 432 ICC_RAS_AngleVD 0;
BA_ "GenSigSendType" SG_ 432 ICC_RAS_AngleVD 1;
BA_ "GenSigStartValue" SG_ 432 ICC_RAS_AngleVD 1;
BA_ "GenSigTimeoutValue" SG_ 432 ICC_RAS_AngleVD 0;
BA_ "Remark" SG_ 432 ICC_RAS_AngleVD "";
BA_ "EventCommandSignal" SG_ 432 ICC_RAS_PstOverlaySt 0;
BA_ "GatewayedSignals" SG_ 432 ICC_RAS_PstOverlaySt 0;
BA_ "GenSigInactiveValue" SG_ 432 ICC_RAS_PstOverlaySt 0;
BA_ "GenSigInvalidValue" SG_ 432 ICC_RAS_PstOverlaySt 0;
BA_ "GenSigSendType" SG_ 432 ICC_RAS_PstOverlaySt 1;
BA_ "GenSigStartValue" SG_ 432 ICC_RAS_PstOverlaySt 0;
BA_ "GenSigTimeoutValue" SG_ 432 ICC_RAS_PstOverlaySt 0;
BA_ "Remark" SG_ 432 ICC_RAS_PstOverlaySt "";
BA_ "EventCommandSignal" SG_ 432 ICC_RAS_SteerMod 0;
BA_ "GatewayedSignals" SG_ 432 ICC_RAS_SteerMod 0;
BA_ "GenSigInactiveValue" SG_ 432 ICC_RAS_SteerMod 0;
BA_ "GenSigInvalidValue" SG_ 432 ICC_RAS_SteerMod 0;
BA_ "GenSigSendType" SG_ 432 ICC_RAS_SteerMod 1;
BA_ "GenSigStartValue" SG_ 432 ICC_RAS_SteerMod 1;
BA_ "GenSigTimeoutValue" SG_ 432 ICC_RAS_SteerMod 1;
BA_ "Remark" SG_ 432 ICC_RAS_SteerMod "";
BA_ "EventCommandSignal" SG_ 432 ICC_RAS_SteeringAngle 0;
BA_ "GatewayedSignals" SG_ 432 ICC_RAS_SteeringAngle 0;
BA_ "GenSigInactiveValue" SG_ 432 ICC_RAS_SteeringAngle 0;
BA_ "GenSigInvalidValue" SG_ 432 ICC_RAS_SteeringAngle 0;
BA_ "GenSigSendType" SG_ 432 ICC_RAS_SteeringAngle 1;
BA_ "GenSigStartValue" SG_ 432 ICC_RAS_SteeringAngle 1023;
BA_ "GenSigTimeoutValue" SG_ 432 ICC_RAS_SteeringAngle 1023;
BA_ "Remark" SG_ 432 ICC_RAS_SteeringAngle "";
BA_ "EventCommandSignal" SG_ 432 ICC_RAS_HealthyStForADC 0;
BA_ "GatewayedSignals" SG_ 432 ICC_RAS_HealthyStForADC 0;
BA_ "GenSigInactiveValue" SG_ 432 ICC_RAS_HealthyStForADC 0;
BA_ "GenSigInvalidValue" SG_ 432 ICC_RAS_HealthyStForADC 0;
BA_ "GenSigSendType" SG_ 432 ICC_RAS_HealthyStForADC 1;
BA_ "GenSigStartValue" SG_ 432 ICC_RAS_HealthyStForADC 0;
BA_ "GenSigTimeoutValue" SG_ 432 ICC_RAS_HealthyStForADC 0;
BA_ "Remark" SG_ 432 ICC_RAS_HealthyStForADC "";
BA_ "EventCommandSignal" SG_ 432 ICC_RAS_SteeringAngleSpdVD 0;
BA_ "GatewayedSignals" SG_ 432 ICC_RAS_SteeringAngleSpdVD 0;
BA_ "GenSigInactiveValue" SG_ 432 ICC_RAS_SteeringAngleSpdVD 0;
BA_ "GenSigInvalidValue" SG_ 432 ICC_RAS_SteeringAngleSpdVD 0;
BA_ "GenSigSendType" SG_ 432 ICC_RAS_SteeringAngleSpdVD 1;
BA_ "GenSigStartValue" SG_ 432 ICC_RAS_SteeringAngleSpdVD 1;
BA_ "GenSigTimeoutValue" SG_ 432 ICC_RAS_SteeringAngleSpdVD 1;
BA_ "Remark" SG_ 432 ICC_RAS_SteeringAngleSpdVD "";
BA_ "EventCommandSignal" SG_ 432 ICC_RAS_ThermalSt 0;
BA_ "GatewayedSignals" SG_ 432 ICC_RAS_ThermalSt 0;
BA_ "GenSigInactiveValue" SG_ 432 ICC_RAS_ThermalSt 0;
BA_ "GenSigInvalidValue" SG_ 432 ICC_RAS_ThermalSt 0;
BA_ "GenSigSendType" SG_ 432 ICC_RAS_ThermalSt 1;
BA_ "GenSigStartValue" SG_ 432 ICC_RAS_ThermalSt 0;
BA_ "GenSigTimeoutValue" SG_ 432 ICC_RAS_ThermalSt 0;
BA_ "Remark" SG_ 432 ICC_RAS_ThermalSt "";
BA_ "EventCommandSignal" SG_ 432 ICC_RAS_SteeringAngleRate 0;
BA_ "GatewayedSignals" SG_ 432 ICC_RAS_SteeringAngleRate 0;
BA_ "GenSigInactiveValue" SG_ 432 ICC_RAS_SteeringAngleRate 0;
BA_ "GenSigInvalidValue" SG_ 432 ICC_RAS_SteeringAngleRate 0;
BA_ "GenSigSendType" SG_ 432 ICC_RAS_SteeringAngleRate 1;
BA_ "GenSigStartValue" SG_ 432 ICC_RAS_SteeringAngleRate 2252;
BA_ "GenSigTimeoutValue" SG_ 432 ICC_RAS_SteeringAngleRate 2252;
BA_ "Remark" SG_ 432 ICC_RAS_SteeringAngleRate "";
BA_ "EventCommandSignal" SG_ 432 ICC_RAS_WarnLamp 0;
BA_ "GatewayedSignals" SG_ 432 ICC_RAS_WarnLamp 0;
BA_ "GenSigInactiveValue" SG_ 432 ICC_RAS_WarnLamp 0;
BA_ "GenSigInvalidValue" SG_ 432 ICC_RAS_WarnLamp 0;
BA_ "GenSigSendType" SG_ 432 ICC_RAS_WarnLamp 1;
BA_ "GenSigStartValue" SG_ 432 ICC_RAS_WarnLamp 0;
BA_ "GenSigTimeoutValue" SG_ 432 ICC_RAS_WarnLamp 0;
BA_ "Remark" SG_ 432 ICC_RAS_WarnLamp "";
BA_ "EventCommandSignal" SG_ 432 ICC_RAS_MotorTorActMot 0;
BA_ "GatewayedSignals" SG_ 432 ICC_RAS_MotorTorActMot 0;
BA_ "GenSigInactiveValue" SG_ 432 ICC_RAS_MotorTorActMot 0;
BA_ "GenSigInvalidValue" SG_ 432 ICC_RAS_MotorTorActMot 4095;
BA_ "GenSigSendType" SG_ 432 ICC_RAS_MotorTorActMot 1;
BA_ "GenSigStartValue" SG_ 432 ICC_RAS_MotorTorActMot 1500;
BA_ "GenSigTimeoutValue" SG_ 432 ICC_RAS_MotorTorActMot 4095;
BA_ "Remark" SG_ 432 ICC_RAS_MotorTorActMot "";
BA_ "EventCommandSignal" SG_ 432 ICC_RAS_ADASTargetAngle 0;
BA_ "GatewayedSignals" SG_ 432 ICC_RAS_ADASTargetAngle 0;
BA_ "GenSigInactiveValue" SG_ 432 ICC_RAS_ADASTargetAngle 0;
BA_ "GenSigInvalidValue" SG_ 432 ICC_RAS_ADASTargetAngle 0;
BA_ "GenSigSendType" SG_ 432 ICC_RAS_ADASTargetAngle 1;
BA_ "GenSigStartValue" SG_ 432 ICC_RAS_ADASTargetAngle 1023;
BA_ "GenSigTimeoutValue" SG_ 432 ICC_RAS_ADASTargetAngle 1023;
BA_ "Remark" SG_ 432 ICC_RAS_ADASTargetAngle "";
BA_ "EventCommandSignal" SG_ 433 CCU_GVS_3_CRC 0;
BA_ "GatewayedSignals" SG_ 433 CCU_GVS_3_CRC 0;
BA_ "GenSigInactiveValue" SG_ 433 CCU_GVS_3_CRC 0;
BA_ "GenSigInvalidValue" SG_ 433 CCU_GVS_3_CRC 0;
BA_ "GenSigSendType" SG_ 433 CCU_GVS_3_CRC 1;
BA_ "GenSigStartValue" SG_ 433 CCU_GVS_3_CRC 0;
BA_ "GenSigTimeoutValue" SG_ 433 CCU_GVS_3_CRC 0;
BA_ "Remark" SG_ 433 CCU_GVS_3_CRC "";
BA_ "EventCommandSignal" SG_ 433 CCU_GVS_3_Counter 0;
BA_ "GatewayedSignals" SG_ 433 CCU_GVS_3_Counter 0;
BA_ "GenSigInactiveValue" SG_ 433 CCU_GVS_3_Counter 0;
BA_ "GenSigInvalidValue" SG_ 433 CCU_GVS_3_Counter 0;
BA_ "GenSigSendType" SG_ 433 CCU_GVS_3_Counter 1;
BA_ "GenSigStartValue" SG_ 433 CCU_GVS_3_Counter 0;
BA_ "GenSigTimeoutValue" SG_ 433 CCU_GVS_3_Counter 0;
BA_ "Remark" SG_ 433 CCU_GVS_3_Counter "";
BA_ "EventCommandSignal" SG_ 433 VCU_VehActDrvTorqRR 0;
BA_ "GatewayedSignals" SG_ 433 VCU_VehActDrvTorqRR 0;
BA_ "GenSigInactiveValue" SG_ 433 VCU_VehActDrvTorqRR 0;
BA_ "GenSigInvalidValue" SG_ 433 VCU_VehActDrvTorqRR 0;
BA_ "GenSigSendType" SG_ 433 VCU_VehActDrvTorqRR 1;
BA_ "GenSigStartValue" SG_ 433 VCU_VehActDrvTorqRR 0;
BA_ "GenSigTimeoutValue" SG_ 433 VCU_VehActDrvTorqRR 0;
BA_ "Remark" SG_ 433 VCU_VehActDrvTorqRR "";
BA_ "EventCommandSignal" SG_ 433 VCU_MotorRgnCaplTqWhl 0;
BA_ "GatewayedSignals" SG_ 433 VCU_MotorRgnCaplTqWhl 0;
BA_ "GenSigInactiveValue" SG_ 433 VCU_MotorRgnCaplTqWhl 0;
BA_ "GenSigInvalidValue" SG_ 433 VCU_MotorRgnCaplTqWhl 0;
BA_ "GenSigSendType" SG_ 433 VCU_MotorRgnCaplTqWhl 1;
BA_ "GenSigStartValue" SG_ 433 VCU_MotorRgnCaplTqWhl 8191;
BA_ "GenSigTimeoutValue" SG_ 433 VCU_MotorRgnCaplTqWhl 0;
BA_ "Remark" SG_ 433 VCU_MotorRgnCaplTqWhl "";
BA_ "EventCommandSignal" SG_ 433 VCU_VehWhlReqTqFAVD 0;
BA_ "GatewayedSignals" SG_ 433 VCU_VehWhlReqTqFAVD 0;
BA_ "GenSigInactiveValue" SG_ 433 VCU_VehWhlReqTqFAVD 0;
BA_ "GenSigInvalidValue" SG_ 433 VCU_VehWhlReqTqFAVD 0;
BA_ "GenSigSendType" SG_ 433 VCU_VehWhlReqTqFAVD 1;
BA_ "GenSigStartValue" SG_ 433 VCU_VehWhlReqTqFAVD 0;
BA_ "GenSigTimeoutValue" SG_ 433 VCU_VehWhlReqTqFAVD 0;
BA_ "Remark" SG_ 433 VCU_VehWhlReqTqFAVD "";
BA_ "EventCommandSignal" SG_ 433 VCU_VehWhlReqTqRRVD 0;
BA_ "GatewayedSignals" SG_ 433 VCU_VehWhlReqTqRRVD 0;
BA_ "GenSigInactiveValue" SG_ 433 VCU_VehWhlReqTqRRVD 0;
BA_ "GenSigInvalidValue" SG_ 433 VCU_VehWhlReqTqRRVD 0;
BA_ "GenSigSendType" SG_ 433 VCU_VehWhlReqTqRRVD 1;
BA_ "GenSigStartValue" SG_ 433 VCU_VehWhlReqTqRRVD 0;
BA_ "GenSigTimeoutValue" SG_ 433 VCU_VehWhlReqTqRRVD 0;
BA_ "Remark" SG_ 433 VCU_VehWhlReqTqRRVD "";
BA_ "EventCommandSignal" SG_ 433 VCU_VehActDrvTorqRRVD 0;
BA_ "GatewayedSignals" SG_ 433 VCU_VehActDrvTorqRRVD 0;
BA_ "GenSigInactiveValue" SG_ 433 VCU_VehActDrvTorqRRVD 0;
BA_ "GenSigInvalidValue" SG_ 433 VCU_VehActDrvTorqRRVD 0;
BA_ "GenSigSendType" SG_ 433 VCU_VehActDrvTorqRRVD 1;
BA_ "GenSigStartValue" SG_ 433 VCU_VehActDrvTorqRRVD 0;
BA_ "GenSigTimeoutValue" SG_ 433 VCU_VehActDrvTorqRRVD 0;
BA_ "Remark" SG_ 433 VCU_VehActDrvTorqRRVD "";
BA_ "EventCommandSignal" SG_ 433 VCU_PreStableFlg 0;
BA_ "GatewayedSignals" SG_ 433 VCU_PreStableFlg 0;
BA_ "GenSigInactiveValue" SG_ 433 VCU_PreStableFlg 0;
BA_ "GenSigInvalidValue" SG_ 433 VCU_PreStableFlg 0;
BA_ "GenSigSendType" SG_ 433 VCU_PreStableFlg 1;
BA_ "GenSigStartValue" SG_ 433 VCU_PreStableFlg 0;
BA_ "GenSigTimeoutValue" SG_ 433 VCU_PreStableFlg 0;
BA_ "Remark" SG_ 433 VCU_PreStableFlg "";
BA_ "EventCommandSignal" SG_ 433 VCU_VehWhlReqTqRLVD 0;
BA_ "GatewayedSignals" SG_ 433 VCU_VehWhlReqTqRLVD 0;
BA_ "GenSigInactiveValue" SG_ 433 VCU_VehWhlReqTqRLVD 0;
BA_ "GenSigInvalidValue" SG_ 433 VCU_VehWhlReqTqRLVD 0;
BA_ "GenSigSendType" SG_ 433 VCU_VehWhlReqTqRLVD 1;
BA_ "GenSigStartValue" SG_ 433 VCU_VehWhlReqTqRLVD 0;
BA_ "GenSigTimeoutValue" SG_ 433 VCU_VehWhlReqTqRLVD 0;
BA_ "Remark" SG_ 433 VCU_VehWhlReqTqRLVD "";
BA_ "EventCommandSignal" SG_ 433 VCU_AccPedalActPstVD 0;
BA_ "GatewayedSignals" SG_ 433 VCU_AccPedalActPstVD 0;
BA_ "GenSigInactiveValue" SG_ 433 VCU_AccPedalActPstVD 0;
BA_ "GenSigInvalidValue" SG_ 433 VCU_AccPedalActPstVD 0;
BA_ "GenSigSendType" SG_ 433 VCU_AccPedalActPstVD 1;
BA_ "GenSigStartValue" SG_ 433 VCU_AccPedalActPstVD 0;
BA_ "GenSigTimeoutValue" SG_ 433 VCU_AccPedalActPstVD 0;
BA_ "Remark" SG_ 433 VCU_AccPedalActPstVD "";
BA_ "EventCommandSignal" SG_ 433 VCU_AccPedalActPst 0;
BA_ "GatewayedSignals" SG_ 433 VCU_AccPedalActPst 0;
BA_ "GenSigInactiveValue" SG_ 433 VCU_AccPedalActPst 0;
BA_ "GenSigInvalidValue" SG_ 433 VCU_AccPedalActPst 0;
BA_ "GenSigSendType" SG_ 433 VCU_AccPedalActPst 1;
BA_ "GenSigStartValue" SG_ 433 VCU_AccPedalActPst 0;
BA_ "GenSigTimeoutValue" SG_ 433 VCU_AccPedalActPst 0;
BA_ "Remark" SG_ 433 VCU_AccPedalActPst "";
BA_ "EventCommandSignal" SG_ 433 VCU_VehWhlReqTqFA 0;
BA_ "GatewayedSignals" SG_ 433 VCU_VehWhlReqTqFA 0;
BA_ "GenSigInactiveValue" SG_ 433 VCU_VehWhlReqTqFA 0;
BA_ "GenSigInvalidValue" SG_ 433 VCU_VehWhlReqTqFA 0;
BA_ "GenSigSendType" SG_ 433 VCU_VehWhlReqTqFA 1;
BA_ "GenSigStartValue" SG_ 433 VCU_VehWhlReqTqFA 0;
BA_ "GenSigTimeoutValue" SG_ 433 VCU_VehWhlReqTqFA 0;
BA_ "Remark" SG_ 433 VCU_VehWhlReqTqFA "";
BA_ "EventCommandSignal" SG_ 433 VCU_VehWhlReqTqRR 0;
BA_ "GatewayedSignals" SG_ 433 VCU_VehWhlReqTqRR 0;
BA_ "GenSigInactiveValue" SG_ 433 VCU_VehWhlReqTqRR 0;
BA_ "GenSigInvalidValue" SG_ 433 VCU_VehWhlReqTqRR 0;
BA_ "GenSigSendType" SG_ 433 VCU_VehWhlReqTqRR 1;
BA_ "GenSigStartValue" SG_ 433 VCU_VehWhlReqTqRR 0;
BA_ "GenSigTimeoutValue" SG_ 433 VCU_VehWhlReqTqRR 0;
BA_ "Remark" SG_ 433 VCU_VehWhlReqTqRR "";
BA_ "EventCommandSignal" SG_ 433 VCU_VehWhlReqTqRL 0;
BA_ "GatewayedSignals" SG_ 433 VCU_VehWhlReqTqRL 0;
BA_ "GenSigInactiveValue" SG_ 433 VCU_VehWhlReqTqRL 0;
BA_ "GenSigInvalidValue" SG_ 433 VCU_VehWhlReqTqRL 0;
BA_ "GenSigSendType" SG_ 433 VCU_VehWhlReqTqRL 1;
BA_ "GenSigStartValue" SG_ 433 VCU_VehWhlReqTqRL 0;
BA_ "GenSigTimeoutValue" SG_ 433 VCU_VehWhlReqTqRL 0;
BA_ "Remark" SG_ 433 VCU_VehWhlReqTqRL "";
BA_ "EventCommandSignal" SG_ 433 VCU_MotorDrvCaplTqWhlFA 0;
BA_ "GatewayedSignals" SG_ 433 VCU_MotorDrvCaplTqWhlFA 0;
BA_ "GenSigInactiveValue" SG_ 433 VCU_MotorDrvCaplTqWhlFA 0;
BA_ "GenSigInvalidValue" SG_ 433 VCU_MotorDrvCaplTqWhlFA 0;
BA_ "GenSigSendType" SG_ 433 VCU_MotorDrvCaplTqWhlFA 1;
BA_ "GenSigStartValue" SG_ 433 VCU_MotorDrvCaplTqWhlFA 0;
BA_ "GenSigTimeoutValue" SG_ 433 VCU_MotorDrvCaplTqWhlFA 65535;
BA_ "Remark" SG_ 433 VCU_MotorDrvCaplTqWhlFA "";
BA_ "EventCommandSignal" SG_ 433 VCU_MotorRgnCaplTqWhlFA 0;
BA_ "GatewayedSignals" SG_ 433 VCU_MotorRgnCaplTqWhlFA 0;
BA_ "GenSigInactiveValue" SG_ 433 VCU_MotorRgnCaplTqWhlFA 0;
BA_ "GenSigInvalidValue" SG_ 433 VCU_MotorRgnCaplTqWhlFA 0;
BA_ "GenSigSendType" SG_ 433 VCU_MotorRgnCaplTqWhlFA 1;
BA_ "GenSigStartValue" SG_ 433 VCU_MotorRgnCaplTqWhlFA 0;
BA_ "GenSigTimeoutValue" SG_ 433 VCU_MotorRgnCaplTqWhlFA 65535;
BA_ "Remark" SG_ 433 VCU_MotorRgnCaplTqWhlFA "";
BA_ "EventCommandSignal" SG_ 433 VCU_MotorDrvCaplTqWhlRL 0;
BA_ "GatewayedSignals" SG_ 433 VCU_MotorDrvCaplTqWhlRL 0;
BA_ "GenSigInactiveValue" SG_ 433 VCU_MotorDrvCaplTqWhlRL 0;
BA_ "GenSigInvalidValue" SG_ 433 VCU_MotorDrvCaplTqWhlRL 0;
BA_ "GenSigSendType" SG_ 433 VCU_MotorDrvCaplTqWhlRL 1;
BA_ "GenSigStartValue" SG_ 433 VCU_MotorDrvCaplTqWhlRL 0;
BA_ "GenSigTimeoutValue" SG_ 433 VCU_MotorDrvCaplTqWhlRL 65535;
BA_ "Remark" SG_ 433 VCU_MotorDrvCaplTqWhlRL "";
BA_ "EventCommandSignal" SG_ 433 VCU_MotorRgnCaplTqWhlRL 0;
BA_ "GatewayedSignals" SG_ 433 VCU_MotorRgnCaplTqWhlRL 0;
BA_ "GenSigInactiveValue" SG_ 433 VCU_MotorRgnCaplTqWhlRL 0;
BA_ "GenSigInvalidValue" SG_ 433 VCU_MotorRgnCaplTqWhlRL 0;
BA_ "GenSigSendType" SG_ 433 VCU_MotorRgnCaplTqWhlRL 1;
BA_ "GenSigStartValue" SG_ 433 VCU_MotorRgnCaplTqWhlRL 0;
BA_ "GenSigTimeoutValue" SG_ 433 VCU_MotorRgnCaplTqWhlRL 65535;
BA_ "Remark" SG_ 433 VCU_MotorRgnCaplTqWhlRL "";
BA_ "EventCommandSignal" SG_ 433 VCU_MotorDrvCaplTqWhlRR 0;
BA_ "GatewayedSignals" SG_ 433 VCU_MotorDrvCaplTqWhlRR 0;
BA_ "GenSigInactiveValue" SG_ 433 VCU_MotorDrvCaplTqWhlRR 0;
BA_ "GenSigInvalidValue" SG_ 433 VCU_MotorDrvCaplTqWhlRR 0;
BA_ "GenSigSendType" SG_ 433 VCU_MotorDrvCaplTqWhlRR 1;
BA_ "GenSigStartValue" SG_ 433 VCU_MotorDrvCaplTqWhlRR 0;
BA_ "GenSigTimeoutValue" SG_ 433 VCU_MotorDrvCaplTqWhlRR 65535;
BA_ "Remark" SG_ 433 VCU_MotorDrvCaplTqWhlRR "";
BA_ "EventCommandSignal" SG_ 433 VCU_GearShiftAvl 0;
BA_ "GatewayedSignals" SG_ 433 VCU_GearShiftAvl 0;
BA_ "GenSigInactiveValue" SG_ 433 VCU_GearShiftAvl 0;
BA_ "GenSigInvalidValue" SG_ 433 VCU_GearShiftAvl 0;
BA_ "GenSigSendType" SG_ 433 VCU_GearShiftAvl 1;
BA_ "GenSigStartValue" SG_ 433 VCU_GearShiftAvl 0;
BA_ "GenSigTimeoutValue" SG_ 433 VCU_GearShiftAvl 0;
BA_ "Remark" SG_ 433 VCU_GearShiftAvl "";
BA_ "EventCommandSignal" SG_ 433 VCU_MotorRgnCaplTqWhlVD 0;
BA_ "GatewayedSignals" SG_ 433 VCU_MotorRgnCaplTqWhlVD 0;
BA_ "GenSigInactiveValue" SG_ 433 VCU_MotorRgnCaplTqWhlVD 0;
BA_ "GenSigInvalidValue" SG_ 433 VCU_MotorRgnCaplTqWhlVD 0;
BA_ "GenSigSendType" SG_ 433 VCU_MotorRgnCaplTqWhlVD 1;
BA_ "GenSigStartValue" SG_ 433 VCU_MotorRgnCaplTqWhlVD 0;
BA_ "GenSigTimeoutValue" SG_ 433 VCU_MotorRgnCaplTqWhlVD 0;
BA_ "Remark" SG_ 433 VCU_MotorRgnCaplTqWhlVD "";
BA_ "EventCommandSignal" SG_ 433 VCU_VehWhlReqTqVD 0;
BA_ "GatewayedSignals" SG_ 433 VCU_VehWhlReqTqVD 0;
BA_ "GenSigInactiveValue" SG_ 433 VCU_VehWhlReqTqVD 0;
BA_ "GenSigInvalidValue" SG_ 433 VCU_VehWhlReqTqVD 0;
BA_ "GenSigSendType" SG_ 433 VCU_VehWhlReqTqVD 1;
BA_ "GenSigStartValue" SG_ 433 VCU_VehWhlReqTqVD 0;
BA_ "GenSigTimeoutValue" SG_ 433 VCU_VehWhlReqTqVD 0;
BA_ "Remark" SG_ 433 VCU_VehWhlReqTqVD "";
BA_ "EventCommandSignal" SG_ 433 VCU_ErrorFb 0;
BA_ "GatewayedSignals" SG_ 433 VCU_ErrorFb 0;
BA_ "GenSigInactiveValue" SG_ 433 VCU_ErrorFb 0;
BA_ "GenSigInvalidValue" SG_ 433 VCU_ErrorFb 0;
BA_ "GenSigSendType" SG_ 433 VCU_ErrorFb 1;
BA_ "GenSigStartValue" SG_ 433 VCU_ErrorFb 0;
BA_ "GenSigTimeoutValue" SG_ 433 VCU_ErrorFb 0;
BA_ "Remark" SG_ 433 VCU_ErrorFb "";
BA_ "EventCommandSignal" SG_ 433 VCU_PtTqActvSts 0;
BA_ "GatewayedSignals" SG_ 433 VCU_PtTqActvSts 0;
BA_ "GenSigInactiveValue" SG_ 433 VCU_PtTqActvSts 0;
BA_ "GenSigInvalidValue" SG_ 433 VCU_PtTqActvSts 0;
BA_ "GenSigSendType" SG_ 433 VCU_PtTqActvSts 1;
BA_ "GenSigStartValue" SG_ 433 VCU_PtTqActvSts 0;
BA_ "GenSigTimeoutValue" SG_ 433 VCU_PtTqActvSts 0;
BA_ "Remark" SG_ 433 VCU_PtTqActvSts "";
BA_ "EventCommandSignal" SG_ 433 VCU_PtTqAvl 0;
BA_ "GatewayedSignals" SG_ 433 VCU_PtTqAvl 0;
BA_ "GenSigInactiveValue" SG_ 433 VCU_PtTqAvl 0;
BA_ "GenSigInvalidValue" SG_ 433 VCU_PtTqAvl 0;
BA_ "GenSigSendType" SG_ 433 VCU_PtTqAvl 1;
BA_ "GenSigStartValue" SG_ 433 VCU_PtTqAvl 0;
BA_ "GenSigTimeoutValue" SG_ 433 VCU_PtTqAvl 0;
BA_ "Remark" SG_ 433 VCU_PtTqAvl "";
BA_ "EventCommandSignal" SG_ 433 VCU_DriverTorqueDesired 0;
BA_ "GatewayedSignals" SG_ 433 VCU_DriverTorqueDesired 0;
BA_ "GenSigInactiveValue" SG_ 433 VCU_DriverTorqueDesired 0;
BA_ "GenSigInvalidValue" SG_ 433 VCU_DriverTorqueDesired 0;
BA_ "GenSigSendType" SG_ 433 VCU_DriverTorqueDesired 1;
BA_ "GenSigStartValue" SG_ 433 VCU_DriverTorqueDesired 32768;
BA_ "GenSigTimeoutValue" SG_ 433 VCU_DriverTorqueDesired 0;
BA_ "Remark" SG_ 433 VCU_DriverTorqueDesired "";
BA_ "EventCommandSignal" SG_ 433 VCU_VehWhlReqTq 0;
BA_ "GatewayedSignals" SG_ 433 VCU_VehWhlReqTq 0;
BA_ "GenSigInactiveValue" SG_ 433 VCU_VehWhlReqTq 0;
BA_ "GenSigInvalidValue" SG_ 433 VCU_VehWhlReqTq 0;
BA_ "GenSigSendType" SG_ 433 VCU_VehWhlReqTq 1;
BA_ "GenSigStartValue" SG_ 433 VCU_VehWhlReqTq 32768;
BA_ "GenSigTimeoutValue" SG_ 433 VCU_VehWhlReqTq 0;
BA_ "Remark" SG_ 433 VCU_VehWhlReqTq "";
BA_ "EventCommandSignal" SG_ 433 VCU_MotorRgnCaplTqWhlRR 0;
BA_ "GatewayedSignals" SG_ 433 VCU_MotorRgnCaplTqWhlRR 0;
BA_ "GenSigInactiveValue" SG_ 433 VCU_MotorRgnCaplTqWhlRR 0;
BA_ "GenSigInvalidValue" SG_ 433 VCU_MotorRgnCaplTqWhlRR 0;
BA_ "GenSigSendType" SG_ 433 VCU_MotorRgnCaplTqWhlRR 1;
BA_ "GenSigStartValue" SG_ 433 VCU_MotorRgnCaplTqWhlRR 0;
BA_ "GenSigTimeoutValue" SG_ 433 VCU_MotorRgnCaplTqWhlRR 65535;
BA_ "Remark" SG_ 433 VCU_MotorRgnCaplTqWhlRR "";
BA_ "EventCommandSignal" SG_ 791 ZCUL_12_CRC 0;
BA_ "GatewayedSignals" SG_ 791 ZCUL_12_CRC 0;
BA_ "GenSigInactiveValue" SG_ 791 ZCUL_12_CRC 0;
BA_ "GenSigInvalidValue" SG_ 791 ZCUL_12_CRC 0;
BA_ "GenSigSendType" SG_ 791 ZCUL_12_CRC 1;
BA_ "GenSigStartValue" SG_ 791 ZCUL_12_CRC 0;
BA_ "GenSigTimeoutValue" SG_ 791 ZCUL_12_CRC 0;
BA_ "Remark" SG_ 791 ZCUL_12_CRC "";
BA_ "EventCommandSignal" SG_ 791 ZCUL_12_Counter 0;
BA_ "GatewayedSignals" SG_ 791 ZCUL_12_Counter 0;
BA_ "GenSigInactiveValue" SG_ 791 ZCUL_12_Counter 0;
BA_ "GenSigInvalidValue" SG_ 791 ZCUL_12_Counter 0;
BA_ "GenSigSendType" SG_ 791 ZCUL_12_Counter 1;
BA_ "GenSigStartValue" SG_ 791 ZCUL_12_Counter 0;
BA_ "GenSigTimeoutValue" SG_ 791 ZCUL_12_Counter 0;
BA_ "Remark" SG_ 791 ZCUL_12_Counter "";
BA_ "EventCommandSignal" SG_ 791 WW_FWPMotorSt 0;
BA_ "GatewayedSignals" SG_ 791 WW_FWPMotorSt 0;
BA_ "GenSigInactiveValue" SG_ 791 WW_FWPMotorSt 0;
BA_ "GenSigInvalidValue" SG_ 791 WW_FWPMotorSt 0;
BA_ "GenSigSendType" SG_ 791 WW_FWPMotorSt 1;
BA_ "GenSigStartValue" SG_ 791 WW_FWPMotorSt 0;
BA_ "GenSigTimeoutValue" SG_ 791 WW_FWPMotorSt 0;
BA_ "Remark" SG_ 791 WW_FWPMotorSt "";
BA_ "EventCommandSignal" SG_ 791 WW_FWSHMotorSt 0;
BA_ "GatewayedSignals" SG_ 791 WW_FWSHMotorSt 0;
BA_ "GenSigInactiveValue" SG_ 791 WW_FWSHMotorSt 0;
BA_ "GenSigInvalidValue" SG_ 791 WW_FWSHMotorSt 0;
BA_ "GenSigSendType" SG_ 791 WW_FWSHMotorSt 1;
BA_ "GenSigStartValue" SG_ 791 WW_FWSHMotorSt 0;
BA_ "GenSigTimeoutValue" SG_ 791 WW_FWSHMotorSt 0;
BA_ "Remark" SG_ 791 WW_FWSHMotorSt "";
BA_ "EventCommandSignal" SG_ 791 HRN_HornRunningSt 0;
BA_ "GatewayedSignals" SG_ 791 HRN_HornRunningSt 0;
BA_ "GenSigInactiveValue" SG_ 791 HRN_HornRunningSt 0;
BA_ "GenSigInvalidValue" SG_ 791 HRN_HornRunningSt 0;
BA_ "GenSigSendType" SG_ 791 HRN_HornRunningSt 1;
BA_ "GenSigStartValue" SG_ 791 HRN_HornRunningSt 0;
BA_ "GenSigTimeoutValue" SG_ 791 HRN_HornRunningSt 0;
BA_ "Remark" SG_ 791 HRN_HornRunningSt "";
BA_ "EventCommandSignal" SG_ 791 HRN_HornWorkingTemplet 0;
BA_ "GatewayedSignals" SG_ 791 HRN_HornWorkingTemplet 0;
BA_ "GenSigInactiveValue" SG_ 791 HRN_HornWorkingTemplet 0;
BA_ "GenSigInvalidValue" SG_ 791 HRN_HornWorkingTemplet 0;
BA_ "GenSigSendType" SG_ 791 HRN_HornWorkingTemplet 1;
BA_ "GenSigStartValue" SG_ 791 HRN_HornWorkingTemplet 0;
BA_ "GenSigTimeoutValue" SG_ 791 HRN_HornWorkingTemplet 0;
BA_ "Remark" SG_ 791 HRN_HornWorkingTemplet "";
BA_ "EventCommandSignal" SG_ 791 EL_FLPositionLightSt 0;
BA_ "GatewayedSignals" SG_ 791 EL_FLPositionLightSt 0;
BA_ "GenSigInactiveValue" SG_ 791 EL_FLPositionLightSt 0;
BA_ "GenSigInvalidValue" SG_ 791 EL_FLPositionLightSt 0;
BA_ "GenSigSendType" SG_ 791 EL_FLPositionLightSt 1;
BA_ "GenSigStartValue" SG_ 791 EL_FLPositionLightSt 0;
BA_ "GenSigTimeoutValue" SG_ 791 EL_FLPositionLightSt 0;
BA_ "Remark" SG_ 791 EL_FLPositionLightSt "";
BA_ "EventCommandSignal" SG_ 791 EL_FLPositionLightFaultSt 0;
BA_ "GatewayedSignals" SG_ 791 EL_FLPositionLightFaultSt 0;
BA_ "GenSigInactiveValue" SG_ 791 EL_FLPositionLightFaultSt 0;
BA_ "GenSigInvalidValue" SG_ 791 EL_FLPositionLightFaultSt 0;
BA_ "GenSigSendType" SG_ 791 EL_FLPositionLightFaultSt 1;
BA_ "GenSigStartValue" SG_ 791 EL_FLPositionLightFaultSt 0;
BA_ "GenSigTimeoutValue" SG_ 791 EL_FLPositionLightFaultSt 0;
BA_ "Remark" SG_ 791 EL_FLPositionLightFaultSt "";
BA_ "EventCommandSignal" SG_ 791 EL_FRPositionLightSt 0;
BA_ "GatewayedSignals" SG_ 791 EL_FRPositionLightSt 0;
BA_ "GenSigInactiveValue" SG_ 791 EL_FRPositionLightSt 0;
BA_ "GenSigInvalidValue" SG_ 791 EL_FRPositionLightSt 0;
BA_ "GenSigSendType" SG_ 791 EL_FRPositionLightSt 1;
BA_ "GenSigStartValue" SG_ 791 EL_FRPositionLightSt 0;
BA_ "GenSigTimeoutValue" SG_ 791 EL_FRPositionLightSt 0;
BA_ "Remark" SG_ 791 EL_FRPositionLightSt "";
BA_ "EventCommandSignal" SG_ 791 EL_FRPositionLightFaultSt 0;
BA_ "GatewayedSignals" SG_ 791 EL_FRPositionLightFaultSt 0;
BA_ "GenSigInactiveValue" SG_ 791 EL_FRPositionLightFaultSt 0;
BA_ "GenSigInvalidValue" SG_ 791 EL_FRPositionLightFaultSt 0;
BA_ "GenSigSendType" SG_ 791 EL_FRPositionLightFaultSt 1;
BA_ "GenSigStartValue" SG_ 791 EL_FRPositionLightFaultSt 0;
BA_ "GenSigTimeoutValue" SG_ 791 EL_FRPositionLightFaultSt 0;
BA_ "Remark" SG_ 791 EL_FRPositionLightFaultSt "";
BA_ "EventCommandSignal" SG_ 791 EL_LeftLowBeamSt 0;
BA_ "GatewayedSignals" SG_ 791 EL_LeftLowBeamSt 0;
BA_ "GenSigInactiveValue" SG_ 791 EL_LeftLowBeamSt 0;
BA_ "GenSigInvalidValue" SG_ 791 EL_LeftLowBeamSt 0;
BA_ "GenSigSendType" SG_ 791 EL_LeftLowBeamSt 1;
BA_ "GenSigStartValue" SG_ 791 EL_LeftLowBeamSt 0;
BA_ "GenSigTimeoutValue" SG_ 791 EL_LeftLowBeamSt 0;
BA_ "Remark" SG_ 791 EL_LeftLowBeamSt "";
BA_ "EventCommandSignal" SG_ 791 EL_LeftLowBeamFaultSt 0;
BA_ "GatewayedSignals" SG_ 791 EL_LeftLowBeamFaultSt 0;
BA_ "GenSigInactiveValue" SG_ 791 EL_LeftLowBeamFaultSt 0;
BA_ "GenSigInvalidValue" SG_ 791 EL_LeftLowBeamFaultSt 0;
BA_ "GenSigSendType" SG_ 791 EL_LeftLowBeamFaultSt 1;
BA_ "GenSigStartValue" SG_ 791 EL_LeftLowBeamFaultSt 0;
BA_ "GenSigTimeoutValue" SG_ 791 EL_LeftLowBeamFaultSt 0;
BA_ "Remark" SG_ 791 EL_LeftLowBeamFaultSt "";
BA_ "EventCommandSignal" SG_ 791 EL_RightLowBeamSt 0;
BA_ "GatewayedSignals" SG_ 791 EL_RightLowBeamSt 0;
BA_ "GenSigInactiveValue" SG_ 791 EL_RightLowBeamSt 0;
BA_ "GenSigInvalidValue" SG_ 791 EL_RightLowBeamSt 0;
BA_ "GenSigSendType" SG_ 791 EL_RightLowBeamSt 1;
BA_ "GenSigStartValue" SG_ 791 EL_RightLowBeamSt 0;
BA_ "GenSigTimeoutValue" SG_ 791 EL_RightLowBeamSt 0;
BA_ "Remark" SG_ 791 EL_RightLowBeamSt "";
BA_ "EventCommandSignal" SG_ 791 EL_RightLowBeamFaultSt 0;
BA_ "GatewayedSignals" SG_ 791 EL_RightLowBeamFaultSt 0;
BA_ "GenSigInactiveValue" SG_ 791 EL_RightLowBeamFaultSt 0;
BA_ "GenSigInvalidValue" SG_ 791 EL_RightLowBeamFaultSt 0;
BA_ "GenSigSendType" SG_ 791 EL_RightLowBeamFaultSt 1;
BA_ "GenSigStartValue" SG_ 791 EL_RightLowBeamFaultSt 0;
BA_ "GenSigTimeoutValue" SG_ 791 EL_RightLowBeamFaultSt 0;
BA_ "Remark" SG_ 791 EL_RightLowBeamFaultSt "";
BA_ "EventCommandSignal" SG_ 791 EL_LeftHighBeamSt 0;
BA_ "GatewayedSignals" SG_ 791 EL_LeftHighBeamSt 0;
BA_ "GenSigInactiveValue" SG_ 791 EL_LeftHighBeamSt 0;
BA_ "GenSigInvalidValue" SG_ 791 EL_LeftHighBeamSt 0;
BA_ "GenSigSendType" SG_ 791 EL_LeftHighBeamSt 1;
BA_ "GenSigStartValue" SG_ 791 EL_LeftHighBeamSt 0;
BA_ "GenSigTimeoutValue" SG_ 791 EL_LeftHighBeamSt 0;
BA_ "Remark" SG_ 791 EL_LeftHighBeamSt "";
BA_ "EventCommandSignal" SG_ 791 EL_LeftHighBeamFaultSt 0;
BA_ "GatewayedSignals" SG_ 791 EL_LeftHighBeamFaultSt 0;
BA_ "GenSigInactiveValue" SG_ 791 EL_LeftHighBeamFaultSt 0;
BA_ "GenSigInvalidValue" SG_ 791 EL_LeftHighBeamFaultSt 0;
BA_ "GenSigSendType" SG_ 791 EL_LeftHighBeamFaultSt 1;
BA_ "GenSigStartValue" SG_ 791 EL_LeftHighBeamFaultSt 0;
BA_ "GenSigTimeoutValue" SG_ 791 EL_LeftHighBeamFaultSt 0;
BA_ "Remark" SG_ 791 EL_LeftHighBeamFaultSt "";
BA_ "EventCommandSignal" SG_ 791 EL_RightHighBeamSt 0;
BA_ "GatewayedSignals" SG_ 791 EL_RightHighBeamSt 0;
BA_ "GenSigInactiveValue" SG_ 791 EL_RightHighBeamSt 0;
BA_ "GenSigInvalidValue" SG_ 791 EL_RightHighBeamSt 0;
BA_ "GenSigSendType" SG_ 791 EL_RightHighBeamSt 1;
BA_ "GenSigStartValue" SG_ 791 EL_RightHighBeamSt 0;
BA_ "GenSigTimeoutValue" SG_ 791 EL_RightHighBeamSt 0;
BA_ "Remark" SG_ 791 EL_RightHighBeamSt "";
BA_ "EventCommandSignal" SG_ 791 EL_RightHighBeamFaultSt 0;
BA_ "GatewayedSignals" SG_ 791 EL_RightHighBeamFaultSt 0;
BA_ "GenSigInactiveValue" SG_ 791 EL_RightHighBeamFaultSt 0;
BA_ "GenSigInvalidValue" SG_ 791 EL_RightHighBeamFaultSt 0;
BA_ "GenSigSendType" SG_ 791 EL_RightHighBeamFaultSt 1;
BA_ "GenSigStartValue" SG_ 791 EL_RightHighBeamFaultSt 0;
BA_ "GenSigTimeoutValue" SG_ 791 EL_RightHighBeamFaultSt 0;
BA_ "Remark" SG_ 791 EL_RightHighBeamFaultSt "";
BA_ "EventCommandSignal" SG_ 791 EL_FLFogLightSt 0;
BA_ "GatewayedSignals" SG_ 791 EL_FLFogLightSt 0;
BA_ "GenSigInactiveValue" SG_ 791 EL_FLFogLightSt 0;
BA_ "GenSigInvalidValue" SG_ 791 EL_FLFogLightSt 0;
BA_ "GenSigSendType" SG_ 791 EL_FLFogLightSt 1;
BA_ "GenSigStartValue" SG_ 791 EL_FLFogLightSt 0;
BA_ "GenSigTimeoutValue" SG_ 791 EL_FLFogLightSt 0;
BA_ "Remark" SG_ 791 EL_FLFogLightSt "";
BA_ "EventCommandSignal" SG_ 791 EL_FLFogLightFaultSt 0;
BA_ "GatewayedSignals" SG_ 791 EL_FLFogLightFaultSt 0;
BA_ "GenSigInactiveValue" SG_ 791 EL_FLFogLightFaultSt 0;
BA_ "GenSigInvalidValue" SG_ 791 EL_FLFogLightFaultSt 0;
BA_ "GenSigSendType" SG_ 791 EL_FLFogLightFaultSt 1;
BA_ "GenSigStartValue" SG_ 791 EL_FLFogLightFaultSt 0;
BA_ "GenSigTimeoutValue" SG_ 791 EL_FLFogLightFaultSt 0;
BA_ "Remark" SG_ 791 EL_FLFogLightFaultSt "";
BA_ "EventCommandSignal" SG_ 791 EL_FRFogLightSt 0;
BA_ "GatewayedSignals" SG_ 791 EL_FRFogLightSt 0;
BA_ "GenSigInactiveValue" SG_ 791 EL_FRFogLightSt 0;
BA_ "GenSigInvalidValue" SG_ 791 EL_FRFogLightSt 0;
BA_ "GenSigSendType" SG_ 791 EL_FRFogLightSt 1;
BA_ "GenSigStartValue" SG_ 791 EL_FRFogLightSt 0;
BA_ "GenSigTimeoutValue" SG_ 791 EL_FRFogLightSt 0;
BA_ "Remark" SG_ 791 EL_FRFogLightSt "";
BA_ "EventCommandSignal" SG_ 791 EL_FRFogLightFaultSt 0;
BA_ "GatewayedSignals" SG_ 791 EL_FRFogLightFaultSt 0;
BA_ "GenSigInactiveValue" SG_ 791 EL_FRFogLightFaultSt 0;
BA_ "GenSigInvalidValue" SG_ 791 EL_FRFogLightFaultSt 0;
BA_ "GenSigSendType" SG_ 791 EL_FRFogLightFaultSt 1;
BA_ "GenSigStartValue" SG_ 791 EL_FRFogLightFaultSt 0;
BA_ "GenSigTimeoutValue" SG_ 791 EL_FRFogLightFaultSt 0;
BA_ "Remark" SG_ 791 EL_FRFogLightFaultSt "";
BA_ "EventCommandSignal" SG_ 791 EL_LeftDRLSt 0;
BA_ "GatewayedSignals" SG_ 791 EL_LeftDRLSt 0;
BA_ "GenSigInactiveValue" SG_ 791 EL_LeftDRLSt 0;
BA_ "GenSigInvalidValue" SG_ 791 EL_LeftDRLSt 0;
BA_ "GenSigSendType" SG_ 791 EL_LeftDRLSt 1;
BA_ "GenSigStartValue" SG_ 791 EL_LeftDRLSt 0;
BA_ "GenSigTimeoutValue" SG_ 791 EL_LeftDRLSt 0;
BA_ "Remark" SG_ 791 EL_LeftDRLSt "";
BA_ "EventCommandSignal" SG_ 791 EL_LeftDRLFaultSt 0;
BA_ "GatewayedSignals" SG_ 791 EL_LeftDRLFaultSt 0;
BA_ "GenSigInactiveValue" SG_ 791 EL_LeftDRLFaultSt 0;
BA_ "GenSigInvalidValue" SG_ 791 EL_LeftDRLFaultSt 0;
BA_ "GenSigSendType" SG_ 791 EL_LeftDRLFaultSt 1;
BA_ "GenSigStartValue" SG_ 791 EL_LeftDRLFaultSt 0;
BA_ "GenSigTimeoutValue" SG_ 791 EL_LeftDRLFaultSt 0;
BA_ "Remark" SG_ 791 EL_LeftDRLFaultSt "";
BA_ "EventCommandSignal" SG_ 791 EL_RightDRLSt 0;
BA_ "GatewayedSignals" SG_ 791 EL_RightDRLSt 0;
BA_ "GenSigInactiveValue" SG_ 791 EL_RightDRLSt 0;
BA_ "GenSigInvalidValue" SG_ 791 EL_RightDRLSt 0;
BA_ "GenSigSendType" SG_ 791 EL_RightDRLSt 1;
BA_ "GenSigStartValue" SG_ 791 EL_RightDRLSt 0;
BA_ "GenSigTimeoutValue" SG_ 791 EL_RightDRLSt 0;
BA_ "Remark" SG_ 791 EL_RightDRLSt "";
BA_ "EventCommandSignal" SG_ 791 EL_RightDRLFaultSt 0;
BA_ "GatewayedSignals" SG_ 791 EL_RightDRLFaultSt 0;
BA_ "GenSigInactiveValue" SG_ 791 EL_RightDRLFaultSt 0;
BA_ "GenSigInvalidValue" SG_ 791 EL_RightDRLFaultSt 0;
BA_ "GenSigSendType" SG_ 791 EL_RightDRLFaultSt 1;
BA_ "GenSigStartValue" SG_ 791 EL_RightDRLFaultSt 0;
BA_ "GenSigTimeoutValue" SG_ 791 EL_RightDRLFaultSt 0;
BA_ "Remark" SG_ 791 EL_RightDRLFaultSt "";
BA_ "EventCommandSignal" SG_ 791 EL_FLTurnLightSt 0;
BA_ "GatewayedSignals" SG_ 791 EL_FLTurnLightSt 0;
BA_ "GenSigInactiveValue" SG_ 791 EL_FLTurnLightSt 0;
BA_ "GenSigInvalidValue" SG_ 791 EL_FLTurnLightSt 0;
BA_ "GenSigSendType" SG_ 791 EL_FLTurnLightSt 1;
BA_ "GenSigStartValue" SG_ 791 EL_FLTurnLightSt 0;
BA_ "GenSigTimeoutValue" SG_ 791 EL_FLTurnLightSt 0;
BA_ "Remark" SG_ 791 EL_FLTurnLightSt "";
BA_ "EventCommandSignal" SG_ 791 EL_FLTurnLightFaultSt 0;
BA_ "GatewayedSignals" SG_ 791 EL_FLTurnLightFaultSt 0;
BA_ "GenSigInactiveValue" SG_ 791 EL_FLTurnLightFaultSt 0;
BA_ "GenSigInvalidValue" SG_ 791 EL_FLTurnLightFaultSt 0;
BA_ "GenSigSendType" SG_ 791 EL_FLTurnLightFaultSt 1;
BA_ "GenSigStartValue" SG_ 791 EL_FLTurnLightFaultSt 0;
BA_ "GenSigTimeoutValue" SG_ 791 EL_FLTurnLightFaultSt 0;
BA_ "Remark" SG_ 791 EL_FLTurnLightFaultSt "";
BA_ "EventCommandSignal" SG_ 791 EL_FRTurnLightSt 0;
BA_ "GatewayedSignals" SG_ 791 EL_FRTurnLightSt 0;
BA_ "GenSigInactiveValue" SG_ 791 EL_FRTurnLightSt 0;
BA_ "GenSigInvalidValue" SG_ 791 EL_FRTurnLightSt 0;
BA_ "GenSigSendType" SG_ 791 EL_FRTurnLightSt 1;
BA_ "GenSigStartValue" SG_ 791 EL_FRTurnLightSt 0;
BA_ "GenSigTimeoutValue" SG_ 791 EL_FRTurnLightSt 0;
BA_ "Remark" SG_ 791 EL_FRTurnLightSt "";
BA_ "EventCommandSignal" SG_ 791 EL_FRTurnLightFaultSt 0;
BA_ "GatewayedSignals" SG_ 791 EL_FRTurnLightFaultSt 0;
BA_ "GenSigInactiveValue" SG_ 791 EL_FRTurnLightFaultSt 0;
BA_ "GenSigInvalidValue" SG_ 791 EL_FRTurnLightFaultSt 0;
BA_ "GenSigSendType" SG_ 791 EL_FRTurnLightFaultSt 1;
BA_ "GenSigStartValue" SG_ 791 EL_FRTurnLightFaultSt 0;
BA_ "GenSigTimeoutValue" SG_ 791 EL_FRTurnLightFaultSt 0;
BA_ "Remark" SG_ 791 EL_FRTurnLightFaultSt "";
BA_ "EventCommandSignal" SG_ 791 WW_RWSHMotorSt 0;
BA_ "GatewayedSignals" SG_ 791 WW_RWSHMotorSt 0;
BA_ "GenSigInactiveValue" SG_ 791 WW_RWSHMotorSt 0;
BA_ "GenSigInvalidValue" SG_ 791 WW_RWSHMotorSt 0;
BA_ "GenSigSendType" SG_ 791 WW_RWSHMotorSt 1;
BA_ "GenSigStartValue" SG_ 791 WW_RWSHMotorSt 0;
BA_ "GenSigTimeoutValue" SG_ 791 WW_RWSHMotorSt 0;
BA_ "Remark" SG_ 791 WW_RWSHMotorSt "";
BA_ "EventCommandSignal" SG_ 791 EL_FADASLightSt 0;
BA_ "GatewayedSignals" SG_ 791 EL_FADASLightSt 0;
BA_ "GenSigInactiveValue" SG_ 791 EL_FADASLightSt 0;
BA_ "GenSigInvalidValue" SG_ 791 EL_FADASLightSt 0;
BA_ "GenSigSendType" SG_ 791 EL_FADASLightSt 1;
BA_ "GenSigStartValue" SG_ 791 EL_FADASLightSt 0;
BA_ "GenSigTimeoutValue" SG_ 791 EL_FADASLightSt 0;
BA_ "Remark" SG_ 791 EL_FADASLightSt "";
BA_ "EventCommandSignal" SG_ 791 EBSF_BattVolt 0;
BA_ "GatewayedSignals" SG_ 791 EBSF_BattVolt 0;
BA_ "GenSigInactiveValue" SG_ 791 EBSF_BattVolt 0;
BA_ "GenSigInvalidValue" SG_ 791 EBSF_BattVolt 0;
BA_ "GenSigSendType" SG_ 791 EBSF_BattVolt 1;
BA_ "GenSigStartValue" SG_ 791 EBSF_BattVolt 16383;
BA_ "GenSigTimeoutValue" SG_ 791 EBSF_BattVolt 0;
BA_ "Remark" SG_ 791 EBSF_BattVolt "";
BA_ "EventCommandSignal" SG_ 791 EBSF_CurrentRange 0;
BA_ "GatewayedSignals" SG_ 791 EBSF_CurrentRange 0;
BA_ "GenSigInactiveValue" SG_ 791 EBSF_CurrentRange 0;
BA_ "GenSigInvalidValue" SG_ 791 EBSF_CurrentRange 0;
BA_ "GenSigSendType" SG_ 791 EBSF_CurrentRange 1;
BA_ "GenSigStartValue" SG_ 791 EBSF_CurrentRange 3;
BA_ "GenSigTimeoutValue" SG_ 791 EBSF_CurrentRange 0;
BA_ "Remark" SG_ 791 EBSF_CurrentRange "";
BA_ "EventCommandSignal" SG_ 791 EBSF_BattCurrent 0;
BA_ "GatewayedSignals" SG_ 791 EBSF_BattCurrent 0;
BA_ "GenSigInactiveValue" SG_ 791 EBSF_BattCurrent 0;
BA_ "GenSigInvalidValue" SG_ 791 EBSF_BattCurrent 0;
BA_ "GenSigSendType" SG_ 791 EBSF_BattCurrent 1;
BA_ "GenSigStartValue" SG_ 791 EBSF_BattCurrent 65535;
BA_ "GenSigTimeoutValue" SG_ 791 EBSF_BattCurrent 0;
BA_ "Remark" SG_ 791 EBSF_BattCurrent "";
BA_ "EventCommandSignal" SG_ 616 CCU_1_CRC 0;
BA_ "GatewayedSignals" SG_ 616 CCU_1_CRC 0;
BA_ "GenSigInactiveValue" SG_ 616 CCU_1_CRC 0;
BA_ "GenSigInvalidValue" SG_ 616 CCU_1_CRC 0;
BA_ "GenSigSendType" SG_ 616 CCU_1_CRC 1;
BA_ "GenSigStartValue" SG_ 616 CCU_1_CRC 0;
BA_ "GenSigTimeoutValue" SG_ 616 CCU_1_CRC 0;
BA_ "Remark" SG_ 616 CCU_1_CRC "";
BA_ "EventCommandSignal" SG_ 616 CCU_1_Counter 0;
BA_ "GatewayedSignals" SG_ 616 CCU_1_Counter 0;
BA_ "GenSigInactiveValue" SG_ 616 CCU_1_Counter 0;
BA_ "GenSigInvalidValue" SG_ 616 CCU_1_Counter 0;
BA_ "GenSigSendType" SG_ 616 CCU_1_Counter 1;
BA_ "GenSigStartValue" SG_ 616 CCU_1_Counter 0;
BA_ "GenSigTimeoutValue" SG_ 616 CCU_1_Counter 0;
BA_ "Remark" SG_ 616 CCU_1_Counter "";
BA_ "EventCommandSignal" SG_ 616 UMM_UsageModeSt 0;
BA_ "GatewayedSignals" SG_ 616 UMM_UsageModeSt 0;
BA_ "GenSigInactiveValue" SG_ 616 UMM_UsageModeSt 0;
BA_ "GenSigInvalidValue" SG_ 616 UMM_UsageModeSt 0;
BA_ "GenSigSendType" SG_ 616 UMM_UsageModeSt 1;
BA_ "GenSigStartValue" SG_ 616 UMM_UsageModeSt 7;
BA_ "GenSigTimeoutValue" SG_ 616 UMM_UsageModeSt 0;
BA_ "Remark" SG_ 616 UMM_UsageModeSt "";
BA_ "EventCommandSignal" SG_ 616 OTA_FuncReq_ADCWakeup 0;
BA_ "GatewayedSignals" SG_ 616 OTA_FuncReq_ADCWakeup 0;
BA_ "GenSigInactiveValue" SG_ 616 OTA_FuncReq_ADCWakeup 0;
BA_ "GenSigInvalidValue" SG_ 616 OTA_FuncReq_ADCWakeup 0;
BA_ "GenSigSendType" SG_ 616 OTA_FuncReq_ADCWakeup 1;
BA_ "GenSigStartValue" SG_ 616 OTA_FuncReq_ADCWakeup 0;
BA_ "GenSigTimeoutValue" SG_ 616 OTA_FuncReq_ADCWakeup 0;
BA_ "Remark" SG_ 616 OTA_FuncReq_ADCWakeup "";
BA_ "EventCommandSignal" SG_ 616 UMM_FrontPassengerSeatSt 0;
BA_ "GatewayedSignals" SG_ 616 UMM_FrontPassengerSeatSt 0;
BA_ "GenSigInactiveValue" SG_ 616 UMM_FrontPassengerSeatSt 0;
BA_ "GenSigInvalidValue" SG_ 616 UMM_FrontPassengerSeatSt 0;
BA_ "GenSigSendType" SG_ 616 UMM_FrontPassengerSeatSt 1;
BA_ "GenSigStartValue" SG_ 616 UMM_FrontPassengerSeatSt 0;
BA_ "GenSigTimeoutValue" SG_ 616 UMM_FrontPassengerSeatSt 0;
BA_ "Remark" SG_ 616 UMM_FrontPassengerSeatSt "";
BA_ "EventCommandSignal" SG_ 616 UMM_DriverSeatSt 0;
BA_ "GatewayedSignals" SG_ 616 UMM_DriverSeatSt 0;
BA_ "GenSigInactiveValue" SG_ 616 UMM_DriverSeatSt 0;
BA_ "GenSigInvalidValue" SG_ 616 UMM_DriverSeatSt 0;
BA_ "GenSigSendType" SG_ 616 UMM_DriverSeatSt 1;
BA_ "GenSigStartValue" SG_ 616 UMM_DriverSeatSt 0;
BA_ "GenSigTimeoutValue" SG_ 616 UMM_DriverSeatSt 0;
BA_ "Remark" SG_ 616 UMM_DriverSeatSt "";
BA_ "EventCommandSignal" SG_ 616 VMM_VehModeSt 0;
BA_ "GatewayedSignals" SG_ 616 VMM_VehModeSt 0;
BA_ "GenSigInactiveValue" SG_ 616 VMM_VehModeSt 0;
BA_ "GenSigInvalidValue" SG_ 616 VMM_VehModeSt 15;
BA_ "GenSigSendType" SG_ 616 VMM_VehModeSt 1;
BA_ "GenSigStartValue" SG_ 616 VMM_VehModeSt 15;
BA_ "GenSigTimeoutValue" SG_ 616 VMM_VehModeSt 15;
BA_ "Remark" SG_ 616 VMM_VehModeSt "";
BA_ "EventCommandSignal" SG_ 616 VMM_LastVehModeSt 0;
BA_ "GatewayedSignals" SG_ 616 VMM_LastVehModeSt 0;
BA_ "GenSigInactiveValue" SG_ 616 VMM_LastVehModeSt 0;
BA_ "GenSigInvalidValue" SG_ 616 VMM_LastVehModeSt 15;
BA_ "GenSigSendType" SG_ 616 VMM_LastVehModeSt 1;
BA_ "GenSigStartValue" SG_ 616 VMM_LastVehModeSt 15;
BA_ "GenSigTimeoutValue" SG_ 616 VMM_LastVehModeSt 15;
BA_ "Remark" SG_ 616 VMM_LastVehModeSt "";
BA_ "EventCommandSignal" SG_ 616 VMM_OTAModeSt 0;
BA_ "GatewayedSignals" SG_ 616 VMM_OTAModeSt 0;
BA_ "GenSigInactiveValue" SG_ 616 VMM_OTAModeSt 0;
BA_ "GenSigInvalidValue" SG_ 616 VMM_OTAModeSt 2;
BA_ "GenSigSendType" SG_ 616 VMM_OTAModeSt 1;
BA_ "GenSigStartValue" SG_ 616 VMM_OTAModeSt 0;
BA_ "GenSigTimeoutValue" SG_ 616 VMM_OTAModeSt 0;
BA_ "Remark" SG_ 616 VMM_OTAModeSt "";
BA_ "EventCommandSignal" SG_ 616 CSM_RC_PAARequest 0;
BA_ "GatewayedSignals" SG_ 616 CSM_RC_PAARequest 0;
BA_ "GenSigInactiveValue" SG_ 616 CSM_RC_PAARequest 0;
BA_ "GenSigInvalidValue" SG_ 616 CSM_RC_PAARequest 0;
BA_ "GenSigSendType" SG_ 616 CSM_RC_PAARequest 1;
BA_ "GenSigStartValue" SG_ 616 CSM_RC_PAARequest 0;
BA_ "GenSigTimeoutValue" SG_ 616 CSM_RC_PAARequest 0;
BA_ "Remark" SG_ 616 CSM_RC_PAARequest "";
BA_ "EventCommandSignal" SG_ 616 IPDS_EnablePowerSup 0;
BA_ "GatewayedSignals" SG_ 616 IPDS_EnablePowerSup 0;
BA_ "GenSigInactiveValue" SG_ 616 IPDS_EnablePowerSup 0;
BA_ "GenSigInvalidValue" SG_ 616 IPDS_EnablePowerSup 0;
BA_ "GenSigSendType" SG_ 616 IPDS_EnablePowerSup 1;
BA_ "GenSigStartValue" SG_ 616 IPDS_EnablePowerSup 0;
BA_ "GenSigTimeoutValue" SG_ 616 IPDS_EnablePowerSup 0;
BA_ "Remark" SG_ 616 IPDS_EnablePowerSup "";
BA_ "EventCommandSignal" SG_ 616 Time_Year 0;
BA_ "GatewayedSignals" SG_ 616 Time_Year 0;
BA_ "GenSigInactiveValue" SG_ 616 Time_Year 0;
BA_ "GenSigInvalidValue" SG_ 616 Time_Year 0;
BA_ "GenSigSendType" SG_ 616 Time_Year 1;
BA_ "GenSigStartValue" SG_ 616 Time_Year 0;
BA_ "GenSigTimeoutValue" SG_ 616 Time_Year 0;
BA_ "Remark" SG_ 616 Time_Year "";
BA_ "EventCommandSignal" SG_ 616 Time_Month 0;
BA_ "GatewayedSignals" SG_ 616 Time_Month 0;
BA_ "GenSigInactiveValue" SG_ 616 Time_Month 0;
BA_ "GenSigInvalidValue" SG_ 616 Time_Month 0;
BA_ "GenSigSendType" SG_ 616 Time_Month 1;
BA_ "GenSigStartValue" SG_ 616 Time_Month 0;
BA_ "GenSigTimeoutValue" SG_ 616 Time_Month 0;
BA_ "Remark" SG_ 616 Time_Month "";
BA_ "EventCommandSignal" SG_ 616 Time_Day 0;
BA_ "GatewayedSignals" SG_ 616 Time_Day 0;
BA_ "GenSigInactiveValue" SG_ 616 Time_Day 0;
BA_ "GenSigInvalidValue" SG_ 616 Time_Day 0;
BA_ "GenSigSendType" SG_ 616 Time_Day 1;
BA_ "GenSigStartValue" SG_ 616 Time_Day 1;
BA_ "GenSigTimeoutValue" SG_ 616 Time_Day 0;
BA_ "Remark" SG_ 616 Time_Day "";
BA_ "EventCommandSignal" SG_ 616 Time_Hour 0;
BA_ "GatewayedSignals" SG_ 616 Time_Hour 0;
BA_ "GenSigInactiveValue" SG_ 616 Time_Hour 0;
BA_ "GenSigInvalidValue" SG_ 616 Time_Hour 0;
BA_ "GenSigSendType" SG_ 616 Time_Hour 1;
BA_ "GenSigStartValue" SG_ 616 Time_Hour 1;
BA_ "GenSigTimeoutValue" SG_ 616 Time_Hour 0;
BA_ "Remark" SG_ 616 Time_Hour "";
BA_ "EventCommandSignal" SG_ 616 Time_Min 0;
BA_ "GatewayedSignals" SG_ 616 Time_Min 0;
BA_ "GenSigInactiveValue" SG_ 616 Time_Min 0;
BA_ "GenSigInvalidValue" SG_ 616 Time_Min 0;
BA_ "GenSigSendType" SG_ 616 Time_Min 1;
BA_ "GenSigStartValue" SG_ 616 Time_Min 1;
BA_ "GenSigTimeoutValue" SG_ 616 Time_Min 0;
BA_ "Remark" SG_ 616 Time_Min "";
BA_ "EventCommandSignal" SG_ 616 Time_Sec 0;
BA_ "GatewayedSignals" SG_ 616 Time_Sec 0;
BA_ "GenSigInactiveValue" SG_ 616 Time_Sec 0;
BA_ "GenSigInvalidValue" SG_ 616 Time_Sec 0;
BA_ "GenSigSendType" SG_ 616 Time_Sec 1;
BA_ "GenSigStartValue" SG_ 616 Time_Sec 1;
BA_ "GenSigTimeoutValue" SG_ 616 Time_Sec 0;
BA_ "Remark" SG_ 616 Time_Sec "";
BA_ "EventCommandSignal" SG_ 616 CCU_DstFlag 0;
BA_ "GatewayedSignals" SG_ 616 CCU_DstFlag 0;
BA_ "GenSigInactiveValue" SG_ 616 CCU_DstFlag 0;
BA_ "GenSigInvalidValue" SG_ 616 CCU_DstFlag 0;
BA_ "GenSigSendType" SG_ 616 CCU_DstFlag 1;
BA_ "GenSigStartValue" SG_ 616 CCU_DstFlag 0;
BA_ "GenSigTimeoutValue" SG_ 616 CCU_DstFlag 0;
BA_ "Remark" SG_ 616 CCU_DstFlag "";
BA_ "EventCommandSignal" SG_ 616 ASB_DriverActiveBeltFaultSt 0;
BA_ "GatewayedSignals" SG_ 616 ASB_DriverActiveBeltFaultSt 0;
BA_ "GenSigInactiveValue" SG_ 616 ASB_DriverActiveBeltFaultSt 0;
BA_ "GenSigInvalidValue" SG_ 616 ASB_DriverActiveBeltFaultSt 0;
BA_ "GenSigSendType" SG_ 616 ASB_DriverActiveBeltFaultSt 0;
BA_ "GenSigStartValue" SG_ 616 ASB_DriverActiveBeltFaultSt 0;
BA_ "GenSigTimeoutValue" SG_ 616 ASB_DriverActiveBeltFaultSt 1;
BA_ "Remark" SG_ 616 ASB_DriverActiveBeltFaultSt "";
BA_ "EventCommandSignal" SG_ 616 IPDS_DCDCOpenCircuitSt 0;
BA_ "GatewayedSignals" SG_ 616 IPDS_DCDCOpenCircuitSt 0;
BA_ "GenSigInactiveValue" SG_ 616 IPDS_DCDCOpenCircuitSt 0;
BA_ "GenSigInvalidValue" SG_ 616 IPDS_DCDCOpenCircuitSt 0;
BA_ "GenSigSendType" SG_ 616 IPDS_DCDCOpenCircuitSt 1;
BA_ "GenSigStartValue" SG_ 616 IPDS_DCDCOpenCircuitSt 0;
BA_ "GenSigTimeoutValue" SG_ 616 IPDS_DCDCOpenCircuitSt 0;
BA_ "Remark" SG_ 616 IPDS_DCDCOpenCircuitSt "";
BA_ "EventCommandSignal" SG_ 825 WW_FwpFaultSt 0;
BA_ "GatewayedSignals" SG_ 825 WW_FwpFaultSt 0;
BA_ "GenSigInactiveValue" SG_ 825 WW_FwpFaultSt 0;
BA_ "GenSigInvalidValue" SG_ 825 WW_FwpFaultSt 0;
BA_ "GenSigSendType" SG_ 825 WW_FwpFaultSt 1;
BA_ "GenSigStartValue" SG_ 825 WW_FwpFaultSt 0;
BA_ "GenSigTimeoutValue" SG_ 825 WW_FwpFaultSt 0;
BA_ "Remark" SG_ 825 WW_FwpFaultSt "";
BA_ "EventCommandSignal" SG_ 825 WW_RwpFaultSt 0;
BA_ "GatewayedSignals" SG_ 825 WW_RwpFaultSt 0;
BA_ "GenSigInactiveValue" SG_ 825 WW_RwpFaultSt 0;
BA_ "GenSigInvalidValue" SG_ 825 WW_RwpFaultSt 0;
BA_ "GenSigSendType" SG_ 825 WW_RwpFaultSt 1;
BA_ "GenSigStartValue" SG_ 825 WW_RwpFaultSt 0;
BA_ "GenSigTimeoutValue" SG_ 825 WW_RwpFaultSt 0;
BA_ "Remark" SG_ 825 WW_RwpFaultSt "";
BA_ "EventCommandSignal" SG_ 825 WW_FwshFaultSt 0;
BA_ "GatewayedSignals" SG_ 825 WW_FwshFaultSt 0;
BA_ "GenSigInactiveValue" SG_ 825 WW_FwshFaultSt 0;
BA_ "GenSigInvalidValue" SG_ 825 WW_FwshFaultSt 0;
BA_ "GenSigSendType" SG_ 825 WW_FwshFaultSt 1;
BA_ "GenSigStartValue" SG_ 825 WW_FwshFaultSt 0;
BA_ "GenSigTimeoutValue" SG_ 825 WW_FwshFaultSt 0;
BA_ "Remark" SG_ 825 WW_FwshFaultSt "";
BA_ "EventCommandSignal" SG_ 825 WW_RwshFaultSt 0;
BA_ "GatewayedSignals" SG_ 825 WW_RwshFaultSt 0;
BA_ "GenSigInactiveValue" SG_ 825 WW_RwshFaultSt 0;
BA_ "GenSigInvalidValue" SG_ 825 WW_RwshFaultSt 0;
BA_ "GenSigSendType" SG_ 825 WW_RwshFaultSt 1;
BA_ "GenSigStartValue" SG_ 825 WW_RwshFaultSt 0;
BA_ "GenSigTimeoutValue" SG_ 825 WW_RwshFaultSt 0;
BA_ "Remark" SG_ 825 WW_RwshFaultSt "";
BA_ "EventCommandSignal" SG_ 825 WW_FwpAutoModeSt 0;
BA_ "GatewayedSignals" SG_ 825 WW_FwpAutoModeSt 0;
BA_ "GenSigInactiveValue" SG_ 825 WW_FwpAutoModeSt 0;
BA_ "GenSigInvalidValue" SG_ 825 WW_FwpAutoModeSt 0;
BA_ "GenSigSendType" SG_ 825 WW_FwpAutoModeSt 1;
BA_ "GenSigStartValue" SG_ 825 WW_FwpAutoModeSt 0;
BA_ "GenSigTimeoutValue" SG_ 825 WW_FwpAutoModeSt 0;
BA_ "Remark" SG_ 825 WW_FwpAutoModeSt "";
BA_ "EventCommandSignal" SG_ 825 RLS_IRBrightness 0;
BA_ "GatewayedSignals" SG_ 825 RLS_IRBrightness 0;
BA_ "GenSigInactiveValue" SG_ 825 RLS_IRBrightness 0;
BA_ "GenSigInvalidValue" SG_ 825 RLS_IRBrightness 0;
BA_ "GenSigSendType" SG_ 825 RLS_IRBrightness 1;
BA_ "GenSigStartValue" SG_ 825 RLS_IRBrightness 2046;
BA_ "GenSigTimeoutValue" SG_ 825 RLS_IRBrightness 0;
BA_ "Remark" SG_ 825 RLS_IRBrightness "";
BA_ "EventCommandSignal" SG_ 825 WW_RainFallLevel 0;
BA_ "GatewayedSignals" SG_ 825 WW_RainFallLevel 0;
BA_ "GenSigInactiveValue" SG_ 825 WW_RainFallLevel 0;
BA_ "GenSigInvalidValue" SG_ 825 WW_RainFallLevel 0;
BA_ "GenSigSendType" SG_ 825 WW_RainFallLevel 1;
BA_ "GenSigStartValue" SG_ 825 WW_RainFallLevel 0;
BA_ "GenSigTimeoutValue" SG_ 825 WW_RainFallLevel 0;
BA_ "Remark" SG_ 825 WW_RainFallLevel "";
BA_ "EventCommandSignal" SG_ 825 RLS_LightOnReq 0;
BA_ "GatewayedSignals" SG_ 825 RLS_LightOnReq 0;
BA_ "GenSigInactiveValue" SG_ 825 RLS_LightOnReq 0;
BA_ "GenSigInvalidValue" SG_ 825 RLS_LightOnReq 0;
BA_ "GenSigSendType" SG_ 825 RLS_LightOnReq 1;
BA_ "GenSigStartValue" SG_ 825 RLS_LightOnReq 0;
BA_ "GenSigTimeoutValue" SG_ 825 RLS_LightOnReq 0;
BA_ "Remark" SG_ 825 RLS_LightOnReq "";
BA_ "EventCommandSignal" SG_ 825 RLS_LampOnReqValid 0;
BA_ "GatewayedSignals" SG_ 825 RLS_LampOnReqValid 0;
BA_ "GenSigInactiveValue" SG_ 825 RLS_LampOnReqValid 0;
BA_ "GenSigInvalidValue" SG_ 825 RLS_LampOnReqValid 0;
BA_ "GenSigSendType" SG_ 825 RLS_LampOnReqValid 1;
BA_ "GenSigStartValue" SG_ 825 RLS_LampOnReqValid 0;
BA_ "GenSigTimeoutValue" SG_ 825 RLS_LampOnReqValid 0;
BA_ "Remark" SG_ 825 RLS_LampOnReqValid "";
BA_ "EventCommandSignal" SG_ 825 RLS_WiperSpd 0;
BA_ "GatewayedSignals" SG_ 825 RLS_WiperSpd 0;
BA_ "GenSigInactiveValue" SG_ 825 RLS_WiperSpd 0;
BA_ "GenSigInvalidValue" SG_ 825 RLS_WiperSpd 0;
BA_ "GenSigSendType" SG_ 825 RLS_WiperSpd 1;
BA_ "GenSigStartValue" SG_ 825 RLS_WiperSpd 0;
BA_ "GenSigTimeoutValue" SG_ 825 RLS_WiperSpd 0;
BA_ "Remark" SG_ 825 RLS_WiperSpd "";
BA_ "EventCommandSignal" SG_ 825 RLS_AMBBrightness 0;
BA_ "GatewayedSignals" SG_ 825 RLS_AMBBrightness 0;
BA_ "GenSigInactiveValue" SG_ 825 RLS_AMBBrightness 0;
BA_ "GenSigInvalidValue" SG_ 825 RLS_AMBBrightness 0;
BA_ "GenSigSendType" SG_ 825 RLS_AMBBrightness 1;
BA_ "GenSigStartValue" SG_ 825 RLS_AMBBrightness 16382;
BA_ "GenSigTimeoutValue" SG_ 825 RLS_AMBBrightness 0;
BA_ "Remark" SG_ 825 RLS_AMBBrightness "";
BA_ "EventCommandSignal" SG_ 825 RLS_FWBrightness 0;
BA_ "GatewayedSignals" SG_ 825 RLS_FWBrightness 0;
BA_ "GenSigInactiveValue" SG_ 825 RLS_FWBrightness 0;
BA_ "GenSigInvalidValue" SG_ 825 RLS_FWBrightness 0;
BA_ "GenSigSendType" SG_ 825 RLS_FWBrightness 1;
BA_ "GenSigStartValue" SG_ 825 RLS_FWBrightness 16382;
BA_ "GenSigTimeoutValue" SG_ 825 RLS_FWBrightness 0;
BA_ "Remark" SG_ 825 RLS_FWBrightness "";
BA_ "EventCommandSignal" SG_ 825 RLS_RainfallLevel 0;
BA_ "GatewayedSignals" SG_ 825 RLS_RainfallLevel 0;
BA_ "GenSigInactiveValue" SG_ 825 RLS_RainfallLevel 0;
BA_ "GenSigInvalidValue" SG_ 825 RLS_RainfallLevel 0;
BA_ "GenSigSendType" SG_ 825 RLS_RainfallLevel 1;
BA_ "GenSigStartValue" SG_ 825 RLS_RainfallLevel 14;
BA_ "GenSigTimeoutValue" SG_ 825 RLS_RainfallLevel 0;
BA_ "Remark" SG_ 825 RLS_RainfallLevel "";
BA_ "EventCommandSignal" SG_ 825 RLS_RSErr 0;
BA_ "GatewayedSignals" SG_ 825 RLS_RSErr 0;
BA_ "GenSigInactiveValue" SG_ 825 RLS_RSErr 0;
BA_ "GenSigInvalidValue" SG_ 825 RLS_RSErr 0;
BA_ "GenSigSendType" SG_ 825 RLS_RSErr 1;
BA_ "GenSigStartValue" SG_ 825 RLS_RSErr 0;
BA_ "GenSigTimeoutValue" SG_ 825 RLS_RSErr 0;
BA_ "Remark" SG_ 825 RLS_RSErr "";
BA_ "EventCommandSignal" SG_ 825 RLS_LSErr 0;
BA_ "GatewayedSignals" SG_ 825 RLS_LSErr 0;
BA_ "GenSigInactiveValue" SG_ 825 RLS_LSErr 0;
BA_ "GenSigInvalidValue" SG_ 825 RLS_LSErr 0;
BA_ "GenSigSendType" SG_ 825 RLS_LSErr 1;
BA_ "GenSigStartValue" SG_ 825 RLS_LSErr 0;
BA_ "GenSigTimeoutValue" SG_ 825 RLS_LSErr 0;
BA_ "Remark" SG_ 825 RLS_LSErr "";
BA_ "EventCommandSignal" SG_ 825 PM_AUTHPstState 0;
BA_ "GatewayedSignals" SG_ 825 PM_AUTHPstState 0;
BA_ "GenSigInactiveValue" SG_ 825 PM_AUTHPstState 0;
BA_ "GenSigInvalidValue" SG_ 825 PM_AUTHPstState 0;
BA_ "GenSigSendType" SG_ 825 PM_AUTHPstState 1;
BA_ "GenSigStartValue" SG_ 825 PM_AUTHPstState 0;
BA_ "GenSigTimeoutValue" SG_ 825 PM_AUTHPstState 0;
BA_ "Remark" SG_ 825 PM_AUTHPstState "";
BA_ "EventCommandSignal" SG_ 825 CCU_FuncReq_SentryMod 0;
BA_ "GatewayedSignals" SG_ 825 CCU_FuncReq_SentryMod 0;
BA_ "GenSigInactiveValue" SG_ 825 CCU_FuncReq_SentryMod 0;
BA_ "GenSigInvalidValue" SG_ 825 CCU_FuncReq_SentryMod 0;
BA_ "GenSigSendType" SG_ 825 CCU_FuncReq_SentryMod 1;
BA_ "GenSigStartValue" SG_ 825 CCU_FuncReq_SentryMod 0;
BA_ "GenSigTimeoutValue" SG_ 825 CCU_FuncReq_SentryMod 0;
BA_ "Remark" SG_ 825 CCU_FuncReq_SentryMod "";
BA_ "EventCommandSignal" SG_ 825 RLS_WindShieldHum 0;
BA_ "GatewayedSignals" SG_ 825 RLS_WindShieldHum 0;
BA_ "GenSigInactiveValue" SG_ 825 RLS_WindShieldHum 0;
BA_ "GenSigInvalidValue" SG_ 825 RLS_WindShieldHum 0;
BA_ "GenSigSendType" SG_ 825 RLS_WindShieldHum 1;
BA_ "GenSigStartValue" SG_ 825 RLS_WindShieldHum 0;
BA_ "GenSigTimeoutValue" SG_ 825 RLS_WindShieldHum 0;
BA_ "Remark" SG_ 825 RLS_WindShieldHum "";
BA_ "EventCommandSignal" SG_ 825 RLS_WindShieldTem 0;
BA_ "GatewayedSignals" SG_ 825 RLS_WindShieldTem 0;
BA_ "GenSigInactiveValue" SG_ 825 RLS_WindShieldTem 0;
BA_ "GenSigInvalidValue" SG_ 825 RLS_WindShieldTem 0;
BA_ "GenSigSendType" SG_ 825 RLS_WindShieldTem 1;
BA_ "GenSigStartValue" SG_ 825 RLS_WindShieldTem 254;
BA_ "GenSigTimeoutValue" SG_ 825 RLS_WindShieldTem 0;
BA_ "Remark" SG_ 825 RLS_WindShieldTem "";
BA_ "EventCommandSignal" SG_ 825 RLS_DewPoint 0;
BA_ "GatewayedSignals" SG_ 825 RLS_DewPoint 0;
BA_ "GenSigInactiveValue" SG_ 825 RLS_DewPoint 0;
BA_ "GenSigInvalidValue" SG_ 825 RLS_DewPoint 0;
BA_ "GenSigSendType" SG_ 825 RLS_DewPoint 1;
BA_ "GenSigStartValue" SG_ 825 RLS_DewPoint 254;
BA_ "GenSigTimeoutValue" SG_ 825 RLS_DewPoint 0;
BA_ "Remark" SG_ 825 RLS_DewPoint "";
BA_ "EventCommandSignal" SG_ 825 CCU_ModeSuppressSts 0;
BA_ "GatewayedSignals" SG_ 825 CCU_ModeSuppressSts 0;
BA_ "GenSigInactiveValue" SG_ 825 CCU_ModeSuppressSts 0;
BA_ "GenSigInvalidValue" SG_ 825 CCU_ModeSuppressSts 0;
BA_ "GenSigSendType" SG_ 825 CCU_ModeSuppressSts 1;
BA_ "GenSigStartValue" SG_ 825 CCU_ModeSuppressSts 0;
BA_ "GenSigTimeoutValue" SG_ 825 CCU_ModeSuppressSts 0;
BA_ "Remark" SG_ 825 CCU_ModeSuppressSts "";
BA_ "EventCommandSignal" SG_ 825 RLS_HUTErr 0;
BA_ "GatewayedSignals" SG_ 825 RLS_HUTErr 0;
BA_ "GenSigInactiveValue" SG_ 825 RLS_HUTErr 0;
BA_ "GenSigInvalidValue" SG_ 825 RLS_HUTErr 0;
BA_ "GenSigSendType" SG_ 825 RLS_HUTErr 1;
BA_ "GenSigStartValue" SG_ 825 RLS_HUTErr 0;
BA_ "GenSigTimeoutValue" SG_ 825 RLS_HUTErr 0;
BA_ "Remark" SG_ 825 RLS_HUTErr "";
BA_ "EventCommandSignal" SG_ 389 ADC_4_B_New_CRC 0;
BA_ "GatewayedSignals" SG_ 389 ADC_4_B_New_CRC 0;
BA_ "GenSigInactiveValue" SG_ 389 ADC_4_B_New_CRC 0;
BA_ "GenSigInvalidValue" SG_ 389 ADC_4_B_New_CRC 0;
BA_ "GenSigSendType" SG_ 389 ADC_4_B_New_CRC 1;
BA_ "GenSigStartValue" SG_ 389 ADC_4_B_New_CRC 0;
BA_ "GenSigTimeoutValue" SG_ 389 ADC_4_B_New_CRC 0;
BA_ "Remark" SG_ 389 ADC_4_B_New_CRC "";
BA_ "EventCommandSignal" SG_ 389 ADC_4_B_New_Counter 0;
BA_ "GatewayedSignals" SG_ 389 ADC_4_B_New_Counter 0;
BA_ "GenSigInactiveValue" SG_ 389 ADC_4_B_New_Counter 0;
BA_ "GenSigInvalidValue" SG_ 389 ADC_4_B_New_Counter 0;
BA_ "GenSigSendType" SG_ 389 ADC_4_B_New_Counter 1;
BA_ "GenSigStartValue" SG_ 389 ADC_4_B_New_Counter 0;
BA_ "GenSigTimeoutValue" SG_ 389 ADC_4_B_New_Counter 0;
BA_ "Remark" SG_ 389 ADC_4_B_New_Counter "";
BA_ "EventCommandSignal" SG_ 389 ADC_AngReqSt_A_B1 0;
BA_ "GatewayedSignals" SG_ 389 ADC_AngReqSt_A_B1 0;
BA_ "GenSigInactiveValue" SG_ 389 ADC_AngReqSt_A_B1 0;
BA_ "GenSigInvalidValue" SG_ 389 ADC_AngReqSt_A_B1 0;
BA_ "GenSigSendType" SG_ 389 ADC_AngReqSt_A_B1 1;
BA_ "GenSigStartValue" SG_ 389 ADC_AngReqSt_A_B1 0;
BA_ "GenSigTimeoutValue" SG_ 389 ADC_AngReqSt_A_B1 0;
BA_ "Remark" SG_ 389 ADC_AngReqSt_A_B1 "";
BA_ "EventCommandSignal" SG_ 389 ADC_AngReqFunction_B1 0;
BA_ "GatewayedSignals" SG_ 389 ADC_AngReqFunction_B1 0;
BA_ "GenSigInactiveValue" SG_ 389 ADC_AngReqFunction_B1 0;
BA_ "GenSigInvalidValue" SG_ 389 ADC_AngReqFunction_B1 0;
BA_ "GenSigSendType" SG_ 389 ADC_AngReqFunction_B1 1;
BA_ "GenSigStartValue" SG_ 389 ADC_AngReqFunction_B1 0;
BA_ "GenSigTimeoutValue" SG_ 389 ADC_AngReqFunction_B1 0;
BA_ "Remark" SG_ 389 ADC_AngReqFunction_B1 "";
BA_ "EventCommandSignal" SG_ 389 ADC_BrakeLightReq_B1 0;
BA_ "GatewayedSignals" SG_ 389 ADC_BrakeLightReq_B1 0;
BA_ "GenSigInactiveValue" SG_ 389 ADC_BrakeLightReq_B1 0;
BA_ "GenSigInvalidValue" SG_ 389 ADC_BrakeLightReq_B1 0;
BA_ "GenSigSendType" SG_ 389 ADC_BrakeLightReq_B1 1;
BA_ "GenSigStartValue" SG_ 389 ADC_BrakeLightReq_B1 0;
BA_ "GenSigTimeoutValue" SG_ 389 ADC_BrakeLightReq_B1 0;
BA_ "Remark" SG_ 389 ADC_BrakeLightReq_B1 "";
BA_ "EventCommandSignal" SG_ 389 ADC_StrAngleReq_A_B1 0;
BA_ "GatewayedSignals" SG_ 389 ADC_StrAngleReq_A_B1 0;
BA_ "GenSigInactiveValue" SG_ 389 ADC_StrAngleReq_A_B1 0;
BA_ "GenSigInvalidValue" SG_ 389 ADC_StrAngleReq_A_B1 65535;
BA_ "GenSigSendType" SG_ 389 ADC_StrAngleReq_A_B1 1;
BA_ "GenSigStartValue" SG_ 389 ADC_StrAngleReq_A_B1 7800;
BA_ "GenSigTimeoutValue" SG_ 389 ADC_StrAngleReq_A_B1 65535;
BA_ "Remark" SG_ 389 ADC_StrAngleReq_A_B1 "";
BA_ "EventCommandSignal" SG_ 389 ADC_SACMotorTorLimExtMax_A_B1 0;
BA_ "GatewayedSignals" SG_ 389 ADC_SACMotorTorLimExtMax_A_B1 0;
BA_ "GenSigInactiveValue" SG_ 389 ADC_SACMotorTorLimExtMax_A_B1 0;
BA_ "GenSigInvalidValue" SG_ 389 ADC_SACMotorTorLimExtMax_A_B1 255;
BA_ "GenSigSendType" SG_ 389 ADC_SACMotorTorLimExtMax_A_B1 1;
BA_ "GenSigStartValue" SG_ 389 ADC_SACMotorTorLimExtMax_A_B1 254;
BA_ "GenSigTimeoutValue" SG_ 389 ADC_SACMotorTorLimExtMax_A_B1 255;
BA_ "Remark" SG_ 389 ADC_SACMotorTorLimExtMax_A_B1 "";
BA_ "EventCommandSignal" SG_ 389 ADC_SACMotorTorLimExtMin_A_B1 0;
BA_ "GatewayedSignals" SG_ 389 ADC_SACMotorTorLimExtMin_A_B1 0;
BA_ "GenSigInactiveValue" SG_ 389 ADC_SACMotorTorLimExtMin_A_B1 0;
BA_ "GenSigInvalidValue" SG_ 389 ADC_SACMotorTorLimExtMin_A_B1 0;
BA_ "GenSigSendType" SG_ 389 ADC_SACMotorTorLimExtMin_A_B1 1;
BA_ "GenSigStartValue" SG_ 389 ADC_SACMotorTorLimExtMin_A_B1 0;
BA_ "GenSigTimeoutValue" SG_ 389 ADC_SACMotorTorLimExtMin_A_B1 255;
BA_ "Remark" SG_ 389 ADC_SACMotorTorLimExtMin_A_B1 "";
BA_ "EventCommandSignal" SG_ 389 ADC_AssistParaSwitchReq_B1 0;
BA_ "GatewayedSignals" SG_ 389 ADC_AssistParaSwitchReq_B1 0;
BA_ "GenSigInactiveValue" SG_ 389 ADC_AssistParaSwitchReq_B1 0;
BA_ "GenSigInvalidValue" SG_ 389 ADC_AssistParaSwitchReq_B1 0;
BA_ "GenSigSendType" SG_ 389 ADC_AssistParaSwitchReq_B1 1;
BA_ "GenSigStartValue" SG_ 389 ADC_AssistParaSwitchReq_B1 0;
BA_ "GenSigTimeoutValue" SG_ 389 ADC_AssistParaSwitchReq_B1 0;
BA_ "Remark" SG_ 389 ADC_AssistParaSwitchReq_B1 "";
BA_ "EventCommandSignal" SG_ 389 ADC_SteerGainReq_B1 0;
BA_ "GatewayedSignals" SG_ 389 ADC_SteerGainReq_B1 0;
BA_ "GenSigInactiveValue" SG_ 389 ADC_SteerGainReq_B1 0;
BA_ "GenSigInvalidValue" SG_ 389 ADC_SteerGainReq_B1 0;
BA_ "GenSigSendType" SG_ 389 ADC_SteerGainReq_B1 1;
BA_ "GenSigStartValue" SG_ 389 ADC_SteerGainReq_B1 0;
BA_ "GenSigTimeoutValue" SG_ 389 ADC_SteerGainReq_B1 0;
BA_ "Remark" SG_ 389 ADC_SteerGainReq_B1 "";
BA_ "EventCommandSignal" SG_ 389 ADC_StrgWhlVibrWarnLevel_B1 0;
BA_ "GatewayedSignals" SG_ 389 ADC_StrgWhlVibrWarnLevel_B1 0;
BA_ "GenSigInactiveValue" SG_ 389 ADC_StrgWhlVibrWarnLevel_B1 0;
BA_ "GenSigInvalidValue" SG_ 389 ADC_StrgWhlVibrWarnLevel_B1 0;
BA_ "GenSigSendType" SG_ 389 ADC_StrgWhlVibrWarnLevel_B1 1;
BA_ "GenSigStartValue" SG_ 389 ADC_StrgWhlVibrWarnLevel_B1 0;
BA_ "GenSigTimeoutValue" SG_ 389 ADC_StrgWhlVibrWarnLevel_B1 0;
BA_ "Remark" SG_ 389 ADC_StrgWhlVibrWarnLevel_B1 "";
BA_ "EventCommandSignal" SG_ 389 ADC_ActTrqReqEnable_B1 0;
BA_ "GatewayedSignals" SG_ 389 ADC_ActTrqReqEnable_B1 0;
BA_ "GenSigInactiveValue" SG_ 389 ADC_ActTrqReqEnable_B1 0;
BA_ "GenSigInvalidValue" SG_ 389 ADC_ActTrqReqEnable_B1 0;
BA_ "GenSigSendType" SG_ 389 ADC_ActTrqReqEnable_B1 1;
BA_ "GenSigStartValue" SG_ 389 ADC_ActTrqReqEnable_B1 0;
BA_ "GenSigTimeoutValue" SG_ 389 ADC_ActTrqReqEnable_B1 0;
BA_ "Remark" SG_ 389 ADC_ActTrqReqEnable_B1 "";
BA_ "EventCommandSignal" SG_ 389 ADC_SteerGainLevel_B1 0;
BA_ "GatewayedSignals" SG_ 389 ADC_SteerGainLevel_B1 0;
BA_ "GenSigInactiveValue" SG_ 389 ADC_SteerGainLevel_B1 0;
BA_ "GenSigInvalidValue" SG_ 389 ADC_SteerGainLevel_B1 0;
BA_ "GenSigSendType" SG_ 389 ADC_SteerGainLevel_B1 1;
BA_ "GenSigStartValue" SG_ 389 ADC_SteerGainLevel_B1 0;
BA_ "GenSigTimeoutValue" SG_ 389 ADC_SteerGainLevel_B1 100;
BA_ "Remark" SG_ 389 ADC_SteerGainLevel_B1 "";
BA_ "EventCommandSignal" SG_ 389 ADC_EvsSteerReq_B1 0;
BA_ "GatewayedSignals" SG_ 389 ADC_EvsSteerReq_B1 0;
BA_ "GenSigInactiveValue" SG_ 389 ADC_EvsSteerReq_B1 0;
BA_ "GenSigInvalidValue" SG_ 389 ADC_EvsSteerReq_B1 0;
BA_ "GenSigSendType" SG_ 389 ADC_EvsSteerReq_B1 1;
BA_ "GenSigStartValue" SG_ 389 ADC_EvsSteerReq_B1 0;
BA_ "GenSigTimeoutValue" SG_ 389 ADC_EvsSteerReq_B1 0;
BA_ "Remark" SG_ 389 ADC_EvsSteerReq_B1 "";
BA_ "EventCommandSignal" SG_ 389 ADC_StrgWhlVibrWarnReq_B1 0;
BA_ "GatewayedSignals" SG_ 389 ADC_StrgWhlVibrWarnReq_B1 0;
BA_ "GenSigInactiveValue" SG_ 389 ADC_StrgWhlVibrWarnReq_B1 0;
BA_ "GenSigInvalidValue" SG_ 389 ADC_StrgWhlVibrWarnReq_B1 0;
BA_ "GenSigSendType" SG_ 389 ADC_StrgWhlVibrWarnReq_B1 1;
BA_ "GenSigStartValue" SG_ 389 ADC_StrgWhlVibrWarnReq_B1 0;
BA_ "GenSigTimeoutValue" SG_ 389 ADC_StrgWhlVibrWarnReq_B1 0;
BA_ "Remark" SG_ 389 ADC_StrgWhlVibrWarnReq_B1 "";
BA_ "EventCommandSignal" SG_ 389 ADC_ActTrqReq_B1 0;
BA_ "GatewayedSignals" SG_ 389 ADC_ActTrqReq_B1 0;
BA_ "GenSigInactiveValue" SG_ 389 ADC_ActTrqReq_B1 0;
BA_ "GenSigInvalidValue" SG_ 389 ADC_ActTrqReq_B1 0;
BA_ "GenSigSendType" SG_ 389 ADC_ActTrqReq_B1 1;
BA_ "GenSigStartValue" SG_ 389 ADC_ActTrqReq_B1 0;
BA_ "GenSigTimeoutValue" SG_ 389 ADC_ActTrqReq_B1 0;
BA_ "Remark" SG_ 389 ADC_ActTrqReq_B1 "";
BA_ "EventCommandSignal" SG_ 389 ADC_DrvTarTqMod2EPB_B 0;
BA_ "GatewayedSignals" SG_ 389 ADC_DrvTarTqMod2EPB_B 0;
BA_ "GenSigInactiveValue" SG_ 389 ADC_DrvTarTqMod2EPB_B 0;
BA_ "GenSigInvalidValue" SG_ 389 ADC_DrvTarTqMod2EPB_B 0;
BA_ "GenSigSendType" SG_ 389 ADC_DrvTarTqMod2EPB_B 1;
BA_ "GenSigStartValue" SG_ 389 ADC_DrvTarTqMod2EPB_B 0;
BA_ "GenSigTimeoutValue" SG_ 389 ADC_DrvTarTqMod2EPB_B 0;
BA_ "Remark" SG_ 389 ADC_DrvTarTqMod2EPB_B "";
BA_ "EventCommandSignal" SG_ 389 ADC_LongCtrlTypReq_B1 0;
BA_ "GatewayedSignals" SG_ 389 ADC_LongCtrlTypReq_B1 0;
BA_ "GenSigInactiveValue" SG_ 389 ADC_LongCtrlTypReq_B1 0;
BA_ "GenSigInvalidValue" SG_ 389 ADC_LongCtrlTypReq_B1 0;
BA_ "GenSigSendType" SG_ 389 ADC_LongCtrlTypReq_B1 1;
BA_ "GenSigStartValue" SG_ 389 ADC_LongCtrlTypReq_B1 0;
BA_ "GenSigTimeoutValue" SG_ 389 ADC_LongCtrlTypReq_B1 0;
BA_ "Remark" SG_ 389 ADC_LongCtrlTypReq_B1 "";
BA_ "EventCommandSignal" SG_ 389 ADC_AEBFaultSt_B1 0;
BA_ "GatewayedSignals" SG_ 389 ADC_AEBFaultSt_B1 0;
BA_ "GenSigInactiveValue" SG_ 389 ADC_AEBFaultSt_B1 0;
BA_ "GenSigInvalidValue" SG_ 389 ADC_AEBFaultSt_B1 0;
BA_ "GenSigSendType" SG_ 389 ADC_AEBFaultSt_B1 1;
BA_ "GenSigStartValue" SG_ 389 ADC_AEBFaultSt_B1 0;
BA_ "GenSigTimeoutValue" SG_ 389 ADC_AEBFaultSt_B1 1;
BA_ "Remark" SG_ 389 ADC_AEBFaultSt_B1 "";
BA_ "EventCommandSignal" SG_ 389 ADC_AEBOffSt_B1 0;
BA_ "GatewayedSignals" SG_ 389 ADC_AEBOffSt_B1 0;
BA_ "GenSigInactiveValue" SG_ 389 ADC_AEBOffSt_B1 0;
BA_ "GenSigInvalidValue" SG_ 389 ADC_AEBOffSt_B1 0;
BA_ "GenSigSendType" SG_ 389 ADC_AEBOffSt_B1 1;
BA_ "GenSigStartValue" SG_ 389 ADC_AEBOffSt_B1 0;
BA_ "GenSigTimeoutValue" SG_ 389 ADC_AEBOffSt_B1 1;
BA_ "Remark" SG_ 389 ADC_AEBOffSt_B1 "";
BA_ "EventCommandSignal" SG_ 389 ADC_AEBInterventionSt_B1 0;
BA_ "GatewayedSignals" SG_ 389 ADC_AEBInterventionSt_B1 0;
BA_ "GenSigInactiveValue" SG_ 389 ADC_AEBInterventionSt_B1 0;
BA_ "GenSigInvalidValue" SG_ 389 ADC_AEBInterventionSt_B1 0;
BA_ "GenSigSendType" SG_ 389 ADC_AEBInterventionSt_B1 1;
BA_ "GenSigStartValue" SG_ 389 ADC_AEBInterventionSt_B1 0;
BA_ "GenSigTimeoutValue" SG_ 389 ADC_AEBInterventionSt_B1 0;
BA_ "Remark" SG_ 389 ADC_AEBInterventionSt_B1 "";
BA_ "EventCommandSignal" SG_ 389 ADC_AEBDecelCtrlReq_B1 0;
BA_ "GatewayedSignals" SG_ 389 ADC_AEBDecelCtrlReq_B1 0;
BA_ "GenSigInactiveValue" SG_ 389 ADC_AEBDecelCtrlReq_B1 0;
BA_ "GenSigInvalidValue" SG_ 389 ADC_AEBDecelCtrlReq_B1 0;
BA_ "GenSigSendType" SG_ 389 ADC_AEBDecelCtrlReq_B1 1;
BA_ "GenSigStartValue" SG_ 389 ADC_AEBDecelCtrlReq_B1 0;
BA_ "GenSigTimeoutValue" SG_ 389 ADC_AEBDecelCtrlReq_B1 0;
BA_ "Remark" SG_ 389 ADC_AEBDecelCtrlReq_B1 "";
BA_ "EventCommandSignal" SG_ 389 ADC_AEBLVehHoldReq_B1 0;
BA_ "GatewayedSignals" SG_ 389 ADC_AEBLVehHoldReq_B1 0;
BA_ "GenSigInactiveValue" SG_ 389 ADC_AEBLVehHoldReq_B1 0;
BA_ "GenSigInvalidValue" SG_ 389 ADC_AEBLVehHoldReq_B1 0;
BA_ "GenSigSendType" SG_ 389 ADC_AEBLVehHoldReq_B1 1;
BA_ "GenSigStartValue" SG_ 389 ADC_AEBLVehHoldReq_B1 0;
BA_ "GenSigTimeoutValue" SG_ 389 ADC_AEBLVehHoldReq_B1 0;
BA_ "Remark" SG_ 389 ADC_AEBLVehHoldReq_B1 "";
BA_ "EventCommandSignal" SG_ 389 ADC_ABAReq_B1 0;
BA_ "GatewayedSignals" SG_ 389 ADC_ABAReq_B1 0;
BA_ "GenSigInactiveValue" SG_ 389 ADC_ABAReq_B1 0;
BA_ "GenSigInvalidValue" SG_ 389 ADC_ABAReq_B1 0;
BA_ "GenSigSendType" SG_ 389 ADC_ABAReq_B1 1;
BA_ "GenSigStartValue" SG_ 389 ADC_ABAReq_B1 0;
BA_ "GenSigTimeoutValue" SG_ 389 ADC_ABAReq_B1 0;
BA_ "Remark" SG_ 389 ADC_ABAReq_B1 "";
BA_ "EventCommandSignal" SG_ 389 ADC_ABALevel_B1 0;
BA_ "GatewayedSignals" SG_ 389 ADC_ABALevel_B1 0;
BA_ "GenSigInactiveValue" SG_ 389 ADC_ABALevel_B1 0;
BA_ "GenSigInvalidValue" SG_ 389 ADC_ABALevel_B1 0;
BA_ "GenSigSendType" SG_ 389 ADC_ABALevel_B1 1;
BA_ "GenSigStartValue" SG_ 389 ADC_ABALevel_B1 0;
BA_ "GenSigTimeoutValue" SG_ 389 ADC_ABALevel_B1 0;
BA_ "Remark" SG_ 389 ADC_ABALevel_B1 "";
BA_ "EventCommandSignal" SG_ 389 ADC_AWBReq_B1 0;
BA_ "GatewayedSignals" SG_ 389 ADC_AWBReq_B1 0;
BA_ "GenSigInactiveValue" SG_ 389 ADC_AWBReq_B1 0;
BA_ "GenSigInvalidValue" SG_ 389 ADC_AWBReq_B1 0;
BA_ "GenSigSendType" SG_ 389 ADC_AWBReq_B1 1;
BA_ "GenSigStartValue" SG_ 389 ADC_AWBReq_B1 0;
BA_ "GenSigTimeoutValue" SG_ 389 ADC_AWBReq_B1 0;
BA_ "Remark" SG_ 389 ADC_AWBReq_B1 "";
BA_ "EventCommandSignal" SG_ 389 ADC_ABPReq_B1 0;
BA_ "GatewayedSignals" SG_ 389 ADC_ABPReq_B1 0;
BA_ "GenSigInactiveValue" SG_ 389 ADC_ABPReq_B1 0;
BA_ "GenSigInvalidValue" SG_ 389 ADC_ABPReq_B1 0;
BA_ "GenSigSendType" SG_ 389 ADC_ABPReq_B1 1;
BA_ "GenSigStartValue" SG_ 389 ADC_ABPReq_B1 0;
BA_ "GenSigTimeoutValue" SG_ 389 ADC_ABPReq_B1 0;
BA_ "Remark" SG_ 389 ADC_ABPReq_B1 "";
BA_ "EventCommandSignal" SG_ 389 ADC_AWBLevel_B1 0;
BA_ "GatewayedSignals" SG_ 389 ADC_AWBLevel_B1 0;
BA_ "GenSigInactiveValue" SG_ 389 ADC_AWBLevel_B1 0;
BA_ "GenSigInvalidValue" SG_ 389 ADC_AWBLevel_B1 0;
BA_ "GenSigSendType" SG_ 389 ADC_AWBLevel_B1 1;
BA_ "GenSigStartValue" SG_ 389 ADC_AWBLevel_B1 0;
BA_ "GenSigTimeoutValue" SG_ 389 ADC_AWBLevel_B1 0;
BA_ "Remark" SG_ 389 ADC_AWBLevel_B1 "";
BA_ "EventCommandSignal" SG_ 389 ADC_AEBTarCalss_B1 0;
BA_ "GatewayedSignals" SG_ 389 ADC_AEBTarCalss_B1 0;
BA_ "GenSigInactiveValue" SG_ 389 ADC_AEBTarCalss_B1 0;
BA_ "GenSigInvalidValue" SG_ 389 ADC_AEBTarCalss_B1 0;
BA_ "GenSigSendType" SG_ 389 ADC_AEBTarCalss_B1 1;
BA_ "GenSigStartValue" SG_ 389 ADC_AEBTarCalss_B1 0;
BA_ "GenSigTimeoutValue" SG_ 389 ADC_AEBTarCalss_B1 0;
BA_ "Remark" SG_ 389 ADC_AEBTarCalss_B1 "";
BA_ "EventCommandSignal" SG_ 389 ADC_AEBTarDetSensor_B1 0;
BA_ "GatewayedSignals" SG_ 389 ADC_AEBTarDetSensor_B1 0;
BA_ "GenSigInactiveValue" SG_ 389 ADC_AEBTarDetSensor_B1 0;
BA_ "GenSigInvalidValue" SG_ 389 ADC_AEBTarDetSensor_B1 0;
BA_ "GenSigSendType" SG_ 389 ADC_AEBTarDetSensor_B1 1;
BA_ "GenSigStartValue" SG_ 389 ADC_AEBTarDetSensor_B1 0;
BA_ "GenSigTimeoutValue" SG_ 389 ADC_AEBTarDetSensor_B1 0;
BA_ "Remark" SG_ 389 ADC_AEBTarDetSensor_B1 "";
BA_ "EventCommandSignal" SG_ 389 ADC_TurnLightReq_B1 0;
BA_ "GatewayedSignals" SG_ 389 ADC_TurnLightReq_B1 0;
BA_ "GenSigInactiveValue" SG_ 389 ADC_TurnLightReq_B1 0;
BA_ "GenSigInvalidValue" SG_ 389 ADC_TurnLightReq_B1 0;
BA_ "GenSigSendType" SG_ 389 ADC_TurnLightReq_B1 1;
BA_ "GenSigStartValue" SG_ 389 ADC_TurnLightReq_B1 0;
BA_ "GenSigTimeoutValue" SG_ 389 ADC_TurnLightReq_B1 0;
BA_ "Remark" SG_ 389 ADC_TurnLightReq_B1 "";
BA_ "EventCommandSignal" SG_ 389 ADC_EpbModReq_B1 0;
BA_ "GatewayedSignals" SG_ 389 ADC_EpbModReq_B1 0;
BA_ "GenSigInactiveValue" SG_ 389 ADC_EpbModReq_B1 0;
BA_ "GenSigInvalidValue" SG_ 389 ADC_EpbModReq_B1 0;
BA_ "GenSigSendType" SG_ 389 ADC_EpbModReq_B1 1;
BA_ "GenSigStartValue" SG_ 389 ADC_EpbModReq_B1 0;
BA_ "GenSigTimeoutValue" SG_ 389 ADC_EpbModReq_B1 0;
BA_ "Remark" SG_ 389 ADC_EpbModReq_B1 "";
BA_ "EventCommandSignal" SG_ 389 ADS_VDCActvSt_B 0;
BA_ "GatewayedSignals" SG_ 389 ADS_VDCActvSt_B 0;
BA_ "GenSigInactiveValue" SG_ 389 ADS_VDCActvSt_B 0;
BA_ "GenSigInvalidValue" SG_ 389 ADS_VDCActvSt_B 0;
BA_ "GenSigSendType" SG_ 389 ADS_VDCActvSt_B 1;
BA_ "GenSigStartValue" SG_ 389 ADS_VDCActvSt_B 0;
BA_ "GenSigTimeoutValue" SG_ 389 ADS_VDCActvSt_B 0;
BA_ "Remark" SG_ 389 ADS_VDCActvSt_B "";
BA_ "EventCommandSignal" SG_ 389 ADS_TCSActvSt_B 0;
BA_ "GatewayedSignals" SG_ 389 ADS_TCSActvSt_B 0;
BA_ "GenSigInactiveValue" SG_ 389 ADS_TCSActvSt_B 0;
BA_ "GenSigInvalidValue" SG_ 389 ADS_TCSActvSt_B 0;
BA_ "GenSigSendType" SG_ 389 ADS_TCSActvSt_B 1;
BA_ "GenSigStartValue" SG_ 389 ADS_TCSActvSt_B 0;
BA_ "GenSigTimeoutValue" SG_ 389 ADS_TCSActvSt_B 0;
BA_ "Remark" SG_ 389 ADS_TCSActvSt_B "";
BA_ "EventCommandSignal" SG_ 389 ADS_DTCActvSt_B 0;
BA_ "GatewayedSignals" SG_ 389 ADS_DTCActvSt_B 0;
BA_ "GenSigInactiveValue" SG_ 389 ADS_DTCActvSt_B 0;
BA_ "GenSigInvalidValue" SG_ 389 ADS_DTCActvSt_B 0;
BA_ "GenSigSendType" SG_ 389 ADS_DTCActvSt_B 1;
BA_ "GenSigStartValue" SG_ 389 ADS_DTCActvSt_B 0;
BA_ "GenSigTimeoutValue" SG_ 389 ADS_DTCActvSt_B 0;
BA_ "Remark" SG_ 389 ADS_DTCActvSt_B "";
BA_ "EventCommandSignal" SG_ 389 ADC_EpbModReqEna_B1 0;
BA_ "GatewayedSignals" SG_ 389 ADC_EpbModReqEna_B1 0;
BA_ "GenSigInactiveValue" SG_ 389 ADC_EpbModReqEna_B1 0;
BA_ "GenSigInvalidValue" SG_ 389 ADC_EpbModReqEna_B1 0;
BA_ "GenSigSendType" SG_ 389 ADC_EpbModReqEna_B1 1;
BA_ "GenSigStartValue" SG_ 389 ADC_EpbModReqEna_B1 0;
BA_ "GenSigTimeoutValue" SG_ 389 ADC_EpbModReqEna_B1 0;
BA_ "Remark" SG_ 389 ADC_EpbModReqEna_B1 "";
BA_ "EventCommandSignal" SG_ 389 ADC_AEBObjectTTC_B1 0;
BA_ "GatewayedSignals" SG_ 389 ADC_AEBObjectTTC_B1 0;
BA_ "GenSigInactiveValue" SG_ 389 ADC_AEBObjectTTC_B1 0;
BA_ "GenSigInvalidValue" SG_ 389 ADC_AEBObjectTTC_B1 0;
BA_ "GenSigSendType" SG_ 389 ADC_AEBObjectTTC_B1 1;
BA_ "GenSigStartValue" SG_ 389 ADC_AEBObjectTTC_B1 501;
BA_ "GenSigTimeoutValue" SG_ 389 ADC_AEBObjectTTC_B1 510;
BA_ "Remark" SG_ 389 ADC_AEBObjectTTC_B1 "";
BA_ "EventCommandSignal" SG_ 389 ADC_AEBObjRelativeSpd_B1 0;
BA_ "GatewayedSignals" SG_ 389 ADC_AEBObjRelativeSpd_B1 0;
BA_ "GenSigInactiveValue" SG_ 389 ADC_AEBObjRelativeSpd_B1 0;
BA_ "GenSigInvalidValue" SG_ 389 ADC_AEBObjRelativeSpd_B1 0;
BA_ "GenSigSendType" SG_ 389 ADC_AEBObjRelativeSpd_B1 1;
BA_ "GenSigStartValue" SG_ 389 ADC_AEBObjRelativeSpd_B1 0;
BA_ "GenSigTimeoutValue" SG_ 389 ADC_AEBObjRelativeSpd_B1 510;
BA_ "Remark" SG_ 389 ADC_AEBObjRelativeSpd_B1 "";
BA_ "EventCommandSignal" SG_ 389 ADC_PAAPwrModeReq_B1 0;
BA_ "GatewayedSignals" SG_ 389 ADC_PAAPwrModeReq_B1 0;
BA_ "GenSigInactiveValue" SG_ 389 ADC_PAAPwrModeReq_B1 0;
BA_ "GenSigInvalidValue" SG_ 389 ADC_PAAPwrModeReq_B1 0;
BA_ "GenSigSendType" SG_ 389 ADC_PAAPwrModeReq_B1 1;
BA_ "GenSigStartValue" SG_ 389 ADC_PAAPwrModeReq_B1 0;
BA_ "GenSigTimeoutValue" SG_ 389 ADC_PAAPwrModeReq_B1 0;
BA_ "Remark" SG_ 389 ADC_PAAPwrModeReq_B1 "";
BA_ "EventCommandSignal" SG_ 389 ADC_PAAGrarLvlReq_B1 0;
BA_ "GatewayedSignals" SG_ 389 ADC_PAAGrarLvlReq_B1 0;
BA_ "GenSigInactiveValue" SG_ 389 ADC_PAAGrarLvlReq_B1 0;
BA_ "GenSigInvalidValue" SG_ 389 ADC_PAAGrarLvlReq_B1 0;
BA_ "GenSigSendType" SG_ 389 ADC_PAAGrarLvlReq_B1 1;
BA_ "GenSigStartValue" SG_ 389 ADC_PAAGrarLvlReq_B1 0;
BA_ "GenSigTimeoutValue" SG_ 389 ADC_PAAGrarLvlReq_B1 0;
BA_ "Remark" SG_ 389 ADC_PAAGrarLvlReq_B1 "";
BA_ "EventCommandSignal" SG_ 389 ADC_PAAGrarLvlReqEnable_B1 0;
BA_ "GatewayedSignals" SG_ 389 ADC_PAAGrarLvlReqEnable_B1 0;
BA_ "GenSigInactiveValue" SG_ 389 ADC_PAAGrarLvlReqEnable_B1 0;
BA_ "GenSigInvalidValue" SG_ 389 ADC_PAAGrarLvlReqEnable_B1 0;
BA_ "GenSigSendType" SG_ 389 ADC_PAAGrarLvlReqEnable_B1 1;
BA_ "GenSigStartValue" SG_ 389 ADC_PAAGrarLvlReqEnable_B1 0;
BA_ "GenSigTimeoutValue" SG_ 389 ADC_PAAGrarLvlReqEnable_B1 0;
BA_ "Remark" SG_ 389 ADC_PAAGrarLvlReqEnable_B1 "";
BA_ "EventCommandSignal" SG_ 389 ADC_ActTrqReqVD_B1 0;
BA_ "GatewayedSignals" SG_ 389 ADC_ActTrqReqVD_B1 0;
BA_ "GenSigInactiveValue" SG_ 389 ADC_ActTrqReqVD_B1 0;
BA_ "GenSigInvalidValue" SG_ 389 ADC_ActTrqReqVD_B1 0;
BA_ "GenSigSendType" SG_ 389 ADC_ActTrqReqVD_B1 1;
BA_ "GenSigStartValue" SG_ 389 ADC_ActTrqReqVD_B1 0;
BA_ "GenSigTimeoutValue" SG_ 389 ADC_ActTrqReqVD_B1 0;
BA_ "Remark" SG_ 389 ADC_ActTrqReqVD_B1 "";
BA_ "EventCommandSignal" SG_ 389 ADC_BrkTarTqEna_B1 0;
BA_ "GatewayedSignals" SG_ 389 ADC_BrkTarTqEna_B1 0;
BA_ "GenSigInactiveValue" SG_ 389 ADC_BrkTarTqEna_B1 0;
BA_ "GenSigInvalidValue" SG_ 389 ADC_BrkTarTqEna_B1 0;
BA_ "GenSigSendType" SG_ 389 ADC_BrkTarTqEna_B1 1;
BA_ "GenSigStartValue" SG_ 389 ADC_BrkTarTqEna_B1 0;
BA_ "GenSigTimeoutValue" SG_ 389 ADC_BrkTarTqEna_B1 0;
BA_ "Remark" SG_ 389 ADC_BrkTarTqEna_B1 "";
BA_ "EventCommandSignal" SG_ 389 ADC_BrkTarTqMod_B1 0;
BA_ "GatewayedSignals" SG_ 389 ADC_BrkTarTqMod_B1 0;
BA_ "GenSigInactiveValue" SG_ 389 ADC_BrkTarTqMod_B1 0;
BA_ "GenSigInvalidValue" SG_ 389 ADC_BrkTarTqMod_B1 0;
BA_ "GenSigSendType" SG_ 389 ADC_BrkTarTqMod_B1 1;
BA_ "GenSigStartValue" SG_ 389 ADC_BrkTarTqMod_B1 0;
BA_ "GenSigTimeoutValue" SG_ 389 ADC_BrkTarTqMod_B1 0;
BA_ "Remark" SG_ 389 ADC_BrkTarTqMod_B1 "";
BA_ "EventCommandSignal" SG_ 389 ADC_AebBrkTarTq_B1 0;
BA_ "GatewayedSignals" SG_ 389 ADC_AebBrkTarTq_B1 0;
BA_ "GenSigInactiveValue" SG_ 389 ADC_AebBrkTarTq_B1 0;
BA_ "GenSigInvalidValue" SG_ 389 ADC_AebBrkTarTq_B1 0;
BA_ "GenSigSendType" SG_ 389 ADC_AebBrkTarTq_B1 1;
BA_ "GenSigStartValue" SG_ 389 ADC_AebBrkTarTq_B1 0;
BA_ "GenSigTimeoutValue" SG_ 389 ADC_AebBrkTarTq_B1 0;
BA_ "Remark" SG_ 389 ADC_AebBrkTarTq_B1 "";
BA_ "EventCommandSignal" SG_ 389 ADC_EpbModReqVld_B1 0;
BA_ "GatewayedSignals" SG_ 389 ADC_EpbModReqVld_B1 0;
BA_ "GenSigInactiveValue" SG_ 389 ADC_EpbModReqVld_B1 0;
BA_ "GenSigInvalidValue" SG_ 389 ADC_EpbModReqVld_B1 0;
BA_ "GenSigSendType" SG_ 389 ADC_EpbModReqVld_B1 1;
BA_ "GenSigStartValue" SG_ 389 ADC_EpbModReqVld_B1 0;
BA_ "GenSigTimeoutValue" SG_ 389 ADC_EpbModReqVld_B1 0;
BA_ "Remark" SG_ 389 ADC_EpbModReqVld_B1 "";
BA_ "EventCommandSignal" SG_ 389 ADC_RWUEna_B1 0;
BA_ "GatewayedSignals" SG_ 389 ADC_RWUEna_B1 0;
BA_ "GenSigInactiveValue" SG_ 389 ADC_RWUEna_B1 0;
BA_ "GenSigInvalidValue" SG_ 389 ADC_RWUEna_B1 0;
BA_ "GenSigSendType" SG_ 389 ADC_RWUEna_B1 1;
BA_ "GenSigStartValue" SG_ 389 ADC_RWUEna_B1 0;
BA_ "GenSigTimeoutValue" SG_ 389 ADC_RWUEna_B1 0;
BA_ "Remark" SG_ 389 ADC_RWUEna_B1 "";
BA_ "EventCommandSignal" SG_ 389 ADC_BrkHoldReq_B1 0;
BA_ "GatewayedSignals" SG_ 389 ADC_BrkHoldReq_B1 0;
BA_ "GenSigInactiveValue" SG_ 389 ADC_BrkHoldReq_B1 0;
BA_ "GenSigInvalidValue" SG_ 389 ADC_BrkHoldReq_B1 0;
BA_ "GenSigSendType" SG_ 389 ADC_BrkHoldReq_B1 1;
BA_ "GenSigStartValue" SG_ 389 ADC_BrkHoldReq_B1 0;
BA_ "GenSigTimeoutValue" SG_ 389 ADC_BrkHoldReq_B1 0;
BA_ "Remark" SG_ 389 ADC_BrkHoldReq_B1 "";
BA_ "EventCommandSignal" SG_ 389 ADC_AngReqAvl_B1 0;
BA_ "GatewayedSignals" SG_ 389 ADC_AngReqAvl_B1 0;
BA_ "GenSigInactiveValue" SG_ 389 ADC_AngReqAvl_B1 0;
BA_ "GenSigInvalidValue" SG_ 389 ADC_AngReqAvl_B1 0;
BA_ "GenSigSendType" SG_ 389 ADC_AngReqAvl_B1 1;
BA_ "GenSigStartValue" SG_ 389 ADC_AngReqAvl_B1 0;
BA_ "GenSigTimeoutValue" SG_ 389 ADC_AngReqAvl_B1 0;
BA_ "Remark" SG_ 389 ADC_AngReqAvl_B1 "";
BA_ "EventCommandSignal" SG_ 389 ADC_TarGearReqVld_B1 0;
BA_ "GatewayedSignals" SG_ 389 ADC_TarGearReqVld_B1 0;
BA_ "GenSigInactiveValue" SG_ 389 ADC_TarGearReqVld_B1 0;
BA_ "GenSigInvalidValue" SG_ 389 ADC_TarGearReqVld_B1 0;
BA_ "GenSigSendType" SG_ 389 ADC_TarGearReqVld_B1 1;
BA_ "GenSigStartValue" SG_ 389 ADC_TarGearReqVld_B1 0;
BA_ "GenSigTimeoutValue" SG_ 389 ADC_TarGearReqVld_B1 0;
BA_ "Remark" SG_ 389 ADC_TarGearReqVld_B1 "";
BA_ "EventCommandSignal" SG_ 389 ADC_FctSts_B1 0;
BA_ "GatewayedSignals" SG_ 389 ADC_FctSts_B1 0;
BA_ "GenSigInactiveValue" SG_ 389 ADC_FctSts_B1 0;
BA_ "GenSigInvalidValue" SG_ 389 ADC_FctSts_B1 0;
BA_ "GenSigSendType" SG_ 389 ADC_FctSts_B1 1;
BA_ "GenSigStartValue" SG_ 389 ADC_FctSts_B1 0;
BA_ "GenSigTimeoutValue" SG_ 389 ADC_FctSts_B1 0;
BA_ "Remark" SG_ 389 ADC_FctSts_B1 "";
BA_ "EventCommandSignal" SG_ 389 ADC_BrkTarTqVld_B1 0;
BA_ "GatewayedSignals" SG_ 389 ADC_BrkTarTqVld_B1 0;
BA_ "GenSigInactiveValue" SG_ 389 ADC_BrkTarTqVld_B1 0;
BA_ "GenSigInvalidValue" SG_ 389 ADC_BrkTarTqVld_B1 0;
BA_ "GenSigSendType" SG_ 389 ADC_BrkTarTqVld_B1 1;
BA_ "GenSigStartValue" SG_ 389 ADC_BrkTarTqVld_B1 0;
BA_ "GenSigTimeoutValue" SG_ 389 ADC_BrkTarTqVld_B1 0;
BA_ "Remark" SG_ 389 ADC_BrkTarTqVld_B1 "";
BA_ "EventCommandSignal" SG_ 389 ADC_AebBrkTarTqVld_B1 0;
BA_ "GatewayedSignals" SG_ 389 ADC_AebBrkTarTqVld_B1 0;
BA_ "GenSigInactiveValue" SG_ 389 ADC_AebBrkTarTqVld_B1 0;
BA_ "GenSigInvalidValue" SG_ 389 ADC_AebBrkTarTqVld_B1 0;
BA_ "GenSigSendType" SG_ 389 ADC_AebBrkTarTqVld_B1 1;
BA_ "GenSigStartValue" SG_ 389 ADC_AebBrkTarTqVld_B1 0;
BA_ "GenSigTimeoutValue" SG_ 389 ADC_AebBrkTarTqVld_B1 0;
BA_ "Remark" SG_ 389 ADC_AebBrkTarTqVld_B1 "";
BA_ "EventCommandSignal" SG_ 389 ADC_AebBrkTarTqEna_B1 0;
BA_ "GatewayedSignals" SG_ 389 ADC_AebBrkTarTqEna_B1 0;
BA_ "GenSigInactiveValue" SG_ 389 ADC_AebBrkTarTqEna_B1 0;
BA_ "GenSigInvalidValue" SG_ 389 ADC_AebBrkTarTqEna_B1 0;
BA_ "GenSigSendType" SG_ 389 ADC_AebBrkTarTqEna_B1 1;
BA_ "GenSigStartValue" SG_ 389 ADC_AebBrkTarTqEna_B1 0;
BA_ "GenSigTimeoutValue" SG_ 389 ADC_AebBrkTarTqEna_B1 0;
BA_ "Remark" SG_ 389 ADC_AebBrkTarTqEna_B1 "";
BA_ "EventCommandSignal" SG_ 389 ADC_ElecBrkFnSwitch_B1 0;
BA_ "GatewayedSignals" SG_ 389 ADC_ElecBrkFnSwitch_B1 0;
BA_ "GenSigInactiveValue" SG_ 389 ADC_ElecBrkFnSwitch_B1 0;
BA_ "GenSigInvalidValue" SG_ 389 ADC_ElecBrkFnSwitch_B1 0;
BA_ "GenSigSendType" SG_ 389 ADC_ElecBrkFnSwitch_B1 1;
BA_ "GenSigStartValue" SG_ 389 ADC_ElecBrkFnSwitch_B1 0;
BA_ "GenSigTimeoutValue" SG_ 389 ADC_ElecBrkFnSwitch_B1 0;
BA_ "Remark" SG_ 389 ADC_ElecBrkFnSwitch_B1 "";
BA_ "EventCommandSignal" SG_ 389 ADC_RedundantSwt_B1 0;
BA_ "GatewayedSignals" SG_ 389 ADC_RedundantSwt_B1 0;
BA_ "GenSigInactiveValue" SG_ 389 ADC_RedundantSwt_B1 0;
BA_ "GenSigInvalidValue" SG_ 389 ADC_RedundantSwt_B1 0;
BA_ "GenSigSendType" SG_ 389 ADC_RedundantSwt_B1 1;
BA_ "GenSigStartValue" SG_ 389 ADC_RedundantSwt_B1 0;
BA_ "GenSigTimeoutValue" SG_ 389 ADC_RedundantSwt_B1 0;
BA_ "Remark" SG_ 389 ADC_RedundantSwt_B1 "";
BA_ "EventCommandSignal" SG_ 389 ADC_ImmediateStopEna_B1 0;
BA_ "GatewayedSignals" SG_ 389 ADC_ImmediateStopEna_B1 0;
BA_ "GenSigInactiveValue" SG_ 389 ADC_ImmediateStopEna_B1 0;
BA_ "GenSigInvalidValue" SG_ 389 ADC_ImmediateStopEna_B1 0;
BA_ "GenSigSendType" SG_ 389 ADC_ImmediateStopEna_B1 1;
BA_ "GenSigStartValue" SG_ 389 ADC_ImmediateStopEna_B1 0;
BA_ "GenSigTimeoutValue" SG_ 389 ADC_ImmediateStopEna_B1 0;
BA_ "Remark" SG_ 389 ADC_ImmediateStopEna_B1 "";
BA_ "EventCommandSignal" SG_ 389 ADC_RWUVld_B1 0;
BA_ "GatewayedSignals" SG_ 389 ADC_RWUVld_B1 0;
BA_ "GenSigInactiveValue" SG_ 389 ADC_RWUVld_B1 0;
BA_ "GenSigInvalidValue" SG_ 389 ADC_RWUVld_B1 0;
BA_ "GenSigSendType" SG_ 389 ADC_RWUVld_B1 1;
BA_ "GenSigStartValue" SG_ 389 ADC_RWUVld_B1 0;
BA_ "GenSigTimeoutValue" SG_ 389 ADC_RWUVld_B1 0;
BA_ "Remark" SG_ 389 ADC_RWUVld_B1 "";
BA_ "EventCommandSignal" SG_ 389 ADC_DriverPresent_B1 0;
BA_ "GatewayedSignals" SG_ 389 ADC_DriverPresent_B1 0;
BA_ "GenSigInactiveValue" SG_ 389 ADC_DriverPresent_B1 0;
BA_ "GenSigInvalidValue" SG_ 389 ADC_DriverPresent_B1 0;
BA_ "GenSigSendType" SG_ 389 ADC_DriverPresent_B1 1;
BA_ "GenSigStartValue" SG_ 389 ADC_DriverPresent_B1 0;
BA_ "GenSigTimeoutValue" SG_ 389 ADC_DriverPresent_B1 0;
BA_ "Remark" SG_ 389 ADC_DriverPresent_B1 "";
BA_ "EventCommandSignal" SG_ 389 ADC_AD_NetMode_B 0;
BA_ "GatewayedSignals" SG_ 389 ADC_AD_NetMode_B 0;
BA_ "GenSigInactiveValue" SG_ 389 ADC_AD_NetMode_B 0;
BA_ "GenSigInvalidValue" SG_ 389 ADC_AD_NetMode_B 0;
BA_ "GenSigSendType" SG_ 389 ADC_AD_NetMode_B 1;
BA_ "GenSigStartValue" SG_ 389 ADC_AD_NetMode_B 0;
BA_ "GenSigTimeoutValue" SG_ 389 ADC_AD_NetMode_B 0;
BA_ "Remark" SG_ 389 ADC_AD_NetMode_B "";
BA_ "EventCommandSignal" SG_ 389 ADC_ChrgPwrMode_B 0;
BA_ "GatewayedSignals" SG_ 389 ADC_ChrgPwrMode_B 0;
BA_ "GenSigInactiveValue" SG_ 389 ADC_ChrgPwrMode_B 0;
BA_ "GenSigInvalidValue" SG_ 389 ADC_ChrgPwrMode_B 0;
BA_ "GenSigSendType" SG_ 389 ADC_ChrgPwrMode_B 1;
BA_ "GenSigStartValue" SG_ 389 ADC_ChrgPwrMode_B 0;
BA_ "GenSigTimeoutValue" SG_ 389 ADC_ChrgPwrMode_B 0;
BA_ "Remark" SG_ 389 ADC_ChrgPwrMode_B "";
BA_ "EventCommandSignal" SG_ 389 ADC_FcsActiveStatus_B 0;
BA_ "GatewayedSignals" SG_ 389 ADC_FcsActiveStatus_B 0;
BA_ "GenSigInactiveValue" SG_ 389 ADC_FcsActiveStatus_B 0;
BA_ "GenSigInvalidValue" SG_ 389 ADC_FcsActiveStatus_B 0;
BA_ "GenSigSendType" SG_ 389 ADC_FcsActiveStatus_B 1;
BA_ "GenSigStartValue" SG_ 389 ADC_FcsActiveStatus_B 0;
BA_ "GenSigTimeoutValue" SG_ 389 ADC_FcsActiveStatus_B 0;
BA_ "Remark" SG_ 389 ADC_FcsActiveStatus_B "";
BA_ "EventCommandSignal" SG_ 389 ADC_DriverSeatBeltPretightenReq_B 0;
BA_ "GatewayedSignals" SG_ 389 ADC_DriverSeatBeltPretightenReq_B 0;
BA_ "GenSigInactiveValue" SG_ 389 ADC_DriverSeatBeltPretightenReq_B 0;
BA_ "GenSigInvalidValue" SG_ 389 ADC_DriverSeatBeltPretightenReq_B 0;
BA_ "GenSigSendType" SG_ 389 ADC_DriverSeatBeltPretightenReq_B 1;
BA_ "GenSigStartValue" SG_ 389 ADC_DriverSeatBeltPretightenReq_B 0;
BA_ "GenSigTimeoutValue" SG_ 389 ADC_DriverSeatBeltPretightenReq_B 0;
BA_ "Remark" SG_ 389 ADC_DriverSeatBeltPretightenReq_B "";
BA_ "EventCommandSignal" SG_ 389 ADC_SteerVibrAvl_B 0;
BA_ "GatewayedSignals" SG_ 389 ADC_SteerVibrAvl_B 0;
BA_ "GenSigInactiveValue" SG_ 389 ADC_SteerVibrAvl_B 0;
BA_ "GenSigInvalidValue" SG_ 389 ADC_SteerVibrAvl_B 0;
BA_ "GenSigSendType" SG_ 389 ADC_SteerVibrAvl_B 1;
BA_ "GenSigStartValue" SG_ 389 ADC_SteerVibrAvl_B 0;
BA_ "GenSigTimeoutValue" SG_ 389 ADC_SteerVibrAvl_B 0;
BA_ "Remark" SG_ 389 ADC_SteerVibrAvl_B "";
BA_ "EventCommandSignal" SG_ 389 ADC_VehSpd_B 0;
BA_ "GatewayedSignals" SG_ 389 ADC_VehSpd_B 0;
BA_ "GenSigInactiveValue" SG_ 389 ADC_VehSpd_B 0;
BA_ "GenSigInvalidValue" SG_ 389 ADC_VehSpd_B 0;
BA_ "GenSigSendType" SG_ 389 ADC_VehSpd_B 1;
BA_ "GenSigStartValue" SG_ 389 ADC_VehSpd_B 0;
BA_ "GenSigTimeoutValue" SG_ 389 ADC_VehSpd_B 0;
BA_ "Remark" SG_ 389 ADC_VehSpd_B "";
BA_ "EventCommandSignal" SG_ 389 ADC_VehSpdVD_B 0;
BA_ "GatewayedSignals" SG_ 389 ADC_VehSpdVD_B 0;
BA_ "GenSigInactiveValue" SG_ 389 ADC_VehSpdVD_B 0;
BA_ "GenSigInvalidValue" SG_ 389 ADC_VehSpdVD_B 0;
BA_ "GenSigSendType" SG_ 389 ADC_VehSpdVD_B 1;
BA_ "GenSigStartValue" SG_ 389 ADC_VehSpdVD_B 0;
BA_ "GenSigTimeoutValue" SG_ 389 ADC_VehSpdVD_B 0;
BA_ "Remark" SG_ 389 ADC_VehSpdVD_B "";
BA_ "EventCommandSignal" SG_ 389 ADC_RasAngReqAvl_B1 0;
BA_ "GatewayedSignals" SG_ 389 ADC_RasAngReqAvl_B1 0;
BA_ "GenSigInactiveValue" SG_ 389 ADC_RasAngReqAvl_B1 0;
BA_ "GenSigInvalidValue" SG_ 389 ADC_RasAngReqAvl_B1 0;
BA_ "GenSigSendType" SG_ 389 ADC_RasAngReqAvl_B1 1;
BA_ "GenSigStartValue" SG_ 389 ADC_RasAngReqAvl_B1 0;
BA_ "GenSigTimeoutValue" SG_ 389 ADC_RasAngReqAvl_B1 0;
BA_ "Remark" SG_ 389 ADC_RasAngReqAvl_B1 "";
BA_ "EventCommandSignal" SG_ 389 ADC_RasAngReqSt_A_B1 0;
BA_ "GatewayedSignals" SG_ 389 ADC_RasAngReqSt_A_B1 0;
BA_ "GenSigInactiveValue" SG_ 389 ADC_RasAngReqSt_A_B1 0;
BA_ "GenSigInvalidValue" SG_ 389 ADC_RasAngReqSt_A_B1 0;
BA_ "GenSigSendType" SG_ 389 ADC_RasAngReqSt_A_B1 1;
BA_ "GenSigStartValue" SG_ 389 ADC_RasAngReqSt_A_B1 0;
BA_ "GenSigTimeoutValue" SG_ 389 ADC_RasAngReqSt_A_B1 0;
BA_ "Remark" SG_ 389 ADC_RasAngReqSt_A_B1 "";
BA_ "EventCommandSignal" SG_ 389 ADC_RasModReq_B1 0;
BA_ "GatewayedSignals" SG_ 389 ADC_RasModReq_B1 0;
BA_ "GenSigInactiveValue" SG_ 389 ADC_RasModReq_B1 0;
BA_ "GenSigInvalidValue" SG_ 389 ADC_RasModReq_B1 0;
BA_ "GenSigSendType" SG_ 389 ADC_RasModReq_B1 1;
BA_ "GenSigStartValue" SG_ 389 ADC_RasModReq_B1 0;
BA_ "GenSigTimeoutValue" SG_ 389 ADC_RasModReq_B1 0;
BA_ "Remark" SG_ 389 ADC_RasModReq_B1 "";
BA_ "EventCommandSignal" SG_ 389 ADC_RasAngleReq_A_B1 0;
BA_ "GatewayedSignals" SG_ 389 ADC_RasAngleReq_A_B1 0;
BA_ "GenSigInactiveValue" SG_ 389 ADC_RasAngleReq_A_B1 0;
BA_ "GenSigInvalidValue" SG_ 389 ADC_RasAngleReq_A_B1 4095;
BA_ "GenSigSendType" SG_ 389 ADC_RasAngleReq_A_B1 1;
BA_ "GenSigStartValue" SG_ 389 ADC_RasAngleReq_A_B1 2048;
BA_ "GenSigTimeoutValue" SG_ 389 ADC_RasAngleReq_A_B1 4095;
BA_ "Remark" SG_ 389 ADC_RasAngleReq_A_B1 "";
BA_ "EventCommandSignal" SG_ 389 ADC_DriverSeatBeltVibrWarnReq_B 0;
BA_ "GatewayedSignals" SG_ 389 ADC_DriverSeatBeltVibrWarnReq_B 0;
BA_ "GenSigInactiveValue" SG_ 389 ADC_DriverSeatBeltVibrWarnReq_B 0;
BA_ "GenSigInvalidValue" SG_ 389 ADC_DriverSeatBeltVibrWarnReq_B 0;
BA_ "GenSigSendType" SG_ 389 ADC_DriverSeatBeltVibrWarnReq_B 0;
BA_ "GenSigStartValue" SG_ 389 ADC_DriverSeatBeltVibrWarnReq_B 0;
BA_ "GenSigTimeoutValue" SG_ 389 ADC_DriverSeatBeltVibrWarnReq_B 0;
BA_ "Remark" SG_ 389 ADC_DriverSeatBeltVibrWarnReq_B "";
BA_ "EventCommandSignal" SG_ 389 ADC_TotalRefTorque 0;
BA_ "GatewayedSignals" SG_ 389 ADC_TotalRefTorque 0;
BA_ "GenSigInactiveValue" SG_ 389 ADC_TotalRefTorque 0;
BA_ "GenSigInvalidValue" SG_ 389 ADC_TotalRefTorque 0;
BA_ "GenSigSendType" SG_ 389 ADC_TotalRefTorque 1;
BA_ "GenSigStartValue" SG_ 389 ADC_TotalRefTorque 0;
BA_ "GenSigTimeoutValue" SG_ 389 ADC_TotalRefTorque 0;
BA_ "Remark" SG_ 389 ADC_TotalRefTorque "";
BA_ "EventCommandSignal" SG_ 389 ADC_MotTarSpd 0;
BA_ "GatewayedSignals" SG_ 389 ADC_MotTarSpd 0;
BA_ "GenSigInactiveValue" SG_ 389 ADC_MotTarSpd 0;
BA_ "GenSigInvalidValue" SG_ 389 ADC_MotTarSpd 0;
BA_ "GenSigSendType" SG_ 389 ADC_MotTarSpd 1;
BA_ "GenSigStartValue" SG_ 389 ADC_MotTarSpd 0;
BA_ "GenSigTimeoutValue" SG_ 389 ADC_MotTarSpd 0;
BA_ "Remark" SG_ 389 ADC_MotTarSpd "";
BA_ "EventCommandSignal" SG_ 389 ADC_LimTqFactorK 0;
BA_ "GatewayedSignals" SG_ 389 ADC_LimTqFactorK 0;
BA_ "GenSigInactiveValue" SG_ 389 ADC_LimTqFactorK 0;
BA_ "GenSigInvalidValue" SG_ 389 ADC_LimTqFactorK 0;
BA_ "GenSigSendType" SG_ 389 ADC_LimTqFactorK 1;
BA_ "GenSigStartValue" SG_ 389 ADC_LimTqFactorK 0;
BA_ "GenSigTimeoutValue" SG_ 389 ADC_LimTqFactorK 0;
BA_ "Remark" SG_ 389 ADC_LimTqFactorK "";
BA_ "EventCommandSignal" SG_ 389 ADC_MotTqLimMin 0;
BA_ "GatewayedSignals" SG_ 389 ADC_MotTqLimMin 0;
BA_ "GenSigInactiveValue" SG_ 389 ADC_MotTqLimMin 0;
BA_ "GenSigInvalidValue" SG_ 389 ADC_MotTqLimMin 0;
BA_ "GenSigSendType" SG_ 389 ADC_MotTqLimMin 1;
BA_ "GenSigStartValue" SG_ 389 ADC_MotTqLimMin 0;
BA_ "GenSigTimeoutValue" SG_ 389 ADC_MotTqLimMin 0;
BA_ "Remark" SG_ 389 ADC_MotTqLimMin "";
BA_ "EventCommandSignal" SG_ 389 ADC_MotTqLimMax 0;
BA_ "GatewayedSignals" SG_ 389 ADC_MotTqLimMax 0;
BA_ "GenSigInactiveValue" SG_ 389 ADC_MotTqLimMax 0;
BA_ "GenSigInvalidValue" SG_ 389 ADC_MotTqLimMax 0;
BA_ "GenSigSendType" SG_ 389 ADC_MotTqLimMax 1;
BA_ "GenSigStartValue" SG_ 389 ADC_MotTqLimMax 0;
BA_ "GenSigTimeoutValue" SG_ 389 ADC_MotTqLimMax 0;
BA_ "Remark" SG_ 389 ADC_MotTqLimMax "";
BA_ "EventCommandSignal" SG_ 389 ADC_MotTqRateLimMin 0;
BA_ "GatewayedSignals" SG_ 389 ADC_MotTqRateLimMin 0;
BA_ "GenSigInactiveValue" SG_ 389 ADC_MotTqRateLimMin 0;
BA_ "GenSigInvalidValue" SG_ 389 ADC_MotTqRateLimMin 0;
BA_ "GenSigSendType" SG_ 389 ADC_MotTqRateLimMin 1;
BA_ "GenSigStartValue" SG_ 389 ADC_MotTqRateLimMin 0;
BA_ "GenSigTimeoutValue" SG_ 389 ADC_MotTqRateLimMin 0;
BA_ "Remark" SG_ 389 ADC_MotTqRateLimMin "";
BA_ "EventCommandSignal" SG_ 389 ADC_MotTqRateLimMax 0;
BA_ "GatewayedSignals" SG_ 389 ADC_MotTqRateLimMax 0;
BA_ "GenSigInactiveValue" SG_ 389 ADC_MotTqRateLimMax 0;
BA_ "GenSigInvalidValue" SG_ 389 ADC_MotTqRateLimMax 0;
BA_ "GenSigSendType" SG_ 389 ADC_MotTqRateLimMax 1;
BA_ "GenSigStartValue" SG_ 389 ADC_MotTqRateLimMax 0;
BA_ "GenSigTimeoutValue" SG_ 389 ADC_MotTqRateLimMax 0;
BA_ "Remark" SG_ 389 ADC_MotTqRateLimMax "";
BA_ "EventCommandSignal" SG_ 389 ADC_TqUnloadRate 0;
BA_ "GatewayedSignals" SG_ 389 ADC_TqUnloadRate 0;
BA_ "GenSigInactiveValue" SG_ 389 ADC_TqUnloadRate 0;
BA_ "GenSigInvalidValue" SG_ 389 ADC_TqUnloadRate 0;
BA_ "GenSigSendType" SG_ 389 ADC_TqUnloadRate 1;
BA_ "GenSigStartValue" SG_ 389 ADC_TqUnloadRate 0;
BA_ "GenSigTimeoutValue" SG_ 389 ADC_TqUnloadRate 0;
BA_ "Remark" SG_ 389 ADC_TqUnloadRate "";
BA_ "EventCommandSignal" SG_ 389 ADC_MotCtrlTar 0;
BA_ "GatewayedSignals" SG_ 389 ADC_MotCtrlTar 0;
BA_ "GenSigInactiveValue" SG_ 389 ADC_MotCtrlTar 0;
BA_ "GenSigInvalidValue" SG_ 389 ADC_MotCtrlTar 0;
BA_ "GenSigSendType" SG_ 389 ADC_MotCtrlTar 1;
BA_ "GenSigStartValue" SG_ 389 ADC_MotCtrlTar 0;
BA_ "GenSigTimeoutValue" SG_ 389 ADC_MotCtrlTar 0;
BA_ "Remark" SG_ 389 ADC_MotCtrlTar "";
BA_ "EventCommandSignal" SG_ 389 ADC_MotTarMod 0;
BA_ "GatewayedSignals" SG_ 389 ADC_MotTarMod 0;
BA_ "GenSigInactiveValue" SG_ 389 ADC_MotTarMod 0;
BA_ "GenSigInvalidValue" SG_ 389 ADC_MotTarMod 0;
BA_ "GenSigSendType" SG_ 389 ADC_MotTarMod 1;
BA_ "GenSigStartValue" SG_ 389 ADC_MotTarMod 0;
BA_ "GenSigTimeoutValue" SG_ 389 ADC_MotTarMod 0;
BA_ "Remark" SG_ 389 ADC_MotTarMod "";
BA_ "EventCommandSignal" SG_ 389 ADC_DrvTarTqMod 0;
BA_ "GatewayedSignals" SG_ 389 ADC_DrvTarTqMod 0;
BA_ "GenSigInactiveValue" SG_ 389 ADC_DrvTarTqMod 0;
BA_ "GenSigInvalidValue" SG_ 389 ADC_DrvTarTqMod 0;
BA_ "GenSigSendType" SG_ 389 ADC_DrvTarTqMod 1;
BA_ "GenSigStartValue" SG_ 389 ADC_DrvTarTqMod 0;
BA_ "GenSigTimeoutValue" SG_ 389 ADC_DrvTarTqMod 0;
BA_ "Remark" SG_ 389 ADC_DrvTarTqMod "";
BA_ "EventCommandSignal" SG_ 389 ADC_RapidRespEna 0;
BA_ "GatewayedSignals" SG_ 389 ADC_RapidRespEna 0;
BA_ "GenSigInactiveValue" SG_ 389 ADC_RapidRespEna 0;
BA_ "GenSigInvalidValue" SG_ 389 ADC_RapidRespEna 0;
BA_ "GenSigSendType" SG_ 389 ADC_RapidRespEna 1;
BA_ "GenSigStartValue" SG_ 389 ADC_RapidRespEna 0;
BA_ "GenSigTimeoutValue" SG_ 389 ADC_RapidRespEna 0;
BA_ "Remark" SG_ 389 ADC_RapidRespEna "";
BA_ "EventCommandSignal" SG_ 389 ADC_LimTqEnable 0;
BA_ "GatewayedSignals" SG_ 389 ADC_LimTqEnable 0;
BA_ "GenSigInactiveValue" SG_ 389 ADC_LimTqEnable 0;
BA_ "GenSigInvalidValue" SG_ 389 ADC_LimTqEnable 0;
BA_ "GenSigSendType" SG_ 389 ADC_LimTqEnable 1;
BA_ "GenSigStartValue" SG_ 389 ADC_LimTqEnable 0;
BA_ "GenSigTimeoutValue" SG_ 389 ADC_LimTqEnable 0;
BA_ "Remark" SG_ 389 ADC_LimTqEnable "";
BA_ "EventCommandSignal" SG_ 389 ADC_MotSpdCtrlEna 0;
BA_ "GatewayedSignals" SG_ 389 ADC_MotSpdCtrlEna 0;
BA_ "GenSigInactiveValue" SG_ 389 ADC_MotSpdCtrlEna 0;
BA_ "GenSigInvalidValue" SG_ 389 ADC_MotSpdCtrlEna 0;
BA_ "GenSigSendType" SG_ 389 ADC_MotSpdCtrlEna 1;
BA_ "GenSigStartValue" SG_ 389 ADC_MotSpdCtrlEna 0;
BA_ "GenSigTimeoutValue" SG_ 389 ADC_MotSpdCtrlEna 0;
BA_ "Remark" SG_ 389 ADC_MotSpdCtrlEna "";
BA_ "EventCommandSignal" SG_ 389 ADC_TqUnloadEna 0;
BA_ "GatewayedSignals" SG_ 389 ADC_TqUnloadEna 0;
BA_ "GenSigInactiveValue" SG_ 389 ADC_TqUnloadEna 0;
BA_ "GenSigInvalidValue" SG_ 389 ADC_TqUnloadEna 0;
BA_ "GenSigSendType" SG_ 389 ADC_TqUnloadEna 1;
BA_ "GenSigStartValue" SG_ 389 ADC_TqUnloadEna 0;
BA_ "GenSigTimeoutValue" SG_ 389 ADC_TqUnloadEna 0;
BA_ "Remark" SG_ 389 ADC_TqUnloadEna "";
BA_ "EventCommandSignal" SG_ 389 ADC_MotTarSpdSvValid 0;
BA_ "GatewayedSignals" SG_ 389 ADC_MotTarSpdSvValid 0;
BA_ "GenSigInactiveValue" SG_ 389 ADC_MotTarSpdSvValid 0;
BA_ "GenSigInvalidValue" SG_ 389 ADC_MotTarSpdSvValid 0;
BA_ "GenSigSendType" SG_ 389 ADC_MotTarSpdSvValid 1;
BA_ "GenSigStartValue" SG_ 389 ADC_MotTarSpdSvValid 0;
BA_ "GenSigTimeoutValue" SG_ 389 ADC_MotTarSpdSvValid 0;
BA_ "Remark" SG_ 389 ADC_MotTarSpdSvValid "";
BA_ "EventCommandSignal" SG_ 389 ADC_UrgentSteerFlg 0;
BA_ "GatewayedSignals" SG_ 389 ADC_UrgentSteerFlg 0;
BA_ "GenSigInactiveValue" SG_ 389 ADC_UrgentSteerFlg 0;
BA_ "GenSigInvalidValue" SG_ 389 ADC_UrgentSteerFlg 0;
BA_ "GenSigSendType" SG_ 389 ADC_UrgentSteerFlg 1;
BA_ "GenSigStartValue" SG_ 389 ADC_UrgentSteerFlg 0;
BA_ "GenSigTimeoutValue" SG_ 389 ADC_UrgentSteerFlg 0;
BA_ "Remark" SG_ 389 ADC_UrgentSteerFlg "";
BA_ "EventCommandSignal" SG_ 389 ADC_OneMotorCtrlEna 0;
BA_ "GatewayedSignals" SG_ 389 ADC_OneMotorCtrlEna 0;
BA_ "GenSigInactiveValue" SG_ 389 ADC_OneMotorCtrlEna 0;
BA_ "GenSigInvalidValue" SG_ 389 ADC_OneMotorCtrlEna 0;
BA_ "GenSigSendType" SG_ 389 ADC_OneMotorCtrlEna 1;
BA_ "GenSigStartValue" SG_ 389 ADC_OneMotorCtrlEna 0;
BA_ "GenSigTimeoutValue" SG_ 389 ADC_OneMotorCtrlEna 0;
BA_ "Remark" SG_ 389 ADC_OneMotorCtrlEna "";
BA_ "EventCommandSignal" SG_ 389 ADC_MotorCtrlTqWhlRL 0;
BA_ "GatewayedSignals" SG_ 389 ADC_MotorCtrlTqWhlRL 0;
BA_ "GenSigInactiveValue" SG_ 389 ADC_MotorCtrlTqWhlRL 0;
BA_ "GenSigInvalidValue" SG_ 389 ADC_MotorCtrlTqWhlRL 0;
BA_ "GenSigSendType" SG_ 389 ADC_MotorCtrlTqWhlRL 1;
BA_ "GenSigStartValue" SG_ 389 ADC_MotorCtrlTqWhlRL 0;
BA_ "GenSigTimeoutValue" SG_ 389 ADC_MotorCtrlTqWhlRL 0;
BA_ "Remark" SG_ 389 ADC_MotorCtrlTqWhlRL "";
BA_ "EventCommandSignal" SG_ 389 ADC_MotorCtrlTqWhlRR 0;
BA_ "GatewayedSignals" SG_ 389 ADC_MotorCtrlTqWhlRR 0;
BA_ "GenSigInactiveValue" SG_ 389 ADC_MotorCtrlTqWhlRR 0;
BA_ "GenSigInvalidValue" SG_ 389 ADC_MotorCtrlTqWhlRR 0;
BA_ "GenSigSendType" SG_ 389 ADC_MotorCtrlTqWhlRR 1;
BA_ "GenSigStartValue" SG_ 389 ADC_MotorCtrlTqWhlRR 0;
BA_ "GenSigTimeoutValue" SG_ 389 ADC_MotorCtrlTqWhlRR 0;
BA_ "Remark" SG_ 389 ADC_MotorCtrlTqWhlRR "";
BA_ "EventCommandSignal" SG_ 389 ADC_MotorCtrlTqWhlFR 0;
BA_ "GatewayedSignals" SG_ 389 ADC_MotorCtrlTqWhlFR 0;
BA_ "GenSigInactiveValue" SG_ 389 ADC_MotorCtrlTqWhlFR 0;
BA_ "GenSigInvalidValue" SG_ 389 ADC_MotorCtrlTqWhlFR 0;
BA_ "GenSigSendType" SG_ 389 ADC_MotorCtrlTqWhlFR 1;
BA_ "GenSigStartValue" SG_ 389 ADC_MotorCtrlTqWhlFR 0;
BA_ "GenSigTimeoutValue" SG_ 389 ADC_MotorCtrlTqWhlFR 0;
BA_ "Remark" SG_ 389 ADC_MotorCtrlTqWhlFR "";
BA_ "EventCommandSignal" SG_ 389 ADC_MotorCtrlTqWhlFL 0;
BA_ "GatewayedSignals" SG_ 389 ADC_MotorCtrlTqWhlFL 0;
BA_ "GenSigInactiveValue" SG_ 389 ADC_MotorCtrlTqWhlFL 0;
BA_ "GenSigInvalidValue" SG_ 389 ADC_MotorCtrlTqWhlFL 0;
BA_ "GenSigSendType" SG_ 389 ADC_MotorCtrlTqWhlFL 1;
BA_ "GenSigStartValue" SG_ 389 ADC_MotorCtrlTqWhlFL 0;
BA_ "GenSigTimeoutValue" SG_ 389 ADC_MotorCtrlTqWhlFL 0;
BA_ "Remark" SG_ 389 ADC_MotorCtrlTqWhlFL "";
BA_ "EventCommandSignal" SG_ 389 ADC_BrkTarTq_B1 0;
BA_ "GatewayedSignals" SG_ 389 ADC_BrkTarTq_B1 0;
BA_ "GenSigInactiveValue" SG_ 389 ADC_BrkTarTq_B1 0;
BA_ "GenSigInvalidValue" SG_ 389 ADC_BrkTarTq_B1 0;
BA_ "GenSigSendType" SG_ 389 ADC_BrkTarTq_B1 1;
BA_ "GenSigStartValue" SG_ 389 ADC_BrkTarTq_B1 0;
BA_ "GenSigTimeoutValue" SG_ 389 ADC_BrkTarTq_B1 0;
BA_ "Remark" SG_ 389 ADC_BrkTarTq_B1 "";
VAL_ 161 ACU_FaceID_Delete 0 "Default" 1 "Delete AUID1" 2 "Delete AUID2" 3 "Delete AUID3" 4 "Delete AUID4" 5 "Delete AUID5" 6 "Delete AUID6" 7 "Delete AUID7" 8 "Delete AUID8" 9 "Reserved" 10 "Reserved" 11 "Reserved" 12 "Reserved" 13 "Reserved" 14 "Reserved" 15 "Reserved"  ;
VAL_ 161 ACU_RegisterTriger 0 "Default" 1 "Register AUID1" 2 "Register AUID2" 3 "Register AUID3" 4 "Register AUID4" 5 "Register AUID5" 6 "Register AUID6" 7 "Register AUID7" 8 "Register AUID8" 9 "Reserved" 10 "Reserved" 11 "Reserved" 12 "Reserved" 13 "Reserved" 14 "Reserved" 15 "Reserved"  ;
VAL_ 161 ACU_VerifyTriger 0 "Default" 1 "Verify AUID1" 2 "Verify AUID2" 3 "Verify AUID3" 4 "Verify AUID4" 5 "Verify AUID5" 6 "Verify AUID6" 7 "Verify AUID7" 8 "Verify AUID8" 9 "Reserved" 10 "Reserved" 11 "Reserved" 12 "Reserved" 13 "Reserved" 14 "Reserved" 15 "Reserved"  ;
VAL_ 161 ACU_FaceIDQuit 0 "No command" 1 "Quit request"  ;
VAL_ 161 ACU_FaceIDSwitch 0 "No command" 1 "Off" 2 "On" 3 "Not used"  ;
VAL_ 161 ACU_AVAS_SwitchCfgReq 0 "No command" 1 "OFF" 2 "ON" 3 "Not used"  ;
VAL_ 432 ICC_FcnInfo 0 "TVC Off" 1 "TVC Action" 0 "TBIP Off" 1 "TBIP Action" 0 "RAS APP Off" 1 "RAS APP Action" 0 "SBW Off" 1 "SBW Action" 0 "TSC Off" 1 "TSC Action" 0 "PDC Off" 1 "PDC Action" 0 "ASTC Off" 1 "ASTC Action" 0 "MSC Off" 1 "MSC Action" 0 "SDC Cor Off" 1 "SDC Cor Aciton" 0 "ECAS Cor Off" 1 "ECAS Cor Action" 0 "WSC Off" 1 "WSC Action" 0 "IOS Off" 1 "IOS Active"  ;
VAL_ 432 ICC_FaultSt 0 "No Fault" 1 "Fault" 0 "No Fault" 1 "Fault" 0 "No Fault" 1 "Fault" 0 "No Fault" 1 "Fault" 0 "No Fault" 1 "Fault" 0 "No Fault" 1 "Fault" 0 "No Fault" 1 "Fault" 0 "No Fault" 1 "Fault" 0 "No Fault" 1 "Fault" 0 "No Fault" 1 "Fault" 0 "No Fault" 1 "Fault"  ;
VAL_ 432 ICC_ActorSt 0 "All Actor Normal" 1 "Actors Abnormal" 0 "VCU Normal" 1 "VCU Abnormal" 0 "EPS Normal" 1 "EPS Abnormal" 0 "RAS Normal" 1 "RAS Abnormal" 0 "IBCS Normal" 1 "IBCS Abnormal" 0 "SDC&ECAS Normal" 1 "SDC&ECAS Abnormal" 0 "SBW Normal" 1 "SBW Abnormal"  ;
VAL_ 432 ICC_FrontLeftTireBlowout 0 "No Function" 1 "Not Blowout" 2 "Blowout" 3 "Reserved"  ;
VAL_ 432 ICC_FrontRightTireBlowout 0 "No Function" 1 "Not Blowout" 2 "Blowout" 3 "Reserved"  ;
VAL_ 432 ICC_RearRightTireBlowout 0 "No Function" 1 "Not Blowout" 2 "Blowout" 3 "Reserved"  ;
VAL_ 432 ICC_RearLeftTireBlowout 0 "No Function" 1 "Not Blowout" 2 "Blowout" 3 "Reserved"  ;
VAL_ 432 ICC_RAS_AgCtrlAvl 0 "Not available" 1 "Available" 2 "Reserved" 3 "Reserved"  ;
VAL_ 432 ICC_RAS_CalibratedSt 0 "Not calibrated" 1 "Calibrated"  ;
VAL_ 432 ICC_RAS_ErrFeedback 0 "No interruption；" 1 "ADAS AngleReq Invaild or Timeout" 2 "Reserved" 3 "Vehicle Speed Invalid" 4 "Reserved" 5 "ADC Channel A signal Error" 6 "RAS Error" 7 "Other Abnormal" 8 "ADAS AngleReq Over range" 9 "ADAS AngleSpdReq Over range" 10 "Reserved" 11 "Both ADAS Channel Error" 12 "ADC Channel B signal Error；" 13 "Reserved；" 14 "Reserved；" 15 "Reserved；"  ;
VAL_ 432 ICC_RAS_AngleVD 0 "Not valid" 1 "Valid"  ;
VAL_ 432 ICC_RAS_PstOverlaySt 0 "No active" 1 "Ready" 2 "active" 3 "Failed"  ;
VAL_ 432 ICC_RAS_SteerMod 0 "Initial" 1 "Adaptive Mode" 2 "Normal Mode(智驾)" 3 "Emergency Mode(智驾)" 4 "Crab Mode" 5 "Abnormal Mode" 6 "reserved" 7 "reserved"  ;
VAL_ 432 ICC_RAS_HealthyStForADC 0 "Healthy" 1 "Slightly failure" 2 "Abnormal" 3 "Shut off"  ;
VAL_ 432 ICC_RAS_SteeringAngleSpdVD 0 "Not valid" 1 "Valid"  ;
VAL_ 432 ICC_RAS_WarnLamp 0 "No Fault" 1 "Slight Fault" 2 "Urgency Fault" 3 "Severity Urgency Fault"  ;
VAL_ 433 VCU_VehWhlReqTqFAVD 0 "Invalid" 1 "Valid"  ;
VAL_ 433 VCU_VehWhlReqTqRRVD 0 "Invalid" 1 "Valid"  ;
VAL_ 433 VCU_VehActDrvTorqRRVD 1 "Valid;" 0 "Invalid;"  ;
VAL_ 433 VCU_PreStableFlg 0 "Not Active" 1 "Active"  ;
VAL_ 433 VCU_VehWhlReqTqRLVD 0 "Invalid" 1 "Valid"  ;
VAL_ 433 VCU_AccPedalActPstVD 0 "Invalid" 1 "Valid"  ;
VAL_ 433 VCU_AccPedalActPst 511 "error;" 510 "Init;"  ;
VAL_ 433 VCU_GearShiftAvl 0 "not available" 1 "available"  ;
VAL_ 433 VCU_MotorRgnCaplTqWhlVD 0 "Invalid" 1 "Valid"  ;
VAL_ 433 VCU_VehWhlReqTqVD 0 "Invalid" 1 "Valid"  ;
VAL_ 433 VCU_ErrorFb 0 "No error" 1 "ADS请求有效位无效" 2 "高压故障" 3 "MCU故障" 4 "BMS故障" 7 "ADS E2E故障或者time out"  ;
VAL_ 433 VCU_PtTqActvSts 0 "Not response" 1 "Response"  ;
VAL_ 433 VCU_PtTqAvl 0 "not available" 1 "available" 2 "available degraded"  ;
VAL_ 791 WW_FWPMotorSt 0 "Off" 1 "Reserve" 2 "Stall protection" 3 "Failure" 4 "Low speed" 5 "High speed" 6 "Hard stopped" 7 "Interval delaying"  ;
VAL_ 791 WW_FWSHMotorSt 0 "OFF" 1 "ON" 2 "Failure"  ;
VAL_ 791 HRN_HornRunningSt 0 "Off" 1 "On" 2 "Failure"  ;
VAL_ 791 HRN_HornWorkingTemplet 0 "No Action"  ;
VAL_ 791 EL_FLPositionLightSt 0 "OFF" 1 "ON"  ;
VAL_ 791 EL_FLPositionLightFaultSt 0 "Not fault" 1 "Fault"  ;
VAL_ 791 EL_FRPositionLightSt 0 "OFF" 1 "ON"  ;
VAL_ 791 EL_FRPositionLightFaultSt 0 "Not fault" 1 "Fault"  ;
VAL_ 791 EL_LeftLowBeamSt 0 "OFF" 1 "ON"  ;
VAL_ 791 EL_LeftLowBeamFaultSt 0 "Not fault" 1 "Fault"  ;
VAL_ 791 EL_RightLowBeamSt 0 "OFF" 1 "ON"  ;
VAL_ 791 EL_RightLowBeamFaultSt 0 "Not fault" 1 "Fault"  ;
VAL_ 791 EL_LeftHighBeamSt 0 "OFF" 1 "ON"  ;
VAL_ 791 EL_LeftHighBeamFaultSt 0 "Not fault" 1 "Fault"  ;
VAL_ 791 EL_RightHighBeamSt 0 "OFF" 1 "ON"  ;
VAL_ 791 EL_RightHighBeamFaultSt 0 "Not fault" 1 "Fault"  ;
VAL_ 791 EL_FLFogLightSt 0 "OFF" 1 "ON"  ;
VAL_ 791 EL_FLFogLightFaultSt 0 "Not fault" 1 "Fault"  ;
VAL_ 791 EL_FRFogLightSt 0 "OFF" 1 "ON"  ;
VAL_ 791 EL_FRFogLightFaultSt 0 "Not fault" 1 "Fault"  ;
VAL_ 791 EL_LeftDRLSt 0 "OFF" 1 "ON"  ;
VAL_ 791 EL_LeftDRLFaultSt 0 "Not fault" 1 "Fault"  ;
VAL_ 791 EL_RightDRLSt 0 "OFF" 1 "ON"  ;
VAL_ 791 EL_RightDRLFaultSt 0 "Not fault" 1 "Fault"  ;
VAL_ 791 EL_FLTurnLightSt 0 "Not active" 1 "OFF" 2 "ON" 3 "Not used"  ;
VAL_ 791 EL_FLTurnLightFaultSt 0 "Not fault" 1 "Fault"  ;
VAL_ 791 EL_FRTurnLightSt 0 "Not active" 1 "OFF" 2 "ON" 3 "Not used"  ;
VAL_ 791 EL_FRTurnLightFaultSt 0 "Not fault" 1 "Fault"  ;
VAL_ 791 WW_RWSHMotorSt 0 "OFF" 1 "ON" 2 "Failure"  ;
VAL_ 791 EL_FADASLightSt 0 "Off" 1 "On" 2 "Fault" 3 "Not used"  ;
VAL_ 616 UMM_UsageModeSt 0 "Standby" 1 "Comfort" 2 "Reserved" 3 "DRV" 4 "Reserved" 5 "Reserved" 6 "Reserved" 7 "Invalid"  ;
VAL_ 616 OTA_FuncReq_ADCWakeup 0 "Inactive" 1 "Active" 2 "Reserved1" 3 "Reserved2" 4 "Reserved3" 5 "Reserved4" 6 "Reserved5" 7 "Reserved6"  ;
VAL_ 616 UMM_FrontPassengerSeatSt 0 "Undefined" 1 "Off" 2 "On" 3 "Failure"  ;
VAL_ 616 UMM_DriverSeatSt 0 "Undefined" 1 "Off" 2 "On" 3 "Failure"  ;
VAL_ 616 VMM_VehModeSt 0 "Normal Mode" 1 "Manufacture Mode" 2 "Transport Mode" 3 "Showroom Mode" 4 "PostCrash Mode" 5 "Maintenance Mode" 6 "Reserved" 7 "Reserved" 8 "Reserved" 9 "Reserved" 10 "Reserved" 11 "Reserved" 12 "Reserved" 13 "Reserved" 14 "Reserved" 15 "Invalid Value"  ;
VAL_ 616 VMM_LastVehModeSt 0 "Normal Mode" 1 "Manufacture Mode" 2 "Transport Mode" 3 "Showroom Mode" 4 "PostCrash Mode" 5 "Maintenance Mode" 6 "Reserved" 7 "Reserved" 8 "Reserved" 9 "Reserved" 10 "Reserved" 11 "Reserved" 12 "Reserved" 13 "Reserved" 14 "Reserved" 15 "Invalid Value"  ;
VAL_ 616 VMM_OTAModeSt 0 "NonOTA Mode" 1 "OTA Mode" 2 "Invalid Value" 3 "Seamless OTA"  ;
VAL_ 616 CSM_RC_PAARequest 0 "No request" 1 "SBM RPA request" 2 "SBM HPA request" 3 "EDK request" 4 "TSP HPA request" 5 "TSP AVP request" 6 "check picture" 7 "check video"  ;
VAL_ 616 IPDS_EnablePowerSup 0 "Not Active" 1 "Active" 2 "PreOFF" 3 "Reserve"  ;
VAL_ 616 CCU_DstFlag 0 "inactive" 1 "active"  ;
VAL_ 616 ASB_DriverActiveBeltFaultSt 0 "Not fault" 1 "Fault"  ;
VAL_ 616 IPDS_DCDCOpenCircuitSt 0 "Invalid" 1 "Normal" 2 "Open Circuit" 3 "Reserved"  ;
VAL_ 825 WW_FwpFaultSt 0 "Not fault" 1 "Fault"  ;
VAL_ 825 WW_RwpFaultSt 0 "Not fault" 1 "Fault"  ;
VAL_ 825 WW_FwshFaultSt 0 "Not fault" 1 "Fault"  ;
VAL_ 825 WW_RwshFaultSt 0 "Not fault" 1 "Fault"  ;
VAL_ 825 WW_FwpAutoModeSt 0 "False" 1 "True"  ;
VAL_ 825 WW_RainFallLevel 0 "No Rain" 1 "Level 1" 2 "Level 2" 3 "Level 3" 4 "Level 4" 5 "Level 5" 6 "Level 6" 7 "Level 7" 8 "Level 8" 9 "Level 9" 10 "Level 10" 11 "Level 11" 12 "Level 12" 13 "Level 13" 14 "Init value" 15 "Invalid value"  ;
VAL_ 825 RLS_LightOnReq 0 "Light Off" 1 "Light On"  ;
VAL_ 825 RLS_LampOnReqValid 0 "Valid value" 1 "Invalid value"  ;
VAL_ 825 RLS_WiperSpd 0 "Switch Off" 1 "Low speed/speed 1" 2 "speed 2" 3 "speed 3" 4 "speed 4" 5 "speed 5" 6 "speed 6" 7 "speed 7" 8 "speed 8" 9 "speed 9" 10 "speed 10" 11 "speed 11" 12 "speed 12" 13 "speed 13" 14 "High speed/speed 14" 15 "Invalid"  ;
VAL_ 825 RLS_RainfallLevel 0 "No Rain" 1 "Level 1" 2 "Level 2" 3 "Level 3" 4 "Level 4" 5 "Level 5" 6 "Level 6" 7 "Level 7" 8 "Level 8" 9 "Level 9" 10 "Level 10" 11 "Level 11" 12 "Level 12" 13 "Level 13" 14 "Init value" 15 "Invalid value"  ;
VAL_ 825 RLS_RSErr 0 "No Error" 1 "Error"  ;
VAL_ 825 RLS_LSErr 0 "No Error" 1 "Error"  ;
VAL_ 825 PM_AUTHPstState 0 "Disable" 1 "Enable"  ;
VAL_ 825 CCU_FuncReq_SentryMod 0 "OFF" 1 "SentryModeWake"  ;
VAL_ 825 CCU_ModeSuppressSts 0 "OFF" 1 "ON" 2 "UNKNOW"  ;
VAL_ 825 RLS_HUTErr 0 "HUT sensor normal" 1 "HUT sensor error"  ;
VAL_ 389 ADC_AngReqSt_A_B1 0 "Inhibited" 1 "Ready" 2 "Active" 3 "Failed"  ;
VAL_ 389 ADC_AngReqFunction_B1 0 "No request" 1 "Request by LKAS" 2 "Request by PAS" 3 "Reserved"  ;
VAL_ 389 ADC_BrakeLightReq_B1 0 "No Request" 1 "turn on" 2 "turn off"  ;
VAL_ 389 ADC_AssistParaSwitchReq_B1 0 "No request" 1 "Request"  ;
VAL_ 389 ADC_SteerGainReq_B1 0 "No request" 1 "Request"  ;
VAL_ 389 ADC_StrgWhlVibrWarnLevel_B1 0 "No request" 1 "Request level 1" 2 "Request level 2" 3 "Request level 3"  ;
VAL_ 389 ADC_ActTrqReqEnable_B1 0 "Disable" 1 "Enable"  ;
VAL_ 389 ADC_EvsSteerReq_B1 0 "No request" 1 "Request"  ;
VAL_ 389 ADC_StrgWhlVibrWarnReq_B1 0 "No request" 1 "Request"  ;
VAL_ 389 ADC_DrvTarTqMod2EPB_B 0 "Override mode" 1 "Inhibit mode" 2 "reserved" 3 "reserved"  ;
VAL_ 389 ADC_LongCtrlTypReq_B1 0 "Comfort Mode" 1 "Emergency Mode"  ;
VAL_ 389 ADC_AEBFaultSt_B1 0 "Not fault" 1 "Fault"  ;
VAL_ 389 ADC_AEBOffSt_B1 0 "On" 1 "Off"  ;
VAL_ 389 ADC_AEBInterventionSt_B1 0 "No intervention" 1 "Intervention"  ;
VAL_ 389 ADC_AEBDecelCtrlReq_B1 0 "No request" 1 "Request"  ;
VAL_ 389 ADC_AEBLVehHoldReq_B1 0 "No request" 1 "Request"  ;
VAL_ 389 ADC_ABAReq_B1 0 "No request" 1 "Request"  ;
VAL_ 389 ADC_ABALevel_B1 0 "Level 0" 1 "Level 1" 2 "Level 2" 3 "Level 3"  ;
VAL_ 389 ADC_AWBReq_B1 0 "No request" 1 "Request"  ;
VAL_ 389 ADC_ABPReq_B1 0 "No request" 1 "Request"  ;
VAL_ 389 ADC_AWBLevel_B1 0 "No level" 1 "Level 1" 2 "Level 2" 3 "Level 3" 4 "Level 4" 5 "Not used" 6 "Not used" 7 "Not used"  ;
VAL_ 389 ADC_AEBTarCalss_B1 0 "Not dectected" 1 "Car" 2 "Pedestrian" 3 "Two wheels" 4 "Motorcycle" 5 "Truck" 6 "Unknown" 7 "Reserve"  ;
VAL_ 389 ADC_AEBTarDetSensor_B1 0 "Invalid" 1 "Not Fusion" 2 "Not used" 3 "Fusion"  ;
VAL_ 389 ADC_TurnLightReq_B1 0 "No Request" 1 "turn off" 2 "turn on left turn lamp" 3 "turn on right turn lamp" 4 "turn on Hazard Lamp" 5 "turn on RCW Hazard Lamp(4HZ)"  ;
VAL_ 389 ADC_EpbModReq_B1 0 "No request" 1 "lock" 2 "release" 3 "reserved"  ;
VAL_ 389 ADS_VDCActvSt_B 0 "Not Active" 1 "Active"  ;
VAL_ 389 ADS_TCSActvSt_B 0 "Not Active" 1 "Active"  ;
VAL_ 389 ADS_DTCActvSt_B 0 "Not Active" 1 "Active"  ;
VAL_ 389 ADC_EpbModReqEna_B1 0 "disable" 1 "enable"  ;
VAL_ 389 ADC_PAAPwrModeReq_B1 0 "No Request" 1 "Power On Request (PTready)"  ;
VAL_ 389 ADC_PAAGrarLvlReq_B1 0 "No Request" 1 "Park" 2 "Reversed" 3 "Neutral" 4 "Drive" 5 "Reversed" 6 "Reversed" 7 "Reversed"  ;
VAL_ 389 ADC_PAAGrarLvlReqEnable_B1 0 "No request" 1 "Gear shift request"  ;
VAL_ 389 ADC_ActTrqReqVD_B1 0 "invalid" 1 "valid"  ;
VAL_ 389 ADC_BrkTarTqEna_B1 0 "disable" 1 "enable"  ;
VAL_ 389 ADC_BrkTarTqMod_B1 0 "no request" 1 "Cruise function" 2 "Parking function" 3 "Reserved"  ;
VAL_ 389 ADC_EpbModReqVld_B1 0 "Invalid" 1 "Valid"  ;
VAL_ 389 ADC_RWUEna_B1 0 "disable" 1 "enable"  ;
VAL_ 389 ADC_BrkHoldReq_B1 0 "No request" 1 "Not active" 2 "Active" 3 "Reserved"  ;
VAL_ 389 ADC_AngReqAvl_B1 0 "Not available" 1 "Available"  ;
VAL_ 389 ADC_TarGearReqVld_B1 0 "Invalid" 1 "Valid"  ;
VAL_ 389 ADC_FctSts_B1 0 "Off" 1 "On"  ;
VAL_ 389 ADC_BrkTarTqVld_B1 0 "Invalid" 1 "Valid"  ;
VAL_ 389 ADC_AebBrkTarTqVld_B1 0 "Invalid" 1 "Valid"  ;
VAL_ 389 ADC_AebBrkTarTqEna_B1 0 "disable" 1 "enable"  ;
VAL_ 389 ADC_ElecBrkFnSwitch_B1 0 "ON" 1 "OFF"  ;
VAL_ 389 ADC_RedundantSwt_B1 0 "Without Redundant" 1 "With Redundant"  ;
VAL_ 389 ADC_ImmediateStopEna_B1 0 "Not Permitted" 1 "Permitted"  ;
VAL_ 389 ADC_RWUVld_B1 0 "Invalid" 1 "Valid"  ;
VAL_ 389 ADC_DriverPresent_B1 0 "Undefined" 1 "Driver  Not Present" 2 "Driver  Present" 3 "Failure"  ;
VAL_ 389 ADC_AD_NetMode_B 0 "Main Net" 1 "Main and Sub Net" 2 "Reserved" 3 "Reserved"  ;
VAL_ 389 ADC_ChrgPwrMode_B 0 "Normal" 1 "Emergent"  ;
VAL_ 389 ADC_FcsActiveStatus_B 0 "No Active" 1 "Active"  ;
VAL_ 389 ADC_DriverSeatBeltPretightenReq_B 0 "Not Request" 1 "Request"  ;
VAL_ 389 ADC_SteerVibrAvl_B 0 "Not available" 1 "Available"  ;
VAL_ 389 ADC_VehSpdVD_B 0 "Not Valid" 1 "Valid"  ;
VAL_ 389 ADC_RasAngReqAvl_B1 0 "Not available" 1 "Available" 2 "Reserved" 3 "Reserved"  ;
VAL_ 389 ADC_RasAngReqSt_A_B1 0 "No Active" 1 "Ready" 2 "Active" 3 "Failed"  ;
VAL_ 389 ADC_RasModReq_B1 0 "Normal" 1 "Emergency" 2 "Reserved" 3 "Reserved"  ;
VAL_ 389 ADC_DriverSeatBeltVibrWarnReq_B 0 "No Request" 1 "Mode 1" 2 "Mode 2" 3 "Mode 3" 4 "Reserved" 5 "Reserved" 6 "Reserved" 7 "Reserved"  ;
VAL_ 389 ADC_MotCtrlTar 0 "FL" 1 "RL" 2 "FL+RL" 3 "RL+RR" 4 "reserved" 5 "reserved" 6 "reserved" 7 "reserved"  ;
VAL_ 389 ADC_MotTarMod 0 "Torque mode" 1 "Speed mode" 2 "SV mode" 3 "Reserved"  ;
VAL_ 389 ADC_DrvTarTqMod 0 "Override mode" 1 "Inhibit mode" 2 "reserved" 3 "reserved"  ;
VAL_ 389 ADC_RapidRespEna 0 "Disable" 1 "Enable"  ;
VAL_ 389 ADC_LimTqEnable 0 "Disable" 1 "Enable"  ;
VAL_ 389 ADC_MotSpdCtrlEna 0 "Disable" 1 "Enable"  ;
VAL_ 389 ADC_TqUnloadEna 0 "Disable" 1 "Enable"  ;
VAL_ 389 ADC_MotTarSpdSvValid 0 "Invalid" 1 "Valid"  ;
VAL_ 389 ADC_UrgentSteerFlg 0 "Disable" 1 "Enable"  ;
VAL_ 389 ADC_OneMotorCtrlEna 0 "Disable（Total Drive Torque）" 1 "Enable（One Wheel Drive Torque）" 2 "Reserved" 3 "Reserved"  ;
