VERSION "Version"

NS_ :

BS_:

BU_: Tester IBCS EPS ADC CCU CCU_CCURT1 CCU_CCURT2 EPB_IBCS EBB ZCUF ZCUL ZCUR ZCUT EMS IDM DCDC IPS NIDU NIDUF DCUR OBC OPC LPC CPC EMCM GCU DCUF IPU BMS EOPF EOPR EVCC DCDC2 EDL SRS ECS EPB RBM ICM IID IDC PHUDD AMP WHUD IMR INU IFC FAPA RRR RLR PAS PCS SCMR SCMRL SCMRR HVSMR SCMRM MFS WSM DRM IDU FCP LBMSAD AVAS ATSS DLPFL FBLCM FLISD FLLCM FRLCM RLLCMA RLLCMB RRLCMA RRLCMB RLISD DLPML DLPMR TRM PSDL PSDR HVSPRL HVSPRR RFR SBM WCM ETC TBOX2 TBOX CCURT1 CCURT2 RT1_C0 RT1_C1 RT2_C3 CBM RAS TMC SCMT PLGM LBMS RLBMS IDUR OTAWL RCICP WCMFR WCMRL LPC2 SAS CD RCP RRISD

BO_ 2015 Fun_Diag_Rx: 64 Tester
 SG_ Fun_Diag_Request : 7|512@0+ (1,0) [0|0] ""  ZCUF,ZCUL,ZCUR,ZCUT,EMS,IDM,DCDC,IPS,NIDU,NIDUF,DCUR,OBC,OPC,LPC,CPC,EMCM,GCU,DCUF,IPU,BMS,EOPF,EOPR,EVCC,DCDC2,EDL,SRS,ECS,EPS,EPB,RBM,IBCS,ICM,IID,IDC,PHUDD,AMP,WHUD,IMR,INU,ADC,IFC,FAPA,RRR,RLR,PAS,PCS,SCMR,SCMRL,SCMRR,HVSMR,SCMRM,MFS,WSM,DRM,IDU,FCP,LBMSAD,AVAS,ATSS,DLPFL,FBLCM,FLISD,FLLCM,FRLCM,RLLCMA,RLLCMB,RRLCMA,RRLCMB,RLISD,DLPML,DLPMR,TRM,PSDL,PSDR,HVSPRL,HVSPRR,RFR,SBM,WCM,ETC,TBOX2,TBOX

BO_ 352 BCS_2_C: 64 IBCS
 SG_ BCS_2_CRC : 7|16@0+ (1,0) [0|65535] ""  CCU,CCURT1,CCURT2,RT1_C0,RT1_C1,RT2_C3,ECS,CBM,RAS,EPS,EPB,RBM,ADC
 SG_ BCS_2_Counter : 23|8@0+ (1,0) [0|255] ""  CCU,CCURT1,CCURT2,RT1_C0,RT1_C1,RT2_C3,ECS,CBM,RAS,EPS,EPB,RBM,ADC
 SG_ BCS_VehSpd : 31|13@0+ (0.05625,0) [0|240] "km/h"  CCU,CCURT1,CCURT2,RT1_C0,RT1_C1,RT2_C3,SRS,EBB,ECS,CBM,RAS,EPS,EPB,ADC
 SG_ BCS_VehSpdVD : 34|1@0+ (1,0) [0|1] ""  CCU,CCURT1,CCURT2,RT1_C0,RT1_C1,RT2_C3,SRS,EBB,ECS,CBM,RAS,EPS,EPB,ADC
 SG_ BCS_EBDActiveSt : 32|1@0+ (1,0) [0|1] ""  CCU,CCURT1,RT1_C0,RT1_C1,ECS,ADC
 SG_ BCS_EBDFaultSt : 47|1@0+ (1,0) [0|1] ""  CCU,CCURT1,RT1_C0,RT1_C1,SRS,ECS,ADC
 SG_ BCS_ABSActiveSt : 46|1@0+ (1,0) [0|1] ""  CCU,CCURT1,RT1_C0,RT1_C1,SRS,EBB,ECS,ADC
 SG_ BCS_ABSFaultSt : 45|1@0+ (1,0) [0|1] ""  CCU,CCURT1,RT1_C0,RT1_C1,SRS,ECS,ADC
 SG_ BCS_TCSActiveSt : 44|1@0+ (1,0) [0|1] ""  CCU,CCURT1,RT1_C0,RT1_C1,SRS,ECS,EPB,ADC
 SG_ BCS_TCSFaultSt : 43|1@0+ (1,0) [0|1] ""  CCU,CCURT1,RT1_C0,RT1_C1,SRS,ECS,EPB,ADC
 SG_ BCS_VDCActiveSt : 42|1@0+ (1,0) [0|1] ""  CCU,CCURT1,RT1_C0,RT1_C1,SRS,ECS,ADC
 SG_ BCS_VDCFaultSt : 41|1@0+ (1,0) [0|1] ""  CCU,CCURT1,RT1_C0,RT1_C1,SRS,ECS,ADC
 SG_ BCS_EngTorqDecFastRA : 55|16@0+ (1,-30000) [-30000|30000] "Nm"  CCU,CCURT1,RT1_C1,ADC
 SG_ BCS_PreAndRealVDCActiveSt : 67|1@0+ (1,0) [0|1] ""  CCU,CCURT1,RT1_C1,ADC,IFC
 SG_ BCS_DTCAvailable : 64|1@0+ (1,0) [0|1] ""  CCU,CCURT1,RT1_C1,ADC
 SG_ BCS_DTCActiveSt : 79|1@0+ (1,0) [0|1] ""  CCU,CCURT1,RT1_C1,ADC
 SG_ BCS_EngTorqIncRA : 77|14@0+ (1,-6000) [-6000|10380] "Nm"  CCU,CCURT1,RT1_C1,ADC
 SG_ BCS_RealTCSActiveSt : 95|1@0+ (1,0) [0|1] ""  CCU,CCURT1,RT1_C1,ADC
 SG_ BCS_CrbsActive : 105|1@0+ (1,0) [0|1] ""  CCU,CCURT1,CCURT2,RT1_C1,RT2_C3,ADC
 SG_ BCS_BrkPedalStVD : 224|1@0+ (1,0) [0|1] ""  CCU,ADC
 SG_ BCS_TargetRecpTorqRqFA : 197|14@0+ (1,-6000) [-6000|6000] "Nm"  CCU,CCURT1,RT1_C1,ADC
 SG_ BCS_TargetRecpTorqRqFASt : 215|2@0+ (1,0) [0|3] ""  CCU,CCURT1,RT1_C1,ADC
 SG_ BCS_TargetRecpTorqRqRA : 213|14@0+ (1,-6000) [-6000|6000] "Nm"  CCU,CCURT1,RT1_C1,ADC
 SG_ BCS_TargetRecpTorqRqRASt : 231|2@0+ (1,0) [0|3] ""  CCU,CCURT1,RT1_C1,ADC
 SG_ BCS_EngTorqDecActiveStRA : 233|1@0+ (1,0) [0|1] ""  CCU,CCURT1,RT1_C1,ADC
 SG_ BCS_EngTorqIncActiveStRA : 232|1@0+ (1,0) [0|1] ""  CCU,CCURT1,RT1_C1,ADC
 SG_ BCS_BrkPedalSt : 227|2@0+ (1,0) [0|3] ""  CCU,CCURT1,RT1_C1,ECS,EPB,ADC
 SG_ BCS_EngTorqDecActiveStFA : 375|1@0+ (1,0) [0|1] ""  CCU,CCURT1,RT1_C1,ADC
 SG_ BCS_EngTorqIncActiveStFA : 383|1@0+ (1,0) [0|1] ""  CCU,CCURT1,RT1_C1,ADC
 SG_ BCS_EngTorqDecFastFA : 399|16@0+ (1,-30000) [-30000|30000] "Nm"  CCU,CCURT1,RT1_C1,ADC
 SG_ BCS_EngTorqIncFA : 415|16@0+ (1,-30000) [-30000|30000] "Nm"  CCU,CCURT1,RT1_C1,ADC
 SG_ BCS_ADCNetErrorFb : 156|3@0+ (1,0) [0|7] ""  CCU,CCURT1,RT1_C1,ADC
 SG_ BCS_NetModeResp : 158|2@0+ (1,0) [0|3] ""  CCU,CCURT1,RT1_C1,ADC
 SG_ BCS_FLWheelSpdVD_B : 33|1@0+ (1,0) [0|1] ""  CCU,CCURT1,RT1_C1,EPS,EPB,ADC
 SG_ BCS_FLWheelRotatedDirectionVD_B : 68|1@0+ (1,0) [0|1] ""  CCU,CCURT1,RT1_C1,ADC
 SG_ BCS_FRWheelSpdVD_B : 69|1@0+ (1,0) [0|1] ""  CCU,CCURT1,RT1_C1,EPS,EPB,ADC
 SG_ BCS_FRWheelRotatedDirectionVD_B : 70|1@0+ (1,0) [0|1] ""  CCU,CCURT1,RT1_C1,ADC
 SG_ BCS_RLWheelSpdVD_B : 71|1@0+ (1,0) [0|1] ""  CCU,CCURT1,RT1_C1,EPS,EPB,ADC
 SG_ BCS_RLWheelRotatedDirectionVD_B : 96|1@0+ (1,0) [0|1] ""  CCU,CCURT1,RT1_C1,ADC
 SG_ BCS_RRWheelSpdVD_B : 97|1@0+ (1,0) [0|1] ""  CCU,CCURT1,RT1_C1,EPS,EPB,ADC
 SG_ BCS_FLWheelSpd_B : 94|13@0+ (0.05625,0) [0|240] "km/h"  CCU,CCURT1,RT1_C1,EPS,EPB,ADC
 SG_ BCS_RRWheelRotatedDirectionVD_B : 109|1@0+ (1,0) [0|1] ""  CCU,CCURT1,RT1_C1,ADC
 SG_ BCS_HHCCtrlSt_B : 110|1@0+ (1,0) [0|1] ""  ADC
 SG_ BCS_HDCErrSt_B : 118|1@0+ (1,0) [0|1] ""  ADC
 SG_ BCS_FRWheelSpd_B : 116|13@0+ (0.05625,0) [0|240] "km/h"  CCU,CCURT1,RT1_C1,EPS,EPB,ADC
 SG_ BCS_RLWheelSpdEdgesSumVD_B : 184|1@0+ (1,0) [0|1] ""  EPB,ADC
 SG_ BCS_RRWheelSpdEdgesSumVD_B : 185|1@0+ (1,0) [0|1] ""  EPB,ADC
 SG_ BCS_VDCOff_B : 186|1@0+ (1,0) [0|1] ""  ADC
 SG_ BCS_AVHSt_B : 187|1@0+ (1,0) [0|1] ""  EPB,ADC
 SG_ BCS_AVHStandby_B : 188|1@0+ (1,0) [0|1] ""  EPB,ADC
 SG_ BCS_AVHAvailable_B : 189|1@0+ (1,0) [0|1] ""  EPB,ADC
 SG_ BCS_TCSOff_B : 190|1@0+ (1,0) [0|1] ""  ADC
 SG_ BCS_BrakeOverHeat_B : 199|1@0+ (1,0) [0|1] ""  ADC
 SG_ BCS_FRWheelSpdEdgesSumVD_B : 234|1@0+ (1,0) [0|1] ""  EPB,ADC
 SG_ BCS_FLWheelSpdEdgesSumVD_B : 239|1@0+ (1,0) [0|1] ""  EPB,ADC
 SG_ BCS_ABAactive_B : 248|1@0+ (1,0) [0|1] ""  ADC
 SG_ BCS_ABAavailable_B : 249|1@0+ (1,0) [0|1] ""  ADC
 SG_ BCS_ABPActive_B : 250|1@0+ (1,0) [0|1] ""  ADC
 SG_ BCS_RLWheelSpd_B : 247|13@0+ (0.05625,0) [0|240] "km/h"  CCU,CCURT1,RT1_C1,EPS,EPB,ADC
 SG_ BCS_FLWheelSpdEdgesSum_B : 275|12@0+ (1,0) [0|4095] ""  EPB,ADC
 SG_ BCS_ABPAvailable_B : 312|1@0+ (1,0) [0|1] ""  ADC
 SG_ BCS_AEBActive_B : 313|1@0+ (1,0) [0|1] ""  ADC
 SG_ BCS_AEBAvailable_B : 314|1@0+ (1,0) [0|1] ""  ADC
 SG_ BCS_RRWheelSpd_B : 311|13@0+ (0.05625,0) [0|240] "km/h"  CCU,CCURT1,RT1_C1,EPS,EPB,ADC
 SG_ BCS_FRWheelSpdEdgesSum_B : 327|12@0+ (1,0) [0|4095] ""  EPB,ADC
 SG_ BCS_RLWheelSpdEdgesSum_B : 331|12@0+ (1,0) [0|4095] ""  EPB,ADC
 SG_ BCS_AWBActive_B : 352|1@0+ (1,0) [0|1] ""  ADC
 SG_ BCS_AWBAvailable_B : 353|1@0+ (1,0) [0|1] ""  ADC
 SG_ BCS_InputRodStroke_B : 350|10@0+ (0.05,-5) [-5|46.15] "mm"  CCU,CCURT1,RT1_C1,ADC
 SG_ BCS_HDCCtrlSt_B : 364|2@0+ (1,0) [0|3] ""  ADC
 SG_ BCS_FLWheelRotatedDirection_B : 366|2@0+ (1,0) [0|3] ""  CCU,CCURT1,RT1_C1,ADC
 SG_ BCS_InputRodStrokeSt_B : 367|1@0+ (1,0) [0|1] ""  CCU,CCURT1,RT1_C1,ADC
 SG_ BCS_BrkTqCtrlActvRdn_B : 369|2@0+ (1,0) [0|3] ""  CCU,ADC
 SG_ BCS_FRWheelRotatedDirection_B : 371|2@0+ (1,0) [0|3] ""  CCU,CCURT1,RT1_C1,ADC
 SG_ BCS_RLWheelRotatedDirection_B : 373|2@0+ (1,0) [0|3] ""  CCU,CCURT1,RT1_C1,ADC
 SG_ BCS_PlungerPressureSt_B : 374|1@0+ (1,0) [0|1] ""  CCU,CCURT1,RT1_C1,EPB,ADC
 SG_ BCS_RRWheelRotatedDirection_B : 377|2@0+ (1,0) [0|3] ""  CCU,CCURT1,RT1_C1,ADC
 SG_ BCS_ParkingReqToEPB_B : 379|2@0+ (1,0) [0|3] ""  EPB,ADC
 SG_ BCS_VehicleStandStillSt_B : 381|2@0+ (1,0) [0|3] ""  EBB,ADC
 SG_ BCS_L3ComVD_B : 382|1@0+ (1,0) [0|1] ""  CCU,ADC
 SG_ BCS_BrkTqCtrlAvlDrivingRdn_B : 386|3@0+ (1,0) [0|7] ""  CCU,ADC
 SG_ BCS_LFIActiveSt_B : 391|1@0+ (1,0) [0|1] ""  CCU,ADC
 SG_ BCS_RRWheelSpdEdgesSum_B : 431|12@0+ (1,0) [0|4095] ""  EPB,ADC
 SG_ BCS_PlungerPressure_B : 435|12@0+ (0.1,-5) [-5|301.9] "bar"  CCU,CCURT1,RT1_C1,EPB,ADC

BO_ 363 EPS_1_C: 64 EPS
 SG_ EPS_1_CRC : 7|16@0+ (1,0) [0|65535] ""  CCU,CCURT1,CCURT2,RT1_C1,RT2_C3,IBCS,ADC,IFC
 SG_ EPS_1_Counter : 23|8@0+ (1,0) [0|255] ""  CCU,CCURT1,CCURT2,RT1_C1,RT2_C3,IBCS,ADC,IFC
 SG_ EPS_StrngWhlTorqVD : 31|1@0+ (1,0) [0|1] ""  CCU,CCURT1,RT1_C1,ADC,IFC
 SG_ EPS_StrngWhlTorq : 30|12@0+ (0.01,-15) [-15|15] "Nm"  CCU,CCURT1,RT1_C1,ADC,IFC
 SG_ TAS_CalibratedSt : 34|1@0+ (1,0) [0|1] ""  CCU,CCURT1,RT1_C1,IBCS,ADC,IFC
 SG_ EPS_SteeringAngleSpdVD : 32|1@0+ (1,0) [0|1] ""  CCU,CCURT1,CCURT2,RT1_C1,RT2_C3,IBCS,ADC
 SG_ EPS_SteeringAngleSpd : 47|8@0+ (4,0) [0|1016] "deg/sec"  CCU,CCURT1,CCURT2,RT1_C1,RT2_C3,IBCS,ADC
 SG_ EPS_SteeringAngle : 55|16@0+ (0.1,-780) [-780|780] "deg"  CCU,CCURT1,CCURT2,RT1_C0,RT1_C1,RT2_C3,IBCS,ADC,IFC
 SG_ EPS_SteeringAngleVD : 71|1@0+ (1,0) [0|1] ""  CCU,CCURT1,CCURT2,RT1_C0,RT1_C1,RT2_C3,IBCS,ADC,IFC
 SG_ EPS_ThermalSt : 69|2@0+ (1,0) [0|3] ""  CCU,CCURT1,RT1_C1,ADC
 SG_ EPS_VMCErrFeedback : 84|4@0+ (1,0) [0|15] ""  CCU,CCURT1,RT1_C1,ADC
 SG_ EPS_PstOverlaySt : 103|3@0+ (1,0) [0|7] ""  CCU,ADC
 SG_ EPS_HealthySt_DualSide : 100|2@0+ (1,0) [0|3] ""  CCU,ADC
 SG_ EPS_VibrationWarnSt_A : 97|2@0+ (1,0) [0|3] ""  CCU,ADC
 SG_ SAC_ErrFeedback_SideA : 111|4@0+ (1,0) [0|15] ""  CCU,ADC
 SG_ EPS_ADASTargetAngle : 119|16@0+ (0.1,-780) [-780|780] "deg"  CCU,CCURT1,RT1_C1,ADC
 SG_ EPS_FunctionStyleSt : 135|2@0+ (1,0) [0|3] ""  CCU,CCURT1,RT1_C1,ADC
 SG_ EPS_SteeringModeSt : 133|2@0+ (1,0) [0|3] ""  CCU,CCURT1,RT1_C1,ADC
 SG_ EPS_ReqAngOverRange : 140|1@0+ (1,0) [0|1] ""  CCU,CCURT1,RT1_C1,ADC
 SG_ EPS_SACMotorTorAct : 139|12@0+ (0.01,-6) [-6|6] "Nm"  CCU,CCURT1,RT1_C1,ADC
 SG_ EPS_SACMotorTorLimInt : 159|11@0+ (0.01,0) [0|6] "Nm"  CCU,CCURT1,RT1_C1,ADC
 SG_ EPS_ReqAngSpdOverRange : 164|1@0+ (1,0) [0|1] ""  CCU,CCURT1,RT1_C1,ADC
 SG_ EPS_AssistPraSwitchToLKA : 163|1@0+ (1,0) [0|1] ""  CCU,CCURT1,RT1_C1,ADC
 SG_ EPS_SteerGainEnable : 162|1@0+ (1,0) [0|1] ""  CCU,CCURT1,RT1_C1,ADC
 SG_ EPS_EmSteerEnbale : 161|1@0+ (1,0) [0|1] ""  CCU,ADC
 SG_ EPS_EM_ErrFeedback : 171|4@0+ (1,0) [0|15] ""  CCU,ADC
 SG_ EPS_VW_ErrFeedback : 183|4@0+ (1,0) [0|15] ""  CCU,ADC
 SG_ EPS_SG_ErrFeedback : 175|4@0+ (1,0) [0|15] ""  CCU,ADC
 SG_ EPS_SACMotorTorActMot : 191|12@0+ (0.01,-6) [-6|6] "Nm"  CCU,CCURT1,RT1_C1,ADC,IFC
 SG_ EPS_SACMotorTorLimIntMot : 194|11@0+ (0.01,0) [0|6] "Nm"  CCU,CCURT1,RT1_C1,ADC,IFC
 SG_ EPS_SG_ActualLevel : 215|8@0+ (1,0) [0|254] "%"  CCU,CCURT1,RT1_C1,ADC
 SG_ EPS_MotorTorSum : 219|12@0+ (0.01,-6) [-6|6] "Nm"  CCU,CCURT1,RT1_C1,ADC
 SG_ EPS_WarnLamp : 242|2@0+ (1,0) [0|3] ""  CCU,CCURT1,RT1_C1,ADC
 SG_ EPS_AssistRatio : 263|8@0+ (1,0) [0|255] ""  CCU,CCURT1,RT1_C1,ADC
 SG_ EPS_SteeringWhlTorFlt : 271|12@0+ (0.01,-15) [-15|15] "Nm"  CCU,CCURT1,RT1_C1,ADC
 SG_ EPS_SteeringWhlTorFltVD : 275|2@0+ (1,0) [0|3] ""  CCU,CCURT1,RT1_C1,ADC
 SG_ EPS_SteeringAngleRate : 273|14@0+ (0.2,-1600) [-1600|1600] "deg/s"  CCU,CCURT1,RT1_C1,ADC
 SG_ EPS_TqCtrlSt : 291|2@0+ (1,0) [0|3] ""  CCU,CCURT1,RT1_C1,ADC
 SG_ EPS_MotorTorForDrv : 239|12@0+ (0.01,-20) [-20|20] "Nm"  CCU,CCURT1,RT1_C1,ADC
 SG_ EPS_TqCtrlAvl : 221|2@0+ (1,0) [0|3] ""  CCU,CCURT1,RT1_C1,ADC
 SG_ EPS_AgCtrlAvl : 223|2@0+ (1,0) [0|3] ""  CCU,CCURT1,RT1_C1,ADC
 SG_ EPS_MotorTorSumVD : 243|1@0+ (1,0) [0|1] ""  CCU,CCURT1,RT1_C1,ADC
 SG_ EPS_DrvOveRideSt : 160|1@0+ (1,0) [0|1] ""  CCU,CCURT1,RT1_C1,ADC
 SG_ EPS_DrvOveRideVD : 176|1@0+ (1,0) [0|1] ""  CCU,CCURT1,RT1_C1,ADC
 SG_ EPS_SteerVibrlAvl : 195|1@0+ (1,0) [0|1] ""  CCU,CCURT1,RT1_C1,ADC
 SG_ EPS_HandsOffDetStVD : 240|1@0+ (1,0) [0|1] ""  CCU,CCURT1,RT1_C1,ADC
 SG_ EPS_HandsOffDetSt : 289|2@0+ (1,0) [0|3] ""  CCU,CCURT1,RT1_C1,ADC
 SG_ EPS_SteerMod : 303|3@0+ (1,0) [0|7] ""  CCU,CCURT1,RT1_C1,ADC
 SG_ EPS_ADCNetErrorFb : 359|3@0+ (1,0) [0|7] ""  CCU,CCURT1,RT1_C1,ADC
 SG_ EPS_NetModeResp : 356|2@0+ (1,0) [0|3] ""  CCU,CCURT1,RT1_C1,ADC

BO_ 360 BCS_6_C: 64 IBCS
 SG_ BCS_6_CRC : 7|16@0+ (1,0) [0|65535] ""  CCU,CCURT1,RT1_C1,ADC
 SG_ BCS_6_Counter : 23|8@0+ (1,0) [0|255] ""  CCU,CCURT1,RT1_C1,ADC
 SG_ BCS_HydBrkActTorqFL : 31|16@0+ (1,-32768) [-32768|32767] "Nm"  CCU,CCURT1,RT1_C1,ADC
 SG_ BCS_HydBrkActTorqFR : 47|16@0+ (1,-32768) [-32768|32767] "Nm"  CCU,CCURT1,RT1_C1,ADC
 SG_ BCS_HydBrkActTorqRL : 63|16@0+ (1,-32768) [-32768|32767] "Nm"  CCU,CCURT1,RT1_C1,ADC
 SG_ BCS_HydBrkActTorqRR : 79|16@0+ (1,-32768) [-32768|32767] "Nm"  CCU,CCURT1,RT1_C1,ADC
 SG_ BCS_HydBrkTorqReq : 95|16@0+ (1,-32768) [-32768|32767] "Nm"  CCU,CCURT1,RT1_C1,ADC
 SG_ BCS_BrkActTorq : 111|16@0+ (1,-32768) [-32768|32767] "Nm"  CCU,CCURT1,RT1_C1,ADC
 SG_ BCS_HydBrkActTorq : 127|16@0+ (1,-32768) [-32768|32767] "Nm"  CCU,CCURT1,RT1_C1,ADC
 SG_ BCS_DycActTorq : 143|16@0+ (1,-32768) [-32768|32767] "Nm"  CCU,CCURT1,RT1_C1,ADC
 SG_ BCS_ChVehSpd : 156|13@0+ (0.05625,0) [0|240] "km/h"  CCU,ADC
 SG_ BCS_BrkTqCtrlAvlDriving : 159|3@0+ (1,0) [0|7] ""  CCU,ADC
 SG_ BCS_BrkTqCtrlAvlParking : 173|2@0+ (1,0) [0|3] ""  CCU,ADC
 SG_ BCS_BrkTqCtrlActv : 175|2@0+ (1,0) [0|3] ""  CCU,CCURT1,RT1_C1,ADC
 SG_ BCS_ChVehSpdVD : 188|1@0+ (1,0) [0|1] ""  CCU,ADC
 SG_ BCS_ESCFailSt : 189|1@0+ (1,0) [0|1] ""  CCU,CCURT1,RT1_C1,ADC
 SG_ BCS_ESCFuncActiveSt : 190|1@0+ (1,0) [0|1] ""  CCU,CCURT1,RT1_C1,ADC
 SG_ BCS_DycEscTarTqCtrlAvl : 191|1@0+ (1,0) [0|1] ""  CCU,ADC
 SG_ BCS_errorFb : 215|4@0+ (1,0) [0|15] ""  CCU,ADC
 SG_ BCS_DrvrBrkOvrd : 217|1@0+ (1,0) [0|1] ""  CCU,CCURT1,RT1_C1,ADC
 SG_ BCS_DrvrBrkOvrdVD : 218|1@0+ (1,0) [0|1] ""  CCU,CCURT1,RT1_C1,ADC
 SG_ BCS_DycEscTarTqActv : 219|1@0+ (1,0) [0|1] ""  CCU,CCURT1,RT1_C1,ADC
 SG_ BCS_WheelSlipFLVD : 220|1@0+ (1,0) [0|1] ""  CCU,ADC
 SG_ BCS_WheelSlipFRVD : 221|1@0+ (1,0) [0|1] ""  CCU,ADC
 SG_ BCS_WheelSlipRLVD : 222|1@0+ (1,0) [0|1] ""  CCU,ADC
 SG_ BCS_WheelSlipRRVD : 223|1@0+ (1,0) [0|1] ""  CCU,ADC
 SG_ BCS_DrvrReqBrkTorq : 231|16@0+ (1,-32768) [-32768|32767] "Nm"  CCU,CCURT1,RT1_C1,ADC
 SG_ BCS_BrkTarRecpTorqFA : 247|14@0+ (1,-6000) [-6000|10380] "Nm"  CCU,ADC
 SG_ BCS_BrkTarRecpTorqFASt : 249|2@0+ (1,0) [0|3] ""  CCU,ADC
 SG_ BCS_BrkTarRecpTorqRA : 263|14@0+ (1,-6000) [-6000|10380] "Nm"  CCU,ADC
 SG_ BCS_BrkTarRecpTorqRASt : 265|2@0+ (1,0) [0|3] ""  CCU,ADC
 SG_ BCS_BrkTarRecpTorq : 279|14@0+ (1,-6000) [-6000|10380] "Nm"  CCU,ADC
 SG_ BCS_BrkTarRecpTorqSt : 281|2@0+ (1,0) [0|3] ""  CCU,ADC
 SG_ BCS_EngTorqDecFastRL : 295|14@0+ (1,-6000) [-6000|10380] "Nm"  CCU,CCURT1,RT1_C1,ADC
 SG_ BCS_EngTorqDecActiveStRL : 183|1@0+ (1,0) [0|1] ""  CCU,CCURT1,RT1_C1,ADC
 SG_ BCS_EngTorqDecFastRR : 297|14@0+ (1,-6000) [-6000|10380] "Nm"  CCU,CCURT1,RT1_C1,ADC
 SG_ BCS_EngTorqDecActiveStRR : 216|1@0+ (1,0) [0|1] ""  CCU,CCURT1,RT1_C1,ADC
 SG_ BCS_BrkTqCtrlAvlParkingRdn : 187|3@0+ (1,0) [0|7] ""  CCU,ADC
 SG_ BCS_WheelSlipFL : 199|8@0+ (0.004,0) [0|1.002] ""  CCU,ADC
 SG_ BCS_WheelSlipFR : 207|8@0+ (0.004,0) [0|1.002] ""  CCU,ADC
 SG_ BCS_WheelSlipRL : 343|8@0+ (0.004,0) [0|1.002] ""  CCU,ADC
 SG_ BCS_WheelSlipRR : 351|8@0+ (0.004,0) [0|1.002] ""  CCU,ADC
 SG_ BCS_ICCSt : 182|1@0+ (1,0) [0|1] ""  CCU,CCURT1,RT1_C1,ADC
 SG_ BCS_ICCAvl : 184|1@0+ (1,0) [0|1] ""  CCU,CCURT1,RT1_C1,ADC
 SG_ BCS_ICCErrFb : 181|4@0+ (1,0) [0|15] ""  CCU,CCURT1,RT1_C1,ADC
 SG_ BCS_SimulatorPressureSt_1 : 436|1@0+ (1,0) [0|1] ""  CCU,ADC
 SG_ BCS_SysSt_1 : 439|3@0+ (1,0) [0|7] ""  CCU,ADC
 SG_ BCS_FWAWarning_1 : 425|2@0+ (1,0) [0|3] ""  CCU,ADC
 SG_ BCS_CSTSt_1 : 427|2@0+ (1,0) [0|3] ""  CCU,ADC
 SG_ BCS_AVDCActive_1 : 428|1@0+ (1,0) [0|1] ""  CCU,ADC
 SG_ BCS_AVDCAvailable_1 : 429|1@0+ (1,0) [0|1] ""  CCU,ADC
 SG_ BCS_SimulatorPressure_1 : 435|12@0+ (0.1,-5) [-5|301.9] "bar"  CCU,ADC

CM_ SG_ 2015 Fun_Diag_Request "Diagnostic function request";
CM_ SG_ 352 BCS_2_CRC "E2E Profile 5 CRC";
CM_ SG_ 352 BCS_2_Counter "E2E Profile 5 Counter";
CM_ SG_ 352 BCS_VehSpd "Vehicle speed";
CM_ SG_ 352 BCS_VehSpdVD "Quality/fault information to vehicle speed";
CM_ SG_ 352 BCS_EBDActiveSt "Indication that EBD system currently performs a brake/engine intervention";
CM_ SG_ 352 BCS_EBDFaultSt "ABS system has detected a heavy fault, which does not even allow a reliable electronic brake distribution and is therefore completely shut down";
CM_ SG_ 352 BCS_ABSActiveSt "Indication that ABS system currently performs a brake intervention";
CM_ SG_ 352 BCS_ABSFaultSt "ABS system has detected a failure which does no allow a reliable ABS regulation and is therefore switched off";
CM_ SG_ 352 BCS_TCSActiveSt "Indication that TCS system currently performs a brake/engine intervention";
CM_ SG_ 352 BCS_TCSFaultSt "TCS is switched off due to detected failure";
CM_ SG_ 352 BCS_VDCActiveSt "Indication that VDC system currently performs a brake/engine intervention when ESC adjust the posture of vehicle ";
CM_ SG_ 352 BCS_VDCFaultSt "VDC is switched off due to detected failure";
CM_ SG_ 352 BCS_EngTorqDecFastRA "This torque  is engine combustion(indicated)decreased target torque (fast) for Rear Axle";
CM_ SG_ 352 BCS_PreAndRealVDCActiveSt "Indication that VDC system currently performs a brake/engine intervention when ESC increase pressure ";
CM_ SG_ 352 BCS_DTCAvailable "Indicate whether ESC can follow ePedal request and modify the recuperation torque";
CM_ SG_ 352 BCS_DTCActiveSt "Reduce repcuperation torque requested by oppotize TCS control active status";
CM_ SG_ 352 BCS_EngTorqIncRA "This torque  is  increased enginecombustion(indicated)target torque for Rear Axle";
CM_ SG_ 352 BCS_RealTCSActiveSt "Indication that TCS system currently real performs a brake/engine intervention ";
CM_ SG_ 352 BCS_CrbsActive "Indicate whether ESP recuperation torque is controlled by CRBS ";
CM_ SG_ 352 BCS_BrkPedalStVD "The validity  of brake pedal status";
CM_ SG_ 352 BCS_TargetRecpTorqRqFA "Target recuperation torque request by BCS to generator,applies to 4WD and front wheel drive";
CM_ SG_ 352 BCS_TargetRecpTorqRqFASt "Status of target recuperation torque request by BCS to generator,applies to 4WD and front wheel drive";
CM_ SG_ 352 BCS_TargetRecpTorqRqRA "Target recuperation torque request by BCS to generator,applies to 4WD and rear wheel drive";
CM_ SG_ 352 BCS_TargetRecpTorqRqRASt "Status of target recuperation torque request by BCS to generator,applies to 4WD and rear wheel drive";
CM_ SG_ 352 BCS_EngTorqDecActiveStRA "Decrease enginetorque  active status (fast and low) for Rear Axle";
CM_ SG_ 352 BCS_EngTorqIncActiveStRA "Increased engine torque  active status for Rear Axle";
CM_ SG_ 352 BCS_BrkPedalSt "IBCS Brake Pedal Status";
CM_ SG_ 352 BCS_EngTorqDecActiveStFA "Decrease enginetorque  active status (fast and low) for Front Axle";
CM_ SG_ 352 BCS_EngTorqIncActiveStFA "Increased engine torque  active status for Front Axle";
CM_ SG_ 352 BCS_EngTorqDecFastFA "This torque  is engine combustion(indicated) decreased target torque (fast)";
CM_ SG_ 352 BCS_EngTorqIncFA "This torque  is  increased engine combustion(indicated)target torque ";
CM_ SG_ 352 BCS_ADCNetErrorFb "ADC Net Error Feedback";
CM_ SG_ 352 BCS_NetModeResp "IBCS  Brake Torque Response Status in Main  Net";
CM_ SG_ 352 BCS_FLWheelSpdVD_B "Quality/fault information to current wheel speed of front left wheel";
CM_ SG_ 352 BCS_FLWheelRotatedDirectionVD_B "FL wheel rotate direction validity";
CM_ SG_ 352 BCS_FRWheelSpdVD_B "Quality/fault information to current wheel speed of front right  wheel";
CM_ SG_ 352 BCS_FRWheelRotatedDirectionVD_B "FR wheel rotate direction validity";
CM_ SG_ 352 BCS_RLWheelSpdVD_B "Quality/fault information to current wheel speed of rear left wheel";
CM_ SG_ 352 BCS_RLWheelRotatedDirectionVD_B "RL wheel rotate direction validity";
CM_ SG_ 352 BCS_RRWheelSpdVD_B "Quality/fault information to current wheel speed of rear right wheel";
CM_ SG_ 352 BCS_FLWheelSpd_B "Current wheel speed information of front left wheel";
CM_ SG_ 352 BCS_RRWheelRotatedDirectionVD_B "RR wheel rotate direction validity";
CM_ SG_ 352 BCS_HHCCtrlSt_B "HHC(Hill Hold Control) control status";
CM_ SG_ 352 BCS_HDCErrSt_B "HDC error status";
CM_ SG_ 352 BCS_FRWheelSpd_B "Current wheel speed information of front right wheel";
CM_ SG_ 352 BCS_RLWheelSpdEdgesSumVD_B "Quality/fault information to current wheel speed edges sum of rear left wheel";
CM_ SG_ 352 BCS_RRWheelSpdEdgesSumVD_B "Quality/fault information to current wheel speed edges sum of rear right wheel";
CM_ SG_ 352 BCS_VDCOff_B "VDC is switched off ";
CM_ SG_ 352 BCS_AVHSt_B "Indicates AVH(Auto Vehicle Hold)in active or not ";
CM_ SG_ 352 BCS_AVHStandby_B "Indicates AVH(Auto Vehicle Hold)in standby mode or not ";
CM_ SG_ 352 BCS_AVHAvailable_B "HMI responsible, can get degrate AVH(Auto Vehicle Hold) statement from DSW and send out ";
CM_ SG_ 352 BCS_TCSOff_B "TCS is switched off ";
CM_ SG_ 352 BCS_BrakeOverHeat_B "Indicating brake temperature too high or not";
CM_ SG_ 352 BCS_FRWheelSpdEdgesSumVD_B "Quality/fault information to current wheel speed edges sum of front right wheel";
CM_ SG_ 352 BCS_FLWheelSpdEdgesSumVD_B "Quality/fault information to current wheel speed edges sum of front left wheel";
CM_ SG_ 352 BCS_ABAactive_B "ABA(Adaptive Brake Assistance) is active";
CM_ SG_ 352 BCS_ABAavailable_B "The ABA(Adaptive Brake Assistance)  function is available";
CM_ SG_ 352 BCS_ABPActive_B "ABP(Automatic brake Pre-fill) is active";
CM_ SG_ 352 BCS_RLWheelSpd_B "Current wheel speed information of rear left wheel";
CM_ SG_ 352 BCS_FLWheelSpdEdgesSum_B "Accumulated sum of rising and falling edges of front left wheel speed sensor output·since IGN ON( the wheel plate have 48 teeth/cycle,the edge is 96)";
CM_ SG_ 352 BCS_ABPAvailable_B "ABP(Automatic brake Pre-fill) is available";
CM_ SG_ 352 BCS_AEBActive_B "AEB(Automatic EmergencyBraking) is active (in deceleration)";
CM_ SG_ 352 BCS_AEBAvailable_B "AEB(Automatic EmergencyBraking) is available";
CM_ SG_ 352 BCS_RRWheelSpd_B "Current wheel speed information of rear right wheel";
CM_ SG_ 352 BCS_FRWheelSpdEdgesSum_B "Accumulated sum of rising and falling edges of front right wheel speed sensor output·since IGN ON( the wheel plate have 48 teeth/cycle,the edge is 96)";
CM_ SG_ 352 BCS_RLWheelSpdEdgesSum_B "Accumulated sum of rising and falling edges of rear left wheel speed sensor output·since IGN ON( the wheel plate have 48 teeth/cycle,the edge is 96)";
CM_ SG_ 352 BCS_AWBActive_B "AWB(Automatic Warning Brake) is active";
CM_ SG_ 352 BCS_AWBAvailable_B "AWB(Automatic Warning Brake) is available";
CM_ SG_ 352 BCS_InputRodStroke_B "Indicate inputRod stroke value";
CM_ SG_ 352 BCS_HDCCtrlSt_B "HDC(Hill Descent Control) control status";
CM_ SG_ 352 BCS_FLWheelRotatedDirection_B "FL wheel rotate direction";
CM_ SG_ 352 BCS_InputRodStrokeSt_B "Indicate inputRod stroke status";
CM_ SG_ 352 BCS_BrkTqCtrlActvRdn_B "It indicates  whether  ESC/IBCS is  responsed for the brake request of ADAS, in redunant mode,including L3/L4/L5.";
CM_ SG_ 352 BCS_FRWheelRotatedDirection_B "FR wheel rotate direction";
CM_ SG_ 352 BCS_RLWheelRotatedDirection_B "RL wheel rotate direction";
CM_ SG_ 352 BCS_PlungerPressureSt_B "Indicate plunger pressure status";
CM_ SG_ 352 BCS_RRWheelRotatedDirection_B "RR wheel rotate direction";
CM_ SG_ 352 BCS_ParkingReqToEPB_B "Indicates the release/lock brake request to EPB";
CM_ SG_ 352 BCS_VehicleStandStillSt_B "Indicating whether the vehicle is standstill or not;must not be set until standstill is surely reached.";
CM_ SG_ 352 BCS_L3ComVD_B "The validity of CAN bus communication .";
CM_ SG_ 352 BCS_BrkTqCtrlAvlDrivingRdn_B "It indicates  whether  ESC/IBCS is available for cruise function ，in redunant mode,including L3/L4/L5.";
CM_ SG_ 352 BCS_LFIActiveSt_B "The activation status of the LFI function。";
CM_ SG_ 352 BCS_RRWheelSpdEdgesSum_B "Accumulated sum of rising and falling edges of  rear right wheel speed sensor output·since IGN ON( the wheel plate have 48 teeth/cycle,the edge is 96)";
CM_ SG_ 352 BCS_PlungerPressure_B "Indicate plunger pressure value";
CM_ SG_ 363 EPS_1_CRC "E2E Profile 5 CRC";
CM_ SG_ 363 EPS_1_Counter "E2E Profile 5 Counter";
CM_ SG_ 363 EPS_StrngWhlTorqVD "Steering Wheel Torque valid value";
CM_ SG_ 363 EPS_StrngWhlTorq "Steering wheel Torque ";
CM_ SG_ 363 TAS_CalibratedSt "The calibration information of steering angle sensor";
CM_ SG_ 363 EPS_SteeringAngleSpd "steering wheel angle speed";
CM_ SG_ 363 EPS_SteeringAngle "steering wheel angle";
CM_ SG_ 363 EPS_SteeringAngleVD "indicate that Angle VD";
CM_ SG_ 363 EPS_ThermalSt "EPS over thermal limit state";
CM_ SG_ 363 EPS_VMCErrFeedback "EPS Error reason feedback to VMC";
CM_ SG_ 363 EPS_PstOverlaySt "Overall EPS Position Overlay Control State";
CM_ SG_ 363 EPS_HealthySt_DualSide "Overall EPS Healthy States";
CM_ SG_ 363 EPS_VibrationWarnSt_A "Vibration Warn State";
CM_ SG_ 363 SAC_ErrFeedback_SideA "EPS_A Errer Feedback";
CM_ SG_ 363 EPS_ADASTargetAngle "EPS's target Angle after the safety limit";
CM_ SG_ 363 EPS_FunctionStyleSt "EPS function style state";
CM_ SG_ 363 EPS_SteeringModeSt "EPS steering mode status";
CM_ SG_ 363 EPS_ReqAngOverRange "target angle received from ADAS/IFC over the safety range";
CM_ SG_ 363 EPS_SACMotorTorAct "SAC Actural motor torque";
CM_ SG_ 363 EPS_SACMotorTorLimInt "EPS’s internal safety limit of SAC motor torque";
CM_ SG_ 363 EPS_ReqAngSpdOverRange "Angular speed of target angle received from ADAS/IFC over the safety range";
CM_ SG_ 363 EPS_AssistPraSwitchToLKA "Indicate EPS Swithinto fixed steering parameters";
CM_ SG_ 363 EPS_SteerGainEnable "Steering Gain Enable";
CM_ SG_ 363 EPS_EmSteerEnbale "Emergency Steering Enable";
CM_ SG_ 363 EPS_EM_ErrFeedback "Emergency Steering Enable Feedback";
CM_ SG_ 363 EPS_VW_ErrFeedback "Vibration Warn Enable Feedback";
CM_ SG_ 363 EPS_SG_ErrFeedback "Steering Gain Enable Error Feedback";
CM_ SG_ 363 EPS_SACMotorTorActMot "SAC Actural motor torque";
CM_ SG_ 363 EPS_MotorTorSum "EPS Motor output Torque  (including SAC and driver steering) ";
CM_ SG_ 363 EPS_WarnLamp "Streering Warning Lamp";
CM_ SG_ 363 EPS_AssistRatio "feedback to IDC the assist ratio ";
CM_ SG_ 363 EPS_SteeringWhlTorFlt "Steering wheel torque after Elfa filtering";
CM_ SG_ 363 EPS_SteeringWhlTorFltVD "indicate that EPS_SteeringWhlTorFlt Valid or not";
CM_ SG_ 363 EPS_SteeringAngleRate "steering wheel angle rate";
CM_ SG_ 363 EPS_TqCtrlSt "ESP response state for ADAS moter torque request";
CM_ SG_ 363 EPS_MotorTorForDrv "EPS motor Torque value for driver steering";
CM_ SG_ 363 EPS_TqCtrlAvl "EPS moter torque control available state for ADAS";
CM_ SG_ 363 EPS_AgCtrlAvl "EPS steer angle control available state for ADAS";
CM_ SG_ 363 EPS_MotorTorSumVD "EPS motor torque valid state of driver steering";
CM_ SG_ 363 EPS_DrvOveRideSt "Driver override detection state";
CM_ SG_ 363 EPS_DrvOveRideVD "Driver override detection valid state";
CM_ SG_ 363 EPS_SteerVibrlAvl "EPS steer vibration control available state for ADAS";
CM_ SG_ 363 EPS_HandsOffDetStVD "Hands Off Detected States valid value";
CM_ SG_ 363 EPS_HandsOffDetSt "Hands Off Detected States";
CM_ SG_ 363 EPS_SteerMod "EPS working mode";
CM_ SG_ 363 EPS_ADCNetErrorFb "ADC Network Fault Feedback";
CM_ SG_ 363 EPS_NetModeResp "EPS Net Mode Response";
CM_ SG_ 360 BCS_6_CRC "E2E Profile 5 CRC";
CM_ SG_ 360 BCS_6_Counter "E2E Profile 5 Counter";
CM_ SG_ 360 BCS_HydBrkActTorqFL "Hydraulic brake torque of the  front left wheel";
CM_ SG_ 360 BCS_HydBrkActTorqFR "Hydraulic brake torque of the  front right wheel";
CM_ SG_ 360 BCS_HydBrkActTorqRL "Hydraulic brake torque of the  rear left wheel";
CM_ SG_ 360 BCS_HydBrkActTorqRR "Hydraulic brake torque of the  rear right wheel";
CM_ SG_ 360 BCS_HydBrkTorqReq "It is the target brake torque to hydraulic brake";
CM_ SG_ 360 BCS_BrkActTorq "It is the real total brake  torque carried out by electric motor（ recuperation torque or electric brake torque）and ESC/IBCS（hydraulic braketorque）.";
CM_ SG_ 360 BCS_HydBrkActTorq "It is the real hydraulic brake  torque carried out by ESC/IBCS.";
CM_ SG_ 360 BCS_DycActTorq "The real  DYC(Direct  yaw moment control)  of the ESC/IBCS";
CM_ SG_ 360 BCS_ChVehSpd "Vehicle characteristic speed ";
CM_ SG_ 360 BCS_BrkTqCtrlAvlDriving "It indicates  whether ESC/IBCS is available for cruise function.";
CM_ SG_ 360 BCS_BrkTqCtrlAvlParking "It indicates  whether ESC/IBCS is available for parking function.";
CM_ SG_ 360 BCS_BrkTqCtrlActv "It indicates  whether ESC/IBCS is  responsed for the brake request of ADAS.";
CM_ SG_ 360 BCS_ChVehSpdVD "Quality/fault information to vehicle  characteristic speed ";
CM_ SG_ 360 BCS_ESCFailSt "It indicates whether ESC/IBCS is error.When any function of ESC/IBCS is error ，it will be error。";
CM_ SG_ 360 BCS_ESCFuncActiveSt "It indicates whether ESC/IBCS is active. When any function of ESC/IBCS is active ，it will be active。";
CM_ SG_ 360 BCS_DycEscTarTqCtrlAvl "The validity  of the DYC(Direct  yaw moment control)  of the ESC/IBCS";
CM_ SG_ 360 BCS_errorFb "Errors related to the braking system(ESP/IPB).It indicates the braking system can not respond to the deceleration request（brake torque） of the ADAS。";
CM_ SG_ 360 BCS_DrvrBrkOvrd "Indicate driver brakes torque more than the ADAS/ADS. ";
CM_ SG_ 360 BCS_DrvrBrkOvrdVD "The validity  of  BCS_DrvrBrkOvrd";
CM_ SG_ 360 BCS_DycEscTarTqActv "Indicates the DYC of the ESC/IBCS in active or not";
CM_ SG_ 360 BCS_WheelSlipFLVD "The validity  of slip ratio of the  front left wheel";
CM_ SG_ 360 BCS_WheelSlipFRVD "The validity of slip ratio of the  front right wheel";
CM_ SG_ 360 BCS_WheelSlipRLVD "The validity of slip ratio of the  rear left wheel";
CM_ SG_ 360 BCS_WheelSlipRRVD "The validity of slip ratio of the  rear right wheel";
CM_ SG_ 360 BCS_DrvrReqBrkTorq "When driver prsees brake pedal，It is the brake torque calculated by ESC/IBCS corresponding to  inputRod stroke.";
CM_ SG_ 360 BCS_BrkTarRecpTorqFA "CRBS target recuperation torque requested by BCS to generator,applies to  front wheel drive ";
CM_ SG_ 360 BCS_BrkTarRecpTorqFASt "Status of BCS_BrkRecpTorqRqFA";
CM_ SG_ 360 BCS_BrkTarRecpTorqRA "CRBS target recuperation torque requested by BCS to generator,applies to  rear wheel drive ";
CM_ SG_ 360 BCS_BrkTarRecpTorqRASt "Status of BCS_BrkRecpTorqRqRA";
CM_ SG_ 360 BCS_BrkTarRecpTorq "CRBS target recuperation torque requested by BCS to generator,applies to 4WD and front wheel drive /rear wheel drive";
CM_ SG_ 360 BCS_BrkTarRecpTorqSt "CRBS target recuperation torque requested by BCS to generator,applies to 4WD and front wheel drive /rear wheel drive";
CM_ SG_ 360 BCS_EngTorqDecFastRL "Target torque(fast) is decreased  for left rear wheel hub motor";
CM_ SG_ 360 BCS_EngTorqDecActiveStRL "Status of target torque(fast) is decreased  for left rear wheel hub motor";
CM_ SG_ 360 BCS_EngTorqDecFastRR "Target torque(fast) is decreased  for right rear wheel hub motor";
CM_ SG_ 360 BCS_EngTorqDecActiveStRR "Status of target torque(fast) is decreased  for right rear wheel hub motor";
CM_ SG_ 360 BCS_BrkTqCtrlAvlParkingRdn "It indicates  whether ESP/IPB is available for parking function,in redunant mode,including L3/L4/L5.";
CM_ SG_ 360 BCS_WheelSlipFL "Slip ratio of the  front left wheel";
CM_ SG_ 360 BCS_WheelSlipFR "Slip ratio of the  front right wheel";
CM_ SG_ 360 BCS_WheelSlipRL "Slip ratio of the  rear left wheel";
CM_ SG_ 360 BCS_WheelSlipRR "Slip ratio of the  rear right wheel";
CM_ SG_ 360 BCS_ICCSt "BCS enables a response signal to the ICC brake interface";
CM_ SG_ 360 BCS_ICCAvl "BCS is available for ICC interface";
CM_ SG_ 360 BCS_ICCErrFb "The IBCS responds to the cause feedback of the ICCS brake interface exception";
CM_ SG_ 360 BCS_SimulatorPressureSt_1 "Indicate simulator pressure status";
CM_ SG_ 360 BCS_SysSt_1 "IBCS system state";
CM_ SG_ 360 BCS_FWAWarning_1 "Indicate FWA state, dashboard need warn driver";
CM_ SG_ 360 BCS_CSTSt_1 "indicates CST status. Only valid for project with CST function.";
CM_ SG_ 360 BCS_AVDCActive_1 "Indicate AVDC deceleration active or not";
CM_ SG_ 360 BCS_AVDCAvailable_1 "Indicate AVDC deceleration available ornot";
CM_ SG_ 360 BCS_SimulatorPressure_1 "Indicate simulator pressure value";

BA_DEF_ BO_  "GenMsgCycleTime" INT 0 0;
BA_DEF_ BO_  "GenMsgCycleTimeFast" INT 0 0;
BA_DEF_ BO_  "GenMsgSendType" ENUM  "Periodic","Event","IfActive","POE","PA","FixedPeriodic","Event","EnabledPeriodic","NotUsed","NotUsed","EventPeriodic","NotUsed","NotUsed","NoMsgSendType";
BA_DEF_ BO_  "VFrameFormat" ENUM  "StandardCAN","ExtendedCAN","reserved","reserved","reserved","reserved","reserved","reserved","reserved","reserved","reserved","reserved","reserved","reserved","StandardCAN_FD","ExtendedCAN_FD";
BA_DEF_ BO_  "CANFD_BRS" ENUM  "0","1";
BA_DEF_ SG_  "EventCommandSignal" ENUM  "No","Yes";
BA_DEF_ SG_  "GatewayedSignals" ENUM  "No","Yes";
BA_DEF_ SG_  "GenSigInactiveValue" HEX 0 0;
BA_DEF_ SG_  "GenSigInvalidValue" HEX 0 0;
BA_DEF_ SG_  "GenSigSendType" ENUM  "Trigger","Passive","Cyclic","OnWrite","OnWriteWithRepetition","OnChange","OnChangeWithRepetition","IfActive","IfActiveWithRepetition","NoSigSendType";
BA_DEF_ SG_  "GenSigStartValue" HEX 0 0;
BA_DEF_ SG_  "GenSigTimeoutValue" HEX 0 0;
BA_DEF_ SG_  "Remark" STRING ;
BA_DEF_  "Manufacturer" STRING ;
BA_DEF_  "Project" STRING ;
BA_DEF_  "Version" STRING ;
BA_DEF_  "Date" STRING ;
BA_DEF_  "Author" STRING ;
BA_DEF_  "DBName" STRING ;
BA_DEF_  "BusType" STRING ;
BA_DEF_  "Checker" STRING ;
BA_DEF_  "Approver" STRING ;
BA_ "Manufacturer" "GACRND";
BA_ "Project" "A88";
BA_ "Version" "0.1";
BA_ "Date" "2026-8-27 11:37:31";
BA_ "Author" "LeoFeng";
BA_ "DBName" "ADCPublic_CANFD2";
BA_ "BusType" "CAN FD";
BA_ "Checker" "Miss Fan";
BA_ "Approver" "Mr Hu";

BA_ "GenMsgCycleTime" BO_ 2015 0;
BA_ "GenMsgCycleTimeFast" BO_ 2015 0;
BA_ "GenMsgSendType" BO_ 2015 1;
BA_ "VFrameFormat" BO_ 2015 14;
BA_ "CANFD_BRS" BO_ 2015 1;
BA_ "GenMsgCycleTime" BO_ 352 10;
BA_ "GenMsgCycleTimeFast" BO_ 352 0;
BA_ "GenMsgSendType" BO_ 352 0;
BA_ "VFrameFormat" BO_ 352 14;
BA_ "CANFD_BRS" BO_ 352 1;
BA_ "GenMsgCycleTime" BO_ 352 10;
BA_ "GenMsgCycleTimeFast" BO_ 352 0;
BA_ "GenMsgSendType" BO_ 352 0;
BA_ "VFrameFormat" BO_ 352 14;
BA_ "CANFD_BRS" BO_ 352 1;
BA_ "GenMsgCycleTime" BO_ 352 10;
BA_ "GenMsgCycleTimeFast" BO_ 352 0;
BA_ "GenMsgSendType" BO_ 352 0;
BA_ "VFrameFormat" BO_ 352 14;
BA_ "CANFD_BRS" BO_ 352 1;
BA_ "GenMsgCycleTime" BO_ 352 10;
BA_ "GenMsgCycleTimeFast" BO_ 352 0;
BA_ "GenMsgSendType" BO_ 352 0;
BA_ "VFrameFormat" BO_ 352 14;
BA_ "CANFD_BRS" BO_ 352 1;
BA_ "GenMsgCycleTime" BO_ 352 10;
BA_ "GenMsgCycleTimeFast" BO_ 352 0;
BA_ "GenMsgSendType" BO_ 352 0;
BA_ "VFrameFormat" BO_ 352 14;
BA_ "CANFD_BRS" BO_ 352 1;
BA_ "GenMsgCycleTime" BO_ 352 10;
BA_ "GenMsgCycleTimeFast" BO_ 352 0;
BA_ "GenMsgSendType" BO_ 352 0;
BA_ "VFrameFormat" BO_ 352 14;
BA_ "CANFD_BRS" BO_ 352 1;
BA_ "GenMsgCycleTime" BO_ 352 10;
BA_ "GenMsgCycleTimeFast" BO_ 352 0;
BA_ "GenMsgSendType" BO_ 352 0;
BA_ "VFrameFormat" BO_ 352 14;
BA_ "CANFD_BRS" BO_ 352 1;
BA_ "GenMsgCycleTime" BO_ 352 10;
BA_ "GenMsgCycleTimeFast" BO_ 352 0;
BA_ "GenMsgSendType" BO_ 352 0;
BA_ "VFrameFormat" BO_ 352 14;
BA_ "CANFD_BRS" BO_ 352 1;
BA_ "GenMsgCycleTime" BO_ 352 10;
BA_ "GenMsgCycleTimeFast" BO_ 352 0;
BA_ "GenMsgSendType" BO_ 352 0;
BA_ "VFrameFormat" BO_ 352 14;
BA_ "CANFD_BRS" BO_ 352 1;
BA_ "GenMsgCycleTime" BO_ 352 10;
BA_ "GenMsgCycleTimeFast" BO_ 352 0;
BA_ "GenMsgSendType" BO_ 352 0;
BA_ "VFrameFormat" BO_ 352 14;
BA_ "CANFD_BRS" BO_ 352 1;
BA_ "GenMsgCycleTime" BO_ 352 10;
BA_ "GenMsgCycleTimeFast" BO_ 352 0;
BA_ "GenMsgSendType" BO_ 352 0;
BA_ "VFrameFormat" BO_ 352 14;
BA_ "CANFD_BRS" BO_ 352 1;
BA_ "GenMsgCycleTime" BO_ 352 10;
BA_ "GenMsgCycleTimeFast" BO_ 352 0;
BA_ "GenMsgSendType" BO_ 352 0;
BA_ "VFrameFormat" BO_ 352 14;
BA_ "CANFD_BRS" BO_ 352 1;
BA_ "GenMsgCycleTime" BO_ 352 10;
BA_ "GenMsgCycleTimeFast" BO_ 352 0;
BA_ "GenMsgSendType" BO_ 352 0;
BA_ "VFrameFormat" BO_ 352 14;
BA_ "CANFD_BRS" BO_ 352 1;
BA_ "GenMsgCycleTime" BO_ 352 10;
BA_ "GenMsgCycleTimeFast" BO_ 352 0;
BA_ "GenMsgSendType" BO_ 352 0;
BA_ "VFrameFormat" BO_ 352 14;
BA_ "CANFD_BRS" BO_ 352 1;
BA_ "GenMsgCycleTime" BO_ 352 10;
BA_ "GenMsgCycleTimeFast" BO_ 352 0;
BA_ "GenMsgSendType" BO_ 352 0;
BA_ "VFrameFormat" BO_ 352 14;
BA_ "CANFD_BRS" BO_ 352 1;
BA_ "GenMsgCycleTime" BO_ 352 10;
BA_ "GenMsgCycleTimeFast" BO_ 352 0;
BA_ "GenMsgSendType" BO_ 352 0;
BA_ "VFrameFormat" BO_ 352 14;
BA_ "CANFD_BRS" BO_ 352 1;
BA_ "GenMsgCycleTime" BO_ 352 10;
BA_ "GenMsgCycleTimeFast" BO_ 352 0;
BA_ "GenMsgSendType" BO_ 352 0;
BA_ "VFrameFormat" BO_ 352 14;
BA_ "CANFD_BRS" BO_ 352 1;
BA_ "GenMsgCycleTime" BO_ 352 10;
BA_ "GenMsgCycleTimeFast" BO_ 352 0;
BA_ "GenMsgSendType" BO_ 352 0;
BA_ "VFrameFormat" BO_ 352 14;
BA_ "CANFD_BRS" BO_ 352 1;
BA_ "GenMsgCycleTime" BO_ 352 10;
BA_ "GenMsgCycleTimeFast" BO_ 352 0;
BA_ "GenMsgSendType" BO_ 352 0;
BA_ "VFrameFormat" BO_ 352 14;
BA_ "CANFD_BRS" BO_ 352 1;
BA_ "GenMsgCycleTime" BO_ 352 10;
BA_ "GenMsgCycleTimeFast" BO_ 352 0;
BA_ "GenMsgSendType" BO_ 352 0;
BA_ "VFrameFormat" BO_ 352 14;
BA_ "CANFD_BRS" BO_ 352 1;
BA_ "GenMsgCycleTime" BO_ 352 10;
BA_ "GenMsgCycleTimeFast" BO_ 352 0;
BA_ "GenMsgSendType" BO_ 352 0;
BA_ "VFrameFormat" BO_ 352 14;
BA_ "CANFD_BRS" BO_ 352 1;
BA_ "GenMsgCycleTime" BO_ 352 10;
BA_ "GenMsgCycleTimeFast" BO_ 352 0;
BA_ "GenMsgSendType" BO_ 352 0;
BA_ "VFrameFormat" BO_ 352 14;
BA_ "CANFD_BRS" BO_ 352 1;
BA_ "GenMsgCycleTime" BO_ 352 10;
BA_ "GenMsgCycleTimeFast" BO_ 352 0;
BA_ "GenMsgSendType" BO_ 352 0;
BA_ "VFrameFormat" BO_ 352 14;
BA_ "CANFD_BRS" BO_ 352 1;
BA_ "GenMsgCycleTime" BO_ 352 10;
BA_ "GenMsgCycleTimeFast" BO_ 352 0;
BA_ "GenMsgSendType" BO_ 352 0;
BA_ "VFrameFormat" BO_ 352 14;
BA_ "CANFD_BRS" BO_ 352 1;
BA_ "GenMsgCycleTime" BO_ 352 10;
BA_ "GenMsgCycleTimeFast" BO_ 352 0;
BA_ "GenMsgSendType" BO_ 352 0;
BA_ "VFrameFormat" BO_ 352 14;
BA_ "CANFD_BRS" BO_ 352 1;
BA_ "GenMsgCycleTime" BO_ 352 10;
BA_ "GenMsgCycleTimeFast" BO_ 352 0;
BA_ "GenMsgSendType" BO_ 352 0;
BA_ "VFrameFormat" BO_ 352 14;
BA_ "CANFD_BRS" BO_ 352 1;
BA_ "GenMsgCycleTime" BO_ 352 10;
BA_ "GenMsgCycleTimeFast" BO_ 352 0;
BA_ "GenMsgSendType" BO_ 352 0;
BA_ "VFrameFormat" BO_ 352 14;
BA_ "CANFD_BRS" BO_ 352 1;
BA_ "GenMsgCycleTime" BO_ 352 10;
BA_ "GenMsgCycleTimeFast" BO_ 352 0;
BA_ "GenMsgSendType" BO_ 352 0;
BA_ "VFrameFormat" BO_ 352 14;
BA_ "CANFD_BRS" BO_ 352 1;
BA_ "GenMsgCycleTime" BO_ 352 10;
BA_ "GenMsgCycleTimeFast" BO_ 352 0;
BA_ "GenMsgSendType" BO_ 352 0;
BA_ "VFrameFormat" BO_ 352 14;
BA_ "CANFD_BRS" BO_ 352 1;
BA_ "GenMsgCycleTime" BO_ 352 10;
BA_ "GenMsgCycleTimeFast" BO_ 352 0;
BA_ "GenMsgSendType" BO_ 352 0;
BA_ "VFrameFormat" BO_ 352 14;
BA_ "CANFD_BRS" BO_ 352 1;
BA_ "GenMsgCycleTime" BO_ 352 10;
BA_ "GenMsgCycleTimeFast" BO_ 352 0;
BA_ "GenMsgSendType" BO_ 352 0;
BA_ "VFrameFormat" BO_ 352 14;
BA_ "CANFD_BRS" BO_ 352 1;
BA_ "GenMsgCycleTime" BO_ 352 10;
BA_ "GenMsgCycleTimeFast" BO_ 352 0;
BA_ "GenMsgSendType" BO_ 352 0;
BA_ "VFrameFormat" BO_ 352 14;
BA_ "CANFD_BRS" BO_ 352 1;
BA_ "GenMsgCycleTime" BO_ 352 10;
BA_ "GenMsgCycleTimeFast" BO_ 352 0;
BA_ "GenMsgSendType" BO_ 352 0;
BA_ "VFrameFormat" BO_ 352 14;
BA_ "CANFD_BRS" BO_ 352 1;
BA_ "GenMsgCycleTime" BO_ 352 10;
BA_ "GenMsgCycleTimeFast" BO_ 352 0;
BA_ "GenMsgSendType" BO_ 352 0;
BA_ "VFrameFormat" BO_ 352 14;
BA_ "CANFD_BRS" BO_ 352 1;
BA_ "GenMsgCycleTime" BO_ 352 10;
BA_ "GenMsgCycleTimeFast" BO_ 352 0;
BA_ "GenMsgSendType" BO_ 352 0;
BA_ "VFrameFormat" BO_ 352 14;
BA_ "CANFD_BRS" BO_ 352 1;
BA_ "GenMsgCycleTime" BO_ 352 10;
BA_ "GenMsgCycleTimeFast" BO_ 352 0;
BA_ "GenMsgSendType" BO_ 352 0;
BA_ "VFrameFormat" BO_ 352 14;
BA_ "CANFD_BRS" BO_ 352 1;
BA_ "GenMsgCycleTime" BO_ 352 10;
BA_ "GenMsgCycleTimeFast" BO_ 352 0;
BA_ "GenMsgSendType" BO_ 352 0;
BA_ "VFrameFormat" BO_ 352 14;
BA_ "CANFD_BRS" BO_ 352 1;
BA_ "GenMsgCycleTime" BO_ 352 10;
BA_ "GenMsgCycleTimeFast" BO_ 352 0;
BA_ "GenMsgSendType" BO_ 352 0;
BA_ "VFrameFormat" BO_ 352 14;
BA_ "CANFD_BRS" BO_ 352 1;
BA_ "GenMsgCycleTime" BO_ 352 10;
BA_ "GenMsgCycleTimeFast" BO_ 352 0;
BA_ "GenMsgSendType" BO_ 352 0;
BA_ "VFrameFormat" BO_ 352 14;
BA_ "CANFD_BRS" BO_ 352 1;
BA_ "GenMsgCycleTime" BO_ 352 10;
BA_ "GenMsgCycleTimeFast" BO_ 352 0;
BA_ "GenMsgSendType" BO_ 352 0;
BA_ "VFrameFormat" BO_ 352 14;
BA_ "CANFD_BRS" BO_ 352 1;
BA_ "GenMsgCycleTime" BO_ 352 10;
BA_ "GenMsgCycleTimeFast" BO_ 352 0;
BA_ "GenMsgSendType" BO_ 352 0;
BA_ "VFrameFormat" BO_ 352 14;
BA_ "CANFD_BRS" BO_ 352 1;
BA_ "GenMsgCycleTime" BO_ 352 10;
BA_ "GenMsgCycleTimeFast" BO_ 352 0;
BA_ "GenMsgSendType" BO_ 352 0;
BA_ "VFrameFormat" BO_ 352 14;
BA_ "CANFD_BRS" BO_ 352 1;
BA_ "GenMsgCycleTime" BO_ 352 10;
BA_ "GenMsgCycleTimeFast" BO_ 352 0;
BA_ "GenMsgSendType" BO_ 352 0;
BA_ "VFrameFormat" BO_ 352 14;
BA_ "CANFD_BRS" BO_ 352 1;
BA_ "GenMsgCycleTime" BO_ 352 10;
BA_ "GenMsgCycleTimeFast" BO_ 352 0;
BA_ "GenMsgSendType" BO_ 352 0;
BA_ "VFrameFormat" BO_ 352 14;
BA_ "CANFD_BRS" BO_ 352 1;
BA_ "GenMsgCycleTime" BO_ 352 10;
BA_ "GenMsgCycleTimeFast" BO_ 352 0;
BA_ "GenMsgSendType" BO_ 352 0;
BA_ "VFrameFormat" BO_ 352 14;
BA_ "CANFD_BRS" BO_ 352 1;
BA_ "GenMsgCycleTime" BO_ 352 10;
BA_ "GenMsgCycleTimeFast" BO_ 352 0;
BA_ "GenMsgSendType" BO_ 352 0;
BA_ "VFrameFormat" BO_ 352 14;
BA_ "CANFD_BRS" BO_ 352 1;
BA_ "GenMsgCycleTime" BO_ 352 10;
BA_ "GenMsgCycleTimeFast" BO_ 352 0;
BA_ "GenMsgSendType" BO_ 352 0;
BA_ "VFrameFormat" BO_ 352 14;
BA_ "CANFD_BRS" BO_ 352 1;
BA_ "GenMsgCycleTime" BO_ 352 10;
BA_ "GenMsgCycleTimeFast" BO_ 352 0;
BA_ "GenMsgSendType" BO_ 352 0;
BA_ "VFrameFormat" BO_ 352 14;
BA_ "CANFD_BRS" BO_ 352 1;
BA_ "GenMsgCycleTime" BO_ 352 10;
BA_ "GenMsgCycleTimeFast" BO_ 352 0;
BA_ "GenMsgSendType" BO_ 352 0;
BA_ "VFrameFormat" BO_ 352 14;
BA_ "CANFD_BRS" BO_ 352 1;
BA_ "GenMsgCycleTime" BO_ 352 10;
BA_ "GenMsgCycleTimeFast" BO_ 352 0;
BA_ "GenMsgSendType" BO_ 352 0;
BA_ "VFrameFormat" BO_ 352 14;
BA_ "CANFD_BRS" BO_ 352 1;
BA_ "GenMsgCycleTime" BO_ 352 10;
BA_ "GenMsgCycleTimeFast" BO_ 352 0;
BA_ "GenMsgSendType" BO_ 352 0;
BA_ "VFrameFormat" BO_ 352 14;
BA_ "CANFD_BRS" BO_ 352 1;
BA_ "GenMsgCycleTime" BO_ 352 10;
BA_ "GenMsgCycleTimeFast" BO_ 352 0;
BA_ "GenMsgSendType" BO_ 352 0;
BA_ "VFrameFormat" BO_ 352 14;
BA_ "CANFD_BRS" BO_ 352 1;
BA_ "GenMsgCycleTime" BO_ 352 10;
BA_ "GenMsgCycleTimeFast" BO_ 352 0;
BA_ "GenMsgSendType" BO_ 352 0;
BA_ "VFrameFormat" BO_ 352 14;
BA_ "CANFD_BRS" BO_ 352 1;
BA_ "GenMsgCycleTime" BO_ 352 10;
BA_ "GenMsgCycleTimeFast" BO_ 352 0;
BA_ "GenMsgSendType" BO_ 352 0;
BA_ "VFrameFormat" BO_ 352 14;
BA_ "CANFD_BRS" BO_ 352 1;
BA_ "GenMsgCycleTime" BO_ 352 10;
BA_ "GenMsgCycleTimeFast" BO_ 352 0;
BA_ "GenMsgSendType" BO_ 352 0;
BA_ "VFrameFormat" BO_ 352 14;
BA_ "CANFD_BRS" BO_ 352 1;
BA_ "GenMsgCycleTime" BO_ 352 10;
BA_ "GenMsgCycleTimeFast" BO_ 352 0;
BA_ "GenMsgSendType" BO_ 352 0;
BA_ "VFrameFormat" BO_ 352 14;
BA_ "CANFD_BRS" BO_ 352 1;
BA_ "GenMsgCycleTime" BO_ 352 10;
BA_ "GenMsgCycleTimeFast" BO_ 352 0;
BA_ "GenMsgSendType" BO_ 352 0;
BA_ "VFrameFormat" BO_ 352 14;
BA_ "CANFD_BRS" BO_ 352 1;
BA_ "GenMsgCycleTime" BO_ 352 10;
BA_ "GenMsgCycleTimeFast" BO_ 352 0;
BA_ "GenMsgSendType" BO_ 352 0;
BA_ "VFrameFormat" BO_ 352 14;
BA_ "CANFD_BRS" BO_ 352 1;
BA_ "GenMsgCycleTime" BO_ 352 10;
BA_ "GenMsgCycleTimeFast" BO_ 352 0;
BA_ "GenMsgSendType" BO_ 352 0;
BA_ "VFrameFormat" BO_ 352 14;
BA_ "CANFD_BRS" BO_ 352 1;
BA_ "GenMsgCycleTime" BO_ 352 10;
BA_ "GenMsgCycleTimeFast" BO_ 352 0;
BA_ "GenMsgSendType" BO_ 352 0;
BA_ "VFrameFormat" BO_ 352 14;
BA_ "CANFD_BRS" BO_ 352 1;
BA_ "GenMsgCycleTime" BO_ 352 10;
BA_ "GenMsgCycleTimeFast" BO_ 352 0;
BA_ "GenMsgSendType" BO_ 352 0;
BA_ "VFrameFormat" BO_ 352 14;
BA_ "CANFD_BRS" BO_ 352 1;
BA_ "GenMsgCycleTime" BO_ 352 10;
BA_ "GenMsgCycleTimeFast" BO_ 352 0;
BA_ "GenMsgSendType" BO_ 352 0;
BA_ "VFrameFormat" BO_ 352 14;
BA_ "CANFD_BRS" BO_ 352 1;
BA_ "GenMsgCycleTime" BO_ 352 10;
BA_ "GenMsgCycleTimeFast" BO_ 352 0;
BA_ "GenMsgSendType" BO_ 352 0;
BA_ "VFrameFormat" BO_ 352 14;
BA_ "CANFD_BRS" BO_ 352 1;
BA_ "GenMsgCycleTime" BO_ 352 10;
BA_ "GenMsgCycleTimeFast" BO_ 352 0;
BA_ "GenMsgSendType" BO_ 352 0;
BA_ "VFrameFormat" BO_ 352 14;
BA_ "CANFD_BRS" BO_ 352 1;
BA_ "GenMsgCycleTime" BO_ 352 10;
BA_ "GenMsgCycleTimeFast" BO_ 352 0;
BA_ "GenMsgSendType" BO_ 352 0;
BA_ "VFrameFormat" BO_ 352 14;
BA_ "CANFD_BRS" BO_ 352 1;
BA_ "GenMsgCycleTime" BO_ 352 10;
BA_ "GenMsgCycleTimeFast" BO_ 352 0;
BA_ "GenMsgSendType" BO_ 352 0;
BA_ "VFrameFormat" BO_ 352 14;
BA_ "CANFD_BRS" BO_ 352 1;
BA_ "GenMsgCycleTime" BO_ 352 10;
BA_ "GenMsgCycleTimeFast" BO_ 352 0;
BA_ "GenMsgSendType" BO_ 352 0;
BA_ "VFrameFormat" BO_ 352 14;
BA_ "CANFD_BRS" BO_ 352 1;
BA_ "GenMsgCycleTime" BO_ 352 10;
BA_ "GenMsgCycleTimeFast" BO_ 352 0;
BA_ "GenMsgSendType" BO_ 352 0;
BA_ "VFrameFormat" BO_ 352 14;
BA_ "CANFD_BRS" BO_ 352 1;
BA_ "GenMsgCycleTime" BO_ 352 10;
BA_ "GenMsgCycleTimeFast" BO_ 352 0;
BA_ "GenMsgSendType" BO_ 352 0;
BA_ "VFrameFormat" BO_ 352 14;
BA_ "CANFD_BRS" BO_ 352 1;
BA_ "GenMsgCycleTime" BO_ 352 10;
BA_ "GenMsgCycleTimeFast" BO_ 352 0;
BA_ "GenMsgSendType" BO_ 352 0;
BA_ "VFrameFormat" BO_ 352 14;
BA_ "CANFD_BRS" BO_ 352 1;
BA_ "GenMsgCycleTime" BO_ 352 10;
BA_ "GenMsgCycleTimeFast" BO_ 352 0;
BA_ "GenMsgSendType" BO_ 352 0;
BA_ "VFrameFormat" BO_ 352 14;
BA_ "CANFD_BRS" BO_ 352 1;
BA_ "GenMsgCycleTime" BO_ 352 10;
BA_ "GenMsgCycleTimeFast" BO_ 352 0;
BA_ "GenMsgSendType" BO_ 352 0;
BA_ "VFrameFormat" BO_ 352 14;
BA_ "CANFD_BRS" BO_ 352 1;
BA_ "GenMsgCycleTime" BO_ 352 10;
BA_ "GenMsgCycleTimeFast" BO_ 352 0;
BA_ "GenMsgSendType" BO_ 352 0;
BA_ "VFrameFormat" BO_ 352 14;
BA_ "CANFD_BRS" BO_ 352 1;
BA_ "GenMsgCycleTime" BO_ 352 10;
BA_ "GenMsgCycleTimeFast" BO_ 352 0;
BA_ "GenMsgSendType" BO_ 352 0;
BA_ "VFrameFormat" BO_ 352 14;
BA_ "CANFD_BRS" BO_ 352 1;
BA_ "GenMsgCycleTime" BO_ 352 10;
BA_ "GenMsgCycleTimeFast" BO_ 352 0;
BA_ "GenMsgSendType" BO_ 352 0;
BA_ "VFrameFormat" BO_ 352 14;
BA_ "CANFD_BRS" BO_ 352 1;
BA_ "GenMsgCycleTime" BO_ 352 10;
BA_ "GenMsgCycleTimeFast" BO_ 352 0;
BA_ "GenMsgSendType" BO_ 352 0;
BA_ "VFrameFormat" BO_ 352 14;
BA_ "CANFD_BRS" BO_ 352 1;
BA_ "GenMsgCycleTime" BO_ 352 10;
BA_ "GenMsgCycleTimeFast" BO_ 352 0;
BA_ "GenMsgSendType" BO_ 352 0;
BA_ "VFrameFormat" BO_ 352 14;
BA_ "CANFD_BRS" BO_ 352 1;
BA_ "GenMsgCycleTime" BO_ 352 10;
BA_ "GenMsgCycleTimeFast" BO_ 352 0;
BA_ "GenMsgSendType" BO_ 352 0;
BA_ "VFrameFormat" BO_ 352 14;
BA_ "CANFD_BRS" BO_ 352 1;
BA_ "GenMsgCycleTime" BO_ 352 10;
BA_ "GenMsgCycleTimeFast" BO_ 352 0;
BA_ "GenMsgSendType" BO_ 352 0;
BA_ "VFrameFormat" BO_ 352 14;
BA_ "CANFD_BRS" BO_ 352 1;
BA_ "GenMsgCycleTime" BO_ 352 10;
BA_ "GenMsgCycleTimeFast" BO_ 352 0;
BA_ "GenMsgSendType" BO_ 352 0;
BA_ "VFrameFormat" BO_ 352 14;
BA_ "CANFD_BRS" BO_ 352 1;
BA_ "GenMsgCycleTime" BO_ 352 10;
BA_ "GenMsgCycleTimeFast" BO_ 352 0;
BA_ "GenMsgSendType" BO_ 352 0;
BA_ "VFrameFormat" BO_ 352 14;
BA_ "CANFD_BRS" BO_ 352 1;
BA_ "GenMsgCycleTime" BO_ 352 10;
BA_ "GenMsgCycleTimeFast" BO_ 352 0;
BA_ "GenMsgSendType" BO_ 352 0;
BA_ "VFrameFormat" BO_ 352 14;
BA_ "CANFD_BRS" BO_ 352 1;
BA_ "GenMsgCycleTime" BO_ 352 10;
BA_ "GenMsgCycleTimeFast" BO_ 352 0;
BA_ "GenMsgSendType" BO_ 352 0;
BA_ "VFrameFormat" BO_ 352 14;
BA_ "CANFD_BRS" BO_ 352 1;
BA_ "GenMsgCycleTime" BO_ 352 10;
BA_ "GenMsgCycleTimeFast" BO_ 352 0;
BA_ "GenMsgSendType" BO_ 352 0;
BA_ "VFrameFormat" BO_ 352 14;
BA_ "CANFD_BRS" BO_ 352 1;
BA_ "GenMsgCycleTime" BO_ 363 10;
BA_ "GenMsgCycleTimeFast" BO_ 363 0;
BA_ "GenMsgSendType" BO_ 363 0;
BA_ "VFrameFormat" BO_ 363 14;
BA_ "CANFD_BRS" BO_ 363 1;
BA_ "GenMsgCycleTime" BO_ 363 10;
BA_ "GenMsgCycleTimeFast" BO_ 363 0;
BA_ "GenMsgSendType" BO_ 363 0;
BA_ "VFrameFormat" BO_ 363 14;
BA_ "CANFD_BRS" BO_ 363 1;
BA_ "GenMsgCycleTime" BO_ 363 10;
BA_ "GenMsgCycleTimeFast" BO_ 363 0;
BA_ "GenMsgSendType" BO_ 363 0;
BA_ "VFrameFormat" BO_ 363 14;
BA_ "CANFD_BRS" BO_ 363 1;
BA_ "GenMsgCycleTime" BO_ 363 10;
BA_ "GenMsgCycleTimeFast" BO_ 363 0;
BA_ "GenMsgSendType" BO_ 363 0;
BA_ "VFrameFormat" BO_ 363 14;
BA_ "CANFD_BRS" BO_ 363 1;
BA_ "GenMsgCycleTime" BO_ 363 10;
BA_ "GenMsgCycleTimeFast" BO_ 363 0;
BA_ "GenMsgSendType" BO_ 363 0;
BA_ "VFrameFormat" BO_ 363 14;
BA_ "CANFD_BRS" BO_ 363 1;
BA_ "GenMsgCycleTime" BO_ 363 10;
BA_ "GenMsgCycleTimeFast" BO_ 363 0;
BA_ "GenMsgSendType" BO_ 363 0;
BA_ "VFrameFormat" BO_ 363 14;
BA_ "CANFD_BRS" BO_ 363 1;
BA_ "GenMsgCycleTime" BO_ 363 10;
BA_ "GenMsgCycleTimeFast" BO_ 363 0;
BA_ "GenMsgSendType" BO_ 363 0;
BA_ "VFrameFormat" BO_ 363 14;
BA_ "CANFD_BRS" BO_ 363 1;
BA_ "GenMsgCycleTime" BO_ 363 10;
BA_ "GenMsgCycleTimeFast" BO_ 363 0;
BA_ "GenMsgSendType" BO_ 363 0;
BA_ "VFrameFormat" BO_ 363 14;
BA_ "CANFD_BRS" BO_ 363 1;
BA_ "GenMsgCycleTime" BO_ 363 10;
BA_ "GenMsgCycleTimeFast" BO_ 363 0;
BA_ "GenMsgSendType" BO_ 363 0;
BA_ "VFrameFormat" BO_ 363 14;
BA_ "CANFD_BRS" BO_ 363 1;
BA_ "GenMsgCycleTime" BO_ 363 10;
BA_ "GenMsgCycleTimeFast" BO_ 363 0;
BA_ "GenMsgSendType" BO_ 363 0;
BA_ "VFrameFormat" BO_ 363 14;
BA_ "CANFD_BRS" BO_ 363 1;
BA_ "GenMsgCycleTime" BO_ 363 10;
BA_ "GenMsgCycleTimeFast" BO_ 363 0;
BA_ "GenMsgSendType" BO_ 363 0;
BA_ "VFrameFormat" BO_ 363 14;
BA_ "CANFD_BRS" BO_ 363 1;
BA_ "GenMsgCycleTime" BO_ 363 10;
BA_ "GenMsgCycleTimeFast" BO_ 363 0;
BA_ "GenMsgSendType" BO_ 363 0;
BA_ "VFrameFormat" BO_ 363 14;
BA_ "CANFD_BRS" BO_ 363 1;
BA_ "GenMsgCycleTime" BO_ 363 10;
BA_ "GenMsgCycleTimeFast" BO_ 363 0;
BA_ "GenMsgSendType" BO_ 363 0;
BA_ "VFrameFormat" BO_ 363 14;
BA_ "CANFD_BRS" BO_ 363 1;
BA_ "GenMsgCycleTime" BO_ 363 10;
BA_ "GenMsgCycleTimeFast" BO_ 363 0;
BA_ "GenMsgSendType" BO_ 363 0;
BA_ "VFrameFormat" BO_ 363 14;
BA_ "CANFD_BRS" BO_ 363 1;
BA_ "GenMsgCycleTime" BO_ 363 10;
BA_ "GenMsgCycleTimeFast" BO_ 363 0;
BA_ "GenMsgSendType" BO_ 363 0;
BA_ "VFrameFormat" BO_ 363 14;
BA_ "CANFD_BRS" BO_ 363 1;
BA_ "GenMsgCycleTime" BO_ 363 10;
BA_ "GenMsgCycleTimeFast" BO_ 363 0;
BA_ "GenMsgSendType" BO_ 363 0;
BA_ "VFrameFormat" BO_ 363 14;
BA_ "CANFD_BRS" BO_ 363 1;
BA_ "GenMsgCycleTime" BO_ 363 10;
BA_ "GenMsgCycleTimeFast" BO_ 363 0;
BA_ "GenMsgSendType" BO_ 363 0;
BA_ "VFrameFormat" BO_ 363 14;
BA_ "CANFD_BRS" BO_ 363 1;
BA_ "GenMsgCycleTime" BO_ 363 10;
BA_ "GenMsgCycleTimeFast" BO_ 363 0;
BA_ "GenMsgSendType" BO_ 363 0;
BA_ "VFrameFormat" BO_ 363 14;
BA_ "CANFD_BRS" BO_ 363 1;
BA_ "GenMsgCycleTime" BO_ 363 10;
BA_ "GenMsgCycleTimeFast" BO_ 363 0;
BA_ "GenMsgSendType" BO_ 363 0;
BA_ "VFrameFormat" BO_ 363 14;
BA_ "CANFD_BRS" BO_ 363 1;
BA_ "GenMsgCycleTime" BO_ 363 10;
BA_ "GenMsgCycleTimeFast" BO_ 363 0;
BA_ "GenMsgSendType" BO_ 363 0;
BA_ "VFrameFormat" BO_ 363 14;
BA_ "CANFD_BRS" BO_ 363 1;
BA_ "GenMsgCycleTime" BO_ 363 10;
BA_ "GenMsgCycleTimeFast" BO_ 363 0;
BA_ "GenMsgSendType" BO_ 363 0;
BA_ "VFrameFormat" BO_ 363 14;
BA_ "CANFD_BRS" BO_ 363 1;
BA_ "GenMsgCycleTime" BO_ 363 10;
BA_ "GenMsgCycleTimeFast" BO_ 363 0;
BA_ "GenMsgSendType" BO_ 363 0;
BA_ "VFrameFormat" BO_ 363 14;
BA_ "CANFD_BRS" BO_ 363 1;
BA_ "GenMsgCycleTime" BO_ 363 10;
BA_ "GenMsgCycleTimeFast" BO_ 363 0;
BA_ "GenMsgSendType" BO_ 363 0;
BA_ "VFrameFormat" BO_ 363 14;
BA_ "CANFD_BRS" BO_ 363 1;
BA_ "GenMsgCycleTime" BO_ 363 10;
BA_ "GenMsgCycleTimeFast" BO_ 363 0;
BA_ "GenMsgSendType" BO_ 363 0;
BA_ "VFrameFormat" BO_ 363 14;
BA_ "CANFD_BRS" BO_ 363 1;
BA_ "GenMsgCycleTime" BO_ 363 10;
BA_ "GenMsgCycleTimeFast" BO_ 363 0;
BA_ "GenMsgSendType" BO_ 363 0;
BA_ "VFrameFormat" BO_ 363 14;
BA_ "CANFD_BRS" BO_ 363 1;
BA_ "GenMsgCycleTime" BO_ 363 10;
BA_ "GenMsgCycleTimeFast" BO_ 363 0;
BA_ "GenMsgSendType" BO_ 363 0;
BA_ "VFrameFormat" BO_ 363 14;
BA_ "CANFD_BRS" BO_ 363 1;
BA_ "GenMsgCycleTime" BO_ 363 10;
BA_ "GenMsgCycleTimeFast" BO_ 363 0;
BA_ "GenMsgSendType" BO_ 363 0;
BA_ "VFrameFormat" BO_ 363 14;
BA_ "CANFD_BRS" BO_ 363 1;
BA_ "GenMsgCycleTime" BO_ 363 10;
BA_ "GenMsgCycleTimeFast" BO_ 363 0;
BA_ "GenMsgSendType" BO_ 363 0;
BA_ "VFrameFormat" BO_ 363 14;
BA_ "CANFD_BRS" BO_ 363 1;
BA_ "GenMsgCycleTime" BO_ 363 10;
BA_ "GenMsgCycleTimeFast" BO_ 363 0;
BA_ "GenMsgSendType" BO_ 363 0;
BA_ "VFrameFormat" BO_ 363 14;
BA_ "CANFD_BRS" BO_ 363 1;
BA_ "GenMsgCycleTime" BO_ 363 10;
BA_ "GenMsgCycleTimeFast" BO_ 363 0;
BA_ "GenMsgSendType" BO_ 363 0;
BA_ "VFrameFormat" BO_ 363 14;
BA_ "CANFD_BRS" BO_ 363 1;
BA_ "GenMsgCycleTime" BO_ 363 10;
BA_ "GenMsgCycleTimeFast" BO_ 363 0;
BA_ "GenMsgSendType" BO_ 363 0;
BA_ "VFrameFormat" BO_ 363 14;
BA_ "CANFD_BRS" BO_ 363 1;
BA_ "GenMsgCycleTime" BO_ 363 10;
BA_ "GenMsgCycleTimeFast" BO_ 363 0;
BA_ "GenMsgSendType" BO_ 363 0;
BA_ "VFrameFormat" BO_ 363 14;
BA_ "CANFD_BRS" BO_ 363 1;
BA_ "GenMsgCycleTime" BO_ 363 10;
BA_ "GenMsgCycleTimeFast" BO_ 363 0;
BA_ "GenMsgSendType" BO_ 363 0;
BA_ "VFrameFormat" BO_ 363 14;
BA_ "CANFD_BRS" BO_ 363 1;
BA_ "GenMsgCycleTime" BO_ 363 10;
BA_ "GenMsgCycleTimeFast" BO_ 363 0;
BA_ "GenMsgSendType" BO_ 363 0;
BA_ "VFrameFormat" BO_ 363 14;
BA_ "CANFD_BRS" BO_ 363 1;
BA_ "GenMsgCycleTime" BO_ 363 10;
BA_ "GenMsgCycleTimeFast" BO_ 363 0;
BA_ "GenMsgSendType" BO_ 363 0;
BA_ "VFrameFormat" BO_ 363 14;
BA_ "CANFD_BRS" BO_ 363 1;
BA_ "GenMsgCycleTime" BO_ 363 10;
BA_ "GenMsgCycleTimeFast" BO_ 363 0;
BA_ "GenMsgSendType" BO_ 363 0;
BA_ "VFrameFormat" BO_ 363 14;
BA_ "CANFD_BRS" BO_ 363 1;
BA_ "GenMsgCycleTime" BO_ 363 10;
BA_ "GenMsgCycleTimeFast" BO_ 363 0;
BA_ "GenMsgSendType" BO_ 363 0;
BA_ "VFrameFormat" BO_ 363 14;
BA_ "CANFD_BRS" BO_ 363 1;
BA_ "GenMsgCycleTime" BO_ 363 10;
BA_ "GenMsgCycleTimeFast" BO_ 363 0;
BA_ "GenMsgSendType" BO_ 363 0;
BA_ "VFrameFormat" BO_ 363 14;
BA_ "CANFD_BRS" BO_ 363 1;
BA_ "GenMsgCycleTime" BO_ 363 10;
BA_ "GenMsgCycleTimeFast" BO_ 363 0;
BA_ "GenMsgSendType" BO_ 363 0;
BA_ "VFrameFormat" BO_ 363 14;
BA_ "CANFD_BRS" BO_ 363 1;
BA_ "GenMsgCycleTime" BO_ 363 10;
BA_ "GenMsgCycleTimeFast" BO_ 363 0;
BA_ "GenMsgSendType" BO_ 363 0;
BA_ "VFrameFormat" BO_ 363 14;
BA_ "CANFD_BRS" BO_ 363 1;
BA_ "GenMsgCycleTime" BO_ 363 10;
BA_ "GenMsgCycleTimeFast" BO_ 363 0;
BA_ "GenMsgSendType" BO_ 363 0;
BA_ "VFrameFormat" BO_ 363 14;
BA_ "CANFD_BRS" BO_ 363 1;
BA_ "GenMsgCycleTime" BO_ 363 10;
BA_ "GenMsgCycleTimeFast" BO_ 363 0;
BA_ "GenMsgSendType" BO_ 363 0;
BA_ "VFrameFormat" BO_ 363 14;
BA_ "CANFD_BRS" BO_ 363 1;
BA_ "GenMsgCycleTime" BO_ 363 10;
BA_ "GenMsgCycleTimeFast" BO_ 363 0;
BA_ "GenMsgSendType" BO_ 363 0;
BA_ "VFrameFormat" BO_ 363 14;
BA_ "CANFD_BRS" BO_ 363 1;
BA_ "GenMsgCycleTime" BO_ 363 10;
BA_ "GenMsgCycleTimeFast" BO_ 363 0;
BA_ "GenMsgSendType" BO_ 363 0;
BA_ "VFrameFormat" BO_ 363 14;
BA_ "CANFD_BRS" BO_ 363 1;
BA_ "GenMsgCycleTime" BO_ 363 10;
BA_ "GenMsgCycleTimeFast" BO_ 363 0;
BA_ "GenMsgSendType" BO_ 363 0;
BA_ "VFrameFormat" BO_ 363 14;
BA_ "CANFD_BRS" BO_ 363 1;
BA_ "GenMsgCycleTime" BO_ 363 10;
BA_ "GenMsgCycleTimeFast" BO_ 363 0;
BA_ "GenMsgSendType" BO_ 363 0;
BA_ "VFrameFormat" BO_ 363 14;
BA_ "CANFD_BRS" BO_ 363 1;
BA_ "GenMsgCycleTime" BO_ 363 10;
BA_ "GenMsgCycleTimeFast" BO_ 363 0;
BA_ "GenMsgSendType" BO_ 363 0;
BA_ "VFrameFormat" BO_ 363 14;
BA_ "CANFD_BRS" BO_ 363 1;
BA_ "GenMsgCycleTime" BO_ 363 10;
BA_ "GenMsgCycleTimeFast" BO_ 363 0;
BA_ "GenMsgSendType" BO_ 363 0;
BA_ "VFrameFormat" BO_ 363 14;
BA_ "CANFD_BRS" BO_ 363 1;
BA_ "GenMsgCycleTime" BO_ 363 10;
BA_ "GenMsgCycleTimeFast" BO_ 363 0;
BA_ "GenMsgSendType" BO_ 363 0;
BA_ "VFrameFormat" BO_ 363 14;
BA_ "CANFD_BRS" BO_ 363 1;
BA_ "GenMsgCycleTime" BO_ 363 10;
BA_ "GenMsgCycleTimeFast" BO_ 363 0;
BA_ "GenMsgSendType" BO_ 363 0;
BA_ "VFrameFormat" BO_ 363 14;
BA_ "CANFD_BRS" BO_ 363 1;
BA_ "GenMsgCycleTime" BO_ 360 10;
BA_ "GenMsgCycleTimeFast" BO_ 360 0;
BA_ "GenMsgSendType" BO_ 360 0;
BA_ "VFrameFormat" BO_ 360 14;
BA_ "CANFD_BRS" BO_ 360 1;
BA_ "GenMsgCycleTime" BO_ 360 10;
BA_ "GenMsgCycleTimeFast" BO_ 360 0;
BA_ "GenMsgSendType" BO_ 360 0;
BA_ "VFrameFormat" BO_ 360 14;
BA_ "CANFD_BRS" BO_ 360 1;
BA_ "GenMsgCycleTime" BO_ 360 10;
BA_ "GenMsgCycleTimeFast" BO_ 360 0;
BA_ "GenMsgSendType" BO_ 360 0;
BA_ "VFrameFormat" BO_ 360 14;
BA_ "CANFD_BRS" BO_ 360 1;
BA_ "GenMsgCycleTime" BO_ 360 10;
BA_ "GenMsgCycleTimeFast" BO_ 360 0;
BA_ "GenMsgSendType" BO_ 360 0;
BA_ "VFrameFormat" BO_ 360 14;
BA_ "CANFD_BRS" BO_ 360 1;
BA_ "GenMsgCycleTime" BO_ 360 10;
BA_ "GenMsgCycleTimeFast" BO_ 360 0;
BA_ "GenMsgSendType" BO_ 360 0;
BA_ "VFrameFormat" BO_ 360 14;
BA_ "CANFD_BRS" BO_ 360 1;
BA_ "GenMsgCycleTime" BO_ 360 10;
BA_ "GenMsgCycleTimeFast" BO_ 360 0;
BA_ "GenMsgSendType" BO_ 360 0;
BA_ "VFrameFormat" BO_ 360 14;
BA_ "CANFD_BRS" BO_ 360 1;
BA_ "GenMsgCycleTime" BO_ 360 10;
BA_ "GenMsgCycleTimeFast" BO_ 360 0;
BA_ "GenMsgSendType" BO_ 360 0;
BA_ "VFrameFormat" BO_ 360 14;
BA_ "CANFD_BRS" BO_ 360 1;
BA_ "GenMsgCycleTime" BO_ 360 10;
BA_ "GenMsgCycleTimeFast" BO_ 360 0;
BA_ "GenMsgSendType" BO_ 360 0;
BA_ "VFrameFormat" BO_ 360 14;
BA_ "CANFD_BRS" BO_ 360 1;
BA_ "GenMsgCycleTime" BO_ 360 10;
BA_ "GenMsgCycleTimeFast" BO_ 360 0;
BA_ "GenMsgSendType" BO_ 360 0;
BA_ "VFrameFormat" BO_ 360 14;
BA_ "CANFD_BRS" BO_ 360 1;
BA_ "GenMsgCycleTime" BO_ 360 10;
BA_ "GenMsgCycleTimeFast" BO_ 360 0;
BA_ "GenMsgSendType" BO_ 360 0;
BA_ "VFrameFormat" BO_ 360 14;
BA_ "CANFD_BRS" BO_ 360 1;
BA_ "GenMsgCycleTime" BO_ 360 10;
BA_ "GenMsgCycleTimeFast" BO_ 360 0;
BA_ "GenMsgSendType" BO_ 360 0;
BA_ "VFrameFormat" BO_ 360 14;
BA_ "CANFD_BRS" BO_ 360 1;
BA_ "GenMsgCycleTime" BO_ 360 10;
BA_ "GenMsgCycleTimeFast" BO_ 360 0;
BA_ "GenMsgSendType" BO_ 360 0;
BA_ "VFrameFormat" BO_ 360 14;
BA_ "CANFD_BRS" BO_ 360 1;
BA_ "GenMsgCycleTime" BO_ 360 10;
BA_ "GenMsgCycleTimeFast" BO_ 360 0;
BA_ "GenMsgSendType" BO_ 360 0;
BA_ "VFrameFormat" BO_ 360 14;
BA_ "CANFD_BRS" BO_ 360 1;
BA_ "GenMsgCycleTime" BO_ 360 10;
BA_ "GenMsgCycleTimeFast" BO_ 360 0;
BA_ "GenMsgSendType" BO_ 360 0;
BA_ "VFrameFormat" BO_ 360 14;
BA_ "CANFD_BRS" BO_ 360 1;
BA_ "GenMsgCycleTime" BO_ 360 10;
BA_ "GenMsgCycleTimeFast" BO_ 360 0;
BA_ "GenMsgSendType" BO_ 360 0;
BA_ "VFrameFormat" BO_ 360 14;
BA_ "CANFD_BRS" BO_ 360 1;
BA_ "GenMsgCycleTime" BO_ 360 10;
BA_ "GenMsgCycleTimeFast" BO_ 360 0;
BA_ "GenMsgSendType" BO_ 360 0;
BA_ "VFrameFormat" BO_ 360 14;
BA_ "CANFD_BRS" BO_ 360 1;
BA_ "GenMsgCycleTime" BO_ 360 10;
BA_ "GenMsgCycleTimeFast" BO_ 360 0;
BA_ "GenMsgSendType" BO_ 360 0;
BA_ "VFrameFormat" BO_ 360 14;
BA_ "CANFD_BRS" BO_ 360 1;
BA_ "GenMsgCycleTime" BO_ 360 10;
BA_ "GenMsgCycleTimeFast" BO_ 360 0;
BA_ "GenMsgSendType" BO_ 360 0;
BA_ "VFrameFormat" BO_ 360 14;
BA_ "CANFD_BRS" BO_ 360 1;
BA_ "GenMsgCycleTime" BO_ 360 10;
BA_ "GenMsgCycleTimeFast" BO_ 360 0;
BA_ "GenMsgSendType" BO_ 360 0;
BA_ "VFrameFormat" BO_ 360 14;
BA_ "CANFD_BRS" BO_ 360 1;
BA_ "GenMsgCycleTime" BO_ 360 10;
BA_ "GenMsgCycleTimeFast" BO_ 360 0;
BA_ "GenMsgSendType" BO_ 360 0;
BA_ "VFrameFormat" BO_ 360 14;
BA_ "CANFD_BRS" BO_ 360 1;
BA_ "GenMsgCycleTime" BO_ 360 10;
BA_ "GenMsgCycleTimeFast" BO_ 360 0;
BA_ "GenMsgSendType" BO_ 360 0;
BA_ "VFrameFormat" BO_ 360 14;
BA_ "CANFD_BRS" BO_ 360 1;
BA_ "GenMsgCycleTime" BO_ 360 10;
BA_ "GenMsgCycleTimeFast" BO_ 360 0;
BA_ "GenMsgSendType" BO_ 360 0;
BA_ "VFrameFormat" BO_ 360 14;
BA_ "CANFD_BRS" BO_ 360 1;
BA_ "GenMsgCycleTime" BO_ 360 10;
BA_ "GenMsgCycleTimeFast" BO_ 360 0;
BA_ "GenMsgSendType" BO_ 360 0;
BA_ "VFrameFormat" BO_ 360 14;
BA_ "CANFD_BRS" BO_ 360 1;
BA_ "GenMsgCycleTime" BO_ 360 10;
BA_ "GenMsgCycleTimeFast" BO_ 360 0;
BA_ "GenMsgSendType" BO_ 360 0;
BA_ "VFrameFormat" BO_ 360 14;
BA_ "CANFD_BRS" BO_ 360 1;
BA_ "GenMsgCycleTime" BO_ 360 10;
BA_ "GenMsgCycleTimeFast" BO_ 360 0;
BA_ "GenMsgSendType" BO_ 360 0;
BA_ "VFrameFormat" BO_ 360 14;
BA_ "CANFD_BRS" BO_ 360 1;
BA_ "GenMsgCycleTime" BO_ 360 10;
BA_ "GenMsgCycleTimeFast" BO_ 360 0;
BA_ "GenMsgSendType" BO_ 360 0;
BA_ "VFrameFormat" BO_ 360 14;
BA_ "CANFD_BRS" BO_ 360 1;
BA_ "GenMsgCycleTime" BO_ 360 10;
BA_ "GenMsgCycleTimeFast" BO_ 360 0;
BA_ "GenMsgSendType" BO_ 360 0;
BA_ "VFrameFormat" BO_ 360 14;
BA_ "CANFD_BRS" BO_ 360 1;
BA_ "GenMsgCycleTime" BO_ 360 10;
BA_ "GenMsgCycleTimeFast" BO_ 360 0;
BA_ "GenMsgSendType" BO_ 360 0;
BA_ "VFrameFormat" BO_ 360 14;
BA_ "CANFD_BRS" BO_ 360 1;
BA_ "GenMsgCycleTime" BO_ 360 10;
BA_ "GenMsgCycleTimeFast" BO_ 360 0;
BA_ "GenMsgSendType" BO_ 360 0;
BA_ "VFrameFormat" BO_ 360 14;
BA_ "CANFD_BRS" BO_ 360 1;
BA_ "GenMsgCycleTime" BO_ 360 10;
BA_ "GenMsgCycleTimeFast" BO_ 360 0;
BA_ "GenMsgSendType" BO_ 360 0;
BA_ "VFrameFormat" BO_ 360 14;
BA_ "CANFD_BRS" BO_ 360 1;
BA_ "GenMsgCycleTime" BO_ 360 10;
BA_ "GenMsgCycleTimeFast" BO_ 360 0;
BA_ "GenMsgSendType" BO_ 360 0;
BA_ "VFrameFormat" BO_ 360 14;
BA_ "CANFD_BRS" BO_ 360 1;
BA_ "GenMsgCycleTime" BO_ 360 10;
BA_ "GenMsgCycleTimeFast" BO_ 360 0;
BA_ "GenMsgSendType" BO_ 360 0;
BA_ "VFrameFormat" BO_ 360 14;
BA_ "CANFD_BRS" BO_ 360 1;
BA_ "GenMsgCycleTime" BO_ 360 10;
BA_ "GenMsgCycleTimeFast" BO_ 360 0;
BA_ "GenMsgSendType" BO_ 360 0;
BA_ "VFrameFormat" BO_ 360 14;
BA_ "CANFD_BRS" BO_ 360 1;
BA_ "GenMsgCycleTime" BO_ 360 10;
BA_ "GenMsgCycleTimeFast" BO_ 360 0;
BA_ "GenMsgSendType" BO_ 360 0;
BA_ "VFrameFormat" BO_ 360 14;
BA_ "CANFD_BRS" BO_ 360 1;
BA_ "GenMsgCycleTime" BO_ 360 10;
BA_ "GenMsgCycleTimeFast" BO_ 360 0;
BA_ "GenMsgSendType" BO_ 360 0;
BA_ "VFrameFormat" BO_ 360 14;
BA_ "CANFD_BRS" BO_ 360 1;
BA_ "GenMsgCycleTime" BO_ 360 10;
BA_ "GenMsgCycleTimeFast" BO_ 360 0;
BA_ "GenMsgSendType" BO_ 360 0;
BA_ "VFrameFormat" BO_ 360 14;
BA_ "CANFD_BRS" BO_ 360 1;
BA_ "GenMsgCycleTime" BO_ 360 10;
BA_ "GenMsgCycleTimeFast" BO_ 360 0;
BA_ "GenMsgSendType" BO_ 360 0;
BA_ "VFrameFormat" BO_ 360 14;
BA_ "CANFD_BRS" BO_ 360 1;
BA_ "GenMsgCycleTime" BO_ 360 10;
BA_ "GenMsgCycleTimeFast" BO_ 360 0;
BA_ "GenMsgSendType" BO_ 360 0;
BA_ "VFrameFormat" BO_ 360 14;
BA_ "CANFD_BRS" BO_ 360 1;
BA_ "GenMsgCycleTime" BO_ 360 10;
BA_ "GenMsgCycleTimeFast" BO_ 360 0;
BA_ "GenMsgSendType" BO_ 360 0;
BA_ "VFrameFormat" BO_ 360 14;
BA_ "CANFD_BRS" BO_ 360 1;
BA_ "GenMsgCycleTime" BO_ 360 10;
BA_ "GenMsgCycleTimeFast" BO_ 360 0;
BA_ "GenMsgSendType" BO_ 360 0;
BA_ "VFrameFormat" BO_ 360 14;
BA_ "CANFD_BRS" BO_ 360 1;
BA_ "GenMsgCycleTime" BO_ 360 10;
BA_ "GenMsgCycleTimeFast" BO_ 360 0;
BA_ "GenMsgSendType" BO_ 360 0;
BA_ "VFrameFormat" BO_ 360 14;
BA_ "CANFD_BRS" BO_ 360 1;
BA_ "GenMsgCycleTime" BO_ 360 10;
BA_ "GenMsgCycleTimeFast" BO_ 360 0;
BA_ "GenMsgSendType" BO_ 360 0;
BA_ "VFrameFormat" BO_ 360 14;
BA_ "CANFD_BRS" BO_ 360 1;
BA_ "GenMsgCycleTime" BO_ 360 10;
BA_ "GenMsgCycleTimeFast" BO_ 360 0;
BA_ "GenMsgSendType" BO_ 360 0;
BA_ "VFrameFormat" BO_ 360 14;
BA_ "CANFD_BRS" BO_ 360 1;
BA_ "GenMsgCycleTime" BO_ 360 10;
BA_ "GenMsgCycleTimeFast" BO_ 360 0;
BA_ "GenMsgSendType" BO_ 360 0;
BA_ "VFrameFormat" BO_ 360 14;
BA_ "CANFD_BRS" BO_ 360 1;
BA_ "GenMsgCycleTime" BO_ 360 10;
BA_ "GenMsgCycleTimeFast" BO_ 360 0;
BA_ "GenMsgSendType" BO_ 360 0;
BA_ "VFrameFormat" BO_ 360 14;
BA_ "CANFD_BRS" BO_ 360 1;
BA_ "GenMsgCycleTime" BO_ 360 10;
BA_ "GenMsgCycleTimeFast" BO_ 360 0;
BA_ "GenMsgSendType" BO_ 360 0;
BA_ "VFrameFormat" BO_ 360 14;
BA_ "CANFD_BRS" BO_ 360 1;
BA_ "GenMsgCycleTime" BO_ 360 10;
BA_ "GenMsgCycleTimeFast" BO_ 360 0;
BA_ "GenMsgSendType" BO_ 360 0;
BA_ "VFrameFormat" BO_ 360 14;
BA_ "CANFD_BRS" BO_ 360 1;
BA_ "GenMsgCycleTime" BO_ 360 10;
BA_ "GenMsgCycleTimeFast" BO_ 360 0;
BA_ "GenMsgSendType" BO_ 360 0;
BA_ "VFrameFormat" BO_ 360 14;
BA_ "CANFD_BRS" BO_ 360 1;
BA_ "GenMsgCycleTime" BO_ 360 10;
BA_ "GenMsgCycleTimeFast" BO_ 360 0;
BA_ "GenMsgSendType" BO_ 360 0;
BA_ "VFrameFormat" BO_ 360 14;
BA_ "CANFD_BRS" BO_ 360 1;
BA_ "GenMsgCycleTime" BO_ 360 10;
BA_ "GenMsgCycleTimeFast" BO_ 360 0;
BA_ "GenMsgSendType" BO_ 360 0;
BA_ "VFrameFormat" BO_ 360 14;
BA_ "CANFD_BRS" BO_ 360 1;
BA_ "GenMsgCycleTime" BO_ 360 10;
BA_ "GenMsgCycleTimeFast" BO_ 360 0;
BA_ "GenMsgSendType" BO_ 360 0;
BA_ "VFrameFormat" BO_ 360 14;
BA_ "CANFD_BRS" BO_ 360 1;
BA_ "GenMsgCycleTime" BO_ 360 10;
BA_ "GenMsgCycleTimeFast" BO_ 360 0;
BA_ "GenMsgSendType" BO_ 360 0;
BA_ "VFrameFormat" BO_ 360 14;
BA_ "CANFD_BRS" BO_ 360 1;

BA_ "EventCommandSignal" SG_ 2015 Fun_Diag_Request 0;
BA_ "GatewayedSignals" SG_ 2015 Fun_Diag_Request 0;
BA_ "GenSigInactiveValue" SG_ 2015 Fun_Diag_Request 0;
BA_ "GenSigInvalidValue" SG_ 2015 Fun_Diag_Request 0;
BA_ "GenSigSendType" SG_ 2015 Fun_Diag_Request 1;
BA_ "GenSigStartValue" SG_ 2015 Fun_Diag_Request 0;
BA_ "GenSigTimeoutValue" SG_ 2015 Fun_Diag_Request 0;
BA_ "Remark" SG_ 2015 Fun_Diag_Request "";
BA_ "EventCommandSignal" SG_ 352 BCS_2_CRC 0;
BA_ "GatewayedSignals" SG_ 352 BCS_2_CRC 0;
BA_ "GenSigInactiveValue" SG_ 352 BCS_2_CRC 0;
BA_ "GenSigInvalidValue" SG_ 352 BCS_2_CRC 0;
BA_ "GenSigSendType" SG_ 352 BCS_2_CRC 1;
BA_ "GenSigStartValue" SG_ 352 BCS_2_CRC 0;
BA_ "GenSigTimeoutValue" SG_ 352 BCS_2_CRC 0;
BA_ "Remark" SG_ 352 BCS_2_CRC "涉及ID管理表";
BA_ "EventCommandSignal" SG_ 352 BCS_2_Counter 0;
BA_ "GatewayedSignals" SG_ 352 BCS_2_Counter 0;
BA_ "GenSigInactiveValue" SG_ 352 BCS_2_Counter 0;
BA_ "GenSigInvalidValue" SG_ 352 BCS_2_Counter 0;
BA_ "GenSigSendType" SG_ 352 BCS_2_Counter 1;
BA_ "GenSigStartValue" SG_ 352 BCS_2_Counter 0;
BA_ "GenSigTimeoutValue" SG_ 352 BCS_2_Counter 0;
BA_ "Remark" SG_ 352 BCS_2_Counter "涉及ID管理表";
BA_ "EventCommandSignal" SG_ 352 BCS_VehSpd 0;
BA_ "GatewayedSignals" SG_ 352 BCS_VehSpd 0;
BA_ "GenSigInactiveValue" SG_ 352 BCS_VehSpd 0;
BA_ "GenSigInvalidValue" SG_ 352 BCS_VehSpd 0;
BA_ "GenSigSendType" SG_ 352 BCS_VehSpd 1;
BA_ "GenSigStartValue" SG_ 352 BCS_VehSpd 0;
BA_ "GenSigTimeoutValue" SG_ 352 BCS_VehSpd 0;
BA_ "Remark" SG_ 352 BCS_VehSpd "涉及ID管理表";
BA_ "EventCommandSignal" SG_ 352 BCS_VehSpdVD 0;
BA_ "GatewayedSignals" SG_ 352 BCS_VehSpdVD 0;
BA_ "GenSigInactiveValue" SG_ 352 BCS_VehSpdVD 0;
BA_ "GenSigInvalidValue" SG_ 352 BCS_VehSpdVD 0;
BA_ "GenSigSendType" SG_ 352 BCS_VehSpdVD 1;
BA_ "GenSigStartValue" SG_ 352 BCS_VehSpdVD 0;
BA_ "GenSigTimeoutValue" SG_ 352 BCS_VehSpdVD 0;
BA_ "Remark" SG_ 352 BCS_VehSpdVD "涉及ID管理表";
BA_ "EventCommandSignal" SG_ 352 BCS_EBDActiveSt 0;
BA_ "GatewayedSignals" SG_ 352 BCS_EBDActiveSt 0;
BA_ "GenSigInactiveValue" SG_ 352 BCS_EBDActiveSt 0;
BA_ "GenSigInvalidValue" SG_ 352 BCS_EBDActiveSt 0;
BA_ "GenSigSendType" SG_ 352 BCS_EBDActiveSt 1;
BA_ "GenSigStartValue" SG_ 352 BCS_EBDActiveSt 0;
BA_ "GenSigTimeoutValue" SG_ 352 BCS_EBDActiveSt 0;
BA_ "Remark" SG_ 352 BCS_EBDActiveSt "涉及ID管理表";
BA_ "EventCommandSignal" SG_ 352 BCS_EBDFaultSt 0;
BA_ "GatewayedSignals" SG_ 352 BCS_EBDFaultSt 0;
BA_ "GenSigInactiveValue" SG_ 352 BCS_EBDFaultSt 0;
BA_ "GenSigInvalidValue" SG_ 352 BCS_EBDFaultSt 0;
BA_ "GenSigSendType" SG_ 352 BCS_EBDFaultSt 1;
BA_ "GenSigStartValue" SG_ 352 BCS_EBDFaultSt 1;
BA_ "GenSigTimeoutValue" SG_ 352 BCS_EBDFaultSt 1;
BA_ "Remark" SG_ 352 BCS_EBDFaultSt "涉及ID管理表";
BA_ "EventCommandSignal" SG_ 352 BCS_ABSActiveSt 0;
BA_ "GatewayedSignals" SG_ 352 BCS_ABSActiveSt 0;
BA_ "GenSigInactiveValue" SG_ 352 BCS_ABSActiveSt 0;
BA_ "GenSigInvalidValue" SG_ 352 BCS_ABSActiveSt 0;
BA_ "GenSigSendType" SG_ 352 BCS_ABSActiveSt 1;
BA_ "GenSigStartValue" SG_ 352 BCS_ABSActiveSt 0;
BA_ "GenSigTimeoutValue" SG_ 352 BCS_ABSActiveSt 0;
BA_ "Remark" SG_ 352 BCS_ABSActiveSt "涉及ID管理表";
BA_ "EventCommandSignal" SG_ 352 BCS_ABSFaultSt 0;
BA_ "GatewayedSignals" SG_ 352 BCS_ABSFaultSt 0;
BA_ "GenSigInactiveValue" SG_ 352 BCS_ABSFaultSt 0;
BA_ "GenSigInvalidValue" SG_ 352 BCS_ABSFaultSt 0;
BA_ "GenSigSendType" SG_ 352 BCS_ABSFaultSt 1;
BA_ "GenSigStartValue" SG_ 352 BCS_ABSFaultSt 1;
BA_ "GenSigTimeoutValue" SG_ 352 BCS_ABSFaultSt 1;
BA_ "Remark" SG_ 352 BCS_ABSFaultSt "涉及ID管理表";
BA_ "EventCommandSignal" SG_ 352 BCS_TCSActiveSt 0;
BA_ "GatewayedSignals" SG_ 352 BCS_TCSActiveSt 0;
BA_ "GenSigInactiveValue" SG_ 352 BCS_TCSActiveSt 0;
BA_ "GenSigInvalidValue" SG_ 352 BCS_TCSActiveSt 0;
BA_ "GenSigSendType" SG_ 352 BCS_TCSActiveSt 1;
BA_ "GenSigStartValue" SG_ 352 BCS_TCSActiveSt 0;
BA_ "GenSigTimeoutValue" SG_ 352 BCS_TCSActiveSt 0;
BA_ "Remark" SG_ 352 BCS_TCSActiveSt "涉及ID管理表";
BA_ "EventCommandSignal" SG_ 352 BCS_TCSFaultSt 0;
BA_ "GatewayedSignals" SG_ 352 BCS_TCSFaultSt 0;
BA_ "GenSigInactiveValue" SG_ 352 BCS_TCSFaultSt 0;
BA_ "GenSigInvalidValue" SG_ 352 BCS_TCSFaultSt 0;
BA_ "GenSigSendType" SG_ 352 BCS_TCSFaultSt 1;
BA_ "GenSigStartValue" SG_ 352 BCS_TCSFaultSt 1;
BA_ "GenSigTimeoutValue" SG_ 352 BCS_TCSFaultSt 1;
BA_ "Remark" SG_ 352 BCS_TCSFaultSt "涉及ID管理表";
BA_ "EventCommandSignal" SG_ 352 BCS_VDCActiveSt 0;
BA_ "GatewayedSignals" SG_ 352 BCS_VDCActiveSt 0;
BA_ "GenSigInactiveValue" SG_ 352 BCS_VDCActiveSt 0;
BA_ "GenSigInvalidValue" SG_ 352 BCS_VDCActiveSt 0;
BA_ "GenSigSendType" SG_ 352 BCS_VDCActiveSt 1;
BA_ "GenSigStartValue" SG_ 352 BCS_VDCActiveSt 0;
BA_ "GenSigTimeoutValue" SG_ 352 BCS_VDCActiveSt 0;
BA_ "Remark" SG_ 352 BCS_VDCActiveSt "涉及ID管理表";
BA_ "EventCommandSignal" SG_ 352 BCS_VDCFaultSt 0;
BA_ "GatewayedSignals" SG_ 352 BCS_VDCFaultSt 0;
BA_ "GenSigInactiveValue" SG_ 352 BCS_VDCFaultSt 0;
BA_ "GenSigInvalidValue" SG_ 352 BCS_VDCFaultSt 0;
BA_ "GenSigSendType" SG_ 352 BCS_VDCFaultSt 1;
BA_ "GenSigStartValue" SG_ 352 BCS_VDCFaultSt 1;
BA_ "GenSigTimeoutValue" SG_ 352 BCS_VDCFaultSt 1;
BA_ "Remark" SG_ 352 BCS_VDCFaultSt "涉及ID管理表";
BA_ "EventCommandSignal" SG_ 352 BCS_EngTorqDecFastRA 0;
BA_ "GatewayedSignals" SG_ 352 BCS_EngTorqDecFastRA 0;
BA_ "GenSigInactiveValue" SG_ 352 BCS_EngTorqDecFastRA 0;
BA_ "GenSigInvalidValue" SG_ 352 BCS_EngTorqDecFastRA 0;
BA_ "GenSigSendType" SG_ 352 BCS_EngTorqDecFastRA 1;
BA_ "GenSigStartValue" SG_ 352 BCS_EngTorqDecFastRA 60000;
BA_ "GenSigTimeoutValue" SG_ 352 BCS_EngTorqDecFastRA 0;
BA_ "Remark" SG_ 352 BCS_EngTorqDecFastRA "涉及ID管理表";
BA_ "EventCommandSignal" SG_ 352 BCS_PreAndRealVDCActiveSt 0;
BA_ "GatewayedSignals" SG_ 352 BCS_PreAndRealVDCActiveSt 0;
BA_ "GenSigInactiveValue" SG_ 352 BCS_PreAndRealVDCActiveSt 0;
BA_ "GenSigInvalidValue" SG_ 352 BCS_PreAndRealVDCActiveSt 0;
BA_ "GenSigSendType" SG_ 352 BCS_PreAndRealVDCActiveSt 1;
BA_ "GenSigStartValue" SG_ 352 BCS_PreAndRealVDCActiveSt 0;
BA_ "GenSigTimeoutValue" SG_ 352 BCS_PreAndRealVDCActiveSt 0;
BA_ "Remark" SG_ 352 BCS_PreAndRealVDCActiveSt "涉及ID管理表";
BA_ "EventCommandSignal" SG_ 352 BCS_DTCAvailable 0;
BA_ "GatewayedSignals" SG_ 352 BCS_DTCAvailable 0;
BA_ "GenSigInactiveValue" SG_ 352 BCS_DTCAvailable 0;
BA_ "GenSigInvalidValue" SG_ 352 BCS_DTCAvailable 0;
BA_ "GenSigSendType" SG_ 352 BCS_DTCAvailable 1;
BA_ "GenSigStartValue" SG_ 352 BCS_DTCAvailable 0;
BA_ "GenSigTimeoutValue" SG_ 352 BCS_DTCAvailable 0;
BA_ "Remark" SG_ 352 BCS_DTCAvailable "涉及ID管理表";
BA_ "EventCommandSignal" SG_ 352 BCS_DTCActiveSt 0;
BA_ "GatewayedSignals" SG_ 352 BCS_DTCActiveSt 0;
BA_ "GenSigInactiveValue" SG_ 352 BCS_DTCActiveSt 0;
BA_ "GenSigInvalidValue" SG_ 352 BCS_DTCActiveSt 0;
BA_ "GenSigSendType" SG_ 352 BCS_DTCActiveSt 1;
BA_ "GenSigStartValue" SG_ 352 BCS_DTCActiveSt 0;
BA_ "GenSigTimeoutValue" SG_ 352 BCS_DTCActiveSt 0;
BA_ "Remark" SG_ 352 BCS_DTCActiveSt "涉及ID管理表";
BA_ "EventCommandSignal" SG_ 352 BCS_EngTorqIncRA 0;
BA_ "GatewayedSignals" SG_ 352 BCS_EngTorqIncRA 0;
BA_ "GenSigInactiveValue" SG_ 352 BCS_EngTorqIncRA 0;
BA_ "GenSigInvalidValue" SG_ 352 BCS_EngTorqIncRA 0;
BA_ "GenSigSendType" SG_ 352 BCS_EngTorqIncRA 1;
BA_ "GenSigStartValue" SG_ 352 BCS_EngTorqIncRA 0;
BA_ "GenSigTimeoutValue" SG_ 352 BCS_EngTorqIncRA 0;
BA_ "Remark" SG_ 352 BCS_EngTorqIncRA "涉及ID管理表";
BA_ "EventCommandSignal" SG_ 352 BCS_RealTCSActiveSt 0;
BA_ "GatewayedSignals" SG_ 352 BCS_RealTCSActiveSt 0;
BA_ "GenSigInactiveValue" SG_ 352 BCS_RealTCSActiveSt 0;
BA_ "GenSigInvalidValue" SG_ 352 BCS_RealTCSActiveSt 0;
BA_ "GenSigSendType" SG_ 352 BCS_RealTCSActiveSt 1;
BA_ "GenSigStartValue" SG_ 352 BCS_RealTCSActiveSt 0;
BA_ "GenSigTimeoutValue" SG_ 352 BCS_RealTCSActiveSt 0;
BA_ "Remark" SG_ 352 BCS_RealTCSActiveSt "涉及ID管理表";
BA_ "EventCommandSignal" SG_ 352 BCS_CrbsActive 0;
BA_ "GatewayedSignals" SG_ 352 BCS_CrbsActive 0;
BA_ "GenSigInactiveValue" SG_ 352 BCS_CrbsActive 0;
BA_ "GenSigInvalidValue" SG_ 352 BCS_CrbsActive 0;
BA_ "GenSigSendType" SG_ 352 BCS_CrbsActive 1;
BA_ "GenSigStartValue" SG_ 352 BCS_CrbsActive 0;
BA_ "GenSigTimeoutValue" SG_ 352 BCS_CrbsActive 0;
BA_ "Remark" SG_ 352 BCS_CrbsActive "涉及ID管理表";
BA_ "EventCommandSignal" SG_ 352 BCS_BrkPedalStVD 0;
BA_ "GatewayedSignals" SG_ 352 BCS_BrkPedalStVD 0;
BA_ "GenSigInactiveValue" SG_ 352 BCS_BrkPedalStVD 0;
BA_ "GenSigInvalidValue" SG_ 352 BCS_BrkPedalStVD 0;
BA_ "GenSigSendType" SG_ 352 BCS_BrkPedalStVD 1;
BA_ "GenSigStartValue" SG_ 352 BCS_BrkPedalStVD 0;
BA_ "GenSigTimeoutValue" SG_ 352 BCS_BrkPedalStVD 0;
BA_ "Remark" SG_ 352 BCS_BrkPedalStVD "涉及ID管理表";
BA_ "EventCommandSignal" SG_ 352 BCS_TargetRecpTorqRqFA 0;
BA_ "GatewayedSignals" SG_ 352 BCS_TargetRecpTorqRqFA 0;
BA_ "GenSigInactiveValue" SG_ 352 BCS_TargetRecpTorqRqFA 0;
BA_ "GenSigInvalidValue" SG_ 352 BCS_TargetRecpTorqRqFA 0;
BA_ "GenSigSendType" SG_ 352 BCS_TargetRecpTorqRqFA 1;
BA_ "GenSigStartValue" SG_ 352 BCS_TargetRecpTorqRqFA 6000;
BA_ "GenSigTimeoutValue" SG_ 352 BCS_TargetRecpTorqRqFA 0;
BA_ "Remark" SG_ 352 BCS_TargetRecpTorqRqFA "涉及ID管理表";
BA_ "EventCommandSignal" SG_ 352 BCS_TargetRecpTorqRqFASt 0;
BA_ "GatewayedSignals" SG_ 352 BCS_TargetRecpTorqRqFASt 0;
BA_ "GenSigInactiveValue" SG_ 352 BCS_TargetRecpTorqRqFASt 0;
BA_ "GenSigInvalidValue" SG_ 352 BCS_TargetRecpTorqRqFASt 0;
BA_ "GenSigSendType" SG_ 352 BCS_TargetRecpTorqRqFASt 1;
BA_ "GenSigStartValue" SG_ 352 BCS_TargetRecpTorqRqFASt 0;
BA_ "GenSigTimeoutValue" SG_ 352 BCS_TargetRecpTorqRqFASt 0;
BA_ "Remark" SG_ 352 BCS_TargetRecpTorqRqFASt "涉及ID管理表";
BA_ "EventCommandSignal" SG_ 352 BCS_TargetRecpTorqRqRA 0;
BA_ "GatewayedSignals" SG_ 352 BCS_TargetRecpTorqRqRA 0;
BA_ "GenSigInactiveValue" SG_ 352 BCS_TargetRecpTorqRqRA 0;
BA_ "GenSigInvalidValue" SG_ 352 BCS_TargetRecpTorqRqRA 0;
BA_ "GenSigSendType" SG_ 352 BCS_TargetRecpTorqRqRA 1;
BA_ "GenSigStartValue" SG_ 352 BCS_TargetRecpTorqRqRA 6000;
BA_ "GenSigTimeoutValue" SG_ 352 BCS_TargetRecpTorqRqRA 0;
BA_ "Remark" SG_ 352 BCS_TargetRecpTorqRqRA "涉及ID管理表";
BA_ "EventCommandSignal" SG_ 352 BCS_TargetRecpTorqRqRASt 0;
BA_ "GatewayedSignals" SG_ 352 BCS_TargetRecpTorqRqRASt 0;
BA_ "GenSigInactiveValue" SG_ 352 BCS_TargetRecpTorqRqRASt 0;
BA_ "GenSigInvalidValue" SG_ 352 BCS_TargetRecpTorqRqRASt 0;
BA_ "GenSigSendType" SG_ 352 BCS_TargetRecpTorqRqRASt 1;
BA_ "GenSigStartValue" SG_ 352 BCS_TargetRecpTorqRqRASt 0;
BA_ "GenSigTimeoutValue" SG_ 352 BCS_TargetRecpTorqRqRASt 0;
BA_ "Remark" SG_ 352 BCS_TargetRecpTorqRqRASt "涉及ID管理表";
BA_ "EventCommandSignal" SG_ 352 BCS_EngTorqDecActiveStRA 0;
BA_ "GatewayedSignals" SG_ 352 BCS_EngTorqDecActiveStRA 0;
BA_ "GenSigInactiveValue" SG_ 352 BCS_EngTorqDecActiveStRA 0;
BA_ "GenSigInvalidValue" SG_ 352 BCS_EngTorqDecActiveStRA 0;
BA_ "GenSigSendType" SG_ 352 BCS_EngTorqDecActiveStRA 1;
BA_ "GenSigStartValue" SG_ 352 BCS_EngTorqDecActiveStRA 0;
BA_ "GenSigTimeoutValue" SG_ 352 BCS_EngTorqDecActiveStRA 0;
BA_ "Remark" SG_ 352 BCS_EngTorqDecActiveStRA "涉及ID管理表";
BA_ "EventCommandSignal" SG_ 352 BCS_EngTorqIncActiveStRA 0;
BA_ "GatewayedSignals" SG_ 352 BCS_EngTorqIncActiveStRA 0;
BA_ "GenSigInactiveValue" SG_ 352 BCS_EngTorqIncActiveStRA 0;
BA_ "GenSigInvalidValue" SG_ 352 BCS_EngTorqIncActiveStRA 0;
BA_ "GenSigSendType" SG_ 352 BCS_EngTorqIncActiveStRA 1;
BA_ "GenSigStartValue" SG_ 352 BCS_EngTorqIncActiveStRA 0;
BA_ "GenSigTimeoutValue" SG_ 352 BCS_EngTorqIncActiveStRA 0;
BA_ "Remark" SG_ 352 BCS_EngTorqIncActiveStRA "涉及ID管理表";
BA_ "EventCommandSignal" SG_ 352 BCS_BrkPedalSt 0;
BA_ "GatewayedSignals" SG_ 352 BCS_BrkPedalSt 0;
BA_ "GenSigInactiveValue" SG_ 352 BCS_BrkPedalSt 0;
BA_ "GenSigInvalidValue" SG_ 352 BCS_BrkPedalSt 0;
BA_ "GenSigSendType" SG_ 352 BCS_BrkPedalSt 1;
BA_ "GenSigStartValue" SG_ 352 BCS_BrkPedalSt 0;
BA_ "GenSigTimeoutValue" SG_ 352 BCS_BrkPedalSt 0;
BA_ "Remark" SG_ 352 BCS_BrkPedalSt "涉及ID管理表";
BA_ "EventCommandSignal" SG_ 352 BCS_EngTorqDecActiveStFA 0;
BA_ "GatewayedSignals" SG_ 352 BCS_EngTorqDecActiveStFA 0;
BA_ "GenSigInactiveValue" SG_ 352 BCS_EngTorqDecActiveStFA 0;
BA_ "GenSigInvalidValue" SG_ 352 BCS_EngTorqDecActiveStFA 0;
BA_ "GenSigSendType" SG_ 352 BCS_EngTorqDecActiveStFA 1;
BA_ "GenSigStartValue" SG_ 352 BCS_EngTorqDecActiveStFA 0;
BA_ "GenSigTimeoutValue" SG_ 352 BCS_EngTorqDecActiveStFA 0;
BA_ "Remark" SG_ 352 BCS_EngTorqDecActiveStFA "涉及ID管理表";
BA_ "EventCommandSignal" SG_ 352 BCS_EngTorqIncActiveStFA 0;
BA_ "GatewayedSignals" SG_ 352 BCS_EngTorqIncActiveStFA 0;
BA_ "GenSigInactiveValue" SG_ 352 BCS_EngTorqIncActiveStFA 0;
BA_ "GenSigInvalidValue" SG_ 352 BCS_EngTorqIncActiveStFA 0;
BA_ "GenSigSendType" SG_ 352 BCS_EngTorqIncActiveStFA 1;
BA_ "GenSigStartValue" SG_ 352 BCS_EngTorqIncActiveStFA 0;
BA_ "GenSigTimeoutValue" SG_ 352 BCS_EngTorqIncActiveStFA 0;
BA_ "Remark" SG_ 352 BCS_EngTorqIncActiveStFA "涉及ID管理表";
BA_ "EventCommandSignal" SG_ 352 BCS_EngTorqDecFastFA 0;
BA_ "GatewayedSignals" SG_ 352 BCS_EngTorqDecFastFA 0;
BA_ "GenSigInactiveValue" SG_ 352 BCS_EngTorqDecFastFA 0;
BA_ "GenSigInvalidValue" SG_ 352 BCS_EngTorqDecFastFA 0;
BA_ "GenSigSendType" SG_ 352 BCS_EngTorqDecFastFA 1;
BA_ "GenSigStartValue" SG_ 352 BCS_EngTorqDecFastFA 60000;
BA_ "GenSigTimeoutValue" SG_ 352 BCS_EngTorqDecFastFA 0;
BA_ "Remark" SG_ 352 BCS_EngTorqDecFastFA "涉及ID管理表";
BA_ "EventCommandSignal" SG_ 352 BCS_EngTorqIncFA 0;
BA_ "GatewayedSignals" SG_ 352 BCS_EngTorqIncFA 0;
BA_ "GenSigInactiveValue" SG_ 352 BCS_EngTorqIncFA 0;
BA_ "GenSigInvalidValue" SG_ 352 BCS_EngTorqIncFA 0;
BA_ "GenSigSendType" SG_ 352 BCS_EngTorqIncFA 1;
BA_ "GenSigStartValue" SG_ 352 BCS_EngTorqIncFA 0;
BA_ "GenSigTimeoutValue" SG_ 352 BCS_EngTorqIncFA 0;
BA_ "Remark" SG_ 352 BCS_EngTorqIncFA "涉及ID管理表";
BA_ "EventCommandSignal" SG_ 352 BCS_ADCNetErrorFb 0;
BA_ "GatewayedSignals" SG_ 352 BCS_ADCNetErrorFb 0;
BA_ "GenSigInactiveValue" SG_ 352 BCS_ADCNetErrorFb 0;
BA_ "GenSigInvalidValue" SG_ 352 BCS_ADCNetErrorFb 0;
BA_ "GenSigSendType" SG_ 352 BCS_ADCNetErrorFb 1;
BA_ "GenSigStartValue" SG_ 352 BCS_ADCNetErrorFb 0;
BA_ "GenSigTimeoutValue" SG_ 352 BCS_ADCNetErrorFb 0;
BA_ "Remark" SG_ 352 BCS_ADCNetErrorFb "涉及ID管理表";
BA_ "EventCommandSignal" SG_ 352 BCS_NetModeResp 0;
BA_ "GatewayedSignals" SG_ 352 BCS_NetModeResp 0;
BA_ "GenSigInactiveValue" SG_ 352 BCS_NetModeResp 0;
BA_ "GenSigInvalidValue" SG_ 352 BCS_NetModeResp 0;
BA_ "GenSigSendType" SG_ 352 BCS_NetModeResp 1;
BA_ "GenSigStartValue" SG_ 352 BCS_NetModeResp 0;
BA_ "GenSigTimeoutValue" SG_ 352 BCS_NetModeResp 0;
BA_ "Remark" SG_ 352 BCS_NetModeResp "涉及ID管理表";
BA_ "EventCommandSignal" SG_ 352 BCS_FLWheelSpdVD_B 0;
BA_ "GatewayedSignals" SG_ 352 BCS_FLWheelSpdVD_B 0;
BA_ "GenSigInactiveValue" SG_ 352 BCS_FLWheelSpdVD_B 0;
BA_ "GenSigInvalidValue" SG_ 352 BCS_FLWheelSpdVD_B 0;
BA_ "GenSigSendType" SG_ 352 BCS_FLWheelSpdVD_B 1;
BA_ "GenSigStartValue" SG_ 352 BCS_FLWheelSpdVD_B 0;
BA_ "GenSigTimeoutValue" SG_ 352 BCS_FLWheelSpdVD_B 0;
BA_ "Remark" SG_ 352 BCS_FLWheelSpdVD_B "涉及ID管理表";
BA_ "EventCommandSignal" SG_ 352 BCS_FLWheelRotatedDirectionVD_B 0;
BA_ "GatewayedSignals" SG_ 352 BCS_FLWheelRotatedDirectionVD_B 0;
BA_ "GenSigInactiveValue" SG_ 352 BCS_FLWheelRotatedDirectionVD_B 0;
BA_ "GenSigInvalidValue" SG_ 352 BCS_FLWheelRotatedDirectionVD_B 0;
BA_ "GenSigSendType" SG_ 352 BCS_FLWheelRotatedDirectionVD_B 1;
BA_ "GenSigStartValue" SG_ 352 BCS_FLWheelRotatedDirectionVD_B 0;
BA_ "GenSigTimeoutValue" SG_ 352 BCS_FLWheelRotatedDirectionVD_B 0;
BA_ "Remark" SG_ 352 BCS_FLWheelRotatedDirectionVD_B "涉及ID管理表";
BA_ "EventCommandSignal" SG_ 352 BCS_FRWheelSpdVD_B 0;
BA_ "GatewayedSignals" SG_ 352 BCS_FRWheelSpdVD_B 0;
BA_ "GenSigInactiveValue" SG_ 352 BCS_FRWheelSpdVD_B 0;
BA_ "GenSigInvalidValue" SG_ 352 BCS_FRWheelSpdVD_B 0;
BA_ "GenSigSendType" SG_ 352 BCS_FRWheelSpdVD_B 1;
BA_ "GenSigStartValue" SG_ 352 BCS_FRWheelSpdVD_B 0;
BA_ "GenSigTimeoutValue" SG_ 352 BCS_FRWheelSpdVD_B 0;
BA_ "Remark" SG_ 352 BCS_FRWheelSpdVD_B "涉及ID管理表";
BA_ "EventCommandSignal" SG_ 352 BCS_FRWheelRotatedDirectionVD_B 0;
BA_ "GatewayedSignals" SG_ 352 BCS_FRWheelRotatedDirectionVD_B 0;
BA_ "GenSigInactiveValue" SG_ 352 BCS_FRWheelRotatedDirectionVD_B 0;
BA_ "GenSigInvalidValue" SG_ 352 BCS_FRWheelRotatedDirectionVD_B 0;
BA_ "GenSigSendType" SG_ 352 BCS_FRWheelRotatedDirectionVD_B 1;
BA_ "GenSigStartValue" SG_ 352 BCS_FRWheelRotatedDirectionVD_B 0;
BA_ "GenSigTimeoutValue" SG_ 352 BCS_FRWheelRotatedDirectionVD_B 0;
BA_ "Remark" SG_ 352 BCS_FRWheelRotatedDirectionVD_B "涉及ID管理表";
BA_ "EventCommandSignal" SG_ 352 BCS_RLWheelSpdVD_B 0;
BA_ "GatewayedSignals" SG_ 352 BCS_RLWheelSpdVD_B 0;
BA_ "GenSigInactiveValue" SG_ 352 BCS_RLWheelSpdVD_B 0;
BA_ "GenSigInvalidValue" SG_ 352 BCS_RLWheelSpdVD_B 0;
BA_ "GenSigSendType" SG_ 352 BCS_RLWheelSpdVD_B 1;
BA_ "GenSigStartValue" SG_ 352 BCS_RLWheelSpdVD_B 0;
BA_ "GenSigTimeoutValue" SG_ 352 BCS_RLWheelSpdVD_B 0;
BA_ "Remark" SG_ 352 BCS_RLWheelSpdVD_B "涉及ID管理表";
BA_ "EventCommandSignal" SG_ 352 BCS_RLWheelRotatedDirectionVD_B 0;
BA_ "GatewayedSignals" SG_ 352 BCS_RLWheelRotatedDirectionVD_B 0;
BA_ "GenSigInactiveValue" SG_ 352 BCS_RLWheelRotatedDirectionVD_B 0;
BA_ "GenSigInvalidValue" SG_ 352 BCS_RLWheelRotatedDirectionVD_B 0;
BA_ "GenSigSendType" SG_ 352 BCS_RLWheelRotatedDirectionVD_B 1;
BA_ "GenSigStartValue" SG_ 352 BCS_RLWheelRotatedDirectionVD_B 0;
BA_ "GenSigTimeoutValue" SG_ 352 BCS_RLWheelRotatedDirectionVD_B 0;
BA_ "Remark" SG_ 352 BCS_RLWheelRotatedDirectionVD_B "涉及ID管理表";
BA_ "EventCommandSignal" SG_ 352 BCS_RRWheelSpdVD_B 0;
BA_ "GatewayedSignals" SG_ 352 BCS_RRWheelSpdVD_B 0;
BA_ "GenSigInactiveValue" SG_ 352 BCS_RRWheelSpdVD_B 0;
BA_ "GenSigInvalidValue" SG_ 352 BCS_RRWheelSpdVD_B 0;
BA_ "GenSigSendType" SG_ 352 BCS_RRWheelSpdVD_B 1;
BA_ "GenSigStartValue" SG_ 352 BCS_RRWheelSpdVD_B 0;
BA_ "GenSigTimeoutValue" SG_ 352 BCS_RRWheelSpdVD_B 0;
BA_ "Remark" SG_ 352 BCS_RRWheelSpdVD_B "涉及ID管理表";
BA_ "EventCommandSignal" SG_ 352 BCS_FLWheelSpd_B 0;
BA_ "GatewayedSignals" SG_ 352 BCS_FLWheelSpd_B 0;
BA_ "GenSigInactiveValue" SG_ 352 BCS_FLWheelSpd_B 0;
BA_ "GenSigInvalidValue" SG_ 352 BCS_FLWheelSpd_B 0;
BA_ "GenSigSendType" SG_ 352 BCS_FLWheelSpd_B 1;
BA_ "GenSigStartValue" SG_ 352 BCS_FLWheelSpd_B 0;
BA_ "GenSigTimeoutValue" SG_ 352 BCS_FLWheelSpd_B 0;
BA_ "Remark" SG_ 352 BCS_FLWheelSpd_B "涉及ID管理表";
BA_ "EventCommandSignal" SG_ 352 BCS_RRWheelRotatedDirectionVD_B 0;
BA_ "GatewayedSignals" SG_ 352 BCS_RRWheelRotatedDirectionVD_B 0;
BA_ "GenSigInactiveValue" SG_ 352 BCS_RRWheelRotatedDirectionVD_B 0;
BA_ "GenSigInvalidValue" SG_ 352 BCS_RRWheelRotatedDirectionVD_B 0;
BA_ "GenSigSendType" SG_ 352 BCS_RRWheelRotatedDirectionVD_B 1;
BA_ "GenSigStartValue" SG_ 352 BCS_RRWheelRotatedDirectionVD_B 0;
BA_ "GenSigTimeoutValue" SG_ 352 BCS_RRWheelRotatedDirectionVD_B 0;
BA_ "Remark" SG_ 352 BCS_RRWheelRotatedDirectionVD_B "涉及ID管理表";
BA_ "EventCommandSignal" SG_ 352 BCS_HHCCtrlSt_B 0;
BA_ "GatewayedSignals" SG_ 352 BCS_HHCCtrlSt_B 0;
BA_ "GenSigInactiveValue" SG_ 352 BCS_HHCCtrlSt_B 0;
BA_ "GenSigInvalidValue" SG_ 352 BCS_HHCCtrlSt_B 0;
BA_ "GenSigSendType" SG_ 352 BCS_HHCCtrlSt_B 1;
BA_ "GenSigStartValue" SG_ 352 BCS_HHCCtrlSt_B 0;
BA_ "GenSigTimeoutValue" SG_ 352 BCS_HHCCtrlSt_B 0;
BA_ "Remark" SG_ 352 BCS_HHCCtrlSt_B "涉及ID管理表";
BA_ "EventCommandSignal" SG_ 352 BCS_HDCErrSt_B 0;
BA_ "GatewayedSignals" SG_ 352 BCS_HDCErrSt_B 0;
BA_ "GenSigInactiveValue" SG_ 352 BCS_HDCErrSt_B 0;
BA_ "GenSigInvalidValue" SG_ 352 BCS_HDCErrSt_B 0;
BA_ "GenSigSendType" SG_ 352 BCS_HDCErrSt_B 1;
BA_ "GenSigStartValue" SG_ 352 BCS_HDCErrSt_B 0;
BA_ "GenSigTimeoutValue" SG_ 352 BCS_HDCErrSt_B 1;
BA_ "Remark" SG_ 352 BCS_HDCErrSt_B "涉及ID管理表";
BA_ "EventCommandSignal" SG_ 352 BCS_FRWheelSpd_B 0;
BA_ "GatewayedSignals" SG_ 352 BCS_FRWheelSpd_B 0;
BA_ "GenSigInactiveValue" SG_ 352 BCS_FRWheelSpd_B 0;
BA_ "GenSigInvalidValue" SG_ 352 BCS_FRWheelSpd_B 0;
BA_ "GenSigSendType" SG_ 352 BCS_FRWheelSpd_B 1;
BA_ "GenSigStartValue" SG_ 352 BCS_FRWheelSpd_B 0;
BA_ "GenSigTimeoutValue" SG_ 352 BCS_FRWheelSpd_B 0;
BA_ "Remark" SG_ 352 BCS_FRWheelSpd_B "涉及ID管理表";
BA_ "EventCommandSignal" SG_ 352 BCS_RLWheelSpdEdgesSumVD_B 0;
BA_ "GatewayedSignals" SG_ 352 BCS_RLWheelSpdEdgesSumVD_B 0;
BA_ "GenSigInactiveValue" SG_ 352 BCS_RLWheelSpdEdgesSumVD_B 0;
BA_ "GenSigInvalidValue" SG_ 352 BCS_RLWheelSpdEdgesSumVD_B 0;
BA_ "GenSigSendType" SG_ 352 BCS_RLWheelSpdEdgesSumVD_B 1;
BA_ "GenSigStartValue" SG_ 352 BCS_RLWheelSpdEdgesSumVD_B 0;
BA_ "GenSigTimeoutValue" SG_ 352 BCS_RLWheelSpdEdgesSumVD_B 0;
BA_ "Remark" SG_ 352 BCS_RLWheelSpdEdgesSumVD_B "涉及ID管理表";
BA_ "EventCommandSignal" SG_ 352 BCS_RRWheelSpdEdgesSumVD_B 0;
BA_ "GatewayedSignals" SG_ 352 BCS_RRWheelSpdEdgesSumVD_B 0;
BA_ "GenSigInactiveValue" SG_ 352 BCS_RRWheelSpdEdgesSumVD_B 0;
BA_ "GenSigInvalidValue" SG_ 352 BCS_RRWheelSpdEdgesSumVD_B 0;
BA_ "GenSigSendType" SG_ 352 BCS_RRWheelSpdEdgesSumVD_B 1;
BA_ "GenSigStartValue" SG_ 352 BCS_RRWheelSpdEdgesSumVD_B 0;
BA_ "GenSigTimeoutValue" SG_ 352 BCS_RRWheelSpdEdgesSumVD_B 0;
BA_ "Remark" SG_ 352 BCS_RRWheelSpdEdgesSumVD_B "涉及ID管理表";
BA_ "EventCommandSignal" SG_ 352 BCS_VDCOff_B 0;
BA_ "GatewayedSignals" SG_ 352 BCS_VDCOff_B 0;
BA_ "GenSigInactiveValue" SG_ 352 BCS_VDCOff_B 0;
BA_ "GenSigInvalidValue" SG_ 352 BCS_VDCOff_B 0;
BA_ "GenSigSendType" SG_ 352 BCS_VDCOff_B 1;
BA_ "GenSigStartValue" SG_ 352 BCS_VDCOff_B 0;
BA_ "GenSigTimeoutValue" SG_ 352 BCS_VDCOff_B 0;
BA_ "Remark" SG_ 352 BCS_VDCOff_B "涉及ID管理表";
BA_ "EventCommandSignal" SG_ 352 BCS_AVHSt_B 0;
BA_ "GatewayedSignals" SG_ 352 BCS_AVHSt_B 0;
BA_ "GenSigInactiveValue" SG_ 352 BCS_AVHSt_B 0;
BA_ "GenSigInvalidValue" SG_ 352 BCS_AVHSt_B 0;
BA_ "GenSigSendType" SG_ 352 BCS_AVHSt_B 1;
BA_ "GenSigStartValue" SG_ 352 BCS_AVHSt_B 0;
BA_ "GenSigTimeoutValue" SG_ 352 BCS_AVHSt_B 0;
BA_ "Remark" SG_ 352 BCS_AVHSt_B "涉及ID管理表";
BA_ "EventCommandSignal" SG_ 352 BCS_AVHStandby_B 0;
BA_ "GatewayedSignals" SG_ 352 BCS_AVHStandby_B 0;
BA_ "GenSigInactiveValue" SG_ 352 BCS_AVHStandby_B 0;
BA_ "GenSigInvalidValue" SG_ 352 BCS_AVHStandby_B 0;
BA_ "GenSigSendType" SG_ 352 BCS_AVHStandby_B 1;
BA_ "GenSigStartValue" SG_ 352 BCS_AVHStandby_B 0;
BA_ "GenSigTimeoutValue" SG_ 352 BCS_AVHStandby_B 0;
BA_ "Remark" SG_ 352 BCS_AVHStandby_B "涉及ID管理表";
BA_ "EventCommandSignal" SG_ 352 BCS_AVHAvailable_B 0;
BA_ "GatewayedSignals" SG_ 352 BCS_AVHAvailable_B 0;
BA_ "GenSigInactiveValue" SG_ 352 BCS_AVHAvailable_B 0;
BA_ "GenSigInvalidValue" SG_ 352 BCS_AVHAvailable_B 0;
BA_ "GenSigSendType" SG_ 352 BCS_AVHAvailable_B 1;
BA_ "GenSigStartValue" SG_ 352 BCS_AVHAvailable_B 0;
BA_ "GenSigTimeoutValue" SG_ 352 BCS_AVHAvailable_B 0;
BA_ "Remark" SG_ 352 BCS_AVHAvailable_B "涉及ID管理表";
BA_ "EventCommandSignal" SG_ 352 BCS_TCSOff_B 0;
BA_ "GatewayedSignals" SG_ 352 BCS_TCSOff_B 0;
BA_ "GenSigInactiveValue" SG_ 352 BCS_TCSOff_B 0;
BA_ "GenSigInvalidValue" SG_ 352 BCS_TCSOff_B 0;
BA_ "GenSigSendType" SG_ 352 BCS_TCSOff_B 1;
BA_ "GenSigStartValue" SG_ 352 BCS_TCSOff_B 0;
BA_ "GenSigTimeoutValue" SG_ 352 BCS_TCSOff_B 0;
BA_ "Remark" SG_ 352 BCS_TCSOff_B "涉及ID管理表";
BA_ "EventCommandSignal" SG_ 352 BCS_BrakeOverHeat_B 0;
BA_ "GatewayedSignals" SG_ 352 BCS_BrakeOverHeat_B 0;
BA_ "GenSigInactiveValue" SG_ 352 BCS_BrakeOverHeat_B 0;
BA_ "GenSigInvalidValue" SG_ 352 BCS_BrakeOverHeat_B 0;
BA_ "GenSigSendType" SG_ 352 BCS_BrakeOverHeat_B 1;
BA_ "GenSigStartValue" SG_ 352 BCS_BrakeOverHeat_B 0;
BA_ "GenSigTimeoutValue" SG_ 352 BCS_BrakeOverHeat_B 0;
BA_ "Remark" SG_ 352 BCS_BrakeOverHeat_B "涉及ID管理表";
BA_ "EventCommandSignal" SG_ 352 BCS_FRWheelSpdEdgesSumVD_B 0;
BA_ "GatewayedSignals" SG_ 352 BCS_FRWheelSpdEdgesSumVD_B 0;
BA_ "GenSigInactiveValue" SG_ 352 BCS_FRWheelSpdEdgesSumVD_B 0;
BA_ "GenSigInvalidValue" SG_ 352 BCS_FRWheelSpdEdgesSumVD_B 0;
BA_ "GenSigSendType" SG_ 352 BCS_FRWheelSpdEdgesSumVD_B 1;
BA_ "GenSigStartValue" SG_ 352 BCS_FRWheelSpdEdgesSumVD_B 0;
BA_ "GenSigTimeoutValue" SG_ 352 BCS_FRWheelSpdEdgesSumVD_B 0;
BA_ "Remark" SG_ 352 BCS_FRWheelSpdEdgesSumVD_B "涉及ID管理表";
BA_ "EventCommandSignal" SG_ 352 BCS_FLWheelSpdEdgesSumVD_B 0;
BA_ "GatewayedSignals" SG_ 352 BCS_FLWheelSpdEdgesSumVD_B 0;
BA_ "GenSigInactiveValue" SG_ 352 BCS_FLWheelSpdEdgesSumVD_B 0;
BA_ "GenSigInvalidValue" SG_ 352 BCS_FLWheelSpdEdgesSumVD_B 0;
BA_ "GenSigSendType" SG_ 352 BCS_FLWheelSpdEdgesSumVD_B 1;
BA_ "GenSigStartValue" SG_ 352 BCS_FLWheelSpdEdgesSumVD_B 0;
BA_ "GenSigTimeoutValue" SG_ 352 BCS_FLWheelSpdEdgesSumVD_B 0;
BA_ "Remark" SG_ 352 BCS_FLWheelSpdEdgesSumVD_B "涉及ID管理表";
BA_ "EventCommandSignal" SG_ 352 BCS_ABAactive_B 0;
BA_ "GatewayedSignals" SG_ 352 BCS_ABAactive_B 0;
BA_ "GenSigInactiveValue" SG_ 352 BCS_ABAactive_B 0;
BA_ "GenSigInvalidValue" SG_ 352 BCS_ABAactive_B 0;
BA_ "GenSigSendType" SG_ 352 BCS_ABAactive_B 1;
BA_ "GenSigStartValue" SG_ 352 BCS_ABAactive_B 0;
BA_ "GenSigTimeoutValue" SG_ 352 BCS_ABAactive_B 0;
BA_ "Remark" SG_ 352 BCS_ABAactive_B "涉及ID管理表";
BA_ "EventCommandSignal" SG_ 352 BCS_ABAavailable_B 0;
BA_ "GatewayedSignals" SG_ 352 BCS_ABAavailable_B 0;
BA_ "GenSigInactiveValue" SG_ 352 BCS_ABAavailable_B 0;
BA_ "GenSigInvalidValue" SG_ 352 BCS_ABAavailable_B 0;
BA_ "GenSigSendType" SG_ 352 BCS_ABAavailable_B 1;
BA_ "GenSigStartValue" SG_ 352 BCS_ABAavailable_B 0;
BA_ "GenSigTimeoutValue" SG_ 352 BCS_ABAavailable_B 0;
BA_ "Remark" SG_ 352 BCS_ABAavailable_B "涉及ID管理表";
BA_ "EventCommandSignal" SG_ 352 BCS_ABPActive_B 0;
BA_ "GatewayedSignals" SG_ 352 BCS_ABPActive_B 0;
BA_ "GenSigInactiveValue" SG_ 352 BCS_ABPActive_B 0;
BA_ "GenSigInvalidValue" SG_ 352 BCS_ABPActive_B 0;
BA_ "GenSigSendType" SG_ 352 BCS_ABPActive_B 1;
BA_ "GenSigStartValue" SG_ 352 BCS_ABPActive_B 0;
BA_ "GenSigTimeoutValue" SG_ 352 BCS_ABPActive_B 0;
BA_ "Remark" SG_ 352 BCS_ABPActive_B "涉及ID管理表";
BA_ "EventCommandSignal" SG_ 352 BCS_RLWheelSpd_B 0;
BA_ "GatewayedSignals" SG_ 352 BCS_RLWheelSpd_B 0;
BA_ "GenSigInactiveValue" SG_ 352 BCS_RLWheelSpd_B 0;
BA_ "GenSigInvalidValue" SG_ 352 BCS_RLWheelSpd_B 0;
BA_ "GenSigSendType" SG_ 352 BCS_RLWheelSpd_B 1;
BA_ "GenSigStartValue" SG_ 352 BCS_RLWheelSpd_B 0;
BA_ "GenSigTimeoutValue" SG_ 352 BCS_RLWheelSpd_B 0;
BA_ "Remark" SG_ 352 BCS_RLWheelSpd_B "涉及ID管理表";
BA_ "EventCommandSignal" SG_ 352 BCS_FLWheelSpdEdgesSum_B 0;
BA_ "GatewayedSignals" SG_ 352 BCS_FLWheelSpdEdgesSum_B 0;
BA_ "GenSigInactiveValue" SG_ 352 BCS_FLWheelSpdEdgesSum_B 0;
BA_ "GenSigInvalidValue" SG_ 352 BCS_FLWheelSpdEdgesSum_B 0;
BA_ "GenSigSendType" SG_ 352 BCS_FLWheelSpdEdgesSum_B 1;
BA_ "GenSigStartValue" SG_ 352 BCS_FLWheelSpdEdgesSum_B 0;
BA_ "GenSigTimeoutValue" SG_ 352 BCS_FLWheelSpdEdgesSum_B 0;
BA_ "Remark" SG_ 352 BCS_FLWheelSpdEdgesSum_B "涉及ID管理表";
BA_ "EventCommandSignal" SG_ 352 BCS_ABPAvailable_B 0;
BA_ "GatewayedSignals" SG_ 352 BCS_ABPAvailable_B 0;
BA_ "GenSigInactiveValue" SG_ 352 BCS_ABPAvailable_B 0;
BA_ "GenSigInvalidValue" SG_ 352 BCS_ABPAvailable_B 0;
BA_ "GenSigSendType" SG_ 352 BCS_ABPAvailable_B 1;
BA_ "GenSigStartValue" SG_ 352 BCS_ABPAvailable_B 0;
BA_ "GenSigTimeoutValue" SG_ 352 BCS_ABPAvailable_B 0;
BA_ "Remark" SG_ 352 BCS_ABPAvailable_B "涉及ID管理表";
BA_ "EventCommandSignal" SG_ 352 BCS_AEBActive_B 0;
BA_ "GatewayedSignals" SG_ 352 BCS_AEBActive_B 0;
BA_ "GenSigInactiveValue" SG_ 352 BCS_AEBActive_B 0;
BA_ "GenSigInvalidValue" SG_ 352 BCS_AEBActive_B 0;
BA_ "GenSigSendType" SG_ 352 BCS_AEBActive_B 1;
BA_ "GenSigStartValue" SG_ 352 BCS_AEBActive_B 0;
BA_ "GenSigTimeoutValue" SG_ 352 BCS_AEBActive_B 0;
BA_ "Remark" SG_ 352 BCS_AEBActive_B "涉及ID管理表";
BA_ "EventCommandSignal" SG_ 352 BCS_AEBAvailable_B 0;
BA_ "GatewayedSignals" SG_ 352 BCS_AEBAvailable_B 0;
BA_ "GenSigInactiveValue" SG_ 352 BCS_AEBAvailable_B 0;
BA_ "GenSigInvalidValue" SG_ 352 BCS_AEBAvailable_B 0;
BA_ "GenSigSendType" SG_ 352 BCS_AEBAvailable_B 1;
BA_ "GenSigStartValue" SG_ 352 BCS_AEBAvailable_B 0;
BA_ "GenSigTimeoutValue" SG_ 352 BCS_AEBAvailable_B 0;
BA_ "Remark" SG_ 352 BCS_AEBAvailable_B "涉及ID管理表";
BA_ "EventCommandSignal" SG_ 352 BCS_RRWheelSpd_B 0;
BA_ "GatewayedSignals" SG_ 352 BCS_RRWheelSpd_B 0;
BA_ "GenSigInactiveValue" SG_ 352 BCS_RRWheelSpd_B 0;
BA_ "GenSigInvalidValue" SG_ 352 BCS_RRWheelSpd_B 0;
BA_ "GenSigSendType" SG_ 352 BCS_RRWheelSpd_B 1;
BA_ "GenSigStartValue" SG_ 352 BCS_RRWheelSpd_B 0;
BA_ "GenSigTimeoutValue" SG_ 352 BCS_RRWheelSpd_B 0;
BA_ "Remark" SG_ 352 BCS_RRWheelSpd_B "涉及ID管理表";
BA_ "EventCommandSignal" SG_ 352 BCS_FRWheelSpdEdgesSum_B 0;
BA_ "GatewayedSignals" SG_ 352 BCS_FRWheelSpdEdgesSum_B 0;
BA_ "GenSigInactiveValue" SG_ 352 BCS_FRWheelSpdEdgesSum_B 0;
BA_ "GenSigInvalidValue" SG_ 352 BCS_FRWheelSpdEdgesSum_B 0;
BA_ "GenSigSendType" SG_ 352 BCS_FRWheelSpdEdgesSum_B 1;
BA_ "GenSigStartValue" SG_ 352 BCS_FRWheelSpdEdgesSum_B 0;
BA_ "GenSigTimeoutValue" SG_ 352 BCS_FRWheelSpdEdgesSum_B 0;
BA_ "Remark" SG_ 352 BCS_FRWheelSpdEdgesSum_B "涉及ID管理表";
BA_ "EventCommandSignal" SG_ 352 BCS_RLWheelSpdEdgesSum_B 0;
BA_ "GatewayedSignals" SG_ 352 BCS_RLWheelSpdEdgesSum_B 0;
BA_ "GenSigInactiveValue" SG_ 352 BCS_RLWheelSpdEdgesSum_B 0;
BA_ "GenSigInvalidValue" SG_ 352 BCS_RLWheelSpdEdgesSum_B 0;
BA_ "GenSigSendType" SG_ 352 BCS_RLWheelSpdEdgesSum_B 1;
BA_ "GenSigStartValue" SG_ 352 BCS_RLWheelSpdEdgesSum_B 0;
BA_ "GenSigTimeoutValue" SG_ 352 BCS_RLWheelSpdEdgesSum_B 0;
BA_ "Remark" SG_ 352 BCS_RLWheelSpdEdgesSum_B "涉及ID管理表";
BA_ "EventCommandSignal" SG_ 352 BCS_AWBActive_B 0;
BA_ "GatewayedSignals" SG_ 352 BCS_AWBActive_B 0;
BA_ "GenSigInactiveValue" SG_ 352 BCS_AWBActive_B 0;
BA_ "GenSigInvalidValue" SG_ 352 BCS_AWBActive_B 0;
BA_ "GenSigSendType" SG_ 352 BCS_AWBActive_B 1;
BA_ "GenSigStartValue" SG_ 352 BCS_AWBActive_B 0;
BA_ "GenSigTimeoutValue" SG_ 352 BCS_AWBActive_B 0;
BA_ "Remark" SG_ 352 BCS_AWBActive_B "涉及ID管理表";
BA_ "EventCommandSignal" SG_ 352 BCS_AWBAvailable_B 0;
BA_ "GatewayedSignals" SG_ 352 BCS_AWBAvailable_B 0;
BA_ "GenSigInactiveValue" SG_ 352 BCS_AWBAvailable_B 0;
BA_ "GenSigInvalidValue" SG_ 352 BCS_AWBAvailable_B 0;
BA_ "GenSigSendType" SG_ 352 BCS_AWBAvailable_B 1;
BA_ "GenSigStartValue" SG_ 352 BCS_AWBAvailable_B 0;
BA_ "GenSigTimeoutValue" SG_ 352 BCS_AWBAvailable_B 0;
BA_ "Remark" SG_ 352 BCS_AWBAvailable_B "涉及ID管理表";
BA_ "EventCommandSignal" SG_ 352 BCS_InputRodStroke_B 0;
BA_ "GatewayedSignals" SG_ 352 BCS_InputRodStroke_B 0;
BA_ "GenSigInactiveValue" SG_ 352 BCS_InputRodStroke_B 0;
BA_ "GenSigInvalidValue" SG_ 352 BCS_InputRodStroke_B 0;
BA_ "GenSigSendType" SG_ 352 BCS_InputRodStroke_B 1;
BA_ "GenSigStartValue" SG_ 352 BCS_InputRodStroke_B 100;
BA_ "GenSigTimeoutValue" SG_ 352 BCS_InputRodStroke_B 0;
BA_ "Remark" SG_ 352 BCS_InputRodStroke_B "涉及ID管理表";
BA_ "EventCommandSignal" SG_ 352 BCS_HDCCtrlSt_B 0;
BA_ "GatewayedSignals" SG_ 352 BCS_HDCCtrlSt_B 0;
BA_ "GenSigInactiveValue" SG_ 352 BCS_HDCCtrlSt_B 0;
BA_ "GenSigInvalidValue" SG_ 352 BCS_HDCCtrlSt_B 0;
BA_ "GenSigSendType" SG_ 352 BCS_HDCCtrlSt_B 1;
BA_ "GenSigStartValue" SG_ 352 BCS_HDCCtrlSt_B 0;
BA_ "GenSigTimeoutValue" SG_ 352 BCS_HDCCtrlSt_B 0;
BA_ "Remark" SG_ 352 BCS_HDCCtrlSt_B "涉及ID管理表";
BA_ "EventCommandSignal" SG_ 352 BCS_FLWheelRotatedDirection_B 0;
BA_ "GatewayedSignals" SG_ 352 BCS_FLWheelRotatedDirection_B 0;
BA_ "GenSigInactiveValue" SG_ 352 BCS_FLWheelRotatedDirection_B 0;
BA_ "GenSigInvalidValue" SG_ 352 BCS_FLWheelRotatedDirection_B 0;
BA_ "GenSigSendType" SG_ 352 BCS_FLWheelRotatedDirection_B 1;
BA_ "GenSigStartValue" SG_ 352 BCS_FLWheelRotatedDirection_B 0;
BA_ "GenSigTimeoutValue" SG_ 352 BCS_FLWheelRotatedDirection_B 0;
BA_ "Remark" SG_ 352 BCS_FLWheelRotatedDirection_B "涉及ID管理表";
BA_ "EventCommandSignal" SG_ 352 BCS_InputRodStrokeSt_B 0;
BA_ "GatewayedSignals" SG_ 352 BCS_InputRodStrokeSt_B 0;
BA_ "GenSigInactiveValue" SG_ 352 BCS_InputRodStrokeSt_B 0;
BA_ "GenSigInvalidValue" SG_ 352 BCS_InputRodStrokeSt_B 0;
BA_ "GenSigSendType" SG_ 352 BCS_InputRodStrokeSt_B 1;
BA_ "GenSigStartValue" SG_ 352 BCS_InputRodStrokeSt_B 0;
BA_ "GenSigTimeoutValue" SG_ 352 BCS_InputRodStrokeSt_B 0;
BA_ "Remark" SG_ 352 BCS_InputRodStrokeSt_B "涉及ID管理表";
BA_ "EventCommandSignal" SG_ 352 BCS_BrkTqCtrlActvRdn_B 0;
BA_ "GatewayedSignals" SG_ 352 BCS_BrkTqCtrlActvRdn_B 0;
BA_ "GenSigInactiveValue" SG_ 352 BCS_BrkTqCtrlActvRdn_B 0;
BA_ "GenSigInvalidValue" SG_ 352 BCS_BrkTqCtrlActvRdn_B 0;
BA_ "GenSigSendType" SG_ 352 BCS_BrkTqCtrlActvRdn_B 1;
BA_ "GenSigStartValue" SG_ 352 BCS_BrkTqCtrlActvRdn_B 0;
BA_ "GenSigTimeoutValue" SG_ 352 BCS_BrkTqCtrlActvRdn_B 0;
BA_ "Remark" SG_ 352 BCS_BrkTqCtrlActvRdn_B "涉及ID管理表";
BA_ "EventCommandSignal" SG_ 352 BCS_FRWheelRotatedDirection_B 0;
BA_ "GatewayedSignals" SG_ 352 BCS_FRWheelRotatedDirection_B 0;
BA_ "GenSigInactiveValue" SG_ 352 BCS_FRWheelRotatedDirection_B 0;
BA_ "GenSigInvalidValue" SG_ 352 BCS_FRWheelRotatedDirection_B 0;
BA_ "GenSigSendType" SG_ 352 BCS_FRWheelRotatedDirection_B 1;
BA_ "GenSigStartValue" SG_ 352 BCS_FRWheelRotatedDirection_B 0;
BA_ "GenSigTimeoutValue" SG_ 352 BCS_FRWheelRotatedDirection_B 0;
BA_ "Remark" SG_ 352 BCS_FRWheelRotatedDirection_B "涉及ID管理表";
BA_ "EventCommandSignal" SG_ 352 BCS_RLWheelRotatedDirection_B 0;
BA_ "GatewayedSignals" SG_ 352 BCS_RLWheelRotatedDirection_B 0;
BA_ "GenSigInactiveValue" SG_ 352 BCS_RLWheelRotatedDirection_B 0;
BA_ "GenSigInvalidValue" SG_ 352 BCS_RLWheelRotatedDirection_B 0;
BA_ "GenSigSendType" SG_ 352 BCS_RLWheelRotatedDirection_B 1;
BA_ "GenSigStartValue" SG_ 352 BCS_RLWheelRotatedDirection_B 0;
BA_ "GenSigTimeoutValue" SG_ 352 BCS_RLWheelRotatedDirection_B 0;
BA_ "Remark" SG_ 352 BCS_RLWheelRotatedDirection_B "涉及ID管理表";
BA_ "EventCommandSignal" SG_ 352 BCS_PlungerPressureSt_B 0;
BA_ "GatewayedSignals" SG_ 352 BCS_PlungerPressureSt_B 0;
BA_ "GenSigInactiveValue" SG_ 352 BCS_PlungerPressureSt_B 0;
BA_ "GenSigInvalidValue" SG_ 352 BCS_PlungerPressureSt_B 0;
BA_ "GenSigSendType" SG_ 352 BCS_PlungerPressureSt_B 1;
BA_ "GenSigStartValue" SG_ 352 BCS_PlungerPressureSt_B 0;
BA_ "GenSigTimeoutValue" SG_ 352 BCS_PlungerPressureSt_B 0;
BA_ "Remark" SG_ 352 BCS_PlungerPressureSt_B "涉及ID管理表";
BA_ "EventCommandSignal" SG_ 352 BCS_RRWheelRotatedDirection_B 0;
BA_ "GatewayedSignals" SG_ 352 BCS_RRWheelRotatedDirection_B 0;
BA_ "GenSigInactiveValue" SG_ 352 BCS_RRWheelRotatedDirection_B 0;
BA_ "GenSigInvalidValue" SG_ 352 BCS_RRWheelRotatedDirection_B 0;
BA_ "GenSigSendType" SG_ 352 BCS_RRWheelRotatedDirection_B 1;
BA_ "GenSigStartValue" SG_ 352 BCS_RRWheelRotatedDirection_B 0;
BA_ "GenSigTimeoutValue" SG_ 352 BCS_RRWheelRotatedDirection_B 0;
BA_ "Remark" SG_ 352 BCS_RRWheelRotatedDirection_B "涉及ID管理表";
BA_ "EventCommandSignal" SG_ 352 BCS_ParkingReqToEPB_B 0;
BA_ "GatewayedSignals" SG_ 352 BCS_ParkingReqToEPB_B 0;
BA_ "GenSigInactiveValue" SG_ 352 BCS_ParkingReqToEPB_B 0;
BA_ "GenSigInvalidValue" SG_ 352 BCS_ParkingReqToEPB_B 0;
BA_ "GenSigSendType" SG_ 352 BCS_ParkingReqToEPB_B 1;
BA_ "GenSigStartValue" SG_ 352 BCS_ParkingReqToEPB_B 0;
BA_ "GenSigTimeoutValue" SG_ 352 BCS_ParkingReqToEPB_B 0;
BA_ "Remark" SG_ 352 BCS_ParkingReqToEPB_B "涉及ID管理表";
BA_ "EventCommandSignal" SG_ 352 BCS_VehicleStandStillSt_B 0;
BA_ "GatewayedSignals" SG_ 352 BCS_VehicleStandStillSt_B 0;
BA_ "GenSigInactiveValue" SG_ 352 BCS_VehicleStandStillSt_B 0;
BA_ "GenSigInvalidValue" SG_ 352 BCS_VehicleStandStillSt_B 0;
BA_ "GenSigSendType" SG_ 352 BCS_VehicleStandStillSt_B 1;
BA_ "GenSigStartValue" SG_ 352 BCS_VehicleStandStillSt_B 0;
BA_ "GenSigTimeoutValue" SG_ 352 BCS_VehicleStandStillSt_B 0;
BA_ "Remark" SG_ 352 BCS_VehicleStandStillSt_B "涉及ID管理表";
BA_ "EventCommandSignal" SG_ 352 BCS_L3ComVD_B 0;
BA_ "GatewayedSignals" SG_ 352 BCS_L3ComVD_B 0;
BA_ "GenSigInactiveValue" SG_ 352 BCS_L3ComVD_B 0;
BA_ "GenSigInvalidValue" SG_ 352 BCS_L3ComVD_B 0;
BA_ "GenSigSendType" SG_ 352 BCS_L3ComVD_B 1;
BA_ "GenSigStartValue" SG_ 352 BCS_L3ComVD_B 0;
BA_ "GenSigTimeoutValue" SG_ 352 BCS_L3ComVD_B 0;
BA_ "Remark" SG_ 352 BCS_L3ComVD_B "涉及ID管理表";
BA_ "EventCommandSignal" SG_ 352 BCS_BrkTqCtrlAvlDrivingRdn_B 0;
BA_ "GatewayedSignals" SG_ 352 BCS_BrkTqCtrlAvlDrivingRdn_B 0;
BA_ "GenSigInactiveValue" SG_ 352 BCS_BrkTqCtrlAvlDrivingRdn_B 0;
BA_ "GenSigInvalidValue" SG_ 352 BCS_BrkTqCtrlAvlDrivingRdn_B 0;
BA_ "GenSigSendType" SG_ 352 BCS_BrkTqCtrlAvlDrivingRdn_B 1;
BA_ "GenSigStartValue" SG_ 352 BCS_BrkTqCtrlAvlDrivingRdn_B 0;
BA_ "GenSigTimeoutValue" SG_ 352 BCS_BrkTqCtrlAvlDrivingRdn_B 0;
BA_ "Remark" SG_ 352 BCS_BrkTqCtrlAvlDrivingRdn_B "涉及ID管理表";
BA_ "EventCommandSignal" SG_ 352 BCS_LFIActiveSt_B 0;
BA_ "GatewayedSignals" SG_ 352 BCS_LFIActiveSt_B 0;
BA_ "GenSigInactiveValue" SG_ 352 BCS_LFIActiveSt_B 0;
BA_ "GenSigInvalidValue" SG_ 352 BCS_LFIActiveSt_B 0;
BA_ "GenSigSendType" SG_ 352 BCS_LFIActiveSt_B 1;
BA_ "GenSigStartValue" SG_ 352 BCS_LFIActiveSt_B 0;
BA_ "GenSigTimeoutValue" SG_ 352 BCS_LFIActiveSt_B 0;
BA_ "Remark" SG_ 352 BCS_LFIActiveSt_B "涉及ID管理表";
BA_ "EventCommandSignal" SG_ 352 BCS_RRWheelSpdEdgesSum_B 0;
BA_ "GatewayedSignals" SG_ 352 BCS_RRWheelSpdEdgesSum_B 0;
BA_ "GenSigInactiveValue" SG_ 352 BCS_RRWheelSpdEdgesSum_B 0;
BA_ "GenSigInvalidValue" SG_ 352 BCS_RRWheelSpdEdgesSum_B 0;
BA_ "GenSigSendType" SG_ 352 BCS_RRWheelSpdEdgesSum_B 1;
BA_ "GenSigStartValue" SG_ 352 BCS_RRWheelSpdEdgesSum_B 0;
BA_ "GenSigTimeoutValue" SG_ 352 BCS_RRWheelSpdEdgesSum_B 0;
BA_ "Remark" SG_ 352 BCS_RRWheelSpdEdgesSum_B "涉及ID管理表";
BA_ "EventCommandSignal" SG_ 352 BCS_PlungerPressure_B 0;
BA_ "GatewayedSignals" SG_ 352 BCS_PlungerPressure_B 0;
BA_ "GenSigInactiveValue" SG_ 352 BCS_PlungerPressure_B 0;
BA_ "GenSigInvalidValue" SG_ 352 BCS_PlungerPressure_B 0;
BA_ "GenSigSendType" SG_ 352 BCS_PlungerPressure_B 1;
BA_ "GenSigStartValue" SG_ 352 BCS_PlungerPressure_B 17;
BA_ "GenSigTimeoutValue" SG_ 352 BCS_PlungerPressure_B 0;
BA_ "Remark" SG_ 352 BCS_PlungerPressure_B "涉及ID管理表";
BA_ "EventCommandSignal" SG_ 363 EPS_1_CRC 0;
BA_ "GatewayedSignals" SG_ 363 EPS_1_CRC 0;
BA_ "GenSigInactiveValue" SG_ 363 EPS_1_CRC 0;
BA_ "GenSigInvalidValue" SG_ 363 EPS_1_CRC 0;
BA_ "GenSigSendType" SG_ 363 EPS_1_CRC 1;
BA_ "GenSigStartValue" SG_ 363 EPS_1_CRC 0;
BA_ "GenSigTimeoutValue" SG_ 363 EPS_1_CRC 0;
BA_ "Remark" SG_ 363 EPS_1_CRC "";
BA_ "EventCommandSignal" SG_ 363 EPS_1_Counter 0;
BA_ "GatewayedSignals" SG_ 363 EPS_1_Counter 0;
BA_ "GenSigInactiveValue" SG_ 363 EPS_1_Counter 0;
BA_ "GenSigInvalidValue" SG_ 363 EPS_1_Counter 0;
BA_ "GenSigSendType" SG_ 363 EPS_1_Counter 1;
BA_ "GenSigStartValue" SG_ 363 EPS_1_Counter 0;
BA_ "GenSigTimeoutValue" SG_ 363 EPS_1_Counter 0;
BA_ "Remark" SG_ 363 EPS_1_Counter "";
BA_ "EventCommandSignal" SG_ 363 EPS_StrngWhlTorqVD 0;
BA_ "GatewayedSignals" SG_ 363 EPS_StrngWhlTorqVD 0;
BA_ "GenSigInactiveValue" SG_ 363 EPS_StrngWhlTorqVD 0;
BA_ "GenSigInvalidValue" SG_ 363 EPS_StrngWhlTorqVD 0;
BA_ "GenSigSendType" SG_ 363 EPS_StrngWhlTorqVD 1;
BA_ "GenSigStartValue" SG_ 363 EPS_StrngWhlTorqVD 0;
BA_ "GenSigTimeoutValue" SG_ 363 EPS_StrngWhlTorqVD 0;
BA_ "Remark" SG_ 363 EPS_StrngWhlTorqVD "";
BA_ "EventCommandSignal" SG_ 363 EPS_StrngWhlTorq 0;
BA_ "GatewayedSignals" SG_ 363 EPS_StrngWhlTorq 0;
BA_ "GenSigInactiveValue" SG_ 363 EPS_StrngWhlTorq 0;
BA_ "GenSigInvalidValue" SG_ 363 EPS_StrngWhlTorq 4095;
BA_ "GenSigSendType" SG_ 363 EPS_StrngWhlTorq 1;
BA_ "GenSigStartValue" SG_ 363 EPS_StrngWhlTorq 1500;
BA_ "GenSigTimeoutValue" SG_ 363 EPS_StrngWhlTorq 4095;
BA_ "Remark" SG_ 363 EPS_StrngWhlTorq "";
BA_ "EventCommandSignal" SG_ 363 TAS_CalibratedSt 0;
BA_ "GatewayedSignals" SG_ 363 TAS_CalibratedSt 0;
BA_ "GenSigInactiveValue" SG_ 363 TAS_CalibratedSt 0;
BA_ "GenSigInvalidValue" SG_ 363 TAS_CalibratedSt 0;
BA_ "GenSigSendType" SG_ 363 TAS_CalibratedSt 1;
BA_ "GenSigStartValue" SG_ 363 TAS_CalibratedSt 0;
BA_ "GenSigTimeoutValue" SG_ 363 TAS_CalibratedSt 0;
BA_ "Remark" SG_ 363 TAS_CalibratedSt "";
BA_ "EventCommandSignal" SG_ 363 EPS_SteeringAngleSpdVD 0;
BA_ "GatewayedSignals" SG_ 363 EPS_SteeringAngleSpdVD 0;
BA_ "GenSigInactiveValue" SG_ 363 EPS_SteeringAngleSpdVD 0;
BA_ "GenSigInvalidValue" SG_ 363 EPS_SteeringAngleSpdVD 0;
BA_ "GenSigSendType" SG_ 363 EPS_SteeringAngleSpdVD 1;
BA_ "GenSigStartValue" SG_ 363 EPS_SteeringAngleSpdVD 0;
BA_ "GenSigTimeoutValue" SG_ 363 EPS_SteeringAngleSpdVD 0;
BA_ "Remark" SG_ 363 EPS_SteeringAngleSpdVD "";
BA_ "EventCommandSignal" SG_ 363 EPS_SteeringAngleSpd 0;
BA_ "GatewayedSignals" SG_ 363 EPS_SteeringAngleSpd 0;
BA_ "GenSigInactiveValue" SG_ 363 EPS_SteeringAngleSpd 0;
BA_ "GenSigInvalidValue" SG_ 363 EPS_SteeringAngleSpd 255;
BA_ "GenSigSendType" SG_ 363 EPS_SteeringAngleSpd 1;
BA_ "GenSigStartValue" SG_ 363 EPS_SteeringAngleSpd 0;
BA_ "GenSigTimeoutValue" SG_ 363 EPS_SteeringAngleSpd 255;
BA_ "Remark" SG_ 363 EPS_SteeringAngleSpd "";
BA_ "EventCommandSignal" SG_ 363 EPS_SteeringAngle 0;
BA_ "GatewayedSignals" SG_ 363 EPS_SteeringAngle 0;
BA_ "GenSigInactiveValue" SG_ 363 EPS_SteeringAngle 0;
BA_ "GenSigInvalidValue" SG_ 363 EPS_SteeringAngle 65535;
BA_ "GenSigSendType" SG_ 363 EPS_SteeringAngle 1;
BA_ "GenSigStartValue" SG_ 363 EPS_SteeringAngle 7800;
BA_ "GenSigTimeoutValue" SG_ 363 EPS_SteeringAngle 65535;
BA_ "Remark" SG_ 363 EPS_SteeringAngle "";
BA_ "EventCommandSignal" SG_ 363 EPS_SteeringAngleVD 0;
BA_ "GatewayedSignals" SG_ 363 EPS_SteeringAngleVD 0;
BA_ "GenSigInactiveValue" SG_ 363 EPS_SteeringAngleVD 0;
BA_ "GenSigInvalidValue" SG_ 363 EPS_SteeringAngleVD 0;
BA_ "GenSigSendType" SG_ 363 EPS_SteeringAngleVD 1;
BA_ "GenSigStartValue" SG_ 363 EPS_SteeringAngleVD 0;
BA_ "GenSigTimeoutValue" SG_ 363 EPS_SteeringAngleVD 0;
BA_ "Remark" SG_ 363 EPS_SteeringAngleVD "";
BA_ "EventCommandSignal" SG_ 363 EPS_ThermalSt 0;
BA_ "GatewayedSignals" SG_ 363 EPS_ThermalSt 0;
BA_ "GenSigInactiveValue" SG_ 363 EPS_ThermalSt 0;
BA_ "GenSigInvalidValue" SG_ 363 EPS_ThermalSt 0;
BA_ "GenSigSendType" SG_ 363 EPS_ThermalSt 1;
BA_ "GenSigStartValue" SG_ 363 EPS_ThermalSt 0;
BA_ "GenSigTimeoutValue" SG_ 363 EPS_ThermalSt 0;
BA_ "Remark" SG_ 363 EPS_ThermalSt "";
BA_ "EventCommandSignal" SG_ 363 EPS_VMCErrFeedback 0;
BA_ "GatewayedSignals" SG_ 363 EPS_VMCErrFeedback 0;
BA_ "GenSigInactiveValue" SG_ 363 EPS_VMCErrFeedback 0;
BA_ "GenSigInvalidValue" SG_ 363 EPS_VMCErrFeedback 0;
BA_ "GenSigSendType" SG_ 363 EPS_VMCErrFeedback 1;
BA_ "GenSigStartValue" SG_ 363 EPS_VMCErrFeedback 0;
BA_ "GenSigTimeoutValue" SG_ 363 EPS_VMCErrFeedback 0;
BA_ "Remark" SG_ 363 EPS_VMCErrFeedback "";
BA_ "EventCommandSignal" SG_ 363 EPS_PstOverlaySt 0;
BA_ "GatewayedSignals" SG_ 363 EPS_PstOverlaySt 0;
BA_ "GenSigInactiveValue" SG_ 363 EPS_PstOverlaySt 0;
BA_ "GenSigInvalidValue" SG_ 363 EPS_PstOverlaySt 0;
BA_ "GenSigSendType" SG_ 363 EPS_PstOverlaySt 1;
BA_ "GenSigStartValue" SG_ 363 EPS_PstOverlaySt 0;
BA_ "GenSigTimeoutValue" SG_ 363 EPS_PstOverlaySt 0;
BA_ "Remark" SG_ 363 EPS_PstOverlaySt "";
BA_ "EventCommandSignal" SG_ 363 EPS_HealthySt_DualSide 0;
BA_ "GatewayedSignals" SG_ 363 EPS_HealthySt_DualSide 0;
BA_ "GenSigInactiveValue" SG_ 363 EPS_HealthySt_DualSide 0;
BA_ "GenSigInvalidValue" SG_ 363 EPS_HealthySt_DualSide 0;
BA_ "GenSigSendType" SG_ 363 EPS_HealthySt_DualSide 1;
BA_ "GenSigStartValue" SG_ 363 EPS_HealthySt_DualSide 0;
BA_ "GenSigTimeoutValue" SG_ 363 EPS_HealthySt_DualSide 0;
BA_ "Remark" SG_ 363 EPS_HealthySt_DualSide "";
BA_ "EventCommandSignal" SG_ 363 EPS_VibrationWarnSt_A 0;
BA_ "GatewayedSignals" SG_ 363 EPS_VibrationWarnSt_A 0;
BA_ "GenSigInactiveValue" SG_ 363 EPS_VibrationWarnSt_A 0;
BA_ "GenSigInvalidValue" SG_ 363 EPS_VibrationWarnSt_A 0;
BA_ "GenSigSendType" SG_ 363 EPS_VibrationWarnSt_A 1;
BA_ "GenSigStartValue" SG_ 363 EPS_VibrationWarnSt_A 0;
BA_ "GenSigTimeoutValue" SG_ 363 EPS_VibrationWarnSt_A 0;
BA_ "Remark" SG_ 363 EPS_VibrationWarnSt_A "";
BA_ "EventCommandSignal" SG_ 363 SAC_ErrFeedback_SideA 0;
BA_ "GatewayedSignals" SG_ 363 SAC_ErrFeedback_SideA 0;
BA_ "GenSigInactiveValue" SG_ 363 SAC_ErrFeedback_SideA 0;
BA_ "GenSigInvalidValue" SG_ 363 SAC_ErrFeedback_SideA 0;
BA_ "GenSigSendType" SG_ 363 SAC_ErrFeedback_SideA 1;
BA_ "GenSigStartValue" SG_ 363 SAC_ErrFeedback_SideA 0;
BA_ "GenSigTimeoutValue" SG_ 363 SAC_ErrFeedback_SideA 0;
BA_ "Remark" SG_ 363 SAC_ErrFeedback_SideA "";
BA_ "EventCommandSignal" SG_ 363 EPS_ADASTargetAngle 0;
BA_ "GatewayedSignals" SG_ 363 EPS_ADASTargetAngle 0;
BA_ "GenSigInactiveValue" SG_ 363 EPS_ADASTargetAngle 0;
BA_ "GenSigInvalidValue" SG_ 363 EPS_ADASTargetAngle 0;
BA_ "GenSigSendType" SG_ 363 EPS_ADASTargetAngle 1;
BA_ "GenSigStartValue" SG_ 363 EPS_ADASTargetAngle 7800;
BA_ "GenSigTimeoutValue" SG_ 363 EPS_ADASTargetAngle 7800;
BA_ "Remark" SG_ 363 EPS_ADASTargetAngle "";
BA_ "EventCommandSignal" SG_ 363 EPS_FunctionStyleSt 0;
BA_ "GatewayedSignals" SG_ 363 EPS_FunctionStyleSt 0;
BA_ "GenSigInactiveValue" SG_ 363 EPS_FunctionStyleSt 0;
BA_ "GenSigInvalidValue" SG_ 363 EPS_FunctionStyleSt 0;
BA_ "GenSigSendType" SG_ 363 EPS_FunctionStyleSt 1;
BA_ "GenSigStartValue" SG_ 363 EPS_FunctionStyleSt 0;
BA_ "GenSigTimeoutValue" SG_ 363 EPS_FunctionStyleSt 0;
BA_ "Remark" SG_ 363 EPS_FunctionStyleSt "";
BA_ "EventCommandSignal" SG_ 363 EPS_SteeringModeSt 0;
BA_ "GatewayedSignals" SG_ 363 EPS_SteeringModeSt 0;
BA_ "GenSigInactiveValue" SG_ 363 EPS_SteeringModeSt 0;
BA_ "GenSigInvalidValue" SG_ 363 EPS_SteeringModeSt 0;
BA_ "GenSigSendType" SG_ 363 EPS_SteeringModeSt 1;
BA_ "GenSigStartValue" SG_ 363 EPS_SteeringModeSt 0;
BA_ "GenSigTimeoutValue" SG_ 363 EPS_SteeringModeSt 0;
BA_ "Remark" SG_ 363 EPS_SteeringModeSt "";
BA_ "EventCommandSignal" SG_ 363 EPS_ReqAngOverRange 0;
BA_ "GatewayedSignals" SG_ 363 EPS_ReqAngOverRange 0;
BA_ "GenSigInactiveValue" SG_ 363 EPS_ReqAngOverRange 0;
BA_ "GenSigInvalidValue" SG_ 363 EPS_ReqAngOverRange 0;
BA_ "GenSigSendType" SG_ 363 EPS_ReqAngOverRange 1;
BA_ "GenSigStartValue" SG_ 363 EPS_ReqAngOverRange 0;
BA_ "GenSigTimeoutValue" SG_ 363 EPS_ReqAngOverRange 0;
BA_ "Remark" SG_ 363 EPS_ReqAngOverRange "";
BA_ "EventCommandSignal" SG_ 363 EPS_SACMotorTorAct 0;
BA_ "GatewayedSignals" SG_ 363 EPS_SACMotorTorAct 0;
BA_ "GenSigInactiveValue" SG_ 363 EPS_SACMotorTorAct 0;
BA_ "GenSigInvalidValue" SG_ 363 EPS_SACMotorTorAct 0;
BA_ "GenSigSendType" SG_ 363 EPS_SACMotorTorAct 1;
BA_ "GenSigStartValue" SG_ 363 EPS_SACMotorTorAct 600;
BA_ "GenSigTimeoutValue" SG_ 363 EPS_SACMotorTorAct 600;
BA_ "Remark" SG_ 363 EPS_SACMotorTorAct "";
BA_ "EventCommandSignal" SG_ 363 EPS_SACMotorTorLimInt 0;
BA_ "GatewayedSignals" SG_ 363 EPS_SACMotorTorLimInt 0;
BA_ "GenSigInactiveValue" SG_ 363 EPS_SACMotorTorLimInt 0;
BA_ "GenSigInvalidValue" SG_ 363 EPS_SACMotorTorLimInt 2047;
BA_ "GenSigSendType" SG_ 363 EPS_SACMotorTorLimInt 1;
BA_ "GenSigStartValue" SG_ 363 EPS_SACMotorTorLimInt 0;
BA_ "GenSigTimeoutValue" SG_ 363 EPS_SACMotorTorLimInt 2047;
BA_ "Remark" SG_ 363 EPS_SACMotorTorLimInt "";
BA_ "EventCommandSignal" SG_ 363 EPS_ReqAngSpdOverRange 0;
BA_ "GatewayedSignals" SG_ 363 EPS_ReqAngSpdOverRange 0;
BA_ "GenSigInactiveValue" SG_ 363 EPS_ReqAngSpdOverRange 0;
BA_ "GenSigInvalidValue" SG_ 363 EPS_ReqAngSpdOverRange 0;
BA_ "GenSigSendType" SG_ 363 EPS_ReqAngSpdOverRange 1;
BA_ "GenSigStartValue" SG_ 363 EPS_ReqAngSpdOverRange 0;
BA_ "GenSigTimeoutValue" SG_ 363 EPS_ReqAngSpdOverRange 0;
BA_ "Remark" SG_ 363 EPS_ReqAngSpdOverRange "";
BA_ "EventCommandSignal" SG_ 363 EPS_AssistPraSwitchToLKA 0;
BA_ "GatewayedSignals" SG_ 363 EPS_AssistPraSwitchToLKA 0;
BA_ "GenSigInactiveValue" SG_ 363 EPS_AssistPraSwitchToLKA 0;
BA_ "GenSigInvalidValue" SG_ 363 EPS_AssistPraSwitchToLKA 0;
BA_ "GenSigSendType" SG_ 363 EPS_AssistPraSwitchToLKA 1;
BA_ "GenSigStartValue" SG_ 363 EPS_AssistPraSwitchToLKA 0;
BA_ "GenSigTimeoutValue" SG_ 363 EPS_AssistPraSwitchToLKA 0;
BA_ "Remark" SG_ 363 EPS_AssistPraSwitchToLKA "";
BA_ "EventCommandSignal" SG_ 363 EPS_SteerGainEnable 0;
BA_ "GatewayedSignals" SG_ 363 EPS_SteerGainEnable 0;
BA_ "GenSigInactiveValue" SG_ 363 EPS_SteerGainEnable 0;
BA_ "GenSigInvalidValue" SG_ 363 EPS_SteerGainEnable 0;
BA_ "GenSigSendType" SG_ 363 EPS_SteerGainEnable 1;
BA_ "GenSigStartValue" SG_ 363 EPS_SteerGainEnable 0;
BA_ "GenSigTimeoutValue" SG_ 363 EPS_SteerGainEnable 0;
BA_ "Remark" SG_ 363 EPS_SteerGainEnable "";
BA_ "EventCommandSignal" SG_ 363 EPS_EmSteerEnbale 0;
BA_ "GatewayedSignals" SG_ 363 EPS_EmSteerEnbale 0;
BA_ "GenSigInactiveValue" SG_ 363 EPS_EmSteerEnbale 0;
BA_ "GenSigInvalidValue" SG_ 363 EPS_EmSteerEnbale 0;
BA_ "GenSigSendType" SG_ 363 EPS_EmSteerEnbale 1;
BA_ "GenSigStartValue" SG_ 363 EPS_EmSteerEnbale 0;
BA_ "GenSigTimeoutValue" SG_ 363 EPS_EmSteerEnbale 0;
BA_ "Remark" SG_ 363 EPS_EmSteerEnbale "";
BA_ "EventCommandSignal" SG_ 363 EPS_EM_ErrFeedback 0;
BA_ "GatewayedSignals" SG_ 363 EPS_EM_ErrFeedback 0;
BA_ "GenSigInactiveValue" SG_ 363 EPS_EM_ErrFeedback 0;
BA_ "GenSigInvalidValue" SG_ 363 EPS_EM_ErrFeedback 0;
BA_ "GenSigSendType" SG_ 363 EPS_EM_ErrFeedback 1;
BA_ "GenSigStartValue" SG_ 363 EPS_EM_ErrFeedback 0;
BA_ "GenSigTimeoutValue" SG_ 363 EPS_EM_ErrFeedback 0;
BA_ "Remark" SG_ 363 EPS_EM_ErrFeedback "";
BA_ "EventCommandSignal" SG_ 363 EPS_VW_ErrFeedback 0;
BA_ "GatewayedSignals" SG_ 363 EPS_VW_ErrFeedback 0;
BA_ "GenSigInactiveValue" SG_ 363 EPS_VW_ErrFeedback 0;
BA_ "GenSigInvalidValue" SG_ 363 EPS_VW_ErrFeedback 0;
BA_ "GenSigSendType" SG_ 363 EPS_VW_ErrFeedback 1;
BA_ "GenSigStartValue" SG_ 363 EPS_VW_ErrFeedback 0;
BA_ "GenSigTimeoutValue" SG_ 363 EPS_VW_ErrFeedback 0;
BA_ "Remark" SG_ 363 EPS_VW_ErrFeedback "";
BA_ "EventCommandSignal" SG_ 363 EPS_SG_ErrFeedback 0;
BA_ "GatewayedSignals" SG_ 363 EPS_SG_ErrFeedback 0;
BA_ "GenSigInactiveValue" SG_ 363 EPS_SG_ErrFeedback 0;
BA_ "GenSigInvalidValue" SG_ 363 EPS_SG_ErrFeedback 0;
BA_ "GenSigSendType" SG_ 363 EPS_SG_ErrFeedback 1;
BA_ "GenSigStartValue" SG_ 363 EPS_SG_ErrFeedback 0;
BA_ "GenSigTimeoutValue" SG_ 363 EPS_SG_ErrFeedback 0;
BA_ "Remark" SG_ 363 EPS_SG_ErrFeedback "";
BA_ "EventCommandSignal" SG_ 363 EPS_SACMotorTorActMot 0;
BA_ "GatewayedSignals" SG_ 363 EPS_SACMotorTorActMot 0;
BA_ "GenSigInactiveValue" SG_ 363 EPS_SACMotorTorActMot 0;
BA_ "GenSigInvalidValue" SG_ 363 EPS_SACMotorTorActMot 0;
BA_ "GenSigSendType" SG_ 363 EPS_SACMotorTorActMot 1;
BA_ "GenSigStartValue" SG_ 363 EPS_SACMotorTorActMot 600;
BA_ "GenSigTimeoutValue" SG_ 363 EPS_SACMotorTorActMot 600;
BA_ "Remark" SG_ 363 EPS_SACMotorTorActMot "";
BA_ "EventCommandSignal" SG_ 363 EPS_SACMotorTorLimIntMot 0;
BA_ "GatewayedSignals" SG_ 363 EPS_SACMotorTorLimIntMot 0;
BA_ "GenSigInactiveValue" SG_ 363 EPS_SACMotorTorLimIntMot 0;
BA_ "GenSigInvalidValue" SG_ 363 EPS_SACMotorTorLimIntMot 2047;
BA_ "GenSigSendType" SG_ 363 EPS_SACMotorTorLimIntMot 1;
BA_ "GenSigStartValue" SG_ 363 EPS_SACMotorTorLimIntMot 0;
BA_ "GenSigTimeoutValue" SG_ 363 EPS_SACMotorTorLimIntMot 2047;
BA_ "Remark" SG_ 363 EPS_SACMotorTorLimIntMot "";
BA_ "EventCommandSignal" SG_ 363 EPS_SG_ActualLevel 0;
BA_ "GatewayedSignals" SG_ 363 EPS_SG_ActualLevel 0;
BA_ "GenSigInactiveValue" SG_ 363 EPS_SG_ActualLevel 0;
BA_ "GenSigInvalidValue" SG_ 363 EPS_SG_ActualLevel 255;
BA_ "GenSigSendType" SG_ 363 EPS_SG_ActualLevel 1;
BA_ "GenSigStartValue" SG_ 363 EPS_SG_ActualLevel 100;
BA_ "GenSigTimeoutValue" SG_ 363 EPS_SG_ActualLevel 0;
BA_ "Remark" SG_ 363 EPS_SG_ActualLevel "";
BA_ "EventCommandSignal" SG_ 363 EPS_MotorTorSum 0;
BA_ "GatewayedSignals" SG_ 363 EPS_MotorTorSum 0;
BA_ "GenSigInactiveValue" SG_ 363 EPS_MotorTorSum 0;
BA_ "GenSigInvalidValue" SG_ 363 EPS_MotorTorSum 0;
BA_ "GenSigSendType" SG_ 363 EPS_MotorTorSum 1;
BA_ "GenSigStartValue" SG_ 363 EPS_MotorTorSum 600;
BA_ "GenSigTimeoutValue" SG_ 363 EPS_MotorTorSum 600;
BA_ "Remark" SG_ 363 EPS_MotorTorSum "";
BA_ "EventCommandSignal" SG_ 363 EPS_WarnLamp 0;
BA_ "GatewayedSignals" SG_ 363 EPS_WarnLamp 0;
BA_ "GenSigInactiveValue" SG_ 363 EPS_WarnLamp 0;
BA_ "GenSigInvalidValue" SG_ 363 EPS_WarnLamp 0;
BA_ "GenSigSendType" SG_ 363 EPS_WarnLamp 1;
BA_ "GenSigStartValue" SG_ 363 EPS_WarnLamp 0;
BA_ "GenSigTimeoutValue" SG_ 363 EPS_WarnLamp 2;
BA_ "Remark" SG_ 363 EPS_WarnLamp "";
BA_ "EventCommandSignal" SG_ 363 EPS_AssistRatio 0;
BA_ "GatewayedSignals" SG_ 363 EPS_AssistRatio 0;
BA_ "GenSigInactiveValue" SG_ 363 EPS_AssistRatio 0;
BA_ "GenSigInvalidValue" SG_ 363 EPS_AssistRatio 50;
BA_ "GenSigSendType" SG_ 363 EPS_AssistRatio 1;
BA_ "GenSigStartValue" SG_ 363 EPS_AssistRatio 50;
BA_ "GenSigTimeoutValue" SG_ 363 EPS_AssistRatio 0;
BA_ "Remark" SG_ 363 EPS_AssistRatio "";
BA_ "EventCommandSignal" SG_ 363 EPS_SteeringWhlTorFlt 0;
BA_ "GatewayedSignals" SG_ 363 EPS_SteeringWhlTorFlt 0;
BA_ "GenSigInactiveValue" SG_ 363 EPS_SteeringWhlTorFlt 0;
BA_ "GenSigInvalidValue" SG_ 363 EPS_SteeringWhlTorFlt 4095;
BA_ "GenSigSendType" SG_ 363 EPS_SteeringWhlTorFlt 1;
BA_ "GenSigStartValue" SG_ 363 EPS_SteeringWhlTorFlt 1500;
BA_ "GenSigTimeoutValue" SG_ 363 EPS_SteeringWhlTorFlt 4095;
BA_ "Remark" SG_ 363 EPS_SteeringWhlTorFlt "";
BA_ "EventCommandSignal" SG_ 363 EPS_SteeringWhlTorFltVD 0;
BA_ "GatewayedSignals" SG_ 363 EPS_SteeringWhlTorFltVD 0;
BA_ "GenSigInactiveValue" SG_ 363 EPS_SteeringWhlTorFltVD 0;
BA_ "GenSigInvalidValue" SG_ 363 EPS_SteeringWhlTorFltVD 0;
BA_ "GenSigSendType" SG_ 363 EPS_SteeringWhlTorFltVD 1;
BA_ "GenSigStartValue" SG_ 363 EPS_SteeringWhlTorFltVD 0;
BA_ "GenSigTimeoutValue" SG_ 363 EPS_SteeringWhlTorFltVD 0;
BA_ "Remark" SG_ 363 EPS_SteeringWhlTorFltVD "";
BA_ "EventCommandSignal" SG_ 363 EPS_SteeringAngleRate 0;
BA_ "GatewayedSignals" SG_ 363 EPS_SteeringAngleRate 0;
BA_ "GenSigInactiveValue" SG_ 363 EPS_SteeringAngleRate 0;
BA_ "GenSigInvalidValue" SG_ 363 EPS_SteeringAngleRate 0;
BA_ "GenSigSendType" SG_ 363 EPS_SteeringAngleRate 1;
BA_ "GenSigStartValue" SG_ 363 EPS_SteeringAngleRate 0;
BA_ "GenSigTimeoutValue" SG_ 363 EPS_SteeringAngleRate 0;
BA_ "Remark" SG_ 363 EPS_SteeringAngleRate "";
BA_ "EventCommandSignal" SG_ 363 EPS_TqCtrlSt 0;
BA_ "GatewayedSignals" SG_ 363 EPS_TqCtrlSt 0;
BA_ "GenSigInactiveValue" SG_ 363 EPS_TqCtrlSt 0;
BA_ "GenSigInvalidValue" SG_ 363 EPS_TqCtrlSt 0;
BA_ "GenSigSendType" SG_ 363 EPS_TqCtrlSt 1;
BA_ "GenSigStartValue" SG_ 363 EPS_TqCtrlSt 0;
BA_ "GenSigTimeoutValue" SG_ 363 EPS_TqCtrlSt 0;
BA_ "Remark" SG_ 363 EPS_TqCtrlSt "";
BA_ "EventCommandSignal" SG_ 363 EPS_MotorTorForDrv 0;
BA_ "GatewayedSignals" SG_ 363 EPS_MotorTorForDrv 0;
BA_ "GenSigInactiveValue" SG_ 363 EPS_MotorTorForDrv 0;
BA_ "GenSigInvalidValue" SG_ 363 EPS_MotorTorForDrv 4095;
BA_ "GenSigSendType" SG_ 363 EPS_MotorTorForDrv 1;
BA_ "GenSigStartValue" SG_ 363 EPS_MotorTorForDrv 2000;
BA_ "GenSigTimeoutValue" SG_ 363 EPS_MotorTorForDrv 4095;
BA_ "Remark" SG_ 363 EPS_MotorTorForDrv "";
BA_ "EventCommandSignal" SG_ 363 EPS_TqCtrlAvl 0;
BA_ "GatewayedSignals" SG_ 363 EPS_TqCtrlAvl 0;
BA_ "GenSigInactiveValue" SG_ 363 EPS_TqCtrlAvl 0;
BA_ "GenSigInvalidValue" SG_ 363 EPS_TqCtrlAvl 0;
BA_ "GenSigSendType" SG_ 363 EPS_TqCtrlAvl 1;
BA_ "GenSigStartValue" SG_ 363 EPS_TqCtrlAvl 0;
BA_ "GenSigTimeoutValue" SG_ 363 EPS_TqCtrlAvl 0;
BA_ "Remark" SG_ 363 EPS_TqCtrlAvl "";
BA_ "EventCommandSignal" SG_ 363 EPS_AgCtrlAvl 0;
BA_ "GatewayedSignals" SG_ 363 EPS_AgCtrlAvl 0;
BA_ "GenSigInactiveValue" SG_ 363 EPS_AgCtrlAvl 0;
BA_ "GenSigInvalidValue" SG_ 363 EPS_AgCtrlAvl 0;
BA_ "GenSigSendType" SG_ 363 EPS_AgCtrlAvl 1;
BA_ "GenSigStartValue" SG_ 363 EPS_AgCtrlAvl 0;
BA_ "GenSigTimeoutValue" SG_ 363 EPS_AgCtrlAvl 0;
BA_ "Remark" SG_ 363 EPS_AgCtrlAvl "";
BA_ "EventCommandSignal" SG_ 363 EPS_MotorTorSumVD 0;
BA_ "GatewayedSignals" SG_ 363 EPS_MotorTorSumVD 0;
BA_ "GenSigInactiveValue" SG_ 363 EPS_MotorTorSumVD 0;
BA_ "GenSigInvalidValue" SG_ 363 EPS_MotorTorSumVD 0;
BA_ "GenSigSendType" SG_ 363 EPS_MotorTorSumVD 1;
BA_ "GenSigStartValue" SG_ 363 EPS_MotorTorSumVD 0;
BA_ "GenSigTimeoutValue" SG_ 363 EPS_MotorTorSumVD 0;
BA_ "Remark" SG_ 363 EPS_MotorTorSumVD "";
BA_ "EventCommandSignal" SG_ 363 EPS_DrvOveRideSt 0;
BA_ "GatewayedSignals" SG_ 363 EPS_DrvOveRideSt 0;
BA_ "GenSigInactiveValue" SG_ 363 EPS_DrvOveRideSt 0;
BA_ "GenSigInvalidValue" SG_ 363 EPS_DrvOveRideSt 0;
BA_ "GenSigSendType" SG_ 363 EPS_DrvOveRideSt 1;
BA_ "GenSigStartValue" SG_ 363 EPS_DrvOveRideSt 0;
BA_ "GenSigTimeoutValue" SG_ 363 EPS_DrvOveRideSt 0;
BA_ "Remark" SG_ 363 EPS_DrvOveRideSt "";
BA_ "EventCommandSignal" SG_ 363 EPS_DrvOveRideVD 0;
BA_ "GatewayedSignals" SG_ 363 EPS_DrvOveRideVD 0;
BA_ "GenSigInactiveValue" SG_ 363 EPS_DrvOveRideVD 0;
BA_ "GenSigInvalidValue" SG_ 363 EPS_DrvOveRideVD 0;
BA_ "GenSigSendType" SG_ 363 EPS_DrvOveRideVD 1;
BA_ "GenSigStartValue" SG_ 363 EPS_DrvOveRideVD 0;
BA_ "GenSigTimeoutValue" SG_ 363 EPS_DrvOveRideVD 0;
BA_ "Remark" SG_ 363 EPS_DrvOveRideVD "";
BA_ "EventCommandSignal" SG_ 363 EPS_SteerVibrlAvl 0;
BA_ "GatewayedSignals" SG_ 363 EPS_SteerVibrlAvl 0;
BA_ "GenSigInactiveValue" SG_ 363 EPS_SteerVibrlAvl 0;
BA_ "GenSigInvalidValue" SG_ 363 EPS_SteerVibrlAvl 0;
BA_ "GenSigSendType" SG_ 363 EPS_SteerVibrlAvl 1;
BA_ "GenSigStartValue" SG_ 363 EPS_SteerVibrlAvl 0;
BA_ "GenSigTimeoutValue" SG_ 363 EPS_SteerVibrlAvl 0;
BA_ "Remark" SG_ 363 EPS_SteerVibrlAvl "";
BA_ "EventCommandSignal" SG_ 363 EPS_HandsOffDetStVD 0;
BA_ "GatewayedSignals" SG_ 363 EPS_HandsOffDetStVD 0;
BA_ "GenSigInactiveValue" SG_ 363 EPS_HandsOffDetStVD 0;
BA_ "GenSigInvalidValue" SG_ 363 EPS_HandsOffDetStVD 0;
BA_ "GenSigSendType" SG_ 363 EPS_HandsOffDetStVD 1;
BA_ "GenSigStartValue" SG_ 363 EPS_HandsOffDetStVD 0;
BA_ "GenSigTimeoutValue" SG_ 363 EPS_HandsOffDetStVD 0;
BA_ "Remark" SG_ 363 EPS_HandsOffDetStVD "";
BA_ "EventCommandSignal" SG_ 363 EPS_HandsOffDetSt 0;
BA_ "GatewayedSignals" SG_ 363 EPS_HandsOffDetSt 0;
BA_ "GenSigInactiveValue" SG_ 363 EPS_HandsOffDetSt 0;
BA_ "GenSigInvalidValue" SG_ 363 EPS_HandsOffDetSt 0;
BA_ "GenSigSendType" SG_ 363 EPS_HandsOffDetSt 1;
BA_ "GenSigStartValue" SG_ 363 EPS_HandsOffDetSt 0;
BA_ "GenSigTimeoutValue" SG_ 363 EPS_HandsOffDetSt 0;
BA_ "Remark" SG_ 363 EPS_HandsOffDetSt "";
BA_ "EventCommandSignal" SG_ 363 EPS_SteerMod 0;
BA_ "GatewayedSignals" SG_ 363 EPS_SteerMod 0;
BA_ "GenSigInactiveValue" SG_ 363 EPS_SteerMod 0;
BA_ "GenSigInvalidValue" SG_ 363 EPS_SteerMod 0;
BA_ "GenSigSendType" SG_ 363 EPS_SteerMod 1;
BA_ "GenSigStartValue" SG_ 363 EPS_SteerMod 0;
BA_ "GenSigTimeoutValue" SG_ 363 EPS_SteerMod 0;
BA_ "Remark" SG_ 363 EPS_SteerMod "";
BA_ "EventCommandSignal" SG_ 363 EPS_ADCNetErrorFb 0;
BA_ "GatewayedSignals" SG_ 363 EPS_ADCNetErrorFb 0;
BA_ "GenSigInactiveValue" SG_ 363 EPS_ADCNetErrorFb 0;
BA_ "GenSigInvalidValue" SG_ 363 EPS_ADCNetErrorFb 0;
BA_ "GenSigSendType" SG_ 363 EPS_ADCNetErrorFb 1;
BA_ "GenSigStartValue" SG_ 363 EPS_ADCNetErrorFb 0;
BA_ "GenSigTimeoutValue" SG_ 363 EPS_ADCNetErrorFb 0;
BA_ "Remark" SG_ 363 EPS_ADCNetErrorFb "";
BA_ "EventCommandSignal" SG_ 363 EPS_NetModeResp 0;
BA_ "GatewayedSignals" SG_ 363 EPS_NetModeResp 0;
BA_ "GenSigInactiveValue" SG_ 363 EPS_NetModeResp 0;
BA_ "GenSigInvalidValue" SG_ 363 EPS_NetModeResp 0;
BA_ "GenSigSendType" SG_ 363 EPS_NetModeResp 1;
BA_ "GenSigStartValue" SG_ 363 EPS_NetModeResp 0;
BA_ "GenSigTimeoutValue" SG_ 363 EPS_NetModeResp 0;
BA_ "Remark" SG_ 363 EPS_NetModeResp "";
BA_ "EventCommandSignal" SG_ 360 BCS_6_CRC 0;
BA_ "GatewayedSignals" SG_ 360 BCS_6_CRC 0;
BA_ "GenSigInactiveValue" SG_ 360 BCS_6_CRC 0;
BA_ "GenSigInvalidValue" SG_ 360 BCS_6_CRC 0;
BA_ "GenSigSendType" SG_ 360 BCS_6_CRC 1;
BA_ "GenSigStartValue" SG_ 360 BCS_6_CRC 0;
BA_ "GenSigTimeoutValue" SG_ 360 BCS_6_CRC 0;
BA_ "Remark" SG_ 360 BCS_6_CRC "";
BA_ "EventCommandSignal" SG_ 360 BCS_6_Counter 0;
BA_ "GatewayedSignals" SG_ 360 BCS_6_Counter 0;
BA_ "GenSigInactiveValue" SG_ 360 BCS_6_Counter 0;
BA_ "GenSigInvalidValue" SG_ 360 BCS_6_Counter 0;
BA_ "GenSigSendType" SG_ 360 BCS_6_Counter 1;
BA_ "GenSigStartValue" SG_ 360 BCS_6_Counter 0;
BA_ "GenSigTimeoutValue" SG_ 360 BCS_6_Counter 0;
BA_ "Remark" SG_ 360 BCS_6_Counter "";
BA_ "EventCommandSignal" SG_ 360 BCS_HydBrkActTorqFL 0;
BA_ "GatewayedSignals" SG_ 360 BCS_HydBrkActTorqFL 0;
BA_ "GenSigInactiveValue" SG_ 360 BCS_HydBrkActTorqFL 0;
BA_ "GenSigInvalidValue" SG_ 360 BCS_HydBrkActTorqFL 0;
BA_ "GenSigSendType" SG_ 360 BCS_HydBrkActTorqFL 1;
BA_ "GenSigStartValue" SG_ 360 BCS_HydBrkActTorqFL 0;
BA_ "GenSigTimeoutValue" SG_ 360 BCS_HydBrkActTorqFL 0;
BA_ "Remark" SG_ 360 BCS_HydBrkActTorqFL "";
BA_ "EventCommandSignal" SG_ 360 BCS_HydBrkActTorqFR 0;
BA_ "GatewayedSignals" SG_ 360 BCS_HydBrkActTorqFR 0;
BA_ "GenSigInactiveValue" SG_ 360 BCS_HydBrkActTorqFR 0;
BA_ "GenSigInvalidValue" SG_ 360 BCS_HydBrkActTorqFR 0;
BA_ "GenSigSendType" SG_ 360 BCS_HydBrkActTorqFR 1;
BA_ "GenSigStartValue" SG_ 360 BCS_HydBrkActTorqFR 0;
BA_ "GenSigTimeoutValue" SG_ 360 BCS_HydBrkActTorqFR 0;
BA_ "Remark" SG_ 360 BCS_HydBrkActTorqFR "";
BA_ "EventCommandSignal" SG_ 360 BCS_HydBrkActTorqRL 0;
BA_ "GatewayedSignals" SG_ 360 BCS_HydBrkActTorqRL 0;
BA_ "GenSigInactiveValue" SG_ 360 BCS_HydBrkActTorqRL 0;
BA_ "GenSigInvalidValue" SG_ 360 BCS_HydBrkActTorqRL 0;
BA_ "GenSigSendType" SG_ 360 BCS_HydBrkActTorqRL 1;
BA_ "GenSigStartValue" SG_ 360 BCS_HydBrkActTorqRL 0;
BA_ "GenSigTimeoutValue" SG_ 360 BCS_HydBrkActTorqRL 0;
BA_ "Remark" SG_ 360 BCS_HydBrkActTorqRL "";
BA_ "EventCommandSignal" SG_ 360 BCS_HydBrkActTorqRR 0;
BA_ "GatewayedSignals" SG_ 360 BCS_HydBrkActTorqRR 0;
BA_ "GenSigInactiveValue" SG_ 360 BCS_HydBrkActTorqRR 0;
BA_ "GenSigInvalidValue" SG_ 360 BCS_HydBrkActTorqRR 0;
BA_ "GenSigSendType" SG_ 360 BCS_HydBrkActTorqRR 1;
BA_ "GenSigStartValue" SG_ 360 BCS_HydBrkActTorqRR 0;
BA_ "GenSigTimeoutValue" SG_ 360 BCS_HydBrkActTorqRR 0;
BA_ "Remark" SG_ 360 BCS_HydBrkActTorqRR "";
BA_ "EventCommandSignal" SG_ 360 BCS_HydBrkTorqReq 0;
BA_ "GatewayedSignals" SG_ 360 BCS_HydBrkTorqReq 0;
BA_ "GenSigInactiveValue" SG_ 360 BCS_HydBrkTorqReq 0;
BA_ "GenSigInvalidValue" SG_ 360 BCS_HydBrkTorqReq 0;
BA_ "GenSigSendType" SG_ 360 BCS_HydBrkTorqReq 1;
BA_ "GenSigStartValue" SG_ 360 BCS_HydBrkTorqReq 0;
BA_ "GenSigTimeoutValue" SG_ 360 BCS_HydBrkTorqReq 0;
BA_ "Remark" SG_ 360 BCS_HydBrkTorqReq "";
BA_ "EventCommandSignal" SG_ 360 BCS_BrkActTorq 0;
BA_ "GatewayedSignals" SG_ 360 BCS_BrkActTorq 0;
BA_ "GenSigInactiveValue" SG_ 360 BCS_BrkActTorq 0;
BA_ "GenSigInvalidValue" SG_ 360 BCS_BrkActTorq 0;
BA_ "GenSigSendType" SG_ 360 BCS_BrkActTorq 1;
BA_ "GenSigStartValue" SG_ 360 BCS_BrkActTorq 0;
BA_ "GenSigTimeoutValue" SG_ 360 BCS_BrkActTorq 0;
BA_ "Remark" SG_ 360 BCS_BrkActTorq "";
BA_ "EventCommandSignal" SG_ 360 BCS_HydBrkActTorq 0;
BA_ "GatewayedSignals" SG_ 360 BCS_HydBrkActTorq 0;
BA_ "GenSigInactiveValue" SG_ 360 BCS_HydBrkActTorq 0;
BA_ "GenSigInvalidValue" SG_ 360 BCS_HydBrkActTorq 0;
BA_ "GenSigSendType" SG_ 360 BCS_HydBrkActTorq 1;
BA_ "GenSigStartValue" SG_ 360 BCS_HydBrkActTorq 0;
BA_ "GenSigTimeoutValue" SG_ 360 BCS_HydBrkActTorq 0;
BA_ "Remark" SG_ 360 BCS_HydBrkActTorq "";
BA_ "EventCommandSignal" SG_ 360 BCS_DycActTorq 0;
BA_ "GatewayedSignals" SG_ 360 BCS_DycActTorq 0;
BA_ "GenSigInactiveValue" SG_ 360 BCS_DycActTorq 0;
BA_ "GenSigInvalidValue" SG_ 360 BCS_DycActTorq 0;
BA_ "GenSigSendType" SG_ 360 BCS_DycActTorq 1;
BA_ "GenSigStartValue" SG_ 360 BCS_DycActTorq 0;
BA_ "GenSigTimeoutValue" SG_ 360 BCS_DycActTorq 0;
BA_ "Remark" SG_ 360 BCS_DycActTorq "";
BA_ "EventCommandSignal" SG_ 360 BCS_ChVehSpd 0;
BA_ "GatewayedSignals" SG_ 360 BCS_ChVehSpd 0;
BA_ "GenSigInactiveValue" SG_ 360 BCS_ChVehSpd 0;
BA_ "GenSigInvalidValue" SG_ 360 BCS_ChVehSpd 0;
BA_ "GenSigSendType" SG_ 360 BCS_ChVehSpd 1;
BA_ "GenSigStartValue" SG_ 360 BCS_ChVehSpd 0;
BA_ "GenSigTimeoutValue" SG_ 360 BCS_ChVehSpd 0;
BA_ "Remark" SG_ 360 BCS_ChVehSpd "";
BA_ "EventCommandSignal" SG_ 360 BCS_BrkTqCtrlAvlDriving 0;
BA_ "GatewayedSignals" SG_ 360 BCS_BrkTqCtrlAvlDriving 0;
BA_ "GenSigInactiveValue" SG_ 360 BCS_BrkTqCtrlAvlDriving 0;
BA_ "GenSigInvalidValue" SG_ 360 BCS_BrkTqCtrlAvlDriving 0;
BA_ "GenSigSendType" SG_ 360 BCS_BrkTqCtrlAvlDriving 1;
BA_ "GenSigStartValue" SG_ 360 BCS_BrkTqCtrlAvlDriving 0;
BA_ "GenSigTimeoutValue" SG_ 360 BCS_BrkTqCtrlAvlDriving 0;
BA_ "Remark" SG_ 360 BCS_BrkTqCtrlAvlDriving "";
BA_ "EventCommandSignal" SG_ 360 BCS_BrkTqCtrlAvlParking 0;
BA_ "GatewayedSignals" SG_ 360 BCS_BrkTqCtrlAvlParking 0;
BA_ "GenSigInactiveValue" SG_ 360 BCS_BrkTqCtrlAvlParking 0;
BA_ "GenSigInvalidValue" SG_ 360 BCS_BrkTqCtrlAvlParking 0;
BA_ "GenSigSendType" SG_ 360 BCS_BrkTqCtrlAvlParking 1;
BA_ "GenSigStartValue" SG_ 360 BCS_BrkTqCtrlAvlParking 0;
BA_ "GenSigTimeoutValue" SG_ 360 BCS_BrkTqCtrlAvlParking 0;
BA_ "Remark" SG_ 360 BCS_BrkTqCtrlAvlParking "";
BA_ "EventCommandSignal" SG_ 360 BCS_BrkTqCtrlActv 0;
BA_ "GatewayedSignals" SG_ 360 BCS_BrkTqCtrlActv 0;
BA_ "GenSigInactiveValue" SG_ 360 BCS_BrkTqCtrlActv 0;
BA_ "GenSigInvalidValue" SG_ 360 BCS_BrkTqCtrlActv 0;
BA_ "GenSigSendType" SG_ 360 BCS_BrkTqCtrlActv 1;
BA_ "GenSigStartValue" SG_ 360 BCS_BrkTqCtrlActv 0;
BA_ "GenSigTimeoutValue" SG_ 360 BCS_BrkTqCtrlActv 0;
BA_ "Remark" SG_ 360 BCS_BrkTqCtrlActv "";
BA_ "EventCommandSignal" SG_ 360 BCS_ChVehSpdVD 0;
BA_ "GatewayedSignals" SG_ 360 BCS_ChVehSpdVD 0;
BA_ "GenSigInactiveValue" SG_ 360 BCS_ChVehSpdVD 0;
BA_ "GenSigInvalidValue" SG_ 360 BCS_ChVehSpdVD 0;
BA_ "GenSigSendType" SG_ 360 BCS_ChVehSpdVD 1;
BA_ "GenSigStartValue" SG_ 360 BCS_ChVehSpdVD 0;
BA_ "GenSigTimeoutValue" SG_ 360 BCS_ChVehSpdVD 0;
BA_ "Remark" SG_ 360 BCS_ChVehSpdVD "";
BA_ "EventCommandSignal" SG_ 360 BCS_ESCFailSt 0;
BA_ "GatewayedSignals" SG_ 360 BCS_ESCFailSt 0;
BA_ "GenSigInactiveValue" SG_ 360 BCS_ESCFailSt 0;
BA_ "GenSigInvalidValue" SG_ 360 BCS_ESCFailSt 0;
BA_ "GenSigSendType" SG_ 360 BCS_ESCFailSt 1;
BA_ "GenSigStartValue" SG_ 360 BCS_ESCFailSt 1;
BA_ "GenSigTimeoutValue" SG_ 360 BCS_ESCFailSt 1;
BA_ "Remark" SG_ 360 BCS_ESCFailSt "";
BA_ "EventCommandSignal" SG_ 360 BCS_ESCFuncActiveSt 0;
BA_ "GatewayedSignals" SG_ 360 BCS_ESCFuncActiveSt 0;
BA_ "GenSigInactiveValue" SG_ 360 BCS_ESCFuncActiveSt 0;
BA_ "GenSigInvalidValue" SG_ 360 BCS_ESCFuncActiveSt 0;
BA_ "GenSigSendType" SG_ 360 BCS_ESCFuncActiveSt 1;
BA_ "GenSigStartValue" SG_ 360 BCS_ESCFuncActiveSt 0;
BA_ "GenSigTimeoutValue" SG_ 360 BCS_ESCFuncActiveSt 0;
BA_ "Remark" SG_ 360 BCS_ESCFuncActiveSt "";
BA_ "EventCommandSignal" SG_ 360 BCS_DycEscTarTqCtrlAvl 0;
BA_ "GatewayedSignals" SG_ 360 BCS_DycEscTarTqCtrlAvl 0;
BA_ "GenSigInactiveValue" SG_ 360 BCS_DycEscTarTqCtrlAvl 0;
BA_ "GenSigInvalidValue" SG_ 360 BCS_DycEscTarTqCtrlAvl 0;
BA_ "GenSigSendType" SG_ 360 BCS_DycEscTarTqCtrlAvl 1;
BA_ "GenSigStartValue" SG_ 360 BCS_DycEscTarTqCtrlAvl 0;
BA_ "GenSigTimeoutValue" SG_ 360 BCS_DycEscTarTqCtrlAvl 0;
BA_ "Remark" SG_ 360 BCS_DycEscTarTqCtrlAvl "";
BA_ "EventCommandSignal" SG_ 360 BCS_errorFb 0;
BA_ "GatewayedSignals" SG_ 360 BCS_errorFb 0;
BA_ "GenSigInactiveValue" SG_ 360 BCS_errorFb 0;
BA_ "GenSigInvalidValue" SG_ 360 BCS_errorFb 0;
BA_ "GenSigSendType" SG_ 360 BCS_errorFb 1;
BA_ "GenSigStartValue" SG_ 360 BCS_errorFb 0;
BA_ "GenSigTimeoutValue" SG_ 360 BCS_errorFb 0;
BA_ "Remark" SG_ 360 BCS_errorFb "";
BA_ "EventCommandSignal" SG_ 360 BCS_DrvrBrkOvrd 0;
BA_ "GatewayedSignals" SG_ 360 BCS_DrvrBrkOvrd 0;
BA_ "GenSigInactiveValue" SG_ 360 BCS_DrvrBrkOvrd 0;
BA_ "GenSigInvalidValue" SG_ 360 BCS_DrvrBrkOvrd 0;
BA_ "GenSigSendType" SG_ 360 BCS_DrvrBrkOvrd 1;
BA_ "GenSigStartValue" SG_ 360 BCS_DrvrBrkOvrd 0;
BA_ "GenSigTimeoutValue" SG_ 360 BCS_DrvrBrkOvrd 0;
BA_ "Remark" SG_ 360 BCS_DrvrBrkOvrd "";
BA_ "EventCommandSignal" SG_ 360 BCS_DrvrBrkOvrdVD 0;
BA_ "GatewayedSignals" SG_ 360 BCS_DrvrBrkOvrdVD 0;
BA_ "GenSigInactiveValue" SG_ 360 BCS_DrvrBrkOvrdVD 0;
BA_ "GenSigInvalidValue" SG_ 360 BCS_DrvrBrkOvrdVD 0;
BA_ "GenSigSendType" SG_ 360 BCS_DrvrBrkOvrdVD 1;
BA_ "GenSigStartValue" SG_ 360 BCS_DrvrBrkOvrdVD 0;
BA_ "GenSigTimeoutValue" SG_ 360 BCS_DrvrBrkOvrdVD 0;
BA_ "Remark" SG_ 360 BCS_DrvrBrkOvrdVD "";
BA_ "EventCommandSignal" SG_ 360 BCS_DycEscTarTqActv 0;
BA_ "GatewayedSignals" SG_ 360 BCS_DycEscTarTqActv 0;
BA_ "GenSigInactiveValue" SG_ 360 BCS_DycEscTarTqActv 0;
BA_ "GenSigInvalidValue" SG_ 360 BCS_DycEscTarTqActv 0;
BA_ "GenSigSendType" SG_ 360 BCS_DycEscTarTqActv 1;
BA_ "GenSigStartValue" SG_ 360 BCS_DycEscTarTqActv 0;
BA_ "GenSigTimeoutValue" SG_ 360 BCS_DycEscTarTqActv 0;
BA_ "Remark" SG_ 360 BCS_DycEscTarTqActv "";
BA_ "EventCommandSignal" SG_ 360 BCS_WheelSlipFLVD 0;
BA_ "GatewayedSignals" SG_ 360 BCS_WheelSlipFLVD 0;
BA_ "GenSigInactiveValue" SG_ 360 BCS_WheelSlipFLVD 0;
BA_ "GenSigInvalidValue" SG_ 360 BCS_WheelSlipFLVD 0;
BA_ "GenSigSendType" SG_ 360 BCS_WheelSlipFLVD 1;
BA_ "GenSigStartValue" SG_ 360 BCS_WheelSlipFLVD 0;
BA_ "GenSigTimeoutValue" SG_ 360 BCS_WheelSlipFLVD 0;
BA_ "Remark" SG_ 360 BCS_WheelSlipFLVD "";
BA_ "EventCommandSignal" SG_ 360 BCS_WheelSlipFRVD 0;
BA_ "GatewayedSignals" SG_ 360 BCS_WheelSlipFRVD 0;
BA_ "GenSigInactiveValue" SG_ 360 BCS_WheelSlipFRVD 0;
BA_ "GenSigInvalidValue" SG_ 360 BCS_WheelSlipFRVD 0;
BA_ "GenSigSendType" SG_ 360 BCS_WheelSlipFRVD 1;
BA_ "GenSigStartValue" SG_ 360 BCS_WheelSlipFRVD 0;
BA_ "GenSigTimeoutValue" SG_ 360 BCS_WheelSlipFRVD 0;
BA_ "Remark" SG_ 360 BCS_WheelSlipFRVD "";
BA_ "EventCommandSignal" SG_ 360 BCS_WheelSlipRLVD 0;
BA_ "GatewayedSignals" SG_ 360 BCS_WheelSlipRLVD 0;
BA_ "GenSigInactiveValue" SG_ 360 BCS_WheelSlipRLVD 0;
BA_ "GenSigInvalidValue" SG_ 360 BCS_WheelSlipRLVD 0;
BA_ "GenSigSendType" SG_ 360 BCS_WheelSlipRLVD 1;
BA_ "GenSigStartValue" SG_ 360 BCS_WheelSlipRLVD 0;
BA_ "GenSigTimeoutValue" SG_ 360 BCS_WheelSlipRLVD 0;
BA_ "Remark" SG_ 360 BCS_WheelSlipRLVD "";
BA_ "EventCommandSignal" SG_ 360 BCS_WheelSlipRRVD 0;
BA_ "GatewayedSignals" SG_ 360 BCS_WheelSlipRRVD 0;
BA_ "GenSigInactiveValue" SG_ 360 BCS_WheelSlipRRVD 0;
BA_ "GenSigInvalidValue" SG_ 360 BCS_WheelSlipRRVD 0;
BA_ "GenSigSendType" SG_ 360 BCS_WheelSlipRRVD 1;
BA_ "GenSigStartValue" SG_ 360 BCS_WheelSlipRRVD 0;
BA_ "GenSigTimeoutValue" SG_ 360 BCS_WheelSlipRRVD 0;
BA_ "Remark" SG_ 360 BCS_WheelSlipRRVD "";
BA_ "EventCommandSignal" SG_ 360 BCS_DrvrReqBrkTorq 0;
BA_ "GatewayedSignals" SG_ 360 BCS_DrvrReqBrkTorq 0;
BA_ "GenSigInactiveValue" SG_ 360 BCS_DrvrReqBrkTorq 0;
BA_ "GenSigInvalidValue" SG_ 360 BCS_DrvrReqBrkTorq 0;
BA_ "GenSigSendType" SG_ 360 BCS_DrvrReqBrkTorq 1;
BA_ "GenSigStartValue" SG_ 360 BCS_DrvrReqBrkTorq 0;
BA_ "GenSigTimeoutValue" SG_ 360 BCS_DrvrReqBrkTorq 0;
BA_ "Remark" SG_ 360 BCS_DrvrReqBrkTorq "";
BA_ "EventCommandSignal" SG_ 360 BCS_BrkTarRecpTorqFA 0;
BA_ "GatewayedSignals" SG_ 360 BCS_BrkTarRecpTorqFA 0;
BA_ "GenSigInactiveValue" SG_ 360 BCS_BrkTarRecpTorqFA 0;
BA_ "GenSigInvalidValue" SG_ 360 BCS_BrkTarRecpTorqFA 0;
BA_ "GenSigSendType" SG_ 360 BCS_BrkTarRecpTorqFA 1;
BA_ "GenSigStartValue" SG_ 360 BCS_BrkTarRecpTorqFA 6000;
BA_ "GenSigTimeoutValue" SG_ 360 BCS_BrkTarRecpTorqFA 0;
BA_ "Remark" SG_ 360 BCS_BrkTarRecpTorqFA "";
BA_ "EventCommandSignal" SG_ 360 BCS_BrkTarRecpTorqFASt 0;
BA_ "GatewayedSignals" SG_ 360 BCS_BrkTarRecpTorqFASt 0;
BA_ "GenSigInactiveValue" SG_ 360 BCS_BrkTarRecpTorqFASt 0;
BA_ "GenSigInvalidValue" SG_ 360 BCS_BrkTarRecpTorqFASt 0;
BA_ "GenSigSendType" SG_ 360 BCS_BrkTarRecpTorqFASt 1;
BA_ "GenSigStartValue" SG_ 360 BCS_BrkTarRecpTorqFASt 0;
BA_ "GenSigTimeoutValue" SG_ 360 BCS_BrkTarRecpTorqFASt 0;
BA_ "Remark" SG_ 360 BCS_BrkTarRecpTorqFASt "";
BA_ "EventCommandSignal" SG_ 360 BCS_BrkTarRecpTorqRA 0;
BA_ "GatewayedSignals" SG_ 360 BCS_BrkTarRecpTorqRA 0;
BA_ "GenSigInactiveValue" SG_ 360 BCS_BrkTarRecpTorqRA 0;
BA_ "GenSigInvalidValue" SG_ 360 BCS_BrkTarRecpTorqRA 0;
BA_ "GenSigSendType" SG_ 360 BCS_BrkTarRecpTorqRA 1;
BA_ "GenSigStartValue" SG_ 360 BCS_BrkTarRecpTorqRA 6000;
BA_ "GenSigTimeoutValue" SG_ 360 BCS_BrkTarRecpTorqRA 0;
BA_ "Remark" SG_ 360 BCS_BrkTarRecpTorqRA "";
BA_ "EventCommandSignal" SG_ 360 BCS_BrkTarRecpTorqRASt 0;
BA_ "GatewayedSignals" SG_ 360 BCS_BrkTarRecpTorqRASt 0;
BA_ "GenSigInactiveValue" SG_ 360 BCS_BrkTarRecpTorqRASt 0;
BA_ "GenSigInvalidValue" SG_ 360 BCS_BrkTarRecpTorqRASt 0;
BA_ "GenSigSendType" SG_ 360 BCS_BrkTarRecpTorqRASt 1;
BA_ "GenSigStartValue" SG_ 360 BCS_BrkTarRecpTorqRASt 0;
BA_ "GenSigTimeoutValue" SG_ 360 BCS_BrkTarRecpTorqRASt 0;
BA_ "Remark" SG_ 360 BCS_BrkTarRecpTorqRASt "";
BA_ "EventCommandSignal" SG_ 360 BCS_BrkTarRecpTorq 0;
BA_ "GatewayedSignals" SG_ 360 BCS_BrkTarRecpTorq 0;
BA_ "GenSigInactiveValue" SG_ 360 BCS_BrkTarRecpTorq 0;
BA_ "GenSigInvalidValue" SG_ 360 BCS_BrkTarRecpTorq 0;
BA_ "GenSigSendType" SG_ 360 BCS_BrkTarRecpTorq 1;
BA_ "GenSigStartValue" SG_ 360 BCS_BrkTarRecpTorq 6000;
BA_ "GenSigTimeoutValue" SG_ 360 BCS_BrkTarRecpTorq 0;
BA_ "Remark" SG_ 360 BCS_BrkTarRecpTorq "";
BA_ "EventCommandSignal" SG_ 360 BCS_BrkTarRecpTorqSt 0;
BA_ "GatewayedSignals" SG_ 360 BCS_BrkTarRecpTorqSt 0;
BA_ "GenSigInactiveValue" SG_ 360 BCS_BrkTarRecpTorqSt 0;
BA_ "GenSigInvalidValue" SG_ 360 BCS_BrkTarRecpTorqSt 0;
BA_ "GenSigSendType" SG_ 360 BCS_BrkTarRecpTorqSt 1;
BA_ "GenSigStartValue" SG_ 360 BCS_BrkTarRecpTorqSt 0;
BA_ "GenSigTimeoutValue" SG_ 360 BCS_BrkTarRecpTorqSt 0;
BA_ "Remark" SG_ 360 BCS_BrkTarRecpTorqSt "";
BA_ "EventCommandSignal" SG_ 360 BCS_EngTorqDecFastRL 0;
BA_ "GatewayedSignals" SG_ 360 BCS_EngTorqDecFastRL 0;
BA_ "GenSigInactiveValue" SG_ 360 BCS_EngTorqDecFastRL 0;
BA_ "GenSigInvalidValue" SG_ 360 BCS_EngTorqDecFastRL 0;
BA_ "GenSigSendType" SG_ 360 BCS_EngTorqDecFastRL 1;
BA_ "GenSigStartValue" SG_ 360 BCS_EngTorqDecFastRL 16383;
BA_ "GenSigTimeoutValue" SG_ 360 BCS_EngTorqDecFastRL 0;
BA_ "Remark" SG_ 360 BCS_EngTorqDecFastRL "";
BA_ "EventCommandSignal" SG_ 360 BCS_EngTorqDecActiveStRL 0;
BA_ "GatewayedSignals" SG_ 360 BCS_EngTorqDecActiveStRL 0;
BA_ "GenSigInactiveValue" SG_ 360 BCS_EngTorqDecActiveStRL 0;
BA_ "GenSigInvalidValue" SG_ 360 BCS_EngTorqDecActiveStRL 0;
BA_ "GenSigSendType" SG_ 360 BCS_EngTorqDecActiveStRL 1;
BA_ "GenSigStartValue" SG_ 360 BCS_EngTorqDecActiveStRL 0;
BA_ "GenSigTimeoutValue" SG_ 360 BCS_EngTorqDecActiveStRL 0;
BA_ "Remark" SG_ 360 BCS_EngTorqDecActiveStRL "";
BA_ "EventCommandSignal" SG_ 360 BCS_EngTorqDecFastRR 0;
BA_ "GatewayedSignals" SG_ 360 BCS_EngTorqDecFastRR 0;
BA_ "GenSigInactiveValue" SG_ 360 BCS_EngTorqDecFastRR 0;
BA_ "GenSigInvalidValue" SG_ 360 BCS_EngTorqDecFastRR 0;
BA_ "GenSigSendType" SG_ 360 BCS_EngTorqDecFastRR 1;
BA_ "GenSigStartValue" SG_ 360 BCS_EngTorqDecFastRR 16383;
BA_ "GenSigTimeoutValue" SG_ 360 BCS_EngTorqDecFastRR 0;
BA_ "Remark" SG_ 360 BCS_EngTorqDecFastRR "";
BA_ "EventCommandSignal" SG_ 360 BCS_EngTorqDecActiveStRR 0;
BA_ "GatewayedSignals" SG_ 360 BCS_EngTorqDecActiveStRR 0;
BA_ "GenSigInactiveValue" SG_ 360 BCS_EngTorqDecActiveStRR 0;
BA_ "GenSigInvalidValue" SG_ 360 BCS_EngTorqDecActiveStRR 0;
BA_ "GenSigSendType" SG_ 360 BCS_EngTorqDecActiveStRR 1;
BA_ "GenSigStartValue" SG_ 360 BCS_EngTorqDecActiveStRR 0;
BA_ "GenSigTimeoutValue" SG_ 360 BCS_EngTorqDecActiveStRR 0;
BA_ "Remark" SG_ 360 BCS_EngTorqDecActiveStRR "";
BA_ "EventCommandSignal" SG_ 360 BCS_BrkTqCtrlAvlParkingRdn 0;
BA_ "GatewayedSignals" SG_ 360 BCS_BrkTqCtrlAvlParkingRdn 0;
BA_ "GenSigInactiveValue" SG_ 360 BCS_BrkTqCtrlAvlParkingRdn 0;
BA_ "GenSigInvalidValue" SG_ 360 BCS_BrkTqCtrlAvlParkingRdn 0;
BA_ "GenSigSendType" SG_ 360 BCS_BrkTqCtrlAvlParkingRdn 1;
BA_ "GenSigStartValue" SG_ 360 BCS_BrkTqCtrlAvlParkingRdn 0;
BA_ "GenSigTimeoutValue" SG_ 360 BCS_BrkTqCtrlAvlParkingRdn 0;
BA_ "Remark" SG_ 360 BCS_BrkTqCtrlAvlParkingRdn "";
BA_ "EventCommandSignal" SG_ 360 BCS_WheelSlipFL 0;
BA_ "GatewayedSignals" SG_ 360 BCS_WheelSlipFL 0;
BA_ "GenSigInactiveValue" SG_ 360 BCS_WheelSlipFL 0;
BA_ "GenSigInvalidValue" SG_ 360 BCS_WheelSlipFL 0;
BA_ "GenSigSendType" SG_ 360 BCS_WheelSlipFL 1;
BA_ "GenSigStartValue" SG_ 360 BCS_WheelSlipFL 0;
BA_ "GenSigTimeoutValue" SG_ 360 BCS_WheelSlipFL 0;
BA_ "Remark" SG_ 360 BCS_WheelSlipFL "";
BA_ "EventCommandSignal" SG_ 360 BCS_WheelSlipFR 0;
BA_ "GatewayedSignals" SG_ 360 BCS_WheelSlipFR 0;
BA_ "GenSigInactiveValue" SG_ 360 BCS_WheelSlipFR 0;
BA_ "GenSigInvalidValue" SG_ 360 BCS_WheelSlipFR 0;
BA_ "GenSigSendType" SG_ 360 BCS_WheelSlipFR 1;
BA_ "GenSigStartValue" SG_ 360 BCS_WheelSlipFR 0;
BA_ "GenSigTimeoutValue" SG_ 360 BCS_WheelSlipFR 0;
BA_ "Remark" SG_ 360 BCS_WheelSlipFR "";
BA_ "EventCommandSignal" SG_ 360 BCS_WheelSlipRL 0;
BA_ "GatewayedSignals" SG_ 360 BCS_WheelSlipRL 0;
BA_ "GenSigInactiveValue" SG_ 360 BCS_WheelSlipRL 0;
BA_ "GenSigInvalidValue" SG_ 360 BCS_WheelSlipRL 0;
BA_ "GenSigSendType" SG_ 360 BCS_WheelSlipRL 1;
BA_ "GenSigStartValue" SG_ 360 BCS_WheelSlipRL 0;
BA_ "GenSigTimeoutValue" SG_ 360 BCS_WheelSlipRL 0;
BA_ "Remark" SG_ 360 BCS_WheelSlipRL "";
BA_ "EventCommandSignal" SG_ 360 BCS_WheelSlipRR 0;
BA_ "GatewayedSignals" SG_ 360 BCS_WheelSlipRR 0;
BA_ "GenSigInactiveValue" SG_ 360 BCS_WheelSlipRR 0;
BA_ "GenSigInvalidValue" SG_ 360 BCS_WheelSlipRR 0;
BA_ "GenSigSendType" SG_ 360 BCS_WheelSlipRR 1;
BA_ "GenSigStartValue" SG_ 360 BCS_WheelSlipRR 0;
BA_ "GenSigTimeoutValue" SG_ 360 BCS_WheelSlipRR 0;
BA_ "Remark" SG_ 360 BCS_WheelSlipRR "";
BA_ "EventCommandSignal" SG_ 360 BCS_ICCSt 0;
BA_ "GatewayedSignals" SG_ 360 BCS_ICCSt 0;
BA_ "GenSigInactiveValue" SG_ 360 BCS_ICCSt 0;
BA_ "GenSigInvalidValue" SG_ 360 BCS_ICCSt 0;
BA_ "GenSigSendType" SG_ 360 BCS_ICCSt 1;
BA_ "GenSigStartValue" SG_ 360 BCS_ICCSt 0;
BA_ "GenSigTimeoutValue" SG_ 360 BCS_ICCSt 0;
BA_ "Remark" SG_ 360 BCS_ICCSt "";
BA_ "EventCommandSignal" SG_ 360 BCS_ICCAvl 0;
BA_ "GatewayedSignals" SG_ 360 BCS_ICCAvl 0;
BA_ "GenSigInactiveValue" SG_ 360 BCS_ICCAvl 0;
BA_ "GenSigInvalidValue" SG_ 360 BCS_ICCAvl 0;
BA_ "GenSigSendType" SG_ 360 BCS_ICCAvl 1;
BA_ "GenSigStartValue" SG_ 360 BCS_ICCAvl 0;
BA_ "GenSigTimeoutValue" SG_ 360 BCS_ICCAvl 0;
BA_ "Remark" SG_ 360 BCS_ICCAvl "";
BA_ "EventCommandSignal" SG_ 360 BCS_ICCErrFb 0;
BA_ "GatewayedSignals" SG_ 360 BCS_ICCErrFb 0;
BA_ "GenSigInactiveValue" SG_ 360 BCS_ICCErrFb 0;
BA_ "GenSigInvalidValue" SG_ 360 BCS_ICCErrFb 0;
BA_ "GenSigSendType" SG_ 360 BCS_ICCErrFb 1;
BA_ "GenSigStartValue" SG_ 360 BCS_ICCErrFb 0;
BA_ "GenSigTimeoutValue" SG_ 360 BCS_ICCErrFb 0;
BA_ "Remark" SG_ 360 BCS_ICCErrFb "";
BA_ "EventCommandSignal" SG_ 360 BCS_SimulatorPressureSt_1 0;
BA_ "GatewayedSignals" SG_ 360 BCS_SimulatorPressureSt_1 0;
BA_ "GenSigInactiveValue" SG_ 360 BCS_SimulatorPressureSt_1 0;
BA_ "GenSigInvalidValue" SG_ 360 BCS_SimulatorPressureSt_1 0;
BA_ "GenSigSendType" SG_ 360 BCS_SimulatorPressureSt_1 1;
BA_ "GenSigStartValue" SG_ 360 BCS_SimulatorPressureSt_1 0;
BA_ "GenSigTimeoutValue" SG_ 360 BCS_SimulatorPressureSt_1 0;
BA_ "Remark" SG_ 360 BCS_SimulatorPressureSt_1 "";
BA_ "EventCommandSignal" SG_ 360 BCS_SysSt_1 0;
BA_ "GatewayedSignals" SG_ 360 BCS_SysSt_1 0;
BA_ "GenSigInactiveValue" SG_ 360 BCS_SysSt_1 0;
BA_ "GenSigInvalidValue" SG_ 360 BCS_SysSt_1 0;
BA_ "GenSigSendType" SG_ 360 BCS_SysSt_1 1;
BA_ "GenSigStartValue" SG_ 360 BCS_SysSt_1 0;
BA_ "GenSigTimeoutValue" SG_ 360 BCS_SysSt_1 0;
BA_ "Remark" SG_ 360 BCS_SysSt_1 "";
BA_ "EventCommandSignal" SG_ 360 BCS_FWAWarning_1 0;
BA_ "GatewayedSignals" SG_ 360 BCS_FWAWarning_1 0;
BA_ "GenSigInactiveValue" SG_ 360 BCS_FWAWarning_1 0;
BA_ "GenSigInvalidValue" SG_ 360 BCS_FWAWarning_1 0;
BA_ "GenSigSendType" SG_ 360 BCS_FWAWarning_1 1;
BA_ "GenSigStartValue" SG_ 360 BCS_FWAWarning_1 0;
BA_ "GenSigTimeoutValue" SG_ 360 BCS_FWAWarning_1 0;
BA_ "Remark" SG_ 360 BCS_FWAWarning_1 "";
BA_ "EventCommandSignal" SG_ 360 BCS_CSTSt_1 0;
BA_ "GatewayedSignals" SG_ 360 BCS_CSTSt_1 0;
BA_ "GenSigInactiveValue" SG_ 360 BCS_CSTSt_1 0;
BA_ "GenSigInvalidValue" SG_ 360 BCS_CSTSt_1 0;
BA_ "GenSigSendType" SG_ 360 BCS_CSTSt_1 1;
BA_ "GenSigStartValue" SG_ 360 BCS_CSTSt_1 0;
BA_ "GenSigTimeoutValue" SG_ 360 BCS_CSTSt_1 0;
BA_ "Remark" SG_ 360 BCS_CSTSt_1 "";
BA_ "EventCommandSignal" SG_ 360 BCS_AVDCActive_1 0;
BA_ "GatewayedSignals" SG_ 360 BCS_AVDCActive_1 0;
BA_ "GenSigInactiveValue" SG_ 360 BCS_AVDCActive_1 0;
BA_ "GenSigInvalidValue" SG_ 360 BCS_AVDCActive_1 0;
BA_ "GenSigSendType" SG_ 360 BCS_AVDCActive_1 1;
BA_ "GenSigStartValue" SG_ 360 BCS_AVDCActive_1 0;
BA_ "GenSigTimeoutValue" SG_ 360 BCS_AVDCActive_1 0;
BA_ "Remark" SG_ 360 BCS_AVDCActive_1 "";
BA_ "EventCommandSignal" SG_ 360 BCS_AVDCAvailable_1 0;
BA_ "GatewayedSignals" SG_ 360 BCS_AVDCAvailable_1 0;
BA_ "GenSigInactiveValue" SG_ 360 BCS_AVDCAvailable_1 0;
BA_ "GenSigInvalidValue" SG_ 360 BCS_AVDCAvailable_1 0;
BA_ "GenSigSendType" SG_ 360 BCS_AVDCAvailable_1 1;
BA_ "GenSigStartValue" SG_ 360 BCS_AVDCAvailable_1 0;
BA_ "GenSigTimeoutValue" SG_ 360 BCS_AVDCAvailable_1 0;
BA_ "Remark" SG_ 360 BCS_AVDCAvailable_1 "";
BA_ "EventCommandSignal" SG_ 360 BCS_SimulatorPressure_1 0;
BA_ "GatewayedSignals" SG_ 360 BCS_SimulatorPressure_1 0;
BA_ "GenSigInactiveValue" SG_ 360 BCS_SimulatorPressure_1 0;
BA_ "GenSigInvalidValue" SG_ 360 BCS_SimulatorPressure_1 0;
BA_ "GenSigSendType" SG_ 360 BCS_SimulatorPressure_1 1;
BA_ "GenSigStartValue" SG_ 360 BCS_SimulatorPressure_1 17;
BA_ "GenSigTimeoutValue" SG_ 360 BCS_SimulatorPressure_1 0;
BA_ "Remark" SG_ 360 BCS_SimulatorPressure_1 "";

VAL_ 352 BCS_VehSpdVD 0 "Not Valid" 1 "Valid"  ;
VAL_ 352 BCS_EBDActiveSt 0 "Not active" 1 "Active"  ;
VAL_ 352 BCS_EBDFaultSt 0 "Not fault" 1 "Fault"  ;
VAL_ 352 BCS_ABSActiveSt 0 "Not active" 1 "Active"  ;
VAL_ 352 BCS_ABSFaultSt 0 "Not fault" 1 "Fault"  ;
VAL_ 352 BCS_TCSActiveSt 0 "Not active" 1 "Active"  ;
VAL_ 352 BCS_TCSFaultSt 0 "Not fault" 1 "Fault"  ;
VAL_ 352 BCS_VDCActiveSt 0 "Not active" 1 "Active"  ;
VAL_ 352 BCS_VDCFaultSt 0 "Not fault" 1 "Fault"  ;
VAL_ 352 BCS_PreAndRealVDCActiveSt 0 "Not active" 1 "Active"  ;
VAL_ 352 BCS_DTCAvailable 0 "Not available" 1 "Available"  ;
VAL_ 352 BCS_DTCActiveSt 0 "Not Active" 1 "Active"  ;
VAL_ 352 BCS_RealTCSActiveSt 0 "Not active" 1 "Active"  ;
VAL_ 352 BCS_CrbsActive 0 "Not Active" 1 "Active"  ;
VAL_ 352 BCS_BrkPedalStVD 0 "Invalid" 1 "Valid"  ;
VAL_ 352 BCS_TargetRecpTorqRqFASt 0 "NotIntialized" 1 "Normal" 2 "Faulty" 3 "Reserved"  ;
VAL_ 352 BCS_TargetRecpTorqRqRASt 0 "NotIntialized" 1 "Normal" 2 "Faulty" 3 "Reserved"  ;
VAL_ 352 BCS_EngTorqDecActiveStRA 0 "Not active" 1 "Active"  ;
VAL_ 352 BCS_EngTorqIncActiveStRA 0 "Not active" 1 "Active"  ;
VAL_ 352 BCS_BrkPedalSt 0 "Not_Pressed/Init/Default" 1 "Pressed" 2 "Reserved" 3 "Error"  ;
VAL_ 352 BCS_EngTorqDecActiveStFA 0 "Not active" 1 "Active"  ;
VAL_ 352 BCS_EngTorqIncActiveStFA 0 "Not active" 1 "Active"  ;
VAL_ 352 BCS_ADCNetErrorFb 0 "No Error" 1 "Main Net E2E Error" 2 "Sub Net E2E Error" 3 "Both Net E2E Error" 4 "Reserved" 5 "Reserved" 6 "Reserved" 7 "Reserved"  ;
VAL_ 352 BCS_NetModeResp 0 "None" 1 "Main/sub Net active" 2 "Main/sub Net active with error" 3 "Reserved"  ;
VAL_ 352 BCS_FLWheelSpdVD_B 0 "Not valid" 1 "Valid"  ;
VAL_ 352 BCS_FLWheelRotatedDirectionVD_B 0 "Not valid" 1 "Valid"  ;
VAL_ 352 BCS_FRWheelSpdVD_B 0 "Not valid" 1 "Valid"  ;
VAL_ 352 BCS_FRWheelRotatedDirectionVD_B 0 "Not valid" 1 "Valid"  ;
VAL_ 352 BCS_RLWheelSpdVD_B 0 "Not valid" 1 "Valid"  ;
VAL_ 352 BCS_RLWheelRotatedDirectionVD_B 0 "Not valid" 1 "Valid"  ;
VAL_ 352 BCS_RRWheelSpdVD_B 0 "Not valid" 1 "Valid"  ;
VAL_ 352 BCS_RRWheelRotatedDirectionVD_B 0 "Not valid" 1 "Valid"  ;
VAL_ 352 BCS_HHCCtrlSt_B 0 "Not active" 1 "Active"  ;
VAL_ 352 BCS_HDCErrSt_B 0 "No error" 1 "Error"  ;
VAL_ 352 BCS_RLWheelSpdEdgesSumVD_B 0 "Not valid" 1 "Valid"  ;
VAL_ 352 BCS_RRWheelSpdEdgesSumVD_B 0 "Not valid" 1 "Valid"  ;
VAL_ 352 BCS_VDCOff_B 0 "On" 1 "Off"  ;
VAL_ 352 BCS_AVHSt_B 0 "Not active" 1 "Active"  ;
VAL_ 352 BCS_AVHStandby_B 0 "Not standby" 1 "Standby"  ;
VAL_ 352 BCS_AVHAvailable_B 0 "Not available" 1 "Available"  ;
VAL_ 352 BCS_TCSOff_B 0 "On" 1 "Off"  ;
VAL_ 352 BCS_BrakeOverHeat_B 0 "Not high" 1 "Temp too high"  ;
VAL_ 352 BCS_FRWheelSpdEdgesSumVD_B 0 "Not valid" 1 "Valid"  ;
VAL_ 352 BCS_FLWheelSpdEdgesSumVD_B 0 "Not valid" 1 "Valid"  ;
VAL_ 352 BCS_ABAactive_B 0 "Not active" 1 "Active"  ;
VAL_ 352 BCS_ABAavailable_B 0 "Not available" 1 "Available"  ;
VAL_ 352 BCS_ABPActive_B 0 "Not active" 1 "Active"  ;
VAL_ 352 BCS_ABPAvailable_B 0 "Not available" 1 "Available"  ;
VAL_ 352 BCS_AEBActive_B 0 "Not active" 1 "Active"  ;
VAL_ 352 BCS_AEBAvailable_B 0 "Not available" 1 "Available"  ;
VAL_ 352 BCS_AWBActive_B 0 "Not active" 1 "Active"  ;
VAL_ 352 BCS_AWBAvailable_B 0 "Not available" 1 "Available"  ;
VAL_ 352 BCS_HDCCtrlSt_B 0 "Off" 1 "On active braking" 2 "On not active braking" 3 "Not used"  ;
VAL_ 352 BCS_FLWheelRotatedDirection_B 0 "Standstill" 1 "Forward" 2 "Backward" 3 "Unknown"  ;
VAL_ 352 BCS_InputRodStrokeSt_B 0 "Valid/Init" 1 "Invalid/Default"  ;
VAL_ 352 BCS_BrkTqCtrlActvRdn_B 0 "BrakeMain_None" 1 "BrakeMain_APAactive" 2 "BrakeMain_ACCactive" 3 "Reserved"  ;
VAL_ 352 BCS_FRWheelRotatedDirection_B 0 "Standstill" 1 "Forward" 2 "Backward" 3 "Unknown"  ;
VAL_ 352 BCS_RLWheelRotatedDirection_B 0 "Standstill" 1 "Forward" 2 "Backward" 3 "Unknown"  ;
VAL_ 352 BCS_PlungerPressureSt_B 0 "Valid/Init" 1 "Invalid/Default"  ;
VAL_ 352 BCS_RRWheelRotatedDirection_B 0 "Standstill" 1 "Forward" 2 "Backward" 3 "Unknown"  ;
VAL_ 352 BCS_ParkingReqToEPB_B 0 "No request" 1 "Release brake request" 2 "Lock brake request" 3 "Not used"  ;
VAL_ 352 BCS_VehicleStandStillSt_B 0 "Not standstill" 1 "standstill" 2 "Invalid (short unavailability, max 3s)" 3 "Not used"  ;
VAL_ 352 BCS_L3ComVD_B 0 "Invalid" 1 "Valid"  ;
VAL_ 352 BCS_BrkTqCtrlAvlDrivingRdn_B 0 "BrakeBackupStrategyAvailability_None" 1 "BrakeBackupStrategyAvailability_Full" 2 "BrakeBackupStrategyAvailability_Fault" 3 "BrakeBackupStrategyAvailability_TestPending" 4 "BrakeBackupStrategyAvailability_NotInitialized" 5 "Reserved" 6 "Reserved" 7 "Reserved"  ;
VAL_ 352 BCS_LFIActiveSt_B 0 "Not Active" 1 "Active"  ;
VAL_ 363 EPS_StrngWhlTorqVD 0 "Not valid" 1 "Valid"  ;
VAL_ 363 TAS_CalibratedSt 0 "Not calibrated" 1 "Calibrated"  ;
VAL_ 363 EPS_SteeringAngleSpdVD 0 "Not valid" 1 "Valid"  ;
VAL_ 363 EPS_SteeringAngleVD 0 "Not valid" 1 "Valid"  ;
VAL_ 363 EPS_VMCErrFeedback 0 "No interruption" 1 "LKA Interruption" 2 "APA Interruption" 3 "Vehicle Speed Invalid" 4 "VMC Activation request error" 5 "VMC ECU Signal error" 6 "EPS Temp error" 7 "Request Torque Slope over limit" 8 "Request Torque Value over limit" 9 "Failed Temp Time Over Limit" 10 "EPS Permanently error" 11 "VMC Triggered safety monitor module" 12 "Drive Override" 13 "Reserved" 14 "Reserved" 15 "Reserved"  ;
VAL_ 363 EPS_PstOverlaySt 0 "Not Ready;" 1 "Ready;" 2 "100% Active;" 3 "50% Active;" 4 "Failed;" 5 "Reserved" 6 "Reserved" 7 "Reserved"  ;
VAL_ 363 EPS_HealthySt_DualSide 0 "Healthy;" 1 "Slightly failure;" 2 "Abnormal;" 3 "Shut off;"  ;
VAL_ 363 EPS_VibrationWarnSt_A 0 "Not Acitve" 1 "Active level 1" 2 "Active level 2" 3 "Active level 3"  ;
VAL_ 363 SAC_ErrFeedback_SideA 0 "No  interruption；" 1 "ADAS TqRateReq Over rangenge" 2 "Driver Override" 3 "Vehicle Speed Invalid" 4 "Activation Requestrian Error" 5 "ADC Channel A signal Error" 6 "EPS Error" 7 "IFC Signal Error" 8 "ADAS AngleReq Over range" 9 "ADAS AngleSpdReq Over range" 10 "ADAS TqReq Over range" 11 "Both ADAS Channel Error" 12 "ADC Channel B signal Error；" 13 "Reserved；" 14 "Reserved；" 15 "Reserved；"  ;
VAL_ 363 EPS_FunctionStyleSt 0 "Unknow" 1 "light" 2 "Comfort" 3 "Sport"  ;
VAL_ 363 EPS_SteeringModeSt 0 "Not ready" 1 "Ready" 2 "In transition" 3 "Fault"  ;
VAL_ 363 EPS_ReqAngOverRange 0 "Not Over Range；" 1 "Over range"  ;
VAL_ 363 EPS_ReqAngSpdOverRange 0 "Not Over Range；" 1 "Over range"  ;
VAL_ 363 EPS_AssistPraSwitchToLKA 0 "Not in LAK mode；" 1 "In LKA Mode；"  ;
VAL_ 363 EPS_SteerGainEnable 0 "Disable；" 1 "Enable；"  ;
VAL_ 363 EPS_EmSteerEnbale 0 "Disable；" 1 "Enable；"  ;
VAL_ 363 EPS_EM_ErrFeedback 0 "No interruption" 1 "Reserved" 2 "Reserved" 3 "Reserved" 4 "Reserved" 5 "ADAS Signal err" 6 "EPS error" 7 "Duration time over"  ;
VAL_ 363 EPS_VW_ErrFeedback 0 "No interruption" 1 "Reserved" 2 "Reserved" 3 "Reserved" 4 "Invalid request" 5 "ADC Signal err" 6 "EPS error"  ;
VAL_ 363 EPS_SG_ErrFeedback 0 "No  interruption；" 1 "Premise fun abort" 2 "Invalid request" 3 "Reserved" 4 "Reserved" 5 "Reserved" 6 "Reserved" 7 "Reserved" 8 "Reserved" 9 "Reserved" 10 "Reserved" 11 "Reserved" 12 "Reserved" 13 "Reserved" 14 "Reserved" 15 "Reserved"  ;
VAL_ 363 EPS_WarnLamp 0 "No Fault" 1 "Slight Fault" 2 "Urgency Fault" 3 "Severity Urgency Fault"  ;
VAL_ 363 EPS_SteeringWhlTorFltVD 0 "No Valid" 1 "Valid with fault detected" 2 "Valid and healthy" 3 "Unkown"  ;
VAL_ 363 EPS_TqCtrlSt 0 "No active" 1 "Ready" 2 "Active" 3 "Failed"  ;
VAL_ 363 EPS_TqCtrlAvl 0 "Not available" 1 "Available" 2 "Available degraded" 3 "Reseved"  ;
VAL_ 363 EPS_AgCtrlAvl 0 "Not available" 1 "Available" 2 "Available degraded" 3 "Reseved"  ;
VAL_ 363 EPS_MotorTorSumVD 0 "Invalid" 1 "Valid"  ;
VAL_ 363 EPS_DrvOveRideSt 0 "Not override" 1 "Override"  ;
VAL_ 363 EPS_DrvOveRideVD 0 "Invalid" 1 "Valid"  ;
VAL_ 363 EPS_SteerVibrlAvl 0 "Not available" 1 "Available"  ;
VAL_ 363 EPS_HandsOffDetStVD 0 "Invalid" 1 "Valid"  ;
VAL_ 363 EPS_HandsOffDetSt 0 "Not detected" 1 "Hands off" 2 "Hands on" 3 "Reserved"  ;
VAL_ 363 EPS_SteerMod 0 "Initial" 1 "Power steer" 2 "Angle control(Normal）" 3 "Angle control(Emergency)" 4 "Torque control(Normal）" 5 "Torque control(Emergency)" 6 "Failure" 7 "Reserved"  ;
VAL_ 363 EPS_ADCNetErrorFb 0 "No Error" 1 "Main Net E2E Error" 2 "Sub Net E2E Error" 3 "Both Net E2E Error" 4 "Reserved" 5 "Reserved" 6 "Reserved" 7 "Reserved"  ;
VAL_ 363 EPS_NetModeResp 0 "None" 1 "Main/sub Net active" 2 "Main/sub Net active with error" 3 "Reserved"  ;
VAL_ 360 BCS_BrkTqCtrlAvlDriving 0 "Not available" 1 "Available" 2 "Available degraded1（Redundant Project）" 3 "Available degraded2 （Redundant Project）" 4 "Reserved" 5 "Reserved" 6 "Reserved" 7 "Reserved"  ;
VAL_ 360 BCS_BrkTqCtrlAvlParking 0 "Not available" 1 "available" 2 "parking overspeed--for BOSCH ADAS" 3 "Reserved"  ;
VAL_ 360 BCS_BrkTqCtrlActv 0 "NotActive" 1 "APA Active" 2 "ACC Active" 3 "BCS Active"  ;
VAL_ 360 BCS_ChVehSpdVD 0 "Invalid" 1 "Valid"  ;
VAL_ 360 BCS_ESCFailSt 0 "No error" 1 "Error"  ;
VAL_ 360 BCS_ESCFuncActiveSt 0 "Not active" 1 "Active"  ;
VAL_ 360 BCS_DycEscTarTqCtrlAvl 0 "Not available" 1 "Available"  ;
VAL_ 360 BCS_errorFb 0 "No error" 1 "Invalid Request of ADAS" 2 "Fault related to wheelspd" 2 "Fault related to steeringangel" 3 "Fault related to powertrain" 4 "Fault related to EPB" 7 "ADAS E2E fault or timeoutt"  ;
VAL_ 360 BCS_DrvrBrkOvrd 0 "Not override" 1 "Override"  ;
VAL_ 360 BCS_DrvrBrkOvrdVD 0 "Invalid" 1 "Valid"  ;
VAL_ 360 BCS_DycEscTarTqActv 0 "NotActive" 1 "Active"  ;
VAL_ 360 BCS_WheelSlipFLVD 0 "Invalid" 1 "Valid"  ;
VAL_ 360 BCS_WheelSlipFRVD 0 "Invalid" 1 "Valid"  ;
VAL_ 360 BCS_WheelSlipRLVD 0 "Invalid" 1 "Valid"  ;
VAL_ 360 BCS_WheelSlipRRVD 0 "Invalid" 1 "Valid"  ;
VAL_ 360 BCS_BrkTarRecpTorqFASt 0 "NotIntialized" 1 "Normal（valid）" 2 "Faulty（invalid）" 3 "Reserved"  ;
VAL_ 360 BCS_BrkTarRecpTorqRASt 0 "NotIntialized" 1 "Normal（valid）" 2 "Faulty（invalid）" 3 "Reserved"  ;
VAL_ 360 BCS_BrkTarRecpTorqSt 0 "NotIntialized" 1 "Normal（valid）" 2 "Faulty（invalid）" 3 "Reserved"  ;
VAL_ 360 BCS_EngTorqDecActiveStRL 0 "Not active" 1 "Active"  ;
VAL_ 360 BCS_EngTorqDecActiveStRR 0 "Not active" 1 "Active"  ;
VAL_ 360 BCS_BrkTqCtrlAvlParkingRdn 0 "BrakeBackupStrategyAvailability_None" 1 "BrakeBackupStrategyAvailability_Full" 2 "BrakeBackupStrategyAvailability_Fault" 3 "BrakeBackupStrategyAvailability_TestPending" 4 "BrakeBackupStrategyAvailability_NotInitialized" 5 "Parking_Overspeed" 6 "Reserved" 7 "Reserved"  ;
VAL_ 360 BCS_ICCSt 0 "Not Active" 1 "Active"  ;
VAL_ 360 BCS_ICCAvl 0 "Not Available" 1 "Available"  ;
VAL_ 360 BCS_ICCErrFb 0 "Normal；" 1 "internal function active；" 2 "ICC abnormal；" 3 "BCS internal falut" 4 "execute higher-priority function；"  ;
VAL_ 360 BCS_SimulatorPressureSt_1 0 "Valid/Init" 1 "Invalid/Default"  ;
VAL_ 360 BCS_SysSt_1 0 "BBF_FullSys/Init/Default" 1 "BBF_DegradedPedalFeel" 2 "BBF_CircuitSperation" 3 "BBF_C1/2BoostOnly" 4 "HydBack w/ act / HydBack w/o act"  ;
VAL_ 360 BCS_FWAWarning_1 0 "no failure/Init/Default" 1 "Warnig level 1 for high Temp. of Brake system" 2 "Warnig level 2 for high Temp. of Brake system" 3 "reserved"  ;
VAL_ 360 BCS_CSTSt_1 0 "CST is disabled/Init/Default" 1 "CST is Standby" 2 "CST is Active" 3 "CST is Failure"  ;
VAL_ 360 BCS_AVDCActive_1 0 "Not active" 1 "Active"  ;
VAL_ 360 BCS_AVDCAvailable_1 0 "Not active" 1 "Active"  ;
