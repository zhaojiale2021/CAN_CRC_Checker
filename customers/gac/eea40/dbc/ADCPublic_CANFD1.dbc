VERSION "Version"

NS_ :

BS_:

BU_: Tester CCU ADC CCU_CCURT1 CCU_CCURT2 RLR RRR ZCUF ZCUL ZCUR ZCUT EMS IDM DCDC IPS NIDU NIDUF DCUR OBC OPC LPC CPC EMCM GCU DCUF IPU BMS EOPF EOPR EVCC DCDC2 EDL SRS ECS EPS EPB RBM IBCS ICM IID IDC PHUDD AMP WHUD IMR INU IFC FAPA PAS PCS SCMR SCMRL SCMRR HVSMR SCMRM MFS WSM DRM IDU FCP LBMSAD AVAS ATSS DLPFL FBLCM FLISD FLLCM FRLCM RLLCMA RLLCMB RRLCMA RRLCMB RLISD DLPML DLPMR TRM PSDL PSDR HVSPRL HVSPRR RFR SBM WCM ETC TBOX2 TBOX IDUR CBM PLGM TMC LPC2 SCMT RCP RRISD LBMS RLBMS CCURT1 CCURT2 RT1_C1 RT2_C3 RT1_C0 OTAWL RAS EBB RCICP WCMFR WCMRL SAS CD

BO_ 387 ADC_4_New: 64 ADC
 SG_ ADC_4_New_CRC : 7|16@0+ (1,0) [0|65535] ""  CCU,CCURT1,CCURT2,RT1_C1,RT2_C3
 SG_ ADC_4_New_Counter : 23|8@0+ (1,0) [0|255] ""  CCU,CCURT1,CCURT2,RT1_C1,RT2_C3
 SG_ ADC_AngReqSt_A : 31|2@0+ (1,0) [0|3] ""  CCU,CCURT1,RT1_C1
 SG_ ADC_AngReqFunction : 29|2@0+ (1,0) [0|3] ""  CCU,CCURT1,RT1_C1
 SG_ ADC_BrakeLightReq : 27|2@0+ (1,0) [0|3] ""  CCU,CCURT2,RT2_C3
 SG_ ADC_StrAngleReq_A : 39|16@0+ (0.1,-780) [-780|780] "deg"  CCU
 SG_ ADC_SACMotorTorLimExtMax_A : 55|8@0+ (0.02,0) [0|5.08] "Nm"  CCU
 SG_ ADC_SACMotorTorLimExtMin_A : 63|8@0+ (0.02,-5.08) [-5.08|0] "Nm"  CCU
 SG_ ADC_AssistParaSwitchReq : 71|1@0+ (1,0) [0|1] ""  CCU
 SG_ ADC_SteerGainReq : 69|1@0+ (1,0) [0|1] ""  CCU
 SG_ ADC_StrgWhlVibrWarnLevel : 68|2@0+ (1,0) [0|3] ""  CCU
 SG_ ADC_ActTrqReqEnable : 66|1@0+ (1,0) [0|1] ""  CCU,CCURT1,RT1_C1
 SG_ ADC_SteerGainLevel : 79|8@0+ (1,0) [0|254] "%"  CCU
 SG_ ADC_EvsSteerReq : 87|1@0+ (1,0) [0|1] ""  CCU
 SG_ ADC_StrgWhlVibrWarnReq : 86|1@0+ (1,0) [0|1] ""  CCU
 SG_ ADC_ActTrqReq : 85|14@0+ (1,-5000) [-5000|5000] "Nm"  CCU,CCURT1,RT1_C1
 SG_ ADC_DrvTarTqMod2EPB : 124|2@0+ (1,0) [0|3] ""  CCU
 SG_ ADC_LongCtrlTypReq : 143|1@0+ (1,0) [0|1] ""  CCU,CCURT1,RT1_C1
 SG_ ADC_TotalRefTorque_A : 247|16@0+ (1,-32768) [-32768|32767] "Nm"  CCU,CCURT1,RT1_C1
 SG_ ADC_AEBFaultSt : 263|1@0+ (1,0) [0|1] ""  CCU,CCURT1,RT1_C1
 SG_ ADC_AEBOffSt : 262|1@0+ (1,0) [0|1] ""  CCU,CCURT1,RT1_C1
 SG_ ADC_AEBInterventionSt : 261|1@0+ (1,0) [0|1] ""  CCU
 SG_ ADC_AEBDecelCtrlReq : 260|1@0+ (1,0) [0|1] ""  CCU,CCURT1,RT1_C1
 SG_ ADC_AEBLVehHoldReq : 259|1@0+ (1,0) [0|1] ""  CCU,CCURT1,RT1_C1
 SG_ ADC_ABAReq : 258|1@0+ (1,0) [0|1] ""  CCU
 SG_ ADC_ABALevel : 257|2@0+ (1,0) [0|3] ""  CCU
 SG_ ADC_AWBReq : 271|1@0+ (1,0) [0|1] ""  CCU
 SG_ ADC_ABPReq : 270|1@0+ (1,0) [0|1] ""  CCU
 SG_ ADC_AWBLevel : 269|3@0+ (1,0) [0|7] ""  CCU
 SG_ ADC_AEBTarCalss : 266|3@0+ (1,0) [0|7] ""  CCU,CCURT1,RT1_C1
 SG_ ADC_AEBTarDetSensor : 277|2@0+ (1,0) [0|3] ""  CCU,CCURT1,RT1_C1
 SG_ ADC_TurnLightReq : 275|3@0+ (1,0) [0|7] ""  CCU,CCURT2,RT2_C3
 SG_ ADC_PAA2EPBEpbReq : 281|2@0+ (1,0) [0|2] ""  CCU,CCURT1,RT1_C1
 SG_ ADC_PAA2EPBEpbReqSt : 294|1@0+ (1,0) [0|1] ""  CCU,CCURT1,RT1_C1
 SG_ ADC_AEBObjectTTC : 288|9@0+ (0.01,0) [0|5] "s"  CCU,CCURT1,RT1_C1
 SG_ ADC_AEBObjRelativeSpd : 304|9@0+ (0.1,0) [0|50] "m/s"  CCU,CCURT1,RT1_C1
 SG_ ADC_PAAPwrModeReq : 405|1@0+ (1,0) [0|1] ""  CCU,CCURT1,RT1_C1
 SG_ ADC_PAAGrarLvlReq : 404|3@0+ (1,0) [0|7] ""  CCU,CCURT1,RT1_C1
 SG_ ADC_PAAGrarLvlReqEnable : 401|1@0+ (1,0) [0|1] ""  CCU,CCURT1,RT1_C1
 SG_ ADC_ACCMode_C : 415|4@0+ (1,0) [0|15] ""  CCU,CCURT1,RT1_C1
 SG_ ADC_ActTrqReqVD : 341|1@0+ (1,0) [0|1] ""  CCU,CCURT1,RT1_C1
 SG_ ADC_BrkTarTqEna : 125|1@0+ (1,0) [0|1] ""  CCU,CCURT1,RT1_C1
 SG_ ADC_BrkTarTqMod : 25|2@0+ (1,0) [0|3] ""  CCU,CCURT1,RT1_C1
 SG_ ADC_AebBrkTarTq : 111|16@0+ (1,0) [0|65535] "Nm"  CCU,CCURT1,RT1_C1
 SG_ ADC_EpbModReqVld : 126|1@0+ (1,0) [0|1] ""  CCU,CCURT1,RT1_C1
 SG_ ADC_RWUEna : 127|1@0+ (1,0) [0|1] ""  CCU,CCURT1,RT1_C1
 SG_ ADC_BrkHoldReq : 279|2@0+ (1,0) [0|3] ""  CCU,CCURT1,RT1_C1
 SG_ ADC_AngReqAvl : 340|1@0+ (1,0) [0|1] ""  CCU,CCURT1,RT1_C1
 SG_ ADC_TarGearReqVld : 342|1@0+ (1,0) [0|1] ""  CCU,CCURT1,RT1_C1
 SG_ ADC_FctSts : 343|1@0+ (1,0) [0|1] ""  CCU,CCURT1,RT1_C1
 SG_ ADC_BrkTarTqVld : 328|1@0+ (1,0) [0|1] ""  CCU,CCURT1,RT1_C1
 SG_ ADC_AebBrkTarTqVld : 305|1@0+ (1,0) [0|1] ""  CCU,CCURT1,RT1_C1
 SG_ ADC_AebBrkTarTqEna : 306|1@0+ (1,0) [0|1] ""  CCU,CCURT1,RT1_C1
 SG_ ADC_ElecBrkFnSwitch : 307|1@0+ (1,0) [0|1] ""  CCU,CCURT1,RT1_C1
 SG_ ADC_RWUVld : 400|1@0+ (1,0) [0|1] ""  CCU,CCURT1,RT1_C1
 SG_ ADC_DriverPresent : 309|2@0+ (1,0) [0|3] ""  CCU,CCURT1,RT1_C1
 SG_ ADC_AD_NetMode : 65|2@0+ (1,0) [0|3] "/"  CCU,CCURT1,CCURT2,RT1_C1,RT2_C3
 SG_ ADC_ChrgPwrMode : 70|1@0+ (1,0) [0|1] ""  CCU,CCURT1,RT1_C1
 SG_ ADC_LimTqEnable_A : 120|1@0+ (1,0) [0|1] ""  CCU,CCURT1,RT1_C1
 SG_ ADC_LimTqFactorK_A : 137|10@0+ (0.001,0) [0|1] ""  CCU,CCURT1,RT1_C1
 SG_ ADC_RapidRespEna_A : 135|1@0+ (1,0) [0|1] ""  CCU,CCURT1,RT1_C1
 SG_ ADC_DrvTarTqMod_A : 134|2@0+ (1,0) [0|3] ""  CCU,CCURT1,RT1_C1
 SG_ ADC_FcsActiveStatus : 122|1@0+ (1,0) [0|1] ""  CCU,CCURT1,RT1_C1
 SG_ ADC_DycEscTarTq_A : 159|16@0+ (1,-32768) [-32768|32767] "Nm"  CCU,CCURT1,RT1_C1
 SG_ ADC_DycEscTarTqfactor_A : 103|8@0+ (0.01,0) [0|1] ""  CCU,CCURT1,RT1_C1
 SG_ ADC_DycEscTarTqVld_A : 132|1@0+ (1,0) [0|1] ""  CCU,CCURT1,RT1_C1
 SG_ ADC_DycEscTarTqEna_A : 131|1@0+ (1,0) [0|1] ""  CCU,CCURT1,RT1_C1
 SG_ ADC_RedundantSwt : 121|1@0+ (1,0) [0|1] ""  CCU,CCURT1,RT1_C1
 SG_ ADC_ImmediateStopEna : 295|1@0+ (1,0) [0|1] ""  CCU,CCURT1,RT1_C1
 SG_ ADS_VDCActvSt : 285|1@0+ (1,0) [0|1] ""  CCU,CCURT1,RT1_C1
 SG_ ADS_TCSActvSt : 286|1@0+ (1,0) [0|1] ""  CCU,CCURT1,RT1_C1
 SG_ ADS_DTCActvSt : 287|1@0+ (1,0) [0|1] ""  CCU,CCURT1,RT1_C1
 SG_ ADC_VehSpd : 175|13@0+ (0.05625,0) [0|240] "km/h"  CCU,CCURT1,RT1_C1
 SG_ ADC_VehSpdVD : 178|1@0+ (1,0) [0|1] ""  CCU,CCURT1,RT1_C1
 SG_ ADC_SteerTqReq_A : 199|12@0+ (0.01,-20) [-20|20] "Nm"  CCU,CCURT1,RT1_C1
 SG_ ADC_SteerTqSt_A : 130|2@0+ (1,0) [0|3] ""  CCU,CCURT1,RT1_C1
 SG_ ADC_TqEvsSteerReq_A : 128|1@0+ (1,0) [0|1] ""  CCU,CCURT1,RT1_C1
 SG_ ADC_SteerTqAvl_A : 142|1@0+ (1,0) [0|1] ""  CCU,CCURT1,RT1_C1
 SG_ ADC_SteerGainLevelTqCtrl_A : 191|8@0+ (1,0) [0|254] "%"  CCU,CCURT1,RT1_C1
 SG_ ADC_BrkTarTq : 439|16@0+ (1,0) [0|65535] "Nm"  CCU,CCURT1,RT1_C1

BO_ 783 ADC_3_New: 64 ADC
 SG_ ADC_3_New_CRC : 7|16@0+ (1,0) [0|65535] ""  CCU,CCURT1,RT1_C1
 SG_ ADC_3_New_Counter : 23|8@0+ (1,0) [0|255] ""  CCU,CCURT1,RT1_C1
 SG_ ADC_FroTrkTargt0ObjClass : 31|4@0+ (1,0) [0|15] ""  CCU,CCURT1,RT1_C1
 SG_ ADC_FroTrkTargt0St : 27|1@0+ (1,0) [0|1] ""  CCU,CCURT1,RT1_C1
 SG_ ADC_FroTrkTargt0longPos : 25|10@0+ (0.2,0) [0|204.4] "m"  CCU,CCURT1,RT1_C1
 SG_ ADC_FroTrkTargt0latPos : 47|10@0+ (0.1,-51.2) [-51.2|51.1] "m"  CCU,CCURT1,RT1_C1
 SG_ ADC_FroTrkTargt0LatRelSpd : 48|9@0+ (0.1,-25.5) [-25.5|25.5] "m/s"  CCU,CCURT1,RT1_C1
 SG_ ADC_FroTrkTargt0LongRelSpd : 71|10@0+ (0.1,-51.2) [-51.2|51.1] "m/s"  CCU,CCURT1,RT1_C1
 SG_ ADC_FroTrkTargt0DetSensor : 53|4@0+ (1,0) [0|15] ""  CCU,CCURT1,RT1_C1
 SG_ ADC_FroTrkTargt1ObjClass : 77|4@0+ (1,0) [0|15] ""  CCU,CCURT1,RT1_C1
 SG_ ADC_FroTrkTargt1St : 26|1@0+ (1,0) [0|1] ""  CCU,CCURT1,RT1_C1
 SG_ ADC_FroTrkTargt1longPos : 73|10@0+ (0.2,0) [0|204.4] "m"  CCU,CCURT1,RT1_C1
 SG_ ADC_FroTrkTargt1latPos : 95|10@0+ (0.1,-51.2) [-51.2|51.1] "m"  CCU,CCURT1,RT1_C1
 SG_ ADC_FroTrkTargt1LatRelSpd : 96|9@0+ (0.1,-25.5) [-25.5|25.5] "m/s"  CCU,CCURT1,RT1_C1
 SG_ ADC_FroTrkTargt1LongRelSpd : 119|10@0+ (0.1,-51.2) [-51.2|51.1] "m/s"  CCU,CCURT1,RT1_C1
 SG_ ADC_FroTrkTargt1DetSensor : 100|4@0+ (1,0) [0|15] ""  CCU,CCURT1,RT1_C1
 SG_ ADC_FroTrkTargt2ObjClass : 125|4@0+ (1,0) [0|15] ""  CCU,CCURT1,RT1_C1
 SG_ ADC_FroTrkTargt2St : 49|1@0+ (1,0) [0|1] ""  CCU,CCURT1,RT1_C1
 SG_ ADC_FroTrkTargt2longPos : 121|10@0+ (0.2,0) [0|204.4] "m"  CCU,CCURT1,RT1_C1
 SG_ ADC_FroTrkTargt2latPos : 143|10@0+ (0.1,-51.2) [-51.2|51.1] "m"  CCU,CCURT1,RT1_C1
 SG_ ADC_FroTrkTargt2LatRelSpd : 149|9@0+ (0.1,-25.5) [-25.5|25.5] "m/s"  CCU,CCURT1,RT1_C1
 SG_ ADC_FroTrkTargt2LongRelSpd : 156|10@0+ (0.1,-51.2) [-51.2|51.1] "m/s"  CCU,CCURT1,RT1_C1
 SG_ ADC_FroTrkTargt2DetSensor : 175|4@0+ (1,0) [0|15] ""  CCU,CCURT1,RT1_C1
 SG_ ADC_FroTrkTargt3ObjClass : 171|4@0+ (1,0) [0|15] ""  CCU,CCURT1,RT1_C1
 SG_ ADC_FroTrkTargt3St : 101|1@0+ (1,0) [0|1] ""  CCU,CCURT1,RT1_C1
 SG_ ADC_FroTrkTargt3longPos : 183|10@0+ (0.2,0) [0|204.4] "m"  CCU,CCURT1,RT1_C1
 SG_ ADC_FroTrkTargt3latPos : 185|10@0+ (0.1,-51.2) [-51.2|51.1] "m"  CCU,CCURT1,RT1_C1
 SG_ ADC_Road_Type_Ahead : 214|5@0+ (1,0) [0|31] ""  CCU,CCURT1,RT1_C1
 SG_ ADC_FroTrkTargt3LatRelSpd : 207|9@0+ (0.1,-25.5) [-25.5|25.5] "m/s"  CCU,CCURT1,RT1_C1
 SG_ ADC_FroTrkTargt3LongRelSpd : 209|10@0+ (0.1,-51.2) [-51.2|51.1] "m/s"  CCU,CCURT1,RT1_C1
 SG_ ADC_FroTrkTargt3DetSensor : 189|4@0+ (1,0) [0|15] ""  CCU,CCURT1,RT1_C1
 SG_ ADC_LLnMrking_A0 : 231|11@0+ (0.01,-10.23) [-10.23|10.23] "m"  CCU,CCURT1,RT1_C1
 SG_ ADC_LLnMrking_A1 : 234|11@0+ (0.001,-1.023) [-1.023|1.023] "rad"  CCU,CCURT1,RT1_C1
 SG_ ADC_LLnMrking_A2 : 250|11@0+ (0.00001,-0.01023) [-0.01023|0.01023] "1/m"  CCU,CCURT1,RT1_C1
 SG_ ADC_LLnMrking_conf : 271|6@0+ (2,0) [0|100] "%"  CCU,CCURT1,RT1_C1
 SG_ ADC_LlnMrkingDispSt : 236|2@0+ (1,0) [0|3] ""  CCU,CCURT1,RT1_C1
 SG_ ADC_LLnMrking_Range : 279|11@0+ (0.1,0) [0|204.7] "m"  CCU,CCURT1,RT1_C1
 SG_ ADC_LLnMrking_Type : 284|4@0+ (1,0) [0|15] ""  CCU,CCURT1,RT1_C1
 SG_ ADC_RLnMrking_A0 : 295|11@0+ (0.01,-10.23) [-10.23|10.23] "m"  CCU,CCURT1,RT1_C1
 SG_ ADC_RLnMrking_A1 : 300|11@0+ (0.001,-1.023) [-1.023|1.023] "rad"  CCU,CCURT1,RT1_C1
 SG_ ADC_RLnMrking_A2 : 319|11@0+ (0.00001,-0.01023) [-0.01023|0.01023] "1/m"  CCU,CCURT1,RT1_C1
 SG_ ADC_RlnMrkingDispSt : 265|2@0+ (1,0) [0|3] ""  CCU,CCURT1,RT1_C1
 SG_ ADC_RLnMrking_conf : 349|6@0+ (2,0) [0|100] "%"  CCU,CCURT1,RT1_C1
 SG_ ADC_RLnMrking_Range : 322|11@0+ (0.1,0) [0|204.7] "m"  CCU,CCURT1,RT1_C1
 SG_ ADC_RLnMrking_Type : 343|4@0+ (1,0) [0|15] ""  CCU,CCURT1,RT1_C1
 SG_ ADC_Road_Type_Ahead_conf : 339|6@0+ (2,0) [0|100] "%"  CCU,CCURT1,RT1_C1

BO_ 659 ADC_5: 64 ADC
 SG_ ADC_5_CRC : 7|16@0+ (1,0) [0|65535] ""  CCU
 SG_ ADC_5_Counter : 23|8@0+ (1,0) [0|255] ""  CCU
 SG_ ADC_NDASt : 31|6@0+ (1,0) [0|63] ""  CCU,CCURT1,RT1_C1,IDC,TBOX
 SG_ ADC_NDATORType : 39|4@0+ (1,0) [0|15] ""  CCU
 SG_ ADC_NDASplitSt : 43|3@0+ (1,0) [0|7] ""  CCU
 SG_ ADC_NDARouteReplanning : 197|1@0+ (1,0) [0|1] ""  CCU
 SG_ ADC_LaneChangeType : 335|5@0+ (1,0) [0|31] ""  CCU
 SG_ ADC_FuncReq_SentryModWarn : 379|1@0+ (1,0) [0|1] ""  CCU
 SG_ ADC_TlaWarning : 232|3@0+ (1,0) [0|7] ""  CCU
 SG_ ADC_TlaFault : 25|2@0+ (1,0) [0|3] ""  CCU
 SG_ ADC_FcwWaning : 255|3@0+ (1,0) [0|7] ""  CCU
 SG_ ADC_AebFault : 74|2@0+ (1,0) [0|3] ""  CCU
 SG_ ADC_RaebWarning : 92|3@0+ (1,0) [0|7] ""  CCU
 SG_ ADC_RaebFault : 83|2@0+ (1,0) [0|3] ""  CCU
 SG_ ADC_RcwFault : 85|2@0+ (1,0) [0|3] ""  CCU
 SG_ ADC_FctbLeftWarning : 89|3@0+ (1,0) [0|7] ""  CCU
 SG_ ADC_FctbRightWarning : 106|3@0+ (1,0) [0|7] ""  CCU
 SG_ ADC_RctaFault : 87|2@0+ (1,0) [0|3] ""  CCU
 SG_ ADC_RctbLeftWarning : 116|3@0+ (1,0) [0|7] ""  CCU
 SG_ ADC_RctbRightWarning : 119|3@0+ (1,0) [0|7] ""  CCU
 SG_ ADC_LdwFault : 361|2@0+ (1,0) [0|3] ""  CCU
 SG_ ADC_LkaFault : 369|2@0+ (1,0) [0|3] ""  CCU
 SG_ ADC_BsdFault : 381|2@0+ (1,0) [0|3] ""  CCU
 SG_ ADC_DowFault : 391|2@0+ (1,0) [0|3] ""  CCU
 SG_ ADC_TsrFault : 81|2@0+ (1,0) [0|3] ""  CCU
 SG_ ADC_ElkaWarning : 143|3@0+ (1,0) [0|7] ""  CCU
 SG_ ADC_ElkaFault : 383|2@0+ (1,0) [0|3] ""  CCU
 SG_ ADC_IMURollingCounter : 263|8@0+ (1,0) [0|255] ""  CCU
 SG_ ADC_IMUAccX : 151|16@0+ (0.002,-65.536) [-65.536|65.534] "m/s2"  CCU
 SG_ ADC_IMUAccY : 167|16@0+ (0.002,-65.536) [-65.536|65.534] "m/s2"  CCU
 SG_ ADC_IMUAccZ : 183|16@0+ (0.002,-65.536) [-65.536|65.534] "m/s2"  CCU
 SG_ ADC_IMUGyroX : 195|16@0+ (0.01,-327.68) [-327.68|327.67] "dps"  CCU
 SG_ ADC_IMUGyroY : 223|16@0+ (0.01,-327.68) [-327.68|327.67] "dps"  CCU
 SG_ ADC_IMUGyroZ : 351|16@0+ (0.01,-327.68) [-327.68|327.67] "dps"  CCU
 SG_ ADC_IMURoll : 407|16@0+ (0.01,-180) [-180|180] "degree"  CCU
 SG_ ADC_IMUPitch : 271|16@0+ (0.01,-180) [-180|180] "degree"  CCU
 SG_ ADC_IMUYaw : 287|16@0+ (0.01,0) [0|360] "degree"  CCU
 SG_ ADC_IMUTimestampVld : 136|1@0+ (1,0) [0|1] ""  CCU
 SG_ ADC_IMUAccVld : 137|1@0+ (1,0) [0|1] ""  CCU
 SG_ ADC_IMUGyroVld : 196|1@0+ (1,0) [0|1] ""  CCU
 SG_ ADC_IMUAttitudeVld : 235|1@0+ (1,0) [0|1] ""  CCU
 SG_ ADC_IMUPositionType : 239|4@0+ (1,0) [0|15] ""  CCU
 SG_ ADC_IMUTimestamp : 303|32@0+ (1,0) [0|4294967295] ""  CCU
 SG_ ADC_AbsoultwSpeedLimit : 439|16@0+ (1,0) [0|65535] "km/h"  CCU,CCURT2,RT2_C3

BO_ 923 ADC_6: 64 ADC
 SG_ ADC_6_CRC : 7|16@0+ (1,0) [0|65535] ""  Vector__XXX
 SG_ ADC_6_Counter : 23|8@0+ (1,0) [0|255] ""  Vector__XXX
 SG_ ADC_FrontWideCameraSt : 31|3@0+ (1,0) [0|7] ""  Vector__XXX
 SG_ ADC_FrontNarrowCameraSt : 28|3@0+ (1,0) [0|7] ""  Vector__XXX
 SG_ ADC_LeftFrontCameraSt : 39|3@0+ (1,0) [0|7] ""  Vector__XXX
 SG_ ADC_LeftRearCameraSt : 36|3@0+ (1,0) [0|7] ""  Vector__XXX
 SG_ ADC_RightFrontCameraSt : 47|3@0+ (1,0) [0|7] ""  Vector__XXX
 SG_ ADC_RightRearCameraSt : 44|3@0+ (1,0) [0|7] ""  Vector__XXX
 SG_ ADC_RearCameraSt : 55|3@0+ (1,0) [0|7] ""  Vector__XXX
 SG_ ADC_FrontRadarSt : 52|3@0+ (1,0) [0|7] ""  Vector__XXX
 SG_ ADC_LeftFrontRadarSt : 63|3@0+ (1,0) [0|7] ""  Vector__XXX
 SG_ ADC_LeftRearRadarSt : 60|3@0+ (1,0) [0|7] ""  Vector__XXX
 SG_ ADC_RightFrontRadarSt : 71|3@0+ (1,0) [0|7] ""  Vector__XXX
 SG_ ADC_RightRearRadarSt : 68|3@0+ (1,0) [0|7] ""  Vector__XXX
 SG_ ADC_RearRadarSt : 79|3@0+ (1,0) [0|7] ""  Vector__XXX
 SG_ ADC_FrontLidarSt : 76|3@0+ (1,0) [0|7] ""  Vector__XXX
 SG_ ADC_LeftLidarSt : 87|3@0+ (1,0) [0|7] ""  Vector__XXX
 SG_ ADC_RightLidarSt : 84|3@0+ (1,0) [0|7] ""  Vector__XXX
 SG_ ADC_SentryStatus : 57|2@0+ (1,0) [0|3] ""  CCU
 SG_ ADC_SystemState : 236|4@0+ (1,0) [0|14] ""  CCU
 SG_ ADC_HWFailureReason : 199|3@0+ (1,0) [0|7] ""  CCU
 SG_ ADC_SWFailureReason : 196|5@0+ (1,0) [0|31] ""  CCU
 SG_ mountAngleIndicator_az : 101|9@0+ (0.05,-12.8) [-12.8|12.75] "degree"  CCU
 SG_ mountAngleCurrent_az : 108|9@0+ (0.05,-12.8) [-12.8|12.75] "degree"  CCU
 SG_ mountAngleIndicator_el : 115|9@0+ (0.05,-12.8) [-12.8|12.75] "degree"  CCU
 SG_ mountAngleCurrent_el : 122|9@0+ (0.05,-12.8) [-12.8|12.75] "degree"  CCU
 SG_ malStablePosEl : 129|9@0+ (0.05,-12.8) [-12.8|12.75] "degree"  CCU
 SG_ malStablePosAz : 136|9@0+ (0.05,-12.8) [-12.8|12.75] "degree"  CCU
 SG_ AngleEMEIndicatorEl : 159|9@0+ (0.05,-12.8) [-12.8|12.75] "degree"  CCU
 SG_ AngleEMEIndicatorAz : 166|9@0+ (0.05,-12.8) [-12.8|12.75] "degree"  CCU
 SG_ highSpreadIndicator_el : 171|9@0+ (0.05,-12.8) [-12.8|12.75] "degree"  CCU
 SG_ highSpreadIndicator_az : 176|9@0+ (0.05,-12.8) [-12.8|12.75] "degree"  CCU
 SG_ Fault_MAL_HOR_ABS_EVENT : 204|1@0+ (1,0) [0|1] ""  CCU
 SG_ Fault_MAL_HOR_REL_EVENT : 205|1@0+ (1,0) [0|1] ""  CCU
 SG_ Fault_MAL_VER_ABS_EVENT : 206|1@0+ (1,0) [0|1] ""  CCU
 SG_ Fault_MAL_VER_REL_EVENT : 207|1@0+ (1,0) [0|1] ""  CCU
 SG_ FilteredPhiSpread : 231|11@0+ (0.1,-102.4) [-102.4|102.3] "Meter"  CCU
 SG_ elOutOfSpecCause : 201|2@0+ (1,0) [0|3] ""  CCU
 SG_ azOutOfSpecCause : 203|2@0+ (1,0) [0|3] ""  CCU
 SG_ azOutOfProfileCause : 215|8@0+ (1,0) [0|255] ""  CCU
 SG_ elOutOfProfileCause : 223|8@0+ (1,0) [0|255] ""  CCU
 SG_ Reserved1 : 440|1@0+ (1,0) [0|1] ""  CCU

CM_ SG_ 387 ADC_4_New_CRC "E2E Profile 5 CRC";
CM_ SG_ 387 ADC_4_New_Counter "E2E Profile 5 Counter";
CM_ SG_ 387 ADC_AngReqSt_A "Lateral control Function Request State";
CM_ SG_ 387 ADC_AngReqFunction "Indicates which function request angle control";
CM_ SG_ 387 ADC_BrakeLightReq "Brake Light Request?";
CM_ SG_ 387 ADC_StrAngleReq_A "Steering Angle Request Value";
CM_ SG_ 387 ADC_SACMotorTorLimExtMax_A "Maximum Motor External Torque Limitation of Angle Following";
CM_ SG_ 387 ADC_SACMotorTorLimExtMin_A "Minimum Motor External Torque Limitation of Angle Following";
CM_ SG_ 387 ADC_AssistParaSwitchReq "Request EPS Switch Assist Parameter to LKAmode";
CM_ SG_ 387 ADC_SteerGainReq "Driver steering  gain request signal";
CM_ SG_ 387 ADC_StrgWhlVibrWarnLevel "Steering wheel vibratio Warn Frequency";
CM_ SG_ 387 ADC_ActTrqReqEnable "Enable flag for VCU for realization of target torque ActTrqReq";
CM_ SG_ 387 ADC_SteerGainLevel "Driver steering gain request value";
CM_ SG_ 387 ADC_EvsSteerReq "Emergency Collision avoidance steering mode request";
CM_ SG_ 387 ADC_StrgWhlVibrWarnReq "Steering wheel vibration Warn request";
CM_ SG_ 387 ADC_ActTrqReq "VLC Request Effective target torque on wheel level to VCU";
CM_ SG_ 387 ADC_DrvTarTqMod2EPB "Drive torque mode to EPB";
CM_ SG_ 387 ADC_LongCtrlTypReq "Main ADC  Longitudinal Control Brake type.Comfort Mode : The controller and brake system will consider NVH limitations, carefully reaction for good driving feeling, etc.Emergency Mode: the controller react fast and the brake system will achieve maximum performance (No limitations, eg. NVH limitations, HW protection).";
CM_ SG_ 387 ADC_TotalRefTorque_A "ADAS total  torque request";
CM_ SG_ 387 ADC_AEBFaultSt "This signal indicates the AEB(Auto Emerrgency Braking) fault status";
CM_ SG_ 387 ADC_AEBOffSt "This signal indicates if the AEB(Auto Emerrgency Braking) is deactivated";
CM_ SG_ 387 ADC_AEBInterventionSt "This signal indicates if the AEB(Auto Emerrgency Braking) intervents";
CM_ SG_ 387 ADC_AEBDecelCtrlReq "Request of the AEB/EBA/FCTB/RCTB deceleration control";
CM_ SG_ 387 ADC_AEBLVehHoldReq "Request ESP to hold vehilce if AEB active and vehilce stopped";
CM_ SG_ 387 ADC_ABAReq "Request of the ABA support from ESP";
CM_ SG_ 387 ADC_ABALevel "ABA(Adaptive Brake Assistance) level to the ESP HBA";
CM_ SG_ 387 ADC_AWBReq "Request of the brake jerk warning to ESP";
CM_ SG_ 387 ADC_ABPReq "Request of the Prefill to ESP";
CM_ SG_ 387 ADC_AWBLevel "Different level request of the brake jerk";
CM_ SG_ 387 ADC_AEBTarCalss "AEB Target Object Class";
CM_ SG_ 387 ADC_AEBTarDetSensor "AEB Target Property Detected by Sensor with Fusion or not.";
CM_ SG_ 387 ADC_TurnLightReq "Turn Lamp and Hazard Lamp Request?";
CM_ SG_ 387 ADC_PAA2EPBEpbReq "ADAS to EPB request  ";
CM_ SG_ 387 ADC_PAA2EPBEpbReqSt "ADAS to EPB Request  Status";
CM_ SG_ 387 ADC_AEBObjectTTC "Time-to-collision between ego vehicle and collision object, and the relative acceleration should be considered";
CM_ SG_ 387 ADC_AEBObjRelativeSpd "Relative Speed between ego vehicle and collision object. Means Ego speed > collision object speed situation";
CM_ SG_ 387 ADC_PAAPwrModeReq "PAA Powertrain Request";
CM_ SG_ 387 ADC_PAAGrarLvlReq "Gear lever position request for the vehicle mo-tion control";
CM_ SG_ 387 ADC_PAAGrarLvlReqEnable "enable flag to control the gear box";
CM_ SG_ 387 ADC_ACCMode_C "This signal indicates ACC(Adaptive cruise control)status";
CM_ SG_ 387 ADC_ActTrqReqVD "The validity of ADC torque request to VCU";
CM_ SG_ 387 ADC_BrkTarTqEna "The enable status  of total target brake torque";
CM_ SG_ 387 ADC_BrkTarTqMod "This signal indicates which function the total target brake torque is used for，cruise or parking function.";
CM_ SG_ 387 ADC_AebBrkTarTq "Total taget brake torque of the AEB";
CM_ SG_ 387 ADC_EpbModReqVld "The validity of the  request from the ADAS/ADS to the  EPB";
CM_ SG_ 387 ADC_RWUEna "The enable status of the  RWU";
CM_ SG_ 387 ADC_BrkHoldReq "The AVH request from the ADAS/ADS to the ESP/IPB.Not active：AVH no activeActive：AVH active";
CM_ SG_ 387 ADC_AngReqAvl "Steering angle request avaliable state";
CM_ SG_ 387 ADC_TarGearReqVld "Gear lever request validity";
CM_ SG_ 387 ADC_FctSts "ADAS active status";
CM_ SG_ 387 ADC_BrkTarTqVld "The validity of total  target brake torque";
CM_ SG_ 387 ADC_AebBrkTarTqVld "The validity of total target brake torque of the AEB";
CM_ SG_ 387 ADC_AebBrkTarTqEna "The enable status  of total  target brake torque of the AEB";
CM_ SG_ 387 ADC_ElecBrkFnSwitch "The switch for regenerative brake and hydraulic brake。Off：The ESP/IPB can not assign regenerative brake torque to the VCU/DCU。On：The ESP/IPB can assign regenerative brake torque to the VCUDCU。";
CM_ SG_ 387 ADC_RWUVld "The validity  of the RWU";
CM_ SG_ 387 ADC_DriverPresent "It indicates whether someone is in the driver's seat.";
CM_ SG_ 387 ADC_AD_NetMode "Autonomous_Driving Request Net Mode";
CM_ SG_ 387 ADC_ChrgPwrMode "ADC VCU Torque Control Mode";
CM_ SG_ 387 ADC_LimTqEnable_A "Limit torque request enable flag";
CM_ SG_ 387 ADC_LimTqFactorK_A "Limit torque request factor";
CM_ SG_ 387 ADC_RapidRespEna_A "Rapid response mode enable flag";
CM_ SG_ 387 ADC_DrvTarTqMod_A "Drive torque mode";
CM_ SG_ 387 ADC_FcsActiveStatus "indicate ADS Fuction is Active for energe save mode";
CM_ SG_ 387 ADC_DycEscTarTq_A "The total target torque of the DYC(Direct  yaw moment control).";
CM_ SG_ 387 ADC_DycEscTarTqfactor_A "Partition coefficient of  total target torque of the DYC:front axle/total";
CM_ SG_ 387 ADC_DycEscTarTqVld_A "The validity of total target torque of the DYC.";
CM_ SG_ 387 ADC_DycEscTarTqEna_A "The enable status  of total target torque of the DYC.";
CM_ SG_ 387 ADC_RedundantSwt "It is the switch for the redundancy mode.";
CM_ SG_ 387 ADC_ImmediateStopEna "It indicates whether ESP is permitted to perform blind braking.（It indicates whether the ESP is permitted to immediately brake the vehicle to a stop.）";
CM_ SG_ 387 ADS_VDCActvSt "ADS的VDC激活标志";
CM_ SG_ 387 ADS_TCSActvSt "ADS的TCS激活标志";
CM_ SG_ 387 ADS_DTCActvSt "ADS的稳定性控制激活标志";
CM_ SG_ 387 ADC_VehSpd "ADC Vehicle speed";
CM_ SG_ 387 ADC_VehSpdVD "ADC Quality/fault information to vehicle speed";
CM_ SG_ 387 ADC_SteerTqReq_A "Steering torque request value";
CM_ SG_ 387 ADC_SteerTqSt_A "Steering torque request  enable state";
CM_ SG_ 387 ADC_TqEvsSteerReq_A "Emergency Collision avoidance steering mode request";
CM_ SG_ 387 ADC_SteerTqAvl_A "Steering torque request avaliable state";
CM_ SG_ 387 ADC_SteerGainLevelTqCtrl_A "Driver steering torque gain request value";
CM_ SG_ 387 ADC_BrkTarTq "Total target brake torque for cruise and parking function ";
CM_ SG_ 783 ADC_3_New_CRC "E2E Profile 5 CRC";
CM_ SG_ 783 ADC_3_New_Counter "E2E Profile 5 Counter";
CM_ SG_ 783 ADC_FroTrkTargt0ObjClass "Front Track Target 0（Closest Same Lane）Object class";
CM_ SG_ 783 ADC_FroTrkTargt0St "Front Track Target 0（Closest Same Lane）detection state";
CM_ SG_ 783 ADC_FroTrkTargt0longPos "Front Track Target 0（Closest Same Lane）Longitudinal Position";
CM_ SG_ 783 ADC_FroTrkTargt0latPos "Front Track Target 0（Closest Same Lane）Lateral Position";
CM_ SG_ 783 ADC_FroTrkTargt0LatRelSpd "Front Track Target 0（Closest Same Lane）Lateral Relative Speed";
CM_ SG_ 783 ADC_FroTrkTargt0LongRelSpd "Front Track Target 0（Closest Same Lane）Longitudinal Relative Speed";
CM_ SG_ 783 ADC_FroTrkTargt0DetSensor "Front Track Target 0（Closest Same Lane）Property Detected by Sensor";
CM_ SG_ 783 ADC_FroTrkTargt1ObjClass "Front Track Target 1（Before Target 0, TheSecond Closest Same Lane）Objectclass";
CM_ SG_ 783 ADC_FroTrkTargt1St "Front Track Target 1（Before Target 0, TheSecond Closest Same Lane）detection state";
CM_ SG_ 783 ADC_FroTrkTargt1longPos "Front Track Target 1（Before Target 0, TheSecond Closest Same Lane）Longitudinal Position";
CM_ SG_ 783 ADC_FroTrkTargt1latPos "Front Track Target 1（Before Target 0, TheSecond Closest Same Lane）Lateral Position";
CM_ SG_ 783 ADC_FroTrkTargt1LatRelSpd "Front Track Target 1（Before Target 0, TheSecond Closest Same Lane）Lateral Relative Speed";
CM_ SG_ 783 ADC_FroTrkTargt1LongRelSpd "Front Track Target 1（Before Target 0, TheSecond Closest Same Lane）Longitudinal Relative Speed";
CM_ SG_ 783 ADC_FroTrkTargt1DetSensor "Front Track Target 1（Before Target 0, TheSecond Closest Same Lane）Property Detected by Sensor";
CM_ SG_ 783 ADC_FroTrkTargt2ObjClass "Front Track Target 2（Closest Left Lane）Object class";
CM_ SG_ 783 ADC_FroTrkTargt2St "Front Track Target 2（Closest Left Lane）detection state";
CM_ SG_ 783 ADC_FroTrkTargt2longPos "Front Track Target 2（Closest Left Lane） Longitudinal Position";
CM_ SG_ 783 ADC_FroTrkTargt2latPos "Front Track Target 2（Closest Left Lane） Lateral Position";
CM_ SG_ 783 ADC_FroTrkTargt2LatRelSpd "Front Track Target 2（Closest Left Lane）Lateral Relative Speed";
CM_ SG_ 783 ADC_FroTrkTargt2LongRelSpd "Front Track Target 2（Closest Left Lane）Longitudinal Relative Speed";
CM_ SG_ 783 ADC_FroTrkTargt2DetSensor "Front Track Target 2（Closest Left Lane）Property Detected by Sensor";
CM_ SG_ 783 ADC_FroTrkTargt3ObjClass "Front Track Target 3（Closest Right Lane）Objectclass";
CM_ SG_ 783 ADC_FroTrkTargt3St "Front Track Target 2（Closest Right Lane）detection state";
CM_ SG_ 783 ADC_FroTrkTargt3longPos "Front Track Target 3（Closest Right Lane）Longitudinal Position";
CM_ SG_ 783 ADC_FroTrkTargt3latPos "Front Track Target 3（Closest Right Lane）Lateral Position";
CM_ SG_ 783 ADC_Road_Type_Ahead "The road type ahead";
CM_ SG_ 783 ADC_FroTrkTargt3LatRelSpd "Front Track Target 3（Closest Right Lane）Lateral Relative Speed";
CM_ SG_ 783 ADC_FroTrkTargt3LongRelSpd "Front Track Target 3（Closest Right Lane）Longitudinal Relative Speed";
CM_ SG_ 783 ADC_FroTrkTargt3DetSensor "Front Track Target 3（Closest Right Lane）Property Detected by Sensor";
CM_ SG_ 783 ADC_LLnMrking_A0 "Left Lane Marking Polynomial Coefficient A0, which stands for the lateral distance between lane marking and the middle of the eog vehicle.";
CM_ SG_ 783 ADC_LLnMrking_A1 "Left Lane Marking Polynomial Coefficient A1, which stands for the heading angle between the lane marking and the ego vehicle.";
CM_ SG_ 783 ADC_LLnMrking_A2 "Left Lane Marking Polynomial Coefficient A2, which stands for the curvature of the lane marking.";
CM_ SG_ 783 ADC_LLnMrking_conf "Left Lane Marking confidence";
CM_ SG_ 783 ADC_LlnMrkingDispSt "Display state of the left lane marking";
CM_ SG_ 783 ADC_LLnMrking_Range "Left Lane Marking range";
CM_ SG_ 783 ADC_LLnMrking_Type "Left side of lane marking indication type";
CM_ SG_ 783 ADC_RLnMrking_A0 "right Lane Marking Polynomial Coefficient A0, which stands for the lateral distance between lane marking and the middle of the eog vehicle.";
CM_ SG_ 783 ADC_RLnMrking_A1 "right Lane Marking Polynomial Coefficient A1, which stands for the heading angle between the lane marking and the ego vehicle.";
CM_ SG_ 783 ADC_RLnMrking_A2 "right Lane Marking Polynomial Coefficient A2, which stands for the curvature of the lane marking.";
CM_ SG_ 783 ADC_RlnMrkingDispSt "Display state of the right lane marking";
CM_ SG_ 783 ADC_RLnMrking_conf "right Lane Marking confidence";
CM_ SG_ 783 ADC_RLnMrking_Range "right Lane Marking range";
CM_ SG_ 783 ADC_RLnMrking_Type "right side of lane marking indication type";
CM_ SG_ 783 ADC_Road_Type_Ahead_conf "The road type ahead confidence";
CM_ SG_ 659 ADC_5_CRC "E2E Profile 5 CRC";
CM_ SG_ 659 ADC_5_Counter "E2E Profile 5 Counter";
CM_ SG_ 659 ADC_NDASt "NDA state information";
CM_ SG_ 659 ADC_NDATORType "NDA/Autonomous Driving System Driver TakeOver Type";
CM_ SG_ 659 ADC_NDASplitSt "NDA Split state";
CM_ SG_ 659 ADC_NDARouteReplanning "ADC_NDA Route Replanning";
CM_ SG_ 659 ADC_LaneChangeType "Lane Change Type";
CM_ SG_ 659 ADC_FuncReq_SentryModWarn "Sentry Mode Warn";
CM_ SG_ 659 ADC_TlaWarning "TLA Warning State for ICM";
CM_ SG_ 659 ADC_TlaFault "TLA Failure State";
CM_ SG_ 659 ADC_FcwWaning "FCW Warning State Effects";
CM_ SG_ 659 ADC_AebFault "AEB Fault State";
CM_ SG_ 659 ADC_RaebWarning "RAEB Warning State Effects";
CM_ SG_ 659 ADC_RaebFault "RAEB Fault State";
CM_ SG_ 659 ADC_RcwFault "RCW Fault State";
CM_ SG_ 659 ADC_FctbLeftWarning "FCTB Left Warning State Effects";
CM_ SG_ 659 ADC_FctbRightWarning "FCTB Right Warning State Effects";
CM_ SG_ 659 ADC_RctaFault "RCTA Fault State";
CM_ SG_ 659 ADC_RctbLeftWarning "RCTB Left Warning State Effects";
CM_ SG_ 659 ADC_RctbRightWarning "RCTB Right Warning State Effects";
CM_ SG_ 659 ADC_LdwFault "LDW Fault State";
CM_ SG_ 659 ADC_LkaFault "LKA Fault State";
CM_ SG_ 659 ADC_BsdFault "BSD Fault State";
CM_ SG_ 659 ADC_DowFault "DOW Fault State";
CM_ SG_ 659 ADC_TsrFault "TSR Fault State";
CM_ SG_ 659 ADC_ElkaWarning "ELKA Warning State Effects";
CM_ SG_ 659 ADC_ElkaFault "ELKA Fault State";
CM_ SG_ 659 ADC_IMURollingCounter "IMU?Counter";
CM_ SG_ 659 ADC_IMUAccX "IMU?X-Axis?Acceleration?(Rear)";
CM_ SG_ 659 ADC_IMUAccY "IMU?Y-Axis?Acceleration?(Right)";
CM_ SG_ 659 ADC_IMUAccZ "IMU?Z-Axis?Acceleration?(Upper)";
CM_ SG_ 659 ADC_IMUGyroX "IMU?X-Axis?AngularVelocity?(Rear)";
CM_ SG_ 659 ADC_IMUGyroY "IMU?Y-Axis?AngularVelocity?(Right)";
CM_ SG_ 659 ADC_IMUGyroZ "IMU?Z-Axis?AngularVelocity?(Upper)";
CM_ SG_ 659 ADC_IMURoll "IMU?RollAngle";
CM_ SG_ 659 ADC_IMUPitch "IMU?PitchAngle";
CM_ SG_ 659 ADC_IMUYaw "IMU?YawAngle";
CM_ SG_ 659 ADC_IMUTimestampVld "IMU?TimeStamp?Valid";
CM_ SG_ 659 ADC_IMUAccVld "IMU?Acceleration?Valid";
CM_ SG_ 659 ADC_IMUGyroVld "IMU?AngularVelocity?Valid";
CM_ SG_ 659 ADC_IMUAttitudeVld "IMU?Attitude?Valid";
CM_ SG_ 659 ADC_IMUPositionType "IMU?Localization?State";
CM_ SG_ 659 ADC_IMUTimestamp "IMU?TimeStamp";
CM_ SG_ 659 ADC_AbsoultwSpeedLimit "Absolute Speed Limit Value set by Driver";
CM_ SG_ 923 ADC_6_CRC "E2E Profile 5 CRC";
CM_ SG_ 923 ADC_6_Counter "E2E Profile 5 Counter";
CM_ SG_ 923 ADC_FrontWideCameraSt "Front Wide Camera State ";
CM_ SG_ 923 ADC_FrontNarrowCameraSt "Front Narrow Camera State ";
CM_ SG_ 923 ADC_LeftFrontCameraSt "Left Front Camera State ";
CM_ SG_ 923 ADC_LeftRearCameraSt "Left Rear Camera State ";
CM_ SG_ 923 ADC_RightFrontCameraSt "Right Front Camera State ";
CM_ SG_ 923 ADC_RightRearCameraSt "Right Rear Camera State ";
CM_ SG_ 923 ADC_RearCameraSt "Rear Camera Failure ";
CM_ SG_ 923 ADC_FrontRadarSt "Front Radar State ";
CM_ SG_ 923 ADC_LeftFrontRadarSt "Left Front Radar State ";
CM_ SG_ 923 ADC_LeftRearRadarSt "Left Rear Radar State ";
CM_ SG_ 923 ADC_RightFrontRadarSt "Right Front Radar State ";
CM_ SG_ 923 ADC_RightRearRadarSt "Right Rear Radar State ";
CM_ SG_ 923 ADC_RearRadarSt "Rear Radar State ";
CM_ SG_ 923 ADC_FrontLidarSt "Front Lidar State";
CM_ SG_ 923 ADC_LeftLidarSt "Left Lidar State";
CM_ SG_ 923 ADC_RightLidarSt "Right Lidar State";
CM_ SG_ 923 ADC_SentryStatus "Sentinel mode state machine";
CM_ SG_ 923 ADC_SystemState "The system status of ADS";
CM_ SG_ 923 ADC_HWFailureReason "NDA_ADC HW Failure Reason";
CM_ SG_ 923 ADC_SWFailureReason "NDA_ADC SW Failure Reason";
CM_ SG_ 923 mountAngleIndicator_az "Horizontal fast Angle";
CM_ SG_ 923 mountAngleCurrent_az "Horizontal slow Angle";
CM_ SG_ 923 mountAngleIndicator_el "Vertical fast Angle";
CM_ SG_ 923 mountAngleCurrent_el "Vertical slow Angle";
CM_ SG_ 923 malStablePosEl "Vertical stable point";
CM_ SG_ 923 malStablePosAz "Horizontal stable point";
CM_ SG_ 923 AngleEMEIndicatorEl "Vertical EME fast Angle";
CM_ SG_ 923 AngleEMEIndicatorAz "Horizontal EME fast Angle";
CM_ SG_ 923 highSpreadIndicator_el "Vertical filterPhiSpread";
CM_ SG_ 923 highSpreadIndicator_az "Horizontal filterPhiSpread";
CM_ SG_ 923 Fault_MAL_HOR_ABS_EVENT "Horizontal Angle absolute overshoot ITC";
CM_ SG_ 923 Fault_MAL_HOR_REL_EVENT "Horizontal relative Angle overshoot ITC";
CM_ SG_ 923 Fault_MAL_VER_ABS_EVENT "Vertical Angle absolute overshoot ITC";
CM_ SG_ 923 Fault_MAL_VER_REL_EVENT "Vertical relative overshoot ITC";
CM_ SG_ 923 FilteredPhiSpread "FR_MAL_FilteredPhiSpread";
CM_ SG_ 923 elOutOfSpecCause "FR_MAL_elOutOfSpecCause";
CM_ SG_ 923 azOutOfSpecCause "FR_MAL_azOutOfSpecCause";
CM_ SG_ 923 azOutOfProfileCause "FR_MAL_azOutOfProfileCause";
CM_ SG_ 923 elOutOfProfileCause "FR_MAL_elOutOfProfileCause";

BA_DEF_ BO_  "GenMsgCycleTime" INT 0 0;
BA_DEF_ BO_  "GenMsgCycleTimeFast" INT 0 0;
BA_DEF_ BO_  "GenMsgSendType" ENUM  "Periodic","Event","IfActive","POE","PA","FixedPeriodic","Event","EnabledPeriodic","NotUsed","NotUsed","EventPeriodic","NotUsed","NotUsed","NoMsgSendType";
BA_DEF_ BO_  "VFrameFormat" ENUM  "StandardCAN","ExtendedCAN","reserved","reserved","reserved","reserved","reserved","reserved","reserved","reserved","reserved","reserved","reserved","reserved","StandardCAN_FD","ExtendedCAN_FD";
BA_DEF_ BO_  "CANFD_BRS" ENUM  "0","1";
BA_DEF_ SG_  "EventCommandSignal" ENUM  "No","Yes";
BA_DEF_ SG_  "GatewayedSignals" ENUM  "No","Yes";
BA_DEF_ SG_  "GenSigInactiveValue" HEX 0 0;
BA_DEF_ SG_  "GenSigInvalidValue" HEX 0 0;
BA_DEF_ SG_  "GenSigSendType" ENUM  "Trigger","Passive","Cyclic","OnWrite","OnWriteWithRepetition","OnChange","OnChangeWithRepetition","IfActive","IfActiveWithRepetition","NoSigSendType";
BA_DEF_ SG_  "GenSigStartValue" HEX 0 0;
BA_DEF_ SG_  "GenSigTimeoutValue" HEX 0 0;
BA_DEF_ SG_  "Remark" STRING ;
BA_ "GenMsgCycleTime" BO_ 387 10;
BA_ "GenMsgCycleTimeFast" BO_ 387 0;
BA_ "GenMsgSendType" BO_ 387 0;
BA_ "VFrameFormat" BO_ 387 14;
BA_ "CANFD_BRS" BO_ 387 1;
BA_ "GenMsgCycleTime" BO_ 387 10;
BA_ "GenMsgCycleTimeFast" BO_ 387 0;
BA_ "GenMsgSendType" BO_ 387 0;
BA_ "VFrameFormat" BO_ 387 14;
BA_ "CANFD_BRS" BO_ 387 1;
BA_ "GenMsgCycleTime" BO_ 387 10;
BA_ "GenMsgCycleTimeFast" BO_ 387 0;
BA_ "GenMsgSendType" BO_ 387 0;
BA_ "VFrameFormat" BO_ 387 14;
BA_ "CANFD_BRS" BO_ 387 1;
BA_ "GenMsgCycleTime" BO_ 387 10;
BA_ "GenMsgCycleTimeFast" BO_ 387 0;
BA_ "GenMsgSendType" BO_ 387 0;
BA_ "VFrameFormat" BO_ 387 14;
BA_ "CANFD_BRS" BO_ 387 1;
BA_ "GenMsgCycleTime" BO_ 387 10;
BA_ "GenMsgCycleTimeFast" BO_ 387 0;
BA_ "GenMsgSendType" BO_ 387 0;
BA_ "VFrameFormat" BO_ 387 14;
BA_ "CANFD_BRS" BO_ 387 1;
BA_ "GenMsgCycleTime" BO_ 387 10;
BA_ "GenMsgCycleTimeFast" BO_ 387 0;
BA_ "GenMsgSendType" BO_ 387 0;
BA_ "VFrameFormat" BO_ 387 14;
BA_ "CANFD_BRS" BO_ 387 1;
BA_ "GenMsgCycleTime" BO_ 387 10;
BA_ "GenMsgCycleTimeFast" BO_ 387 0;
BA_ "GenMsgSendType" BO_ 387 0;
BA_ "VFrameFormat" BO_ 387 14;
BA_ "CANFD_BRS" BO_ 387 1;
BA_ "GenMsgCycleTime" BO_ 387 10;
BA_ "GenMsgCycleTimeFast" BO_ 387 0;
BA_ "GenMsgSendType" BO_ 387 0;
BA_ "VFrameFormat" BO_ 387 14;
BA_ "CANFD_BRS" BO_ 387 1;
BA_ "GenMsgCycleTime" BO_ 387 10;
BA_ "GenMsgCycleTimeFast" BO_ 387 0;
BA_ "GenMsgSendType" BO_ 387 0;
BA_ "VFrameFormat" BO_ 387 14;
BA_ "CANFD_BRS" BO_ 387 1;
BA_ "GenMsgCycleTime" BO_ 387 10;
BA_ "GenMsgCycleTimeFast" BO_ 387 0;
BA_ "GenMsgSendType" BO_ 387 0;
BA_ "VFrameFormat" BO_ 387 14;
BA_ "CANFD_BRS" BO_ 387 1;
BA_ "GenMsgCycleTime" BO_ 387 10;
BA_ "GenMsgCycleTimeFast" BO_ 387 0;
BA_ "GenMsgSendType" BO_ 387 0;
BA_ "VFrameFormat" BO_ 387 14;
BA_ "CANFD_BRS" BO_ 387 1;
BA_ "GenMsgCycleTime" BO_ 387 10;
BA_ "GenMsgCycleTimeFast" BO_ 387 0;
BA_ "GenMsgSendType" BO_ 387 0;
BA_ "VFrameFormat" BO_ 387 14;
BA_ "CANFD_BRS" BO_ 387 1;
BA_ "GenMsgCycleTime" BO_ 387 10;
BA_ "GenMsgCycleTimeFast" BO_ 387 0;
BA_ "GenMsgSendType" BO_ 387 0;
BA_ "VFrameFormat" BO_ 387 14;
BA_ "CANFD_BRS" BO_ 387 1;
BA_ "GenMsgCycleTime" BO_ 387 10;
BA_ "GenMsgCycleTimeFast" BO_ 387 0;
BA_ "GenMsgSendType" BO_ 387 0;
BA_ "VFrameFormat" BO_ 387 14;
BA_ "CANFD_BRS" BO_ 387 1;
BA_ "GenMsgCycleTime" BO_ 387 10;
BA_ "GenMsgCycleTimeFast" BO_ 387 0;
BA_ "GenMsgSendType" BO_ 387 0;
BA_ "VFrameFormat" BO_ 387 14;
BA_ "CANFD_BRS" BO_ 387 1;
BA_ "GenMsgCycleTime" BO_ 387 10;
BA_ "GenMsgCycleTimeFast" BO_ 387 0;
BA_ "GenMsgSendType" BO_ 387 0;
BA_ "VFrameFormat" BO_ 387 14;
BA_ "CANFD_BRS" BO_ 387 1;
BA_ "GenMsgCycleTime" BO_ 387 10;
BA_ "GenMsgCycleTimeFast" BO_ 387 0;
BA_ "GenMsgSendType" BO_ 387 0;
BA_ "VFrameFormat" BO_ 387 14;
BA_ "CANFD_BRS" BO_ 387 1;
BA_ "GenMsgCycleTime" BO_ 387 10;
BA_ "GenMsgCycleTimeFast" BO_ 387 0;
BA_ "GenMsgSendType" BO_ 387 0;
BA_ "VFrameFormat" BO_ 387 14;
BA_ "CANFD_BRS" BO_ 387 1;
BA_ "GenMsgCycleTime" BO_ 387 10;
BA_ "GenMsgCycleTimeFast" BO_ 387 0;
BA_ "GenMsgSendType" BO_ 387 0;
BA_ "VFrameFormat" BO_ 387 14;
BA_ "CANFD_BRS" BO_ 387 1;
BA_ "GenMsgCycleTime" BO_ 387 10;
BA_ "GenMsgCycleTimeFast" BO_ 387 0;
BA_ "GenMsgSendType" BO_ 387 0;
BA_ "VFrameFormat" BO_ 387 14;
BA_ "CANFD_BRS" BO_ 387 1;
BA_ "GenMsgCycleTime" BO_ 387 10;
BA_ "GenMsgCycleTimeFast" BO_ 387 0;
BA_ "GenMsgSendType" BO_ 387 0;
BA_ "VFrameFormat" BO_ 387 14;
BA_ "CANFD_BRS" BO_ 387 1;
BA_ "GenMsgCycleTime" BO_ 387 10;
BA_ "GenMsgCycleTimeFast" BO_ 387 0;
BA_ "GenMsgSendType" BO_ 387 0;
BA_ "VFrameFormat" BO_ 387 14;
BA_ "CANFD_BRS" BO_ 387 1;
BA_ "GenMsgCycleTime" BO_ 387 10;
BA_ "GenMsgCycleTimeFast" BO_ 387 0;
BA_ "GenMsgSendType" BO_ 387 0;
BA_ "VFrameFormat" BO_ 387 14;
BA_ "CANFD_BRS" BO_ 387 1;
BA_ "GenMsgCycleTime" BO_ 387 10;
BA_ "GenMsgCycleTimeFast" BO_ 387 0;
BA_ "GenMsgSendType" BO_ 387 0;
BA_ "VFrameFormat" BO_ 387 14;
BA_ "CANFD_BRS" BO_ 387 1;
BA_ "GenMsgCycleTime" BO_ 387 10;
BA_ "GenMsgCycleTimeFast" BO_ 387 0;
BA_ "GenMsgSendType" BO_ 387 0;
BA_ "VFrameFormat" BO_ 387 14;
BA_ "CANFD_BRS" BO_ 387 1;
BA_ "GenMsgCycleTime" BO_ 387 10;
BA_ "GenMsgCycleTimeFast" BO_ 387 0;
BA_ "GenMsgSendType" BO_ 387 0;
BA_ "VFrameFormat" BO_ 387 14;
BA_ "CANFD_BRS" BO_ 387 1;
BA_ "GenMsgCycleTime" BO_ 387 10;
BA_ "GenMsgCycleTimeFast" BO_ 387 0;
BA_ "GenMsgSendType" BO_ 387 0;
BA_ "VFrameFormat" BO_ 387 14;
BA_ "CANFD_BRS" BO_ 387 1;
BA_ "GenMsgCycleTime" BO_ 387 10;
BA_ "GenMsgCycleTimeFast" BO_ 387 0;
BA_ "GenMsgSendType" BO_ 387 0;
BA_ "VFrameFormat" BO_ 387 14;
BA_ "CANFD_BRS" BO_ 387 1;
BA_ "GenMsgCycleTime" BO_ 387 10;
BA_ "GenMsgCycleTimeFast" BO_ 387 0;
BA_ "GenMsgSendType" BO_ 387 0;
BA_ "VFrameFormat" BO_ 387 14;
BA_ "CANFD_BRS" BO_ 387 1;
BA_ "GenMsgCycleTime" BO_ 387 10;
BA_ "GenMsgCycleTimeFast" BO_ 387 0;
BA_ "GenMsgSendType" BO_ 387 0;
BA_ "VFrameFormat" BO_ 387 14;
BA_ "CANFD_BRS" BO_ 387 1;
BA_ "GenMsgCycleTime" BO_ 387 10;
BA_ "GenMsgCycleTimeFast" BO_ 387 0;
BA_ "GenMsgSendType" BO_ 387 0;
BA_ "VFrameFormat" BO_ 387 14;
BA_ "CANFD_BRS" BO_ 387 1;
BA_ "GenMsgCycleTime" BO_ 387 10;
BA_ "GenMsgCycleTimeFast" BO_ 387 0;
BA_ "GenMsgSendType" BO_ 387 0;
BA_ "VFrameFormat" BO_ 387 14;
BA_ "CANFD_BRS" BO_ 387 1;
BA_ "GenMsgCycleTime" BO_ 387 10;
BA_ "GenMsgCycleTimeFast" BO_ 387 0;
BA_ "GenMsgSendType" BO_ 387 0;
BA_ "VFrameFormat" BO_ 387 14;
BA_ "CANFD_BRS" BO_ 387 1;
BA_ "GenMsgCycleTime" BO_ 387 10;
BA_ "GenMsgCycleTimeFast" BO_ 387 0;
BA_ "GenMsgSendType" BO_ 387 0;
BA_ "VFrameFormat" BO_ 387 14;
BA_ "CANFD_BRS" BO_ 387 1;
BA_ "GenMsgCycleTime" BO_ 387 10;
BA_ "GenMsgCycleTimeFast" BO_ 387 0;
BA_ "GenMsgSendType" BO_ 387 0;
BA_ "VFrameFormat" BO_ 387 14;
BA_ "CANFD_BRS" BO_ 387 1;
BA_ "GenMsgCycleTime" BO_ 387 10;
BA_ "GenMsgCycleTimeFast" BO_ 387 0;
BA_ "GenMsgSendType" BO_ 387 0;
BA_ "VFrameFormat" BO_ 387 14;
BA_ "CANFD_BRS" BO_ 387 1;
BA_ "GenMsgCycleTime" BO_ 387 10;
BA_ "GenMsgCycleTimeFast" BO_ 387 0;
BA_ "GenMsgSendType" BO_ 387 0;
BA_ "VFrameFormat" BO_ 387 14;
BA_ "CANFD_BRS" BO_ 387 1;
BA_ "GenMsgCycleTime" BO_ 387 10;
BA_ "GenMsgCycleTimeFast" BO_ 387 0;
BA_ "GenMsgSendType" BO_ 387 0;
BA_ "VFrameFormat" BO_ 387 14;
BA_ "CANFD_BRS" BO_ 387 1;
BA_ "GenMsgCycleTime" BO_ 387 10;
BA_ "GenMsgCycleTimeFast" BO_ 387 0;
BA_ "GenMsgSendType" BO_ 387 0;
BA_ "VFrameFormat" BO_ 387 14;
BA_ "CANFD_BRS" BO_ 387 1;
BA_ "GenMsgCycleTime" BO_ 387 10;
BA_ "GenMsgCycleTimeFast" BO_ 387 0;
BA_ "GenMsgSendType" BO_ 387 0;
BA_ "VFrameFormat" BO_ 387 14;
BA_ "CANFD_BRS" BO_ 387 1;
BA_ "GenMsgCycleTime" BO_ 387 10;
BA_ "GenMsgCycleTimeFast" BO_ 387 0;
BA_ "GenMsgSendType" BO_ 387 0;
BA_ "VFrameFormat" BO_ 387 14;
BA_ "CANFD_BRS" BO_ 387 1;
BA_ "GenMsgCycleTime" BO_ 387 10;
BA_ "GenMsgCycleTimeFast" BO_ 387 0;
BA_ "GenMsgSendType" BO_ 387 0;
BA_ "VFrameFormat" BO_ 387 14;
BA_ "CANFD_BRS" BO_ 387 1;
BA_ "GenMsgCycleTime" BO_ 387 10;
BA_ "GenMsgCycleTimeFast" BO_ 387 0;
BA_ "GenMsgSendType" BO_ 387 0;
BA_ "VFrameFormat" BO_ 387 14;
BA_ "CANFD_BRS" BO_ 387 1;
BA_ "GenMsgCycleTime" BO_ 387 10;
BA_ "GenMsgCycleTimeFast" BO_ 387 0;
BA_ "GenMsgSendType" BO_ 387 0;
BA_ "VFrameFormat" BO_ 387 14;
BA_ "CANFD_BRS" BO_ 387 1;
BA_ "GenMsgCycleTime" BO_ 387 10;
BA_ "GenMsgCycleTimeFast" BO_ 387 0;
BA_ "GenMsgSendType" BO_ 387 0;
BA_ "VFrameFormat" BO_ 387 14;
BA_ "CANFD_BRS" BO_ 387 1;
BA_ "GenMsgCycleTime" BO_ 387 10;
BA_ "GenMsgCycleTimeFast" BO_ 387 0;
BA_ "GenMsgSendType" BO_ 387 0;
BA_ "VFrameFormat" BO_ 387 14;
BA_ "CANFD_BRS" BO_ 387 1;
BA_ "GenMsgCycleTime" BO_ 387 10;
BA_ "GenMsgCycleTimeFast" BO_ 387 0;
BA_ "GenMsgSendType" BO_ 387 0;
BA_ "VFrameFormat" BO_ 387 14;
BA_ "CANFD_BRS" BO_ 387 1;
BA_ "GenMsgCycleTime" BO_ 387 10;
BA_ "GenMsgCycleTimeFast" BO_ 387 0;
BA_ "GenMsgSendType" BO_ 387 0;
BA_ "VFrameFormat" BO_ 387 14;
BA_ "CANFD_BRS" BO_ 387 1;
BA_ "GenMsgCycleTime" BO_ 387 10;
BA_ "GenMsgCycleTimeFast" BO_ 387 0;
BA_ "GenMsgSendType" BO_ 387 0;
BA_ "VFrameFormat" BO_ 387 14;
BA_ "CANFD_BRS" BO_ 387 1;
BA_ "GenMsgCycleTime" BO_ 387 10;
BA_ "GenMsgCycleTimeFast" BO_ 387 0;
BA_ "GenMsgSendType" BO_ 387 0;
BA_ "VFrameFormat" BO_ 387 14;
BA_ "CANFD_BRS" BO_ 387 1;
BA_ "GenMsgCycleTime" BO_ 387 10;
BA_ "GenMsgCycleTimeFast" BO_ 387 0;
BA_ "GenMsgSendType" BO_ 387 0;
BA_ "VFrameFormat" BO_ 387 14;
BA_ "CANFD_BRS" BO_ 387 1;
BA_ "GenMsgCycleTime" BO_ 387 10;
BA_ "GenMsgCycleTimeFast" BO_ 387 0;
BA_ "GenMsgSendType" BO_ 387 0;
BA_ "VFrameFormat" BO_ 387 14;
BA_ "CANFD_BRS" BO_ 387 1;
BA_ "GenMsgCycleTime" BO_ 387 10;
BA_ "GenMsgCycleTimeFast" BO_ 387 0;
BA_ "GenMsgSendType" BO_ 387 0;
BA_ "VFrameFormat" BO_ 387 14;
BA_ "CANFD_BRS" BO_ 387 1;
BA_ "GenMsgCycleTime" BO_ 387 10;
BA_ "GenMsgCycleTimeFast" BO_ 387 0;
BA_ "GenMsgSendType" BO_ 387 0;
BA_ "VFrameFormat" BO_ 387 14;
BA_ "CANFD_BRS" BO_ 387 1;
BA_ "GenMsgCycleTime" BO_ 387 10;
BA_ "GenMsgCycleTimeFast" BO_ 387 0;
BA_ "GenMsgSendType" BO_ 387 0;
BA_ "VFrameFormat" BO_ 387 14;
BA_ "CANFD_BRS" BO_ 387 1;
BA_ "GenMsgCycleTime" BO_ 387 10;
BA_ "GenMsgCycleTimeFast" BO_ 387 0;
BA_ "GenMsgSendType" BO_ 387 0;
BA_ "VFrameFormat" BO_ 387 14;
BA_ "CANFD_BRS" BO_ 387 1;
BA_ "GenMsgCycleTime" BO_ 387 10;
BA_ "GenMsgCycleTimeFast" BO_ 387 0;
BA_ "GenMsgSendType" BO_ 387 0;
BA_ "VFrameFormat" BO_ 387 14;
BA_ "CANFD_BRS" BO_ 387 1;
BA_ "GenMsgCycleTime" BO_ 387 10;
BA_ "GenMsgCycleTimeFast" BO_ 387 0;
BA_ "GenMsgSendType" BO_ 387 0;
BA_ "VFrameFormat" BO_ 387 14;
BA_ "CANFD_BRS" BO_ 387 1;
BA_ "GenMsgCycleTime" BO_ 387 10;
BA_ "GenMsgCycleTimeFast" BO_ 387 0;
BA_ "GenMsgSendType" BO_ 387 0;
BA_ "VFrameFormat" BO_ 387 14;
BA_ "CANFD_BRS" BO_ 387 1;
BA_ "GenMsgCycleTime" BO_ 387 10;
BA_ "GenMsgCycleTimeFast" BO_ 387 0;
BA_ "GenMsgSendType" BO_ 387 0;
BA_ "VFrameFormat" BO_ 387 14;
BA_ "CANFD_BRS" BO_ 387 1;
BA_ "GenMsgCycleTime" BO_ 387 10;
BA_ "GenMsgCycleTimeFast" BO_ 387 0;
BA_ "GenMsgSendType" BO_ 387 0;
BA_ "VFrameFormat" BO_ 387 14;
BA_ "CANFD_BRS" BO_ 387 1;
BA_ "GenMsgCycleTime" BO_ 387 10;
BA_ "GenMsgCycleTimeFast" BO_ 387 0;
BA_ "GenMsgSendType" BO_ 387 0;
BA_ "VFrameFormat" BO_ 387 14;
BA_ "CANFD_BRS" BO_ 387 1;
BA_ "GenMsgCycleTime" BO_ 387 10;
BA_ "GenMsgCycleTimeFast" BO_ 387 0;
BA_ "GenMsgSendType" BO_ 387 0;
BA_ "VFrameFormat" BO_ 387 14;
BA_ "CANFD_BRS" BO_ 387 1;
BA_ "GenMsgCycleTime" BO_ 387 10;
BA_ "GenMsgCycleTimeFast" BO_ 387 0;
BA_ "GenMsgSendType" BO_ 387 0;
BA_ "VFrameFormat" BO_ 387 14;
BA_ "CANFD_BRS" BO_ 387 1;
BA_ "GenMsgCycleTime" BO_ 387 10;
BA_ "GenMsgCycleTimeFast" BO_ 387 0;
BA_ "GenMsgSendType" BO_ 387 0;
BA_ "VFrameFormat" BO_ 387 14;
BA_ "CANFD_BRS" BO_ 387 1;
BA_ "GenMsgCycleTime" BO_ 387 10;
BA_ "GenMsgCycleTimeFast" BO_ 387 0;
BA_ "GenMsgSendType" BO_ 387 0;
BA_ "VFrameFormat" BO_ 387 14;
BA_ "CANFD_BRS" BO_ 387 1;
BA_ "GenMsgCycleTime" BO_ 387 10;
BA_ "GenMsgCycleTimeFast" BO_ 387 0;
BA_ "GenMsgSendType" BO_ 387 0;
BA_ "VFrameFormat" BO_ 387 14;
BA_ "CANFD_BRS" BO_ 387 1;
BA_ "GenMsgCycleTime" BO_ 387 10;
BA_ "GenMsgCycleTimeFast" BO_ 387 0;
BA_ "GenMsgSendType" BO_ 387 0;
BA_ "VFrameFormat" BO_ 387 14;
BA_ "CANFD_BRS" BO_ 387 1;
BA_ "GenMsgCycleTime" BO_ 387 10;
BA_ "GenMsgCycleTimeFast" BO_ 387 0;
BA_ "GenMsgSendType" BO_ 387 0;
BA_ "VFrameFormat" BO_ 387 14;
BA_ "CANFD_BRS" BO_ 387 1;
BA_ "GenMsgCycleTime" BO_ 387 10;
BA_ "GenMsgCycleTimeFast" BO_ 387 0;
BA_ "GenMsgSendType" BO_ 387 0;
BA_ "VFrameFormat" BO_ 387 14;
BA_ "CANFD_BRS" BO_ 387 1;
BA_ "GenMsgCycleTime" BO_ 387 10;
BA_ "GenMsgCycleTimeFast" BO_ 387 0;
BA_ "GenMsgSendType" BO_ 387 0;
BA_ "VFrameFormat" BO_ 387 14;
BA_ "CANFD_BRS" BO_ 387 1;
BA_ "GenMsgCycleTime" BO_ 387 10;
BA_ "GenMsgCycleTimeFast" BO_ 387 0;
BA_ "GenMsgSendType" BO_ 387 0;
BA_ "VFrameFormat" BO_ 387 14;
BA_ "CANFD_BRS" BO_ 387 1;
BA_ "GenMsgCycleTime" BO_ 387 10;
BA_ "GenMsgCycleTimeFast" BO_ 387 0;
BA_ "GenMsgSendType" BO_ 387 0;
BA_ "VFrameFormat" BO_ 387 14;
BA_ "CANFD_BRS" BO_ 387 1;
BA_ "GenMsgCycleTime" BO_ 387 10;
BA_ "GenMsgCycleTimeFast" BO_ 387 0;
BA_ "GenMsgSendType" BO_ 387 0;
BA_ "VFrameFormat" BO_ 387 14;
BA_ "CANFD_BRS" BO_ 387 1;
BA_ "GenMsgCycleTime" BO_ 387 10;
BA_ "GenMsgCycleTimeFast" BO_ 387 0;
BA_ "GenMsgSendType" BO_ 387 0;
BA_ "VFrameFormat" BO_ 387 14;
BA_ "CANFD_BRS" BO_ 387 1;
BA_ "GenMsgCycleTime" BO_ 387 10;
BA_ "GenMsgCycleTimeFast" BO_ 387 0;
BA_ "GenMsgSendType" BO_ 387 0;
BA_ "VFrameFormat" BO_ 387 14;
BA_ "CANFD_BRS" BO_ 387 1;
BA_ "GenMsgCycleTime" BO_ 387 10;
BA_ "GenMsgCycleTimeFast" BO_ 387 0;
BA_ "GenMsgSendType" BO_ 387 0;
BA_ "VFrameFormat" BO_ 387 14;
BA_ "CANFD_BRS" BO_ 387 1;
BA_ "GenMsgCycleTime" BO_ 387 10;
BA_ "GenMsgCycleTimeFast" BO_ 387 0;
BA_ "GenMsgSendType" BO_ 387 0;
BA_ "VFrameFormat" BO_ 387 14;
BA_ "CANFD_BRS" BO_ 387 1;
BA_ "GenMsgCycleTime" BO_ 387 10;
BA_ "GenMsgCycleTimeFast" BO_ 387 0;
BA_ "GenMsgSendType" BO_ 387 0;
BA_ "VFrameFormat" BO_ 387 14;
BA_ "CANFD_BRS" BO_ 387 1;
BA_ "GenMsgCycleTime" BO_ 387 10;
BA_ "GenMsgCycleTimeFast" BO_ 387 0;
BA_ "GenMsgSendType" BO_ 387 0;
BA_ "VFrameFormat" BO_ 387 14;
BA_ "CANFD_BRS" BO_ 387 1;
BA_ "GenMsgCycleTime" BO_ 783 50;
BA_ "GenMsgCycleTimeFast" BO_ 783 0;
BA_ "GenMsgSendType" BO_ 783 0;
BA_ "VFrameFormat" BO_ 783 14;
BA_ "CANFD_BRS" BO_ 783 1;
BA_ "GenMsgCycleTime" BO_ 783 50;
BA_ "GenMsgCycleTimeFast" BO_ 783 0;
BA_ "GenMsgSendType" BO_ 783 0;
BA_ "VFrameFormat" BO_ 783 14;
BA_ "CANFD_BRS" BO_ 783 1;
BA_ "GenMsgCycleTime" BO_ 783 50;
BA_ "GenMsgCycleTimeFast" BO_ 783 0;
BA_ "GenMsgSendType" BO_ 783 0;
BA_ "VFrameFormat" BO_ 783 14;
BA_ "CANFD_BRS" BO_ 783 1;
BA_ "GenMsgCycleTime" BO_ 783 50;
BA_ "GenMsgCycleTimeFast" BO_ 783 0;
BA_ "GenMsgSendType" BO_ 783 0;
BA_ "VFrameFormat" BO_ 783 14;
BA_ "CANFD_BRS" BO_ 783 1;
BA_ "GenMsgCycleTime" BO_ 783 50;
BA_ "GenMsgCycleTimeFast" BO_ 783 0;
BA_ "GenMsgSendType" BO_ 783 0;
BA_ "VFrameFormat" BO_ 783 14;
BA_ "CANFD_BRS" BO_ 783 1;
BA_ "GenMsgCycleTime" BO_ 783 50;
BA_ "GenMsgCycleTimeFast" BO_ 783 0;
BA_ "GenMsgSendType" BO_ 783 0;
BA_ "VFrameFormat" BO_ 783 14;
BA_ "CANFD_BRS" BO_ 783 1;
BA_ "GenMsgCycleTime" BO_ 783 50;
BA_ "GenMsgCycleTimeFast" BO_ 783 0;
BA_ "GenMsgSendType" BO_ 783 0;
BA_ "VFrameFormat" BO_ 783 14;
BA_ "CANFD_BRS" BO_ 783 1;
BA_ "GenMsgCycleTime" BO_ 783 50;
BA_ "GenMsgCycleTimeFast" BO_ 783 0;
BA_ "GenMsgSendType" BO_ 783 0;
BA_ "VFrameFormat" BO_ 783 14;
BA_ "CANFD_BRS" BO_ 783 1;
BA_ "GenMsgCycleTime" BO_ 783 50;
BA_ "GenMsgCycleTimeFast" BO_ 783 0;
BA_ "GenMsgSendType" BO_ 783 0;
BA_ "VFrameFormat" BO_ 783 14;
BA_ "CANFD_BRS" BO_ 783 1;
BA_ "GenMsgCycleTime" BO_ 783 50;
BA_ "GenMsgCycleTimeFast" BO_ 783 0;
BA_ "GenMsgSendType" BO_ 783 0;
BA_ "VFrameFormat" BO_ 783 14;
BA_ "CANFD_BRS" BO_ 783 1;
BA_ "GenMsgCycleTime" BO_ 783 50;
BA_ "GenMsgCycleTimeFast" BO_ 783 0;
BA_ "GenMsgSendType" BO_ 783 0;
BA_ "VFrameFormat" BO_ 783 14;
BA_ "CANFD_BRS" BO_ 783 1;
BA_ "GenMsgCycleTime" BO_ 783 50;
BA_ "GenMsgCycleTimeFast" BO_ 783 0;
BA_ "GenMsgSendType" BO_ 783 0;
BA_ "VFrameFormat" BO_ 783 14;
BA_ "CANFD_BRS" BO_ 783 1;
BA_ "GenMsgCycleTime" BO_ 783 50;
BA_ "GenMsgCycleTimeFast" BO_ 783 0;
BA_ "GenMsgSendType" BO_ 783 0;
BA_ "VFrameFormat" BO_ 783 14;
BA_ "CANFD_BRS" BO_ 783 1;
BA_ "GenMsgCycleTime" BO_ 783 50;
BA_ "GenMsgCycleTimeFast" BO_ 783 0;
BA_ "GenMsgSendType" BO_ 783 0;
BA_ "VFrameFormat" BO_ 783 14;
BA_ "CANFD_BRS" BO_ 783 1;
BA_ "GenMsgCycleTime" BO_ 783 50;
BA_ "GenMsgCycleTimeFast" BO_ 783 0;
BA_ "GenMsgSendType" BO_ 783 0;
BA_ "VFrameFormat" BO_ 783 14;
BA_ "CANFD_BRS" BO_ 783 1;
BA_ "GenMsgCycleTime" BO_ 783 50;
BA_ "GenMsgCycleTimeFast" BO_ 783 0;
BA_ "GenMsgSendType" BO_ 783 0;
BA_ "VFrameFormat" BO_ 783 14;
BA_ "CANFD_BRS" BO_ 783 1;
BA_ "GenMsgCycleTime" BO_ 783 50;
BA_ "GenMsgCycleTimeFast" BO_ 783 0;
BA_ "GenMsgSendType" BO_ 783 0;
BA_ "VFrameFormat" BO_ 783 14;
BA_ "CANFD_BRS" BO_ 783 1;
BA_ "GenMsgCycleTime" BO_ 783 50;
BA_ "GenMsgCycleTimeFast" BO_ 783 0;
BA_ "GenMsgSendType" BO_ 783 0;
BA_ "VFrameFormat" BO_ 783 14;
BA_ "CANFD_BRS" BO_ 783 1;
BA_ "GenMsgCycleTime" BO_ 783 50;
BA_ "GenMsgCycleTimeFast" BO_ 783 0;
BA_ "GenMsgSendType" BO_ 783 0;
BA_ "VFrameFormat" BO_ 783 14;
BA_ "CANFD_BRS" BO_ 783 1;
BA_ "GenMsgCycleTime" BO_ 783 50;
BA_ "GenMsgCycleTimeFast" BO_ 783 0;
BA_ "GenMsgSendType" BO_ 783 0;
BA_ "VFrameFormat" BO_ 783 14;
BA_ "CANFD_BRS" BO_ 783 1;
BA_ "GenMsgCycleTime" BO_ 783 50;
BA_ "GenMsgCycleTimeFast" BO_ 783 0;
BA_ "GenMsgSendType" BO_ 783 0;
BA_ "VFrameFormat" BO_ 783 14;
BA_ "CANFD_BRS" BO_ 783 1;
BA_ "GenMsgCycleTime" BO_ 783 50;
BA_ "GenMsgCycleTimeFast" BO_ 783 0;
BA_ "GenMsgSendType" BO_ 783 0;
BA_ "VFrameFormat" BO_ 783 14;
BA_ "CANFD_BRS" BO_ 783 1;
BA_ "GenMsgCycleTime" BO_ 783 50;
BA_ "GenMsgCycleTimeFast" BO_ 783 0;
BA_ "GenMsgSendType" BO_ 783 0;
BA_ "VFrameFormat" BO_ 783 14;
BA_ "CANFD_BRS" BO_ 783 1;
BA_ "GenMsgCycleTime" BO_ 783 50;
BA_ "GenMsgCycleTimeFast" BO_ 783 0;
BA_ "GenMsgSendType" BO_ 783 0;
BA_ "VFrameFormat" BO_ 783 14;
BA_ "CANFD_BRS" BO_ 783 1;
BA_ "GenMsgCycleTime" BO_ 783 50;
BA_ "GenMsgCycleTimeFast" BO_ 783 0;
BA_ "GenMsgSendType" BO_ 783 0;
BA_ "VFrameFormat" BO_ 783 14;
BA_ "CANFD_BRS" BO_ 783 1;
BA_ "GenMsgCycleTime" BO_ 783 50;
BA_ "GenMsgCycleTimeFast" BO_ 783 0;
BA_ "GenMsgSendType" BO_ 783 0;
BA_ "VFrameFormat" BO_ 783 14;
BA_ "CANFD_BRS" BO_ 783 1;
BA_ "GenMsgCycleTime" BO_ 783 50;
BA_ "GenMsgCycleTimeFast" BO_ 783 0;
BA_ "GenMsgSendType" BO_ 783 0;
BA_ "VFrameFormat" BO_ 783 14;
BA_ "CANFD_BRS" BO_ 783 1;
BA_ "GenMsgCycleTime" BO_ 783 50;
BA_ "GenMsgCycleTimeFast" BO_ 783 0;
BA_ "GenMsgSendType" BO_ 783 0;
BA_ "VFrameFormat" BO_ 783 14;
BA_ "CANFD_BRS" BO_ 783 1;
BA_ "GenMsgCycleTime" BO_ 783 50;
BA_ "GenMsgCycleTimeFast" BO_ 783 0;
BA_ "GenMsgSendType" BO_ 783 0;
BA_ "VFrameFormat" BO_ 783 14;
BA_ "CANFD_BRS" BO_ 783 1;
BA_ "GenMsgCycleTime" BO_ 783 50;
BA_ "GenMsgCycleTimeFast" BO_ 783 0;
BA_ "GenMsgSendType" BO_ 783 0;
BA_ "VFrameFormat" BO_ 783 14;
BA_ "CANFD_BRS" BO_ 783 1;
BA_ "GenMsgCycleTime" BO_ 783 50;
BA_ "GenMsgCycleTimeFast" BO_ 783 0;
BA_ "GenMsgSendType" BO_ 783 0;
BA_ "VFrameFormat" BO_ 783 14;
BA_ "CANFD_BRS" BO_ 783 1;
BA_ "GenMsgCycleTime" BO_ 783 50;
BA_ "GenMsgCycleTimeFast" BO_ 783 0;
BA_ "GenMsgSendType" BO_ 783 0;
BA_ "VFrameFormat" BO_ 783 14;
BA_ "CANFD_BRS" BO_ 783 1;
BA_ "GenMsgCycleTime" BO_ 783 50;
BA_ "GenMsgCycleTimeFast" BO_ 783 0;
BA_ "GenMsgSendType" BO_ 783 0;
BA_ "VFrameFormat" BO_ 783 14;
BA_ "CANFD_BRS" BO_ 783 1;
BA_ "GenMsgCycleTime" BO_ 783 50;
BA_ "GenMsgCycleTimeFast" BO_ 783 0;
BA_ "GenMsgSendType" BO_ 783 0;
BA_ "VFrameFormat" BO_ 783 14;
BA_ "CANFD_BRS" BO_ 783 1;
BA_ "GenMsgCycleTime" BO_ 783 50;
BA_ "GenMsgCycleTimeFast" BO_ 783 0;
BA_ "GenMsgSendType" BO_ 783 0;
BA_ "VFrameFormat" BO_ 783 14;
BA_ "CANFD_BRS" BO_ 783 1;
BA_ "GenMsgCycleTime" BO_ 783 50;
BA_ "GenMsgCycleTimeFast" BO_ 783 0;
BA_ "GenMsgSendType" BO_ 783 0;
BA_ "VFrameFormat" BO_ 783 14;
BA_ "CANFD_BRS" BO_ 783 1;
BA_ "GenMsgCycleTime" BO_ 783 50;
BA_ "GenMsgCycleTimeFast" BO_ 783 0;
BA_ "GenMsgSendType" BO_ 783 0;
BA_ "VFrameFormat" BO_ 783 14;
BA_ "CANFD_BRS" BO_ 783 1;
BA_ "GenMsgCycleTime" BO_ 783 50;
BA_ "GenMsgCycleTimeFast" BO_ 783 0;
BA_ "GenMsgSendType" BO_ 783 0;
BA_ "VFrameFormat" BO_ 783 14;
BA_ "CANFD_BRS" BO_ 783 1;
BA_ "GenMsgCycleTime" BO_ 783 50;
BA_ "GenMsgCycleTimeFast" BO_ 783 0;
BA_ "GenMsgSendType" BO_ 783 0;
BA_ "VFrameFormat" BO_ 783 14;
BA_ "CANFD_BRS" BO_ 783 1;
BA_ "GenMsgCycleTime" BO_ 783 50;
BA_ "GenMsgCycleTimeFast" BO_ 783 0;
BA_ "GenMsgSendType" BO_ 783 0;
BA_ "VFrameFormat" BO_ 783 14;
BA_ "CANFD_BRS" BO_ 783 1;
BA_ "GenMsgCycleTime" BO_ 783 50;
BA_ "GenMsgCycleTimeFast" BO_ 783 0;
BA_ "GenMsgSendType" BO_ 783 0;
BA_ "VFrameFormat" BO_ 783 14;
BA_ "CANFD_BRS" BO_ 783 1;
BA_ "GenMsgCycleTime" BO_ 783 50;
BA_ "GenMsgCycleTimeFast" BO_ 783 0;
BA_ "GenMsgSendType" BO_ 783 0;
BA_ "VFrameFormat" BO_ 783 14;
BA_ "CANFD_BRS" BO_ 783 1;
BA_ "GenMsgCycleTime" BO_ 783 50;
BA_ "GenMsgCycleTimeFast" BO_ 783 0;
BA_ "GenMsgSendType" BO_ 783 0;
BA_ "VFrameFormat" BO_ 783 14;
BA_ "CANFD_BRS" BO_ 783 1;
BA_ "GenMsgCycleTime" BO_ 783 50;
BA_ "GenMsgCycleTimeFast" BO_ 783 0;
BA_ "GenMsgSendType" BO_ 783 0;
BA_ "VFrameFormat" BO_ 783 14;
BA_ "CANFD_BRS" BO_ 783 1;
BA_ "GenMsgCycleTime" BO_ 783 50;
BA_ "GenMsgCycleTimeFast" BO_ 783 0;
BA_ "GenMsgSendType" BO_ 783 0;
BA_ "VFrameFormat" BO_ 783 14;
BA_ "CANFD_BRS" BO_ 783 1;
BA_ "GenMsgCycleTime" BO_ 783 50;
BA_ "GenMsgCycleTimeFast" BO_ 783 0;
BA_ "GenMsgSendType" BO_ 783 0;
BA_ "VFrameFormat" BO_ 783 14;
BA_ "CANFD_BRS" BO_ 783 1;
BA_ "GenMsgCycleTime" BO_ 659 20;
BA_ "GenMsgCycleTimeFast" BO_ 659 0;
BA_ "GenMsgSendType" BO_ 659 0;
BA_ "VFrameFormat" BO_ 659 14;
BA_ "CANFD_BRS" BO_ 659 1;
BA_ "GenMsgCycleTime" BO_ 659 20;
BA_ "GenMsgCycleTimeFast" BO_ 659 0;
BA_ "GenMsgSendType" BO_ 659 0;
BA_ "VFrameFormat" BO_ 659 14;
BA_ "CANFD_BRS" BO_ 659 1;
BA_ "GenMsgCycleTime" BO_ 659 20;
BA_ "GenMsgCycleTimeFast" BO_ 659 0;
BA_ "GenMsgSendType" BO_ 659 0;
BA_ "VFrameFormat" BO_ 659 14;
BA_ "CANFD_BRS" BO_ 659 1;
BA_ "GenMsgCycleTime" BO_ 659 20;
BA_ "GenMsgCycleTimeFast" BO_ 659 0;
BA_ "GenMsgSendType" BO_ 659 0;
BA_ "VFrameFormat" BO_ 659 14;
BA_ "CANFD_BRS" BO_ 659 1;
BA_ "GenMsgCycleTime" BO_ 659 20;
BA_ "GenMsgCycleTimeFast" BO_ 659 0;
BA_ "GenMsgSendType" BO_ 659 0;
BA_ "VFrameFormat" BO_ 659 14;
BA_ "CANFD_BRS" BO_ 659 1;
BA_ "GenMsgCycleTime" BO_ 659 20;
BA_ "GenMsgCycleTimeFast" BO_ 659 0;
BA_ "GenMsgSendType" BO_ 659 0;
BA_ "VFrameFormat" BO_ 659 14;
BA_ "CANFD_BRS" BO_ 659 1;
BA_ "GenMsgCycleTime" BO_ 659 20;
BA_ "GenMsgCycleTimeFast" BO_ 659 0;
BA_ "GenMsgSendType" BO_ 659 0;
BA_ "VFrameFormat" BO_ 659 14;
BA_ "CANFD_BRS" BO_ 659 1;
BA_ "GenMsgCycleTime" BO_ 659 20;
BA_ "GenMsgCycleTimeFast" BO_ 659 0;
BA_ "GenMsgSendType" BO_ 659 0;
BA_ "VFrameFormat" BO_ 659 14;
BA_ "CANFD_BRS" BO_ 659 1;
BA_ "GenMsgCycleTime" BO_ 659 20;
BA_ "GenMsgCycleTimeFast" BO_ 659 0;
BA_ "GenMsgSendType" BO_ 659 0;
BA_ "VFrameFormat" BO_ 659 14;
BA_ "CANFD_BRS" BO_ 659 1;
BA_ "GenMsgCycleTime" BO_ 659 20;
BA_ "GenMsgCycleTimeFast" BO_ 659 0;
BA_ "GenMsgSendType" BO_ 659 0;
BA_ "VFrameFormat" BO_ 659 14;
BA_ "CANFD_BRS" BO_ 659 1;
BA_ "GenMsgCycleTime" BO_ 659 20;
BA_ "GenMsgCycleTimeFast" BO_ 659 0;
BA_ "GenMsgSendType" BO_ 659 0;
BA_ "VFrameFormat" BO_ 659 14;
BA_ "CANFD_BRS" BO_ 659 1;
BA_ "GenMsgCycleTime" BO_ 659 20;
BA_ "GenMsgCycleTimeFast" BO_ 659 0;
BA_ "GenMsgSendType" BO_ 659 0;
BA_ "VFrameFormat" BO_ 659 14;
BA_ "CANFD_BRS" BO_ 659 1;
BA_ "GenMsgCycleTime" BO_ 659 20;
BA_ "GenMsgCycleTimeFast" BO_ 659 0;
BA_ "GenMsgSendType" BO_ 659 0;
BA_ "VFrameFormat" BO_ 659 14;
BA_ "CANFD_BRS" BO_ 659 1;
BA_ "GenMsgCycleTime" BO_ 659 20;
BA_ "GenMsgCycleTimeFast" BO_ 659 0;
BA_ "GenMsgSendType" BO_ 659 0;
BA_ "VFrameFormat" BO_ 659 14;
BA_ "CANFD_BRS" BO_ 659 1;
BA_ "GenMsgCycleTime" BO_ 659 20;
BA_ "GenMsgCycleTimeFast" BO_ 659 0;
BA_ "GenMsgSendType" BO_ 659 0;
BA_ "VFrameFormat" BO_ 659 14;
BA_ "CANFD_BRS" BO_ 659 1;
BA_ "GenMsgCycleTime" BO_ 659 20;
BA_ "GenMsgCycleTimeFast" BO_ 659 0;
BA_ "GenMsgSendType" BO_ 659 0;
BA_ "VFrameFormat" BO_ 659 14;
BA_ "CANFD_BRS" BO_ 659 1;
BA_ "GenMsgCycleTime" BO_ 659 20;
BA_ "GenMsgCycleTimeFast" BO_ 659 0;
BA_ "GenMsgSendType" BO_ 659 0;
BA_ "VFrameFormat" BO_ 659 14;
BA_ "CANFD_BRS" BO_ 659 1;
BA_ "GenMsgCycleTime" BO_ 659 20;
BA_ "GenMsgCycleTimeFast" BO_ 659 0;
BA_ "GenMsgSendType" BO_ 659 0;
BA_ "VFrameFormat" BO_ 659 14;
BA_ "CANFD_BRS" BO_ 659 1;
BA_ "GenMsgCycleTime" BO_ 659 20;
BA_ "GenMsgCycleTimeFast" BO_ 659 0;
BA_ "GenMsgSendType" BO_ 659 0;
BA_ "VFrameFormat" BO_ 659 14;
BA_ "CANFD_BRS" BO_ 659 1;
BA_ "GenMsgCycleTime" BO_ 659 20;
BA_ "GenMsgCycleTimeFast" BO_ 659 0;
BA_ "GenMsgSendType" BO_ 659 0;
BA_ "VFrameFormat" BO_ 659 14;
BA_ "CANFD_BRS" BO_ 659 1;
BA_ "GenMsgCycleTime" BO_ 659 20;
BA_ "GenMsgCycleTimeFast" BO_ 659 0;
BA_ "GenMsgSendType" BO_ 659 0;
BA_ "VFrameFormat" BO_ 659 14;
BA_ "CANFD_BRS" BO_ 659 1;
BA_ "GenMsgCycleTime" BO_ 659 20;
BA_ "GenMsgCycleTimeFast" BO_ 659 0;
BA_ "GenMsgSendType" BO_ 659 0;
BA_ "VFrameFormat" BO_ 659 14;
BA_ "CANFD_BRS" BO_ 659 1;
BA_ "GenMsgCycleTime" BO_ 659 20;
BA_ "GenMsgCycleTimeFast" BO_ 659 0;
BA_ "GenMsgSendType" BO_ 659 0;
BA_ "VFrameFormat" BO_ 659 14;
BA_ "CANFD_BRS" BO_ 659 1;
BA_ "GenMsgCycleTime" BO_ 659 20;
BA_ "GenMsgCycleTimeFast" BO_ 659 0;
BA_ "GenMsgSendType" BO_ 659 0;
BA_ "VFrameFormat" BO_ 659 14;
BA_ "CANFD_BRS" BO_ 659 1;
BA_ "GenMsgCycleTime" BO_ 659 20;
BA_ "GenMsgCycleTimeFast" BO_ 659 0;
BA_ "GenMsgSendType" BO_ 659 0;
BA_ "VFrameFormat" BO_ 659 14;
BA_ "CANFD_BRS" BO_ 659 1;
BA_ "GenMsgCycleTime" BO_ 659 20;
BA_ "GenMsgCycleTimeFast" BO_ 659 0;
BA_ "GenMsgSendType" BO_ 659 0;
BA_ "VFrameFormat" BO_ 659 14;
BA_ "CANFD_BRS" BO_ 659 1;
BA_ "GenMsgCycleTime" BO_ 659 20;
BA_ "GenMsgCycleTimeFast" BO_ 659 0;
BA_ "GenMsgSendType" BO_ 659 0;
BA_ "VFrameFormat" BO_ 659 14;
BA_ "CANFD_BRS" BO_ 659 1;
BA_ "GenMsgCycleTime" BO_ 659 20;
BA_ "GenMsgCycleTimeFast" BO_ 659 0;
BA_ "GenMsgSendType" BO_ 659 0;
BA_ "VFrameFormat" BO_ 659 14;
BA_ "CANFD_BRS" BO_ 659 1;
BA_ "GenMsgCycleTime" BO_ 659 20;
BA_ "GenMsgCycleTimeFast" BO_ 659 0;
BA_ "GenMsgSendType" BO_ 659 0;
BA_ "VFrameFormat" BO_ 659 14;
BA_ "CANFD_BRS" BO_ 659 1;
BA_ "GenMsgCycleTime" BO_ 659 20;
BA_ "GenMsgCycleTimeFast" BO_ 659 0;
BA_ "GenMsgSendType" BO_ 659 0;
BA_ "VFrameFormat" BO_ 659 14;
BA_ "CANFD_BRS" BO_ 659 1;
BA_ "GenMsgCycleTime" BO_ 659 20;
BA_ "GenMsgCycleTimeFast" BO_ 659 0;
BA_ "GenMsgSendType" BO_ 659 0;
BA_ "VFrameFormat" BO_ 659 14;
BA_ "CANFD_BRS" BO_ 659 1;
BA_ "GenMsgCycleTime" BO_ 659 20;
BA_ "GenMsgCycleTimeFast" BO_ 659 0;
BA_ "GenMsgSendType" BO_ 659 0;
BA_ "VFrameFormat" BO_ 659 14;
BA_ "CANFD_BRS" BO_ 659 1;
BA_ "GenMsgCycleTime" BO_ 659 20;
BA_ "GenMsgCycleTimeFast" BO_ 659 0;
BA_ "GenMsgSendType" BO_ 659 0;
BA_ "VFrameFormat" BO_ 659 14;
BA_ "CANFD_BRS" BO_ 659 1;
BA_ "GenMsgCycleTime" BO_ 659 20;
BA_ "GenMsgCycleTimeFast" BO_ 659 0;
BA_ "GenMsgSendType" BO_ 659 0;
BA_ "VFrameFormat" BO_ 659 14;
BA_ "CANFD_BRS" BO_ 659 1;
BA_ "GenMsgCycleTime" BO_ 659 20;
BA_ "GenMsgCycleTimeFast" BO_ 659 0;
BA_ "GenMsgSendType" BO_ 659 0;
BA_ "VFrameFormat" BO_ 659 14;
BA_ "CANFD_BRS" BO_ 659 1;
BA_ "GenMsgCycleTime" BO_ 659 20;
BA_ "GenMsgCycleTimeFast" BO_ 659 0;
BA_ "GenMsgSendType" BO_ 659 0;
BA_ "VFrameFormat" BO_ 659 14;
BA_ "CANFD_BRS" BO_ 659 1;
BA_ "GenMsgCycleTime" BO_ 659 20;
BA_ "GenMsgCycleTimeFast" BO_ 659 0;
BA_ "GenMsgSendType" BO_ 659 0;
BA_ "VFrameFormat" BO_ 659 14;
BA_ "CANFD_BRS" BO_ 659 1;
BA_ "GenMsgCycleTime" BO_ 659 20;
BA_ "GenMsgCycleTimeFast" BO_ 659 0;
BA_ "GenMsgSendType" BO_ 659 0;
BA_ "VFrameFormat" BO_ 659 14;
BA_ "CANFD_BRS" BO_ 659 1;
BA_ "GenMsgCycleTime" BO_ 659 20;
BA_ "GenMsgCycleTimeFast" BO_ 659 0;
BA_ "GenMsgSendType" BO_ 659 0;
BA_ "VFrameFormat" BO_ 659 14;
BA_ "CANFD_BRS" BO_ 659 1;
BA_ "GenMsgCycleTime" BO_ 659 20;
BA_ "GenMsgCycleTimeFast" BO_ 659 0;
BA_ "GenMsgSendType" BO_ 659 0;
BA_ "VFrameFormat" BO_ 659 14;
BA_ "CANFD_BRS" BO_ 659 1;
BA_ "GenMsgCycleTime" BO_ 659 20;
BA_ "GenMsgCycleTimeFast" BO_ 659 0;
BA_ "GenMsgSendType" BO_ 659 0;
BA_ "VFrameFormat" BO_ 659 14;
BA_ "CANFD_BRS" BO_ 659 1;
BA_ "GenMsgCycleTime" BO_ 659 20;
BA_ "GenMsgCycleTimeFast" BO_ 659 0;
BA_ "GenMsgSendType" BO_ 659 0;
BA_ "VFrameFormat" BO_ 659 14;
BA_ "CANFD_BRS" BO_ 659 1;
BA_ "GenMsgCycleTime" BO_ 659 20;
BA_ "GenMsgCycleTimeFast" BO_ 659 0;
BA_ "GenMsgSendType" BO_ 659 0;
BA_ "VFrameFormat" BO_ 659 14;
BA_ "CANFD_BRS" BO_ 659 1;
BA_ "GenMsgCycleTime" BO_ 659 20;
BA_ "GenMsgCycleTimeFast" BO_ 659 0;
BA_ "GenMsgSendType" BO_ 659 0;
BA_ "VFrameFormat" BO_ 659 14;
BA_ "CANFD_BRS" BO_ 659 1;
BA_ "GenMsgCycleTime" BO_ 923 100;
BA_ "GenMsgCycleTimeFast" BO_ 923 0;
BA_ "GenMsgSendType" BO_ 923 0;
BA_ "VFrameFormat" BO_ 923 14;
BA_ "CANFD_BRS" BO_ 923 1;
BA_ "GenMsgCycleTime" BO_ 923 100;
BA_ "GenMsgCycleTimeFast" BO_ 923 0;
BA_ "GenMsgSendType" BO_ 923 0;
BA_ "VFrameFormat" BO_ 923 14;
BA_ "CANFD_BRS" BO_ 923 1;
BA_ "GenMsgCycleTime" BO_ 923 100;
BA_ "GenMsgCycleTimeFast" BO_ 923 0;
BA_ "GenMsgSendType" BO_ 923 0;
BA_ "VFrameFormat" BO_ 923 14;
BA_ "CANFD_BRS" BO_ 923 1;
BA_ "GenMsgCycleTime" BO_ 923 100;
BA_ "GenMsgCycleTimeFast" BO_ 923 0;
BA_ "GenMsgSendType" BO_ 923 0;
BA_ "VFrameFormat" BO_ 923 14;
BA_ "CANFD_BRS" BO_ 923 1;
BA_ "GenMsgCycleTime" BO_ 923 100;
BA_ "GenMsgCycleTimeFast" BO_ 923 0;
BA_ "GenMsgSendType" BO_ 923 0;
BA_ "VFrameFormat" BO_ 923 14;
BA_ "CANFD_BRS" BO_ 923 1;
BA_ "GenMsgCycleTime" BO_ 923 100;
BA_ "GenMsgCycleTimeFast" BO_ 923 0;
BA_ "GenMsgSendType" BO_ 923 0;
BA_ "VFrameFormat" BO_ 923 14;
BA_ "CANFD_BRS" BO_ 923 1;
BA_ "GenMsgCycleTime" BO_ 923 100;
BA_ "GenMsgCycleTimeFast" BO_ 923 0;
BA_ "GenMsgSendType" BO_ 923 0;
BA_ "VFrameFormat" BO_ 923 14;
BA_ "CANFD_BRS" BO_ 923 1;
BA_ "GenMsgCycleTime" BO_ 923 100;
BA_ "GenMsgCycleTimeFast" BO_ 923 0;
BA_ "GenMsgSendType" BO_ 923 0;
BA_ "VFrameFormat" BO_ 923 14;
BA_ "CANFD_BRS" BO_ 923 1;
BA_ "GenMsgCycleTime" BO_ 923 100;
BA_ "GenMsgCycleTimeFast" BO_ 923 0;
BA_ "GenMsgSendType" BO_ 923 0;
BA_ "VFrameFormat" BO_ 923 14;
BA_ "CANFD_BRS" BO_ 923 1;
BA_ "GenMsgCycleTime" BO_ 923 100;
BA_ "GenMsgCycleTimeFast" BO_ 923 0;
BA_ "GenMsgSendType" BO_ 923 0;
BA_ "VFrameFormat" BO_ 923 14;
BA_ "CANFD_BRS" BO_ 923 1;
BA_ "GenMsgCycleTime" BO_ 923 100;
BA_ "GenMsgCycleTimeFast" BO_ 923 0;
BA_ "GenMsgSendType" BO_ 923 0;
BA_ "VFrameFormat" BO_ 923 14;
BA_ "CANFD_BRS" BO_ 923 1;
BA_ "GenMsgCycleTime" BO_ 923 100;
BA_ "GenMsgCycleTimeFast" BO_ 923 0;
BA_ "GenMsgSendType" BO_ 923 0;
BA_ "VFrameFormat" BO_ 923 14;
BA_ "CANFD_BRS" BO_ 923 1;
BA_ "GenMsgCycleTime" BO_ 923 100;
BA_ "GenMsgCycleTimeFast" BO_ 923 0;
BA_ "GenMsgSendType" BO_ 923 0;
BA_ "VFrameFormat" BO_ 923 14;
BA_ "CANFD_BRS" BO_ 923 1;
BA_ "GenMsgCycleTime" BO_ 923 100;
BA_ "GenMsgCycleTimeFast" BO_ 923 0;
BA_ "GenMsgSendType" BO_ 923 0;
BA_ "VFrameFormat" BO_ 923 14;
BA_ "CANFD_BRS" BO_ 923 1;
BA_ "GenMsgCycleTime" BO_ 923 100;
BA_ "GenMsgCycleTimeFast" BO_ 923 0;
BA_ "GenMsgSendType" BO_ 923 0;
BA_ "VFrameFormat" BO_ 923 14;
BA_ "CANFD_BRS" BO_ 923 1;
BA_ "GenMsgCycleTime" BO_ 923 100;
BA_ "GenMsgCycleTimeFast" BO_ 923 0;
BA_ "GenMsgSendType" BO_ 923 0;
BA_ "VFrameFormat" BO_ 923 14;
BA_ "CANFD_BRS" BO_ 923 1;
BA_ "GenMsgCycleTime" BO_ 923 100;
BA_ "GenMsgCycleTimeFast" BO_ 923 0;
BA_ "GenMsgSendType" BO_ 923 0;
BA_ "VFrameFormat" BO_ 923 14;
BA_ "CANFD_BRS" BO_ 923 1;
BA_ "GenMsgCycleTime" BO_ 923 100;
BA_ "GenMsgCycleTimeFast" BO_ 923 0;
BA_ "GenMsgSendType" BO_ 923 0;
BA_ "VFrameFormat" BO_ 923 14;
BA_ "CANFD_BRS" BO_ 923 1;
BA_ "GenMsgCycleTime" BO_ 923 100;
BA_ "GenMsgCycleTimeFast" BO_ 923 0;
BA_ "GenMsgSendType" BO_ 923 0;
BA_ "VFrameFormat" BO_ 923 14;
BA_ "CANFD_BRS" BO_ 923 1;
BA_ "GenMsgCycleTime" BO_ 923 100;
BA_ "GenMsgCycleTimeFast" BO_ 923 0;
BA_ "GenMsgSendType" BO_ 923 0;
BA_ "VFrameFormat" BO_ 923 14;
BA_ "CANFD_BRS" BO_ 923 1;
BA_ "GenMsgCycleTime" BO_ 923 100;
BA_ "GenMsgCycleTimeFast" BO_ 923 0;
BA_ "GenMsgSendType" BO_ 923 0;
BA_ "VFrameFormat" BO_ 923 14;
BA_ "CANFD_BRS" BO_ 923 1;
BA_ "GenMsgCycleTime" BO_ 923 100;
BA_ "GenMsgCycleTimeFast" BO_ 923 0;
BA_ "GenMsgSendType" BO_ 923 0;
BA_ "VFrameFormat" BO_ 923 14;
BA_ "CANFD_BRS" BO_ 923 1;
BA_ "GenMsgCycleTime" BO_ 923 100;
BA_ "GenMsgCycleTimeFast" BO_ 923 0;
BA_ "GenMsgSendType" BO_ 923 0;
BA_ "VFrameFormat" BO_ 923 14;
BA_ "CANFD_BRS" BO_ 923 1;
BA_ "GenMsgCycleTime" BO_ 923 100;
BA_ "GenMsgCycleTimeFast" BO_ 923 0;
BA_ "GenMsgSendType" BO_ 923 0;
BA_ "VFrameFormat" BO_ 923 14;
BA_ "CANFD_BRS" BO_ 923 1;
BA_ "GenMsgCycleTime" BO_ 923 100;
BA_ "GenMsgCycleTimeFast" BO_ 923 0;
BA_ "GenMsgSendType" BO_ 923 0;
BA_ "VFrameFormat" BO_ 923 14;
BA_ "CANFD_BRS" BO_ 923 1;
BA_ "GenMsgCycleTime" BO_ 923 100;
BA_ "GenMsgCycleTimeFast" BO_ 923 0;
BA_ "GenMsgSendType" BO_ 923 0;
BA_ "VFrameFormat" BO_ 923 14;
BA_ "CANFD_BRS" BO_ 923 1;
BA_ "GenMsgCycleTime" BO_ 923 100;
BA_ "GenMsgCycleTimeFast" BO_ 923 0;
BA_ "GenMsgSendType" BO_ 923 0;
BA_ "VFrameFormat" BO_ 923 14;
BA_ "CANFD_BRS" BO_ 923 1;
BA_ "GenMsgCycleTime" BO_ 923 100;
BA_ "GenMsgCycleTimeFast" BO_ 923 0;
BA_ "GenMsgSendType" BO_ 923 0;
BA_ "VFrameFormat" BO_ 923 14;
BA_ "CANFD_BRS" BO_ 923 1;
BA_ "GenMsgCycleTime" BO_ 923 100;
BA_ "GenMsgCycleTimeFast" BO_ 923 0;
BA_ "GenMsgSendType" BO_ 923 0;
BA_ "VFrameFormat" BO_ 923 14;
BA_ "CANFD_BRS" BO_ 923 1;
BA_ "GenMsgCycleTime" BO_ 923 100;
BA_ "GenMsgCycleTimeFast" BO_ 923 0;
BA_ "GenMsgSendType" BO_ 923 0;
BA_ "VFrameFormat" BO_ 923 14;
BA_ "CANFD_BRS" BO_ 923 1;
BA_ "GenMsgCycleTime" BO_ 923 100;
BA_ "GenMsgCycleTimeFast" BO_ 923 0;
BA_ "GenMsgSendType" BO_ 923 0;
BA_ "VFrameFormat" BO_ 923 14;
BA_ "CANFD_BRS" BO_ 923 1;
BA_ "GenMsgCycleTime" BO_ 923 100;
BA_ "GenMsgCycleTimeFast" BO_ 923 0;
BA_ "GenMsgSendType" BO_ 923 0;
BA_ "VFrameFormat" BO_ 923 14;
BA_ "CANFD_BRS" BO_ 923 1;
BA_ "GenMsgCycleTime" BO_ 923 100;
BA_ "GenMsgCycleTimeFast" BO_ 923 0;
BA_ "GenMsgSendType" BO_ 923 0;
BA_ "VFrameFormat" BO_ 923 14;
BA_ "CANFD_BRS" BO_ 923 1;
BA_ "GenMsgCycleTime" BO_ 923 100;
BA_ "GenMsgCycleTimeFast" BO_ 923 0;
BA_ "GenMsgSendType" BO_ 923 0;
BA_ "VFrameFormat" BO_ 923 14;
BA_ "CANFD_BRS" BO_ 923 1;
BA_ "GenMsgCycleTime" BO_ 923 100;
BA_ "GenMsgCycleTimeFast" BO_ 923 0;
BA_ "GenMsgSendType" BO_ 923 0;
BA_ "VFrameFormat" BO_ 923 14;
BA_ "CANFD_BRS" BO_ 923 1;
BA_ "GenMsgCycleTime" BO_ 923 100;
BA_ "GenMsgCycleTimeFast" BO_ 923 0;
BA_ "GenMsgSendType" BO_ 923 0;
BA_ "VFrameFormat" BO_ 923 14;
BA_ "CANFD_BRS" BO_ 923 1;
BA_ "GenMsgCycleTime" BO_ 923 100;
BA_ "GenMsgCycleTimeFast" BO_ 923 0;
BA_ "GenMsgSendType" BO_ 923 0;
BA_ "VFrameFormat" BO_ 923 14;
BA_ "CANFD_BRS" BO_ 923 1;
BA_ "GenMsgCycleTime" BO_ 923 100;
BA_ "GenMsgCycleTimeFast" BO_ 923 0;
BA_ "GenMsgSendType" BO_ 923 0;
BA_ "VFrameFormat" BO_ 923 14;
BA_ "CANFD_BRS" BO_ 923 1;
BA_ "GenMsgCycleTime" BO_ 923 100;
BA_ "GenMsgCycleTimeFast" BO_ 923 0;
BA_ "GenMsgSendType" BO_ 923 0;
BA_ "VFrameFormat" BO_ 923 14;
BA_ "CANFD_BRS" BO_ 923 1;
BA_ "GenMsgCycleTime" BO_ 923 100;
BA_ "GenMsgCycleTimeFast" BO_ 923 0;
BA_ "GenMsgSendType" BO_ 923 0;
BA_ "VFrameFormat" BO_ 923 14;
BA_ "CANFD_BRS" BO_ 923 1;
BA_ "GenMsgCycleTime" BO_ 923 100;
BA_ "GenMsgCycleTimeFast" BO_ 923 0;
BA_ "GenMsgSendType" BO_ 923 0;
BA_ "VFrameFormat" BO_ 923 14;
BA_ "CANFD_BRS" BO_ 923 1;
BA_ "GenMsgCycleTime" BO_ 923 100;
BA_ "GenMsgCycleTimeFast" BO_ 923 0;
BA_ "GenMsgSendType" BO_ 923 0;
BA_ "VFrameFormat" BO_ 923 14;
BA_ "CANFD_BRS" BO_ 923 1;
BA_ "EventCommandSignal" SG_ 387 ADC_4_New_CRC 0;
BA_ "GatewayedSignals" SG_ 387 ADC_4_New_CRC 0;
BA_ "GenSigInactiveValue" SG_ 387 ADC_4_New_CRC 0;
BA_ "GenSigInvalidValue" SG_ 387 ADC_4_New_CRC 0;
BA_ "GenSigSendType" SG_ 387 ADC_4_New_CRC 1;
BA_ "GenSigStartValue" SG_ 387 ADC_4_New_CRC 0;
BA_ "GenSigTimeoutValue" SG_ 387 ADC_4_New_CRC 0;
BA_ "Remark" SG_ 387 ADC_4_New_CRC "";
BA_ "EventCommandSignal" SG_ 387 ADC_4_New_Counter 0;
BA_ "GatewayedSignals" SG_ 387 ADC_4_New_Counter 0;
BA_ "GenSigInactiveValue" SG_ 387 ADC_4_New_Counter 0;
BA_ "GenSigInvalidValue" SG_ 387 ADC_4_New_Counter 0;
BA_ "GenSigSendType" SG_ 387 ADC_4_New_Counter 1;
BA_ "GenSigStartValue" SG_ 387 ADC_4_New_Counter 0;
BA_ "GenSigTimeoutValue" SG_ 387 ADC_4_New_Counter 0;
BA_ "Remark" SG_ 387 ADC_4_New_Counter "";
BA_ "EventCommandSignal" SG_ 387 ADC_AngReqSt_A 0;
BA_ "GatewayedSignals" SG_ 387 ADC_AngReqSt_A 0;
BA_ "GenSigInactiveValue" SG_ 387 ADC_AngReqSt_A 0;
BA_ "GenSigInvalidValue" SG_ 387 ADC_AngReqSt_A 0;
BA_ "GenSigSendType" SG_ 387 ADC_AngReqSt_A 1;
BA_ "GenSigStartValue" SG_ 387 ADC_AngReqSt_A 0;
BA_ "GenSigTimeoutValue" SG_ 387 ADC_AngReqSt_A 0;
BA_ "Remark" SG_ 387 ADC_AngReqSt_A "";
BA_ "EventCommandSignal" SG_ 387 ADC_AngReqFunction 0;
BA_ "GatewayedSignals" SG_ 387 ADC_AngReqFunction 0;
BA_ "GenSigInactiveValue" SG_ 387 ADC_AngReqFunction 0;
BA_ "GenSigInvalidValue" SG_ 387 ADC_AngReqFunction 0;
BA_ "GenSigSendType" SG_ 387 ADC_AngReqFunction 1;
BA_ "GenSigStartValue" SG_ 387 ADC_AngReqFunction 0;
BA_ "GenSigTimeoutValue" SG_ 387 ADC_AngReqFunction 0;
BA_ "Remark" SG_ 387 ADC_AngReqFunction "";
BA_ "EventCommandSignal" SG_ 387 ADC_BrakeLightReq 0;
BA_ "GatewayedSignals" SG_ 387 ADC_BrakeLightReq 0;
BA_ "GenSigInactiveValue" SG_ 387 ADC_BrakeLightReq 0;
BA_ "GenSigInvalidValue" SG_ 387 ADC_BrakeLightReq 0;
BA_ "GenSigSendType" SG_ 387 ADC_BrakeLightReq 1;
BA_ "GenSigStartValue" SG_ 387 ADC_BrakeLightReq 0;
BA_ "GenSigTimeoutValue" SG_ 387 ADC_BrakeLightReq 0;
BA_ "Remark" SG_ 387 ADC_BrakeLightReq "";
BA_ "EventCommandSignal" SG_ 387 ADC_StrAngleReq_A 0;
BA_ "GatewayedSignals" SG_ 387 ADC_StrAngleReq_A 0;
BA_ "GenSigInactiveValue" SG_ 387 ADC_StrAngleReq_A 0;
BA_ "GenSigInvalidValue" SG_ 387 ADC_StrAngleReq_A 65535;
BA_ "GenSigSendType" SG_ 387 ADC_StrAngleReq_A 1;
BA_ "GenSigStartValue" SG_ 387 ADC_StrAngleReq_A 7800;
BA_ "GenSigTimeoutValue" SG_ 387 ADC_StrAngleReq_A 65535;
BA_ "Remark" SG_ 387 ADC_StrAngleReq_A "";
BA_ "EventCommandSignal" SG_ 387 ADC_SACMotorTorLimExtMax_A 0;
BA_ "GatewayedSignals" SG_ 387 ADC_SACMotorTorLimExtMax_A 0;
BA_ "GenSigInactiveValue" SG_ 387 ADC_SACMotorTorLimExtMax_A 0;
BA_ "GenSigInvalidValue" SG_ 387 ADC_SACMotorTorLimExtMax_A 255;
BA_ "GenSigSendType" SG_ 387 ADC_SACMotorTorLimExtMax_A 1;
BA_ "GenSigStartValue" SG_ 387 ADC_SACMotorTorLimExtMax_A 254;
BA_ "GenSigTimeoutValue" SG_ 387 ADC_SACMotorTorLimExtMax_A 255;
BA_ "Remark" SG_ 387 ADC_SACMotorTorLimExtMax_A "";
BA_ "EventCommandSignal" SG_ 387 ADC_SACMotorTorLimExtMin_A 0;
BA_ "GatewayedSignals" SG_ 387 ADC_SACMotorTorLimExtMin_A 0;
BA_ "GenSigInactiveValue" SG_ 387 ADC_SACMotorTorLimExtMin_A 0;
BA_ "GenSigInvalidValue" SG_ 387 ADC_SACMotorTorLimExtMin_A 0;
BA_ "GenSigSendType" SG_ 387 ADC_SACMotorTorLimExtMin_A 1;
BA_ "GenSigStartValue" SG_ 387 ADC_SACMotorTorLimExtMin_A 0;
BA_ "GenSigTimeoutValue" SG_ 387 ADC_SACMotorTorLimExtMin_A 255;
BA_ "Remark" SG_ 387 ADC_SACMotorTorLimExtMin_A "";
BA_ "EventCommandSignal" SG_ 387 ADC_AssistParaSwitchReq 0;
BA_ "GatewayedSignals" SG_ 387 ADC_AssistParaSwitchReq 0;
BA_ "GenSigInactiveValue" SG_ 387 ADC_AssistParaSwitchReq 0;
BA_ "GenSigInvalidValue" SG_ 387 ADC_AssistParaSwitchReq 0;
BA_ "GenSigSendType" SG_ 387 ADC_AssistParaSwitchReq 1;
BA_ "GenSigStartValue" SG_ 387 ADC_AssistParaSwitchReq 0;
BA_ "GenSigTimeoutValue" SG_ 387 ADC_AssistParaSwitchReq 0;
BA_ "Remark" SG_ 387 ADC_AssistParaSwitchReq "";
BA_ "EventCommandSignal" SG_ 387 ADC_SteerGainReq 0;
BA_ "GatewayedSignals" SG_ 387 ADC_SteerGainReq 0;
BA_ "GenSigInactiveValue" SG_ 387 ADC_SteerGainReq 0;
BA_ "GenSigInvalidValue" SG_ 387 ADC_SteerGainReq 0;
BA_ "GenSigSendType" SG_ 387 ADC_SteerGainReq 1;
BA_ "GenSigStartValue" SG_ 387 ADC_SteerGainReq 0;
BA_ "GenSigTimeoutValue" SG_ 387 ADC_SteerGainReq 0;
BA_ "Remark" SG_ 387 ADC_SteerGainReq "";
BA_ "EventCommandSignal" SG_ 387 ADC_StrgWhlVibrWarnLevel 0;
BA_ "GatewayedSignals" SG_ 387 ADC_StrgWhlVibrWarnLevel 0;
BA_ "GenSigInactiveValue" SG_ 387 ADC_StrgWhlVibrWarnLevel 0;
BA_ "GenSigInvalidValue" SG_ 387 ADC_StrgWhlVibrWarnLevel 0;
BA_ "GenSigSendType" SG_ 387 ADC_StrgWhlVibrWarnLevel 1;
BA_ "GenSigStartValue" SG_ 387 ADC_StrgWhlVibrWarnLevel 0;
BA_ "GenSigTimeoutValue" SG_ 387 ADC_StrgWhlVibrWarnLevel 0;
BA_ "Remark" SG_ 387 ADC_StrgWhlVibrWarnLevel "";
BA_ "EventCommandSignal" SG_ 387 ADC_ActTrqReqEnable 0;
BA_ "GatewayedSignals" SG_ 387 ADC_ActTrqReqEnable 0;
BA_ "GenSigInactiveValue" SG_ 387 ADC_ActTrqReqEnable 0;
BA_ "GenSigInvalidValue" SG_ 387 ADC_ActTrqReqEnable 0;
BA_ "GenSigSendType" SG_ 387 ADC_ActTrqReqEnable 1;
BA_ "GenSigStartValue" SG_ 387 ADC_ActTrqReqEnable 0;
BA_ "GenSigTimeoutValue" SG_ 387 ADC_ActTrqReqEnable 0;
BA_ "Remark" SG_ 387 ADC_ActTrqReqEnable "";
BA_ "EventCommandSignal" SG_ 387 ADC_SteerGainLevel 0;
BA_ "GatewayedSignals" SG_ 387 ADC_SteerGainLevel 0;
BA_ "GenSigInactiveValue" SG_ 387 ADC_SteerGainLevel 0;
BA_ "GenSigInvalidValue" SG_ 387 ADC_SteerGainLevel 0;
BA_ "GenSigSendType" SG_ 387 ADC_SteerGainLevel 1;
BA_ "GenSigStartValue" SG_ 387 ADC_SteerGainLevel 0;
BA_ "GenSigTimeoutValue" SG_ 387 ADC_SteerGainLevel 100;
BA_ "Remark" SG_ 387 ADC_SteerGainLevel "";
BA_ "EventCommandSignal" SG_ 387 ADC_EvsSteerReq 0;
BA_ "GatewayedSignals" SG_ 387 ADC_EvsSteerReq 0;
BA_ "GenSigInactiveValue" SG_ 387 ADC_EvsSteerReq 0;
BA_ "GenSigInvalidValue" SG_ 387 ADC_EvsSteerReq 0;
BA_ "GenSigSendType" SG_ 387 ADC_EvsSteerReq 1;
BA_ "GenSigStartValue" SG_ 387 ADC_EvsSteerReq 0;
BA_ "GenSigTimeoutValue" SG_ 387 ADC_EvsSteerReq 0;
BA_ "Remark" SG_ 387 ADC_EvsSteerReq "";
BA_ "EventCommandSignal" SG_ 387 ADC_StrgWhlVibrWarnReq 0;
BA_ "GatewayedSignals" SG_ 387 ADC_StrgWhlVibrWarnReq 0;
BA_ "GenSigInactiveValue" SG_ 387 ADC_StrgWhlVibrWarnReq 0;
BA_ "GenSigInvalidValue" SG_ 387 ADC_StrgWhlVibrWarnReq 0;
BA_ "GenSigSendType" SG_ 387 ADC_StrgWhlVibrWarnReq 1;
BA_ "GenSigStartValue" SG_ 387 ADC_StrgWhlVibrWarnReq 0;
BA_ "GenSigTimeoutValue" SG_ 387 ADC_StrgWhlVibrWarnReq 0;
BA_ "Remark" SG_ 387 ADC_StrgWhlVibrWarnReq "";
BA_ "EventCommandSignal" SG_ 387 ADC_ActTrqReq 0;
BA_ "GatewayedSignals" SG_ 387 ADC_ActTrqReq 0;
BA_ "GenSigInactiveValue" SG_ 387 ADC_ActTrqReq 0;
BA_ "GenSigInvalidValue" SG_ 387 ADC_ActTrqReq 0;
BA_ "GenSigSendType" SG_ 387 ADC_ActTrqReq 1;
BA_ "GenSigStartValue" SG_ 387 ADC_ActTrqReq 0;
BA_ "GenSigTimeoutValue" SG_ 387 ADC_ActTrqReq 0;
BA_ "Remark" SG_ 387 ADC_ActTrqReq "";
BA_ "EventCommandSignal" SG_ 387 ADC_DrvTarTqMod2EPB 0;
BA_ "GatewayedSignals" SG_ 387 ADC_DrvTarTqMod2EPB 0;
BA_ "GenSigInactiveValue" SG_ 387 ADC_DrvTarTqMod2EPB 0;
BA_ "GenSigInvalidValue" SG_ 387 ADC_DrvTarTqMod2EPB 0;
BA_ "GenSigSendType" SG_ 387 ADC_DrvTarTqMod2EPB 1;
BA_ "GenSigStartValue" SG_ 387 ADC_DrvTarTqMod2EPB 0;
BA_ "GenSigTimeoutValue" SG_ 387 ADC_DrvTarTqMod2EPB 0;
BA_ "Remark" SG_ 387 ADC_DrvTarTqMod2EPB "";
BA_ "EventCommandSignal" SG_ 387 ADC_LongCtrlTypReq 0;
BA_ "GatewayedSignals" SG_ 387 ADC_LongCtrlTypReq 0;
BA_ "GenSigInactiveValue" SG_ 387 ADC_LongCtrlTypReq 0;
BA_ "GenSigInvalidValue" SG_ 387 ADC_LongCtrlTypReq 0;
BA_ "GenSigSendType" SG_ 387 ADC_LongCtrlTypReq 1;
BA_ "GenSigStartValue" SG_ 387 ADC_LongCtrlTypReq 0;
BA_ "GenSigTimeoutValue" SG_ 387 ADC_LongCtrlTypReq 0;
BA_ "Remark" SG_ 387 ADC_LongCtrlTypReq "";
BA_ "EventCommandSignal" SG_ 387 ADC_TotalRefTorque_A 0;
BA_ "GatewayedSignals" SG_ 387 ADC_TotalRefTorque_A 0;
BA_ "GenSigInactiveValue" SG_ 387 ADC_TotalRefTorque_A 0;
BA_ "GenSigInvalidValue" SG_ 387 ADC_TotalRefTorque_A 0;
BA_ "GenSigSendType" SG_ 387 ADC_TotalRefTorque_A 1;
BA_ "GenSigStartValue" SG_ 387 ADC_TotalRefTorque_A 0;
BA_ "GenSigTimeoutValue" SG_ 387 ADC_TotalRefTorque_A 0;
BA_ "Remark" SG_ 387 ADC_TotalRefTorque_A "";
BA_ "EventCommandSignal" SG_ 387 ADC_AEBFaultSt 0;
BA_ "GatewayedSignals" SG_ 387 ADC_AEBFaultSt 0;
BA_ "GenSigInactiveValue" SG_ 387 ADC_AEBFaultSt 0;
BA_ "GenSigInvalidValue" SG_ 387 ADC_AEBFaultSt 0;
BA_ "GenSigSendType" SG_ 387 ADC_AEBFaultSt 1;
BA_ "GenSigStartValue" SG_ 387 ADC_AEBFaultSt 0;
BA_ "GenSigTimeoutValue" SG_ 387 ADC_AEBFaultSt 1;
BA_ "Remark" SG_ 387 ADC_AEBFaultSt "";
BA_ "EventCommandSignal" SG_ 387 ADC_AEBOffSt 0;
BA_ "GatewayedSignals" SG_ 387 ADC_AEBOffSt 0;
BA_ "GenSigInactiveValue" SG_ 387 ADC_AEBOffSt 0;
BA_ "GenSigInvalidValue" SG_ 387 ADC_AEBOffSt 0;
BA_ "GenSigSendType" SG_ 387 ADC_AEBOffSt 1;
BA_ "GenSigStartValue" SG_ 387 ADC_AEBOffSt 0;
BA_ "GenSigTimeoutValue" SG_ 387 ADC_AEBOffSt 1;
BA_ "Remark" SG_ 387 ADC_AEBOffSt "";
BA_ "EventCommandSignal" SG_ 387 ADC_AEBInterventionSt 0;
BA_ "GatewayedSignals" SG_ 387 ADC_AEBInterventionSt 0;
BA_ "GenSigInactiveValue" SG_ 387 ADC_AEBInterventionSt 0;
BA_ "GenSigInvalidValue" SG_ 387 ADC_AEBInterventionSt 0;
BA_ "GenSigSendType" SG_ 387 ADC_AEBInterventionSt 1;
BA_ "GenSigStartValue" SG_ 387 ADC_AEBInterventionSt 0;
BA_ "GenSigTimeoutValue" SG_ 387 ADC_AEBInterventionSt 0;
BA_ "Remark" SG_ 387 ADC_AEBInterventionSt "";
BA_ "EventCommandSignal" SG_ 387 ADC_AEBDecelCtrlReq 0;
BA_ "GatewayedSignals" SG_ 387 ADC_AEBDecelCtrlReq 0;
BA_ "GenSigInactiveValue" SG_ 387 ADC_AEBDecelCtrlReq 0;
BA_ "GenSigInvalidValue" SG_ 387 ADC_AEBDecelCtrlReq 0;
BA_ "GenSigSendType" SG_ 387 ADC_AEBDecelCtrlReq 1;
BA_ "GenSigStartValue" SG_ 387 ADC_AEBDecelCtrlReq 0;
BA_ "GenSigTimeoutValue" SG_ 387 ADC_AEBDecelCtrlReq 0;
BA_ "Remark" SG_ 387 ADC_AEBDecelCtrlReq "";
BA_ "EventCommandSignal" SG_ 387 ADC_AEBLVehHoldReq 0;
BA_ "GatewayedSignals" SG_ 387 ADC_AEBLVehHoldReq 0;
BA_ "GenSigInactiveValue" SG_ 387 ADC_AEBLVehHoldReq 0;
BA_ "GenSigInvalidValue" SG_ 387 ADC_AEBLVehHoldReq 0;
BA_ "GenSigSendType" SG_ 387 ADC_AEBLVehHoldReq 1;
BA_ "GenSigStartValue" SG_ 387 ADC_AEBLVehHoldReq 0;
BA_ "GenSigTimeoutValue" SG_ 387 ADC_AEBLVehHoldReq 0;
BA_ "Remark" SG_ 387 ADC_AEBLVehHoldReq "";
BA_ "EventCommandSignal" SG_ 387 ADC_ABAReq 0;
BA_ "GatewayedSignals" SG_ 387 ADC_ABAReq 0;
BA_ "GenSigInactiveValue" SG_ 387 ADC_ABAReq 0;
BA_ "GenSigInvalidValue" SG_ 387 ADC_ABAReq 0;
BA_ "GenSigSendType" SG_ 387 ADC_ABAReq 1;
BA_ "GenSigStartValue" SG_ 387 ADC_ABAReq 0;
BA_ "GenSigTimeoutValue" SG_ 387 ADC_ABAReq 0;
BA_ "Remark" SG_ 387 ADC_ABAReq "";
BA_ "EventCommandSignal" SG_ 387 ADC_ABALevel 0;
BA_ "GatewayedSignals" SG_ 387 ADC_ABALevel 0;
BA_ "GenSigInactiveValue" SG_ 387 ADC_ABALevel 0;
BA_ "GenSigInvalidValue" SG_ 387 ADC_ABALevel 0;
BA_ "GenSigSendType" SG_ 387 ADC_ABALevel 1;
BA_ "GenSigStartValue" SG_ 387 ADC_ABALevel 0;
BA_ "GenSigTimeoutValue" SG_ 387 ADC_ABALevel 0;
BA_ "Remark" SG_ 387 ADC_ABALevel "";
BA_ "EventCommandSignal" SG_ 387 ADC_AWBReq 0;
BA_ "GatewayedSignals" SG_ 387 ADC_AWBReq 0;
BA_ "GenSigInactiveValue" SG_ 387 ADC_AWBReq 0;
BA_ "GenSigInvalidValue" SG_ 387 ADC_AWBReq 0;
BA_ "GenSigSendType" SG_ 387 ADC_AWBReq 1;
BA_ "GenSigStartValue" SG_ 387 ADC_AWBReq 0;
BA_ "GenSigTimeoutValue" SG_ 387 ADC_AWBReq 0;
BA_ "Remark" SG_ 387 ADC_AWBReq "";
BA_ "EventCommandSignal" SG_ 387 ADC_ABPReq 0;
BA_ "GatewayedSignals" SG_ 387 ADC_ABPReq 0;
BA_ "GenSigInactiveValue" SG_ 387 ADC_ABPReq 0;
BA_ "GenSigInvalidValue" SG_ 387 ADC_ABPReq 0;
BA_ "GenSigSendType" SG_ 387 ADC_ABPReq 1;
BA_ "GenSigStartValue" SG_ 387 ADC_ABPReq 0;
BA_ "GenSigTimeoutValue" SG_ 387 ADC_ABPReq 0;
BA_ "Remark" SG_ 387 ADC_ABPReq "";
BA_ "EventCommandSignal" SG_ 387 ADC_AWBLevel 0;
BA_ "GatewayedSignals" SG_ 387 ADC_AWBLevel 0;
BA_ "GenSigInactiveValue" SG_ 387 ADC_AWBLevel 0;
BA_ "GenSigInvalidValue" SG_ 387 ADC_AWBLevel 0;
BA_ "GenSigSendType" SG_ 387 ADC_AWBLevel 1;
BA_ "GenSigStartValue" SG_ 387 ADC_AWBLevel 0;
BA_ "GenSigTimeoutValue" SG_ 387 ADC_AWBLevel 0;
BA_ "Remark" SG_ 387 ADC_AWBLevel "";
BA_ "EventCommandSignal" SG_ 387 ADC_AEBTarCalss 0;
BA_ "GatewayedSignals" SG_ 387 ADC_AEBTarCalss 0;
BA_ "GenSigInactiveValue" SG_ 387 ADC_AEBTarCalss 0;
BA_ "GenSigInvalidValue" SG_ 387 ADC_AEBTarCalss 0;
BA_ "GenSigSendType" SG_ 387 ADC_AEBTarCalss 1;
BA_ "GenSigStartValue" SG_ 387 ADC_AEBTarCalss 0;
BA_ "GenSigTimeoutValue" SG_ 387 ADC_AEBTarCalss 0;
BA_ "Remark" SG_ 387 ADC_AEBTarCalss "";
BA_ "EventCommandSignal" SG_ 387 ADC_AEBTarDetSensor 0;
BA_ "GatewayedSignals" SG_ 387 ADC_AEBTarDetSensor 0;
BA_ "GenSigInactiveValue" SG_ 387 ADC_AEBTarDetSensor 0;
BA_ "GenSigInvalidValue" SG_ 387 ADC_AEBTarDetSensor 0;
BA_ "GenSigSendType" SG_ 387 ADC_AEBTarDetSensor 1;
BA_ "GenSigStartValue" SG_ 387 ADC_AEBTarDetSensor 0;
BA_ "GenSigTimeoutValue" SG_ 387 ADC_AEBTarDetSensor 0;
BA_ "Remark" SG_ 387 ADC_AEBTarDetSensor "";
BA_ "EventCommandSignal" SG_ 387 ADC_TurnLightReq 0;
BA_ "GatewayedSignals" SG_ 387 ADC_TurnLightReq 0;
BA_ "GenSigInactiveValue" SG_ 387 ADC_TurnLightReq 0;
BA_ "GenSigInvalidValue" SG_ 387 ADC_TurnLightReq 0;
BA_ "GenSigSendType" SG_ 387 ADC_TurnLightReq 1;
BA_ "GenSigStartValue" SG_ 387 ADC_TurnLightReq 0;
BA_ "GenSigTimeoutValue" SG_ 387 ADC_TurnLightReq 0;
BA_ "Remark" SG_ 387 ADC_TurnLightReq "";
BA_ "EventCommandSignal" SG_ 387 ADC_PAA2EPBEpbReq 0;
BA_ "GatewayedSignals" SG_ 387 ADC_PAA2EPBEpbReq 0;
BA_ "GenSigInactiveValue" SG_ 387 ADC_PAA2EPBEpbReq 0;
BA_ "GenSigInvalidValue" SG_ 387 ADC_PAA2EPBEpbReq 0;
BA_ "GenSigSendType" SG_ 387 ADC_PAA2EPBEpbReq 1;
BA_ "GenSigStartValue" SG_ 387 ADC_PAA2EPBEpbReq 0;
BA_ "GenSigTimeoutValue" SG_ 387 ADC_PAA2EPBEpbReq 0;
BA_ "Remark" SG_ 387 ADC_PAA2EPBEpbReq "";
BA_ "EventCommandSignal" SG_ 387 ADC_PAA2EPBEpbReqSt 0;
BA_ "GatewayedSignals" SG_ 387 ADC_PAA2EPBEpbReqSt 0;
BA_ "GenSigInactiveValue" SG_ 387 ADC_PAA2EPBEpbReqSt 0;
BA_ "GenSigInvalidValue" SG_ 387 ADC_PAA2EPBEpbReqSt 0;
BA_ "GenSigSendType" SG_ 387 ADC_PAA2EPBEpbReqSt 1;
BA_ "GenSigStartValue" SG_ 387 ADC_PAA2EPBEpbReqSt 0;
BA_ "GenSigTimeoutValue" SG_ 387 ADC_PAA2EPBEpbReqSt 0;
BA_ "Remark" SG_ 387 ADC_PAA2EPBEpbReqSt "";
BA_ "EventCommandSignal" SG_ 387 ADC_AEBObjectTTC 0;
BA_ "GatewayedSignals" SG_ 387 ADC_AEBObjectTTC 0;
BA_ "GenSigInactiveValue" SG_ 387 ADC_AEBObjectTTC 0;
BA_ "GenSigInvalidValue" SG_ 387 ADC_AEBObjectTTC 0;
BA_ "GenSigSendType" SG_ 387 ADC_AEBObjectTTC 1;
BA_ "GenSigStartValue" SG_ 387 ADC_AEBObjectTTC 501;
BA_ "GenSigTimeoutValue" SG_ 387 ADC_AEBObjectTTC 510;
BA_ "Remark" SG_ 387 ADC_AEBObjectTTC "";
BA_ "EventCommandSignal" SG_ 387 ADC_AEBObjRelativeSpd 0;
BA_ "GatewayedSignals" SG_ 387 ADC_AEBObjRelativeSpd 0;
BA_ "GenSigInactiveValue" SG_ 387 ADC_AEBObjRelativeSpd 0;
BA_ "GenSigInvalidValue" SG_ 387 ADC_AEBObjRelativeSpd 0;
BA_ "GenSigSendType" SG_ 387 ADC_AEBObjRelativeSpd 1;
BA_ "GenSigStartValue" SG_ 387 ADC_AEBObjRelativeSpd 0;
BA_ "GenSigTimeoutValue" SG_ 387 ADC_AEBObjRelativeSpd 510;
BA_ "Remark" SG_ 387 ADC_AEBObjRelativeSpd "";
BA_ "EventCommandSignal" SG_ 387 ADC_PAAPwrModeReq 0;
BA_ "GatewayedSignals" SG_ 387 ADC_PAAPwrModeReq 0;
BA_ "GenSigInactiveValue" SG_ 387 ADC_PAAPwrModeReq 0;
BA_ "GenSigInvalidValue" SG_ 387 ADC_PAAPwrModeReq 0;
BA_ "GenSigSendType" SG_ 387 ADC_PAAPwrModeReq 1;
BA_ "GenSigStartValue" SG_ 387 ADC_PAAPwrModeReq 0;
BA_ "GenSigTimeoutValue" SG_ 387 ADC_PAAPwrModeReq 0;
BA_ "Remark" SG_ 387 ADC_PAAPwrModeReq "";
BA_ "EventCommandSignal" SG_ 387 ADC_PAAGrarLvlReq 0;
BA_ "GatewayedSignals" SG_ 387 ADC_PAAGrarLvlReq 0;
BA_ "GenSigInactiveValue" SG_ 387 ADC_PAAGrarLvlReq 0;
BA_ "GenSigInvalidValue" SG_ 387 ADC_PAAGrarLvlReq 0;
BA_ "GenSigSendType" SG_ 387 ADC_PAAGrarLvlReq 1;
BA_ "GenSigStartValue" SG_ 387 ADC_PAAGrarLvlReq 0;
BA_ "GenSigTimeoutValue" SG_ 387 ADC_PAAGrarLvlReq 0;
BA_ "Remark" SG_ 387 ADC_PAAGrarLvlReq "";
BA_ "EventCommandSignal" SG_ 387 ADC_PAAGrarLvlReqEnable 0;
BA_ "GatewayedSignals" SG_ 387 ADC_PAAGrarLvlReqEnable 0;
BA_ "GenSigInactiveValue" SG_ 387 ADC_PAAGrarLvlReqEnable 0;
BA_ "GenSigInvalidValue" SG_ 387 ADC_PAAGrarLvlReqEnable 0;
BA_ "GenSigSendType" SG_ 387 ADC_PAAGrarLvlReqEnable 1;
BA_ "GenSigStartValue" SG_ 387 ADC_PAAGrarLvlReqEnable 0;
BA_ "GenSigTimeoutValue" SG_ 387 ADC_PAAGrarLvlReqEnable 0;
BA_ "Remark" SG_ 387 ADC_PAAGrarLvlReqEnable "";
BA_ "EventCommandSignal" SG_ 387 ADC_ACCMode_C 0;
BA_ "GatewayedSignals" SG_ 387 ADC_ACCMode_C 0;
BA_ "GenSigInactiveValue" SG_ 387 ADC_ACCMode_C 0;
BA_ "GenSigInvalidValue" SG_ 387 ADC_ACCMode_C 0;
BA_ "GenSigSendType" SG_ 387 ADC_ACCMode_C 1;
BA_ "GenSigStartValue" SG_ 387 ADC_ACCMode_C 1;
BA_ "GenSigTimeoutValue" SG_ 387 ADC_ACCMode_C 0;
BA_ "Remark" SG_ 387 ADC_ACCMode_C "";
BA_ "EventCommandSignal" SG_ 387 ADC_ActTrqReqVD 0;
BA_ "GatewayedSignals" SG_ 387 ADC_ActTrqReqVD 0;
BA_ "GenSigInactiveValue" SG_ 387 ADC_ActTrqReqVD 0;
BA_ "GenSigInvalidValue" SG_ 387 ADC_ActTrqReqVD 0;
BA_ "GenSigSendType" SG_ 387 ADC_ActTrqReqVD 1;
BA_ "GenSigStartValue" SG_ 387 ADC_ActTrqReqVD 0;
BA_ "GenSigTimeoutValue" SG_ 387 ADC_ActTrqReqVD 0;
BA_ "Remark" SG_ 387 ADC_ActTrqReqVD "";
BA_ "EventCommandSignal" SG_ 387 ADC_BrkTarTqEna 0;
BA_ "GatewayedSignals" SG_ 387 ADC_BrkTarTqEna 0;
BA_ "GenSigInactiveValue" SG_ 387 ADC_BrkTarTqEna 0;
BA_ "GenSigInvalidValue" SG_ 387 ADC_BrkTarTqEna 0;
BA_ "GenSigSendType" SG_ 387 ADC_BrkTarTqEna 1;
BA_ "GenSigStartValue" SG_ 387 ADC_BrkTarTqEna 0;
BA_ "GenSigTimeoutValue" SG_ 387 ADC_BrkTarTqEna 0;
BA_ "Remark" SG_ 387 ADC_BrkTarTqEna "";
BA_ "EventCommandSignal" SG_ 387 ADC_BrkTarTqMod 0;
BA_ "GatewayedSignals" SG_ 387 ADC_BrkTarTqMod 0;
BA_ "GenSigInactiveValue" SG_ 387 ADC_BrkTarTqMod 0;
BA_ "GenSigInvalidValue" SG_ 387 ADC_BrkTarTqMod 0;
BA_ "GenSigSendType" SG_ 387 ADC_BrkTarTqMod 1;
BA_ "GenSigStartValue" SG_ 387 ADC_BrkTarTqMod 0;
BA_ "GenSigTimeoutValue" SG_ 387 ADC_BrkTarTqMod 0;
BA_ "Remark" SG_ 387 ADC_BrkTarTqMod "";
BA_ "EventCommandSignal" SG_ 387 ADC_AebBrkTarTq 0;
BA_ "GatewayedSignals" SG_ 387 ADC_AebBrkTarTq 0;
BA_ "GenSigInactiveValue" SG_ 387 ADC_AebBrkTarTq 0;
BA_ "GenSigInvalidValue" SG_ 387 ADC_AebBrkTarTq 0;
BA_ "GenSigSendType" SG_ 387 ADC_AebBrkTarTq 1;
BA_ "GenSigStartValue" SG_ 387 ADC_AebBrkTarTq 0;
BA_ "GenSigTimeoutValue" SG_ 387 ADC_AebBrkTarTq 0;
BA_ "Remark" SG_ 387 ADC_AebBrkTarTq "";
BA_ "EventCommandSignal" SG_ 387 ADC_EpbModReqVld 0;
BA_ "GatewayedSignals" SG_ 387 ADC_EpbModReqVld 0;
BA_ "GenSigInactiveValue" SG_ 387 ADC_EpbModReqVld 0;
BA_ "GenSigInvalidValue" SG_ 387 ADC_EpbModReqVld 0;
BA_ "GenSigSendType" SG_ 387 ADC_EpbModReqVld 1;
BA_ "GenSigStartValue" SG_ 387 ADC_EpbModReqVld 0;
BA_ "GenSigTimeoutValue" SG_ 387 ADC_EpbModReqVld 0;
BA_ "Remark" SG_ 387 ADC_EpbModReqVld "";
BA_ "EventCommandSignal" SG_ 387 ADC_RWUEna 0;
BA_ "GatewayedSignals" SG_ 387 ADC_RWUEna 0;
BA_ "GenSigInactiveValue" SG_ 387 ADC_RWUEna 0;
BA_ "GenSigInvalidValue" SG_ 387 ADC_RWUEna 0;
BA_ "GenSigSendType" SG_ 387 ADC_RWUEna 1;
BA_ "GenSigStartValue" SG_ 387 ADC_RWUEna 0;
BA_ "GenSigTimeoutValue" SG_ 387 ADC_RWUEna 0;
BA_ "Remark" SG_ 387 ADC_RWUEna "";
BA_ "EventCommandSignal" SG_ 387 ADC_BrkHoldReq 0;
BA_ "GatewayedSignals" SG_ 387 ADC_BrkHoldReq 0;
BA_ "GenSigInactiveValue" SG_ 387 ADC_BrkHoldReq 0;
BA_ "GenSigInvalidValue" SG_ 387 ADC_BrkHoldReq 0;
BA_ "GenSigSendType" SG_ 387 ADC_BrkHoldReq 1;
BA_ "GenSigStartValue" SG_ 387 ADC_BrkHoldReq 0;
BA_ "GenSigTimeoutValue" SG_ 387 ADC_BrkHoldReq 0;
BA_ "Remark" SG_ 387 ADC_BrkHoldReq "";
BA_ "EventCommandSignal" SG_ 387 ADC_AngReqAvl 0;
BA_ "GatewayedSignals" SG_ 387 ADC_AngReqAvl 0;
BA_ "GenSigInactiveValue" SG_ 387 ADC_AngReqAvl 0;
BA_ "GenSigInvalidValue" SG_ 387 ADC_AngReqAvl 0;
BA_ "GenSigSendType" SG_ 387 ADC_AngReqAvl 1;
BA_ "GenSigStartValue" SG_ 387 ADC_AngReqAvl 0;
BA_ "GenSigTimeoutValue" SG_ 387 ADC_AngReqAvl 0;
BA_ "Remark" SG_ 387 ADC_AngReqAvl "";
BA_ "EventCommandSignal" SG_ 387 ADC_TarGearReqVld 0;
BA_ "GatewayedSignals" SG_ 387 ADC_TarGearReqVld 0;
BA_ "GenSigInactiveValue" SG_ 387 ADC_TarGearReqVld 0;
BA_ "GenSigInvalidValue" SG_ 387 ADC_TarGearReqVld 0;
BA_ "GenSigSendType" SG_ 387 ADC_TarGearReqVld 1;
BA_ "GenSigStartValue" SG_ 387 ADC_TarGearReqVld 0;
BA_ "GenSigTimeoutValue" SG_ 387 ADC_TarGearReqVld 0;
BA_ "Remark" SG_ 387 ADC_TarGearReqVld "";
BA_ "EventCommandSignal" SG_ 387 ADC_FctSts 0;
BA_ "GatewayedSignals" SG_ 387 ADC_FctSts 0;
BA_ "GenSigInactiveValue" SG_ 387 ADC_FctSts 0;
BA_ "GenSigInvalidValue" SG_ 387 ADC_FctSts 0;
BA_ "GenSigSendType" SG_ 387 ADC_FctSts 1;
BA_ "GenSigStartValue" SG_ 387 ADC_FctSts 0;
BA_ "GenSigTimeoutValue" SG_ 387 ADC_FctSts 0;
BA_ "Remark" SG_ 387 ADC_FctSts "";
BA_ "EventCommandSignal" SG_ 387 ADC_BrkTarTqVld 0;
BA_ "GatewayedSignals" SG_ 387 ADC_BrkTarTqVld 0;
BA_ "GenSigInactiveValue" SG_ 387 ADC_BrkTarTqVld 0;
BA_ "GenSigInvalidValue" SG_ 387 ADC_BrkTarTqVld 0;
BA_ "GenSigSendType" SG_ 387 ADC_BrkTarTqVld 1;
BA_ "GenSigStartValue" SG_ 387 ADC_BrkTarTqVld 0;
BA_ "GenSigTimeoutValue" SG_ 387 ADC_BrkTarTqVld 0;
BA_ "Remark" SG_ 387 ADC_BrkTarTqVld "";
BA_ "EventCommandSignal" SG_ 387 ADC_AebBrkTarTqVld 0;
BA_ "GatewayedSignals" SG_ 387 ADC_AebBrkTarTqVld 0;
BA_ "GenSigInactiveValue" SG_ 387 ADC_AebBrkTarTqVld 0;
BA_ "GenSigInvalidValue" SG_ 387 ADC_AebBrkTarTqVld 0;
BA_ "GenSigSendType" SG_ 387 ADC_AebBrkTarTqVld 1;
BA_ "GenSigStartValue" SG_ 387 ADC_AebBrkTarTqVld 0;
BA_ "GenSigTimeoutValue" SG_ 387 ADC_AebBrkTarTqVld 0;
BA_ "Remark" SG_ 387 ADC_AebBrkTarTqVld "";
BA_ "EventCommandSignal" SG_ 387 ADC_AebBrkTarTqEna 0;
BA_ "GatewayedSignals" SG_ 387 ADC_AebBrkTarTqEna 0;
BA_ "GenSigInactiveValue" SG_ 387 ADC_AebBrkTarTqEna 0;
BA_ "GenSigInvalidValue" SG_ 387 ADC_AebBrkTarTqEna 0;
BA_ "GenSigSendType" SG_ 387 ADC_AebBrkTarTqEna 1;
BA_ "GenSigStartValue" SG_ 387 ADC_AebBrkTarTqEna 0;
BA_ "GenSigTimeoutValue" SG_ 387 ADC_AebBrkTarTqEna 0;
BA_ "Remark" SG_ 387 ADC_AebBrkTarTqEna "";
BA_ "EventCommandSignal" SG_ 387 ADC_ElecBrkFnSwitch 0;
BA_ "GatewayedSignals" SG_ 387 ADC_ElecBrkFnSwitch 0;
BA_ "GenSigInactiveValue" SG_ 387 ADC_ElecBrkFnSwitch 0;
BA_ "GenSigInvalidValue" SG_ 387 ADC_ElecBrkFnSwitch 0;
BA_ "GenSigSendType" SG_ 387 ADC_ElecBrkFnSwitch 1;
BA_ "GenSigStartValue" SG_ 387 ADC_ElecBrkFnSwitch 0;
BA_ "GenSigTimeoutValue" SG_ 387 ADC_ElecBrkFnSwitch 0;
BA_ "Remark" SG_ 387 ADC_ElecBrkFnSwitch "";
BA_ "EventCommandSignal" SG_ 387 ADC_RWUVld 0;
BA_ "GatewayedSignals" SG_ 387 ADC_RWUVld 0;
BA_ "GenSigInactiveValue" SG_ 387 ADC_RWUVld 0;
BA_ "GenSigInvalidValue" SG_ 387 ADC_RWUVld 0;
BA_ "GenSigSendType" SG_ 387 ADC_RWUVld 1;
BA_ "GenSigStartValue" SG_ 387 ADC_RWUVld 0;
BA_ "GenSigTimeoutValue" SG_ 387 ADC_RWUVld 0;
BA_ "Remark" SG_ 387 ADC_RWUVld "";
BA_ "EventCommandSignal" SG_ 387 ADC_DriverPresent 0;
BA_ "GatewayedSignals" SG_ 387 ADC_DriverPresent 0;
BA_ "GenSigInactiveValue" SG_ 387 ADC_DriverPresent 0;
BA_ "GenSigInvalidValue" SG_ 387 ADC_DriverPresent 0;
BA_ "GenSigSendType" SG_ 387 ADC_DriverPresent 1;
BA_ "GenSigStartValue" SG_ 387 ADC_DriverPresent 0;
BA_ "GenSigTimeoutValue" SG_ 387 ADC_DriverPresent 0;
BA_ "Remark" SG_ 387 ADC_DriverPresent "";
BA_ "EventCommandSignal" SG_ 387 ADC_AD_NetMode 0;
BA_ "GatewayedSignals" SG_ 387 ADC_AD_NetMode 0;
BA_ "GenSigInactiveValue" SG_ 387 ADC_AD_NetMode 0;
BA_ "GenSigInvalidValue" SG_ 387 ADC_AD_NetMode 0;
BA_ "GenSigSendType" SG_ 387 ADC_AD_NetMode 1;
BA_ "GenSigStartValue" SG_ 387 ADC_AD_NetMode 0;
BA_ "GenSigTimeoutValue" SG_ 387 ADC_AD_NetMode 0;
BA_ "Remark" SG_ 387 ADC_AD_NetMode "";
BA_ "EventCommandSignal" SG_ 387 ADC_ChrgPwrMode 0;
BA_ "GatewayedSignals" SG_ 387 ADC_ChrgPwrMode 0;
BA_ "GenSigInactiveValue" SG_ 387 ADC_ChrgPwrMode 0;
BA_ "GenSigInvalidValue" SG_ 387 ADC_ChrgPwrMode 0;
BA_ "GenSigSendType" SG_ 387 ADC_ChrgPwrMode 1;
BA_ "GenSigStartValue" SG_ 387 ADC_ChrgPwrMode 0;
BA_ "GenSigTimeoutValue" SG_ 387 ADC_ChrgPwrMode 0;
BA_ "Remark" SG_ 387 ADC_ChrgPwrMode "";
BA_ "EventCommandSignal" SG_ 387 ADC_LimTqEnable_A 0;
BA_ "GatewayedSignals" SG_ 387 ADC_LimTqEnable_A 0;
BA_ "GenSigInactiveValue" SG_ 387 ADC_LimTqEnable_A 0;
BA_ "GenSigInvalidValue" SG_ 387 ADC_LimTqEnable_A 0;
BA_ "GenSigSendType" SG_ 387 ADC_LimTqEnable_A 1;
BA_ "GenSigStartValue" SG_ 387 ADC_LimTqEnable_A 0;
BA_ "GenSigTimeoutValue" SG_ 387 ADC_LimTqEnable_A 0;
BA_ "Remark" SG_ 387 ADC_LimTqEnable_A "";
BA_ "EventCommandSignal" SG_ 387 ADC_LimTqFactorK_A 0;
BA_ "GatewayedSignals" SG_ 387 ADC_LimTqFactorK_A 0;
BA_ "GenSigInactiveValue" SG_ 387 ADC_LimTqFactorK_A 0;
BA_ "GenSigInvalidValue" SG_ 387 ADC_LimTqFactorK_A 0;
BA_ "GenSigSendType" SG_ 387 ADC_LimTqFactorK_A 1;
BA_ "GenSigStartValue" SG_ 387 ADC_LimTqFactorK_A 0;
BA_ "GenSigTimeoutValue" SG_ 387 ADC_LimTqFactorK_A 0;
BA_ "Remark" SG_ 387 ADC_LimTqFactorK_A "";
BA_ "EventCommandSignal" SG_ 387 ADC_RapidRespEna_A 0;
BA_ "GatewayedSignals" SG_ 387 ADC_RapidRespEna_A 0;
BA_ "GenSigInactiveValue" SG_ 387 ADC_RapidRespEna_A 0;
BA_ "GenSigInvalidValue" SG_ 387 ADC_RapidRespEna_A 0;
BA_ "GenSigSendType" SG_ 387 ADC_RapidRespEna_A 1;
BA_ "GenSigStartValue" SG_ 387 ADC_RapidRespEna_A 0;
BA_ "GenSigTimeoutValue" SG_ 387 ADC_RapidRespEna_A 0;
BA_ "Remark" SG_ 387 ADC_RapidRespEna_A "";
BA_ "EventCommandSignal" SG_ 387 ADC_DrvTarTqMod_A 0;
BA_ "GatewayedSignals" SG_ 387 ADC_DrvTarTqMod_A 0;
BA_ "GenSigInactiveValue" SG_ 387 ADC_DrvTarTqMod_A 0;
BA_ "GenSigInvalidValue" SG_ 387 ADC_DrvTarTqMod_A 0;
BA_ "GenSigSendType" SG_ 387 ADC_DrvTarTqMod_A 1;
BA_ "GenSigStartValue" SG_ 387 ADC_DrvTarTqMod_A 0;
BA_ "GenSigTimeoutValue" SG_ 387 ADC_DrvTarTqMod_A 0;
BA_ "Remark" SG_ 387 ADC_DrvTarTqMod_A "";
BA_ "EventCommandSignal" SG_ 387 ADC_FcsActiveStatus 0;
BA_ "GatewayedSignals" SG_ 387 ADC_FcsActiveStatus 0;
BA_ "GenSigInactiveValue" SG_ 387 ADC_FcsActiveStatus 0;
BA_ "GenSigInvalidValue" SG_ 387 ADC_FcsActiveStatus 0;
BA_ "GenSigSendType" SG_ 387 ADC_FcsActiveStatus 1;
BA_ "GenSigStartValue" SG_ 387 ADC_FcsActiveStatus 0;
BA_ "GenSigTimeoutValue" SG_ 387 ADC_FcsActiveStatus 0;
BA_ "Remark" SG_ 387 ADC_FcsActiveStatus "";
BA_ "EventCommandSignal" SG_ 387 ADC_DycEscTarTq_A 0;
BA_ "GatewayedSignals" SG_ 387 ADC_DycEscTarTq_A 0;
BA_ "GenSigInactiveValue" SG_ 387 ADC_DycEscTarTq_A 0;
BA_ "GenSigInvalidValue" SG_ 387 ADC_DycEscTarTq_A 0;
BA_ "GenSigSendType" SG_ 387 ADC_DycEscTarTq_A 1;
BA_ "GenSigStartValue" SG_ 387 ADC_DycEscTarTq_A 0;
BA_ "GenSigTimeoutValue" SG_ 387 ADC_DycEscTarTq_A 0;
BA_ "Remark" SG_ 387 ADC_DycEscTarTq_A "";
BA_ "EventCommandSignal" SG_ 387 ADC_DycEscTarTqfactor_A 0;
BA_ "GatewayedSignals" SG_ 387 ADC_DycEscTarTqfactor_A 0;
BA_ "GenSigInactiveValue" SG_ 387 ADC_DycEscTarTqfactor_A 0;
BA_ "GenSigInvalidValue" SG_ 387 ADC_DycEscTarTqfactor_A 0;
BA_ "GenSigSendType" SG_ 387 ADC_DycEscTarTqfactor_A 1;
BA_ "GenSigStartValue" SG_ 387 ADC_DycEscTarTqfactor_A 0;
BA_ "GenSigTimeoutValue" SG_ 387 ADC_DycEscTarTqfactor_A 0;
BA_ "Remark" SG_ 387 ADC_DycEscTarTqfactor_A "";
BA_ "EventCommandSignal" SG_ 387 ADC_DycEscTarTqVld_A 0;
BA_ "GatewayedSignals" SG_ 387 ADC_DycEscTarTqVld_A 0;
BA_ "GenSigInactiveValue" SG_ 387 ADC_DycEscTarTqVld_A 0;
BA_ "GenSigInvalidValue" SG_ 387 ADC_DycEscTarTqVld_A 0;
BA_ "GenSigSendType" SG_ 387 ADC_DycEscTarTqVld_A 1;
BA_ "GenSigStartValue" SG_ 387 ADC_DycEscTarTqVld_A 0;
BA_ "GenSigTimeoutValue" SG_ 387 ADC_DycEscTarTqVld_A 0;
BA_ "Remark" SG_ 387 ADC_DycEscTarTqVld_A "";
BA_ "EventCommandSignal" SG_ 387 ADC_DycEscTarTqEna_A 0;
BA_ "GatewayedSignals" SG_ 387 ADC_DycEscTarTqEna_A 0;
BA_ "GenSigInactiveValue" SG_ 387 ADC_DycEscTarTqEna_A 0;
BA_ "GenSigInvalidValue" SG_ 387 ADC_DycEscTarTqEna_A 0;
BA_ "GenSigSendType" SG_ 387 ADC_DycEscTarTqEna_A 1;
BA_ "GenSigStartValue" SG_ 387 ADC_DycEscTarTqEna_A 0;
BA_ "GenSigTimeoutValue" SG_ 387 ADC_DycEscTarTqEna_A 0;
BA_ "Remark" SG_ 387 ADC_DycEscTarTqEna_A "";
BA_ "EventCommandSignal" SG_ 387 ADC_RedundantSwt 0;
BA_ "GatewayedSignals" SG_ 387 ADC_RedundantSwt 0;
BA_ "GenSigInactiveValue" SG_ 387 ADC_RedundantSwt 0;
BA_ "GenSigInvalidValue" SG_ 387 ADC_RedundantSwt 0;
BA_ "GenSigSendType" SG_ 387 ADC_RedundantSwt 1;
BA_ "GenSigStartValue" SG_ 387 ADC_RedundantSwt 0;
BA_ "GenSigTimeoutValue" SG_ 387 ADC_RedundantSwt 0;
BA_ "Remark" SG_ 387 ADC_RedundantSwt "";
BA_ "EventCommandSignal" SG_ 387 ADC_ImmediateStopEna 0;
BA_ "GatewayedSignals" SG_ 387 ADC_ImmediateStopEna 0;
BA_ "GenSigInactiveValue" SG_ 387 ADC_ImmediateStopEna 0;
BA_ "GenSigInvalidValue" SG_ 387 ADC_ImmediateStopEna 0;
BA_ "GenSigSendType" SG_ 387 ADC_ImmediateStopEna 1;
BA_ "GenSigStartValue" SG_ 387 ADC_ImmediateStopEna 0;
BA_ "GenSigTimeoutValue" SG_ 387 ADC_ImmediateStopEna 0;
BA_ "Remark" SG_ 387 ADC_ImmediateStopEna "";
BA_ "EventCommandSignal" SG_ 387 ADS_VDCActvSt 0;
BA_ "GatewayedSignals" SG_ 387 ADS_VDCActvSt 0;
BA_ "GenSigInactiveValue" SG_ 387 ADS_VDCActvSt 0;
BA_ "GenSigInvalidValue" SG_ 387 ADS_VDCActvSt 0;
BA_ "GenSigSendType" SG_ 387 ADS_VDCActvSt 1;
BA_ "GenSigStartValue" SG_ 387 ADS_VDCActvSt 0;
BA_ "GenSigTimeoutValue" SG_ 387 ADS_VDCActvSt 0;
BA_ "Remark" SG_ 387 ADS_VDCActvSt "";
BA_ "EventCommandSignal" SG_ 387 ADS_TCSActvSt 0;
BA_ "GatewayedSignals" SG_ 387 ADS_TCSActvSt 0;
BA_ "GenSigInactiveValue" SG_ 387 ADS_TCSActvSt 0;
BA_ "GenSigInvalidValue" SG_ 387 ADS_TCSActvSt 0;
BA_ "GenSigSendType" SG_ 387 ADS_TCSActvSt 1;
BA_ "GenSigStartValue" SG_ 387 ADS_TCSActvSt 0;
BA_ "GenSigTimeoutValue" SG_ 387 ADS_TCSActvSt 0;
BA_ "Remark" SG_ 387 ADS_TCSActvSt "";
BA_ "EventCommandSignal" SG_ 387 ADS_DTCActvSt 0;
BA_ "GatewayedSignals" SG_ 387 ADS_DTCActvSt 0;
BA_ "GenSigInactiveValue" SG_ 387 ADS_DTCActvSt 0;
BA_ "GenSigInvalidValue" SG_ 387 ADS_DTCActvSt 0;
BA_ "GenSigSendType" SG_ 387 ADS_DTCActvSt 1;
BA_ "GenSigStartValue" SG_ 387 ADS_DTCActvSt 0;
BA_ "GenSigTimeoutValue" SG_ 387 ADS_DTCActvSt 0;
BA_ "Remark" SG_ 387 ADS_DTCActvSt "";
BA_ "EventCommandSignal" SG_ 387 ADC_VehSpd 0;
BA_ "GatewayedSignals" SG_ 387 ADC_VehSpd 0;
BA_ "GenSigInactiveValue" SG_ 387 ADC_VehSpd 0;
BA_ "GenSigInvalidValue" SG_ 387 ADC_VehSpd 0;
BA_ "GenSigSendType" SG_ 387 ADC_VehSpd 1;
BA_ "GenSigStartValue" SG_ 387 ADC_VehSpd 0;
BA_ "GenSigTimeoutValue" SG_ 387 ADC_VehSpd 0;
BA_ "Remark" SG_ 387 ADC_VehSpd "";
BA_ "EventCommandSignal" SG_ 387 ADC_VehSpdVD 0;
BA_ "GatewayedSignals" SG_ 387 ADC_VehSpdVD 0;
BA_ "GenSigInactiveValue" SG_ 387 ADC_VehSpdVD 0;
BA_ "GenSigInvalidValue" SG_ 387 ADC_VehSpdVD 0;
BA_ "GenSigSendType" SG_ 387 ADC_VehSpdVD 1;
BA_ "GenSigStartValue" SG_ 387 ADC_VehSpdVD 0;
BA_ "GenSigTimeoutValue" SG_ 387 ADC_VehSpdVD 0;
BA_ "Remark" SG_ 387 ADC_VehSpdVD "";
BA_ "EventCommandSignal" SG_ 387 ADC_SteerTqReq_A 0;
BA_ "GatewayedSignals" SG_ 387 ADC_SteerTqReq_A 0;
BA_ "GenSigInactiveValue" SG_ 387 ADC_SteerTqReq_A 0;
BA_ "GenSigInvalidValue" SG_ 387 ADC_SteerTqReq_A 4095;
BA_ "GenSigSendType" SG_ 387 ADC_SteerTqReq_A 1;
BA_ "GenSigStartValue" SG_ 387 ADC_SteerTqReq_A 2000;
BA_ "GenSigTimeoutValue" SG_ 387 ADC_SteerTqReq_A 4095;
BA_ "Remark" SG_ 387 ADC_SteerTqReq_A "";
BA_ "EventCommandSignal" SG_ 387 ADC_SteerTqSt_A 0;
BA_ "GatewayedSignals" SG_ 387 ADC_SteerTqSt_A 0;
BA_ "GenSigInactiveValue" SG_ 387 ADC_SteerTqSt_A 0;
BA_ "GenSigInvalidValue" SG_ 387 ADC_SteerTqSt_A 0;
BA_ "GenSigSendType" SG_ 387 ADC_SteerTqSt_A 1;
BA_ "GenSigStartValue" SG_ 387 ADC_SteerTqSt_A 0;
BA_ "GenSigTimeoutValue" SG_ 387 ADC_SteerTqSt_A 0;
BA_ "Remark" SG_ 387 ADC_SteerTqSt_A "";
BA_ "EventCommandSignal" SG_ 387 ADC_TqEvsSteerReq_A 0;
BA_ "GatewayedSignals" SG_ 387 ADC_TqEvsSteerReq_A 0;
BA_ "GenSigInactiveValue" SG_ 387 ADC_TqEvsSteerReq_A 0;
BA_ "GenSigInvalidValue" SG_ 387 ADC_TqEvsSteerReq_A 0;
BA_ "GenSigSendType" SG_ 387 ADC_TqEvsSteerReq_A 1;
BA_ "GenSigStartValue" SG_ 387 ADC_TqEvsSteerReq_A 0;
BA_ "GenSigTimeoutValue" SG_ 387 ADC_TqEvsSteerReq_A 0;
BA_ "Remark" SG_ 387 ADC_TqEvsSteerReq_A "";
BA_ "EventCommandSignal" SG_ 387 ADC_SteerTqAvl_A 0;
BA_ "GatewayedSignals" SG_ 387 ADC_SteerTqAvl_A 0;
BA_ "GenSigInactiveValue" SG_ 387 ADC_SteerTqAvl_A 0;
BA_ "GenSigInvalidValue" SG_ 387 ADC_SteerTqAvl_A 0;
BA_ "GenSigSendType" SG_ 387 ADC_SteerTqAvl_A 1;
BA_ "GenSigStartValue" SG_ 387 ADC_SteerTqAvl_A 0;
BA_ "GenSigTimeoutValue" SG_ 387 ADC_SteerTqAvl_A 0;
BA_ "Remark" SG_ 387 ADC_SteerTqAvl_A "";
BA_ "EventCommandSignal" SG_ 387 ADC_SteerGainLevelTqCtrl_A 0;
BA_ "GatewayedSignals" SG_ 387 ADC_SteerGainLevelTqCtrl_A 0;
BA_ "GenSigInactiveValue" SG_ 387 ADC_SteerGainLevelTqCtrl_A 0;
BA_ "GenSigInvalidValue" SG_ 387 ADC_SteerGainLevelTqCtrl_A 0;
BA_ "GenSigSendType" SG_ 387 ADC_SteerGainLevelTqCtrl_A 1;
BA_ "GenSigStartValue" SG_ 387 ADC_SteerGainLevelTqCtrl_A 0;
BA_ "GenSigTimeoutValue" SG_ 387 ADC_SteerGainLevelTqCtrl_A 100;
BA_ "Remark" SG_ 387 ADC_SteerGainLevelTqCtrl_A "";
BA_ "EventCommandSignal" SG_ 387 ADC_BrkTarTq 0;
BA_ "GatewayedSignals" SG_ 387 ADC_BrkTarTq 0;
BA_ "GenSigInactiveValue" SG_ 387 ADC_BrkTarTq 0;
BA_ "GenSigInvalidValue" SG_ 387 ADC_BrkTarTq 0;
BA_ "GenSigSendType" SG_ 387 ADC_BrkTarTq 1;
BA_ "GenSigStartValue" SG_ 387 ADC_BrkTarTq 0;
BA_ "GenSigTimeoutValue" SG_ 387 ADC_BrkTarTq 0;
BA_ "Remark" SG_ 387 ADC_BrkTarTq "";
BA_ "EventCommandSignal" SG_ 783 ADC_3_New_CRC 0;
BA_ "GatewayedSignals" SG_ 783 ADC_3_New_CRC 0;
BA_ "GenSigInactiveValue" SG_ 783 ADC_3_New_CRC 0;
BA_ "GenSigInvalidValue" SG_ 783 ADC_3_New_CRC 0;
BA_ "GenSigSendType" SG_ 783 ADC_3_New_CRC 1;
BA_ "GenSigStartValue" SG_ 783 ADC_3_New_CRC 0;
BA_ "GenSigTimeoutValue" SG_ 783 ADC_3_New_CRC 0;
BA_ "Remark" SG_ 783 ADC_3_New_CRC "";
BA_ "EventCommandSignal" SG_ 783 ADC_3_New_Counter 0;
BA_ "GatewayedSignals" SG_ 783 ADC_3_New_Counter 0;
BA_ "GenSigInactiveValue" SG_ 783 ADC_3_New_Counter 0;
BA_ "GenSigInvalidValue" SG_ 783 ADC_3_New_Counter 0;
BA_ "GenSigSendType" SG_ 783 ADC_3_New_Counter 1;
BA_ "GenSigStartValue" SG_ 783 ADC_3_New_Counter 0;
BA_ "GenSigTimeoutValue" SG_ 783 ADC_3_New_Counter 0;
BA_ "Remark" SG_ 783 ADC_3_New_Counter "";
BA_ "EventCommandSignal" SG_ 783 ADC_FroTrkTargt0ObjClass 0;
BA_ "GatewayedSignals" SG_ 783 ADC_FroTrkTargt0ObjClass 0;
BA_ "GenSigInactiveValue" SG_ 783 ADC_FroTrkTargt0ObjClass 0;
BA_ "GenSigInvalidValue" SG_ 783 ADC_FroTrkTargt0ObjClass 0;
BA_ "GenSigSendType" SG_ 783 ADC_FroTrkTargt0ObjClass 1;
BA_ "GenSigStartValue" SG_ 783 ADC_FroTrkTargt0ObjClass 0;
BA_ "GenSigTimeoutValue" SG_ 783 ADC_FroTrkTargt0ObjClass 0;
BA_ "Remark" SG_ 783 ADC_FroTrkTargt0ObjClass "";
BA_ "EventCommandSignal" SG_ 783 ADC_FroTrkTargt0St 0;
BA_ "GatewayedSignals" SG_ 783 ADC_FroTrkTargt0St 0;
BA_ "GenSigInactiveValue" SG_ 783 ADC_FroTrkTargt0St 0;
BA_ "GenSigInvalidValue" SG_ 783 ADC_FroTrkTargt0St 0;
BA_ "GenSigSendType" SG_ 783 ADC_FroTrkTargt0St 1;
BA_ "GenSigStartValue" SG_ 783 ADC_FroTrkTargt0St 0;
BA_ "GenSigTimeoutValue" SG_ 783 ADC_FroTrkTargt0St 0;
BA_ "Remark" SG_ 783 ADC_FroTrkTargt0St "";
BA_ "EventCommandSignal" SG_ 783 ADC_FroTrkTargt0longPos 0;
BA_ "GatewayedSignals" SG_ 783 ADC_FroTrkTargt0longPos 0;
BA_ "GenSigInactiveValue" SG_ 783 ADC_FroTrkTargt0longPos 0;
BA_ "GenSigInvalidValue" SG_ 783 ADC_FroTrkTargt0longPos 0;
BA_ "GenSigSendType" SG_ 783 ADC_FroTrkTargt0longPos 1;
BA_ "GenSigStartValue" SG_ 783 ADC_FroTrkTargt0longPos 0;
BA_ "GenSigTimeoutValue" SG_ 783 ADC_FroTrkTargt0longPos 0;
BA_ "Remark" SG_ 783 ADC_FroTrkTargt0longPos "";
BA_ "EventCommandSignal" SG_ 783 ADC_FroTrkTargt0latPos 0;
BA_ "GatewayedSignals" SG_ 783 ADC_FroTrkTargt0latPos 0;
BA_ "GenSigInactiveValue" SG_ 783 ADC_FroTrkTargt0latPos 0;
BA_ "GenSigInvalidValue" SG_ 783 ADC_FroTrkTargt0latPos 0;
BA_ "GenSigSendType" SG_ 783 ADC_FroTrkTargt0latPos 1;
BA_ "GenSigStartValue" SG_ 783 ADC_FroTrkTargt0latPos 512;
BA_ "GenSigTimeoutValue" SG_ 783 ADC_FroTrkTargt0latPos 0;
BA_ "Remark" SG_ 783 ADC_FroTrkTargt0latPos "";
BA_ "EventCommandSignal" SG_ 783 ADC_FroTrkTargt0LatRelSpd 0;
BA_ "GatewayedSignals" SG_ 783 ADC_FroTrkTargt0LatRelSpd 0;
BA_ "GenSigInactiveValue" SG_ 783 ADC_FroTrkTargt0LatRelSpd 0;
BA_ "GenSigInvalidValue" SG_ 783 ADC_FroTrkTargt0LatRelSpd 0;
BA_ "GenSigSendType" SG_ 783 ADC_FroTrkTargt0LatRelSpd 1;
BA_ "GenSigStartValue" SG_ 783 ADC_FroTrkTargt0LatRelSpd 0;
BA_ "GenSigTimeoutValue" SG_ 783 ADC_FroTrkTargt0LatRelSpd 0;
BA_ "Remark" SG_ 783 ADC_FroTrkTargt0LatRelSpd "";
BA_ "EventCommandSignal" SG_ 783 ADC_FroTrkTargt0LongRelSpd 0;
BA_ "GatewayedSignals" SG_ 783 ADC_FroTrkTargt0LongRelSpd 0;
BA_ "GenSigInactiveValue" SG_ 783 ADC_FroTrkTargt0LongRelSpd 0;
BA_ "GenSigInvalidValue" SG_ 783 ADC_FroTrkTargt0LongRelSpd 0;
BA_ "GenSigSendType" SG_ 783 ADC_FroTrkTargt0LongRelSpd 1;
BA_ "GenSigStartValue" SG_ 783 ADC_FroTrkTargt0LongRelSpd 0;
BA_ "GenSigTimeoutValue" SG_ 783 ADC_FroTrkTargt0LongRelSpd 0;
BA_ "Remark" SG_ 783 ADC_FroTrkTargt0LongRelSpd "";
BA_ "EventCommandSignal" SG_ 783 ADC_FroTrkTargt0DetSensor 0;
BA_ "GatewayedSignals" SG_ 783 ADC_FroTrkTargt0DetSensor 0;
BA_ "GenSigInactiveValue" SG_ 783 ADC_FroTrkTargt0DetSensor 0;
BA_ "GenSigInvalidValue" SG_ 783 ADC_FroTrkTargt0DetSensor 0;
BA_ "GenSigSendType" SG_ 783 ADC_FroTrkTargt0DetSensor 1;
BA_ "GenSigStartValue" SG_ 783 ADC_FroTrkTargt0DetSensor 0;
BA_ "GenSigTimeoutValue" SG_ 783 ADC_FroTrkTargt0DetSensor 0;
BA_ "Remark" SG_ 783 ADC_FroTrkTargt0DetSensor "";
BA_ "EventCommandSignal" SG_ 783 ADC_FroTrkTargt1ObjClass 0;
BA_ "GatewayedSignals" SG_ 783 ADC_FroTrkTargt1ObjClass 0;
BA_ "GenSigInactiveValue" SG_ 783 ADC_FroTrkTargt1ObjClass 0;
BA_ "GenSigInvalidValue" SG_ 783 ADC_FroTrkTargt1ObjClass 0;
BA_ "GenSigSendType" SG_ 783 ADC_FroTrkTargt1ObjClass 1;
BA_ "GenSigStartValue" SG_ 783 ADC_FroTrkTargt1ObjClass 0;
BA_ "GenSigTimeoutValue" SG_ 783 ADC_FroTrkTargt1ObjClass 0;
BA_ "Remark" SG_ 783 ADC_FroTrkTargt1ObjClass "";
BA_ "EventCommandSignal" SG_ 783 ADC_FroTrkTargt1St 0;
BA_ "GatewayedSignals" SG_ 783 ADC_FroTrkTargt1St 0;
BA_ "GenSigInactiveValue" SG_ 783 ADC_FroTrkTargt1St 0;
BA_ "GenSigInvalidValue" SG_ 783 ADC_FroTrkTargt1St 0;
BA_ "GenSigSendType" SG_ 783 ADC_FroTrkTargt1St 1;
BA_ "GenSigStartValue" SG_ 783 ADC_FroTrkTargt1St 0;
BA_ "GenSigTimeoutValue" SG_ 783 ADC_FroTrkTargt1St 0;
BA_ "Remark" SG_ 783 ADC_FroTrkTargt1St "";
BA_ "EventCommandSignal" SG_ 783 ADC_FroTrkTargt1longPos 0;
BA_ "GatewayedSignals" SG_ 783 ADC_FroTrkTargt1longPos 0;
BA_ "GenSigInactiveValue" SG_ 783 ADC_FroTrkTargt1longPos 0;
BA_ "GenSigInvalidValue" SG_ 783 ADC_FroTrkTargt1longPos 0;
BA_ "GenSigSendType" SG_ 783 ADC_FroTrkTargt1longPos 1;
BA_ "GenSigStartValue" SG_ 783 ADC_FroTrkTargt1longPos 0;
BA_ "GenSigTimeoutValue" SG_ 783 ADC_FroTrkTargt1longPos 0;
BA_ "Remark" SG_ 783 ADC_FroTrkTargt1longPos "";
BA_ "EventCommandSignal" SG_ 783 ADC_FroTrkTargt1latPos 0;
BA_ "GatewayedSignals" SG_ 783 ADC_FroTrkTargt1latPos 0;
BA_ "GenSigInactiveValue" SG_ 783 ADC_FroTrkTargt1latPos 0;
BA_ "GenSigInvalidValue" SG_ 783 ADC_FroTrkTargt1latPos 0;
BA_ "GenSigSendType" SG_ 783 ADC_FroTrkTargt1latPos 1;
BA_ "GenSigStartValue" SG_ 783 ADC_FroTrkTargt1latPos 512;
BA_ "GenSigTimeoutValue" SG_ 783 ADC_FroTrkTargt1latPos 0;
BA_ "Remark" SG_ 783 ADC_FroTrkTargt1latPos "";
BA_ "EventCommandSignal" SG_ 783 ADC_FroTrkTargt1LatRelSpd 0;
BA_ "GatewayedSignals" SG_ 783 ADC_FroTrkTargt1LatRelSpd 0;
BA_ "GenSigInactiveValue" SG_ 783 ADC_FroTrkTargt1LatRelSpd 0;
BA_ "GenSigInvalidValue" SG_ 783 ADC_FroTrkTargt1LatRelSpd 0;
BA_ "GenSigSendType" SG_ 783 ADC_FroTrkTargt1LatRelSpd 1;
BA_ "GenSigStartValue" SG_ 783 ADC_FroTrkTargt1LatRelSpd 0;
BA_ "GenSigTimeoutValue" SG_ 783 ADC_FroTrkTargt1LatRelSpd 0;
BA_ "Remark" SG_ 783 ADC_FroTrkTargt1LatRelSpd "";
BA_ "EventCommandSignal" SG_ 783 ADC_FroTrkTargt1LongRelSpd 0;
BA_ "GatewayedSignals" SG_ 783 ADC_FroTrkTargt1LongRelSpd 0;
BA_ "GenSigInactiveValue" SG_ 783 ADC_FroTrkTargt1LongRelSpd 0;
BA_ "GenSigInvalidValue" SG_ 783 ADC_FroTrkTargt1LongRelSpd 0;
BA_ "GenSigSendType" SG_ 783 ADC_FroTrkTargt1LongRelSpd 1;
BA_ "GenSigStartValue" SG_ 783 ADC_FroTrkTargt1LongRelSpd 0;
BA_ "GenSigTimeoutValue" SG_ 783 ADC_FroTrkTargt1LongRelSpd 0;
BA_ "Remark" SG_ 783 ADC_FroTrkTargt1LongRelSpd "";
BA_ "EventCommandSignal" SG_ 783 ADC_FroTrkTargt1DetSensor 0;
BA_ "GatewayedSignals" SG_ 783 ADC_FroTrkTargt1DetSensor 0;
BA_ "GenSigInactiveValue" SG_ 783 ADC_FroTrkTargt1DetSensor 0;
BA_ "GenSigInvalidValue" SG_ 783 ADC_FroTrkTargt1DetSensor 0;
BA_ "GenSigSendType" SG_ 783 ADC_FroTrkTargt1DetSensor 1;
BA_ "GenSigStartValue" SG_ 783 ADC_FroTrkTargt1DetSensor 0;
BA_ "GenSigTimeoutValue" SG_ 783 ADC_FroTrkTargt1DetSensor 0;
BA_ "Remark" SG_ 783 ADC_FroTrkTargt1DetSensor "";
BA_ "EventCommandSignal" SG_ 783 ADC_FroTrkTargt2ObjClass 0;
BA_ "GatewayedSignals" SG_ 783 ADC_FroTrkTargt2ObjClass 0;
BA_ "GenSigInactiveValue" SG_ 783 ADC_FroTrkTargt2ObjClass 0;
BA_ "GenSigInvalidValue" SG_ 783 ADC_FroTrkTargt2ObjClass 0;
BA_ "GenSigSendType" SG_ 783 ADC_FroTrkTargt2ObjClass 1;
BA_ "GenSigStartValue" SG_ 783 ADC_FroTrkTargt2ObjClass 0;
BA_ "GenSigTimeoutValue" SG_ 783 ADC_FroTrkTargt2ObjClass 0;
BA_ "Remark" SG_ 783 ADC_FroTrkTargt2ObjClass "";
BA_ "EventCommandSignal" SG_ 783 ADC_FroTrkTargt2St 0;
BA_ "GatewayedSignals" SG_ 783 ADC_FroTrkTargt2St 0;
BA_ "GenSigInactiveValue" SG_ 783 ADC_FroTrkTargt2St 0;
BA_ "GenSigInvalidValue" SG_ 783 ADC_FroTrkTargt2St 0;
BA_ "GenSigSendType" SG_ 783 ADC_FroTrkTargt2St 1;
BA_ "GenSigStartValue" SG_ 783 ADC_FroTrkTargt2St 0;
BA_ "GenSigTimeoutValue" SG_ 783 ADC_FroTrkTargt2St 0;
BA_ "Remark" SG_ 783 ADC_FroTrkTargt2St "";
BA_ "EventCommandSignal" SG_ 783 ADC_FroTrkTargt2longPos 0;
BA_ "GatewayedSignals" SG_ 783 ADC_FroTrkTargt2longPos 0;
BA_ "GenSigInactiveValue" SG_ 783 ADC_FroTrkTargt2longPos 0;
BA_ "GenSigInvalidValue" SG_ 783 ADC_FroTrkTargt2longPos 0;
BA_ "GenSigSendType" SG_ 783 ADC_FroTrkTargt2longPos 1;
BA_ "GenSigStartValue" SG_ 783 ADC_FroTrkTargt2longPos 0;
BA_ "GenSigTimeoutValue" SG_ 783 ADC_FroTrkTargt2longPos 0;
BA_ "Remark" SG_ 783 ADC_FroTrkTargt2longPos "";
BA_ "EventCommandSignal" SG_ 783 ADC_FroTrkTargt2latPos 0;
BA_ "GatewayedSignals" SG_ 783 ADC_FroTrkTargt2latPos 0;
BA_ "GenSigInactiveValue" SG_ 783 ADC_FroTrkTargt2latPos 0;
BA_ "GenSigInvalidValue" SG_ 783 ADC_FroTrkTargt2latPos 0;
BA_ "GenSigSendType" SG_ 783 ADC_FroTrkTargt2latPos 1;
BA_ "GenSigStartValue" SG_ 783 ADC_FroTrkTargt2latPos 512;
BA_ "GenSigTimeoutValue" SG_ 783 ADC_FroTrkTargt2latPos 0;
BA_ "Remark" SG_ 783 ADC_FroTrkTargt2latPos "";
BA_ "EventCommandSignal" SG_ 783 ADC_FroTrkTargt2LatRelSpd 0;
BA_ "GatewayedSignals" SG_ 783 ADC_FroTrkTargt2LatRelSpd 0;
BA_ "GenSigInactiveValue" SG_ 783 ADC_FroTrkTargt2LatRelSpd 0;
BA_ "GenSigInvalidValue" SG_ 783 ADC_FroTrkTargt2LatRelSpd 0;
BA_ "GenSigSendType" SG_ 783 ADC_FroTrkTargt2LatRelSpd 1;
BA_ "GenSigStartValue" SG_ 783 ADC_FroTrkTargt2LatRelSpd 0;
BA_ "GenSigTimeoutValue" SG_ 783 ADC_FroTrkTargt2LatRelSpd 0;
BA_ "Remark" SG_ 783 ADC_FroTrkTargt2LatRelSpd "";
BA_ "EventCommandSignal" SG_ 783 ADC_FroTrkTargt2LongRelSpd 0;
BA_ "GatewayedSignals" SG_ 783 ADC_FroTrkTargt2LongRelSpd 0;
BA_ "GenSigInactiveValue" SG_ 783 ADC_FroTrkTargt2LongRelSpd 0;
BA_ "GenSigInvalidValue" SG_ 783 ADC_FroTrkTargt2LongRelSpd 0;
BA_ "GenSigSendType" SG_ 783 ADC_FroTrkTargt2LongRelSpd 1;
BA_ "GenSigStartValue" SG_ 783 ADC_FroTrkTargt2LongRelSpd 0;
BA_ "GenSigTimeoutValue" SG_ 783 ADC_FroTrkTargt2LongRelSpd 0;
BA_ "Remark" SG_ 783 ADC_FroTrkTargt2LongRelSpd "";
BA_ "EventCommandSignal" SG_ 783 ADC_FroTrkTargt2DetSensor 0;
BA_ "GatewayedSignals" SG_ 783 ADC_FroTrkTargt2DetSensor 0;
BA_ "GenSigInactiveValue" SG_ 783 ADC_FroTrkTargt2DetSensor 0;
BA_ "GenSigInvalidValue" SG_ 783 ADC_FroTrkTargt2DetSensor 0;
BA_ "GenSigSendType" SG_ 783 ADC_FroTrkTargt2DetSensor 1;
BA_ "GenSigStartValue" SG_ 783 ADC_FroTrkTargt2DetSensor 0;
BA_ "GenSigTimeoutValue" SG_ 783 ADC_FroTrkTargt2DetSensor 0;
BA_ "Remark" SG_ 783 ADC_FroTrkTargt2DetSensor "";
BA_ "EventCommandSignal" SG_ 783 ADC_FroTrkTargt3ObjClass 0;
BA_ "GatewayedSignals" SG_ 783 ADC_FroTrkTargt3ObjClass 0;
BA_ "GenSigInactiveValue" SG_ 783 ADC_FroTrkTargt3ObjClass 0;
BA_ "GenSigInvalidValue" SG_ 783 ADC_FroTrkTargt3ObjClass 0;
BA_ "GenSigSendType" SG_ 783 ADC_FroTrkTargt3ObjClass 1;
BA_ "GenSigStartValue" SG_ 783 ADC_FroTrkTargt3ObjClass 0;
BA_ "GenSigTimeoutValue" SG_ 783 ADC_FroTrkTargt3ObjClass 0;
BA_ "Remark" SG_ 783 ADC_FroTrkTargt3ObjClass "";
BA_ "EventCommandSignal" SG_ 783 ADC_FroTrkTargt3St 0;
BA_ "GatewayedSignals" SG_ 783 ADC_FroTrkTargt3St 0;
BA_ "GenSigInactiveValue" SG_ 783 ADC_FroTrkTargt3St 0;
BA_ "GenSigInvalidValue" SG_ 783 ADC_FroTrkTargt3St 0;
BA_ "GenSigSendType" SG_ 783 ADC_FroTrkTargt3St 1;
BA_ "GenSigStartValue" SG_ 783 ADC_FroTrkTargt3St 0;
BA_ "GenSigTimeoutValue" SG_ 783 ADC_FroTrkTargt3St 0;
BA_ "Remark" SG_ 783 ADC_FroTrkTargt3St "";
BA_ "EventCommandSignal" SG_ 783 ADC_FroTrkTargt3longPos 0;
BA_ "GatewayedSignals" SG_ 783 ADC_FroTrkTargt3longPos 0;
BA_ "GenSigInactiveValue" SG_ 783 ADC_FroTrkTargt3longPos 0;
BA_ "GenSigInvalidValue" SG_ 783 ADC_FroTrkTargt3longPos 0;
BA_ "GenSigSendType" SG_ 783 ADC_FroTrkTargt3longPos 1;
BA_ "GenSigStartValue" SG_ 783 ADC_FroTrkTargt3longPos 0;
BA_ "GenSigTimeoutValue" SG_ 783 ADC_FroTrkTargt3longPos 0;
BA_ "Remark" SG_ 783 ADC_FroTrkTargt3longPos "";
BA_ "EventCommandSignal" SG_ 783 ADC_FroTrkTargt3latPos 0;
BA_ "GatewayedSignals" SG_ 783 ADC_FroTrkTargt3latPos 0;
BA_ "GenSigInactiveValue" SG_ 783 ADC_FroTrkTargt3latPos 0;
BA_ "GenSigInvalidValue" SG_ 783 ADC_FroTrkTargt3latPos 0;
BA_ "GenSigSendType" SG_ 783 ADC_FroTrkTargt3latPos 1;
BA_ "GenSigStartValue" SG_ 783 ADC_FroTrkTargt3latPos 512;
BA_ "GenSigTimeoutValue" SG_ 783 ADC_FroTrkTargt3latPos 0;
BA_ "Remark" SG_ 783 ADC_FroTrkTargt3latPos "";
BA_ "EventCommandSignal" SG_ 783 ADC_Road_Type_Ahead 0;
BA_ "GatewayedSignals" SG_ 783 ADC_Road_Type_Ahead 0;
BA_ "GenSigInactiveValue" SG_ 783 ADC_Road_Type_Ahead 0;
BA_ "GenSigInvalidValue" SG_ 783 ADC_Road_Type_Ahead 31;
BA_ "GenSigSendType" SG_ 783 ADC_Road_Type_Ahead 1;
BA_ "GenSigStartValue" SG_ 783 ADC_Road_Type_Ahead 0;
BA_ "GenSigTimeoutValue" SG_ 783 ADC_Road_Type_Ahead 31;
BA_ "Remark" SG_ 783 ADC_Road_Type_Ahead "";
BA_ "EventCommandSignal" SG_ 783 ADC_FroTrkTargt3LatRelSpd 0;
BA_ "GatewayedSignals" SG_ 783 ADC_FroTrkTargt3LatRelSpd 0;
BA_ "GenSigInactiveValue" SG_ 783 ADC_FroTrkTargt3LatRelSpd 0;
BA_ "GenSigInvalidValue" SG_ 783 ADC_FroTrkTargt3LatRelSpd 0;
BA_ "GenSigSendType" SG_ 783 ADC_FroTrkTargt3LatRelSpd 1;
BA_ "GenSigStartValue" SG_ 783 ADC_FroTrkTargt3LatRelSpd 0;
BA_ "GenSigTimeoutValue" SG_ 783 ADC_FroTrkTargt3LatRelSpd 0;
BA_ "Remark" SG_ 783 ADC_FroTrkTargt3LatRelSpd "";
BA_ "EventCommandSignal" SG_ 783 ADC_FroTrkTargt3LongRelSpd 0;
BA_ "GatewayedSignals" SG_ 783 ADC_FroTrkTargt3LongRelSpd 0;
BA_ "GenSigInactiveValue" SG_ 783 ADC_FroTrkTargt3LongRelSpd 0;
BA_ "GenSigInvalidValue" SG_ 783 ADC_FroTrkTargt3LongRelSpd 0;
BA_ "GenSigSendType" SG_ 783 ADC_FroTrkTargt3LongRelSpd 1;
BA_ "GenSigStartValue" SG_ 783 ADC_FroTrkTargt3LongRelSpd 0;
BA_ "GenSigTimeoutValue" SG_ 783 ADC_FroTrkTargt3LongRelSpd 0;
BA_ "Remark" SG_ 783 ADC_FroTrkTargt3LongRelSpd "";
BA_ "EventCommandSignal" SG_ 783 ADC_FroTrkTargt3DetSensor 0;
BA_ "GatewayedSignals" SG_ 783 ADC_FroTrkTargt3DetSensor 0;
BA_ "GenSigInactiveValue" SG_ 783 ADC_FroTrkTargt3DetSensor 0;
BA_ "GenSigInvalidValue" SG_ 783 ADC_FroTrkTargt3DetSensor 0;
BA_ "GenSigSendType" SG_ 783 ADC_FroTrkTargt3DetSensor 1;
BA_ "GenSigStartValue" SG_ 783 ADC_FroTrkTargt3DetSensor 0;
BA_ "GenSigTimeoutValue" SG_ 783 ADC_FroTrkTargt3DetSensor 0;
BA_ "Remark" SG_ 783 ADC_FroTrkTargt3DetSensor "";
BA_ "EventCommandSignal" SG_ 783 ADC_LLnMrking_A0 0;
BA_ "GatewayedSignals" SG_ 783 ADC_LLnMrking_A0 0;
BA_ "GenSigInactiveValue" SG_ 783 ADC_LLnMrking_A0 0;
BA_ "GenSigInvalidValue" SG_ 783 ADC_LLnMrking_A0 0;
BA_ "GenSigSendType" SG_ 783 ADC_LLnMrking_A0 1;
BA_ "GenSigStartValue" SG_ 783 ADC_LLnMrking_A0 1023;
BA_ "GenSigTimeoutValue" SG_ 783 ADC_LLnMrking_A0 0;
BA_ "Remark" SG_ 783 ADC_LLnMrking_A0 "";
BA_ "EventCommandSignal" SG_ 783 ADC_LLnMrking_A1 0;
BA_ "GatewayedSignals" SG_ 783 ADC_LLnMrking_A1 0;
BA_ "GenSigInactiveValue" SG_ 783 ADC_LLnMrking_A1 0;
BA_ "GenSigInvalidValue" SG_ 783 ADC_LLnMrking_A1 0;
BA_ "GenSigSendType" SG_ 783 ADC_LLnMrking_A1 1;
BA_ "GenSigStartValue" SG_ 783 ADC_LLnMrking_A1 1023;
BA_ "GenSigTimeoutValue" SG_ 783 ADC_LLnMrking_A1 0;
BA_ "Remark" SG_ 783 ADC_LLnMrking_A1 "";
BA_ "EventCommandSignal" SG_ 783 ADC_LLnMrking_A2 0;
BA_ "GatewayedSignals" SG_ 783 ADC_LLnMrking_A2 0;
BA_ "GenSigInactiveValue" SG_ 783 ADC_LLnMrking_A2 0;
BA_ "GenSigInvalidValue" SG_ 783 ADC_LLnMrking_A2 0;
BA_ "GenSigSendType" SG_ 783 ADC_LLnMrking_A2 1;
BA_ "GenSigStartValue" SG_ 783 ADC_LLnMrking_A2 1023;
BA_ "GenSigTimeoutValue" SG_ 783 ADC_LLnMrking_A2 0;
BA_ "Remark" SG_ 783 ADC_LLnMrking_A2 "";
BA_ "EventCommandSignal" SG_ 783 ADC_LLnMrking_conf 0;
BA_ "GatewayedSignals" SG_ 783 ADC_LLnMrking_conf 0;
BA_ "GenSigInactiveValue" SG_ 783 ADC_LLnMrking_conf 0;
BA_ "GenSigInvalidValue" SG_ 783 ADC_LLnMrking_conf 0;
BA_ "GenSigSendType" SG_ 783 ADC_LLnMrking_conf 1;
BA_ "GenSigStartValue" SG_ 783 ADC_LLnMrking_conf 0;
BA_ "GenSigTimeoutValue" SG_ 783 ADC_LLnMrking_conf 0;
BA_ "Remark" SG_ 783 ADC_LLnMrking_conf "";
BA_ "EventCommandSignal" SG_ 783 ADC_LlnMrkingDispSt 0;
BA_ "GatewayedSignals" SG_ 783 ADC_LlnMrkingDispSt 0;
BA_ "GenSigInactiveValue" SG_ 783 ADC_LlnMrkingDispSt 0;
BA_ "GenSigInvalidValue" SG_ 783 ADC_LlnMrkingDispSt 0;
BA_ "GenSigSendType" SG_ 783 ADC_LlnMrkingDispSt 1;
BA_ "GenSigStartValue" SG_ 783 ADC_LlnMrkingDispSt 0;
BA_ "GenSigTimeoutValue" SG_ 783 ADC_LlnMrkingDispSt 0;
BA_ "Remark" SG_ 783 ADC_LlnMrkingDispSt "";
BA_ "EventCommandSignal" SG_ 783 ADC_LLnMrking_Range 0;
BA_ "GatewayedSignals" SG_ 783 ADC_LLnMrking_Range 0;
BA_ "GenSigInactiveValue" SG_ 783 ADC_LLnMrking_Range 0;
BA_ "GenSigInvalidValue" SG_ 783 ADC_LLnMrking_Range 0;
BA_ "GenSigSendType" SG_ 783 ADC_LLnMrking_Range 1;
BA_ "GenSigStartValue" SG_ 783 ADC_LLnMrking_Range 0;
BA_ "GenSigTimeoutValue" SG_ 783 ADC_LLnMrking_Range 0;
BA_ "Remark" SG_ 783 ADC_LLnMrking_Range "";
BA_ "EventCommandSignal" SG_ 783 ADC_LLnMrking_Type 0;
BA_ "GatewayedSignals" SG_ 783 ADC_LLnMrking_Type 0;
BA_ "GenSigInactiveValue" SG_ 783 ADC_LLnMrking_Type 0;
BA_ "GenSigInvalidValue" SG_ 783 ADC_LLnMrking_Type 0;
BA_ "GenSigSendType" SG_ 783 ADC_LLnMrking_Type 1;
BA_ "GenSigStartValue" SG_ 783 ADC_LLnMrking_Type 0;
BA_ "GenSigTimeoutValue" SG_ 783 ADC_LLnMrking_Type 0;
BA_ "Remark" SG_ 783 ADC_LLnMrking_Type "";
BA_ "EventCommandSignal" SG_ 783 ADC_RLnMrking_A0 0;
BA_ "GatewayedSignals" SG_ 783 ADC_RLnMrking_A0 0;
BA_ "GenSigInactiveValue" SG_ 783 ADC_RLnMrking_A0 0;
BA_ "GenSigInvalidValue" SG_ 783 ADC_RLnMrking_A0 0;
BA_ "GenSigSendType" SG_ 783 ADC_RLnMrking_A0 1;
BA_ "GenSigStartValue" SG_ 783 ADC_RLnMrking_A0 1023;
BA_ "GenSigTimeoutValue" SG_ 783 ADC_RLnMrking_A0 0;
BA_ "Remark" SG_ 783 ADC_RLnMrking_A0 "";
BA_ "EventCommandSignal" SG_ 783 ADC_RLnMrking_A1 0;
BA_ "GatewayedSignals" SG_ 783 ADC_RLnMrking_A1 0;
BA_ "GenSigInactiveValue" SG_ 783 ADC_RLnMrking_A1 0;
BA_ "GenSigInvalidValue" SG_ 783 ADC_RLnMrking_A1 0;
BA_ "GenSigSendType" SG_ 783 ADC_RLnMrking_A1 1;
BA_ "GenSigStartValue" SG_ 783 ADC_RLnMrking_A1 1023;
BA_ "GenSigTimeoutValue" SG_ 783 ADC_RLnMrking_A1 0;
BA_ "Remark" SG_ 783 ADC_RLnMrking_A1 "";
BA_ "EventCommandSignal" SG_ 783 ADC_RLnMrking_A2 0;
BA_ "GatewayedSignals" SG_ 783 ADC_RLnMrking_A2 0;
BA_ "GenSigInactiveValue" SG_ 783 ADC_RLnMrking_A2 0;
BA_ "GenSigInvalidValue" SG_ 783 ADC_RLnMrking_A2 0;
BA_ "GenSigSendType" SG_ 783 ADC_RLnMrking_A2 1;
BA_ "GenSigStartValue" SG_ 783 ADC_RLnMrking_A2 1023;
BA_ "GenSigTimeoutValue" SG_ 783 ADC_RLnMrking_A2 0;
BA_ "Remark" SG_ 783 ADC_RLnMrking_A2 "";
BA_ "EventCommandSignal" SG_ 783 ADC_RlnMrkingDispSt 0;
BA_ "GatewayedSignals" SG_ 783 ADC_RlnMrkingDispSt 0;
BA_ "GenSigInactiveValue" SG_ 783 ADC_RlnMrkingDispSt 0;
BA_ "GenSigInvalidValue" SG_ 783 ADC_RlnMrkingDispSt 0;
BA_ "GenSigSendType" SG_ 783 ADC_RlnMrkingDispSt 1;
BA_ "GenSigStartValue" SG_ 783 ADC_RlnMrkingDispSt 0;
BA_ "GenSigTimeoutValue" SG_ 783 ADC_RlnMrkingDispSt 0;
BA_ "Remark" SG_ 783 ADC_RlnMrkingDispSt "";
BA_ "EventCommandSignal" SG_ 783 ADC_RLnMrking_conf 0;
BA_ "GatewayedSignals" SG_ 783 ADC_RLnMrking_conf 0;
BA_ "GenSigInactiveValue" SG_ 783 ADC_RLnMrking_conf 0;
BA_ "GenSigInvalidValue" SG_ 783 ADC_RLnMrking_conf 0;
BA_ "GenSigSendType" SG_ 783 ADC_RLnMrking_conf 1;
BA_ "GenSigStartValue" SG_ 783 ADC_RLnMrking_conf 0;
BA_ "GenSigTimeoutValue" SG_ 783 ADC_RLnMrking_conf 0;
BA_ "Remark" SG_ 783 ADC_RLnMrking_conf "";
BA_ "EventCommandSignal" SG_ 783 ADC_RLnMrking_Range 0;
BA_ "GatewayedSignals" SG_ 783 ADC_RLnMrking_Range 0;
BA_ "GenSigInactiveValue" SG_ 783 ADC_RLnMrking_Range 0;
BA_ "GenSigInvalidValue" SG_ 783 ADC_RLnMrking_Range 0;
BA_ "GenSigSendType" SG_ 783 ADC_RLnMrking_Range 1;
BA_ "GenSigStartValue" SG_ 783 ADC_RLnMrking_Range 0;
BA_ "GenSigTimeoutValue" SG_ 783 ADC_RLnMrking_Range 0;
BA_ "Remark" SG_ 783 ADC_RLnMrking_Range "";
BA_ "EventCommandSignal" SG_ 783 ADC_RLnMrking_Type 0;
BA_ "GatewayedSignals" SG_ 783 ADC_RLnMrking_Type 0;
BA_ "GenSigInactiveValue" SG_ 783 ADC_RLnMrking_Type 0;
BA_ "GenSigInvalidValue" SG_ 783 ADC_RLnMrking_Type 0;
BA_ "GenSigSendType" SG_ 783 ADC_RLnMrking_Type 1;
BA_ "GenSigStartValue" SG_ 783 ADC_RLnMrking_Type 0;
BA_ "GenSigTimeoutValue" SG_ 783 ADC_RLnMrking_Type 0;
BA_ "Remark" SG_ 783 ADC_RLnMrking_Type "";
BA_ "EventCommandSignal" SG_ 783 ADC_Road_Type_Ahead_conf 0;
BA_ "GatewayedSignals" SG_ 783 ADC_Road_Type_Ahead_conf 0;
BA_ "GenSigInactiveValue" SG_ 783 ADC_Road_Type_Ahead_conf 0;
BA_ "GenSigInvalidValue" SG_ 783 ADC_Road_Type_Ahead_conf 63;
BA_ "GenSigSendType" SG_ 783 ADC_Road_Type_Ahead_conf 1;
BA_ "GenSigStartValue" SG_ 783 ADC_Road_Type_Ahead_conf 0;
BA_ "GenSigTimeoutValue" SG_ 783 ADC_Road_Type_Ahead_conf 63;
BA_ "Remark" SG_ 783 ADC_Road_Type_Ahead_conf "";
BA_ "EventCommandSignal" SG_ 659 ADC_5_CRC 0;
BA_ "GatewayedSignals" SG_ 659 ADC_5_CRC 0;
BA_ "GenSigInactiveValue" SG_ 659 ADC_5_CRC 0;
BA_ "GenSigInvalidValue" SG_ 659 ADC_5_CRC 0;
BA_ "GenSigSendType" SG_ 659 ADC_5_CRC 1;
BA_ "GenSigStartValue" SG_ 659 ADC_5_CRC 0;
BA_ "GenSigTimeoutValue" SG_ 659 ADC_5_CRC 0;
BA_ "Remark" SG_ 659 ADC_5_CRC "";
BA_ "EventCommandSignal" SG_ 659 ADC_5_Counter 0;
BA_ "GatewayedSignals" SG_ 659 ADC_5_Counter 0;
BA_ "GenSigInactiveValue" SG_ 659 ADC_5_Counter 0;
BA_ "GenSigInvalidValue" SG_ 659 ADC_5_Counter 0;
BA_ "GenSigSendType" SG_ 659 ADC_5_Counter 1;
BA_ "GenSigStartValue" SG_ 659 ADC_5_Counter 0;
BA_ "GenSigTimeoutValue" SG_ 659 ADC_5_Counter 0;
BA_ "Remark" SG_ 659 ADC_5_Counter "";
BA_ "EventCommandSignal" SG_ 659 ADC_NDASt 0;
BA_ "GatewayedSignals" SG_ 659 ADC_NDASt 0;
BA_ "GenSigInactiveValue" SG_ 659 ADC_NDASt 0;
BA_ "GenSigInvalidValue" SG_ 659 ADC_NDASt 0;
BA_ "GenSigSendType" SG_ 659 ADC_NDASt 1;
BA_ "GenSigStartValue" SG_ 659 ADC_NDASt 0;
BA_ "GenSigTimeoutValue" SG_ 659 ADC_NDASt 0;
BA_ "Remark" SG_ 659 ADC_NDASt "";
BA_ "EventCommandSignal" SG_ 659 ADC_NDATORType 0;
BA_ "GatewayedSignals" SG_ 659 ADC_NDATORType 0;
BA_ "GenSigInactiveValue" SG_ 659 ADC_NDATORType 0;
BA_ "GenSigInvalidValue" SG_ 659 ADC_NDATORType 0;
BA_ "GenSigSendType" SG_ 659 ADC_NDATORType 1;
BA_ "GenSigStartValue" SG_ 659 ADC_NDATORType 0;
BA_ "GenSigTimeoutValue" SG_ 659 ADC_NDATORType 0;
BA_ "Remark" SG_ 659 ADC_NDATORType "";
BA_ "EventCommandSignal" SG_ 659 ADC_NDASplitSt 0;
BA_ "GatewayedSignals" SG_ 659 ADC_NDASplitSt 0;
BA_ "GenSigInactiveValue" SG_ 659 ADC_NDASplitSt 0;
BA_ "GenSigInvalidValue" SG_ 659 ADC_NDASplitSt 0;
BA_ "GenSigSendType" SG_ 659 ADC_NDASplitSt 1;
BA_ "GenSigStartValue" SG_ 659 ADC_NDASplitSt 0;
BA_ "GenSigTimeoutValue" SG_ 659 ADC_NDASplitSt 0;
BA_ "Remark" SG_ 659 ADC_NDASplitSt "";
BA_ "EventCommandSignal" SG_ 659 ADC_NDARouteReplanning 0;
BA_ "GatewayedSignals" SG_ 659 ADC_NDARouteReplanning 0;
BA_ "GenSigInactiveValue" SG_ 659 ADC_NDARouteReplanning 0;
BA_ "GenSigInvalidValue" SG_ 659 ADC_NDARouteReplanning 0;
BA_ "GenSigSendType" SG_ 659 ADC_NDARouteReplanning 1;
BA_ "GenSigStartValue" SG_ 659 ADC_NDARouteReplanning 0;
BA_ "GenSigTimeoutValue" SG_ 659 ADC_NDARouteReplanning 0;
BA_ "Remark" SG_ 659 ADC_NDARouteReplanning "";
BA_ "EventCommandSignal" SG_ 659 ADC_LaneChangeType 0;
BA_ "GatewayedSignals" SG_ 659 ADC_LaneChangeType 0;
BA_ "GenSigInactiveValue" SG_ 659 ADC_LaneChangeType 0;
BA_ "GenSigInvalidValue" SG_ 659 ADC_LaneChangeType 0;
BA_ "GenSigSendType" SG_ 659 ADC_LaneChangeType 1;
BA_ "GenSigStartValue" SG_ 659 ADC_LaneChangeType 0;
BA_ "GenSigTimeoutValue" SG_ 659 ADC_LaneChangeType 0;
BA_ "Remark" SG_ 659 ADC_LaneChangeType "";
BA_ "EventCommandSignal" SG_ 659 ADC_FuncReq_SentryModWarn 0;
BA_ "GatewayedSignals" SG_ 659 ADC_FuncReq_SentryModWarn 0;
BA_ "GenSigInactiveValue" SG_ 659 ADC_FuncReq_SentryModWarn 0;
BA_ "GenSigInvalidValue" SG_ 659 ADC_FuncReq_SentryModWarn 0;
BA_ "GenSigSendType" SG_ 659 ADC_FuncReq_SentryModWarn 1;
BA_ "GenSigStartValue" SG_ 659 ADC_FuncReq_SentryModWarn 0;
BA_ "GenSigTimeoutValue" SG_ 659 ADC_FuncReq_SentryModWarn 0;
BA_ "Remark" SG_ 659 ADC_FuncReq_SentryModWarn "";
BA_ "EventCommandSignal" SG_ 659 ADC_TlaWarning 0;
BA_ "GatewayedSignals" SG_ 659 ADC_TlaWarning 0;
BA_ "GenSigInactiveValue" SG_ 659 ADC_TlaWarning 0;
BA_ "GenSigInvalidValue" SG_ 659 ADC_TlaWarning 0;
BA_ "GenSigSendType" SG_ 659 ADC_TlaWarning 1;
BA_ "GenSigStartValue" SG_ 659 ADC_TlaWarning 0;
BA_ "GenSigTimeoutValue" SG_ 659 ADC_TlaWarning 0;
BA_ "Remark" SG_ 659 ADC_TlaWarning "";
BA_ "EventCommandSignal" SG_ 659 ADC_TlaFault 0;
BA_ "GatewayedSignals" SG_ 659 ADC_TlaFault 0;
BA_ "GenSigInactiveValue" SG_ 659 ADC_TlaFault 0;
BA_ "GenSigInvalidValue" SG_ 659 ADC_TlaFault 0;
BA_ "GenSigSendType" SG_ 659 ADC_TlaFault 1;
BA_ "GenSigStartValue" SG_ 659 ADC_TlaFault 0;
BA_ "GenSigTimeoutValue" SG_ 659 ADC_TlaFault 0;
BA_ "Remark" SG_ 659 ADC_TlaFault "";
BA_ "EventCommandSignal" SG_ 659 ADC_FcwWaning 0;
BA_ "GatewayedSignals" SG_ 659 ADC_FcwWaning 0;
BA_ "GenSigInactiveValue" SG_ 659 ADC_FcwWaning 0;
BA_ "GenSigInvalidValue" SG_ 659 ADC_FcwWaning 0;
BA_ "GenSigSendType" SG_ 659 ADC_FcwWaning 1;
BA_ "GenSigStartValue" SG_ 659 ADC_FcwWaning 0;
BA_ "GenSigTimeoutValue" SG_ 659 ADC_FcwWaning 0;
BA_ "Remark" SG_ 659 ADC_FcwWaning "";
BA_ "EventCommandSignal" SG_ 659 ADC_AebFault 0;
BA_ "GatewayedSignals" SG_ 659 ADC_AebFault 0;
BA_ "GenSigInactiveValue" SG_ 659 ADC_AebFault 0;
BA_ "GenSigInvalidValue" SG_ 659 ADC_AebFault 0;
BA_ "GenSigSendType" SG_ 659 ADC_AebFault 1;
BA_ "GenSigStartValue" SG_ 659 ADC_AebFault 0;
BA_ "GenSigTimeoutValue" SG_ 659 ADC_AebFault 0;
BA_ "Remark" SG_ 659 ADC_AebFault "";
BA_ "EventCommandSignal" SG_ 659 ADC_RaebWarning 0;
BA_ "GatewayedSignals" SG_ 659 ADC_RaebWarning 0;
BA_ "GenSigInactiveValue" SG_ 659 ADC_RaebWarning 0;
BA_ "GenSigInvalidValue" SG_ 659 ADC_RaebWarning 0;
BA_ "GenSigSendType" SG_ 659 ADC_RaebWarning 1;
BA_ "GenSigStartValue" SG_ 659 ADC_RaebWarning 0;
BA_ "GenSigTimeoutValue" SG_ 659 ADC_RaebWarning 0;
BA_ "Remark" SG_ 659 ADC_RaebWarning "";
BA_ "EventCommandSignal" SG_ 659 ADC_RaebFault 0;
BA_ "GatewayedSignals" SG_ 659 ADC_RaebFault 0;
BA_ "GenSigInactiveValue" SG_ 659 ADC_RaebFault 0;
BA_ "GenSigInvalidValue" SG_ 659 ADC_RaebFault 0;
BA_ "GenSigSendType" SG_ 659 ADC_RaebFault 1;
BA_ "GenSigStartValue" SG_ 659 ADC_RaebFault 0;
BA_ "GenSigTimeoutValue" SG_ 659 ADC_RaebFault 0;
BA_ "Remark" SG_ 659 ADC_RaebFault "";
BA_ "EventCommandSignal" SG_ 659 ADC_RcwFault 0;
BA_ "GatewayedSignals" SG_ 659 ADC_RcwFault 0;
BA_ "GenSigInactiveValue" SG_ 659 ADC_RcwFault 0;
BA_ "GenSigInvalidValue" SG_ 659 ADC_RcwFault 0;
BA_ "GenSigSendType" SG_ 659 ADC_RcwFault 1;
BA_ "GenSigStartValue" SG_ 659 ADC_RcwFault 0;
BA_ "GenSigTimeoutValue" SG_ 659 ADC_RcwFault 0;
BA_ "Remark" SG_ 659 ADC_RcwFault "";
BA_ "EventCommandSignal" SG_ 659 ADC_FctbLeftWarning 0;
BA_ "GatewayedSignals" SG_ 659 ADC_FctbLeftWarning 0;
BA_ "GenSigInactiveValue" SG_ 659 ADC_FctbLeftWarning 0;
BA_ "GenSigInvalidValue" SG_ 659 ADC_FctbLeftWarning 0;
BA_ "GenSigSendType" SG_ 659 ADC_FctbLeftWarning 1;
BA_ "GenSigStartValue" SG_ 659 ADC_FctbLeftWarning 0;
BA_ "GenSigTimeoutValue" SG_ 659 ADC_FctbLeftWarning 0;
BA_ "Remark" SG_ 659 ADC_FctbLeftWarning "";
BA_ "EventCommandSignal" SG_ 659 ADC_FctbRightWarning 0;
BA_ "GatewayedSignals" SG_ 659 ADC_FctbRightWarning 0;
BA_ "GenSigInactiveValue" SG_ 659 ADC_FctbRightWarning 0;
BA_ "GenSigInvalidValue" SG_ 659 ADC_FctbRightWarning 0;
BA_ "GenSigSendType" SG_ 659 ADC_FctbRightWarning 1;
BA_ "GenSigStartValue" SG_ 659 ADC_FctbRightWarning 0;
BA_ "GenSigTimeoutValue" SG_ 659 ADC_FctbRightWarning 0;
BA_ "Remark" SG_ 659 ADC_FctbRightWarning "";
BA_ "EventCommandSignal" SG_ 659 ADC_RctaFault 0;
BA_ "GatewayedSignals" SG_ 659 ADC_RctaFault 0;
BA_ "GenSigInactiveValue" SG_ 659 ADC_RctaFault 0;
BA_ "GenSigInvalidValue" SG_ 659 ADC_RctaFault 0;
BA_ "GenSigSendType" SG_ 659 ADC_RctaFault 1;
BA_ "GenSigStartValue" SG_ 659 ADC_RctaFault 0;
BA_ "GenSigTimeoutValue" SG_ 659 ADC_RctaFault 0;
BA_ "Remark" SG_ 659 ADC_RctaFault "";
BA_ "EventCommandSignal" SG_ 659 ADC_RctbLeftWarning 0;
BA_ "GatewayedSignals" SG_ 659 ADC_RctbLeftWarning 0;
BA_ "GenSigInactiveValue" SG_ 659 ADC_RctbLeftWarning 0;
BA_ "GenSigInvalidValue" SG_ 659 ADC_RctbLeftWarning 0;
BA_ "GenSigSendType" SG_ 659 ADC_RctbLeftWarning 1;
BA_ "GenSigStartValue" SG_ 659 ADC_RctbLeftWarning 0;
BA_ "GenSigTimeoutValue" SG_ 659 ADC_RctbLeftWarning 0;
BA_ "Remark" SG_ 659 ADC_RctbLeftWarning "";
BA_ "EventCommandSignal" SG_ 659 ADC_RctbRightWarning 0;
BA_ "GatewayedSignals" SG_ 659 ADC_RctbRightWarning 0;
BA_ "GenSigInactiveValue" SG_ 659 ADC_RctbRightWarning 0;
BA_ "GenSigInvalidValue" SG_ 659 ADC_RctbRightWarning 0;
BA_ "GenSigSendType" SG_ 659 ADC_RctbRightWarning 1;
BA_ "GenSigStartValue" SG_ 659 ADC_RctbRightWarning 0;
BA_ "GenSigTimeoutValue" SG_ 659 ADC_RctbRightWarning 0;
BA_ "Remark" SG_ 659 ADC_RctbRightWarning "";
BA_ "EventCommandSignal" SG_ 659 ADC_LdwFault 0;
BA_ "GatewayedSignals" SG_ 659 ADC_LdwFault 0;
BA_ "GenSigInactiveValue" SG_ 659 ADC_LdwFault 0;
BA_ "GenSigInvalidValue" SG_ 659 ADC_LdwFault 0;
BA_ "GenSigSendType" SG_ 659 ADC_LdwFault 1;
BA_ "GenSigStartValue" SG_ 659 ADC_LdwFault 0;
BA_ "GenSigTimeoutValue" SG_ 659 ADC_LdwFault 0;
BA_ "Remark" SG_ 659 ADC_LdwFault "";
BA_ "EventCommandSignal" SG_ 659 ADC_LkaFault 0;
BA_ "GatewayedSignals" SG_ 659 ADC_LkaFault 0;
BA_ "GenSigInactiveValue" SG_ 659 ADC_LkaFault 0;
BA_ "GenSigInvalidValue" SG_ 659 ADC_LkaFault 0;
BA_ "GenSigSendType" SG_ 659 ADC_LkaFault 1;
BA_ "GenSigStartValue" SG_ 659 ADC_LkaFault 0;
BA_ "GenSigTimeoutValue" SG_ 659 ADC_LkaFault 0;
BA_ "Remark" SG_ 659 ADC_LkaFault "";
BA_ "EventCommandSignal" SG_ 659 ADC_BsdFault 0;
BA_ "GatewayedSignals" SG_ 659 ADC_BsdFault 0;
BA_ "GenSigInactiveValue" SG_ 659 ADC_BsdFault 0;
BA_ "GenSigInvalidValue" SG_ 659 ADC_BsdFault 0;
BA_ "GenSigSendType" SG_ 659 ADC_BsdFault 1;
BA_ "GenSigStartValue" SG_ 659 ADC_BsdFault 0;
BA_ "GenSigTimeoutValue" SG_ 659 ADC_BsdFault 0;
BA_ "Remark" SG_ 659 ADC_BsdFault "";
BA_ "EventCommandSignal" SG_ 659 ADC_DowFault 0;
BA_ "GatewayedSignals" SG_ 659 ADC_DowFault 0;
BA_ "GenSigInactiveValue" SG_ 659 ADC_DowFault 0;
BA_ "GenSigInvalidValue" SG_ 659 ADC_DowFault 0;
BA_ "GenSigSendType" SG_ 659 ADC_DowFault 1;
BA_ "GenSigStartValue" SG_ 659 ADC_DowFault 0;
BA_ "GenSigTimeoutValue" SG_ 659 ADC_DowFault 0;
BA_ "Remark" SG_ 659 ADC_DowFault "";
BA_ "EventCommandSignal" SG_ 659 ADC_TsrFault 0;
BA_ "GatewayedSignals" SG_ 659 ADC_TsrFault 0;
BA_ "GenSigInactiveValue" SG_ 659 ADC_TsrFault 0;
BA_ "GenSigInvalidValue" SG_ 659 ADC_TsrFault 0;
BA_ "GenSigSendType" SG_ 659 ADC_TsrFault 1;
BA_ "GenSigStartValue" SG_ 659 ADC_TsrFault 0;
BA_ "GenSigTimeoutValue" SG_ 659 ADC_TsrFault 0;
BA_ "Remark" SG_ 659 ADC_TsrFault "";
BA_ "EventCommandSignal" SG_ 659 ADC_ElkaWarning 0;
BA_ "GatewayedSignals" SG_ 659 ADC_ElkaWarning 0;
BA_ "GenSigInactiveValue" SG_ 659 ADC_ElkaWarning 0;
BA_ "GenSigInvalidValue" SG_ 659 ADC_ElkaWarning 0;
BA_ "GenSigSendType" SG_ 659 ADC_ElkaWarning 1;
BA_ "GenSigStartValue" SG_ 659 ADC_ElkaWarning 0;
BA_ "GenSigTimeoutValue" SG_ 659 ADC_ElkaWarning 0;
BA_ "Remark" SG_ 659 ADC_ElkaWarning "";
BA_ "EventCommandSignal" SG_ 659 ADC_ElkaFault 0;
BA_ "GatewayedSignals" SG_ 659 ADC_ElkaFault 0;
BA_ "GenSigInactiveValue" SG_ 659 ADC_ElkaFault 0;
BA_ "GenSigInvalidValue" SG_ 659 ADC_ElkaFault 0;
BA_ "GenSigSendType" SG_ 659 ADC_ElkaFault 1;
BA_ "GenSigStartValue" SG_ 659 ADC_ElkaFault 0;
BA_ "GenSigTimeoutValue" SG_ 659 ADC_ElkaFault 0;
BA_ "Remark" SG_ 659 ADC_ElkaFault "";
BA_ "EventCommandSignal" SG_ 659 ADC_IMURollingCounter 0;
BA_ "GatewayedSignals" SG_ 659 ADC_IMURollingCounter 0;
BA_ "GenSigInactiveValue" SG_ 659 ADC_IMURollingCounter 0;
BA_ "GenSigInvalidValue" SG_ 659 ADC_IMURollingCounter 0;
BA_ "GenSigSendType" SG_ 659 ADC_IMURollingCounter 1;
BA_ "GenSigStartValue" SG_ 659 ADC_IMURollingCounter 0;
BA_ "GenSigTimeoutValue" SG_ 659 ADC_IMURollingCounter 255;
BA_ "Remark" SG_ 659 ADC_IMURollingCounter "未给主机接收";
BA_ "EventCommandSignal" SG_ 659 ADC_IMUAccX 0;
BA_ "GatewayedSignals" SG_ 659 ADC_IMUAccX 0;
BA_ "GenSigInactiveValue" SG_ 659 ADC_IMUAccX 0;
BA_ "GenSigInvalidValue" SG_ 659 ADC_IMUAccX 0;
BA_ "GenSigSendType" SG_ 659 ADC_IMUAccX 1;
BA_ "GenSigStartValue" SG_ 659 ADC_IMUAccX 32768;
BA_ "GenSigTimeoutValue" SG_ 659 ADC_IMUAccX 65535;
BA_ "Remark" SG_ 659 ADC_IMUAccX "未给主机接收";
BA_ "EventCommandSignal" SG_ 659 ADC_IMUAccY 0;
BA_ "GatewayedSignals" SG_ 659 ADC_IMUAccY 0;
BA_ "GenSigInactiveValue" SG_ 659 ADC_IMUAccY 0;
BA_ "GenSigInvalidValue" SG_ 659 ADC_IMUAccY 0;
BA_ "GenSigSendType" SG_ 659 ADC_IMUAccY 1;
BA_ "GenSigStartValue" SG_ 659 ADC_IMUAccY 32768;
BA_ "GenSigTimeoutValue" SG_ 659 ADC_IMUAccY 65535;
BA_ "Remark" SG_ 659 ADC_IMUAccY "未给主机接收";
BA_ "EventCommandSignal" SG_ 659 ADC_IMUAccZ 0;
BA_ "GatewayedSignals" SG_ 659 ADC_IMUAccZ 0;
BA_ "GenSigInactiveValue" SG_ 659 ADC_IMUAccZ 0;
BA_ "GenSigInvalidValue" SG_ 659 ADC_IMUAccZ 0;
BA_ "GenSigSendType" SG_ 659 ADC_IMUAccZ 1;
BA_ "GenSigStartValue" SG_ 659 ADC_IMUAccZ 32768;
BA_ "GenSigTimeoutValue" SG_ 659 ADC_IMUAccZ 65535;
BA_ "Remark" SG_ 659 ADC_IMUAccZ "未给主机接收";
BA_ "EventCommandSignal" SG_ 659 ADC_IMUGyroX 0;
BA_ "GatewayedSignals" SG_ 659 ADC_IMUGyroX 0;
BA_ "GenSigInactiveValue" SG_ 659 ADC_IMUGyroX 0;
BA_ "GenSigInvalidValue" SG_ 659 ADC_IMUGyroX 0;
BA_ "GenSigSendType" SG_ 659 ADC_IMUGyroX 1;
BA_ "GenSigStartValue" SG_ 659 ADC_IMUGyroX 32768;
BA_ "GenSigTimeoutValue" SG_ 659 ADC_IMUGyroX 65535;
BA_ "Remark" SG_ 659 ADC_IMUGyroX "未给主机接收";
BA_ "EventCommandSignal" SG_ 659 ADC_IMUGyroY 0;
BA_ "GatewayedSignals" SG_ 659 ADC_IMUGyroY 0;
BA_ "GenSigInactiveValue" SG_ 659 ADC_IMUGyroY 0;
BA_ "GenSigInvalidValue" SG_ 659 ADC_IMUGyroY 0;
BA_ "GenSigSendType" SG_ 659 ADC_IMUGyroY 1;
BA_ "GenSigStartValue" SG_ 659 ADC_IMUGyroY 32768;
BA_ "GenSigTimeoutValue" SG_ 659 ADC_IMUGyroY 65535;
BA_ "Remark" SG_ 659 ADC_IMUGyroY "未给主机接收";
BA_ "EventCommandSignal" SG_ 659 ADC_IMUGyroZ 0;
BA_ "GatewayedSignals" SG_ 659 ADC_IMUGyroZ 0;
BA_ "GenSigInactiveValue" SG_ 659 ADC_IMUGyroZ 0;
BA_ "GenSigInvalidValue" SG_ 659 ADC_IMUGyroZ 0;
BA_ "GenSigSendType" SG_ 659 ADC_IMUGyroZ 1;
BA_ "GenSigStartValue" SG_ 659 ADC_IMUGyroZ 32768;
BA_ "GenSigTimeoutValue" SG_ 659 ADC_IMUGyroZ 65535;
BA_ "Remark" SG_ 659 ADC_IMUGyroZ "未给主机接收";
BA_ "EventCommandSignal" SG_ 659 ADC_IMURoll 0;
BA_ "GatewayedSignals" SG_ 659 ADC_IMURoll 0;
BA_ "GenSigInactiveValue" SG_ 659 ADC_IMURoll 0;
BA_ "GenSigInvalidValue" SG_ 659 ADC_IMURoll 0;
BA_ "GenSigSendType" SG_ 659 ADC_IMURoll 1;
BA_ "GenSigStartValue" SG_ 659 ADC_IMURoll 18000;
BA_ "GenSigTimeoutValue" SG_ 659 ADC_IMURoll 65535;
BA_ "Remark" SG_ 659 ADC_IMURoll "未给主机接收";
BA_ "EventCommandSignal" SG_ 659 ADC_IMUPitch 0;
BA_ "GatewayedSignals" SG_ 659 ADC_IMUPitch 0;
BA_ "GenSigInactiveValue" SG_ 659 ADC_IMUPitch 0;
BA_ "GenSigInvalidValue" SG_ 659 ADC_IMUPitch 0;
BA_ "GenSigSendType" SG_ 659 ADC_IMUPitch 1;
BA_ "GenSigStartValue" SG_ 659 ADC_IMUPitch 18000;
BA_ "GenSigTimeoutValue" SG_ 659 ADC_IMUPitch 65535;
BA_ "Remark" SG_ 659 ADC_IMUPitch "未给主机接收";
BA_ "EventCommandSignal" SG_ 659 ADC_IMUYaw 0;
BA_ "GatewayedSignals" SG_ 659 ADC_IMUYaw 0;
BA_ "GenSigInactiveValue" SG_ 659 ADC_IMUYaw 0;
BA_ "GenSigInvalidValue" SG_ 659 ADC_IMUYaw 0;
BA_ "GenSigSendType" SG_ 659 ADC_IMUYaw 1;
BA_ "GenSigStartValue" SG_ 659 ADC_IMUYaw 0;
BA_ "GenSigTimeoutValue" SG_ 659 ADC_IMUYaw 65535;
BA_ "Remark" SG_ 659 ADC_IMUYaw "未给主机接收";
BA_ "EventCommandSignal" SG_ 659 ADC_IMUTimestampVld 0;
BA_ "GatewayedSignals" SG_ 659 ADC_IMUTimestampVld 0;
BA_ "GenSigInactiveValue" SG_ 659 ADC_IMUTimestampVld 0;
BA_ "GenSigInvalidValue" SG_ 659 ADC_IMUTimestampVld 0;
BA_ "GenSigSendType" SG_ 659 ADC_IMUTimestampVld 1;
BA_ "GenSigStartValue" SG_ 659 ADC_IMUTimestampVld 0;
BA_ "GenSigTimeoutValue" SG_ 659 ADC_IMUTimestampVld 0;
BA_ "Remark" SG_ 659 ADC_IMUTimestampVld "未给主机接收";
BA_ "EventCommandSignal" SG_ 659 ADC_IMUAccVld 0;
BA_ "GatewayedSignals" SG_ 659 ADC_IMUAccVld 0;
BA_ "GenSigInactiveValue" SG_ 659 ADC_IMUAccVld 0;
BA_ "GenSigInvalidValue" SG_ 659 ADC_IMUAccVld 0;
BA_ "GenSigSendType" SG_ 659 ADC_IMUAccVld 1;
BA_ "GenSigStartValue" SG_ 659 ADC_IMUAccVld 0;
BA_ "GenSigTimeoutValue" SG_ 659 ADC_IMUAccVld 0;
BA_ "Remark" SG_ 659 ADC_IMUAccVld "未给主机接收";
BA_ "EventCommandSignal" SG_ 659 ADC_IMUGyroVld 0;
BA_ "GatewayedSignals" SG_ 659 ADC_IMUGyroVld 0;
BA_ "GenSigInactiveValue" SG_ 659 ADC_IMUGyroVld 0;
BA_ "GenSigInvalidValue" SG_ 659 ADC_IMUGyroVld 0;
BA_ "GenSigSendType" SG_ 659 ADC_IMUGyroVld 1;
BA_ "GenSigStartValue" SG_ 659 ADC_IMUGyroVld 0;
BA_ "GenSigTimeoutValue" SG_ 659 ADC_IMUGyroVld 0;
BA_ "Remark" SG_ 659 ADC_IMUGyroVld "未给主机接收";
BA_ "EventCommandSignal" SG_ 659 ADC_IMUAttitudeVld 0;
BA_ "GatewayedSignals" SG_ 659 ADC_IMUAttitudeVld 0;
BA_ "GenSigInactiveValue" SG_ 659 ADC_IMUAttitudeVld 0;
BA_ "GenSigInvalidValue" SG_ 659 ADC_IMUAttitudeVld 0;
BA_ "GenSigSendType" SG_ 659 ADC_IMUAttitudeVld 1;
BA_ "GenSigStartValue" SG_ 659 ADC_IMUAttitudeVld 0;
BA_ "GenSigTimeoutValue" SG_ 659 ADC_IMUAttitudeVld 0;
BA_ "Remark" SG_ 659 ADC_IMUAttitudeVld "未给主机接收";
BA_ "EventCommandSignal" SG_ 659 ADC_IMUPositionType 0;
BA_ "GatewayedSignals" SG_ 659 ADC_IMUPositionType 0;
BA_ "GenSigInactiveValue" SG_ 659 ADC_IMUPositionType 0;
BA_ "GenSigInvalidValue" SG_ 659 ADC_IMUPositionType 0;
BA_ "GenSigSendType" SG_ 659 ADC_IMUPositionType 1;
BA_ "GenSigStartValue" SG_ 659 ADC_IMUPositionType 0;
BA_ "GenSigTimeoutValue" SG_ 659 ADC_IMUPositionType 0;
BA_ "Remark" SG_ 659 ADC_IMUPositionType "未给主机接收";
BA_ "EventCommandSignal" SG_ 659 ADC_IMUTimestamp 0;
BA_ "GatewayedSignals" SG_ 659 ADC_IMUTimestamp 0;
BA_ "GenSigInactiveValue" SG_ 659 ADC_IMUTimestamp 0;
BA_ "GenSigInvalidValue" SG_ 659 ADC_IMUTimestamp 0;
BA_ "GenSigSendType" SG_ 659 ADC_IMUTimestamp 1;
BA_ "GenSigStartValue" SG_ 659 ADC_IMUTimestamp 0;
BA_ "GenSigTimeoutValue" SG_ 659 ADC_IMUTimestamp 4294967295;
BA_ "Remark" SG_ 659 ADC_IMUTimestamp "未给主机接收";
BA_ "EventCommandSignal" SG_ 659 ADC_AbsoultwSpeedLimit 0;
BA_ "GatewayedSignals" SG_ 659 ADC_AbsoultwSpeedLimit 0;
BA_ "GenSigInactiveValue" SG_ 659 ADC_AbsoultwSpeedLimit 0;
BA_ "GenSigInvalidValue" SG_ 659 ADC_AbsoultwSpeedLimit 0;
BA_ "GenSigSendType" SG_ 659 ADC_AbsoultwSpeedLimit 1;
BA_ "GenSigStartValue" SG_ 659 ADC_AbsoultwSpeedLimit 0;
BA_ "GenSigTimeoutValue" SG_ 659 ADC_AbsoultwSpeedLimit 0;
BA_ "Remark" SG_ 659 ADC_AbsoultwSpeedLimit "";
BA_ "EventCommandSignal" SG_ 923 ADC_6_CRC 0;
BA_ "GatewayedSignals" SG_ 923 ADC_6_CRC 0;
BA_ "GenSigInactiveValue" SG_ 923 ADC_6_CRC 0;
BA_ "GenSigInvalidValue" SG_ 923 ADC_6_CRC 0;
BA_ "GenSigSendType" SG_ 923 ADC_6_CRC 1;
BA_ "GenSigStartValue" SG_ 923 ADC_6_CRC 0;
BA_ "GenSigTimeoutValue" SG_ 923 ADC_6_CRC 0;
BA_ "Remark" SG_ 923 ADC_6_CRC "";
BA_ "EventCommandSignal" SG_ 923 ADC_6_Counter 0;
BA_ "GatewayedSignals" SG_ 923 ADC_6_Counter 0;
BA_ "GenSigInactiveValue" SG_ 923 ADC_6_Counter 0;
BA_ "GenSigInvalidValue" SG_ 923 ADC_6_Counter 0;
BA_ "GenSigSendType" SG_ 923 ADC_6_Counter 1;
BA_ "GenSigStartValue" SG_ 923 ADC_6_Counter 0;
BA_ "GenSigTimeoutValue" SG_ 923 ADC_6_Counter 0;
BA_ "Remark" SG_ 923 ADC_6_Counter "";
BA_ "EventCommandSignal" SG_ 923 ADC_FrontWideCameraSt 0;
BA_ "GatewayedSignals" SG_ 923 ADC_FrontWideCameraSt 0;
BA_ "GenSigInactiveValue" SG_ 923 ADC_FrontWideCameraSt 0;
BA_ "GenSigInvalidValue" SG_ 923 ADC_FrontWideCameraSt 0;
BA_ "GenSigSendType" SG_ 923 ADC_FrontWideCameraSt 1;
BA_ "GenSigStartValue" SG_ 923 ADC_FrontWideCameraSt 0;
BA_ "GenSigTimeoutValue" SG_ 923 ADC_FrontWideCameraSt 0;
BA_ "Remark" SG_ 923 ADC_FrontWideCameraSt "";
BA_ "EventCommandSignal" SG_ 923 ADC_FrontNarrowCameraSt 0;
BA_ "GatewayedSignals" SG_ 923 ADC_FrontNarrowCameraSt 0;
BA_ "GenSigInactiveValue" SG_ 923 ADC_FrontNarrowCameraSt 0;
BA_ "GenSigInvalidValue" SG_ 923 ADC_FrontNarrowCameraSt 0;
BA_ "GenSigSendType" SG_ 923 ADC_FrontNarrowCameraSt 1;
BA_ "GenSigStartValue" SG_ 923 ADC_FrontNarrowCameraSt 0;
BA_ "GenSigTimeoutValue" SG_ 923 ADC_FrontNarrowCameraSt 0;
BA_ "Remark" SG_ 923 ADC_FrontNarrowCameraSt "";
BA_ "EventCommandSignal" SG_ 923 ADC_LeftFrontCameraSt 0;
BA_ "GatewayedSignals" SG_ 923 ADC_LeftFrontCameraSt 0;
BA_ "GenSigInactiveValue" SG_ 923 ADC_LeftFrontCameraSt 0;
BA_ "GenSigInvalidValue" SG_ 923 ADC_LeftFrontCameraSt 0;
BA_ "GenSigSendType" SG_ 923 ADC_LeftFrontCameraSt 1;
BA_ "GenSigStartValue" SG_ 923 ADC_LeftFrontCameraSt 0;
BA_ "GenSigTimeoutValue" SG_ 923 ADC_LeftFrontCameraSt 0;
BA_ "Remark" SG_ 923 ADC_LeftFrontCameraSt "";
BA_ "EventCommandSignal" SG_ 923 ADC_LeftRearCameraSt 0;
BA_ "GatewayedSignals" SG_ 923 ADC_LeftRearCameraSt 0;
BA_ "GenSigInactiveValue" SG_ 923 ADC_LeftRearCameraSt 0;
BA_ "GenSigInvalidValue" SG_ 923 ADC_LeftRearCameraSt 0;
BA_ "GenSigSendType" SG_ 923 ADC_LeftRearCameraSt 1;
BA_ "GenSigStartValue" SG_ 923 ADC_LeftRearCameraSt 0;
BA_ "GenSigTimeoutValue" SG_ 923 ADC_LeftRearCameraSt 0;
BA_ "Remark" SG_ 923 ADC_LeftRearCameraSt "";
BA_ "EventCommandSignal" SG_ 923 ADC_RightFrontCameraSt 0;
BA_ "GatewayedSignals" SG_ 923 ADC_RightFrontCameraSt 0;
BA_ "GenSigInactiveValue" SG_ 923 ADC_RightFrontCameraSt 0;
BA_ "GenSigInvalidValue" SG_ 923 ADC_RightFrontCameraSt 0;
BA_ "GenSigSendType" SG_ 923 ADC_RightFrontCameraSt 1;
BA_ "GenSigStartValue" SG_ 923 ADC_RightFrontCameraSt 0;
BA_ "GenSigTimeoutValue" SG_ 923 ADC_RightFrontCameraSt 0;
BA_ "Remark" SG_ 923 ADC_RightFrontCameraSt "";
BA_ "EventCommandSignal" SG_ 923 ADC_RightRearCameraSt 0;
BA_ "GatewayedSignals" SG_ 923 ADC_RightRearCameraSt 0;
BA_ "GenSigInactiveValue" SG_ 923 ADC_RightRearCameraSt 0;
BA_ "GenSigInvalidValue" SG_ 923 ADC_RightRearCameraSt 0;
BA_ "GenSigSendType" SG_ 923 ADC_RightRearCameraSt 1;
BA_ "GenSigStartValue" SG_ 923 ADC_RightRearCameraSt 0;
BA_ "GenSigTimeoutValue" SG_ 923 ADC_RightRearCameraSt 0;
BA_ "Remark" SG_ 923 ADC_RightRearCameraSt "";
BA_ "EventCommandSignal" SG_ 923 ADC_RearCameraSt 0;
BA_ "GatewayedSignals" SG_ 923 ADC_RearCameraSt 0;
BA_ "GenSigInactiveValue" SG_ 923 ADC_RearCameraSt 0;
BA_ "GenSigInvalidValue" SG_ 923 ADC_RearCameraSt 0;
BA_ "GenSigSendType" SG_ 923 ADC_RearCameraSt 1;
BA_ "GenSigStartValue" SG_ 923 ADC_RearCameraSt 0;
BA_ "GenSigTimeoutValue" SG_ 923 ADC_RearCameraSt 0;
BA_ "Remark" SG_ 923 ADC_RearCameraSt "";
BA_ "EventCommandSignal" SG_ 923 ADC_FrontRadarSt 0;
BA_ "GatewayedSignals" SG_ 923 ADC_FrontRadarSt 0;
BA_ "GenSigInactiveValue" SG_ 923 ADC_FrontRadarSt 0;
BA_ "GenSigInvalidValue" SG_ 923 ADC_FrontRadarSt 0;
BA_ "GenSigSendType" SG_ 923 ADC_FrontRadarSt 1;
BA_ "GenSigStartValue" SG_ 923 ADC_FrontRadarSt 0;
BA_ "GenSigTimeoutValue" SG_ 923 ADC_FrontRadarSt 0;
BA_ "Remark" SG_ 923 ADC_FrontRadarSt "";
BA_ "EventCommandSignal" SG_ 923 ADC_LeftFrontRadarSt 0;
BA_ "GatewayedSignals" SG_ 923 ADC_LeftFrontRadarSt 0;
BA_ "GenSigInactiveValue" SG_ 923 ADC_LeftFrontRadarSt 0;
BA_ "GenSigInvalidValue" SG_ 923 ADC_LeftFrontRadarSt 0;
BA_ "GenSigSendType" SG_ 923 ADC_LeftFrontRadarSt 1;
BA_ "GenSigStartValue" SG_ 923 ADC_LeftFrontRadarSt 0;
BA_ "GenSigTimeoutValue" SG_ 923 ADC_LeftFrontRadarSt 0;
BA_ "Remark" SG_ 923 ADC_LeftFrontRadarSt "";
BA_ "EventCommandSignal" SG_ 923 ADC_LeftRearRadarSt 0;
BA_ "GatewayedSignals" SG_ 923 ADC_LeftRearRadarSt 0;
BA_ "GenSigInactiveValue" SG_ 923 ADC_LeftRearRadarSt 0;
BA_ "GenSigInvalidValue" SG_ 923 ADC_LeftRearRadarSt 0;
BA_ "GenSigSendType" SG_ 923 ADC_LeftRearRadarSt 1;
BA_ "GenSigStartValue" SG_ 923 ADC_LeftRearRadarSt 0;
BA_ "GenSigTimeoutValue" SG_ 923 ADC_LeftRearRadarSt 0;
BA_ "Remark" SG_ 923 ADC_LeftRearRadarSt "";
BA_ "EventCommandSignal" SG_ 923 ADC_RightFrontRadarSt 0;
BA_ "GatewayedSignals" SG_ 923 ADC_RightFrontRadarSt 0;
BA_ "GenSigInactiveValue" SG_ 923 ADC_RightFrontRadarSt 0;
BA_ "GenSigInvalidValue" SG_ 923 ADC_RightFrontRadarSt 0;
BA_ "GenSigSendType" SG_ 923 ADC_RightFrontRadarSt 1;
BA_ "GenSigStartValue" SG_ 923 ADC_RightFrontRadarSt 0;
BA_ "GenSigTimeoutValue" SG_ 923 ADC_RightFrontRadarSt 0;
BA_ "Remark" SG_ 923 ADC_RightFrontRadarSt "";
BA_ "EventCommandSignal" SG_ 923 ADC_RightRearRadarSt 0;
BA_ "GatewayedSignals" SG_ 923 ADC_RightRearRadarSt 0;
BA_ "GenSigInactiveValue" SG_ 923 ADC_RightRearRadarSt 0;
BA_ "GenSigInvalidValue" SG_ 923 ADC_RightRearRadarSt 0;
BA_ "GenSigSendType" SG_ 923 ADC_RightRearRadarSt 1;
BA_ "GenSigStartValue" SG_ 923 ADC_RightRearRadarSt 0;
BA_ "GenSigTimeoutValue" SG_ 923 ADC_RightRearRadarSt 0;
BA_ "Remark" SG_ 923 ADC_RightRearRadarSt "";
BA_ "EventCommandSignal" SG_ 923 ADC_RearRadarSt 0;
BA_ "GatewayedSignals" SG_ 923 ADC_RearRadarSt 0;
BA_ "GenSigInactiveValue" SG_ 923 ADC_RearRadarSt 0;
BA_ "GenSigInvalidValue" SG_ 923 ADC_RearRadarSt 0;
BA_ "GenSigSendType" SG_ 923 ADC_RearRadarSt 1;
BA_ "GenSigStartValue" SG_ 923 ADC_RearRadarSt 0;
BA_ "GenSigTimeoutValue" SG_ 923 ADC_RearRadarSt 0;
BA_ "Remark" SG_ 923 ADC_RearRadarSt "";
BA_ "EventCommandSignal" SG_ 923 ADC_FrontLidarSt 0;
BA_ "GatewayedSignals" SG_ 923 ADC_FrontLidarSt 0;
BA_ "GenSigInactiveValue" SG_ 923 ADC_FrontLidarSt 0;
BA_ "GenSigInvalidValue" SG_ 923 ADC_FrontLidarSt 0;
BA_ "GenSigSendType" SG_ 923 ADC_FrontLidarSt 1;
BA_ "GenSigStartValue" SG_ 923 ADC_FrontLidarSt 0;
BA_ "GenSigTimeoutValue" SG_ 923 ADC_FrontLidarSt 0;
BA_ "Remark" SG_ 923 ADC_FrontLidarSt "";
BA_ "EventCommandSignal" SG_ 923 ADC_LeftLidarSt 0;
BA_ "GatewayedSignals" SG_ 923 ADC_LeftLidarSt 0;
BA_ "GenSigInactiveValue" SG_ 923 ADC_LeftLidarSt 0;
BA_ "GenSigInvalidValue" SG_ 923 ADC_LeftLidarSt 0;
BA_ "GenSigSendType" SG_ 923 ADC_LeftLidarSt 1;
BA_ "GenSigStartValue" SG_ 923 ADC_LeftLidarSt 0;
BA_ "GenSigTimeoutValue" SG_ 923 ADC_LeftLidarSt 0;
BA_ "Remark" SG_ 923 ADC_LeftLidarSt "";
BA_ "EventCommandSignal" SG_ 923 ADC_RightLidarSt 0;
BA_ "GatewayedSignals" SG_ 923 ADC_RightLidarSt 0;
BA_ "GenSigInactiveValue" SG_ 923 ADC_RightLidarSt 0;
BA_ "GenSigInvalidValue" SG_ 923 ADC_RightLidarSt 0;
BA_ "GenSigSendType" SG_ 923 ADC_RightLidarSt 1;
BA_ "GenSigStartValue" SG_ 923 ADC_RightLidarSt 0;
BA_ "GenSigTimeoutValue" SG_ 923 ADC_RightLidarSt 0;
BA_ "Remark" SG_ 923 ADC_RightLidarSt "";
BA_ "EventCommandSignal" SG_ 923 ADC_SentryStatus 0;
BA_ "GatewayedSignals" SG_ 923 ADC_SentryStatus 0;
BA_ "GenSigInactiveValue" SG_ 923 ADC_SentryStatus 0;
BA_ "GenSigInvalidValue" SG_ 923 ADC_SentryStatus 0;
BA_ "GenSigSendType" SG_ 923 ADC_SentryStatus 1;
BA_ "GenSigStartValue" SG_ 923 ADC_SentryStatus 0;
BA_ "GenSigTimeoutValue" SG_ 923 ADC_SentryStatus 0;
BA_ "Remark" SG_ 923 ADC_SentryStatus "";
BA_ "EventCommandSignal" SG_ 923 ADC_SystemState 0;
BA_ "GatewayedSignals" SG_ 923 ADC_SystemState 0;
BA_ "GenSigInactiveValue" SG_ 923 ADC_SystemState 0;
BA_ "GenSigInvalidValue" SG_ 923 ADC_SystemState 15;
BA_ "GenSigSendType" SG_ 923 ADC_SystemState 1;
BA_ "GenSigStartValue" SG_ 923 ADC_SystemState 0;
BA_ "GenSigTimeoutValue" SG_ 923 ADC_SystemState 0;
BA_ "Remark" SG_ 923 ADC_SystemState "";
BA_ "EventCommandSignal" SG_ 923 ADC_HWFailureReason 0;
BA_ "GatewayedSignals" SG_ 923 ADC_HWFailureReason 0;
BA_ "GenSigInactiveValue" SG_ 923 ADC_HWFailureReason 0;
BA_ "GenSigInvalidValue" SG_ 923 ADC_HWFailureReason 0;
BA_ "GenSigSendType" SG_ 923 ADC_HWFailureReason 1;
BA_ "GenSigStartValue" SG_ 923 ADC_HWFailureReason 0;
BA_ "GenSigTimeoutValue" SG_ 923 ADC_HWFailureReason 0;
BA_ "Remark" SG_ 923 ADC_HWFailureReason "";
BA_ "EventCommandSignal" SG_ 923 ADC_SWFailureReason 0;
BA_ "GatewayedSignals" SG_ 923 ADC_SWFailureReason 0;
BA_ "GenSigInactiveValue" SG_ 923 ADC_SWFailureReason 0;
BA_ "GenSigInvalidValue" SG_ 923 ADC_SWFailureReason 0;
BA_ "GenSigSendType" SG_ 923 ADC_SWFailureReason 1;
BA_ "GenSigStartValue" SG_ 923 ADC_SWFailureReason 0;
BA_ "GenSigTimeoutValue" SG_ 923 ADC_SWFailureReason 0;
BA_ "Remark" SG_ 923 ADC_SWFailureReason "";
BA_ "EventCommandSignal" SG_ 923 mountAngleIndicator_az 0;
BA_ "GatewayedSignals" SG_ 923 mountAngleIndicator_az 0;
BA_ "GenSigInactiveValue" SG_ 923 mountAngleIndicator_az 0;
BA_ "GenSigInvalidValue" SG_ 923 mountAngleIndicator_az 0;
BA_ "GenSigSendType" SG_ 923 mountAngleIndicator_az 1;
BA_ "GenSigStartValue" SG_ 923 mountAngleIndicator_az 0;
BA_ "GenSigTimeoutValue" SG_ 923 mountAngleIndicator_az 0;
BA_ "Remark" SG_ 923 mountAngleIndicator_az "";
BA_ "EventCommandSignal" SG_ 923 mountAngleCurrent_az 0;
BA_ "GatewayedSignals" SG_ 923 mountAngleCurrent_az 0;
BA_ "GenSigInactiveValue" SG_ 923 mountAngleCurrent_az 0;
BA_ "GenSigInvalidValue" SG_ 923 mountAngleCurrent_az 0;
BA_ "GenSigSendType" SG_ 923 mountAngleCurrent_az 1;
BA_ "GenSigStartValue" SG_ 923 mountAngleCurrent_az 0;
BA_ "GenSigTimeoutValue" SG_ 923 mountAngleCurrent_az 0;
BA_ "Remark" SG_ 923 mountAngleCurrent_az "";
BA_ "EventCommandSignal" SG_ 923 mountAngleIndicator_el 0;
BA_ "GatewayedSignals" SG_ 923 mountAngleIndicator_el 0;
BA_ "GenSigInactiveValue" SG_ 923 mountAngleIndicator_el 0;
BA_ "GenSigInvalidValue" SG_ 923 mountAngleIndicator_el 0;
BA_ "GenSigSendType" SG_ 923 mountAngleIndicator_el 1;
BA_ "GenSigStartValue" SG_ 923 mountAngleIndicator_el 0;
BA_ "GenSigTimeoutValue" SG_ 923 mountAngleIndicator_el 0;
BA_ "Remark" SG_ 923 mountAngleIndicator_el "";
BA_ "EventCommandSignal" SG_ 923 mountAngleCurrent_el 0;
BA_ "GatewayedSignals" SG_ 923 mountAngleCurrent_el 0;
BA_ "GenSigInactiveValue" SG_ 923 mountAngleCurrent_el 0;
BA_ "GenSigInvalidValue" SG_ 923 mountAngleCurrent_el 0;
BA_ "GenSigSendType" SG_ 923 mountAngleCurrent_el 1;
BA_ "GenSigStartValue" SG_ 923 mountAngleCurrent_el 0;
BA_ "GenSigTimeoutValue" SG_ 923 mountAngleCurrent_el 0;
BA_ "Remark" SG_ 923 mountAngleCurrent_el "";
BA_ "EventCommandSignal" SG_ 923 malStablePosEl 0;
BA_ "GatewayedSignals" SG_ 923 malStablePosEl 0;
BA_ "GenSigInactiveValue" SG_ 923 malStablePosEl 0;
BA_ "GenSigInvalidValue" SG_ 923 malStablePosEl 0;
BA_ "GenSigSendType" SG_ 923 malStablePosEl 1;
BA_ "GenSigStartValue" SG_ 923 malStablePosEl 0;
BA_ "GenSigTimeoutValue" SG_ 923 malStablePosEl 0;
BA_ "Remark" SG_ 923 malStablePosEl "";
BA_ "EventCommandSignal" SG_ 923 malStablePosAz 0;
BA_ "GatewayedSignals" SG_ 923 malStablePosAz 0;
BA_ "GenSigInactiveValue" SG_ 923 malStablePosAz 0;
BA_ "GenSigInvalidValue" SG_ 923 malStablePosAz 0;
BA_ "GenSigSendType" SG_ 923 malStablePosAz 1;
BA_ "GenSigStartValue" SG_ 923 malStablePosAz 0;
BA_ "GenSigTimeoutValue" SG_ 923 malStablePosAz 0;
BA_ "Remark" SG_ 923 malStablePosAz "";
BA_ "EventCommandSignal" SG_ 923 AngleEMEIndicatorEl 0;
BA_ "GatewayedSignals" SG_ 923 AngleEMEIndicatorEl 0;
BA_ "GenSigInactiveValue" SG_ 923 AngleEMEIndicatorEl 0;
BA_ "GenSigInvalidValue" SG_ 923 AngleEMEIndicatorEl 0;
BA_ "GenSigSendType" SG_ 923 AngleEMEIndicatorEl 1;
BA_ "GenSigStartValue" SG_ 923 AngleEMEIndicatorEl 0;
BA_ "GenSigTimeoutValue" SG_ 923 AngleEMEIndicatorEl 0;
BA_ "Remark" SG_ 923 AngleEMEIndicatorEl "";
BA_ "EventCommandSignal" SG_ 923 AngleEMEIndicatorAz 0;
BA_ "GatewayedSignals" SG_ 923 AngleEMEIndicatorAz 0;
BA_ "GenSigInactiveValue" SG_ 923 AngleEMEIndicatorAz 0;
BA_ "GenSigInvalidValue" SG_ 923 AngleEMEIndicatorAz 0;
BA_ "GenSigSendType" SG_ 923 AngleEMEIndicatorAz 1;
BA_ "GenSigStartValue" SG_ 923 AngleEMEIndicatorAz 0;
BA_ "GenSigTimeoutValue" SG_ 923 AngleEMEIndicatorAz 0;
BA_ "Remark" SG_ 923 AngleEMEIndicatorAz "";
BA_ "EventCommandSignal" SG_ 923 highSpreadIndicator_el 0;
BA_ "GatewayedSignals" SG_ 923 highSpreadIndicator_el 0;
BA_ "GenSigInactiveValue" SG_ 923 highSpreadIndicator_el 0;
BA_ "GenSigInvalidValue" SG_ 923 highSpreadIndicator_el 0;
BA_ "GenSigSendType" SG_ 923 highSpreadIndicator_el 1;
BA_ "GenSigStartValue" SG_ 923 highSpreadIndicator_el 0;
BA_ "GenSigTimeoutValue" SG_ 923 highSpreadIndicator_el 0;
BA_ "Remark" SG_ 923 highSpreadIndicator_el "";
BA_ "EventCommandSignal" SG_ 923 highSpreadIndicator_az 0;
BA_ "GatewayedSignals" SG_ 923 highSpreadIndicator_az 0;
BA_ "GenSigInactiveValue" SG_ 923 highSpreadIndicator_az 0;
BA_ "GenSigInvalidValue" SG_ 923 highSpreadIndicator_az 0;
BA_ "GenSigSendType" SG_ 923 highSpreadIndicator_az 1;
BA_ "GenSigStartValue" SG_ 923 highSpreadIndicator_az 0;
BA_ "GenSigTimeoutValue" SG_ 923 highSpreadIndicator_az 0;
BA_ "Remark" SG_ 923 highSpreadIndicator_az "";
BA_ "EventCommandSignal" SG_ 923 Fault_MAL_HOR_ABS_EVENT 0;
BA_ "GatewayedSignals" SG_ 923 Fault_MAL_HOR_ABS_EVENT 0;
BA_ "GenSigInactiveValue" SG_ 923 Fault_MAL_HOR_ABS_EVENT 0;
BA_ "GenSigInvalidValue" SG_ 923 Fault_MAL_HOR_ABS_EVENT 0;
BA_ "GenSigSendType" SG_ 923 Fault_MAL_HOR_ABS_EVENT 1;
BA_ "GenSigStartValue" SG_ 923 Fault_MAL_HOR_ABS_EVENT 0;
BA_ "GenSigTimeoutValue" SG_ 923 Fault_MAL_HOR_ABS_EVENT 0;
BA_ "Remark" SG_ 923 Fault_MAL_HOR_ABS_EVENT "";
BA_ "EventCommandSignal" SG_ 923 Fault_MAL_HOR_REL_EVENT 0;
BA_ "GatewayedSignals" SG_ 923 Fault_MAL_HOR_REL_EVENT 0;
BA_ "GenSigInactiveValue" SG_ 923 Fault_MAL_HOR_REL_EVENT 0;
BA_ "GenSigInvalidValue" SG_ 923 Fault_MAL_HOR_REL_EVENT 0;
BA_ "GenSigSendType" SG_ 923 Fault_MAL_HOR_REL_EVENT 1;
BA_ "GenSigStartValue" SG_ 923 Fault_MAL_HOR_REL_EVENT 0;
BA_ "GenSigTimeoutValue" SG_ 923 Fault_MAL_HOR_REL_EVENT 0;
BA_ "Remark" SG_ 923 Fault_MAL_HOR_REL_EVENT "";
BA_ "EventCommandSignal" SG_ 923 Fault_MAL_VER_ABS_EVENT 0;
BA_ "GatewayedSignals" SG_ 923 Fault_MAL_VER_ABS_EVENT 0;
BA_ "GenSigInactiveValue" SG_ 923 Fault_MAL_VER_ABS_EVENT 0;
BA_ "GenSigInvalidValue" SG_ 923 Fault_MAL_VER_ABS_EVENT 0;
BA_ "GenSigSendType" SG_ 923 Fault_MAL_VER_ABS_EVENT 1;
BA_ "GenSigStartValue" SG_ 923 Fault_MAL_VER_ABS_EVENT 0;
BA_ "GenSigTimeoutValue" SG_ 923 Fault_MAL_VER_ABS_EVENT 0;
BA_ "Remark" SG_ 923 Fault_MAL_VER_ABS_EVENT "";
BA_ "EventCommandSignal" SG_ 923 Fault_MAL_VER_REL_EVENT 0;
BA_ "GatewayedSignals" SG_ 923 Fault_MAL_VER_REL_EVENT 0;
BA_ "GenSigInactiveValue" SG_ 923 Fault_MAL_VER_REL_EVENT 0;
BA_ "GenSigInvalidValue" SG_ 923 Fault_MAL_VER_REL_EVENT 0;
BA_ "GenSigSendType" SG_ 923 Fault_MAL_VER_REL_EVENT 1;
BA_ "GenSigStartValue" SG_ 923 Fault_MAL_VER_REL_EVENT 0;
BA_ "GenSigTimeoutValue" SG_ 923 Fault_MAL_VER_REL_EVENT 0;
BA_ "Remark" SG_ 923 Fault_MAL_VER_REL_EVENT "";
BA_ "EventCommandSignal" SG_ 923 FilteredPhiSpread 0;
BA_ "GatewayedSignals" SG_ 923 FilteredPhiSpread 0;
BA_ "GenSigInactiveValue" SG_ 923 FilteredPhiSpread 0;
BA_ "GenSigInvalidValue" SG_ 923 FilteredPhiSpread 0;
BA_ "GenSigSendType" SG_ 923 FilteredPhiSpread 1;
BA_ "GenSigStartValue" SG_ 923 FilteredPhiSpread 0;
BA_ "GenSigTimeoutValue" SG_ 923 FilteredPhiSpread 0;
BA_ "Remark" SG_ 923 FilteredPhiSpread "";
BA_ "EventCommandSignal" SG_ 923 elOutOfSpecCause 0;
BA_ "GatewayedSignals" SG_ 923 elOutOfSpecCause 0;
BA_ "GenSigInactiveValue" SG_ 923 elOutOfSpecCause 0;
BA_ "GenSigInvalidValue" SG_ 923 elOutOfSpecCause 0;
BA_ "GenSigSendType" SG_ 923 elOutOfSpecCause 1;
BA_ "GenSigStartValue" SG_ 923 elOutOfSpecCause 0;
BA_ "GenSigTimeoutValue" SG_ 923 elOutOfSpecCause 0;
BA_ "Remark" SG_ 923 elOutOfSpecCause "";
BA_ "EventCommandSignal" SG_ 923 azOutOfSpecCause 0;
BA_ "GatewayedSignals" SG_ 923 azOutOfSpecCause 0;
BA_ "GenSigInactiveValue" SG_ 923 azOutOfSpecCause 0;
BA_ "GenSigInvalidValue" SG_ 923 azOutOfSpecCause 0;
BA_ "GenSigSendType" SG_ 923 azOutOfSpecCause 1;
BA_ "GenSigStartValue" SG_ 923 azOutOfSpecCause 0;
BA_ "GenSigTimeoutValue" SG_ 923 azOutOfSpecCause 0;
BA_ "Remark" SG_ 923 azOutOfSpecCause "";
BA_ "EventCommandSignal" SG_ 923 azOutOfProfileCause 0;
BA_ "GatewayedSignals" SG_ 923 azOutOfProfileCause 0;
BA_ "GenSigInactiveValue" SG_ 923 azOutOfProfileCause 0;
BA_ "GenSigInvalidValue" SG_ 923 azOutOfProfileCause 0;
BA_ "GenSigSendType" SG_ 923 azOutOfProfileCause 1;
BA_ "GenSigStartValue" SG_ 923 azOutOfProfileCause 0;
BA_ "GenSigTimeoutValue" SG_ 923 azOutOfProfileCause 0;
BA_ "Remark" SG_ 923 azOutOfProfileCause "";
BA_ "EventCommandSignal" SG_ 923 elOutOfProfileCause 0;
BA_ "GatewayedSignals" SG_ 923 elOutOfProfileCause 0;
BA_ "GenSigInactiveValue" SG_ 923 elOutOfProfileCause 0;
BA_ "GenSigInvalidValue" SG_ 923 elOutOfProfileCause 0;
BA_ "GenSigSendType" SG_ 923 elOutOfProfileCause 1;
BA_ "GenSigStartValue" SG_ 923 elOutOfProfileCause 0;
BA_ "GenSigTimeoutValue" SG_ 923 elOutOfProfileCause 0;
BA_ "Remark" SG_ 923 elOutOfProfileCause "";
BA_ "EventCommandSignal" SG_ 923 Reserved1 0;
BA_ "GatewayedSignals" SG_ 923 Reserved1 0;
BA_ "GenSigInactiveValue" SG_ 923 Reserved1 0;
BA_ "GenSigInvalidValue" SG_ 923 Reserved1 0;
BA_ "GenSigSendType" SG_ 923 Reserved1 1;
BA_ "GenSigStartValue" SG_ 923 Reserved1 0;
BA_ "GenSigTimeoutValue" SG_ 923 Reserved1 0;
BA_ "Remark" SG_ 923 Reserved1 "";
VAL_ 387 ADC_AngReqSt_A 0 "Inhibited" 1 "Ready" 2 "Active" 3 "Failed"  ;
VAL_ 387 ADC_AngReqFunction 0 "No request" 1 "Request by LKAS" 2 "Request by PAS" 3 "Reserved"  ;
VAL_ 387 ADC_BrakeLightReq 0 "No Request" 1 "turn on" 2 "turn off"  ;
VAL_ 387 ADC_AssistParaSwitchReq 0 "No request" 1 "Request"  ;
VAL_ 387 ADC_SteerGainReq 0 "No request" 1 "Request"  ;
VAL_ 387 ADC_StrgWhlVibrWarnLevel 0 "No request" 1 "Request level 1" 2 "Request level 2" 3 "Request level 3"  ;
VAL_ 387 ADC_ActTrqReqEnable 0 "Disable" 1 "Enable"  ;
VAL_ 387 ADC_EvsSteerReq 0 "No request" 1 "Request"  ;
VAL_ 387 ADC_StrgWhlVibrWarnReq 0 "No request" 1 "Request"  ;
VAL_ 387 ADC_DrvTarTqMod2EPB 0 "Override mode" 1 "Inhibit mode" 2 "reserved" 3 "reserved"  ;
VAL_ 387 ADC_LongCtrlTypReq 0 "Comfort Mode" 1 "Emergency Mode"  ;
VAL_ 387 ADC_AEBFaultSt 0 "Not fault" 1 "Fault"  ;
VAL_ 387 ADC_AEBOffSt 0 "On" 1 "Off"  ;
VAL_ 387 ADC_AEBInterventionSt 0 "No intervention" 1 "Intervention"  ;
VAL_ 387 ADC_AEBDecelCtrlReq 0 "No request" 1 "Request"  ;
VAL_ 387 ADC_AEBLVehHoldReq 0 "No request" 1 "Request"  ;
VAL_ 387 ADC_ABAReq 0 "No request" 1 "Request"  ;
VAL_ 387 ADC_ABALevel 0 "Level 0" 1 "Level 1" 2 "Level 2" 3 "Level 3"  ;
VAL_ 387 ADC_AWBReq 0 "No request" 1 "Request"  ;
VAL_ 387 ADC_ABPReq 0 "No request" 1 "Request"  ;
VAL_ 387 ADC_AWBLevel 0 "No level" 1 "Level 1" 2 "Level 2" 3 "Level 3" 4 "Level 4" 5 "Not used" 6 "Not used" 7 "Not used"  ;
VAL_ 387 ADC_AEBTarCalss 0 "Not dectected" 1 "Car" 2 "Pedestrian" 3 "Two wheels" 4 "Motorcycle" 5 "Truck" 6 "Unknown" 7 "Reserve"  ;
VAL_ 387 ADC_AEBTarDetSensor 0 "Invalid" 1 "Not Fusion" 2 "Not used" 3 "Fusion"  ;
VAL_ 387 ADC_TurnLightReq 0 "No Request" 1 "turn off" 2 "turn on left turn lamp" 3 "turn on right turn lamp" 4 "turn on Hazard Lamp" 5 "turn on RCW Hazard Lamp(4HZ)"  ;
VAL_ 387 ADC_PAA2EPBEpbReq 0 "None" 1 "ReleaseReq" 2 "ApplyReq"  ;
VAL_ 387 ADC_PAA2EPBEpbReqSt 0 "No request" 1 "Request"  ;
VAL_ 387 ADC_PAAPwrModeReq 0 "No Request" 1 "Power On Request (PTready)"  ;
VAL_ 387 ADC_PAAGrarLvlReq 0 "No Request" 1 "Park" 2 "Reversed" 3 "Neutral" 4 "Drive" 5 "Reversed" 6 "Reversed" 7 "Reversed"  ;
VAL_ 387 ADC_PAAGrarLvlReqEnable 0 "No request" 1 "Gear shift request"  ;
VAL_ 387 ADC_ACCMode_C 0 "Failure （ACC failure）" 1 "Passive mode (ACC passive)" 2 "Standby mode (ACC standby)" 3 "Active control mode (ACC active)" 4 "Brake only mode" 5 "Override (ACC Lng-Override)" 6 "Standwait (ACC standwait )" 7 "Standactive (ACC standactive)" 8 "No Request (Only ADS)" 9 "Off (ACC disable)" 10 "Not used" 11 "Not used" 12 "Not used" 13 "Not used" 14 "Not used" 15 "Not used"  ;
VAL_ 387 ADC_ActTrqReqVD 0 "invalid" 1 "valid"  ;
VAL_ 387 ADC_BrkTarTqEna 0 "disable" 1 "enable"  ;
VAL_ 387 ADC_BrkTarTqMod 0 "no request" 1 "Cruise function" 2 "Parking function" 3 "Reserved"  ;
VAL_ 387 ADC_EpbModReqVld 0 "Invalid" 1 "Valid"  ;
VAL_ 387 ADC_RWUEna 0 "disable" 1 "enable"  ;
VAL_ 387 ADC_BrkHoldReq 0 "No request" 1 "Not active" 2 "Active" 3 "Reserved"  ;
VAL_ 387 ADC_AngReqAvl 0 "Not available" 1 "Available"  ;
VAL_ 387 ADC_TarGearReqVld 0 "Invalid" 1 "Valid"  ;
VAL_ 387 ADC_FctSts 0 "Off" 1 "On"  ;
VAL_ 387 ADC_BrkTarTqVld 0 "Invalid" 1 "Valid"  ;
VAL_ 387 ADC_AebBrkTarTqVld 0 "Invalid" 1 "Valid"  ;
VAL_ 387 ADC_AebBrkTarTqEna 0 "disable" 1 "enable"  ;
VAL_ 387 ADC_ElecBrkFnSwitch 0 "ON" 1 "OFF"  ;
VAL_ 387 ADC_RWUVld 0 "Invalid" 1 "Valid"  ;
VAL_ 387 ADC_DriverPresent 0 "Undefined" 1 "Driver  Not Present" 2 "Driver  Present" 3 "Failure"  ;
VAL_ 387 ADC_AD_NetMode 0 "Main Net" 1 "Main and Sub Net" 2 "Reserved" 3 "Reserved"  ;
VAL_ 387 ADC_ChrgPwrMode 0 "Normal" 1 "Emergent"  ;
VAL_ 387 ADC_LimTqEnable_A 0 "Disable" 1 "Enable"  ;
VAL_ 387 ADC_RapidRespEna_A 0 "Disable" 1 "Enable"  ;
VAL_ 387 ADC_DrvTarTqMod_A 0 "Override mode" 1 "Inhibit mode" 2 "reserved" 3 "reserved"  ;
VAL_ 387 ADC_FcsActiveStatus 0 "No Active" 1 "Active"  ;
VAL_ 387 ADC_DycEscTarTqVld_A 0 "Invalid" 1 "Valid"  ;
VAL_ 387 ADC_DycEscTarTqEna_A 0 "Disable" 1 "Enable"  ;
VAL_ 387 ADC_RedundantSwt 0 "Without Redundant" 1 "With Redundant"  ;
VAL_ 387 ADC_ImmediateStopEna 0 "Not Permitted" 1 "Permitted"  ;
VAL_ 387 ADS_VDCActvSt 0 "Not Active" 1 "Active"  ;
VAL_ 387 ADS_TCSActvSt 0 "Not Active" 1 "Active"  ;
VAL_ 387 ADS_DTCActvSt 0 "Not Active" 1 "Active"  ;
VAL_ 387 ADC_VehSpdVD 0 "Not Valid" 1 "Valid"  ;
VAL_ 387 ADC_SteerTqSt_A 0 "No request" 1 "Ready" 2 "Active" 3 "Reserved"  ;
VAL_ 387 ADC_TqEvsSteerReq_A 0 "Normal" 1 "Emergency"  ;
VAL_ 387 ADC_SteerTqAvl_A 0 "Not available" 1 "Available"  ;
VAL_ 783 ADC_FroTrkTargt0ObjClass 0 "Underdetemined" 1 "Car" 2 "motorcycle" 3 "truck" 4 "pedestrian" 5 "Pole(TBD)" 6 "tree(TBD)" 7 "animal(TBD)" 8 "General on-borad object(TBD)" 9 "bicycle" 10 "unidentified vehicle(TBD)" 11 "Reserved" 12 "Reserved" 13 "Reserved" 14 "Reserved" 15 "Reserved"  ;
VAL_ 783 ADC_FroTrkTargt0St 0 "not dectected" 1 "dectected"  ;
VAL_ 783 ADC_FroTrkTargt0DetSensor 0 "Invalid" 1 "Radar only" 2 "Vision only" 3 "Radar+Vision" 4 "Lidar only" 5 "Lidar+Radar" 6 "Lidar+Vision" 7 "Lidar+Radar+Vision" 8 "Reserve" 9 "Reserve" 10 "Reserve" 11 "Reserve" 12 "Reserve" 13 "Reserve" 14 "Reserve" 15 "Reserve"  ;
VAL_ 783 ADC_FroTrkTargt1ObjClass 0 "Underdetemined" 1 "Car" 2 "motorcycle" 3 "truck" 4 "pedestrian" 5 "Pole(TBD)" 6 "tree(TBD)" 7 "animal(TBD)" 8 "General on-borad object(TBD)" 9 "bicycle" 10 "unidentified vehicle(TBD)" 11 "Reserved" 12 "Reserved" 13 "Reserved" 14 "Reserved" 15 "Reserved"  ;
VAL_ 783 ADC_FroTrkTargt1St 0 "not dectected" 1 "dectected"  ;
VAL_ 783 ADC_FroTrkTargt1DetSensor 0 "Invalid" 1 "Radar only" 2 "Vision only" 3 "Radar+Vision" 4 "Lidar only" 5 "Lidar+Radar" 6 "Lidar+Vision" 7 "Lidar+Radar+Vision" 8 "Reserve" 9 "Reserve" 10 "Reserve" 11 "Reserve" 12 "Reserve" 13 "Reserve" 14 "Reserve" 15 "Reserve"  ;
VAL_ 783 ADC_FroTrkTargt2ObjClass 0 "Underdetemined" 1 "Car" 2 "motorcycle" 3 "truck" 4 "pedestrian" 5 "Pole(TBD)" 6 "tree(TBD)" 7 "animal(TBD)" 8 "General on-borad object(TBD)" 9 "bicycle" 10 "unidentified vehicle(TBD)" 11 "Reserved" 12 "Reserved" 13 "Reserved" 14 "Reserved" 15 "Reserved"  ;
VAL_ 783 ADC_FroTrkTargt2St 0 "not dectected" 1 "dectected"  ;
VAL_ 783 ADC_FroTrkTargt2DetSensor 0 "Invalid" 1 "Radar only" 2 "Vision only" 3 "Radar+Vision" 4 "Lidar only" 5 "Lidar+Radar" 6 "Lidar+Vision" 7 "Lidar+Radar+Vision" 8 "Reserve" 9 "Reserve" 10 "Reserve" 11 "Reserve" 12 "Reserve" 13 "Reserve" 14 "Reserve" 15 "Reserve"  ;
VAL_ 783 ADC_FroTrkTargt3ObjClass 0 "Underdetemined" 1 "Car" 2 "motorcycle" 3 "truck" 4 "pedestrian" 5 "Pole(TBD)" 6 "tree(TBD)" 7 "animal(TBD)" 8 "General on-borad object(TBD)" 9 "bicycle" 10 "unidentified vehicle(TBD)" 11 "Reserved" 12 "Reserved" 13 "Reserved" 14 "Reserved" 15 "Reserved"  ;
VAL_ 783 ADC_FroTrkTargt3St 0 "not dectected" 1 "dectected"  ;
VAL_ 783 ADC_Road_Type_Ahead 0 "Initial" 1 "Unknown" 2 "Asphalt road" 3 "Concrete Road" 4 "Grass road" 5 "Dirt road" 6 "Muddy road" 7 "Gravel road" 8 "Sandy road" 9 "Ponding road" 10 "Packed snow road" 11 "Snowy road" 12 "Ice road" 13 "Split left high road" 14 "Split left low road" 15 "Rocky Road" 31 "Invalid"  ;
VAL_ 783 ADC_FroTrkTargt3DetSensor 0 "Invalid" 1 "Radar only" 2 "Vision only" 3 "Radar+Vision" 4 "Lidar only" 5 "Lidar+Radar" 6 "Lidar+Vision" 7 "Lidar+Radar+Vision" 8 "Reserve" 9 "Reserve" 10 "Reserve" 11 "Reserve" 12 "Reserve" 13 "Reserve" 14 "Reserve" 15 "Reserve"  ;
VAL_ 783 ADC_LlnMrkingDispSt 0 "No display" 1 "tracking" 2 "intervening" 3 "warning"  ;
VAL_ 783 ADC_LLnMrking_Type 0 "No display" 1 "dashed" 2 "solid" 3 "Fishbone deceleration line（dashed）" 4 "Fishbone deceleration line（solid）" 5 "road edge" 6 "curb" 7 "Cone barrel" 8 "Plastic fence" 9 "barrier" 10 "parking cars" 11 "not used" 12 "not used" 13 "not used" 14 "not used" 15 "not used"  ;
VAL_ 783 ADC_RlnMrkingDispSt 0 "No display" 1 "tracking" 2 "intervening" 3 "warning"  ;
VAL_ 783 ADC_RLnMrking_Type 0 "No display" 1 "dashed" 2 "solid" 3 "Fishbone deceleration line（dashed）" 4 "Fishbone deceleration line（solid）" 5 "road edge" 6 "curb" 7 "Cone barrel" 8 "Plastic fence" 9 "barrier" 10 "parking cars" 11 "not used" 12 "not used" 13 "not used" 14 "not used" 15 "not used"  ;
VAL_ 659 ADC_NDASt 0 "NDA disable" 1 "NDA passive" 2 "NDA standby normal" 3 "Not used" 4 "NDA active normal" 5 "Not used" 6 "NDA active standwait" 7 "Not used" 8 "NDA active standactive" 9 "BOM" 10 "Not used" 11 "NDA Lat-Override" 12 "NDA Lng-Override" 13 "Not used" 14 "NDA Lat&Lng Override" 15 "Not used" 16 "Not used" 17 "Not used" 18 "NDA MRM Emergency Lane with Lat-control" 19 "NDA MRM Emergency Lane with Lat&Lng-control" 20 "NDA MRM Ego Lane  with Lat-control" 21 "NDA MRM Ego Lane  with Lat&Lng-control" 22 "Not used" 23 "Not used" 24 "NDA MRC" 25 "NDA failure light" 26 "Not used" 27 "Not used" 28 "Not used" 29 "Not used" 30 "Not used" 31 "Not used" 32 "Not used" 33 "Not used" 34 "Not used" 35 "Not used" 36 "Not used" 37 "Not used" 38 "Not used" 39 "Not used" 40 "Not used" 41 "Not used" 42 "Not used" 43 "Not used" 44 "Not used" 45 "Not used" 46 "Not used" 47 "Not used" 48 "Not used" 49 "Not used" 50 "Not used" 51 "Not used" 52 "Not used" 53 "Not used" 54 "Not used" 55 "Not used" 56 "Not used" 57 "Not used" 58 "Not used" 59 "Not used" 60 "Not used" 61 "Not used" 62 "Not used" 63 "Not used"  ;
VAL_ 659 ADC_NDATORType 0 "No TakeOver" 1 "Driver Brake" 2 "Driver Brake for long time" 3 "Driver Override Steering" 4 "Driver Alert and Override Accele" 5 "Driver fatiger hands on and Override Accele" 6 "Driver Alert and Hands On" 7 "Hands On and Override Accele" 8 "Hands On" 9 "Hands On and Brake" 10 "AD Normal Red Hand" 11 "AD Release Acc Pedal" 12 "AD Brake Pedal" 13 "AD MRM Red Hand" 14 "AD MRM Yellow Hand" 15 "Invalid"  ;
VAL_ 659 ADC_NDASplitSt 0 "No Split/Merge" 1 "Split" 2 "Merge" 3 "Not used" 4 "Not used" 5 "Not used" 6 "Not used" 7 "Not used"  ;
VAL_ 659 ADC_NDARouteReplanning 0 "No" 1 "Replanning"  ;
VAL_ 659 ADC_LaneChangeType 0 "No Lane Change" 1 "Lane_Lost Lane Change" 2 "Avoid Obstacle Lane Change" 3 "Driver_TurnLever Lane Change" 4 "Aviod Merge or Split Zone Lane Change" 5 "Other Lane Change Type" 6 "Not used" 7 "Effective Lane Change" 8 "Not used" 9 "Construction Zone Lane Change" 10 "Fast Lane Lane Change" 11 "Navigation LC" 12 "Not used" 13 "Not used" 14 "Not used" 15 "Not used" 16 "Not used" 17 "Not used" 18 "Not used" 19 "Not used" 20 "Not used" 21 "Not used" 22 "Not used" 23 "Not used" 24 "Not used" 25 "Not used" 26 "Not used" 27 "Not used" 28 "Not used" 29 "Not used" 30 "Not used" 31 "Not used"  ;
VAL_ 659 ADC_FuncReq_SentryModWarn 0 "OFF" 1 "SentryModeWake"  ;
VAL_ 659 ADC_TlaWarning 0 "no request" 1 "No Warning" 2 "Red Light Warning" 3 "Start Warning" 4 "Reserved" 5 "Reserved" 6 "Reserved" 7 "Invalid"  ;
VAL_ 659 ADC_TlaFault 0 "no request" 1 "No fault" 2 "Fault" 3 "Invalid"  ;
VAL_ 659 ADC_FcwWaning 0 "no request" 1 "Off" 2 "Standby" 3 "Active_level1" 4 "Active_level2" 5 "Nolicense" 6 "Reserved" 7 "Invalid"  ;
VAL_ 659 ADC_AebFault 0 "no request" 1 "no fault" 2 "fault" 3 "Invalid"  ;
VAL_ 659 ADC_RaebWarning 0 "no request" 1 "off" 2 "Active" 3 "Hold" 4 "Inactive (standby)" 5 "Nolicense" 6 "Warning" 7 "Reserved"  ;
VAL_ 659 ADC_RaebFault 0 "no request" 1 "No fault" 2 "Fault" 3 "Invalid"  ;
VAL_ 659 ADC_RcwFault 0 "no request" 1 "No fault" 2 "Fault" 3 "Invalid"  ;
VAL_ 659 ADC_FctbLeftWarning 0 "no request" 1 "Off" 2 "Active_Left" 3 "IBA" 4 "Hold" 5 "inactive (standby)" 6 "Nolicense" 7 "Invalid"  ;
VAL_ 659 ADC_FctbRightWarning 0 "no request" 1 "Off" 2 "Active_Right" 3 "IBA" 4 "Hold" 5 "inactive (standby)" 6 "Nolicense" 7 "Invalid"  ;
VAL_ 659 ADC_RctaFault 0 "no request" 1 "No fault" 2 "Fault" 3 "Invalid"  ;
VAL_ 659 ADC_RctbLeftWarning 0 "no request" 1 "Off" 2 "Active_Left" 3 "Hold" 4 "Inactive (Standby)" 5 "Nolicense" 6 "Reserved" 7 "Invalid"  ;
VAL_ 659 ADC_RctbRightWarning 0 "no request" 1 "Off" 2 "Active_Right" 3 "Hold" 4 "Inactive (Standby)" 5 "Nolicense" 6 "Reserved" 7 "Invalid"  ;
VAL_ 659 ADC_LdwFault 0 "no request" 1 "No fault" 2 "Fault" 3 "Invalid"  ;
VAL_ 659 ADC_LkaFault 0 "no request" 1 "No fault" 2 "Fault" 3 "Invalid"  ;
VAL_ 659 ADC_BsdFault 0 "no request" 1 "No fault" 2 "Fault" 3 "Invalid"  ;
VAL_ 659 ADC_DowFault 0 "no request" 1 "No fault" 2 "Fault" 3 "Invalid"  ;
VAL_ 659 ADC_TsrFault 0 "no request" 1 "No fault" 2 "Fault" 3 "Invalid"  ;
VAL_ 659 ADC_ElkaWarning 0 "no request" 1 "Off" 2 "Standby" 3 "Ready" 4 "Active_Left" 5 "Active_Right" 6 "Switchoff" 7 "Invalid"  ;
VAL_ 659 ADC_ElkaFault 0 "no request" 1 "No fault" 2 "Fault" 3 "Invalid"  ;
VAL_ 659 ADC_IMUTimestampVld 0 "Invalid" 1 "Valid"  ;
VAL_ 659 ADC_IMUAccVld 0 "Invalid" 1 "Valid"  ;
VAL_ 659 ADC_IMUGyroVld 0 "Invalid" 1 "Valid"  ;
VAL_ 659 ADC_IMUAttitudeVld 0 "Invalid" 1 "Valid"  ;
VAL_ 659 ADC_IMUPositionType 0 "No?Solution" 1 "Gnss" 2 "RTK" 3 "Resersed" 4 "Resersed" 5 "Resersed" 6 "Resersed" 7 "Resersed" 8 "Resersed" 9 "Resersed" 10 "Resersed" 11 "Resersed" 12 "Resersed" 13 "Resersed" 14 "Resersed" 15 "Resersed"  ;
VAL_ 923 ADC_FrontWideCameraSt 0 "No Failure" 1 "Failure" 2 "Blockage" 3 "Calibration failed" 4 "Angle not meet"  ;
VAL_ 923 ADC_FrontNarrowCameraSt 0 "No Failure" 1 "Failure" 2 "Blockage" 3 "Calibration failed" 4 "Angle not meet"  ;
VAL_ 923 ADC_LeftFrontCameraSt 0 "No Failure" 1 "Failure" 2 "Blockage" 3 "Calibration failed" 4 "Angle not meet"  ;
VAL_ 923 ADC_LeftRearCameraSt 0 "No Failure" 1 "Failure" 2 "Blockage" 3 "Calibration failed" 4 "Angle not meet"  ;
VAL_ 923 ADC_RightFrontCameraSt 0 "No Failure" 1 "Failure" 2 "Blockage" 3 "Calibration failed" 4 "Angle not meet"  ;
VAL_ 923 ADC_RightRearCameraSt 0 "No Failure" 1 "Failure" 2 "Blockage" 3 "Calibration failed" 4 "Angle not meet"  ;
VAL_ 923 ADC_RearCameraSt 0 "No Failure" 1 "Failure" 2 "Blockage" 3 "Calibration failed" 4 "Angle not meet"  ;
VAL_ 923 ADC_FrontRadarSt 0 "No Failure" 1 "Failure" 2 "Blockage" 3 "Calibration failed" 4 "Angle not meet"  ;
VAL_ 923 ADC_LeftFrontRadarSt 0 "No Failure" 1 "Failure" 2 "Blockage" 3 "Calibration failed" 4 "Angle not meet"  ;
VAL_ 923 ADC_LeftRearRadarSt 0 "No Failure" 1 "Failure" 2 "Blockage" 3 "Calibration failed" 4 "Angle not meet"  ;
VAL_ 923 ADC_RightFrontRadarSt 0 "No Failure" 1 "Failure" 2 "Blockage" 3 "Calibration failed" 4 "Angle not meet"  ;
VAL_ 923 ADC_RightRearRadarSt 0 "No Failure" 1 "Failure" 2 "Blockage" 3 "Calibration failed" 4 "Angle not meet"  ;
VAL_ 923 ADC_RearRadarSt 0 "No Failure" 1 "Failure" 2 "Blockage" 3 "Calibration failed" 4 "Angle not meet"  ;
VAL_ 923 ADC_FrontLidarSt 0 "No Failure" 1 "Failure" 2 "Blockage" 3 "Calibration failed" 4 "Angle not meet"  ;
VAL_ 923 ADC_LeftLidarSt 0 "No Failure" 1 "Failure" 2 "Blockage" 3 "Calibration failed" 4 "Angle not meet"  ;
VAL_ 923 ADC_RightLidarSt 0 "No Failure" 1 "Failure" 2 "Blockage" 3 "Calibration failed" 4 "Angle not meet"  ;
VAL_ 923 ADC_SentryStatus 0 "OFF" 1 "Standby" 2 "Warn" 3 "Alarm"  ;
VAL_ 923 ADC_SystemState 0 "DeepSleep" 1 "LightSleep" 2 "Active" 3 "PartialActive" 4 "Reserved" 5 "Reserved" 6 "Reserved" 7 "Reserved" 8 "Reserved" 9 "Reserved" 10 "Reserved" 11 "Reserved" 12 "Reserved" 13 "Reserved" 14 "Reserved" 15 "Invalid"  ;
VAL_ 923 ADC_HWFailureReason 0 "No Failure" 1 "SOC Failure" 2 "MCU Failure" 3 "Others Failure" 4 "Not Used" 5 "Not Used" 6 "Not Used" 7 "Not Used"  ;
VAL_ 923 ADC_SWFailureReason 0 "No Failure" 1 "perception failure" 2 "Localization Fusion" 3 "EHP" 4 "Control" 5 "Automation" 6 "OTA" 7 "Calibration module" 8 "Data module" 9 "TSM" 10 "CID" 11 "Not Used" 12 "Not Used" 13 "Not Used" 14 "Not Used" 15 "Not Used" 16 "Not Used" 17 "Not Used" 18 "Not Used" 19 "Not Used" 20 "Not Used" 21 "Not Used" 22 "Not Used" 23 "Not Used" 24 "Not Used" 25 "Not Used" 26 "Not Used" 27 "Not Used" 28 "Not Used" 29 "Not Used" 30 "Not Used" 31 "Not Used"  ;
VAL_ 923 Fault_MAL_HOR_ABS_EVENT 0 "Not Fault" 1 "Fault"  ;
VAL_ 923 Fault_MAL_HOR_REL_EVENT 0 "Not Fault" 1 "Fault"  ;
VAL_ 923 Fault_MAL_VER_ABS_EVENT 0 "Not Fault" 1 "Fault"  ;
VAL_ 923 Fault_MAL_VER_REL_EVENT 0 "Not Fault" 1 "Fault"  ;
VAL_ 923 elOutOfSpecCause 0 "No Out" 1 "Out" 0 "No Out" 1 "Out"  ;
VAL_ 923 azOutOfSpecCause 0 "No Out" 1 "Out" 0 "No Out" 1 "Out"  ;
VAL_ 923 azOutOfProfileCause 0 "No Out" 1 "Out"  ;
VAL_ 923 elOutOfProfileCause 0 "No Out" 1 "Out"  ;
