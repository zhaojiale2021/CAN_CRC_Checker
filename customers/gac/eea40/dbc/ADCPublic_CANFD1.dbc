VERSION "Version"

NS_ :

BS_:

BU_: Tester CCU ADC CCU_CCURT1 CCU_CCURT2 RLR RRR ZCUF ZCUL ZCUR ZCUT EMS IDM DCDC IPS NIDU NIDUF DCUR OBC OPC LPC CPC EMCM GCU DCUF IPU BMS EOPF EOPR EVCC DCDC2 EDL SRS ECS EPS EPB RBM IBCS ICM IID IDC PHUDD AMP WHUD IMR INU IFC FAPA PAS PCS SCMR SCMRL SCMRR HVSMR SCMRM MFS WSM DRM IDU FCP LBMSAD AVAS ATSS DLPFL FBLCM FLISD FLLCM FRLCM RLLCMA RLLCMB RRLCMA RRLCMB RLISD DLPML DLPMR TRM PSDL PSDR HVSPRL HVSPRR RFR SBM WCM ETC TBOX2 TBOX IDUR CBM PLGM TMC LPC2 SCMT RCP RRISD LBMS RLBMS CCURT1 CCURT2 RT1_C1 RT2_C3 RT1_C0 OTAWL RAS EBB RCICP WCMFR WCMRL SAS CD

BO_ 400 CCU_MFS_1: 32 CCU
 SG_ UINM_1_CRC : 7|16@0+ (1,0) [0|65535] ""  ADC,FAPA
 SG_ UINM_1_Counter : 23|8@0+ (1,0) [0|255] ""  ADC,FAPA
 SG_ UINM_DrvReqShft : 31|4@0+ (1,0) [0|15] ""  IDC,ADC,FAPA
 SG_ UINM_DrvReqShftInv : 27|4@0+ (1,0) [0|15] ""  ADC,FAPA
 SG_ UINM_FuSaErrSt : 39|1@0+ (1,0) [0|1] ""  ADC,FAPA
 SG_ UINM_ShftFault : 38|1@0+ (1,0) [0|1] ""  ADC,FAPA
 SG_ UINM_PositionLightSwSt : 37|2@0+ (1,0) [0|3] ""  ADC,IFC,FAPA,RRR,RLR
 SG_ UINM_LowBeamSwSt : 35|2@0+ (1,0) [0|3] ""  ADC,IFC,FAPA,RRR,RLR
 SG_ UINM_AutoLightSwSt : 33|2@0+ (1,0) [0|3] ""  ADC,IFC,FAPA,RRR,RLR
 SG_ UINM_FrontFogLightSwSt : 47|1@0+ (1,0) [0|1] ""  ADC,IFC,FAPA,RRR,RLR
 SG_ UINM_RearFogLightSwSt : 46|1@0+ (1,0) [0|1] ""  ADC,IFC,FAPA,RRR,RLR
 SG_ UINM_HighBeamSwSt : 45|2@0+ (1,0) [0|3] ""  ADC,IFC,FAPA,RRR,RLR
 SG_ UINM_TurnLightSwSt : 43|3@0+ (1,0) [0|7] ""  ADC,IFC,FAPA,RRR,RLR,PCS
 SG_ UINM_FrontWiperSwSt : 55|3@0+ (1,0) [0|7] ""  ADC,IFC,FAPA
 SG_ UINM_FrontWiperIntAdjSwSt : 52|4@0+ (1,0) [0|15] ""  ADC,IFC,FAPA
 SG_ UINM_FrontWasherSwSt : 48|1@0+ (1,0) [0|1] ""  ADC,IFC,FAPA
 SG_ UINM_RearWiperSwSt : 63|3@0+ (1,0) [0|7] ""  ADC,IFC,FAPA
 SG_ UINM_RearWiperIntAdjSwSt : 60|4@0+ (1,0) [0|15] ""  ADC,IFC,FAPA
 SG_ UINM_RearWasherSwSt : 56|1@0+ (1,0) [0|1] ""  ADC,IFC,FAPA
 SG_ UINM_HeadLampWasherSwSt : 71|1@0+ (1,0) [0|1] ""  ADC,IFC,FAPA,RRR,RLR

BO_ 616 CCU_1: 64 CCU_CCURT1
 SG_ CCU_1_CRC : 7|16@0+ (1,0) [0|65535] ""  CCURT2,RT2_C3,OTAWL,ZCUF,ZCUL,ZCUR,ZCUT,NIDU,DCUR,BMS,CBM,RBM,ICM,IDC,PHUDD,ADC,IFC,FAPA,DRM,PLGM,TRM,RLBMS,TBOX
 SG_ CCU_1_Counter : 23|8@0+ (1,0) [0|255] ""  CCURT2,RT2_C3,OTAWL,ZCUF,ZCUL,ZCUR,ZCUT,NIDU,DCUR,BMS,CBM,RBM,ICM,IDC,PHUDD,ADC,IFC,FAPA,DRM,PLGM,TRM,RLBMS,TBOX
 SG_ UMM_UsageModeSt : 26|3@0+ (1,0) [0|7] ""  CCURT2,RT2_C3,OTAWL,TMC,ZCUF,ZCUL,ZCUR,ZCUT,EMS,IDM,DCDC,IPS,NIDU,NIDUF,DCUR,IDUR,OBC,OPC,LPC,LPC2,CPC,EMCM,GCU,DCUF,IPU,BMS,EOPF,EOPR,DCDC2,EDL,SRS,EBB,ECS,SAS,CBM,RAS,EPS,RBM,IBCS,ICM,IID,IDC,PHUDD,RCICP,AMP,WHUD,IMR,CD,INU,ADC,IFC,FAPA,RRR,RLR,PAS,PCS,SCMR,SCMRL,SCMRR,HVSMR,SCMRM,SCMT,MFS,WSM,DRM,IDU,FCP,RCP,LBMSAD,AVAS,ATSS,DLPFL,FBLCM,FLISD,FLLCM,FRLCM,RLLCMA,RLLCMB,RRLCMA,RRLCMB,RLISD,RRISD,DLPML,DLPMR,PLGM,TRM,PSDL,PSDR,HVSPRL,HVSPRR,LBMS,RLBMS,TBOX2,TBOX
 SG_ OTA_FuncReq_ADCWakeup : 45|3@0+ (1,0) [0|7] ""  ADC,FAPA
 SG_ UMM_FrontPassengerSeatSt : 57|2@0+ (1,0) [0|3] ""  OTAWL,ZCUR,SRS,EBB,IBCS,ICM,IDC,ADC,IFC,FAPA,RRR,RLR,TBOX
 SG_ UMM_DriverSeatSt : 59|2@0+ (1,0) [0|3] ""  OTAWL,ZCUR,SRS,EBB,IBCS,ICM,IDC,ADC,IFC,FAPA,RRR,RLR,TBOX
 SG_ VMM_VehModeSt : 159|4@0+ (1,0) [0|15] ""  CCURT2,RT2_C3,OTAWL,TMC,ZCUF,ZCUL,ZCUR,ZCUT,EMS,DCDC,IPS,NIDU,NIDUF,DCUR,IDUR,OBC,OPC,LPC,LPC2,CPC,EMCM,GCU,DCUF,IPU,BMS,EOPF,EOPR,DCDC2,EDL,SRS,EBB,ECS,SAS,EPS,EPB,RBM,IBCS,ICM,IDC,RCICP,AMP,WHUD,IMR,ADC,IFC,FAPA,RRR,RLR,PAS,SCMR,SCMRL,SCMRR,HVSMR,SCMRM,SCMT,MFS,IDU,FCP,RCP,LBMSAD,AVAS,ATSS,DLPFL,FBLCM,FLISD,FLLCM,FRLCM,RLLCMA,RLLCMB,RRLCMA,RRLCMB,RLISD,RRISD,DLPML,DLPMR,PLGM,TRM,PSDL,PSDR,HVSPRL,HVSPRR,LBMS,RLBMS,RFR,SBM,WCM,ETC,TBOX2,TBOX
 SG_ VMM_LastVehModeSt : 155|4@0+ (1,0) [0|15] ""  TMC,ZCUF,ZCUL,ZCUR,ZCUT,EMS,DCDC,IPS,NIDU,NIDUF,DCUR,IDUR,OBC,OPC,LPC,LPC2,CPC,EMCM,GCU,DCUF,IPU,BMS,DCDC2,EDL,SRS,EBB,EPS,EPB,RBM,IBCS,ICM,IDC,AMP,ADC,IFC,FAPA,PAS,SCMR,SCMRL,SCMRR,HVSMR,SCMRM,MFS,FCP,RCP,AVAS,ATSS,FLLCM,FRLCM,TRM,PSDL,RFR,SBM,WCM,ETC,TBOX
 SG_ VMM_OTAModeSt : 167|2@0+ (1,0) [0|3] ""  CCURT2,RT2_C3,OTAWL,ZCUF,ZCUL,ZCUR,ZCUT,EMS,IDM,DCDC,IPS,NIDU,NIDUF,DCUR,IDUR,OBC,OPC,LPC,LPC2,CPC,EMCM,GCU,DCUF,IPU,BMS,EOPF,EOPR,DCDC2,EDL,SRS,EBB,ECS,EPS,EPB,RBM,IBCS,ICM,IID,IDC,PHUDD,RCICP,AMP,WHUD,ADC,IFC,FAPA,RRR,RLR,PAS,SCMR,SCMRL,SCMRR,HVSMR,SCMRM,SCMT,MFS,FCP,RCP,LBMSAD,AVAS,ATSS,DLPFL,FBLCM,FLISD,FLLCM,FRLCM,RLLCMA,RLLCMB,RRLCMA,RRLCMB,RLISD,RRISD,DLPML,DLPMR,TRM,PSDL,PSDR,HVSPRL,HVSPRR,LBMS,RLBMS,RFR,SBM,WCM,ETC,TBOX
 SG_ CSM_RC_PAARequest : 287|4@0+ (1,0) [0|15] ""  ADC,FAPA
 SG_ IPDS_EnablePowerSup : 327|2@0+ (1,0) [0|3] ""  CCURT2,RT2_C3,ZCUF,ZCUL,ZCUR,ZCUT,EMS,IPS,NIDU,NIDUF,DCUR,IDUR,OBC,OPC,LPC,LPC2,CPC,EMCM,GCU,DCUF,IPU,BMS,EDL,SRS,EBB,ECS,EPB,RBM,IBCS,ICM,IID,IDC,PHUDD,ADC,FAPA,PCS,TBOX
 SG_ Time_Year : 343|8@0+ (1,2000) [2000|2255] "y"  CCURT2,RT2_C3,TMC,ZCUF,ZCUL,ZCUR,ZCUT,EMS,IDM,DCDC,IPS,NIDU,NIDUF,DCUR,IDUR,OBC,OPC,LPC,LPC2,CPC,EMCM,GCU,DCUF,IPU,BMS,EOPF,EOPR,EVCC,DCDC2,EDL,SRS,EBB,ECS,CBM,RAS,EPS,EPB,RBM,IBCS,RCICP,AMP,WHUD,IMR,INU,ADC,IFC,FAPA,RRR,RLR,PAS,PCS,SCMR,SCMRL,SCMRR,HVSMR,SCMRM,SCMT,MFS,WSM,DRM,FCP,RCP,LBMSAD,ATSS,DLPFL,FBLCM,FLISD,FLLCM,FRLCM,RLLCMA,RLLCMB,RRLCMA,RRLCMB,RLISD,RRISD,DLPML,DLPMR,PLGM,TRM,PSDL,PSDR,HVSPRL,HVSPRR,LBMS,RLBMS
 SG_ Time_Month : 351|4@0+ (1,0) [1|12] "m"  CCURT2,RT2_C3,TMC,ZCUF,ZCUL,ZCUR,ZCUT,EMS,IDM,DCDC,IPS,NIDU,NIDUF,DCUR,IDUR,OBC,OPC,LPC,LPC2,CPC,EMCM,GCU,DCUF,IPU,BMS,EOPF,EOPR,EVCC,DCDC2,EDL,SRS,EBB,ECS,CBM,RAS,EPS,EPB,RBM,IBCS,RCICP,AMP,WHUD,IMR,INU,ADC,IFC,FAPA,RRR,RLR,PAS,PCS,SCMR,SCMRL,SCMRR,HVSMR,SCMRM,SCMT,MFS,WSM,DRM,FCP,RCP,LBMSAD,ATSS,DLPFL,FBLCM,FLISD,FLLCM,FRLCM,RLLCMA,RLLCMB,RRLCMA,RRLCMB,RLISD,RRISD,DLPML,DLPMR,PLGM,TRM,PSDL,PSDR,HVSPRL,HVSPRR,LBMS,RLBMS
 SG_ Time_Day : 347|5@0+ (1,0) [1|31] "d"  CCURT2,RT2_C3,TMC,ZCUF,ZCUL,ZCUR,ZCUT,EMS,IDM,DCDC,IPS,NIDU,NIDUF,DCUR,IDUR,OBC,OPC,LPC,LPC2,CPC,EMCM,GCU,DCUF,IPU,BMS,EOPF,EOPR,EVCC,DCDC2,EDL,SRS,EBB,ECS,CBM,RAS,EPS,EPB,RBM,IBCS,RCICP,AMP,WHUD,IMR,INU,ADC,IFC,FAPA,RRR,RLR,PAS,PCS,SCMR,SCMRL,SCMRR,HVSMR,SCMRM,SCMT,MFS,WSM,DRM,FCP,RCP,LBMSAD,ATSS,DLPFL,FBLCM,FLISD,FLLCM,FRLCM,RLLCMA,RLLCMB,RRLCMA,RRLCMB,RLISD,RRISD,DLPML,DLPMR,PLGM,TRM,PSDL,PSDR,HVSPRL,HVSPRR,LBMS,RLBMS
 SG_ Time_Hour : 358|5@0+ (1,0) [0|23] "h"  CCURT2,RT2_C3,TMC,ZCUF,ZCUL,ZCUR,ZCUT,EMS,IDM,DCDC,IPS,NIDU,NIDUF,DCUR,IDUR,OBC,OPC,LPC,LPC2,CPC,EMCM,GCU,DCUF,IPU,BMS,EOPF,EOPR,EVCC,DCDC2,EDL,SRS,EBB,ECS,CBM,RAS,EPS,EPB,RBM,IBCS,RCICP,AMP,WHUD,IMR,INU,ADC,IFC,FAPA,RRR,RLR,PAS,PCS,SCMR,SCMRL,SCMRR,HVSMR,SCMRM,SCMT,MFS,WSM,DRM,FCP,RCP,LBMSAD,ATSS,DLPFL,FBLCM,FLISD,FLLCM,FRLCM,RLLCMA,RLLCMB,RRLCMA,RRLCMB,RLISD,RRISD,DLPML,DLPMR,PLGM,TRM,PSDL,PSDR,HVSPRL,HVSPRR,LBMS,RLBMS
 SG_ Time_Min : 353|6@0+ (1,0) [0|59] "min"  CCURT2,RT2_C3,TMC,ZCUF,ZCUL,ZCUR,ZCUT,EMS,IDM,DCDC,IPS,NIDU,NIDUF,DCUR,IDUR,OBC,OPC,LPC,LPC2,CPC,EMCM,GCU,DCUF,IPU,BMS,EOPF,EOPR,EVCC,DCDC2,EDL,SRS,EBB,ECS,CBM,RAS,EPS,EPB,RBM,IBCS,RCICP,AMP,WHUD,IMR,INU,ADC,IFC,FAPA,RRR,RLR,PAS,PCS,SCMR,SCMRL,SCMRR,HVSMR,SCMRM,SCMT,MFS,WSM,DRM,FCP,RCP,LBMSAD,ATSS,DLPFL,FBLCM,FLISD,FLLCM,FRLCM,RLLCMA,RLLCMB,RRLCMA,RRLCMB,RLISD,RRISD,DLPML,DLPMR,PLGM,TRM,PSDL,PSDR,HVSPRL,HVSPRR,LBMS,RLBMS
 SG_ Time_Sec : 363|6@0+ (1,0) [0|59] "s"  CCURT2,RT2_C3,TMC,ZCUF,ZCUL,ZCUR,ZCUT,EMS,IDM,DCDC,IPS,NIDU,NIDUF,DCUR,IDUR,OBC,OPC,LPC,LPC2,CPC,EMCM,GCU,DCUF,IPU,BMS,EOPF,EOPR,EVCC,DCDC2,EDL,SRS,EBB,ECS,CBM,RAS,EPS,EPB,RBM,IBCS,RCICP,AMP,WHUD,IMR,INU,ADC,IFC,FAPA,RRR,RLR,PAS,PCS,SCMR,SCMRL,SCMRR,HVSMR,SCMRM,SCMT,MFS,WSM,DRM,FCP,RCP,LBMSAD,ATSS,DLPFL,FBLCM,FLISD,FLLCM,FRLCM,RLLCMA,RLLCMB,RRLCMA,RRLCMB,RLISD,RRISD,DLPML,DLPMR,PLGM,TRM,PSDL,PSDR,HVSPRL,HVSPRR,LBMS,RLBMS
 SG_ CCU_DstFlag : 272|1@0+ (1,0) [0|1] ""  ZCUF,ZCUL,ZCUR,ZCUT,ADC,FAPA
 SG_ ASB_DriverActiveBeltFaultSt : 420|1@0+ (1,0) [0|1] ""  IDC,ADC,IFC,FAPA,TBOX
 SG_ IPDS_DCDCOpenCircuitSt : 377|2@0+ (1,0) [0|3] ""  IDC,ADC

BO_ 825 CCU_5: 64 CCU_CCURT2
 SG_ WW_FwpFaultSt : 34|1@0+ (1,0) [0|1] ""  ICM,IDC,ADC,IFC
 SG_ WW_RwpFaultSt : 33|1@0+ (1,0) [0|1] ""  ICM,IDC,ADC,IFC
 SG_ WW_FwshFaultSt : 32|1@0+ (1,0) [0|1] ""  ICM,IDC,ADC,IFC
 SG_ WW_RwshFaultSt : 47|1@0+ (1,0) [0|1] ""  ICM,IDC,ADC,IFC
 SG_ WW_FwpAutoModeSt : 46|1@0+ (1,0) [0|1] ""  ICM,IDC,ADC,IFC
 SG_ RLS_IRBrightness : 218|11@0+ (400,0) [0|818000] ""  WHUD,ADC
 SG_ WW_RainFallLevel : 391|4@0+ (1,0) [0|15] ""  CCURT1,RT1_C1,ZCUF,ZCUL,ZCUR,ZCUT,ICM,IDC,ADC,IFC
 SG_ RLS_LightOnReq : 387|1@0+ (1,0) [0|1] ""  ZCUL,ZCUR,IDC,ADC,IFC
 SG_ RLS_LampOnReqValid : 386|1@0+ (1,0) [0|1] ""  IDC,ADC,IFC
 SG_ RLS_WiperSpd : 385|4@0+ (1,0) [0|15] ""  IDC,ADC,IFC
 SG_ RLS_AMBBrightness : 298|14@0+ (6,0) [0|98286] "Lux"  IDC,WHUD,ADC,IFC
 SG_ RLS_FWBrightness : 413|14@0+ (6,0) [0|98286] ""  IDC,WHUD,ADC,IFC
 SG_ RLS_RainfallLevel : 439|4@0+ (1,0) [0|15] ""  ICM,IDC,ADC,IFC
 SG_ RLS_RSErr : 400|1@0+ (1,0) [0|1] ""  ICM,IDC,ADC,IFC
 SG_ RLS_LSErr : 401|1@0+ (1,0) [0|1] ""  ZCUR,ICM,IDC,ADC,IFC
 SG_ PM_AUTHPstState : 469|1@0+ (1,0) [0|1] ""  CCURT1,RT1_C0,ADC,IFC
 SG_ CCU_FuncReq_SentryMod : 146|1@0+ (1,0) [0|1] ""  IDC,ADC
 SG_ RLS_WindShieldHum : 119|8@0+ (0.5,-0.5) [0|100] "%"  ADC
 SG_ RLS_WindShieldTem : 127|8@0+ (0.5,-40) [-40|86.5] "℃"  ADC
 SG_ RLS_DewPoint : 135|8@0+ (0.5,-40) [-40|86.5] "℃"  ADC
 SG_ CCU_ModeSuppressSts : 369|2@0+ (1,0) [0|2] ""  IDC,ADC
 SG_ RLS_HUTErr : 426|1@0+ (1,0) [0|1] ""  ADC

BO_ 291 CCU_6: 64 CCU_CCURT2
 SG_ CCU_6_CRC : 7|16@0+ (1,0) [0|65535] ""  ZCUF,ZCUL,ZCUR,ADC,IFC,FAPA,PLGM
 SG_ CCU_6_Counter : 23|8@0+ (1,0) [0|255] ""  ZCUF,ZCUL,ZCUR,ADC,IFC,FAPA,PLGM
 SG_ ATWS_ATWSAlarmReq : 31|2@0+ (1,0) [0|3] ""  CCURT1,RT1_C1,ICM,IDC,ADC,IFC,FAPA
 SG_ ATWS_ATWSSt : 26|3@0+ (1,0) [0|7] ""  CCURT1,RT1_C0,RT1_C1,OTAWL,ZCUR,ICM,IDC,ADC,IFC,FAPA,RRR,RLR,PLGM
 SG_ WW_FrontWasherCmd : 39|2@0+ (1,0) [0|3] ""  CCURT1,RT1_C1,ZCUF,ZCUL,ADC,IFC,FAPA
 SG_ WW_FrtWiperAutoAvl : 56|1@0+ (1,0) [0|1] ""  ADC,IFC,FAPA
 SG_ WW_FrontWiperCmd_Speed : 85|2@0+ (1,0) [0|3] ""  CCURT1,RT1_C1,ZCUF,ZCUL,ADC,IFC,FAPA
 SG_ WW_RearWiperCtrlSt : 107|3@0+ (1,0) [0|7] ""  CCURT1,RT1_C1,ZCUF,ZCUL,ZCUR,ZCUT,ICM,IDC,ADC,IFC,FAPA
 SG_ WW_FrontWiperCtrlSt : 111|3@0+ (1,0) [0|7] ""  CCURT1,RT1_C0,RT1_C1,ZCUF,ZCUL,ZCUR,ZCUT,EMS,ICM,IDC,ADC,IFC,FAPA
 SG_ WW_FrontWiperCtrlSrc : 115|3@0+ (1,0) [0|7] ""  CCURT1,RT1_C1,ZCUF,ZCUL,ZCUR,ZCUT,ICM,IDC,ADC,FAPA
 SG_ WW_RearWiperCtrlSrc : 112|3@0+ (1,0) [0|7] ""  CCURT1,RT1_C1,ZCUF,ZCUL,ZCUR,ZCUT,ICM,IDC,ADC,IFC,FAPA
 SG_ WW_RearCamWasherVKResp : 125|2@0+ (1,0) [0|3] ""  ICM,IDC,ADC,IFC,FAPA
 SG_ WW_RearCamWasherVRResp : 123|2@0+ (1,0) [0|3] ""  ICM,IDC,ADC,IFC,FAPA
 SG_ CSM_RC_AuthSt : 249|2@0+ (1,0) [0|3] ""  CCURT1,RT1_C0,RT1_C1,ADC

BO_ 865 CCU_7: 64 CCU_CCURT2
 SG_ EL_ReverseLightCtrlCmd : 30|1@0+ (1,0) [0|1] ""  CCURT1,ZCUR,ZCUT,ADC,IFC,FAPA,TRM
 SG_ EL_SideBrkLightCtrlCmd : 29|1@0+ (1,0) [0|1] ""  CCURT1,RT1_C1,ZCUF,ZCUL,ZCUR,ZCUT,IDC,ADC,IFC,FAPA,PCS,TRM
 SG_ EL_LeftLowBeamCtrlCmd : 36|1@0+ (1,0) [0|1] ""  CCURT1,ZCUF,ZCUL,ADC,IFC,FAPA
 SG_ EL_RightLowBeamCtrlCmd : 35|1@0+ (1,0) [0|1] ""  CCURT1,ZCUF,ZCUL,ADC,IFC,FAPA
 SG_ EL_PositionLightCtrlSource : 34|3@0+ (1,0) [0|7] ""  CCURT1,ZCUF,ZCUL,ZCUR,ZCUT,ICM,IDC,RCICP,ADC,IFC,FAPA,MFS,FCP,RCP,ATSS,TRM
 SG_ EL_LeftHighBeamCtrlCmd : 55|1@0+ (1,0) [0|1] ""  CCURT1,ZCUF,ZCUL,ADC,IFC,FAPA
 SG_ EL_RightHighBeamCtrlCmd : 54|1@0+ (1,0) [0|1] ""  CCURT1,ZCUF,ZCUL,ADC,IFC,FAPA
 SG_ EL_LowBeamCtrlSource : 53|3@0+ (1,0) [0|7] ""  CCURT1,ZCUF,ZCUL,ZCUR,ZCUT,ADC,IFC,FAPA
 SG_ EL_RearFogLightCtrlSource : 50|3@0+ (1,0) [0|7] ""  CCURT1,ZCUR,ZCUT,ADC,IFC,FAPA,TRM
 SG_ EL_HighBeamCtrlSource : 61|3@0+ (1,0) [0|7] ""  CCURT1,ZCUF,ZCUL,ADC,IFC,FAPA
 SG_ EL_FrontFogLightCtrlSource : 71|3@0+ (1,0) [0|7] ""  CCURT1,ZCUF,ZCUL,ZCUR,ZCUT,ADC,IFC,FAPA
 SG_ EL_LicencePlateLightCtrlSource : 84|3@0+ (1,0) [0|7] ""  CCURT1,ZCUR,ZCUT,ADC,IFC,FAPA
 SG_ EL_FlasherCtrlSource : 95|4@0+ (1,0) [0|15] ""  CCURT1,RT1_C0,ZCUF,ZCUL,ZCUR,ZCUT,SRS,ADC,IFC,FAPA,DLPML,DLPMR,TRM
 SG_ EL_FADASLightCtrlCmd : 130|1@0+ (1,0) [0|1] ""  ZCUF,ZCUL,ZCUR,ZCUT,ADC,FAPA
 SG_ EL_RADASLightCtrlCmd : 131|1@0+ (1,0) [0|1] ""  ZCUF,ZCUL,ZCUR,ZCUT,ADC,FAPA
 SG_ EL_IHBColourSt : 155|2@0+ (1,0) [0|3] ""  IID,IDC,PHUDD,ADC,IFC,FAPA
 SG_ EL_AutoHighBeamCtrlSt : 128|1@0+ (1,0) [0|1] ""  CCURT1,ADC,IFC,FAPA
 SG_ EL_ADBEnable : 252|1@0+ (1,0) [0|1] ""  IDC,ADC,IFC,FAPA
 SG_ EL_ADC_2_VERFailFlag : 175|1@0+ (1,0) [0|1] ""  ADC,IFC,FAPA
 SG_ EL_ADC_4_New_VERFailFlag : 174|1@0+ (1,0) [0|1] ""  ADC,IFC,FAPA
 SG_ EL_ADC_8_VERFailFlag : 173|1@0+ (1,0) [0|1] ""  ADC,IFC,FAPA
 SG_ EL_HeadLightLevelingSWSt : 467|4@0+ (1,0) [0|15] ""  CCURT1,ICM,IDC,ADC,IFC,FAPA
 SG_ EL_LeftTurnLightStForDisp : 478|1@0+ (1,0) [0|1] ""  CCURT1,IID,IDC,PHUDD,ADC,IFC,FAPA,RRR,RLR,PCS,DLPML,DLPMR
 SG_ EL_RightTurnLightStForDisp : 477|1@0+ (1,0) [0|1] ""  CCURT1,IID,IDC,PHUDD,ADC,IFC,FAPA,RRR,RLR,PCS,DLPML,DLPMR
 SG_ EL_PositionLightStForDisp : 476|1@0+ (1,0) [0|1] ""  CCURT1,RT1_C1,ZCUL,ZCUR,ZCUT,IID,IDC,PHUDD,WHUD,ADC,IFC,FAPA,PCS,MFS,FCP
 SG_ EL_FrontFogLightStForDisp : 475|1@0+ (1,0) [0|1] ""  CCURT1,IDC,ADC,IFC,FAPA,PCS
 SG_ EL_RearFogLightStForDisp : 474|1@0+ (1,0) [0|1] ""  CCURT1,ZCUR,IDC,ADC,IFC,FAPA,PCS,RCP
 SG_ EL_LowBeamStForDisp : 473|1@0+ (1,0) [0|1] ""  CCURT1,RT1_C1,IDC,ADC,IFC,FAPA,PCS,DLPML,DLPMR
 SG_ EL_HighBeamStForDisp : 472|1@0+ (1,0) [0|1] ""  CCURT1,RT1_C1,IID,IDC,PHUDD,ADC,IFC,FAPA,PCS
 SG_ EL_HeadLightSWSt : 510|2@0+ (1,0) [0|3] ""  ZCUR,IDC,ADC,FAPA

BO_ 293 CCU_8: 64 CCU_CCURT2
 SG_ TPMS_FrontLeftTireBlowout : 193|2@0+ (1,0) [0|3] ""  CCURT1,RT1_C1,IDC,ADC,IFC,FAPA
 SG_ TPMS_FrontRightTireBlowout : 195|2@0+ (1,0) [0|3] ""  CCURT1,RT1_C1,IDC,ADC,IFC,FAPA
 SG_ TPMS_RearRightTireBlowout : 197|2@0+ (1,0) [0|3] ""  CCURT1,RT1_C1,IDC,ADC,IFC,FAPA
 SG_ TPMS_RearLeftTireBlowout : 199|2@0+ (1,0) [0|3] ""  CCURT1,RT1_C1,IDC,ADC,IFC,FAPA
 SG_ TPMS_FrontLeftTirePressure : 207|8@0+ (1.373,0) [0|350.115] "kpa"  CCURT1,RT1_C0,RT1_C1,ICM,IDC,ADC,FAPA
 SG_ TPMS_FrontRightTirePressure : 215|8@0+ (1.373,0) [0|350.115] "kpa"  CCURT1,RT1_C0,RT1_C1,ICM,IDC,ADC,FAPA
 SG_ TPMS_RearRightTirePressure : 223|8@0+ (1.373,0) [0|350.115] "kpa"  CCURT1,RT1_C0,RT1_C1,ICM,IDC,ADC,FAPA
 SG_ TPMS_RearLeftTirePressure : 231|8@0+ (1.373,0) [0|350.115] "kpa"  CCURT1,RT1_C0,RT1_C1,ICM,IDC,ADC,FAPA
 SG_ TPMS_TireWarningLamp : 295|1@0+ (1,0) [0|1] ""  SRS,ICM,IID,IDC,PHUDD,ADC,IFC,FAPA
 SG_ TPMS_SystemWarningLamp : 310|1@0+ (1,0) [0|1] ""  SRS,ICM,IID,IDC,PHUDD,ADC,IFC,FAPA

BO_ 294 CCU_9: 64 CCU_CCURT2
 SG_ LCK_DriverDoorAjarSt : 31|1@0+ (1,0) [0|1] ""  CCURT1,RT1_C0,RT1_C1,OTAWL,ZCUF,ZCUL,ZCUR,ZCUT,ECS,IBCS,ICM,IDC,IMR,ADC,IFC,FAPA,PCS
 SG_ LCK_PassengerDoorAjarSt : 30|1@0+ (1,0) [0|1] ""  CCURT1,RT1_C0,RT1_C1,OTAWL,ZCUL,ZCUR,ECS,ICM,IDC,IMR,ADC,IFC,FAPA,PCS
 SG_ LCK_DriverDoorLockSt : 29|1@0+ (1,0) [0|1] ""  CCURT1,RT1_C0,RT1_C1,OTAWL,ZCUL,ZCUR,ZCUT,ECS,ICM,IDC,IMR,ADC,IFC,FAPA
 SG_ LCK_PassengerDoorLockSt : 28|1@0+ (1,0) [0|1] ""  CCURT1,RT1_C0,RT1_C1,OTAWL,ZCUL,ZCUR,ZCUT,ECS,ICM,IDC,IMR,ADC,IFC,FAPA
 SG_ LCK_VehicleDoorAjarSt : 27|2@0+ (1,0) [0|3] ""  CCURT1,RT1_C1,OTAWL,ZCUL,ZCUR,ZCUT,IDC,ADC,IFC,FAPA
 SG_ LCK_VehicleDoorLockSt : 25|2@0+ (1,0) [0|3] ""  CCURT1,RT1_C0,RT1_C1,OTAWL,ZCUF,ZCUL,ZCUR,ZCUT,ICM,IDC,IMR,ADC,IFC,FAPA
 SG_ LCK_VehicleChildSaftyLockSt : 39|1@0+ (1,0) [0|1] ""  CCURT1,ZCUL,ICM,IDC,ADC,IFC,FAPA
 SG_ LCK_VehicleChildSaftyLockedIndicate : 38|1@0+ (1,0) [0|1] ""  CCURT1,ZCUL,ICM,IDC,ADC,IFC,FAPA

BO_ 334 CCU_15: 64 CCU_CCURT1
 SG_ Theft_Auth_Status : 379|12@0+ (1,0) [0|4095] ""  ADC,FAPA
 SG_ CSM_RC_ViewExtvideo : 215|16@0+ (1,0) [0|65535] ""  IDC,ADC,FAPA
 SG_ CSM_RC_ViewExtvideoReq : 231|1@0+ (1,0) [0|1] ""  IDC,ADC,FAPA

BO_ 93 CCU_17: 8 CCU_CCURT1
 SG_ CCU_ADCSoCWakeupRequest : 7|3@0+ (1,0) [0|7] ""  ADC,FAPA

BO_ 120 CCU_SECKEY: 32 CCU_CCURT1
 SG_ CCU_SEC_KEY_Defaultencoding : 7|256@0+ (1,0) [0|0] ""  ZCUF,ZCUL,ZCUR,ZCUT,IDC,ADC,IFC,FAPA

BO_ 154 CCU_IMMO: 32 CCU_CCURT1
 SG_ CCU_IMMO : 7|256@0+ (1,0) [0|0] ""  OTAWL,ZCUR,ICM,IDC,ADC,SBM,TBOX

BO_ 777 CCU_ZCUR_4: 64 CCU
 SG_ ZCUR_4_CRC : 7|16@0+ (1,0) [0|65535] ""  ADC,IFC,FAPA
 SG_ ZCUR_4_Counter : 23|8@0+ (1,0) [0|255] ""  ADC,IFC,FAPA
 SG_ EL_MRADASLightSt : 113|2@0+ (1,0) [0|3] ""  ADC,IFC
 SG_ MR_RightMirrorFoldUnfoldSt : 199|2@0+ (1,0) [0|3] ""  IDC,ADC,IFC,FAPA,PCS
 SG_ PWL_WinCurrentPos_FRWinPst : 303|8@0+ (0.5,0) [0|100] "％"  IDC,AMP,IMR,ADC,FAPA
 SG_ EL_MRTurnLightSt : 325|2@0+ (1,0) [0|3] ""  ICM,IDC,ADC,IFC,FAPA
 SG_ EL_MRTurnLightFaultSt : 323|1@0+ (1,0) [0|1] ""  ICM,IDC,ADC,IFC,FAPA
 SG_ KAE_toADCDRVUnlockSensorSt : 328|1@0+ (1,0) [0|1] ""  ADC,FAPA
 SG_ KAE_toADCDRVLockSensorSt : 360|1@0+ (1,0) [0|1] ""  ADC,FAPA
 SG_ EL_RightBSDIndicatorSt : 353|1@0+ (1,0) [0|1] ""  ADC,IFC,FAPA
 SG_ EL_RightBSDIndicatorFaultSt : 352|1@0+ (1,0) [0|1] ""  ADC,IFC,FAPA

BO_ 163 CCU_IDC_11: 64 CCU
 SG_ ACU_RAEBcfg : 2|2@0+ (1,0) [0|2] ""  ADC
 SG_ ACU_PAAMode : 7|4@0+ (1,0) [0|15] ""  ADC
 SG_ ACU_SVM_Button : 3|1@0+ (1,0) [0|1] ""  ADC
 SG_ ACU_PCS_MirrorpagedownButtonST : 0|1@0+ (1,0) [0|1] ""  ADC
 SG_ ACU_PCS_ScreenTouchSt : 15|2@0+ (1,0) [0|3] ""  ADC
 SG_ ACU_LanguageTypeSet : 13|6@0+ (1,0) [0|63] ""  IID,PHUDD,ADC,IFC
 SG_ ACU_PCS_SVM_FunctionCmd : 23|4@0+ (1,0) [0|15] ""  ADC
 SG_ ACU_PCS_ScreenCoordY : 19|12@0+ (1,0) [0|1439] ""  ADC
 SG_ ACU_PCS_ScreenCoordX : 39|12@0+ (1,0) [0|2559] ""  ADC
 SG_ ACU_APAMessageSt : 43|3@0+ (1,0) [0|7] ""  ADC
 SG_ ACU_PAS_ButtonPress : 40|1@0+ (1,0) [0|1] ""  ADC,PAS
 SG_ ACU_HPAMessageSt : 55|3@0+ (1,0) [0|7] ""  ADC
 SG_ ACU_AVPMessageSt : 52|3@0+ (1,0) [0|7] ""  ADC
 SG_ ACU_HPALearningSetParkLot : 49|2@0+ (1,0) [0|3] ""  ADC
 SG_ ACU_HPALearningProcessInfo : 63|5@0+ (1,0) [0|31] ""  ADC
 SG_ ACU_SDEnterParkingLot : 58|2@0+ (1,0) [0|3] ""  ADC
 SG_ ACU_PCS_ER_QuitConfirm : 56|1@0+ (1,0) [0|1] ""  ADC
 SG_ ACU_DisplayReq : 71|2@0+ (1,0) [0|3] ""  ADC
 SG_ ACU_ER_FuncCfg : 69|2@0+ (1,0) [0|3] ""  ADC
 SG_ ACU_PCS_ER_EnterCmd : 67|1@0+ (1,0) [0|1] ""  ADC
 SG_ ACU_PCS_ScreenTouchSignal : 66|2@0+ (1,0) [0|3] ""  ADC
 SG_ ACU_DPMessageSt : 79|3@0+ (1,0) [0|7] ""  ADC
 SG_ ACU_ParkingBoxMidX : 87|12@0+ (1,0) [0|1919] ""  ADC
 SG_ ACU_ParkingBoxMidY : 91|12@0+ (1,0) [0|1079] ""  ADC
 SG_ ACU_LowPowerConfig : 114|3@0+ (1,0) [0|7] ""  ADC,IFC
 SG_ ACU_PCSModeSt : 115|1@0+ (1,0) [0|1] ""  ADC
 SG_ ACU_PCSModeSt_A : 74|2@0+ (1,0) [0|2] ""  ADC
 SG_ ACU_ParkingBoxAngle : 111|12@0+ (0.1,-180) [-180|180] "°"  ADC
 SG_ IDC_APAParkingSpdsSfg : 125|2@0+ (1,0) [0|3] ""  ADC
 SG_ IDC_DskScreenOperationSt : 123|2@0+ (1,0) [0|3] ""  ADC
 SG_ IDC_SenslesEtyParkingSwSt : 121|2@0+ (1,0) [0|3] ""  ADC
 SG_ ACU_NDAVoicePromptTypeCfg : 127|2@0+ (1,0) [0|3] ""  ADC
 SG_ IDC_SenslesEtyParkingDskScene : 143|3@0+ (1,0) [0|7] ""  ADC
 SG_ ACU_VR_APAControl : 131|4@0+ (1,0) [0|15] ""  ADC
 SG_ ACU_SteeringPrkgButton : 135|4@0+ (1,0) [0|15] ""  ADC
 SG_ ACU_ActiveNDAMessageSt : 162|3@0+ (1,0) [0|4] ""  ADC,IFC
 SG_ ACU_ActiveAVPMessageSt : 175|3@0+ (1,0) [0|4] ""  ADC,IFC
 SG_ ACU_LeftLaneChangeMessageSt : 169|3@0+ (1,0) [0|4] ""  ADC,IFC
 SG_ ACU_RigthLaneChangeMessageSt : 172|3@0+ (1,0) [0|4] ""  ADC,IFC
 SG_ ACU_ICANDAIconMessageSt : 182|1@0+ (1,0) [0|1] ""  ADC,IFC
 SG_ ACU_SVM_Button_A : 343|3@0+ (1,0) [0|7] ""  ADC

BO_ 618 CCU_EPB_1: 32 CCU
 SG_ EPB_1_CRC : 7|16@0+ (1,0) [0|65535] ""  ZCUF,ZCUL,ZCUR,IBCS,ICM,IDC,ADC,IFC,FAPA,RRR,RLR,PAS
 SG_ EPB_1_Counter : 23|8@0+ (1,0) [0|255] ""  ZCUF,ZCUL,ZCUR,IBCS,ICM,IDC,ADC,IFC,FAPA,RRR,RLR,PAS
 SG_ EPB_SwitchSt : 31|2@0+ (1,0) [0|3] ""  ZCUF,ZCUL,ZCUR,SRS,IBCS,IDC,ADC,IFC,FAPA,RRR,RLR,PAS
 SG_ EPB_SwitchStVD : 29|1@0+ (1,0) [0|1] ""  ZCUF,ZCUL,ZCUR,SRS,IBCS,ADC,IFC,FAPA,RRR,RLR,PAS
 SG_ EPB_SysSt : 28|3@0+ (1,0) [0|7] ""  ZCUF,ZCUL,ZCUR,SRS,IBCS,ICM,IDC,ADC,IFC,FAPA,RRR,RLR,PAS
 SG_ EPB_FailSt : 39|1@0+ (1,0) [0|1] ""  ZCUF,ZCUL,SRS,IBCS,ICM,IID,IDC,PHUDD,ADC,IFC,FAPA,RRR,RLR,PAS
 SG_ EPB_ExtAvailable : 47|2@0+ (1,0) [0|3] ""  ZCUF,ZCUL,IBCS,ADC,IFC,FAPA,RRR,RLR
 SG_ EPB_DynamicApplySt : 82|3@0+ (1,0) [0|7] ""  ZCUF,ZCUL,IBCS,ADC,IFC,FAPA
 SG_ EPB_ActuatorSt_R : 107|4@0+ (1,0) [0|15] ""  ZCUF,ZCUL,IBCS,ADC,IFC,FAPA,RRR,RLR
 SG_ EPB_RWUActvSts : 109|2@0+ (1,0) [0|3] ""  ADC,FAPA
 SG_ EPB_RWUAvl : 111|2@0+ (1,0) [0|3] ""  ADC,IFC,FAPA
 SG_ EPB_RPAAVPAvailability : 129|2@0+ (1,0) [0|3] ""  ADC,FAPA
 SG_ EPB_APAAvailability : 143|1@0+ (1,0) [0|1] ""  ADC,FAPA

CM_ SG_ 400 UINM_1_CRC "E2E Profile 5 CRC";
CM_ SG_ 400 UINM_1_Counter "E2E Profile 5 Counter";
CM_ SG_ 400 UINM_DrvReqShft "Driver requested gear shift position";
CM_ SG_ 400 UINM_DrvReqShftInv "Driver requested gear shift position inverse";
CM_ SG_ 400 UINM_FuSaErrSt "function safety Error status";
CM_ SG_ 400 UINM_ShftFault "this signal indicate E-shift fault which represent E-shift can not reflect the real driver demand because of any reason.";
CM_ SG_ 400 UINM_PositionLightSwSt "Position light switch state";
CM_ SG_ 400 UINM_LowBeamSwSt "Low beam switch state";
CM_ SG_ 400 UINM_AutoLightSwSt "Auto light switch state";
CM_ SG_ 400 UINM_FrontFogLightSwSt "Front fog light switch state";
CM_ SG_ 400 UINM_RearFogLightSwSt "Rear fog light switch state";
CM_ SG_ 400 UINM_HighBeamSwSt "High beam switch state";
CM_ SG_ 400 UINM_TurnLightSwSt "Turn light switch state";
CM_ SG_ 400 UINM_FrontWiperSwSt "Front wiper  switch status";
CM_ SG_ 400 UINM_FrontWiperIntAdjSwSt "Front wiper interval switch state";
CM_ SG_ 400 UINM_FrontWasherSwSt "Front Washer switch status ";
CM_ SG_ 400 UINM_RearWiperSwSt "Rear Wiper Switch Status";
CM_ SG_ 400 UINM_RearWiperIntAdjSwSt "RearWiperIntAdjSwSt ";
CM_ SG_ 400 UINM_RearWasherSwSt "Front Washer switch status ";
CM_ SG_ 400 UINM_HeadLampWasherSwSt "HeadLamp Washer switch status";
CM_ SG_ 616 CCU_1_CRC "E2E Profile 5 CRC";
CM_ SG_ 616 CCU_1_Counter "E2E Profile 5 Counter";
CM_ SG_ 616 UMM_UsageModeSt "Usage mode state";
CM_ SG_ 616 OTA_FuncReq_ADCWakeup "OTA Requset ADC to Wakeup";
CM_ SG_ 616 UMM_FrontPassengerSeatSt "Front Right Seat Sensor Status";
CM_ SG_ 616 UMM_DriverSeatSt "Front Left Seat Sensor Status";
CM_ SG_ 616 VMM_VehModeSt "Vehicle mode state";
CM_ SG_ 616 VMM_LastVehModeSt "Last time vehicle mode";
CM_ SG_ 616 VMM_OTAModeSt "OTA Mode state";
CM_ SG_ 616 CSM_RC_PAARequest "CSM_RC_Park request";
CM_ SG_ 616 IPDS_EnablePowerSup "Enable power supply";
CM_ SG_ 616 Time_Year "Year number";
CM_ SG_ 616 Time_Month "Month number";
CM_ SG_ 616 Time_Day "Day number";
CM_ SG_ 616 Time_Hour "Hour number";
CM_ SG_ 616 Time_Min "Minute number";
CM_ SG_ 616 Time_Sec "Second number";
CM_ SG_ 616 CCU_DstFlag "Daylight Saving Time Flag";
CM_ SG_ 616 ASB_DriverActiveBeltFaultSt "Driver Side Active Seat Belt Fault State";
CM_ SG_ 616 IPDS_DCDCOpenCircuitSt "DCDC Output Open Circuit Status";
CM_ SG_ 825 WW_FwpFaultSt "Front Wiper Fault state";
CM_ SG_ 825 WW_RwpFaultSt "Rear Wiper Fault state";
CM_ SG_ 825 WW_FwshFaultSt "Front Washer Fault state";
CM_ SG_ 825 WW_RwshFaultSt "Rear Washer Fault state";
CM_ SG_ 825 WW_FwpAutoModeSt "Front Wiper Auto Mode state";
CM_ SG_ 825 WW_RainFallLevel "Rain Fall Level";
CM_ SG_ 825 RLS_LightOnReq "Switch on/off low beam request";
CM_ SG_ 825 RLS_LampOnReqValid "Lamp On Request signal valid";
CM_ SG_ 825 RLS_WiperSpd "Wiper speed mode";
CM_ SG_ 825 RLS_AMBBrightness "Ambient Light Brightness";
CM_ SG_ 825 RLS_FWBrightness "Forward Light Brightness";
CM_ SG_ 825 RLS_RainfallLevel "Rain level";
CM_ SG_ 825 RLS_RSErr "Error status rain sensor";
CM_ SG_ 825 RLS_LSErr "Error status light sensor";
CM_ SG_ 825 PM_AUTHPstState "位置授权开关状态";
CM_ SG_ 825 CCU_FuncReq_SentryMod "Sentry Mode Wake SOC of MDC";
CM_ SG_ 825 RLS_WindShieldHum "Data windshield humidity";
CM_ SG_ 825 RLS_WindShieldTem "Temperature of the windscreen in ℃";
CM_ SG_ 825 RLS_DewPoint "Dew Temperature of the windscreen in ℃";
CM_ SG_ 825 CCU_ModeSuppressSts "Sentry Mode Suppress Status";
CM_ SG_ 825 RLS_HUTErr "HT sensor status";
CM_ SG_ 291 CCU_6_CRC "E2E Profile 5 CRC";
CM_ SG_ 291 CCU_6_Counter "E2E Profile 5 Counter";
CM_ SG_ 291 ATWS_ATWSAlarmReq "ATWS Alarm Request";
CM_ SG_ 291 ATWS_ATWSSt "ATWS status";
CM_ SG_ 291 WW_FrontWasherCmd "Front Washer driver command";
CM_ SG_ 291 WW_FrtWiperAutoAvl "Front wiper auto control available";
CM_ SG_ 291 WW_FrontWiperCmd_Speed "front wiper speed command";
CM_ SG_ 291 WW_RearWiperCtrlSt "Rear wiper control status";
CM_ SG_ 291 WW_FrontWiperCtrlSt "Front wiper control status";
CM_ SG_ 291 WW_FrontWiperCtrlSrc "Front wiper control source";
CM_ SG_ 291 WW_RearWiperCtrlSrc "Rear wiper control source";
CM_ SG_ 291 WW_RearCamWasherVKResp "Rear Camera Washer Request";
CM_ SG_ 291 WW_RearCamWasherVRResp "Rear Camera Washer Request";
CM_ SG_ 291 CSM_RC_AuthSt "Auth Result with SBM/TBOX/KAE";
CM_ SG_ 865 EL_ReverseLightCtrlCmd "Reverse light control command";
CM_ SG_ 865 EL_SideBrkLightCtrlCmd "Side brake light control command";
CM_ SG_ 865 EL_LeftLowBeamCtrlCmd "Left low beam control command";
CM_ SG_ 865 EL_RightLowBeamCtrlCmd "Right low beam control command";
CM_ SG_ 865 EL_PositionLightCtrlSource "Position light control source";
CM_ SG_ 865 EL_LeftHighBeamCtrlCmd "Left high beam control command";
CM_ SG_ 865 EL_RightHighBeamCtrlCmd "Right high beam control command";
CM_ SG_ 865 EL_LowBeamCtrlSource "Low beam control source";
CM_ SG_ 865 EL_RearFogLightCtrlSource "Rear fog light control source";
CM_ SG_ 865 EL_HighBeamCtrlSource "High beam control source";
CM_ SG_ 865 EL_FrontFogLightCtrlSource "Front fog lgiht control source";
CM_ SG_ 865 EL_LicencePlateLightCtrlSource "Licence plate light control source";
CM_ SG_ 865 EL_FlasherCtrlSource "Flasher control source";
CM_ SG_ 865 EL_FADASLightCtrlCmd "Front ADAS light control command";
CM_ SG_ 865 EL_RADASLightCtrlCmd "Rear ADAS light control command";
CM_ SG_ 865 EL_IHBColourSt "Intelligent high beam colour status";
CM_ SG_ 865 EL_ADBEnable "ADB enable";
CM_ SG_ 865 EL_ADC_2_VERFailFlag "ADC_2 Message Verification Fail Flag";
CM_ SG_ 865 EL_ADC_4_New_VERFailFlag "ADC_4_X Message Verification Fail Flag";
CM_ SG_ 865 EL_ADC_8_VERFailFlag "ADC_8 Message Verification Fail Flag";
CM_ SG_ 865 EL_HeadLightLevelingSWSt "Head light leveling manul adjust switch status";
CM_ SG_ 865 EL_LeftTurnLightStForDisp "Left turn light status";
CM_ SG_ 865 EL_RightTurnLightStForDisp "Right turn light status";
CM_ SG_ 865 EL_PositionLightStForDisp "Position light status";
CM_ SG_ 865 EL_FrontFogLightStForDisp "Front fog light status";
CM_ SG_ 865 EL_RearFogLightStForDisp "Rear fog light status";
CM_ SG_ 865 EL_LowBeamStForDisp "Low beam status";
CM_ SG_ 865 EL_HighBeamStForDisp "High beam status";
CM_ SG_ 865 EL_HeadLightSWSt "Headlight switch status";
CM_ SG_ 293 TPMS_FrontLeftTireBlowout "Front Left Tire Blow Out State";
CM_ SG_ 293 TPMS_FrontRightTireBlowout "Front Right Tire Blow Out State";
CM_ SG_ 293 TPMS_RearRightTireBlowout "Rear Right Tire Blow Out State";
CM_ SG_ 293 TPMS_RearLeftTireBlowout "Rear Left Tire Blow Out State";
CM_ SG_ 293 TPMS_FrontLeftTirePressure "FrontLeftTirePresssure";
CM_ SG_ 293 TPMS_FrontRightTirePressure "FrontRightTirePresssure";
CM_ SG_ 293 TPMS_RearRightTirePressure "RearRightTirePresssure";
CM_ SG_ 293 TPMS_RearLeftTirePressure "RearLeftTirePresssure";
CM_ SG_ 293 TPMS_TireWarningLamp "TireWarningLamp";
CM_ SG_ 293 TPMS_SystemWarningLamp "SystemWarningLamp";
CM_ SG_ 294 LCK_DriverDoorAjarSt "DriverDoorAjarST ";
CM_ SG_ 294 LCK_PassengerDoorAjarSt "PassengerDoorAjarST";
CM_ SG_ 294 LCK_DriverDoorLockSt "DriverDoorLockSt";
CM_ SG_ 294 LCK_PassengerDoorLockSt "PassengerDoorLockSt";
CM_ SG_ 294 LCK_VehicleDoorAjarSt "VehicleDoorAjarSt";
CM_ SG_ 294 LCK_VehicleDoorLockSt "VehicleDoorLockSt";
CM_ SG_ 294 LCK_VehicleChildSaftyLockSt "VehicleChildSaftyLockSt";
CM_ SG_ 294 LCK_VehicleChildSaftyLockedIndicate "VehicleChildSaftyLockedIndicate";
CM_ SG_ 334 Theft_Auth_Status "Anti-theft authentication result";
CM_ SG_ 334 CSM_RC_ViewExtvideo "View Exterior-car video remotely (远程查看车外视频)";
CM_ SG_ 334 CSM_RC_ViewExtvideoReq "View Exterior-car video remotely Request (远程查看车外视频请求信号)";
CM_ SG_ 93 CCU_ADCSoCWakeupRequest "CCU Wakeup ADC_Soc";
CM_ SG_ 120 CCU_SEC_KEY_Defaultencoding "CCU distribute SecOC key and default_encoding";
CM_ SG_ 154 CCU_IMMO "CCU distribute anti-theft information";
CM_ SG_ 777 ZCUR_4_CRC "E2E Profile 5 CRC";
CM_ SG_ 777 ZCUR_4_Counter "E2E Profile 5 Counter";
CM_ SG_ 777 EL_MRADASLightSt "Middle right ADAS light status";
CM_ SG_ 777 MR_RightMirrorFoldUnfoldSt "Right Mirror Fold Unfold Status";
CM_ SG_ 777 PWL_WinCurrentPos_FRWinPst "Front Right Window Current Position";
CM_ SG_ 777 EL_MRTurnLightSt "Middle right turn light status";
CM_ SG_ 777 EL_MRTurnLightFaultSt "Middle right turn light fault status";
CM_ SG_ 777 KAE_toADCDRVUnlockSensorSt "Driver Capa Unlock Switch Status";
CM_ SG_ 777 KAE_toADCDRVLockSensorSt "Driver Capa Lock Switch Status";
CM_ SG_ 777 EL_RightBSDIndicatorSt "Right BSD indicator status";
CM_ SG_ 777 EL_RightBSDIndicatorFaultSt "Right BSD indicator fault status";
CM_ SG_ 163 ACU_RAEBcfg "RAEB Configuration";
CM_ SG_ 163 ACU_PAAMode "The Mode of PAA? which ACU request for";
CM_ SG_ 163 ACU_SVM_Button "SVM button press status";
CM_ SG_ 163 ACU_PCS_MirrorpagedownButtonST "Mirror Pagedown Button Status";
CM_ SG_ 163 ACU_PCS_ScreenTouchSt "ACU screen touch status";
CM_ SG_ 163 ACU_LanguageTypeSet "language type set";
CM_ SG_ 163 ACU_PCS_ScreenCoordY "Screen touched in ER coordinate Y";
CM_ SG_ 163 ACU_PCS_ScreenCoordX "Screen touched in ER coordinate X";
CM_ SG_ 163 ACU_APAMessageSt "The State of APA Message";
CM_ SG_ 163 ACU_PAS_ButtonPress "PAS button press state";
CM_ SG_ 163 ACU_HPAMessageSt "The State of HPA Message";
CM_ SG_ 163 ACU_AVPMessageSt "The State of AVP Message";
CM_ SG_ 163 ACU_HPALearningSetParkLot "User set HAVP parkLot type";
CM_ SG_ 163 ACU_HPALearningProcessInfo "AVP controller will send this singnal to show indications through HU to driver during learning process";
CM_ SG_ 163 ACU_SDEnterParkingLot "The vehicle enter parking lot";
CM_ SG_ 163 ACU_PCS_ER_QuitConfirm "Event record quit confirm ";
CM_ SG_ 163 ACU_ER_FuncCfg "Event record funtion configuration";
CM_ SG_ 163 ACU_PCS_ER_EnterCmd "Event record enter command";
CM_ SG_ 163 ACU_PCS_ScreenTouchSignal "ACU screen touch status";
CM_ SG_ 163 ACU_DPMessageSt "The State of DP Message";
CM_ SG_ 163 ACU_ParkingBoxMidX "X coordinate pixel value of  parking space frame handle";
CM_ SG_ 163 ACU_ParkingBoxMidY "Y coordinate pixel value of  parking space frame handle";
CM_ SG_ 163 ACU_LowPowerConfig "ACU_LowPowerMode Config";
CM_ SG_ 163 ACU_PCSModeSt "The mode of the host request panorama display";
CM_ SG_ 163 ACU_PCSModeSt_A "The mode of the host request panorama display";
CM_ SG_ 163 ACU_ParkingBoxAngle "Angle of parking space frame";
CM_ SG_ 163 IDC_APAParkingSpdsSfg "APA Parking speed configuration";
CM_ SG_ 163 IDC_DskScreenOperationSt "Screen Touch status";
CM_ SG_ 163 IDC_SenslesEtyParkingSwSt "Senseless entry parking switch";
CM_ SG_ 163 ACU_NDAVoicePromptTypeCfg "NDA Voice mode switch";
CM_ SG_ 163 IDC_SenslesEtyParkingDskScene "Senseless entry parking desktop  scene";
CM_ SG_ 163 ACU_VR_APAControl "Parking voice wake up";
CM_ SG_ 163 ACU_SteeringPrkgButton "ACU_SteeringPrkgButton";
CM_ SG_ 163 ACU_ActiveNDAMessageSt "“recommend switch to NDA” card state";
CM_ SG_ 163 ACU_ActiveAVPMessageSt "\"recommend switch to AVP\" card state";
CM_ SG_ 163 ACU_LeftLaneChangeMessageSt "\"recommed LeftLane Change\" card state";
CM_ SG_ 163 ACU_RigthLaneChangeMessageSt "\"recommed RighLane Change\" card state";
CM_ SG_ 163 ACU_ICANDAIconMessageSt "driver click ICON button state";
CM_ SG_ 163 ACU_SVM_Button_A "SVM button press status";
CM_ SG_ 618 EPB_1_CRC "E2E Profile 5 CRC";
CM_ SG_ 618 EPB_1_Counter "E2E Profile 5 Counter";
CM_ SG_ 618 EPB_SwitchSt "EPB switch status ";
CM_ SG_ 618 EPB_SwitchStVD "EPB switch status validity";
CM_ SG_ 618 EPB_SysSt "EPB system status";
CM_ SG_ 618 EPB_FailSt "EPB fail status,to indicate wether EPB can response to external apply  request or not";
CM_ SG_ 618 EPB_ExtAvailable "EPB  status,to indicate wetherEPB can response to externalapply request or not";
CM_ SG_ 618 EPB_DynamicApplySt "EPB dynamic apply status";
CM_ SG_ 618 EPB_ActuatorSt_R "EPB right  actuator status";
CM_ SG_ 618 EPB_RWUActvSts "It indicates whether the RWU  of the ESP/IPB is active";
CM_ SG_ 618 EPB_RWUAvl "It indicates whether the RWU  of the EPB  is available";
CM_ SG_ 618 EPB_RPAAVPAvailability "Flag indicate  RPA AVP availability for EPB control";
CM_ SG_ 618 EPB_APAAvailability "Flag indicate  APA availability for EPB control";

BA_DEF_ BO_  "GenMsgCycleTime" INT 0 0;
BA_DEF_ BO_  "GenMsgCycleTimeFast" INT 0 0;
BA_DEF_ BO_  "GenMsgSendType" ENUM  "Periodic","Event","IfActive","POE","PA","FixedPeriodic","Event","EnabledPeriodic","NotUsed","NotUsed","EventPeriodic","NotUsed","NotUsed","NoMsgSendType";
BA_DEF_ BO_  "VFrameFormat" ENUM  "StandardCAN","ExtendedCAN","reserved","reserved","reserved","reserved","reserved","reserved","reserved","reserved","reserved","reserved","reserved","reserved","StandardCAN_FD","ExtendedCAN_FD";
BA_DEF_ BO_  "CANFD_BRS" ENUM  "0","1";
BA_DEF_ SG_  "EventCommandSignal" ENUM  "No","Yes";
BA_DEF_ SG_  "GatewayedSignals" ENUM  "No","Yes";
BA_DEF_ SG_  "GenSigInactiveValue" HEX 0 0;
BA_DEF_ SG_  "GenSigInvalidValue" HEX 0 0;
BA_DEF_ SG_  "GenSigSendType" ENUM  "Trigger","Passive","Cyclic","OnWrite","OnWriteWithRepetition","OnChange","OnChangeWithRepetition","IfActive","IfActiveWithRepetition","NoSigSendType";
BA_DEF_ SG_  "GenSigStartValue" HEX 0 0;
BA_DEF_ SG_  "GenSigTimeoutValue" HEX 0 0;
BA_DEF_ SG_  "Remark" STRING ;
BA_ "GenMsgCycleTime" BO_ 400 20;
BA_ "GenMsgCycleTimeFast" BO_ 400 0;
BA_ "GenMsgSendType" BO_ 400 0;
BA_ "VFrameFormat" BO_ 400 14;
BA_ "CANFD_BRS" BO_ 400 1;
BA_ "GenMsgCycleTime" BO_ 400 20;
BA_ "GenMsgCycleTimeFast" BO_ 400 0;
BA_ "GenMsgSendType" BO_ 400 0;
BA_ "VFrameFormat" BO_ 400 14;
BA_ "CANFD_BRS" BO_ 400 1;
BA_ "GenMsgCycleTime" BO_ 400 20;
BA_ "GenMsgCycleTimeFast" BO_ 400 0;
BA_ "GenMsgSendType" BO_ 400 0;
BA_ "VFrameFormat" BO_ 400 14;
BA_ "CANFD_BRS" BO_ 400 1;
BA_ "GenMsgCycleTime" BO_ 400 20;
BA_ "GenMsgCycleTimeFast" BO_ 400 0;
BA_ "GenMsgSendType" BO_ 400 0;
BA_ "VFrameFormat" BO_ 400 14;
BA_ "CANFD_BRS" BO_ 400 1;
BA_ "GenMsgCycleTime" BO_ 400 20;
BA_ "GenMsgCycleTimeFast" BO_ 400 0;
BA_ "GenMsgSendType" BO_ 400 0;
BA_ "VFrameFormat" BO_ 400 14;
BA_ "CANFD_BRS" BO_ 400 1;
BA_ "GenMsgCycleTime" BO_ 400 20;
BA_ "GenMsgCycleTimeFast" BO_ 400 0;
BA_ "GenMsgSendType" BO_ 400 0;
BA_ "VFrameFormat" BO_ 400 14;
BA_ "CANFD_BRS" BO_ 400 1;
BA_ "GenMsgCycleTime" BO_ 400 20;
BA_ "GenMsgCycleTimeFast" BO_ 400 0;
BA_ "GenMsgSendType" BO_ 400 0;
BA_ "VFrameFormat" BO_ 400 14;
BA_ "CANFD_BRS" BO_ 400 1;
BA_ "GenMsgCycleTime" BO_ 400 20;
BA_ "GenMsgCycleTimeFast" BO_ 400 0;
BA_ "GenMsgSendType" BO_ 400 0;
BA_ "VFrameFormat" BO_ 400 14;
BA_ "CANFD_BRS" BO_ 400 1;
BA_ "GenMsgCycleTime" BO_ 400 20;
BA_ "GenMsgCycleTimeFast" BO_ 400 0;
BA_ "GenMsgSendType" BO_ 400 0;
BA_ "VFrameFormat" BO_ 400 14;
BA_ "CANFD_BRS" BO_ 400 1;
BA_ "GenMsgCycleTime" BO_ 400 20;
BA_ "GenMsgCycleTimeFast" BO_ 400 0;
BA_ "GenMsgSendType" BO_ 400 0;
BA_ "VFrameFormat" BO_ 400 14;
BA_ "CANFD_BRS" BO_ 400 1;
BA_ "GenMsgCycleTime" BO_ 400 20;
BA_ "GenMsgCycleTimeFast" BO_ 400 0;
BA_ "GenMsgSendType" BO_ 400 0;
BA_ "VFrameFormat" BO_ 400 14;
BA_ "CANFD_BRS" BO_ 400 1;
BA_ "GenMsgCycleTime" BO_ 400 20;
BA_ "GenMsgCycleTimeFast" BO_ 400 0;
BA_ "GenMsgSendType" BO_ 400 0;
BA_ "VFrameFormat" BO_ 400 14;
BA_ "CANFD_BRS" BO_ 400 1;
BA_ "GenMsgCycleTime" BO_ 400 20;
BA_ "GenMsgCycleTimeFast" BO_ 400 0;
BA_ "GenMsgSendType" BO_ 400 0;
BA_ "VFrameFormat" BO_ 400 14;
BA_ "CANFD_BRS" BO_ 400 1;
BA_ "GenMsgCycleTime" BO_ 400 20;
BA_ "GenMsgCycleTimeFast" BO_ 400 0;
BA_ "GenMsgSendType" BO_ 400 0;
BA_ "VFrameFormat" BO_ 400 14;
BA_ "CANFD_BRS" BO_ 400 1;
BA_ "GenMsgCycleTime" BO_ 400 20;
BA_ "GenMsgCycleTimeFast" BO_ 400 0;
BA_ "GenMsgSendType" BO_ 400 0;
BA_ "VFrameFormat" BO_ 400 14;
BA_ "CANFD_BRS" BO_ 400 1;
BA_ "GenMsgCycleTime" BO_ 400 20;
BA_ "GenMsgCycleTimeFast" BO_ 400 0;
BA_ "GenMsgSendType" BO_ 400 0;
BA_ "VFrameFormat" BO_ 400 14;
BA_ "CANFD_BRS" BO_ 400 1;
BA_ "GenMsgCycleTime" BO_ 400 20;
BA_ "GenMsgCycleTimeFast" BO_ 400 0;
BA_ "GenMsgSendType" BO_ 400 0;
BA_ "VFrameFormat" BO_ 400 14;
BA_ "CANFD_BRS" BO_ 400 1;
BA_ "GenMsgCycleTime" BO_ 400 20;
BA_ "GenMsgCycleTimeFast" BO_ 400 0;
BA_ "GenMsgSendType" BO_ 400 0;
BA_ "VFrameFormat" BO_ 400 14;
BA_ "CANFD_BRS" BO_ 400 1;
BA_ "GenMsgCycleTime" BO_ 400 20;
BA_ "GenMsgCycleTimeFast" BO_ 400 0;
BA_ "GenMsgSendType" BO_ 400 0;
BA_ "VFrameFormat" BO_ 400 14;
BA_ "CANFD_BRS" BO_ 400 1;
BA_ "GenMsgCycleTime" BO_ 400 20;
BA_ "GenMsgCycleTimeFast" BO_ 400 0;
BA_ "GenMsgSendType" BO_ 400 0;
BA_ "VFrameFormat" BO_ 400 14;
BA_ "CANFD_BRS" BO_ 400 1;
BA_ "GenMsgCycleTime" BO_ 616 20;
BA_ "GenMsgCycleTimeFast" BO_ 616 0;
BA_ "GenMsgSendType" BO_ 616 0;
BA_ "VFrameFormat" BO_ 616 14;
BA_ "CANFD_BRS" BO_ 616 1;
BA_ "GenMsgCycleTime" BO_ 616 20;
BA_ "GenMsgCycleTimeFast" BO_ 616 0;
BA_ "GenMsgSendType" BO_ 616 0;
BA_ "VFrameFormat" BO_ 616 14;
BA_ "CANFD_BRS" BO_ 616 1;
BA_ "GenMsgCycleTime" BO_ 616 20;
BA_ "GenMsgCycleTimeFast" BO_ 616 0;
BA_ "GenMsgSendType" BO_ 616 0;
BA_ "VFrameFormat" BO_ 616 14;
BA_ "CANFD_BRS" BO_ 616 1;
BA_ "GenMsgCycleTime" BO_ 616 20;
BA_ "GenMsgCycleTimeFast" BO_ 616 0;
BA_ "GenMsgSendType" BO_ 616 0;
BA_ "VFrameFormat" BO_ 616 14;
BA_ "CANFD_BRS" BO_ 616 1;
BA_ "GenMsgCycleTime" BO_ 616 20;
BA_ "GenMsgCycleTimeFast" BO_ 616 0;
BA_ "GenMsgSendType" BO_ 616 0;
BA_ "VFrameFormat" BO_ 616 14;
BA_ "CANFD_BRS" BO_ 616 1;
BA_ "GenMsgCycleTime" BO_ 616 20;
BA_ "GenMsgCycleTimeFast" BO_ 616 0;
BA_ "GenMsgSendType" BO_ 616 0;
BA_ "VFrameFormat" BO_ 616 14;
BA_ "CANFD_BRS" BO_ 616 1;
BA_ "GenMsgCycleTime" BO_ 616 20;
BA_ "GenMsgCycleTimeFast" BO_ 616 0;
BA_ "GenMsgSendType" BO_ 616 0;
BA_ "VFrameFormat" BO_ 616 14;
BA_ "CANFD_BRS" BO_ 616 1;
BA_ "GenMsgCycleTime" BO_ 616 20;
BA_ "GenMsgCycleTimeFast" BO_ 616 0;
BA_ "GenMsgSendType" BO_ 616 0;
BA_ "VFrameFormat" BO_ 616 14;
BA_ "CANFD_BRS" BO_ 616 1;
BA_ "GenMsgCycleTime" BO_ 616 20;
BA_ "GenMsgCycleTimeFast" BO_ 616 0;
BA_ "GenMsgSendType" BO_ 616 0;
BA_ "VFrameFormat" BO_ 616 14;
BA_ "CANFD_BRS" BO_ 616 1;
BA_ "GenMsgCycleTime" BO_ 616 20;
BA_ "GenMsgCycleTimeFast" BO_ 616 0;
BA_ "GenMsgSendType" BO_ 616 0;
BA_ "VFrameFormat" BO_ 616 14;
BA_ "CANFD_BRS" BO_ 616 1;
BA_ "GenMsgCycleTime" BO_ 616 20;
BA_ "GenMsgCycleTimeFast" BO_ 616 0;
BA_ "GenMsgSendType" BO_ 616 0;
BA_ "VFrameFormat" BO_ 616 14;
BA_ "CANFD_BRS" BO_ 616 1;
BA_ "GenMsgCycleTime" BO_ 616 20;
BA_ "GenMsgCycleTimeFast" BO_ 616 0;
BA_ "GenMsgSendType" BO_ 616 0;
BA_ "VFrameFormat" BO_ 616 14;
BA_ "CANFD_BRS" BO_ 616 1;
BA_ "GenMsgCycleTime" BO_ 616 20;
BA_ "GenMsgCycleTimeFast" BO_ 616 0;
BA_ "GenMsgSendType" BO_ 616 0;
BA_ "VFrameFormat" BO_ 616 14;
BA_ "CANFD_BRS" BO_ 616 1;
BA_ "GenMsgCycleTime" BO_ 616 20;
BA_ "GenMsgCycleTimeFast" BO_ 616 0;
BA_ "GenMsgSendType" BO_ 616 0;
BA_ "VFrameFormat" BO_ 616 14;
BA_ "CANFD_BRS" BO_ 616 1;
BA_ "GenMsgCycleTime" BO_ 616 20;
BA_ "GenMsgCycleTimeFast" BO_ 616 0;
BA_ "GenMsgSendType" BO_ 616 0;
BA_ "VFrameFormat" BO_ 616 14;
BA_ "CANFD_BRS" BO_ 616 1;
BA_ "GenMsgCycleTime" BO_ 616 20;
BA_ "GenMsgCycleTimeFast" BO_ 616 0;
BA_ "GenMsgSendType" BO_ 616 0;
BA_ "VFrameFormat" BO_ 616 14;
BA_ "CANFD_BRS" BO_ 616 1;
BA_ "GenMsgCycleTime" BO_ 616 20;
BA_ "GenMsgCycleTimeFast" BO_ 616 0;
BA_ "GenMsgSendType" BO_ 616 0;
BA_ "VFrameFormat" BO_ 616 14;
BA_ "CANFD_BRS" BO_ 616 1;
BA_ "GenMsgCycleTime" BO_ 616 20;
BA_ "GenMsgCycleTimeFast" BO_ 616 0;
BA_ "GenMsgSendType" BO_ 616 0;
BA_ "VFrameFormat" BO_ 616 14;
BA_ "CANFD_BRS" BO_ 616 1;
BA_ "GenMsgCycleTime" BO_ 616 20;
BA_ "GenMsgCycleTimeFast" BO_ 616 0;
BA_ "GenMsgSendType" BO_ 616 0;
BA_ "VFrameFormat" BO_ 616 14;
BA_ "CANFD_BRS" BO_ 616 1;
BA_ "GenMsgCycleTime" BO_ 616 20;
BA_ "GenMsgCycleTimeFast" BO_ 616 0;
BA_ "GenMsgSendType" BO_ 616 0;
BA_ "VFrameFormat" BO_ 616 14;
BA_ "CANFD_BRS" BO_ 616 1;
BA_ "GenMsgCycleTime" BO_ 825 100;
BA_ "GenMsgCycleTimeFast" BO_ 825 0;
BA_ "GenMsgSendType" BO_ 825 0;
BA_ "VFrameFormat" BO_ 825 14;
BA_ "CANFD_BRS" BO_ 825 1;
BA_ "GenMsgCycleTime" BO_ 825 100;
BA_ "GenMsgCycleTimeFast" BO_ 825 0;
BA_ "GenMsgSendType" BO_ 825 0;
BA_ "VFrameFormat" BO_ 825 14;
BA_ "CANFD_BRS" BO_ 825 1;
BA_ "GenMsgCycleTime" BO_ 825 100;
BA_ "GenMsgCycleTimeFast" BO_ 825 0;
BA_ "GenMsgSendType" BO_ 825 0;
BA_ "VFrameFormat" BO_ 825 14;
BA_ "CANFD_BRS" BO_ 825 1;
BA_ "GenMsgCycleTime" BO_ 825 100;
BA_ "GenMsgCycleTimeFast" BO_ 825 0;
BA_ "GenMsgSendType" BO_ 825 0;
BA_ "VFrameFormat" BO_ 825 14;
BA_ "CANFD_BRS" BO_ 825 1;
BA_ "GenMsgCycleTime" BO_ 825 100;
BA_ "GenMsgCycleTimeFast" BO_ 825 0;
BA_ "GenMsgSendType" BO_ 825 0;
BA_ "VFrameFormat" BO_ 825 14;
BA_ "CANFD_BRS" BO_ 825 1;
BA_ "GenMsgCycleTime" BO_ 825 100;
BA_ "GenMsgCycleTimeFast" BO_ 825 0;
BA_ "GenMsgSendType" BO_ 825 0;
BA_ "VFrameFormat" BO_ 825 14;
BA_ "CANFD_BRS" BO_ 825 1;
BA_ "GenMsgCycleTime" BO_ 825 100;
BA_ "GenMsgCycleTimeFast" BO_ 825 0;
BA_ "GenMsgSendType" BO_ 825 0;
BA_ "VFrameFormat" BO_ 825 14;
BA_ "CANFD_BRS" BO_ 825 1;
BA_ "GenMsgCycleTime" BO_ 825 100;
BA_ "GenMsgCycleTimeFast" BO_ 825 0;
BA_ "GenMsgSendType" BO_ 825 0;
BA_ "VFrameFormat" BO_ 825 14;
BA_ "CANFD_BRS" BO_ 825 1;
BA_ "GenMsgCycleTime" BO_ 825 100;
BA_ "GenMsgCycleTimeFast" BO_ 825 0;
BA_ "GenMsgSendType" BO_ 825 0;
BA_ "VFrameFormat" BO_ 825 14;
BA_ "CANFD_BRS" BO_ 825 1;
BA_ "GenMsgCycleTime" BO_ 825 100;
BA_ "GenMsgCycleTimeFast" BO_ 825 0;
BA_ "GenMsgSendType" BO_ 825 0;
BA_ "VFrameFormat" BO_ 825 14;
BA_ "CANFD_BRS" BO_ 825 1;
BA_ "GenMsgCycleTime" BO_ 825 100;
BA_ "GenMsgCycleTimeFast" BO_ 825 0;
BA_ "GenMsgSendType" BO_ 825 0;
BA_ "VFrameFormat" BO_ 825 14;
BA_ "CANFD_BRS" BO_ 825 1;
BA_ "GenMsgCycleTime" BO_ 825 100;
BA_ "GenMsgCycleTimeFast" BO_ 825 0;
BA_ "GenMsgSendType" BO_ 825 0;
BA_ "VFrameFormat" BO_ 825 14;
BA_ "CANFD_BRS" BO_ 825 1;
BA_ "GenMsgCycleTime" BO_ 825 100;
BA_ "GenMsgCycleTimeFast" BO_ 825 0;
BA_ "GenMsgSendType" BO_ 825 0;
BA_ "VFrameFormat" BO_ 825 14;
BA_ "CANFD_BRS" BO_ 825 1;
BA_ "GenMsgCycleTime" BO_ 825 100;
BA_ "GenMsgCycleTimeFast" BO_ 825 0;
BA_ "GenMsgSendType" BO_ 825 0;
BA_ "VFrameFormat" BO_ 825 14;
BA_ "CANFD_BRS" BO_ 825 1;
BA_ "GenMsgCycleTime" BO_ 825 100;
BA_ "GenMsgCycleTimeFast" BO_ 825 0;
BA_ "GenMsgSendType" BO_ 825 0;
BA_ "VFrameFormat" BO_ 825 14;
BA_ "CANFD_BRS" BO_ 825 1;
BA_ "GenMsgCycleTime" BO_ 825 100;
BA_ "GenMsgCycleTimeFast" BO_ 825 0;
BA_ "GenMsgSendType" BO_ 825 0;
BA_ "VFrameFormat" BO_ 825 14;
BA_ "CANFD_BRS" BO_ 825 1;
BA_ "GenMsgCycleTime" BO_ 825 100;
BA_ "GenMsgCycleTimeFast" BO_ 825 0;
BA_ "GenMsgSendType" BO_ 825 0;
BA_ "VFrameFormat" BO_ 825 14;
BA_ "CANFD_BRS" BO_ 825 1;
BA_ "GenMsgCycleTime" BO_ 825 100;
BA_ "GenMsgCycleTimeFast" BO_ 825 0;
BA_ "GenMsgSendType" BO_ 825 0;
BA_ "VFrameFormat" BO_ 825 14;
BA_ "CANFD_BRS" BO_ 825 1;
BA_ "GenMsgCycleTime" BO_ 825 100;
BA_ "GenMsgCycleTimeFast" BO_ 825 0;
BA_ "GenMsgSendType" BO_ 825 0;
BA_ "VFrameFormat" BO_ 825 14;
BA_ "CANFD_BRS" BO_ 825 1;
BA_ "GenMsgCycleTime" BO_ 825 100;
BA_ "GenMsgCycleTimeFast" BO_ 825 0;
BA_ "GenMsgSendType" BO_ 825 0;
BA_ "VFrameFormat" BO_ 825 14;
BA_ "CANFD_BRS" BO_ 825 1;
BA_ "GenMsgCycleTime" BO_ 825 100;
BA_ "GenMsgCycleTimeFast" BO_ 825 0;
BA_ "GenMsgSendType" BO_ 825 0;
BA_ "VFrameFormat" BO_ 825 14;
BA_ "CANFD_BRS" BO_ 825 1;
BA_ "GenMsgCycleTime" BO_ 825 100;
BA_ "GenMsgCycleTimeFast" BO_ 825 0;
BA_ "GenMsgSendType" BO_ 825 0;
BA_ "VFrameFormat" BO_ 825 14;
BA_ "CANFD_BRS" BO_ 825 1;
BA_ "GenMsgCycleTime" BO_ 291 40;
BA_ "GenMsgCycleTimeFast" BO_ 291 0;
BA_ "GenMsgSendType" BO_ 291 0;
BA_ "VFrameFormat" BO_ 291 14;
BA_ "CANFD_BRS" BO_ 291 1;
BA_ "GenMsgCycleTime" BO_ 291 40;
BA_ "GenMsgCycleTimeFast" BO_ 291 0;
BA_ "GenMsgSendType" BO_ 291 0;
BA_ "VFrameFormat" BO_ 291 14;
BA_ "CANFD_BRS" BO_ 291 1;
BA_ "GenMsgCycleTime" BO_ 291 40;
BA_ "GenMsgCycleTimeFast" BO_ 291 0;
BA_ "GenMsgSendType" BO_ 291 0;
BA_ "VFrameFormat" BO_ 291 14;
BA_ "CANFD_BRS" BO_ 291 1;
BA_ "GenMsgCycleTime" BO_ 291 40;
BA_ "GenMsgCycleTimeFast" BO_ 291 0;
BA_ "GenMsgSendType" BO_ 291 0;
BA_ "VFrameFormat" BO_ 291 14;
BA_ "CANFD_BRS" BO_ 291 1;
BA_ "GenMsgCycleTime" BO_ 291 40;
BA_ "GenMsgCycleTimeFast" BO_ 291 0;
BA_ "GenMsgSendType" BO_ 291 0;
BA_ "VFrameFormat" BO_ 291 14;
BA_ "CANFD_BRS" BO_ 291 1;
BA_ "GenMsgCycleTime" BO_ 291 40;
BA_ "GenMsgCycleTimeFast" BO_ 291 0;
BA_ "GenMsgSendType" BO_ 291 0;
BA_ "VFrameFormat" BO_ 291 14;
BA_ "CANFD_BRS" BO_ 291 1;
BA_ "GenMsgCycleTime" BO_ 291 40;
BA_ "GenMsgCycleTimeFast" BO_ 291 0;
BA_ "GenMsgSendType" BO_ 291 0;
BA_ "VFrameFormat" BO_ 291 14;
BA_ "CANFD_BRS" BO_ 291 1;
BA_ "GenMsgCycleTime" BO_ 291 40;
BA_ "GenMsgCycleTimeFast" BO_ 291 0;
BA_ "GenMsgSendType" BO_ 291 0;
BA_ "VFrameFormat" BO_ 291 14;
BA_ "CANFD_BRS" BO_ 291 1;
BA_ "GenMsgCycleTime" BO_ 291 40;
BA_ "GenMsgCycleTimeFast" BO_ 291 0;
BA_ "GenMsgSendType" BO_ 291 0;
BA_ "VFrameFormat" BO_ 291 14;
BA_ "CANFD_BRS" BO_ 291 1;
BA_ "GenMsgCycleTime" BO_ 291 40;
BA_ "GenMsgCycleTimeFast" BO_ 291 0;
BA_ "GenMsgSendType" BO_ 291 0;
BA_ "VFrameFormat" BO_ 291 14;
BA_ "CANFD_BRS" BO_ 291 1;
BA_ "GenMsgCycleTime" BO_ 291 40;
BA_ "GenMsgCycleTimeFast" BO_ 291 0;
BA_ "GenMsgSendType" BO_ 291 0;
BA_ "VFrameFormat" BO_ 291 14;
BA_ "CANFD_BRS" BO_ 291 1;
BA_ "GenMsgCycleTime" BO_ 291 40;
BA_ "GenMsgCycleTimeFast" BO_ 291 0;
BA_ "GenMsgSendType" BO_ 291 0;
BA_ "VFrameFormat" BO_ 291 14;
BA_ "CANFD_BRS" BO_ 291 1;
BA_ "GenMsgCycleTime" BO_ 291 40;
BA_ "GenMsgCycleTimeFast" BO_ 291 0;
BA_ "GenMsgSendType" BO_ 291 0;
BA_ "VFrameFormat" BO_ 291 14;
BA_ "CANFD_BRS" BO_ 291 1;
BA_ "GenMsgCycleTime" BO_ 291 40;
BA_ "GenMsgCycleTimeFast" BO_ 291 0;
BA_ "GenMsgSendType" BO_ 291 0;
BA_ "VFrameFormat" BO_ 291 14;
BA_ "CANFD_BRS" BO_ 291 1;
BA_ "GenMsgCycleTime" BO_ 865 40;
BA_ "GenMsgCycleTimeFast" BO_ 865 0;
BA_ "GenMsgSendType" BO_ 865 0;
BA_ "VFrameFormat" BO_ 865 14;
BA_ "CANFD_BRS" BO_ 865 1;
BA_ "GenMsgCycleTime" BO_ 865 40;
BA_ "GenMsgCycleTimeFast" BO_ 865 0;
BA_ "GenMsgSendType" BO_ 865 0;
BA_ "VFrameFormat" BO_ 865 14;
BA_ "CANFD_BRS" BO_ 865 1;
BA_ "GenMsgCycleTime" BO_ 865 40;
BA_ "GenMsgCycleTimeFast" BO_ 865 0;
BA_ "GenMsgSendType" BO_ 865 0;
BA_ "VFrameFormat" BO_ 865 14;
BA_ "CANFD_BRS" BO_ 865 1;
BA_ "GenMsgCycleTime" BO_ 865 40;
BA_ "GenMsgCycleTimeFast" BO_ 865 0;
BA_ "GenMsgSendType" BO_ 865 0;
BA_ "VFrameFormat" BO_ 865 14;
BA_ "CANFD_BRS" BO_ 865 1;
BA_ "GenMsgCycleTime" BO_ 865 40;
BA_ "GenMsgCycleTimeFast" BO_ 865 0;
BA_ "GenMsgSendType" BO_ 865 0;
BA_ "VFrameFormat" BO_ 865 14;
BA_ "CANFD_BRS" BO_ 865 1;
BA_ "GenMsgCycleTime" BO_ 865 40;
BA_ "GenMsgCycleTimeFast" BO_ 865 0;
BA_ "GenMsgSendType" BO_ 865 0;
BA_ "VFrameFormat" BO_ 865 14;
BA_ "CANFD_BRS" BO_ 865 1;
BA_ "GenMsgCycleTime" BO_ 865 40;
BA_ "GenMsgCycleTimeFast" BO_ 865 0;
BA_ "GenMsgSendType" BO_ 865 0;
BA_ "VFrameFormat" BO_ 865 14;
BA_ "CANFD_BRS" BO_ 865 1;
BA_ "GenMsgCycleTime" BO_ 865 40;
BA_ "GenMsgCycleTimeFast" BO_ 865 0;
BA_ "GenMsgSendType" BO_ 865 0;
BA_ "VFrameFormat" BO_ 865 14;
BA_ "CANFD_BRS" BO_ 865 1;
BA_ "GenMsgCycleTime" BO_ 865 40;
BA_ "GenMsgCycleTimeFast" BO_ 865 0;
BA_ "GenMsgSendType" BO_ 865 0;
BA_ "VFrameFormat" BO_ 865 14;
BA_ "CANFD_BRS" BO_ 865 1;
BA_ "GenMsgCycleTime" BO_ 865 40;
BA_ "GenMsgCycleTimeFast" BO_ 865 0;
BA_ "GenMsgSendType" BO_ 865 0;
BA_ "VFrameFormat" BO_ 865 14;
BA_ "CANFD_BRS" BO_ 865 1;
BA_ "GenMsgCycleTime" BO_ 865 40;
BA_ "GenMsgCycleTimeFast" BO_ 865 0;
BA_ "GenMsgSendType" BO_ 865 0;
BA_ "VFrameFormat" BO_ 865 14;
BA_ "CANFD_BRS" BO_ 865 1;
BA_ "GenMsgCycleTime" BO_ 865 40;
BA_ "GenMsgCycleTimeFast" BO_ 865 0;
BA_ "GenMsgSendType" BO_ 865 0;
BA_ "VFrameFormat" BO_ 865 14;
BA_ "CANFD_BRS" BO_ 865 1;
BA_ "GenMsgCycleTime" BO_ 865 40;
BA_ "GenMsgCycleTimeFast" BO_ 865 0;
BA_ "GenMsgSendType" BO_ 865 0;
BA_ "VFrameFormat" BO_ 865 14;
BA_ "CANFD_BRS" BO_ 865 1;
BA_ "GenMsgCycleTime" BO_ 865 40;
BA_ "GenMsgCycleTimeFast" BO_ 865 0;
BA_ "GenMsgSendType" BO_ 865 0;
BA_ "VFrameFormat" BO_ 865 14;
BA_ "CANFD_BRS" BO_ 865 1;
BA_ "GenMsgCycleTime" BO_ 865 40;
BA_ "GenMsgCycleTimeFast" BO_ 865 0;
BA_ "GenMsgSendType" BO_ 865 0;
BA_ "VFrameFormat" BO_ 865 14;
BA_ "CANFD_BRS" BO_ 865 1;
BA_ "GenMsgCycleTime" BO_ 865 40;
BA_ "GenMsgCycleTimeFast" BO_ 865 0;
BA_ "GenMsgSendType" BO_ 865 0;
BA_ "VFrameFormat" BO_ 865 14;
BA_ "CANFD_BRS" BO_ 865 1;
BA_ "GenMsgCycleTime" BO_ 865 40;
BA_ "GenMsgCycleTimeFast" BO_ 865 0;
BA_ "GenMsgSendType" BO_ 865 0;
BA_ "VFrameFormat" BO_ 865 14;
BA_ "CANFD_BRS" BO_ 865 1;
BA_ "GenMsgCycleTime" BO_ 865 40;
BA_ "GenMsgCycleTimeFast" BO_ 865 0;
BA_ "GenMsgSendType" BO_ 865 0;
BA_ "VFrameFormat" BO_ 865 14;
BA_ "CANFD_BRS" BO_ 865 1;
BA_ "GenMsgCycleTime" BO_ 865 40;
BA_ "GenMsgCycleTimeFast" BO_ 865 0;
BA_ "GenMsgSendType" BO_ 865 0;
BA_ "VFrameFormat" BO_ 865 14;
BA_ "CANFD_BRS" BO_ 865 1;
BA_ "GenMsgCycleTime" BO_ 865 40;
BA_ "GenMsgCycleTimeFast" BO_ 865 0;
BA_ "GenMsgSendType" BO_ 865 0;
BA_ "VFrameFormat" BO_ 865 14;
BA_ "CANFD_BRS" BO_ 865 1;
BA_ "GenMsgCycleTime" BO_ 865 40;
BA_ "GenMsgCycleTimeFast" BO_ 865 0;
BA_ "GenMsgSendType" BO_ 865 0;
BA_ "VFrameFormat" BO_ 865 14;
BA_ "CANFD_BRS" BO_ 865 1;
BA_ "GenMsgCycleTime" BO_ 865 40;
BA_ "GenMsgCycleTimeFast" BO_ 865 0;
BA_ "GenMsgSendType" BO_ 865 0;
BA_ "VFrameFormat" BO_ 865 14;
BA_ "CANFD_BRS" BO_ 865 1;
BA_ "GenMsgCycleTime" BO_ 865 40;
BA_ "GenMsgCycleTimeFast" BO_ 865 0;
BA_ "GenMsgSendType" BO_ 865 0;
BA_ "VFrameFormat" BO_ 865 14;
BA_ "CANFD_BRS" BO_ 865 1;
BA_ "GenMsgCycleTime" BO_ 865 40;
BA_ "GenMsgCycleTimeFast" BO_ 865 0;
BA_ "GenMsgSendType" BO_ 865 0;
BA_ "VFrameFormat" BO_ 865 14;
BA_ "CANFD_BRS" BO_ 865 1;
BA_ "GenMsgCycleTime" BO_ 865 40;
BA_ "GenMsgCycleTimeFast" BO_ 865 0;
BA_ "GenMsgSendType" BO_ 865 0;
BA_ "VFrameFormat" BO_ 865 14;
BA_ "CANFD_BRS" BO_ 865 1;
BA_ "GenMsgCycleTime" BO_ 865 40;
BA_ "GenMsgCycleTimeFast" BO_ 865 0;
BA_ "GenMsgSendType" BO_ 865 0;
BA_ "VFrameFormat" BO_ 865 14;
BA_ "CANFD_BRS" BO_ 865 1;
BA_ "GenMsgCycleTime" BO_ 865 40;
BA_ "GenMsgCycleTimeFast" BO_ 865 0;
BA_ "GenMsgSendType" BO_ 865 0;
BA_ "VFrameFormat" BO_ 865 14;
BA_ "CANFD_BRS" BO_ 865 1;
BA_ "GenMsgCycleTime" BO_ 865 40;
BA_ "GenMsgCycleTimeFast" BO_ 865 0;
BA_ "GenMsgSendType" BO_ 865 0;
BA_ "VFrameFormat" BO_ 865 14;
BA_ "CANFD_BRS" BO_ 865 1;
BA_ "GenMsgCycleTime" BO_ 865 40;
BA_ "GenMsgCycleTimeFast" BO_ 865 0;
BA_ "GenMsgSendType" BO_ 865 0;
BA_ "VFrameFormat" BO_ 865 14;
BA_ "CANFD_BRS" BO_ 865 1;
BA_ "GenMsgCycleTime" BO_ 865 40;
BA_ "GenMsgCycleTimeFast" BO_ 865 0;
BA_ "GenMsgSendType" BO_ 865 0;
BA_ "VFrameFormat" BO_ 865 14;
BA_ "CANFD_BRS" BO_ 865 1;
BA_ "GenMsgCycleTime" BO_ 293 500;
BA_ "GenMsgCycleTimeFast" BO_ 293 40;
BA_ "GenMsgSendType" BO_ 293 3;
BA_ "VFrameFormat" BO_ 293 14;
BA_ "CANFD_BRS" BO_ 293 1;
BA_ "GenMsgCycleTime" BO_ 293 500;
BA_ "GenMsgCycleTimeFast" BO_ 293 40;
BA_ "GenMsgSendType" BO_ 293 3;
BA_ "VFrameFormat" BO_ 293 14;
BA_ "CANFD_BRS" BO_ 293 1;
BA_ "GenMsgCycleTime" BO_ 293 500;
BA_ "GenMsgCycleTimeFast" BO_ 293 40;
BA_ "GenMsgSendType" BO_ 293 3;
BA_ "VFrameFormat" BO_ 293 14;
BA_ "CANFD_BRS" BO_ 293 1;
BA_ "GenMsgCycleTime" BO_ 293 500;
BA_ "GenMsgCycleTimeFast" BO_ 293 40;
BA_ "GenMsgSendType" BO_ 293 3;
BA_ "VFrameFormat" BO_ 293 14;
BA_ "CANFD_BRS" BO_ 293 1;
BA_ "GenMsgCycleTime" BO_ 293 500;
BA_ "GenMsgCycleTimeFast" BO_ 293 40;
BA_ "GenMsgSendType" BO_ 293 3;
BA_ "VFrameFormat" BO_ 293 14;
BA_ "CANFD_BRS" BO_ 293 1;
BA_ "GenMsgCycleTime" BO_ 293 500;
BA_ "GenMsgCycleTimeFast" BO_ 293 40;
BA_ "GenMsgSendType" BO_ 293 3;
BA_ "VFrameFormat" BO_ 293 14;
BA_ "CANFD_BRS" BO_ 293 1;
BA_ "GenMsgCycleTime" BO_ 293 500;
BA_ "GenMsgCycleTimeFast" BO_ 293 40;
BA_ "GenMsgSendType" BO_ 293 3;
BA_ "VFrameFormat" BO_ 293 14;
BA_ "CANFD_BRS" BO_ 293 1;
BA_ "GenMsgCycleTime" BO_ 293 500;
BA_ "GenMsgCycleTimeFast" BO_ 293 40;
BA_ "GenMsgSendType" BO_ 293 3;
BA_ "VFrameFormat" BO_ 293 14;
BA_ "CANFD_BRS" BO_ 293 1;
BA_ "GenMsgCycleTime" BO_ 293 500;
BA_ "GenMsgCycleTimeFast" BO_ 293 40;
BA_ "GenMsgSendType" BO_ 293 3;
BA_ "VFrameFormat" BO_ 293 14;
BA_ "CANFD_BRS" BO_ 293 1;
BA_ "GenMsgCycleTime" BO_ 293 500;
BA_ "GenMsgCycleTimeFast" BO_ 293 40;
BA_ "GenMsgSendType" BO_ 293 3;
BA_ "VFrameFormat" BO_ 293 14;
BA_ "CANFD_BRS" BO_ 293 1;
BA_ "GenMsgCycleTime" BO_ 294 500;
BA_ "GenMsgCycleTimeFast" BO_ 294 40;
BA_ "GenMsgSendType" BO_ 294 3;
BA_ "VFrameFormat" BO_ 294 14;
BA_ "CANFD_BRS" BO_ 294 1;
BA_ "GenMsgCycleTime" BO_ 294 500;
BA_ "GenMsgCycleTimeFast" BO_ 294 40;
BA_ "GenMsgSendType" BO_ 294 3;
BA_ "VFrameFormat" BO_ 294 14;
BA_ "CANFD_BRS" BO_ 294 1;
BA_ "GenMsgCycleTime" BO_ 294 500;
BA_ "GenMsgCycleTimeFast" BO_ 294 40;
BA_ "GenMsgSendType" BO_ 294 3;
BA_ "VFrameFormat" BO_ 294 14;
BA_ "CANFD_BRS" BO_ 294 1;
BA_ "GenMsgCycleTime" BO_ 294 500;
BA_ "GenMsgCycleTimeFast" BO_ 294 40;
BA_ "GenMsgSendType" BO_ 294 3;
BA_ "VFrameFormat" BO_ 294 14;
BA_ "CANFD_BRS" BO_ 294 1;
BA_ "GenMsgCycleTime" BO_ 294 500;
BA_ "GenMsgCycleTimeFast" BO_ 294 40;
BA_ "GenMsgSendType" BO_ 294 3;
BA_ "VFrameFormat" BO_ 294 14;
BA_ "CANFD_BRS" BO_ 294 1;
BA_ "GenMsgCycleTime" BO_ 294 500;
BA_ "GenMsgCycleTimeFast" BO_ 294 40;
BA_ "GenMsgSendType" BO_ 294 3;
BA_ "VFrameFormat" BO_ 294 14;
BA_ "CANFD_BRS" BO_ 294 1;
BA_ "GenMsgCycleTime" BO_ 294 500;
BA_ "GenMsgCycleTimeFast" BO_ 294 40;
BA_ "GenMsgSendType" BO_ 294 3;
BA_ "VFrameFormat" BO_ 294 14;
BA_ "CANFD_BRS" BO_ 294 1;
BA_ "GenMsgCycleTime" BO_ 294 500;
BA_ "GenMsgCycleTimeFast" BO_ 294 40;
BA_ "GenMsgSendType" BO_ 294 3;
BA_ "VFrameFormat" BO_ 294 14;
BA_ "CANFD_BRS" BO_ 294 1;
BA_ "GenMsgCycleTime" BO_ 334 500;
BA_ "GenMsgCycleTimeFast" BO_ 334 40;
BA_ "GenMsgSendType" BO_ 334 3;
BA_ "VFrameFormat" BO_ 334 14;
BA_ "CANFD_BRS" BO_ 334 1;
BA_ "GenMsgCycleTime" BO_ 334 500;
BA_ "GenMsgCycleTimeFast" BO_ 334 40;
BA_ "GenMsgSendType" BO_ 334 3;
BA_ "VFrameFormat" BO_ 334 14;
BA_ "CANFD_BRS" BO_ 334 1;
BA_ "GenMsgCycleTime" BO_ 334 500;
BA_ "GenMsgCycleTimeFast" BO_ 334 40;
BA_ "GenMsgSendType" BO_ 334 3;
BA_ "VFrameFormat" BO_ 334 14;
BA_ "CANFD_BRS" BO_ 334 1;
BA_ "GenMsgCycleTime" BO_ 93 0;
BA_ "GenMsgCycleTimeFast" BO_ 93 0;
BA_ "GenMsgSendType" BO_ 93 1;
BA_ "VFrameFormat" BO_ 93 14;
BA_ "CANFD_BRS" BO_ 93 1;
BA_ "GenMsgCycleTime" BO_ 120 0;
BA_ "GenMsgCycleTimeFast" BO_ 120 0;
BA_ "GenMsgSendType" BO_ 120 1;
BA_ "VFrameFormat" BO_ 120 14;
BA_ "CANFD_BRS" BO_ 120 1;
BA_ "GenMsgCycleTime" BO_ 154 0;
BA_ "GenMsgCycleTimeFast" BO_ 154 0;
BA_ "GenMsgSendType" BO_ 154 1;
BA_ "VFrameFormat" BO_ 154 14;
BA_ "CANFD_BRS" BO_ 154 1;
BA_ "GenMsgCycleTime" BO_ 777 100;
BA_ "GenMsgCycleTimeFast" BO_ 777 0;
BA_ "GenMsgSendType" BO_ 777 0;
BA_ "VFrameFormat" BO_ 777 14;
BA_ "CANFD_BRS" BO_ 777 1;
BA_ "GenMsgCycleTime" BO_ 777 100;
BA_ "GenMsgCycleTimeFast" BO_ 777 0;
BA_ "GenMsgSendType" BO_ 777 0;
BA_ "VFrameFormat" BO_ 777 14;
BA_ "CANFD_BRS" BO_ 777 1;
BA_ "GenMsgCycleTime" BO_ 777 100;
BA_ "GenMsgCycleTimeFast" BO_ 777 0;
BA_ "GenMsgSendType" BO_ 777 0;
BA_ "VFrameFormat" BO_ 777 14;
BA_ "CANFD_BRS" BO_ 777 1;
BA_ "GenMsgCycleTime" BO_ 777 100;
BA_ "GenMsgCycleTimeFast" BO_ 777 0;
BA_ "GenMsgSendType" BO_ 777 0;
BA_ "VFrameFormat" BO_ 777 14;
BA_ "CANFD_BRS" BO_ 777 1;
BA_ "GenMsgCycleTime" BO_ 777 100;
BA_ "GenMsgCycleTimeFast" BO_ 777 0;
BA_ "GenMsgSendType" BO_ 777 0;
BA_ "VFrameFormat" BO_ 777 14;
BA_ "CANFD_BRS" BO_ 777 1;
BA_ "GenMsgCycleTime" BO_ 777 100;
BA_ "GenMsgCycleTimeFast" BO_ 777 0;
BA_ "GenMsgSendType" BO_ 777 0;
BA_ "VFrameFormat" BO_ 777 14;
BA_ "CANFD_BRS" BO_ 777 1;
BA_ "GenMsgCycleTime" BO_ 777 100;
BA_ "GenMsgCycleTimeFast" BO_ 777 0;
BA_ "GenMsgSendType" BO_ 777 0;
BA_ "VFrameFormat" BO_ 777 14;
BA_ "CANFD_BRS" BO_ 777 1;
BA_ "GenMsgCycleTime" BO_ 777 100;
BA_ "GenMsgCycleTimeFast" BO_ 777 0;
BA_ "GenMsgSendType" BO_ 777 0;
BA_ "VFrameFormat" BO_ 777 14;
BA_ "CANFD_BRS" BO_ 777 1;
BA_ "GenMsgCycleTime" BO_ 777 100;
BA_ "GenMsgCycleTimeFast" BO_ 777 0;
BA_ "GenMsgSendType" BO_ 777 0;
BA_ "VFrameFormat" BO_ 777 14;
BA_ "CANFD_BRS" BO_ 777 1;
BA_ "GenMsgCycleTime" BO_ 777 100;
BA_ "GenMsgCycleTimeFast" BO_ 777 0;
BA_ "GenMsgSendType" BO_ 777 0;
BA_ "VFrameFormat" BO_ 777 14;
BA_ "CANFD_BRS" BO_ 777 1;
BA_ "GenMsgCycleTime" BO_ 777 100;
BA_ "GenMsgCycleTimeFast" BO_ 777 0;
BA_ "GenMsgSendType" BO_ 777 0;
BA_ "VFrameFormat" BO_ 777 14;
BA_ "CANFD_BRS" BO_ 777 1;
BA_ "GenMsgCycleTime" BO_ 163 0;
BA_ "GenMsgCycleTimeFast" BO_ 163 0;
BA_ "GenMsgSendType" BO_ 163 1;
BA_ "VFrameFormat" BO_ 163 14;
BA_ "CANFD_BRS" BO_ 163 1;
BA_ "GenMsgCycleTime" BO_ 163 0;
BA_ "GenMsgCycleTimeFast" BO_ 163 0;
BA_ "GenMsgSendType" BO_ 163 1;
BA_ "VFrameFormat" BO_ 163 14;
BA_ "CANFD_BRS" BO_ 163 1;
BA_ "GenMsgCycleTime" BO_ 163 0;
BA_ "GenMsgCycleTimeFast" BO_ 163 0;
BA_ "GenMsgSendType" BO_ 163 1;
BA_ "VFrameFormat" BO_ 163 14;
BA_ "CANFD_BRS" BO_ 163 1;
BA_ "GenMsgCycleTime" BO_ 163 0;
BA_ "GenMsgCycleTimeFast" BO_ 163 0;
BA_ "GenMsgSendType" BO_ 163 1;
BA_ "VFrameFormat" BO_ 163 14;
BA_ "CANFD_BRS" BO_ 163 1;
BA_ "GenMsgCycleTime" BO_ 163 0;
BA_ "GenMsgCycleTimeFast" BO_ 163 0;
BA_ "GenMsgSendType" BO_ 163 1;
BA_ "VFrameFormat" BO_ 163 14;
BA_ "CANFD_BRS" BO_ 163 1;
BA_ "GenMsgCycleTime" BO_ 163 0;
BA_ "GenMsgCycleTimeFast" BO_ 163 0;
BA_ "GenMsgSendType" BO_ 163 1;
BA_ "VFrameFormat" BO_ 163 14;
BA_ "CANFD_BRS" BO_ 163 1;
BA_ "GenMsgCycleTime" BO_ 163 0;
BA_ "GenMsgCycleTimeFast" BO_ 163 0;
BA_ "GenMsgSendType" BO_ 163 1;
BA_ "VFrameFormat" BO_ 163 14;
BA_ "CANFD_BRS" BO_ 163 1;
BA_ "GenMsgCycleTime" BO_ 163 0;
BA_ "GenMsgCycleTimeFast" BO_ 163 0;
BA_ "GenMsgSendType" BO_ 163 1;
BA_ "VFrameFormat" BO_ 163 14;
BA_ "CANFD_BRS" BO_ 163 1;
BA_ "GenMsgCycleTime" BO_ 163 0;
BA_ "GenMsgCycleTimeFast" BO_ 163 0;
BA_ "GenMsgSendType" BO_ 163 1;
BA_ "VFrameFormat" BO_ 163 14;
BA_ "CANFD_BRS" BO_ 163 1;
BA_ "GenMsgCycleTime" BO_ 163 0;
BA_ "GenMsgCycleTimeFast" BO_ 163 0;
BA_ "GenMsgSendType" BO_ 163 1;
BA_ "VFrameFormat" BO_ 163 14;
BA_ "CANFD_BRS" BO_ 163 1;
BA_ "GenMsgCycleTime" BO_ 163 0;
BA_ "GenMsgCycleTimeFast" BO_ 163 0;
BA_ "GenMsgSendType" BO_ 163 1;
BA_ "VFrameFormat" BO_ 163 14;
BA_ "CANFD_BRS" BO_ 163 1;
BA_ "GenMsgCycleTime" BO_ 163 0;
BA_ "GenMsgCycleTimeFast" BO_ 163 0;
BA_ "GenMsgSendType" BO_ 163 1;
BA_ "VFrameFormat" BO_ 163 14;
BA_ "CANFD_BRS" BO_ 163 1;
BA_ "GenMsgCycleTime" BO_ 163 0;
BA_ "GenMsgCycleTimeFast" BO_ 163 0;
BA_ "GenMsgSendType" BO_ 163 1;
BA_ "VFrameFormat" BO_ 163 14;
BA_ "CANFD_BRS" BO_ 163 1;
BA_ "GenMsgCycleTime" BO_ 163 0;
BA_ "GenMsgCycleTimeFast" BO_ 163 0;
BA_ "GenMsgSendType" BO_ 163 1;
BA_ "VFrameFormat" BO_ 163 14;
BA_ "CANFD_BRS" BO_ 163 1;
BA_ "GenMsgCycleTime" BO_ 163 0;
BA_ "GenMsgCycleTimeFast" BO_ 163 0;
BA_ "GenMsgSendType" BO_ 163 1;
BA_ "VFrameFormat" BO_ 163 14;
BA_ "CANFD_BRS" BO_ 163 1;
BA_ "GenMsgCycleTime" BO_ 163 0;
BA_ "GenMsgCycleTimeFast" BO_ 163 0;
BA_ "GenMsgSendType" BO_ 163 1;
BA_ "VFrameFormat" BO_ 163 14;
BA_ "CANFD_BRS" BO_ 163 1;
BA_ "GenMsgCycleTime" BO_ 163 0;
BA_ "GenMsgCycleTimeFast" BO_ 163 0;
BA_ "GenMsgSendType" BO_ 163 1;
BA_ "VFrameFormat" BO_ 163 14;
BA_ "CANFD_BRS" BO_ 163 1;
BA_ "GenMsgCycleTime" BO_ 163 0;
BA_ "GenMsgCycleTimeFast" BO_ 163 0;
BA_ "GenMsgSendType" BO_ 163 1;
BA_ "VFrameFormat" BO_ 163 14;
BA_ "CANFD_BRS" BO_ 163 1;
BA_ "GenMsgCycleTime" BO_ 163 0;
BA_ "GenMsgCycleTimeFast" BO_ 163 0;
BA_ "GenMsgSendType" BO_ 163 1;
BA_ "VFrameFormat" BO_ 163 14;
BA_ "CANFD_BRS" BO_ 163 1;
BA_ "GenMsgCycleTime" BO_ 163 0;
BA_ "GenMsgCycleTimeFast" BO_ 163 0;
BA_ "GenMsgSendType" BO_ 163 1;
BA_ "VFrameFormat" BO_ 163 14;
BA_ "CANFD_BRS" BO_ 163 1;
BA_ "GenMsgCycleTime" BO_ 163 0;
BA_ "GenMsgCycleTimeFast" BO_ 163 0;
BA_ "GenMsgSendType" BO_ 163 1;
BA_ "VFrameFormat" BO_ 163 14;
BA_ "CANFD_BRS" BO_ 163 1;
BA_ "GenMsgCycleTime" BO_ 163 0;
BA_ "GenMsgCycleTimeFast" BO_ 163 0;
BA_ "GenMsgSendType" BO_ 163 1;
BA_ "VFrameFormat" BO_ 163 14;
BA_ "CANFD_BRS" BO_ 163 1;
BA_ "GenMsgCycleTime" BO_ 163 0;
BA_ "GenMsgCycleTimeFast" BO_ 163 0;
BA_ "GenMsgSendType" BO_ 163 1;
BA_ "VFrameFormat" BO_ 163 14;
BA_ "CANFD_BRS" BO_ 163 1;
BA_ "GenMsgCycleTime" BO_ 163 0;
BA_ "GenMsgCycleTimeFast" BO_ 163 0;
BA_ "GenMsgSendType" BO_ 163 1;
BA_ "VFrameFormat" BO_ 163 14;
BA_ "CANFD_BRS" BO_ 163 1;
BA_ "GenMsgCycleTime" BO_ 163 0;
BA_ "GenMsgCycleTimeFast" BO_ 163 0;
BA_ "GenMsgSendType" BO_ 163 1;
BA_ "VFrameFormat" BO_ 163 14;
BA_ "CANFD_BRS" BO_ 163 1;
BA_ "GenMsgCycleTime" BO_ 163 0;
BA_ "GenMsgCycleTimeFast" BO_ 163 0;
BA_ "GenMsgSendType" BO_ 163 1;
BA_ "VFrameFormat" BO_ 163 14;
BA_ "CANFD_BRS" BO_ 163 1;
BA_ "GenMsgCycleTime" BO_ 163 0;
BA_ "GenMsgCycleTimeFast" BO_ 163 0;
BA_ "GenMsgSendType" BO_ 163 1;
BA_ "VFrameFormat" BO_ 163 14;
BA_ "CANFD_BRS" BO_ 163 1;
BA_ "GenMsgCycleTime" BO_ 163 0;
BA_ "GenMsgCycleTimeFast" BO_ 163 0;
BA_ "GenMsgSendType" BO_ 163 1;
BA_ "VFrameFormat" BO_ 163 14;
BA_ "CANFD_BRS" BO_ 163 1;
BA_ "GenMsgCycleTime" BO_ 163 0;
BA_ "GenMsgCycleTimeFast" BO_ 163 0;
BA_ "GenMsgSendType" BO_ 163 1;
BA_ "VFrameFormat" BO_ 163 14;
BA_ "CANFD_BRS" BO_ 163 1;
BA_ "GenMsgCycleTime" BO_ 163 0;
BA_ "GenMsgCycleTimeFast" BO_ 163 0;
BA_ "GenMsgSendType" BO_ 163 1;
BA_ "VFrameFormat" BO_ 163 14;
BA_ "CANFD_BRS" BO_ 163 1;
BA_ "GenMsgCycleTime" BO_ 163 0;
BA_ "GenMsgCycleTimeFast" BO_ 163 0;
BA_ "GenMsgSendType" BO_ 163 1;
BA_ "VFrameFormat" BO_ 163 14;
BA_ "CANFD_BRS" BO_ 163 1;
BA_ "GenMsgCycleTime" BO_ 163 0;
BA_ "GenMsgCycleTimeFast" BO_ 163 0;
BA_ "GenMsgSendType" BO_ 163 1;
BA_ "VFrameFormat" BO_ 163 14;
BA_ "CANFD_BRS" BO_ 163 1;
BA_ "GenMsgCycleTime" BO_ 163 0;
BA_ "GenMsgCycleTimeFast" BO_ 163 0;
BA_ "GenMsgSendType" BO_ 163 1;
BA_ "VFrameFormat" BO_ 163 14;
BA_ "CANFD_BRS" BO_ 163 1;
BA_ "GenMsgCycleTime" BO_ 163 0;
BA_ "GenMsgCycleTimeFast" BO_ 163 0;
BA_ "GenMsgSendType" BO_ 163 1;
BA_ "VFrameFormat" BO_ 163 14;
BA_ "CANFD_BRS" BO_ 163 1;
BA_ "GenMsgCycleTime" BO_ 163 0;
BA_ "GenMsgCycleTimeFast" BO_ 163 0;
BA_ "GenMsgSendType" BO_ 163 1;
BA_ "VFrameFormat" BO_ 163 14;
BA_ "CANFD_BRS" BO_ 163 1;
BA_ "GenMsgCycleTime" BO_ 163 0;
BA_ "GenMsgCycleTimeFast" BO_ 163 0;
BA_ "GenMsgSendType" BO_ 163 1;
BA_ "VFrameFormat" BO_ 163 14;
BA_ "CANFD_BRS" BO_ 163 1;
BA_ "GenMsgCycleTime" BO_ 163 0;
BA_ "GenMsgCycleTimeFast" BO_ 163 0;
BA_ "GenMsgSendType" BO_ 163 1;
BA_ "VFrameFormat" BO_ 163 14;
BA_ "CANFD_BRS" BO_ 163 1;
BA_ "GenMsgCycleTime" BO_ 163 0;
BA_ "GenMsgCycleTimeFast" BO_ 163 0;
BA_ "GenMsgSendType" BO_ 163 1;
BA_ "VFrameFormat" BO_ 163 14;
BA_ "CANFD_BRS" BO_ 163 1;
BA_ "GenMsgCycleTime" BO_ 163 0;
BA_ "GenMsgCycleTimeFast" BO_ 163 0;
BA_ "GenMsgSendType" BO_ 163 1;
BA_ "VFrameFormat" BO_ 163 14;
BA_ "CANFD_BRS" BO_ 163 1;
BA_ "GenMsgCycleTime" BO_ 163 0;
BA_ "GenMsgCycleTimeFast" BO_ 163 0;
BA_ "GenMsgSendType" BO_ 163 1;
BA_ "VFrameFormat" BO_ 163 14;
BA_ "CANFD_BRS" BO_ 163 1;
BA_ "GenMsgCycleTime" BO_ 163 0;
BA_ "GenMsgCycleTimeFast" BO_ 163 0;
BA_ "GenMsgSendType" BO_ 163 1;
BA_ "VFrameFormat" BO_ 163 14;
BA_ "CANFD_BRS" BO_ 163 1;
BA_ "GenMsgCycleTime" BO_ 618 20;
BA_ "GenMsgCycleTimeFast" BO_ 618 0;
BA_ "GenMsgSendType" BO_ 618 0;
BA_ "VFrameFormat" BO_ 618 14;
BA_ "CANFD_BRS" BO_ 618 1;
BA_ "GenMsgCycleTime" BO_ 618 20;
BA_ "GenMsgCycleTimeFast" BO_ 618 0;
BA_ "GenMsgSendType" BO_ 618 0;
BA_ "VFrameFormat" BO_ 618 14;
BA_ "CANFD_BRS" BO_ 618 1;
BA_ "GenMsgCycleTime" BO_ 618 20;
BA_ "GenMsgCycleTimeFast" BO_ 618 0;
BA_ "GenMsgSendType" BO_ 618 0;
BA_ "VFrameFormat" BO_ 618 14;
BA_ "CANFD_BRS" BO_ 618 1;
BA_ "GenMsgCycleTime" BO_ 618 20;
BA_ "GenMsgCycleTimeFast" BO_ 618 0;
BA_ "GenMsgSendType" BO_ 618 0;
BA_ "VFrameFormat" BO_ 618 14;
BA_ "CANFD_BRS" BO_ 618 1;
BA_ "GenMsgCycleTime" BO_ 618 20;
BA_ "GenMsgCycleTimeFast" BO_ 618 0;
BA_ "GenMsgSendType" BO_ 618 0;
BA_ "VFrameFormat" BO_ 618 14;
BA_ "CANFD_BRS" BO_ 618 1;
BA_ "GenMsgCycleTime" BO_ 618 20;
BA_ "GenMsgCycleTimeFast" BO_ 618 0;
BA_ "GenMsgSendType" BO_ 618 0;
BA_ "VFrameFormat" BO_ 618 14;
BA_ "CANFD_BRS" BO_ 618 1;
BA_ "GenMsgCycleTime" BO_ 618 20;
BA_ "GenMsgCycleTimeFast" BO_ 618 0;
BA_ "GenMsgSendType" BO_ 618 0;
BA_ "VFrameFormat" BO_ 618 14;
BA_ "CANFD_BRS" BO_ 618 1;
BA_ "GenMsgCycleTime" BO_ 618 20;
BA_ "GenMsgCycleTimeFast" BO_ 618 0;
BA_ "GenMsgSendType" BO_ 618 0;
BA_ "VFrameFormat" BO_ 618 14;
BA_ "CANFD_BRS" BO_ 618 1;
BA_ "GenMsgCycleTime" BO_ 618 20;
BA_ "GenMsgCycleTimeFast" BO_ 618 0;
BA_ "GenMsgSendType" BO_ 618 0;
BA_ "VFrameFormat" BO_ 618 14;
BA_ "CANFD_BRS" BO_ 618 1;
BA_ "GenMsgCycleTime" BO_ 618 20;
BA_ "GenMsgCycleTimeFast" BO_ 618 0;
BA_ "GenMsgSendType" BO_ 618 0;
BA_ "VFrameFormat" BO_ 618 14;
BA_ "CANFD_BRS" BO_ 618 1;
BA_ "GenMsgCycleTime" BO_ 618 20;
BA_ "GenMsgCycleTimeFast" BO_ 618 0;
BA_ "GenMsgSendType" BO_ 618 0;
BA_ "VFrameFormat" BO_ 618 14;
BA_ "CANFD_BRS" BO_ 618 1;
BA_ "GenMsgCycleTime" BO_ 618 20;
BA_ "GenMsgCycleTimeFast" BO_ 618 0;
BA_ "GenMsgSendType" BO_ 618 0;
BA_ "VFrameFormat" BO_ 618 14;
BA_ "CANFD_BRS" BO_ 618 1;
BA_ "GenMsgCycleTime" BO_ 618 20;
BA_ "GenMsgCycleTimeFast" BO_ 618 0;
BA_ "GenMsgSendType" BO_ 618 0;
BA_ "VFrameFormat" BO_ 618 14;
BA_ "CANFD_BRS" BO_ 618 1;
BA_ "EventCommandSignal" SG_ 400 UINM_1_CRC 0;
BA_ "GatewayedSignals" SG_ 400 UINM_1_CRC 0;
BA_ "GenSigInactiveValue" SG_ 400 UINM_1_CRC 0;
BA_ "GenSigInvalidValue" SG_ 400 UINM_1_CRC 0;
BA_ "GenSigSendType" SG_ 400 UINM_1_CRC 1;
BA_ "GenSigStartValue" SG_ 400 UINM_1_CRC 0;
BA_ "GenSigTimeoutValue" SG_ 400 UINM_1_CRC 0;
BA_ "Remark" SG_ 400 UINM_1_CRC "";
BA_ "EventCommandSignal" SG_ 400 UINM_1_Counter 0;
BA_ "GatewayedSignals" SG_ 400 UINM_1_Counter 0;
BA_ "GenSigInactiveValue" SG_ 400 UINM_1_Counter 0;
BA_ "GenSigInvalidValue" SG_ 400 UINM_1_Counter 0;
BA_ "GenSigSendType" SG_ 400 UINM_1_Counter 1;
BA_ "GenSigStartValue" SG_ 400 UINM_1_Counter 0;
BA_ "GenSigTimeoutValue" SG_ 400 UINM_1_Counter 0;
BA_ "Remark" SG_ 400 UINM_1_Counter "";
BA_ "EventCommandSignal" SG_ 400 UINM_DrvReqShft 0;
BA_ "GatewayedSignals" SG_ 400 UINM_DrvReqShft 0;
BA_ "GenSigInactiveValue" SG_ 400 UINM_DrvReqShft 0;
BA_ "GenSigInvalidValue" SG_ 400 UINM_DrvReqShft 0;
BA_ "GenSigSendType" SG_ 400 UINM_DrvReqShft 1;
BA_ "GenSigStartValue" SG_ 400 UINM_DrvReqShft 5;
BA_ "GenSigTimeoutValue" SG_ 400 UINM_DrvReqShft 0;
BA_ "Remark" SG_ 400 UINM_DrvReqShft "";
BA_ "EventCommandSignal" SG_ 400 UINM_DrvReqShftInv 0;
BA_ "GatewayedSignals" SG_ 400 UINM_DrvReqShftInv 0;
BA_ "GenSigInactiveValue" SG_ 400 UINM_DrvReqShftInv 0;
BA_ "GenSigInvalidValue" SG_ 400 UINM_DrvReqShftInv 0;
BA_ "GenSigSendType" SG_ 400 UINM_DrvReqShftInv 1;
BA_ "GenSigStartValue" SG_ 400 UINM_DrvReqShftInv 10;
BA_ "GenSigTimeoutValue" SG_ 400 UINM_DrvReqShftInv 0;
BA_ "Remark" SG_ 400 UINM_DrvReqShftInv "";
BA_ "EventCommandSignal" SG_ 400 UINM_FuSaErrSt 0;
BA_ "GatewayedSignals" SG_ 400 UINM_FuSaErrSt 0;
BA_ "GenSigInactiveValue" SG_ 400 UINM_FuSaErrSt 0;
BA_ "GenSigInvalidValue" SG_ 400 UINM_FuSaErrSt 0;
BA_ "GenSigSendType" SG_ 400 UINM_FuSaErrSt 1;
BA_ "GenSigStartValue" SG_ 400 UINM_FuSaErrSt 0;
BA_ "GenSigTimeoutValue" SG_ 400 UINM_FuSaErrSt 0;
BA_ "Remark" SG_ 400 UINM_FuSaErrSt "";
BA_ "EventCommandSignal" SG_ 400 UINM_ShftFault 0;
BA_ "GatewayedSignals" SG_ 400 UINM_ShftFault 0;
BA_ "GenSigInactiveValue" SG_ 400 UINM_ShftFault 0;
BA_ "GenSigInvalidValue" SG_ 400 UINM_ShftFault 0;
BA_ "GenSigSendType" SG_ 400 UINM_ShftFault 1;
BA_ "GenSigStartValue" SG_ 400 UINM_ShftFault 0;
BA_ "GenSigTimeoutValue" SG_ 400 UINM_ShftFault 0;
BA_ "Remark" SG_ 400 UINM_ShftFault "";
BA_ "EventCommandSignal" SG_ 400 UINM_PositionLightSwSt 0;
BA_ "GatewayedSignals" SG_ 400 UINM_PositionLightSwSt 0;
BA_ "GenSigInactiveValue" SG_ 400 UINM_PositionLightSwSt 0;
BA_ "GenSigInvalidValue" SG_ 400 UINM_PositionLightSwSt 2;
BA_ "GenSigSendType" SG_ 400 UINM_PositionLightSwSt 1;
BA_ "GenSigStartValue" SG_ 400 UINM_PositionLightSwSt 0;
BA_ "GenSigTimeoutValue" SG_ 400 UINM_PositionLightSwSt 0;
BA_ "Remark" SG_ 400 UINM_PositionLightSwSt "";
BA_ "EventCommandSignal" SG_ 400 UINM_LowBeamSwSt 0;
BA_ "GatewayedSignals" SG_ 400 UINM_LowBeamSwSt 0;
BA_ "GenSigInactiveValue" SG_ 400 UINM_LowBeamSwSt 0;
BA_ "GenSigInvalidValue" SG_ 400 UINM_LowBeamSwSt 2;
BA_ "GenSigSendType" SG_ 400 UINM_LowBeamSwSt 1;
BA_ "GenSigStartValue" SG_ 400 UINM_LowBeamSwSt 0;
BA_ "GenSigTimeoutValue" SG_ 400 UINM_LowBeamSwSt 0;
BA_ "Remark" SG_ 400 UINM_LowBeamSwSt "";
BA_ "EventCommandSignal" SG_ 400 UINM_AutoLightSwSt 0;
BA_ "GatewayedSignals" SG_ 400 UINM_AutoLightSwSt 0;
BA_ "GenSigInactiveValue" SG_ 400 UINM_AutoLightSwSt 0;
BA_ "GenSigInvalidValue" SG_ 400 UINM_AutoLightSwSt 2;
BA_ "GenSigSendType" SG_ 400 UINM_AutoLightSwSt 1;
BA_ "GenSigStartValue" SG_ 400 UINM_AutoLightSwSt 0;
BA_ "GenSigTimeoutValue" SG_ 400 UINM_AutoLightSwSt 0;
BA_ "Remark" SG_ 400 UINM_AutoLightSwSt "";
BA_ "EventCommandSignal" SG_ 400 UINM_FrontFogLightSwSt 0;
BA_ "GatewayedSignals" SG_ 400 UINM_FrontFogLightSwSt 0;
BA_ "GenSigInactiveValue" SG_ 400 UINM_FrontFogLightSwSt 0;
BA_ "GenSigInvalidValue" SG_ 400 UINM_FrontFogLightSwSt 0;
BA_ "GenSigSendType" SG_ 400 UINM_FrontFogLightSwSt 1;
BA_ "GenSigStartValue" SG_ 400 UINM_FrontFogLightSwSt 0;
BA_ "GenSigTimeoutValue" SG_ 400 UINM_FrontFogLightSwSt 0;
BA_ "Remark" SG_ 400 UINM_FrontFogLightSwSt "";
BA_ "EventCommandSignal" SG_ 400 UINM_RearFogLightSwSt 0;
BA_ "GatewayedSignals" SG_ 400 UINM_RearFogLightSwSt 0;
BA_ "GenSigInactiveValue" SG_ 400 UINM_RearFogLightSwSt 0;
BA_ "GenSigInvalidValue" SG_ 400 UINM_RearFogLightSwSt 0;
BA_ "GenSigSendType" SG_ 400 UINM_RearFogLightSwSt 1;
BA_ "GenSigStartValue" SG_ 400 UINM_RearFogLightSwSt 0;
BA_ "GenSigTimeoutValue" SG_ 400 UINM_RearFogLightSwSt 0;
BA_ "Remark" SG_ 400 UINM_RearFogLightSwSt "";
BA_ "EventCommandSignal" SG_ 400 UINM_HighBeamSwSt 0;
BA_ "GatewayedSignals" SG_ 400 UINM_HighBeamSwSt 0;
BA_ "GenSigInactiveValue" SG_ 400 UINM_HighBeamSwSt 0;
BA_ "GenSigInvalidValue" SG_ 400 UINM_HighBeamSwSt 3;
BA_ "GenSigSendType" SG_ 400 UINM_HighBeamSwSt 1;
BA_ "GenSigStartValue" SG_ 400 UINM_HighBeamSwSt 0;
BA_ "GenSigTimeoutValue" SG_ 400 UINM_HighBeamSwSt 0;
BA_ "Remark" SG_ 400 UINM_HighBeamSwSt "";
BA_ "EventCommandSignal" SG_ 400 UINM_TurnLightSwSt 0;
BA_ "GatewayedSignals" SG_ 400 UINM_TurnLightSwSt 0;
BA_ "GenSigInactiveValue" SG_ 400 UINM_TurnLightSwSt 0;
BA_ "GenSigInvalidValue" SG_ 400 UINM_TurnLightSwSt 5;
BA_ "GenSigSendType" SG_ 400 UINM_TurnLightSwSt 1;
BA_ "GenSigStartValue" SG_ 400 UINM_TurnLightSwSt 0;
BA_ "GenSigTimeoutValue" SG_ 400 UINM_TurnLightSwSt 0;
BA_ "Remark" SG_ 400 UINM_TurnLightSwSt "";
BA_ "EventCommandSignal" SG_ 400 UINM_FrontWiperSwSt 0;
BA_ "GatewayedSignals" SG_ 400 UINM_FrontWiperSwSt 0;
BA_ "GenSigInactiveValue" SG_ 400 UINM_FrontWiperSwSt 0;
BA_ "GenSigInvalidValue" SG_ 400 UINM_FrontWiperSwSt 7;
BA_ "GenSigSendType" SG_ 400 UINM_FrontWiperSwSt 1;
BA_ "GenSigStartValue" SG_ 400 UINM_FrontWiperSwSt 0;
BA_ "GenSigTimeoutValue" SG_ 400 UINM_FrontWiperSwSt 0;
BA_ "Remark" SG_ 400 UINM_FrontWiperSwSt "";
BA_ "EventCommandSignal" SG_ 400 UINM_FrontWiperIntAdjSwSt 0;
BA_ "GatewayedSignals" SG_ 400 UINM_FrontWiperIntAdjSwSt 0;
BA_ "GenSigInactiveValue" SG_ 400 UINM_FrontWiperIntAdjSwSt 0;
BA_ "GenSigInvalidValue" SG_ 400 UINM_FrontWiperIntAdjSwSt 15;
BA_ "GenSigSendType" SG_ 400 UINM_FrontWiperIntAdjSwSt 1;
BA_ "GenSigStartValue" SG_ 400 UINM_FrontWiperIntAdjSwSt 0;
BA_ "GenSigTimeoutValue" SG_ 400 UINM_FrontWiperIntAdjSwSt 0;
BA_ "Remark" SG_ 400 UINM_FrontWiperIntAdjSwSt "";
BA_ "EventCommandSignal" SG_ 400 UINM_FrontWasherSwSt 0;
BA_ "GatewayedSignals" SG_ 400 UINM_FrontWasherSwSt 0;
BA_ "GenSigInactiveValue" SG_ 400 UINM_FrontWasherSwSt 0;
BA_ "GenSigInvalidValue" SG_ 400 UINM_FrontWasherSwSt 0;
BA_ "GenSigSendType" SG_ 400 UINM_FrontWasherSwSt 1;
BA_ "GenSigStartValue" SG_ 400 UINM_FrontWasherSwSt 0;
BA_ "GenSigTimeoutValue" SG_ 400 UINM_FrontWasherSwSt 0;
BA_ "Remark" SG_ 400 UINM_FrontWasherSwSt "";
BA_ "EventCommandSignal" SG_ 400 UINM_RearWiperSwSt 0;
BA_ "GatewayedSignals" SG_ 400 UINM_RearWiperSwSt 0;
BA_ "GenSigInactiveValue" SG_ 400 UINM_RearWiperSwSt 0;
BA_ "GenSigInvalidValue" SG_ 400 UINM_RearWiperSwSt 7;
BA_ "GenSigSendType" SG_ 400 UINM_RearWiperSwSt 1;
BA_ "GenSigStartValue" SG_ 400 UINM_RearWiperSwSt 0;
BA_ "GenSigTimeoutValue" SG_ 400 UINM_RearWiperSwSt 0;
BA_ "Remark" SG_ 400 UINM_RearWiperSwSt "";
BA_ "EventCommandSignal" SG_ 400 UINM_RearWiperIntAdjSwSt 0;
BA_ "GatewayedSignals" SG_ 400 UINM_RearWiperIntAdjSwSt 0;
BA_ "GenSigInactiveValue" SG_ 400 UINM_RearWiperIntAdjSwSt 0;
BA_ "GenSigInvalidValue" SG_ 400 UINM_RearWiperIntAdjSwSt 15;
BA_ "GenSigSendType" SG_ 400 UINM_RearWiperIntAdjSwSt 1;
BA_ "GenSigStartValue" SG_ 400 UINM_RearWiperIntAdjSwSt 0;
BA_ "GenSigTimeoutValue" SG_ 400 UINM_RearWiperIntAdjSwSt 0;
BA_ "Remark" SG_ 400 UINM_RearWiperIntAdjSwSt "";
BA_ "EventCommandSignal" SG_ 400 UINM_RearWasherSwSt 0;
BA_ "GatewayedSignals" SG_ 400 UINM_RearWasherSwSt 0;
BA_ "GenSigInactiveValue" SG_ 400 UINM_RearWasherSwSt 0;
BA_ "GenSigInvalidValue" SG_ 400 UINM_RearWasherSwSt 0;
BA_ "GenSigSendType" SG_ 400 UINM_RearWasherSwSt 1;
BA_ "GenSigStartValue" SG_ 400 UINM_RearWasherSwSt 0;
BA_ "GenSigTimeoutValue" SG_ 400 UINM_RearWasherSwSt 0;
BA_ "Remark" SG_ 400 UINM_RearWasherSwSt "";
BA_ "EventCommandSignal" SG_ 400 UINM_HeadLampWasherSwSt 0;
BA_ "GatewayedSignals" SG_ 400 UINM_HeadLampWasherSwSt 0;
BA_ "GenSigInactiveValue" SG_ 400 UINM_HeadLampWasherSwSt 0;
BA_ "GenSigInvalidValue" SG_ 400 UINM_HeadLampWasherSwSt 0;
BA_ "GenSigSendType" SG_ 400 UINM_HeadLampWasherSwSt 1;
BA_ "GenSigStartValue" SG_ 400 UINM_HeadLampWasherSwSt 0;
BA_ "GenSigTimeoutValue" SG_ 400 UINM_HeadLampWasherSwSt 0;
BA_ "Remark" SG_ 400 UINM_HeadLampWasherSwSt "";
BA_ "EventCommandSignal" SG_ 616 CCU_1_CRC 0;
BA_ "GatewayedSignals" SG_ 616 CCU_1_CRC 0;
BA_ "GenSigInactiveValue" SG_ 616 CCU_1_CRC 0;
BA_ "GenSigInvalidValue" SG_ 616 CCU_1_CRC 0;
BA_ "GenSigSendType" SG_ 616 CCU_1_CRC 1;
BA_ "GenSigStartValue" SG_ 616 CCU_1_CRC 0;
BA_ "GenSigTimeoutValue" SG_ 616 CCU_1_CRC 0;
BA_ "Remark" SG_ 616 CCU_1_CRC "";
BA_ "EventCommandSignal" SG_ 616 CCU_1_Counter 0;
BA_ "GatewayedSignals" SG_ 616 CCU_1_Counter 0;
BA_ "GenSigInactiveValue" SG_ 616 CCU_1_Counter 0;
BA_ "GenSigInvalidValue" SG_ 616 CCU_1_Counter 0;
BA_ "GenSigSendType" SG_ 616 CCU_1_Counter 1;
BA_ "GenSigStartValue" SG_ 616 CCU_1_Counter 0;
BA_ "GenSigTimeoutValue" SG_ 616 CCU_1_Counter 0;
BA_ "Remark" SG_ 616 CCU_1_Counter "";
BA_ "EventCommandSignal" SG_ 616 UMM_UsageModeSt 0;
BA_ "GatewayedSignals" SG_ 616 UMM_UsageModeSt 0;
BA_ "GenSigInactiveValue" SG_ 616 UMM_UsageModeSt 0;
BA_ "GenSigInvalidValue" SG_ 616 UMM_UsageModeSt 0;
BA_ "GenSigSendType" SG_ 616 UMM_UsageModeSt 1;
BA_ "GenSigStartValue" SG_ 616 UMM_UsageModeSt 7;
BA_ "GenSigTimeoutValue" SG_ 616 UMM_UsageModeSt 0;
BA_ "Remark" SG_ 616 UMM_UsageModeSt "";
BA_ "EventCommandSignal" SG_ 616 OTA_FuncReq_ADCWakeup 0;
BA_ "GatewayedSignals" SG_ 616 OTA_FuncReq_ADCWakeup 0;
BA_ "GenSigInactiveValue" SG_ 616 OTA_FuncReq_ADCWakeup 0;
BA_ "GenSigInvalidValue" SG_ 616 OTA_FuncReq_ADCWakeup 0;
BA_ "GenSigSendType" SG_ 616 OTA_FuncReq_ADCWakeup 1;
BA_ "GenSigStartValue" SG_ 616 OTA_FuncReq_ADCWakeup 0;
BA_ "GenSigTimeoutValue" SG_ 616 OTA_FuncReq_ADCWakeup 0;
BA_ "Remark" SG_ 616 OTA_FuncReq_ADCWakeup "";
BA_ "EventCommandSignal" SG_ 616 UMM_FrontPassengerSeatSt 0;
BA_ "GatewayedSignals" SG_ 616 UMM_FrontPassengerSeatSt 0;
BA_ "GenSigInactiveValue" SG_ 616 UMM_FrontPassengerSeatSt 0;
BA_ "GenSigInvalidValue" SG_ 616 UMM_FrontPassengerSeatSt 0;
BA_ "GenSigSendType" SG_ 616 UMM_FrontPassengerSeatSt 1;
BA_ "GenSigStartValue" SG_ 616 UMM_FrontPassengerSeatSt 0;
BA_ "GenSigTimeoutValue" SG_ 616 UMM_FrontPassengerSeatSt 0;
BA_ "Remark" SG_ 616 UMM_FrontPassengerSeatSt "";
BA_ "EventCommandSignal" SG_ 616 UMM_DriverSeatSt 0;
BA_ "GatewayedSignals" SG_ 616 UMM_DriverSeatSt 0;
BA_ "GenSigInactiveValue" SG_ 616 UMM_DriverSeatSt 0;
BA_ "GenSigInvalidValue" SG_ 616 UMM_DriverSeatSt 0;
BA_ "GenSigSendType" SG_ 616 UMM_DriverSeatSt 1;
BA_ "GenSigStartValue" SG_ 616 UMM_DriverSeatSt 0;
BA_ "GenSigTimeoutValue" SG_ 616 UMM_DriverSeatSt 0;
BA_ "Remark" SG_ 616 UMM_DriverSeatSt "";
BA_ "EventCommandSignal" SG_ 616 VMM_VehModeSt 0;
BA_ "GatewayedSignals" SG_ 616 VMM_VehModeSt 0;
BA_ "GenSigInactiveValue" SG_ 616 VMM_VehModeSt 0;
BA_ "GenSigInvalidValue" SG_ 616 VMM_VehModeSt 15;
BA_ "GenSigSendType" SG_ 616 VMM_VehModeSt 1;
BA_ "GenSigStartValue" SG_ 616 VMM_VehModeSt 15;
BA_ "GenSigTimeoutValue" SG_ 616 VMM_VehModeSt 15;
BA_ "Remark" SG_ 616 VMM_VehModeSt "";
BA_ "EventCommandSignal" SG_ 616 VMM_LastVehModeSt 0;
BA_ "GatewayedSignals" SG_ 616 VMM_LastVehModeSt 0;
BA_ "GenSigInactiveValue" SG_ 616 VMM_LastVehModeSt 0;
BA_ "GenSigInvalidValue" SG_ 616 VMM_LastVehModeSt 15;
BA_ "GenSigSendType" SG_ 616 VMM_LastVehModeSt 1;
BA_ "GenSigStartValue" SG_ 616 VMM_LastVehModeSt 15;
BA_ "GenSigTimeoutValue" SG_ 616 VMM_LastVehModeSt 15;
BA_ "Remark" SG_ 616 VMM_LastVehModeSt "";
BA_ "EventCommandSignal" SG_ 616 VMM_OTAModeSt 0;
BA_ "GatewayedSignals" SG_ 616 VMM_OTAModeSt 0;
BA_ "GenSigInactiveValue" SG_ 616 VMM_OTAModeSt 0;
BA_ "GenSigInvalidValue" SG_ 616 VMM_OTAModeSt 2;
BA_ "GenSigSendType" SG_ 616 VMM_OTAModeSt 1;
BA_ "GenSigStartValue" SG_ 616 VMM_OTAModeSt 0;
BA_ "GenSigTimeoutValue" SG_ 616 VMM_OTAModeSt 0;
BA_ "Remark" SG_ 616 VMM_OTAModeSt "";
BA_ "EventCommandSignal" SG_ 616 CSM_RC_PAARequest 0;
BA_ "GatewayedSignals" SG_ 616 CSM_RC_PAARequest 0;
BA_ "GenSigInactiveValue" SG_ 616 CSM_RC_PAARequest 0;
BA_ "GenSigInvalidValue" SG_ 616 CSM_RC_PAARequest 0;
BA_ "GenSigSendType" SG_ 616 CSM_RC_PAARequest 1;
BA_ "GenSigStartValue" SG_ 616 CSM_RC_PAARequest 0;
BA_ "GenSigTimeoutValue" SG_ 616 CSM_RC_PAARequest 0;
BA_ "Remark" SG_ 616 CSM_RC_PAARequest "";
BA_ "EventCommandSignal" SG_ 616 IPDS_EnablePowerSup 0;
BA_ "GatewayedSignals" SG_ 616 IPDS_EnablePowerSup 0;
BA_ "GenSigInactiveValue" SG_ 616 IPDS_EnablePowerSup 0;
BA_ "GenSigInvalidValue" SG_ 616 IPDS_EnablePowerSup 0;
BA_ "GenSigSendType" SG_ 616 IPDS_EnablePowerSup 1;
BA_ "GenSigStartValue" SG_ 616 IPDS_EnablePowerSup 0;
BA_ "GenSigTimeoutValue" SG_ 616 IPDS_EnablePowerSup 0;
BA_ "Remark" SG_ 616 IPDS_EnablePowerSup "";
BA_ "EventCommandSignal" SG_ 616 Time_Year 0;
BA_ "GatewayedSignals" SG_ 616 Time_Year 0;
BA_ "GenSigInactiveValue" SG_ 616 Time_Year 0;
BA_ "GenSigInvalidValue" SG_ 616 Time_Year 0;
BA_ "GenSigSendType" SG_ 616 Time_Year 1;
BA_ "GenSigStartValue" SG_ 616 Time_Year 0;
BA_ "GenSigTimeoutValue" SG_ 616 Time_Year 0;
BA_ "Remark" SG_ 616 Time_Year "";
BA_ "EventCommandSignal" SG_ 616 Time_Month 0;
BA_ "GatewayedSignals" SG_ 616 Time_Month 0;
BA_ "GenSigInactiveValue" SG_ 616 Time_Month 0;
BA_ "GenSigInvalidValue" SG_ 616 Time_Month 0;
BA_ "GenSigSendType" SG_ 616 Time_Month 1;
BA_ "GenSigStartValue" SG_ 616 Time_Month 0;
BA_ "GenSigTimeoutValue" SG_ 616 Time_Month 0;
BA_ "Remark" SG_ 616 Time_Month "";
BA_ "EventCommandSignal" SG_ 616 Time_Day 0;
BA_ "GatewayedSignals" SG_ 616 Time_Day 0;
BA_ "GenSigInactiveValue" SG_ 616 Time_Day 0;
BA_ "GenSigInvalidValue" SG_ 616 Time_Day 0;
BA_ "GenSigSendType" SG_ 616 Time_Day 1;
BA_ "GenSigStartValue" SG_ 616 Time_Day 1;
BA_ "GenSigTimeoutValue" SG_ 616 Time_Day 0;
BA_ "Remark" SG_ 616 Time_Day "";
BA_ "EventCommandSignal" SG_ 616 Time_Hour 0;
BA_ "GatewayedSignals" SG_ 616 Time_Hour 0;
BA_ "GenSigInactiveValue" SG_ 616 Time_Hour 0;
BA_ "GenSigInvalidValue" SG_ 616 Time_Hour 0;
BA_ "GenSigSendType" SG_ 616 Time_Hour 1;
BA_ "GenSigStartValue" SG_ 616 Time_Hour 1;
BA_ "GenSigTimeoutValue" SG_ 616 Time_Hour 0;
BA_ "Remark" SG_ 616 Time_Hour "";
BA_ "EventCommandSignal" SG_ 616 Time_Min 0;
BA_ "GatewayedSignals" SG_ 616 Time_Min 0;
BA_ "GenSigInactiveValue" SG_ 616 Time_Min 0;
BA_ "GenSigInvalidValue" SG_ 616 Time_Min 0;
BA_ "GenSigSendType" SG_ 616 Time_Min 1;
BA_ "GenSigStartValue" SG_ 616 Time_Min 1;
BA_ "GenSigTimeoutValue" SG_ 616 Time_Min 0;
BA_ "Remark" SG_ 616 Time_Min "";
BA_ "EventCommandSignal" SG_ 616 Time_Sec 0;
BA_ "GatewayedSignals" SG_ 616 Time_Sec 0;
BA_ "GenSigInactiveValue" SG_ 616 Time_Sec 0;
BA_ "GenSigInvalidValue" SG_ 616 Time_Sec 0;
BA_ "GenSigSendType" SG_ 616 Time_Sec 1;
BA_ "GenSigStartValue" SG_ 616 Time_Sec 1;
BA_ "GenSigTimeoutValue" SG_ 616 Time_Sec 0;
BA_ "Remark" SG_ 616 Time_Sec "";
BA_ "EventCommandSignal" SG_ 616 CCU_DstFlag 0;
BA_ "GatewayedSignals" SG_ 616 CCU_DstFlag 0;
BA_ "GenSigInactiveValue" SG_ 616 CCU_DstFlag 0;
BA_ "GenSigInvalidValue" SG_ 616 CCU_DstFlag 0;
BA_ "GenSigSendType" SG_ 616 CCU_DstFlag 1;
BA_ "GenSigStartValue" SG_ 616 CCU_DstFlag 0;
BA_ "GenSigTimeoutValue" SG_ 616 CCU_DstFlag 0;
BA_ "Remark" SG_ 616 CCU_DstFlag "";
BA_ "EventCommandSignal" SG_ 616 ASB_DriverActiveBeltFaultSt 0;
BA_ "GatewayedSignals" SG_ 616 ASB_DriverActiveBeltFaultSt 0;
BA_ "GenSigInactiveValue" SG_ 616 ASB_DriverActiveBeltFaultSt 0;
BA_ "GenSigInvalidValue" SG_ 616 ASB_DriverActiveBeltFaultSt 0;
BA_ "GenSigSendType" SG_ 616 ASB_DriverActiveBeltFaultSt 0;
BA_ "GenSigStartValue" SG_ 616 ASB_DriverActiveBeltFaultSt 0;
BA_ "GenSigTimeoutValue" SG_ 616 ASB_DriverActiveBeltFaultSt 1;
BA_ "Remark" SG_ 616 ASB_DriverActiveBeltFaultSt "";
BA_ "EventCommandSignal" SG_ 616 IPDS_DCDCOpenCircuitSt 0;
BA_ "GatewayedSignals" SG_ 616 IPDS_DCDCOpenCircuitSt 0;
BA_ "GenSigInactiveValue" SG_ 616 IPDS_DCDCOpenCircuitSt 0;
BA_ "GenSigInvalidValue" SG_ 616 IPDS_DCDCOpenCircuitSt 0;
BA_ "GenSigSendType" SG_ 616 IPDS_DCDCOpenCircuitSt 1;
BA_ "GenSigStartValue" SG_ 616 IPDS_DCDCOpenCircuitSt 0;
BA_ "GenSigTimeoutValue" SG_ 616 IPDS_DCDCOpenCircuitSt 0;
BA_ "Remark" SG_ 616 IPDS_DCDCOpenCircuitSt "";
BA_ "EventCommandSignal" SG_ 825 WW_FwpFaultSt 0;
BA_ "GatewayedSignals" SG_ 825 WW_FwpFaultSt 0;
BA_ "GenSigInactiveValue" SG_ 825 WW_FwpFaultSt 0;
BA_ "GenSigInvalidValue" SG_ 825 WW_FwpFaultSt 0;
BA_ "GenSigSendType" SG_ 825 WW_FwpFaultSt 1;
BA_ "GenSigStartValue" SG_ 825 WW_FwpFaultSt 0;
BA_ "GenSigTimeoutValue" SG_ 825 WW_FwpFaultSt 0;
BA_ "Remark" SG_ 825 WW_FwpFaultSt "";
BA_ "EventCommandSignal" SG_ 825 WW_RwpFaultSt 0;
BA_ "GatewayedSignals" SG_ 825 WW_RwpFaultSt 0;
BA_ "GenSigInactiveValue" SG_ 825 WW_RwpFaultSt 0;
BA_ "GenSigInvalidValue" SG_ 825 WW_RwpFaultSt 0;
BA_ "GenSigSendType" SG_ 825 WW_RwpFaultSt 1;
BA_ "GenSigStartValue" SG_ 825 WW_RwpFaultSt 0;
BA_ "GenSigTimeoutValue" SG_ 825 WW_RwpFaultSt 0;
BA_ "Remark" SG_ 825 WW_RwpFaultSt "";
BA_ "EventCommandSignal" SG_ 825 WW_FwshFaultSt 0;
BA_ "GatewayedSignals" SG_ 825 WW_FwshFaultSt 0;
BA_ "GenSigInactiveValue" SG_ 825 WW_FwshFaultSt 0;
BA_ "GenSigInvalidValue" SG_ 825 WW_FwshFaultSt 0;
BA_ "GenSigSendType" SG_ 825 WW_FwshFaultSt 1;
BA_ "GenSigStartValue" SG_ 825 WW_FwshFaultSt 0;
BA_ "GenSigTimeoutValue" SG_ 825 WW_FwshFaultSt 0;
BA_ "Remark" SG_ 825 WW_FwshFaultSt "";
BA_ "EventCommandSignal" SG_ 825 WW_RwshFaultSt 0;
BA_ "GatewayedSignals" SG_ 825 WW_RwshFaultSt 0;
BA_ "GenSigInactiveValue" SG_ 825 WW_RwshFaultSt 0;
BA_ "GenSigInvalidValue" SG_ 825 WW_RwshFaultSt 0;
BA_ "GenSigSendType" SG_ 825 WW_RwshFaultSt 1;
BA_ "GenSigStartValue" SG_ 825 WW_RwshFaultSt 0;
BA_ "GenSigTimeoutValue" SG_ 825 WW_RwshFaultSt 0;
BA_ "Remark" SG_ 825 WW_RwshFaultSt "";
BA_ "EventCommandSignal" SG_ 825 WW_FwpAutoModeSt 0;
BA_ "GatewayedSignals" SG_ 825 WW_FwpAutoModeSt 0;
BA_ "GenSigInactiveValue" SG_ 825 WW_FwpAutoModeSt 0;
BA_ "GenSigInvalidValue" SG_ 825 WW_FwpAutoModeSt 0;
BA_ "GenSigSendType" SG_ 825 WW_FwpAutoModeSt 1;
BA_ "GenSigStartValue" SG_ 825 WW_FwpAutoModeSt 0;
BA_ "GenSigTimeoutValue" SG_ 825 WW_FwpAutoModeSt 0;
BA_ "Remark" SG_ 825 WW_FwpAutoModeSt "";
BA_ "EventCommandSignal" SG_ 825 RLS_IRBrightness 0;
BA_ "GatewayedSignals" SG_ 825 RLS_IRBrightness 0;
BA_ "GenSigInactiveValue" SG_ 825 RLS_IRBrightness 0;
BA_ "GenSigInvalidValue" SG_ 825 RLS_IRBrightness 0;
BA_ "GenSigSendType" SG_ 825 RLS_IRBrightness 1;
BA_ "GenSigStartValue" SG_ 825 RLS_IRBrightness 2046;
BA_ "GenSigTimeoutValue" SG_ 825 RLS_IRBrightness 0;
BA_ "Remark" SG_ 825 RLS_IRBrightness "";
BA_ "EventCommandSignal" SG_ 825 WW_RainFallLevel 0;
BA_ "GatewayedSignals" SG_ 825 WW_RainFallLevel 0;
BA_ "GenSigInactiveValue" SG_ 825 WW_RainFallLevel 0;
BA_ "GenSigInvalidValue" SG_ 825 WW_RainFallLevel 0;
BA_ "GenSigSendType" SG_ 825 WW_RainFallLevel 1;
BA_ "GenSigStartValue" SG_ 825 WW_RainFallLevel 0;
BA_ "GenSigTimeoutValue" SG_ 825 WW_RainFallLevel 0;
BA_ "Remark" SG_ 825 WW_RainFallLevel "";
BA_ "EventCommandSignal" SG_ 825 RLS_LightOnReq 0;
BA_ "GatewayedSignals" SG_ 825 RLS_LightOnReq 0;
BA_ "GenSigInactiveValue" SG_ 825 RLS_LightOnReq 0;
BA_ "GenSigInvalidValue" SG_ 825 RLS_LightOnReq 0;
BA_ "GenSigSendType" SG_ 825 RLS_LightOnReq 1;
BA_ "GenSigStartValue" SG_ 825 RLS_LightOnReq 0;
BA_ "GenSigTimeoutValue" SG_ 825 RLS_LightOnReq 0;
BA_ "Remark" SG_ 825 RLS_LightOnReq "";
BA_ "EventCommandSignal" SG_ 825 RLS_LampOnReqValid 0;
BA_ "GatewayedSignals" SG_ 825 RLS_LampOnReqValid 0;
BA_ "GenSigInactiveValue" SG_ 825 RLS_LampOnReqValid 0;
BA_ "GenSigInvalidValue" SG_ 825 RLS_LampOnReqValid 0;
BA_ "GenSigSendType" SG_ 825 RLS_LampOnReqValid 1;
BA_ "GenSigStartValue" SG_ 825 RLS_LampOnReqValid 0;
BA_ "GenSigTimeoutValue" SG_ 825 RLS_LampOnReqValid 0;
BA_ "Remark" SG_ 825 RLS_LampOnReqValid "";
BA_ "EventCommandSignal" SG_ 825 RLS_WiperSpd 0;
BA_ "GatewayedSignals" SG_ 825 RLS_WiperSpd 0;
BA_ "GenSigInactiveValue" SG_ 825 RLS_WiperSpd 0;
BA_ "GenSigInvalidValue" SG_ 825 RLS_WiperSpd 0;
BA_ "GenSigSendType" SG_ 825 RLS_WiperSpd 1;
BA_ "GenSigStartValue" SG_ 825 RLS_WiperSpd 0;
BA_ "GenSigTimeoutValue" SG_ 825 RLS_WiperSpd 0;
BA_ "Remark" SG_ 825 RLS_WiperSpd "";
BA_ "EventCommandSignal" SG_ 825 RLS_AMBBrightness 0;
BA_ "GatewayedSignals" SG_ 825 RLS_AMBBrightness 0;
BA_ "GenSigInactiveValue" SG_ 825 RLS_AMBBrightness 0;
BA_ "GenSigInvalidValue" SG_ 825 RLS_AMBBrightness 0;
BA_ "GenSigSendType" SG_ 825 RLS_AMBBrightness 1;
BA_ "GenSigStartValue" SG_ 825 RLS_AMBBrightness 16382;
BA_ "GenSigTimeoutValue" SG_ 825 RLS_AMBBrightness 0;
BA_ "Remark" SG_ 825 RLS_AMBBrightness "";
BA_ "EventCommandSignal" SG_ 825 RLS_FWBrightness 0;
BA_ "GatewayedSignals" SG_ 825 RLS_FWBrightness 0;
BA_ "GenSigInactiveValue" SG_ 825 RLS_FWBrightness 0;
BA_ "GenSigInvalidValue" SG_ 825 RLS_FWBrightness 0;
BA_ "GenSigSendType" SG_ 825 RLS_FWBrightness 1;
BA_ "GenSigStartValue" SG_ 825 RLS_FWBrightness 16382;
BA_ "GenSigTimeoutValue" SG_ 825 RLS_FWBrightness 0;
BA_ "Remark" SG_ 825 RLS_FWBrightness "";
BA_ "EventCommandSignal" SG_ 825 RLS_RainfallLevel 0;
BA_ "GatewayedSignals" SG_ 825 RLS_RainfallLevel 0;
BA_ "GenSigInactiveValue" SG_ 825 RLS_RainfallLevel 0;
BA_ "GenSigInvalidValue" SG_ 825 RLS_RainfallLevel 0;
BA_ "GenSigSendType" SG_ 825 RLS_RainfallLevel 1;
BA_ "GenSigStartValue" SG_ 825 RLS_RainfallLevel 14;
BA_ "GenSigTimeoutValue" SG_ 825 RLS_RainfallLevel 0;
BA_ "Remark" SG_ 825 RLS_RainfallLevel "";
BA_ "EventCommandSignal" SG_ 825 RLS_RSErr 0;
BA_ "GatewayedSignals" SG_ 825 RLS_RSErr 0;
BA_ "GenSigInactiveValue" SG_ 825 RLS_RSErr 0;
BA_ "GenSigInvalidValue" SG_ 825 RLS_RSErr 0;
BA_ "GenSigSendType" SG_ 825 RLS_RSErr 1;
BA_ "GenSigStartValue" SG_ 825 RLS_RSErr 0;
BA_ "GenSigTimeoutValue" SG_ 825 RLS_RSErr 0;
BA_ "Remark" SG_ 825 RLS_RSErr "";
BA_ "EventCommandSignal" SG_ 825 RLS_LSErr 0;
BA_ "GatewayedSignals" SG_ 825 RLS_LSErr 0;
BA_ "GenSigInactiveValue" SG_ 825 RLS_LSErr 0;
BA_ "GenSigInvalidValue" SG_ 825 RLS_LSErr 0;
BA_ "GenSigSendType" SG_ 825 RLS_LSErr 1;
BA_ "GenSigStartValue" SG_ 825 RLS_LSErr 0;
BA_ "GenSigTimeoutValue" SG_ 825 RLS_LSErr 0;
BA_ "Remark" SG_ 825 RLS_LSErr "";
BA_ "EventCommandSignal" SG_ 825 PM_AUTHPstState 0;
BA_ "GatewayedSignals" SG_ 825 PM_AUTHPstState 0;
BA_ "GenSigInactiveValue" SG_ 825 PM_AUTHPstState 0;
BA_ "GenSigInvalidValue" SG_ 825 PM_AUTHPstState 0;
BA_ "GenSigSendType" SG_ 825 PM_AUTHPstState 1;
BA_ "GenSigStartValue" SG_ 825 PM_AUTHPstState 0;
BA_ "GenSigTimeoutValue" SG_ 825 PM_AUTHPstState 0;
BA_ "Remark" SG_ 825 PM_AUTHPstState "";
BA_ "EventCommandSignal" SG_ 825 CCU_FuncReq_SentryMod 0;
BA_ "GatewayedSignals" SG_ 825 CCU_FuncReq_SentryMod 0;
BA_ "GenSigInactiveValue" SG_ 825 CCU_FuncReq_SentryMod 0;
BA_ "GenSigInvalidValue" SG_ 825 CCU_FuncReq_SentryMod 0;
BA_ "GenSigSendType" SG_ 825 CCU_FuncReq_SentryMod 1;
BA_ "GenSigStartValue" SG_ 825 CCU_FuncReq_SentryMod 0;
BA_ "GenSigTimeoutValue" SG_ 825 CCU_FuncReq_SentryMod 0;
BA_ "Remark" SG_ 825 CCU_FuncReq_SentryMod "";
BA_ "EventCommandSignal" SG_ 825 RLS_WindShieldHum 0;
BA_ "GatewayedSignals" SG_ 825 RLS_WindShieldHum 0;
BA_ "GenSigInactiveValue" SG_ 825 RLS_WindShieldHum 0;
BA_ "GenSigInvalidValue" SG_ 825 RLS_WindShieldHum 0;
BA_ "GenSigSendType" SG_ 825 RLS_WindShieldHum 1;
BA_ "GenSigStartValue" SG_ 825 RLS_WindShieldHum 0;
BA_ "GenSigTimeoutValue" SG_ 825 RLS_WindShieldHum 0;
BA_ "Remark" SG_ 825 RLS_WindShieldHum "";
BA_ "EventCommandSignal" SG_ 825 RLS_WindShieldTem 0;
BA_ "GatewayedSignals" SG_ 825 RLS_WindShieldTem 0;
BA_ "GenSigInactiveValue" SG_ 825 RLS_WindShieldTem 0;
BA_ "GenSigInvalidValue" SG_ 825 RLS_WindShieldTem 0;
BA_ "GenSigSendType" SG_ 825 RLS_WindShieldTem 1;
BA_ "GenSigStartValue" SG_ 825 RLS_WindShieldTem 254;
BA_ "GenSigTimeoutValue" SG_ 825 RLS_WindShieldTem 0;
BA_ "Remark" SG_ 825 RLS_WindShieldTem "";
BA_ "EventCommandSignal" SG_ 825 RLS_DewPoint 0;
BA_ "GatewayedSignals" SG_ 825 RLS_DewPoint 0;
BA_ "GenSigInactiveValue" SG_ 825 RLS_DewPoint 0;
BA_ "GenSigInvalidValue" SG_ 825 RLS_DewPoint 0;
BA_ "GenSigSendType" SG_ 825 RLS_DewPoint 1;
BA_ "GenSigStartValue" SG_ 825 RLS_DewPoint 254;
BA_ "GenSigTimeoutValue" SG_ 825 RLS_DewPoint 0;
BA_ "Remark" SG_ 825 RLS_DewPoint "";
BA_ "EventCommandSignal" SG_ 825 CCU_ModeSuppressSts 0;
BA_ "GatewayedSignals" SG_ 825 CCU_ModeSuppressSts 0;
BA_ "GenSigInactiveValue" SG_ 825 CCU_ModeSuppressSts 0;
BA_ "GenSigInvalidValue" SG_ 825 CCU_ModeSuppressSts 0;
BA_ "GenSigSendType" SG_ 825 CCU_ModeSuppressSts 1;
BA_ "GenSigStartValue" SG_ 825 CCU_ModeSuppressSts 0;
BA_ "GenSigTimeoutValue" SG_ 825 CCU_ModeSuppressSts 0;
BA_ "Remark" SG_ 825 CCU_ModeSuppressSts "";
BA_ "EventCommandSignal" SG_ 825 RLS_HUTErr 0;
BA_ "GatewayedSignals" SG_ 825 RLS_HUTErr 0;
BA_ "GenSigInactiveValue" SG_ 825 RLS_HUTErr 0;
BA_ "GenSigInvalidValue" SG_ 825 RLS_HUTErr 0;
BA_ "GenSigSendType" SG_ 825 RLS_HUTErr 1;
BA_ "GenSigStartValue" SG_ 825 RLS_HUTErr 0;
BA_ "GenSigTimeoutValue" SG_ 825 RLS_HUTErr 0;
BA_ "Remark" SG_ 825 RLS_HUTErr "";
BA_ "EventCommandSignal" SG_ 291 CCU_6_CRC 0;
BA_ "GatewayedSignals" SG_ 291 CCU_6_CRC 0;
BA_ "GenSigInactiveValue" SG_ 291 CCU_6_CRC 0;
BA_ "GenSigInvalidValue" SG_ 291 CCU_6_CRC 0;
BA_ "GenSigSendType" SG_ 291 CCU_6_CRC 1;
BA_ "GenSigStartValue" SG_ 291 CCU_6_CRC 0;
BA_ "GenSigTimeoutValue" SG_ 291 CCU_6_CRC 0;
BA_ "Remark" SG_ 291 CCU_6_CRC "";
BA_ "EventCommandSignal" SG_ 291 CCU_6_Counter 0;
BA_ "GatewayedSignals" SG_ 291 CCU_6_Counter 0;
BA_ "GenSigInactiveValue" SG_ 291 CCU_6_Counter 0;
BA_ "GenSigInvalidValue" SG_ 291 CCU_6_Counter 0;
BA_ "GenSigSendType" SG_ 291 CCU_6_Counter 1;
BA_ "GenSigStartValue" SG_ 291 CCU_6_Counter 0;
BA_ "GenSigTimeoutValue" SG_ 291 CCU_6_Counter 0;
BA_ "Remark" SG_ 291 CCU_6_Counter "";
BA_ "EventCommandSignal" SG_ 291 ATWS_ATWSAlarmReq 0;
BA_ "GatewayedSignals" SG_ 291 ATWS_ATWSAlarmReq 0;
BA_ "GenSigInactiveValue" SG_ 291 ATWS_ATWSAlarmReq 0;
BA_ "GenSigInvalidValue" SG_ 291 ATWS_ATWSAlarmReq 0;
BA_ "GenSigSendType" SG_ 291 ATWS_ATWSAlarmReq 1;
BA_ "GenSigStartValue" SG_ 291 ATWS_ATWSAlarmReq 0;
BA_ "GenSigTimeoutValue" SG_ 291 ATWS_ATWSAlarmReq 0;
BA_ "Remark" SG_ 291 ATWS_ATWSAlarmReq "";
BA_ "EventCommandSignal" SG_ 291 ATWS_ATWSSt 0;
BA_ "GatewayedSignals" SG_ 291 ATWS_ATWSSt 0;
BA_ "GenSigInactiveValue" SG_ 291 ATWS_ATWSSt 0;
BA_ "GenSigInvalidValue" SG_ 291 ATWS_ATWSSt 0;
BA_ "GenSigSendType" SG_ 291 ATWS_ATWSSt 1;
BA_ "GenSigStartValue" SG_ 291 ATWS_ATWSSt 0;
BA_ "GenSigTimeoutValue" SG_ 291 ATWS_ATWSSt 0;
BA_ "Remark" SG_ 291 ATWS_ATWSSt "";
BA_ "EventCommandSignal" SG_ 291 WW_FrontWasherCmd 0;
BA_ "GatewayedSignals" SG_ 291 WW_FrontWasherCmd 0;
BA_ "GenSigInactiveValue" SG_ 291 WW_FrontWasherCmd 0;
BA_ "GenSigInvalidValue" SG_ 291 WW_FrontWasherCmd 0;
BA_ "GenSigSendType" SG_ 291 WW_FrontWasherCmd 1;
BA_ "GenSigStartValue" SG_ 291 WW_FrontWasherCmd 0;
BA_ "GenSigTimeoutValue" SG_ 291 WW_FrontWasherCmd 0;
BA_ "Remark" SG_ 291 WW_FrontWasherCmd "";
BA_ "EventCommandSignal" SG_ 291 WW_FrtWiperAutoAvl 0;
BA_ "GatewayedSignals" SG_ 291 WW_FrtWiperAutoAvl 0;
BA_ "GenSigInactiveValue" SG_ 291 WW_FrtWiperAutoAvl 0;
BA_ "GenSigInvalidValue" SG_ 291 WW_FrtWiperAutoAvl 0;
BA_ "GenSigSendType" SG_ 291 WW_FrtWiperAutoAvl 1;
BA_ "GenSigStartValue" SG_ 291 WW_FrtWiperAutoAvl 0;
BA_ "GenSigTimeoutValue" SG_ 291 WW_FrtWiperAutoAvl 0;
BA_ "Remark" SG_ 291 WW_FrtWiperAutoAvl "";
BA_ "EventCommandSignal" SG_ 291 WW_FrontWiperCmd_Speed 0;
BA_ "GatewayedSignals" SG_ 291 WW_FrontWiperCmd_Speed 0;
BA_ "GenSigInactiveValue" SG_ 291 WW_FrontWiperCmd_Speed 0;
BA_ "GenSigInvalidValue" SG_ 291 WW_FrontWiperCmd_Speed 0;
BA_ "GenSigSendType" SG_ 291 WW_FrontWiperCmd_Speed 1;
BA_ "GenSigStartValue" SG_ 291 WW_FrontWiperCmd_Speed 0;
BA_ "GenSigTimeoutValue" SG_ 291 WW_FrontWiperCmd_Speed 0;
BA_ "Remark" SG_ 291 WW_FrontWiperCmd_Speed "";
BA_ "EventCommandSignal" SG_ 291 WW_RearWiperCtrlSt 0;
BA_ "GatewayedSignals" SG_ 291 WW_RearWiperCtrlSt 0;
BA_ "GenSigInactiveValue" SG_ 291 WW_RearWiperCtrlSt 0;
BA_ "GenSigInvalidValue" SG_ 291 WW_RearWiperCtrlSt 0;
BA_ "GenSigSendType" SG_ 291 WW_RearWiperCtrlSt 1;
BA_ "GenSigStartValue" SG_ 291 WW_RearWiperCtrlSt 0;
BA_ "GenSigTimeoutValue" SG_ 291 WW_RearWiperCtrlSt 0;
BA_ "Remark" SG_ 291 WW_RearWiperCtrlSt "";
BA_ "EventCommandSignal" SG_ 291 WW_FrontWiperCtrlSt 0;
BA_ "GatewayedSignals" SG_ 291 WW_FrontWiperCtrlSt 0;
BA_ "GenSigInactiveValue" SG_ 291 WW_FrontWiperCtrlSt 0;
BA_ "GenSigInvalidValue" SG_ 291 WW_FrontWiperCtrlSt 0;
BA_ "GenSigSendType" SG_ 291 WW_FrontWiperCtrlSt 1;
BA_ "GenSigStartValue" SG_ 291 WW_FrontWiperCtrlSt 0;
BA_ "GenSigTimeoutValue" SG_ 291 WW_FrontWiperCtrlSt 0;
BA_ "Remark" SG_ 291 WW_FrontWiperCtrlSt "";
BA_ "EventCommandSignal" SG_ 291 WW_FrontWiperCtrlSrc 0;
BA_ "GatewayedSignals" SG_ 291 WW_FrontWiperCtrlSrc 0;
BA_ "GenSigInactiveValue" SG_ 291 WW_FrontWiperCtrlSrc 0;
BA_ "GenSigInvalidValue" SG_ 291 WW_FrontWiperCtrlSrc 0;
BA_ "GenSigSendType" SG_ 291 WW_FrontWiperCtrlSrc 1;
BA_ "GenSigStartValue" SG_ 291 WW_FrontWiperCtrlSrc 0;
BA_ "GenSigTimeoutValue" SG_ 291 WW_FrontWiperCtrlSrc 0;
BA_ "Remark" SG_ 291 WW_FrontWiperCtrlSrc "";
BA_ "EventCommandSignal" SG_ 291 WW_RearWiperCtrlSrc 0;
BA_ "GatewayedSignals" SG_ 291 WW_RearWiperCtrlSrc 0;
BA_ "GenSigInactiveValue" SG_ 291 WW_RearWiperCtrlSrc 0;
BA_ "GenSigInvalidValue" SG_ 291 WW_RearWiperCtrlSrc 0;
BA_ "GenSigSendType" SG_ 291 WW_RearWiperCtrlSrc 1;
BA_ "GenSigStartValue" SG_ 291 WW_RearWiperCtrlSrc 0;
BA_ "GenSigTimeoutValue" SG_ 291 WW_RearWiperCtrlSrc 0;
BA_ "Remark" SG_ 291 WW_RearWiperCtrlSrc "";
BA_ "EventCommandSignal" SG_ 291 WW_RearCamWasherVKResp 0;
BA_ "GatewayedSignals" SG_ 291 WW_RearCamWasherVKResp 0;
BA_ "GenSigInactiveValue" SG_ 291 WW_RearCamWasherVKResp 0;
BA_ "GenSigInvalidValue" SG_ 291 WW_RearCamWasherVKResp 3;
BA_ "GenSigSendType" SG_ 291 WW_RearCamWasherVKResp 1;
BA_ "GenSigStartValue" SG_ 291 WW_RearCamWasherVKResp 0;
BA_ "GenSigTimeoutValue" SG_ 291 WW_RearCamWasherVKResp 0;
BA_ "Remark" SG_ 291 WW_RearCamWasherVKResp "";
BA_ "EventCommandSignal" SG_ 291 WW_RearCamWasherVRResp 0;
BA_ "GatewayedSignals" SG_ 291 WW_RearCamWasherVRResp 0;
BA_ "GenSigInactiveValue" SG_ 291 WW_RearCamWasherVRResp 0;
BA_ "GenSigInvalidValue" SG_ 291 WW_RearCamWasherVRResp 3;
BA_ "GenSigSendType" SG_ 291 WW_RearCamWasherVRResp 1;
BA_ "GenSigStartValue" SG_ 291 WW_RearCamWasherVRResp 0;
BA_ "GenSigTimeoutValue" SG_ 291 WW_RearCamWasherVRResp 0;
BA_ "Remark" SG_ 291 WW_RearCamWasherVRResp "";
BA_ "EventCommandSignal" SG_ 291 CSM_RC_AuthSt 0;
BA_ "GatewayedSignals" SG_ 291 CSM_RC_AuthSt 0;
BA_ "GenSigInactiveValue" SG_ 291 CSM_RC_AuthSt 0;
BA_ "GenSigInvalidValue" SG_ 291 CSM_RC_AuthSt 0;
BA_ "GenSigSendType" SG_ 291 CSM_RC_AuthSt 1;
BA_ "GenSigStartValue" SG_ 291 CSM_RC_AuthSt 0;
BA_ "GenSigTimeoutValue" SG_ 291 CSM_RC_AuthSt 0;
BA_ "Remark" SG_ 291 CSM_RC_AuthSt "";
BA_ "EventCommandSignal" SG_ 865 EL_ReverseLightCtrlCmd 0;
BA_ "GatewayedSignals" SG_ 865 EL_ReverseLightCtrlCmd 0;
BA_ "GenSigInactiveValue" SG_ 865 EL_ReverseLightCtrlCmd 0;
BA_ "GenSigInvalidValue" SG_ 865 EL_ReverseLightCtrlCmd 0;
BA_ "GenSigSendType" SG_ 865 EL_ReverseLightCtrlCmd 1;
BA_ "GenSigStartValue" SG_ 865 EL_ReverseLightCtrlCmd 0;
BA_ "GenSigTimeoutValue" SG_ 865 EL_ReverseLightCtrlCmd 0;
BA_ "Remark" SG_ 865 EL_ReverseLightCtrlCmd "";
BA_ "EventCommandSignal" SG_ 865 EL_SideBrkLightCtrlCmd 0;
BA_ "GatewayedSignals" SG_ 865 EL_SideBrkLightCtrlCmd 0;
BA_ "GenSigInactiveValue" SG_ 865 EL_SideBrkLightCtrlCmd 0;
BA_ "GenSigInvalidValue" SG_ 865 EL_SideBrkLightCtrlCmd 0;
BA_ "GenSigSendType" SG_ 865 EL_SideBrkLightCtrlCmd 1;
BA_ "GenSigStartValue" SG_ 865 EL_SideBrkLightCtrlCmd 0;
BA_ "GenSigTimeoutValue" SG_ 865 EL_SideBrkLightCtrlCmd 0;
BA_ "Remark" SG_ 865 EL_SideBrkLightCtrlCmd "";
BA_ "EventCommandSignal" SG_ 865 EL_LeftLowBeamCtrlCmd 0;
BA_ "GatewayedSignals" SG_ 865 EL_LeftLowBeamCtrlCmd 0;
BA_ "GenSigInactiveValue" SG_ 865 EL_LeftLowBeamCtrlCmd 0;
BA_ "GenSigInvalidValue" SG_ 865 EL_LeftLowBeamCtrlCmd 0;
BA_ "GenSigSendType" SG_ 865 EL_LeftLowBeamCtrlCmd 1;
BA_ "GenSigStartValue" SG_ 865 EL_LeftLowBeamCtrlCmd 0;
BA_ "GenSigTimeoutValue" SG_ 865 EL_LeftLowBeamCtrlCmd 0;
BA_ "Remark" SG_ 865 EL_LeftLowBeamCtrlCmd "";
BA_ "EventCommandSignal" SG_ 865 EL_RightLowBeamCtrlCmd 0;
BA_ "GatewayedSignals" SG_ 865 EL_RightLowBeamCtrlCmd 0;
BA_ "GenSigInactiveValue" SG_ 865 EL_RightLowBeamCtrlCmd 0;
BA_ "GenSigInvalidValue" SG_ 865 EL_RightLowBeamCtrlCmd 0;
BA_ "GenSigSendType" SG_ 865 EL_RightLowBeamCtrlCmd 1;
BA_ "GenSigStartValue" SG_ 865 EL_RightLowBeamCtrlCmd 0;
BA_ "GenSigTimeoutValue" SG_ 865 EL_RightLowBeamCtrlCmd 0;
BA_ "Remark" SG_ 865 EL_RightLowBeamCtrlCmd "";
BA_ "EventCommandSignal" SG_ 865 EL_PositionLightCtrlSource 0;
BA_ "GatewayedSignals" SG_ 865 EL_PositionLightCtrlSource 0;
BA_ "GenSigInactiveValue" SG_ 865 EL_PositionLightCtrlSource 0;
BA_ "GenSigInvalidValue" SG_ 865 EL_PositionLightCtrlSource 0;
BA_ "GenSigSendType" SG_ 865 EL_PositionLightCtrlSource 1;
BA_ "GenSigStartValue" SG_ 865 EL_PositionLightCtrlSource 0;
BA_ "GenSigTimeoutValue" SG_ 865 EL_PositionLightCtrlSource 0;
BA_ "Remark" SG_ 865 EL_PositionLightCtrlSource "";
BA_ "EventCommandSignal" SG_ 865 EL_LeftHighBeamCtrlCmd 0;
BA_ "GatewayedSignals" SG_ 865 EL_LeftHighBeamCtrlCmd 0;
BA_ "GenSigInactiveValue" SG_ 865 EL_LeftHighBeamCtrlCmd 0;
BA_ "GenSigInvalidValue" SG_ 865 EL_LeftHighBeamCtrlCmd 0;
BA_ "GenSigSendType" SG_ 865 EL_LeftHighBeamCtrlCmd 1;
BA_ "GenSigStartValue" SG_ 865 EL_LeftHighBeamCtrlCmd 0;
BA_ "GenSigTimeoutValue" SG_ 865 EL_LeftHighBeamCtrlCmd 0;
BA_ "Remark" SG_ 865 EL_LeftHighBeamCtrlCmd "";
BA_ "EventCommandSignal" SG_ 865 EL_RightHighBeamCtrlCmd 0;
BA_ "GatewayedSignals" SG_ 865 EL_RightHighBeamCtrlCmd 0;
BA_ "GenSigInactiveValue" SG_ 865 EL_RightHighBeamCtrlCmd 0;
BA_ "GenSigInvalidValue" SG_ 865 EL_RightHighBeamCtrlCmd 0;
BA_ "GenSigSendType" SG_ 865 EL_RightHighBeamCtrlCmd 1;
BA_ "GenSigStartValue" SG_ 865 EL_RightHighBeamCtrlCmd 0;
BA_ "GenSigTimeoutValue" SG_ 865 EL_RightHighBeamCtrlCmd 0;
BA_ "Remark" SG_ 865 EL_RightHighBeamCtrlCmd "";
BA_ "EventCommandSignal" SG_ 865 EL_LowBeamCtrlSource 0;
BA_ "GatewayedSignals" SG_ 865 EL_LowBeamCtrlSource 0;
BA_ "GenSigInactiveValue" SG_ 865 EL_LowBeamCtrlSource 0;
BA_ "GenSigInvalidValue" SG_ 865 EL_LowBeamCtrlSource 0;
BA_ "GenSigSendType" SG_ 865 EL_LowBeamCtrlSource 1;
BA_ "GenSigStartValue" SG_ 865 EL_LowBeamCtrlSource 0;
BA_ "GenSigTimeoutValue" SG_ 865 EL_LowBeamCtrlSource 0;
BA_ "Remark" SG_ 865 EL_LowBeamCtrlSource "";
BA_ "EventCommandSignal" SG_ 865 EL_RearFogLightCtrlSource 0;
BA_ "GatewayedSignals" SG_ 865 EL_RearFogLightCtrlSource 0;
BA_ "GenSigInactiveValue" SG_ 865 EL_RearFogLightCtrlSource 0;
BA_ "GenSigInvalidValue" SG_ 865 EL_RearFogLightCtrlSource 0;
BA_ "GenSigSendType" SG_ 865 EL_RearFogLightCtrlSource 1;
BA_ "GenSigStartValue" SG_ 865 EL_RearFogLightCtrlSource 0;
BA_ "GenSigTimeoutValue" SG_ 865 EL_RearFogLightCtrlSource 0;
BA_ "Remark" SG_ 865 EL_RearFogLightCtrlSource "";
BA_ "EventCommandSignal" SG_ 865 EL_HighBeamCtrlSource 0;
BA_ "GatewayedSignals" SG_ 865 EL_HighBeamCtrlSource 0;
BA_ "GenSigInactiveValue" SG_ 865 EL_HighBeamCtrlSource 0;
BA_ "GenSigInvalidValue" SG_ 865 EL_HighBeamCtrlSource 0;
BA_ "GenSigSendType" SG_ 865 EL_HighBeamCtrlSource 1;
BA_ "GenSigStartValue" SG_ 865 EL_HighBeamCtrlSource 0;
BA_ "GenSigTimeoutValue" SG_ 865 EL_HighBeamCtrlSource 0;
BA_ "Remark" SG_ 865 EL_HighBeamCtrlSource "";
BA_ "EventCommandSignal" SG_ 865 EL_FrontFogLightCtrlSource 0;
BA_ "GatewayedSignals" SG_ 865 EL_FrontFogLightCtrlSource 0;
BA_ "GenSigInactiveValue" SG_ 865 EL_FrontFogLightCtrlSource 0;
BA_ "GenSigInvalidValue" SG_ 865 EL_FrontFogLightCtrlSource 0;
BA_ "GenSigSendType" SG_ 865 EL_FrontFogLightCtrlSource 1;
BA_ "GenSigStartValue" SG_ 865 EL_FrontFogLightCtrlSource 0;
BA_ "GenSigTimeoutValue" SG_ 865 EL_FrontFogLightCtrlSource 0;
BA_ "Remark" SG_ 865 EL_FrontFogLightCtrlSource "";
BA_ "EventCommandSignal" SG_ 865 EL_LicencePlateLightCtrlSource 0;
BA_ "GatewayedSignals" SG_ 865 EL_LicencePlateLightCtrlSource 0;
BA_ "GenSigInactiveValue" SG_ 865 EL_LicencePlateLightCtrlSource 0;
BA_ "GenSigInvalidValue" SG_ 865 EL_LicencePlateLightCtrlSource 0;
BA_ "GenSigSendType" SG_ 865 EL_LicencePlateLightCtrlSource 1;
BA_ "GenSigStartValue" SG_ 865 EL_LicencePlateLightCtrlSource 0;
BA_ "GenSigTimeoutValue" SG_ 865 EL_LicencePlateLightCtrlSource 0;
BA_ "Remark" SG_ 865 EL_LicencePlateLightCtrlSource "";
BA_ "EventCommandSignal" SG_ 865 EL_FlasherCtrlSource 0;
BA_ "GatewayedSignals" SG_ 865 EL_FlasherCtrlSource 0;
BA_ "GenSigInactiveValue" SG_ 865 EL_FlasherCtrlSource 0;
BA_ "GenSigInvalidValue" SG_ 865 EL_FlasherCtrlSource 0;
BA_ "GenSigSendType" SG_ 865 EL_FlasherCtrlSource 1;
BA_ "GenSigStartValue" SG_ 865 EL_FlasherCtrlSource 0;
BA_ "GenSigTimeoutValue" SG_ 865 EL_FlasherCtrlSource 0;
BA_ "Remark" SG_ 865 EL_FlasherCtrlSource "";
BA_ "EventCommandSignal" SG_ 865 EL_FADASLightCtrlCmd 0;
BA_ "GatewayedSignals" SG_ 865 EL_FADASLightCtrlCmd 0;
BA_ "GenSigInactiveValue" SG_ 865 EL_FADASLightCtrlCmd 0;
BA_ "GenSigInvalidValue" SG_ 865 EL_FADASLightCtrlCmd 0;
BA_ "GenSigSendType" SG_ 865 EL_FADASLightCtrlCmd 1;
BA_ "GenSigStartValue" SG_ 865 EL_FADASLightCtrlCmd 0;
BA_ "GenSigTimeoutValue" SG_ 865 EL_FADASLightCtrlCmd 0;
BA_ "Remark" SG_ 865 EL_FADASLightCtrlCmd "";
BA_ "EventCommandSignal" SG_ 865 EL_RADASLightCtrlCmd 0;
BA_ "GatewayedSignals" SG_ 865 EL_RADASLightCtrlCmd 0;
BA_ "GenSigInactiveValue" SG_ 865 EL_RADASLightCtrlCmd 0;
BA_ "GenSigInvalidValue" SG_ 865 EL_RADASLightCtrlCmd 0;
BA_ "GenSigSendType" SG_ 865 EL_RADASLightCtrlCmd 1;
BA_ "GenSigStartValue" SG_ 865 EL_RADASLightCtrlCmd 0;
BA_ "GenSigTimeoutValue" SG_ 865 EL_RADASLightCtrlCmd 0;
BA_ "Remark" SG_ 865 EL_RADASLightCtrlCmd "";
BA_ "EventCommandSignal" SG_ 865 EL_IHBColourSt 0;
BA_ "GatewayedSignals" SG_ 865 EL_IHBColourSt 0;
BA_ "GenSigInactiveValue" SG_ 865 EL_IHBColourSt 0;
BA_ "GenSigInvalidValue" SG_ 865 EL_IHBColourSt 0;
BA_ "GenSigSendType" SG_ 865 EL_IHBColourSt 1;
BA_ "GenSigStartValue" SG_ 865 EL_IHBColourSt 0;
BA_ "GenSigTimeoutValue" SG_ 865 EL_IHBColourSt 0;
BA_ "Remark" SG_ 865 EL_IHBColourSt "";
BA_ "EventCommandSignal" SG_ 865 EL_AutoHighBeamCtrlSt 0;
BA_ "GatewayedSignals" SG_ 865 EL_AutoHighBeamCtrlSt 0;
BA_ "GenSigInactiveValue" SG_ 865 EL_AutoHighBeamCtrlSt 0;
BA_ "GenSigInvalidValue" SG_ 865 EL_AutoHighBeamCtrlSt 0;
BA_ "GenSigSendType" SG_ 865 EL_AutoHighBeamCtrlSt 1;
BA_ "GenSigStartValue" SG_ 865 EL_AutoHighBeamCtrlSt 0;
BA_ "GenSigTimeoutValue" SG_ 865 EL_AutoHighBeamCtrlSt 0;
BA_ "Remark" SG_ 865 EL_AutoHighBeamCtrlSt "";
BA_ "EventCommandSignal" SG_ 865 EL_ADBEnable 0;
BA_ "GatewayedSignals" SG_ 865 EL_ADBEnable 0;
BA_ "GenSigInactiveValue" SG_ 865 EL_ADBEnable 0;
BA_ "GenSigInvalidValue" SG_ 865 EL_ADBEnable 0;
BA_ "GenSigSendType" SG_ 865 EL_ADBEnable 1;
BA_ "GenSigStartValue" SG_ 865 EL_ADBEnable 1;
BA_ "GenSigTimeoutValue" SG_ 865 EL_ADBEnable 0;
BA_ "Remark" SG_ 865 EL_ADBEnable "";
BA_ "EventCommandSignal" SG_ 865 EL_ADC_2_VERFailFlag 0;
BA_ "GatewayedSignals" SG_ 865 EL_ADC_2_VERFailFlag 0;
BA_ "GenSigInactiveValue" SG_ 865 EL_ADC_2_VERFailFlag 0;
BA_ "GenSigInvalidValue" SG_ 865 EL_ADC_2_VERFailFlag 0;
BA_ "GenSigSendType" SG_ 865 EL_ADC_2_VERFailFlag 1;
BA_ "GenSigStartValue" SG_ 865 EL_ADC_2_VERFailFlag 0;
BA_ "GenSigTimeoutValue" SG_ 865 EL_ADC_2_VERFailFlag 0;
BA_ "Remark" SG_ 865 EL_ADC_2_VERFailFlag "";
BA_ "EventCommandSignal" SG_ 865 EL_ADC_4_New_VERFailFlag 0;
BA_ "GatewayedSignals" SG_ 865 EL_ADC_4_New_VERFailFlag 0;
BA_ "GenSigInactiveValue" SG_ 865 EL_ADC_4_New_VERFailFlag 0;
BA_ "GenSigInvalidValue" SG_ 865 EL_ADC_4_New_VERFailFlag 0;
BA_ "GenSigSendType" SG_ 865 EL_ADC_4_New_VERFailFlag 1;
BA_ "GenSigStartValue" SG_ 865 EL_ADC_4_New_VERFailFlag 0;
BA_ "GenSigTimeoutValue" SG_ 865 EL_ADC_4_New_VERFailFlag 0;
BA_ "Remark" SG_ 865 EL_ADC_4_New_VERFailFlag "";
BA_ "EventCommandSignal" SG_ 865 EL_ADC_8_VERFailFlag 0;
BA_ "GatewayedSignals" SG_ 865 EL_ADC_8_VERFailFlag 0;
BA_ "GenSigInactiveValue" SG_ 865 EL_ADC_8_VERFailFlag 0;
BA_ "GenSigInvalidValue" SG_ 865 EL_ADC_8_VERFailFlag 0;
BA_ "GenSigSendType" SG_ 865 EL_ADC_8_VERFailFlag 1;
BA_ "GenSigStartValue" SG_ 865 EL_ADC_8_VERFailFlag 0;
BA_ "GenSigTimeoutValue" SG_ 865 EL_ADC_8_VERFailFlag 0;
BA_ "Remark" SG_ 865 EL_ADC_8_VERFailFlag "";
BA_ "EventCommandSignal" SG_ 865 EL_HeadLightLevelingSWSt 0;
BA_ "GatewayedSignals" SG_ 865 EL_HeadLightLevelingSWSt 0;
BA_ "GenSigInactiveValue" SG_ 865 EL_HeadLightLevelingSWSt 0;
BA_ "GenSigInvalidValue" SG_ 865 EL_HeadLightLevelingSWSt 0;
BA_ "GenSigSendType" SG_ 865 EL_HeadLightLevelingSWSt 1;
BA_ "GenSigStartValue" SG_ 865 EL_HeadLightLevelingSWSt 0;
BA_ "GenSigTimeoutValue" SG_ 865 EL_HeadLightLevelingSWSt 0;
BA_ "Remark" SG_ 865 EL_HeadLightLevelingSWSt "";
BA_ "EventCommandSignal" SG_ 865 EL_LeftTurnLightStForDisp 0;
BA_ "GatewayedSignals" SG_ 865 EL_LeftTurnLightStForDisp 0;
BA_ "GenSigInactiveValue" SG_ 865 EL_LeftTurnLightStForDisp 0;
BA_ "GenSigInvalidValue" SG_ 865 EL_LeftTurnLightStForDisp 0;
BA_ "GenSigSendType" SG_ 865 EL_LeftTurnLightStForDisp 1;
BA_ "GenSigStartValue" SG_ 865 EL_LeftTurnLightStForDisp 0;
BA_ "GenSigTimeoutValue" SG_ 865 EL_LeftTurnLightStForDisp 0;
BA_ "Remark" SG_ 865 EL_LeftTurnLightStForDisp "";
BA_ "EventCommandSignal" SG_ 865 EL_RightTurnLightStForDisp 0;
BA_ "GatewayedSignals" SG_ 865 EL_RightTurnLightStForDisp 0;
BA_ "GenSigInactiveValue" SG_ 865 EL_RightTurnLightStForDisp 0;
BA_ "GenSigInvalidValue" SG_ 865 EL_RightTurnLightStForDisp 0;
BA_ "GenSigSendType" SG_ 865 EL_RightTurnLightStForDisp 1;
BA_ "GenSigStartValue" SG_ 865 EL_RightTurnLightStForDisp 0;
BA_ "GenSigTimeoutValue" SG_ 865 EL_RightTurnLightStForDisp 0;
BA_ "Remark" SG_ 865 EL_RightTurnLightStForDisp "";
BA_ "EventCommandSignal" SG_ 865 EL_PositionLightStForDisp 0;
BA_ "GatewayedSignals" SG_ 865 EL_PositionLightStForDisp 0;
BA_ "GenSigInactiveValue" SG_ 865 EL_PositionLightStForDisp 0;
BA_ "GenSigInvalidValue" SG_ 865 EL_PositionLightStForDisp 0;
BA_ "GenSigSendType" SG_ 865 EL_PositionLightStForDisp 1;
BA_ "GenSigStartValue" SG_ 865 EL_PositionLightStForDisp 0;
BA_ "GenSigTimeoutValue" SG_ 865 EL_PositionLightStForDisp 0;
BA_ "Remark" SG_ 865 EL_PositionLightStForDisp "";
BA_ "EventCommandSignal" SG_ 865 EL_FrontFogLightStForDisp 0;
BA_ "GatewayedSignals" SG_ 865 EL_FrontFogLightStForDisp 0;
BA_ "GenSigInactiveValue" SG_ 865 EL_FrontFogLightStForDisp 0;
BA_ "GenSigInvalidValue" SG_ 865 EL_FrontFogLightStForDisp 0;
BA_ "GenSigSendType" SG_ 865 EL_FrontFogLightStForDisp 1;
BA_ "GenSigStartValue" SG_ 865 EL_FrontFogLightStForDisp 0;
BA_ "GenSigTimeoutValue" SG_ 865 EL_FrontFogLightStForDisp 0;
BA_ "Remark" SG_ 865 EL_FrontFogLightStForDisp "";
BA_ "EventCommandSignal" SG_ 865 EL_RearFogLightStForDisp 0;
BA_ "GatewayedSignals" SG_ 865 EL_RearFogLightStForDisp 0;
BA_ "GenSigInactiveValue" SG_ 865 EL_RearFogLightStForDisp 0;
BA_ "GenSigInvalidValue" SG_ 865 EL_RearFogLightStForDisp 0;
BA_ "GenSigSendType" SG_ 865 EL_RearFogLightStForDisp 1;
BA_ "GenSigStartValue" SG_ 865 EL_RearFogLightStForDisp 0;
BA_ "GenSigTimeoutValue" SG_ 865 EL_RearFogLightStForDisp 0;
BA_ "Remark" SG_ 865 EL_RearFogLightStForDisp "";
BA_ "EventCommandSignal" SG_ 865 EL_LowBeamStForDisp 0;
BA_ "GatewayedSignals" SG_ 865 EL_LowBeamStForDisp 0;
BA_ "GenSigInactiveValue" SG_ 865 EL_LowBeamStForDisp 0;
BA_ "GenSigInvalidValue" SG_ 865 EL_LowBeamStForDisp 0;
BA_ "GenSigSendType" SG_ 865 EL_LowBeamStForDisp 1;
BA_ "GenSigStartValue" SG_ 865 EL_LowBeamStForDisp 0;
BA_ "GenSigTimeoutValue" SG_ 865 EL_LowBeamStForDisp 0;
BA_ "Remark" SG_ 865 EL_LowBeamStForDisp "";
BA_ "EventCommandSignal" SG_ 865 EL_HighBeamStForDisp 0;
BA_ "GatewayedSignals" SG_ 865 EL_HighBeamStForDisp 0;
BA_ "GenSigInactiveValue" SG_ 865 EL_HighBeamStForDisp 0;
BA_ "GenSigInvalidValue" SG_ 865 EL_HighBeamStForDisp 0;
BA_ "GenSigSendType" SG_ 865 EL_HighBeamStForDisp 1;
BA_ "GenSigStartValue" SG_ 865 EL_HighBeamStForDisp 0;
BA_ "GenSigTimeoutValue" SG_ 865 EL_HighBeamStForDisp 0;
BA_ "Remark" SG_ 865 EL_HighBeamStForDisp "";
BA_ "EventCommandSignal" SG_ 865 EL_HeadLightSWSt 0;
BA_ "GatewayedSignals" SG_ 865 EL_HeadLightSWSt 0;
BA_ "GenSigInactiveValue" SG_ 865 EL_HeadLightSWSt 0;
BA_ "GenSigInvalidValue" SG_ 865 EL_HeadLightSWSt 0;
BA_ "GenSigSendType" SG_ 865 EL_HeadLightSWSt 1;
BA_ "GenSigStartValue" SG_ 865 EL_HeadLightSWSt 0;
BA_ "GenSigTimeoutValue" SG_ 865 EL_HeadLightSWSt 0;
BA_ "Remark" SG_ 865 EL_HeadLightSWSt "";
BA_ "EventCommandSignal" SG_ 293 TPMS_FrontLeftTireBlowout 1;
BA_ "GatewayedSignals" SG_ 293 TPMS_FrontLeftTireBlowout 0;
BA_ "GenSigInactiveValue" SG_ 293 TPMS_FrontLeftTireBlowout 0;
BA_ "GenSigInvalidValue" SG_ 293 TPMS_FrontLeftTireBlowout 0;
BA_ "GenSigSendType" SG_ 293 TPMS_FrontLeftTireBlowout 0;
BA_ "GenSigStartValue" SG_ 293 TPMS_FrontLeftTireBlowout 0;
BA_ "GenSigTimeoutValue" SG_ 293 TPMS_FrontLeftTireBlowout 0;
BA_ "Remark" SG_ 293 TPMS_FrontLeftTireBlowout "";
BA_ "EventCommandSignal" SG_ 293 TPMS_FrontRightTireBlowout 1;
BA_ "GatewayedSignals" SG_ 293 TPMS_FrontRightTireBlowout 0;
BA_ "GenSigInactiveValue" SG_ 293 TPMS_FrontRightTireBlowout 0;
BA_ "GenSigInvalidValue" SG_ 293 TPMS_FrontRightTireBlowout 0;
BA_ "GenSigSendType" SG_ 293 TPMS_FrontRightTireBlowout 0;
BA_ "GenSigStartValue" SG_ 293 TPMS_FrontRightTireBlowout 0;
BA_ "GenSigTimeoutValue" SG_ 293 TPMS_FrontRightTireBlowout 0;
BA_ "Remark" SG_ 293 TPMS_FrontRightTireBlowout "";
BA_ "EventCommandSignal" SG_ 293 TPMS_RearRightTireBlowout 1;
BA_ "GatewayedSignals" SG_ 293 TPMS_RearRightTireBlowout 0;
BA_ "GenSigInactiveValue" SG_ 293 TPMS_RearRightTireBlowout 0;
BA_ "GenSigInvalidValue" SG_ 293 TPMS_RearRightTireBlowout 0;
BA_ "GenSigSendType" SG_ 293 TPMS_RearRightTireBlowout 0;
BA_ "GenSigStartValue" SG_ 293 TPMS_RearRightTireBlowout 0;
BA_ "GenSigTimeoutValue" SG_ 293 TPMS_RearRightTireBlowout 0;
BA_ "Remark" SG_ 293 TPMS_RearRightTireBlowout "";
BA_ "EventCommandSignal" SG_ 293 TPMS_RearLeftTireBlowout 1;
BA_ "GatewayedSignals" SG_ 293 TPMS_RearLeftTireBlowout 0;
BA_ "GenSigInactiveValue" SG_ 293 TPMS_RearLeftTireBlowout 0;
BA_ "GenSigInvalidValue" SG_ 293 TPMS_RearLeftTireBlowout 0;
BA_ "GenSigSendType" SG_ 293 TPMS_RearLeftTireBlowout 0;
BA_ "GenSigStartValue" SG_ 293 TPMS_RearLeftTireBlowout 0;
BA_ "GenSigTimeoutValue" SG_ 293 TPMS_RearLeftTireBlowout 0;
BA_ "Remark" SG_ 293 TPMS_RearLeftTireBlowout "";
BA_ "EventCommandSignal" SG_ 293 TPMS_FrontLeftTirePressure 0;
BA_ "GatewayedSignals" SG_ 293 TPMS_FrontLeftTirePressure 0;
BA_ "GenSigInactiveValue" SG_ 293 TPMS_FrontLeftTirePressure 0;
BA_ "GenSigInvalidValue" SG_ 293 TPMS_FrontLeftTirePressure 0;
BA_ "GenSigSendType" SG_ 293 TPMS_FrontLeftTirePressure 1;
BA_ "GenSigStartValue" SG_ 293 TPMS_FrontLeftTirePressure 255;
BA_ "GenSigTimeoutValue" SG_ 293 TPMS_FrontLeftTirePressure 255;
BA_ "Remark" SG_ 293 TPMS_FrontLeftTirePressure "";
BA_ "EventCommandSignal" SG_ 293 TPMS_FrontRightTirePressure 0;
BA_ "GatewayedSignals" SG_ 293 TPMS_FrontRightTirePressure 0;
BA_ "GenSigInactiveValue" SG_ 293 TPMS_FrontRightTirePressure 0;
BA_ "GenSigInvalidValue" SG_ 293 TPMS_FrontRightTirePressure 0;
BA_ "GenSigSendType" SG_ 293 TPMS_FrontRightTirePressure 1;
BA_ "GenSigStartValue" SG_ 293 TPMS_FrontRightTirePressure 255;
BA_ "GenSigTimeoutValue" SG_ 293 TPMS_FrontRightTirePressure 255;
BA_ "Remark" SG_ 293 TPMS_FrontRightTirePressure "";
BA_ "EventCommandSignal" SG_ 293 TPMS_RearRightTirePressure 0;
BA_ "GatewayedSignals" SG_ 293 TPMS_RearRightTirePressure 0;
BA_ "GenSigInactiveValue" SG_ 293 TPMS_RearRightTirePressure 0;
BA_ "GenSigInvalidValue" SG_ 293 TPMS_RearRightTirePressure 0;
BA_ "GenSigSendType" SG_ 293 TPMS_RearRightTirePressure 1;
BA_ "GenSigStartValue" SG_ 293 TPMS_RearRightTirePressure 255;
BA_ "GenSigTimeoutValue" SG_ 293 TPMS_RearRightTirePressure 255;
BA_ "Remark" SG_ 293 TPMS_RearRightTirePressure "";
BA_ "EventCommandSignal" SG_ 293 TPMS_RearLeftTirePressure 0;
BA_ "GatewayedSignals" SG_ 293 TPMS_RearLeftTirePressure 0;
BA_ "GenSigInactiveValue" SG_ 293 TPMS_RearLeftTirePressure 0;
BA_ "GenSigInvalidValue" SG_ 293 TPMS_RearLeftTirePressure 0;
BA_ "GenSigSendType" SG_ 293 TPMS_RearLeftTirePressure 1;
BA_ "GenSigStartValue" SG_ 293 TPMS_RearLeftTirePressure 255;
BA_ "GenSigTimeoutValue" SG_ 293 TPMS_RearLeftTirePressure 255;
BA_ "Remark" SG_ 293 TPMS_RearLeftTirePressure "";
BA_ "EventCommandSignal" SG_ 293 TPMS_TireWarningLamp 1;
BA_ "GatewayedSignals" SG_ 293 TPMS_TireWarningLamp 0;
BA_ "GenSigInactiveValue" SG_ 293 TPMS_TireWarningLamp 0;
BA_ "GenSigInvalidValue" SG_ 293 TPMS_TireWarningLamp 0;
BA_ "GenSigSendType" SG_ 293 TPMS_TireWarningLamp 0;
BA_ "GenSigStartValue" SG_ 293 TPMS_TireWarningLamp 0;
BA_ "GenSigTimeoutValue" SG_ 293 TPMS_TireWarningLamp 0;
BA_ "Remark" SG_ 293 TPMS_TireWarningLamp "";
BA_ "EventCommandSignal" SG_ 293 TPMS_SystemWarningLamp 1;
BA_ "GatewayedSignals" SG_ 293 TPMS_SystemWarningLamp 0;
BA_ "GenSigInactiveValue" SG_ 293 TPMS_SystemWarningLamp 0;
BA_ "GenSigInvalidValue" SG_ 293 TPMS_SystemWarningLamp 0;
BA_ "GenSigSendType" SG_ 293 TPMS_SystemWarningLamp 0;
BA_ "GenSigStartValue" SG_ 293 TPMS_SystemWarningLamp 0;
BA_ "GenSigTimeoutValue" SG_ 293 TPMS_SystemWarningLamp 0;
BA_ "Remark" SG_ 293 TPMS_SystemWarningLamp "";
BA_ "EventCommandSignal" SG_ 294 LCK_DriverDoorAjarSt 1;
BA_ "GatewayedSignals" SG_ 294 LCK_DriverDoorAjarSt 0;
BA_ "GenSigInactiveValue" SG_ 294 LCK_DriverDoorAjarSt 0;
BA_ "GenSigInvalidValue" SG_ 294 LCK_DriverDoorAjarSt 0;
BA_ "GenSigSendType" SG_ 294 LCK_DriverDoorAjarSt 0;
BA_ "GenSigStartValue" SG_ 294 LCK_DriverDoorAjarSt 0;
BA_ "GenSigTimeoutValue" SG_ 294 LCK_DriverDoorAjarSt 0;
BA_ "Remark" SG_ 294 LCK_DriverDoorAjarSt "";
BA_ "EventCommandSignal" SG_ 294 LCK_PassengerDoorAjarSt 1;
BA_ "GatewayedSignals" SG_ 294 LCK_PassengerDoorAjarSt 0;
BA_ "GenSigInactiveValue" SG_ 294 LCK_PassengerDoorAjarSt 0;
BA_ "GenSigInvalidValue" SG_ 294 LCK_PassengerDoorAjarSt 0;
BA_ "GenSigSendType" SG_ 294 LCK_PassengerDoorAjarSt 0;
BA_ "GenSigStartValue" SG_ 294 LCK_PassengerDoorAjarSt 0;
BA_ "GenSigTimeoutValue" SG_ 294 LCK_PassengerDoorAjarSt 0;
BA_ "Remark" SG_ 294 LCK_PassengerDoorAjarSt "";
BA_ "EventCommandSignal" SG_ 294 LCK_DriverDoorLockSt 1;
BA_ "GatewayedSignals" SG_ 294 LCK_DriverDoorLockSt 0;
BA_ "GenSigInactiveValue" SG_ 294 LCK_DriverDoorLockSt 0;
BA_ "GenSigInvalidValue" SG_ 294 LCK_DriverDoorLockSt 0;
BA_ "GenSigSendType" SG_ 294 LCK_DriverDoorLockSt 0;
BA_ "GenSigStartValue" SG_ 294 LCK_DriverDoorLockSt 0;
BA_ "GenSigTimeoutValue" SG_ 294 LCK_DriverDoorLockSt 0;
BA_ "Remark" SG_ 294 LCK_DriverDoorLockSt "";
BA_ "EventCommandSignal" SG_ 294 LCK_PassengerDoorLockSt 1;
BA_ "GatewayedSignals" SG_ 294 LCK_PassengerDoorLockSt 0;
BA_ "GenSigInactiveValue" SG_ 294 LCK_PassengerDoorLockSt 0;
BA_ "GenSigInvalidValue" SG_ 294 LCK_PassengerDoorLockSt 0;
BA_ "GenSigSendType" SG_ 294 LCK_PassengerDoorLockSt 0;
BA_ "GenSigStartValue" SG_ 294 LCK_PassengerDoorLockSt 0;
BA_ "GenSigTimeoutValue" SG_ 294 LCK_PassengerDoorLockSt 0;
BA_ "Remark" SG_ 294 LCK_PassengerDoorLockSt "";
BA_ "EventCommandSignal" SG_ 294 LCK_VehicleDoorAjarSt 1;
BA_ "GatewayedSignals" SG_ 294 LCK_VehicleDoorAjarSt 0;
BA_ "GenSigInactiveValue" SG_ 294 LCK_VehicleDoorAjarSt 0;
BA_ "GenSigInvalidValue" SG_ 294 LCK_VehicleDoorAjarSt 0;
BA_ "GenSigSendType" SG_ 294 LCK_VehicleDoorAjarSt 0;
BA_ "GenSigStartValue" SG_ 294 LCK_VehicleDoorAjarSt 0;
BA_ "GenSigTimeoutValue" SG_ 294 LCK_VehicleDoorAjarSt 0;
BA_ "Remark" SG_ 294 LCK_VehicleDoorAjarSt "";
BA_ "EventCommandSignal" SG_ 294 LCK_VehicleDoorLockSt 1;
BA_ "GatewayedSignals" SG_ 294 LCK_VehicleDoorLockSt 0;
BA_ "GenSigInactiveValue" SG_ 294 LCK_VehicleDoorLockSt 0;
BA_ "GenSigInvalidValue" SG_ 294 LCK_VehicleDoorLockSt 0;
BA_ "GenSigSendType" SG_ 294 LCK_VehicleDoorLockSt 0;
BA_ "GenSigStartValue" SG_ 294 LCK_VehicleDoorLockSt 0;
BA_ "GenSigTimeoutValue" SG_ 294 LCK_VehicleDoorLockSt 0;
BA_ "Remark" SG_ 294 LCK_VehicleDoorLockSt "";
BA_ "EventCommandSignal" SG_ 294 LCK_VehicleChildSaftyLockSt 1;
BA_ "GatewayedSignals" SG_ 294 LCK_VehicleChildSaftyLockSt 0;
BA_ "GenSigInactiveValue" SG_ 294 LCK_VehicleChildSaftyLockSt 0;
BA_ "GenSigInvalidValue" SG_ 294 LCK_VehicleChildSaftyLockSt 0;
BA_ "GenSigSendType" SG_ 294 LCK_VehicleChildSaftyLockSt 0;
BA_ "GenSigStartValue" SG_ 294 LCK_VehicleChildSaftyLockSt 0;
BA_ "GenSigTimeoutValue" SG_ 294 LCK_VehicleChildSaftyLockSt 0;
BA_ "Remark" SG_ 294 LCK_VehicleChildSaftyLockSt "";
BA_ "EventCommandSignal" SG_ 294 LCK_VehicleChildSaftyLockedIndicate 1;
BA_ "GatewayedSignals" SG_ 294 LCK_VehicleChildSaftyLockedIndicate 0;
BA_ "GenSigInactiveValue" SG_ 294 LCK_VehicleChildSaftyLockedIndicate 0;
BA_ "GenSigInvalidValue" SG_ 294 LCK_VehicleChildSaftyLockedIndicate 0;
BA_ "GenSigSendType" SG_ 294 LCK_VehicleChildSaftyLockedIndicate 0;
BA_ "GenSigStartValue" SG_ 294 LCK_VehicleChildSaftyLockedIndicate 0;
BA_ "GenSigTimeoutValue" SG_ 294 LCK_VehicleChildSaftyLockedIndicate 0;
BA_ "Remark" SG_ 294 LCK_VehicleChildSaftyLockedIndicate "";
BA_ "EventCommandSignal" SG_ 334 Theft_Auth_Status 1;
BA_ "GatewayedSignals" SG_ 334 Theft_Auth_Status 0;
BA_ "GenSigInactiveValue" SG_ 334 Theft_Auth_Status 0;
BA_ "GenSigInvalidValue" SG_ 334 Theft_Auth_Status 0;
BA_ "GenSigSendType" SG_ 334 Theft_Auth_Status 0;
BA_ "GenSigStartValue" SG_ 334 Theft_Auth_Status 0;
BA_ "GenSigTimeoutValue" SG_ 334 Theft_Auth_Status 0;
BA_ "Remark" SG_ 334 Theft_Auth_Status "";
BA_ "EventCommandSignal" SG_ 334 CSM_RC_ViewExtvideo 0;
BA_ "GatewayedSignals" SG_ 334 CSM_RC_ViewExtvideo 0;
BA_ "GenSigInactiveValue" SG_ 334 CSM_RC_ViewExtvideo 0;
BA_ "GenSigInvalidValue" SG_ 334 CSM_RC_ViewExtvideo 65535;
BA_ "GenSigSendType" SG_ 334 CSM_RC_ViewExtvideo 1;
BA_ "GenSigStartValue" SG_ 334 CSM_RC_ViewExtvideo 0;
BA_ "GenSigTimeoutValue" SG_ 334 CSM_RC_ViewExtvideo 0;
BA_ "Remark" SG_ 334 CSM_RC_ViewExtvideo "";
BA_ "EventCommandSignal" SG_ 334 CSM_RC_ViewExtvideoReq 0;
BA_ "GatewayedSignals" SG_ 334 CSM_RC_ViewExtvideoReq 0;
BA_ "GenSigInactiveValue" SG_ 334 CSM_RC_ViewExtvideoReq 0;
BA_ "GenSigInvalidValue" SG_ 334 CSM_RC_ViewExtvideoReq 0;
BA_ "GenSigSendType" SG_ 334 CSM_RC_ViewExtvideoReq 1;
BA_ "GenSigStartValue" SG_ 334 CSM_RC_ViewExtvideoReq 0;
BA_ "GenSigTimeoutValue" SG_ 334 CSM_RC_ViewExtvideoReq 0;
BA_ "Remark" SG_ 334 CSM_RC_ViewExtvideoReq "";
BA_ "EventCommandSignal" SG_ 93 CCU_ADCSoCWakeupRequest 1;
BA_ "GatewayedSignals" SG_ 93 CCU_ADCSoCWakeupRequest 0;
BA_ "GenSigInactiveValue" SG_ 93 CCU_ADCSoCWakeupRequest 0;
BA_ "GenSigInvalidValue" SG_ 93 CCU_ADCSoCWakeupRequest 0;
BA_ "GenSigSendType" SG_ 93 CCU_ADCSoCWakeupRequest 0;
BA_ "GenSigStartValue" SG_ 93 CCU_ADCSoCWakeupRequest 0;
BA_ "GenSigTimeoutValue" SG_ 93 CCU_ADCSoCWakeupRequest 0;
BA_ "Remark" SG_ 93 CCU_ADCSoCWakeupRequest "";
BA_ "EventCommandSignal" SG_ 120 CCU_SEC_KEY_Defaultencoding 1;
BA_ "GatewayedSignals" SG_ 120 CCU_SEC_KEY_Defaultencoding 0;
BA_ "GenSigInactiveValue" SG_ 120 CCU_SEC_KEY_Defaultencoding 0;
BA_ "GenSigInvalidValue" SG_ 120 CCU_SEC_KEY_Defaultencoding 0;
BA_ "GenSigSendType" SG_ 120 CCU_SEC_KEY_Defaultencoding 0;
BA_ "GenSigStartValue" SG_ 120 CCU_SEC_KEY_Defaultencoding 0;
BA_ "GenSigTimeoutValue" SG_ 120 CCU_SEC_KEY_Defaultencoding 0;
BA_ "Remark" SG_ 120 CCU_SEC_KEY_Defaultencoding "";
BA_ "EventCommandSignal" SG_ 154 CCU_IMMO 1;
BA_ "GatewayedSignals" SG_ 154 CCU_IMMO 0;
BA_ "GenSigInactiveValue" SG_ 154 CCU_IMMO 0;
BA_ "GenSigInvalidValue" SG_ 154 CCU_IMMO 0;
BA_ "GenSigSendType" SG_ 154 CCU_IMMO 0;
BA_ "GenSigStartValue" SG_ 154 CCU_IMMO 0;
BA_ "GenSigTimeoutValue" SG_ 154 CCU_IMMO 0;
BA_ "Remark" SG_ 154 CCU_IMMO "";
BA_ "EventCommandSignal" SG_ 777 ZCUR_4_CRC 0;
BA_ "GatewayedSignals" SG_ 777 ZCUR_4_CRC 0;
BA_ "GenSigInactiveValue" SG_ 777 ZCUR_4_CRC 0;
BA_ "GenSigInvalidValue" SG_ 777 ZCUR_4_CRC 0;
BA_ "GenSigSendType" SG_ 777 ZCUR_4_CRC 1;
BA_ "GenSigStartValue" SG_ 777 ZCUR_4_CRC 0;
BA_ "GenSigTimeoutValue" SG_ 777 ZCUR_4_CRC 0;
BA_ "Remark" SG_ 777 ZCUR_4_CRC "Source Msg Cycle Time is 20ms";
BA_ "EventCommandSignal" SG_ 777 ZCUR_4_Counter 0;
BA_ "GatewayedSignals" SG_ 777 ZCUR_4_Counter 0;
BA_ "GenSigInactiveValue" SG_ 777 ZCUR_4_Counter 0;
BA_ "GenSigInvalidValue" SG_ 777 ZCUR_4_Counter 0;
BA_ "GenSigSendType" SG_ 777 ZCUR_4_Counter 1;
BA_ "GenSigStartValue" SG_ 777 ZCUR_4_Counter 0;
BA_ "GenSigTimeoutValue" SG_ 777 ZCUR_4_Counter 0;
BA_ "Remark" SG_ 777 ZCUR_4_Counter "Source Msg Cycle Time is 20ms";
BA_ "EventCommandSignal" SG_ 777 EL_MRADASLightSt 0;
BA_ "GatewayedSignals" SG_ 777 EL_MRADASLightSt 0;
BA_ "GenSigInactiveValue" SG_ 777 EL_MRADASLightSt 0;
BA_ "GenSigInvalidValue" SG_ 777 EL_MRADASLightSt 0;
BA_ "GenSigSendType" SG_ 777 EL_MRADASLightSt 1;
BA_ "GenSigStartValue" SG_ 777 EL_MRADASLightSt 0;
BA_ "GenSigTimeoutValue" SG_ 777 EL_MRADASLightSt 0;
BA_ "Remark" SG_ 777 EL_MRADASLightSt "";
BA_ "EventCommandSignal" SG_ 777 MR_RightMirrorFoldUnfoldSt 0;
BA_ "GatewayedSignals" SG_ 777 MR_RightMirrorFoldUnfoldSt 0;
BA_ "GenSigInactiveValue" SG_ 777 MR_RightMirrorFoldUnfoldSt 0;
BA_ "GenSigInvalidValue" SG_ 777 MR_RightMirrorFoldUnfoldSt 0;
BA_ "GenSigSendType" SG_ 777 MR_RightMirrorFoldUnfoldSt 1;
BA_ "GenSigStartValue" SG_ 777 MR_RightMirrorFoldUnfoldSt 0;
BA_ "GenSigTimeoutValue" SG_ 777 MR_RightMirrorFoldUnfoldSt 0;
BA_ "Remark" SG_ 777 MR_RightMirrorFoldUnfoldSt "";
BA_ "EventCommandSignal" SG_ 777 PWL_WinCurrentPos_FRWinPst 0;
BA_ "GatewayedSignals" SG_ 777 PWL_WinCurrentPos_FRWinPst 0;
BA_ "GenSigInactiveValue" SG_ 777 PWL_WinCurrentPos_FRWinPst 0;
BA_ "GenSigInvalidValue" SG_ 777 PWL_WinCurrentPos_FRWinPst 0;
BA_ "GenSigSendType" SG_ 777 PWL_WinCurrentPos_FRWinPst 1;
BA_ "GenSigStartValue" SG_ 777 PWL_WinCurrentPos_FRWinPst 255;
BA_ "GenSigTimeoutValue" SG_ 777 PWL_WinCurrentPos_FRWinPst 0;
BA_ "Remark" SG_ 777 PWL_WinCurrentPos_FRWinPst "";
BA_ "EventCommandSignal" SG_ 777 EL_MRTurnLightSt 0;
BA_ "GatewayedSignals" SG_ 777 EL_MRTurnLightSt 0;
BA_ "GenSigInactiveValue" SG_ 777 EL_MRTurnLightSt 0;
BA_ "GenSigInvalidValue" SG_ 777 EL_MRTurnLightSt 0;
BA_ "GenSigSendType" SG_ 777 EL_MRTurnLightSt 1;
BA_ "GenSigStartValue" SG_ 777 EL_MRTurnLightSt 0;
BA_ "GenSigTimeoutValue" SG_ 777 EL_MRTurnLightSt 0;
BA_ "Remark" SG_ 777 EL_MRTurnLightSt "";
BA_ "EventCommandSignal" SG_ 777 EL_MRTurnLightFaultSt 0;
BA_ "GatewayedSignals" SG_ 777 EL_MRTurnLightFaultSt 0;
BA_ "GenSigInactiveValue" SG_ 777 EL_MRTurnLightFaultSt 0;
BA_ "GenSigInvalidValue" SG_ 777 EL_MRTurnLightFaultSt 0;
BA_ "GenSigSendType" SG_ 777 EL_MRTurnLightFaultSt 1;
BA_ "GenSigStartValue" SG_ 777 EL_MRTurnLightFaultSt 0;
BA_ "GenSigTimeoutValue" SG_ 777 EL_MRTurnLightFaultSt 0;
BA_ "Remark" SG_ 777 EL_MRTurnLightFaultSt "";
BA_ "EventCommandSignal" SG_ 777 KAE_toADCDRVUnlockSensorSt 0;
BA_ "GatewayedSignals" SG_ 777 KAE_toADCDRVUnlockSensorSt 0;
BA_ "GenSigInactiveValue" SG_ 777 KAE_toADCDRVUnlockSensorSt 0;
BA_ "GenSigInvalidValue" SG_ 777 KAE_toADCDRVUnlockSensorSt 0;
BA_ "GenSigSendType" SG_ 777 KAE_toADCDRVUnlockSensorSt 1;
BA_ "GenSigStartValue" SG_ 777 KAE_toADCDRVUnlockSensorSt 0;
BA_ "GenSigTimeoutValue" SG_ 777 KAE_toADCDRVUnlockSensorSt 0;
BA_ "Remark" SG_ 777 KAE_toADCDRVUnlockSensorSt "";
BA_ "EventCommandSignal" SG_ 777 KAE_toADCDRVLockSensorSt 0;
BA_ "GatewayedSignals" SG_ 777 KAE_toADCDRVLockSensorSt 0;
BA_ "GenSigInactiveValue" SG_ 777 KAE_toADCDRVLockSensorSt 0;
BA_ "GenSigInvalidValue" SG_ 777 KAE_toADCDRVLockSensorSt 0;
BA_ "GenSigSendType" SG_ 777 KAE_toADCDRVLockSensorSt 1;
BA_ "GenSigStartValue" SG_ 777 KAE_toADCDRVLockSensorSt 0;
BA_ "GenSigTimeoutValue" SG_ 777 KAE_toADCDRVLockSensorSt 0;
BA_ "Remark" SG_ 777 KAE_toADCDRVLockSensorSt "";
BA_ "EventCommandSignal" SG_ 777 EL_RightBSDIndicatorSt 0;
BA_ "GatewayedSignals" SG_ 777 EL_RightBSDIndicatorSt 0;
BA_ "GenSigInactiveValue" SG_ 777 EL_RightBSDIndicatorSt 0;
BA_ "GenSigInvalidValue" SG_ 777 EL_RightBSDIndicatorSt 0;
BA_ "GenSigSendType" SG_ 777 EL_RightBSDIndicatorSt 1;
BA_ "GenSigStartValue" SG_ 777 EL_RightBSDIndicatorSt 0;
BA_ "GenSigTimeoutValue" SG_ 777 EL_RightBSDIndicatorSt 0;
BA_ "Remark" SG_ 777 EL_RightBSDIndicatorSt "";
BA_ "EventCommandSignal" SG_ 777 EL_RightBSDIndicatorFaultSt 0;
BA_ "GatewayedSignals" SG_ 777 EL_RightBSDIndicatorFaultSt 0;
BA_ "GenSigInactiveValue" SG_ 777 EL_RightBSDIndicatorFaultSt 0;
BA_ "GenSigInvalidValue" SG_ 777 EL_RightBSDIndicatorFaultSt 0;
BA_ "GenSigSendType" SG_ 777 EL_RightBSDIndicatorFaultSt 1;
BA_ "GenSigStartValue" SG_ 777 EL_RightBSDIndicatorFaultSt 0;
BA_ "GenSigTimeoutValue" SG_ 777 EL_RightBSDIndicatorFaultSt 0;
BA_ "Remark" SG_ 777 EL_RightBSDIndicatorFaultSt "";
BA_ "EventCommandSignal" SG_ 163 ACU_RAEBcfg 1;
BA_ "GatewayedSignals" SG_ 163 ACU_RAEBcfg 0;
BA_ "GenSigInactiveValue" SG_ 163 ACU_RAEBcfg 0;
BA_ "GenSigInvalidValue" SG_ 163 ACU_RAEBcfg 0;
BA_ "GenSigSendType" SG_ 163 ACU_RAEBcfg 0;
BA_ "GenSigStartValue" SG_ 163 ACU_RAEBcfg 0;
BA_ "GenSigTimeoutValue" SG_ 163 ACU_RAEBcfg 0;
BA_ "Remark" SG_ 163 ACU_RAEBcfg "";
BA_ "EventCommandSignal" SG_ 163 ACU_PAAMode 1;
BA_ "GatewayedSignals" SG_ 163 ACU_PAAMode 0;
BA_ "GenSigInactiveValue" SG_ 163 ACU_PAAMode 0;
BA_ "GenSigInvalidValue" SG_ 163 ACU_PAAMode 0;
BA_ "GenSigSendType" SG_ 163 ACU_PAAMode 0;
BA_ "GenSigStartValue" SG_ 163 ACU_PAAMode 0;
BA_ "GenSigTimeoutValue" SG_ 163 ACU_PAAMode 0;
BA_ "Remark" SG_ 163 ACU_PAAMode "";
BA_ "EventCommandSignal" SG_ 163 ACU_SVM_Button 1;
BA_ "GatewayedSignals" SG_ 163 ACU_SVM_Button 0;
BA_ "GenSigInactiveValue" SG_ 163 ACU_SVM_Button 0;
BA_ "GenSigInvalidValue" SG_ 163 ACU_SVM_Button 0;
BA_ "GenSigSendType" SG_ 163 ACU_SVM_Button 0;
BA_ "GenSigStartValue" SG_ 163 ACU_SVM_Button 0;
BA_ "GenSigTimeoutValue" SG_ 163 ACU_SVM_Button 0;
BA_ "Remark" SG_ 163 ACU_SVM_Button "";
BA_ "EventCommandSignal" SG_ 163 ACU_PCS_MirrorpagedownButtonST 1;
BA_ "GatewayedSignals" SG_ 163 ACU_PCS_MirrorpagedownButtonST 0;
BA_ "GenSigInactiveValue" SG_ 163 ACU_PCS_MirrorpagedownButtonST 0;
BA_ "GenSigInvalidValue" SG_ 163 ACU_PCS_MirrorpagedownButtonST 0;
BA_ "GenSigSendType" SG_ 163 ACU_PCS_MirrorpagedownButtonST 0;
BA_ "GenSigStartValue" SG_ 163 ACU_PCS_MirrorpagedownButtonST 0;
BA_ "GenSigTimeoutValue" SG_ 163 ACU_PCS_MirrorpagedownButtonST 0;
BA_ "Remark" SG_ 163 ACU_PCS_MirrorpagedownButtonST "";
BA_ "EventCommandSignal" SG_ 163 ACU_PCS_ScreenTouchSt 1;
BA_ "GatewayedSignals" SG_ 163 ACU_PCS_ScreenTouchSt 0;
BA_ "GenSigInactiveValue" SG_ 163 ACU_PCS_ScreenTouchSt 0;
BA_ "GenSigInvalidValue" SG_ 163 ACU_PCS_ScreenTouchSt 0;
BA_ "GenSigSendType" SG_ 163 ACU_PCS_ScreenTouchSt 0;
BA_ "GenSigStartValue" SG_ 163 ACU_PCS_ScreenTouchSt 0;
BA_ "GenSigTimeoutValue" SG_ 163 ACU_PCS_ScreenTouchSt 0;
BA_ "Remark" SG_ 163 ACU_PCS_ScreenTouchSt "";
BA_ "EventCommandSignal" SG_ 163 ACU_LanguageTypeSet 1;
BA_ "GatewayedSignals" SG_ 163 ACU_LanguageTypeSet 0;
BA_ "GenSigInactiveValue" SG_ 163 ACU_LanguageTypeSet 0;
BA_ "GenSigInvalidValue" SG_ 163 ACU_LanguageTypeSet 0;
BA_ "GenSigSendType" SG_ 163 ACU_LanguageTypeSet 0;
BA_ "GenSigStartValue" SG_ 163 ACU_LanguageTypeSet 0;
BA_ "GenSigTimeoutValue" SG_ 163 ACU_LanguageTypeSet 0;
BA_ "Remark" SG_ 163 ACU_LanguageTypeSet "";
BA_ "EventCommandSignal" SG_ 163 ACU_PCS_SVM_FunctionCmd 1;
BA_ "GatewayedSignals" SG_ 163 ACU_PCS_SVM_FunctionCmd 0;
BA_ "GenSigInactiveValue" SG_ 163 ACU_PCS_SVM_FunctionCmd 0;
BA_ "GenSigInvalidValue" SG_ 163 ACU_PCS_SVM_FunctionCmd 0;
BA_ "GenSigSendType" SG_ 163 ACU_PCS_SVM_FunctionCmd 0;
BA_ "GenSigStartValue" SG_ 163 ACU_PCS_SVM_FunctionCmd 0;
BA_ "GenSigTimeoutValue" SG_ 163 ACU_PCS_SVM_FunctionCmd 0;
BA_ "Remark" SG_ 163 ACU_PCS_SVM_FunctionCmd "";
BA_ "EventCommandSignal" SG_ 163 ACU_PCS_ScreenCoordY 1;
BA_ "GatewayedSignals" SG_ 163 ACU_PCS_ScreenCoordY 0;
BA_ "GenSigInactiveValue" SG_ 163 ACU_PCS_ScreenCoordY 0;
BA_ "GenSigInvalidValue" SG_ 163 ACU_PCS_ScreenCoordY 0;
BA_ "GenSigSendType" SG_ 163 ACU_PCS_ScreenCoordY 0;
BA_ "GenSigStartValue" SG_ 163 ACU_PCS_ScreenCoordY 0;
BA_ "GenSigTimeoutValue" SG_ 163 ACU_PCS_ScreenCoordY 0;
BA_ "Remark" SG_ 163 ACU_PCS_ScreenCoordY "";
BA_ "EventCommandSignal" SG_ 163 ACU_PCS_ScreenCoordX 1;
BA_ "GatewayedSignals" SG_ 163 ACU_PCS_ScreenCoordX 0;
BA_ "GenSigInactiveValue" SG_ 163 ACU_PCS_ScreenCoordX 0;
BA_ "GenSigInvalidValue" SG_ 163 ACU_PCS_ScreenCoordX 0;
BA_ "GenSigSendType" SG_ 163 ACU_PCS_ScreenCoordX 0;
BA_ "GenSigStartValue" SG_ 163 ACU_PCS_ScreenCoordX 0;
BA_ "GenSigTimeoutValue" SG_ 163 ACU_PCS_ScreenCoordX 0;
BA_ "Remark" SG_ 163 ACU_PCS_ScreenCoordX "";
BA_ "EventCommandSignal" SG_ 163 ACU_APAMessageSt 1;
BA_ "GatewayedSignals" SG_ 163 ACU_APAMessageSt 0;
BA_ "GenSigInactiveValue" SG_ 163 ACU_APAMessageSt 0;
BA_ "GenSigInvalidValue" SG_ 163 ACU_APAMessageSt 0;
BA_ "GenSigSendType" SG_ 163 ACU_APAMessageSt 0;
BA_ "GenSigStartValue" SG_ 163 ACU_APAMessageSt 0;
BA_ "GenSigTimeoutValue" SG_ 163 ACU_APAMessageSt 0;
BA_ "Remark" SG_ 163 ACU_APAMessageSt "";
BA_ "EventCommandSignal" SG_ 163 ACU_PAS_ButtonPress 1;
BA_ "GatewayedSignals" SG_ 163 ACU_PAS_ButtonPress 0;
BA_ "GenSigInactiveValue" SG_ 163 ACU_PAS_ButtonPress 0;
BA_ "GenSigInvalidValue" SG_ 163 ACU_PAS_ButtonPress 0;
BA_ "GenSigSendType" SG_ 163 ACU_PAS_ButtonPress 0;
BA_ "GenSigStartValue" SG_ 163 ACU_PAS_ButtonPress 0;
BA_ "GenSigTimeoutValue" SG_ 163 ACU_PAS_ButtonPress 0;
BA_ "Remark" SG_ 163 ACU_PAS_ButtonPress "";
BA_ "EventCommandSignal" SG_ 163 ACU_HPAMessageSt 1;
BA_ "GatewayedSignals" SG_ 163 ACU_HPAMessageSt 0;
BA_ "GenSigInactiveValue" SG_ 163 ACU_HPAMessageSt 0;
BA_ "GenSigInvalidValue" SG_ 163 ACU_HPAMessageSt 0;
BA_ "GenSigSendType" SG_ 163 ACU_HPAMessageSt 0;
BA_ "GenSigStartValue" SG_ 163 ACU_HPAMessageSt 0;
BA_ "GenSigTimeoutValue" SG_ 163 ACU_HPAMessageSt 0;
BA_ "Remark" SG_ 163 ACU_HPAMessageSt "";
BA_ "EventCommandSignal" SG_ 163 ACU_AVPMessageSt 1;
BA_ "GatewayedSignals" SG_ 163 ACU_AVPMessageSt 0;
BA_ "GenSigInactiveValue" SG_ 163 ACU_AVPMessageSt 0;
BA_ "GenSigInvalidValue" SG_ 163 ACU_AVPMessageSt 0;
BA_ "GenSigSendType" SG_ 163 ACU_AVPMessageSt 0;
BA_ "GenSigStartValue" SG_ 163 ACU_AVPMessageSt 0;
BA_ "GenSigTimeoutValue" SG_ 163 ACU_AVPMessageSt 0;
BA_ "Remark" SG_ 163 ACU_AVPMessageSt "";
BA_ "EventCommandSignal" SG_ 163 ACU_HPALearningSetParkLot 1;
BA_ "GatewayedSignals" SG_ 163 ACU_HPALearningSetParkLot 0;
BA_ "GenSigInactiveValue" SG_ 163 ACU_HPALearningSetParkLot 0;
BA_ "GenSigInvalidValue" SG_ 163 ACU_HPALearningSetParkLot 0;
BA_ "GenSigSendType" SG_ 163 ACU_HPALearningSetParkLot 0;
BA_ "GenSigStartValue" SG_ 163 ACU_HPALearningSetParkLot 0;
BA_ "GenSigTimeoutValue" SG_ 163 ACU_HPALearningSetParkLot 0;
BA_ "Remark" SG_ 163 ACU_HPALearningSetParkLot "";
BA_ "EventCommandSignal" SG_ 163 ACU_HPALearningProcessInfo 1;
BA_ "GatewayedSignals" SG_ 163 ACU_HPALearningProcessInfo 0;
BA_ "GenSigInactiveValue" SG_ 163 ACU_HPALearningProcessInfo 0;
BA_ "GenSigInvalidValue" SG_ 163 ACU_HPALearningProcessInfo 0;
BA_ "GenSigSendType" SG_ 163 ACU_HPALearningProcessInfo 0;
BA_ "GenSigStartValue" SG_ 163 ACU_HPALearningProcessInfo 0;
BA_ "GenSigTimeoutValue" SG_ 163 ACU_HPALearningProcessInfo 0;
BA_ "Remark" SG_ 163 ACU_HPALearningProcessInfo "";
BA_ "EventCommandSignal" SG_ 163 ACU_SDEnterParkingLot 1;
BA_ "GatewayedSignals" SG_ 163 ACU_SDEnterParkingLot 0;
BA_ "GenSigInactiveValue" SG_ 163 ACU_SDEnterParkingLot 0;
BA_ "GenSigInvalidValue" SG_ 163 ACU_SDEnterParkingLot 0;
BA_ "GenSigSendType" SG_ 163 ACU_SDEnterParkingLot 0;
BA_ "GenSigStartValue" SG_ 163 ACU_SDEnterParkingLot 0;
BA_ "GenSigTimeoutValue" SG_ 163 ACU_SDEnterParkingLot 0;
BA_ "Remark" SG_ 163 ACU_SDEnterParkingLot "";
BA_ "EventCommandSignal" SG_ 163 ACU_PCS_ER_QuitConfirm 1;
BA_ "GatewayedSignals" SG_ 163 ACU_PCS_ER_QuitConfirm 0;
BA_ "GenSigInactiveValue" SG_ 163 ACU_PCS_ER_QuitConfirm 0;
BA_ "GenSigInvalidValue" SG_ 163 ACU_PCS_ER_QuitConfirm 0;
BA_ "GenSigSendType" SG_ 163 ACU_PCS_ER_QuitConfirm 0;
BA_ "GenSigStartValue" SG_ 163 ACU_PCS_ER_QuitConfirm 0;
BA_ "GenSigTimeoutValue" SG_ 163 ACU_PCS_ER_QuitConfirm 0;
BA_ "Remark" SG_ 163 ACU_PCS_ER_QuitConfirm "";
BA_ "EventCommandSignal" SG_ 163 ACU_DisplayReq 1;
BA_ "GatewayedSignals" SG_ 163 ACU_DisplayReq 0;
BA_ "GenSigInactiveValue" SG_ 163 ACU_DisplayReq 0;
BA_ "GenSigInvalidValue" SG_ 163 ACU_DisplayReq 0;
BA_ "GenSigSendType" SG_ 163 ACU_DisplayReq 0;
BA_ "GenSigStartValue" SG_ 163 ACU_DisplayReq 0;
BA_ "GenSigTimeoutValue" SG_ 163 ACU_DisplayReq 0;
BA_ "Remark" SG_ 163 ACU_DisplayReq "";
BA_ "EventCommandSignal" SG_ 163 ACU_ER_FuncCfg 1;
BA_ "GatewayedSignals" SG_ 163 ACU_ER_FuncCfg 0;
BA_ "GenSigInactiveValue" SG_ 163 ACU_ER_FuncCfg 0;
BA_ "GenSigInvalidValue" SG_ 163 ACU_ER_FuncCfg 0;
BA_ "GenSigSendType" SG_ 163 ACU_ER_FuncCfg 0;
BA_ "GenSigStartValue" SG_ 163 ACU_ER_FuncCfg 0;
BA_ "GenSigTimeoutValue" SG_ 163 ACU_ER_FuncCfg 0;
BA_ "Remark" SG_ 163 ACU_ER_FuncCfg "";
BA_ "EventCommandSignal" SG_ 163 ACU_PCS_ER_EnterCmd 1;
BA_ "GatewayedSignals" SG_ 163 ACU_PCS_ER_EnterCmd 0;
BA_ "GenSigInactiveValue" SG_ 163 ACU_PCS_ER_EnterCmd 0;
BA_ "GenSigInvalidValue" SG_ 163 ACU_PCS_ER_EnterCmd 0;
BA_ "GenSigSendType" SG_ 163 ACU_PCS_ER_EnterCmd 0;
BA_ "GenSigStartValue" SG_ 163 ACU_PCS_ER_EnterCmd 0;
BA_ "GenSigTimeoutValue" SG_ 163 ACU_PCS_ER_EnterCmd 0;
BA_ "Remark" SG_ 163 ACU_PCS_ER_EnterCmd "";
BA_ "EventCommandSignal" SG_ 163 ACU_PCS_ScreenTouchSignal 1;
BA_ "GatewayedSignals" SG_ 163 ACU_PCS_ScreenTouchSignal 0;
BA_ "GenSigInactiveValue" SG_ 163 ACU_PCS_ScreenTouchSignal 0;
BA_ "GenSigInvalidValue" SG_ 163 ACU_PCS_ScreenTouchSignal 0;
BA_ "GenSigSendType" SG_ 163 ACU_PCS_ScreenTouchSignal 0;
BA_ "GenSigStartValue" SG_ 163 ACU_PCS_ScreenTouchSignal 0;
BA_ "GenSigTimeoutValue" SG_ 163 ACU_PCS_ScreenTouchSignal 0;
BA_ "Remark" SG_ 163 ACU_PCS_ScreenTouchSignal "";
BA_ "EventCommandSignal" SG_ 163 ACU_DPMessageSt 1;
BA_ "GatewayedSignals" SG_ 163 ACU_DPMessageSt 0;
BA_ "GenSigInactiveValue" SG_ 163 ACU_DPMessageSt 0;
BA_ "GenSigInvalidValue" SG_ 163 ACU_DPMessageSt 0;
BA_ "GenSigSendType" SG_ 163 ACU_DPMessageSt 0;
BA_ "GenSigStartValue" SG_ 163 ACU_DPMessageSt 0;
BA_ "GenSigTimeoutValue" SG_ 163 ACU_DPMessageSt 0;
BA_ "Remark" SG_ 163 ACU_DPMessageSt "";
BA_ "EventCommandSignal" SG_ 163 ACU_ParkingBoxMidX 1;
BA_ "GatewayedSignals" SG_ 163 ACU_ParkingBoxMidX 0;
BA_ "GenSigInactiveValue" SG_ 163 ACU_ParkingBoxMidX 0;
BA_ "GenSigInvalidValue" SG_ 163 ACU_ParkingBoxMidX 0;
BA_ "GenSigSendType" SG_ 163 ACU_ParkingBoxMidX 0;
BA_ "GenSigStartValue" SG_ 163 ACU_ParkingBoxMidX 0;
BA_ "GenSigTimeoutValue" SG_ 163 ACU_ParkingBoxMidX 0;
BA_ "Remark" SG_ 163 ACU_ParkingBoxMidX "";
BA_ "EventCommandSignal" SG_ 163 ACU_ParkingBoxMidY 1;
BA_ "GatewayedSignals" SG_ 163 ACU_ParkingBoxMidY 0;
BA_ "GenSigInactiveValue" SG_ 163 ACU_ParkingBoxMidY 0;
BA_ "GenSigInvalidValue" SG_ 163 ACU_ParkingBoxMidY 0;
BA_ "GenSigSendType" SG_ 163 ACU_ParkingBoxMidY 0;
BA_ "GenSigStartValue" SG_ 163 ACU_ParkingBoxMidY 0;
BA_ "GenSigTimeoutValue" SG_ 163 ACU_ParkingBoxMidY 0;
BA_ "Remark" SG_ 163 ACU_ParkingBoxMidY "";
BA_ "EventCommandSignal" SG_ 163 ACU_LowPowerConfig 1;
BA_ "GatewayedSignals" SG_ 163 ACU_LowPowerConfig 0;
BA_ "GenSigInactiveValue" SG_ 163 ACU_LowPowerConfig 0;
BA_ "GenSigInvalidValue" SG_ 163 ACU_LowPowerConfig 0;
BA_ "GenSigSendType" SG_ 163 ACU_LowPowerConfig 0;
BA_ "GenSigStartValue" SG_ 163 ACU_LowPowerConfig 0;
BA_ "GenSigTimeoutValue" SG_ 163 ACU_LowPowerConfig 0;
BA_ "Remark" SG_ 163 ACU_LowPowerConfig "";
BA_ "EventCommandSignal" SG_ 163 ACU_PCSModeSt 1;
BA_ "GatewayedSignals" SG_ 163 ACU_PCSModeSt 0;
BA_ "GenSigInactiveValue" SG_ 163 ACU_PCSModeSt 0;
BA_ "GenSigInvalidValue" SG_ 163 ACU_PCSModeSt 0;
BA_ "GenSigSendType" SG_ 163 ACU_PCSModeSt 0;
BA_ "GenSigStartValue" SG_ 163 ACU_PCSModeSt 0;
BA_ "GenSigTimeoutValue" SG_ 163 ACU_PCSModeSt 0;
BA_ "Remark" SG_ 163 ACU_PCSModeSt "";
BA_ "EventCommandSignal" SG_ 163 ACU_PCSModeSt_A 1;
BA_ "GatewayedSignals" SG_ 163 ACU_PCSModeSt_A 0;
BA_ "GenSigInactiveValue" SG_ 163 ACU_PCSModeSt_A 0;
BA_ "GenSigInvalidValue" SG_ 163 ACU_PCSModeSt_A 0;
BA_ "GenSigSendType" SG_ 163 ACU_PCSModeSt_A 0;
BA_ "GenSigStartValue" SG_ 163 ACU_PCSModeSt_A 0;
BA_ "GenSigTimeoutValue" SG_ 163 ACU_PCSModeSt_A 0;
BA_ "Remark" SG_ 163 ACU_PCSModeSt_A "";
BA_ "EventCommandSignal" SG_ 163 ACU_ParkingBoxAngle 1;
BA_ "GatewayedSignals" SG_ 163 ACU_ParkingBoxAngle 0;
BA_ "GenSigInactiveValue" SG_ 163 ACU_ParkingBoxAngle 0;
BA_ "GenSigInvalidValue" SG_ 163 ACU_ParkingBoxAngle 0;
BA_ "GenSigSendType" SG_ 163 ACU_ParkingBoxAngle 0;
BA_ "GenSigStartValue" SG_ 163 ACU_ParkingBoxAngle 0;
BA_ "GenSigTimeoutValue" SG_ 163 ACU_ParkingBoxAngle 0;
BA_ "Remark" SG_ 163 ACU_ParkingBoxAngle "";
BA_ "EventCommandSignal" SG_ 163 IDC_APAParkingSpdsSfg 1;
BA_ "GatewayedSignals" SG_ 163 IDC_APAParkingSpdsSfg 0;
BA_ "GenSigInactiveValue" SG_ 163 IDC_APAParkingSpdsSfg 0;
BA_ "GenSigInvalidValue" SG_ 163 IDC_APAParkingSpdsSfg 0;
BA_ "GenSigSendType" SG_ 163 IDC_APAParkingSpdsSfg 0;
BA_ "GenSigStartValue" SG_ 163 IDC_APAParkingSpdsSfg 0;
BA_ "GenSigTimeoutValue" SG_ 163 IDC_APAParkingSpdsSfg 0;
BA_ "Remark" SG_ 163 IDC_APAParkingSpdsSfg "";
BA_ "EventCommandSignal" SG_ 163 IDC_DskScreenOperationSt 1;
BA_ "GatewayedSignals" SG_ 163 IDC_DskScreenOperationSt 0;
BA_ "GenSigInactiveValue" SG_ 163 IDC_DskScreenOperationSt 0;
BA_ "GenSigInvalidValue" SG_ 163 IDC_DskScreenOperationSt 0;
BA_ "GenSigSendType" SG_ 163 IDC_DskScreenOperationSt 0;
BA_ "GenSigStartValue" SG_ 163 IDC_DskScreenOperationSt 0;
BA_ "GenSigTimeoutValue" SG_ 163 IDC_DskScreenOperationSt 0;
BA_ "Remark" SG_ 163 IDC_DskScreenOperationSt "";
BA_ "EventCommandSignal" SG_ 163 IDC_SenslesEtyParkingSwSt 1;
BA_ "GatewayedSignals" SG_ 163 IDC_SenslesEtyParkingSwSt 0;
BA_ "GenSigInactiveValue" SG_ 163 IDC_SenslesEtyParkingSwSt 0;
BA_ "GenSigInvalidValue" SG_ 163 IDC_SenslesEtyParkingSwSt 0;
BA_ "GenSigSendType" SG_ 163 IDC_SenslesEtyParkingSwSt 0;
BA_ "GenSigStartValue" SG_ 163 IDC_SenslesEtyParkingSwSt 0;
BA_ "GenSigTimeoutValue" SG_ 163 IDC_SenslesEtyParkingSwSt 0;
BA_ "Remark" SG_ 163 IDC_SenslesEtyParkingSwSt "";
BA_ "EventCommandSignal" SG_ 163 ACU_NDAVoicePromptTypeCfg 1;
BA_ "GatewayedSignals" SG_ 163 ACU_NDAVoicePromptTypeCfg 0;
BA_ "GenSigInactiveValue" SG_ 163 ACU_NDAVoicePromptTypeCfg 0;
BA_ "GenSigInvalidValue" SG_ 163 ACU_NDAVoicePromptTypeCfg 0;
BA_ "GenSigSendType" SG_ 163 ACU_NDAVoicePromptTypeCfg 0;
BA_ "GenSigStartValue" SG_ 163 ACU_NDAVoicePromptTypeCfg 0;
BA_ "GenSigTimeoutValue" SG_ 163 ACU_NDAVoicePromptTypeCfg 0;
BA_ "Remark" SG_ 163 ACU_NDAVoicePromptTypeCfg "";
BA_ "EventCommandSignal" SG_ 163 IDC_SenslesEtyParkingDskScene 1;
BA_ "GatewayedSignals" SG_ 163 IDC_SenslesEtyParkingDskScene 0;
BA_ "GenSigInactiveValue" SG_ 163 IDC_SenslesEtyParkingDskScene 0;
BA_ "GenSigInvalidValue" SG_ 163 IDC_SenslesEtyParkingDskScene 0;
BA_ "GenSigSendType" SG_ 163 IDC_SenslesEtyParkingDskScene 0;
BA_ "GenSigStartValue" SG_ 163 IDC_SenslesEtyParkingDskScene 0;
BA_ "GenSigTimeoutValue" SG_ 163 IDC_SenslesEtyParkingDskScene 0;
BA_ "Remark" SG_ 163 IDC_SenslesEtyParkingDskScene "";
BA_ "EventCommandSignal" SG_ 163 ACU_VR_APAControl 1;
BA_ "GatewayedSignals" SG_ 163 ACU_VR_APAControl 0;
BA_ "GenSigInactiveValue" SG_ 163 ACU_VR_APAControl 0;
BA_ "GenSigInvalidValue" SG_ 163 ACU_VR_APAControl 0;
BA_ "GenSigSendType" SG_ 163 ACU_VR_APAControl 0;
BA_ "GenSigStartValue" SG_ 163 ACU_VR_APAControl 0;
BA_ "GenSigTimeoutValue" SG_ 163 ACU_VR_APAControl 0;
BA_ "Remark" SG_ 163 ACU_VR_APAControl "";
BA_ "EventCommandSignal" SG_ 163 ACU_SteeringPrkgButton 1;
BA_ "GatewayedSignals" SG_ 163 ACU_SteeringPrkgButton 0;
BA_ "GenSigInactiveValue" SG_ 163 ACU_SteeringPrkgButton 0;
BA_ "GenSigInvalidValue" SG_ 163 ACU_SteeringPrkgButton 0;
BA_ "GenSigSendType" SG_ 163 ACU_SteeringPrkgButton 0;
BA_ "GenSigStartValue" SG_ 163 ACU_SteeringPrkgButton 0;
BA_ "GenSigTimeoutValue" SG_ 163 ACU_SteeringPrkgButton 0;
BA_ "Remark" SG_ 163 ACU_SteeringPrkgButton "";
BA_ "EventCommandSignal" SG_ 163 ACU_ActiveNDAMessageSt 1;
BA_ "GatewayedSignals" SG_ 163 ACU_ActiveNDAMessageSt 0;
BA_ "GenSigInactiveValue" SG_ 163 ACU_ActiveNDAMessageSt 0;
BA_ "GenSigInvalidValue" SG_ 163 ACU_ActiveNDAMessageSt 0;
BA_ "GenSigSendType" SG_ 163 ACU_ActiveNDAMessageSt 0;
BA_ "GenSigStartValue" SG_ 163 ACU_ActiveNDAMessageSt 0;
BA_ "GenSigTimeoutValue" SG_ 163 ACU_ActiveNDAMessageSt 0;
BA_ "Remark" SG_ 163 ACU_ActiveNDAMessageSt "";
BA_ "EventCommandSignal" SG_ 163 ACU_ActiveAVPMessageSt 1;
BA_ "GatewayedSignals" SG_ 163 ACU_ActiveAVPMessageSt 0;
BA_ "GenSigInactiveValue" SG_ 163 ACU_ActiveAVPMessageSt 0;
BA_ "GenSigInvalidValue" SG_ 163 ACU_ActiveAVPMessageSt 0;
BA_ "GenSigSendType" SG_ 163 ACU_ActiveAVPMessageSt 0;
BA_ "GenSigStartValue" SG_ 163 ACU_ActiveAVPMessageSt 0;
BA_ "GenSigTimeoutValue" SG_ 163 ACU_ActiveAVPMessageSt 0;
BA_ "Remark" SG_ 163 ACU_ActiveAVPMessageSt "";
BA_ "EventCommandSignal" SG_ 163 ACU_LeftLaneChangeMessageSt 1;
BA_ "GatewayedSignals" SG_ 163 ACU_LeftLaneChangeMessageSt 0;
BA_ "GenSigInactiveValue" SG_ 163 ACU_LeftLaneChangeMessageSt 0;
BA_ "GenSigInvalidValue" SG_ 163 ACU_LeftLaneChangeMessageSt 0;
BA_ "GenSigSendType" SG_ 163 ACU_LeftLaneChangeMessageSt 0;
BA_ "GenSigStartValue" SG_ 163 ACU_LeftLaneChangeMessageSt 0;
BA_ "GenSigTimeoutValue" SG_ 163 ACU_LeftLaneChangeMessageSt 0;
BA_ "Remark" SG_ 163 ACU_LeftLaneChangeMessageSt "";
BA_ "EventCommandSignal" SG_ 163 ACU_RigthLaneChangeMessageSt 1;
BA_ "GatewayedSignals" SG_ 163 ACU_RigthLaneChangeMessageSt 0;
BA_ "GenSigInactiveValue" SG_ 163 ACU_RigthLaneChangeMessageSt 0;
BA_ "GenSigInvalidValue" SG_ 163 ACU_RigthLaneChangeMessageSt 0;
BA_ "GenSigSendType" SG_ 163 ACU_RigthLaneChangeMessageSt 0;
BA_ "GenSigStartValue" SG_ 163 ACU_RigthLaneChangeMessageSt 0;
BA_ "GenSigTimeoutValue" SG_ 163 ACU_RigthLaneChangeMessageSt 0;
BA_ "Remark" SG_ 163 ACU_RigthLaneChangeMessageSt "";
BA_ "EventCommandSignal" SG_ 163 ACU_ICANDAIconMessageSt 1;
BA_ "GatewayedSignals" SG_ 163 ACU_ICANDAIconMessageSt 0;
BA_ "GenSigInactiveValue" SG_ 163 ACU_ICANDAIconMessageSt 0;
BA_ "GenSigInvalidValue" SG_ 163 ACU_ICANDAIconMessageSt 0;
BA_ "GenSigSendType" SG_ 163 ACU_ICANDAIconMessageSt 0;
BA_ "GenSigStartValue" SG_ 163 ACU_ICANDAIconMessageSt 0;
BA_ "GenSigTimeoutValue" SG_ 163 ACU_ICANDAIconMessageSt 0;
BA_ "Remark" SG_ 163 ACU_ICANDAIconMessageSt "";
BA_ "EventCommandSignal" SG_ 163 ACU_SVM_Button_A 1;
BA_ "GatewayedSignals" SG_ 163 ACU_SVM_Button_A 0;
BA_ "GenSigInactiveValue" SG_ 163 ACU_SVM_Button_A 0;
BA_ "GenSigInvalidValue" SG_ 163 ACU_SVM_Button_A 0;
BA_ "GenSigSendType" SG_ 163 ACU_SVM_Button_A 0;
BA_ "GenSigStartValue" SG_ 163 ACU_SVM_Button_A 0;
BA_ "GenSigTimeoutValue" SG_ 163 ACU_SVM_Button_A 0;
BA_ "Remark" SG_ 163 ACU_SVM_Button_A "";
BA_ "EventCommandSignal" SG_ 618 EPB_1_CRC 0;
BA_ "GatewayedSignals" SG_ 618 EPB_1_CRC 0;
BA_ "GenSigInactiveValue" SG_ 618 EPB_1_CRC 0;
BA_ "GenSigInvalidValue" SG_ 618 EPB_1_CRC 0;
BA_ "GenSigSendType" SG_ 618 EPB_1_CRC 1;
BA_ "GenSigStartValue" SG_ 618 EPB_1_CRC 0;
BA_ "GenSigTimeoutValue" SG_ 618 EPB_1_CRC 0;
BA_ "Remark" SG_ 618 EPB_1_CRC "涉及ID管理表";
BA_ "EventCommandSignal" SG_ 618 EPB_1_Counter 0;
BA_ "GatewayedSignals" SG_ 618 EPB_1_Counter 0;
BA_ "GenSigInactiveValue" SG_ 618 EPB_1_Counter 0;
BA_ "GenSigInvalidValue" SG_ 618 EPB_1_Counter 0;
BA_ "GenSigSendType" SG_ 618 EPB_1_Counter 1;
BA_ "GenSigStartValue" SG_ 618 EPB_1_Counter 0;
BA_ "GenSigTimeoutValue" SG_ 618 EPB_1_Counter 0;
BA_ "Remark" SG_ 618 EPB_1_Counter "涉及ID管理表";
BA_ "EventCommandSignal" SG_ 618 EPB_SwitchSt 0;
BA_ "GatewayedSignals" SG_ 618 EPB_SwitchSt 0;
BA_ "GenSigInactiveValue" SG_ 618 EPB_SwitchSt 0;
BA_ "GenSigInvalidValue" SG_ 618 EPB_SwitchSt 0;
BA_ "GenSigSendType" SG_ 618 EPB_SwitchSt 1;
BA_ "GenSigStartValue" SG_ 618 EPB_SwitchSt 0;
BA_ "GenSigTimeoutValue" SG_ 618 EPB_SwitchSt 0;
BA_ "Remark" SG_ 618 EPB_SwitchSt "涉及ID管理表";
BA_ "EventCommandSignal" SG_ 618 EPB_SwitchStVD 0;
BA_ "GatewayedSignals" SG_ 618 EPB_SwitchStVD 0;
BA_ "GenSigInactiveValue" SG_ 618 EPB_SwitchStVD 0;
BA_ "GenSigInvalidValue" SG_ 618 EPB_SwitchStVD 0;
BA_ "GenSigSendType" SG_ 618 EPB_SwitchStVD 1;
BA_ "GenSigStartValue" SG_ 618 EPB_SwitchStVD 0;
BA_ "GenSigTimeoutValue" SG_ 618 EPB_SwitchStVD 0;
BA_ "Remark" SG_ 618 EPB_SwitchStVD "涉及ID管理表";
BA_ "EventCommandSignal" SG_ 618 EPB_SysSt 0;
BA_ "GatewayedSignals" SG_ 618 EPB_SysSt 0;
BA_ "GenSigInactiveValue" SG_ 618 EPB_SysSt 0;
BA_ "GenSigInvalidValue" SG_ 618 EPB_SysSt 0;
BA_ "GenSigSendType" SG_ 618 EPB_SysSt 1;
BA_ "GenSigStartValue" SG_ 618 EPB_SysSt 0;
BA_ "GenSigTimeoutValue" SG_ 618 EPB_SysSt 7;
BA_ "Remark" SG_ 618 EPB_SysSt "涉及ID管理表";
BA_ "EventCommandSignal" SG_ 618 EPB_FailSt 0;
BA_ "GatewayedSignals" SG_ 618 EPB_FailSt 0;
BA_ "GenSigInactiveValue" SG_ 618 EPB_FailSt 0;
BA_ "GenSigInvalidValue" SG_ 618 EPB_FailSt 0;
BA_ "GenSigSendType" SG_ 618 EPB_FailSt 1;
BA_ "GenSigStartValue" SG_ 618 EPB_FailSt 0;
BA_ "GenSigTimeoutValue" SG_ 618 EPB_FailSt 1;
BA_ "Remark" SG_ 618 EPB_FailSt "涉及ID管理表";
BA_ "EventCommandSignal" SG_ 618 EPB_ExtAvailable 0;
BA_ "GatewayedSignals" SG_ 618 EPB_ExtAvailable 0;
BA_ "GenSigInactiveValue" SG_ 618 EPB_ExtAvailable 0;
BA_ "GenSigInvalidValue" SG_ 618 EPB_ExtAvailable 0;
BA_ "GenSigSendType" SG_ 618 EPB_ExtAvailable 1;
BA_ "GenSigStartValue" SG_ 618 EPB_ExtAvailable 0;
BA_ "GenSigTimeoutValue" SG_ 618 EPB_ExtAvailable 0;
BA_ "Remark" SG_ 618 EPB_ExtAvailable "涉及ID管理表";
BA_ "EventCommandSignal" SG_ 618 EPB_DynamicApplySt 0;
BA_ "GatewayedSignals" SG_ 618 EPB_DynamicApplySt 0;
BA_ "GenSigInactiveValue" SG_ 618 EPB_DynamicApplySt 0;
BA_ "GenSigInvalidValue" SG_ 618 EPB_DynamicApplySt 0;
BA_ "GenSigSendType" SG_ 618 EPB_DynamicApplySt 1;
BA_ "GenSigStartValue" SG_ 618 EPB_DynamicApplySt 0;
BA_ "GenSigTimeoutValue" SG_ 618 EPB_DynamicApplySt 0;
BA_ "Remark" SG_ 618 EPB_DynamicApplySt "涉及ID管理表";
BA_ "EventCommandSignal" SG_ 618 EPB_ActuatorSt_R 0;
BA_ "GatewayedSignals" SG_ 618 EPB_ActuatorSt_R 0;
BA_ "GenSigInactiveValue" SG_ 618 EPB_ActuatorSt_R 0;
BA_ "GenSigInvalidValue" SG_ 618 EPB_ActuatorSt_R 0;
BA_ "GenSigSendType" SG_ 618 EPB_ActuatorSt_R 1;
BA_ "GenSigStartValue" SG_ 618 EPB_ActuatorSt_R 0;
BA_ "GenSigTimeoutValue" SG_ 618 EPB_ActuatorSt_R 0;
BA_ "Remark" SG_ 618 EPB_ActuatorSt_R "涉及ID管理表";
BA_ "EventCommandSignal" SG_ 618 EPB_RWUActvSts 0;
BA_ "GatewayedSignals" SG_ 618 EPB_RWUActvSts 0;
BA_ "GenSigInactiveValue" SG_ 618 EPB_RWUActvSts 0;
BA_ "GenSigInvalidValue" SG_ 618 EPB_RWUActvSts 0;
BA_ "GenSigSendType" SG_ 618 EPB_RWUActvSts 1;
BA_ "GenSigStartValue" SG_ 618 EPB_RWUActvSts 0;
BA_ "GenSigTimeoutValue" SG_ 618 EPB_RWUActvSts 0;
BA_ "Remark" SG_ 618 EPB_RWUActvSts "涉及ID管理表";
BA_ "EventCommandSignal" SG_ 618 EPB_RWUAvl 0;
BA_ "GatewayedSignals" SG_ 618 EPB_RWUAvl 0;
BA_ "GenSigInactiveValue" SG_ 618 EPB_RWUAvl 0;
BA_ "GenSigInvalidValue" SG_ 618 EPB_RWUAvl 0;
BA_ "GenSigSendType" SG_ 618 EPB_RWUAvl 1;
BA_ "GenSigStartValue" SG_ 618 EPB_RWUAvl 0;
BA_ "GenSigTimeoutValue" SG_ 618 EPB_RWUAvl 0;
BA_ "Remark" SG_ 618 EPB_RWUAvl "涉及ID管理表";
BA_ "EventCommandSignal" SG_ 618 EPB_RPAAVPAvailability 0;
BA_ "GatewayedSignals" SG_ 618 EPB_RPAAVPAvailability 0;
BA_ "GenSigInactiveValue" SG_ 618 EPB_RPAAVPAvailability 0;
BA_ "GenSigInvalidValue" SG_ 618 EPB_RPAAVPAvailability 0;
BA_ "GenSigSendType" SG_ 618 EPB_RPAAVPAvailability 1;
BA_ "GenSigStartValue" SG_ 618 EPB_RPAAVPAvailability 0;
BA_ "GenSigTimeoutValue" SG_ 618 EPB_RPAAVPAvailability 0;
BA_ "Remark" SG_ 618 EPB_RPAAVPAvailability "涉及ID管理表";
BA_ "EventCommandSignal" SG_ 618 EPB_APAAvailability 0;
BA_ "GatewayedSignals" SG_ 618 EPB_APAAvailability 0;
BA_ "GenSigInactiveValue" SG_ 618 EPB_APAAvailability 0;
BA_ "GenSigInvalidValue" SG_ 618 EPB_APAAvailability 0;
BA_ "GenSigSendType" SG_ 618 EPB_APAAvailability 1;
BA_ "GenSigStartValue" SG_ 618 EPB_APAAvailability 0;
BA_ "GenSigTimeoutValue" SG_ 618 EPB_APAAvailability 0;
BA_ "Remark" SG_ 618 EPB_APAAvailability "涉及ID管理表";
VAL_ 400 UINM_DrvReqShft 0 "Shifter position O" 1 "Shifter position F1" 2 "Shifter position F2" 3 "Shifter position B1" 4 "Shifter position B2" 5 "Shifter not initialized / INIT" 6 "Signal not available / SNA (Double fault shifter sensor)"  ;
VAL_ 400 UINM_DrvReqShftInv 9 "Signal not available / SNA (Double fault shifter sensor)" 10 "Shifter not initialized / INIT" 11 "Shifter position B2" 12 "Shifter position B1" 13 "Shifter position F2" 14 "Shifter position F1" 15 "Shifter position O"  ;
VAL_ 400 UINM_FuSaErrSt 0 "No Error" 1 "Error"  ;
VAL_ 400 UINM_ShftFault 0 "E-shift Normal" 1 "E-shift fault"  ;
VAL_ 400 UINM_PositionLightSwSt 0 "Not Active" 1 "Active" 2 "fault" 3 "Reserved"  ;
VAL_ 400 UINM_LowBeamSwSt 0 "Not Active" 1 "Active" 2 "fault" 3 "Reserved"  ;
VAL_ 400 UINM_AutoLightSwSt 0 "Not Active" 1 "Active" 2 "fault" 3 "Reserved"  ;
VAL_ 400 UINM_FrontFogLightSwSt 0 "Not Active" 1 "Active"  ;
VAL_ 400 UINM_RearFogLightSwSt 0 "Not Active" 1 "Active"  ;
VAL_ 400 UINM_HighBeamSwSt 0 "Not active" 1 "Continue" 2 "Flash" 3 "fault"  ;
VAL_ 400 UINM_TurnLightSwSt 0 "Not active" 1 "Left turn" 2 "Right turn" 3 "Left change" 4 "Right change" 5 "Fault" 6 "Reserved" 7 "Reserved"  ;
VAL_ 400 UINM_FrontWiperSwSt 0 "Off" 1 "Low speed" 2 "Int/Auto" 3 "High speed" 4 "Mist" 5 "No used" 6 "Auto2" 7 "invaild"  ;
VAL_ 400 UINM_FrontWiperIntAdjSwSt 0 "No used" 15 "Invaild"  ;
VAL_ 400 UINM_FrontWasherSwSt 0 "Not Active" 1 "Active"  ;
VAL_ 400 UINM_RearWiperSwSt 0 "Off" 1 "Low speed" 2 "Int/Auto" 3 "High speed" 7 "invaild"  ;
VAL_ 400 UINM_RearWiperIntAdjSwSt 0 "No used" 15 "Invaild"  ;
VAL_ 400 UINM_RearWasherSwSt 0 "Inactive" 1 "Active"  ;
VAL_ 400 UINM_HeadLampWasherSwSt 0 "Inactive" 1 "Active"  ;
VAL_ 616 UMM_UsageModeSt 0 "Standby" 1 "Comfort" 2 "Reserved" 3 "DRV" 4 "Reserved" 5 "Reserved" 6 "Reserved" 7 "Invalid"  ;
VAL_ 616 OTA_FuncReq_ADCWakeup 0 "Inactive" 1 "Active" 2 "Reserved1" 3 "Reserved2" 4 "Reserved3" 5 "Reserved4" 6 "Reserved5" 7 "Reserved6"  ;
VAL_ 616 UMM_FrontPassengerSeatSt 0 "Undefined" 1 "Off" 2 "On" 3 "Failure"  ;
VAL_ 616 UMM_DriverSeatSt 0 "Undefined" 1 "Off" 2 "On" 3 "Failure"  ;
VAL_ 616 VMM_VehModeSt 0 "Normal Mode" 1 "Manufacture Mode" 2 "Transport Mode" 3 "Showroom Mode" 4 "PostCrash Mode" 5 "Maintenance Mode" 6 "Reserved" 7 "Reserved" 8 "Reserved" 9 "Reserved" 10 "Reserved" 11 "Reserved" 12 "Reserved" 13 "Reserved" 14 "Reserved" 15 "Invalid Value"  ;
VAL_ 616 VMM_LastVehModeSt 0 "Normal Mode" 1 "Manufacture Mode" 2 "Transport Mode" 3 "Showroom Mode" 4 "PostCrash Mode" 5 "Maintenance Mode" 6 "Reserved" 7 "Reserved" 8 "Reserved" 9 "Reserved" 10 "Reserved" 11 "Reserved" 12 "Reserved" 13 "Reserved" 14 "Reserved" 15 "Invalid Value"  ;
VAL_ 616 VMM_OTAModeSt 0 "NonOTA Mode" 1 "OTA Mode" 2 "Invalid Value" 3 "Seamless OTA"  ;
VAL_ 616 CSM_RC_PAARequest 0 "No request" 1 "SBM RPA request" 2 "SBM HPA request" 3 "EDK request" 4 "TSP HPA request" 5 "TSP AVP request" 6 "check picture" 7 "check video"  ;
VAL_ 616 IPDS_EnablePowerSup 0 "Not Active" 1 "Active" 2 "PreOFF" 3 "Reserve"  ;
VAL_ 616 CCU_DstFlag 0 "inactive" 1 "active"  ;
VAL_ 616 ASB_DriverActiveBeltFaultSt 0 "Not fault" 1 "Fault"  ;
VAL_ 616 IPDS_DCDCOpenCircuitSt 0 "Invalid" 1 "Normal" 2 "Open Circuit" 3 "Reserved"  ;
VAL_ 825 WW_FwpFaultSt 0 "Not fault" 1 "Fault"  ;
VAL_ 825 WW_RwpFaultSt 0 "Not fault" 1 "Fault"  ;
VAL_ 825 WW_FwshFaultSt 0 "Not fault" 1 "Fault"  ;
VAL_ 825 WW_RwshFaultSt 0 "Not fault" 1 "Fault"  ;
VAL_ 825 WW_FwpAutoModeSt 0 "False" 1 "True"  ;
VAL_ 825 WW_RainFallLevel 0 "No Rain" 1 "Level 1" 2 "Level 2" 3 "Level 3" 4 "Level 4" 5 "Level 5" 6 "Level 6" 7 "Level 7" 8 "Level 8" 9 "Level 9" 10 "Level 10" 11 "Level 11" 12 "Level 12" 13 "Level 13" 14 "Init value" 15 "Invalid value"  ;
VAL_ 825 RLS_LightOnReq 0 "Light Off" 1 "Light On"  ;
VAL_ 825 RLS_LampOnReqValid 0 "Valid value" 1 "Invalid value"  ;
VAL_ 825 RLS_WiperSpd 0 "Switch Off" 1 "Low speed/speed 1" 2 "speed 2" 3 "speed 3" 4 "speed 4" 5 "speed 5" 6 "speed 6" 7 "speed 7" 8 "speed 8" 9 "speed 9" 10 "speed 10" 11 "speed 11" 12 "speed 12" 13 "speed 13" 14 "High speed/speed 14" 15 "Invalid"  ;
VAL_ 825 RLS_RainfallLevel 0 "No Rain" 1 "Level 1" 2 "Level 2" 3 "Level 3" 4 "Level 4" 5 "Level 5" 6 "Level 6" 7 "Level 7" 8 "Level 8" 9 "Level 9" 10 "Level 10" 11 "Level 11" 12 "Level 12" 13 "Level 13" 14 "Init value" 15 "Invalid value"  ;
VAL_ 825 RLS_RSErr 0 "No Error" 1 "Error"  ;
VAL_ 825 RLS_LSErr 0 "No Error" 1 "Error"  ;
VAL_ 825 PM_AUTHPstState 0 "Disable" 1 "Enable"  ;
VAL_ 825 CCU_FuncReq_SentryMod 0 "OFF" 1 "SentryModeWake"  ;
VAL_ 825 CCU_ModeSuppressSts 0 "OFF" 1 "ON" 2 "UNKNOW"  ;
VAL_ 825 RLS_HUTErr 0 "HUT sensor normal" 1 "HUT sensor error"  ;
VAL_ 291 ATWS_ATWSAlarmReq 0 "No Request" 1 "Alarm ON" 2 "Alarm OFF"  ;
VAL_ 291 ATWS_ATWSSt 0 "DisArm" 1 "PreArm" 2 "Partially Armed" 3 "Fully Armed" 4 "PreDisarm" 5 "Alarm"  ;
VAL_ 291 WW_FrontWasherCmd 0 "No Request" 1 "Active" 2 "Not Active"  ;
VAL_ 291 WW_FrtWiperAutoAvl 0 "Not Available" 1 "Available"  ;
VAL_ 291 WW_FrontWiperCmd_Speed 0 "no request" 1 "off" 2 "low speed" 3 "high speed"  ;
VAL_ 291 WW_RearWiperCtrlSt 0 "Off" 1 "Int" 2 "LowSpeed" 3 "HighSpeed" 4 "Auto"  ;
VAL_ 291 WW_FrontWiperCtrlSt 0 "Off" 1 "Int" 2 "LowSpeed" 3 "HighSpeed" 4 "Auto"  ;
VAL_ 291 WW_FrontWiperCtrlSrc 0 "No source" 1 "Switch" 2 "VirtualKey" 3 "VoiceControl" 4 "RLS" 5 "OtherLocalSystem" 6 "WiperSystem" 7 "ServiceConsumer"  ;
VAL_ 291 WW_RearWiperCtrlSrc 0 "No source" 1 "Switch" 2 "VirtualKey" 3 "VoiceControl" 4 "RLS" 5 "OtherLocalSystem" 6 "WiperSystem" 7 "ServiceConsumer"  ;
VAL_ 291 WW_RearCamWasherVKResp 0 "No response" 1 "Success" 2 "Fail"  ;
VAL_ 291 WW_RearCamWasherVRResp 0 "No response" 1 "Success" 2 "Fail"  ;
VAL_ 291 CSM_RC_AuthSt 0 "Not Used" 1 "Pass" 2 "Failed"  ;
VAL_ 865 EL_ReverseLightCtrlCmd 0 "OFF" 1 "ON"  ;
VAL_ 865 EL_SideBrkLightCtrlCmd 0 "OFF" 1 "ON"  ;
VAL_ 865 EL_LeftLowBeamCtrlCmd 0 "OFF" 1 "ON"  ;
VAL_ 865 EL_RightLowBeamCtrlCmd 0 "OFF" 1 "ON"  ;
VAL_ 865 EL_PositionLightCtrlSource 0 "Not active" 1 "Group1" 2 "Group2" 3 "Group3" 4 "Reserved" 5 "Reserved" 6 "Reserved" 7 "Reserved"  ;
VAL_ 865 EL_LeftHighBeamCtrlCmd 0 "OFF" 1 "ON"  ;
VAL_ 865 EL_RightHighBeamCtrlCmd 0 "OFF" 1 "ON"  ;
VAL_ 865 EL_LowBeamCtrlSource 0 "Not active" 1 "Group1" 2 "Group2" 3 "Group3" 4 "Reserved" 5 "Reserved" 6 "Reserved" 7 "Reserved"  ;
VAL_ 865 EL_RearFogLightCtrlSource 0 "Not active" 1 "Group1" 2 "Group2" 3 "Group3" 4 "Reserved" 5 "Reserved" 6 "Reserved" 7 "Reserved"  ;
VAL_ 865 EL_HighBeamCtrlSource 0 "Not active" 1 "Group1" 2 "Group2" 3 "Group3" 4 "Reserved" 5 "Reserved" 6 "Reserved" 7 "Reserved"  ;
VAL_ 865 EL_FrontFogLightCtrlSource 0 "Not active" 1 "Group1" 2 "Group2" 3 "Group3" 4 "Reserved" 5 "Reserved" 6 "Reserved" 7 "Reserved"  ;
VAL_ 865 EL_LicencePlateLightCtrlSource 0 "Not active" 1 "Group1" 2 "Group2" 3 "Group3" 4 "Reserved" 5 "Reserved" 6 "Reserved" 7 "Reserved"  ;
VAL_ 865 EL_FlasherCtrlSource 0 "Not active" 1 "Group1_TurnLight" 2 "Group1_HazardLight" 3 "Group1_ReminderLight" 4 "Group2_HazardLight" 5 "Group2_ReminderLight" 6 "Group3" 7 "Reserved" 8 "Reserved" 9 "Reserved" 10 "Reserved" 11 "Reserved" 12 "Reserved" 13 "Reserved" 14 "Reserved" 15 "Reserved"  ;
VAL_ 865 EL_FADASLightCtrlCmd 0 "OFF" 1 "ON"  ;
VAL_ 865 EL_RADASLightCtrlCmd 0 "OFF" 1 "ON"  ;
VAL_ 865 EL_IHBColourSt 0 "No display" 1 "Active colour-blue" 2 "Standby colour-grey" 3 "Failure colour-yellow"  ;
VAL_ 865 EL_AutoHighBeamCtrlSt 0 "Not active" 1 "Active"  ;
VAL_ 865 EL_ADBEnable 0 "Disable" 1 "Enable"  ;
VAL_ 865 EL_ADC_2_VERFailFlag 0 "Not active" 1 "Active"  ;
VAL_ 865 EL_ADC_4_New_VERFailFlag 0 "Not active" 1 "Active"  ;
VAL_ 865 EL_ADC_8_VERFailFlag 0 "Not active" 1 "Active"  ;
VAL_ 865 EL_HeadLightLevelingSWSt 0 "Level 0" 1 "Level 1" 2 "Level 2" 3 "Level 3"  ;
VAL_ 865 EL_LeftTurnLightStForDisp 0 "OFF" 1 "ON"  ;
VAL_ 865 EL_RightTurnLightStForDisp 0 "OFF" 1 "ON"  ;
VAL_ 865 EL_PositionLightStForDisp 0 "OFF" 1 "ON"  ;
VAL_ 865 EL_FrontFogLightStForDisp 0 "OFF" 1 "ON"  ;
VAL_ 865 EL_RearFogLightStForDisp 0 "OFF" 1 "ON"  ;
VAL_ 865 EL_LowBeamStForDisp 0 "OFF" 1 "ON"  ;
VAL_ 865 EL_HighBeamStForDisp 0 "OFF" 1 "ON"  ;
VAL_ 865 EL_HeadLightSWSt 0 "OFF" 1 "Positon light" 2 "LowBeam" 3 "Auto"  ;
VAL_ 293 TPMS_FrontLeftTireBlowout 0 "No Function" 1 "Not Blowout" 2 "Blowout" 3 "Reserved"  ;
VAL_ 293 TPMS_FrontRightTireBlowout 0 "No Function" 1 "Not Blowout" 2 "Blowout" 3 "Reserved"  ;
VAL_ 293 TPMS_RearRightTireBlowout 0 "No Function" 1 "Not Blowout" 2 "Blowout" 3 "Reserved"  ;
VAL_ 293 TPMS_RearLeftTireBlowout 0 "No Function" 1 "Not Blowout" 2 "Blowout" 3 "Reserved"  ;
VAL_ 293 TPMS_FrontLeftTirePressure 0 "Invalid" 255 "Unknown"  ;
VAL_ 293 TPMS_FrontRightTirePressure 0 "Invalid" 255 "Unknown"  ;
VAL_ 293 TPMS_RearRightTirePressure 0 "Invalid" 255 "Unknown"  ;
VAL_ 293 TPMS_RearLeftTirePressure 0 "Invalid" 255 "Unknown"  ;
VAL_ 293 TPMS_TireWarningLamp 0 "NoWarning" 1 "Warning"  ;
VAL_ 293 TPMS_SystemWarningLamp 0 "NoWarning" 1 "Warning"  ;
VAL_ 294 LCK_DriverDoorAjarSt 0 "Closed" 1 "Opened"  ;
VAL_ 294 LCK_PassengerDoorAjarSt 0 "Closed" 1 "Opened"  ;
VAL_ 294 LCK_DriverDoorLockSt 0 "Locked" 1 "Unlocked"  ;
VAL_ 294 LCK_PassengerDoorLockSt 0 "Locked" 1 "Unlocked"  ;
VAL_ 294 LCK_VehicleDoorAjarSt 0 "ALLDoorsClosed" 1 "AllDoorsClosedAndHoodorTrunkOpened" 2 "AnyDoorOpened"  ;
VAL_ 294 LCK_VehicleDoorLockSt 0 "AllDoorLocked" 1 "PartialDoorUnlocked" 2 "AllDoorUnlocked"  ;
VAL_ 294 LCK_VehicleChildSaftyLockSt 0 "AllChildSaftyLocked" 1 "AnyChildSaftyUnlocked"  ;
VAL_ 294 LCK_VehicleChildSaftyLockedIndicate 0 "IndicateLampOff" 1 "IndicateLampOn"  ;
VAL_ 334 CSM_RC_ViewExtvideo 65535 "invalid? 无效值"  ;
VAL_ 334 CSM_RC_ViewExtvideoReq 0 "No Request" 1 "Request"  ;
VAL_ 93 CCU_ADCSoCWakeupRequest 0 "No Request" 1 "Request" 2 "Reserved" 3 "Reserved" 4 "Reserved" 5 "Reserved" 6 "Reserved" 7 "Reserved"  ;
VAL_ 777 EL_MRADASLightSt 0 "Off" 1 "On" 2 "Fault" 3 "Not used"  ;
VAL_ 777 MR_RightMirrorFoldUnfoldSt 0 "Unknown" 1 "Mirror fold" 2 "Mirror unfold" 3 "Reserved"  ;
VAL_ 777 PWL_WinCurrentPos_FRWinPst 255 "Undefined window position"  ;
VAL_ 777 EL_MRTurnLightSt 0 "Not active" 1 "OFF" 2 "ON" 3 "Not used"  ;
VAL_ 777 EL_MRTurnLightFaultSt 0 "Not fault" 1 "Fault"  ;
VAL_ 777 KAE_toADCDRVUnlockSensorSt 0 "No active" 1 "Active"  ;
VAL_ 777 KAE_toADCDRVLockSensorSt 0 "No active" 1 "Active"  ;
VAL_ 777 EL_RightBSDIndicatorSt 0 "OFF" 1 "ON"  ;
VAL_ 777 EL_RightBSDIndicatorFaultSt 0 "Not fault" 1 "Fault"  ;
VAL_ 163 ACU_RAEBcfg 0 "No request" 1 "Off" 2 "On"  ;
VAL_ 163 ACU_PAAMode 0 "No Request；" 1 "APA" 2 "RPA" 3 "HPA" 4 "AVP" 5 "RA" 6 "Customer Slot" 7 "PAA" 8 "APA OFF；" 9 "PAA OFF；" 10 "RA OFF；" 11 "DP" 12 "SteeringParkingButton"  ;
VAL_ 163 ACU_SVM_Button 0 "No request" 1 "Request"  ;
VAL_ 163 ACU_PCS_MirrorpagedownButtonST 0 "Off" 1 "On"  ;
VAL_ 163 ACU_PCS_ScreenTouchSt 0 "No command" 1 "Press" 2 "Release" 3 "Slither"  ;
VAL_ 163 ACU_LanguageTypeSet 0 "Not used" 1 "Chinese" 2 "English" 3 "Russian" 4 "Arabic" 5 "Latin Spanish" 6 "Thai" 7 "Norwegian" 8 "HK" 9 "Indonesian" 10 "Melayu" 11 "Vietnamese" 12 "Deutsch" 13 "French" 14 "Italian" 15 "Spanish" 16 "Dutch" 17 "Swedish" 18 "Portuguese" 19 "Brazilian Portuguese"  ;
VAL_ 163 ACU_PCS_SVM_FunctionCmd 0 "No command" 1 "HMI in transition(SVM)" 2 "Surround view and Front view(SVM)" 3 "Enlarge front view(SVM)" 4 "Surround view and Rear view(SVM)" 5 "Enlarge rear view(SVM)" 6 "Left blind spot view (SVM)" 7 "Right blind spot view(SVM)" 8 "Parking guidance view(SVM)" 9 "Parallel parking view(SVM)" 10 "Vertical parking view(SVM)" 11 "Rear view(RVM)" 12 "Parallel parking view(RVM)" 13 "Vertical parking view(RVM)" 14 "Not used" 15 "Request to cancel"  ;
VAL_ 163 ACU_PCS_ScreenCoordY 0 "No command"  ;
VAL_ 163 ACU_PCS_ScreenCoordX 0 "No command"  ;
VAL_ 163 ACU_APAMessageSt 0 "No Command" 1 "Show" 2 "Auto close" 3 "Maual close" 4 "Manual active"  ;
VAL_ 163 ACU_PAS_ButtonPress 0 "Not press" 1 "Press"  ;
VAL_ 163 ACU_HPAMessageSt 0 "None" 1 "Show" 2 "Auto close" 3 "Maual close" 4 "Maual Active"  ;
VAL_ 163 ACU_AVPMessageSt 0 "None" 1 "Show" 2 "Auto close" 3 "Maual close" 4 "Maual Active"  ;
VAL_ 163 ACU_HPALearningSetParkLot 0 "Invalid" 1 "Fixed parking lot" 2 "Random parking lot" 3 "Reserved"  ;
VAL_ 163 ACU_HPALearningProcessInfo 0 "No text" 1 "Set path starting point" 2 "Speed high" 3 "Starting point invalid" 4 "Continue driving" 5 "Distance limit" 6 "Exceed learning distance limit" 7 "Automatic parking in" 8 "Saving path" 9 "Learning path invalid_Reserved" 10 "Setting path name" 11 "Learning path valid_Reserved" 12 "Fixed or random parking lot" 13 "Learning finished" 14 "Keep drving to ending" 15 "Setting path ending" 15 "Setting path ending" 17 "Learning path failed" 18 "Speed higher than 15km/h" 19 "Speed higher than 20km/h and quit" 20 "Reserved" 21 "Reserved" 22 "Reserved" 23 "Reserved" 24 "Reserved" 25 "Reserved" 26 "Reserved" 27 "Reserved" 28 "Reserved" 29 "Reserved" 30 "Reserved" 31 "Reserved"  ;
VAL_ 163 ACU_SDEnterParkingLot 0 "No Request" 1 "Not enter" 2 "Entered" 3 "Unknown"  ;
VAL_ 163 ACU_PCS_ER_QuitConfirm 0 "No command" 1 "Command"  ;
VAL_ 163 ACU_DisplayReq 0 "No command" 1 "On" 2 "Off"  ;
VAL_ 163 ACU_ER_FuncCfg 0 "No command" 1 "On" 2 "Off"  ;
VAL_ 163 ACU_PCS_ER_EnterCmd 0 "No command" 1 "Command"  ;
VAL_ 163 ACU_PCS_ScreenTouchSignal 0 "No command" 1 "press" 2 "Release" 3 "Slither"  ;
VAL_ 163 ACU_DPMessageSt 0 "No Command" 1 "Show" 2 "Auto close" 3 "Maual close" 4 "Manual active"  ;
VAL_ 163 ACU_ParkingBoxMidX 0 "No command"  ;
VAL_ 163 ACU_ParkingBoxMidY 0 "No command"  ;
VAL_ 163 ACU_LowPowerConfig 0 "No command" 1 "LowPower Mode Requst" 2 "Normal Mode Request" 3 "ModeChaging"  ;
VAL_ 163 ACU_PCSModeSt 0 "Normal mode" 1 "Quick start mode;"  ;
VAL_ 163 ACU_PCSModeSt_A 0 "No command;" 1 "Quick start mode;" 2 "Normal mode"  ;
VAL_ 163 ACU_ParkingBoxAngle 0 "No command"  ;
VAL_ 163 IDC_APAParkingSpdsSfg 0 "No Request;" 1 "SlowReq" 2 "MiddleReq" 3 "HighReq"  ;
VAL_ 163 IDC_DskScreenOperationSt 0 "Not Operating" 1 "Operating"  ;
VAL_ 163 IDC_SenslesEtyParkingSwSt 0 "Not request" 1 "OFF" 2 "ON"  ;
VAL_ 163 ACU_NDAVoicePromptTypeCfg 0 "Not selected" 1 "simple" 2 "full" 3 "Not used"  ;
VAL_ 163 IDC_SenslesEtyParkingDskScene 0 "None;" 1 "VehicleModeScene" 2 "NaviScene" 3 "WallpaperScene" 7 "OthersScene"  ;
VAL_ 163 ACU_VR_APAControl 0 "No Request；" 1 "APA自动泊车功能；" 2 "RPA遥控泊车功能；" 3 "HPA记忆泊车功能；" 4 "AVP代客泊车功能；" 5 "RA倒车寻迹功能；" 6 "Customer Slot 自选车位功能；" 7 "AVM 全景影像；" 8 "OFF泊车关闭/退出；" 9 "StartParking开始/继续泊车；" 10 "Pause泊车暂停；"  ;
VAL_ 163 ACU_SteeringPrkgButton 0 "No Request；" 1 "APA自动泊车功能；" 2 "RPA遥控泊车功能；" 3 "HPA记忆泊车功能；" 4 "AVP代客泊车功能；" 5 "RA倒车寻迹功能；" 6 "Customer Slot 自选车位功能；" 7 "AVM 全景影像；"  ;
VAL_ 163 ACU_ActiveNDAMessageSt 0 "No command" 1 "Active" 2 "Auto close" 3 "Manuel close" 4 "Manuel confirm"  ;
VAL_ 163 ACU_ActiveAVPMessageSt 0 "No command" 1 "Active" 2 "Auto close" 3 "Manuel close" 4 "Manuel confirm"  ;
VAL_ 163 ACU_LeftLaneChangeMessageSt 0 "No command" 1 "Active" 2 "Auto close" 3 "Manuel close" 4 "Manuel confirm"  ;
VAL_ 163 ACU_RigthLaneChangeMessageSt 0 "No command" 1 "Active" 2 "Auto close" 3 "Manuel close" 4 "Manuel confirm"  ;
VAL_ 163 ACU_ICANDAIconMessageSt 0 "No command" 1 "press"  ;
VAL_ 163 ACU_SVM_Button_A 0 "No request" 1 "Open SVM" 2 "Close SVM" 3 "Open Trailer Monitoring" 4 "Not used" 5 "Not used" 6 "Not used" 7 "Not used"  ;
VAL_ 618 EPB_SwitchSt 0 "Not active" 1 "Released" 2 "Applied" 3 "Not used"  ;
VAL_ 618 EPB_SwitchStVD 0 "Not valid" 1 "Valid"  ;
VAL_ 618 EPB_SysSt 0 "Release (fully released)" 1 "Apply (fully applied)" 2 "Releasing" 3 "Applying" 4 "Disengaged" 5 "Not used" 6 "Not used" 7 "Fault(not sure position)"  ;
VAL_ 618 EPB_FailSt 0 "No error" 1 "Error"  ;
VAL_ 618 EPB_ExtAvailable 0 "Apply and release" 1 "Only apply" 2 "Only release" 3 "None"  ;
VAL_ 618 EPB_DynamicApplySt 0 "Not active" 1 "BCS dynamic apply" 2 "Anti-Lock Apply" 3 "EPB degraded apply" 4 "Not used" 5 "Not used" 6 "Not used" 7 "Not used"  ;
VAL_ 618 EPB_ActuatorSt_R 0 "PbcActuatorState_Applied" 1 "PbcActuatorState_Released" 2 "PbcActuatorState_Applying" 3 "PbcActuatorState_Releasing" 4 "PbcActuatorState_Unknown" 5 "PbcActuatorState_HoldApplied" 6 "PbcActuatorState_CompletelyReleased" 7 "Not used" 8 "Not used" 9 "Not used" 10 "Not used" 11 "Not used" 12 "Not used" 13 "Not used" 14 "Not used" 15 "Not used"  ;
VAL_ 618 EPB_RWUActvSts 0 "Not active" 1 "CDP active" 2 "RWU active" 3 "Limp home"  ;
VAL_ 618 EPB_RWUAvl 0 "Not available" 1 "Reserved" 2 "RWU available" 3 "Limp home available"  ;
VAL_ 618 EPB_RPAAVPAvailability 0 "NotAvailable" 1 "Available" 2 "TestPending"  ;
VAL_ 618 EPB_APAAvailability 0 "NotAvailable" 1 "Available"  ;
