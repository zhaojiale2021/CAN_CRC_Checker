VERSION "Version"

NS_ :

BS_:

BU_: Tester CCU ADC CCU_CCURT1 CCU_CCURT2 RLR RRR ZCUF ZCUL ZCUR ZCUT EMS IDM DCDC IPS NIDU NIDUF DCUR OBC OPC LPC CPC EMCM GCU DCUF IPU BMS EOPF EOPR EVCC DCDC2 EDL SRS ECS EPS EPB RBM IBCS ICM IID IDC PHUDD AMP WHUD IMR INU IFC FAPA PAS PCS SCMR SCMRL SCMRR HVSMR SCMRM MFS WSM DRM IDU FCP LBMSAD AVAS ATSS DLPFL FBLCM FLISD FLLCM FRLCM RLLCMA RLLCMB RRLCMA RRLCMB RLISD DLPML DLPMR TRM PSDL PSDR HVSPRL HVSPRR RFR SBM WCM ETC TBOX2 TBOX IDUR CBM PLGM TMC LPC2 SCMT RCP RRISD LBMS RLBMS CCURT1 CCURT2 RT1_C1 RT2_C3 RT1_C0 OTAWL RAS EBB RCICP WCMFR WCMRL SAS CD

BO_ 2015 Fun_Diag_Rx: 64 Tester
 SG_ Fun_Diag_Request : 7|512@0+ (1,0) [0|0] ""  ZCUF,ZCUL,ZCUR,ZCUT,EMS,IDM,DCDC,IPS,NIDU,NIDUF,DCUR,OBC,OPC,LPC,CPC,EMCM,GCU,DCUF,IPU,BMS,EOPF,EOPR,EVCC,DCDC2,EDL,SRS,ECS,EPS,EPB,RBM,IBCS,ICM,IID,IDC,PHUDD,AMP,WHUD,IMR,INU,ADC,IFC,FAPA,RRR,RLR,PAS,PCS,SCMR,SCMRL,SCMRR,HVSMR,SCMRM,MFS,WSM,DRM,IDU,FCP,LBMSAD,AVAS,ATSS,DLPFL,FBLCM,FLISD,FLLCM,FRLCM,RLLCMA,RLLCMB,RRLCMA,RRLCMB,RLISD,DLPML,DLPMR,TRM,PSDL,PSDR,HVSPRL,HVSPRR,RFR,SBM,WCM,ETC,TBOX2,TBOX

BO_ 352 CCU_BCS_2_C: 64 CCU
 SG_ BCS_2_CRC : 7|16@0+ (1,0) [0|65535] ""  ZCUF,ZCUL,ZCUR,ZCUT,IDM,IPS,NIDU,NIDUF,DCUR,IDUR,OBC,DCUF,IPU,CBM,ICM,IDC,INU,ADC,IFC,FAPA,RRR,RLR,DRM,FLISD,RLLCMA,RLLCMB,RRLCMA,RRLCMB,PLGM,TRM,PSDL,PSDR,TBOX
 SG_ BCS_2_Counter : 23|8@0+ (1,0) [0|255] ""  ZCUF,ZCUL,ZCUR,ZCUT,IDM,IPS,NIDU,NIDUF,DCUR,IDUR,OBC,DCUF,IPU,CBM,ICM,IDC,INU,ADC,IFC,FAPA,RRR,RLR,DRM,FLISD,PLGM,TRM,TBOX
 SG_ BCS_VehSpd : 31|13@0+ (0.05625,0) [0|240] "km/h"  TMC,ZCUF,ZCUL,ZCUR,ZCUT,EMS,IDM,DCDC,IPS,NIDU,NIDUF,DCUR,IDUR,OBC,OPC,LPC,LPC2,CPC,EMCM,GCU,DCUF,IPU,BMS,EVCC,DCDC2,EDL,CBM,ICM,IID,IDC,PHUDD,AMP,IMR,INU,ADC,IFC,FAPA,RRR,RLR,PAS,PCS,SCMR,SCMRL,SCMRR,HVSMR,SCMRM,SCMT,MFS,WSM,DRM,IDU,FCP,RCP,LBMSAD,AVAS,ATSS,DLPFL,FBLCM,FLISD,FLLCM,FRLCM,RLLCMA,RLLCMB,RRLCMA,RRLCMB,RLISD,RRISD,DLPML,DLPMR,PLGM,TRM,PSDL,PSDR,HVSPRL,HVSPRR,LBMS,RLBMS,TBOX2,TBOX
 SG_ BCS_VehSpdVD : 34|1@0+ (1,0) [0|1] ""  TMC,ZCUF,ZCUL,ZCUR,ZCUT,EMS,IDM,DCDC,IPS,NIDU,NIDUF,DCUR,IDUR,OBC,OPC,LPC,LPC2,CPC,GCU,DCUF,IPU,BMS,EVCC,DCDC2,CBM,ICM,IID,IDC,PHUDD,AMP,IMR,INU,ADC,IFC,FAPA,RRR,RLR,PAS,SCMR,SCMRL,SCMRR,HVSMR,SCMRM,SCMT,MFS,DRM,IDU,FCP,RCP,LBMSAD,AVAS,ATSS,DLPFL,FBLCM,FLISD,FLLCM,FRLCM,RLLCMA,RLLCMB,RRLCMA,RRLCMB,RLISD,RRISD,DLPML,DLPMR,PLGM,TRM,PSDL,PSDR,HVSPRL,HVSPRR,LBMS,RLBMS,TBOX
 SG_ BCS_EBDActiveSt : 32|1@0+ (1,0) [0|1] ""  ZCUF,ZCUL,NIDU,NIDUF,DCUR,ADC,IFC,FAPA,RRR,RLR
 SG_ BCS_EBDFaultSt : 47|1@0+ (1,0) [0|1] ""  ZCUF,ZCUL,NIDU,NIDUF,DCUR,ICM,IID,IDC,PHUDD,ADC,IFC,FAPA,TBOX
 SG_ BCS_ABSActiveSt : 46|1@0+ (1,0) [0|1] ""  ZCUF,ZCUL,NIDU,NIDUF,DCUR,IDUR,ADC,IFC,FAPA,RRR,RLR
 SG_ BCS_ABSFaultSt : 45|1@0+ (1,0) [0|1] ""  ZCUF,ZCUL,NIDU,NIDUF,DCUR,IDUR,ICM,IID,IDC,PHUDD,ADC,IFC,FAPA,TBOX
 SG_ BCS_TCSActiveSt : 44|1@0+ (1,0) [0|1] ""  ZCUF,ZCUL,ZCUR,ZCUT,NIDU,NIDUF,DCUR,IDUR,ICM,IID,IDC,PHUDD,ADC,IFC,FAPA,RRR,RLR,TBOX
 SG_ BCS_TCSFaultSt : 43|1@0+ (1,0) [0|1] ""  ZCUF,ZCUL,ZCUR,ZCUT,NIDU,NIDUF,DCUR,IDUR,ICM,IID,IDC,PHUDD,ADC,IFC,FAPA,RRR,RLR,TBOX
 SG_ BCS_VDCActiveSt : 42|1@0+ (1,0) [0|1] ""  ZCUF,ZCUL,NIDU,NIDUF,DCUR,IDUR,ICM,IID,IDC,PHUDD,ADC,IFC,FAPA,RRR,RLR,PCS,TBOX
 SG_ BCS_VDCFaultSt : 41|1@0+ (1,0) [0|1] ""  ZCUF,ZCUL,NIDU,NIDUF,DCUR,IDUR,ICM,IID,IDC,PHUDD,ADC,IFC,FAPA,RRR,RLR,TBOX
 SG_ BCS_PreAndRealVDCActiveSt : 67|1@0+ (1,0) [0|1] ""  ZCUF,ZCUL,ADC,IFC,FAPA
 SG_ BCS_DTCAvailable : 64|1@0+ (1,0) [0|1] ""  ZCUF,ZCUL,NIDU,NIDUF,DCUR,IDUR,ADC,IFC,FAPA
 SG_ BCS_DTCActiveSt : 79|1@0+ (1,0) [0|1] ""  ZCUF,ZCUL,NIDU,NIDUF,DCUR,IDUR,ADC,IFC,FAPA
 SG_ BCS_RealTCSActiveSt : 95|1@0+ (1,0) [0|1] ""  IDC,ADC,IFC,FAPA,TBOX
 SG_ BCS_CrbsActive : 105|1@0+ (1,0) [0|1] ""  ZCUF,ZCUL,ADC,IFC,FAPA
 SG_ BCS_BrkPedalStVD : 224|1@0+ (1,0) [0|1] ""  ADC,IFC,FAPA
 SG_ BCS_BrkPedalSt : 227|2@0+ (1,0) [0|3] ""  ZCUF,ZCUL,ZCUR,ZCUT,ICM,IDC,ADC,IFC,FAPA,TBOX
 SG_ BCS_EngTorqDecFastRA : 55|16@0+ (1,-30000) [-30000|30000] "Nm"  ADC,IFC,FAPA
 SG_ BCS_EngTorqIncRA : 77|14@0+ (1,-6000) [-6000|10380] "Nm"  ADC,IFC,FAPA
 SG_ BCS_TargetRecpTorqRqFA : 197|14@0+ (1,-6000) [-6000|6000] "Nm"  ADC,IFC,FAPA
 SG_ BCS_TargetRecpTorqRqFASt : 215|2@0+ (1,0) [0|3] ""  ADC,IFC,FAPA
 SG_ BCS_TargetRecpTorqRqRA : 213|14@0+ (1,-6000) [-6000|6000] "Nm"  ADC,IFC,FAPA
 SG_ BCS_TargetRecpTorqRqRASt : 231|2@0+ (1,0) [0|3] ""  ADC,IFC,FAPA
 SG_ BCS_EngTorqDecActiveStRA : 233|1@0+ (1,0) [0|1] ""  NIDU,NIDUF,DCUR,IDUR,ADC,IFC,FAPA
 SG_ BCS_EngTorqDecActiveStFA : 375|1@0+ (1,0) [0|1] ""  ADC,IFC,FAPA
 SG_ BCS_EngTorqIncActiveStFA : 383|1@0+ (1,0) [0|1] ""  ADC,IFC,FAPA
 SG_ BCS_ADCNetErrorFb : 156|3@0+ (1,0) [0|7] ""  ADC,IFC,FAPA
 SG_ BCS_NetModeResp : 158|2@0+ (1,0) [0|3] ""  ADC,FAPA
 SG_ BCS_EngTorqDecFastFA : 399|16@0+ (1,-30000) [-30000|30000] "Nm"  ADC,IFC,FAPA
 SG_ BCS_EngTorqIncFA : 415|16@0+ (1,-30000) [-30000|30000] "Nm"  ADC,IFC,FAPA

BO_ 1238 FR_DiagCode: 64 ADC
 SG_ FR_DTCCode : 7|512@0+ (1,0) [0|0] ""  CCU

BO_ 403 ADC_1: 64 ADC
 SG_ ADC_1_CRC : 7|16@0+ (1,0) [0|65535] ""  CCU,ICM,IDC,FAPA
 SG_ ADC_1_Counter : 23|8@0+ (1,0) [0|255] ""  CCU,ICM,IDC,FAPA
 SG_ ADC_ACCMode : 31|4@0+ (1,0) [0|15] ""  CCU,ICM,IDC,FAPA
 SG_ ADC_ACCFailureReason : 59|4@0+ (1,0) [0|15] ""  CCU,FAPA
 SG_ ADC_ACCPassiveReason : 67|4@0+ (1,0) [0|15] ""  CCU,FAPA
 SG_ ADC_TJP_St : 79|5@0+ (1,0) [0|31] ""  CCU,FAPA
 SG_ ADC_TJPIconColor : 74|3@0+ (1,0) [0|7] ""  CCU,FAPA
 SG_ ADC_TimeGapSet : 87|3@0+ (1,0) [0|7] ""  CCU,FAPA
 SG_ ADC_ICA_St : 84|5@0+ (1,0) [0|31] ""  CCU,FAPA
 SG_ ADC_Cruise_SpeedLimitType : 91|4@0+ (1,0) [0|15] ""  CCU,FAPA
 SG_ ADC_LaneChangeSt : 119|4@0+ (1,0) [0|15] ""  CCU,FAPA
 SG_ ADC_LaneChange_AbortReason : 123|4@0+ (1,0) [0|15] ""  CCU,FAPA
 SG_ ADC_LaneChange_Actdirection : 135|2@0+ (1,0) [0|3] ""  CCU,FAPA
 SG_ ADC_ICA_MRMReason : 133|3@0+ (1,0) [0|7] ""  CCU,FAPA
 SG_ ADC_ICA_Mileage : 130|11@0+ (1,0) [0|2000] ""  CCU,FAPA
 SG_ ADC_ICA_PassiveReason : 149|6@0+ (1,0) [0|63] ""  CCU,FAPA
 SG_ ADC_ICA_faultReason : 159|5@0+ (1,0) [0|31] ""  CCU,FAPA
 SG_ ADC_HFIconColor : 154|3@0+ (1,0) [0|7] ""  CCU,FAPA
 SG_ ADC_MRMNumber : 167|4@0+ (1,0) [0|15] ""  CCU,FAPA
 SG_ ADC_MRCNumber : 163|4@0+ (1,0) [0|15] ""  CCU,FAPA
 SG_ ADC_HandsOnSt : 175|2@0+ (1,0) [0|3] ""  CCU,FAPA
 SG_ ADC_ICMADASFailureText : 183|8@0+ (1,0) [0|255] ""  CCU,FAPA
 SG_ ADC_ICMADASWarnText : 191|5@0+ (1,0) [0|31] ""  CCU,FAPA
 SG_ ADC_SpeedLimitIconSt : 186|3@0+ (1,0) [0|7] ""  CCU,FAPA
 SG_ ADC_ICMWarnCardSt : 199|5@0+ (1,0) [0|31] ""  CCU,FAPA
 SG_ ADC_ICAIconColor : 194|3@0+ (1,0) [0|7] ""  CCU,FAPA
 SG_ ADC_ICMPromptWarn : 207|5@0+ (1,0) [0|31] ""  CCU,FAPA
 SG_ ADC_ACUVoiceWarn : 215|5@0+ (1,0) [0|31] ""  CCU,FAPA
 SG_ ADC_NDAStateIcon : 210|3@0+ (1,0) [0|7] ""  CCU,FAPA
 SG_ ADC_SpeedLimitIcon : 223|8@0+ (1,0) [0|255] "km/h"  CCU,FAPA
 SG_ ADC_ICANDAIconAngle : 231|8@0+ (2,-180) [-180|180] "degree"  CCU,FAPA
 SG_ ADC_ACCTargetSpeedCard : 239|8@0+ (1,0) [0|255] "km/h"  CCU,FAPA
 SG_ ADC_ACCIconColor : 247|3@0+ (1,0) [0|7] ""  CCU,FAPA
 SG_ ADC_ICMADASFailureLamp : 244|2@0+ (1,0) [0|3] ""  CCU,FAPA
 SG_ ADC_Pilot_VoiceWarn : 242|5@0+ (1,0) [0|31] ""  CCU
 SG_ ADC_Pilot_PromptWarn : 253|5@0+ (1,0) [0|31] ""  CCU
 SG_ ADC_Pilot_WarnText : 248|5@0+ (1,0) [0|31] ""  CCU
 SG_ ADC_Pilot_WarnCardSt : 259|5@0+ (1,0) [0|31] ""  CCU
 SG_ NDA_Type : 27|3@0+ (1,0) [0|7] ""  CCU,FAPA
 SG_ ADAS_System_Failure_St : 55|6@0+ (1,0) [0|63] ""  CCU,FAPA
 SG_ ADAS_Related_System_Failure_St : 24|5@0+ (1,0) [0|31] ""  CCU,FAPA
 SG_ ADC_AdsFault : 266|3@0+ (1,0) [0|7] ""  CCU,FAPA
 SG_ ADC_NicaReminderLEDVisual : 269|3@0+ (1,0) [0|7] ""  CCU,FAPA
 SG_ ADC_NicaReminderAcoustic : 359|3@0+ (1,0) [0|7] ""  CCU,FAPA
 SG_ ADC_AdsTakeoverID : 279|16@0+ (1,0) [0|65535] ""  CCU,FAPA
 SG_ ADC_AdsTakeoverLevel : 339|3@0+ (1,0) [0|7] ""  CCU,FAPA
 SG_ ADC_TORIDCorrespErrorID : 295|16@0+ (1,0) [0|65535] ""  CCU,FAPA
 SG_ ADC_TakeoverExtended16bit : 311|16@0+ (1,0) [0|65535] "m"  CCU,FAPA
 SG_ ADC_TakeoverExtended8bit : 327|8@0+ (1,0) [0|255] ""  CCU,FAPA
 SG_ ADC_AdsFucntionNotActive : 171|4@0+ (1,0) [0|15] ""  CCU,FAPA
 SG_ ADC_AvpFunctionStatus : 356|5@0+ (1,0) [0|31] ""  CCU,FAPA
 SG_ ADC_CalibState : 331|4@0+ (1,0) [0|15] ""  CCU,FAPA
 SG_ ADC_AccFunctionStatus : 335|4@0+ (1,0) [0|15] ""  CCU,FAPA
 SG_ ADC_NicaFunctionStatus : 349|6@0+ (1,0) [0|63] ""  CCU,FAPA
 SG_ ADC_AEBWaning : 343|4@0+ (1,0) [0|15] ""  CCU,FAPA
 SG_ ADC_LKAWarning : 336|3@0+ (1,0) [0|7] ""  CCU,FAPA
 SG_ ADC_LCCStateIcon : 367|3@0+ (1,0) [0|7] ""  CCU,FAPA
 SG_ Reserved1 : 440|1@0+ (1,0) [0|0] ""  CCU,FAPA

BO_ 411 ADC_2: 64 ADC
 SG_ ADC_2_CRC : 7|16@0+ (1,0) [0|65535] ""  CCU,CCURT1,CCURT2,RT1_C1,RT2_C3,FAPA
 SG_ ADC_2_Counter : 23|8@0+ (1,0) [0|255] ""  CCU,CCURT1,CCURT2,RT1_C1,RT2_C3,FAPA
 SG_ ADC_FCWAssistType : 31|2@0+ (1,0) [0|3] ""  CCU,FAPA,RRR,RLR
 SG_ ADC_FCWFaultSt : 29|1@0+ (1,0) [0|1] ""  CCU,FAPA
 SG_ ADC_FCWPreWarn : 28|2@0+ (1,0) [0|3] ""  CCU,FAPA
 SG_ ADC_FCWLatentWarn : 26|2@0+ (1,0) [0|3] ""  CCU,FAPA
 SG_ ADC_FCWWarmDistance : 37|2@0+ (1,0) [0|3] ""  CCU,FAPA,RRR,RLR
 SG_ ADC_AEBTarObjType : 35|4@0+ (1,0) [0|15] ""  CCU,CCURT1,RT1_C1,FAPA
 SG_ ADC_BSDVibrWarnR : 46|3@0+ (1,0) [0|7] ""  CCU,FAPA
 SG_ ADC_BSDVibrWarnL : 43|3@0+ (1,0) [0|7] ""  CCU,FAPA
 SG_ ADC_AEBBrkPedalOverRide : 52|1@0+ (1,0) [0|1] ""  CCU,CCURT1,RT1_C1,FAPA
 SG_ ADC_AEBBrePedalPressure : 51|1@0+ (1,0) [0|1] ""  CCU,CCURT1,RT1_C1,FAPA
 SG_ ADC_AEBAccelePedalOverRide : 50|1@0+ (1,0) [0|1] ""  CCU,CCURT1,RT1_C1,FAPA
 SG_ ADC_AEBSteeringInhibit : 49|1@0+ (1,0) [0|1] ""  CCU,CCURT1,RT1_C1,FAPA
 SG_ ADC_PMAEnableSt : 47|1@0+ (1,0) [0|1] ""  CCU,FAPA
 SG_ ADC_PMAWarStatus : 48|1@0+ (1,0) [0|1] ""  CCU,FAPA
 SG_ ADC_AEBTarLatPos : 63|10@0+ (0.1,-51.2) [-51.2|51.1] "m"  CCU,CCURT1,RT1_C1,FAPA
 SG_ ADC_AEBTarRangeRate : 69|10@0+ (0.1,-51.2) [-51.2|51.1] "m/s"  CCU,CCURT1,RT1_C1,FAPA
 SG_ ADC_AEBTarOncomingState : 87|1@0+ (1,0) [0|1] ""  CCU,CCURT1,RT1_C1,FAPA
 SG_ ADC_AEBTarMotionState : 86|2@0+ (1,0) [0|3] ""  CCU,CCURT1,RT1_C1,FAPA
 SG_ ADC_AEBTarConfiLevel : 84|3@0+ (1,0) [0|7] ""  CCU,CCURT1,RT1_C1,FAPA
 SG_ ADC_AEBTarLongPos : 81|10@0+ (0.1,0) [0|102.3] "m"  CCU,CCURT1,RT1_C1,FAPA
 SG_ ADC_AEBTarLatSpd : 103|9@0+ (0.1,-25.5) [-25.5|25.5] "m/s"  CCU,CCURT1,RT1_C1,FAPA
 SG_ ADC_AEBTarRangeAccel : 105|9@0+ (0.1,-25.5) [-25.5|25.5] "m/s^2"  CCU,CCURT1,RT1_C1,FAPA
 SG_ ADC_DOWAudioWarnFR : 143|2@0+ (1,0) [0|3] ""  CCU,IDC,FAPA
 SG_ ADC_DOWAudioWarnFL : 141|2@0+ (1,0) [0|3] ""  CCU,IDC,FAPA
 SG_ ADC_DOWAudioWarnRR : 139|2@0+ (1,0) [0|3] ""  CCU,IDC,FAPA
 SG_ ADC_DOWAudioWarnRL : 137|2@0+ (1,0) [0|3] ""  CCU,IDC,FAPA
 SG_ ADC_DOWIALWarnFR : 151|2@0+ (1,0) [0|3] ""  CCU,CCURT2,RT2_C3,IDC,FAPA
 SG_ ADC_DOWIALWarnFL : 149|2@0+ (1,0) [0|3] ""  CCU,CCURT2,RT2_C3,IDC,FAPA
 SG_ ADC_DOWIALWarnRR : 147|2@0+ (1,0) [0|3] ""  CCU,CCURT2,RT2_C3,IDC,FAPA
 SG_ ADC_DOWIALWarnRL : 145|2@0+ (1,0) [0|3] ""  CCU,CCURT2,RT2_C3,IDC,FAPA
 SG_ ADC_BSDExMirLedWarnR : 159|2@0+ (1,0) [0|3] ""  CCU,CCURT2,RT2_C3,FAPA
 SG_ ADC_BSDExMirLedWarnL : 157|2@0+ (1,0) [0|3] ""  CCU,CCURT2,RT2_C3,FAPA
 SG_ ADC_BSDLCASt : 153|2@0+ (1,0) [0|3] ""  CCU,FAPA
 SG_ ADC_BSDLCAEnableSt : 167|1@0+ (1,0) [0|1] ""  CCU,FAPA,RRR,RLR
 SG_ ADC_RCTAEnableSt : 166|1@0+ (1,0) [0|1] ""  CCU,FAPA,RRR,RLR
 SG_ ADC_RCTASt : 165|2@0+ (1,0) [0|3] ""  CCU,FAPA
 SG_ ADC_RCTAAssistType : 163|2@0+ (1,0) [0|3] ""  CCU,FAPA,RRR,RLR
 SG_ ADC_DOWSt : 161|2@0+ (1,0) [0|3] ""  CCU,FAPA
 SG_ ADC_DOWEnableSt : 175|1@0+ (1,0) [0|1] ""  CCU,FAPA,RRR,RLR
 SG_ ADC_LCAWarnLeft : 174|2@0+ (1,0) [0|3] ""  CCU,IDC,FAPA
 SG_ ADC_LCAWarnRight : 172|2@0+ (1,0) [0|3] ""  CCU,IDC,FAPA
 SG_ ADC_RCTAWarnLeft : 170|2@0+ (1,0) [0|3] ""  CCU,FAPA
 SG_ ADC_RCWEnableSt : 168|1@0+ (1,0) [0|1] ""  CCU,FAPA,RRR,RLR
 SG_ ADC_RCTAWarnRight : 183|2@0+ (1,0) [0|3] ""  CCU,FAPA
 SG_ ADC_RCWSt : 181|2@0+ (1,0) [0|3] ""  CCU,FAPA
 SG_ ADC_RCWWarn : 179|2@0+ (1,0) [0|3] ""  CCU,CCURT2,RT2_C3,FAPA
 SG_ ADC_FCTAEnableSt : 177|1@0+ (1,0) [0|1] ""  CCU,FAPA
 SG_ ADC_FCTASt : 191|2@0+ (1,0) [0|3] ""  CCU,FAPA
 SG_ ADC_FCTAAssistType : 189|2@0+ (1,0) [0|3] ""  CCU,FAPA
 SG_ ADC_FCTAWarnL : 187|2@0+ (1,0) [0|3] ""  CCU,FAPA
 SG_ ADC_FCTAWarnR : 185|2@0+ (1,0) [0|3] ""  CCU,FAPA
 SG_ ADC_FroNestTarLatSpd : 205|9@0+ (0.1,-25.5) [-25.5|25.5] "m/s"  CCU,FAPA
 SG_ ADC_FroNestTarRangeRate : 199|10@0+ (0.1,-51.2) [-51.2|51.1] "m/s"  CCU,FAPA
 SG_ ADC_FroNestTarRangeAccel : 208|9@0+ (0.1,-25.5) [-25.5|25.5] "m/s^2"  CCU,FAPA
 SG_ ADC_FroNestTarDetSensor : 227|4@0+ (1,0) [0|15] ""  CCU,FAPA
 SG_ ADC_FroNestTarObjType : 231|4@0+ (1,0) [0|15] ""  CCU,FAPA
 SG_ ADC_LDS_LaneAssistType : 239|2@0+ (1,0) [0|3] ""  CCU,FAPA
 SG_ ADC_IHBC_EnableSt : 237|1@0+ (1,0) [0|1] ""  CCU,FAPA
 SG_ ADC_ELK_EnableSt : 234|1@0+ (1,0) [0|1] ""  CCU,FAPA
 SG_ ADC_ESA_EnableSt : 233|1@0+ (1,0) [0|1] ""  CCU,FAPA
 SG_ ADC_AES_EnableSt : 232|1@0+ (1,0) [0|1] ""  CCU,FAPA
 SG_ ADC_LDWSt : 247|3@0+ (1,0) [0|7] ""  CCU,FAPA
 SG_ ADC_LDW_Actdirection : 244|2@0+ (1,0) [0|3] ""  CCU,FAPA
 SG_ ADC_LDP_Actdirection : 242|2@0+ (1,0) [0|3] ""  CCU,FAPA
 SG_ ADC_LDW_PassiveReason : 255|5@0+ (1,0) [0|31] ""  CCU,FAPA
 SG_ ADC_LDPSt : 250|3@0+ (1,0) [0|7] ""  CCU,FAPA
 SG_ ADC_LDP_PassiveReason : 263|5@0+ (1,0) [0|31] ""  CCU,FAPA
 SG_ ADC_RDP_St : 258|3@0+ (1,0) [0|7] ""  CCU,FAPA
 SG_ ADC_RDP_PassiveReason : 271|5@0+ (1,0) [0|31] ""  CCU,FAPA
 SG_ ADC_IHBC_St : 266|3@0+ (1,0) [0|7] ""  CCU,CCURT2,RT2_C3,FAPA
 SG_ ADC_RDP_Actdirection : 279|2@0+ (1,0) [0|3] ""  CCU,FAPA
 SG_ ADC_FCMS_SwitchLockReq : 75|2@0+ (1,0) [0|3] ""  CCU,FAPA
 SG_ ADC_LKSLaneAssistSensitivity : 211|3@0+ (1,0) [0|7] ""  CCU,FAPA
 SG_ ADC_IHBC_SuppressSt : 286|2@0+ (1,0) [0|3] ""  CCU,FAPA
 SG_ ADC_IHBC_SuppressReason : 284|5@0+ (1,0) [0|31] ""  CCU,FAPA
 SG_ ADC_IHBC_Dis2Oncoming : 295|8@0+ (1,0) [0|100] ""  CCU,FAPA
 SG_ ADC_IHBC_Dis2Preceding : 303|8@0+ (1,0) [0|100] ""  CCU,FAPA
 SG_ ADC_IHBC_RoadlightNum : 311|8@0+ (1,0) [0|100] ""  CCU,FAPA
 SG_ ADC_IHBC_Dis2NearestRoadlight : 319|8@0+ (1,0) [0|200] ""  CCU,FAPA
 SG_ ADC_IHBC_TargetType : 327|3@0+ (1,0) [0|7] ""  CCU,FAPA
 SG_ ADC_TSR_SpdLimType : 335|2@0+ (1,0) [0|3] ""  CCU,CCURT1,RT1_C1,FAPA
 SG_ ADC_TSR_SpeedLimitSource : 367|3@0+ (1,0) [0|7] ""  CCU,CCURT1,RT1_C1,FAPA
 SG_ ADC_ELKoncomingSt : 383|3@0+ (1,0) [0|7] ""  CCU,FAPA
 SG_ ADC_ELKoncoming_PassiveReason : 380|5@0+ (1,0) [0|31] ""  CCU,FAPA
 SG_ ADC_ELKoncoming_Actdirection : 391|2@0+ (1,0) [0|3] ""  CCU,FAPA
 SG_ ADC_ELKovertakingSt : 389|3@0+ (1,0) [0|7] ""  CCU,FAPA
 SG_ ADC_ELKovertaking_ActDirection : 386|2@0+ (1,0) [0|3] ""  CCU,FAPA
 SG_ ADC_ELKovertaking_PassiveReason : 399|5@0+ (1,0) [0|31] ""  CCU,FAPA
 SG_ ADC_ELK_TargetObjClass : 394|3@0+ (1,0) [0|7] ""  CCU,FAPA
 SG_ ADC_ESA_St : 407|3@0+ (1,0) [0|7] ""  CCU,FAPA
 SG_ ADC_ESA_ActDirection : 404|2@0+ (1,0) [0|3] ""  CCU,FAPA
 SG_ ADC_AES_St : 402|3@0+ (1,0) [0|7] ""  CCU,FAPA
 SG_ ADC_AES_ActDirection : 415|2@0+ (1,0) [0|3] ""  CCU,FAPA
 SG_ ADC_RDP_Number : 413|6@0+ (1,0) [0|63] ""  CCU,FAPA
 SG_ ADC_ELKoncoming_Number : 421|6@0+ (1,0) [0|63] ""  CCU,FAPA
 SG_ ADC_ELKovertaking_Numbe : 429|6@0+ (1,0) [0|63] ""  CCU,FAPA
 SG_ ADC_ESA_TargetObjClass : 439|3@0+ (1,0) [0|7] ""  CCU,FAPA
 SG_ ADC_ESA_PassiveReason : 436|5@0+ (1,0) [0|31] ""  CCU,FAPA
 SG_ ADC_AES_TargetObjClass : 447|3@0+ (1,0) [0|7] ""  CCU,FAPA
 SG_ ADC_AES_PassiveReason : 444|5@0+ (1,0) [0|31] ""  CCU,FAPA
 SG_ ADC_LDW_Number : 455|8@0+ (1,0) [0|255] ""  CCU,FAPA
 SG_ ADC_LDPNumber : 463|8@0+ (1,0) [0|255] ""  CCU,FAPA
 SG_ ADC_L1_LatfaultReason : 471|5@0+ (1,0) [0|31] ""  CCU,FAPA
 SG_ ADC_ESA_Number : 466|6@0+ (1,0) [0|63] ""  CCU,FAPA
 SG_ ADC_AES_Number : 476|6@0+ (1,0) [0|63] ""  CCU,FAPA
 SG_ ADC_FroNestTarLatPos : 486|10@0+ (0.1,-51.2) [-51.2|51.1] "m"  CCU,FAPA
 SG_ ADC_LDSIconColor : 498|3@0+ (1,0) [0|7] ""  CCU,FAPA
 SG_ ADC_FroNestTarLongPos : 492|10@0+ (0.1,0) [0|102.3] "m"  CCU,FAPA
 SG_ ADC_LOCP_St : 506|3@0+ (1,0) [0|7] ""  CCU,FAPA

CM_ SG_ 2015 Fun_Diag_Request "Diagnostic function request";
CM_ SG_ 352 BCS_2_CRC "E2E Profile 5 CRC";
CM_ SG_ 352 BCS_2_Counter "E2E Profile 5 Counter";
CM_ SG_ 352 BCS_VehSpd "Vehicle speed";
CM_ SG_ 352 BCS_VehSpdVD "Quality/fault information to vehicle speed";
CM_ SG_ 352 BCS_EBDActiveSt "Indication that EBD system currently performs a brake/engine intervention";
CM_ SG_ 352 BCS_EBDFaultSt "ABS system has detected a heavy fault, which does not even allow a reliable electronic brake distribution and is therefore completely shut down";
CM_ SG_ 352 BCS_ABSActiveSt "Indication that ABS system currently performs a brake intervention";
CM_ SG_ 352 BCS_ABSFaultSt "ABS system has detected a failure which does no allow a reliable ABS regulation and is therefore switched off";
CM_ SG_ 352 BCS_TCSActiveSt "Indication that TCS system currently performs a brake/engine intervention";
CM_ SG_ 352 BCS_TCSFaultSt "TCS is switched off due to detected failure";
CM_ SG_ 352 BCS_VDCActiveSt "Indication that VDC system currently performs a brake/engine intervention when ESC adjust the posture of vehicle ";
CM_ SG_ 352 BCS_VDCFaultSt "VDC is switched off due to detected failure";
CM_ SG_ 352 BCS_PreAndRealVDCActiveSt "Indication that VDC system currently performs a brake/engine intervention when ESC increase pressure ";
CM_ SG_ 352 BCS_DTCAvailable "Indicate whether ESC can follow ePedal request and modify the recuperation torque";
CM_ SG_ 352 BCS_DTCActiveSt "Reduce repcuperation torque requested by oppotize TCS control active status";
CM_ SG_ 352 BCS_RealTCSActiveSt "Indication that TCS system currently real performs a brake/engine intervention ";
CM_ SG_ 352 BCS_CrbsActive "Indicate whether ESP recuperation torque is controlled by CRBS ";
CM_ SG_ 352 BCS_BrkPedalStVD "The validity  of brake pedal status";
CM_ SG_ 352 BCS_BrkPedalSt "IBCS Brake Pedal Status";
CM_ SG_ 352 BCS_EngTorqDecFastRA "This torque  is engine combustion(indicated)decreased target torque (fast) for Rear Axle";
CM_ SG_ 352 BCS_EngTorqIncRA "This torque  is  increased enginecombustion(indicated)target torque for Rear Axle";
CM_ SG_ 352 BCS_TargetRecpTorqRqFA "Target recuperation torque request by BCS to generator,applies to 4WD and front wheel drive";
CM_ SG_ 352 BCS_TargetRecpTorqRqFASt "Status of target recuperation torque request by BCS to generator,applies to 4WD and front wheel drive";
CM_ SG_ 352 BCS_TargetRecpTorqRqRA "Target recuperation torque request by BCS to generator,applies to 4WD and rear wheel drive";
CM_ SG_ 352 BCS_TargetRecpTorqRqRASt "Status of target recuperation torque request by BCS to generator,applies to 4WD and rear wheel drive";
CM_ SG_ 352 BCS_EngTorqDecActiveStRA "Decrease enginetorque  active status (fast and low) for Rear Axle";
CM_ SG_ 352 BCS_EngTorqDecActiveStFA "Decrease enginetorque  active status (fast and low) for Front Axle";
CM_ SG_ 352 BCS_EngTorqIncActiveStFA "Increased engine torque  active status for Front Axle";
CM_ SG_ 352 BCS_ADCNetErrorFb "ADC Net Error Feedback";
CM_ SG_ 352 BCS_NetModeResp "IBCS  Brake Torque Response Status in Main  Net";
CM_ SG_ 352 BCS_EngTorqDecFastFA "This torque  is engine combustion(indicated) decreased target torque (fast)";
CM_ SG_ 352 BCS_EngTorqIncFA "This torque  is  increased engine combustion(indicated)target torque ";
CM_ SG_ 1238 FR_DTCCode "DTC Sent To CCU";
CM_ SG_ 403 ADC_1_CRC "E2E Profile 5 CRC";
CM_ SG_ 403 ADC_1_Counter "E2E Profile 5 Counter";
CM_ SG_ 403 ADC_ACCMode "This signal indicates ACC(Adaptive cruise control)status";
CM_ SG_ 403 ADC_ACCFailureReason " ACC failure reason";
CM_ SG_ 403 ADC_ACCPassiveReason " ACC Passive reason";
CM_ SG_ 403 ADC_TJP_St "TJP/HWP state information";
CM_ SG_ 403 ADC_TJPIconColor "TJP Icon Color";
CM_ SG_ 403 ADC_TimeGapSet "The set timeGap from driver, should be displayed to driver and if the set value changes";
CM_ SG_ 403 ADC_ICA_St "ICA state information";
CM_ SG_ 403 ADC_Cruise_SpeedLimitType "Cruise Speed Limit Type";
CM_ SG_ 403 ADC_LaneChangeSt "Lane Change state";
CM_ SG_ 403 ADC_LaneChange_AbortReason "Lane Changeabort Reason";
CM_ SG_ 403 ADC_LaneChange_Actdirection "Lane change active direction";
CM_ SG_ 403 ADC_ICA_MRMReason "ICA MRM reason";
CM_ SG_ 403 ADC_ICA_Mileage "Number of times ICA is activated in the current ignition cycle";
CM_ SG_ 403 ADC_ICA_PassiveReason "ADAS passive reason,not only ICA";
CM_ SG_ 403 ADC_ICA_faultReason "ICA function fault reason";
CM_ SG_ 403 ADC_HFIconColor "HandFree Icon Color";
CM_ SG_ 403 ADC_MRMNumber "Number of times MRM is activated in the current ignition cycle";
CM_ SG_ 403 ADC_MRCNumber "Number of times MRC is activated in the current ignition cycle";
CM_ SG_ 403 ADC_HandsOnSt "ADAS Hands On state";
CM_ SG_ 403 ADC_ICMADASFailureText "ADAS Failure Text";
CM_ SG_ 403 ADC_ICMADASWarnText "ADAS Warn Text";
CM_ SG_ 403 ADC_SpeedLimitIconSt "Speed Limit Icon State";
CM_ SG_ 403 ADC_ICMWarnCardSt "Warn Card State";
CM_ SG_ 403 ADC_ICAIconColor "ICA Icon Color";
CM_ SG_ 403 ADC_ICMPromptWarn "Prompt Warn";
CM_ SG_ 403 ADC_ACUVoiceWarn "Voice Warn";
CM_ SG_ 403 ADC_NDAStateIcon "NDA State Icon";
CM_ SG_ 403 ADC_SpeedLimitIcon "Speed Limit Icon";
CM_ SG_ 403 ADC_ICANDAIconAngle "ICA NDA Icon Angle";
CM_ SG_ 403 ADC_ACCTargetSpeedCard "ACC Target Speed Card";
CM_ SG_ 403 ADC_ACCIconColor "ACC Icon Color";
CM_ SG_ 403 ADC_ICMADASFailureLamp "ADAS Failure Indicator light, it turns on when more than two ADAS-systems fail";
CM_ SG_ 403 ADC_Pilot_VoiceWarn "Pilot Voice Warn";
CM_ SG_ 403 ADC_Pilot_PromptWarn "Pilot Prompt Warn";
CM_ SG_ 403 ADC_Pilot_WarnText "Pilot Warn Text";
CM_ SG_ 403 ADC_Pilot_WarnCardSt "Pilot Warn Card State";
CM_ SG_ 403 NDA_Type "NDA Type";
CM_ SG_ 403 ADAS_System_Failure_St "ADAS System Failure State";
CM_ SG_ 403 ADAS_Related_System_Failure_St "ADAS Related system Failure State";
CM_ SG_ 403 ADC_AdsFault "ADS System Failure Icon";
CM_ SG_ 403 ADC_NicaReminderLEDVisual "ADS TOR Warning Icon";
CM_ SG_ 403 ADC_NicaReminderAcoustic "ADS Warning Acoustic";
CM_ SG_ 403 ADC_AdsTakeoverID "ADS TOR Scenes Description Text";
CM_ SG_ 403 ADC_AdsTakeoverLevel "TORLevel, indicates the Warning Ways";
CM_ SG_ 403 ADC_TORIDCorrespErrorID "TOR error code ID (Reasons relate to TakeoverID)";
CM_ SG_ 403 ADC_TakeoverExtended16bit "TOR Extended Information (Value in Message)";
CM_ SG_ 403 ADC_TakeoverExtended8bit "TOR Extended Information (Text combined with Value)";
CM_ SG_ 403 ADC_AdsFucntionNotActive "ADS Function cannot Active Icon";
CM_ SG_ 403 ADC_AvpFunctionStatus "AVP Icon related to Function State";
CM_ SG_ 403 ADC_CalibState "ADC Calibration State Icon";
CM_ SG_ 403 ADC_AccFunctionStatus "ACC Function State Icon";
CM_ SG_ 403 ADC_NicaFunctionStatus "ICA/NCA Function State Icon";
CM_ SG_ 403 ADC_AEBWaning "AEB Warning State Effects";
CM_ SG_ 403 ADC_LKAWarning "LKA Warning State Effects";
CM_ SG_ 403 ADC_LCCStateIcon "LCC State Icon";
CM_ SG_ 411 ADC_2_CRC "E2E Profile 5 CRC";
CM_ SG_ 411 ADC_2_Counter "E2E Profile 5 Counter";
CM_ SG_ 411 ADC_FCWAssistType "This signal indicates if the FCW(Front Collision Warning) Assist Type";
CM_ SG_ 411 ADC_FCWFaultSt "This signal indicates if the FCW(Front Collision Warning) fault status";
CM_ SG_ 411 ADC_FCWPreWarn "Visual and Audio warning if the FCW (Imminent Warning) intervents";
CM_ SG_ 411 ADC_FCWLatentWarn "Visual warning if the FCW (Alert Warning) intervents";
CM_ SG_ 411 ADC_FCWWarmDistance "FCW warming distance";
CM_ SG_ 411 ADC_AEBTarObjType "AEB Target Object Type";
CM_ SG_ 411 ADC_BSDVibrWarnR "Driver seat vibration warning right";
CM_ SG_ 411 ADC_BSDVibrWarnL "Driver seat vibration warning left";
CM_ SG_ 411 ADC_AEBBrkPedalOverRide "AEB override status when Brakepedal applied";
CM_ SG_ 411 ADC_AEBBrePedalPressure "AEB override status when Brakepedal with ESP Pressure";
CM_ SG_ 411 ADC_AEBAccelePedalOverRide "AEB override status whith Certain gaspedal";
CM_ SG_ 411 ADC_AEBSteeringInhibit "AEB override status whith Certain Steering angel or angelSpeed";
CM_ SG_ 411 ADC_PMAEnableSt "PMA Enable Status";
CM_ SG_ 411 ADC_PMAWarStatus "Visual and Audio warning if the PMA(Accelerator Pedal Misaction) intervents";
CM_ SG_ 411 ADC_AEBTarLatPos "AEB Target  lateral Position";
CM_ SG_ 411 ADC_AEBTarRangeRate "AEB Target RangeRate";
CM_ SG_ 411 ADC_AEBTarOncomingState "Indictate AEB Target Oncomgin or not";
CM_ SG_ 411 ADC_AEBTarMotionState "Indictate AEB Target in Moving or stationary";
CM_ SG_ 411 ADC_AEBTarConfiLevel "AEB Target Confidence Level";
CM_ SG_ 411 ADC_AEBTarLongPos "AEB Target Longitudinal Possition";
CM_ SG_ 411 ADC_AEBTarLatSpd "AEB Target  lateral Speed";
CM_ SG_ 411 ADC_AEBTarRangeAccel "AEB Target Longtitul Acceleration";
CM_ SG_ 411 ADC_DOWAudioWarnFR "Front right door speaker warning";
CM_ SG_ 411 ADC_DOWAudioWarnFL "Front left door speaker warning";
CM_ SG_ 411 ADC_DOWAudioWarnRR "Rear right door speaker warning";
CM_ SG_ 411 ADC_DOWAudioWarnRL "Rear left door speaker warning";
CM_ SG_ 411 ADC_DOWIALWarnFR "Front right door light warning ";
CM_ SG_ 411 ADC_DOWIALWarnFL "Front left door light warning";
CM_ SG_ 411 ADC_DOWIALWarnRR "Rear right door light warning ";
CM_ SG_ 411 ADC_DOWIALWarnRL "Rear left door light warning";
CM_ SG_ 411 ADC_BSDExMirLedWarnR "Exterior mirror LED warning right";
CM_ SG_ 411 ADC_BSDExMirLedWarnL "Exterior mirror LED warning left";
CM_ SG_ 411 ADC_BSDLCASt "BSD-LCA Function status";
CM_ SG_ 411 ADC_BSDLCAEnableSt "BSD-LCA Enable status";
CM_ SG_ 411 ADC_RCTAEnableSt "RCTA Enable status";
CM_ SG_ 411 ADC_RCTASt "RCTA Function status";
CM_ SG_ 411 ADC_RCTAAssistType "RCTA assist type request";
CM_ SG_ 411 ADC_DOWSt "DOW Function state";
CM_ SG_ 411 ADC_DOWEnableSt "DOW Enable status";
CM_ SG_ 411 ADC_LCAWarnLeft " the vehicle left warning level in the LCA feature";
CM_ SG_ 411 ADC_LCAWarnRight " the vehicle right warning level in the LCA feature";
CM_ SG_ 411 ADC_RCTAWarnLeft " the vehicle left warning in the RCTA feature";
CM_ SG_ 411 ADC_RCWEnableSt "RCW Enable status";
CM_ SG_ 411 ADC_RCTAWarnRight " the vehicle right warning in the RCTA feature";
CM_ SG_ 411 ADC_RCWSt "RCW(rear collision warning ) feature status";
CM_ SG_ 411 ADC_RCWWarn " the vehicle warning  level in the RCW feature";
CM_ SG_ 411 ADC_FCTAEnableSt "FCTA Enable status";
CM_ SG_ 411 ADC_FCTASt "FCTA feature status";
CM_ SG_ 411 ADC_FCTAAssistType "FCTA assist type request";
CM_ SG_ 411 ADC_FCTAWarnL "FCTA warning left";
CM_ SG_ 411 ADC_FCTAWarnR "FCTA warning right";
CM_ SG_ 411 ADC_FroNestTarLatSpd "Front Nearest Target  lateral Speed";
CM_ SG_ 411 ADC_FroNestTarRangeRate "Front Nearest Target RangeRate";
CM_ SG_ 411 ADC_FroNestTarRangeAccel "Front Nearest Target Longtitul Acceleration";
CM_ SG_ 411 ADC_FroNestTarDetSensor "Front Nearest Target Property Detected by Sensor";
CM_ SG_ 411 ADC_FroNestTarObjType "Front Nearest Target Object Type";
CM_ SG_ 411 ADC_LDS_LaneAssistType "operation mode of LDS";
CM_ SG_ 411 ADC_IHBC_EnableSt "IHBC enable status";
CM_ SG_ 411 ADC_ELK_EnableSt "ELK Enable State";
CM_ SG_ 411 ADC_ESA_EnableSt "ESA Enable State";
CM_ SG_ 411 ADC_AES_EnableSt "AES Enable State";
CM_ SG_ 411 ADC_LDWSt "LDW state information";
CM_ SG_ 411 ADC_LDW_Actdirection "LDW active direction";
CM_ SG_ 411 ADC_LDP_Actdirection "LDP active direction";
CM_ SG_ 411 ADC_LDW_PassiveReason "LDW passive reason";
CM_ SG_ 411 ADC_LDPSt "LDP state information";
CM_ SG_ 411 ADC_LDP_PassiveReason "Left LDP passive reason";
CM_ SG_ 411 ADC_RDP_St "RDP state information";
CM_ SG_ 411 ADC_RDP_PassiveReason "RDP passive reason";
CM_ SG_ 411 ADC_IHBC_St "IHBC State";
CM_ SG_ 411 ADC_RDP_Actdirection "RDP active direction";
CM_ SG_ 411 ADC_FCMS_SwitchLockReq "This signal indicates if the Front Collision Mitigation System (AEB&FCW) Switch is locked because of VehSpeed & ESP";
CM_ SG_ 411 ADC_LKSLaneAssistSensitivity "This signal indicates the LKSLaneAssist Sensitivity State";
CM_ SG_ 411 ADC_IHBC_SuppressSt "IHBC Suppress State";
CM_ SG_ 411 ADC_IHBC_SuppressReason "IHBC Suppress Reason";
CM_ SG_ 411 ADC_IHBC_Dis2Oncoming "distance of oncoming target which lead to IHBC Suppress";
CM_ SG_ 411 ADC_IHBC_Dis2Preceding "distance of preceding target which lead to IHBC Suppress";
CM_ SG_ 411 ADC_IHBC_RoadlightNum " number of roadlight ";
CM_ SG_ 411 ADC_IHBC_Dis2NearestRoadlight "distance of nearest roadlight  ";
CM_ SG_ 411 ADC_IHBC_TargetType "type of target  which lead to IHBC Suppress";
CM_ SG_ 411 ADC_TSR_SpdLimType "TSR specific speed limit type";
CM_ SG_ 411 ADC_TSR_SpeedLimitSource "source of speed limit ";
CM_ SG_ 411 ADC_ELKoncomingSt "ELKoncoming state information";
CM_ SG_ 411 ADC_ELKoncoming_PassiveReason "Left ELKoncoming passive reason";
CM_ SG_ 411 ADC_ELKoncoming_Actdirection "ELKoncoming active direction";
CM_ SG_ 411 ADC_ELKovertakingSt "ELKovertaking state information";
CM_ SG_ 411 ADC_ELKovertaking_ActDirection "ELKovertaking active direction";
CM_ SG_ 411 ADC_ELKovertaking_PassiveReason " ELKovertaking passive reason";
CM_ SG_ 411 ADC_ELK_TargetObjClass "Type of ELK target Object class";
CM_ SG_ 411 ADC_ESA_St "ESA state information";
CM_ SG_ 411 ADC_ESA_ActDirection "ESA active direction";
CM_ SG_ 411 ADC_AES_St "AES state information";
CM_ SG_ 411 ADC_AES_ActDirection "AES active direction";
CM_ SG_ 411 ADC_RDP_Number "Number of times RDP is activated in the current ignition cycle";
CM_ SG_ 411 ADC_ELKoncoming_Number "Number of times ELKoncoming is activated in the current ignition cycle";
CM_ SG_ 411 ADC_ELKovertaking_Numbe "Number of times ELKovertaking is activated in the current ignition cycle";
CM_ SG_ 411 ADC_ESA_TargetObjClass "Type of ESA target Object class";
CM_ SG_ 411 ADC_ESA_PassiveReason "ESA passive reason";
CM_ SG_ 411 ADC_AES_TargetObjClass "Type of AES target Object class";
CM_ SG_ 411 ADC_AES_PassiveReason "AES passive reason";
CM_ SG_ 411 ADC_LDW_Number "Number of times LDW is activated in the current ignition cycle";
CM_ SG_ 411 ADC_LDPNumber "Number of times LDP is activated in the current ignition cycle";
CM_ SG_ 411 ADC_L1_LatfaultReason "L0 & L1 lateral function fault reason";
CM_ SG_ 411 ADC_ESA_Number "Number of times ESA is activated in the current ignition cycle";
CM_ SG_ 411 ADC_AES_Number "Number of times AES is activated in the current ignition cycle";
CM_ SG_ 411 ADC_FroNestTarLatPos "Front Nearest Target lateral Position";
CM_ SG_ 411 ADC_LDSIconColor "LDS（include LDW and LDP ) Icon Color";
CM_ SG_ 411 ADC_FroNestTarLongPos "Front Nearest Target Longitudinal Possition";
CM_ SG_ 411 ADC_LOCP_St "LOCP?state?information";

BA_DEF_ BO_  "GenMsgCycleTime" INT 0 0;
BA_DEF_ BO_  "GenMsgCycleTimeFast" INT 0 0;
BA_DEF_ BO_  "GenMsgSendType" ENUM  "Periodic","Event","IfActive","POE","PA","FixedPeriodic","Event","EnabledPeriodic","NotUsed","NotUsed","EventPeriodic","NotUsed","NotUsed","NoMsgSendType";
BA_DEF_ BO_  "VFrameFormat" ENUM  "StandardCAN","ExtendedCAN","reserved","reserved","reserved","reserved","reserved","reserved","reserved","reserved","reserved","reserved","reserved","reserved","StandardCAN_FD","ExtendedCAN_FD";
BA_DEF_ BO_  "CANFD_BRS" ENUM  "0","1";
BA_DEF_ SG_  "EventCommandSignal" ENUM  "No","Yes";
BA_DEF_ SG_  "GatewayedSignals" ENUM  "No","Yes";
BA_DEF_ SG_  "GenSigInactiveValue" HEX 0 0;
BA_DEF_ SG_  "GenSigInvalidValue" HEX 0 0;
BA_DEF_ SG_  "GenSigSendType" ENUM  "Trigger","Passive","Cyclic","OnWrite","OnWriteWithRepetition","OnChange","OnChangeWithRepetition","IfActive","IfActiveWithRepetition","NoSigSendType";
BA_DEF_ SG_  "GenSigStartValue" HEX 0 0;
BA_DEF_ SG_  "GenSigTimeoutValue" HEX 0 0;
BA_DEF_ SG_  "Remark" STRING ;
BA_DEF_  "Manufacturer" STRING ;
BA_DEF_  "Project" STRING ;
BA_DEF_  "Version" STRING ;
BA_DEF_  "Date" STRING ;
BA_DEF_  "Author" STRING ;
BA_DEF_  "DBName" STRING ;
BA_DEF_  "BusType" STRING ;
BA_DEF_  "Checker" STRING ;
BA_DEF_  "Approver" STRING ;
BA_ "Manufacturer" "GACRND";
BA_ "Project" "A88";
BA_ "Version" "0.1";
BA_ "Date" "2026-8-27 11:37:31";
BA_ "Author" "LeoFeng";
BA_ "DBName" "ADCPublic_CANFD1";
BA_ "BusType" "CAN FD";
BA_ "Checker" "Miss Fan";
BA_ "Approver" "Mr Hu";

BA_ "GenMsgCycleTime" BO_ 2015 0;
BA_ "GenMsgCycleTimeFast" BO_ 2015 0;
BA_ "GenMsgSendType" BO_ 2015 1;
BA_ "VFrameFormat" BO_ 2015 14;
BA_ "CANFD_BRS" BO_ 2015 1;
BA_ "GenMsgCycleTime" BO_ 352 10;
BA_ "GenMsgCycleTimeFast" BO_ 352 0;
BA_ "GenMsgSendType" BO_ 352 0;
BA_ "VFrameFormat" BO_ 352 14;
BA_ "CANFD_BRS" BO_ 352 1;
BA_ "GenMsgCycleTime" BO_ 352 10;
BA_ "GenMsgCycleTimeFast" BO_ 352 0;
BA_ "GenMsgSendType" BO_ 352 0;
BA_ "VFrameFormat" BO_ 352 14;
BA_ "CANFD_BRS" BO_ 352 1;
BA_ "GenMsgCycleTime" BO_ 352 10;
BA_ "GenMsgCycleTimeFast" BO_ 352 0;
BA_ "GenMsgSendType" BO_ 352 0;
BA_ "VFrameFormat" BO_ 352 14;
BA_ "CANFD_BRS" BO_ 352 1;
BA_ "GenMsgCycleTime" BO_ 352 10;
BA_ "GenMsgCycleTimeFast" BO_ 352 0;
BA_ "GenMsgSendType" BO_ 352 0;
BA_ "VFrameFormat" BO_ 352 14;
BA_ "CANFD_BRS" BO_ 352 1;
BA_ "GenMsgCycleTime" BO_ 352 10;
BA_ "GenMsgCycleTimeFast" BO_ 352 0;
BA_ "GenMsgSendType" BO_ 352 0;
BA_ "VFrameFormat" BO_ 352 14;
BA_ "CANFD_BRS" BO_ 352 1;
BA_ "GenMsgCycleTime" BO_ 352 10;
BA_ "GenMsgCycleTimeFast" BO_ 352 0;
BA_ "GenMsgSendType" BO_ 352 0;
BA_ "VFrameFormat" BO_ 352 14;
BA_ "CANFD_BRS" BO_ 352 1;
BA_ "GenMsgCycleTime" BO_ 352 10;
BA_ "GenMsgCycleTimeFast" BO_ 352 0;
BA_ "GenMsgSendType" BO_ 352 0;
BA_ "VFrameFormat" BO_ 352 14;
BA_ "CANFD_BRS" BO_ 352 1;
BA_ "GenMsgCycleTime" BO_ 352 10;
BA_ "GenMsgCycleTimeFast" BO_ 352 0;
BA_ "GenMsgSendType" BO_ 352 0;
BA_ "VFrameFormat" BO_ 352 14;
BA_ "CANFD_BRS" BO_ 352 1;
BA_ "GenMsgCycleTime" BO_ 352 10;
BA_ "GenMsgCycleTimeFast" BO_ 352 0;
BA_ "GenMsgSendType" BO_ 352 0;
BA_ "VFrameFormat" BO_ 352 14;
BA_ "CANFD_BRS" BO_ 352 1;
BA_ "GenMsgCycleTime" BO_ 352 10;
BA_ "GenMsgCycleTimeFast" BO_ 352 0;
BA_ "GenMsgSendType" BO_ 352 0;
BA_ "VFrameFormat" BO_ 352 14;
BA_ "CANFD_BRS" BO_ 352 1;
BA_ "GenMsgCycleTime" BO_ 352 10;
BA_ "GenMsgCycleTimeFast" BO_ 352 0;
BA_ "GenMsgSendType" BO_ 352 0;
BA_ "VFrameFormat" BO_ 352 14;
BA_ "CANFD_BRS" BO_ 352 1;
BA_ "GenMsgCycleTime" BO_ 352 10;
BA_ "GenMsgCycleTimeFast" BO_ 352 0;
BA_ "GenMsgSendType" BO_ 352 0;
BA_ "VFrameFormat" BO_ 352 14;
BA_ "CANFD_BRS" BO_ 352 1;
BA_ "GenMsgCycleTime" BO_ 352 10;
BA_ "GenMsgCycleTimeFast" BO_ 352 0;
BA_ "GenMsgSendType" BO_ 352 0;
BA_ "VFrameFormat" BO_ 352 14;
BA_ "CANFD_BRS" BO_ 352 1;
BA_ "GenMsgCycleTime" BO_ 352 10;
BA_ "GenMsgCycleTimeFast" BO_ 352 0;
BA_ "GenMsgSendType" BO_ 352 0;
BA_ "VFrameFormat" BO_ 352 14;
BA_ "CANFD_BRS" BO_ 352 1;
BA_ "GenMsgCycleTime" BO_ 352 10;
BA_ "GenMsgCycleTimeFast" BO_ 352 0;
BA_ "GenMsgSendType" BO_ 352 0;
BA_ "VFrameFormat" BO_ 352 14;
BA_ "CANFD_BRS" BO_ 352 1;
BA_ "GenMsgCycleTime" BO_ 352 10;
BA_ "GenMsgCycleTimeFast" BO_ 352 0;
BA_ "GenMsgSendType" BO_ 352 0;
BA_ "VFrameFormat" BO_ 352 14;
BA_ "CANFD_BRS" BO_ 352 1;
BA_ "GenMsgCycleTime" BO_ 352 10;
BA_ "GenMsgCycleTimeFast" BO_ 352 0;
BA_ "GenMsgSendType" BO_ 352 0;
BA_ "VFrameFormat" BO_ 352 14;
BA_ "CANFD_BRS" BO_ 352 1;
BA_ "GenMsgCycleTime" BO_ 352 10;
BA_ "GenMsgCycleTimeFast" BO_ 352 0;
BA_ "GenMsgSendType" BO_ 352 0;
BA_ "VFrameFormat" BO_ 352 14;
BA_ "CANFD_BRS" BO_ 352 1;
BA_ "GenMsgCycleTime" BO_ 352 10;
BA_ "GenMsgCycleTimeFast" BO_ 352 0;
BA_ "GenMsgSendType" BO_ 352 0;
BA_ "VFrameFormat" BO_ 352 14;
BA_ "CANFD_BRS" BO_ 352 1;
BA_ "GenMsgCycleTime" BO_ 352 10;
BA_ "GenMsgCycleTimeFast" BO_ 352 0;
BA_ "GenMsgSendType" BO_ 352 0;
BA_ "VFrameFormat" BO_ 352 14;
BA_ "CANFD_BRS" BO_ 352 1;
BA_ "GenMsgCycleTime" BO_ 352 10;
BA_ "GenMsgCycleTimeFast" BO_ 352 0;
BA_ "GenMsgSendType" BO_ 352 0;
BA_ "VFrameFormat" BO_ 352 14;
BA_ "CANFD_BRS" BO_ 352 1;
BA_ "GenMsgCycleTime" BO_ 352 10;
BA_ "GenMsgCycleTimeFast" BO_ 352 0;
BA_ "GenMsgSendType" BO_ 352 0;
BA_ "VFrameFormat" BO_ 352 14;
BA_ "CANFD_BRS" BO_ 352 1;
BA_ "GenMsgCycleTime" BO_ 352 10;
BA_ "GenMsgCycleTimeFast" BO_ 352 0;
BA_ "GenMsgSendType" BO_ 352 0;
BA_ "VFrameFormat" BO_ 352 14;
BA_ "CANFD_BRS" BO_ 352 1;
BA_ "GenMsgCycleTime" BO_ 352 10;
BA_ "GenMsgCycleTimeFast" BO_ 352 0;
BA_ "GenMsgSendType" BO_ 352 0;
BA_ "VFrameFormat" BO_ 352 14;
BA_ "CANFD_BRS" BO_ 352 1;
BA_ "GenMsgCycleTime" BO_ 352 10;
BA_ "GenMsgCycleTimeFast" BO_ 352 0;
BA_ "GenMsgSendType" BO_ 352 0;
BA_ "VFrameFormat" BO_ 352 14;
BA_ "CANFD_BRS" BO_ 352 1;
BA_ "GenMsgCycleTime" BO_ 352 10;
BA_ "GenMsgCycleTimeFast" BO_ 352 0;
BA_ "GenMsgSendType" BO_ 352 0;
BA_ "VFrameFormat" BO_ 352 14;
BA_ "CANFD_BRS" BO_ 352 1;
BA_ "GenMsgCycleTime" BO_ 352 10;
BA_ "GenMsgCycleTimeFast" BO_ 352 0;
BA_ "GenMsgSendType" BO_ 352 0;
BA_ "VFrameFormat" BO_ 352 14;
BA_ "CANFD_BRS" BO_ 352 1;
BA_ "GenMsgCycleTime" BO_ 352 10;
BA_ "GenMsgCycleTimeFast" BO_ 352 0;
BA_ "GenMsgSendType" BO_ 352 0;
BA_ "VFrameFormat" BO_ 352 14;
BA_ "CANFD_BRS" BO_ 352 1;
BA_ "GenMsgCycleTime" BO_ 352 10;
BA_ "GenMsgCycleTimeFast" BO_ 352 0;
BA_ "GenMsgSendType" BO_ 352 0;
BA_ "VFrameFormat" BO_ 352 14;
BA_ "CANFD_BRS" BO_ 352 1;
BA_ "GenMsgCycleTime" BO_ 352 10;
BA_ "GenMsgCycleTimeFast" BO_ 352 0;
BA_ "GenMsgSendType" BO_ 352 0;
BA_ "VFrameFormat" BO_ 352 14;
BA_ "CANFD_BRS" BO_ 352 1;
BA_ "GenMsgCycleTime" BO_ 352 10;
BA_ "GenMsgCycleTimeFast" BO_ 352 0;
BA_ "GenMsgSendType" BO_ 352 0;
BA_ "VFrameFormat" BO_ 352 14;
BA_ "CANFD_BRS" BO_ 352 1;
BA_ "GenMsgCycleTime" BO_ 352 10;
BA_ "GenMsgCycleTimeFast" BO_ 352 0;
BA_ "GenMsgSendType" BO_ 352 0;
BA_ "VFrameFormat" BO_ 352 14;
BA_ "CANFD_BRS" BO_ 352 1;
BA_ "GenMsgCycleTime" BO_ 1238 0;
BA_ "GenMsgCycleTimeFast" BO_ 1238 0;
BA_ "GenMsgSendType" BO_ 1238 1;
BA_ "VFrameFormat" BO_ 1238 14;
BA_ "CANFD_BRS" BO_ 1238 1;
BA_ "GenMsgCycleTime" BO_ 403 20;
BA_ "GenMsgCycleTimeFast" BO_ 403 0;
BA_ "GenMsgSendType" BO_ 403 0;
BA_ "VFrameFormat" BO_ 403 14;
BA_ "CANFD_BRS" BO_ 403 1;
BA_ "GenMsgCycleTime" BO_ 403 20;
BA_ "GenMsgCycleTimeFast" BO_ 403 0;
BA_ "GenMsgSendType" BO_ 403 0;
BA_ "VFrameFormat" BO_ 403 14;
BA_ "CANFD_BRS" BO_ 403 1;
BA_ "GenMsgCycleTime" BO_ 403 20;
BA_ "GenMsgCycleTimeFast" BO_ 403 0;
BA_ "GenMsgSendType" BO_ 403 0;
BA_ "VFrameFormat" BO_ 403 14;
BA_ "CANFD_BRS" BO_ 403 1;
BA_ "GenMsgCycleTime" BO_ 403 20;
BA_ "GenMsgCycleTimeFast" BO_ 403 0;
BA_ "GenMsgSendType" BO_ 403 0;
BA_ "VFrameFormat" BO_ 403 14;
BA_ "CANFD_BRS" BO_ 403 1;
BA_ "GenMsgCycleTime" BO_ 403 20;
BA_ "GenMsgCycleTimeFast" BO_ 403 0;
BA_ "GenMsgSendType" BO_ 403 0;
BA_ "VFrameFormat" BO_ 403 14;
BA_ "CANFD_BRS" BO_ 403 1;
BA_ "GenMsgCycleTime" BO_ 403 20;
BA_ "GenMsgCycleTimeFast" BO_ 403 0;
BA_ "GenMsgSendType" BO_ 403 0;
BA_ "VFrameFormat" BO_ 403 14;
BA_ "CANFD_BRS" BO_ 403 1;
BA_ "GenMsgCycleTime" BO_ 403 20;
BA_ "GenMsgCycleTimeFast" BO_ 403 0;
BA_ "GenMsgSendType" BO_ 403 0;
BA_ "VFrameFormat" BO_ 403 14;
BA_ "CANFD_BRS" BO_ 403 1;
BA_ "GenMsgCycleTime" BO_ 403 20;
BA_ "GenMsgCycleTimeFast" BO_ 403 0;
BA_ "GenMsgSendType" BO_ 403 0;
BA_ "VFrameFormat" BO_ 403 14;
BA_ "CANFD_BRS" BO_ 403 1;
BA_ "GenMsgCycleTime" BO_ 403 20;
BA_ "GenMsgCycleTimeFast" BO_ 403 0;
BA_ "GenMsgSendType" BO_ 403 0;
BA_ "VFrameFormat" BO_ 403 14;
BA_ "CANFD_BRS" BO_ 403 1;
BA_ "GenMsgCycleTime" BO_ 403 20;
BA_ "GenMsgCycleTimeFast" BO_ 403 0;
BA_ "GenMsgSendType" BO_ 403 0;
BA_ "VFrameFormat" BO_ 403 14;
BA_ "CANFD_BRS" BO_ 403 1;
BA_ "GenMsgCycleTime" BO_ 403 20;
BA_ "GenMsgCycleTimeFast" BO_ 403 0;
BA_ "GenMsgSendType" BO_ 403 0;
BA_ "VFrameFormat" BO_ 403 14;
BA_ "CANFD_BRS" BO_ 403 1;
BA_ "GenMsgCycleTime" BO_ 403 20;
BA_ "GenMsgCycleTimeFast" BO_ 403 0;
BA_ "GenMsgSendType" BO_ 403 0;
BA_ "VFrameFormat" BO_ 403 14;
BA_ "CANFD_BRS" BO_ 403 1;
BA_ "GenMsgCycleTime" BO_ 403 20;
BA_ "GenMsgCycleTimeFast" BO_ 403 0;
BA_ "GenMsgSendType" BO_ 403 0;
BA_ "VFrameFormat" BO_ 403 14;
BA_ "CANFD_BRS" BO_ 403 1;
BA_ "GenMsgCycleTime" BO_ 403 20;
BA_ "GenMsgCycleTimeFast" BO_ 403 0;
BA_ "GenMsgSendType" BO_ 403 0;
BA_ "VFrameFormat" BO_ 403 14;
BA_ "CANFD_BRS" BO_ 403 1;
BA_ "GenMsgCycleTime" BO_ 403 20;
BA_ "GenMsgCycleTimeFast" BO_ 403 0;
BA_ "GenMsgSendType" BO_ 403 0;
BA_ "VFrameFormat" BO_ 403 14;
BA_ "CANFD_BRS" BO_ 403 1;
BA_ "GenMsgCycleTime" BO_ 403 20;
BA_ "GenMsgCycleTimeFast" BO_ 403 0;
BA_ "GenMsgSendType" BO_ 403 0;
BA_ "VFrameFormat" BO_ 403 14;
BA_ "CANFD_BRS" BO_ 403 1;
BA_ "GenMsgCycleTime" BO_ 403 20;
BA_ "GenMsgCycleTimeFast" BO_ 403 0;
BA_ "GenMsgSendType" BO_ 403 0;
BA_ "VFrameFormat" BO_ 403 14;
BA_ "CANFD_BRS" BO_ 403 1;
BA_ "GenMsgCycleTime" BO_ 403 20;
BA_ "GenMsgCycleTimeFast" BO_ 403 0;
BA_ "GenMsgSendType" BO_ 403 0;
BA_ "VFrameFormat" BO_ 403 14;
BA_ "CANFD_BRS" BO_ 403 1;
BA_ "GenMsgCycleTime" BO_ 403 20;
BA_ "GenMsgCycleTimeFast" BO_ 403 0;
BA_ "GenMsgSendType" BO_ 403 0;
BA_ "VFrameFormat" BO_ 403 14;
BA_ "CANFD_BRS" BO_ 403 1;
BA_ "GenMsgCycleTime" BO_ 403 20;
BA_ "GenMsgCycleTimeFast" BO_ 403 0;
BA_ "GenMsgSendType" BO_ 403 0;
BA_ "VFrameFormat" BO_ 403 14;
BA_ "CANFD_BRS" BO_ 403 1;
BA_ "GenMsgCycleTime" BO_ 403 20;
BA_ "GenMsgCycleTimeFast" BO_ 403 0;
BA_ "GenMsgSendType" BO_ 403 0;
BA_ "VFrameFormat" BO_ 403 14;
BA_ "CANFD_BRS" BO_ 403 1;
BA_ "GenMsgCycleTime" BO_ 403 20;
BA_ "GenMsgCycleTimeFast" BO_ 403 0;
BA_ "GenMsgSendType" BO_ 403 0;
BA_ "VFrameFormat" BO_ 403 14;
BA_ "CANFD_BRS" BO_ 403 1;
BA_ "GenMsgCycleTime" BO_ 403 20;
BA_ "GenMsgCycleTimeFast" BO_ 403 0;
BA_ "GenMsgSendType" BO_ 403 0;
BA_ "VFrameFormat" BO_ 403 14;
BA_ "CANFD_BRS" BO_ 403 1;
BA_ "GenMsgCycleTime" BO_ 403 20;
BA_ "GenMsgCycleTimeFast" BO_ 403 0;
BA_ "GenMsgSendType" BO_ 403 0;
BA_ "VFrameFormat" BO_ 403 14;
BA_ "CANFD_BRS" BO_ 403 1;
BA_ "GenMsgCycleTime" BO_ 403 20;
BA_ "GenMsgCycleTimeFast" BO_ 403 0;
BA_ "GenMsgSendType" BO_ 403 0;
BA_ "VFrameFormat" BO_ 403 14;
BA_ "CANFD_BRS" BO_ 403 1;
BA_ "GenMsgCycleTime" BO_ 403 20;
BA_ "GenMsgCycleTimeFast" BO_ 403 0;
BA_ "GenMsgSendType" BO_ 403 0;
BA_ "VFrameFormat" BO_ 403 14;
BA_ "CANFD_BRS" BO_ 403 1;
BA_ "GenMsgCycleTime" BO_ 403 20;
BA_ "GenMsgCycleTimeFast" BO_ 403 0;
BA_ "GenMsgSendType" BO_ 403 0;
BA_ "VFrameFormat" BO_ 403 14;
BA_ "CANFD_BRS" BO_ 403 1;
BA_ "GenMsgCycleTime" BO_ 403 20;
BA_ "GenMsgCycleTimeFast" BO_ 403 0;
BA_ "GenMsgSendType" BO_ 403 0;
BA_ "VFrameFormat" BO_ 403 14;
BA_ "CANFD_BRS" BO_ 403 1;
BA_ "GenMsgCycleTime" BO_ 403 20;
BA_ "GenMsgCycleTimeFast" BO_ 403 0;
BA_ "GenMsgSendType" BO_ 403 0;
BA_ "VFrameFormat" BO_ 403 14;
BA_ "CANFD_BRS" BO_ 403 1;
BA_ "GenMsgCycleTime" BO_ 403 20;
BA_ "GenMsgCycleTimeFast" BO_ 403 0;
BA_ "GenMsgSendType" BO_ 403 0;
BA_ "VFrameFormat" BO_ 403 14;
BA_ "CANFD_BRS" BO_ 403 1;
BA_ "GenMsgCycleTime" BO_ 403 20;
BA_ "GenMsgCycleTimeFast" BO_ 403 0;
BA_ "GenMsgSendType" BO_ 403 0;
BA_ "VFrameFormat" BO_ 403 14;
BA_ "CANFD_BRS" BO_ 403 1;
BA_ "GenMsgCycleTime" BO_ 403 20;
BA_ "GenMsgCycleTimeFast" BO_ 403 0;
BA_ "GenMsgSendType" BO_ 403 0;
BA_ "VFrameFormat" BO_ 403 14;
BA_ "CANFD_BRS" BO_ 403 1;
BA_ "GenMsgCycleTime" BO_ 403 20;
BA_ "GenMsgCycleTimeFast" BO_ 403 0;
BA_ "GenMsgSendType" BO_ 403 0;
BA_ "VFrameFormat" BO_ 403 14;
BA_ "CANFD_BRS" BO_ 403 1;
BA_ "GenMsgCycleTime" BO_ 403 20;
BA_ "GenMsgCycleTimeFast" BO_ 403 0;
BA_ "GenMsgSendType" BO_ 403 0;
BA_ "VFrameFormat" BO_ 403 14;
BA_ "CANFD_BRS" BO_ 403 1;
BA_ "GenMsgCycleTime" BO_ 403 20;
BA_ "GenMsgCycleTimeFast" BO_ 403 0;
BA_ "GenMsgSendType" BO_ 403 0;
BA_ "VFrameFormat" BO_ 403 14;
BA_ "CANFD_BRS" BO_ 403 1;
BA_ "GenMsgCycleTime" BO_ 403 20;
BA_ "GenMsgCycleTimeFast" BO_ 403 0;
BA_ "GenMsgSendType" BO_ 403 0;
BA_ "VFrameFormat" BO_ 403 14;
BA_ "CANFD_BRS" BO_ 403 1;
BA_ "GenMsgCycleTime" BO_ 403 20;
BA_ "GenMsgCycleTimeFast" BO_ 403 0;
BA_ "GenMsgSendType" BO_ 403 0;
BA_ "VFrameFormat" BO_ 403 14;
BA_ "CANFD_BRS" BO_ 403 1;
BA_ "GenMsgCycleTime" BO_ 403 20;
BA_ "GenMsgCycleTimeFast" BO_ 403 0;
BA_ "GenMsgSendType" BO_ 403 0;
BA_ "VFrameFormat" BO_ 403 14;
BA_ "CANFD_BRS" BO_ 403 1;
BA_ "GenMsgCycleTime" BO_ 403 20;
BA_ "GenMsgCycleTimeFast" BO_ 403 0;
BA_ "GenMsgSendType" BO_ 403 0;
BA_ "VFrameFormat" BO_ 403 14;
BA_ "CANFD_BRS" BO_ 403 1;
BA_ "GenMsgCycleTime" BO_ 403 20;
BA_ "GenMsgCycleTimeFast" BO_ 403 0;
BA_ "GenMsgSendType" BO_ 403 0;
BA_ "VFrameFormat" BO_ 403 14;
BA_ "CANFD_BRS" BO_ 403 1;
BA_ "GenMsgCycleTime" BO_ 403 20;
BA_ "GenMsgCycleTimeFast" BO_ 403 0;
BA_ "GenMsgSendType" BO_ 403 0;
BA_ "VFrameFormat" BO_ 403 14;
BA_ "CANFD_BRS" BO_ 403 1;
BA_ "GenMsgCycleTime" BO_ 403 20;
BA_ "GenMsgCycleTimeFast" BO_ 403 0;
BA_ "GenMsgSendType" BO_ 403 0;
BA_ "VFrameFormat" BO_ 403 14;
BA_ "CANFD_BRS" BO_ 403 1;
BA_ "GenMsgCycleTime" BO_ 403 20;
BA_ "GenMsgCycleTimeFast" BO_ 403 0;
BA_ "GenMsgSendType" BO_ 403 0;
BA_ "VFrameFormat" BO_ 403 14;
BA_ "CANFD_BRS" BO_ 403 1;
BA_ "GenMsgCycleTime" BO_ 403 20;
BA_ "GenMsgCycleTimeFast" BO_ 403 0;
BA_ "GenMsgSendType" BO_ 403 0;
BA_ "VFrameFormat" BO_ 403 14;
BA_ "CANFD_BRS" BO_ 403 1;
BA_ "GenMsgCycleTime" BO_ 403 20;
BA_ "GenMsgCycleTimeFast" BO_ 403 0;
BA_ "GenMsgSendType" BO_ 403 0;
BA_ "VFrameFormat" BO_ 403 14;
BA_ "CANFD_BRS" BO_ 403 1;
BA_ "GenMsgCycleTime" BO_ 403 20;
BA_ "GenMsgCycleTimeFast" BO_ 403 0;
BA_ "GenMsgSendType" BO_ 403 0;
BA_ "VFrameFormat" BO_ 403 14;
BA_ "CANFD_BRS" BO_ 403 1;
BA_ "GenMsgCycleTime" BO_ 403 20;
BA_ "GenMsgCycleTimeFast" BO_ 403 0;
BA_ "GenMsgSendType" BO_ 403 0;
BA_ "VFrameFormat" BO_ 403 14;
BA_ "CANFD_BRS" BO_ 403 1;
BA_ "GenMsgCycleTime" BO_ 403 20;
BA_ "GenMsgCycleTimeFast" BO_ 403 0;
BA_ "GenMsgSendType" BO_ 403 0;
BA_ "VFrameFormat" BO_ 403 14;
BA_ "CANFD_BRS" BO_ 403 1;
BA_ "GenMsgCycleTime" BO_ 403 20;
BA_ "GenMsgCycleTimeFast" BO_ 403 0;
BA_ "GenMsgSendType" BO_ 403 0;
BA_ "VFrameFormat" BO_ 403 14;
BA_ "CANFD_BRS" BO_ 403 1;
BA_ "GenMsgCycleTime" BO_ 403 20;
BA_ "GenMsgCycleTimeFast" BO_ 403 0;
BA_ "GenMsgSendType" BO_ 403 0;
BA_ "VFrameFormat" BO_ 403 14;
BA_ "CANFD_BRS" BO_ 403 1;
BA_ "GenMsgCycleTime" BO_ 403 20;
BA_ "GenMsgCycleTimeFast" BO_ 403 0;
BA_ "GenMsgSendType" BO_ 403 0;
BA_ "VFrameFormat" BO_ 403 14;
BA_ "CANFD_BRS" BO_ 403 1;
BA_ "GenMsgCycleTime" BO_ 403 20;
BA_ "GenMsgCycleTimeFast" BO_ 403 0;
BA_ "GenMsgSendType" BO_ 403 0;
BA_ "VFrameFormat" BO_ 403 14;
BA_ "CANFD_BRS" BO_ 403 1;
BA_ "GenMsgCycleTime" BO_ 403 20;
BA_ "GenMsgCycleTimeFast" BO_ 403 0;
BA_ "GenMsgSendType" BO_ 403 0;
BA_ "VFrameFormat" BO_ 403 14;
BA_ "CANFD_BRS" BO_ 403 1;
BA_ "GenMsgCycleTime" BO_ 403 20;
BA_ "GenMsgCycleTimeFast" BO_ 403 0;
BA_ "GenMsgSendType" BO_ 403 0;
BA_ "VFrameFormat" BO_ 403 14;
BA_ "CANFD_BRS" BO_ 403 1;
BA_ "GenMsgCycleTime" BO_ 403 20;
BA_ "GenMsgCycleTimeFast" BO_ 403 0;
BA_ "GenMsgSendType" BO_ 403 0;
BA_ "VFrameFormat" BO_ 403 14;
BA_ "CANFD_BRS" BO_ 403 1;
BA_ "GenMsgCycleTime" BO_ 403 20;
BA_ "GenMsgCycleTimeFast" BO_ 403 0;
BA_ "GenMsgSendType" BO_ 403 0;
BA_ "VFrameFormat" BO_ 403 14;
BA_ "CANFD_BRS" BO_ 403 1;
BA_ "GenMsgCycleTime" BO_ 403 20;
BA_ "GenMsgCycleTimeFast" BO_ 403 0;
BA_ "GenMsgSendType" BO_ 403 0;
BA_ "VFrameFormat" BO_ 403 14;
BA_ "CANFD_BRS" BO_ 403 1;
BA_ "GenMsgCycleTime" BO_ 403 20;
BA_ "GenMsgCycleTimeFast" BO_ 403 0;
BA_ "GenMsgSendType" BO_ 403 0;
BA_ "VFrameFormat" BO_ 403 14;
BA_ "CANFD_BRS" BO_ 403 1;
BA_ "GenMsgCycleTime" BO_ 411 20;
BA_ "GenMsgCycleTimeFast" BO_ 411 0;
BA_ "GenMsgSendType" BO_ 411 0;
BA_ "VFrameFormat" BO_ 411 14;
BA_ "CANFD_BRS" BO_ 411 1;
BA_ "GenMsgCycleTime" BO_ 411 20;
BA_ "GenMsgCycleTimeFast" BO_ 411 0;
BA_ "GenMsgSendType" BO_ 411 0;
BA_ "VFrameFormat" BO_ 411 14;
BA_ "CANFD_BRS" BO_ 411 1;
BA_ "GenMsgCycleTime" BO_ 411 20;
BA_ "GenMsgCycleTimeFast" BO_ 411 0;
BA_ "GenMsgSendType" BO_ 411 0;
BA_ "VFrameFormat" BO_ 411 14;
BA_ "CANFD_BRS" BO_ 411 1;
BA_ "GenMsgCycleTime" BO_ 411 20;
BA_ "GenMsgCycleTimeFast" BO_ 411 0;
BA_ "GenMsgSendType" BO_ 411 0;
BA_ "VFrameFormat" BO_ 411 14;
BA_ "CANFD_BRS" BO_ 411 1;
BA_ "GenMsgCycleTime" BO_ 411 20;
BA_ "GenMsgCycleTimeFast" BO_ 411 0;
BA_ "GenMsgSendType" BO_ 411 0;
BA_ "VFrameFormat" BO_ 411 14;
BA_ "CANFD_BRS" BO_ 411 1;
BA_ "GenMsgCycleTime" BO_ 411 20;
BA_ "GenMsgCycleTimeFast" BO_ 411 0;
BA_ "GenMsgSendType" BO_ 411 0;
BA_ "VFrameFormat" BO_ 411 14;
BA_ "CANFD_BRS" BO_ 411 1;
BA_ "GenMsgCycleTime" BO_ 411 20;
BA_ "GenMsgCycleTimeFast" BO_ 411 0;
BA_ "GenMsgSendType" BO_ 411 0;
BA_ "VFrameFormat" BO_ 411 14;
BA_ "CANFD_BRS" BO_ 411 1;
BA_ "GenMsgCycleTime" BO_ 411 20;
BA_ "GenMsgCycleTimeFast" BO_ 411 0;
BA_ "GenMsgSendType" BO_ 411 0;
BA_ "VFrameFormat" BO_ 411 14;
BA_ "CANFD_BRS" BO_ 411 1;
BA_ "GenMsgCycleTime" BO_ 411 20;
BA_ "GenMsgCycleTimeFast" BO_ 411 0;
BA_ "GenMsgSendType" BO_ 411 0;
BA_ "VFrameFormat" BO_ 411 14;
BA_ "CANFD_BRS" BO_ 411 1;
BA_ "GenMsgCycleTime" BO_ 411 20;
BA_ "GenMsgCycleTimeFast" BO_ 411 0;
BA_ "GenMsgSendType" BO_ 411 0;
BA_ "VFrameFormat" BO_ 411 14;
BA_ "CANFD_BRS" BO_ 411 1;
BA_ "GenMsgCycleTime" BO_ 411 20;
BA_ "GenMsgCycleTimeFast" BO_ 411 0;
BA_ "GenMsgSendType" BO_ 411 0;
BA_ "VFrameFormat" BO_ 411 14;
BA_ "CANFD_BRS" BO_ 411 1;
BA_ "GenMsgCycleTime" BO_ 411 20;
BA_ "GenMsgCycleTimeFast" BO_ 411 0;
BA_ "GenMsgSendType" BO_ 411 0;
BA_ "VFrameFormat" BO_ 411 14;
BA_ "CANFD_BRS" BO_ 411 1;
BA_ "GenMsgCycleTime" BO_ 411 20;
BA_ "GenMsgCycleTimeFast" BO_ 411 0;
BA_ "GenMsgSendType" BO_ 411 0;
BA_ "VFrameFormat" BO_ 411 14;
BA_ "CANFD_BRS" BO_ 411 1;
BA_ "GenMsgCycleTime" BO_ 411 20;
BA_ "GenMsgCycleTimeFast" BO_ 411 0;
BA_ "GenMsgSendType" BO_ 411 0;
BA_ "VFrameFormat" BO_ 411 14;
BA_ "CANFD_BRS" BO_ 411 1;
BA_ "GenMsgCycleTime" BO_ 411 20;
BA_ "GenMsgCycleTimeFast" BO_ 411 0;
BA_ "GenMsgSendType" BO_ 411 0;
BA_ "VFrameFormat" BO_ 411 14;
BA_ "CANFD_BRS" BO_ 411 1;
BA_ "GenMsgCycleTime" BO_ 411 20;
BA_ "GenMsgCycleTimeFast" BO_ 411 0;
BA_ "GenMsgSendType" BO_ 411 0;
BA_ "VFrameFormat" BO_ 411 14;
BA_ "CANFD_BRS" BO_ 411 1;
BA_ "GenMsgCycleTime" BO_ 411 20;
BA_ "GenMsgCycleTimeFast" BO_ 411 0;
BA_ "GenMsgSendType" BO_ 411 0;
BA_ "VFrameFormat" BO_ 411 14;
BA_ "CANFD_BRS" BO_ 411 1;
BA_ "GenMsgCycleTime" BO_ 411 20;
BA_ "GenMsgCycleTimeFast" BO_ 411 0;
BA_ "GenMsgSendType" BO_ 411 0;
BA_ "VFrameFormat" BO_ 411 14;
BA_ "CANFD_BRS" BO_ 411 1;
BA_ "GenMsgCycleTime" BO_ 411 20;
BA_ "GenMsgCycleTimeFast" BO_ 411 0;
BA_ "GenMsgSendType" BO_ 411 0;
BA_ "VFrameFormat" BO_ 411 14;
BA_ "CANFD_BRS" BO_ 411 1;
BA_ "GenMsgCycleTime" BO_ 411 20;
BA_ "GenMsgCycleTimeFast" BO_ 411 0;
BA_ "GenMsgSendType" BO_ 411 0;
BA_ "VFrameFormat" BO_ 411 14;
BA_ "CANFD_BRS" BO_ 411 1;
BA_ "GenMsgCycleTime" BO_ 411 20;
BA_ "GenMsgCycleTimeFast" BO_ 411 0;
BA_ "GenMsgSendType" BO_ 411 0;
BA_ "VFrameFormat" BO_ 411 14;
BA_ "CANFD_BRS" BO_ 411 1;
BA_ "GenMsgCycleTime" BO_ 411 20;
BA_ "GenMsgCycleTimeFast" BO_ 411 0;
BA_ "GenMsgSendType" BO_ 411 0;
BA_ "VFrameFormat" BO_ 411 14;
BA_ "CANFD_BRS" BO_ 411 1;
BA_ "GenMsgCycleTime" BO_ 411 20;
BA_ "GenMsgCycleTimeFast" BO_ 411 0;
BA_ "GenMsgSendType" BO_ 411 0;
BA_ "VFrameFormat" BO_ 411 14;
BA_ "CANFD_BRS" BO_ 411 1;
BA_ "GenMsgCycleTime" BO_ 411 20;
BA_ "GenMsgCycleTimeFast" BO_ 411 0;
BA_ "GenMsgSendType" BO_ 411 0;
BA_ "VFrameFormat" BO_ 411 14;
BA_ "CANFD_BRS" BO_ 411 1;
BA_ "GenMsgCycleTime" BO_ 411 20;
BA_ "GenMsgCycleTimeFast" BO_ 411 0;
BA_ "GenMsgSendType" BO_ 411 0;
BA_ "VFrameFormat" BO_ 411 14;
BA_ "CANFD_BRS" BO_ 411 1;
BA_ "GenMsgCycleTime" BO_ 411 20;
BA_ "GenMsgCycleTimeFast" BO_ 411 0;
BA_ "GenMsgSendType" BO_ 411 0;
BA_ "VFrameFormat" BO_ 411 14;
BA_ "CANFD_BRS" BO_ 411 1;
BA_ "GenMsgCycleTime" BO_ 411 20;
BA_ "GenMsgCycleTimeFast" BO_ 411 0;
BA_ "GenMsgSendType" BO_ 411 0;
BA_ "VFrameFormat" BO_ 411 14;
BA_ "CANFD_BRS" BO_ 411 1;
BA_ "GenMsgCycleTime" BO_ 411 20;
BA_ "GenMsgCycleTimeFast" BO_ 411 0;
BA_ "GenMsgSendType" BO_ 411 0;
BA_ "VFrameFormat" BO_ 411 14;
BA_ "CANFD_BRS" BO_ 411 1;
BA_ "GenMsgCycleTime" BO_ 411 20;
BA_ "GenMsgCycleTimeFast" BO_ 411 0;
BA_ "GenMsgSendType" BO_ 411 0;
BA_ "VFrameFormat" BO_ 411 14;
BA_ "CANFD_BRS" BO_ 411 1;
BA_ "GenMsgCycleTime" BO_ 411 20;
BA_ "GenMsgCycleTimeFast" BO_ 411 0;
BA_ "GenMsgSendType" BO_ 411 0;
BA_ "VFrameFormat" BO_ 411 14;
BA_ "CANFD_BRS" BO_ 411 1;
BA_ "GenMsgCycleTime" BO_ 411 20;
BA_ "GenMsgCycleTimeFast" BO_ 411 0;
BA_ "GenMsgSendType" BO_ 411 0;
BA_ "VFrameFormat" BO_ 411 14;
BA_ "CANFD_BRS" BO_ 411 1;
BA_ "GenMsgCycleTime" BO_ 411 20;
BA_ "GenMsgCycleTimeFast" BO_ 411 0;
BA_ "GenMsgSendType" BO_ 411 0;
BA_ "VFrameFormat" BO_ 411 14;
BA_ "CANFD_BRS" BO_ 411 1;
BA_ "GenMsgCycleTime" BO_ 411 20;
BA_ "GenMsgCycleTimeFast" BO_ 411 0;
BA_ "GenMsgSendType" BO_ 411 0;
BA_ "VFrameFormat" BO_ 411 14;
BA_ "CANFD_BRS" BO_ 411 1;
BA_ "GenMsgCycleTime" BO_ 411 20;
BA_ "GenMsgCycleTimeFast" BO_ 411 0;
BA_ "GenMsgSendType" BO_ 411 0;
BA_ "VFrameFormat" BO_ 411 14;
BA_ "CANFD_BRS" BO_ 411 1;
BA_ "GenMsgCycleTime" BO_ 411 20;
BA_ "GenMsgCycleTimeFast" BO_ 411 0;
BA_ "GenMsgSendType" BO_ 411 0;
BA_ "VFrameFormat" BO_ 411 14;
BA_ "CANFD_BRS" BO_ 411 1;
BA_ "GenMsgCycleTime" BO_ 411 20;
BA_ "GenMsgCycleTimeFast" BO_ 411 0;
BA_ "GenMsgSendType" BO_ 411 0;
BA_ "VFrameFormat" BO_ 411 14;
BA_ "CANFD_BRS" BO_ 411 1;
BA_ "GenMsgCycleTime" BO_ 411 20;
BA_ "GenMsgCycleTimeFast" BO_ 411 0;
BA_ "GenMsgSendType" BO_ 411 0;
BA_ "VFrameFormat" BO_ 411 14;
BA_ "CANFD_BRS" BO_ 411 1;
BA_ "GenMsgCycleTime" BO_ 411 20;
BA_ "GenMsgCycleTimeFast" BO_ 411 0;
BA_ "GenMsgSendType" BO_ 411 0;
BA_ "VFrameFormat" BO_ 411 14;
BA_ "CANFD_BRS" BO_ 411 1;
BA_ "GenMsgCycleTime" BO_ 411 20;
BA_ "GenMsgCycleTimeFast" BO_ 411 0;
BA_ "GenMsgSendType" BO_ 411 0;
BA_ "VFrameFormat" BO_ 411 14;
BA_ "CANFD_BRS" BO_ 411 1;
BA_ "GenMsgCycleTime" BO_ 411 20;
BA_ "GenMsgCycleTimeFast" BO_ 411 0;
BA_ "GenMsgSendType" BO_ 411 0;
BA_ "VFrameFormat" BO_ 411 14;
BA_ "CANFD_BRS" BO_ 411 1;
BA_ "GenMsgCycleTime" BO_ 411 20;
BA_ "GenMsgCycleTimeFast" BO_ 411 0;
BA_ "GenMsgSendType" BO_ 411 0;
BA_ "VFrameFormat" BO_ 411 14;
BA_ "CANFD_BRS" BO_ 411 1;
BA_ "GenMsgCycleTime" BO_ 411 20;
BA_ "GenMsgCycleTimeFast" BO_ 411 0;
BA_ "GenMsgSendType" BO_ 411 0;
BA_ "VFrameFormat" BO_ 411 14;
BA_ "CANFD_BRS" BO_ 411 1;
BA_ "GenMsgCycleTime" BO_ 411 20;
BA_ "GenMsgCycleTimeFast" BO_ 411 0;
BA_ "GenMsgSendType" BO_ 411 0;
BA_ "VFrameFormat" BO_ 411 14;
BA_ "CANFD_BRS" BO_ 411 1;
BA_ "GenMsgCycleTime" BO_ 411 20;
BA_ "GenMsgCycleTimeFast" BO_ 411 0;
BA_ "GenMsgSendType" BO_ 411 0;
BA_ "VFrameFormat" BO_ 411 14;
BA_ "CANFD_BRS" BO_ 411 1;
BA_ "GenMsgCycleTime" BO_ 411 20;
BA_ "GenMsgCycleTimeFast" BO_ 411 0;
BA_ "GenMsgSendType" BO_ 411 0;
BA_ "VFrameFormat" BO_ 411 14;
BA_ "CANFD_BRS" BO_ 411 1;
BA_ "GenMsgCycleTime" BO_ 411 20;
BA_ "GenMsgCycleTimeFast" BO_ 411 0;
BA_ "GenMsgSendType" BO_ 411 0;
BA_ "VFrameFormat" BO_ 411 14;
BA_ "CANFD_BRS" BO_ 411 1;
BA_ "GenMsgCycleTime" BO_ 411 20;
BA_ "GenMsgCycleTimeFast" BO_ 411 0;
BA_ "GenMsgSendType" BO_ 411 0;
BA_ "VFrameFormat" BO_ 411 14;
BA_ "CANFD_BRS" BO_ 411 1;
BA_ "GenMsgCycleTime" BO_ 411 20;
BA_ "GenMsgCycleTimeFast" BO_ 411 0;
BA_ "GenMsgSendType" BO_ 411 0;
BA_ "VFrameFormat" BO_ 411 14;
BA_ "CANFD_BRS" BO_ 411 1;
BA_ "GenMsgCycleTime" BO_ 411 20;
BA_ "GenMsgCycleTimeFast" BO_ 411 0;
BA_ "GenMsgSendType" BO_ 411 0;
BA_ "VFrameFormat" BO_ 411 14;
BA_ "CANFD_BRS" BO_ 411 1;
BA_ "GenMsgCycleTime" BO_ 411 20;
BA_ "GenMsgCycleTimeFast" BO_ 411 0;
BA_ "GenMsgSendType" BO_ 411 0;
BA_ "VFrameFormat" BO_ 411 14;
BA_ "CANFD_BRS" BO_ 411 1;
BA_ "GenMsgCycleTime" BO_ 411 20;
BA_ "GenMsgCycleTimeFast" BO_ 411 0;
BA_ "GenMsgSendType" BO_ 411 0;
BA_ "VFrameFormat" BO_ 411 14;
BA_ "CANFD_BRS" BO_ 411 1;
BA_ "GenMsgCycleTime" BO_ 411 20;
BA_ "GenMsgCycleTimeFast" BO_ 411 0;
BA_ "GenMsgSendType" BO_ 411 0;
BA_ "VFrameFormat" BO_ 411 14;
BA_ "CANFD_BRS" BO_ 411 1;
BA_ "GenMsgCycleTime" BO_ 411 20;
BA_ "GenMsgCycleTimeFast" BO_ 411 0;
BA_ "GenMsgSendType" BO_ 411 0;
BA_ "VFrameFormat" BO_ 411 14;
BA_ "CANFD_BRS" BO_ 411 1;
BA_ "GenMsgCycleTime" BO_ 411 20;
BA_ "GenMsgCycleTimeFast" BO_ 411 0;
BA_ "GenMsgSendType" BO_ 411 0;
BA_ "VFrameFormat" BO_ 411 14;
BA_ "CANFD_BRS" BO_ 411 1;
BA_ "GenMsgCycleTime" BO_ 411 20;
BA_ "GenMsgCycleTimeFast" BO_ 411 0;
BA_ "GenMsgSendType" BO_ 411 0;
BA_ "VFrameFormat" BO_ 411 14;
BA_ "CANFD_BRS" BO_ 411 1;
BA_ "GenMsgCycleTime" BO_ 411 20;
BA_ "GenMsgCycleTimeFast" BO_ 411 0;
BA_ "GenMsgSendType" BO_ 411 0;
BA_ "VFrameFormat" BO_ 411 14;
BA_ "CANFD_BRS" BO_ 411 1;
BA_ "GenMsgCycleTime" BO_ 411 20;
BA_ "GenMsgCycleTimeFast" BO_ 411 0;
BA_ "GenMsgSendType" BO_ 411 0;
BA_ "VFrameFormat" BO_ 411 14;
BA_ "CANFD_BRS" BO_ 411 1;
BA_ "GenMsgCycleTime" BO_ 411 20;
BA_ "GenMsgCycleTimeFast" BO_ 411 0;
BA_ "GenMsgSendType" BO_ 411 0;
BA_ "VFrameFormat" BO_ 411 14;
BA_ "CANFD_BRS" BO_ 411 1;
BA_ "GenMsgCycleTime" BO_ 411 20;
BA_ "GenMsgCycleTimeFast" BO_ 411 0;
BA_ "GenMsgSendType" BO_ 411 0;
BA_ "VFrameFormat" BO_ 411 14;
BA_ "CANFD_BRS" BO_ 411 1;
BA_ "GenMsgCycleTime" BO_ 411 20;
BA_ "GenMsgCycleTimeFast" BO_ 411 0;
BA_ "GenMsgSendType" BO_ 411 0;
BA_ "VFrameFormat" BO_ 411 14;
BA_ "CANFD_BRS" BO_ 411 1;
BA_ "GenMsgCycleTime" BO_ 411 20;
BA_ "GenMsgCycleTimeFast" BO_ 411 0;
BA_ "GenMsgSendType" BO_ 411 0;
BA_ "VFrameFormat" BO_ 411 14;
BA_ "CANFD_BRS" BO_ 411 1;
BA_ "GenMsgCycleTime" BO_ 411 20;
BA_ "GenMsgCycleTimeFast" BO_ 411 0;
BA_ "GenMsgSendType" BO_ 411 0;
BA_ "VFrameFormat" BO_ 411 14;
BA_ "CANFD_BRS" BO_ 411 1;
BA_ "GenMsgCycleTime" BO_ 411 20;
BA_ "GenMsgCycleTimeFast" BO_ 411 0;
BA_ "GenMsgSendType" BO_ 411 0;
BA_ "VFrameFormat" BO_ 411 14;
BA_ "CANFD_BRS" BO_ 411 1;
BA_ "GenMsgCycleTime" BO_ 411 20;
BA_ "GenMsgCycleTimeFast" BO_ 411 0;
BA_ "GenMsgSendType" BO_ 411 0;
BA_ "VFrameFormat" BO_ 411 14;
BA_ "CANFD_BRS" BO_ 411 1;
BA_ "GenMsgCycleTime" BO_ 411 20;
BA_ "GenMsgCycleTimeFast" BO_ 411 0;
BA_ "GenMsgSendType" BO_ 411 0;
BA_ "VFrameFormat" BO_ 411 14;
BA_ "CANFD_BRS" BO_ 411 1;
BA_ "GenMsgCycleTime" BO_ 411 20;
BA_ "GenMsgCycleTimeFast" BO_ 411 0;
BA_ "GenMsgSendType" BO_ 411 0;
BA_ "VFrameFormat" BO_ 411 14;
BA_ "CANFD_BRS" BO_ 411 1;
BA_ "GenMsgCycleTime" BO_ 411 20;
BA_ "GenMsgCycleTimeFast" BO_ 411 0;
BA_ "GenMsgSendType" BO_ 411 0;
BA_ "VFrameFormat" BO_ 411 14;
BA_ "CANFD_BRS" BO_ 411 1;
BA_ "GenMsgCycleTime" BO_ 411 20;
BA_ "GenMsgCycleTimeFast" BO_ 411 0;
BA_ "GenMsgSendType" BO_ 411 0;
BA_ "VFrameFormat" BO_ 411 14;
BA_ "CANFD_BRS" BO_ 411 1;
BA_ "GenMsgCycleTime" BO_ 411 20;
BA_ "GenMsgCycleTimeFast" BO_ 411 0;
BA_ "GenMsgSendType" BO_ 411 0;
BA_ "VFrameFormat" BO_ 411 14;
BA_ "CANFD_BRS" BO_ 411 1;
BA_ "GenMsgCycleTime" BO_ 411 20;
BA_ "GenMsgCycleTimeFast" BO_ 411 0;
BA_ "GenMsgSendType" BO_ 411 0;
BA_ "VFrameFormat" BO_ 411 14;
BA_ "CANFD_BRS" BO_ 411 1;
BA_ "GenMsgCycleTime" BO_ 411 20;
BA_ "GenMsgCycleTimeFast" BO_ 411 0;
BA_ "GenMsgSendType" BO_ 411 0;
BA_ "VFrameFormat" BO_ 411 14;
BA_ "CANFD_BRS" BO_ 411 1;
BA_ "GenMsgCycleTime" BO_ 411 20;
BA_ "GenMsgCycleTimeFast" BO_ 411 0;
BA_ "GenMsgSendType" BO_ 411 0;
BA_ "VFrameFormat" BO_ 411 14;
BA_ "CANFD_BRS" BO_ 411 1;
BA_ "GenMsgCycleTime" BO_ 411 20;
BA_ "GenMsgCycleTimeFast" BO_ 411 0;
BA_ "GenMsgSendType" BO_ 411 0;
BA_ "VFrameFormat" BO_ 411 14;
BA_ "CANFD_BRS" BO_ 411 1;
BA_ "GenMsgCycleTime" BO_ 411 20;
BA_ "GenMsgCycleTimeFast" BO_ 411 0;
BA_ "GenMsgSendType" BO_ 411 0;
BA_ "VFrameFormat" BO_ 411 14;
BA_ "CANFD_BRS" BO_ 411 1;
BA_ "GenMsgCycleTime" BO_ 411 20;
BA_ "GenMsgCycleTimeFast" BO_ 411 0;
BA_ "GenMsgSendType" BO_ 411 0;
BA_ "VFrameFormat" BO_ 411 14;
BA_ "CANFD_BRS" BO_ 411 1;
BA_ "GenMsgCycleTime" BO_ 411 20;
BA_ "GenMsgCycleTimeFast" BO_ 411 0;
BA_ "GenMsgSendType" BO_ 411 0;
BA_ "VFrameFormat" BO_ 411 14;
BA_ "CANFD_BRS" BO_ 411 1;
BA_ "GenMsgCycleTime" BO_ 411 20;
BA_ "GenMsgCycleTimeFast" BO_ 411 0;
BA_ "GenMsgSendType" BO_ 411 0;
BA_ "VFrameFormat" BO_ 411 14;
BA_ "CANFD_BRS" BO_ 411 1;
BA_ "GenMsgCycleTime" BO_ 411 20;
BA_ "GenMsgCycleTimeFast" BO_ 411 0;
BA_ "GenMsgSendType" BO_ 411 0;
BA_ "VFrameFormat" BO_ 411 14;
BA_ "CANFD_BRS" BO_ 411 1;
BA_ "GenMsgCycleTime" BO_ 411 20;
BA_ "GenMsgCycleTimeFast" BO_ 411 0;
BA_ "GenMsgSendType" BO_ 411 0;
BA_ "VFrameFormat" BO_ 411 14;
BA_ "CANFD_BRS" BO_ 411 1;
BA_ "GenMsgCycleTime" BO_ 411 20;
BA_ "GenMsgCycleTimeFast" BO_ 411 0;
BA_ "GenMsgSendType" BO_ 411 0;
BA_ "VFrameFormat" BO_ 411 14;
BA_ "CANFD_BRS" BO_ 411 1;
BA_ "GenMsgCycleTime" BO_ 411 20;
BA_ "GenMsgCycleTimeFast" BO_ 411 0;
BA_ "GenMsgSendType" BO_ 411 0;
BA_ "VFrameFormat" BO_ 411 14;
BA_ "CANFD_BRS" BO_ 411 1;
BA_ "GenMsgCycleTime" BO_ 411 20;
BA_ "GenMsgCycleTimeFast" BO_ 411 0;
BA_ "GenMsgSendType" BO_ 411 0;
BA_ "VFrameFormat" BO_ 411 14;
BA_ "CANFD_BRS" BO_ 411 1;
BA_ "GenMsgCycleTime" BO_ 411 20;
BA_ "GenMsgCycleTimeFast" BO_ 411 0;
BA_ "GenMsgSendType" BO_ 411 0;
BA_ "VFrameFormat" BO_ 411 14;
BA_ "CANFD_BRS" BO_ 411 1;
BA_ "GenMsgCycleTime" BO_ 411 20;
BA_ "GenMsgCycleTimeFast" BO_ 411 0;
BA_ "GenMsgSendType" BO_ 411 0;
BA_ "VFrameFormat" BO_ 411 14;
BA_ "CANFD_BRS" BO_ 411 1;
BA_ "GenMsgCycleTime" BO_ 411 20;
BA_ "GenMsgCycleTimeFast" BO_ 411 0;
BA_ "GenMsgSendType" BO_ 411 0;
BA_ "VFrameFormat" BO_ 411 14;
BA_ "CANFD_BRS" BO_ 411 1;
BA_ "GenMsgCycleTime" BO_ 411 20;
BA_ "GenMsgCycleTimeFast" BO_ 411 0;
BA_ "GenMsgSendType" BO_ 411 0;
BA_ "VFrameFormat" BO_ 411 14;
BA_ "CANFD_BRS" BO_ 411 1;
BA_ "GenMsgCycleTime" BO_ 411 20;
BA_ "GenMsgCycleTimeFast" BO_ 411 0;
BA_ "GenMsgSendType" BO_ 411 0;
BA_ "VFrameFormat" BO_ 411 14;
BA_ "CANFD_BRS" BO_ 411 1;
BA_ "GenMsgCycleTime" BO_ 411 20;
BA_ "GenMsgCycleTimeFast" BO_ 411 0;
BA_ "GenMsgSendType" BO_ 411 0;
BA_ "VFrameFormat" BO_ 411 14;
BA_ "CANFD_BRS" BO_ 411 1;
BA_ "GenMsgCycleTime" BO_ 411 20;
BA_ "GenMsgCycleTimeFast" BO_ 411 0;
BA_ "GenMsgSendType" BO_ 411 0;
BA_ "VFrameFormat" BO_ 411 14;
BA_ "CANFD_BRS" BO_ 411 1;
BA_ "GenMsgCycleTime" BO_ 411 20;
BA_ "GenMsgCycleTimeFast" BO_ 411 0;
BA_ "GenMsgSendType" BO_ 411 0;
BA_ "VFrameFormat" BO_ 411 14;
BA_ "CANFD_BRS" BO_ 411 1;
BA_ "GenMsgCycleTime" BO_ 411 20;
BA_ "GenMsgCycleTimeFast" BO_ 411 0;
BA_ "GenMsgSendType" BO_ 411 0;
BA_ "VFrameFormat" BO_ 411 14;
BA_ "CANFD_BRS" BO_ 411 1;
BA_ "GenMsgCycleTime" BO_ 411 20;
BA_ "GenMsgCycleTimeFast" BO_ 411 0;
BA_ "GenMsgSendType" BO_ 411 0;
BA_ "VFrameFormat" BO_ 411 14;
BA_ "CANFD_BRS" BO_ 411 1;
BA_ "GenMsgCycleTime" BO_ 411 20;
BA_ "GenMsgCycleTimeFast" BO_ 411 0;
BA_ "GenMsgSendType" BO_ 411 0;
BA_ "VFrameFormat" BO_ 411 14;
BA_ "CANFD_BRS" BO_ 411 1;
BA_ "GenMsgCycleTime" BO_ 411 20;
BA_ "GenMsgCycleTimeFast" BO_ 411 0;
BA_ "GenMsgSendType" BO_ 411 0;
BA_ "VFrameFormat" BO_ 411 14;
BA_ "CANFD_BRS" BO_ 411 1;
BA_ "GenMsgCycleTime" BO_ 411 20;
BA_ "GenMsgCycleTimeFast" BO_ 411 0;
BA_ "GenMsgSendType" BO_ 411 0;
BA_ "VFrameFormat" BO_ 411 14;
BA_ "CANFD_BRS" BO_ 411 1;
BA_ "GenMsgCycleTime" BO_ 411 20;
BA_ "GenMsgCycleTimeFast" BO_ 411 0;
BA_ "GenMsgSendType" BO_ 411 0;
BA_ "VFrameFormat" BO_ 411 14;
BA_ "CANFD_BRS" BO_ 411 1;
BA_ "GenMsgCycleTime" BO_ 411 20;
BA_ "GenMsgCycleTimeFast" BO_ 411 0;
BA_ "GenMsgSendType" BO_ 411 0;
BA_ "VFrameFormat" BO_ 411 14;
BA_ "CANFD_BRS" BO_ 411 1;
BA_ "GenMsgCycleTime" BO_ 411 20;
BA_ "GenMsgCycleTimeFast" BO_ 411 0;
BA_ "GenMsgSendType" BO_ 411 0;
BA_ "VFrameFormat" BO_ 411 14;
BA_ "CANFD_BRS" BO_ 411 1;
BA_ "GenMsgCycleTime" BO_ 411 20;
BA_ "GenMsgCycleTimeFast" BO_ 411 0;
BA_ "GenMsgSendType" BO_ 411 0;
BA_ "VFrameFormat" BO_ 411 14;
BA_ "CANFD_BRS" BO_ 411 1;
BA_ "GenMsgCycleTime" BO_ 411 20;
BA_ "GenMsgCycleTimeFast" BO_ 411 0;
BA_ "GenMsgSendType" BO_ 411 0;
BA_ "VFrameFormat" BO_ 411 14;
BA_ "CANFD_BRS" BO_ 411 1;
BA_ "GenMsgCycleTime" BO_ 411 20;
BA_ "GenMsgCycleTimeFast" BO_ 411 0;
BA_ "GenMsgSendType" BO_ 411 0;
BA_ "VFrameFormat" BO_ 411 14;
BA_ "CANFD_BRS" BO_ 411 1;
BA_ "GenMsgCycleTime" BO_ 411 20;
BA_ "GenMsgCycleTimeFast" BO_ 411 0;
BA_ "GenMsgSendType" BO_ 411 0;
BA_ "VFrameFormat" BO_ 411 14;
BA_ "CANFD_BRS" BO_ 411 1;
BA_ "GenMsgCycleTime" BO_ 411 20;
BA_ "GenMsgCycleTimeFast" BO_ 411 0;
BA_ "GenMsgSendType" BO_ 411 0;
BA_ "VFrameFormat" BO_ 411 14;
BA_ "CANFD_BRS" BO_ 411 1;
BA_ "GenMsgCycleTime" BO_ 411 20;
BA_ "GenMsgCycleTimeFast" BO_ 411 0;
BA_ "GenMsgSendType" BO_ 411 0;
BA_ "VFrameFormat" BO_ 411 14;
BA_ "CANFD_BRS" BO_ 411 1;
BA_ "GenMsgCycleTime" BO_ 411 20;
BA_ "GenMsgCycleTimeFast" BO_ 411 0;
BA_ "GenMsgSendType" BO_ 411 0;
BA_ "VFrameFormat" BO_ 411 14;
BA_ "CANFD_BRS" BO_ 411 1;
BA_ "GenMsgCycleTime" BO_ 411 20;
BA_ "GenMsgCycleTimeFast" BO_ 411 0;
BA_ "GenMsgSendType" BO_ 411 0;
BA_ "VFrameFormat" BO_ 411 14;
BA_ "CANFD_BRS" BO_ 411 1;
BA_ "GenMsgCycleTime" BO_ 411 20;
BA_ "GenMsgCycleTimeFast" BO_ 411 0;
BA_ "GenMsgSendType" BO_ 411 0;
BA_ "VFrameFormat" BO_ 411 14;
BA_ "CANFD_BRS" BO_ 411 1;
BA_ "GenMsgCycleTime" BO_ 411 20;
BA_ "GenMsgCycleTimeFast" BO_ 411 0;
BA_ "GenMsgSendType" BO_ 411 0;
BA_ "VFrameFormat" BO_ 411 14;
BA_ "CANFD_BRS" BO_ 411 1;
BA_ "GenMsgCycleTime" BO_ 411 20;
BA_ "GenMsgCycleTimeFast" BO_ 411 0;
BA_ "GenMsgSendType" BO_ 411 0;
BA_ "VFrameFormat" BO_ 411 14;
BA_ "CANFD_BRS" BO_ 411 1;
BA_ "GenMsgCycleTime" BO_ 411 20;
BA_ "GenMsgCycleTimeFast" BO_ 411 0;
BA_ "GenMsgSendType" BO_ 411 0;
BA_ "VFrameFormat" BO_ 411 14;
BA_ "CANFD_BRS" BO_ 411 1;
BA_ "GenMsgCycleTime" BO_ 411 20;
BA_ "GenMsgCycleTimeFast" BO_ 411 0;
BA_ "GenMsgSendType" BO_ 411 0;
BA_ "VFrameFormat" BO_ 411 14;
BA_ "CANFD_BRS" BO_ 411 1;

BA_ "EventCommandSignal" SG_ 2015 Fun_Diag_Request 0;
BA_ "GatewayedSignals" SG_ 2015 Fun_Diag_Request 0;
BA_ "GenSigInactiveValue" SG_ 2015 Fun_Diag_Request 0;
BA_ "GenSigInvalidValue" SG_ 2015 Fun_Diag_Request 0;
BA_ "GenSigSendType" SG_ 2015 Fun_Diag_Request 1;
BA_ "GenSigStartValue" SG_ 2015 Fun_Diag_Request 0;
BA_ "GenSigTimeoutValue" SG_ 2015 Fun_Diag_Request 0;
BA_ "Remark" SG_ 2015 Fun_Diag_Request "";
BA_ "EventCommandSignal" SG_ 352 BCS_2_CRC 0;
BA_ "GatewayedSignals" SG_ 352 BCS_2_CRC 0;
BA_ "GenSigInactiveValue" SG_ 352 BCS_2_CRC 0;
BA_ "GenSigInvalidValue" SG_ 352 BCS_2_CRC 0;
BA_ "GenSigSendType" SG_ 352 BCS_2_CRC 1;
BA_ "GenSigStartValue" SG_ 352 BCS_2_CRC 0;
BA_ "GenSigTimeoutValue" SG_ 352 BCS_2_CRC 0;
BA_ "Remark" SG_ 352 BCS_2_CRC "涉及ID管理表";
BA_ "EventCommandSignal" SG_ 352 BCS_2_Counter 0;
BA_ "GatewayedSignals" SG_ 352 BCS_2_Counter 0;
BA_ "GenSigInactiveValue" SG_ 352 BCS_2_Counter 0;
BA_ "GenSigInvalidValue" SG_ 352 BCS_2_Counter 0;
BA_ "GenSigSendType" SG_ 352 BCS_2_Counter 1;
BA_ "GenSigStartValue" SG_ 352 BCS_2_Counter 0;
BA_ "GenSigTimeoutValue" SG_ 352 BCS_2_Counter 0;
BA_ "Remark" SG_ 352 BCS_2_Counter "涉及ID管理表";
BA_ "EventCommandSignal" SG_ 352 BCS_VehSpd 0;
BA_ "GatewayedSignals" SG_ 352 BCS_VehSpd 0;
BA_ "GenSigInactiveValue" SG_ 352 BCS_VehSpd 0;
BA_ "GenSigInvalidValue" SG_ 352 BCS_VehSpd 0;
BA_ "GenSigSendType" SG_ 352 BCS_VehSpd 1;
BA_ "GenSigStartValue" SG_ 352 BCS_VehSpd 0;
BA_ "GenSigTimeoutValue" SG_ 352 BCS_VehSpd 0;
BA_ "Remark" SG_ 352 BCS_VehSpd "涉及ID管理表";
BA_ "EventCommandSignal" SG_ 352 BCS_VehSpdVD 0;
BA_ "GatewayedSignals" SG_ 352 BCS_VehSpdVD 0;
BA_ "GenSigInactiveValue" SG_ 352 BCS_VehSpdVD 0;
BA_ "GenSigInvalidValue" SG_ 352 BCS_VehSpdVD 0;
BA_ "GenSigSendType" SG_ 352 BCS_VehSpdVD 1;
BA_ "GenSigStartValue" SG_ 352 BCS_VehSpdVD 0;
BA_ "GenSigTimeoutValue" SG_ 352 BCS_VehSpdVD 0;
BA_ "Remark" SG_ 352 BCS_VehSpdVD "涉及ID管理表";
BA_ "EventCommandSignal" SG_ 352 BCS_EBDActiveSt 0;
BA_ "GatewayedSignals" SG_ 352 BCS_EBDActiveSt 0;
BA_ "GenSigInactiveValue" SG_ 352 BCS_EBDActiveSt 0;
BA_ "GenSigInvalidValue" SG_ 352 BCS_EBDActiveSt 0;
BA_ "GenSigSendType" SG_ 352 BCS_EBDActiveSt 1;
BA_ "GenSigStartValue" SG_ 352 BCS_EBDActiveSt 0;
BA_ "GenSigTimeoutValue" SG_ 352 BCS_EBDActiveSt 0;
BA_ "Remark" SG_ 352 BCS_EBDActiveSt "涉及ID管理表";
BA_ "EventCommandSignal" SG_ 352 BCS_EBDFaultSt 0;
BA_ "GatewayedSignals" SG_ 352 BCS_EBDFaultSt 0;
BA_ "GenSigInactiveValue" SG_ 352 BCS_EBDFaultSt 0;
BA_ "GenSigInvalidValue" SG_ 352 BCS_EBDFaultSt 0;
BA_ "GenSigSendType" SG_ 352 BCS_EBDFaultSt 1;
BA_ "GenSigStartValue" SG_ 352 BCS_EBDFaultSt 1;
BA_ "GenSigTimeoutValue" SG_ 352 BCS_EBDFaultSt 1;
BA_ "Remark" SG_ 352 BCS_EBDFaultSt "涉及ID管理表";
BA_ "EventCommandSignal" SG_ 352 BCS_ABSActiveSt 0;
BA_ "GatewayedSignals" SG_ 352 BCS_ABSActiveSt 0;
BA_ "GenSigInactiveValue" SG_ 352 BCS_ABSActiveSt 0;
BA_ "GenSigInvalidValue" SG_ 352 BCS_ABSActiveSt 0;
BA_ "GenSigSendType" SG_ 352 BCS_ABSActiveSt 1;
BA_ "GenSigStartValue" SG_ 352 BCS_ABSActiveSt 0;
BA_ "GenSigTimeoutValue" SG_ 352 BCS_ABSActiveSt 0;
BA_ "Remark" SG_ 352 BCS_ABSActiveSt "涉及ID管理表";
BA_ "EventCommandSignal" SG_ 352 BCS_ABSFaultSt 0;
BA_ "GatewayedSignals" SG_ 352 BCS_ABSFaultSt 0;
BA_ "GenSigInactiveValue" SG_ 352 BCS_ABSFaultSt 0;
BA_ "GenSigInvalidValue" SG_ 352 BCS_ABSFaultSt 0;
BA_ "GenSigSendType" SG_ 352 BCS_ABSFaultSt 1;
BA_ "GenSigStartValue" SG_ 352 BCS_ABSFaultSt 1;
BA_ "GenSigTimeoutValue" SG_ 352 BCS_ABSFaultSt 1;
BA_ "Remark" SG_ 352 BCS_ABSFaultSt "涉及ID管理表";
BA_ "EventCommandSignal" SG_ 352 BCS_TCSActiveSt 0;
BA_ "GatewayedSignals" SG_ 352 BCS_TCSActiveSt 0;
BA_ "GenSigInactiveValue" SG_ 352 BCS_TCSActiveSt 0;
BA_ "GenSigInvalidValue" SG_ 352 BCS_TCSActiveSt 0;
BA_ "GenSigSendType" SG_ 352 BCS_TCSActiveSt 1;
BA_ "GenSigStartValue" SG_ 352 BCS_TCSActiveSt 0;
BA_ "GenSigTimeoutValue" SG_ 352 BCS_TCSActiveSt 0;
BA_ "Remark" SG_ 352 BCS_TCSActiveSt "涉及ID管理表";
BA_ "EventCommandSignal" SG_ 352 BCS_TCSFaultSt 0;
BA_ "GatewayedSignals" SG_ 352 BCS_TCSFaultSt 0;
BA_ "GenSigInactiveValue" SG_ 352 BCS_TCSFaultSt 0;
BA_ "GenSigInvalidValue" SG_ 352 BCS_TCSFaultSt 0;
BA_ "GenSigSendType" SG_ 352 BCS_TCSFaultSt 1;
BA_ "GenSigStartValue" SG_ 352 BCS_TCSFaultSt 1;
BA_ "GenSigTimeoutValue" SG_ 352 BCS_TCSFaultSt 1;
BA_ "Remark" SG_ 352 BCS_TCSFaultSt "涉及ID管理表";
BA_ "EventCommandSignal" SG_ 352 BCS_VDCActiveSt 0;
BA_ "GatewayedSignals" SG_ 352 BCS_VDCActiveSt 0;
BA_ "GenSigInactiveValue" SG_ 352 BCS_VDCActiveSt 0;
BA_ "GenSigInvalidValue" SG_ 352 BCS_VDCActiveSt 0;
BA_ "GenSigSendType" SG_ 352 BCS_VDCActiveSt 1;
BA_ "GenSigStartValue" SG_ 352 BCS_VDCActiveSt 0;
BA_ "GenSigTimeoutValue" SG_ 352 BCS_VDCActiveSt 0;
BA_ "Remark" SG_ 352 BCS_VDCActiveSt "涉及ID管理表";
BA_ "EventCommandSignal" SG_ 352 BCS_VDCFaultSt 0;
BA_ "GatewayedSignals" SG_ 352 BCS_VDCFaultSt 0;
BA_ "GenSigInactiveValue" SG_ 352 BCS_VDCFaultSt 0;
BA_ "GenSigInvalidValue" SG_ 352 BCS_VDCFaultSt 0;
BA_ "GenSigSendType" SG_ 352 BCS_VDCFaultSt 1;
BA_ "GenSigStartValue" SG_ 352 BCS_VDCFaultSt 1;
BA_ "GenSigTimeoutValue" SG_ 352 BCS_VDCFaultSt 1;
BA_ "Remark" SG_ 352 BCS_VDCFaultSt "涉及ID管理表";
BA_ "EventCommandSignal" SG_ 352 BCS_PreAndRealVDCActiveSt 0;
BA_ "GatewayedSignals" SG_ 352 BCS_PreAndRealVDCActiveSt 0;
BA_ "GenSigInactiveValue" SG_ 352 BCS_PreAndRealVDCActiveSt 0;
BA_ "GenSigInvalidValue" SG_ 352 BCS_PreAndRealVDCActiveSt 0;
BA_ "GenSigSendType" SG_ 352 BCS_PreAndRealVDCActiveSt 1;
BA_ "GenSigStartValue" SG_ 352 BCS_PreAndRealVDCActiveSt 0;
BA_ "GenSigTimeoutValue" SG_ 352 BCS_PreAndRealVDCActiveSt 0;
BA_ "Remark" SG_ 352 BCS_PreAndRealVDCActiveSt "涉及ID管理表";
BA_ "EventCommandSignal" SG_ 352 BCS_DTCAvailable 0;
BA_ "GatewayedSignals" SG_ 352 BCS_DTCAvailable 0;
BA_ "GenSigInactiveValue" SG_ 352 BCS_DTCAvailable 0;
BA_ "GenSigInvalidValue" SG_ 352 BCS_DTCAvailable 0;
BA_ "GenSigSendType" SG_ 352 BCS_DTCAvailable 1;
BA_ "GenSigStartValue" SG_ 352 BCS_DTCAvailable 0;
BA_ "GenSigTimeoutValue" SG_ 352 BCS_DTCAvailable 0;
BA_ "Remark" SG_ 352 BCS_DTCAvailable "涉及ID管理表";
BA_ "EventCommandSignal" SG_ 352 BCS_DTCActiveSt 0;
BA_ "GatewayedSignals" SG_ 352 BCS_DTCActiveSt 0;
BA_ "GenSigInactiveValue" SG_ 352 BCS_DTCActiveSt 0;
BA_ "GenSigInvalidValue" SG_ 352 BCS_DTCActiveSt 0;
BA_ "GenSigSendType" SG_ 352 BCS_DTCActiveSt 1;
BA_ "GenSigStartValue" SG_ 352 BCS_DTCActiveSt 0;
BA_ "GenSigTimeoutValue" SG_ 352 BCS_DTCActiveSt 0;
BA_ "Remark" SG_ 352 BCS_DTCActiveSt "涉及ID管理表";
BA_ "EventCommandSignal" SG_ 352 BCS_RealTCSActiveSt 0;
BA_ "GatewayedSignals" SG_ 352 BCS_RealTCSActiveSt 0;
BA_ "GenSigInactiveValue" SG_ 352 BCS_RealTCSActiveSt 0;
BA_ "GenSigInvalidValue" SG_ 352 BCS_RealTCSActiveSt 0;
BA_ "GenSigSendType" SG_ 352 BCS_RealTCSActiveSt 1;
BA_ "GenSigStartValue" SG_ 352 BCS_RealTCSActiveSt 0;
BA_ "GenSigTimeoutValue" SG_ 352 BCS_RealTCSActiveSt 0;
BA_ "Remark" SG_ 352 BCS_RealTCSActiveSt "涉及ID管理表";
BA_ "EventCommandSignal" SG_ 352 BCS_CrbsActive 0;
BA_ "GatewayedSignals" SG_ 352 BCS_CrbsActive 0;
BA_ "GenSigInactiveValue" SG_ 352 BCS_CrbsActive 0;
BA_ "GenSigInvalidValue" SG_ 352 BCS_CrbsActive 0;
BA_ "GenSigSendType" SG_ 352 BCS_CrbsActive 1;
BA_ "GenSigStartValue" SG_ 352 BCS_CrbsActive 0;
BA_ "GenSigTimeoutValue" SG_ 352 BCS_CrbsActive 0;
BA_ "Remark" SG_ 352 BCS_CrbsActive "涉及ID管理表";
BA_ "EventCommandSignal" SG_ 352 BCS_BrkPedalStVD 0;
BA_ "GatewayedSignals" SG_ 352 BCS_BrkPedalStVD 0;
BA_ "GenSigInactiveValue" SG_ 352 BCS_BrkPedalStVD 0;
BA_ "GenSigInvalidValue" SG_ 352 BCS_BrkPedalStVD 0;
BA_ "GenSigSendType" SG_ 352 BCS_BrkPedalStVD 1;
BA_ "GenSigStartValue" SG_ 352 BCS_BrkPedalStVD 0;
BA_ "GenSigTimeoutValue" SG_ 352 BCS_BrkPedalStVD 0;
BA_ "Remark" SG_ 352 BCS_BrkPedalStVD "涉及ID管理表";
BA_ "EventCommandSignal" SG_ 352 BCS_BrkPedalSt 0;
BA_ "GatewayedSignals" SG_ 352 BCS_BrkPedalSt 0;
BA_ "GenSigInactiveValue" SG_ 352 BCS_BrkPedalSt 0;
BA_ "GenSigInvalidValue" SG_ 352 BCS_BrkPedalSt 0;
BA_ "GenSigSendType" SG_ 352 BCS_BrkPedalSt 1;
BA_ "GenSigStartValue" SG_ 352 BCS_BrkPedalSt 0;
BA_ "GenSigTimeoutValue" SG_ 352 BCS_BrkPedalSt 0;
BA_ "Remark" SG_ 352 BCS_BrkPedalSt "涉及ID管理表";
BA_ "EventCommandSignal" SG_ 352 BCS_EngTorqDecFastRA 0;
BA_ "GatewayedSignals" SG_ 352 BCS_EngTorqDecFastRA 0;
BA_ "GenSigInactiveValue" SG_ 352 BCS_EngTorqDecFastRA 0;
BA_ "GenSigInvalidValue" SG_ 352 BCS_EngTorqDecFastRA 0;
BA_ "GenSigSendType" SG_ 352 BCS_EngTorqDecFastRA 1;
BA_ "GenSigStartValue" SG_ 352 BCS_EngTorqDecFastRA 60000;
BA_ "GenSigTimeoutValue" SG_ 352 BCS_EngTorqDecFastRA 0;
BA_ "Remark" SG_ 352 BCS_EngTorqDecFastRA "涉及ID管理表";
BA_ "EventCommandSignal" SG_ 352 BCS_EngTorqIncRA 0;
BA_ "GatewayedSignals" SG_ 352 BCS_EngTorqIncRA 0;
BA_ "GenSigInactiveValue" SG_ 352 BCS_EngTorqIncRA 0;
BA_ "GenSigInvalidValue" SG_ 352 BCS_EngTorqIncRA 0;
BA_ "GenSigSendType" SG_ 352 BCS_EngTorqIncRA 1;
BA_ "GenSigStartValue" SG_ 352 BCS_EngTorqIncRA 0;
BA_ "GenSigTimeoutValue" SG_ 352 BCS_EngTorqIncRA 0;
BA_ "Remark" SG_ 352 BCS_EngTorqIncRA "涉及ID管理表";
BA_ "EventCommandSignal" SG_ 352 BCS_TargetRecpTorqRqFA 0;
BA_ "GatewayedSignals" SG_ 352 BCS_TargetRecpTorqRqFA 0;
BA_ "GenSigInactiveValue" SG_ 352 BCS_TargetRecpTorqRqFA 0;
BA_ "GenSigInvalidValue" SG_ 352 BCS_TargetRecpTorqRqFA 0;
BA_ "GenSigSendType" SG_ 352 BCS_TargetRecpTorqRqFA 1;
BA_ "GenSigStartValue" SG_ 352 BCS_TargetRecpTorqRqFA 6000;
BA_ "GenSigTimeoutValue" SG_ 352 BCS_TargetRecpTorqRqFA 0;
BA_ "Remark" SG_ 352 BCS_TargetRecpTorqRqFA "涉及ID管理表";
BA_ "EventCommandSignal" SG_ 352 BCS_TargetRecpTorqRqFASt 0;
BA_ "GatewayedSignals" SG_ 352 BCS_TargetRecpTorqRqFASt 0;
BA_ "GenSigInactiveValue" SG_ 352 BCS_TargetRecpTorqRqFASt 0;
BA_ "GenSigInvalidValue" SG_ 352 BCS_TargetRecpTorqRqFASt 0;
BA_ "GenSigSendType" SG_ 352 BCS_TargetRecpTorqRqFASt 1;
BA_ "GenSigStartValue" SG_ 352 BCS_TargetRecpTorqRqFASt 0;
BA_ "GenSigTimeoutValue" SG_ 352 BCS_TargetRecpTorqRqFASt 0;
BA_ "Remark" SG_ 352 BCS_TargetRecpTorqRqFASt "涉及ID管理表";
BA_ "EventCommandSignal" SG_ 352 BCS_TargetRecpTorqRqRA 0;
BA_ "GatewayedSignals" SG_ 352 BCS_TargetRecpTorqRqRA 0;
BA_ "GenSigInactiveValue" SG_ 352 BCS_TargetRecpTorqRqRA 0;
BA_ "GenSigInvalidValue" SG_ 352 BCS_TargetRecpTorqRqRA 0;
BA_ "GenSigSendType" SG_ 352 BCS_TargetRecpTorqRqRA 1;
BA_ "GenSigStartValue" SG_ 352 BCS_TargetRecpTorqRqRA 6000;
BA_ "GenSigTimeoutValue" SG_ 352 BCS_TargetRecpTorqRqRA 0;
BA_ "Remark" SG_ 352 BCS_TargetRecpTorqRqRA "涉及ID管理表";
BA_ "EventCommandSignal" SG_ 352 BCS_TargetRecpTorqRqRASt 0;
BA_ "GatewayedSignals" SG_ 352 BCS_TargetRecpTorqRqRASt 0;
BA_ "GenSigInactiveValue" SG_ 352 BCS_TargetRecpTorqRqRASt 0;
BA_ "GenSigInvalidValue" SG_ 352 BCS_TargetRecpTorqRqRASt 0;
BA_ "GenSigSendType" SG_ 352 BCS_TargetRecpTorqRqRASt 1;
BA_ "GenSigStartValue" SG_ 352 BCS_TargetRecpTorqRqRASt 0;
BA_ "GenSigTimeoutValue" SG_ 352 BCS_TargetRecpTorqRqRASt 0;
BA_ "Remark" SG_ 352 BCS_TargetRecpTorqRqRASt "涉及ID管理表";
BA_ "EventCommandSignal" SG_ 352 BCS_EngTorqDecActiveStRA 0;
BA_ "GatewayedSignals" SG_ 352 BCS_EngTorqDecActiveStRA 0;
BA_ "GenSigInactiveValue" SG_ 352 BCS_EngTorqDecActiveStRA 0;
BA_ "GenSigInvalidValue" SG_ 352 BCS_EngTorqDecActiveStRA 0;
BA_ "GenSigSendType" SG_ 352 BCS_EngTorqDecActiveStRA 1;
BA_ "GenSigStartValue" SG_ 352 BCS_EngTorqDecActiveStRA 0;
BA_ "GenSigTimeoutValue" SG_ 352 BCS_EngTorqDecActiveStRA 0;
BA_ "Remark" SG_ 352 BCS_EngTorqDecActiveStRA "涉及ID管理表";
BA_ "EventCommandSignal" SG_ 352 BCS_EngTorqDecActiveStFA 0;
BA_ "GatewayedSignals" SG_ 352 BCS_EngTorqDecActiveStFA 0;
BA_ "GenSigInactiveValue" SG_ 352 BCS_EngTorqDecActiveStFA 0;
BA_ "GenSigInvalidValue" SG_ 352 BCS_EngTorqDecActiveStFA 0;
BA_ "GenSigSendType" SG_ 352 BCS_EngTorqDecActiveStFA 1;
BA_ "GenSigStartValue" SG_ 352 BCS_EngTorqDecActiveStFA 0;
BA_ "GenSigTimeoutValue" SG_ 352 BCS_EngTorqDecActiveStFA 0;
BA_ "Remark" SG_ 352 BCS_EngTorqDecActiveStFA "涉及ID管理表";
BA_ "EventCommandSignal" SG_ 352 BCS_EngTorqIncActiveStFA 0;
BA_ "GatewayedSignals" SG_ 352 BCS_EngTorqIncActiveStFA 0;
BA_ "GenSigInactiveValue" SG_ 352 BCS_EngTorqIncActiveStFA 0;
BA_ "GenSigInvalidValue" SG_ 352 BCS_EngTorqIncActiveStFA 0;
BA_ "GenSigSendType" SG_ 352 BCS_EngTorqIncActiveStFA 1;
BA_ "GenSigStartValue" SG_ 352 BCS_EngTorqIncActiveStFA 0;
BA_ "GenSigTimeoutValue" SG_ 352 BCS_EngTorqIncActiveStFA 0;
BA_ "Remark" SG_ 352 BCS_EngTorqIncActiveStFA "涉及ID管理表";
BA_ "EventCommandSignal" SG_ 352 BCS_ADCNetErrorFb 0;
BA_ "GatewayedSignals" SG_ 352 BCS_ADCNetErrorFb 0;
BA_ "GenSigInactiveValue" SG_ 352 BCS_ADCNetErrorFb 0;
BA_ "GenSigInvalidValue" SG_ 352 BCS_ADCNetErrorFb 0;
BA_ "GenSigSendType" SG_ 352 BCS_ADCNetErrorFb 1;
BA_ "GenSigStartValue" SG_ 352 BCS_ADCNetErrorFb 0;
BA_ "GenSigTimeoutValue" SG_ 352 BCS_ADCNetErrorFb 0;
BA_ "Remark" SG_ 352 BCS_ADCNetErrorFb "涉及ID管理表";
BA_ "EventCommandSignal" SG_ 352 BCS_NetModeResp 0;
BA_ "GatewayedSignals" SG_ 352 BCS_NetModeResp 0;
BA_ "GenSigInactiveValue" SG_ 352 BCS_NetModeResp 0;
BA_ "GenSigInvalidValue" SG_ 352 BCS_NetModeResp 0;
BA_ "GenSigSendType" SG_ 352 BCS_NetModeResp 1;
BA_ "GenSigStartValue" SG_ 352 BCS_NetModeResp 0;
BA_ "GenSigTimeoutValue" SG_ 352 BCS_NetModeResp 0;
BA_ "Remark" SG_ 352 BCS_NetModeResp "涉及ID管理表";
BA_ "EventCommandSignal" SG_ 352 BCS_EngTorqDecFastFA 0;
BA_ "GatewayedSignals" SG_ 352 BCS_EngTorqDecFastFA 0;
BA_ "GenSigInactiveValue" SG_ 352 BCS_EngTorqDecFastFA 0;
BA_ "GenSigInvalidValue" SG_ 352 BCS_EngTorqDecFastFA 0;
BA_ "GenSigSendType" SG_ 352 BCS_EngTorqDecFastFA 1;
BA_ "GenSigStartValue" SG_ 352 BCS_EngTorqDecFastFA 60000;
BA_ "GenSigTimeoutValue" SG_ 352 BCS_EngTorqDecFastFA 0;
BA_ "Remark" SG_ 352 BCS_EngTorqDecFastFA "涉及ID管理表";
BA_ "EventCommandSignal" SG_ 352 BCS_EngTorqIncFA 0;
BA_ "GatewayedSignals" SG_ 352 BCS_EngTorqIncFA 0;
BA_ "GenSigInactiveValue" SG_ 352 BCS_EngTorqIncFA 0;
BA_ "GenSigInvalidValue" SG_ 352 BCS_EngTorqIncFA 0;
BA_ "GenSigSendType" SG_ 352 BCS_EngTorqIncFA 1;
BA_ "GenSigStartValue" SG_ 352 BCS_EngTorqIncFA 0;
BA_ "GenSigTimeoutValue" SG_ 352 BCS_EngTorqIncFA 0;
BA_ "Remark" SG_ 352 BCS_EngTorqIncFA "涉及ID管理表";
BA_ "EventCommandSignal" SG_ 1238 FR_DTCCode 1;
BA_ "GatewayedSignals" SG_ 1238 FR_DTCCode 0;
BA_ "GenSigInactiveValue" SG_ 1238 FR_DTCCode 0;
BA_ "GenSigInvalidValue" SG_ 1238 FR_DTCCode 0;
BA_ "GenSigSendType" SG_ 1238 FR_DTCCode 0;
BA_ "GenSigStartValue" SG_ 1238 FR_DTCCode 0;
BA_ "GenSigTimeoutValue" SG_ 1238 FR_DTCCode 0;
BA_ "Remark" SG_ 1238 FR_DTCCode "";
BA_ "EventCommandSignal" SG_ 403 ADC_1_CRC 0;
BA_ "GatewayedSignals" SG_ 403 ADC_1_CRC 0;
BA_ "GenSigInactiveValue" SG_ 403 ADC_1_CRC 0;
BA_ "GenSigInvalidValue" SG_ 403 ADC_1_CRC 0;
BA_ "GenSigSendType" SG_ 403 ADC_1_CRC 1;
BA_ "GenSigStartValue" SG_ 403 ADC_1_CRC 0;
BA_ "GenSigTimeoutValue" SG_ 403 ADC_1_CRC 0;
BA_ "Remark" SG_ 403 ADC_1_CRC "";
BA_ "EventCommandSignal" SG_ 403 ADC_1_Counter 0;
BA_ "GatewayedSignals" SG_ 403 ADC_1_Counter 0;
BA_ "GenSigInactiveValue" SG_ 403 ADC_1_Counter 0;
BA_ "GenSigInvalidValue" SG_ 403 ADC_1_Counter 0;
BA_ "GenSigSendType" SG_ 403 ADC_1_Counter 1;
BA_ "GenSigStartValue" SG_ 403 ADC_1_Counter 0;
BA_ "GenSigTimeoutValue" SG_ 403 ADC_1_Counter 0;
BA_ "Remark" SG_ 403 ADC_1_Counter "";
BA_ "EventCommandSignal" SG_ 403 ADC_ACCMode 0;
BA_ "GatewayedSignals" SG_ 403 ADC_ACCMode 0;
BA_ "GenSigInactiveValue" SG_ 403 ADC_ACCMode 0;
BA_ "GenSigInvalidValue" SG_ 403 ADC_ACCMode 0;
BA_ "GenSigSendType" SG_ 403 ADC_ACCMode 1;
BA_ "GenSigStartValue" SG_ 403 ADC_ACCMode 1;
BA_ "GenSigTimeoutValue" SG_ 403 ADC_ACCMode 0;
BA_ "Remark" SG_ 403 ADC_ACCMode "";
BA_ "EventCommandSignal" SG_ 403 ADC_ACCFailureReason 0;
BA_ "GatewayedSignals" SG_ 403 ADC_ACCFailureReason 0;
BA_ "GenSigInactiveValue" SG_ 403 ADC_ACCFailureReason 0;
BA_ "GenSigInvalidValue" SG_ 403 ADC_ACCFailureReason 0;
BA_ "GenSigSendType" SG_ 403 ADC_ACCFailureReason 1;
BA_ "GenSigStartValue" SG_ 403 ADC_ACCFailureReason 0;
BA_ "GenSigTimeoutValue" SG_ 403 ADC_ACCFailureReason 0;
BA_ "Remark" SG_ 403 ADC_ACCFailureReason "";
BA_ "EventCommandSignal" SG_ 403 ADC_ACCPassiveReason 0;
BA_ "GatewayedSignals" SG_ 403 ADC_ACCPassiveReason 0;
BA_ "GenSigInactiveValue" SG_ 403 ADC_ACCPassiveReason 0;
BA_ "GenSigInvalidValue" SG_ 403 ADC_ACCPassiveReason 0;
BA_ "GenSigSendType" SG_ 403 ADC_ACCPassiveReason 1;
BA_ "GenSigStartValue" SG_ 403 ADC_ACCPassiveReason 0;
BA_ "GenSigTimeoutValue" SG_ 403 ADC_ACCPassiveReason 0;
BA_ "Remark" SG_ 403 ADC_ACCPassiveReason "";
BA_ "EventCommandSignal" SG_ 403 ADC_TJP_St 0;
BA_ "GatewayedSignals" SG_ 403 ADC_TJP_St 0;
BA_ "GenSigInactiveValue" SG_ 403 ADC_TJP_St 0;
BA_ "GenSigInvalidValue" SG_ 403 ADC_TJP_St 0;
BA_ "GenSigSendType" SG_ 403 ADC_TJP_St 1;
BA_ "GenSigStartValue" SG_ 403 ADC_TJP_St 0;
BA_ "GenSigTimeoutValue" SG_ 403 ADC_TJP_St 0;
BA_ "Remark" SG_ 403 ADC_TJP_St "";
BA_ "EventCommandSignal" SG_ 403 ADC_TJPIconColor 0;
BA_ "GatewayedSignals" SG_ 403 ADC_TJPIconColor 0;
BA_ "GenSigInactiveValue" SG_ 403 ADC_TJPIconColor 0;
BA_ "GenSigInvalidValue" SG_ 403 ADC_TJPIconColor 0;
BA_ "GenSigSendType" SG_ 403 ADC_TJPIconColor 0;
BA_ "GenSigStartValue" SG_ 403 ADC_TJPIconColor 0;
BA_ "GenSigTimeoutValue" SG_ 403 ADC_TJPIconColor 4;
BA_ "Remark" SG_ 403 ADC_TJPIconColor "";
BA_ "EventCommandSignal" SG_ 403 ADC_TimeGapSet 0;
BA_ "GatewayedSignals" SG_ 403 ADC_TimeGapSet 0;
BA_ "GenSigInactiveValue" SG_ 403 ADC_TimeGapSet 0;
BA_ "GenSigInvalidValue" SG_ 403 ADC_TimeGapSet 0;
BA_ "GenSigSendType" SG_ 403 ADC_TimeGapSet 1;
BA_ "GenSigStartValue" SG_ 403 ADC_TimeGapSet 0;
BA_ "GenSigTimeoutValue" SG_ 403 ADC_TimeGapSet 0;
BA_ "Remark" SG_ 403 ADC_TimeGapSet "";
BA_ "EventCommandSignal" SG_ 403 ADC_ICA_St 0;
BA_ "GatewayedSignals" SG_ 403 ADC_ICA_St 0;
BA_ "GenSigInactiveValue" SG_ 403 ADC_ICA_St 0;
BA_ "GenSigInvalidValue" SG_ 403 ADC_ICA_St 0;
BA_ "GenSigSendType" SG_ 403 ADC_ICA_St 1;
BA_ "GenSigStartValue" SG_ 403 ADC_ICA_St 0;
BA_ "GenSigTimeoutValue" SG_ 403 ADC_ICA_St 0;
BA_ "Remark" SG_ 403 ADC_ICA_St "";
BA_ "EventCommandSignal" SG_ 403 ADC_Cruise_SpeedLimitType 0;
BA_ "GatewayedSignals" SG_ 403 ADC_Cruise_SpeedLimitType 0;
BA_ "GenSigInactiveValue" SG_ 403 ADC_Cruise_SpeedLimitType 0;
BA_ "GenSigInvalidValue" SG_ 403 ADC_Cruise_SpeedLimitType 0;
BA_ "GenSigSendType" SG_ 403 ADC_Cruise_SpeedLimitType 1;
BA_ "GenSigStartValue" SG_ 403 ADC_Cruise_SpeedLimitType 0;
BA_ "GenSigTimeoutValue" SG_ 403 ADC_Cruise_SpeedLimitType 0;
BA_ "Remark" SG_ 403 ADC_Cruise_SpeedLimitType "";
BA_ "EventCommandSignal" SG_ 403 ADC_LaneChangeSt 0;
BA_ "GatewayedSignals" SG_ 403 ADC_LaneChangeSt 0;
BA_ "GenSigInactiveValue" SG_ 403 ADC_LaneChangeSt 0;
BA_ "GenSigInvalidValue" SG_ 403 ADC_LaneChangeSt 0;
BA_ "GenSigSendType" SG_ 403 ADC_LaneChangeSt 1;
BA_ "GenSigStartValue" SG_ 403 ADC_LaneChangeSt 0;
BA_ "GenSigTimeoutValue" SG_ 403 ADC_LaneChangeSt 0;
BA_ "Remark" SG_ 403 ADC_LaneChangeSt "";
BA_ "EventCommandSignal" SG_ 403 ADC_LaneChange_AbortReason 0;
BA_ "GatewayedSignals" SG_ 403 ADC_LaneChange_AbortReason 0;
BA_ "GenSigInactiveValue" SG_ 403 ADC_LaneChange_AbortReason 0;
BA_ "GenSigInvalidValue" SG_ 403 ADC_LaneChange_AbortReason 0;
BA_ "GenSigSendType" SG_ 403 ADC_LaneChange_AbortReason 1;
BA_ "GenSigStartValue" SG_ 403 ADC_LaneChange_AbortReason 0;
BA_ "GenSigTimeoutValue" SG_ 403 ADC_LaneChange_AbortReason 0;
BA_ "Remark" SG_ 403 ADC_LaneChange_AbortReason "";
BA_ "EventCommandSignal" SG_ 403 ADC_LaneChange_Actdirection 0;
BA_ "GatewayedSignals" SG_ 403 ADC_LaneChange_Actdirection 0;
BA_ "GenSigInactiveValue" SG_ 403 ADC_LaneChange_Actdirection 0;
BA_ "GenSigInvalidValue" SG_ 403 ADC_LaneChange_Actdirection 0;
BA_ "GenSigSendType" SG_ 403 ADC_LaneChange_Actdirection 1;
BA_ "GenSigStartValue" SG_ 403 ADC_LaneChange_Actdirection 0;
BA_ "GenSigTimeoutValue" SG_ 403 ADC_LaneChange_Actdirection 0;
BA_ "Remark" SG_ 403 ADC_LaneChange_Actdirection "";
BA_ "EventCommandSignal" SG_ 403 ADC_ICA_MRMReason 0;
BA_ "GatewayedSignals" SG_ 403 ADC_ICA_MRMReason 0;
BA_ "GenSigInactiveValue" SG_ 403 ADC_ICA_MRMReason 0;
BA_ "GenSigInvalidValue" SG_ 403 ADC_ICA_MRMReason 0;
BA_ "GenSigSendType" SG_ 403 ADC_ICA_MRMReason 1;
BA_ "GenSigStartValue" SG_ 403 ADC_ICA_MRMReason 0;
BA_ "GenSigTimeoutValue" SG_ 403 ADC_ICA_MRMReason 0;
BA_ "Remark" SG_ 403 ADC_ICA_MRMReason "";
BA_ "EventCommandSignal" SG_ 403 ADC_ICA_Mileage 0;
BA_ "GatewayedSignals" SG_ 403 ADC_ICA_Mileage 0;
BA_ "GenSigInactiveValue" SG_ 403 ADC_ICA_Mileage 0;
BA_ "GenSigInvalidValue" SG_ 403 ADC_ICA_Mileage 2047;
BA_ "GenSigSendType" SG_ 403 ADC_ICA_Mileage 1;
BA_ "GenSigStartValue" SG_ 403 ADC_ICA_Mileage 0;
BA_ "GenSigTimeoutValue" SG_ 403 ADC_ICA_Mileage 0;
BA_ "Remark" SG_ 403 ADC_ICA_Mileage "";
BA_ "EventCommandSignal" SG_ 403 ADC_ICA_PassiveReason 0;
BA_ "GatewayedSignals" SG_ 403 ADC_ICA_PassiveReason 0;
BA_ "GenSigInactiveValue" SG_ 403 ADC_ICA_PassiveReason 0;
BA_ "GenSigInvalidValue" SG_ 403 ADC_ICA_PassiveReason 0;
BA_ "GenSigSendType" SG_ 403 ADC_ICA_PassiveReason 1;
BA_ "GenSigStartValue" SG_ 403 ADC_ICA_PassiveReason 0;
BA_ "GenSigTimeoutValue" SG_ 403 ADC_ICA_PassiveReason 0;
BA_ "Remark" SG_ 403 ADC_ICA_PassiveReason "";
BA_ "EventCommandSignal" SG_ 403 ADC_ICA_faultReason 0;
BA_ "GatewayedSignals" SG_ 403 ADC_ICA_faultReason 0;
BA_ "GenSigInactiveValue" SG_ 403 ADC_ICA_faultReason 0;
BA_ "GenSigInvalidValue" SG_ 403 ADC_ICA_faultReason 0;
BA_ "GenSigSendType" SG_ 403 ADC_ICA_faultReason 1;
BA_ "GenSigStartValue" SG_ 403 ADC_ICA_faultReason 0;
BA_ "GenSigTimeoutValue" SG_ 403 ADC_ICA_faultReason 0;
BA_ "Remark" SG_ 403 ADC_ICA_faultReason "";
BA_ "EventCommandSignal" SG_ 403 ADC_HFIconColor 0;
BA_ "GatewayedSignals" SG_ 403 ADC_HFIconColor 0;
BA_ "GenSigInactiveValue" SG_ 403 ADC_HFIconColor 0;
BA_ "GenSigInvalidValue" SG_ 403 ADC_HFIconColor 0;
BA_ "GenSigSendType" SG_ 403 ADC_HFIconColor 0;
BA_ "GenSigStartValue" SG_ 403 ADC_HFIconColor 0;
BA_ "GenSigTimeoutValue" SG_ 403 ADC_HFIconColor 4;
BA_ "Remark" SG_ 403 ADC_HFIconColor "";
BA_ "EventCommandSignal" SG_ 403 ADC_MRMNumber 0;
BA_ "GatewayedSignals" SG_ 403 ADC_MRMNumber 0;
BA_ "GenSigInactiveValue" SG_ 403 ADC_MRMNumber 0;
BA_ "GenSigInvalidValue" SG_ 403 ADC_MRMNumber 0;
BA_ "GenSigSendType" SG_ 403 ADC_MRMNumber 1;
BA_ "GenSigStartValue" SG_ 403 ADC_MRMNumber 0;
BA_ "GenSigTimeoutValue" SG_ 403 ADC_MRMNumber 0;
BA_ "Remark" SG_ 403 ADC_MRMNumber "";
BA_ "EventCommandSignal" SG_ 403 ADC_MRCNumber 0;
BA_ "GatewayedSignals" SG_ 403 ADC_MRCNumber 0;
BA_ "GenSigInactiveValue" SG_ 403 ADC_MRCNumber 0;
BA_ "GenSigInvalidValue" SG_ 403 ADC_MRCNumber 0;
BA_ "GenSigSendType" SG_ 403 ADC_MRCNumber 1;
BA_ "GenSigStartValue" SG_ 403 ADC_MRCNumber 0;
BA_ "GenSigTimeoutValue" SG_ 403 ADC_MRCNumber 0;
BA_ "Remark" SG_ 403 ADC_MRCNumber "";
BA_ "EventCommandSignal" SG_ 403 ADC_HandsOnSt 0;
BA_ "GatewayedSignals" SG_ 403 ADC_HandsOnSt 0;
BA_ "GenSigInactiveValue" SG_ 403 ADC_HandsOnSt 0;
BA_ "GenSigInvalidValue" SG_ 403 ADC_HandsOnSt 0;
BA_ "GenSigSendType" SG_ 403 ADC_HandsOnSt 1;
BA_ "GenSigStartValue" SG_ 403 ADC_HandsOnSt 0;
BA_ "GenSigTimeoutValue" SG_ 403 ADC_HandsOnSt 0;
BA_ "Remark" SG_ 403 ADC_HandsOnSt "";
BA_ "EventCommandSignal" SG_ 403 ADC_ICMADASFailureText 0;
BA_ "GatewayedSignals" SG_ 403 ADC_ICMADASFailureText 0;
BA_ "GenSigInactiveValue" SG_ 403 ADC_ICMADASFailureText 0;
BA_ "GenSigInvalidValue" SG_ 403 ADC_ICMADASFailureText 15;
BA_ "GenSigSendType" SG_ 403 ADC_ICMADASFailureText 0;
BA_ "GenSigStartValue" SG_ 403 ADC_ICMADASFailureText 0;
BA_ "GenSigTimeoutValue" SG_ 403 ADC_ICMADASFailureText 15;
BA_ "Remark" SG_ 403 ADC_ICMADASFailureText "";
BA_ "EventCommandSignal" SG_ 403 ADC_ICMADASWarnText 0;
BA_ "GatewayedSignals" SG_ 403 ADC_ICMADASWarnText 0;
BA_ "GenSigInactiveValue" SG_ 403 ADC_ICMADASWarnText 0;
BA_ "GenSigInvalidValue" SG_ 403 ADC_ICMADASWarnText 0;
BA_ "GenSigSendType" SG_ 403 ADC_ICMADASWarnText 0;
BA_ "GenSigStartValue" SG_ 403 ADC_ICMADASWarnText 0;
BA_ "GenSigTimeoutValue" SG_ 403 ADC_ICMADASWarnText 0;
BA_ "Remark" SG_ 403 ADC_ICMADASWarnText "";
BA_ "EventCommandSignal" SG_ 403 ADC_SpeedLimitIconSt 0;
BA_ "GatewayedSignals" SG_ 403 ADC_SpeedLimitIconSt 0;
BA_ "GenSigInactiveValue" SG_ 403 ADC_SpeedLimitIconSt 0;
BA_ "GenSigInvalidValue" SG_ 403 ADC_SpeedLimitIconSt 0;
BA_ "GenSigSendType" SG_ 403 ADC_SpeedLimitIconSt 0;
BA_ "GenSigStartValue" SG_ 403 ADC_SpeedLimitIconSt 0;
BA_ "GenSigTimeoutValue" SG_ 403 ADC_SpeedLimitIconSt 0;
BA_ "Remark" SG_ 403 ADC_SpeedLimitIconSt "";
BA_ "EventCommandSignal" SG_ 403 ADC_ICMWarnCardSt 0;
BA_ "GatewayedSignals" SG_ 403 ADC_ICMWarnCardSt 0;
BA_ "GenSigInactiveValue" SG_ 403 ADC_ICMWarnCardSt 0;
BA_ "GenSigInvalidValue" SG_ 403 ADC_ICMWarnCardSt 0;
BA_ "GenSigSendType" SG_ 403 ADC_ICMWarnCardSt 0;
BA_ "GenSigStartValue" SG_ 403 ADC_ICMWarnCardSt 0;
BA_ "GenSigTimeoutValue" SG_ 403 ADC_ICMWarnCardSt 0;
BA_ "Remark" SG_ 403 ADC_ICMWarnCardSt "";
BA_ "EventCommandSignal" SG_ 403 ADC_ICAIconColor 0;
BA_ "GatewayedSignals" SG_ 403 ADC_ICAIconColor 0;
BA_ "GenSigInactiveValue" SG_ 403 ADC_ICAIconColor 0;
BA_ "GenSigInvalidValue" SG_ 403 ADC_ICAIconColor 0;
BA_ "GenSigSendType" SG_ 403 ADC_ICAIconColor 0;
BA_ "GenSigStartValue" SG_ 403 ADC_ICAIconColor 0;
BA_ "GenSigTimeoutValue" SG_ 403 ADC_ICAIconColor 0;
BA_ "Remark" SG_ 403 ADC_ICAIconColor "";
BA_ "EventCommandSignal" SG_ 403 ADC_ICMPromptWarn 0;
BA_ "GatewayedSignals" SG_ 403 ADC_ICMPromptWarn 0;
BA_ "GenSigInactiveValue" SG_ 403 ADC_ICMPromptWarn 0;
BA_ "GenSigInvalidValue" SG_ 403 ADC_ICMPromptWarn 0;
BA_ "GenSigSendType" SG_ 403 ADC_ICMPromptWarn 0;
BA_ "GenSigStartValue" SG_ 403 ADC_ICMPromptWarn 0;
BA_ "GenSigTimeoutValue" SG_ 403 ADC_ICMPromptWarn 0;
BA_ "Remark" SG_ 403 ADC_ICMPromptWarn "";
BA_ "EventCommandSignal" SG_ 403 ADC_ACUVoiceWarn 0;
BA_ "GatewayedSignals" SG_ 403 ADC_ACUVoiceWarn 0;
BA_ "GenSigInactiveValue" SG_ 403 ADC_ACUVoiceWarn 0;
BA_ "GenSigInvalidValue" SG_ 403 ADC_ACUVoiceWarn 0;
BA_ "GenSigSendType" SG_ 403 ADC_ACUVoiceWarn 0;
BA_ "GenSigStartValue" SG_ 403 ADC_ACUVoiceWarn 0;
BA_ "GenSigTimeoutValue" SG_ 403 ADC_ACUVoiceWarn 0;
BA_ "Remark" SG_ 403 ADC_ACUVoiceWarn "";
BA_ "EventCommandSignal" SG_ 403 ADC_NDAStateIcon 0;
BA_ "GatewayedSignals" SG_ 403 ADC_NDAStateIcon 0;
BA_ "GenSigInactiveValue" SG_ 403 ADC_NDAStateIcon 0;
BA_ "GenSigInvalidValue" SG_ 403 ADC_NDAStateIcon 0;
BA_ "GenSigSendType" SG_ 403 ADC_NDAStateIcon 0;
BA_ "GenSigStartValue" SG_ 403 ADC_NDAStateIcon 0;
BA_ "GenSigTimeoutValue" SG_ 403 ADC_NDAStateIcon 0;
BA_ "Remark" SG_ 403 ADC_NDAStateIcon "";
BA_ "EventCommandSignal" SG_ 403 ADC_SpeedLimitIcon 0;
BA_ "GatewayedSignals" SG_ 403 ADC_SpeedLimitIcon 0;
BA_ "GenSigInactiveValue" SG_ 403 ADC_SpeedLimitIcon 0;
BA_ "GenSigInvalidValue" SG_ 403 ADC_SpeedLimitIcon 0;
BA_ "GenSigSendType" SG_ 403 ADC_SpeedLimitIcon 0;
BA_ "GenSigStartValue" SG_ 403 ADC_SpeedLimitIcon 255;
BA_ "GenSigTimeoutValue" SG_ 403 ADC_SpeedLimitIcon 255;
BA_ "Remark" SG_ 403 ADC_SpeedLimitIcon "";
BA_ "EventCommandSignal" SG_ 403 ADC_ICANDAIconAngle 0;
BA_ "GatewayedSignals" SG_ 403 ADC_ICANDAIconAngle 0;
BA_ "GenSigInactiveValue" SG_ 403 ADC_ICANDAIconAngle 0;
BA_ "GenSigInvalidValue" SG_ 403 ADC_ICANDAIconAngle 0;
BA_ "GenSigSendType" SG_ 403 ADC_ICANDAIconAngle 0;
BA_ "GenSigStartValue" SG_ 403 ADC_ICANDAIconAngle 0;
BA_ "GenSigTimeoutValue" SG_ 403 ADC_ICANDAIconAngle 0;
BA_ "Remark" SG_ 403 ADC_ICANDAIconAngle "";
BA_ "EventCommandSignal" SG_ 403 ADC_ACCTargetSpeedCard 0;
BA_ "GatewayedSignals" SG_ 403 ADC_ACCTargetSpeedCard 0;
BA_ "GenSigInactiveValue" SG_ 403 ADC_ACCTargetSpeedCard 0;
BA_ "GenSigInvalidValue" SG_ 403 ADC_ACCTargetSpeedCard 0;
BA_ "GenSigSendType" SG_ 403 ADC_ACCTargetSpeedCard 0;
BA_ "GenSigStartValue" SG_ 403 ADC_ACCTargetSpeedCard 255;
BA_ "GenSigTimeoutValue" SG_ 403 ADC_ACCTargetSpeedCard 255;
BA_ "Remark" SG_ 403 ADC_ACCTargetSpeedCard "";
BA_ "EventCommandSignal" SG_ 403 ADC_ACCIconColor 0;
BA_ "GatewayedSignals" SG_ 403 ADC_ACCIconColor 0;
BA_ "GenSigInactiveValue" SG_ 403 ADC_ACCIconColor 0;
BA_ "GenSigInvalidValue" SG_ 403 ADC_ACCIconColor 0;
BA_ "GenSigSendType" SG_ 403 ADC_ACCIconColor 0;
BA_ "GenSigStartValue" SG_ 403 ADC_ACCIconColor 0;
BA_ "GenSigTimeoutValue" SG_ 403 ADC_ACCIconColor 0;
BA_ "Remark" SG_ 403 ADC_ACCIconColor "";
BA_ "EventCommandSignal" SG_ 403 ADC_ICMADASFailureLamp 0;
BA_ "GatewayedSignals" SG_ 403 ADC_ICMADASFailureLamp 0;
BA_ "GenSigInactiveValue" SG_ 403 ADC_ICMADASFailureLamp 0;
BA_ "GenSigInvalidValue" SG_ 403 ADC_ICMADASFailureLamp 0;
BA_ "GenSigSendType" SG_ 403 ADC_ICMADASFailureLamp 1;
BA_ "GenSigStartValue" SG_ 403 ADC_ICMADASFailureLamp 0;
BA_ "GenSigTimeoutValue" SG_ 403 ADC_ICMADASFailureLamp 1;
BA_ "Remark" SG_ 403 ADC_ICMADASFailureLamp "";
BA_ "EventCommandSignal" SG_ 403 ADC_Pilot_VoiceWarn 0;
BA_ "GatewayedSignals" SG_ 403 ADC_Pilot_VoiceWarn 0;
BA_ "GenSigInactiveValue" SG_ 403 ADC_Pilot_VoiceWarn 0;
BA_ "GenSigInvalidValue" SG_ 403 ADC_Pilot_VoiceWarn 0;
BA_ "GenSigSendType" SG_ 403 ADC_Pilot_VoiceWarn 0;
BA_ "GenSigStartValue" SG_ 403 ADC_Pilot_VoiceWarn 0;
BA_ "GenSigTimeoutValue" SG_ 403 ADC_Pilot_VoiceWarn 0;
BA_ "Remark" SG_ 403 ADC_Pilot_VoiceWarn "";
BA_ "EventCommandSignal" SG_ 403 ADC_Pilot_PromptWarn 0;
BA_ "GatewayedSignals" SG_ 403 ADC_Pilot_PromptWarn 0;
BA_ "GenSigInactiveValue" SG_ 403 ADC_Pilot_PromptWarn 0;
BA_ "GenSigInvalidValue" SG_ 403 ADC_Pilot_PromptWarn 0;
BA_ "GenSigSendType" SG_ 403 ADC_Pilot_PromptWarn 0;
BA_ "GenSigStartValue" SG_ 403 ADC_Pilot_PromptWarn 0;
BA_ "GenSigTimeoutValue" SG_ 403 ADC_Pilot_PromptWarn 0;
BA_ "Remark" SG_ 403 ADC_Pilot_PromptWarn "";
BA_ "EventCommandSignal" SG_ 403 ADC_Pilot_WarnText 0;
BA_ "GatewayedSignals" SG_ 403 ADC_Pilot_WarnText 0;
BA_ "GenSigInactiveValue" SG_ 403 ADC_Pilot_WarnText 0;
BA_ "GenSigInvalidValue" SG_ 403 ADC_Pilot_WarnText 0;
BA_ "GenSigSendType" SG_ 403 ADC_Pilot_WarnText 0;
BA_ "GenSigStartValue" SG_ 403 ADC_Pilot_WarnText 0;
BA_ "GenSigTimeoutValue" SG_ 403 ADC_Pilot_WarnText 0;
BA_ "Remark" SG_ 403 ADC_Pilot_WarnText "";
BA_ "EventCommandSignal" SG_ 403 ADC_Pilot_WarnCardSt 0;
BA_ "GatewayedSignals" SG_ 403 ADC_Pilot_WarnCardSt 0;
BA_ "GenSigInactiveValue" SG_ 403 ADC_Pilot_WarnCardSt 0;
BA_ "GenSigInvalidValue" SG_ 403 ADC_Pilot_WarnCardSt 0;
BA_ "GenSigSendType" SG_ 403 ADC_Pilot_WarnCardSt 0;
BA_ "GenSigStartValue" SG_ 403 ADC_Pilot_WarnCardSt 0;
BA_ "GenSigTimeoutValue" SG_ 403 ADC_Pilot_WarnCardSt 0;
BA_ "Remark" SG_ 403 ADC_Pilot_WarnCardSt "";
BA_ "EventCommandSignal" SG_ 403 NDA_Type 0;
BA_ "GatewayedSignals" SG_ 403 NDA_Type 0;
BA_ "GenSigInactiveValue" SG_ 403 NDA_Type 0;
BA_ "GenSigInvalidValue" SG_ 403 NDA_Type 0;
BA_ "GenSigSendType" SG_ 403 NDA_Type 1;
BA_ "GenSigStartValue" SG_ 403 NDA_Type 0;
BA_ "GenSigTimeoutValue" SG_ 403 NDA_Type 0;
BA_ "Remark" SG_ 403 NDA_Type "";
BA_ "EventCommandSignal" SG_ 403 ADAS_System_Failure_St 0;
BA_ "GatewayedSignals" SG_ 403 ADAS_System_Failure_St 0;
BA_ "GenSigInactiveValue" SG_ 403 ADAS_System_Failure_St 0;
BA_ "GenSigInvalidValue" SG_ 403 ADAS_System_Failure_St 0;
BA_ "GenSigSendType" SG_ 403 ADAS_System_Failure_St 1;
BA_ "GenSigStartValue" SG_ 403 ADAS_System_Failure_St 0;
BA_ "GenSigTimeoutValue" SG_ 403 ADAS_System_Failure_St 0;
BA_ "Remark" SG_ 403 ADAS_System_Failure_St "";
BA_ "EventCommandSignal" SG_ 403 ADAS_Related_System_Failure_St 0;
BA_ "GatewayedSignals" SG_ 403 ADAS_Related_System_Failure_St 0;
BA_ "GenSigInactiveValue" SG_ 403 ADAS_Related_System_Failure_St 0;
BA_ "GenSigInvalidValue" SG_ 403 ADAS_Related_System_Failure_St 0;
BA_ "GenSigSendType" SG_ 403 ADAS_Related_System_Failure_St 1;
BA_ "GenSigStartValue" SG_ 403 ADAS_Related_System_Failure_St 0;
BA_ "GenSigTimeoutValue" SG_ 403 ADAS_Related_System_Failure_St 0;
BA_ "Remark" SG_ 403 ADAS_Related_System_Failure_St "";
BA_ "EventCommandSignal" SG_ 403 ADC_AdsFault 0;
BA_ "GatewayedSignals" SG_ 403 ADC_AdsFault 0;
BA_ "GenSigInactiveValue" SG_ 403 ADC_AdsFault 0;
BA_ "GenSigInvalidValue" SG_ 403 ADC_AdsFault 0;
BA_ "GenSigSendType" SG_ 403 ADC_AdsFault 1;
BA_ "GenSigStartValue" SG_ 403 ADC_AdsFault 0;
BA_ "GenSigTimeoutValue" SG_ 403 ADC_AdsFault 0;
BA_ "Remark" SG_ 403 ADC_AdsFault "";
BA_ "EventCommandSignal" SG_ 403 ADC_NicaReminderLEDVisual 0;
BA_ "GatewayedSignals" SG_ 403 ADC_NicaReminderLEDVisual 0;
BA_ "GenSigInactiveValue" SG_ 403 ADC_NicaReminderLEDVisual 0;
BA_ "GenSigInvalidValue" SG_ 403 ADC_NicaReminderLEDVisual 0;
BA_ "GenSigSendType" SG_ 403 ADC_NicaReminderLEDVisual 1;
BA_ "GenSigStartValue" SG_ 403 ADC_NicaReminderLEDVisual 0;
BA_ "GenSigTimeoutValue" SG_ 403 ADC_NicaReminderLEDVisual 0;
BA_ "Remark" SG_ 403 ADC_NicaReminderLEDVisual "";
BA_ "EventCommandSignal" SG_ 403 ADC_NicaReminderAcoustic 0;
BA_ "GatewayedSignals" SG_ 403 ADC_NicaReminderAcoustic 0;
BA_ "GenSigInactiveValue" SG_ 403 ADC_NicaReminderAcoustic 0;
BA_ "GenSigInvalidValue" SG_ 403 ADC_NicaReminderAcoustic 0;
BA_ "GenSigSendType" SG_ 403 ADC_NicaReminderAcoustic 1;
BA_ "GenSigStartValue" SG_ 403 ADC_NicaReminderAcoustic 0;
BA_ "GenSigTimeoutValue" SG_ 403 ADC_NicaReminderAcoustic 0;
BA_ "Remark" SG_ 403 ADC_NicaReminderAcoustic "";
BA_ "EventCommandSignal" SG_ 403 ADC_AdsTakeoverID 0;
BA_ "GatewayedSignals" SG_ 403 ADC_AdsTakeoverID 0;
BA_ "GenSigInactiveValue" SG_ 403 ADC_AdsTakeoverID 0;
BA_ "GenSigInvalidValue" SG_ 403 ADC_AdsTakeoverID 0;
BA_ "GenSigSendType" SG_ 403 ADC_AdsTakeoverID 1;
BA_ "GenSigStartValue" SG_ 403 ADC_AdsTakeoverID 0;
BA_ "GenSigTimeoutValue" SG_ 403 ADC_AdsTakeoverID 0;
BA_ "Remark" SG_ 403 ADC_AdsTakeoverID "";
BA_ "EventCommandSignal" SG_ 403 ADC_AdsTakeoverLevel 0;
BA_ "GatewayedSignals" SG_ 403 ADC_AdsTakeoverLevel 0;
BA_ "GenSigInactiveValue" SG_ 403 ADC_AdsTakeoverLevel 0;
BA_ "GenSigInvalidValue" SG_ 403 ADC_AdsTakeoverLevel 0;
BA_ "GenSigSendType" SG_ 403 ADC_AdsTakeoverLevel 1;
BA_ "GenSigStartValue" SG_ 403 ADC_AdsTakeoverLevel 0;
BA_ "GenSigTimeoutValue" SG_ 403 ADC_AdsTakeoverLevel 0;
BA_ "Remark" SG_ 403 ADC_AdsTakeoverLevel "";
BA_ "EventCommandSignal" SG_ 403 ADC_TORIDCorrespErrorID 0;
BA_ "GatewayedSignals" SG_ 403 ADC_TORIDCorrespErrorID 0;
BA_ "GenSigInactiveValue" SG_ 403 ADC_TORIDCorrespErrorID 0;
BA_ "GenSigInvalidValue" SG_ 403 ADC_TORIDCorrespErrorID 0;
BA_ "GenSigSendType" SG_ 403 ADC_TORIDCorrespErrorID 1;
BA_ "GenSigStartValue" SG_ 403 ADC_TORIDCorrespErrorID 0;
BA_ "GenSigTimeoutValue" SG_ 403 ADC_TORIDCorrespErrorID 0;
BA_ "Remark" SG_ 403 ADC_TORIDCorrespErrorID "";
BA_ "EventCommandSignal" SG_ 403 ADC_TakeoverExtended16bit 0;
BA_ "GatewayedSignals" SG_ 403 ADC_TakeoverExtended16bit 0;
BA_ "GenSigInactiveValue" SG_ 403 ADC_TakeoverExtended16bit 0;
BA_ "GenSigInvalidValue" SG_ 403 ADC_TakeoverExtended16bit 0;
BA_ "GenSigSendType" SG_ 403 ADC_TakeoverExtended16bit 1;
BA_ "GenSigStartValue" SG_ 403 ADC_TakeoverExtended16bit 0;
BA_ "GenSigTimeoutValue" SG_ 403 ADC_TakeoverExtended16bit 0;
BA_ "Remark" SG_ 403 ADC_TakeoverExtended16bit "";
BA_ "EventCommandSignal" SG_ 403 ADC_TakeoverExtended8bit 0;
BA_ "GatewayedSignals" SG_ 403 ADC_TakeoverExtended8bit 0;
BA_ "GenSigInactiveValue" SG_ 403 ADC_TakeoverExtended8bit 0;
BA_ "GenSigInvalidValue" SG_ 403 ADC_TakeoverExtended8bit 0;
BA_ "GenSigSendType" SG_ 403 ADC_TakeoverExtended8bit 1;
BA_ "GenSigStartValue" SG_ 403 ADC_TakeoverExtended8bit 0;
BA_ "GenSigTimeoutValue" SG_ 403 ADC_TakeoverExtended8bit 0;
BA_ "Remark" SG_ 403 ADC_TakeoverExtended8bit "";
BA_ "EventCommandSignal" SG_ 403 ADC_AdsFucntionNotActive 0;
BA_ "GatewayedSignals" SG_ 403 ADC_AdsFucntionNotActive 0;
BA_ "GenSigInactiveValue" SG_ 403 ADC_AdsFucntionNotActive 0;
BA_ "GenSigInvalidValue" SG_ 403 ADC_AdsFucntionNotActive 0;
BA_ "GenSigSendType" SG_ 403 ADC_AdsFucntionNotActive 1;
BA_ "GenSigStartValue" SG_ 403 ADC_AdsFucntionNotActive 0;
BA_ "GenSigTimeoutValue" SG_ 403 ADC_AdsFucntionNotActive 0;
BA_ "Remark" SG_ 403 ADC_AdsFucntionNotActive "";
BA_ "EventCommandSignal" SG_ 403 ADC_AvpFunctionStatus 0;
BA_ "GatewayedSignals" SG_ 403 ADC_AvpFunctionStatus 0;
BA_ "GenSigInactiveValue" SG_ 403 ADC_AvpFunctionStatus 0;
BA_ "GenSigInvalidValue" SG_ 403 ADC_AvpFunctionStatus 0;
BA_ "GenSigSendType" SG_ 403 ADC_AvpFunctionStatus 1;
BA_ "GenSigStartValue" SG_ 403 ADC_AvpFunctionStatus 0;
BA_ "GenSigTimeoutValue" SG_ 403 ADC_AvpFunctionStatus 0;
BA_ "Remark" SG_ 403 ADC_AvpFunctionStatus "";
BA_ "EventCommandSignal" SG_ 403 ADC_CalibState 0;
BA_ "GatewayedSignals" SG_ 403 ADC_CalibState 0;
BA_ "GenSigInactiveValue" SG_ 403 ADC_CalibState 0;
BA_ "GenSigInvalidValue" SG_ 403 ADC_CalibState 0;
BA_ "GenSigSendType" SG_ 403 ADC_CalibState 1;
BA_ "GenSigStartValue" SG_ 403 ADC_CalibState 0;
BA_ "GenSigTimeoutValue" SG_ 403 ADC_CalibState 0;
BA_ "Remark" SG_ 403 ADC_CalibState "";
BA_ "EventCommandSignal" SG_ 403 ADC_AccFunctionStatus 0;
BA_ "GatewayedSignals" SG_ 403 ADC_AccFunctionStatus 0;
BA_ "GenSigInactiveValue" SG_ 403 ADC_AccFunctionStatus 0;
BA_ "GenSigInvalidValue" SG_ 403 ADC_AccFunctionStatus 0;
BA_ "GenSigSendType" SG_ 403 ADC_AccFunctionStatus 1;
BA_ "GenSigStartValue" SG_ 403 ADC_AccFunctionStatus 0;
BA_ "GenSigTimeoutValue" SG_ 403 ADC_AccFunctionStatus 0;
BA_ "Remark" SG_ 403 ADC_AccFunctionStatus "";
BA_ "EventCommandSignal" SG_ 403 ADC_NicaFunctionStatus 0;
BA_ "GatewayedSignals" SG_ 403 ADC_NicaFunctionStatus 0;
BA_ "GenSigInactiveValue" SG_ 403 ADC_NicaFunctionStatus 0;
BA_ "GenSigInvalidValue" SG_ 403 ADC_NicaFunctionStatus 0;
BA_ "GenSigSendType" SG_ 403 ADC_NicaFunctionStatus 1;
BA_ "GenSigStartValue" SG_ 403 ADC_NicaFunctionStatus 0;
BA_ "GenSigTimeoutValue" SG_ 403 ADC_NicaFunctionStatus 0;
BA_ "Remark" SG_ 403 ADC_NicaFunctionStatus "";
BA_ "EventCommandSignal" SG_ 403 ADC_AEBWaning 0;
BA_ "GatewayedSignals" SG_ 403 ADC_AEBWaning 0;
BA_ "GenSigInactiveValue" SG_ 403 ADC_AEBWaning 0;
BA_ "GenSigInvalidValue" SG_ 403 ADC_AEBWaning 0;
BA_ "GenSigSendType" SG_ 403 ADC_AEBWaning 1;
BA_ "GenSigStartValue" SG_ 403 ADC_AEBWaning 0;
BA_ "GenSigTimeoutValue" SG_ 403 ADC_AEBWaning 0;
BA_ "Remark" SG_ 403 ADC_AEBWaning "";
BA_ "EventCommandSignal" SG_ 403 ADC_LKAWarning 0;
BA_ "GatewayedSignals" SG_ 403 ADC_LKAWarning 0;
BA_ "GenSigInactiveValue" SG_ 403 ADC_LKAWarning 0;
BA_ "GenSigInvalidValue" SG_ 403 ADC_LKAWarning 0;
BA_ "GenSigSendType" SG_ 403 ADC_LKAWarning 1;
BA_ "GenSigStartValue" SG_ 403 ADC_LKAWarning 0;
BA_ "GenSigTimeoutValue" SG_ 403 ADC_LKAWarning 0;
BA_ "Remark" SG_ 403 ADC_LKAWarning "";
BA_ "EventCommandSignal" SG_ 403 ADC_LCCStateIcon 0;
BA_ "GatewayedSignals" SG_ 403 ADC_LCCStateIcon 0;
BA_ "GenSigInactiveValue" SG_ 403 ADC_LCCStateIcon 0;
BA_ "GenSigInvalidValue" SG_ 403 ADC_LCCStateIcon 0;
BA_ "GenSigSendType" SG_ 403 ADC_LCCStateIcon 1;
BA_ "GenSigStartValue" SG_ 403 ADC_LCCStateIcon 0;
BA_ "GenSigTimeoutValue" SG_ 403 ADC_LCCStateIcon 0;
BA_ "Remark" SG_ 403 ADC_LCCStateIcon "";
BA_ "EventCommandSignal" SG_ 403 Reserved1 0;
BA_ "GatewayedSignals" SG_ 403 Reserved1 0;
BA_ "GenSigInactiveValue" SG_ 403 Reserved1 0;
BA_ "GenSigInvalidValue" SG_ 403 Reserved1 0;
BA_ "GenSigSendType" SG_ 403 Reserved1 1;
BA_ "GenSigStartValue" SG_ 403 Reserved1 0;
BA_ "GenSigTimeoutValue" SG_ 403 Reserved1 0;
BA_ "Remark" SG_ 403 Reserved1 "";
BA_ "EventCommandSignal" SG_ 411 ADC_2_CRC 0;
BA_ "GatewayedSignals" SG_ 411 ADC_2_CRC 0;
BA_ "GenSigInactiveValue" SG_ 411 ADC_2_CRC 0;
BA_ "GenSigInvalidValue" SG_ 411 ADC_2_CRC 0;
BA_ "GenSigSendType" SG_ 411 ADC_2_CRC 1;
BA_ "GenSigStartValue" SG_ 411 ADC_2_CRC 0;
BA_ "GenSigTimeoutValue" SG_ 411 ADC_2_CRC 0;
BA_ "Remark" SG_ 411 ADC_2_CRC "";
BA_ "EventCommandSignal" SG_ 411 ADC_2_Counter 0;
BA_ "GatewayedSignals" SG_ 411 ADC_2_Counter 0;
BA_ "GenSigInactiveValue" SG_ 411 ADC_2_Counter 0;
BA_ "GenSigInvalidValue" SG_ 411 ADC_2_Counter 0;
BA_ "GenSigSendType" SG_ 411 ADC_2_Counter 1;
BA_ "GenSigStartValue" SG_ 411 ADC_2_Counter 0;
BA_ "GenSigTimeoutValue" SG_ 411 ADC_2_Counter 0;
BA_ "Remark" SG_ 411 ADC_2_Counter "";
BA_ "EventCommandSignal" SG_ 411 ADC_FCWAssistType 0;
BA_ "GatewayedSignals" SG_ 411 ADC_FCWAssistType 0;
BA_ "GenSigInactiveValue" SG_ 411 ADC_FCWAssistType 0;
BA_ "GenSigInvalidValue" SG_ 411 ADC_FCWAssistType 2;
BA_ "GenSigSendType" SG_ 411 ADC_FCWAssistType 1;
BA_ "GenSigStartValue" SG_ 411 ADC_FCWAssistType 0;
BA_ "GenSigTimeoutValue" SG_ 411 ADC_FCWAssistType 2;
BA_ "Remark" SG_ 411 ADC_FCWAssistType "";
BA_ "EventCommandSignal" SG_ 411 ADC_FCWFaultSt 0;
BA_ "GatewayedSignals" SG_ 411 ADC_FCWFaultSt 0;
BA_ "GenSigInactiveValue" SG_ 411 ADC_FCWFaultSt 0;
BA_ "GenSigInvalidValue" SG_ 411 ADC_FCWFaultSt 1;
BA_ "GenSigSendType" SG_ 411 ADC_FCWFaultSt 1;
BA_ "GenSigStartValue" SG_ 411 ADC_FCWFaultSt 0;
BA_ "GenSigTimeoutValue" SG_ 411 ADC_FCWFaultSt 1;
BA_ "Remark" SG_ 411 ADC_FCWFaultSt "";
BA_ "EventCommandSignal" SG_ 411 ADC_FCWPreWarn 0;
BA_ "GatewayedSignals" SG_ 411 ADC_FCWPreWarn 0;
BA_ "GenSigInactiveValue" SG_ 411 ADC_FCWPreWarn 0;
BA_ "GenSigInvalidValue" SG_ 411 ADC_FCWPreWarn 0;
BA_ "GenSigSendType" SG_ 411 ADC_FCWPreWarn 1;
BA_ "GenSigStartValue" SG_ 411 ADC_FCWPreWarn 0;
BA_ "GenSigTimeoutValue" SG_ 411 ADC_FCWPreWarn 0;
BA_ "Remark" SG_ 411 ADC_FCWPreWarn "";
BA_ "EventCommandSignal" SG_ 411 ADC_FCWLatentWarn 0;
BA_ "GatewayedSignals" SG_ 411 ADC_FCWLatentWarn 0;
BA_ "GenSigInactiveValue" SG_ 411 ADC_FCWLatentWarn 0;
BA_ "GenSigInvalidValue" SG_ 411 ADC_FCWLatentWarn 0;
BA_ "GenSigSendType" SG_ 411 ADC_FCWLatentWarn 1;
BA_ "GenSigStartValue" SG_ 411 ADC_FCWLatentWarn 0;
BA_ "GenSigTimeoutValue" SG_ 411 ADC_FCWLatentWarn 0;
BA_ "Remark" SG_ 411 ADC_FCWLatentWarn "";
BA_ "EventCommandSignal" SG_ 411 ADC_FCWWarmDistance 0;
BA_ "GatewayedSignals" SG_ 411 ADC_FCWWarmDistance 0;
BA_ "GenSigInactiveValue" SG_ 411 ADC_FCWWarmDistance 0;
BA_ "GenSigInvalidValue" SG_ 411 ADC_FCWWarmDistance 0;
BA_ "GenSigSendType" SG_ 411 ADC_FCWWarmDistance 1;
BA_ "GenSigStartValue" SG_ 411 ADC_FCWWarmDistance 0;
BA_ "GenSigTimeoutValue" SG_ 411 ADC_FCWWarmDistance 1;
BA_ "Remark" SG_ 411 ADC_FCWWarmDistance "";
BA_ "EventCommandSignal" SG_ 411 ADC_AEBTarObjType 0;
BA_ "GatewayedSignals" SG_ 411 ADC_AEBTarObjType 0;
BA_ "GenSigInactiveValue" SG_ 411 ADC_AEBTarObjType 0;
BA_ "GenSigInvalidValue" SG_ 411 ADC_AEBTarObjType 0;
BA_ "GenSigSendType" SG_ 411 ADC_AEBTarObjType 1;
BA_ "GenSigStartValue" SG_ 411 ADC_AEBTarObjType 0;
BA_ "GenSigTimeoutValue" SG_ 411 ADC_AEBTarObjType 0;
BA_ "Remark" SG_ 411 ADC_AEBTarObjType "";
BA_ "EventCommandSignal" SG_ 411 ADC_BSDVibrWarnR 0;
BA_ "GatewayedSignals" SG_ 411 ADC_BSDVibrWarnR 0;
BA_ "GenSigInactiveValue" SG_ 411 ADC_BSDVibrWarnR 0;
BA_ "GenSigInvalidValue" SG_ 411 ADC_BSDVibrWarnR 0;
BA_ "GenSigSendType" SG_ 411 ADC_BSDVibrWarnR 1;
BA_ "GenSigStartValue" SG_ 411 ADC_BSDVibrWarnR 0;
BA_ "GenSigTimeoutValue" SG_ 411 ADC_BSDVibrWarnR 0;
BA_ "Remark" SG_ 411 ADC_BSDVibrWarnR "";
BA_ "EventCommandSignal" SG_ 411 ADC_BSDVibrWarnL 0;
BA_ "GatewayedSignals" SG_ 411 ADC_BSDVibrWarnL 0;
BA_ "GenSigInactiveValue" SG_ 411 ADC_BSDVibrWarnL 0;
BA_ "GenSigInvalidValue" SG_ 411 ADC_BSDVibrWarnL 0;
BA_ "GenSigSendType" SG_ 411 ADC_BSDVibrWarnL 1;
BA_ "GenSigStartValue" SG_ 411 ADC_BSDVibrWarnL 0;
BA_ "GenSigTimeoutValue" SG_ 411 ADC_BSDVibrWarnL 0;
BA_ "Remark" SG_ 411 ADC_BSDVibrWarnL "";
BA_ "EventCommandSignal" SG_ 411 ADC_AEBBrkPedalOverRide 0;
BA_ "GatewayedSignals" SG_ 411 ADC_AEBBrkPedalOverRide 0;
BA_ "GenSigInactiveValue" SG_ 411 ADC_AEBBrkPedalOverRide 0;
BA_ "GenSigInvalidValue" SG_ 411 ADC_AEBBrkPedalOverRide 0;
BA_ "GenSigSendType" SG_ 411 ADC_AEBBrkPedalOverRide 1;
BA_ "GenSigStartValue" SG_ 411 ADC_AEBBrkPedalOverRide 0;
BA_ "GenSigTimeoutValue" SG_ 411 ADC_AEBBrkPedalOverRide 0;
BA_ "Remark" SG_ 411 ADC_AEBBrkPedalOverRide "";
BA_ "EventCommandSignal" SG_ 411 ADC_AEBBrePedalPressure 0;
BA_ "GatewayedSignals" SG_ 411 ADC_AEBBrePedalPressure 0;
BA_ "GenSigInactiveValue" SG_ 411 ADC_AEBBrePedalPressure 0;
BA_ "GenSigInvalidValue" SG_ 411 ADC_AEBBrePedalPressure 0;
BA_ "GenSigSendType" SG_ 411 ADC_AEBBrePedalPressure 1;
BA_ "GenSigStartValue" SG_ 411 ADC_AEBBrePedalPressure 0;
BA_ "GenSigTimeoutValue" SG_ 411 ADC_AEBBrePedalPressure 0;
BA_ "Remark" SG_ 411 ADC_AEBBrePedalPressure "";
BA_ "EventCommandSignal" SG_ 411 ADC_AEBAccelePedalOverRide 0;
BA_ "GatewayedSignals" SG_ 411 ADC_AEBAccelePedalOverRide 0;
BA_ "GenSigInactiveValue" SG_ 411 ADC_AEBAccelePedalOverRide 0;
BA_ "GenSigInvalidValue" SG_ 411 ADC_AEBAccelePedalOverRide 0;
BA_ "GenSigSendType" SG_ 411 ADC_AEBAccelePedalOverRide 1;
BA_ "GenSigStartValue" SG_ 411 ADC_AEBAccelePedalOverRide 0;
BA_ "GenSigTimeoutValue" SG_ 411 ADC_AEBAccelePedalOverRide 0;
BA_ "Remark" SG_ 411 ADC_AEBAccelePedalOverRide "";
BA_ "EventCommandSignal" SG_ 411 ADC_AEBSteeringInhibit 0;
BA_ "GatewayedSignals" SG_ 411 ADC_AEBSteeringInhibit 0;
BA_ "GenSigInactiveValue" SG_ 411 ADC_AEBSteeringInhibit 0;
BA_ "GenSigInvalidValue" SG_ 411 ADC_AEBSteeringInhibit 0;
BA_ "GenSigSendType" SG_ 411 ADC_AEBSteeringInhibit 1;
BA_ "GenSigStartValue" SG_ 411 ADC_AEBSteeringInhibit 0;
BA_ "GenSigTimeoutValue" SG_ 411 ADC_AEBSteeringInhibit 0;
BA_ "Remark" SG_ 411 ADC_AEBSteeringInhibit "";
BA_ "EventCommandSignal" SG_ 411 ADC_PMAEnableSt 0;
BA_ "GatewayedSignals" SG_ 411 ADC_PMAEnableSt 0;
BA_ "GenSigInactiveValue" SG_ 411 ADC_PMAEnableSt 0;
BA_ "GenSigInvalidValue" SG_ 411 ADC_PMAEnableSt 0;
BA_ "GenSigSendType" SG_ 411 ADC_PMAEnableSt 1;
BA_ "GenSigStartValue" SG_ 411 ADC_PMAEnableSt 0;
BA_ "GenSigTimeoutValue" SG_ 411 ADC_PMAEnableSt 0;
BA_ "Remark" SG_ 411 ADC_PMAEnableSt "";
BA_ "EventCommandSignal" SG_ 411 ADC_PMAWarStatus 0;
BA_ "GatewayedSignals" SG_ 411 ADC_PMAWarStatus 0;
BA_ "GenSigInactiveValue" SG_ 411 ADC_PMAWarStatus 0;
BA_ "GenSigInvalidValue" SG_ 411 ADC_PMAWarStatus 0;
BA_ "GenSigSendType" SG_ 411 ADC_PMAWarStatus 1;
BA_ "GenSigStartValue" SG_ 411 ADC_PMAWarStatus 0;
BA_ "GenSigTimeoutValue" SG_ 411 ADC_PMAWarStatus 0;
BA_ "Remark" SG_ 411 ADC_PMAWarStatus "";
BA_ "EventCommandSignal" SG_ 411 ADC_AEBTarLatPos 0;
BA_ "GatewayedSignals" SG_ 411 ADC_AEBTarLatPos 0;
BA_ "GenSigInactiveValue" SG_ 411 ADC_AEBTarLatPos 0;
BA_ "GenSigInvalidValue" SG_ 411 ADC_AEBTarLatPos 0;
BA_ "GenSigSendType" SG_ 411 ADC_AEBTarLatPos 1;
BA_ "GenSigStartValue" SG_ 411 ADC_AEBTarLatPos 0;
BA_ "GenSigTimeoutValue" SG_ 411 ADC_AEBTarLatPos 0;
BA_ "Remark" SG_ 411 ADC_AEBTarLatPos "";
BA_ "EventCommandSignal" SG_ 411 ADC_AEBTarRangeRate 0;
BA_ "GatewayedSignals" SG_ 411 ADC_AEBTarRangeRate 0;
BA_ "GenSigInactiveValue" SG_ 411 ADC_AEBTarRangeRate 0;
BA_ "GenSigInvalidValue" SG_ 411 ADC_AEBTarRangeRate 0;
BA_ "GenSigSendType" SG_ 411 ADC_AEBTarRangeRate 1;
BA_ "GenSigStartValue" SG_ 411 ADC_AEBTarRangeRate 0;
BA_ "GenSigTimeoutValue" SG_ 411 ADC_AEBTarRangeRate 0;
BA_ "Remark" SG_ 411 ADC_AEBTarRangeRate "";
BA_ "EventCommandSignal" SG_ 411 ADC_AEBTarOncomingState 0;
BA_ "GatewayedSignals" SG_ 411 ADC_AEBTarOncomingState 0;
BA_ "GenSigInactiveValue" SG_ 411 ADC_AEBTarOncomingState 0;
BA_ "GenSigInvalidValue" SG_ 411 ADC_AEBTarOncomingState 0;
BA_ "GenSigSendType" SG_ 411 ADC_AEBTarOncomingState 1;
BA_ "GenSigStartValue" SG_ 411 ADC_AEBTarOncomingState 0;
BA_ "GenSigTimeoutValue" SG_ 411 ADC_AEBTarOncomingState 0;
BA_ "Remark" SG_ 411 ADC_AEBTarOncomingState "";
BA_ "EventCommandSignal" SG_ 411 ADC_AEBTarMotionState 0;
BA_ "GatewayedSignals" SG_ 411 ADC_AEBTarMotionState 0;
BA_ "GenSigInactiveValue" SG_ 411 ADC_AEBTarMotionState 0;
BA_ "GenSigInvalidValue" SG_ 411 ADC_AEBTarMotionState 0;
BA_ "GenSigSendType" SG_ 411 ADC_AEBTarMotionState 1;
BA_ "GenSigStartValue" SG_ 411 ADC_AEBTarMotionState 0;
BA_ "GenSigTimeoutValue" SG_ 411 ADC_AEBTarMotionState 0;
BA_ "Remark" SG_ 411 ADC_AEBTarMotionState "";
BA_ "EventCommandSignal" SG_ 411 ADC_AEBTarConfiLevel 0;
BA_ "GatewayedSignals" SG_ 411 ADC_AEBTarConfiLevel 0;
BA_ "GenSigInactiveValue" SG_ 411 ADC_AEBTarConfiLevel 0;
BA_ "GenSigInvalidValue" SG_ 411 ADC_AEBTarConfiLevel 0;
BA_ "GenSigSendType" SG_ 411 ADC_AEBTarConfiLevel 1;
BA_ "GenSigStartValue" SG_ 411 ADC_AEBTarConfiLevel 0;
BA_ "GenSigTimeoutValue" SG_ 411 ADC_AEBTarConfiLevel 0;
BA_ "Remark" SG_ 411 ADC_AEBTarConfiLevel "";
BA_ "EventCommandSignal" SG_ 411 ADC_AEBTarLongPos 0;
BA_ "GatewayedSignals" SG_ 411 ADC_AEBTarLongPos 0;
BA_ "GenSigInactiveValue" SG_ 411 ADC_AEBTarLongPos 0;
BA_ "GenSigInvalidValue" SG_ 411 ADC_AEBTarLongPos 0;
BA_ "GenSigSendType" SG_ 411 ADC_AEBTarLongPos 1;
BA_ "GenSigStartValue" SG_ 411 ADC_AEBTarLongPos 0;
BA_ "GenSigTimeoutValue" SG_ 411 ADC_AEBTarLongPos 0;
BA_ "Remark" SG_ 411 ADC_AEBTarLongPos "";
BA_ "EventCommandSignal" SG_ 411 ADC_AEBTarLatSpd 0;
BA_ "GatewayedSignals" SG_ 411 ADC_AEBTarLatSpd 0;
BA_ "GenSigInactiveValue" SG_ 411 ADC_AEBTarLatSpd 0;
BA_ "GenSigInvalidValue" SG_ 411 ADC_AEBTarLatSpd 0;
BA_ "GenSigSendType" SG_ 411 ADC_AEBTarLatSpd 1;
BA_ "GenSigStartValue" SG_ 411 ADC_AEBTarLatSpd 0;
BA_ "GenSigTimeoutValue" SG_ 411 ADC_AEBTarLatSpd 0;
BA_ "Remark" SG_ 411 ADC_AEBTarLatSpd "";
BA_ "EventCommandSignal" SG_ 411 ADC_AEBTarRangeAccel 0;
BA_ "GatewayedSignals" SG_ 411 ADC_AEBTarRangeAccel 0;
BA_ "GenSigInactiveValue" SG_ 411 ADC_AEBTarRangeAccel 0;
BA_ "GenSigInvalidValue" SG_ 411 ADC_AEBTarRangeAccel 0;
BA_ "GenSigSendType" SG_ 411 ADC_AEBTarRangeAccel 1;
BA_ "GenSigStartValue" SG_ 411 ADC_AEBTarRangeAccel 0;
BA_ "GenSigTimeoutValue" SG_ 411 ADC_AEBTarRangeAccel 0;
BA_ "Remark" SG_ 411 ADC_AEBTarRangeAccel "";
BA_ "EventCommandSignal" SG_ 411 ADC_DOWAudioWarnFR 0;
BA_ "GatewayedSignals" SG_ 411 ADC_DOWAudioWarnFR 0;
BA_ "GenSigInactiveValue" SG_ 411 ADC_DOWAudioWarnFR 0;
BA_ "GenSigInvalidValue" SG_ 411 ADC_DOWAudioWarnFR 0;
BA_ "GenSigSendType" SG_ 411 ADC_DOWAudioWarnFR 1;
BA_ "GenSigStartValue" SG_ 411 ADC_DOWAudioWarnFR 0;
BA_ "GenSigTimeoutValue" SG_ 411 ADC_DOWAudioWarnFR 0;
BA_ "Remark" SG_ 411 ADC_DOWAudioWarnFR "";
BA_ "EventCommandSignal" SG_ 411 ADC_DOWAudioWarnFL 0;
BA_ "GatewayedSignals" SG_ 411 ADC_DOWAudioWarnFL 0;
BA_ "GenSigInactiveValue" SG_ 411 ADC_DOWAudioWarnFL 0;
BA_ "GenSigInvalidValue" SG_ 411 ADC_DOWAudioWarnFL 0;
BA_ "GenSigSendType" SG_ 411 ADC_DOWAudioWarnFL 1;
BA_ "GenSigStartValue" SG_ 411 ADC_DOWAudioWarnFL 0;
BA_ "GenSigTimeoutValue" SG_ 411 ADC_DOWAudioWarnFL 0;
BA_ "Remark" SG_ 411 ADC_DOWAudioWarnFL "";
BA_ "EventCommandSignal" SG_ 411 ADC_DOWAudioWarnRR 0;
BA_ "GatewayedSignals" SG_ 411 ADC_DOWAudioWarnRR 0;
BA_ "GenSigInactiveValue" SG_ 411 ADC_DOWAudioWarnRR 0;
BA_ "GenSigInvalidValue" SG_ 411 ADC_DOWAudioWarnRR 0;
BA_ "GenSigSendType" SG_ 411 ADC_DOWAudioWarnRR 1;
BA_ "GenSigStartValue" SG_ 411 ADC_DOWAudioWarnRR 0;
BA_ "GenSigTimeoutValue" SG_ 411 ADC_DOWAudioWarnRR 0;
BA_ "Remark" SG_ 411 ADC_DOWAudioWarnRR "";
BA_ "EventCommandSignal" SG_ 411 ADC_DOWAudioWarnRL 0;
BA_ "GatewayedSignals" SG_ 411 ADC_DOWAudioWarnRL 0;
BA_ "GenSigInactiveValue" SG_ 411 ADC_DOWAudioWarnRL 0;
BA_ "GenSigInvalidValue" SG_ 411 ADC_DOWAudioWarnRL 0;
BA_ "GenSigSendType" SG_ 411 ADC_DOWAudioWarnRL 1;
BA_ "GenSigStartValue" SG_ 411 ADC_DOWAudioWarnRL 0;
BA_ "GenSigTimeoutValue" SG_ 411 ADC_DOWAudioWarnRL 0;
BA_ "Remark" SG_ 411 ADC_DOWAudioWarnRL "";
BA_ "EventCommandSignal" SG_ 411 ADC_DOWIALWarnFR 0;
BA_ "GatewayedSignals" SG_ 411 ADC_DOWIALWarnFR 0;
BA_ "GenSigInactiveValue" SG_ 411 ADC_DOWIALWarnFR 0;
BA_ "GenSigInvalidValue" SG_ 411 ADC_DOWIALWarnFR 0;
BA_ "GenSigSendType" SG_ 411 ADC_DOWIALWarnFR 1;
BA_ "GenSigStartValue" SG_ 411 ADC_DOWIALWarnFR 0;
BA_ "GenSigTimeoutValue" SG_ 411 ADC_DOWIALWarnFR 0;
BA_ "Remark" SG_ 411 ADC_DOWIALWarnFR "";
BA_ "EventCommandSignal" SG_ 411 ADC_DOWIALWarnFL 0;
BA_ "GatewayedSignals" SG_ 411 ADC_DOWIALWarnFL 0;
BA_ "GenSigInactiveValue" SG_ 411 ADC_DOWIALWarnFL 0;
BA_ "GenSigInvalidValue" SG_ 411 ADC_DOWIALWarnFL 0;
BA_ "GenSigSendType" SG_ 411 ADC_DOWIALWarnFL 1;
BA_ "GenSigStartValue" SG_ 411 ADC_DOWIALWarnFL 0;
BA_ "GenSigTimeoutValue" SG_ 411 ADC_DOWIALWarnFL 0;
BA_ "Remark" SG_ 411 ADC_DOWIALWarnFL "";
BA_ "EventCommandSignal" SG_ 411 ADC_DOWIALWarnRR 0;
BA_ "GatewayedSignals" SG_ 411 ADC_DOWIALWarnRR 0;
BA_ "GenSigInactiveValue" SG_ 411 ADC_DOWIALWarnRR 0;
BA_ "GenSigInvalidValue" SG_ 411 ADC_DOWIALWarnRR 0;
BA_ "GenSigSendType" SG_ 411 ADC_DOWIALWarnRR 1;
BA_ "GenSigStartValue" SG_ 411 ADC_DOWIALWarnRR 0;
BA_ "GenSigTimeoutValue" SG_ 411 ADC_DOWIALWarnRR 0;
BA_ "Remark" SG_ 411 ADC_DOWIALWarnRR "";
BA_ "EventCommandSignal" SG_ 411 ADC_DOWIALWarnRL 0;
BA_ "GatewayedSignals" SG_ 411 ADC_DOWIALWarnRL 0;
BA_ "GenSigInactiveValue" SG_ 411 ADC_DOWIALWarnRL 0;
BA_ "GenSigInvalidValue" SG_ 411 ADC_DOWIALWarnRL 0;
BA_ "GenSigSendType" SG_ 411 ADC_DOWIALWarnRL 1;
BA_ "GenSigStartValue" SG_ 411 ADC_DOWIALWarnRL 0;
BA_ "GenSigTimeoutValue" SG_ 411 ADC_DOWIALWarnRL 0;
BA_ "Remark" SG_ 411 ADC_DOWIALWarnRL "";
BA_ "EventCommandSignal" SG_ 411 ADC_BSDExMirLedWarnR 0;
BA_ "GatewayedSignals" SG_ 411 ADC_BSDExMirLedWarnR 0;
BA_ "GenSigInactiveValue" SG_ 411 ADC_BSDExMirLedWarnR 0;
BA_ "GenSigInvalidValue" SG_ 411 ADC_BSDExMirLedWarnR 0;
BA_ "GenSigSendType" SG_ 411 ADC_BSDExMirLedWarnR 1;
BA_ "GenSigStartValue" SG_ 411 ADC_BSDExMirLedWarnR 0;
BA_ "GenSigTimeoutValue" SG_ 411 ADC_BSDExMirLedWarnR 0;
BA_ "Remark" SG_ 411 ADC_BSDExMirLedWarnR "";
BA_ "EventCommandSignal" SG_ 411 ADC_BSDExMirLedWarnL 0;
BA_ "GatewayedSignals" SG_ 411 ADC_BSDExMirLedWarnL 0;
BA_ "GenSigInactiveValue" SG_ 411 ADC_BSDExMirLedWarnL 0;
BA_ "GenSigInvalidValue" SG_ 411 ADC_BSDExMirLedWarnL 0;
BA_ "GenSigSendType" SG_ 411 ADC_BSDExMirLedWarnL 1;
BA_ "GenSigStartValue" SG_ 411 ADC_BSDExMirLedWarnL 0;
BA_ "GenSigTimeoutValue" SG_ 411 ADC_BSDExMirLedWarnL 0;
BA_ "Remark" SG_ 411 ADC_BSDExMirLedWarnL "";
BA_ "EventCommandSignal" SG_ 411 ADC_BSDLCASt 0;
BA_ "GatewayedSignals" SG_ 411 ADC_BSDLCASt 0;
BA_ "GenSigInactiveValue" SG_ 411 ADC_BSDLCASt 0;
BA_ "GenSigInvalidValue" SG_ 411 ADC_BSDLCASt 0;
BA_ "GenSigSendType" SG_ 411 ADC_BSDLCASt 1;
BA_ "GenSigStartValue" SG_ 411 ADC_BSDLCASt 0;
BA_ "GenSigTimeoutValue" SG_ 411 ADC_BSDLCASt 3;
BA_ "Remark" SG_ 411 ADC_BSDLCASt "";
BA_ "EventCommandSignal" SG_ 411 ADC_BSDLCAEnableSt 0;
BA_ "GatewayedSignals" SG_ 411 ADC_BSDLCAEnableSt 0;
BA_ "GenSigInactiveValue" SG_ 411 ADC_BSDLCAEnableSt 0;
BA_ "GenSigInvalidValue" SG_ 411 ADC_BSDLCAEnableSt 0;
BA_ "GenSigSendType" SG_ 411 ADC_BSDLCAEnableSt 1;
BA_ "GenSigStartValue" SG_ 411 ADC_BSDLCAEnableSt 0;
BA_ "GenSigTimeoutValue" SG_ 411 ADC_BSDLCAEnableSt 0;
BA_ "Remark" SG_ 411 ADC_BSDLCAEnableSt "";
BA_ "EventCommandSignal" SG_ 411 ADC_RCTAEnableSt 0;
BA_ "GatewayedSignals" SG_ 411 ADC_RCTAEnableSt 0;
BA_ "GenSigInactiveValue" SG_ 411 ADC_RCTAEnableSt 0;
BA_ "GenSigInvalidValue" SG_ 411 ADC_RCTAEnableSt 0;
BA_ "GenSigSendType" SG_ 411 ADC_RCTAEnableSt 1;
BA_ "GenSigStartValue" SG_ 411 ADC_RCTAEnableSt 0;
BA_ "GenSigTimeoutValue" SG_ 411 ADC_RCTAEnableSt 0;
BA_ "Remark" SG_ 411 ADC_RCTAEnableSt "";
BA_ "EventCommandSignal" SG_ 411 ADC_RCTASt 0;
BA_ "GatewayedSignals" SG_ 411 ADC_RCTASt 0;
BA_ "GenSigInactiveValue" SG_ 411 ADC_RCTASt 0;
BA_ "GenSigInvalidValue" SG_ 411 ADC_RCTASt 0;
BA_ "GenSigSendType" SG_ 411 ADC_RCTASt 1;
BA_ "GenSigStartValue" SG_ 411 ADC_RCTASt 0;
BA_ "GenSigTimeoutValue" SG_ 411 ADC_RCTASt 3;
BA_ "Remark" SG_ 411 ADC_RCTASt "";
BA_ "EventCommandSignal" SG_ 411 ADC_RCTAAssistType 0;
BA_ "GatewayedSignals" SG_ 411 ADC_RCTAAssistType 0;
BA_ "GenSigInactiveValue" SG_ 411 ADC_RCTAAssistType 0;
BA_ "GenSigInvalidValue" SG_ 411 ADC_RCTAAssistType 0;
BA_ "GenSigSendType" SG_ 411 ADC_RCTAAssistType 1;
BA_ "GenSigStartValue" SG_ 411 ADC_RCTAAssistType 0;
BA_ "GenSigTimeoutValue" SG_ 411 ADC_RCTAAssistType 0;
BA_ "Remark" SG_ 411 ADC_RCTAAssistType "";
BA_ "EventCommandSignal" SG_ 411 ADC_DOWSt 0;
BA_ "GatewayedSignals" SG_ 411 ADC_DOWSt 0;
BA_ "GenSigInactiveValue" SG_ 411 ADC_DOWSt 0;
BA_ "GenSigInvalidValue" SG_ 411 ADC_DOWSt 0;
BA_ "GenSigSendType" SG_ 411 ADC_DOWSt 1;
BA_ "GenSigStartValue" SG_ 411 ADC_DOWSt 0;
BA_ "GenSigTimeoutValue" SG_ 411 ADC_DOWSt 3;
BA_ "Remark" SG_ 411 ADC_DOWSt "";
BA_ "EventCommandSignal" SG_ 411 ADC_DOWEnableSt 0;
BA_ "GatewayedSignals" SG_ 411 ADC_DOWEnableSt 0;
BA_ "GenSigInactiveValue" SG_ 411 ADC_DOWEnableSt 0;
BA_ "GenSigInvalidValue" SG_ 411 ADC_DOWEnableSt 0;
BA_ "GenSigSendType" SG_ 411 ADC_DOWEnableSt 1;
BA_ "GenSigStartValue" SG_ 411 ADC_DOWEnableSt 0;
BA_ "GenSigTimeoutValue" SG_ 411 ADC_DOWEnableSt 0;
BA_ "Remark" SG_ 411 ADC_DOWEnableSt "";
BA_ "EventCommandSignal" SG_ 411 ADC_LCAWarnLeft 0;
BA_ "GatewayedSignals" SG_ 411 ADC_LCAWarnLeft 0;
BA_ "GenSigInactiveValue" SG_ 411 ADC_LCAWarnLeft 0;
BA_ "GenSigInvalidValue" SG_ 411 ADC_LCAWarnLeft 0;
BA_ "GenSigSendType" SG_ 411 ADC_LCAWarnLeft 1;
BA_ "GenSigStartValue" SG_ 411 ADC_LCAWarnLeft 0;
BA_ "GenSigTimeoutValue" SG_ 411 ADC_LCAWarnLeft 0;
BA_ "Remark" SG_ 411 ADC_LCAWarnLeft "";
BA_ "EventCommandSignal" SG_ 411 ADC_LCAWarnRight 0;
BA_ "GatewayedSignals" SG_ 411 ADC_LCAWarnRight 0;
BA_ "GenSigInactiveValue" SG_ 411 ADC_LCAWarnRight 0;
BA_ "GenSigInvalidValue" SG_ 411 ADC_LCAWarnRight 0;
BA_ "GenSigSendType" SG_ 411 ADC_LCAWarnRight 1;
BA_ "GenSigStartValue" SG_ 411 ADC_LCAWarnRight 0;
BA_ "GenSigTimeoutValue" SG_ 411 ADC_LCAWarnRight 0;
BA_ "Remark" SG_ 411 ADC_LCAWarnRight "";
BA_ "EventCommandSignal" SG_ 411 ADC_RCTAWarnLeft 0;
BA_ "GatewayedSignals" SG_ 411 ADC_RCTAWarnLeft 0;
BA_ "GenSigInactiveValue" SG_ 411 ADC_RCTAWarnLeft 0;
BA_ "GenSigInvalidValue" SG_ 411 ADC_RCTAWarnLeft 0;
BA_ "GenSigSendType" SG_ 411 ADC_RCTAWarnLeft 1;
BA_ "GenSigStartValue" SG_ 411 ADC_RCTAWarnLeft 0;
BA_ "GenSigTimeoutValue" SG_ 411 ADC_RCTAWarnLeft 0;
BA_ "Remark" SG_ 411 ADC_RCTAWarnLeft "";
BA_ "EventCommandSignal" SG_ 411 ADC_RCWEnableSt 0;
BA_ "GatewayedSignals" SG_ 411 ADC_RCWEnableSt 0;
BA_ "GenSigInactiveValue" SG_ 411 ADC_RCWEnableSt 0;
BA_ "GenSigInvalidValue" SG_ 411 ADC_RCWEnableSt 0;
BA_ "GenSigSendType" SG_ 411 ADC_RCWEnableSt 1;
BA_ "GenSigStartValue" SG_ 411 ADC_RCWEnableSt 0;
BA_ "GenSigTimeoutValue" SG_ 411 ADC_RCWEnableSt 0;
BA_ "Remark" SG_ 411 ADC_RCWEnableSt "";
BA_ "EventCommandSignal" SG_ 411 ADC_RCTAWarnRight 0;
BA_ "GatewayedSignals" SG_ 411 ADC_RCTAWarnRight 0;
BA_ "GenSigInactiveValue" SG_ 411 ADC_RCTAWarnRight 0;
BA_ "GenSigInvalidValue" SG_ 411 ADC_RCTAWarnRight 0;
BA_ "GenSigSendType" SG_ 411 ADC_RCTAWarnRight 1;
BA_ "GenSigStartValue" SG_ 411 ADC_RCTAWarnRight 0;
BA_ "GenSigTimeoutValue" SG_ 411 ADC_RCTAWarnRight 0;
BA_ "Remark" SG_ 411 ADC_RCTAWarnRight "";
BA_ "EventCommandSignal" SG_ 411 ADC_RCWSt 0;
BA_ "GatewayedSignals" SG_ 411 ADC_RCWSt 0;
BA_ "GenSigInactiveValue" SG_ 411 ADC_RCWSt 0;
BA_ "GenSigInvalidValue" SG_ 411 ADC_RCWSt 0;
BA_ "GenSigSendType" SG_ 411 ADC_RCWSt 1;
BA_ "GenSigStartValue" SG_ 411 ADC_RCWSt 0;
BA_ "GenSigTimeoutValue" SG_ 411 ADC_RCWSt 3;
BA_ "Remark" SG_ 411 ADC_RCWSt "";
BA_ "EventCommandSignal" SG_ 411 ADC_RCWWarn 0;
BA_ "GatewayedSignals" SG_ 411 ADC_RCWWarn 0;
BA_ "GenSigInactiveValue" SG_ 411 ADC_RCWWarn 0;
BA_ "GenSigInvalidValue" SG_ 411 ADC_RCWWarn 0;
BA_ "GenSigSendType" SG_ 411 ADC_RCWWarn 1;
BA_ "GenSigStartValue" SG_ 411 ADC_RCWWarn 0;
BA_ "GenSigTimeoutValue" SG_ 411 ADC_RCWWarn 0;
BA_ "Remark" SG_ 411 ADC_RCWWarn "";
BA_ "EventCommandSignal" SG_ 411 ADC_FCTAEnableSt 0;
BA_ "GatewayedSignals" SG_ 411 ADC_FCTAEnableSt 0;
BA_ "GenSigInactiveValue" SG_ 411 ADC_FCTAEnableSt 0;
BA_ "GenSigInvalidValue" SG_ 411 ADC_FCTAEnableSt 0;
BA_ "GenSigSendType" SG_ 411 ADC_FCTAEnableSt 1;
BA_ "GenSigStartValue" SG_ 411 ADC_FCTAEnableSt 0;
BA_ "GenSigTimeoutValue" SG_ 411 ADC_FCTAEnableSt 0;
BA_ "Remark" SG_ 411 ADC_FCTAEnableSt "";
BA_ "EventCommandSignal" SG_ 411 ADC_FCTASt 0;
BA_ "GatewayedSignals" SG_ 411 ADC_FCTASt 0;
BA_ "GenSigInactiveValue" SG_ 411 ADC_FCTASt 0;
BA_ "GenSigInvalidValue" SG_ 411 ADC_FCTASt 0;
BA_ "GenSigSendType" SG_ 411 ADC_FCTASt 1;
BA_ "GenSigStartValue" SG_ 411 ADC_FCTASt 0;
BA_ "GenSigTimeoutValue" SG_ 411 ADC_FCTASt 3;
BA_ "Remark" SG_ 411 ADC_FCTASt "";
BA_ "EventCommandSignal" SG_ 411 ADC_FCTAAssistType 0;
BA_ "GatewayedSignals" SG_ 411 ADC_FCTAAssistType 0;
BA_ "GenSigInactiveValue" SG_ 411 ADC_FCTAAssistType 0;
BA_ "GenSigInvalidValue" SG_ 411 ADC_FCTAAssistType 0;
BA_ "GenSigSendType" SG_ 411 ADC_FCTAAssistType 1;
BA_ "GenSigStartValue" SG_ 411 ADC_FCTAAssistType 0;
BA_ "GenSigTimeoutValue" SG_ 411 ADC_FCTAAssistType 0;
BA_ "Remark" SG_ 411 ADC_FCTAAssistType "";
BA_ "EventCommandSignal" SG_ 411 ADC_FCTAWarnL 0;
BA_ "GatewayedSignals" SG_ 411 ADC_FCTAWarnL 0;
BA_ "GenSigInactiveValue" SG_ 411 ADC_FCTAWarnL 0;
BA_ "GenSigInvalidValue" SG_ 411 ADC_FCTAWarnL 0;
BA_ "GenSigSendType" SG_ 411 ADC_FCTAWarnL 1;
BA_ "GenSigStartValue" SG_ 411 ADC_FCTAWarnL 0;
BA_ "GenSigTimeoutValue" SG_ 411 ADC_FCTAWarnL 0;
BA_ "Remark" SG_ 411 ADC_FCTAWarnL "";
BA_ "EventCommandSignal" SG_ 411 ADC_FCTAWarnR 0;
BA_ "GatewayedSignals" SG_ 411 ADC_FCTAWarnR 0;
BA_ "GenSigInactiveValue" SG_ 411 ADC_FCTAWarnR 0;
BA_ "GenSigInvalidValue" SG_ 411 ADC_FCTAWarnR 0;
BA_ "GenSigSendType" SG_ 411 ADC_FCTAWarnR 1;
BA_ "GenSigStartValue" SG_ 411 ADC_FCTAWarnR 0;
BA_ "GenSigTimeoutValue" SG_ 411 ADC_FCTAWarnR 0;
BA_ "Remark" SG_ 411 ADC_FCTAWarnR "";
BA_ "EventCommandSignal" SG_ 411 ADC_FroNestTarLatSpd 0;
BA_ "GatewayedSignals" SG_ 411 ADC_FroNestTarLatSpd 0;
BA_ "GenSigInactiveValue" SG_ 411 ADC_FroNestTarLatSpd 0;
BA_ "GenSigInvalidValue" SG_ 411 ADC_FroNestTarLatSpd 0;
BA_ "GenSigSendType" SG_ 411 ADC_FroNestTarLatSpd 1;
BA_ "GenSigStartValue" SG_ 411 ADC_FroNestTarLatSpd 0;
BA_ "GenSigTimeoutValue" SG_ 411 ADC_FroNestTarLatSpd 0;
BA_ "Remark" SG_ 411 ADC_FroNestTarLatSpd "";
BA_ "EventCommandSignal" SG_ 411 ADC_FroNestTarRangeRate 0;
BA_ "GatewayedSignals" SG_ 411 ADC_FroNestTarRangeRate 0;
BA_ "GenSigInactiveValue" SG_ 411 ADC_FroNestTarRangeRate 0;
BA_ "GenSigInvalidValue" SG_ 411 ADC_FroNestTarRangeRate 0;
BA_ "GenSigSendType" SG_ 411 ADC_FroNestTarRangeRate 1;
BA_ "GenSigStartValue" SG_ 411 ADC_FroNestTarRangeRate 0;
BA_ "GenSigTimeoutValue" SG_ 411 ADC_FroNestTarRangeRate 0;
BA_ "Remark" SG_ 411 ADC_FroNestTarRangeRate "";
BA_ "EventCommandSignal" SG_ 411 ADC_FroNestTarRangeAccel 0;
BA_ "GatewayedSignals" SG_ 411 ADC_FroNestTarRangeAccel 0;
BA_ "GenSigInactiveValue" SG_ 411 ADC_FroNestTarRangeAccel 0;
BA_ "GenSigInvalidValue" SG_ 411 ADC_FroNestTarRangeAccel 0;
BA_ "GenSigSendType" SG_ 411 ADC_FroNestTarRangeAccel 1;
BA_ "GenSigStartValue" SG_ 411 ADC_FroNestTarRangeAccel 0;
BA_ "GenSigTimeoutValue" SG_ 411 ADC_FroNestTarRangeAccel 0;
BA_ "Remark" SG_ 411 ADC_FroNestTarRangeAccel "";
BA_ "EventCommandSignal" SG_ 411 ADC_FroNestTarDetSensor 0;
BA_ "GatewayedSignals" SG_ 411 ADC_FroNestTarDetSensor 0;
BA_ "GenSigInactiveValue" SG_ 411 ADC_FroNestTarDetSensor 0;
BA_ "GenSigInvalidValue" SG_ 411 ADC_FroNestTarDetSensor 0;
BA_ "GenSigSendType" SG_ 411 ADC_FroNestTarDetSensor 1;
BA_ "GenSigStartValue" SG_ 411 ADC_FroNestTarDetSensor 0;
BA_ "GenSigTimeoutValue" SG_ 411 ADC_FroNestTarDetSensor 0;
BA_ "Remark" SG_ 411 ADC_FroNestTarDetSensor "";
BA_ "EventCommandSignal" SG_ 411 ADC_FroNestTarObjType 0;
BA_ "GatewayedSignals" SG_ 411 ADC_FroNestTarObjType 0;
BA_ "GenSigInactiveValue" SG_ 411 ADC_FroNestTarObjType 0;
BA_ "GenSigInvalidValue" SG_ 411 ADC_FroNestTarObjType 0;
BA_ "GenSigSendType" SG_ 411 ADC_FroNestTarObjType 1;
BA_ "GenSigStartValue" SG_ 411 ADC_FroNestTarObjType 0;
BA_ "GenSigTimeoutValue" SG_ 411 ADC_FroNestTarObjType 0;
BA_ "Remark" SG_ 411 ADC_FroNestTarObjType "";
BA_ "EventCommandSignal" SG_ 411 ADC_LDS_LaneAssistType 0;
BA_ "GatewayedSignals" SG_ 411 ADC_LDS_LaneAssistType 0;
BA_ "GenSigInactiveValue" SG_ 411 ADC_LDS_LaneAssistType 0;
BA_ "GenSigInvalidValue" SG_ 411 ADC_LDS_LaneAssistType 0;
BA_ "GenSigSendType" SG_ 411 ADC_LDS_LaneAssistType 1;
BA_ "GenSigStartValue" SG_ 411 ADC_LDS_LaneAssistType 0;
BA_ "GenSigTimeoutValue" SG_ 411 ADC_LDS_LaneAssistType 0;
BA_ "Remark" SG_ 411 ADC_LDS_LaneAssistType "";
BA_ "EventCommandSignal" SG_ 411 ADC_IHBC_EnableSt 0;
BA_ "GatewayedSignals" SG_ 411 ADC_IHBC_EnableSt 0;
BA_ "GenSigInactiveValue" SG_ 411 ADC_IHBC_EnableSt 0;
BA_ "GenSigInvalidValue" SG_ 411 ADC_IHBC_EnableSt 0;
BA_ "GenSigSendType" SG_ 411 ADC_IHBC_EnableSt 1;
BA_ "GenSigStartValue" SG_ 411 ADC_IHBC_EnableSt 0;
BA_ "GenSigTimeoutValue" SG_ 411 ADC_IHBC_EnableSt 0;
BA_ "Remark" SG_ 411 ADC_IHBC_EnableSt "";
BA_ "EventCommandSignal" SG_ 411 ADC_ELK_EnableSt 0;
BA_ "GatewayedSignals" SG_ 411 ADC_ELK_EnableSt 0;
BA_ "GenSigInactiveValue" SG_ 411 ADC_ELK_EnableSt 0;
BA_ "GenSigInvalidValue" SG_ 411 ADC_ELK_EnableSt 0;
BA_ "GenSigSendType" SG_ 411 ADC_ELK_EnableSt 1;
BA_ "GenSigStartValue" SG_ 411 ADC_ELK_EnableSt 0;
BA_ "GenSigTimeoutValue" SG_ 411 ADC_ELK_EnableSt 0;
BA_ "Remark" SG_ 411 ADC_ELK_EnableSt "";
BA_ "EventCommandSignal" SG_ 411 ADC_ESA_EnableSt 0;
BA_ "GatewayedSignals" SG_ 411 ADC_ESA_EnableSt 0;
BA_ "GenSigInactiveValue" SG_ 411 ADC_ESA_EnableSt 0;
BA_ "GenSigInvalidValue" SG_ 411 ADC_ESA_EnableSt 0;
BA_ "GenSigSendType" SG_ 411 ADC_ESA_EnableSt 1;
BA_ "GenSigStartValue" SG_ 411 ADC_ESA_EnableSt 0;
BA_ "GenSigTimeoutValue" SG_ 411 ADC_ESA_EnableSt 0;
BA_ "Remark" SG_ 411 ADC_ESA_EnableSt "";
BA_ "EventCommandSignal" SG_ 411 ADC_AES_EnableSt 0;
BA_ "GatewayedSignals" SG_ 411 ADC_AES_EnableSt 0;
BA_ "GenSigInactiveValue" SG_ 411 ADC_AES_EnableSt 0;
BA_ "GenSigInvalidValue" SG_ 411 ADC_AES_EnableSt 0;
BA_ "GenSigSendType" SG_ 411 ADC_AES_EnableSt 1;
BA_ "GenSigStartValue" SG_ 411 ADC_AES_EnableSt 0;
BA_ "GenSigTimeoutValue" SG_ 411 ADC_AES_EnableSt 0;
BA_ "Remark" SG_ 411 ADC_AES_EnableSt "";
BA_ "EventCommandSignal" SG_ 411 ADC_LDWSt 0;
BA_ "GatewayedSignals" SG_ 411 ADC_LDWSt 0;
BA_ "GenSigInactiveValue" SG_ 411 ADC_LDWSt 0;
BA_ "GenSigInvalidValue" SG_ 411 ADC_LDWSt 0;
BA_ "GenSigSendType" SG_ 411 ADC_LDWSt 1;
BA_ "GenSigStartValue" SG_ 411 ADC_LDWSt 0;
BA_ "GenSigTimeoutValue" SG_ 411 ADC_LDWSt 0;
BA_ "Remark" SG_ 411 ADC_LDWSt "";
BA_ "EventCommandSignal" SG_ 411 ADC_LDW_Actdirection 0;
BA_ "GatewayedSignals" SG_ 411 ADC_LDW_Actdirection 0;
BA_ "GenSigInactiveValue" SG_ 411 ADC_LDW_Actdirection 0;
BA_ "GenSigInvalidValue" SG_ 411 ADC_LDW_Actdirection 0;
BA_ "GenSigSendType" SG_ 411 ADC_LDW_Actdirection 1;
BA_ "GenSigStartValue" SG_ 411 ADC_LDW_Actdirection 0;
BA_ "GenSigTimeoutValue" SG_ 411 ADC_LDW_Actdirection 0;
BA_ "Remark" SG_ 411 ADC_LDW_Actdirection "";
BA_ "EventCommandSignal" SG_ 411 ADC_LDP_Actdirection 0;
BA_ "GatewayedSignals" SG_ 411 ADC_LDP_Actdirection 0;
BA_ "GenSigInactiveValue" SG_ 411 ADC_LDP_Actdirection 0;
BA_ "GenSigInvalidValue" SG_ 411 ADC_LDP_Actdirection 0;
BA_ "GenSigSendType" SG_ 411 ADC_LDP_Actdirection 1;
BA_ "GenSigStartValue" SG_ 411 ADC_LDP_Actdirection 0;
BA_ "GenSigTimeoutValue" SG_ 411 ADC_LDP_Actdirection 0;
BA_ "Remark" SG_ 411 ADC_LDP_Actdirection "";
BA_ "EventCommandSignal" SG_ 411 ADC_LDW_PassiveReason 0;
BA_ "GatewayedSignals" SG_ 411 ADC_LDW_PassiveReason 0;
BA_ "GenSigInactiveValue" SG_ 411 ADC_LDW_PassiveReason 0;
BA_ "GenSigInvalidValue" SG_ 411 ADC_LDW_PassiveReason 0;
BA_ "GenSigSendType" SG_ 411 ADC_LDW_PassiveReason 1;
BA_ "GenSigStartValue" SG_ 411 ADC_LDW_PassiveReason 0;
BA_ "GenSigTimeoutValue" SG_ 411 ADC_LDW_PassiveReason 0;
BA_ "Remark" SG_ 411 ADC_LDW_PassiveReason "";
BA_ "EventCommandSignal" SG_ 411 ADC_LDPSt 0;
BA_ "GatewayedSignals" SG_ 411 ADC_LDPSt 0;
BA_ "GenSigInactiveValue" SG_ 411 ADC_LDPSt 0;
BA_ "GenSigInvalidValue" SG_ 411 ADC_LDPSt 0;
BA_ "GenSigSendType" SG_ 411 ADC_LDPSt 1;
BA_ "GenSigStartValue" SG_ 411 ADC_LDPSt 0;
BA_ "GenSigTimeoutValue" SG_ 411 ADC_LDPSt 0;
BA_ "Remark" SG_ 411 ADC_LDPSt "";
BA_ "EventCommandSignal" SG_ 411 ADC_LDP_PassiveReason 0;
BA_ "GatewayedSignals" SG_ 411 ADC_LDP_PassiveReason 0;
BA_ "GenSigInactiveValue" SG_ 411 ADC_LDP_PassiveReason 0;
BA_ "GenSigInvalidValue" SG_ 411 ADC_LDP_PassiveReason 0;
BA_ "GenSigSendType" SG_ 411 ADC_LDP_PassiveReason 1;
BA_ "GenSigStartValue" SG_ 411 ADC_LDP_PassiveReason 0;
BA_ "GenSigTimeoutValue" SG_ 411 ADC_LDP_PassiveReason 0;
BA_ "Remark" SG_ 411 ADC_LDP_PassiveReason "";
BA_ "EventCommandSignal" SG_ 411 ADC_RDP_St 0;
BA_ "GatewayedSignals" SG_ 411 ADC_RDP_St 0;
BA_ "GenSigInactiveValue" SG_ 411 ADC_RDP_St 0;
BA_ "GenSigInvalidValue" SG_ 411 ADC_RDP_St 0;
BA_ "GenSigSendType" SG_ 411 ADC_RDP_St 1;
BA_ "GenSigStartValue" SG_ 411 ADC_RDP_St 0;
BA_ "GenSigTimeoutValue" SG_ 411 ADC_RDP_St 0;
BA_ "Remark" SG_ 411 ADC_RDP_St "";
BA_ "EventCommandSignal" SG_ 411 ADC_RDP_PassiveReason 0;
BA_ "GatewayedSignals" SG_ 411 ADC_RDP_PassiveReason 0;
BA_ "GenSigInactiveValue" SG_ 411 ADC_RDP_PassiveReason 0;
BA_ "GenSigInvalidValue" SG_ 411 ADC_RDP_PassiveReason 0;
BA_ "GenSigSendType" SG_ 411 ADC_RDP_PassiveReason 1;
BA_ "GenSigStartValue" SG_ 411 ADC_RDP_PassiveReason 0;
BA_ "GenSigTimeoutValue" SG_ 411 ADC_RDP_PassiveReason 0;
BA_ "Remark" SG_ 411 ADC_RDP_PassiveReason "";
BA_ "EventCommandSignal" SG_ 411 ADC_IHBC_St 0;
BA_ "GatewayedSignals" SG_ 411 ADC_IHBC_St 0;
BA_ "GenSigInactiveValue" SG_ 411 ADC_IHBC_St 0;
BA_ "GenSigInvalidValue" SG_ 411 ADC_IHBC_St 0;
BA_ "GenSigSendType" SG_ 411 ADC_IHBC_St 1;
BA_ "GenSigStartValue" SG_ 411 ADC_IHBC_St 0;
BA_ "GenSigTimeoutValue" SG_ 411 ADC_IHBC_St 0;
BA_ "Remark" SG_ 411 ADC_IHBC_St "";
BA_ "EventCommandSignal" SG_ 411 ADC_RDP_Actdirection 0;
BA_ "GatewayedSignals" SG_ 411 ADC_RDP_Actdirection 0;
BA_ "GenSigInactiveValue" SG_ 411 ADC_RDP_Actdirection 0;
BA_ "GenSigInvalidValue" SG_ 411 ADC_RDP_Actdirection 0;
BA_ "GenSigSendType" SG_ 411 ADC_RDP_Actdirection 1;
BA_ "GenSigStartValue" SG_ 411 ADC_RDP_Actdirection 0;
BA_ "GenSigTimeoutValue" SG_ 411 ADC_RDP_Actdirection 0;
BA_ "Remark" SG_ 411 ADC_RDP_Actdirection "";
BA_ "EventCommandSignal" SG_ 411 ADC_FCMS_SwitchLockReq 0;
BA_ "GatewayedSignals" SG_ 411 ADC_FCMS_SwitchLockReq 0;
BA_ "GenSigInactiveValue" SG_ 411 ADC_FCMS_SwitchLockReq 0;
BA_ "GenSigInvalidValue" SG_ 411 ADC_FCMS_SwitchLockReq 0;
BA_ "GenSigSendType" SG_ 411 ADC_FCMS_SwitchLockReq 1;
BA_ "GenSigStartValue" SG_ 411 ADC_FCMS_SwitchLockReq 0;
BA_ "GenSigTimeoutValue" SG_ 411 ADC_FCMS_SwitchLockReq 0;
BA_ "Remark" SG_ 411 ADC_FCMS_SwitchLockReq "";
BA_ "EventCommandSignal" SG_ 411 ADC_LKSLaneAssistSensitivity 0;
BA_ "GatewayedSignals" SG_ 411 ADC_LKSLaneAssistSensitivity 0;
BA_ "GenSigInactiveValue" SG_ 411 ADC_LKSLaneAssistSensitivity 0;
BA_ "GenSigInvalidValue" SG_ 411 ADC_LKSLaneAssistSensitivity 0;
BA_ "GenSigSendType" SG_ 411 ADC_LKSLaneAssistSensitivity 1;
BA_ "GenSigStartValue" SG_ 411 ADC_LKSLaneAssistSensitivity 0;
BA_ "GenSigTimeoutValue" SG_ 411 ADC_LKSLaneAssistSensitivity 4;
BA_ "Remark" SG_ 411 ADC_LKSLaneAssistSensitivity "";
BA_ "EventCommandSignal" SG_ 411 ADC_IHBC_SuppressSt 0;
BA_ "GatewayedSignals" SG_ 411 ADC_IHBC_SuppressSt 0;
BA_ "GenSigInactiveValue" SG_ 411 ADC_IHBC_SuppressSt 0;
BA_ "GenSigInvalidValue" SG_ 411 ADC_IHBC_SuppressSt 0;
BA_ "GenSigSendType" SG_ 411 ADC_IHBC_SuppressSt 1;
BA_ "GenSigStartValue" SG_ 411 ADC_IHBC_SuppressSt 0;
BA_ "GenSigTimeoutValue" SG_ 411 ADC_IHBC_SuppressSt 0;
BA_ "Remark" SG_ 411 ADC_IHBC_SuppressSt "";
BA_ "EventCommandSignal" SG_ 411 ADC_IHBC_SuppressReason 0;
BA_ "GatewayedSignals" SG_ 411 ADC_IHBC_SuppressReason 0;
BA_ "GenSigInactiveValue" SG_ 411 ADC_IHBC_SuppressReason 0;
BA_ "GenSigInvalidValue" SG_ 411 ADC_IHBC_SuppressReason 0;
BA_ "GenSigSendType" SG_ 411 ADC_IHBC_SuppressReason 1;
BA_ "GenSigStartValue" SG_ 411 ADC_IHBC_SuppressReason 0;
BA_ "GenSigTimeoutValue" SG_ 411 ADC_IHBC_SuppressReason 0;
BA_ "Remark" SG_ 411 ADC_IHBC_SuppressReason "";
BA_ "EventCommandSignal" SG_ 411 ADC_IHBC_Dis2Oncoming 0;
BA_ "GatewayedSignals" SG_ 411 ADC_IHBC_Dis2Oncoming 0;
BA_ "GenSigInactiveValue" SG_ 411 ADC_IHBC_Dis2Oncoming 0;
BA_ "GenSigInvalidValue" SG_ 411 ADC_IHBC_Dis2Oncoming 0;
BA_ "GenSigSendType" SG_ 411 ADC_IHBC_Dis2Oncoming 1;
BA_ "GenSigStartValue" SG_ 411 ADC_IHBC_Dis2Oncoming 0;
BA_ "GenSigTimeoutValue" SG_ 411 ADC_IHBC_Dis2Oncoming 0;
BA_ "Remark" SG_ 411 ADC_IHBC_Dis2Oncoming "";
BA_ "EventCommandSignal" SG_ 411 ADC_IHBC_Dis2Preceding 0;
BA_ "GatewayedSignals" SG_ 411 ADC_IHBC_Dis2Preceding 0;
BA_ "GenSigInactiveValue" SG_ 411 ADC_IHBC_Dis2Preceding 0;
BA_ "GenSigInvalidValue" SG_ 411 ADC_IHBC_Dis2Preceding 0;
BA_ "GenSigSendType" SG_ 411 ADC_IHBC_Dis2Preceding 1;
BA_ "GenSigStartValue" SG_ 411 ADC_IHBC_Dis2Preceding 0;
BA_ "GenSigTimeoutValue" SG_ 411 ADC_IHBC_Dis2Preceding 0;
BA_ "Remark" SG_ 411 ADC_IHBC_Dis2Preceding "";
BA_ "EventCommandSignal" SG_ 411 ADC_IHBC_RoadlightNum 0;
BA_ "GatewayedSignals" SG_ 411 ADC_IHBC_RoadlightNum 0;
BA_ "GenSigInactiveValue" SG_ 411 ADC_IHBC_RoadlightNum 0;
BA_ "GenSigInvalidValue" SG_ 411 ADC_IHBC_RoadlightNum 0;
BA_ "GenSigSendType" SG_ 411 ADC_IHBC_RoadlightNum 1;
BA_ "GenSigStartValue" SG_ 411 ADC_IHBC_RoadlightNum 0;
BA_ "GenSigTimeoutValue" SG_ 411 ADC_IHBC_RoadlightNum 0;
BA_ "Remark" SG_ 411 ADC_IHBC_RoadlightNum "";
BA_ "EventCommandSignal" SG_ 411 ADC_IHBC_Dis2NearestRoadlight 0;
BA_ "GatewayedSignals" SG_ 411 ADC_IHBC_Dis2NearestRoadlight 0;
BA_ "GenSigInactiveValue" SG_ 411 ADC_IHBC_Dis2NearestRoadlight 0;
BA_ "GenSigInvalidValue" SG_ 411 ADC_IHBC_Dis2NearestRoadlight 0;
BA_ "GenSigSendType" SG_ 411 ADC_IHBC_Dis2NearestRoadlight 1;
BA_ "GenSigStartValue" SG_ 411 ADC_IHBC_Dis2NearestRoadlight 0;
BA_ "GenSigTimeoutValue" SG_ 411 ADC_IHBC_Dis2NearestRoadlight 0;
BA_ "Remark" SG_ 411 ADC_IHBC_Dis2NearestRoadlight "";
BA_ "EventCommandSignal" SG_ 411 ADC_IHBC_TargetType 0;
BA_ "GatewayedSignals" SG_ 411 ADC_IHBC_TargetType 0;
BA_ "GenSigInactiveValue" SG_ 411 ADC_IHBC_TargetType 0;
BA_ "GenSigInvalidValue" SG_ 411 ADC_IHBC_TargetType 0;
BA_ "GenSigSendType" SG_ 411 ADC_IHBC_TargetType 1;
BA_ "GenSigStartValue" SG_ 411 ADC_IHBC_TargetType 0;
BA_ "GenSigTimeoutValue" SG_ 411 ADC_IHBC_TargetType 0;
BA_ "Remark" SG_ 411 ADC_IHBC_TargetType "";
BA_ "EventCommandSignal" SG_ 411 ADC_TSR_SpdLimType 0;
BA_ "GatewayedSignals" SG_ 411 ADC_TSR_SpdLimType 0;
BA_ "GenSigInactiveValue" SG_ 411 ADC_TSR_SpdLimType 0;
BA_ "GenSigInvalidValue" SG_ 411 ADC_TSR_SpdLimType 0;
BA_ "GenSigSendType" SG_ 411 ADC_TSR_SpdLimType 1;
BA_ "GenSigStartValue" SG_ 411 ADC_TSR_SpdLimType 0;
BA_ "GenSigTimeoutValue" SG_ 411 ADC_TSR_SpdLimType 0;
BA_ "Remark" SG_ 411 ADC_TSR_SpdLimType "";
BA_ "EventCommandSignal" SG_ 411 ADC_TSR_SpeedLimitSource 0;
BA_ "GatewayedSignals" SG_ 411 ADC_TSR_SpeedLimitSource 0;
BA_ "GenSigInactiveValue" SG_ 411 ADC_TSR_SpeedLimitSource 0;
BA_ "GenSigInvalidValue" SG_ 411 ADC_TSR_SpeedLimitSource 0;
BA_ "GenSigSendType" SG_ 411 ADC_TSR_SpeedLimitSource 1;
BA_ "GenSigStartValue" SG_ 411 ADC_TSR_SpeedLimitSource 0;
BA_ "GenSigTimeoutValue" SG_ 411 ADC_TSR_SpeedLimitSource 0;
BA_ "Remark" SG_ 411 ADC_TSR_SpeedLimitSource "";
BA_ "EventCommandSignal" SG_ 411 ADC_ELKoncomingSt 0;
BA_ "GatewayedSignals" SG_ 411 ADC_ELKoncomingSt 0;
BA_ "GenSigInactiveValue" SG_ 411 ADC_ELKoncomingSt 0;
BA_ "GenSigInvalidValue" SG_ 411 ADC_ELKoncomingSt 0;
BA_ "GenSigSendType" SG_ 411 ADC_ELKoncomingSt 1;
BA_ "GenSigStartValue" SG_ 411 ADC_ELKoncomingSt 0;
BA_ "GenSigTimeoutValue" SG_ 411 ADC_ELKoncomingSt 0;
BA_ "Remark" SG_ 411 ADC_ELKoncomingSt "";
BA_ "EventCommandSignal" SG_ 411 ADC_ELKoncoming_PassiveReason 0;
BA_ "GatewayedSignals" SG_ 411 ADC_ELKoncoming_PassiveReason 0;
BA_ "GenSigInactiveValue" SG_ 411 ADC_ELKoncoming_PassiveReason 0;
BA_ "GenSigInvalidValue" SG_ 411 ADC_ELKoncoming_PassiveReason 0;
BA_ "GenSigSendType" SG_ 411 ADC_ELKoncoming_PassiveReason 1;
BA_ "GenSigStartValue" SG_ 411 ADC_ELKoncoming_PassiveReason 0;
BA_ "GenSigTimeoutValue" SG_ 411 ADC_ELKoncoming_PassiveReason 0;
BA_ "Remark" SG_ 411 ADC_ELKoncoming_PassiveReason "";
BA_ "EventCommandSignal" SG_ 411 ADC_ELKoncoming_Actdirection 0;
BA_ "GatewayedSignals" SG_ 411 ADC_ELKoncoming_Actdirection 0;
BA_ "GenSigInactiveValue" SG_ 411 ADC_ELKoncoming_Actdirection 0;
BA_ "GenSigInvalidValue" SG_ 411 ADC_ELKoncoming_Actdirection 0;
BA_ "GenSigSendType" SG_ 411 ADC_ELKoncoming_Actdirection 1;
BA_ "GenSigStartValue" SG_ 411 ADC_ELKoncoming_Actdirection 0;
BA_ "GenSigTimeoutValue" SG_ 411 ADC_ELKoncoming_Actdirection 0;
BA_ "Remark" SG_ 411 ADC_ELKoncoming_Actdirection "";
BA_ "EventCommandSignal" SG_ 411 ADC_ELKovertakingSt 0;
BA_ "GatewayedSignals" SG_ 411 ADC_ELKovertakingSt 0;
BA_ "GenSigInactiveValue" SG_ 411 ADC_ELKovertakingSt 0;
BA_ "GenSigInvalidValue" SG_ 411 ADC_ELKovertakingSt 0;
BA_ "GenSigSendType" SG_ 411 ADC_ELKovertakingSt 1;
BA_ "GenSigStartValue" SG_ 411 ADC_ELKovertakingSt 0;
BA_ "GenSigTimeoutValue" SG_ 411 ADC_ELKovertakingSt 0;
BA_ "Remark" SG_ 411 ADC_ELKovertakingSt "";
BA_ "EventCommandSignal" SG_ 411 ADC_ELKovertaking_ActDirection 0;
BA_ "GatewayedSignals" SG_ 411 ADC_ELKovertaking_ActDirection 0;
BA_ "GenSigInactiveValue" SG_ 411 ADC_ELKovertaking_ActDirection 0;
BA_ "GenSigInvalidValue" SG_ 411 ADC_ELKovertaking_ActDirection 0;
BA_ "GenSigSendType" SG_ 411 ADC_ELKovertaking_ActDirection 1;
BA_ "GenSigStartValue" SG_ 411 ADC_ELKovertaking_ActDirection 0;
BA_ "GenSigTimeoutValue" SG_ 411 ADC_ELKovertaking_ActDirection 0;
BA_ "Remark" SG_ 411 ADC_ELKovertaking_ActDirection "";
BA_ "EventCommandSignal" SG_ 411 ADC_ELKovertaking_PassiveReason 0;
BA_ "GatewayedSignals" SG_ 411 ADC_ELKovertaking_PassiveReason 0;
BA_ "GenSigInactiveValue" SG_ 411 ADC_ELKovertaking_PassiveReason 0;
BA_ "GenSigInvalidValue" SG_ 411 ADC_ELKovertaking_PassiveReason 0;
BA_ "GenSigSendType" SG_ 411 ADC_ELKovertaking_PassiveReason 1;
BA_ "GenSigStartValue" SG_ 411 ADC_ELKovertaking_PassiveReason 0;
BA_ "GenSigTimeoutValue" SG_ 411 ADC_ELKovertaking_PassiveReason 0;
BA_ "Remark" SG_ 411 ADC_ELKovertaking_PassiveReason "";
BA_ "EventCommandSignal" SG_ 411 ADC_ELK_TargetObjClass 0;
BA_ "GatewayedSignals" SG_ 411 ADC_ELK_TargetObjClass 0;
BA_ "GenSigInactiveValue" SG_ 411 ADC_ELK_TargetObjClass 0;
BA_ "GenSigInvalidValue" SG_ 411 ADC_ELK_TargetObjClass 0;
BA_ "GenSigSendType" SG_ 411 ADC_ELK_TargetObjClass 1;
BA_ "GenSigStartValue" SG_ 411 ADC_ELK_TargetObjClass 0;
BA_ "GenSigTimeoutValue" SG_ 411 ADC_ELK_TargetObjClass 0;
BA_ "Remark" SG_ 411 ADC_ELK_TargetObjClass "";
BA_ "EventCommandSignal" SG_ 411 ADC_ESA_St 0;
BA_ "GatewayedSignals" SG_ 411 ADC_ESA_St 0;
BA_ "GenSigInactiveValue" SG_ 411 ADC_ESA_St 0;
BA_ "GenSigInvalidValue" SG_ 411 ADC_ESA_St 0;
BA_ "GenSigSendType" SG_ 411 ADC_ESA_St 1;
BA_ "GenSigStartValue" SG_ 411 ADC_ESA_St 0;
BA_ "GenSigTimeoutValue" SG_ 411 ADC_ESA_St 4;
BA_ "Remark" SG_ 411 ADC_ESA_St "";
BA_ "EventCommandSignal" SG_ 411 ADC_ESA_ActDirection 0;
BA_ "GatewayedSignals" SG_ 411 ADC_ESA_ActDirection 0;
BA_ "GenSigInactiveValue" SG_ 411 ADC_ESA_ActDirection 0;
BA_ "GenSigInvalidValue" SG_ 411 ADC_ESA_ActDirection 0;
BA_ "GenSigSendType" SG_ 411 ADC_ESA_ActDirection 1;
BA_ "GenSigStartValue" SG_ 411 ADC_ESA_ActDirection 0;
BA_ "GenSigTimeoutValue" SG_ 411 ADC_ESA_ActDirection 0;
BA_ "Remark" SG_ 411 ADC_ESA_ActDirection "";
BA_ "EventCommandSignal" SG_ 411 ADC_AES_St 0;
BA_ "GatewayedSignals" SG_ 411 ADC_AES_St 0;
BA_ "GenSigInactiveValue" SG_ 411 ADC_AES_St 0;
BA_ "GenSigInvalidValue" SG_ 411 ADC_AES_St 0;
BA_ "GenSigSendType" SG_ 411 ADC_AES_St 1;
BA_ "GenSigStartValue" SG_ 411 ADC_AES_St 0;
BA_ "GenSigTimeoutValue" SG_ 411 ADC_AES_St 4;
BA_ "Remark" SG_ 411 ADC_AES_St "";
BA_ "EventCommandSignal" SG_ 411 ADC_AES_ActDirection 0;
BA_ "GatewayedSignals" SG_ 411 ADC_AES_ActDirection 0;
BA_ "GenSigInactiveValue" SG_ 411 ADC_AES_ActDirection 0;
BA_ "GenSigInvalidValue" SG_ 411 ADC_AES_ActDirection 0;
BA_ "GenSigSendType" SG_ 411 ADC_AES_ActDirection 1;
BA_ "GenSigStartValue" SG_ 411 ADC_AES_ActDirection 0;
BA_ "GenSigTimeoutValue" SG_ 411 ADC_AES_ActDirection 0;
BA_ "Remark" SG_ 411 ADC_AES_ActDirection "";
BA_ "EventCommandSignal" SG_ 411 ADC_RDP_Number 0;
BA_ "GatewayedSignals" SG_ 411 ADC_RDP_Number 0;
BA_ "GenSigInactiveValue" SG_ 411 ADC_RDP_Number 0;
BA_ "GenSigInvalidValue" SG_ 411 ADC_RDP_Number 0;
BA_ "GenSigSendType" SG_ 411 ADC_RDP_Number 1;
BA_ "GenSigStartValue" SG_ 411 ADC_RDP_Number 0;
BA_ "GenSigTimeoutValue" SG_ 411 ADC_RDP_Number 0;
BA_ "Remark" SG_ 411 ADC_RDP_Number "";
BA_ "EventCommandSignal" SG_ 411 ADC_ELKoncoming_Number 0;
BA_ "GatewayedSignals" SG_ 411 ADC_ELKoncoming_Number 0;
BA_ "GenSigInactiveValue" SG_ 411 ADC_ELKoncoming_Number 0;
BA_ "GenSigInvalidValue" SG_ 411 ADC_ELKoncoming_Number 0;
BA_ "GenSigSendType" SG_ 411 ADC_ELKoncoming_Number 1;
BA_ "GenSigStartValue" SG_ 411 ADC_ELKoncoming_Number 0;
BA_ "GenSigTimeoutValue" SG_ 411 ADC_ELKoncoming_Number 0;
BA_ "Remark" SG_ 411 ADC_ELKoncoming_Number "";
BA_ "EventCommandSignal" SG_ 411 ADC_ELKovertaking_Numbe 0;
BA_ "GatewayedSignals" SG_ 411 ADC_ELKovertaking_Numbe 0;
BA_ "GenSigInactiveValue" SG_ 411 ADC_ELKovertaking_Numbe 0;
BA_ "GenSigInvalidValue" SG_ 411 ADC_ELKovertaking_Numbe 0;
BA_ "GenSigSendType" SG_ 411 ADC_ELKovertaking_Numbe 1;
BA_ "GenSigStartValue" SG_ 411 ADC_ELKovertaking_Numbe 0;
BA_ "GenSigTimeoutValue" SG_ 411 ADC_ELKovertaking_Numbe 0;
BA_ "Remark" SG_ 411 ADC_ELKovertaking_Numbe "";
BA_ "EventCommandSignal" SG_ 411 ADC_ESA_TargetObjClass 0;
BA_ "GatewayedSignals" SG_ 411 ADC_ESA_TargetObjClass 0;
BA_ "GenSigInactiveValue" SG_ 411 ADC_ESA_TargetObjClass 0;
BA_ "GenSigInvalidValue" SG_ 411 ADC_ESA_TargetObjClass 0;
BA_ "GenSigSendType" SG_ 411 ADC_ESA_TargetObjClass 1;
BA_ "GenSigStartValue" SG_ 411 ADC_ESA_TargetObjClass 0;
BA_ "GenSigTimeoutValue" SG_ 411 ADC_ESA_TargetObjClass 0;
BA_ "Remark" SG_ 411 ADC_ESA_TargetObjClass "";
BA_ "EventCommandSignal" SG_ 411 ADC_ESA_PassiveReason 0;
BA_ "GatewayedSignals" SG_ 411 ADC_ESA_PassiveReason 0;
BA_ "GenSigInactiveValue" SG_ 411 ADC_ESA_PassiveReason 0;
BA_ "GenSigInvalidValue" SG_ 411 ADC_ESA_PassiveReason 0;
BA_ "GenSigSendType" SG_ 411 ADC_ESA_PassiveReason 1;
BA_ "GenSigStartValue" SG_ 411 ADC_ESA_PassiveReason 0;
BA_ "GenSigTimeoutValue" SG_ 411 ADC_ESA_PassiveReason 0;
BA_ "Remark" SG_ 411 ADC_ESA_PassiveReason "";
BA_ "EventCommandSignal" SG_ 411 ADC_AES_TargetObjClass 0;
BA_ "GatewayedSignals" SG_ 411 ADC_AES_TargetObjClass 0;
BA_ "GenSigInactiveValue" SG_ 411 ADC_AES_TargetObjClass 0;
BA_ "GenSigInvalidValue" SG_ 411 ADC_AES_TargetObjClass 0;
BA_ "GenSigSendType" SG_ 411 ADC_AES_TargetObjClass 1;
BA_ "GenSigStartValue" SG_ 411 ADC_AES_TargetObjClass 0;
BA_ "GenSigTimeoutValue" SG_ 411 ADC_AES_TargetObjClass 0;
BA_ "Remark" SG_ 411 ADC_AES_TargetObjClass "";
BA_ "EventCommandSignal" SG_ 411 ADC_AES_PassiveReason 0;
BA_ "GatewayedSignals" SG_ 411 ADC_AES_PassiveReason 0;
BA_ "GenSigInactiveValue" SG_ 411 ADC_AES_PassiveReason 0;
BA_ "GenSigInvalidValue" SG_ 411 ADC_AES_PassiveReason 0;
BA_ "GenSigSendType" SG_ 411 ADC_AES_PassiveReason 1;
BA_ "GenSigStartValue" SG_ 411 ADC_AES_PassiveReason 0;
BA_ "GenSigTimeoutValue" SG_ 411 ADC_AES_PassiveReason 0;
BA_ "Remark" SG_ 411 ADC_AES_PassiveReason "";
BA_ "EventCommandSignal" SG_ 411 ADC_LDW_Number 0;
BA_ "GatewayedSignals" SG_ 411 ADC_LDW_Number 0;
BA_ "GenSigInactiveValue" SG_ 411 ADC_LDW_Number 0;
BA_ "GenSigInvalidValue" SG_ 411 ADC_LDW_Number 0;
BA_ "GenSigSendType" SG_ 411 ADC_LDW_Number 1;
BA_ "GenSigStartValue" SG_ 411 ADC_LDW_Number 0;
BA_ "GenSigTimeoutValue" SG_ 411 ADC_LDW_Number 0;
BA_ "Remark" SG_ 411 ADC_LDW_Number "";
BA_ "EventCommandSignal" SG_ 411 ADC_LDPNumber 0;
BA_ "GatewayedSignals" SG_ 411 ADC_LDPNumber 0;
BA_ "GenSigInactiveValue" SG_ 411 ADC_LDPNumber 0;
BA_ "GenSigInvalidValue" SG_ 411 ADC_LDPNumber 0;
BA_ "GenSigSendType" SG_ 411 ADC_LDPNumber 1;
BA_ "GenSigStartValue" SG_ 411 ADC_LDPNumber 0;
BA_ "GenSigTimeoutValue" SG_ 411 ADC_LDPNumber 0;
BA_ "Remark" SG_ 411 ADC_LDPNumber "";
BA_ "EventCommandSignal" SG_ 411 ADC_L1_LatfaultReason 0;
BA_ "GatewayedSignals" SG_ 411 ADC_L1_LatfaultReason 0;
BA_ "GenSigInactiveValue" SG_ 411 ADC_L1_LatfaultReason 0;
BA_ "GenSigInvalidValue" SG_ 411 ADC_L1_LatfaultReason 0;
BA_ "GenSigSendType" SG_ 411 ADC_L1_LatfaultReason 1;
BA_ "GenSigStartValue" SG_ 411 ADC_L1_LatfaultReason 0;
BA_ "GenSigTimeoutValue" SG_ 411 ADC_L1_LatfaultReason 0;
BA_ "Remark" SG_ 411 ADC_L1_LatfaultReason "";
BA_ "EventCommandSignal" SG_ 411 ADC_ESA_Number 0;
BA_ "GatewayedSignals" SG_ 411 ADC_ESA_Number 0;
BA_ "GenSigInactiveValue" SG_ 411 ADC_ESA_Number 0;
BA_ "GenSigInvalidValue" SG_ 411 ADC_ESA_Number 0;
BA_ "GenSigSendType" SG_ 411 ADC_ESA_Number 1;
BA_ "GenSigStartValue" SG_ 411 ADC_ESA_Number 0;
BA_ "GenSigTimeoutValue" SG_ 411 ADC_ESA_Number 0;
BA_ "Remark" SG_ 411 ADC_ESA_Number "";
BA_ "EventCommandSignal" SG_ 411 ADC_AES_Number 0;
BA_ "GatewayedSignals" SG_ 411 ADC_AES_Number 0;
BA_ "GenSigInactiveValue" SG_ 411 ADC_AES_Number 0;
BA_ "GenSigInvalidValue" SG_ 411 ADC_AES_Number 0;
BA_ "GenSigSendType" SG_ 411 ADC_AES_Number 1;
BA_ "GenSigStartValue" SG_ 411 ADC_AES_Number 0;
BA_ "GenSigTimeoutValue" SG_ 411 ADC_AES_Number 0;
BA_ "Remark" SG_ 411 ADC_AES_Number "";
BA_ "EventCommandSignal" SG_ 411 ADC_FroNestTarLatPos 0;
BA_ "GatewayedSignals" SG_ 411 ADC_FroNestTarLatPos 0;
BA_ "GenSigInactiveValue" SG_ 411 ADC_FroNestTarLatPos 0;
BA_ "GenSigInvalidValue" SG_ 411 ADC_FroNestTarLatPos 0;
BA_ "GenSigSendType" SG_ 411 ADC_FroNestTarLatPos 1;
BA_ "GenSigStartValue" SG_ 411 ADC_FroNestTarLatPos 0;
BA_ "GenSigTimeoutValue" SG_ 411 ADC_FroNestTarLatPos 0;
BA_ "Remark" SG_ 411 ADC_FroNestTarLatPos "";
BA_ "EventCommandSignal" SG_ 411 ADC_LDSIconColor 0;
BA_ "GatewayedSignals" SG_ 411 ADC_LDSIconColor 0;
BA_ "GenSigInactiveValue" SG_ 411 ADC_LDSIconColor 0;
BA_ "GenSigInvalidValue" SG_ 411 ADC_LDSIconColor 0;
BA_ "GenSigSendType" SG_ 411 ADC_LDSIconColor 1;
BA_ "GenSigStartValue" SG_ 411 ADC_LDSIconColor 0;
BA_ "GenSigTimeoutValue" SG_ 411 ADC_LDSIconColor 5;
BA_ "Remark" SG_ 411 ADC_LDSIconColor "";
BA_ "EventCommandSignal" SG_ 411 ADC_FroNestTarLongPos 0;
BA_ "GatewayedSignals" SG_ 411 ADC_FroNestTarLongPos 0;
BA_ "GenSigInactiveValue" SG_ 411 ADC_FroNestTarLongPos 0;
BA_ "GenSigInvalidValue" SG_ 411 ADC_FroNestTarLongPos 0;
BA_ "GenSigSendType" SG_ 411 ADC_FroNestTarLongPos 1;
BA_ "GenSigStartValue" SG_ 411 ADC_FroNestTarLongPos 0;
BA_ "GenSigTimeoutValue" SG_ 411 ADC_FroNestTarLongPos 0;
BA_ "Remark" SG_ 411 ADC_FroNestTarLongPos "";
BA_ "EventCommandSignal" SG_ 411 ADC_LOCP_St 0;
BA_ "GatewayedSignals" SG_ 411 ADC_LOCP_St 0;
BA_ "GenSigInactiveValue" SG_ 411 ADC_LOCP_St 0;
BA_ "GenSigInvalidValue" SG_ 411 ADC_LOCP_St 0;
BA_ "GenSigSendType" SG_ 411 ADC_LOCP_St 1;
BA_ "GenSigStartValue" SG_ 411 ADC_LOCP_St 0;
BA_ "GenSigTimeoutValue" SG_ 411 ADC_LOCP_St 4;
BA_ "Remark" SG_ 411 ADC_LOCP_St "";

VAL_ 352 BCS_VehSpdVD 0 "Not Valid" 1 "Valid"  ;
VAL_ 352 BCS_EBDActiveSt 0 "Not active" 1 "Active"  ;
VAL_ 352 BCS_EBDFaultSt 0 "Not fault" 1 "Fault"  ;
VAL_ 352 BCS_ABSActiveSt 0 "Not active" 1 "Active"  ;
VAL_ 352 BCS_ABSFaultSt 0 "Not fault" 1 "Fault"  ;
VAL_ 352 BCS_TCSActiveSt 0 "Not active" 1 "Active"  ;
VAL_ 352 BCS_TCSFaultSt 0 "Not fault" 1 "Fault"  ;
VAL_ 352 BCS_VDCActiveSt 0 "Not active" 1 "Active"  ;
VAL_ 352 BCS_VDCFaultSt 0 "Not fault" 1 "Fault"  ;
VAL_ 352 BCS_PreAndRealVDCActiveSt 0 "Not active" 1 "Active"  ;
VAL_ 352 BCS_DTCAvailable 0 "Not available" 1 "Available"  ;
VAL_ 352 BCS_DTCActiveSt 0 "Not Active" 1 "Active"  ;
VAL_ 352 BCS_RealTCSActiveSt 0 "Not active" 1 "Active"  ;
VAL_ 352 BCS_CrbsActive 0 "Not Active" 1 "Active"  ;
VAL_ 352 BCS_BrkPedalStVD 0 "Invalid" 1 "Valid"  ;
VAL_ 352 BCS_BrkPedalSt 0 "Not_Pressed/Init/Default" 1 "Pressed" 2 "Reserved" 3 "Error"  ;
VAL_ 352 BCS_TargetRecpTorqRqFASt 0 "NotIntialized" 1 "Normal" 2 "Faulty" 3 "Reserved"  ;
VAL_ 352 BCS_TargetRecpTorqRqRASt 0 "NotIntialized" 1 "Normal" 2 "Faulty" 3 "Reserved"  ;
VAL_ 352 BCS_EngTorqDecActiveStRA 0 "Not active" 1 "Active"  ;
VAL_ 352 BCS_EngTorqDecActiveStFA 0 "Not active" 1 "Active"  ;
VAL_ 352 BCS_EngTorqIncActiveStFA 0 "Not active" 1 "Active"  ;
VAL_ 352 BCS_ADCNetErrorFb 0 "No Error" 1 "Main Net E2E Error" 2 "Sub Net E2E Error" 3 "Both Net E2E Error" 4 "Reserved" 5 "Reserved" 6 "Reserved" 7 "Reserved"  ;
VAL_ 352 BCS_NetModeResp 0 "None" 1 "Main/sub Net active" 2 "Main/sub Net active with error" 3 "Reserved"  ;
VAL_ 403 ADC_ACCMode 0 "Failure （ACC failure）" 1 "Passive mode (ACC passive)" 2 "Standby mode (ACC standby)" 3 "Active control mode (ACC active)" 4 "Brake only mode" 5 "Override (ACC Lng-Override)" 6 "Standwait (ACC standwait )" 7 "Standactive (ACC standactive)" 8 "No Request (Only ADS)" 9 "Off (ACC disable)" 10 "Not used" 11 "Not used" 12 "Not used" 13 "Not used" 14 "Not used" 15 "Not used"  ;
VAL_ 403 ADC_ACCFailureReason 0 "Not failure reason" 1 "Brake failure" 2 "Sensor failure" 3 "ECU failure" 4 "Power failure" 5 "Steering failure" 6 "Power Supply failure" 7 "ICM failure" 8 "SRS failure" 9 "Reserved" 10 "Reserved" 11 "Reserved" 12 "Reserved" 13 "Reserved" 14 "Reserved" 15 "Other reason"  ;
VAL_ 403 ADC_ACCPassiveReason 0 "No passive reason" 1 "Function configurtion code close" 2 "Four door and two covers not closed" 3 "Not D gear" 4 "Not Forward direction" 5 "Seatbelt unfastened" 6 "SteeringAngle  or SteeringAngleSpd not statisfied" 7 "BrkPedal applied" 8 "Vehicle Speed not statisfied" 9 "EPB not released" 10 "Autohold actived" 11 "ESP not statisfied" 12 "Frontwiper in fast gear" 13 "Reserved" 14 "Reserved" 15 "Other reason"  ;
VAL_ 403 ADC_TJP_St 0 "TJP disable" 1 "TJP passive" 2 "TJP standby" 3 "TJP activated-active-normal" 4 "TJP activated-active-standactive" 5 "TJP activated-Lng_override-accel_override" 6 "TJP activated-Lng_override-brake_override" 7 "TJP Lat-Override" 8 "TJP Lat & Lng Override" 9 "TJP SYS-Priority" 10 "TJP 预留" 11 "TJP TOR with Lat-control" 12 "TJP TOR with Lat&Lng-contro" 13 "BOM" 14 "TJP MRM Ego Lane comfortable with Lat-control" 15 "TJP MRM Ego Lane comfortable with Lat&Lng-control" 16 "TJP MRM Ego Lane emergency with Lat-control" 17 "TJP MRM Ego Lane emergency with Lat&Lng-control" 18 "TJP MRC" 19 "TJP failure" 20 "AD Transition Phase" 21 "Not used" 22 "Not used" 23 "Not used" 24 "Not used" 25 "Not used" 26 "Not used" 27 "Not used" 28 "Not used" 29 "Not used" 30 "Not used" 31 "Not used"  ;
VAL_ 403 ADC_TJPIconColor 0 "IconColor_None" 1 "IconColor_Gray" 2 "IconColor_Green" 3 "IconColor_Blue" 4 "IconClolor_Yellow" 5 "override flash（blue）" 6 "TOR_Red"  ;
VAL_ 403 ADC_TimeGapSet 0 "TimeGap 0" 1 "TimeGap 1" 2 "TimeGap 2" 3 "TimeGap 3" 4 "TimeGap 4" 5 "Auto" 6 "TimeGap 5 (Not for GAC-ADAS)" 7 "Not used"  ;
VAL_ 403 ADC_ICA_St 0 "ICA disable" 1 "ICA passive" 2 "ICA standby" 3 "ICA active normal" 4 "ICA active standwait" 5 "ICA active standactive" 6 "Not used" 7 "ICA Lat-Override" 8 "ICA Lng-Override" 9 "Not used" 10 "ICA Lat & Lng Override" 11 "BOM" 12 "Not used" 13 "Not used" 14 "ICA MRM Ego Lane  with Lat-control" 15 "ICA MRM Ego Lane  with Lat&Lng-control" 16 "Not used" 17 "Not used" 18 "ICA MRC" 19 "ICA failure light" 20 "Not used" 21 "Not used" 22 "Not used" 23 "Not used" 24 "Not used" 25 "Not used" 26 "Not used" 27 "Not used" 28 "Not used" 29 "Not used" 30 "Not used" 31 "Not used"  ;
VAL_ 403 ADC_Cruise_SpeedLimitType 0 "No speed SET" 1 "User Settings" 2 "heavy weather" 3 "curvature" 4 "lane width" 5 "Adjacent lane target" 6 "crossing" 7 "Lane type switching" 8 "TSR" 9 "TOR" 10 "SteeringAngle" 11 "Stub or Ramp" 12 "Not used" 13 "Not used" 14 "Not used" 15 "Not used"  ;
VAL_ 403 ADC_LaneChangeSt 0 "No Lane Change" 1 "Prepare Lane Change Left" 2 "Prepare Lane Change Right" 3 "Lane Changing left" 4 "Lane Changing Right" 5 "Cancel Lane Changing Left" 6 "Cancel Lane Changing Right" 7 "Lane Change Finished" 8 "Not Used" 9 "Not Used" 10 "Not used" 11 "Not used" 12 "not used" 13 "not used" 14 "not used" 15 "not used"  ;
VAL_ 403 ADC_LaneChange_AbortReason 0 "no  abort" 1 "GAP front vehicles Sharp slowdown" 2 "GAP rear vehicles rapidly accelerate" 3 "There are Pedestrian in the GAP" 4 "There are stationary obstacles in the GAP" 5 "risk of collision with vehicles in adjacent lanes" 6 "Target lane width narrow" 7 "Origina lane width narrow" 8 "Driver Turn off function" 9 "Curvature not satisfied" 10 "Speed ODD not satisfied" 11 "Tigh priority function is triggered" 12 "others" 13 "reserved" 14 "reserved" 15 "reserved"  ;
VAL_ 403 ADC_LaneChange_Actdirection 0 "not active" 1 "left" 2 "right" 3 "Not used"  ;
VAL_ 403 ADC_ICA_MRMReason 0 "No request" 1 "Hands off overtime" 2 "Not used"  ;
VAL_ 403 ADC_ICA_PassiveReason 0 "No Passive State" 1 "Cruise Function Configuration Code Close" 2 "Driver Brake Pedal Pressed" 3 "Driver Steering Torque/Angle/AngleSpd not Satisfied" 4 "Driver Acc Pedal  Applied" 5 "Driver EPB Applied" 6 "Driver Not D gear" 7 "Vehicle Not Forward Direction" 8 "Vehicle Speed not Satisfied" 9 "ADAS System Failure" 10 "Event  Collision" 11 "Vehicle Ignition Off" 12 "High Priority System Activation" 13 "ABS or ESP active" 14 "Driver Cancle Button" 15 "Vehicle Four Doors and Two Covers? not Closed" 16 "Driver Seat Belt not Fastened" 17 "Vehicle Autohold Actived" 18 "Vehicle ADAS Related System Failure" 19 "IBCS Handshake Abnormal" 20 "VCU Handshake Abnormal" 21 "EPS Handshake Abnormal" 22 "Weather Rain not Satisfied（Frontwiper in Fast Gear etc）" 23 "Event Front Object Missing" 24 "Road Lane Topology Cause ACC Exit" 25 "Road and Lane Condotion to Cruise" 26 "Others Reasons Cause ACC Exit" 27 "Driver Hands off Too Long" 28 "VehicleTurn Lamp Light" 29 "Vehicle  Posture is not Satisfied" 30 "Hazard Lamp Light" 31 "Ride Line" 32 "Punish" 33 "Function Safety Condition Require" 34 "Eyes off" 35 "No Navgation" 36 "NDA Enbale Switch" 37 "NDA ODD not Satisfied" 38 "NDA Localization Abnormal" 39 "NDA Plan Abnormal"  ;
VAL_ 403 ADC_ICA_faultReason 0 "NO Function fault state" 1 "Sensor Failure" 2 "ADC Failure" 3 "ZCU failure or BCM  Failure" 4 "CCU failure" 5 "SRS failure" 6 "EPS failure" 7 "EBB failure" 8 ":ESC failure" 9 "VCU and relevate system failure" 10 "IDU failure OR IHU  failure" 11 "A-CAN? failure" 12 "P-CAN failure" 13 "I-CAN failure" 14 "Power abnormal" 15 "IMU failure" 16 "diagnose  abnormal" 17 "CID abnormal" 18 "Physical key failure" 19 "Tire pressure failure" 20 "Tire pressure abnormal" 21 "others"  ;
VAL_ 403 ADC_HFIconColor 0 "IconColor_None" 1 "IconColor_Gray" 2 "IconColor_Green" 3 "IconColor_Blue" 4 "IconClolor_Yellow" 5 "override flash（blue）" 6 "TOR_Red"  ;
VAL_ 403 ADC_HandsOnSt 0 "No request" 1 "Hands On" 2 "Hands Off" 3 "not used"  ;
VAL_ 403 ADC_ICMADASFailureText 0 "No display" 1 "Adigo please clean AD sensor" 0 "No display" 1 "Adigo forwad safety function limited" 0 "No display" 1 "Backward safety function limited" 0 "No display" 1 "Adigo LKS function limited" 0 "No display" 1 "Adigo cruise assist function limited" 0 "No display" 1 "Adigo Cruise function can not be activated this ignition cycle" 0 "No display" 1 "Active safety function limited" 0 "No display" 1 "ICA can not be activated this ignition cycle"  ;
VAL_ 403 ADC_ICMADASWarnText 0 "No display" 1 "ACC driving does not meet the open condition" 2 "ICA driving does not meet the open condition" 3 "Synchronize target cruising speed to 20 km/h" 4 "Synchronize target cruising speed to 30 km/h" 5 "Synchronize target cruising speed to 40 km/h" 6 "Synchronize target cruising speed to 50 km/h" 7 "Synchronize target cruising speed to 60 km/h" 8 "Synchronize target cruising speed to 70 km/h" 9 "Synchronize target cruising speed to 80 km/h" 10 "Synchronize target cruising speed to 90 km/h" 11 "Synchronize target cruising speed to 100 km/h" 12 "Synchronize target cruising speed to 110 km/h" 13 "Synchronize target cruising speed to 120 km/h" 14 "Please press the accelerator lightly to resume cruising" 15 "Emergency braking" 16 "Assisting steering" 17 "Emergency turn in progress" 18 "Please pay attention to side and rear road conditions" 19 "Crusing waiting" 20 "Plz focus on road to resume cruise" 21 "Avoiding Now" 22 "Vehicle is now being controlled" 23 "Speed is now being controlled" 24 "Direction is now being controlled" 25 "Downgraded to ACC" 26 "Downgraded to ICA" 27 "Driven based on the Navigation now" 28 "Driven within the lane now" 29 "Please brake" 30 "PMA Activates please release the gaspedal" 31 "Text1"  ;
VAL_ 403 ADC_SpeedLimitIconSt 0 "SpeedLimitIconAction_None" 1 "SpeedLimitIconAction_Flash" 2 "SpeedLimitIconAction_Constant" 3 "SpeedLimitFault" 4 "SpeedLimitIconAction_Absolute" 5 "SpeedLimitIcon_NoDisplay" 6 "Reserved" 7 "Reserved"  ;
VAL_ 403 ADC_ICMWarnCardSt 0 "HORValue_None" 1 "HORValue_Level1_HOD" 2 "HORValue_Level2" 3 "HORValue_Level3" 4 "FORValue_Level1" 5 "FORValue_Level2" 6 "FORValue_Level3" 7 "TORValueLat_level1" 8 "TORValueLat_level2" 9 "TORValueLat_level3" 10 "TORValueLongLat_level1" 11 "TORValueLongLat_level2" 12 "TORValueLongLat_level3" 13 "TORValue_Stopping" 14 "TORValue_Stopped" 15 "HORValue_Level1" 16 "HORValue_Level2_HOD" 17 "HORValue_Level3_HOD" 18 "TOR_RoadBlockageAhead" 19 "TOR_CameraBlockageByWiper" 20 "TOR_LackOfLight" 21 "TOR_OverSpeed" 22 "TOR_LCCNoTurning" 23 "TOR_ADSEnded" 24 "Be about to arrive the TollStation, please take over" 25 "Be about to turn around, please take over" 26 "Be about to arrive the Roundabout, please take over" 27 "Be about to arrive the destination, please take over" 28 "TOR_BraketoTakeOver" 29 "TOR_PlzTakeoverCannotPassNarrowroad" 30 "TOR_PlzTakeoverSystemNotSupportU-Turn" 31 "TOR_Reserved"  ;
VAL_ 403 ADC_ICAIconColor 0 "IconColor_None" 1 "IconColor_Gray" 2 "IconColor_Green" 3 "IconColor_Blue" 4 "IconClolor_Yellow" 5 "override flash_blue" 6 "TOR_Red"  ;
VAL_ 403 ADC_ICMPromptWarn 0 "None" 1 "On-ramp successful/in-main successful" 2 "NDA exit" 3 "ACC open" 4 "ACC/ICA fails to be enabled" 5 "ACC stop & go" 6 "ACC exit" 7 "ICA open" 8 "ICA exit" 9 "Level 1 distraction alert/Level 1 hand alert/Level 1 take-over alert" 10 "Second and third level distraction reminder/second and third level hand reminder/second and third level take-over reminder" 11 "Level 4 take-over alert/Level 5 take-over alert" 12 "/FCTA left alarm /FCTA right alarm /RCTA left alarm /RCTA right alarm /DOW left alarm /DOW right alarm /LDW left deviation alarm /LDW right deviation alarm" 13 "Active braking alarm/collision avoidance steering auxiliary alarm/automatic collision avoidance steering alarm /FCTB left alarm /FCTB right alarm /RCTB left alarm /RCTB right alarm /ELKA left deviation alarm /ELKA right deviation alarm" 14 "TSR speeding alarm" 15 "Intelligent driving fault prompt tone" 16 "Failed to enable the cruise function" 17 "NDA open" 18 "Please change lane manually" 19 "HWA failed" 20 "TJP open" 21 "TJP exit" 22 "TJP overspeed'" 23 "The same as '0xC' , should play the prompt sound until stop request" 24 "PMA alarms" 25 "PromptWarn1" 26 "PromptWarn2"  ;
VAL_ 403 ADC_ACUVoiceWarn 0 "Default value" 1 "Navigation Assistance has been activated for you" 2 "Prepare left lane change" 3 "Prepare right lane change" 4 "Wait for lane change" 5 "Lane changes have been canceled" 6 "Please make a hand change to the right" 7 "Please make a hand change to the left" 8 "Be about to diverge" 9 "Complete Diverging, please drive carefully" 10 "Be about to merge" 11 "After 1 km it will leave the navigation driving section" 12 "After 200 meters the function will exit please prepare to take over" 13 "After 100 meters the function wil exit please take over immediately" 14 "Navigational Assistance has ended" 15 "Driver assistance has ended" 16 "Complex road conditions, drive carefully" 17 "Construction section, please drive carefully" 18 "Lane change along the navigation to the right" 19 "Lane change to the left for overtaking" 20 "Lane change along navigation to the left" 21 "Lane change to the right for overtaking" 22 "Driver has controlled the speed" 23 "Driver has controlled the direction" 24 "Pay attention to the still flashing blinker" 25 "ACC has been actived" 26 "NDA has been downgraded to ICA" 27 "NDA has been activated" 28 "NDA has been downgraded to ACC" 29 "ICA has been Actived"  ;
VAL_ 403 ADC_NDAStateIcon 0 "NDAStateIcon_None" 1 "NDAStateIcon_PreActive" 2 "NDAStateIcon_Active" 3 "NDAStateIcon_Override" 4 "NDAStateIcon_TurnLeft" 5 "NDAStateIcon_TurnRight"  ;
VAL_ 403 ADC_ACCIconColor 0 "IconColor_None" 1 "IconColor_Gray" 2 "IconColor_Green" 3 "IconColor_Blue" 4 "IconClolor_Yellow" 5 "IconAction_Blue_Appear_Speed_limit_synchronized" 6 "TOR_flash"  ;
VAL_ 403 ADC_ICMADASFailureLamp 0 "Light Off" 1 "Light On" 2 "Reserved" 3 "Reserved"  ;
VAL_ 403 ADC_Pilot_VoiceWarn 0 "No display" 1 "TJP has been activated" 2 "TJP has ended" 3 "Complex road conditions, drive carefully" 4 "Construction section, please drive carefully" 5 "Complex road conditions, please take over the Vehicle"  ;
VAL_ 403 ADC_Pilot_PromptWarn 0 "None" 1 "TJP open" 2 "TJP Exit" 3 "TJP fails to be enabled"  ;
VAL_ 403 ADC_Pilot_WarnText 0 "No display" 1 "TJP driving does not meet the open condition" 2 "TJP driving could be activated in this section" 3 "TJP has exited" 4 "Complex road conditions, please take over the Vehicle"  ;
VAL_ 403 ADC_Pilot_WarnCardSt 0 "HORValue_None" 1 "HORValue_Level1" 2 "HORValue_Level2" 3 "HORValue_Level3" 4 "FORValue_Level1" 5 "FORValue_Level2" 6 "FORValue_Level3" 7 "TORValueLong_level1" 8 "TORValueLong_level2" 9 "TORValueLong_level3" 10 "TORValueLat_level1" 11 "TORValueLat_level2" 12 "TORValueLat_level3" 13 "TORValue_Stopping" 14 "TORValue_Stopped"  ;
VAL_ 403 NDA_Type 0 "Not Active" 1 "HNDA" 2 "CNDA" 3 "AI Driving" 4 "Full Scenario"  ;
VAL_ 403 ADAS_System_Failure_St 0 "No Failure" 1 "Main ADC Failure" 2 "Redundant ADC Failure" 3 "Driving Function ASW failure" 4 "Parking Function ASW failure" 5 "Active safety Function ASW failure" 6 "FOV120 camera Failure" 7 "FOV30 camera Failure" 8 "Left front camera Failure" 9 "Left rear camera Failure" 10 "Right front camera Failure" 11 "Right rear camera Failure" 12 "Rear camera Failure" 13 "Front AVM camera Failure" 14 "Left AVM camera Failure" 15 "Right AVM camera Failure" 16 "Rear AVM camera Failure" 17 "INU failure" 18 "Front Radar Failure" 19 "Left Front Radar Failure" 20 "Left Rear Radar Failure" 21 "Right Front Radar Failure" 22 "Right  Rear Radar Failure" 23 "Rear Radar Failure（" 24 "Front Lidar Failure" 25 "Left Lidar Failure" 26 "Right Lidar Failure" 27 "Rear Lidar Failure" 28 "USS failure" 29 "ADAS Map Failure"  ;
VAL_ 403 ADAS_Related_System_Failure_St 0 "No Failure" 1 "ESP failure" 2 "EPS failure" 3 "VCU and Relevate System Failure" 4 "EPB failure" 5 "CCU failure" 6 "PADS failure" 7 "IDC failure" 8 "SRS failure" 9 "SBM failure" 10 "DMS failure" 11 "Tbox failure" 12 "HOD failure" 13 "SD Map failure" 14 "Power System failure" 15 "ECS failure" 16 "Others"  ;
VAL_ 403 ADC_AdsFault 0 "no request" 1 "no fault" 2 "fault" 3 "reserved" 4 "reserved" 5 "reserved" 6 "reserved" 7 "Invalid"  ;
VAL_ 403 ADC_NicaReminderLEDVisual 0 "no request" 1 "turn on" 2 "turn off" 3 "reserved" 4 "reserved" 5 "reserved" 6 "reserved" 7 "Invalid"  ;
VAL_ 403 ADC_NicaReminderAcoustic 0 "no request" 1 "acoustic" 2 "no acoustic" 3 "torL1_acoustic" 4 "aeb_acoustic" 5 "reserved" 6 "reserved" 7 "Invalid"  ;
VAL_ 403 ADC_AdsTakeoverID 0 "no request"  ;
VAL_ 403 ADC_AdsTakeoverLevel 0 "no request" 1 "Level 1" 2 "Level 2" 3 "Level 3" 4 "Level 4" 5 "reserved" 6 "reserved" 7 "Invalid"  ;
VAL_ 403 ADC_TORIDCorrespErrorID 0 "no request"  ;
VAL_ 403 ADC_AdsFucntionNotActive 0 "no request" 1 "OFF" 2 "ACC" 3 "ICA" 4 "NCA" 5 "AVP" 6 "Autonomous Driving" 7 "Reserved" 8 "Reserved" 9 "Reserved" 10 "Reserved" 11 "Reserved" 12 "Reserved" 13 "Reserved" 14 "Reserved" 15 "Invalid"  ;
VAL_ 403 ADC_AvpFunctionStatus 0 "no request" 1 "AVP_STATE_OFF" 2 "AVP_STATE_STANDBY" 3 "AVP_STATE_LOGITUDINALOVERRIDE" 4 "AVP_STATE_ACTIVE" 5 "Reserved" 6 "Reserved" 7 "Reserved" 8 "Reserved" 9 "Reserved" 10 "Reserved" 11 "Reserved" 12 "Reserved" 13 "Reserved" 14 "Reserved" 15 "Reserved" 16 "Reserved" 17 "Reserved" 18 "Reserved" 19 "Reserved" 20 "Reserved" 21 "Reserved" 22 "Reserved" 23 "Reserved" 24 "Reserved" 25 "Reserved" 26 "Reserved" 27 "Reserved" 28 "Reserved" 29 "Reserved" 30 "Reserved" 31 "Invalid"  ;
VAL_ 403 ADC_CalibState 0 "no request" 1 "off" 2 "on" 3 "reserved" 4 "reserved" 5 "reserved" 6 "reserved"  ;
VAL_ 403 ADC_AccFunctionStatus 0 "No request" 1 "ACC_OFF" 2 "ACC_STANDBY" 3 "ACC_OVERRIDE" 4 "ACC_ACTIVE" 5 "ACC_STANDSTILL" 6 "Reserved" 7 "Reserved" 8 "Reserved" 9 "Reserved" 10 "Reserved" 11 "Reserved" 12 "Reserved" 13 "Reserved" 14 "Reserved" 15 "Invalid"  ;
VAL_ 403 ADC_NicaFunctionStatus 0 "no request" 1 "OFF" 2 "ICA_STANDBY" 3 "ICA_LATERAL_OVERRIDE" 4 "ICA_LONGITUDINAL_OVERRIDE" 5 "ICA_LAT_LONG_OVERRIDE" 6 "ICA_ACTIVE" 7 "NCA_STANDBY" 8 "NCA_LATERAL_OVERRIDE" 9 "NCA_LONGITUDINAL_OVERRIDE" 10 "NCA_LAT_LONG_OVERRIDE" 11 "NCA_ACTIVE" 12 "Reserved" 13 "Reserved" 14 "Reserved" 15 "Reserved" 16 "Reserved" 17 "Reserved" 18 "Reserved" 19 "Reserved" 20 "Reserved" 21 "Reserved" 22 "Reserved" 23 "Reserved" 24 "Reserved" 25 "Reserved" 26 "Reserved" 27 "Reserved" 28 "Reserved" 29 "Reserved" 30 "Reserved" 31 "Reserved" 32 "Reserved" 33 "Reserved" 34 "Reserved" 35 "Reserved" 36 "Reserved" 37 "Reserved" 38 "Reserved" 39 "Reserved" 40 "Reserved" 41 "Reserved" 42 "Reserved" 43 "Reserved" 44 "Reserved" 45 "Reserved" 46 "Reserved" 47 "Reserved" 48 "Reserved" 49 "Reserved" 50 "Reserved" 51 "Reserved" 52 "Reserved" 53 "Reserved" 54 "Reserved" 55 "Reserved" 56 "Reserved" 57 "Reserved" 58 "Reserved" 59 "Reserved" 60 "Reserved" 61 "Reserved" 62 "Reserved" 63 "Invalid"  ;
VAL_ 403 ADC_AEBWaning 0 "no request" 1 "Off" 2 "Active" 3 "IBA" 4 "Hold" 5 "Inactive (standby)" 6 "Nolicense" 7 "Reserved" 8 "Reserved" 9 "Reserved" 10 "Reserved" 11 "Reserved" 12 "Reserved" 13 "Reserved" 14 "Reserved" 15 "Invalid"  ;
VAL_ 403 ADC_LKAWarning 0 "no request" 1 "Off" 2 "Standby" 3 "Ready" 4 "Active_Left" 5 "Active_Right" 6 "Switchoff" 7 "Invalid"  ;
VAL_ 403 ADC_LCCStateIcon 0 "LCCStateIcon_None" 1 "LCCStateIcon_PreActive" 2 "LCCStateIcon_Active" 3 "LCCStateIcon_Override" 4 "LCCStateIcon_TurnLeft" 5 "LCCStateIcon_TurnRight" 6 "LCCStateIcon_1" 7 "LCCStateIcon_2"  ;
VAL_ 411 ADC_FCWAssistType 0 "Warning and brake" 1 "Warning only" 2 "Off" 3 "Not used"  ;
VAL_ 411 ADC_FCWFaultSt 0 "Not fault" 1 "Fault"  ;
VAL_ 411 ADC_FCWPreWarn 0 "No warning" 1 "Warning" 2 "Not used" 3 "Not used"  ;
VAL_ 411 ADC_FCWLatentWarn 0 "No warning" 1 "Warning" 2 "Not used" 3 "Not used"  ;
VAL_ 411 ADC_FCWWarmDistance 0 "Normal" 1 "Close" 2 "Far" 3 "Off"  ;
VAL_ 411 ADC_AEBTarObjType 0 "Not dectected" 1 "Car" 2 "Pedestrian" 3 "Two wheels" 4 "Motorcycle" 5 "Truck" 6 "Unknown"  ;
VAL_ 411 ADC_BSDVibrWarnR 0 "No Request" 1 "Slightly" 2 "General" 3 "Urgent" 4 "No Warning"  ;
VAL_ 411 ADC_BSDVibrWarnL 0 "No Request" 1 "Slightly" 2 "General" 3 "Urgent" 4 "No Warning"  ;
VAL_ 411 ADC_AEBBrkPedalOverRide 0 "False" 1 "True"  ;
VAL_ 411 ADC_AEBBrePedalPressure 0 "False" 1 "True"  ;
VAL_ 411 ADC_AEBAccelePedalOverRide 0 "False" 1 "True"  ;
VAL_ 411 ADC_AEBSteeringInhibit 0 "False" 1 "True"  ;
VAL_ 411 ADC_PMAEnableSt 0 "off" 1 "on"  ;
VAL_ 411 ADC_PMAWarStatus 0 "No warning" 1 "Warning"  ;
VAL_ 411 ADC_AEBTarOncomingState 0 "Not Oncoming" 1 "Oncoming"  ;
VAL_ 411 ADC_AEBTarMotionState 0 "Not dectected" 1 "stationary" 2 "moving"  ;
VAL_ 411 ADC_AEBTarConfiLevel 0 "NoLevel" 1 "Low_1[0~0.4]" 2 "Low_1[0.4~0.5]" 3 "Mid_1 [0.5~0.6]" 4 "Mid_2 [0.6~0.7]" 5 "High_1 [0.7~0.8]" 6 "High_2 [0.8~0.9]" 7 "High_3 [0.9~1.0]"  ;
VAL_ 411 ADC_DOWAudioWarnFR 0 "No Warning" 1 "Warning_Lv2" 2 "Warning_Lv1" 3 "Reserved"  ;
VAL_ 411 ADC_DOWAudioWarnFL 0 "No Warning" 1 "Warning_Lv2" 2 "Warning_Lv1" 3 "Reserved"  ;
VAL_ 411 ADC_DOWAudioWarnRR 0 "No Warning" 1 "Warning_Lv2" 2 "Warning_Lv1" 3 "Reserved"  ;
VAL_ 411 ADC_DOWAudioWarnRL 0 "No Warning" 1 "Warning_Lv2" 2 "Warning_Lv1" 3 "Reserved"  ;
VAL_ 411 ADC_DOWIALWarnFR 0 "No Request" 1 "Warning level 1" 2 "Warning level 2" 3 "No Warning"  ;
VAL_ 411 ADC_DOWIALWarnFL 0 "No Request" 1 "Warning level 1" 2 "Warning level 2" 3 "No Warning"  ;
VAL_ 411 ADC_DOWIALWarnRR 0 "No Request" 1 "Warning level 1" 2 "Warning level 2" 3 "No Warning"  ;
VAL_ 411 ADC_DOWIALWarnRL 0 "No Request" 1 "Warning level 1" 2 "Warning level 2" 3 "No Warning"  ;
VAL_ 411 ADC_BSDExMirLedWarnR 0 "No Request" 1 "Continue ON（Warning level 1）" 2 "Flashing（Warning level 2）" 3 "OFF"  ;
VAL_ 411 ADC_BSDExMirLedWarnL 0 "No Request" 1 "Continue ON（Warning level 1）" 2 "Flashing（Warning level 2）" 3 "OFF"  ;
VAL_ 411 ADC_BSDLCASt 0 "OFF" 1 "Passive" 2 "Active" 3 "Failure"  ;
VAL_ 411 ADC_BSDLCAEnableSt 0 "Off" 1 "ON"  ;
VAL_ 411 ADC_RCTAEnableSt 0 "Off" 1 "ON"  ;
VAL_ 411 ADC_RCTASt 0 "OFF" 1 "Passive" 2 "Active" 3 "Failure"  ;
VAL_ 411 ADC_RCTAAssistType 0 "OFF" 1 "fail" 2 "Warning" 3 "brake and Warning"  ;
VAL_ 411 ADC_DOWSt 0 "OFF" 1 "Passive" 2 "Active" 3 "Failure"  ;
VAL_ 411 ADC_DOWEnableSt 0 "Off" 1 "ON"  ;
VAL_ 411 ADC_LCAWarnLeft 0 "No warning" 1 "Warning level 1" 2 "Warning level 2" 3 "Not used"  ;
VAL_ 411 ADC_LCAWarnRight 0 "No warning" 1 "Warning level 1" 2 "Warning level 2" 3 "Not used"  ;
VAL_ 411 ADC_RCTAWarnLeft 0 "No_Warning" 1 "Warning_level1_RCTA" 2 "Warning_level2_RCTB" 3 "Warning_level2_RCTA"  ;
VAL_ 411 ADC_RCWEnableSt 0 "Off" 1 "ON"  ;
VAL_ 411 ADC_RCTAWarnRight 0 "No_Warning" 1 "Warning_level1_RCTA" 2 "Warning_level2_RCTB" 3 "Warning_level2_RCTA"  ;
VAL_ 411 ADC_RCWSt 0 "Off" 1 "Passive/On/Inactive" 2 "Active" 3 "Failure"  ;
VAL_ 411 ADC_RCWWarn 0 "No warning" 1 "Warning level 1" 2 "Warning level 2" 3 "Not used"  ;
VAL_ 411 ADC_FCTAEnableSt 0 "Off" 1 "ON"  ;
VAL_ 411 ADC_FCTASt 0 "Off" 1 "Passive/On/Inactive" 2 "Active" 3 "failure"  ;
VAL_ 411 ADC_FCTAAssistType 0 "No Selected" 1 "Failure" 2 "Warning" 3 "brake and Warning"  ;
VAL_ 411 ADC_FCTAWarnL 0 "No_Warning" 1 "Warning_level1_FCTA" 2 "Warning_level2_FCTB" 3 "Warning_level2_FCTA"  ;
VAL_ 411 ADC_FCTAWarnR 0 "No_Warning" 1 "Warning_level1_FCTA" 2 "Warning_level2_FCTB" 3 "Warning_level2_FCTA"  ;
VAL_ 411 ADC_FroNestTarDetSensor 0 "Invalid" 1 "Radar only" 2 "Vision only" 3 "Radar+Vision" 4 "Lidar only" 5 "Lidar+Radar" 6 "Lidar+Vision" 7 "Lidar+Radar+Vision" 8 "Reserve" 9 "Reserve" 10 "Reserve" 11 "Reserve" 12 "Reserve" 13 "Reserve" 14 "Reserve" 15 "Reserve"  ;
VAL_ 411 ADC_FroNestTarObjType 0 "Not dectected" 1 "Car" 2 "Pedestrian" 3 "Two wheels" 4 "Motorcycle" 5 "Truck" 6 "Unknown"  ;
VAL_ 411 ADC_LDS_LaneAssistType 0 "Disable" 1 "Steering" 2 "Warning" 3 "Steering and Warning"  ;
VAL_ 411 ADC_IHBC_EnableSt 0 "Disable" 1 "Enable"  ;
VAL_ 411 ADC_ELK_EnableSt 0 "Disable" 1 "Enable"  ;
VAL_ 411 ADC_ESA_EnableSt 0 "Disable" 1 "Enable"  ;
VAL_ 411 ADC_AES_EnableSt 0 "Disable" 1 "Enable"  ;
VAL_ 411 ADC_LDWSt 0 "LDW disable" 1 "LDW passive" 2 "LDW standby" 3 "LDW active" 4 "LDW failure no light" 5 "LDW failure light" 6 "Not used" 7 "Not used"  ;
VAL_ 411 ADC_LDW_Actdirection 0 "not active" 1 "left" 2 "right" 3 "Not used"  ;
VAL_ 411 ADC_LDP_Actdirection 0 "not active" 1 "left" 2 "right" 3 "Not used"  ;
VAL_ 411 ADC_LDW_PassiveReason 0 "No Function passive state" 1 "Lane Missing" 2 "Vehicle speed too high" 3 "Vehicle speed too low" 4 "Lane too wide" 5 "Lane too narrow" 6 "Excessive curvature" 7 "High priority function is triggered" 8 "Sensor Blocked" 9 "Turn lamp light" 10 "Braking" 11 "Steering AngleSpd too high" 12 "Driver Steerin Torque too high" 13 "Hazard lamp light" 14 "Ride line" 15 "Step on the accelerator quickly" 16 "Yaw rate too high" 17 "Alarm timeout" 18 "Lane merging" 19 "ABS or ESP active" 20 "Others"  ;
VAL_ 411 ADC_LDPSt 0 "LDP disable" 1 "LDP passive" 2 "LDP standby" 3 "LDP active" 4 "LDP failure no light" 5 "LDP failure light" 6 "Not used" 7 "Not used"  ;
VAL_ 411 ADC_LDP_PassiveReason 0 "NO Function passive state" 1 "Lane Missing" 2 "Vehicle speed too high" 3 "Vehicle speed too low" 4 "Lane too wide" 5 "Lane too narrow" 6 "Excessive curvature" 7 "High priority function active" 8 "Sensor Blocked" 9 "Turn lamp light" 10 "Braking" 11 "Steering AngleSpd too high" 12 "Driver Steerin Torque too high" 13 "Hazard lamp light" 14 "Ride line" 15 "Step on the accelerator quickly" 16 "Yaw rate too high" 17 "Alarm timeout" 19 "ABS or ESP active" 20 ":hands off too long" 21 "Others"  ;
VAL_ 411 ADC_RDP_St 0 "RDP disable" 1 "RDP passive" 2 "RDP standby" 3 "RDP active" 4 "RDP failure no light" 5 "RDP failure light" 6 "Not used" 7 "Not used"  ;
VAL_ 411 ADC_RDP_PassiveReason 0 "NO Function passive state" 1 "Lane Missing" 2 "Vehicle speed too high" 3 "Vehicle speed too low" 4 "Lane too wide" 5 "Lane too narrow" 6 "Excessive curvature" 7 "High priority function active" 8 "Sensor Blocked" 9 "Turn lamp light" 10 "Braking" 11 "Steering AngleSpd too high" 12 "Driver Steerin Torque too high" 13 "Hazard lamp light" 14 "Ride line" 15 "Step on the accelerator quickly" 16 "Yaw rate too high" 17 "Alarm timeout" 19 "ABS or ESP active" 20 ":hands off too long" 21 "Others"  ;
VAL_ 411 ADC_IHBC_St 0 "IHBC disable" 1 "IHBC passive" 2 "IHBC standby" 3 "IHBC active" 4 "IHBC failure" 5 "Not Used" 6 "Not Used" 7 "Not Used"  ;
VAL_ 411 ADC_RDP_Actdirection 0 "not active" 1 "left" 2 "right" 3 "Not used"  ;
VAL_ 411 ADC_FCMS_SwitchLockReq 0 "No_locked_ESP" 1 "Locked_ESP" 0 "No_locked_Speed" 1 "Locked_Speed"  ;
VAL_ 411 ADC_LKSLaneAssistSensitivity 0 "Not_Selected" 1 "Medium" 2 "Low" 3 "High" 4 "Failure" 5 "UserDefined"  ;
VAL_ 411 ADC_IHBC_SuppressSt 0 "No" 1 "Suppress transition" 2 "Suppress High beam" 3 "Not used"  ;
VAL_ 411 ADC_IHBC_SuppressReason 0 "No" 1 "yawrate" 2 "Steering angle rate" 3 "Lateral Acceleration" 4 "Turn light active" 5 "ABS Active" 6 "High Beam shortest active duation" 7 "Spped too low" 8 "Fog Light Active" 9 "Windsreen Wiper fast" 10 "Illumination Intensity" 11 "Oncoming Vehicle" 12 "Following vehicle" 13 "Camera Blockage" 14 "Partner ECU Failure" 15 "System Failure" 16 "Other Traffic Particapant" 17 "Not Used" 18 "Not Used" 19 "Not Used" 20 "Not Used" 21 "Not Used" 22 "Not Used" 23 "Not Used" 24 "Not Used" 25 "Not Used" 26 "Not Used" 27 "Not Used" 28 "Not Used" 29 "Not Used" 30 "Not Used" 31 "Not Used"  ;
VAL_ 411 ADC_IHBC_TargetType 0 "NO" 1 "pedestrian" 2 "car" 3 "not used"  ;
VAL_ 411 ADC_TSR_SpdLimType 0 "not specific" 1 "Camera detection" 2 "Interval speed detection" 3 "Not used"  ;
VAL_ 411 ADC_TSR_SpeedLimitSource 0 "No" 1 "Video only" 2 "Navi only" 3 "Map only" 4 "Video+Navi" 5 "Video+Map" 6 "Navi+Map" 7 "Video+Navi+Map"  ;
VAL_ 411 ADC_ELKoncomingSt 0 "ELKoncoming disable" 1 "ELKoncoming passive" 2 "ELKoncoming standby" 3 "ELKoncoming active" 4 "ELKoncoming failure no light" 5 "ELKoncoming failure light" 6 "Not used" 7 "Not used"  ;
VAL_ 411 ADC_ELKoncoming_PassiveReason 0 "NO Function passive state" 1 "Lane Missing" 2 "Vehicle speed too high" 3 "Vehicle speed too low" 4 "Lane too wide" 5 "Lane too narrow" 6 "Excessive curvature" 7 "High priority function active" 8 "Sensor Blocked" 9 "Turn lamp light" 10 "Braking" 11 "Steering AngleSpd too high" 12 "Driver Steerin Torque too high" 13 "Hazard lamp light" 14 "Ride line" 15 "Step on the accelerator quickly" 16 "Yaw rate too high" 17 "Alarm timeout" 18 "Lane merging" 19 "ABS or ESP active" 20 "hands off too long" 21 "Others"  ;
VAL_ 411 ADC_ELKoncoming_Actdirection 0 "not active" 1 "left" 2 "right" 3 "Not used"  ;
VAL_ 411 ADC_ELKovertakingSt 0 "ELKovertaking disable" 1 "ELKovertaking passive" 2 "ELKovertaking standby" 3 "ELKovertaking active" 4 "ELKovertaking failure no light" 5 "ELKovertaking failure light" 6 "Not used" 7 "Not used"  ;
VAL_ 411 ADC_ELKovertaking_ActDirection 0 "not active" 1 "left" 2 "right" 3 "Not used"  ;
VAL_ 411 ADC_ELKovertaking_PassiveReason 0 "NO Function passive state" 1 "Lane Missing" 2 "Vehicle speed too high" 3 "Vehicle speed too low" 4 "Lane too wide" 5 "Lane too narrow" 6 "Excessive curvature" 7 "High priority function active" 8 "Sensor Blocked" 9 "Turn lamp light" 10 "Braking" 11 "Steering AngleSpd too high" 12 "Driver Steerin Torque too high" 13 "Hazard lamp light" 14 "Ride line" 15 "Step on the accelerator quickly" 16 "Yaw rate too high" 17 "Alarm timeout" 18 "Lane merging" 19 "ABS or ESP active" 20 "hands off too long" 21 "Others"  ;
VAL_ 411 ADC_ELK_TargetObjClass 0 "Underdetemined" 1 "Car" 2 "motorcycle" 3 "Truck" 4 "bicycle" 5 "Not used" 6 "Not used" 7 "Not used"  ;
VAL_ 411 ADC_ESA_St 0 "ESA?disable" 1 "ESA?passive" 2 "ESA?standby" 3 "ESA?active" 4 "ESA?failure" 5 "No?License" 6 "Finish" 7 "Invalid"  ;
VAL_ 411 ADC_ESA_ActDirection 0 "not active" 1 "left" 2 "right" 3 "Not used"  ;
VAL_ 411 ADC_AES_St 0 "AES?disable" 1 "AES?passive" 2 "AES?standby" 3 "AES?active" 4 "AES?failure" 5 "No?License" 6 "Finish" 7 "Invalid"  ;
VAL_ 411 ADC_AES_ActDirection 0 "not active" 1 "left" 2 "right" 3 "Not used"  ;
VAL_ 411 ADC_ESA_TargetObjClass 0 "Underdetemined" 1 "Car" 2 "motorcycle" 3 "Truck" 4 "bicycle" 5 "pedestrian" 6 "obstacle" 7 "Not used"  ;
VAL_ 411 ADC_ESA_PassiveReason 0 "NO passive reason" 1 "Lane Missing" 2 "Vehicle speed too high" 3 "Vehicle speed too low" 4 "Lane too wide" 5 "Lane too narrow" 6 "Excessive curvature" 7 "High priority function active" 8 "Sensor Blocked" 9 "Turn lamp light" 10 "Braking" 11 "Steering AngleSpd too high" 12 "Driver Steerin Torque too high" 13 "Hazard lamp light" 14 "Ride line" 15 "Step on the accelerator quickly" 16 "Yaw rate too high" 17 "Alarm timeout" 18 "Lane merging" 19 "ABS or ESP active" 20 "hands off too long" 21 "NO gap space" 22 "Others"  ;
VAL_ 411 ADC_AES_TargetObjClass 0 "Underdetemined" 1 "Car" 2 "motorcycle" 3 "Truck" 4 "bicycle" 5 "pedestrian" 6 "obstacle" 7 "Not used"  ;
VAL_ 411 ADC_AES_PassiveReason 0 "NO passive reason" 1 "Lane Missing" 2 "Vehicle speed too high" 3 "Vehicle speed too low" 4 "Lane too wide" 5 "Lane too narrow" 6 "Excessive curvature" 7 "High priority function active" 8 "Sensor Blocked" 9 "Turn lamp light" 10 "Braking" 11 "Steering AngleSpd too high" 12 "Driver Steerin Torque too high" 13 "Hazard lamp light" 14 "Ride line" 15 "Step on the accelerator quickly" 16 "Yaw rate too high" 17 "Alarm timeout" 18 "Lane merging" 19 "ABS or ESP active" 20 "hands off too long" 21 "NO gap space" 22 "Others"  ;
VAL_ 411 ADC_L1_LatfaultReason 0 "NO Function fault state" 1 "Sensor Failure" 2 "ADC Failure" 3 "ZCU failure or BCM  Failure" 4 "CCU failure" 5 "SRS failure" 6 "EPS failure" 7 "EBB failure" 8 ":ESC failure" 9 "VCU and relevate system failure" 10 "IDU failure" 11 "A-CAN? failure" 12 "P-CAN failure" 13 "I-CAN failure" 14 "Power abnormal" 15 "others"  ;
VAL_ 411 ADC_LDSIconColor 0 "IconColor_None" 1 "IconColor_Grey" 2 "IconColor_White" 3 "IconColor_Green" 4 "IconColor_Blue" 5 "IconClolor_Yellow" 6 "override flash_blue" 7 "IconColor_Yellow_Off"  ;
VAL_ 411 ADC_LOCP_St 0 "LOCP?disable" 1 "LOCP?passive" 2 "LOCP?standby" 3 "LOCP?active" 4 "LOCP?failure" 5 "No?License" 6 "Finish" 7 "Invalid"  ;
