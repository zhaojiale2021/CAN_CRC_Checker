VERSION "Version"

NS_ :

BS_:

BU_: Tester CCU ADC CCU_CCURT1 CCU_CCURT2 RLR RRR ZCUF ZCUL ZCUR ZCUT EMS IDM DCDC IPS NIDU NIDUF DCUR OBC OPC LPC CPC EMCM GCU DCUF IPU BMS EOPF EOPR EVCC DCDC2 EDL SRS ECS EPS EPB RBM IBCS ICM IID IDC PHUDD AMP WHUD IMR INU IFC FAPA PAS PCS SCMR SCMRL SCMRR HVSMR SCMRM MFS WSM DRM IDU FCP LBMSAD AVAS ATSS DLPFL FBLCM FLISD FLLCM FRLCM RLLCMA RLLCMB RRLCMA RRLCMB RLISD DLPML DLPMR TRM PSDL PSDR HVSPRL HVSPRR RFR SBM WCM ETC TBOX2 TBOX IDUR CBM PLGM TMC LPC2 SCMT RCP RRISD LBMS RLBMS CCURT1 CCURT2 RT1_C1 RT2_C3 RT1_C0 OTAWL RAS EBB RCICP WCMFR WCMRL SAS CD

BO_ 431 CCU_VCU_8: 64 CCU_CCURT1
 SG_ VCU_TargetRecpTorqVD : 132|1@0+ (1,0) [0|1] ""  IBCS,ADC,IFC,FAPA
 SG_ VCU_AccDriverOrvd : 150|1@0+ (1,0) [0|1] ""  ADC,IFC,FAPA
 SG_ VCU_AccDriverOrvdVD : 154|1@0+ (1,0) [0|1] ""  IBCS,ADC
 SG_ VCU_TargetRecpTorq : 423|14@0+ (1,0) [0|16000] "Nm"  IBCS,ADC,IFC,FAPA
 SG_ VCU_TargetRecpTorqFA : 153|14@0+ (1,0) [0|16000] "Nm"  IBCS,ADC,IFC,FAPA
 SG_ VCU_TargetRecpTorqRA : 171|14@0+ (1,0) [0|16000] "Nm"  IBCS,ADC,IFC,FAPA
 SG_ VCU_TorqDriverReqFA : 189|14@0+ (1,0) [0|16000] "Nm"  ECS,IBCS,ADC,IFC,FAPA
 SG_ VCU_TorqDriverReqRA : 207|14@0+ (1,0) [0|16000] "Nm"  ECS,IBCS,ADC,IFC,FAPA
 SG_ VCU_VehActDrvTorqFA : 209|14@0+ (1,0) [0|16000] "Nm"  ECS,EPS,IBCS,IDC,ADC,IFC,FAPA
 SG_ VCU_VehActDrvTorqRA : 227|14@0+ (1,0) [0|16000] "Nm"  IDM,ECS,EPS,IBCS,IDC,ADC,IFC,FAPA
 SG_ VCU_TargetRecpTorqFAVD : 104|1@0+ (1,0) [0|1] ""  IBCS,ADC,IFC,FAPA
 SG_ VCU_TargetRecpTorqRAVD : 105|1@0+ (1,0) [0|1] ""  IBCS,ADC,IFC,FAPA
 SG_ VCU_TorqDriverReqFAVD : 128|1@0+ (1,0) [0|1] ""  ECS,IBCS,ADC,IFC,FAPA
 SG_ VCU_TorqDriverReqRAVD : 129|1@0+ (1,0) [0|1] ""  ECS,IBCS,ADC,IFC,FAPA
 SG_ VCU_VehActDrvTorqFAVD : 244|1@0+ (1,0) [0|1] ""  ECS,EPS,IBCS,ADC,IFC,FAPA
 SG_ VCU_VehActDrvTorqRAVD : 245|1@0+ (1,0) [0|1] ""  IDM,ECS,EPS,IBCS,ADC,IFC,FAPA
 SG_ VCU_BcsDecelReq : 243|4@0+ (0.066,-0.99) [-0.99|0] "m/s2"  IBCS,ADC,IFC,FAPA
 SG_ VCU_BcsDecelVD : 255|1@0+ (1,0) [0|1] ""  IBCS,ADC,IFC,FAPA
 SG_ VCU_RecpTorqRL : 261|14@0+ (1,0) [0|16000] ""  IBCS,ADC,FAPA
 SG_ VCU_RecpTorqRLVD : 262|1@0+ (1,0) [0|1] ""  IBCS,ADC,FAPA
 SG_ VCU_RecpTorqRR : 277|14@0+ (1,0) [0|16000] ""  IBCS,ADC,FAPA
 SG_ VCU_RecpTorqRRVD : 278|1@0+ (1,0) [0|1] ""  IBCS,ADC,FAPA
 SG_ VCU_ADSNetErrorFb : 159|3@0+ (1,0) [0|7] ""  ADC,IFC,FAPA
 SG_ VCU_NetModeResp : 156|2@0+ (1,0) [0|3] ""  ADC,FAPA
 SG_ VCU_PwrLimDrv_kW : 322|11@0+ (1,-1024) [-1024|1023] "kW"  ADC
 SG_ VCU_PwrLimRegen_kW : 343|11@0+ (1,-1024) [-1024|1023] "kW"  ADC
 SG_ VCU_PwrLimDrv_kWVD : 346|1@0+ (1,0) [0|1] ""  ADC
 SG_ VCU_PwrLimRegen_kWVD : 347|1@0+ (1,0) [0|1] ""  ADC
 SG_ VCU_PtTqActvStsFL : 348|1@0+ (1,0) [0|1] ""  ADC
 SG_ VCU_PtTqActvStsFR : 441|1@0+ (1,0) [0|1] ""  ADC
 SG_ VCU_PtTqActvStsRL : 442|1@0+ (1,0) [0|1] ""  ADC
 SG_ VCU_PtTqActvStsRR : 443|1@0+ (1,0) [0|1] ""  ADC

BO_ 615 CCU_BCS_1_C: 64 CCU
 SG_ BCS_1_CRC : 7|16@0+ (1,0) [0|65535] ""  ZCUF,ZCUL,ZCUR,ZCUT,IPU,ICM,IDC,INU,ADC,IFC,FAPA,RRR,RLR,TBOX
 SG_ BCS_1_Counter : 23|8@0+ (1,0) [0|255] ""  ZCUF,ZCUL,ZCUR,ZCUT,IPU,ICM,IDC,INU,ADC,IFC,FAPA,RRR,RLR,TBOX
 SG_ BCS_FLWheelSpd : 31|13@0+ (0.05625,0) [0|240] "km/h"  ZCUF,ZCUL,ZCUR,ZCUT,EMS,IPU,IDC,INU,ADC,IFC,FAPA,RRR,RLR,PCS,TBOX
 SG_ BCS_FLWheelSpdVD : 34|1@0+ (1,0) [0|1] ""  ZCUF,ZCUL,ZCUR,ZCUT,EMS,IPU,IDC,INU,ADC,IFC,FAPA,RRR,RLR,PCS,TBOX
 SG_ BCS_FLWheelRotatedDirectionVD : 32|1@0+ (1,0) [0|1] ""  IPU,INU,ADC,IFC,FAPA,RRR,RLR,PCS
 SG_ BCS_FRWheelSpd : 47|13@0+ (0.05625,0) [0|240] "km/h"  ZCUF,ZCUL,ZCUR,ZCUT,EMS,IPU,IDC,INU,ADC,IFC,FAPA,RRR,RLR,PCS,TBOX
 SG_ BCS_FRWheelSpdVD : 50|1@0+ (1,0) [0|1] ""  ZCUF,ZCUL,ZCUR,ZCUT,EMS,IPU,IDC,INU,ADC,IFC,FAPA,RRR,RLR,PCS,TBOX
 SG_ BCS_FRWheelRotatedDirectionVD : 48|1@0+ (1,0) [0|1] ""  IPU,INU,ADC,IFC,FAPA,RRR,RLR,PCS
 SG_ BCS_RLWheelSpd : 63|13@0+ (0.05625,0) [0|240] "km/h"  ZCUF,ZCUL,ZCUR,ZCUT,EMS,IDC,INU,ADC,IFC,FAPA,RRR,RLR,PCS,TBOX
 SG_ BCS_RLWheelSpdVD : 66|1@0+ (1,0) [0|1] ""  ZCUF,ZCUL,ZCUR,ZCUT,EMS,IDC,INU,ADC,IFC,FAPA,RRR,RLR,PCS,TBOX
 SG_ BCS_RLWheelRotatedDirectionVD : 64|1@0+ (1,0) [0|1] ""  INU,ADC,IFC,FAPA,RRR,RLR,PCS
 SG_ BCS_RRWheelSpd : 79|13@0+ (0.05625,0) [0|240] "km/h"  ZCUF,ZCUL,ZCUR,ZCUT,EMS,IDC,INU,ADC,IFC,FAPA,RRR,RLR,PCS,TBOX
 SG_ BCS_RRWheelSpdVD : 82|1@0+ (1,0) [0|1] ""  ZCUF,ZCUL,ZCUR,ZCUT,EMS,IDC,INU,ADC,IFC,FAPA,RRR,RLR,PCS,TBOX
 SG_ BCS_RRWheelRotatedDirectionVD : 80|1@0+ (1,0) [0|1] ""  INU,ADC,IFC,FAPA,RRR,RLR,PCS
 SG_ BCS_HHCCtrlSt : 95|1@0+ (1,0) [0|1] ""  EMS,ADC,IFC,FAPA
 SG_ BCS_HDCCtrlSt : 93|2@0+ (1,0) [0|3] ""  ICM,IID,IDC,ADC,IFC,FAPA,TBOX
 SG_ BCS_HDCErrSt : 91|1@0+ (1,0) [0|1] ""  ICM,IID,IDC,PHUDD,ADC,IFC,FAPA,TBOX
 SG_ BCS_FLWheelSpdEdgesSum : 103|12@0+ (1,0) [0|4095] ""  ZCUF,ZCUL,ZCUR,ZCUT,ICM,IID,IDC,PHUDD,ADC,IFC,FAPA,RRR,RLR,PCS,WSM,TBOX
 SG_ BCS_FRWheelSpdEdgesSum : 107|12@0+ (1,0) [0|4095] ""  ZCUF,ZCUL,ZCUR,ZCUT,IID,IDC,PHUDD,ADC,IFC,FAPA,RRR,RLR,PCS,WSM,TBOX
 SG_ BCS_RLWheelSpdEdgesSum : 127|12@0+ (1,0) [0|4095] ""  ZCUF,ZCUL,ZCUR,ZCUT,ICM,IID,IDC,PHUDD,ADC,IFC,FAPA,RRR,RLR,PCS,WSM,TBOX
 SG_ BCS_RRWheelSpdEdgesSum : 131|12@0+ (1,0) [0|4095] ""  ZCUF,ZCUL,ZCUR,ZCUT,IID,IDC,PHUDD,ADC,IFC,FAPA,RRR,RLR,PCS,WSM,TBOX
 SG_ BCS_FLWheelSpdEdgesSumVD : 151|1@0+ (1,0) [0|1] ""  ZCUF,ZCUL,ZCUR,ZCUT,ICM,IID,IDC,PHUDD,ADC,IFC,FAPA,RRR,RLR,PCS,WSM,TBOX
 SG_ BCS_FRWheelSpdEdgesSumVD : 150|1@0+ (1,0) [0|1] ""  ZCUF,ZCUL,ZCUR,ZCUT,ADC,IFC,FAPA,RRR,RLR,PCS,WSM
 SG_ BCS_RLWheelSpdEdgesSumVD : 149|1@0+ (1,0) [0|1] ""  ZCUF,ZCUL,ZCUR,ZCUT,ICM,IID,IDC,PHUDD,ADC,IFC,FAPA,RRR,RLR,PCS,WSM,TBOX
 SG_ BCS_RRWheelSpdEdgesSumVD : 148|1@0+ (1,0) [0|1] ""  ZCUF,ZCUL,ZCUR,ZCUT,ADC,IFC,FAPA,RRR,RLR,PCS,WSM
 SG_ BCS_FLWheelRotatedDirection : 147|2@0+ (1,0) [0|3] ""  IPU,ADC,IFC,FAPA,PAS,WSM
 SG_ BCS_FRWheelRotatedDirection : 145|2@0+ (1,0) [0|3] ""  IPU,ADC,IFC,FAPA,PAS,WSM
 SG_ BCS_RLWheelRotatedDirection : 159|2@0+ (1,0) [0|3] ""  ADC,IFC,FAPA,PAS,WSM
 SG_ BCS_RRWheelRotatedDirection : 157|2@0+ (1,0) [0|3] ""  ADC,IFC,FAPA,PAS,WSM
 SG_ BCS_ParkingReqToEPB : 155|2@0+ (1,0) [0|3] ""  ZCUF,ZCUL,ZCUR,ZCUT,ADC,FAPA
 SG_ BCS_VDCOff : 153|1@0+ (1,0) [0|1] ""  ICM,IID,IDC,PHUDD,ADC,IFC,FAPA,TBOX
 SG_ BCS_AVHSt : 152|1@0+ (1,0) [0|1] ""  ZCUF,ZCUL,ZCUR,ZCUT,ICM,IID,IDC,PHUDD,ADC,IFC,FAPA,FLISD,RLISD,RRISD,TBOX
 SG_ BCS_AVHAvailable : 166|1@0+ (1,0) [0|1] ""  ZCUF,ZCUL,ZCUR,ZCUT,ICM,IDC,ADC,IFC,FAPA,TBOX
 SG_ BCS_TCSOff : 165|1@0+ (1,0) [0|1] ""  ICM,IID,IDC,PHUDD,ADC,IFC,FAPA,RRR,RLR,TBOX
 SG_ BCS_BrakeOverHeat : 160|1@0+ (1,0) [0|1] ""  ADC,IFC,FAPA
 SG_ BCS_ABAactive : 175|1@0+ (1,0) [0|1] ""  ADC,IFC,FAPA
 SG_ BCS_ABAavailable : 174|1@0+ (1,0) [0|1] ""  ADC,IFC,FAPA
 SG_ BCS_ABPActive : 173|1@0+ (1,0) [0|1] ""  ADC,IFC,FAPA
 SG_ BCS_ABPAvailable : 172|1@0+ (1,0) [0|1] ""  ADC,IFC,FAPA
 SG_ BCS_AEBActive : 171|1@0+ (1,0) [0|1] ""  ADC,IFC,FAPA,RRR,RLR
 SG_ BCS_AEBAvailable : 170|1@0+ (1,0) [0|1] ""  ADC,IFC,FAPA,RRR,RLR
 SG_ BCS_AWBActive : 169|1@0+ (1,0) [0|1] ""  ADC,IFC,FAPA
 SG_ BCS_AWBAvailable : 168|1@0+ (1,0) [0|1] ""  ADC,IFC,FAPA
 SG_ BCS_VehicleStandStillSt : 180|2@0+ (1,0) [0|3] ""  ADC,IFC,FAPA,RRR,RLR
 SG_ BCS_InputRodStroke : 363|10@0+ (0.05,-5) [-5|46.15] "mm"  ICM,IDC,AMP,ADC,IFC,FAPA,TBOX
 SG_ BCS_InputRodStrokeSt : 379|1@0+ (1,0) [0|1] ""  ICM,IDC,AMP,ADC,IFC,FAPA,TBOX
 SG_ BCS_PlungerPressureSt : 376|1@0+ (1,0) [0|1] ""  ZCUF,ZCUL,ZCUR,ZCUT,EMS,ADC,IFC,FAPA,RRR,RLR
 SG_ BCS_PlungerPressure : 391|12@0+ (0.1,-5) [-5|301.9] "bar"  ZCUF,ZCUL,ZCUR,ZCUT,EMS,ADC,IFC,FAPA,RRR,RLR
 SG_ BCS_BrkTqCtrlAvlDrivingRdn : 405|3@0+ (1,0) [0|7] ""  ADC
 SG_ BCS_BrkTqCtrlActvRdn : 407|2@0+ (1,0) [0|3] ""  ADC
 SG_ BCS_L3ComVD : 392|1@0+ (1,0) [0|1] ""  ADC
 SG_ BCS_LFIActiveSt : 402|1@0+ (1,0) [0|1] ""  ADC,IFC

BO_ 430 CCU_SRS_1: 64 CCU
 SG_ SRS_1_CRC_1 : 7|16@0+ (1,0) [0|65535] ""  ZCUF,ZCUL,ZCUR,ZCUT,EMS,CBM,EPS,EPB,IDC,ADC,IFC,FAPA,RRR,RLR,LBMSAD,PSDL,PSDR,LBMS,TBOX2,TBOX
 SG_ SRS_1_Counter_1 : 23|8@0+ (1,0) [0|255] ""  ZCUF,ZCUL,ZCUR,ZCUT,EMS,CBM,EPS,EPB,IDC,ADC,IFC,FAPA,RRR,RLR,LBMSAD,PSDL,PSDR,LBMS,TBOX2,TBOX
 SG_ SRS_CrashOutputSt : 31|8@0+ (1,0) [0|160] ""  ZCUF,ZCUL,ZCUR,ZCUT,EMS,CBM,IDC,ADC,IFC,FAPA,LBMSAD,PSDL,PSDR,LBMS,TBOX2,TBOX
 SG_ SRS_Front_CrashOutputSt : 39|1@0+ (1,0) [0|1] ""  ZCUF,ZCUL,ZCUR,IDC,ADC,IFC,FAPA,PSDL,PSDR,TBOX2,TBOX
 SG_ SRS_DriverSide_CrashOutputSt : 38|1@0+ (1,0) [0|1] ""  ZCUF,ZCUL,ZCUR,IDC,ADC,IFC,FAPA,PSDL,PSDR,TBOX2,TBOX
 SG_ SRS_PassengerSide_CrashOutputSt : 37|1@0+ (1,0) [0|1] ""  ZCUF,ZCUL,ZCUR,IDC,ADC,IFC,FAPA,PSDL,PSDR,TBOX2,TBOX
 SG_ SRS_Rear_CrashOutputSt : 36|1@0+ (1,0) [0|1] ""  ZCUF,ZCUL,ZCUR,IDC,ADC,IFC,FAPA,PSDL,PSDR,TBOX2,TBOX
 SG_ SRS_RolloverCrashOutputSt : 35|1@0+ (1,0) [0|1] ""  ZCUF,ZCUL,ZCUR,IDC,ADC,IFC,FAPA,PSDL,PSDR,TBOX2,TBOX
 SG_ SRS_NearCrashOutputSt : 34|1@0+ (1,0) [0|1] ""  ZCUF,ZCUL,ZCUR,IDC,ADC,IFC,FAPA,PSDL,PSDR,TBOX2,TBOX
 SG_ SRS_YawSnsCalibSt : 135|1@0+ (1,0) [0|1] ""  ZCUF,ZCUL,ZCUR,IDC,ADC,IFC,FAPA,RRR,RLR,TBOX
 SG_ SRS_VehLongAccelVD : 134|2@0+ (1,0) [0|3] ""  ZCUF,ZCUL,ZCUR,ZCUT,EPS,EPB,IDC,ADC,IFC,FAPA,RRR,RLR,PCS,TBOX
 SG_ SRS_VehLatrlAccelVD : 132|2@0+ (1,0) [0|3] ""  ZCUF,ZCUL,ZCUR,EPS,IDC,ADC,IFC,FAPA,RRR,RLR,PCS,TBOX
 SG_ SRS_YawRateVD : 130|2@0+ (1,0) [0|3] ""  ZCUF,ZCUL,ZCUR,EPS,IDC,ADC,IFC,FAPA,RRR,RLR,PCS,TBOX
 SG_ SRS_VehLongAccel : 143|12@0+ (0.001,-2) [-2|2] "g"  ZCUF,ZCUL,ZCUR,ZCUT,EPS,EPB,IDC,ADC,IFC,FAPA,RRR,RLR,PCS,TBOX
 SG_ SRS_VehLatrlAccel : 147|12@0+ (0.001,-2) [-2|2] "g"  ZCUF,ZCUL,ZCUR,EPS,IDC,ADC,IFC,FAPA,RRR,RLR,PCS,TBOX
 SG_ SRS_YawRate : 167|16@0+ (0.01,-180) [-180|180] "deg/s"  ZCUF,ZCUL,ZCUR,EPS,IDC,ADC,IFC,FAPA,RRR,RLR,PCS,TBOX

BO_ 290 CCU_PowerOn: 64 CCU_CCURT1
 SG_ IPDS_FrontRadarPowerSup : 33|2@0+ (1,0) [0|3] ""  CCURT2,RT2_C3,ZCUF,ZCUL,ADC
 SG_ IPDS_FLRadarPowerSup : 47|2@0+ (1,0) [0|3] ""  CCURT2,RT2_C3,ZCUF,ZCUL,ADC
 SG_ IPDS_FRRadarPowerSup : 45|2@0+ (1,0) [0|3] ""  CCURT2,RT2_C3,ZCUF,ZCUL,ADC
 SG_ IPDS_HDMapPowerSup : 79|2@0+ (1,0) [0|3] ""  CCURT2,RT2_C3,ZCUL,ADC
 SG_ IPDS_Lidar1PowerSup : 77|2@0+ (1,0) [0|3] ""  CCURT2,RT2_C3,ZCUL,ADC
 SG_ IPDS_RearRadarPowerSup : 129|2@0+ (1,0) [0|3] ""  CCURT2,RT2_C3,ZCUR,ZCUT,ADC

BO_ 398 CCU_EMS_1: 48 CCU
 SG_ EMS_ClutchTorqVD : 97|1@0+ (1,0) [0|1] ""  IBCS,ADC
 SG_ EMS_EngFrictionTorqVD : 113|1@0+ (1,0) [0|1] ""  ADC
 SG_ EMS_MinClutchTorqVD : 112|1@0+ (1,0) [0|1] ""  IBCS,ADC
 SG_ EMS_MaxClutchTorqVD : 145|1@0+ (1,0) [0|1] ""  IBCS,ADC
 SG_ EMS_EngSt : 163|1@0+ (1,0) [0|1] ""  ZCUL,ZCUR,IBCS,ICM,IID,IDC,PHUDD,ADC,TBOX
 SG_ EMS_MaxEngTorqNorm : 175|8@0+ (10,0) [0|2550] "Nm"  ADC

BO_ 161 CCU_IDC_1: 64 CCU
 SG_ ACU_FaceID_Delete : 119|4@0+ (1,0) [0|15] ""  ADC,FAPA
 SG_ ACU_RegisterTriger : 115|4@0+ (1,0) [0|15] ""  ADC,FAPA
 SG_ ACU_VerifyTriger : 127|4@0+ (1,0) [0|15] ""  ADC,FAPA
 SG_ ACU_FaceIDQuit : 123|1@0+ (1,0) [0|1] ""  ADC,FAPA
 SG_ ACU_FaceIDSwitch : 122|2@0+ (1,0) [0|3] ""  ADC,FAPA
 SG_ ACU_AVAS_SwitchCfgReq : 273|2@0+ (1,0) [0|3] ""  ZCUF,ZCUL,ADC,FAPA,AVAS

BO_ 1045 CCU_IDC_6: 64 CCU
 SG_ ACU_Longitude : 31|28@0+ (0.000001,0) [0|180] "℃"  ADC,IFC,FAPA,TBOX
 SG_ ACU_Latitude : 51|28@0+ (0.000001,0) [0|90] "℃"  ADC,IFC,FAPA,TBOX

BO_ 363 CCU_EPS_1_C: 64 CCU
 SG_ EPS_1_CRC : 7|16@0+ (1,0) [0|65535] ""  ECS,IBCS,ADC,IFC,FAPA,RRR,RLR
 SG_ EPS_1_Counter : 23|8@0+ (1,0) [0|255] ""  ECS,IBCS,ADC,IFC,FAPA,RRR,RLR
 SG_ EPS_StrngWhlTorqVD : 31|1@0+ (1,0) [0|1] ""  ADC,IFC,FAPA,RRR,RLR
 SG_ EPS_StrngWhlTorq : 30|12@0+ (0.01,-15) [-15|15] "Nm"  ADC,IFC,FAPA,RRR,RLR
 SG_ TAS_CalibratedSt : 34|1@0+ (1,0) [0|1] ""  SRS,ECS,IBCS,ADC,IFC,FAPA,RRR,RLR
 SG_ EPS_SteeringAngleSpdVD : 32|1@0+ (1,0) [0|1] ""  SRS,ECS,IBCS,ADC,IFC,FAPA,RRR,RLR
 SG_ EPS_SteeringAngleSpd : 47|8@0+ (4,0) [0|1016] "deg/sec"  SRS,ECS,IBCS,ADC,IFC,FAPA,RRR,RLR,PCS
 SG_ EPS_SteeringAngle : 55|16@0+ (0.1,-780) [-780|780] "deg"  ZCUR,SRS,ECS,IBCS,ADC,IFC,FAPA,RRR,RLR,PCS
 SG_ EPS_SteeringAngleVD : 71|1@0+ (1,0) [0|1] ""  ZCUR,SRS,ECS,IBCS,ADC,IFC,FAPA,RRR,RLR
 SG_ EPS_ThermalSt : 69|2@0+ (1,0) [0|3] ""  ADC,IFC,FAPA
 SG_ EPS_VMCErrFeedback : 84|4@0+ (1,0) [0|15] ""  ADC,IFC,FAPA
 SG_ EPS_PstOverlaySt : 103|3@0+ (1,0) [0|7] ""  ADC,IFC,FAPA
 SG_ EPS_HealthySt_DualSide : 100|2@0+ (1,0) [0|3] ""  ADC,IFC,FAPA
 SG_ EPS_VibrationWarnSt_A : 97|2@0+ (1,0) [0|3] ""  ADC,IFC,FAPA
 SG_ SAC_ErrFeedback_SideA : 111|4@0+ (1,0) [0|15] ""  ADC,IFC,FAPA
 SG_ EPS_ADASTargetAngle : 119|16@0+ (0.1,-780) [-780|780] "deg"  ADC,IFC,FAPA
 SG_ EPS_FunctionStyleSt : 135|2@0+ (1,0) [0|3] ""  ADC,IFC,FAPA
 SG_ EPS_SteeringModeSt : 133|2@0+ (1,0) [0|3] ""  ADC,IFC,FAPA
 SG_ EPS_ReqAngOverRange : 140|1@0+ (1,0) [0|1] ""  ADC,IFC,FAPA
 SG_ EPS_SACMotorTorAct : 139|12@0+ (0.01,-6) [-6|6] "Nm"  ADC,IFC,FAPA
 SG_ EPS_SACMotorTorLimInt : 159|11@0+ (0.01,0) [0|6] "Nm"  ADC,IFC,FAPA
 SG_ EPS_ReqAngSpdOverRange : 164|1@0+ (1,0) [0|1] ""  ADC,IFC,FAPA
 SG_ EPS_AssistPraSwitchToLKA : 163|1@0+ (1,0) [0|1] ""  ADC,IFC,FAPA
 SG_ EPS_SteerGainEnable : 162|1@0+ (1,0) [0|1] ""  ADC,IFC,FAPA
 SG_ EPS_EmSteerEnbale : 161|1@0+ (1,0) [0|1] ""  ADC,IFC,FAPA
 SG_ EPS_EM_ErrFeedback : 171|4@0+ (1,0) [0|15] ""  ADC,IFC,FAPA
 SG_ EPS_VW_ErrFeedback : 183|4@0+ (1,0) [0|15] ""  ADC,IFC,FAPA
 SG_ EPS_SG_ErrFeedback : 175|4@0+ (1,0) [0|15] ""  ADC,IFC,FAPA
 SG_ EPS_SACMotorTorActMot : 191|12@0+ (0.01,-6) [-6|6] "Nm"  ADC,IFC,FAPA
 SG_ EPS_SACMotorTorLimIntMot : 194|11@0+ (0.01,0) [0|6] "Nm"  ADC,IFC,FAPA
 SG_ EPS_SG_ActualLevel : 215|8@0+ (1,0) [0|254] "%"  ADC,IFC,FAPA
 SG_ EPS_MotorTorSum : 219|12@0+ (0.01,-6) [-6|6] "Nm"  ADC,IFC,FAPA
 SG_ EPS_WarnLamp : 242|2@0+ (1,0) [0|3] ""  ADC,IFC,FAPA
 SG_ EPS_AssistRatio : 263|8@0+ (1,0) [0|255] ""  ADC,IFC,FAPA
 SG_ EPS_SteeringWhlTorFlt : 271|12@0+ (0.01,-15) [-15|15] "Nm"  ADC,IFC,FAPA
 SG_ EPS_SteeringWhlTorFltVD : 275|2@0+ (1,0) [0|3] ""  ADC,IFC,FAPA
 SG_ EPS_SteeringAngleRate : 273|14@0+ (0.2,-1600) [-1600|1600] "deg/s"  ADC,IFC,FAPA
 SG_ EPS_TqCtrlSt : 291|2@0+ (1,0) [0|3] ""  ADC,IFC,FAPA
 SG_ EPS_MotorTorForDrv : 239|12@0+ (0.01,-20) [-20|20] "Nm"  ADC,IFC,FAPA
 SG_ EPS_TqCtrlAvl : 221|2@0+ (1,0) [0|3] ""  ADC,IFC,FAPA
 SG_ EPS_AgCtrlAvl : 223|2@0+ (1,0) [0|3] ""  ADC,IFC,FAPA
 SG_ EPS_MotorTorSumVD : 243|1@0+ (1,0) [0|1] ""  ADC,IFC,FAPA
 SG_ EPS_DrvOveRideSt : 160|1@0+ (1,0) [0|1] ""  ADC,IFC,FAPA
 SG_ EPS_DrvOveRideVD : 176|1@0+ (1,0) [0|1] ""  ADC,IFC,FAPA
 SG_ EPS_SteerVibrlAvl : 195|1@0+ (1,0) [0|1] ""  ADC,IFC,FAPA
 SG_ EPS_HandsOffDetStVD : 240|1@0+ (1,0) [0|1] ""  ADC,IFC,FAPA
 SG_ EPS_HandsOffDetSt : 289|2@0+ (1,0) [0|3] ""  ADC,IFC,FAPA
 SG_ EPS_SteerMod : 303|3@0+ (1,0) [0|7] ""  ADC,IFC,FAPA
 SG_ EPS_ADCNetErrorFb : 359|3@0+ (1,0) [0|7] ""  ADC,IFC,FAPA
 SG_ EPS_NetModeResp : 356|2@0+ (1,0) [0|3] ""  ADC,FAPA

BO_ 433 CCU_GVS_3: 48 CCU_CCURT1
 SG_ CCU_GVS_3_CRC : 7|16@0+ (1,0) [0|65535] ""  ZCUF,ZCUL,ZCUR,ZCUT,EPB,IBCS,ADC,IFC,FAPA
 SG_ CCU_GVS_3_Counter : 23|8@0+ (1,0) [0|255] ""  ZCUF,ZCUL,ZCUR,ZCUT,EPB,IBCS,ADC,IFC,FAPA
 SG_ VCU_VehActDrvTorqRR : 33|14@0+ (1,0) [0|16000] "Nm"  IBCS,ADC,FAPA
 SG_ VCU_MotorRgnCaplTqWhl : 50|14@0+ (1,-16000) [-16000|0] "Nm"  ADC
 SG_ VCU_VehWhlReqTqFAVD : 80|1@0+ (1,0) [0|1] ""  ADC,FAPA
 SG_ VCU_VehWhlReqTqRRVD : 81|1@0+ (1,0) [0|1] ""  ADC,FAPA
 SG_ VCU_VehActDrvTorqRRVD : 189|1@0+ (1,0) [0|1] ""  IBCS,ADC,FAPA
 SG_ VCU_PreStableFlg : 202|1@0+ (1,0) [0|1] ""  ADC,FAPA
 SG_ VCU_VehWhlReqTqRLVD : 207|1@0+ (1,0) [0|1] ""  ADC,FAPA
 SG_ VCU_AccPedalActPstVD : 209|1@0+ (1,0) [0|1] ""  ZCUF,ZCUL,ZCUR,ZCUT,SRS,EPB,IBCS,IDC,ADC,IFC,FAPA
 SG_ VCU_AccPedalActPst : 216|9@0+ (0.2,0) [0|100] "%"  ZCUF,ZCUL,ZCUR,ZCUT,SRS,EPB,IBCS,IDC,ADC,IFC,FAPA
 SG_ VCU_VehWhlReqTqFA : 247|16@0+ (1,-32768) [-32768|32767] "Nm"  ADC,FAPA
 SG_ VCU_VehWhlReqTqRR : 263|16@0+ (1,-32768) [-32768|32767] "Nm"  ADC,FAPA
 SG_ VCU_VehWhlReqTqRL : 279|16@0+ (1,-32768) [-32768|32767] "Nm"  ADC,FAPA
 SG_ VCU_MotorDrvCaplTqWhlFA : 295|16@0+ (1,-32768) [-32768|32767] "Nm"  ADC,FAPA
 SG_ VCU_MotorRgnCaplTqWhlFA : 311|16@0+ (1,-32768) [-32768|32767] "Nm"  ADC,FAPA
 SG_ VCU_MotorDrvCaplTqWhlRL : 327|16@0+ (1,-32768) [-32768|32767] "Nm"  ADC,FAPA
 SG_ VCU_MotorRgnCaplTqWhlRL : 343|16@0+ (1,-32768) [-32768|32767] "Nm"  ADC,FAPA
 SG_ VCU_MotorDrvCaplTqWhlRR : 359|16@0+ (1,-32768) [-32768|32767] "Nm"  ADC,FAPA
 SG_ VCU_GearShiftAvl : 51|1@0+ (1,0) [0|1] ""  ADC,IFC,FAPA
 SG_ VCU_MotorRgnCaplTqWhlVD : 190|1@0+ (1,0) [0|1] ""  ADC,IFC,FAPA
 SG_ VCU_VehWhlReqTqVD : 200|1@0+ (1,0) [0|1] ""  ADC,IFC,FAPA
 SG_ VCU_ErrorFb : 206|4@0+ (1,0) [0|15] ""  ADC,IFC,FAPA
 SG_ VCU_PtTqActvSts : 201|1@0+ (1,0) [0|1] ""  ADC,IFC,FAPA
 SG_ VCU_PtTqAvl : 83|2@0+ (1,0) [0|3] ""  ADC,IFC,FAPA
 SG_ VCU_DriverTorqueDesired : 119|16@0+ (1,-32768) [-32768|32767] "Nm"  ADC,IFC,FAPA
 SG_ VCU_VehWhlReqTq : 135|16@0+ (1,-32768) [-32768|32767] "Nm"  ADC,IFC,FAPA
 SG_ VCU_MotorRgnCaplTqWhlRR : 375|16@0+ (1,-32768) [-32768|32767] "Nm"  ADC,FAPA

BO_ 791 CCU_ZCUL_12: 64 CCU
 SG_ ZCUL_12_CRC : 7|16@0+ (1,0) [0|65535] ""  ADC,IFC,FAPA
 SG_ ZCUL_12_Counter : 23|8@0+ (1,0) [0|255] ""  ADC,IFC,FAPA
 SG_ WW_FWPMotorSt : 27|3@0+ (1,0) [0|7] ""  ADC,IFC,FAPA
 SG_ WW_FWSHMotorSt : 39|2@0+ (1,0) [0|3] ""  ADC,IFC,FAPA
 SG_ HRN_HornRunningSt : 45|2@0+ (1,0) [0|3] ""  ADC,IFC,FAPA
 SG_ HRN_HornWorkingTemplet : 43|4@0+ (1,0) [0|15] ""  ADC,IFC,FAPA
 SG_ EL_FLPositionLightSt : 71|1@0+ (1,0) [0|1] ""  ICM,IDC,ADC,IFC,FAPA
 SG_ EL_FLPositionLightFaultSt : 70|1@0+ (1,0) [0|1] ""  ICM,IDC,ADC,IFC,FAPA
 SG_ EL_FRPositionLightSt : 69|1@0+ (1,0) [0|1] ""  ICM,IDC,ADC,IFC,FAPA
 SG_ EL_FRPositionLightFaultSt : 68|1@0+ (1,0) [0|1] ""  ICM,IDC,ADC,IFC,FAPA
 SG_ EL_LeftLowBeamSt : 67|1@0+ (1,0) [0|1] ""  ICM,IDC,WHUD,ADC,IFC,FAPA
 SG_ EL_LeftLowBeamFaultSt : 66|1@0+ (1,0) [0|1] ""  ICM,IDC,ADC,FAPA
 SG_ EL_RightLowBeamSt : 65|1@0+ (1,0) [0|1] ""  ICM,IDC,ADC,IFC,FAPA
 SG_ EL_RightLowBeamFaultSt : 64|1@0+ (1,0) [0|1] ""  ICM,IDC,ADC,IFC,FAPA
 SG_ EL_LeftHighBeamSt : 79|1@0+ (1,0) [0|1] ""  ICM,IDC,ADC,IFC,FAPA
 SG_ EL_LeftHighBeamFaultSt : 78|1@0+ (1,0) [0|1] ""  ICM,IDC,ADC,IFC,FAPA
 SG_ EL_RightHighBeamSt : 77|1@0+ (1,0) [0|1] ""  ICM,IDC,ADC,IFC,FAPA
 SG_ EL_RightHighBeamFaultSt : 76|1@0+ (1,0) [0|1] ""  ICM,IDC,ADC,IFC,FAPA
 SG_ EL_FLFogLightSt : 75|1@0+ (1,0) [0|1] ""  ICM,IDC,ADC,IFC,FAPA
 SG_ EL_FLFogLightFaultSt : 74|1@0+ (1,0) [0|1] ""  ICM,IDC,ADC,IFC,FAPA
 SG_ EL_FRFogLightSt : 73|1@0+ (1,0) [0|1] ""  ICM,IDC,ADC,IFC,FAPA
 SG_ EL_FRFogLightFaultSt : 72|1@0+ (1,0) [0|1] ""  ICM,IDC,ADC,IFC,FAPA
 SG_ EL_LeftDRLSt : 87|1@0+ (1,0) [0|1] ""  IDC,ADC,IFC,FAPA,PCS
 SG_ EL_LeftDRLFaultSt : 86|1@0+ (1,0) [0|1] ""  ICM,IDC,ADC,IFC,FAPA
 SG_ EL_RightDRLSt : 85|1@0+ (1,0) [0|1] ""  IDC,ADC,IFC,FAPA,PCS
 SG_ EL_RightDRLFaultSt : 84|1@0+ (1,0) [0|1] ""  ICM,IDC,ADC,IFC,FAPA
 SG_ EL_FLTurnLightSt : 95|2@0+ (1,0) [0|3] ""  SRS,ICM,IDC,ADC,IFC,FAPA
 SG_ EL_FLTurnLightFaultSt : 93|1@0+ (1,0) [0|1] ""  SRS,ICM,IDC,ADC,IFC,FAPA
 SG_ EL_FRTurnLightSt : 92|2@0+ (1,0) [0|3] ""  SRS,ICM,IDC,ADC,IFC,FAPA
 SG_ EL_FRTurnLightFaultSt : 90|1@0+ (1,0) [0|1] ""  SRS,ICM,IDC,ADC,IFC,FAPA
 SG_ WW_RWSHMotorSt : 103|2@0+ (1,0) [0|3] ""  ADC,IFC,FAPA
 SG_ EL_FADASLightSt : 127|2@0+ (1,0) [0|3] ""  ADC,IFC
 SG_ EBSF_BattVolt : 199|14@0+ (0.0009765625,3) [3|18] "V"  IDC,ADC,FAPA
 SG_ EBSF_CurrentRange : 201|2@0+ (1,0) [0|3] ""  ADC,FAPA
 SG_ EBSF_BattCurrent : 215|16@0+ (1,0) [-1500|1500] "A"  ADC,FAPA

CM_ SG_ 431 VCU_TargetRecpTorqVD "Status of  Target cuperation torque of generator";
CM_ SG_ 431 VCU_AccDriverOrvd "Indicating the torque demanded by the driver is higher than the torque demanded by ACC";
CM_ SG_ 431 VCU_AccDriverOrvdVD "Indicating the torque demanded by the driver is higher than the torque demanded by ACC.";
CM_ SG_ 431 VCU_TargetRecpTorq "Current target recuperation torque of generator";
CM_ SG_ 431 VCU_TargetRecpTorqFA "Target cuperation torque of generator for front axel";
CM_ SG_ 431 VCU_TargetRecpTorqRA "Target cuperation torque of generator for rear axel";
CM_ SG_ 431 VCU_TorqDriverReqFA "the driver torque request for front axel";
CM_ SG_ 431 VCU_TorqDriverReqRA "the driver torque request for rear axel or left rear wheel hub motor";
CM_ SG_ 431 VCU_VehActDrvTorqFA "Vehicle actual drive torque for front axel";
CM_ SG_ 431 VCU_VehActDrvTorqRA "Vehicle actual drive torque for  rear axel or  left rear wheel hub motor";
CM_ SG_ 431 VCU_TargetRecpTorqFAVD "Status of? Target cuperation torque of generator for front axel";
CM_ SG_ 431 VCU_TargetRecpTorqRAVD "Status of? Target cuperation torque of generator for rear axel";
CM_ SG_ 431 VCU_TorqDriverReqFAVD "Status of the driver torque request for front axel";
CM_ SG_ 431 VCU_TorqDriverReqRAVD "Status of the driver torque request for rear axel or  left rear wheel hub motor";
CM_ SG_ 431 VCU_VehActDrvTorqFAVD "Vehicle actual drive torque valid data for front axel";
CM_ SG_ 431 VCU_VehActDrvTorqRAVD "Vehicle actual drive torque valid data for rear axel or  left rear wheel hub motor";
CM_ SG_ 431 VCU_BcsDecelReq "target deceleration to BCS by AVDC";
CM_ SG_ 431 VCU_BcsDecelVD "Quality/Fault of AVDC deceleration to BCS";
CM_ SG_ 431 VCU_RecpTorqRL "Current recuperation torque of left rear wheel hub motor";
CM_ SG_ 431 VCU_RecpTorqRLVD "Status ofCurrent recuperation torque of left rear wheel hub motor";
CM_ SG_ 431 VCU_RecpTorqRR "Current recuperation torque of Right rear wheel hub motor";
CM_ SG_ 431 VCU_RecpTorqRRVD "Status ofCurrent recuperation torque of Right rear wheel hub motor";
CM_ SG_ 431 VCU_ADSNetErrorFb "ADS Net Error Feedback";
CM_ SG_ 431 VCU_NetModeResp "VCU Use Net Feedback";
CM_ SG_ 431 VCU_PwrLimDrv_kW "整车分配给驱动系统的最大驱动功率限制（电池可用功率扣除非动力系统功率后的总功率）";
CM_ SG_ 431 VCU_PwrLimRegen_kW "整车分配给驱动系统的最大回馈功率限制（电池可用功率扣除非动力系统功率后的总功率）";
CM_ SG_ 431 VCU_PwrLimDrv_kWVD "整车分配给驱动系统的最大驱动功率限制（电池可用功率扣除非动力系统功率后的总功率）";
CM_ SG_ 431 VCU_PwrLimRegen_kWVD "整车分配给驱动系统的最大回馈功率限制（电池可用功率扣除非动力系统功率后的总功率）";
CM_ SG_ 431 VCU_PtTqActvStsFL "VCU扭矩响应状态";
CM_ SG_ 431 VCU_PtTqActvStsFR "VCU扭矩响应状态";
CM_ SG_ 431 VCU_PtTqActvStsRL "VCU扭矩响应状态";
CM_ SG_ 431 VCU_PtTqActvStsRR "VCU扭矩响应状态";
CM_ SG_ 615 BCS_1_CRC "E2E Profile 5 CRC";
CM_ SG_ 615 BCS_1_Counter "E2E Profile 5 Counter";
CM_ SG_ 615 BCS_FLWheelSpd "Current wheel speed information of front left wheel";
CM_ SG_ 615 BCS_FLWheelSpdVD "Quality/fault information to current wheel speed of front left wheel";
CM_ SG_ 615 BCS_FLWheelRotatedDirectionVD "FL wheel rotate direction validity";
CM_ SG_ 615 BCS_FRWheelSpd "Current wheel speed information of front right wheel";
CM_ SG_ 615 BCS_FRWheelSpdVD "Quality/fault information to current wheel speed of front right  wheel";
CM_ SG_ 615 BCS_FRWheelRotatedDirectionVD "FR wheel rotate direction validity";
CM_ SG_ 615 BCS_RLWheelSpd "Current wheel speed information of rear left wheel";
CM_ SG_ 615 BCS_RLWheelSpdVD "Quality/fault information to current wheel speed of rear left wheel";
CM_ SG_ 615 BCS_RLWheelRotatedDirectionVD "RL wheel rotate direction validity";
CM_ SG_ 615 BCS_RRWheelSpd "Current wheel speed information of rear right wheel";
CM_ SG_ 615 BCS_RRWheelSpdVD "Quality/fault information to current wheel speed of rear right wheel";
CM_ SG_ 615 BCS_RRWheelRotatedDirectionVD "RR wheel rotate direction validity";
CM_ SG_ 615 BCS_HHCCtrlSt "HHC(Hill Hold Control) control status";
CM_ SG_ 615 BCS_HDCCtrlSt "HDC(Hill Descent Control) control status";
CM_ SG_ 615 BCS_HDCErrSt "HDC error status";
CM_ SG_ 615 BCS_FLWheelSpdEdgesSum "Accumulated sum of rising and falling edges of front left wheel speed sensor output·since IGN ON( the wheel plate have 48 teeth/cycle,the edge is 96)";
CM_ SG_ 615 BCS_FRWheelSpdEdgesSum "Accumulated sum of rising and falling edges of front right wheel speed sensor output·since IGN ON( the wheel plate have 48 teeth/cycle,the edge is 96)";
CM_ SG_ 615 BCS_RLWheelSpdEdgesSum "Accumulated sum of rising and falling edges of rear left wheel speed sensor output·since IGN ON( the wheel plate have 48 teeth/cycle,the edge is 96)";
CM_ SG_ 615 BCS_RRWheelSpdEdgesSum "Accumulated sum of rising and falling edges of  rear right wheel speed sensor output·since IGN ON( the wheel plate have 48 teeth/cycle,the edge is 96)";
CM_ SG_ 615 BCS_FLWheelSpdEdgesSumVD "Quality/fault information to current wheel speed edges sum of front left wheel";
CM_ SG_ 615 BCS_FRWheelSpdEdgesSumVD "Quality/fault information to current wheel speed edges sum of front right wheel";
CM_ SG_ 615 BCS_RLWheelSpdEdgesSumVD "Quality/fault information to current wheel speed edges sum of rear left wheel";
CM_ SG_ 615 BCS_RRWheelSpdEdgesSumVD "Quality/fault information to current wheel speed edges sum of rear right wheel";
CM_ SG_ 615 BCS_FLWheelRotatedDirection "FL wheel rotate direction";
CM_ SG_ 615 BCS_FRWheelRotatedDirection "FR wheel rotate direction";
CM_ SG_ 615 BCS_RLWheelRotatedDirection "RL wheel rotate direction";
CM_ SG_ 615 BCS_RRWheelRotatedDirection "RR wheel rotate direction";
CM_ SG_ 615 BCS_ParkingReqToEPB "Indicates the release/lock brake request to EPB";
CM_ SG_ 615 BCS_VDCOff "VDC is switched off ";
CM_ SG_ 615 BCS_AVHSt "Indicates AVH(Auto Vehicle Hold)in active or not ";
CM_ SG_ 615 BCS_AVHAvailable "HMI responsible, can get degrate AVH(Auto Vehicle Hold) statement from DSW and send out ";
CM_ SG_ 615 BCS_TCSOff "TCS is switched off ";
CM_ SG_ 615 BCS_BrakeOverHeat "Indicating brake temperature too high or not";
CM_ SG_ 615 BCS_ABAactive "ABA(Adaptive Brake Assistance) is active";
CM_ SG_ 615 BCS_ABAavailable "The ABA(Adaptive Brake Assistance)  function is available";
CM_ SG_ 615 BCS_ABPActive "ABP(Automatic brake Pre-fill) is active";
CM_ SG_ 615 BCS_ABPAvailable "ABP(Automatic brake Pre-fill) is available";
CM_ SG_ 615 BCS_AEBActive "AEB(Automatic EmergencyBraking) is active (in deceleration)";
CM_ SG_ 615 BCS_AEBAvailable "AEB(Automatic EmergencyBraking) is available";
CM_ SG_ 615 BCS_AWBActive "AWB(Automatic Warning Brake) is active";
CM_ SG_ 615 BCS_AWBAvailable "AWB(Automatic Warning Brake) is available";
CM_ SG_ 615 BCS_VehicleStandStillSt "Indicating whether the vehicle is standstill or not;must not be set until standstill is surely reached.";
CM_ SG_ 615 BCS_InputRodStroke "Indicate inputRod stroke value";
CM_ SG_ 615 BCS_InputRodStrokeSt "Indicate inputRod stroke status";
CM_ SG_ 615 BCS_PlungerPressureSt "Indicate plunger pressure status";
CM_ SG_ 615 BCS_PlungerPressure "Indicate plunger pressure value";
CM_ SG_ 615 BCS_BrkTqCtrlAvlDrivingRdn "It indicates  whether  ESC/IBCS is available for cruise function ，in redunant mode,including L3/L4/L5.";
CM_ SG_ 615 BCS_BrkTqCtrlActvRdn "It indicates  whether  ESC/IBCS is  responsed for the brake request of ADAS, in redunant mode,including L3/L4/L5.";
CM_ SG_ 615 BCS_L3ComVD "The validity of CAN bus communication .";
CM_ SG_ 615 BCS_LFIActiveSt "The activation status of the LFI function。";
CM_ SG_ 430 SRS_1_CRC_1 "E2E Profile 5 CRC";
CM_ SG_ 430 SRS_1_Counter_1 "E2E Profile 5 Counter";
CM_ SG_ 430 SRS_CrashOutputSt "To inform there's crash event happened in last 2 seconds.After 2 seconds, the signal will turn to 0(crash here means any one of the 5 status defined below)";
CM_ SG_ 430 SRS_Front_CrashOutputSt "To inform there's front crash event happened in last 2 seconds. After 2 seconds, the signal will turn to 0.";
CM_ SG_ 430 SRS_DriverSide_CrashOutputSt "To inform there's driver side crash event happened in last 2 seconds. After 2 seconds, the signal will turn to 0.(Driver side is the left side for the left-hand-drive vehicle, the right side for the right-hand-drive one. )";
CM_ SG_ 430 SRS_PassengerSide_CrashOutputSt "To inform there's passenger side crash event happened in last 2 seconds. After 2 seconds, the signal will turn to 0.(Passenger side is the right side for the left-hand-drive vehicle, the left side for the right-hand-drive one. )";
CM_ SG_ 430 SRS_Rear_CrashOutputSt "To inform there's rear crash event happened in last 2 seconds. After 2 seconds, the signal will turn to 0.";
CM_ SG_ 430 SRS_RolloverCrashOutputSt "To inform there's rollover crash event happened in last 2 seconds. After 2 seconds, the signal will turn to 0.";
CM_ SG_ 430 SRS_NearCrashOutputSt "To inform there's near crash event happened in last 2 seconds.After 2 seconds, the signal will turn to 0";
CM_ SG_ 430 SRS_YawSnsCalibSt "To indicates  yaw sensor calibration state";
CM_ SG_ 430 SRS_VehLongAccelVD "To indicate vehicle longitudinal acceleration valid state";
CM_ SG_ 430 SRS_VehLatrlAccelVD "To indicate vehicle lateral acceleration valid state";
CM_ SG_ 430 SRS_YawRateVD "To indicate yaw rate valid state";
CM_ SG_ 430 SRS_VehLongAccel "To indicate vehicle longitudinal acceleration";
CM_ SG_ 430 SRS_VehLatrlAccel "To indicate vehicle lateral acceleration";
CM_ SG_ 430 SRS_YawRate "To indicate vehicle yaw rate";
CM_ SG_ 290 IPDS_FrontRadarPowerSup "Front radar power supply";
CM_ SG_ 290 IPDS_FLRadarPowerSup "Front left radar power supply";
CM_ SG_ 290 IPDS_FRRadarPowerSup "Front right radar power supply";
CM_ SG_ 290 IPDS_HDMapPowerSup "HD map power supply";
CM_ SG_ 290 IPDS_Lidar1PowerSup "Lidar1 power supply";
CM_ SG_ 290 IPDS_RearRadarPowerSup "Rear radar power supply";
CM_ SG_ 398 EMS_ClutchTorqVD "EMS_ClutchTorq statusvalid data";
CM_ SG_ 398 EMS_EngFrictionTorqVD "EMS_EngFrictionTorq validity";
CM_ SG_ 398 EMS_MinClutchTorqVD "Minimum Clutch Torque Valid DataFor PHEV or HEV Project, this signal corresponds to EMS_MinEngTorqVD of the VCU matrix";
CM_ SG_ 398 EMS_MaxClutchTorqVD "Maximum Clutch Torque Valid DataFor PHEV or HEV Project, this signal corresponds to EMS_MaxEngTorqVD of the VCU matrix";
CM_ SG_ 398 EMS_EngSt "Engine running status";
CM_ SG_ 398 EMS_MaxEngTorqNorm "Max Engine combustion (indicated) Torque Norm";
CM_ SG_ 161 ACU_FaceID_Delete "Delete_FaceID";
CM_ SG_ 161 ACU_RegisterTriger "FaceID register triger";
CM_ SG_ 161 ACU_VerifyTriger "FaceID verify triger";
CM_ SG_ 161 ACU_FaceIDQuit "FaceID quit triger";
CM_ SG_ 161 ACU_FaceIDSwitch "FaceID switch triger";
CM_ SG_ 161 ACU_AVAS_SwitchCfgReq "AVAS switch configuration require";
CM_ SG_ 1045 ACU_Longitude "Longitude";
CM_ SG_ 1045 ACU_Latitude "Latitude";
CM_ SG_ 363 EPS_1_CRC "E2E Profile 5 CRC";
CM_ SG_ 363 EPS_1_Counter "E2E Profile 5 Counter";
CM_ SG_ 363 EPS_StrngWhlTorqVD "Steering Wheel Torque valid value";
CM_ SG_ 363 EPS_StrngWhlTorq "Steering wheel Torque ";
CM_ SG_ 363 TAS_CalibratedSt "The calibration information of steering angle sensor";
CM_ SG_ 363 EPS_SteeringAngleSpd "steering wheel angle speed";
CM_ SG_ 363 EPS_SteeringAngle "steering wheel angle";
CM_ SG_ 363 EPS_SteeringAngleVD "indicate that Angle VD";
CM_ SG_ 363 EPS_ThermalSt "EPS over thermal limit state";
CM_ SG_ 363 EPS_VMCErrFeedback "EPS Error reason feedback to VMC";
CM_ SG_ 363 EPS_PstOverlaySt "Overall EPS Position Overlay Control State";
CM_ SG_ 363 EPS_HealthySt_DualSide "Overall EPS Healthy States";
CM_ SG_ 363 EPS_VibrationWarnSt_A "Vibration Warn State";
CM_ SG_ 363 SAC_ErrFeedback_SideA "EPS_A Errer Feedback";
CM_ SG_ 363 EPS_ADASTargetAngle "EPS's target Angle after the safety limit";
CM_ SG_ 363 EPS_FunctionStyleSt "EPS function style state";
CM_ SG_ 363 EPS_SteeringModeSt "EPS steering mode status";
CM_ SG_ 363 EPS_ReqAngOverRange "target angle received from ADAS/IFC over the safety range";
CM_ SG_ 363 EPS_SACMotorTorAct "SAC Actural motor torque";
CM_ SG_ 363 EPS_SACMotorTorLimInt "EPS’s internal safety limit of SAC motor torque";
CM_ SG_ 363 EPS_ReqAngSpdOverRange "Angular speed of target angle received from ADAS/IFC over the safety range";
CM_ SG_ 363 EPS_AssistPraSwitchToLKA "Indicate EPS Swithinto fixed steering parameters";
CM_ SG_ 363 EPS_SteerGainEnable "Steering Gain Enable";
CM_ SG_ 363 EPS_EmSteerEnbale "Emergency Steering Enable";
CM_ SG_ 363 EPS_EM_ErrFeedback "Emergency Steering Enable Feedback";
CM_ SG_ 363 EPS_VW_ErrFeedback "Vibration Warn Enable Feedback";
CM_ SG_ 363 EPS_SG_ErrFeedback "Steering Gain Enable Error Feedback";
CM_ SG_ 363 EPS_SACMotorTorActMot "SAC Actural motor torque";
CM_ SG_ 363 EPS_MotorTorSum "EPS Motor output Torque  (including SAC and driver steering) ";
CM_ SG_ 363 EPS_WarnLamp "Streering Warning Lamp";
CM_ SG_ 363 EPS_AssistRatio "feedback to IDC the assist ratio ";
CM_ SG_ 363 EPS_SteeringWhlTorFlt "Steering wheel torque after Elfa filtering";
CM_ SG_ 363 EPS_SteeringWhlTorFltVD "indicate that EPS_SteeringWhlTorFlt Valid or not";
CM_ SG_ 363 EPS_SteeringAngleRate "steering wheel angle rate";
CM_ SG_ 363 EPS_TqCtrlSt "ESP response state for ADAS moter torque request";
CM_ SG_ 363 EPS_MotorTorForDrv "EPS motor Torque value for driver steering";
CM_ SG_ 363 EPS_TqCtrlAvl "EPS moter torque control available state for ADAS";
CM_ SG_ 363 EPS_AgCtrlAvl "EPS steer angle control available state for ADAS";
CM_ SG_ 363 EPS_MotorTorSumVD "EPS motor torque valid state of driver steering";
CM_ SG_ 363 EPS_DrvOveRideSt "Driver override detection state";
CM_ SG_ 363 EPS_DrvOveRideVD "Driver override detection valid state";
CM_ SG_ 363 EPS_SteerVibrlAvl "EPS steer vibration control available state for ADAS";
CM_ SG_ 363 EPS_HandsOffDetStVD "Hands Off Detected States valid value";
CM_ SG_ 363 EPS_HandsOffDetSt "Hands Off Detected States";
CM_ SG_ 363 EPS_SteerMod "EPS working mode";
CM_ SG_ 363 EPS_ADCNetErrorFb "ADC Network Fault Feedback";
CM_ SG_ 363 EPS_NetModeResp "EPS Net Mode Response";
CM_ SG_ 433 CCU_GVS_3_CRC "E2E Profile 5 CRC";
CM_ SG_ 433 CCU_GVS_3_Counter "E2E Profile 5 Counter";
CM_ SG_ 433 VCU_VehActDrvTorqRR "Vehicle actual drive torque for right rear wheel hub motor";
CM_ SG_ 433 VCU_MotorRgnCaplTqWhl "整车最大允许制动能量回收扭矩轮端扭矩（扣滑行）";
CM_ SG_ 433 VCU_VehWhlReqTqFAVD "Required Torque for Front Axle or Front Left Motor Valid Bit";
CM_ SG_ 433 VCU_VehWhlReqTqRRVD "Required Torque for Rear Right Motor Valid Bit";
CM_ SG_ 433 VCU_VehActDrvTorqRRVD "Vehicle actual drive torque valid data for right rear wheel hub motor";
CM_ SG_ 433 VCU_PreStableFlg "VCU Pre Stable Flag";
CM_ SG_ 433 VCU_VehWhlReqTqRLVD "Required Torque for Rear Left(or Rear) Motor Valid Bit";
CM_ SG_ 433 VCU_AccPedalActPstVD "Current accelerate pedal actual position validity for MRR";
CM_ SG_ 433 VCU_AccPedalActPst "Current accelerate pedal actual position for MRR";
CM_ SG_ 433 VCU_VehWhlReqTqFA "Required Torque for Front Axle Motor(or Front Left )";
CM_ SG_ 433 VCU_VehWhlReqTqRR "Required Torque for Rear Right Motor";
CM_ SG_ 433 VCU_VehWhlReqTqRL "Required Torque for Rear Left(or Rear) motor";
CM_ SG_ 433 VCU_MotorDrvCaplTqWhlFA "Front Motor Wheel End Driving Torque Capability (or Front Left)";
CM_ SG_ 433 VCU_MotorRgnCaplTqWhlFA "Left Rear Motor Wheel End Negative Torque Capability(or Front Left)";
CM_ SG_ 433 VCU_MotorDrvCaplTqWhlRL "Left Rear(or Rear) Motor Wheel End Driving Torque Capability";
CM_ SG_ 433 VCU_MotorRgnCaplTqWhlRL "Left Rear(or Rear) Motor Wheel End Negative Torque Capability";
CM_ SG_ 433 VCU_MotorDrvCaplTqWhlRR "Right Rear Motor Wheel End Driving Torque Capability";
CM_ SG_ 433 VCU_GearShiftAvl "档位切换可用状态";
CM_ SG_ 433 VCU_MotorRgnCaplTqWhlVD "整车最大允许制动能量回收扭矩轮端扭矩有效位";
CM_ SG_ 433 VCU_VehWhlReqTqVD "整车需求轮端扭矩有效";
CM_ SG_ 433 VCU_ErrorFb "VCU上报故障原因";
CM_ SG_ 433 VCU_PtTqActvSts "VCU扭矩响应状态";
CM_ SG_ 433 VCU_PtTqAvl "动力系统扭矩可用状态";
CM_ SG_ 433 VCU_DriverTorqueDesired "驾驶员需求力矩（驾驶员油门对应的驱动力矩）";
CM_ SG_ 433 VCU_VehWhlReqTq "整车需求轮端扭矩（仲裁滤波后）";
CM_ SG_ 433 VCU_MotorRgnCaplTqWhlRR "Right Rear Motor Wheel End Negative Torque Capability";
CM_ SG_ 791 ZCUL_12_CRC "E2E Profile 5 CRC";
CM_ SG_ 791 ZCUL_12_Counter "E2E Profile 5 Counter";
CM_ SG_ 791 WW_FWPMotorSt "FrontWiper Motor status";
CM_ SG_ 791 WW_FWSHMotorSt "FrontWasher motor status";
CM_ SG_ 791 HRN_HornRunningSt "Horn Running status";
CM_ SG_ 791 HRN_HornWorkingTemplet "Horn Working Templet";
CM_ SG_ 791 EL_FLPositionLightSt "Front left position light status";
CM_ SG_ 791 EL_FLPositionLightFaultSt "Front left position light fault status";
CM_ SG_ 791 EL_FRPositionLightSt "Front Right position light status";
CM_ SG_ 791 EL_FRPositionLightFaultSt "Front Right position light fault status";
CM_ SG_ 791 EL_LeftLowBeamSt "Left low beam status";
CM_ SG_ 791 EL_LeftLowBeamFaultSt "Left low beam fault status";
CM_ SG_ 791 EL_RightLowBeamSt "Right low beam status";
CM_ SG_ 791 EL_RightLowBeamFaultSt "Right low beam fault status";
CM_ SG_ 791 EL_LeftHighBeamSt "Left high beam status";
CM_ SG_ 791 EL_LeftHighBeamFaultSt "Left high beam fault status";
CM_ SG_ 791 EL_RightHighBeamSt "Right high beam status";
CM_ SG_ 791 EL_RightHighBeamFaultSt "Right high beam fault status";
CM_ SG_ 791 EL_FLFogLightSt "Front left fog light status";
CM_ SG_ 791 EL_FLFogLightFaultSt "Front left fog light fault status";
CM_ SG_ 791 EL_FRFogLightSt "Front right fog light status";
CM_ SG_ 791 EL_FRFogLightFaultSt "Front right fog light fault status";
CM_ SG_ 791 EL_LeftDRLSt "Left day time running light status";
CM_ SG_ 791 EL_LeftDRLFaultSt "Left day time running light fault status";
CM_ SG_ 791 EL_RightDRLSt "Right day time running light status";
CM_ SG_ 791 EL_RightDRLFaultSt "Right day time running light fault status";
CM_ SG_ 791 EL_FLTurnLightSt "Front left turn light status";
CM_ SG_ 791 EL_FLTurnLightFaultSt "Front left turn light fault status";
CM_ SG_ 791 EL_FRTurnLightSt "Front right turn light status";
CM_ SG_ 791 EL_FRTurnLightFaultSt "Front right turn light fault status";
CM_ SG_ 791 WW_RWSHMotorSt "Rear washer motor status";
CM_ SG_ 791 EL_FADASLightSt "Front ADAS light status";
CM_ SG_ 791 EBSF_BattVolt "Battery voltage";
CM_ SG_ 791 EBSF_CurrentRange "Battery current range";
CM_ SG_ 791 EBSF_BattCurrent "Battery current ";

BA_DEF_ BO_  "GenMsgCycleTime" INT 0 0;
BA_DEF_ BO_  "GenMsgCycleTimeFast" INT 0 0;
BA_DEF_ BO_  "GenMsgSendType" ENUM  "Periodic","Event","IfActive","POE","PA","FixedPeriodic","Event","EnabledPeriodic","NotUsed","NotUsed","EventPeriodic","NotUsed","NotUsed","NoMsgSendType";
BA_DEF_ BO_  "VFrameFormat" ENUM  "StandardCAN","ExtendedCAN","reserved","reserved","reserved","reserved","reserved","reserved","reserved","reserved","reserved","reserved","reserved","reserved","StandardCAN_FD","ExtendedCAN_FD";
BA_DEF_ BO_  "CANFD_BRS" ENUM  "0","1";
BA_DEF_ SG_  "EventCommandSignal" ENUM  "No","Yes";
BA_DEF_ SG_  "GatewayedSignals" ENUM  "No","Yes";
BA_DEF_ SG_  "GenSigInactiveValue" HEX 0 0;
BA_DEF_ SG_  "GenSigInvalidValue" HEX 0 0;
BA_DEF_ SG_  "GenSigSendType" ENUM  "Trigger","Passive","Cyclic","OnWrite","OnWriteWithRepetition","OnChange","OnChangeWithRepetition","IfActive","IfActiveWithRepetition","NoSigSendType";
BA_DEF_ SG_  "GenSigStartValue" HEX 0 0;
BA_DEF_ SG_  "GenSigTimeoutValue" HEX 0 0;
BA_DEF_ SG_  "Remark" STRING ;
BA_ "GenMsgCycleTime" BO_ 431 10;
BA_ "GenMsgCycleTimeFast" BO_ 431 0;
BA_ "GenMsgSendType" BO_ 431 0;
BA_ "VFrameFormat" BO_ 431 14;
BA_ "CANFD_BRS" BO_ 431 1;
BA_ "GenMsgCycleTime" BO_ 431 10;
BA_ "GenMsgCycleTimeFast" BO_ 431 0;
BA_ "GenMsgSendType" BO_ 431 0;
BA_ "VFrameFormat" BO_ 431 14;
BA_ "CANFD_BRS" BO_ 431 1;
BA_ "GenMsgCycleTime" BO_ 431 10;
BA_ "GenMsgCycleTimeFast" BO_ 431 0;
BA_ "GenMsgSendType" BO_ 431 0;
BA_ "VFrameFormat" BO_ 431 14;
BA_ "CANFD_BRS" BO_ 431 1;
BA_ "GenMsgCycleTime" BO_ 431 10;
BA_ "GenMsgCycleTimeFast" BO_ 431 0;
BA_ "GenMsgSendType" BO_ 431 0;
BA_ "VFrameFormat" BO_ 431 14;
BA_ "CANFD_BRS" BO_ 431 1;
BA_ "GenMsgCycleTime" BO_ 431 10;
BA_ "GenMsgCycleTimeFast" BO_ 431 0;
BA_ "GenMsgSendType" BO_ 431 0;
BA_ "VFrameFormat" BO_ 431 14;
BA_ "CANFD_BRS" BO_ 431 1;
BA_ "GenMsgCycleTime" BO_ 431 10;
BA_ "GenMsgCycleTimeFast" BO_ 431 0;
BA_ "GenMsgSendType" BO_ 431 0;
BA_ "VFrameFormat" BO_ 431 14;
BA_ "CANFD_BRS" BO_ 431 1;
BA_ "GenMsgCycleTime" BO_ 431 10;
BA_ "GenMsgCycleTimeFast" BO_ 431 0;
BA_ "GenMsgSendType" BO_ 431 0;
BA_ "VFrameFormat" BO_ 431 14;
BA_ "CANFD_BRS" BO_ 431 1;
BA_ "GenMsgCycleTime" BO_ 431 10;
BA_ "GenMsgCycleTimeFast" BO_ 431 0;
BA_ "GenMsgSendType" BO_ 431 0;
BA_ "VFrameFormat" BO_ 431 14;
BA_ "CANFD_BRS" BO_ 431 1;
BA_ "GenMsgCycleTime" BO_ 431 10;
BA_ "GenMsgCycleTimeFast" BO_ 431 0;
BA_ "GenMsgSendType" BO_ 431 0;
BA_ "VFrameFormat" BO_ 431 14;
BA_ "CANFD_BRS" BO_ 431 1;
BA_ "GenMsgCycleTime" BO_ 431 10;
BA_ "GenMsgCycleTimeFast" BO_ 431 0;
BA_ "GenMsgSendType" BO_ 431 0;
BA_ "VFrameFormat" BO_ 431 14;
BA_ "CANFD_BRS" BO_ 431 1;
BA_ "GenMsgCycleTime" BO_ 431 10;
BA_ "GenMsgCycleTimeFast" BO_ 431 0;
BA_ "GenMsgSendType" BO_ 431 0;
BA_ "VFrameFormat" BO_ 431 14;
BA_ "CANFD_BRS" BO_ 431 1;
BA_ "GenMsgCycleTime" BO_ 431 10;
BA_ "GenMsgCycleTimeFast" BO_ 431 0;
BA_ "GenMsgSendType" BO_ 431 0;
BA_ "VFrameFormat" BO_ 431 14;
BA_ "CANFD_BRS" BO_ 431 1;
BA_ "GenMsgCycleTime" BO_ 431 10;
BA_ "GenMsgCycleTimeFast" BO_ 431 0;
BA_ "GenMsgSendType" BO_ 431 0;
BA_ "VFrameFormat" BO_ 431 14;
BA_ "CANFD_BRS" BO_ 431 1;
BA_ "GenMsgCycleTime" BO_ 431 10;
BA_ "GenMsgCycleTimeFast" BO_ 431 0;
BA_ "GenMsgSendType" BO_ 431 0;
BA_ "VFrameFormat" BO_ 431 14;
BA_ "CANFD_BRS" BO_ 431 1;
BA_ "GenMsgCycleTime" BO_ 431 10;
BA_ "GenMsgCycleTimeFast" BO_ 431 0;
BA_ "GenMsgSendType" BO_ 431 0;
BA_ "VFrameFormat" BO_ 431 14;
BA_ "CANFD_BRS" BO_ 431 1;
BA_ "GenMsgCycleTime" BO_ 431 10;
BA_ "GenMsgCycleTimeFast" BO_ 431 0;
BA_ "GenMsgSendType" BO_ 431 0;
BA_ "VFrameFormat" BO_ 431 14;
BA_ "CANFD_BRS" BO_ 431 1;
BA_ "GenMsgCycleTime" BO_ 431 10;
BA_ "GenMsgCycleTimeFast" BO_ 431 0;
BA_ "GenMsgSendType" BO_ 431 0;
BA_ "VFrameFormat" BO_ 431 14;
BA_ "CANFD_BRS" BO_ 431 1;
BA_ "GenMsgCycleTime" BO_ 431 10;
BA_ "GenMsgCycleTimeFast" BO_ 431 0;
BA_ "GenMsgSendType" BO_ 431 0;
BA_ "VFrameFormat" BO_ 431 14;
BA_ "CANFD_BRS" BO_ 431 1;
BA_ "GenMsgCycleTime" BO_ 431 10;
BA_ "GenMsgCycleTimeFast" BO_ 431 0;
BA_ "GenMsgSendType" BO_ 431 0;
BA_ "VFrameFormat" BO_ 431 14;
BA_ "CANFD_BRS" BO_ 431 1;
BA_ "GenMsgCycleTime" BO_ 431 10;
BA_ "GenMsgCycleTimeFast" BO_ 431 0;
BA_ "GenMsgSendType" BO_ 431 0;
BA_ "VFrameFormat" BO_ 431 14;
BA_ "CANFD_BRS" BO_ 431 1;
BA_ "GenMsgCycleTime" BO_ 431 10;
BA_ "GenMsgCycleTimeFast" BO_ 431 0;
BA_ "GenMsgSendType" BO_ 431 0;
BA_ "VFrameFormat" BO_ 431 14;
BA_ "CANFD_BRS" BO_ 431 1;
BA_ "GenMsgCycleTime" BO_ 431 10;
BA_ "GenMsgCycleTimeFast" BO_ 431 0;
BA_ "GenMsgSendType" BO_ 431 0;
BA_ "VFrameFormat" BO_ 431 14;
BA_ "CANFD_BRS" BO_ 431 1;
BA_ "GenMsgCycleTime" BO_ 431 10;
BA_ "GenMsgCycleTimeFast" BO_ 431 0;
BA_ "GenMsgSendType" BO_ 431 0;
BA_ "VFrameFormat" BO_ 431 14;
BA_ "CANFD_BRS" BO_ 431 1;
BA_ "GenMsgCycleTime" BO_ 431 10;
BA_ "GenMsgCycleTimeFast" BO_ 431 0;
BA_ "GenMsgSendType" BO_ 431 0;
BA_ "VFrameFormat" BO_ 431 14;
BA_ "CANFD_BRS" BO_ 431 1;
BA_ "GenMsgCycleTime" BO_ 431 10;
BA_ "GenMsgCycleTimeFast" BO_ 431 0;
BA_ "GenMsgSendType" BO_ 431 0;
BA_ "VFrameFormat" BO_ 431 14;
BA_ "CANFD_BRS" BO_ 431 1;
BA_ "GenMsgCycleTime" BO_ 431 10;
BA_ "GenMsgCycleTimeFast" BO_ 431 0;
BA_ "GenMsgSendType" BO_ 431 0;
BA_ "VFrameFormat" BO_ 431 14;
BA_ "CANFD_BRS" BO_ 431 1;
BA_ "GenMsgCycleTime" BO_ 431 10;
BA_ "GenMsgCycleTimeFast" BO_ 431 0;
BA_ "GenMsgSendType" BO_ 431 0;
BA_ "VFrameFormat" BO_ 431 14;
BA_ "CANFD_BRS" BO_ 431 1;
BA_ "GenMsgCycleTime" BO_ 431 10;
BA_ "GenMsgCycleTimeFast" BO_ 431 0;
BA_ "GenMsgSendType" BO_ 431 0;
BA_ "VFrameFormat" BO_ 431 14;
BA_ "CANFD_BRS" BO_ 431 1;
BA_ "GenMsgCycleTime" BO_ 431 10;
BA_ "GenMsgCycleTimeFast" BO_ 431 0;
BA_ "GenMsgSendType" BO_ 431 0;
BA_ "VFrameFormat" BO_ 431 14;
BA_ "CANFD_BRS" BO_ 431 1;
BA_ "GenMsgCycleTime" BO_ 431 10;
BA_ "GenMsgCycleTimeFast" BO_ 431 0;
BA_ "GenMsgSendType" BO_ 431 0;
BA_ "VFrameFormat" BO_ 431 14;
BA_ "CANFD_BRS" BO_ 431 1;
BA_ "GenMsgCycleTime" BO_ 431 10;
BA_ "GenMsgCycleTimeFast" BO_ 431 0;
BA_ "GenMsgSendType" BO_ 431 0;
BA_ "VFrameFormat" BO_ 431 14;
BA_ "CANFD_BRS" BO_ 431 1;
BA_ "GenMsgCycleTime" BO_ 431 10;
BA_ "GenMsgCycleTimeFast" BO_ 431 0;
BA_ "GenMsgSendType" BO_ 431 0;
BA_ "VFrameFormat" BO_ 431 14;
BA_ "CANFD_BRS" BO_ 431 1;
BA_ "GenMsgCycleTime" BO_ 615 20;
BA_ "GenMsgCycleTimeFast" BO_ 615 0;
BA_ "GenMsgSendType" BO_ 615 0;
BA_ "VFrameFormat" BO_ 615 14;
BA_ "CANFD_BRS" BO_ 615 1;
BA_ "GenMsgCycleTime" BO_ 615 20;
BA_ "GenMsgCycleTimeFast" BO_ 615 0;
BA_ "GenMsgSendType" BO_ 615 0;
BA_ "VFrameFormat" BO_ 615 14;
BA_ "CANFD_BRS" BO_ 615 1;
BA_ "GenMsgCycleTime" BO_ 615 20;
BA_ "GenMsgCycleTimeFast" BO_ 615 0;
BA_ "GenMsgSendType" BO_ 615 0;
BA_ "VFrameFormat" BO_ 615 14;
BA_ "CANFD_BRS" BO_ 615 1;
BA_ "GenMsgCycleTime" BO_ 615 20;
BA_ "GenMsgCycleTimeFast" BO_ 615 0;
BA_ "GenMsgSendType" BO_ 615 0;
BA_ "VFrameFormat" BO_ 615 14;
BA_ "CANFD_BRS" BO_ 615 1;
BA_ "GenMsgCycleTime" BO_ 615 20;
BA_ "GenMsgCycleTimeFast" BO_ 615 0;
BA_ "GenMsgSendType" BO_ 615 0;
BA_ "VFrameFormat" BO_ 615 14;
BA_ "CANFD_BRS" BO_ 615 1;
BA_ "GenMsgCycleTime" BO_ 615 20;
BA_ "GenMsgCycleTimeFast" BO_ 615 0;
BA_ "GenMsgSendType" BO_ 615 0;
BA_ "VFrameFormat" BO_ 615 14;
BA_ "CANFD_BRS" BO_ 615 1;
BA_ "GenMsgCycleTime" BO_ 615 20;
BA_ "GenMsgCycleTimeFast" BO_ 615 0;
BA_ "GenMsgSendType" BO_ 615 0;
BA_ "VFrameFormat" BO_ 615 14;
BA_ "CANFD_BRS" BO_ 615 1;
BA_ "GenMsgCycleTime" BO_ 615 20;
BA_ "GenMsgCycleTimeFast" BO_ 615 0;
BA_ "GenMsgSendType" BO_ 615 0;
BA_ "VFrameFormat" BO_ 615 14;
BA_ "CANFD_BRS" BO_ 615 1;
BA_ "GenMsgCycleTime" BO_ 615 20;
BA_ "GenMsgCycleTimeFast" BO_ 615 0;
BA_ "GenMsgSendType" BO_ 615 0;
BA_ "VFrameFormat" BO_ 615 14;
BA_ "CANFD_BRS" BO_ 615 1;
BA_ "GenMsgCycleTime" BO_ 615 20;
BA_ "GenMsgCycleTimeFast" BO_ 615 0;
BA_ "GenMsgSendType" BO_ 615 0;
BA_ "VFrameFormat" BO_ 615 14;
BA_ "CANFD_BRS" BO_ 615 1;
BA_ "GenMsgCycleTime" BO_ 615 20;
BA_ "GenMsgCycleTimeFast" BO_ 615 0;
BA_ "GenMsgSendType" BO_ 615 0;
BA_ "VFrameFormat" BO_ 615 14;
BA_ "CANFD_BRS" BO_ 615 1;
BA_ "GenMsgCycleTime" BO_ 615 20;
BA_ "GenMsgCycleTimeFast" BO_ 615 0;
BA_ "GenMsgSendType" BO_ 615 0;
BA_ "VFrameFormat" BO_ 615 14;
BA_ "CANFD_BRS" BO_ 615 1;
BA_ "GenMsgCycleTime" BO_ 615 20;
BA_ "GenMsgCycleTimeFast" BO_ 615 0;
BA_ "GenMsgSendType" BO_ 615 0;
BA_ "VFrameFormat" BO_ 615 14;
BA_ "CANFD_BRS" BO_ 615 1;
BA_ "GenMsgCycleTime" BO_ 615 20;
BA_ "GenMsgCycleTimeFast" BO_ 615 0;
BA_ "GenMsgSendType" BO_ 615 0;
BA_ "VFrameFormat" BO_ 615 14;
BA_ "CANFD_BRS" BO_ 615 1;
BA_ "GenMsgCycleTime" BO_ 615 20;
BA_ "GenMsgCycleTimeFast" BO_ 615 0;
BA_ "GenMsgSendType" BO_ 615 0;
BA_ "VFrameFormat" BO_ 615 14;
BA_ "CANFD_BRS" BO_ 615 1;
BA_ "GenMsgCycleTime" BO_ 615 20;
BA_ "GenMsgCycleTimeFast" BO_ 615 0;
BA_ "GenMsgSendType" BO_ 615 0;
BA_ "VFrameFormat" BO_ 615 14;
BA_ "CANFD_BRS" BO_ 615 1;
BA_ "GenMsgCycleTime" BO_ 615 20;
BA_ "GenMsgCycleTimeFast" BO_ 615 0;
BA_ "GenMsgSendType" BO_ 615 0;
BA_ "VFrameFormat" BO_ 615 14;
BA_ "CANFD_BRS" BO_ 615 1;
BA_ "GenMsgCycleTime" BO_ 615 20;
BA_ "GenMsgCycleTimeFast" BO_ 615 0;
BA_ "GenMsgSendType" BO_ 615 0;
BA_ "VFrameFormat" BO_ 615 14;
BA_ "CANFD_BRS" BO_ 615 1;
BA_ "GenMsgCycleTime" BO_ 615 20;
BA_ "GenMsgCycleTimeFast" BO_ 615 0;
BA_ "GenMsgSendType" BO_ 615 0;
BA_ "VFrameFormat" BO_ 615 14;
BA_ "CANFD_BRS" BO_ 615 1;
BA_ "GenMsgCycleTime" BO_ 615 20;
BA_ "GenMsgCycleTimeFast" BO_ 615 0;
BA_ "GenMsgSendType" BO_ 615 0;
BA_ "VFrameFormat" BO_ 615 14;
BA_ "CANFD_BRS" BO_ 615 1;
BA_ "GenMsgCycleTime" BO_ 615 20;
BA_ "GenMsgCycleTimeFast" BO_ 615 0;
BA_ "GenMsgSendType" BO_ 615 0;
BA_ "VFrameFormat" BO_ 615 14;
BA_ "CANFD_BRS" BO_ 615 1;
BA_ "GenMsgCycleTime" BO_ 615 20;
BA_ "GenMsgCycleTimeFast" BO_ 615 0;
BA_ "GenMsgSendType" BO_ 615 0;
BA_ "VFrameFormat" BO_ 615 14;
BA_ "CANFD_BRS" BO_ 615 1;
BA_ "GenMsgCycleTime" BO_ 615 20;
BA_ "GenMsgCycleTimeFast" BO_ 615 0;
BA_ "GenMsgSendType" BO_ 615 0;
BA_ "VFrameFormat" BO_ 615 14;
BA_ "CANFD_BRS" BO_ 615 1;
BA_ "GenMsgCycleTime" BO_ 615 20;
BA_ "GenMsgCycleTimeFast" BO_ 615 0;
BA_ "GenMsgSendType" BO_ 615 0;
BA_ "VFrameFormat" BO_ 615 14;
BA_ "CANFD_BRS" BO_ 615 1;
BA_ "GenMsgCycleTime" BO_ 615 20;
BA_ "GenMsgCycleTimeFast" BO_ 615 0;
BA_ "GenMsgSendType" BO_ 615 0;
BA_ "VFrameFormat" BO_ 615 14;
BA_ "CANFD_BRS" BO_ 615 1;
BA_ "GenMsgCycleTime" BO_ 615 20;
BA_ "GenMsgCycleTimeFast" BO_ 615 0;
BA_ "GenMsgSendType" BO_ 615 0;
BA_ "VFrameFormat" BO_ 615 14;
BA_ "CANFD_BRS" BO_ 615 1;
BA_ "GenMsgCycleTime" BO_ 615 20;
BA_ "GenMsgCycleTimeFast" BO_ 615 0;
BA_ "GenMsgSendType" BO_ 615 0;
BA_ "VFrameFormat" BO_ 615 14;
BA_ "CANFD_BRS" BO_ 615 1;
BA_ "GenMsgCycleTime" BO_ 615 20;
BA_ "GenMsgCycleTimeFast" BO_ 615 0;
BA_ "GenMsgSendType" BO_ 615 0;
BA_ "VFrameFormat" BO_ 615 14;
BA_ "CANFD_BRS" BO_ 615 1;
BA_ "GenMsgCycleTime" BO_ 615 20;
BA_ "GenMsgCycleTimeFast" BO_ 615 0;
BA_ "GenMsgSendType" BO_ 615 0;
BA_ "VFrameFormat" BO_ 615 14;
BA_ "CANFD_BRS" BO_ 615 1;
BA_ "GenMsgCycleTime" BO_ 615 20;
BA_ "GenMsgCycleTimeFast" BO_ 615 0;
BA_ "GenMsgSendType" BO_ 615 0;
BA_ "VFrameFormat" BO_ 615 14;
BA_ "CANFD_BRS" BO_ 615 1;
BA_ "GenMsgCycleTime" BO_ 615 20;
BA_ "GenMsgCycleTimeFast" BO_ 615 0;
BA_ "GenMsgSendType" BO_ 615 0;
BA_ "VFrameFormat" BO_ 615 14;
BA_ "CANFD_BRS" BO_ 615 1;
BA_ "GenMsgCycleTime" BO_ 615 20;
BA_ "GenMsgCycleTimeFast" BO_ 615 0;
BA_ "GenMsgSendType" BO_ 615 0;
BA_ "VFrameFormat" BO_ 615 14;
BA_ "CANFD_BRS" BO_ 615 1;
BA_ "GenMsgCycleTime" BO_ 615 20;
BA_ "GenMsgCycleTimeFast" BO_ 615 0;
BA_ "GenMsgSendType" BO_ 615 0;
BA_ "VFrameFormat" BO_ 615 14;
BA_ "CANFD_BRS" BO_ 615 1;
BA_ "GenMsgCycleTime" BO_ 615 20;
BA_ "GenMsgCycleTimeFast" BO_ 615 0;
BA_ "GenMsgSendType" BO_ 615 0;
BA_ "VFrameFormat" BO_ 615 14;
BA_ "CANFD_BRS" BO_ 615 1;
BA_ "GenMsgCycleTime" BO_ 615 20;
BA_ "GenMsgCycleTimeFast" BO_ 615 0;
BA_ "GenMsgSendType" BO_ 615 0;
BA_ "VFrameFormat" BO_ 615 14;
BA_ "CANFD_BRS" BO_ 615 1;
BA_ "GenMsgCycleTime" BO_ 615 20;
BA_ "GenMsgCycleTimeFast" BO_ 615 0;
BA_ "GenMsgSendType" BO_ 615 0;
BA_ "VFrameFormat" BO_ 615 14;
BA_ "CANFD_BRS" BO_ 615 1;
BA_ "GenMsgCycleTime" BO_ 615 20;
BA_ "GenMsgCycleTimeFast" BO_ 615 0;
BA_ "GenMsgSendType" BO_ 615 0;
BA_ "VFrameFormat" BO_ 615 14;
BA_ "CANFD_BRS" BO_ 615 1;
BA_ "GenMsgCycleTime" BO_ 615 20;
BA_ "GenMsgCycleTimeFast" BO_ 615 0;
BA_ "GenMsgSendType" BO_ 615 0;
BA_ "VFrameFormat" BO_ 615 14;
BA_ "CANFD_BRS" BO_ 615 1;
BA_ "GenMsgCycleTime" BO_ 615 20;
BA_ "GenMsgCycleTimeFast" BO_ 615 0;
BA_ "GenMsgSendType" BO_ 615 0;
BA_ "VFrameFormat" BO_ 615 14;
BA_ "CANFD_BRS" BO_ 615 1;
BA_ "GenMsgCycleTime" BO_ 615 20;
BA_ "GenMsgCycleTimeFast" BO_ 615 0;
BA_ "GenMsgSendType" BO_ 615 0;
BA_ "VFrameFormat" BO_ 615 14;
BA_ "CANFD_BRS" BO_ 615 1;
BA_ "GenMsgCycleTime" BO_ 615 20;
BA_ "GenMsgCycleTimeFast" BO_ 615 0;
BA_ "GenMsgSendType" BO_ 615 0;
BA_ "VFrameFormat" BO_ 615 14;
BA_ "CANFD_BRS" BO_ 615 1;
BA_ "GenMsgCycleTime" BO_ 615 20;
BA_ "GenMsgCycleTimeFast" BO_ 615 0;
BA_ "GenMsgSendType" BO_ 615 0;
BA_ "VFrameFormat" BO_ 615 14;
BA_ "CANFD_BRS" BO_ 615 1;
BA_ "GenMsgCycleTime" BO_ 615 20;
BA_ "GenMsgCycleTimeFast" BO_ 615 0;
BA_ "GenMsgSendType" BO_ 615 0;
BA_ "VFrameFormat" BO_ 615 14;
BA_ "CANFD_BRS" BO_ 615 1;
BA_ "GenMsgCycleTime" BO_ 615 20;
BA_ "GenMsgCycleTimeFast" BO_ 615 0;
BA_ "GenMsgSendType" BO_ 615 0;
BA_ "VFrameFormat" BO_ 615 14;
BA_ "CANFD_BRS" BO_ 615 1;
BA_ "GenMsgCycleTime" BO_ 615 20;
BA_ "GenMsgCycleTimeFast" BO_ 615 0;
BA_ "GenMsgSendType" BO_ 615 0;
BA_ "VFrameFormat" BO_ 615 14;
BA_ "CANFD_BRS" BO_ 615 1;
BA_ "GenMsgCycleTime" BO_ 615 20;
BA_ "GenMsgCycleTimeFast" BO_ 615 0;
BA_ "GenMsgSendType" BO_ 615 0;
BA_ "VFrameFormat" BO_ 615 14;
BA_ "CANFD_BRS" BO_ 615 1;
BA_ "GenMsgCycleTime" BO_ 615 20;
BA_ "GenMsgCycleTimeFast" BO_ 615 0;
BA_ "GenMsgSendType" BO_ 615 0;
BA_ "VFrameFormat" BO_ 615 14;
BA_ "CANFD_BRS" BO_ 615 1;
BA_ "GenMsgCycleTime" BO_ 615 20;
BA_ "GenMsgCycleTimeFast" BO_ 615 0;
BA_ "GenMsgSendType" BO_ 615 0;
BA_ "VFrameFormat" BO_ 615 14;
BA_ "CANFD_BRS" BO_ 615 1;
BA_ "GenMsgCycleTime" BO_ 615 20;
BA_ "GenMsgCycleTimeFast" BO_ 615 0;
BA_ "GenMsgSendType" BO_ 615 0;
BA_ "VFrameFormat" BO_ 615 14;
BA_ "CANFD_BRS" BO_ 615 1;
BA_ "GenMsgCycleTime" BO_ 615 20;
BA_ "GenMsgCycleTimeFast" BO_ 615 0;
BA_ "GenMsgSendType" BO_ 615 0;
BA_ "VFrameFormat" BO_ 615 14;
BA_ "CANFD_BRS" BO_ 615 1;
BA_ "GenMsgCycleTime" BO_ 615 20;
BA_ "GenMsgCycleTimeFast" BO_ 615 0;
BA_ "GenMsgSendType" BO_ 615 0;
BA_ "VFrameFormat" BO_ 615 14;
BA_ "CANFD_BRS" BO_ 615 1;
BA_ "GenMsgCycleTime" BO_ 615 20;
BA_ "GenMsgCycleTimeFast" BO_ 615 0;
BA_ "GenMsgSendType" BO_ 615 0;
BA_ "VFrameFormat" BO_ 615 14;
BA_ "CANFD_BRS" BO_ 615 1;
BA_ "GenMsgCycleTime" BO_ 430 10;
BA_ "GenMsgCycleTimeFast" BO_ 430 0;
BA_ "GenMsgSendType" BO_ 430 0;
BA_ "VFrameFormat" BO_ 430 14;
BA_ "CANFD_BRS" BO_ 430 1;
BA_ "GenMsgCycleTime" BO_ 430 10;
BA_ "GenMsgCycleTimeFast" BO_ 430 0;
BA_ "GenMsgSendType" BO_ 430 0;
BA_ "VFrameFormat" BO_ 430 14;
BA_ "CANFD_BRS" BO_ 430 1;
BA_ "GenMsgCycleTime" BO_ 430 10;
BA_ "GenMsgCycleTimeFast" BO_ 430 0;
BA_ "GenMsgSendType" BO_ 430 0;
BA_ "VFrameFormat" BO_ 430 14;
BA_ "CANFD_BRS" BO_ 430 1;
BA_ "GenMsgCycleTime" BO_ 430 10;
BA_ "GenMsgCycleTimeFast" BO_ 430 0;
BA_ "GenMsgSendType" BO_ 430 0;
BA_ "VFrameFormat" BO_ 430 14;
BA_ "CANFD_BRS" BO_ 430 1;
BA_ "GenMsgCycleTime" BO_ 430 10;
BA_ "GenMsgCycleTimeFast" BO_ 430 0;
BA_ "GenMsgSendType" BO_ 430 0;
BA_ "VFrameFormat" BO_ 430 14;
BA_ "CANFD_BRS" BO_ 430 1;
BA_ "GenMsgCycleTime" BO_ 430 10;
BA_ "GenMsgCycleTimeFast" BO_ 430 0;
BA_ "GenMsgSendType" BO_ 430 0;
BA_ "VFrameFormat" BO_ 430 14;
BA_ "CANFD_BRS" BO_ 430 1;
BA_ "GenMsgCycleTime" BO_ 430 10;
BA_ "GenMsgCycleTimeFast" BO_ 430 0;
BA_ "GenMsgSendType" BO_ 430 0;
BA_ "VFrameFormat" BO_ 430 14;
BA_ "CANFD_BRS" BO_ 430 1;
BA_ "GenMsgCycleTime" BO_ 430 10;
BA_ "GenMsgCycleTimeFast" BO_ 430 0;
BA_ "GenMsgSendType" BO_ 430 0;
BA_ "VFrameFormat" BO_ 430 14;
BA_ "CANFD_BRS" BO_ 430 1;
BA_ "GenMsgCycleTime" BO_ 430 10;
BA_ "GenMsgCycleTimeFast" BO_ 430 0;
BA_ "GenMsgSendType" BO_ 430 0;
BA_ "VFrameFormat" BO_ 430 14;
BA_ "CANFD_BRS" BO_ 430 1;
BA_ "GenMsgCycleTime" BO_ 430 10;
BA_ "GenMsgCycleTimeFast" BO_ 430 0;
BA_ "GenMsgSendType" BO_ 430 0;
BA_ "VFrameFormat" BO_ 430 14;
BA_ "CANFD_BRS" BO_ 430 1;
BA_ "GenMsgCycleTime" BO_ 430 10;
BA_ "GenMsgCycleTimeFast" BO_ 430 0;
BA_ "GenMsgSendType" BO_ 430 0;
BA_ "VFrameFormat" BO_ 430 14;
BA_ "CANFD_BRS" BO_ 430 1;
BA_ "GenMsgCycleTime" BO_ 430 10;
BA_ "GenMsgCycleTimeFast" BO_ 430 0;
BA_ "GenMsgSendType" BO_ 430 0;
BA_ "VFrameFormat" BO_ 430 14;
BA_ "CANFD_BRS" BO_ 430 1;
BA_ "GenMsgCycleTime" BO_ 430 10;
BA_ "GenMsgCycleTimeFast" BO_ 430 0;
BA_ "GenMsgSendType" BO_ 430 0;
BA_ "VFrameFormat" BO_ 430 14;
BA_ "CANFD_BRS" BO_ 430 1;
BA_ "GenMsgCycleTime" BO_ 430 10;
BA_ "GenMsgCycleTimeFast" BO_ 430 0;
BA_ "GenMsgSendType" BO_ 430 0;
BA_ "VFrameFormat" BO_ 430 14;
BA_ "CANFD_BRS" BO_ 430 1;
BA_ "GenMsgCycleTime" BO_ 430 10;
BA_ "GenMsgCycleTimeFast" BO_ 430 0;
BA_ "GenMsgSendType" BO_ 430 0;
BA_ "VFrameFormat" BO_ 430 14;
BA_ "CANFD_BRS" BO_ 430 1;
BA_ "GenMsgCycleTime" BO_ 430 10;
BA_ "GenMsgCycleTimeFast" BO_ 430 0;
BA_ "GenMsgSendType" BO_ 430 0;
BA_ "VFrameFormat" BO_ 430 14;
BA_ "CANFD_BRS" BO_ 430 1;
BA_ "GenMsgCycleTime" BO_ 290 500;
BA_ "GenMsgCycleTimeFast" BO_ 290 40;
BA_ "GenMsgSendType" BO_ 290 3;
BA_ "VFrameFormat" BO_ 290 14;
BA_ "CANFD_BRS" BO_ 290 1;
BA_ "GenMsgCycleTime" BO_ 290 500;
BA_ "GenMsgCycleTimeFast" BO_ 290 40;
BA_ "GenMsgSendType" BO_ 290 3;
BA_ "VFrameFormat" BO_ 290 14;
BA_ "CANFD_BRS" BO_ 290 1;
BA_ "GenMsgCycleTime" BO_ 290 500;
BA_ "GenMsgCycleTimeFast" BO_ 290 40;
BA_ "GenMsgSendType" BO_ 290 3;
BA_ "VFrameFormat" BO_ 290 14;
BA_ "CANFD_BRS" BO_ 290 1;
BA_ "GenMsgCycleTime" BO_ 290 500;
BA_ "GenMsgCycleTimeFast" BO_ 290 40;
BA_ "GenMsgSendType" BO_ 290 3;
BA_ "VFrameFormat" BO_ 290 14;
BA_ "CANFD_BRS" BO_ 290 1;
BA_ "GenMsgCycleTime" BO_ 290 500;
BA_ "GenMsgCycleTimeFast" BO_ 290 40;
BA_ "GenMsgSendType" BO_ 290 3;
BA_ "VFrameFormat" BO_ 290 14;
BA_ "CANFD_BRS" BO_ 290 1;
BA_ "GenMsgCycleTime" BO_ 290 500;
BA_ "GenMsgCycleTimeFast" BO_ 290 40;
BA_ "GenMsgSendType" BO_ 290 3;
BA_ "VFrameFormat" BO_ 290 14;
BA_ "CANFD_BRS" BO_ 290 1;
BA_ "GenMsgCycleTime" BO_ 398 10;
BA_ "GenMsgCycleTimeFast" BO_ 398 0;
BA_ "GenMsgSendType" BO_ 398 0;
BA_ "VFrameFormat" BO_ 398 14;
BA_ "CANFD_BRS" BO_ 398 1;
BA_ "GenMsgCycleTime" BO_ 398 10;
BA_ "GenMsgCycleTimeFast" BO_ 398 0;
BA_ "GenMsgSendType" BO_ 398 0;
BA_ "VFrameFormat" BO_ 398 14;
BA_ "CANFD_BRS" BO_ 398 1;
BA_ "GenMsgCycleTime" BO_ 398 10;
BA_ "GenMsgCycleTimeFast" BO_ 398 0;
BA_ "GenMsgSendType" BO_ 398 0;
BA_ "VFrameFormat" BO_ 398 14;
BA_ "CANFD_BRS" BO_ 398 1;
BA_ "GenMsgCycleTime" BO_ 398 10;
BA_ "GenMsgCycleTimeFast" BO_ 398 0;
BA_ "GenMsgSendType" BO_ 398 0;
BA_ "VFrameFormat" BO_ 398 14;
BA_ "CANFD_BRS" BO_ 398 1;
BA_ "GenMsgCycleTime" BO_ 398 10;
BA_ "GenMsgCycleTimeFast" BO_ 398 0;
BA_ "GenMsgSendType" BO_ 398 0;
BA_ "VFrameFormat" BO_ 398 14;
BA_ "CANFD_BRS" BO_ 398 1;
BA_ "GenMsgCycleTime" BO_ 398 10;
BA_ "GenMsgCycleTimeFast" BO_ 398 0;
BA_ "GenMsgSendType" BO_ 398 0;
BA_ "VFrameFormat" BO_ 398 14;
BA_ "CANFD_BRS" BO_ 398 1;
BA_ "GenMsgCycleTime" BO_ 161 0;
BA_ "GenMsgCycleTimeFast" BO_ 161 0;
BA_ "GenMsgSendType" BO_ 161 1;
BA_ "VFrameFormat" BO_ 161 14;
BA_ "CANFD_BRS" BO_ 161 1;
BA_ "GenMsgCycleTime" BO_ 161 0;
BA_ "GenMsgCycleTimeFast" BO_ 161 0;
BA_ "GenMsgSendType" BO_ 161 1;
BA_ "VFrameFormat" BO_ 161 14;
BA_ "CANFD_BRS" BO_ 161 1;
BA_ "GenMsgCycleTime" BO_ 161 0;
BA_ "GenMsgCycleTimeFast" BO_ 161 0;
BA_ "GenMsgSendType" BO_ 161 1;
BA_ "VFrameFormat" BO_ 161 14;
BA_ "CANFD_BRS" BO_ 161 1;
BA_ "GenMsgCycleTime" BO_ 161 0;
BA_ "GenMsgCycleTimeFast" BO_ 161 0;
BA_ "GenMsgSendType" BO_ 161 1;
BA_ "VFrameFormat" BO_ 161 14;
BA_ "CANFD_BRS" BO_ 161 1;
BA_ "GenMsgCycleTime" BO_ 161 0;
BA_ "GenMsgCycleTimeFast" BO_ 161 0;
BA_ "GenMsgSendType" BO_ 161 1;
BA_ "VFrameFormat" BO_ 161 14;
BA_ "CANFD_BRS" BO_ 161 1;
BA_ "GenMsgCycleTime" BO_ 161 0;
BA_ "GenMsgCycleTimeFast" BO_ 161 0;
BA_ "GenMsgSendType" BO_ 161 1;
BA_ "VFrameFormat" BO_ 161 14;
BA_ "CANFD_BRS" BO_ 161 1;
BA_ "GenMsgCycleTime" BO_ 1045 1000;
BA_ "GenMsgCycleTimeFast" BO_ 1045 0;
BA_ "GenMsgSendType" BO_ 1045 0;
BA_ "VFrameFormat" BO_ 1045 14;
BA_ "CANFD_BRS" BO_ 1045 1;
BA_ "GenMsgCycleTime" BO_ 1045 1000;
BA_ "GenMsgCycleTimeFast" BO_ 1045 0;
BA_ "GenMsgSendType" BO_ 1045 0;
BA_ "VFrameFormat" BO_ 1045 14;
BA_ "CANFD_BRS" BO_ 1045 1;
BA_ "GenMsgCycleTime" BO_ 363 10;
BA_ "GenMsgCycleTimeFast" BO_ 363 0;
BA_ "GenMsgSendType" BO_ 363 0;
BA_ "VFrameFormat" BO_ 363 14;
BA_ "CANFD_BRS" BO_ 363 1;
BA_ "GenMsgCycleTime" BO_ 363 10;
BA_ "GenMsgCycleTimeFast" BO_ 363 0;
BA_ "GenMsgSendType" BO_ 363 0;
BA_ "VFrameFormat" BO_ 363 14;
BA_ "CANFD_BRS" BO_ 363 1;
BA_ "GenMsgCycleTime" BO_ 363 10;
BA_ "GenMsgCycleTimeFast" BO_ 363 0;
BA_ "GenMsgSendType" BO_ 363 0;
BA_ "VFrameFormat" BO_ 363 14;
BA_ "CANFD_BRS" BO_ 363 1;
BA_ "GenMsgCycleTime" BO_ 363 10;
BA_ "GenMsgCycleTimeFast" BO_ 363 0;
BA_ "GenMsgSendType" BO_ 363 0;
BA_ "VFrameFormat" BO_ 363 14;
BA_ "CANFD_BRS" BO_ 363 1;
BA_ "GenMsgCycleTime" BO_ 363 10;
BA_ "GenMsgCycleTimeFast" BO_ 363 0;
BA_ "GenMsgSendType" BO_ 363 0;
BA_ "VFrameFormat" BO_ 363 14;
BA_ "CANFD_BRS" BO_ 363 1;
BA_ "GenMsgCycleTime" BO_ 363 10;
BA_ "GenMsgCycleTimeFast" BO_ 363 0;
BA_ "GenMsgSendType" BO_ 363 0;
BA_ "VFrameFormat" BO_ 363 14;
BA_ "CANFD_BRS" BO_ 363 1;
BA_ "GenMsgCycleTime" BO_ 363 10;
BA_ "GenMsgCycleTimeFast" BO_ 363 0;
BA_ "GenMsgSendType" BO_ 363 0;
BA_ "VFrameFormat" BO_ 363 14;
BA_ "CANFD_BRS" BO_ 363 1;
BA_ "GenMsgCycleTime" BO_ 363 10;
BA_ "GenMsgCycleTimeFast" BO_ 363 0;
BA_ "GenMsgSendType" BO_ 363 0;
BA_ "VFrameFormat" BO_ 363 14;
BA_ "CANFD_BRS" BO_ 363 1;
BA_ "GenMsgCycleTime" BO_ 363 10;
BA_ "GenMsgCycleTimeFast" BO_ 363 0;
BA_ "GenMsgSendType" BO_ 363 0;
BA_ "VFrameFormat" BO_ 363 14;
BA_ "CANFD_BRS" BO_ 363 1;
BA_ "GenMsgCycleTime" BO_ 363 10;
BA_ "GenMsgCycleTimeFast" BO_ 363 0;
BA_ "GenMsgSendType" BO_ 363 0;
BA_ "VFrameFormat" BO_ 363 14;
BA_ "CANFD_BRS" BO_ 363 1;
BA_ "GenMsgCycleTime" BO_ 363 10;
BA_ "GenMsgCycleTimeFast" BO_ 363 0;
BA_ "GenMsgSendType" BO_ 363 0;
BA_ "VFrameFormat" BO_ 363 14;
BA_ "CANFD_BRS" BO_ 363 1;
BA_ "GenMsgCycleTime" BO_ 363 10;
BA_ "GenMsgCycleTimeFast" BO_ 363 0;
BA_ "GenMsgSendType" BO_ 363 0;
BA_ "VFrameFormat" BO_ 363 14;
BA_ "CANFD_BRS" BO_ 363 1;
BA_ "GenMsgCycleTime" BO_ 363 10;
BA_ "GenMsgCycleTimeFast" BO_ 363 0;
BA_ "GenMsgSendType" BO_ 363 0;
BA_ "VFrameFormat" BO_ 363 14;
BA_ "CANFD_BRS" BO_ 363 1;
BA_ "GenMsgCycleTime" BO_ 363 10;
BA_ "GenMsgCycleTimeFast" BO_ 363 0;
BA_ "GenMsgSendType" BO_ 363 0;
BA_ "VFrameFormat" BO_ 363 14;
BA_ "CANFD_BRS" BO_ 363 1;
BA_ "GenMsgCycleTime" BO_ 363 10;
BA_ "GenMsgCycleTimeFast" BO_ 363 0;
BA_ "GenMsgSendType" BO_ 363 0;
BA_ "VFrameFormat" BO_ 363 14;
BA_ "CANFD_BRS" BO_ 363 1;
BA_ "GenMsgCycleTime" BO_ 363 10;
BA_ "GenMsgCycleTimeFast" BO_ 363 0;
BA_ "GenMsgSendType" BO_ 363 0;
BA_ "VFrameFormat" BO_ 363 14;
BA_ "CANFD_BRS" BO_ 363 1;
BA_ "GenMsgCycleTime" BO_ 363 10;
BA_ "GenMsgCycleTimeFast" BO_ 363 0;
BA_ "GenMsgSendType" BO_ 363 0;
BA_ "VFrameFormat" BO_ 363 14;
BA_ "CANFD_BRS" BO_ 363 1;
BA_ "GenMsgCycleTime" BO_ 363 10;
BA_ "GenMsgCycleTimeFast" BO_ 363 0;
BA_ "GenMsgSendType" BO_ 363 0;
BA_ "VFrameFormat" BO_ 363 14;
BA_ "CANFD_BRS" BO_ 363 1;
BA_ "GenMsgCycleTime" BO_ 363 10;
BA_ "GenMsgCycleTimeFast" BO_ 363 0;
BA_ "GenMsgSendType" BO_ 363 0;
BA_ "VFrameFormat" BO_ 363 14;
BA_ "CANFD_BRS" BO_ 363 1;
BA_ "GenMsgCycleTime" BO_ 363 10;
BA_ "GenMsgCycleTimeFast" BO_ 363 0;
BA_ "GenMsgSendType" BO_ 363 0;
BA_ "VFrameFormat" BO_ 363 14;
BA_ "CANFD_BRS" BO_ 363 1;
BA_ "GenMsgCycleTime" BO_ 363 10;
BA_ "GenMsgCycleTimeFast" BO_ 363 0;
BA_ "GenMsgSendType" BO_ 363 0;
BA_ "VFrameFormat" BO_ 363 14;
BA_ "CANFD_BRS" BO_ 363 1;
BA_ "GenMsgCycleTime" BO_ 363 10;
BA_ "GenMsgCycleTimeFast" BO_ 363 0;
BA_ "GenMsgSendType" BO_ 363 0;
BA_ "VFrameFormat" BO_ 363 14;
BA_ "CANFD_BRS" BO_ 363 1;
BA_ "GenMsgCycleTime" BO_ 363 10;
BA_ "GenMsgCycleTimeFast" BO_ 363 0;
BA_ "GenMsgSendType" BO_ 363 0;
BA_ "VFrameFormat" BO_ 363 14;
BA_ "CANFD_BRS" BO_ 363 1;
BA_ "GenMsgCycleTime" BO_ 363 10;
BA_ "GenMsgCycleTimeFast" BO_ 363 0;
BA_ "GenMsgSendType" BO_ 363 0;
BA_ "VFrameFormat" BO_ 363 14;
BA_ "CANFD_BRS" BO_ 363 1;
BA_ "GenMsgCycleTime" BO_ 363 10;
BA_ "GenMsgCycleTimeFast" BO_ 363 0;
BA_ "GenMsgSendType" BO_ 363 0;
BA_ "VFrameFormat" BO_ 363 14;
BA_ "CANFD_BRS" BO_ 363 1;
BA_ "GenMsgCycleTime" BO_ 363 10;
BA_ "GenMsgCycleTimeFast" BO_ 363 0;
BA_ "GenMsgSendType" BO_ 363 0;
BA_ "VFrameFormat" BO_ 363 14;
BA_ "CANFD_BRS" BO_ 363 1;
BA_ "GenMsgCycleTime" BO_ 363 10;
BA_ "GenMsgCycleTimeFast" BO_ 363 0;
BA_ "GenMsgSendType" BO_ 363 0;
BA_ "VFrameFormat" BO_ 363 14;
BA_ "CANFD_BRS" BO_ 363 1;
BA_ "GenMsgCycleTime" BO_ 363 10;
BA_ "GenMsgCycleTimeFast" BO_ 363 0;
BA_ "GenMsgSendType" BO_ 363 0;
BA_ "VFrameFormat" BO_ 363 14;
BA_ "CANFD_BRS" BO_ 363 1;
BA_ "GenMsgCycleTime" BO_ 363 10;
BA_ "GenMsgCycleTimeFast" BO_ 363 0;
BA_ "GenMsgSendType" BO_ 363 0;
BA_ "VFrameFormat" BO_ 363 14;
BA_ "CANFD_BRS" BO_ 363 1;
BA_ "GenMsgCycleTime" BO_ 363 10;
BA_ "GenMsgCycleTimeFast" BO_ 363 0;
BA_ "GenMsgSendType" BO_ 363 0;
BA_ "VFrameFormat" BO_ 363 14;
BA_ "CANFD_BRS" BO_ 363 1;
BA_ "GenMsgCycleTime" BO_ 363 10;
BA_ "GenMsgCycleTimeFast" BO_ 363 0;
BA_ "GenMsgSendType" BO_ 363 0;
BA_ "VFrameFormat" BO_ 363 14;
BA_ "CANFD_BRS" BO_ 363 1;
BA_ "GenMsgCycleTime" BO_ 363 10;
BA_ "GenMsgCycleTimeFast" BO_ 363 0;
BA_ "GenMsgSendType" BO_ 363 0;
BA_ "VFrameFormat" BO_ 363 14;
BA_ "CANFD_BRS" BO_ 363 1;
BA_ "GenMsgCycleTime" BO_ 363 10;
BA_ "GenMsgCycleTimeFast" BO_ 363 0;
BA_ "GenMsgSendType" BO_ 363 0;
BA_ "VFrameFormat" BO_ 363 14;
BA_ "CANFD_BRS" BO_ 363 1;
BA_ "GenMsgCycleTime" BO_ 363 10;
BA_ "GenMsgCycleTimeFast" BO_ 363 0;
BA_ "GenMsgSendType" BO_ 363 0;
BA_ "VFrameFormat" BO_ 363 14;
BA_ "CANFD_BRS" BO_ 363 1;
BA_ "GenMsgCycleTime" BO_ 363 10;
BA_ "GenMsgCycleTimeFast" BO_ 363 0;
BA_ "GenMsgSendType" BO_ 363 0;
BA_ "VFrameFormat" BO_ 363 14;
BA_ "CANFD_BRS" BO_ 363 1;
BA_ "GenMsgCycleTime" BO_ 363 10;
BA_ "GenMsgCycleTimeFast" BO_ 363 0;
BA_ "GenMsgSendType" BO_ 363 0;
BA_ "VFrameFormat" BO_ 363 14;
BA_ "CANFD_BRS" BO_ 363 1;
BA_ "GenMsgCycleTime" BO_ 363 10;
BA_ "GenMsgCycleTimeFast" BO_ 363 0;
BA_ "GenMsgSendType" BO_ 363 0;
BA_ "VFrameFormat" BO_ 363 14;
BA_ "CANFD_BRS" BO_ 363 1;
BA_ "GenMsgCycleTime" BO_ 363 10;
BA_ "GenMsgCycleTimeFast" BO_ 363 0;
BA_ "GenMsgSendType" BO_ 363 0;
BA_ "VFrameFormat" BO_ 363 14;
BA_ "CANFD_BRS" BO_ 363 1;
BA_ "GenMsgCycleTime" BO_ 363 10;
BA_ "GenMsgCycleTimeFast" BO_ 363 0;
BA_ "GenMsgSendType" BO_ 363 0;
BA_ "VFrameFormat" BO_ 363 14;
BA_ "CANFD_BRS" BO_ 363 1;
BA_ "GenMsgCycleTime" BO_ 363 10;
BA_ "GenMsgCycleTimeFast" BO_ 363 0;
BA_ "GenMsgSendType" BO_ 363 0;
BA_ "VFrameFormat" BO_ 363 14;
BA_ "CANFD_BRS" BO_ 363 1;
BA_ "GenMsgCycleTime" BO_ 363 10;
BA_ "GenMsgCycleTimeFast" BO_ 363 0;
BA_ "GenMsgSendType" BO_ 363 0;
BA_ "VFrameFormat" BO_ 363 14;
BA_ "CANFD_BRS" BO_ 363 1;
BA_ "GenMsgCycleTime" BO_ 363 10;
BA_ "GenMsgCycleTimeFast" BO_ 363 0;
BA_ "GenMsgSendType" BO_ 363 0;
BA_ "VFrameFormat" BO_ 363 14;
BA_ "CANFD_BRS" BO_ 363 1;
BA_ "GenMsgCycleTime" BO_ 363 10;
BA_ "GenMsgCycleTimeFast" BO_ 363 0;
BA_ "GenMsgSendType" BO_ 363 0;
BA_ "VFrameFormat" BO_ 363 14;
BA_ "CANFD_BRS" BO_ 363 1;
BA_ "GenMsgCycleTime" BO_ 363 10;
BA_ "GenMsgCycleTimeFast" BO_ 363 0;
BA_ "GenMsgSendType" BO_ 363 0;
BA_ "VFrameFormat" BO_ 363 14;
BA_ "CANFD_BRS" BO_ 363 1;
BA_ "GenMsgCycleTime" BO_ 363 10;
BA_ "GenMsgCycleTimeFast" BO_ 363 0;
BA_ "GenMsgSendType" BO_ 363 0;
BA_ "VFrameFormat" BO_ 363 14;
BA_ "CANFD_BRS" BO_ 363 1;
BA_ "GenMsgCycleTime" BO_ 363 10;
BA_ "GenMsgCycleTimeFast" BO_ 363 0;
BA_ "GenMsgSendType" BO_ 363 0;
BA_ "VFrameFormat" BO_ 363 14;
BA_ "CANFD_BRS" BO_ 363 1;
BA_ "GenMsgCycleTime" BO_ 363 10;
BA_ "GenMsgCycleTimeFast" BO_ 363 0;
BA_ "GenMsgSendType" BO_ 363 0;
BA_ "VFrameFormat" BO_ 363 14;
BA_ "CANFD_BRS" BO_ 363 1;
BA_ "GenMsgCycleTime" BO_ 363 10;
BA_ "GenMsgCycleTimeFast" BO_ 363 0;
BA_ "GenMsgSendType" BO_ 363 0;
BA_ "VFrameFormat" BO_ 363 14;
BA_ "CANFD_BRS" BO_ 363 1;
BA_ "GenMsgCycleTime" BO_ 363 10;
BA_ "GenMsgCycleTimeFast" BO_ 363 0;
BA_ "GenMsgSendType" BO_ 363 0;
BA_ "VFrameFormat" BO_ 363 14;
BA_ "CANFD_BRS" BO_ 363 1;
BA_ "GenMsgCycleTime" BO_ 363 10;
BA_ "GenMsgCycleTimeFast" BO_ 363 0;
BA_ "GenMsgSendType" BO_ 363 0;
BA_ "VFrameFormat" BO_ 363 14;
BA_ "CANFD_BRS" BO_ 363 1;
BA_ "GenMsgCycleTime" BO_ 433 10;
BA_ "GenMsgCycleTimeFast" BO_ 433 0;
BA_ "GenMsgSendType" BO_ 433 0;
BA_ "VFrameFormat" BO_ 433 14;
BA_ "CANFD_BRS" BO_ 433 1;
BA_ "GenMsgCycleTime" BO_ 433 10;
BA_ "GenMsgCycleTimeFast" BO_ 433 0;
BA_ "GenMsgSendType" BO_ 433 0;
BA_ "VFrameFormat" BO_ 433 14;
BA_ "CANFD_BRS" BO_ 433 1;
BA_ "GenMsgCycleTime" BO_ 433 10;
BA_ "GenMsgCycleTimeFast" BO_ 433 0;
BA_ "GenMsgSendType" BO_ 433 0;
BA_ "VFrameFormat" BO_ 433 14;
BA_ "CANFD_BRS" BO_ 433 1;
BA_ "GenMsgCycleTime" BO_ 433 10;
BA_ "GenMsgCycleTimeFast" BO_ 433 0;
BA_ "GenMsgSendType" BO_ 433 0;
BA_ "VFrameFormat" BO_ 433 14;
BA_ "CANFD_BRS" BO_ 433 1;
BA_ "GenMsgCycleTime" BO_ 433 10;
BA_ "GenMsgCycleTimeFast" BO_ 433 0;
BA_ "GenMsgSendType" BO_ 433 0;
BA_ "VFrameFormat" BO_ 433 14;
BA_ "CANFD_BRS" BO_ 433 1;
BA_ "GenMsgCycleTime" BO_ 433 10;
BA_ "GenMsgCycleTimeFast" BO_ 433 0;
BA_ "GenMsgSendType" BO_ 433 0;
BA_ "VFrameFormat" BO_ 433 14;
BA_ "CANFD_BRS" BO_ 433 1;
BA_ "GenMsgCycleTime" BO_ 433 10;
BA_ "GenMsgCycleTimeFast" BO_ 433 0;
BA_ "GenMsgSendType" BO_ 433 0;
BA_ "VFrameFormat" BO_ 433 14;
BA_ "CANFD_BRS" BO_ 433 1;
BA_ "GenMsgCycleTime" BO_ 433 10;
BA_ "GenMsgCycleTimeFast" BO_ 433 0;
BA_ "GenMsgSendType" BO_ 433 0;
BA_ "VFrameFormat" BO_ 433 14;
BA_ "CANFD_BRS" BO_ 433 1;
BA_ "GenMsgCycleTime" BO_ 433 10;
BA_ "GenMsgCycleTimeFast" BO_ 433 0;
BA_ "GenMsgSendType" BO_ 433 0;
BA_ "VFrameFormat" BO_ 433 14;
BA_ "CANFD_BRS" BO_ 433 1;
BA_ "GenMsgCycleTime" BO_ 433 10;
BA_ "GenMsgCycleTimeFast" BO_ 433 0;
BA_ "GenMsgSendType" BO_ 433 0;
BA_ "VFrameFormat" BO_ 433 14;
BA_ "CANFD_BRS" BO_ 433 1;
BA_ "GenMsgCycleTime" BO_ 433 10;
BA_ "GenMsgCycleTimeFast" BO_ 433 0;
BA_ "GenMsgSendType" BO_ 433 0;
BA_ "VFrameFormat" BO_ 433 14;
BA_ "CANFD_BRS" BO_ 433 1;
BA_ "GenMsgCycleTime" BO_ 433 10;
BA_ "GenMsgCycleTimeFast" BO_ 433 0;
BA_ "GenMsgSendType" BO_ 433 0;
BA_ "VFrameFormat" BO_ 433 14;
BA_ "CANFD_BRS" BO_ 433 1;
BA_ "GenMsgCycleTime" BO_ 433 10;
BA_ "GenMsgCycleTimeFast" BO_ 433 0;
BA_ "GenMsgSendType" BO_ 433 0;
BA_ "VFrameFormat" BO_ 433 14;
BA_ "CANFD_BRS" BO_ 433 1;
BA_ "GenMsgCycleTime" BO_ 433 10;
BA_ "GenMsgCycleTimeFast" BO_ 433 0;
BA_ "GenMsgSendType" BO_ 433 0;
BA_ "VFrameFormat" BO_ 433 14;
BA_ "CANFD_BRS" BO_ 433 1;
BA_ "GenMsgCycleTime" BO_ 433 10;
BA_ "GenMsgCycleTimeFast" BO_ 433 0;
BA_ "GenMsgSendType" BO_ 433 0;
BA_ "VFrameFormat" BO_ 433 14;
BA_ "CANFD_BRS" BO_ 433 1;
BA_ "GenMsgCycleTime" BO_ 433 10;
BA_ "GenMsgCycleTimeFast" BO_ 433 0;
BA_ "GenMsgSendType" BO_ 433 0;
BA_ "VFrameFormat" BO_ 433 14;
BA_ "CANFD_BRS" BO_ 433 1;
BA_ "GenMsgCycleTime" BO_ 433 10;
BA_ "GenMsgCycleTimeFast" BO_ 433 0;
BA_ "GenMsgSendType" BO_ 433 0;
BA_ "VFrameFormat" BO_ 433 14;
BA_ "CANFD_BRS" BO_ 433 1;
BA_ "GenMsgCycleTime" BO_ 433 10;
BA_ "GenMsgCycleTimeFast" BO_ 433 0;
BA_ "GenMsgSendType" BO_ 433 0;
BA_ "VFrameFormat" BO_ 433 14;
BA_ "CANFD_BRS" BO_ 433 1;
BA_ "GenMsgCycleTime" BO_ 433 10;
BA_ "GenMsgCycleTimeFast" BO_ 433 0;
BA_ "GenMsgSendType" BO_ 433 0;
BA_ "VFrameFormat" BO_ 433 14;
BA_ "CANFD_BRS" BO_ 433 1;
BA_ "GenMsgCycleTime" BO_ 433 10;
BA_ "GenMsgCycleTimeFast" BO_ 433 0;
BA_ "GenMsgSendType" BO_ 433 0;
BA_ "VFrameFormat" BO_ 433 14;
BA_ "CANFD_BRS" BO_ 433 1;
BA_ "GenMsgCycleTime" BO_ 433 10;
BA_ "GenMsgCycleTimeFast" BO_ 433 0;
BA_ "GenMsgSendType" BO_ 433 0;
BA_ "VFrameFormat" BO_ 433 14;
BA_ "CANFD_BRS" BO_ 433 1;
BA_ "GenMsgCycleTime" BO_ 433 10;
BA_ "GenMsgCycleTimeFast" BO_ 433 0;
BA_ "GenMsgSendType" BO_ 433 0;
BA_ "VFrameFormat" BO_ 433 14;
BA_ "CANFD_BRS" BO_ 433 1;
BA_ "GenMsgCycleTime" BO_ 433 10;
BA_ "GenMsgCycleTimeFast" BO_ 433 0;
BA_ "GenMsgSendType" BO_ 433 0;
BA_ "VFrameFormat" BO_ 433 14;
BA_ "CANFD_BRS" BO_ 433 1;
BA_ "GenMsgCycleTime" BO_ 433 10;
BA_ "GenMsgCycleTimeFast" BO_ 433 0;
BA_ "GenMsgSendType" BO_ 433 0;
BA_ "VFrameFormat" BO_ 433 14;
BA_ "CANFD_BRS" BO_ 433 1;
BA_ "GenMsgCycleTime" BO_ 433 10;
BA_ "GenMsgCycleTimeFast" BO_ 433 0;
BA_ "GenMsgSendType" BO_ 433 0;
BA_ "VFrameFormat" BO_ 433 14;
BA_ "CANFD_BRS" BO_ 433 1;
BA_ "GenMsgCycleTime" BO_ 433 10;
BA_ "GenMsgCycleTimeFast" BO_ 433 0;
BA_ "GenMsgSendType" BO_ 433 0;
BA_ "VFrameFormat" BO_ 433 14;
BA_ "CANFD_BRS" BO_ 433 1;
BA_ "GenMsgCycleTime" BO_ 433 10;
BA_ "GenMsgCycleTimeFast" BO_ 433 0;
BA_ "GenMsgSendType" BO_ 433 0;
BA_ "VFrameFormat" BO_ 433 14;
BA_ "CANFD_BRS" BO_ 433 1;
BA_ "GenMsgCycleTime" BO_ 433 10;
BA_ "GenMsgCycleTimeFast" BO_ 433 0;
BA_ "GenMsgSendType" BO_ 433 0;
BA_ "VFrameFormat" BO_ 433 14;
BA_ "CANFD_BRS" BO_ 433 1;
BA_ "GenMsgCycleTime" BO_ 791 100;
BA_ "GenMsgCycleTimeFast" BO_ 791 0;
BA_ "GenMsgSendType" BO_ 791 0;
BA_ "VFrameFormat" BO_ 791 14;
BA_ "CANFD_BRS" BO_ 791 1;
BA_ "GenMsgCycleTime" BO_ 791 100;
BA_ "GenMsgCycleTimeFast" BO_ 791 0;
BA_ "GenMsgSendType" BO_ 791 0;
BA_ "VFrameFormat" BO_ 791 14;
BA_ "CANFD_BRS" BO_ 791 1;
BA_ "GenMsgCycleTime" BO_ 791 100;
BA_ "GenMsgCycleTimeFast" BO_ 791 0;
BA_ "GenMsgSendType" BO_ 791 0;
BA_ "VFrameFormat" BO_ 791 14;
BA_ "CANFD_BRS" BO_ 791 1;
BA_ "GenMsgCycleTime" BO_ 791 100;
BA_ "GenMsgCycleTimeFast" BO_ 791 0;
BA_ "GenMsgSendType" BO_ 791 0;
BA_ "VFrameFormat" BO_ 791 14;
BA_ "CANFD_BRS" BO_ 791 1;
BA_ "GenMsgCycleTime" BO_ 791 100;
BA_ "GenMsgCycleTimeFast" BO_ 791 0;
BA_ "GenMsgSendType" BO_ 791 0;
BA_ "VFrameFormat" BO_ 791 14;
BA_ "CANFD_BRS" BO_ 791 1;
BA_ "GenMsgCycleTime" BO_ 791 100;
BA_ "GenMsgCycleTimeFast" BO_ 791 0;
BA_ "GenMsgSendType" BO_ 791 0;
BA_ "VFrameFormat" BO_ 791 14;
BA_ "CANFD_BRS" BO_ 791 1;
BA_ "GenMsgCycleTime" BO_ 791 100;
BA_ "GenMsgCycleTimeFast" BO_ 791 0;
BA_ "GenMsgSendType" BO_ 791 0;
BA_ "VFrameFormat" BO_ 791 14;
BA_ "CANFD_BRS" BO_ 791 1;
BA_ "GenMsgCycleTime" BO_ 791 100;
BA_ "GenMsgCycleTimeFast" BO_ 791 0;
BA_ "GenMsgSendType" BO_ 791 0;
BA_ "VFrameFormat" BO_ 791 14;
BA_ "CANFD_BRS" BO_ 791 1;
BA_ "GenMsgCycleTime" BO_ 791 100;
BA_ "GenMsgCycleTimeFast" BO_ 791 0;
BA_ "GenMsgSendType" BO_ 791 0;
BA_ "VFrameFormat" BO_ 791 14;
BA_ "CANFD_BRS" BO_ 791 1;
BA_ "GenMsgCycleTime" BO_ 791 100;
BA_ "GenMsgCycleTimeFast" BO_ 791 0;
BA_ "GenMsgSendType" BO_ 791 0;
BA_ "VFrameFormat" BO_ 791 14;
BA_ "CANFD_BRS" BO_ 791 1;
BA_ "GenMsgCycleTime" BO_ 791 100;
BA_ "GenMsgCycleTimeFast" BO_ 791 0;
BA_ "GenMsgSendType" BO_ 791 0;
BA_ "VFrameFormat" BO_ 791 14;
BA_ "CANFD_BRS" BO_ 791 1;
BA_ "GenMsgCycleTime" BO_ 791 100;
BA_ "GenMsgCycleTimeFast" BO_ 791 0;
BA_ "GenMsgSendType" BO_ 791 0;
BA_ "VFrameFormat" BO_ 791 14;
BA_ "CANFD_BRS" BO_ 791 1;
BA_ "GenMsgCycleTime" BO_ 791 100;
BA_ "GenMsgCycleTimeFast" BO_ 791 0;
BA_ "GenMsgSendType" BO_ 791 0;
BA_ "VFrameFormat" BO_ 791 14;
BA_ "CANFD_BRS" BO_ 791 1;
BA_ "GenMsgCycleTime" BO_ 791 100;
BA_ "GenMsgCycleTimeFast" BO_ 791 0;
BA_ "GenMsgSendType" BO_ 791 0;
BA_ "VFrameFormat" BO_ 791 14;
BA_ "CANFD_BRS" BO_ 791 1;
BA_ "GenMsgCycleTime" BO_ 791 100;
BA_ "GenMsgCycleTimeFast" BO_ 791 0;
BA_ "GenMsgSendType" BO_ 791 0;
BA_ "VFrameFormat" BO_ 791 14;
BA_ "CANFD_BRS" BO_ 791 1;
BA_ "GenMsgCycleTime" BO_ 791 100;
BA_ "GenMsgCycleTimeFast" BO_ 791 0;
BA_ "GenMsgSendType" BO_ 791 0;
BA_ "VFrameFormat" BO_ 791 14;
BA_ "CANFD_BRS" BO_ 791 1;
BA_ "GenMsgCycleTime" BO_ 791 100;
BA_ "GenMsgCycleTimeFast" BO_ 791 0;
BA_ "GenMsgSendType" BO_ 791 0;
BA_ "VFrameFormat" BO_ 791 14;
BA_ "CANFD_BRS" BO_ 791 1;
BA_ "GenMsgCycleTime" BO_ 791 100;
BA_ "GenMsgCycleTimeFast" BO_ 791 0;
BA_ "GenMsgSendType" BO_ 791 0;
BA_ "VFrameFormat" BO_ 791 14;
BA_ "CANFD_BRS" BO_ 791 1;
BA_ "GenMsgCycleTime" BO_ 791 100;
BA_ "GenMsgCycleTimeFast" BO_ 791 0;
BA_ "GenMsgSendType" BO_ 791 0;
BA_ "VFrameFormat" BO_ 791 14;
BA_ "CANFD_BRS" BO_ 791 1;
BA_ "GenMsgCycleTime" BO_ 791 100;
BA_ "GenMsgCycleTimeFast" BO_ 791 0;
BA_ "GenMsgSendType" BO_ 791 0;
BA_ "VFrameFormat" BO_ 791 14;
BA_ "CANFD_BRS" BO_ 791 1;
BA_ "GenMsgCycleTime" BO_ 791 100;
BA_ "GenMsgCycleTimeFast" BO_ 791 0;
BA_ "GenMsgSendType" BO_ 791 0;
BA_ "VFrameFormat" BO_ 791 14;
BA_ "CANFD_BRS" BO_ 791 1;
BA_ "GenMsgCycleTime" BO_ 791 100;
BA_ "GenMsgCycleTimeFast" BO_ 791 0;
BA_ "GenMsgSendType" BO_ 791 0;
BA_ "VFrameFormat" BO_ 791 14;
BA_ "CANFD_BRS" BO_ 791 1;
BA_ "GenMsgCycleTime" BO_ 791 100;
BA_ "GenMsgCycleTimeFast" BO_ 791 0;
BA_ "GenMsgSendType" BO_ 791 0;
BA_ "VFrameFormat" BO_ 791 14;
BA_ "CANFD_BRS" BO_ 791 1;
BA_ "GenMsgCycleTime" BO_ 791 100;
BA_ "GenMsgCycleTimeFast" BO_ 791 0;
BA_ "GenMsgSendType" BO_ 791 0;
BA_ "VFrameFormat" BO_ 791 14;
BA_ "CANFD_BRS" BO_ 791 1;
BA_ "GenMsgCycleTime" BO_ 791 100;
BA_ "GenMsgCycleTimeFast" BO_ 791 0;
BA_ "GenMsgSendType" BO_ 791 0;
BA_ "VFrameFormat" BO_ 791 14;
BA_ "CANFD_BRS" BO_ 791 1;
BA_ "GenMsgCycleTime" BO_ 791 100;
BA_ "GenMsgCycleTimeFast" BO_ 791 0;
BA_ "GenMsgSendType" BO_ 791 0;
BA_ "VFrameFormat" BO_ 791 14;
BA_ "CANFD_BRS" BO_ 791 1;
BA_ "GenMsgCycleTime" BO_ 791 100;
BA_ "GenMsgCycleTimeFast" BO_ 791 0;
BA_ "GenMsgSendType" BO_ 791 0;
BA_ "VFrameFormat" BO_ 791 14;
BA_ "CANFD_BRS" BO_ 791 1;
BA_ "GenMsgCycleTime" BO_ 791 100;
BA_ "GenMsgCycleTimeFast" BO_ 791 0;
BA_ "GenMsgSendType" BO_ 791 0;
BA_ "VFrameFormat" BO_ 791 14;
BA_ "CANFD_BRS" BO_ 791 1;
BA_ "GenMsgCycleTime" BO_ 791 100;
BA_ "GenMsgCycleTimeFast" BO_ 791 0;
BA_ "GenMsgSendType" BO_ 791 0;
BA_ "VFrameFormat" BO_ 791 14;
BA_ "CANFD_BRS" BO_ 791 1;
BA_ "GenMsgCycleTime" BO_ 791 100;
BA_ "GenMsgCycleTimeFast" BO_ 791 0;
BA_ "GenMsgSendType" BO_ 791 0;
BA_ "VFrameFormat" BO_ 791 14;
BA_ "CANFD_BRS" BO_ 791 1;
BA_ "GenMsgCycleTime" BO_ 791 100;
BA_ "GenMsgCycleTimeFast" BO_ 791 0;
BA_ "GenMsgSendType" BO_ 791 0;
BA_ "VFrameFormat" BO_ 791 14;
BA_ "CANFD_BRS" BO_ 791 1;
BA_ "GenMsgCycleTime" BO_ 791 100;
BA_ "GenMsgCycleTimeFast" BO_ 791 0;
BA_ "GenMsgSendType" BO_ 791 0;
BA_ "VFrameFormat" BO_ 791 14;
BA_ "CANFD_BRS" BO_ 791 1;
BA_ "GenMsgCycleTime" BO_ 791 100;
BA_ "GenMsgCycleTimeFast" BO_ 791 0;
BA_ "GenMsgSendType" BO_ 791 0;
BA_ "VFrameFormat" BO_ 791 14;
BA_ "CANFD_BRS" BO_ 791 1;
BA_ "GenMsgCycleTime" BO_ 791 100;
BA_ "GenMsgCycleTimeFast" BO_ 791 0;
BA_ "GenMsgSendType" BO_ 791 0;
BA_ "VFrameFormat" BO_ 791 14;
BA_ "CANFD_BRS" BO_ 791 1;
BA_ "GenMsgCycleTime" BO_ 791 100;
BA_ "GenMsgCycleTimeFast" BO_ 791 0;
BA_ "GenMsgSendType" BO_ 791 0;
BA_ "VFrameFormat" BO_ 791 14;
BA_ "CANFD_BRS" BO_ 791 1;
BA_ "EventCommandSignal" SG_ 431 VCU_TargetRecpTorqVD 0;
BA_ "GatewayedSignals" SG_ 431 VCU_TargetRecpTorqVD 0;
BA_ "GenSigInactiveValue" SG_ 431 VCU_TargetRecpTorqVD 0;
BA_ "GenSigInvalidValue" SG_ 431 VCU_TargetRecpTorqVD 0;
BA_ "GenSigSendType" SG_ 431 VCU_TargetRecpTorqVD 1;
BA_ "GenSigStartValue" SG_ 431 VCU_TargetRecpTorqVD 0;
BA_ "GenSigTimeoutValue" SG_ 431 VCU_TargetRecpTorqVD 0;
BA_ "Remark" SG_ 431 VCU_TargetRecpTorqVD "涉及ID管理表";
BA_ "EventCommandSignal" SG_ 431 VCU_AccDriverOrvd 0;
BA_ "GatewayedSignals" SG_ 431 VCU_AccDriverOrvd 0;
BA_ "GenSigInactiveValue" SG_ 431 VCU_AccDriverOrvd 0;
BA_ "GenSigInvalidValue" SG_ 431 VCU_AccDriverOrvd 0;
BA_ "GenSigSendType" SG_ 431 VCU_AccDriverOrvd 1;
BA_ "GenSigStartValue" SG_ 431 VCU_AccDriverOrvd 0;
BA_ "GenSigTimeoutValue" SG_ 431 VCU_AccDriverOrvd 0;
BA_ "Remark" SG_ 431 VCU_AccDriverOrvd "涉及ID管理表";
BA_ "EventCommandSignal" SG_ 431 VCU_AccDriverOrvdVD 0;
BA_ "GatewayedSignals" SG_ 431 VCU_AccDriverOrvdVD 0;
BA_ "GenSigInactiveValue" SG_ 431 VCU_AccDriverOrvdVD 0;
BA_ "GenSigInvalidValue" SG_ 431 VCU_AccDriverOrvdVD 0;
BA_ "GenSigSendType" SG_ 431 VCU_AccDriverOrvdVD 1;
BA_ "GenSigStartValue" SG_ 431 VCU_AccDriverOrvdVD 0;
BA_ "GenSigTimeoutValue" SG_ 431 VCU_AccDriverOrvdVD 0;
BA_ "Remark" SG_ 431 VCU_AccDriverOrvdVD "涉及ID管理表";
BA_ "EventCommandSignal" SG_ 431 VCU_TargetRecpTorq 0;
BA_ "GatewayedSignals" SG_ 431 VCU_TargetRecpTorq 0;
BA_ "GenSigInactiveValue" SG_ 431 VCU_TargetRecpTorq 0;
BA_ "GenSigInvalidValue" SG_ 431 VCU_TargetRecpTorq 0;
BA_ "GenSigSendType" SG_ 431 VCU_TargetRecpTorq 1;
BA_ "GenSigStartValue" SG_ 431 VCU_TargetRecpTorq 0;
BA_ "GenSigTimeoutValue" SG_ 431 VCU_TargetRecpTorq 0;
BA_ "Remark" SG_ 431 VCU_TargetRecpTorq "涉及ID管理表";
BA_ "EventCommandSignal" SG_ 431 VCU_TargetRecpTorqFA 0;
BA_ "GatewayedSignals" SG_ 431 VCU_TargetRecpTorqFA 0;
BA_ "GenSigInactiveValue" SG_ 431 VCU_TargetRecpTorqFA 0;
BA_ "GenSigInvalidValue" SG_ 431 VCU_TargetRecpTorqFA 0;
BA_ "GenSigSendType" SG_ 431 VCU_TargetRecpTorqFA 1;
BA_ "GenSigStartValue" SG_ 431 VCU_TargetRecpTorqFA 0;
BA_ "GenSigTimeoutValue" SG_ 431 VCU_TargetRecpTorqFA 0;
BA_ "Remark" SG_ 431 VCU_TargetRecpTorqFA "涉及ID管理表";
BA_ "EventCommandSignal" SG_ 431 VCU_TargetRecpTorqRA 0;
BA_ "GatewayedSignals" SG_ 431 VCU_TargetRecpTorqRA 0;
BA_ "GenSigInactiveValue" SG_ 431 VCU_TargetRecpTorqRA 0;
BA_ "GenSigInvalidValue" SG_ 431 VCU_TargetRecpTorqRA 0;
BA_ "GenSigSendType" SG_ 431 VCU_TargetRecpTorqRA 1;
BA_ "GenSigStartValue" SG_ 431 VCU_TargetRecpTorqRA 0;
BA_ "GenSigTimeoutValue" SG_ 431 VCU_TargetRecpTorqRA 0;
BA_ "Remark" SG_ 431 VCU_TargetRecpTorqRA "涉及ID管理表";
BA_ "EventCommandSignal" SG_ 431 VCU_TorqDriverReqFA 0;
BA_ "GatewayedSignals" SG_ 431 VCU_TorqDriverReqFA 0;
BA_ "GenSigInactiveValue" SG_ 431 VCU_TorqDriverReqFA 0;
BA_ "GenSigInvalidValue" SG_ 431 VCU_TorqDriverReqFA 0;
BA_ "GenSigSendType" SG_ 431 VCU_TorqDriverReqFA 1;
BA_ "GenSigStartValue" SG_ 431 VCU_TorqDriverReqFA 0;
BA_ "GenSigTimeoutValue" SG_ 431 VCU_TorqDriverReqFA 0;
BA_ "Remark" SG_ 431 VCU_TorqDriverReqFA "涉及ID管理表";
BA_ "EventCommandSignal" SG_ 431 VCU_TorqDriverReqRA 0;
BA_ "GatewayedSignals" SG_ 431 VCU_TorqDriverReqRA 0;
BA_ "GenSigInactiveValue" SG_ 431 VCU_TorqDriverReqRA 0;
BA_ "GenSigInvalidValue" SG_ 431 VCU_TorqDriverReqRA 0;
BA_ "GenSigSendType" SG_ 431 VCU_TorqDriverReqRA 1;
BA_ "GenSigStartValue" SG_ 431 VCU_TorqDriverReqRA 0;
BA_ "GenSigTimeoutValue" SG_ 431 VCU_TorqDriverReqRA 0;
BA_ "Remark" SG_ 431 VCU_TorqDriverReqRA "涉及ID管理表";
BA_ "EventCommandSignal" SG_ 431 VCU_VehActDrvTorqFA 0;
BA_ "GatewayedSignals" SG_ 431 VCU_VehActDrvTorqFA 0;
BA_ "GenSigInactiveValue" SG_ 431 VCU_VehActDrvTorqFA 0;
BA_ "GenSigInvalidValue" SG_ 431 VCU_VehActDrvTorqFA 0;
BA_ "GenSigSendType" SG_ 431 VCU_VehActDrvTorqFA 1;
BA_ "GenSigStartValue" SG_ 431 VCU_VehActDrvTorqFA 0;
BA_ "GenSigTimeoutValue" SG_ 431 VCU_VehActDrvTorqFA 0;
BA_ "Remark" SG_ 431 VCU_VehActDrvTorqFA "涉及ID管理表";
BA_ "EventCommandSignal" SG_ 431 VCU_VehActDrvTorqRA 0;
BA_ "GatewayedSignals" SG_ 431 VCU_VehActDrvTorqRA 0;
BA_ "GenSigInactiveValue" SG_ 431 VCU_VehActDrvTorqRA 0;
BA_ "GenSigInvalidValue" SG_ 431 VCU_VehActDrvTorqRA 0;
BA_ "GenSigSendType" SG_ 431 VCU_VehActDrvTorqRA 1;
BA_ "GenSigStartValue" SG_ 431 VCU_VehActDrvTorqRA 0;
BA_ "GenSigTimeoutValue" SG_ 431 VCU_VehActDrvTorqRA 0;
BA_ "Remark" SG_ 431 VCU_VehActDrvTorqRA "涉及ID管理表";
BA_ "EventCommandSignal" SG_ 431 VCU_TargetRecpTorqFAVD 0;
BA_ "GatewayedSignals" SG_ 431 VCU_TargetRecpTorqFAVD 0;
BA_ "GenSigInactiveValue" SG_ 431 VCU_TargetRecpTorqFAVD 0;
BA_ "GenSigInvalidValue" SG_ 431 VCU_TargetRecpTorqFAVD 0;
BA_ "GenSigSendType" SG_ 431 VCU_TargetRecpTorqFAVD 1;
BA_ "GenSigStartValue" SG_ 431 VCU_TargetRecpTorqFAVD 0;
BA_ "GenSigTimeoutValue" SG_ 431 VCU_TargetRecpTorqFAVD 0;
BA_ "Remark" SG_ 431 VCU_TargetRecpTorqFAVD "涉及ID管理表";
BA_ "EventCommandSignal" SG_ 431 VCU_TargetRecpTorqRAVD 0;
BA_ "GatewayedSignals" SG_ 431 VCU_TargetRecpTorqRAVD 0;
BA_ "GenSigInactiveValue" SG_ 431 VCU_TargetRecpTorqRAVD 0;
BA_ "GenSigInvalidValue" SG_ 431 VCU_TargetRecpTorqRAVD 0;
BA_ "GenSigSendType" SG_ 431 VCU_TargetRecpTorqRAVD 1;
BA_ "GenSigStartValue" SG_ 431 VCU_TargetRecpTorqRAVD 0;
BA_ "GenSigTimeoutValue" SG_ 431 VCU_TargetRecpTorqRAVD 0;
BA_ "Remark" SG_ 431 VCU_TargetRecpTorqRAVD "涉及ID管理表";
BA_ "EventCommandSignal" SG_ 431 VCU_TorqDriverReqFAVD 0;
BA_ "GatewayedSignals" SG_ 431 VCU_TorqDriverReqFAVD 0;
BA_ "GenSigInactiveValue" SG_ 431 VCU_TorqDriverReqFAVD 0;
BA_ "GenSigInvalidValue" SG_ 431 VCU_TorqDriverReqFAVD 0;
BA_ "GenSigSendType" SG_ 431 VCU_TorqDriverReqFAVD 1;
BA_ "GenSigStartValue" SG_ 431 VCU_TorqDriverReqFAVD 0;
BA_ "GenSigTimeoutValue" SG_ 431 VCU_TorqDriverReqFAVD 0;
BA_ "Remark" SG_ 431 VCU_TorqDriverReqFAVD "涉及ID管理表";
BA_ "EventCommandSignal" SG_ 431 VCU_TorqDriverReqRAVD 0;
BA_ "GatewayedSignals" SG_ 431 VCU_TorqDriverReqRAVD 0;
BA_ "GenSigInactiveValue" SG_ 431 VCU_TorqDriverReqRAVD 0;
BA_ "GenSigInvalidValue" SG_ 431 VCU_TorqDriverReqRAVD 0;
BA_ "GenSigSendType" SG_ 431 VCU_TorqDriverReqRAVD 1;
BA_ "GenSigStartValue" SG_ 431 VCU_TorqDriverReqRAVD 0;
BA_ "GenSigTimeoutValue" SG_ 431 VCU_TorqDriverReqRAVD 0;
BA_ "Remark" SG_ 431 VCU_TorqDriverReqRAVD "涉及ID管理表";
BA_ "EventCommandSignal" SG_ 431 VCU_VehActDrvTorqFAVD 0;
BA_ "GatewayedSignals" SG_ 431 VCU_VehActDrvTorqFAVD 0;
BA_ "GenSigInactiveValue" SG_ 431 VCU_VehActDrvTorqFAVD 0;
BA_ "GenSigInvalidValue" SG_ 431 VCU_VehActDrvTorqFAVD 0;
BA_ "GenSigSendType" SG_ 431 VCU_VehActDrvTorqFAVD 1;
BA_ "GenSigStartValue" SG_ 431 VCU_VehActDrvTorqFAVD 0;
BA_ "GenSigTimeoutValue" SG_ 431 VCU_VehActDrvTorqFAVD 0;
BA_ "Remark" SG_ 431 VCU_VehActDrvTorqFAVD "涉及ID管理表";
BA_ "EventCommandSignal" SG_ 431 VCU_VehActDrvTorqRAVD 0;
BA_ "GatewayedSignals" SG_ 431 VCU_VehActDrvTorqRAVD 0;
BA_ "GenSigInactiveValue" SG_ 431 VCU_VehActDrvTorqRAVD 0;
BA_ "GenSigInvalidValue" SG_ 431 VCU_VehActDrvTorqRAVD 0;
BA_ "GenSigSendType" SG_ 431 VCU_VehActDrvTorqRAVD 1;
BA_ "GenSigStartValue" SG_ 431 VCU_VehActDrvTorqRAVD 0;
BA_ "GenSigTimeoutValue" SG_ 431 VCU_VehActDrvTorqRAVD 0;
BA_ "Remark" SG_ 431 VCU_VehActDrvTorqRAVD "涉及ID管理表";
BA_ "EventCommandSignal" SG_ 431 VCU_BcsDecelReq 0;
BA_ "GatewayedSignals" SG_ 431 VCU_BcsDecelReq 0;
BA_ "GenSigInactiveValue" SG_ 431 VCU_BcsDecelReq 0;
BA_ "GenSigInvalidValue" SG_ 431 VCU_BcsDecelReq 0;
BA_ "GenSigSendType" SG_ 431 VCU_BcsDecelReq 1;
BA_ "GenSigStartValue" SG_ 431 VCU_BcsDecelReq 15;
BA_ "GenSigTimeoutValue" SG_ 431 VCU_BcsDecelReq 0;
BA_ "Remark" SG_ 431 VCU_BcsDecelReq "涉及ID管理表";
BA_ "EventCommandSignal" SG_ 431 VCU_BcsDecelVD 0;
BA_ "GatewayedSignals" SG_ 431 VCU_BcsDecelVD 0;
BA_ "GenSigInactiveValue" SG_ 431 VCU_BcsDecelVD 0;
BA_ "GenSigInvalidValue" SG_ 431 VCU_BcsDecelVD 0;
BA_ "GenSigSendType" SG_ 431 VCU_BcsDecelVD 1;
BA_ "GenSigStartValue" SG_ 431 VCU_BcsDecelVD 0;
BA_ "GenSigTimeoutValue" SG_ 431 VCU_BcsDecelVD 0;
BA_ "Remark" SG_ 431 VCU_BcsDecelVD "涉及ID管理表";
BA_ "EventCommandSignal" SG_ 431 VCU_RecpTorqRL 0;
BA_ "GatewayedSignals" SG_ 431 VCU_RecpTorqRL 0;
BA_ "GenSigInactiveValue" SG_ 431 VCU_RecpTorqRL 0;
BA_ "GenSigInvalidValue" SG_ 431 VCU_RecpTorqRL 0;
BA_ "GenSigSendType" SG_ 431 VCU_RecpTorqRL 1;
BA_ "GenSigStartValue" SG_ 431 VCU_RecpTorqRL 0;
BA_ "GenSigTimeoutValue" SG_ 431 VCU_RecpTorqRL 0;
BA_ "Remark" SG_ 431 VCU_RecpTorqRL "涉及ID管理表";
BA_ "EventCommandSignal" SG_ 431 VCU_RecpTorqRLVD 0;
BA_ "GatewayedSignals" SG_ 431 VCU_RecpTorqRLVD 0;
BA_ "GenSigInactiveValue" SG_ 431 VCU_RecpTorqRLVD 0;
BA_ "GenSigInvalidValue" SG_ 431 VCU_RecpTorqRLVD 0;
BA_ "GenSigSendType" SG_ 431 VCU_RecpTorqRLVD 1;
BA_ "GenSigStartValue" SG_ 431 VCU_RecpTorqRLVD 0;
BA_ "GenSigTimeoutValue" SG_ 431 VCU_RecpTorqRLVD 0;
BA_ "Remark" SG_ 431 VCU_RecpTorqRLVD "涉及ID管理表";
BA_ "EventCommandSignal" SG_ 431 VCU_RecpTorqRR 0;
BA_ "GatewayedSignals" SG_ 431 VCU_RecpTorqRR 0;
BA_ "GenSigInactiveValue" SG_ 431 VCU_RecpTorqRR 0;
BA_ "GenSigInvalidValue" SG_ 431 VCU_RecpTorqRR 0;
BA_ "GenSigSendType" SG_ 431 VCU_RecpTorqRR 1;
BA_ "GenSigStartValue" SG_ 431 VCU_RecpTorqRR 0;
BA_ "GenSigTimeoutValue" SG_ 431 VCU_RecpTorqRR 0;
BA_ "Remark" SG_ 431 VCU_RecpTorqRR "涉及ID管理表";
BA_ "EventCommandSignal" SG_ 431 VCU_RecpTorqRRVD 0;
BA_ "GatewayedSignals" SG_ 431 VCU_RecpTorqRRVD 0;
BA_ "GenSigInactiveValue" SG_ 431 VCU_RecpTorqRRVD 0;
BA_ "GenSigInvalidValue" SG_ 431 VCU_RecpTorqRRVD 0;
BA_ "GenSigSendType" SG_ 431 VCU_RecpTorqRRVD 1;
BA_ "GenSigStartValue" SG_ 431 VCU_RecpTorqRRVD 0;
BA_ "GenSigTimeoutValue" SG_ 431 VCU_RecpTorqRRVD 0;
BA_ "Remark" SG_ 431 VCU_RecpTorqRRVD "涉及ID管理表";
BA_ "EventCommandSignal" SG_ 431 VCU_ADSNetErrorFb 0;
BA_ "GatewayedSignals" SG_ 431 VCU_ADSNetErrorFb 0;
BA_ "GenSigInactiveValue" SG_ 431 VCU_ADSNetErrorFb 0;
BA_ "GenSigInvalidValue" SG_ 431 VCU_ADSNetErrorFb 0;
BA_ "GenSigSendType" SG_ 431 VCU_ADSNetErrorFb 1;
BA_ "GenSigStartValue" SG_ 431 VCU_ADSNetErrorFb 0;
BA_ "GenSigTimeoutValue" SG_ 431 VCU_ADSNetErrorFb 0;
BA_ "Remark" SG_ 431 VCU_ADSNetErrorFb "涉及ID管理表";
BA_ "EventCommandSignal" SG_ 431 VCU_NetModeResp 0;
BA_ "GatewayedSignals" SG_ 431 VCU_NetModeResp 0;
BA_ "GenSigInactiveValue" SG_ 431 VCU_NetModeResp 0;
BA_ "GenSigInvalidValue" SG_ 431 VCU_NetModeResp 0;
BA_ "GenSigSendType" SG_ 431 VCU_NetModeResp 1;
BA_ "GenSigStartValue" SG_ 431 VCU_NetModeResp 0;
BA_ "GenSigTimeoutValue" SG_ 431 VCU_NetModeResp 0;
BA_ "Remark" SG_ 431 VCU_NetModeResp "涉及ID管理表";
BA_ "EventCommandSignal" SG_ 431 VCU_PwrLimDrv_kW 0;
BA_ "GatewayedSignals" SG_ 431 VCU_PwrLimDrv_kW 0;
BA_ "GenSigInactiveValue" SG_ 431 VCU_PwrLimDrv_kW 0;
BA_ "GenSigInvalidValue" SG_ 431 VCU_PwrLimDrv_kW 0;
BA_ "GenSigSendType" SG_ 431 VCU_PwrLimDrv_kW 1;
BA_ "GenSigStartValue" SG_ 431 VCU_PwrLimDrv_kW 1024;
BA_ "GenSigTimeoutValue" SG_ 431 VCU_PwrLimDrv_kW 0;
BA_ "Remark" SG_ 431 VCU_PwrLimDrv_kW "涉及ID管理表";
BA_ "EventCommandSignal" SG_ 431 VCU_PwrLimRegen_kW 0;
BA_ "GatewayedSignals" SG_ 431 VCU_PwrLimRegen_kW 0;
BA_ "GenSigInactiveValue" SG_ 431 VCU_PwrLimRegen_kW 0;
BA_ "GenSigInvalidValue" SG_ 431 VCU_PwrLimRegen_kW 0;
BA_ "GenSigSendType" SG_ 431 VCU_PwrLimRegen_kW 1;
BA_ "GenSigStartValue" SG_ 431 VCU_PwrLimRegen_kW 1024;
BA_ "GenSigTimeoutValue" SG_ 431 VCU_PwrLimRegen_kW 0;
BA_ "Remark" SG_ 431 VCU_PwrLimRegen_kW "涉及ID管理表";
BA_ "EventCommandSignal" SG_ 431 VCU_PwrLimDrv_kWVD 0;
BA_ "GatewayedSignals" SG_ 431 VCU_PwrLimDrv_kWVD 0;
BA_ "GenSigInactiveValue" SG_ 431 VCU_PwrLimDrv_kWVD 0;
BA_ "GenSigInvalidValue" SG_ 431 VCU_PwrLimDrv_kWVD 0;
BA_ "GenSigSendType" SG_ 431 VCU_PwrLimDrv_kWVD 1;
BA_ "GenSigStartValue" SG_ 431 VCU_PwrLimDrv_kWVD 0;
BA_ "GenSigTimeoutValue" SG_ 431 VCU_PwrLimDrv_kWVD 0;
BA_ "Remark" SG_ 431 VCU_PwrLimDrv_kWVD "涉及ID管理表";
BA_ "EventCommandSignal" SG_ 431 VCU_PwrLimRegen_kWVD 0;
BA_ "GatewayedSignals" SG_ 431 VCU_PwrLimRegen_kWVD 0;
BA_ "GenSigInactiveValue" SG_ 431 VCU_PwrLimRegen_kWVD 0;
BA_ "GenSigInvalidValue" SG_ 431 VCU_PwrLimRegen_kWVD 0;
BA_ "GenSigSendType" SG_ 431 VCU_PwrLimRegen_kWVD 1;
BA_ "GenSigStartValue" SG_ 431 VCU_PwrLimRegen_kWVD 0;
BA_ "GenSigTimeoutValue" SG_ 431 VCU_PwrLimRegen_kWVD 0;
BA_ "Remark" SG_ 431 VCU_PwrLimRegen_kWVD "涉及ID管理表";
BA_ "EventCommandSignal" SG_ 431 VCU_PtTqActvStsFL 0;
BA_ "GatewayedSignals" SG_ 431 VCU_PtTqActvStsFL 0;
BA_ "GenSigInactiveValue" SG_ 431 VCU_PtTqActvStsFL 0;
BA_ "GenSigInvalidValue" SG_ 431 VCU_PtTqActvStsFL 0;
BA_ "GenSigSendType" SG_ 431 VCU_PtTqActvStsFL 1;
BA_ "GenSigStartValue" SG_ 431 VCU_PtTqActvStsFL 0;
BA_ "GenSigTimeoutValue" SG_ 431 VCU_PtTqActvStsFL 0;
BA_ "Remark" SG_ 431 VCU_PtTqActvStsFL "涉及ID管理表";
BA_ "EventCommandSignal" SG_ 431 VCU_PtTqActvStsFR 0;
BA_ "GatewayedSignals" SG_ 431 VCU_PtTqActvStsFR 0;
BA_ "GenSigInactiveValue" SG_ 431 VCU_PtTqActvStsFR 0;
BA_ "GenSigInvalidValue" SG_ 431 VCU_PtTqActvStsFR 0;
BA_ "GenSigSendType" SG_ 431 VCU_PtTqActvStsFR 1;
BA_ "GenSigStartValue" SG_ 431 VCU_PtTqActvStsFR 0;
BA_ "GenSigTimeoutValue" SG_ 431 VCU_PtTqActvStsFR 0;
BA_ "Remark" SG_ 431 VCU_PtTqActvStsFR "涉及ID管理表";
BA_ "EventCommandSignal" SG_ 431 VCU_PtTqActvStsRL 0;
BA_ "GatewayedSignals" SG_ 431 VCU_PtTqActvStsRL 0;
BA_ "GenSigInactiveValue" SG_ 431 VCU_PtTqActvStsRL 0;
BA_ "GenSigInvalidValue" SG_ 431 VCU_PtTqActvStsRL 0;
BA_ "GenSigSendType" SG_ 431 VCU_PtTqActvStsRL 1;
BA_ "GenSigStartValue" SG_ 431 VCU_PtTqActvStsRL 0;
BA_ "GenSigTimeoutValue" SG_ 431 VCU_PtTqActvStsRL 0;
BA_ "Remark" SG_ 431 VCU_PtTqActvStsRL "涉及ID管理表";
BA_ "EventCommandSignal" SG_ 431 VCU_PtTqActvStsRR 0;
BA_ "GatewayedSignals" SG_ 431 VCU_PtTqActvStsRR 0;
BA_ "GenSigInactiveValue" SG_ 431 VCU_PtTqActvStsRR 0;
BA_ "GenSigInvalidValue" SG_ 431 VCU_PtTqActvStsRR 0;
BA_ "GenSigSendType" SG_ 431 VCU_PtTqActvStsRR 1;
BA_ "GenSigStartValue" SG_ 431 VCU_PtTqActvStsRR 0;
BA_ "GenSigTimeoutValue" SG_ 431 VCU_PtTqActvStsRR 0;
BA_ "Remark" SG_ 431 VCU_PtTqActvStsRR "涉及ID管理表";
BA_ "EventCommandSignal" SG_ 615 BCS_1_CRC 0;
BA_ "GatewayedSignals" SG_ 615 BCS_1_CRC 0;
BA_ "GenSigInactiveValue" SG_ 615 BCS_1_CRC 0;
BA_ "GenSigInvalidValue" SG_ 615 BCS_1_CRC 0;
BA_ "GenSigSendType" SG_ 615 BCS_1_CRC 1;
BA_ "GenSigStartValue" SG_ 615 BCS_1_CRC 0;
BA_ "GenSigTimeoutValue" SG_ 615 BCS_1_CRC 0;
BA_ "Remark" SG_ 615 BCS_1_CRC "";
BA_ "EventCommandSignal" SG_ 615 BCS_1_Counter 0;
BA_ "GatewayedSignals" SG_ 615 BCS_1_Counter 0;
BA_ "GenSigInactiveValue" SG_ 615 BCS_1_Counter 0;
BA_ "GenSigInvalidValue" SG_ 615 BCS_1_Counter 0;
BA_ "GenSigSendType" SG_ 615 BCS_1_Counter 1;
BA_ "GenSigStartValue" SG_ 615 BCS_1_Counter 0;
BA_ "GenSigTimeoutValue" SG_ 615 BCS_1_Counter 0;
BA_ "Remark" SG_ 615 BCS_1_Counter "";
BA_ "EventCommandSignal" SG_ 615 BCS_FLWheelSpd 0;
BA_ "GatewayedSignals" SG_ 615 BCS_FLWheelSpd 0;
BA_ "GenSigInactiveValue" SG_ 615 BCS_FLWheelSpd 0;
BA_ "GenSigInvalidValue" SG_ 615 BCS_FLWheelSpd 0;
BA_ "GenSigSendType" SG_ 615 BCS_FLWheelSpd 1;
BA_ "GenSigStartValue" SG_ 615 BCS_FLWheelSpd 0;
BA_ "GenSigTimeoutValue" SG_ 615 BCS_FLWheelSpd 0;
BA_ "Remark" SG_ 615 BCS_FLWheelSpd "";
BA_ "EventCommandSignal" SG_ 615 BCS_FLWheelSpdVD 0;
BA_ "GatewayedSignals" SG_ 615 BCS_FLWheelSpdVD 0;
BA_ "GenSigInactiveValue" SG_ 615 BCS_FLWheelSpdVD 0;
BA_ "GenSigInvalidValue" SG_ 615 BCS_FLWheelSpdVD 0;
BA_ "GenSigSendType" SG_ 615 BCS_FLWheelSpdVD 1;
BA_ "GenSigStartValue" SG_ 615 BCS_FLWheelSpdVD 0;
BA_ "GenSigTimeoutValue" SG_ 615 BCS_FLWheelSpdVD 0;
BA_ "Remark" SG_ 615 BCS_FLWheelSpdVD "";
BA_ "EventCommandSignal" SG_ 615 BCS_FLWheelRotatedDirectionVD 0;
BA_ "GatewayedSignals" SG_ 615 BCS_FLWheelRotatedDirectionVD 0;
BA_ "GenSigInactiveValue" SG_ 615 BCS_FLWheelRotatedDirectionVD 0;
BA_ "GenSigInvalidValue" SG_ 615 BCS_FLWheelRotatedDirectionVD 0;
BA_ "GenSigSendType" SG_ 615 BCS_FLWheelRotatedDirectionVD 1;
BA_ "GenSigStartValue" SG_ 615 BCS_FLWheelRotatedDirectionVD 0;
BA_ "GenSigTimeoutValue" SG_ 615 BCS_FLWheelRotatedDirectionVD 0;
BA_ "Remark" SG_ 615 BCS_FLWheelRotatedDirectionVD "";
BA_ "EventCommandSignal" SG_ 615 BCS_FRWheelSpd 0;
BA_ "GatewayedSignals" SG_ 615 BCS_FRWheelSpd 0;
BA_ "GenSigInactiveValue" SG_ 615 BCS_FRWheelSpd 0;
BA_ "GenSigInvalidValue" SG_ 615 BCS_FRWheelSpd 0;
BA_ "GenSigSendType" SG_ 615 BCS_FRWheelSpd 1;
BA_ "GenSigStartValue" SG_ 615 BCS_FRWheelSpd 0;
BA_ "GenSigTimeoutValue" SG_ 615 BCS_FRWheelSpd 0;
BA_ "Remark" SG_ 615 BCS_FRWheelSpd "";
BA_ "EventCommandSignal" SG_ 615 BCS_FRWheelSpdVD 0;
BA_ "GatewayedSignals" SG_ 615 BCS_FRWheelSpdVD 0;
BA_ "GenSigInactiveValue" SG_ 615 BCS_FRWheelSpdVD 0;
BA_ "GenSigInvalidValue" SG_ 615 BCS_FRWheelSpdVD 0;
BA_ "GenSigSendType" SG_ 615 BCS_FRWheelSpdVD 1;
BA_ "GenSigStartValue" SG_ 615 BCS_FRWheelSpdVD 0;
BA_ "GenSigTimeoutValue" SG_ 615 BCS_FRWheelSpdVD 0;
BA_ "Remark" SG_ 615 BCS_FRWheelSpdVD "";
BA_ "EventCommandSignal" SG_ 615 BCS_FRWheelRotatedDirectionVD 0;
BA_ "GatewayedSignals" SG_ 615 BCS_FRWheelRotatedDirectionVD 0;
BA_ "GenSigInactiveValue" SG_ 615 BCS_FRWheelRotatedDirectionVD 0;
BA_ "GenSigInvalidValue" SG_ 615 BCS_FRWheelRotatedDirectionVD 0;
BA_ "GenSigSendType" SG_ 615 BCS_FRWheelRotatedDirectionVD 1;
BA_ "GenSigStartValue" SG_ 615 BCS_FRWheelRotatedDirectionVD 0;
BA_ "GenSigTimeoutValue" SG_ 615 BCS_FRWheelRotatedDirectionVD 0;
BA_ "Remark" SG_ 615 BCS_FRWheelRotatedDirectionVD "";
BA_ "EventCommandSignal" SG_ 615 BCS_RLWheelSpd 0;
BA_ "GatewayedSignals" SG_ 615 BCS_RLWheelSpd 0;
BA_ "GenSigInactiveValue" SG_ 615 BCS_RLWheelSpd 0;
BA_ "GenSigInvalidValue" SG_ 615 BCS_RLWheelSpd 0;
BA_ "GenSigSendType" SG_ 615 BCS_RLWheelSpd 1;
BA_ "GenSigStartValue" SG_ 615 BCS_RLWheelSpd 0;
BA_ "GenSigTimeoutValue" SG_ 615 BCS_RLWheelSpd 0;
BA_ "Remark" SG_ 615 BCS_RLWheelSpd "";
BA_ "EventCommandSignal" SG_ 615 BCS_RLWheelSpdVD 0;
BA_ "GatewayedSignals" SG_ 615 BCS_RLWheelSpdVD 0;
BA_ "GenSigInactiveValue" SG_ 615 BCS_RLWheelSpdVD 0;
BA_ "GenSigInvalidValue" SG_ 615 BCS_RLWheelSpdVD 0;
BA_ "GenSigSendType" SG_ 615 BCS_RLWheelSpdVD 1;
BA_ "GenSigStartValue" SG_ 615 BCS_RLWheelSpdVD 0;
BA_ "GenSigTimeoutValue" SG_ 615 BCS_RLWheelSpdVD 0;
BA_ "Remark" SG_ 615 BCS_RLWheelSpdVD "";
BA_ "EventCommandSignal" SG_ 615 BCS_RLWheelRotatedDirectionVD 0;
BA_ "GatewayedSignals" SG_ 615 BCS_RLWheelRotatedDirectionVD 0;
BA_ "GenSigInactiveValue" SG_ 615 BCS_RLWheelRotatedDirectionVD 0;
BA_ "GenSigInvalidValue" SG_ 615 BCS_RLWheelRotatedDirectionVD 0;
BA_ "GenSigSendType" SG_ 615 BCS_RLWheelRotatedDirectionVD 1;
BA_ "GenSigStartValue" SG_ 615 BCS_RLWheelRotatedDirectionVD 0;
BA_ "GenSigTimeoutValue" SG_ 615 BCS_RLWheelRotatedDirectionVD 0;
BA_ "Remark" SG_ 615 BCS_RLWheelRotatedDirectionVD "";
BA_ "EventCommandSignal" SG_ 615 BCS_RRWheelSpd 0;
BA_ "GatewayedSignals" SG_ 615 BCS_RRWheelSpd 0;
BA_ "GenSigInactiveValue" SG_ 615 BCS_RRWheelSpd 0;
BA_ "GenSigInvalidValue" SG_ 615 BCS_RRWheelSpd 0;
BA_ "GenSigSendType" SG_ 615 BCS_RRWheelSpd 1;
BA_ "GenSigStartValue" SG_ 615 BCS_RRWheelSpd 0;
BA_ "GenSigTimeoutValue" SG_ 615 BCS_RRWheelSpd 0;
BA_ "Remark" SG_ 615 BCS_RRWheelSpd "";
BA_ "EventCommandSignal" SG_ 615 BCS_RRWheelSpdVD 0;
BA_ "GatewayedSignals" SG_ 615 BCS_RRWheelSpdVD 0;
BA_ "GenSigInactiveValue" SG_ 615 BCS_RRWheelSpdVD 0;
BA_ "GenSigInvalidValue" SG_ 615 BCS_RRWheelSpdVD 0;
BA_ "GenSigSendType" SG_ 615 BCS_RRWheelSpdVD 1;
BA_ "GenSigStartValue" SG_ 615 BCS_RRWheelSpdVD 0;
BA_ "GenSigTimeoutValue" SG_ 615 BCS_RRWheelSpdVD 0;
BA_ "Remark" SG_ 615 BCS_RRWheelSpdVD "";
BA_ "EventCommandSignal" SG_ 615 BCS_RRWheelRotatedDirectionVD 0;
BA_ "GatewayedSignals" SG_ 615 BCS_RRWheelRotatedDirectionVD 0;
BA_ "GenSigInactiveValue" SG_ 615 BCS_RRWheelRotatedDirectionVD 0;
BA_ "GenSigInvalidValue" SG_ 615 BCS_RRWheelRotatedDirectionVD 0;
BA_ "GenSigSendType" SG_ 615 BCS_RRWheelRotatedDirectionVD 1;
BA_ "GenSigStartValue" SG_ 615 BCS_RRWheelRotatedDirectionVD 0;
BA_ "GenSigTimeoutValue" SG_ 615 BCS_RRWheelRotatedDirectionVD 0;
BA_ "Remark" SG_ 615 BCS_RRWheelRotatedDirectionVD "";
BA_ "EventCommandSignal" SG_ 615 BCS_HHCCtrlSt 0;
BA_ "GatewayedSignals" SG_ 615 BCS_HHCCtrlSt 0;
BA_ "GenSigInactiveValue" SG_ 615 BCS_HHCCtrlSt 0;
BA_ "GenSigInvalidValue" SG_ 615 BCS_HHCCtrlSt 0;
BA_ "GenSigSendType" SG_ 615 BCS_HHCCtrlSt 1;
BA_ "GenSigStartValue" SG_ 615 BCS_HHCCtrlSt 0;
BA_ "GenSigTimeoutValue" SG_ 615 BCS_HHCCtrlSt 0;
BA_ "Remark" SG_ 615 BCS_HHCCtrlSt "";
BA_ "EventCommandSignal" SG_ 615 BCS_HDCCtrlSt 0;
BA_ "GatewayedSignals" SG_ 615 BCS_HDCCtrlSt 0;
BA_ "GenSigInactiveValue" SG_ 615 BCS_HDCCtrlSt 0;
BA_ "GenSigInvalidValue" SG_ 615 BCS_HDCCtrlSt 0;
BA_ "GenSigSendType" SG_ 615 BCS_HDCCtrlSt 1;
BA_ "GenSigStartValue" SG_ 615 BCS_HDCCtrlSt 0;
BA_ "GenSigTimeoutValue" SG_ 615 BCS_HDCCtrlSt 0;
BA_ "Remark" SG_ 615 BCS_HDCCtrlSt "";
BA_ "EventCommandSignal" SG_ 615 BCS_HDCErrSt 0;
BA_ "GatewayedSignals" SG_ 615 BCS_HDCErrSt 0;
BA_ "GenSigInactiveValue" SG_ 615 BCS_HDCErrSt 0;
BA_ "GenSigInvalidValue" SG_ 615 BCS_HDCErrSt 0;
BA_ "GenSigSendType" SG_ 615 BCS_HDCErrSt 1;
BA_ "GenSigStartValue" SG_ 615 BCS_HDCErrSt 0;
BA_ "GenSigTimeoutValue" SG_ 615 BCS_HDCErrSt 1;
BA_ "Remark" SG_ 615 BCS_HDCErrSt "";
BA_ "EventCommandSignal" SG_ 615 BCS_FLWheelSpdEdgesSum 0;
BA_ "GatewayedSignals" SG_ 615 BCS_FLWheelSpdEdgesSum 0;
BA_ "GenSigInactiveValue" SG_ 615 BCS_FLWheelSpdEdgesSum 0;
BA_ "GenSigInvalidValue" SG_ 615 BCS_FLWheelSpdEdgesSum 0;
BA_ "GenSigSendType" SG_ 615 BCS_FLWheelSpdEdgesSum 1;
BA_ "GenSigStartValue" SG_ 615 BCS_FLWheelSpdEdgesSum 0;
BA_ "GenSigTimeoutValue" SG_ 615 BCS_FLWheelSpdEdgesSum 0;
BA_ "Remark" SG_ 615 BCS_FLWheelSpdEdgesSum "";
BA_ "EventCommandSignal" SG_ 615 BCS_FRWheelSpdEdgesSum 0;
BA_ "GatewayedSignals" SG_ 615 BCS_FRWheelSpdEdgesSum 0;
BA_ "GenSigInactiveValue" SG_ 615 BCS_FRWheelSpdEdgesSum 0;
BA_ "GenSigInvalidValue" SG_ 615 BCS_FRWheelSpdEdgesSum 0;
BA_ "GenSigSendType" SG_ 615 BCS_FRWheelSpdEdgesSum 1;
BA_ "GenSigStartValue" SG_ 615 BCS_FRWheelSpdEdgesSum 0;
BA_ "GenSigTimeoutValue" SG_ 615 BCS_FRWheelSpdEdgesSum 0;
BA_ "Remark" SG_ 615 BCS_FRWheelSpdEdgesSum "";
BA_ "EventCommandSignal" SG_ 615 BCS_RLWheelSpdEdgesSum 0;
BA_ "GatewayedSignals" SG_ 615 BCS_RLWheelSpdEdgesSum 0;
BA_ "GenSigInactiveValue" SG_ 615 BCS_RLWheelSpdEdgesSum 0;
BA_ "GenSigInvalidValue" SG_ 615 BCS_RLWheelSpdEdgesSum 0;
BA_ "GenSigSendType" SG_ 615 BCS_RLWheelSpdEdgesSum 1;
BA_ "GenSigStartValue" SG_ 615 BCS_RLWheelSpdEdgesSum 0;
BA_ "GenSigTimeoutValue" SG_ 615 BCS_RLWheelSpdEdgesSum 0;
BA_ "Remark" SG_ 615 BCS_RLWheelSpdEdgesSum "";
BA_ "EventCommandSignal" SG_ 615 BCS_RRWheelSpdEdgesSum 0;
BA_ "GatewayedSignals" SG_ 615 BCS_RRWheelSpdEdgesSum 0;
BA_ "GenSigInactiveValue" SG_ 615 BCS_RRWheelSpdEdgesSum 0;
BA_ "GenSigInvalidValue" SG_ 615 BCS_RRWheelSpdEdgesSum 0;
BA_ "GenSigSendType" SG_ 615 BCS_RRWheelSpdEdgesSum 1;
BA_ "GenSigStartValue" SG_ 615 BCS_RRWheelSpdEdgesSum 0;
BA_ "GenSigTimeoutValue" SG_ 615 BCS_RRWheelSpdEdgesSum 0;
BA_ "Remark" SG_ 615 BCS_RRWheelSpdEdgesSum "";
BA_ "EventCommandSignal" SG_ 615 BCS_FLWheelSpdEdgesSumVD 0;
BA_ "GatewayedSignals" SG_ 615 BCS_FLWheelSpdEdgesSumVD 0;
BA_ "GenSigInactiveValue" SG_ 615 BCS_FLWheelSpdEdgesSumVD 0;
BA_ "GenSigInvalidValue" SG_ 615 BCS_FLWheelSpdEdgesSumVD 0;
BA_ "GenSigSendType" SG_ 615 BCS_FLWheelSpdEdgesSumVD 1;
BA_ "GenSigStartValue" SG_ 615 BCS_FLWheelSpdEdgesSumVD 0;
BA_ "GenSigTimeoutValue" SG_ 615 BCS_FLWheelSpdEdgesSumVD 0;
BA_ "Remark" SG_ 615 BCS_FLWheelSpdEdgesSumVD "";
BA_ "EventCommandSignal" SG_ 615 BCS_FRWheelSpdEdgesSumVD 0;
BA_ "GatewayedSignals" SG_ 615 BCS_FRWheelSpdEdgesSumVD 0;
BA_ "GenSigInactiveValue" SG_ 615 BCS_FRWheelSpdEdgesSumVD 0;
BA_ "GenSigInvalidValue" SG_ 615 BCS_FRWheelSpdEdgesSumVD 0;
BA_ "GenSigSendType" SG_ 615 BCS_FRWheelSpdEdgesSumVD 1;
BA_ "GenSigStartValue" SG_ 615 BCS_FRWheelSpdEdgesSumVD 0;
BA_ "GenSigTimeoutValue" SG_ 615 BCS_FRWheelSpdEdgesSumVD 0;
BA_ "Remark" SG_ 615 BCS_FRWheelSpdEdgesSumVD "";
BA_ "EventCommandSignal" SG_ 615 BCS_RLWheelSpdEdgesSumVD 0;
BA_ "GatewayedSignals" SG_ 615 BCS_RLWheelSpdEdgesSumVD 0;
BA_ "GenSigInactiveValue" SG_ 615 BCS_RLWheelSpdEdgesSumVD 0;
BA_ "GenSigInvalidValue" SG_ 615 BCS_RLWheelSpdEdgesSumVD 0;
BA_ "GenSigSendType" SG_ 615 BCS_RLWheelSpdEdgesSumVD 1;
BA_ "GenSigStartValue" SG_ 615 BCS_RLWheelSpdEdgesSumVD 0;
BA_ "GenSigTimeoutValue" SG_ 615 BCS_RLWheelSpdEdgesSumVD 0;
BA_ "Remark" SG_ 615 BCS_RLWheelSpdEdgesSumVD "";
BA_ "EventCommandSignal" SG_ 615 BCS_RRWheelSpdEdgesSumVD 0;
BA_ "GatewayedSignals" SG_ 615 BCS_RRWheelSpdEdgesSumVD 0;
BA_ "GenSigInactiveValue" SG_ 615 BCS_RRWheelSpdEdgesSumVD 0;
BA_ "GenSigInvalidValue" SG_ 615 BCS_RRWheelSpdEdgesSumVD 0;
BA_ "GenSigSendType" SG_ 615 BCS_RRWheelSpdEdgesSumVD 1;
BA_ "GenSigStartValue" SG_ 615 BCS_RRWheelSpdEdgesSumVD 0;
BA_ "GenSigTimeoutValue" SG_ 615 BCS_RRWheelSpdEdgesSumVD 0;
BA_ "Remark" SG_ 615 BCS_RRWheelSpdEdgesSumVD "";
BA_ "EventCommandSignal" SG_ 615 BCS_FLWheelRotatedDirection 0;
BA_ "GatewayedSignals" SG_ 615 BCS_FLWheelRotatedDirection 0;
BA_ "GenSigInactiveValue" SG_ 615 BCS_FLWheelRotatedDirection 0;
BA_ "GenSigInvalidValue" SG_ 615 BCS_FLWheelRotatedDirection 0;
BA_ "GenSigSendType" SG_ 615 BCS_FLWheelRotatedDirection 1;
BA_ "GenSigStartValue" SG_ 615 BCS_FLWheelRotatedDirection 0;
BA_ "GenSigTimeoutValue" SG_ 615 BCS_FLWheelRotatedDirection 0;
BA_ "Remark" SG_ 615 BCS_FLWheelRotatedDirection "";
BA_ "EventCommandSignal" SG_ 615 BCS_FRWheelRotatedDirection 0;
BA_ "GatewayedSignals" SG_ 615 BCS_FRWheelRotatedDirection 0;
BA_ "GenSigInactiveValue" SG_ 615 BCS_FRWheelRotatedDirection 0;
BA_ "GenSigInvalidValue" SG_ 615 BCS_FRWheelRotatedDirection 0;
BA_ "GenSigSendType" SG_ 615 BCS_FRWheelRotatedDirection 1;
BA_ "GenSigStartValue" SG_ 615 BCS_FRWheelRotatedDirection 0;
BA_ "GenSigTimeoutValue" SG_ 615 BCS_FRWheelRotatedDirection 0;
BA_ "Remark" SG_ 615 BCS_FRWheelRotatedDirection "";
BA_ "EventCommandSignal" SG_ 615 BCS_RLWheelRotatedDirection 0;
BA_ "GatewayedSignals" SG_ 615 BCS_RLWheelRotatedDirection 0;
BA_ "GenSigInactiveValue" SG_ 615 BCS_RLWheelRotatedDirection 0;
BA_ "GenSigInvalidValue" SG_ 615 BCS_RLWheelRotatedDirection 0;
BA_ "GenSigSendType" SG_ 615 BCS_RLWheelRotatedDirection 1;
BA_ "GenSigStartValue" SG_ 615 BCS_RLWheelRotatedDirection 0;
BA_ "GenSigTimeoutValue" SG_ 615 BCS_RLWheelRotatedDirection 0;
BA_ "Remark" SG_ 615 BCS_RLWheelRotatedDirection "";
BA_ "EventCommandSignal" SG_ 615 BCS_RRWheelRotatedDirection 0;
BA_ "GatewayedSignals" SG_ 615 BCS_RRWheelRotatedDirection 0;
BA_ "GenSigInactiveValue" SG_ 615 BCS_RRWheelRotatedDirection 0;
BA_ "GenSigInvalidValue" SG_ 615 BCS_RRWheelRotatedDirection 0;
BA_ "GenSigSendType" SG_ 615 BCS_RRWheelRotatedDirection 1;
BA_ "GenSigStartValue" SG_ 615 BCS_RRWheelRotatedDirection 0;
BA_ "GenSigTimeoutValue" SG_ 615 BCS_RRWheelRotatedDirection 0;
BA_ "Remark" SG_ 615 BCS_RRWheelRotatedDirection "";
BA_ "EventCommandSignal" SG_ 615 BCS_ParkingReqToEPB 0;
BA_ "GatewayedSignals" SG_ 615 BCS_ParkingReqToEPB 0;
BA_ "GenSigInactiveValue" SG_ 615 BCS_ParkingReqToEPB 0;
BA_ "GenSigInvalidValue" SG_ 615 BCS_ParkingReqToEPB 0;
BA_ "GenSigSendType" SG_ 615 BCS_ParkingReqToEPB 1;
BA_ "GenSigStartValue" SG_ 615 BCS_ParkingReqToEPB 0;
BA_ "GenSigTimeoutValue" SG_ 615 BCS_ParkingReqToEPB 0;
BA_ "Remark" SG_ 615 BCS_ParkingReqToEPB "";
BA_ "EventCommandSignal" SG_ 615 BCS_VDCOff 0;
BA_ "GatewayedSignals" SG_ 615 BCS_VDCOff 0;
BA_ "GenSigInactiveValue" SG_ 615 BCS_VDCOff 0;
BA_ "GenSigInvalidValue" SG_ 615 BCS_VDCOff 0;
BA_ "GenSigSendType" SG_ 615 BCS_VDCOff 1;
BA_ "GenSigStartValue" SG_ 615 BCS_VDCOff 0;
BA_ "GenSigTimeoutValue" SG_ 615 BCS_VDCOff 0;
BA_ "Remark" SG_ 615 BCS_VDCOff "";
BA_ "EventCommandSignal" SG_ 615 BCS_AVHSt 0;
BA_ "GatewayedSignals" SG_ 615 BCS_AVHSt 0;
BA_ "GenSigInactiveValue" SG_ 615 BCS_AVHSt 0;
BA_ "GenSigInvalidValue" SG_ 615 BCS_AVHSt 0;
BA_ "GenSigSendType" SG_ 615 BCS_AVHSt 1;
BA_ "GenSigStartValue" SG_ 615 BCS_AVHSt 0;
BA_ "GenSigTimeoutValue" SG_ 615 BCS_AVHSt 0;
BA_ "Remark" SG_ 615 BCS_AVHSt "";
BA_ "EventCommandSignal" SG_ 615 BCS_AVHAvailable 0;
BA_ "GatewayedSignals" SG_ 615 BCS_AVHAvailable 0;
BA_ "GenSigInactiveValue" SG_ 615 BCS_AVHAvailable 0;
BA_ "GenSigInvalidValue" SG_ 615 BCS_AVHAvailable 0;
BA_ "GenSigSendType" SG_ 615 BCS_AVHAvailable 1;
BA_ "GenSigStartValue" SG_ 615 BCS_AVHAvailable 0;
BA_ "GenSigTimeoutValue" SG_ 615 BCS_AVHAvailable 0;
BA_ "Remark" SG_ 615 BCS_AVHAvailable "";
BA_ "EventCommandSignal" SG_ 615 BCS_TCSOff 0;
BA_ "GatewayedSignals" SG_ 615 BCS_TCSOff 0;
BA_ "GenSigInactiveValue" SG_ 615 BCS_TCSOff 0;
BA_ "GenSigInvalidValue" SG_ 615 BCS_TCSOff 0;
BA_ "GenSigSendType" SG_ 615 BCS_TCSOff 1;
BA_ "GenSigStartValue" SG_ 615 BCS_TCSOff 0;
BA_ "GenSigTimeoutValue" SG_ 615 BCS_TCSOff 0;
BA_ "Remark" SG_ 615 BCS_TCSOff "";
BA_ "EventCommandSignal" SG_ 615 BCS_BrakeOverHeat 0;
BA_ "GatewayedSignals" SG_ 615 BCS_BrakeOverHeat 0;
BA_ "GenSigInactiveValue" SG_ 615 BCS_BrakeOverHeat 0;
BA_ "GenSigInvalidValue" SG_ 615 BCS_BrakeOverHeat 0;
BA_ "GenSigSendType" SG_ 615 BCS_BrakeOverHeat 1;
BA_ "GenSigStartValue" SG_ 615 BCS_BrakeOverHeat 0;
BA_ "GenSigTimeoutValue" SG_ 615 BCS_BrakeOverHeat 0;
BA_ "Remark" SG_ 615 BCS_BrakeOverHeat "";
BA_ "EventCommandSignal" SG_ 615 BCS_ABAactive 0;
BA_ "GatewayedSignals" SG_ 615 BCS_ABAactive 0;
BA_ "GenSigInactiveValue" SG_ 615 BCS_ABAactive 0;
BA_ "GenSigInvalidValue" SG_ 615 BCS_ABAactive 0;
BA_ "GenSigSendType" SG_ 615 BCS_ABAactive 1;
BA_ "GenSigStartValue" SG_ 615 BCS_ABAactive 0;
BA_ "GenSigTimeoutValue" SG_ 615 BCS_ABAactive 0;
BA_ "Remark" SG_ 615 BCS_ABAactive "";
BA_ "EventCommandSignal" SG_ 615 BCS_ABAavailable 0;
BA_ "GatewayedSignals" SG_ 615 BCS_ABAavailable 0;
BA_ "GenSigInactiveValue" SG_ 615 BCS_ABAavailable 0;
BA_ "GenSigInvalidValue" SG_ 615 BCS_ABAavailable 0;
BA_ "GenSigSendType" SG_ 615 BCS_ABAavailable 1;
BA_ "GenSigStartValue" SG_ 615 BCS_ABAavailable 0;
BA_ "GenSigTimeoutValue" SG_ 615 BCS_ABAavailable 0;
BA_ "Remark" SG_ 615 BCS_ABAavailable "";
BA_ "EventCommandSignal" SG_ 615 BCS_ABPActive 0;
BA_ "GatewayedSignals" SG_ 615 BCS_ABPActive 0;
BA_ "GenSigInactiveValue" SG_ 615 BCS_ABPActive 0;
BA_ "GenSigInvalidValue" SG_ 615 BCS_ABPActive 0;
BA_ "GenSigSendType" SG_ 615 BCS_ABPActive 1;
BA_ "GenSigStartValue" SG_ 615 BCS_ABPActive 0;
BA_ "GenSigTimeoutValue" SG_ 615 BCS_ABPActive 0;
BA_ "Remark" SG_ 615 BCS_ABPActive "";
BA_ "EventCommandSignal" SG_ 615 BCS_ABPAvailable 0;
BA_ "GatewayedSignals" SG_ 615 BCS_ABPAvailable 0;
BA_ "GenSigInactiveValue" SG_ 615 BCS_ABPAvailable 0;
BA_ "GenSigInvalidValue" SG_ 615 BCS_ABPAvailable 0;
BA_ "GenSigSendType" SG_ 615 BCS_ABPAvailable 1;
BA_ "GenSigStartValue" SG_ 615 BCS_ABPAvailable 0;
BA_ "GenSigTimeoutValue" SG_ 615 BCS_ABPAvailable 0;
BA_ "Remark" SG_ 615 BCS_ABPAvailable "";
BA_ "EventCommandSignal" SG_ 615 BCS_AEBActive 0;
BA_ "GatewayedSignals" SG_ 615 BCS_AEBActive 0;
BA_ "GenSigInactiveValue" SG_ 615 BCS_AEBActive 0;
BA_ "GenSigInvalidValue" SG_ 615 BCS_AEBActive 0;
BA_ "GenSigSendType" SG_ 615 BCS_AEBActive 1;
BA_ "GenSigStartValue" SG_ 615 BCS_AEBActive 0;
BA_ "GenSigTimeoutValue" SG_ 615 BCS_AEBActive 0;
BA_ "Remark" SG_ 615 BCS_AEBActive "";
BA_ "EventCommandSignal" SG_ 615 BCS_AEBAvailable 0;
BA_ "GatewayedSignals" SG_ 615 BCS_AEBAvailable 0;
BA_ "GenSigInactiveValue" SG_ 615 BCS_AEBAvailable 0;
BA_ "GenSigInvalidValue" SG_ 615 BCS_AEBAvailable 0;
BA_ "GenSigSendType" SG_ 615 BCS_AEBAvailable 1;
BA_ "GenSigStartValue" SG_ 615 BCS_AEBAvailable 0;
BA_ "GenSigTimeoutValue" SG_ 615 BCS_AEBAvailable 0;
BA_ "Remark" SG_ 615 BCS_AEBAvailable "";
BA_ "EventCommandSignal" SG_ 615 BCS_AWBActive 0;
BA_ "GatewayedSignals" SG_ 615 BCS_AWBActive 0;
BA_ "GenSigInactiveValue" SG_ 615 BCS_AWBActive 0;
BA_ "GenSigInvalidValue" SG_ 615 BCS_AWBActive 0;
BA_ "GenSigSendType" SG_ 615 BCS_AWBActive 1;
BA_ "GenSigStartValue" SG_ 615 BCS_AWBActive 0;
BA_ "GenSigTimeoutValue" SG_ 615 BCS_AWBActive 0;
BA_ "Remark" SG_ 615 BCS_AWBActive "";
BA_ "EventCommandSignal" SG_ 615 BCS_AWBAvailable 0;
BA_ "GatewayedSignals" SG_ 615 BCS_AWBAvailable 0;
BA_ "GenSigInactiveValue" SG_ 615 BCS_AWBAvailable 0;
BA_ "GenSigInvalidValue" SG_ 615 BCS_AWBAvailable 0;
BA_ "GenSigSendType" SG_ 615 BCS_AWBAvailable 1;
BA_ "GenSigStartValue" SG_ 615 BCS_AWBAvailable 0;
BA_ "GenSigTimeoutValue" SG_ 615 BCS_AWBAvailable 0;
BA_ "Remark" SG_ 615 BCS_AWBAvailable "";
BA_ "EventCommandSignal" SG_ 615 BCS_VehicleStandStillSt 0;
BA_ "GatewayedSignals" SG_ 615 BCS_VehicleStandStillSt 0;
BA_ "GenSigInactiveValue" SG_ 615 BCS_VehicleStandStillSt 0;
BA_ "GenSigInvalidValue" SG_ 615 BCS_VehicleStandStillSt 0;
BA_ "GenSigSendType" SG_ 615 BCS_VehicleStandStillSt 1;
BA_ "GenSigStartValue" SG_ 615 BCS_VehicleStandStillSt 0;
BA_ "GenSigTimeoutValue" SG_ 615 BCS_VehicleStandStillSt 0;
BA_ "Remark" SG_ 615 BCS_VehicleStandStillSt "";
BA_ "EventCommandSignal" SG_ 615 BCS_InputRodStroke 0;
BA_ "GatewayedSignals" SG_ 615 BCS_InputRodStroke 0;
BA_ "GenSigInactiveValue" SG_ 615 BCS_InputRodStroke 0;
BA_ "GenSigInvalidValue" SG_ 615 BCS_InputRodStroke 0;
BA_ "GenSigSendType" SG_ 615 BCS_InputRodStroke 1;
BA_ "GenSigStartValue" SG_ 615 BCS_InputRodStroke 100;
BA_ "GenSigTimeoutValue" SG_ 615 BCS_InputRodStroke 0;
BA_ "Remark" SG_ 615 BCS_InputRodStroke "";
BA_ "EventCommandSignal" SG_ 615 BCS_InputRodStrokeSt 0;
BA_ "GatewayedSignals" SG_ 615 BCS_InputRodStrokeSt 0;
BA_ "GenSigInactiveValue" SG_ 615 BCS_InputRodStrokeSt 0;
BA_ "GenSigInvalidValue" SG_ 615 BCS_InputRodStrokeSt 0;
BA_ "GenSigSendType" SG_ 615 BCS_InputRodStrokeSt 1;
BA_ "GenSigStartValue" SG_ 615 BCS_InputRodStrokeSt 0;
BA_ "GenSigTimeoutValue" SG_ 615 BCS_InputRodStrokeSt 0;
BA_ "Remark" SG_ 615 BCS_InputRodStrokeSt "";
BA_ "EventCommandSignal" SG_ 615 BCS_PlungerPressureSt 0;
BA_ "GatewayedSignals" SG_ 615 BCS_PlungerPressureSt 0;
BA_ "GenSigInactiveValue" SG_ 615 BCS_PlungerPressureSt 0;
BA_ "GenSigInvalidValue" SG_ 615 BCS_PlungerPressureSt 0;
BA_ "GenSigSendType" SG_ 615 BCS_PlungerPressureSt 1;
BA_ "GenSigStartValue" SG_ 615 BCS_PlungerPressureSt 0;
BA_ "GenSigTimeoutValue" SG_ 615 BCS_PlungerPressureSt 0;
BA_ "Remark" SG_ 615 BCS_PlungerPressureSt "";
BA_ "EventCommandSignal" SG_ 615 BCS_PlungerPressure 0;
BA_ "GatewayedSignals" SG_ 615 BCS_PlungerPressure 0;
BA_ "GenSigInactiveValue" SG_ 615 BCS_PlungerPressure 0;
BA_ "GenSigInvalidValue" SG_ 615 BCS_PlungerPressure 0;
BA_ "GenSigSendType" SG_ 615 BCS_PlungerPressure 1;
BA_ "GenSigStartValue" SG_ 615 BCS_PlungerPressure 17;
BA_ "GenSigTimeoutValue" SG_ 615 BCS_PlungerPressure 0;
BA_ "Remark" SG_ 615 BCS_PlungerPressure "";
BA_ "EventCommandSignal" SG_ 615 BCS_BrkTqCtrlAvlDrivingRdn 0;
BA_ "GatewayedSignals" SG_ 615 BCS_BrkTqCtrlAvlDrivingRdn 0;
BA_ "GenSigInactiveValue" SG_ 615 BCS_BrkTqCtrlAvlDrivingRdn 0;
BA_ "GenSigInvalidValue" SG_ 615 BCS_BrkTqCtrlAvlDrivingRdn 0;
BA_ "GenSigSendType" SG_ 615 BCS_BrkTqCtrlAvlDrivingRdn 1;
BA_ "GenSigStartValue" SG_ 615 BCS_BrkTqCtrlAvlDrivingRdn 0;
BA_ "GenSigTimeoutValue" SG_ 615 BCS_BrkTqCtrlAvlDrivingRdn 0;
BA_ "Remark" SG_ 615 BCS_BrkTqCtrlAvlDrivingRdn "";
BA_ "EventCommandSignal" SG_ 615 BCS_BrkTqCtrlActvRdn 0;
BA_ "GatewayedSignals" SG_ 615 BCS_BrkTqCtrlActvRdn 0;
BA_ "GenSigInactiveValue" SG_ 615 BCS_BrkTqCtrlActvRdn 0;
BA_ "GenSigInvalidValue" SG_ 615 BCS_BrkTqCtrlActvRdn 0;
BA_ "GenSigSendType" SG_ 615 BCS_BrkTqCtrlActvRdn 1;
BA_ "GenSigStartValue" SG_ 615 BCS_BrkTqCtrlActvRdn 0;
BA_ "GenSigTimeoutValue" SG_ 615 BCS_BrkTqCtrlActvRdn 0;
BA_ "Remark" SG_ 615 BCS_BrkTqCtrlActvRdn "";
BA_ "EventCommandSignal" SG_ 615 BCS_L3ComVD 0;
BA_ "GatewayedSignals" SG_ 615 BCS_L3ComVD 0;
BA_ "GenSigInactiveValue" SG_ 615 BCS_L3ComVD 0;
BA_ "GenSigInvalidValue" SG_ 615 BCS_L3ComVD 0;
BA_ "GenSigSendType" SG_ 615 BCS_L3ComVD 1;
BA_ "GenSigStartValue" SG_ 615 BCS_L3ComVD 0;
BA_ "GenSigTimeoutValue" SG_ 615 BCS_L3ComVD 0;
BA_ "Remark" SG_ 615 BCS_L3ComVD "";
BA_ "EventCommandSignal" SG_ 615 BCS_LFIActiveSt 0;
BA_ "GatewayedSignals" SG_ 615 BCS_LFIActiveSt 0;
BA_ "GenSigInactiveValue" SG_ 615 BCS_LFIActiveSt 0;
BA_ "GenSigInvalidValue" SG_ 615 BCS_LFIActiveSt 0;
BA_ "GenSigSendType" SG_ 615 BCS_LFIActiveSt 1;
BA_ "GenSigStartValue" SG_ 615 BCS_LFIActiveSt 0;
BA_ "GenSigTimeoutValue" SG_ 615 BCS_LFIActiveSt 0;
BA_ "Remark" SG_ 615 BCS_LFIActiveSt "";
BA_ "EventCommandSignal" SG_ 430 SRS_1_CRC_1 0;
BA_ "GatewayedSignals" SG_ 430 SRS_1_CRC_1 0;
BA_ "GenSigInactiveValue" SG_ 430 SRS_1_CRC_1 0;
BA_ "GenSigInvalidValue" SG_ 430 SRS_1_CRC_1 0;
BA_ "GenSigSendType" SG_ 430 SRS_1_CRC_1 1;
BA_ "GenSigStartValue" SG_ 430 SRS_1_CRC_1 0;
BA_ "GenSigTimeoutValue" SG_ 430 SRS_1_CRC_1 0;
BA_ "Remark" SG_ 430 SRS_1_CRC_1 "";
BA_ "EventCommandSignal" SG_ 430 SRS_1_Counter_1 0;
BA_ "GatewayedSignals" SG_ 430 SRS_1_Counter_1 0;
BA_ "GenSigInactiveValue" SG_ 430 SRS_1_Counter_1 0;
BA_ "GenSigInvalidValue" SG_ 430 SRS_1_Counter_1 0;
BA_ "GenSigSendType" SG_ 430 SRS_1_Counter_1 1;
BA_ "GenSigStartValue" SG_ 430 SRS_1_Counter_1 0;
BA_ "GenSigTimeoutValue" SG_ 430 SRS_1_Counter_1 0;
BA_ "Remark" SG_ 430 SRS_1_Counter_1 "";
BA_ "EventCommandSignal" SG_ 430 SRS_CrashOutputSt 0;
BA_ "GatewayedSignals" SG_ 430 SRS_CrashOutputSt 0;
BA_ "GenSigInactiveValue" SG_ 430 SRS_CrashOutputSt 0;
BA_ "GenSigInvalidValue" SG_ 430 SRS_CrashOutputSt 0;
BA_ "GenSigSendType" SG_ 430 SRS_CrashOutputSt 1;
BA_ "GenSigStartValue" SG_ 430 SRS_CrashOutputSt 0;
BA_ "GenSigTimeoutValue" SG_ 430 SRS_CrashOutputSt 0;
BA_ "Remark" SG_ 430 SRS_CrashOutputSt "";
BA_ "EventCommandSignal" SG_ 430 SRS_Front_CrashOutputSt 0;
BA_ "GatewayedSignals" SG_ 430 SRS_Front_CrashOutputSt 0;
BA_ "GenSigInactiveValue" SG_ 430 SRS_Front_CrashOutputSt 0;
BA_ "GenSigInvalidValue" SG_ 430 SRS_Front_CrashOutputSt 0;
BA_ "GenSigSendType" SG_ 430 SRS_Front_CrashOutputSt 1;
BA_ "GenSigStartValue" SG_ 430 SRS_Front_CrashOutputSt 0;
BA_ "GenSigTimeoutValue" SG_ 430 SRS_Front_CrashOutputSt 0;
BA_ "Remark" SG_ 430 SRS_Front_CrashOutputSt "";
BA_ "EventCommandSignal" SG_ 430 SRS_DriverSide_CrashOutputSt 0;
BA_ "GatewayedSignals" SG_ 430 SRS_DriverSide_CrashOutputSt 0;
BA_ "GenSigInactiveValue" SG_ 430 SRS_DriverSide_CrashOutputSt 0;
BA_ "GenSigInvalidValue" SG_ 430 SRS_DriverSide_CrashOutputSt 0;
BA_ "GenSigSendType" SG_ 430 SRS_DriverSide_CrashOutputSt 1;
BA_ "GenSigStartValue" SG_ 430 SRS_DriverSide_CrashOutputSt 0;
BA_ "GenSigTimeoutValue" SG_ 430 SRS_DriverSide_CrashOutputSt 0;
BA_ "Remark" SG_ 430 SRS_DriverSide_CrashOutputSt "";
BA_ "EventCommandSignal" SG_ 430 SRS_PassengerSide_CrashOutputSt 0;
BA_ "GatewayedSignals" SG_ 430 SRS_PassengerSide_CrashOutputSt 0;
BA_ "GenSigInactiveValue" SG_ 430 SRS_PassengerSide_CrashOutputSt 0;
BA_ "GenSigInvalidValue" SG_ 430 SRS_PassengerSide_CrashOutputSt 0;
BA_ "GenSigSendType" SG_ 430 SRS_PassengerSide_CrashOutputSt 1;
BA_ "GenSigStartValue" SG_ 430 SRS_PassengerSide_CrashOutputSt 0;
BA_ "GenSigTimeoutValue" SG_ 430 SRS_PassengerSide_CrashOutputSt 0;
BA_ "Remark" SG_ 430 SRS_PassengerSide_CrashOutputSt "";
BA_ "EventCommandSignal" SG_ 430 SRS_Rear_CrashOutputSt 0;
BA_ "GatewayedSignals" SG_ 430 SRS_Rear_CrashOutputSt 0;
BA_ "GenSigInactiveValue" SG_ 430 SRS_Rear_CrashOutputSt 0;
BA_ "GenSigInvalidValue" SG_ 430 SRS_Rear_CrashOutputSt 0;
BA_ "GenSigSendType" SG_ 430 SRS_Rear_CrashOutputSt 1;
BA_ "GenSigStartValue" SG_ 430 SRS_Rear_CrashOutputSt 0;
BA_ "GenSigTimeoutValue" SG_ 430 SRS_Rear_CrashOutputSt 0;
BA_ "Remark" SG_ 430 SRS_Rear_CrashOutputSt "";
BA_ "EventCommandSignal" SG_ 430 SRS_RolloverCrashOutputSt 0;
BA_ "GatewayedSignals" SG_ 430 SRS_RolloverCrashOutputSt 0;
BA_ "GenSigInactiveValue" SG_ 430 SRS_RolloverCrashOutputSt 0;
BA_ "GenSigInvalidValue" SG_ 430 SRS_RolloverCrashOutputSt 0;
BA_ "GenSigSendType" SG_ 430 SRS_RolloverCrashOutputSt 1;
BA_ "GenSigStartValue" SG_ 430 SRS_RolloverCrashOutputSt 0;
BA_ "GenSigTimeoutValue" SG_ 430 SRS_RolloverCrashOutputSt 0;
BA_ "Remark" SG_ 430 SRS_RolloverCrashOutputSt "";
BA_ "EventCommandSignal" SG_ 430 SRS_NearCrashOutputSt 0;
BA_ "GatewayedSignals" SG_ 430 SRS_NearCrashOutputSt 0;
BA_ "GenSigInactiveValue" SG_ 430 SRS_NearCrashOutputSt 0;
BA_ "GenSigInvalidValue" SG_ 430 SRS_NearCrashOutputSt 0;
BA_ "GenSigSendType" SG_ 430 SRS_NearCrashOutputSt 1;
BA_ "GenSigStartValue" SG_ 430 SRS_NearCrashOutputSt 0;
BA_ "GenSigTimeoutValue" SG_ 430 SRS_NearCrashOutputSt 0;
BA_ "Remark" SG_ 430 SRS_NearCrashOutputSt "";
BA_ "EventCommandSignal" SG_ 430 SRS_YawSnsCalibSt 0;
BA_ "GatewayedSignals" SG_ 430 SRS_YawSnsCalibSt 0;
BA_ "GenSigInactiveValue" SG_ 430 SRS_YawSnsCalibSt 0;
BA_ "GenSigInvalidValue" SG_ 430 SRS_YawSnsCalibSt 0;
BA_ "GenSigSendType" SG_ 430 SRS_YawSnsCalibSt 1;
BA_ "GenSigStartValue" SG_ 430 SRS_YawSnsCalibSt 0;
BA_ "GenSigTimeoutValue" SG_ 430 SRS_YawSnsCalibSt 0;
BA_ "Remark" SG_ 430 SRS_YawSnsCalibSt "";
BA_ "EventCommandSignal" SG_ 430 SRS_VehLongAccelVD 0;
BA_ "GatewayedSignals" SG_ 430 SRS_VehLongAccelVD 0;
BA_ "GenSigInactiveValue" SG_ 430 SRS_VehLongAccelVD 0;
BA_ "GenSigInvalidValue" SG_ 430 SRS_VehLongAccelVD 0;
BA_ "GenSigSendType" SG_ 430 SRS_VehLongAccelVD 1;
BA_ "GenSigStartValue" SG_ 430 SRS_VehLongAccelVD 0;
BA_ "GenSigTimeoutValue" SG_ 430 SRS_VehLongAccelVD 2;
BA_ "Remark" SG_ 430 SRS_VehLongAccelVD "";
BA_ "EventCommandSignal" SG_ 430 SRS_VehLatrlAccelVD 0;
BA_ "GatewayedSignals" SG_ 430 SRS_VehLatrlAccelVD 0;
BA_ "GenSigInactiveValue" SG_ 430 SRS_VehLatrlAccelVD 0;
BA_ "GenSigInvalidValue" SG_ 430 SRS_VehLatrlAccelVD 0;
BA_ "GenSigSendType" SG_ 430 SRS_VehLatrlAccelVD 1;
BA_ "GenSigStartValue" SG_ 430 SRS_VehLatrlAccelVD 0;
BA_ "GenSigTimeoutValue" SG_ 430 SRS_VehLatrlAccelVD 2;
BA_ "Remark" SG_ 430 SRS_VehLatrlAccelVD "";
BA_ "EventCommandSignal" SG_ 430 SRS_YawRateVD 0;
BA_ "GatewayedSignals" SG_ 430 SRS_YawRateVD 0;
BA_ "GenSigInactiveValue" SG_ 430 SRS_YawRateVD 0;
BA_ "GenSigInvalidValue" SG_ 430 SRS_YawRateVD 0;
BA_ "GenSigSendType" SG_ 430 SRS_YawRateVD 1;
BA_ "GenSigStartValue" SG_ 430 SRS_YawRateVD 0;
BA_ "GenSigTimeoutValue" SG_ 430 SRS_YawRateVD 2;
BA_ "Remark" SG_ 430 SRS_YawRateVD "";
BA_ "EventCommandSignal" SG_ 430 SRS_VehLongAccel 0;
BA_ "GatewayedSignals" SG_ 430 SRS_VehLongAccel 0;
BA_ "GenSigInactiveValue" SG_ 430 SRS_VehLongAccel 0;
BA_ "GenSigInvalidValue" SG_ 430 SRS_VehLongAccel 0;
BA_ "GenSigSendType" SG_ 430 SRS_VehLongAccel 1;
BA_ "GenSigStartValue" SG_ 430 SRS_VehLongAccel 2000;
BA_ "GenSigTimeoutValue" SG_ 430 SRS_VehLongAccel 2000;
BA_ "Remark" SG_ 430 SRS_VehLongAccel "";
BA_ "EventCommandSignal" SG_ 430 SRS_VehLatrlAccel 0;
BA_ "GatewayedSignals" SG_ 430 SRS_VehLatrlAccel 0;
BA_ "GenSigInactiveValue" SG_ 430 SRS_VehLatrlAccel 0;
BA_ "GenSigInvalidValue" SG_ 430 SRS_VehLatrlAccel 0;
BA_ "GenSigSendType" SG_ 430 SRS_VehLatrlAccel 1;
BA_ "GenSigStartValue" SG_ 430 SRS_VehLatrlAccel 2000;
BA_ "GenSigTimeoutValue" SG_ 430 SRS_VehLatrlAccel 2000;
BA_ "Remark" SG_ 430 SRS_VehLatrlAccel "";
BA_ "EventCommandSignal" SG_ 430 SRS_YawRate 0;
BA_ "GatewayedSignals" SG_ 430 SRS_YawRate 0;
BA_ "GenSigInactiveValue" SG_ 430 SRS_YawRate 0;
BA_ "GenSigInvalidValue" SG_ 430 SRS_YawRate 0;
BA_ "GenSigSendType" SG_ 430 SRS_YawRate 1;
BA_ "GenSigStartValue" SG_ 430 SRS_YawRate 18000;
BA_ "GenSigTimeoutValue" SG_ 430 SRS_YawRate 18000;
BA_ "Remark" SG_ 430 SRS_YawRate "";
BA_ "EventCommandSignal" SG_ 290 IPDS_FrontRadarPowerSup 1;
BA_ "GatewayedSignals" SG_ 290 IPDS_FrontRadarPowerSup 0;
BA_ "GenSigInactiveValue" SG_ 290 IPDS_FrontRadarPowerSup 0;
BA_ "GenSigInvalidValue" SG_ 290 IPDS_FrontRadarPowerSup 0;
BA_ "GenSigSendType" SG_ 290 IPDS_FrontRadarPowerSup 0;
BA_ "GenSigStartValue" SG_ 290 IPDS_FrontRadarPowerSup 3;
BA_ "GenSigTimeoutValue" SG_ 290 IPDS_FrontRadarPowerSup 0;
BA_ "Remark" SG_ 290 IPDS_FrontRadarPowerSup "";
BA_ "EventCommandSignal" SG_ 290 IPDS_FLRadarPowerSup 1;
BA_ "GatewayedSignals" SG_ 290 IPDS_FLRadarPowerSup 0;
BA_ "GenSigInactiveValue" SG_ 290 IPDS_FLRadarPowerSup 0;
BA_ "GenSigInvalidValue" SG_ 290 IPDS_FLRadarPowerSup 0;
BA_ "GenSigSendType" SG_ 290 IPDS_FLRadarPowerSup 0;
BA_ "GenSigStartValue" SG_ 290 IPDS_FLRadarPowerSup 3;
BA_ "GenSigTimeoutValue" SG_ 290 IPDS_FLRadarPowerSup 0;
BA_ "Remark" SG_ 290 IPDS_FLRadarPowerSup "";
BA_ "EventCommandSignal" SG_ 290 IPDS_FRRadarPowerSup 1;
BA_ "GatewayedSignals" SG_ 290 IPDS_FRRadarPowerSup 0;
BA_ "GenSigInactiveValue" SG_ 290 IPDS_FRRadarPowerSup 0;
BA_ "GenSigInvalidValue" SG_ 290 IPDS_FRRadarPowerSup 0;
BA_ "GenSigSendType" SG_ 290 IPDS_FRRadarPowerSup 0;
BA_ "GenSigStartValue" SG_ 290 IPDS_FRRadarPowerSup 3;
BA_ "GenSigTimeoutValue" SG_ 290 IPDS_FRRadarPowerSup 0;
BA_ "Remark" SG_ 290 IPDS_FRRadarPowerSup "";
BA_ "EventCommandSignal" SG_ 290 IPDS_HDMapPowerSup 1;
BA_ "GatewayedSignals" SG_ 290 IPDS_HDMapPowerSup 0;
BA_ "GenSigInactiveValue" SG_ 290 IPDS_HDMapPowerSup 0;
BA_ "GenSigInvalidValue" SG_ 290 IPDS_HDMapPowerSup 0;
BA_ "GenSigSendType" SG_ 290 IPDS_HDMapPowerSup 0;
BA_ "GenSigStartValue" SG_ 290 IPDS_HDMapPowerSup 3;
BA_ "GenSigTimeoutValue" SG_ 290 IPDS_HDMapPowerSup 0;
BA_ "Remark" SG_ 290 IPDS_HDMapPowerSup "";
BA_ "EventCommandSignal" SG_ 290 IPDS_Lidar1PowerSup 1;
BA_ "GatewayedSignals" SG_ 290 IPDS_Lidar1PowerSup 0;
BA_ "GenSigInactiveValue" SG_ 290 IPDS_Lidar1PowerSup 0;
BA_ "GenSigInvalidValue" SG_ 290 IPDS_Lidar1PowerSup 0;
BA_ "GenSigSendType" SG_ 290 IPDS_Lidar1PowerSup 0;
BA_ "GenSigStartValue" SG_ 290 IPDS_Lidar1PowerSup 3;
BA_ "GenSigTimeoutValue" SG_ 290 IPDS_Lidar1PowerSup 0;
BA_ "Remark" SG_ 290 IPDS_Lidar1PowerSup "";
BA_ "EventCommandSignal" SG_ 290 IPDS_RearRadarPowerSup 1;
BA_ "GatewayedSignals" SG_ 290 IPDS_RearRadarPowerSup 0;
BA_ "GenSigInactiveValue" SG_ 290 IPDS_RearRadarPowerSup 0;
BA_ "GenSigInvalidValue" SG_ 290 IPDS_RearRadarPowerSup 0;
BA_ "GenSigSendType" SG_ 290 IPDS_RearRadarPowerSup 0;
BA_ "GenSigStartValue" SG_ 290 IPDS_RearRadarPowerSup 3;
BA_ "GenSigTimeoutValue" SG_ 290 IPDS_RearRadarPowerSup 0;
BA_ "Remark" SG_ 290 IPDS_RearRadarPowerSup "";
BA_ "EventCommandSignal" SG_ 398 EMS_ClutchTorqVD 0;
BA_ "GatewayedSignals" SG_ 398 EMS_ClutchTorqVD 0;
BA_ "GenSigInactiveValue" SG_ 398 EMS_ClutchTorqVD 0;
BA_ "GenSigInvalidValue" SG_ 398 EMS_ClutchTorqVD 0;
BA_ "GenSigSendType" SG_ 398 EMS_ClutchTorqVD 1;
BA_ "GenSigStartValue" SG_ 398 EMS_ClutchTorqVD 0;
BA_ "GenSigTimeoutValue" SG_ 398 EMS_ClutchTorqVD 0;
BA_ "Remark" SG_ 398 EMS_ClutchTorqVD "";
BA_ "EventCommandSignal" SG_ 398 EMS_EngFrictionTorqVD 0;
BA_ "GatewayedSignals" SG_ 398 EMS_EngFrictionTorqVD 0;
BA_ "GenSigInactiveValue" SG_ 398 EMS_EngFrictionTorqVD 0;
BA_ "GenSigInvalidValue" SG_ 398 EMS_EngFrictionTorqVD 0;
BA_ "GenSigSendType" SG_ 398 EMS_EngFrictionTorqVD 1;
BA_ "GenSigStartValue" SG_ 398 EMS_EngFrictionTorqVD 0;
BA_ "GenSigTimeoutValue" SG_ 398 EMS_EngFrictionTorqVD 0;
BA_ "Remark" SG_ 398 EMS_EngFrictionTorqVD "";
BA_ "EventCommandSignal" SG_ 398 EMS_MinClutchTorqVD 0;
BA_ "GatewayedSignals" SG_ 398 EMS_MinClutchTorqVD 0;
BA_ "GenSigInactiveValue" SG_ 398 EMS_MinClutchTorqVD 0;
BA_ "GenSigInvalidValue" SG_ 398 EMS_MinClutchTorqVD 0;
BA_ "GenSigSendType" SG_ 398 EMS_MinClutchTorqVD 1;
BA_ "GenSigStartValue" SG_ 398 EMS_MinClutchTorqVD 0;
BA_ "GenSigTimeoutValue" SG_ 398 EMS_MinClutchTorqVD 0;
BA_ "Remark" SG_ 398 EMS_MinClutchTorqVD "";
BA_ "EventCommandSignal" SG_ 398 EMS_MaxClutchTorqVD 0;
BA_ "GatewayedSignals" SG_ 398 EMS_MaxClutchTorqVD 0;
BA_ "GenSigInactiveValue" SG_ 398 EMS_MaxClutchTorqVD 0;
BA_ "GenSigInvalidValue" SG_ 398 EMS_MaxClutchTorqVD 0;
BA_ "GenSigSendType" SG_ 398 EMS_MaxClutchTorqVD 1;
BA_ "GenSigStartValue" SG_ 398 EMS_MaxClutchTorqVD 0;
BA_ "GenSigTimeoutValue" SG_ 398 EMS_MaxClutchTorqVD 0;
BA_ "Remark" SG_ 398 EMS_MaxClutchTorqVD "";
BA_ "EventCommandSignal" SG_ 398 EMS_EngSt 0;
BA_ "GatewayedSignals" SG_ 398 EMS_EngSt 0;
BA_ "GenSigInactiveValue" SG_ 398 EMS_EngSt 0;
BA_ "GenSigInvalidValue" SG_ 398 EMS_EngSt 0;
BA_ "GenSigSendType" SG_ 398 EMS_EngSt 1;
BA_ "GenSigStartValue" SG_ 398 EMS_EngSt 0;
BA_ "GenSigTimeoutValue" SG_ 398 EMS_EngSt 0;
BA_ "Remark" SG_ 398 EMS_EngSt "";
BA_ "EventCommandSignal" SG_ 398 EMS_MaxEngTorqNorm 0;
BA_ "GatewayedSignals" SG_ 398 EMS_MaxEngTorqNorm 0;
BA_ "GenSigInactiveValue" SG_ 398 EMS_MaxEngTorqNorm 0;
BA_ "GenSigInvalidValue" SG_ 398 EMS_MaxEngTorqNorm 0;
BA_ "GenSigSendType" SG_ 398 EMS_MaxEngTorqNorm 1;
BA_ "GenSigStartValue" SG_ 398 EMS_MaxEngTorqNorm 0;
BA_ "GenSigTimeoutValue" SG_ 398 EMS_MaxEngTorqNorm 0;
BA_ "Remark" SG_ 398 EMS_MaxEngTorqNorm "";
BA_ "EventCommandSignal" SG_ 161 ACU_FaceID_Delete 1;
BA_ "GatewayedSignals" SG_ 161 ACU_FaceID_Delete 0;
BA_ "GenSigInactiveValue" SG_ 161 ACU_FaceID_Delete 0;
BA_ "GenSigInvalidValue" SG_ 161 ACU_FaceID_Delete 0;
BA_ "GenSigSendType" SG_ 161 ACU_FaceID_Delete 0;
BA_ "GenSigStartValue" SG_ 161 ACU_FaceID_Delete 0;
BA_ "GenSigTimeoutValue" SG_ 161 ACU_FaceID_Delete 0;
BA_ "Remark" SG_ 161 ACU_FaceID_Delete "";
BA_ "EventCommandSignal" SG_ 161 ACU_RegisterTriger 1;
BA_ "GatewayedSignals" SG_ 161 ACU_RegisterTriger 0;
BA_ "GenSigInactiveValue" SG_ 161 ACU_RegisterTriger 0;
BA_ "GenSigInvalidValue" SG_ 161 ACU_RegisterTriger 0;
BA_ "GenSigSendType" SG_ 161 ACU_RegisterTriger 0;
BA_ "GenSigStartValue" SG_ 161 ACU_RegisterTriger 0;
BA_ "GenSigTimeoutValue" SG_ 161 ACU_RegisterTriger 0;
BA_ "Remark" SG_ 161 ACU_RegisterTriger "";
BA_ "EventCommandSignal" SG_ 161 ACU_VerifyTriger 1;
BA_ "GatewayedSignals" SG_ 161 ACU_VerifyTriger 0;
BA_ "GenSigInactiveValue" SG_ 161 ACU_VerifyTriger 0;
BA_ "GenSigInvalidValue" SG_ 161 ACU_VerifyTriger 0;
BA_ "GenSigSendType" SG_ 161 ACU_VerifyTriger 0;
BA_ "GenSigStartValue" SG_ 161 ACU_VerifyTriger 0;
BA_ "GenSigTimeoutValue" SG_ 161 ACU_VerifyTriger 0;
BA_ "Remark" SG_ 161 ACU_VerifyTriger "";
BA_ "EventCommandSignal" SG_ 161 ACU_FaceIDQuit 1;
BA_ "GatewayedSignals" SG_ 161 ACU_FaceIDQuit 0;
BA_ "GenSigInactiveValue" SG_ 161 ACU_FaceIDQuit 0;
BA_ "GenSigInvalidValue" SG_ 161 ACU_FaceIDQuit 0;
BA_ "GenSigSendType" SG_ 161 ACU_FaceIDQuit 0;
BA_ "GenSigStartValue" SG_ 161 ACU_FaceIDQuit 0;
BA_ "GenSigTimeoutValue" SG_ 161 ACU_FaceIDQuit 0;
BA_ "Remark" SG_ 161 ACU_FaceIDQuit "";
BA_ "EventCommandSignal" SG_ 161 ACU_FaceIDSwitch 1;
BA_ "GatewayedSignals" SG_ 161 ACU_FaceIDSwitch 0;
BA_ "GenSigInactiveValue" SG_ 161 ACU_FaceIDSwitch 0;
BA_ "GenSigInvalidValue" SG_ 161 ACU_FaceIDSwitch 0;
BA_ "GenSigSendType" SG_ 161 ACU_FaceIDSwitch 0;
BA_ "GenSigStartValue" SG_ 161 ACU_FaceIDSwitch 0;
BA_ "GenSigTimeoutValue" SG_ 161 ACU_FaceIDSwitch 0;
BA_ "Remark" SG_ 161 ACU_FaceIDSwitch "";
BA_ "EventCommandSignal" SG_ 161 ACU_AVAS_SwitchCfgReq 1;
BA_ "GatewayedSignals" SG_ 161 ACU_AVAS_SwitchCfgReq 0;
BA_ "GenSigInactiveValue" SG_ 161 ACU_AVAS_SwitchCfgReq 0;
BA_ "GenSigInvalidValue" SG_ 161 ACU_AVAS_SwitchCfgReq 0;
BA_ "GenSigSendType" SG_ 161 ACU_AVAS_SwitchCfgReq 0;
BA_ "GenSigStartValue" SG_ 161 ACU_AVAS_SwitchCfgReq 0;
BA_ "GenSigTimeoutValue" SG_ 161 ACU_AVAS_SwitchCfgReq 0;
BA_ "Remark" SG_ 161 ACU_AVAS_SwitchCfgReq "";
BA_ "EventCommandSignal" SG_ 1045 ACU_Longitude 0;
BA_ "GatewayedSignals" SG_ 1045 ACU_Longitude 0;
BA_ "GenSigInactiveValue" SG_ 1045 ACU_Longitude 0;
BA_ "GenSigInvalidValue" SG_ 1045 ACU_Longitude 0;
BA_ "GenSigSendType" SG_ 1045 ACU_Longitude 1;
BA_ "GenSigStartValue" SG_ 1045 ACU_Longitude 0;
BA_ "GenSigTimeoutValue" SG_ 1045 ACU_Longitude 0;
BA_ "Remark" SG_ 1045 ACU_Longitude "";
BA_ "EventCommandSignal" SG_ 1045 ACU_Latitude 0;
BA_ "GatewayedSignals" SG_ 1045 ACU_Latitude 0;
BA_ "GenSigInactiveValue" SG_ 1045 ACU_Latitude 0;
BA_ "GenSigInvalidValue" SG_ 1045 ACU_Latitude 0;
BA_ "GenSigSendType" SG_ 1045 ACU_Latitude 1;
BA_ "GenSigStartValue" SG_ 1045 ACU_Latitude 0;
BA_ "GenSigTimeoutValue" SG_ 1045 ACU_Latitude 0;
BA_ "Remark" SG_ 1045 ACU_Latitude "";
BA_ "EventCommandSignal" SG_ 363 EPS_1_CRC 0;
BA_ "GatewayedSignals" SG_ 363 EPS_1_CRC 0;
BA_ "GenSigInactiveValue" SG_ 363 EPS_1_CRC 0;
BA_ "GenSigInvalidValue" SG_ 363 EPS_1_CRC 0;
BA_ "GenSigSendType" SG_ 363 EPS_1_CRC 1;
BA_ "GenSigStartValue" SG_ 363 EPS_1_CRC 0;
BA_ "GenSigTimeoutValue" SG_ 363 EPS_1_CRC 0;
BA_ "Remark" SG_ 363 EPS_1_CRC "";
BA_ "EventCommandSignal" SG_ 363 EPS_1_Counter 0;
BA_ "GatewayedSignals" SG_ 363 EPS_1_Counter 0;
BA_ "GenSigInactiveValue" SG_ 363 EPS_1_Counter 0;
BA_ "GenSigInvalidValue" SG_ 363 EPS_1_Counter 0;
BA_ "GenSigSendType" SG_ 363 EPS_1_Counter 1;
BA_ "GenSigStartValue" SG_ 363 EPS_1_Counter 0;
BA_ "GenSigTimeoutValue" SG_ 363 EPS_1_Counter 0;
BA_ "Remark" SG_ 363 EPS_1_Counter "";
BA_ "EventCommandSignal" SG_ 363 EPS_StrngWhlTorqVD 0;
BA_ "GatewayedSignals" SG_ 363 EPS_StrngWhlTorqVD 0;
BA_ "GenSigInactiveValue" SG_ 363 EPS_StrngWhlTorqVD 0;
BA_ "GenSigInvalidValue" SG_ 363 EPS_StrngWhlTorqVD 0;
BA_ "GenSigSendType" SG_ 363 EPS_StrngWhlTorqVD 1;
BA_ "GenSigStartValue" SG_ 363 EPS_StrngWhlTorqVD 0;
BA_ "GenSigTimeoutValue" SG_ 363 EPS_StrngWhlTorqVD 0;
BA_ "Remark" SG_ 363 EPS_StrngWhlTorqVD "";
BA_ "EventCommandSignal" SG_ 363 EPS_StrngWhlTorq 0;
BA_ "GatewayedSignals" SG_ 363 EPS_StrngWhlTorq 0;
BA_ "GenSigInactiveValue" SG_ 363 EPS_StrngWhlTorq 0;
BA_ "GenSigInvalidValue" SG_ 363 EPS_StrngWhlTorq 4095;
BA_ "GenSigSendType" SG_ 363 EPS_StrngWhlTorq 1;
BA_ "GenSigStartValue" SG_ 363 EPS_StrngWhlTorq 1500;
BA_ "GenSigTimeoutValue" SG_ 363 EPS_StrngWhlTorq 4095;
BA_ "Remark" SG_ 363 EPS_StrngWhlTorq "";
BA_ "EventCommandSignal" SG_ 363 TAS_CalibratedSt 0;
BA_ "GatewayedSignals" SG_ 363 TAS_CalibratedSt 0;
BA_ "GenSigInactiveValue" SG_ 363 TAS_CalibratedSt 0;
BA_ "GenSigInvalidValue" SG_ 363 TAS_CalibratedSt 0;
BA_ "GenSigSendType" SG_ 363 TAS_CalibratedSt 1;
BA_ "GenSigStartValue" SG_ 363 TAS_CalibratedSt 0;
BA_ "GenSigTimeoutValue" SG_ 363 TAS_CalibratedSt 0;
BA_ "Remark" SG_ 363 TAS_CalibratedSt "";
BA_ "EventCommandSignal" SG_ 363 EPS_SteeringAngleSpdVD 0;
BA_ "GatewayedSignals" SG_ 363 EPS_SteeringAngleSpdVD 0;
BA_ "GenSigInactiveValue" SG_ 363 EPS_SteeringAngleSpdVD 0;
BA_ "GenSigInvalidValue" SG_ 363 EPS_SteeringAngleSpdVD 0;
BA_ "GenSigSendType" SG_ 363 EPS_SteeringAngleSpdVD 1;
BA_ "GenSigStartValue" SG_ 363 EPS_SteeringAngleSpdVD 0;
BA_ "GenSigTimeoutValue" SG_ 363 EPS_SteeringAngleSpdVD 0;
BA_ "Remark" SG_ 363 EPS_SteeringAngleSpdVD "";
BA_ "EventCommandSignal" SG_ 363 EPS_SteeringAngleSpd 0;
BA_ "GatewayedSignals" SG_ 363 EPS_SteeringAngleSpd 0;
BA_ "GenSigInactiveValue" SG_ 363 EPS_SteeringAngleSpd 0;
BA_ "GenSigInvalidValue" SG_ 363 EPS_SteeringAngleSpd 255;
BA_ "GenSigSendType" SG_ 363 EPS_SteeringAngleSpd 1;
BA_ "GenSigStartValue" SG_ 363 EPS_SteeringAngleSpd 0;
BA_ "GenSigTimeoutValue" SG_ 363 EPS_SteeringAngleSpd 255;
BA_ "Remark" SG_ 363 EPS_SteeringAngleSpd "";
BA_ "EventCommandSignal" SG_ 363 EPS_SteeringAngle 0;
BA_ "GatewayedSignals" SG_ 363 EPS_SteeringAngle 0;
BA_ "GenSigInactiveValue" SG_ 363 EPS_SteeringAngle 0;
BA_ "GenSigInvalidValue" SG_ 363 EPS_SteeringAngle 65535;
BA_ "GenSigSendType" SG_ 363 EPS_SteeringAngle 1;
BA_ "GenSigStartValue" SG_ 363 EPS_SteeringAngle 7800;
BA_ "GenSigTimeoutValue" SG_ 363 EPS_SteeringAngle 65535;
BA_ "Remark" SG_ 363 EPS_SteeringAngle "";
BA_ "EventCommandSignal" SG_ 363 EPS_SteeringAngleVD 0;
BA_ "GatewayedSignals" SG_ 363 EPS_SteeringAngleVD 0;
BA_ "GenSigInactiveValue" SG_ 363 EPS_SteeringAngleVD 0;
BA_ "GenSigInvalidValue" SG_ 363 EPS_SteeringAngleVD 0;
BA_ "GenSigSendType" SG_ 363 EPS_SteeringAngleVD 1;
BA_ "GenSigStartValue" SG_ 363 EPS_SteeringAngleVD 0;
BA_ "GenSigTimeoutValue" SG_ 363 EPS_SteeringAngleVD 0;
BA_ "Remark" SG_ 363 EPS_SteeringAngleVD "";
BA_ "EventCommandSignal" SG_ 363 EPS_ThermalSt 0;
BA_ "GatewayedSignals" SG_ 363 EPS_ThermalSt 0;
BA_ "GenSigInactiveValue" SG_ 363 EPS_ThermalSt 0;
BA_ "GenSigInvalidValue" SG_ 363 EPS_ThermalSt 0;
BA_ "GenSigSendType" SG_ 363 EPS_ThermalSt 1;
BA_ "GenSigStartValue" SG_ 363 EPS_ThermalSt 0;
BA_ "GenSigTimeoutValue" SG_ 363 EPS_ThermalSt 0;
BA_ "Remark" SG_ 363 EPS_ThermalSt "";
BA_ "EventCommandSignal" SG_ 363 EPS_VMCErrFeedback 0;
BA_ "GatewayedSignals" SG_ 363 EPS_VMCErrFeedback 0;
BA_ "GenSigInactiveValue" SG_ 363 EPS_VMCErrFeedback 0;
BA_ "GenSigInvalidValue" SG_ 363 EPS_VMCErrFeedback 0;
BA_ "GenSigSendType" SG_ 363 EPS_VMCErrFeedback 1;
BA_ "GenSigStartValue" SG_ 363 EPS_VMCErrFeedback 0;
BA_ "GenSigTimeoutValue" SG_ 363 EPS_VMCErrFeedback 0;
BA_ "Remark" SG_ 363 EPS_VMCErrFeedback "";
BA_ "EventCommandSignal" SG_ 363 EPS_PstOverlaySt 0;
BA_ "GatewayedSignals" SG_ 363 EPS_PstOverlaySt 0;
BA_ "GenSigInactiveValue" SG_ 363 EPS_PstOverlaySt 0;
BA_ "GenSigInvalidValue" SG_ 363 EPS_PstOverlaySt 0;
BA_ "GenSigSendType" SG_ 363 EPS_PstOverlaySt 1;
BA_ "GenSigStartValue" SG_ 363 EPS_PstOverlaySt 0;
BA_ "GenSigTimeoutValue" SG_ 363 EPS_PstOverlaySt 0;
BA_ "Remark" SG_ 363 EPS_PstOverlaySt "";
BA_ "EventCommandSignal" SG_ 363 EPS_HealthySt_DualSide 0;
BA_ "GatewayedSignals" SG_ 363 EPS_HealthySt_DualSide 0;
BA_ "GenSigInactiveValue" SG_ 363 EPS_HealthySt_DualSide 0;
BA_ "GenSigInvalidValue" SG_ 363 EPS_HealthySt_DualSide 0;
BA_ "GenSigSendType" SG_ 363 EPS_HealthySt_DualSide 1;
BA_ "GenSigStartValue" SG_ 363 EPS_HealthySt_DualSide 0;
BA_ "GenSigTimeoutValue" SG_ 363 EPS_HealthySt_DualSide 0;
BA_ "Remark" SG_ 363 EPS_HealthySt_DualSide "";
BA_ "EventCommandSignal" SG_ 363 EPS_VibrationWarnSt_A 0;
BA_ "GatewayedSignals" SG_ 363 EPS_VibrationWarnSt_A 0;
BA_ "GenSigInactiveValue" SG_ 363 EPS_VibrationWarnSt_A 0;
BA_ "GenSigInvalidValue" SG_ 363 EPS_VibrationWarnSt_A 0;
BA_ "GenSigSendType" SG_ 363 EPS_VibrationWarnSt_A 1;
BA_ "GenSigStartValue" SG_ 363 EPS_VibrationWarnSt_A 0;
BA_ "GenSigTimeoutValue" SG_ 363 EPS_VibrationWarnSt_A 0;
BA_ "Remark" SG_ 363 EPS_VibrationWarnSt_A "";
BA_ "EventCommandSignal" SG_ 363 SAC_ErrFeedback_SideA 0;
BA_ "GatewayedSignals" SG_ 363 SAC_ErrFeedback_SideA 0;
BA_ "GenSigInactiveValue" SG_ 363 SAC_ErrFeedback_SideA 0;
BA_ "GenSigInvalidValue" SG_ 363 SAC_ErrFeedback_SideA 0;
BA_ "GenSigSendType" SG_ 363 SAC_ErrFeedback_SideA 1;
BA_ "GenSigStartValue" SG_ 363 SAC_ErrFeedback_SideA 0;
BA_ "GenSigTimeoutValue" SG_ 363 SAC_ErrFeedback_SideA 0;
BA_ "Remark" SG_ 363 SAC_ErrFeedback_SideA "";
BA_ "EventCommandSignal" SG_ 363 EPS_ADASTargetAngle 0;
BA_ "GatewayedSignals" SG_ 363 EPS_ADASTargetAngle 0;
BA_ "GenSigInactiveValue" SG_ 363 EPS_ADASTargetAngle 0;
BA_ "GenSigInvalidValue" SG_ 363 EPS_ADASTargetAngle 0;
BA_ "GenSigSendType" SG_ 363 EPS_ADASTargetAngle 1;
BA_ "GenSigStartValue" SG_ 363 EPS_ADASTargetAngle 7800;
BA_ "GenSigTimeoutValue" SG_ 363 EPS_ADASTargetAngle 7800;
BA_ "Remark" SG_ 363 EPS_ADASTargetAngle "";
BA_ "EventCommandSignal" SG_ 363 EPS_FunctionStyleSt 0;
BA_ "GatewayedSignals" SG_ 363 EPS_FunctionStyleSt 0;
BA_ "GenSigInactiveValue" SG_ 363 EPS_FunctionStyleSt 0;
BA_ "GenSigInvalidValue" SG_ 363 EPS_FunctionStyleSt 0;
BA_ "GenSigSendType" SG_ 363 EPS_FunctionStyleSt 1;
BA_ "GenSigStartValue" SG_ 363 EPS_FunctionStyleSt 0;
BA_ "GenSigTimeoutValue" SG_ 363 EPS_FunctionStyleSt 0;
BA_ "Remark" SG_ 363 EPS_FunctionStyleSt "";
BA_ "EventCommandSignal" SG_ 363 EPS_SteeringModeSt 0;
BA_ "GatewayedSignals" SG_ 363 EPS_SteeringModeSt 0;
BA_ "GenSigInactiveValue" SG_ 363 EPS_SteeringModeSt 0;
BA_ "GenSigInvalidValue" SG_ 363 EPS_SteeringModeSt 0;
BA_ "GenSigSendType" SG_ 363 EPS_SteeringModeSt 1;
BA_ "GenSigStartValue" SG_ 363 EPS_SteeringModeSt 0;
BA_ "GenSigTimeoutValue" SG_ 363 EPS_SteeringModeSt 0;
BA_ "Remark" SG_ 363 EPS_SteeringModeSt "";
BA_ "EventCommandSignal" SG_ 363 EPS_ReqAngOverRange 0;
BA_ "GatewayedSignals" SG_ 363 EPS_ReqAngOverRange 0;
BA_ "GenSigInactiveValue" SG_ 363 EPS_ReqAngOverRange 0;
BA_ "GenSigInvalidValue" SG_ 363 EPS_ReqAngOverRange 0;
BA_ "GenSigSendType" SG_ 363 EPS_ReqAngOverRange 1;
BA_ "GenSigStartValue" SG_ 363 EPS_ReqAngOverRange 0;
BA_ "GenSigTimeoutValue" SG_ 363 EPS_ReqAngOverRange 0;
BA_ "Remark" SG_ 363 EPS_ReqAngOverRange "";
BA_ "EventCommandSignal" SG_ 363 EPS_SACMotorTorAct 0;
BA_ "GatewayedSignals" SG_ 363 EPS_SACMotorTorAct 0;
BA_ "GenSigInactiveValue" SG_ 363 EPS_SACMotorTorAct 0;
BA_ "GenSigInvalidValue" SG_ 363 EPS_SACMotorTorAct 0;
BA_ "GenSigSendType" SG_ 363 EPS_SACMotorTorAct 1;
BA_ "GenSigStartValue" SG_ 363 EPS_SACMotorTorAct 600;
BA_ "GenSigTimeoutValue" SG_ 363 EPS_SACMotorTorAct 600;
BA_ "Remark" SG_ 363 EPS_SACMotorTorAct "";
BA_ "EventCommandSignal" SG_ 363 EPS_SACMotorTorLimInt 0;
BA_ "GatewayedSignals" SG_ 363 EPS_SACMotorTorLimInt 0;
BA_ "GenSigInactiveValue" SG_ 363 EPS_SACMotorTorLimInt 0;
BA_ "GenSigInvalidValue" SG_ 363 EPS_SACMotorTorLimInt 2047;
BA_ "GenSigSendType" SG_ 363 EPS_SACMotorTorLimInt 1;
BA_ "GenSigStartValue" SG_ 363 EPS_SACMotorTorLimInt 0;
BA_ "GenSigTimeoutValue" SG_ 363 EPS_SACMotorTorLimInt 2047;
BA_ "Remark" SG_ 363 EPS_SACMotorTorLimInt "";
BA_ "EventCommandSignal" SG_ 363 EPS_ReqAngSpdOverRange 0;
BA_ "GatewayedSignals" SG_ 363 EPS_ReqAngSpdOverRange 0;
BA_ "GenSigInactiveValue" SG_ 363 EPS_ReqAngSpdOverRange 0;
BA_ "GenSigInvalidValue" SG_ 363 EPS_ReqAngSpdOverRange 0;
BA_ "GenSigSendType" SG_ 363 EPS_ReqAngSpdOverRange 1;
BA_ "GenSigStartValue" SG_ 363 EPS_ReqAngSpdOverRange 0;
BA_ "GenSigTimeoutValue" SG_ 363 EPS_ReqAngSpdOverRange 0;
BA_ "Remark" SG_ 363 EPS_ReqAngSpdOverRange "";
BA_ "EventCommandSignal" SG_ 363 EPS_AssistPraSwitchToLKA 0;
BA_ "GatewayedSignals" SG_ 363 EPS_AssistPraSwitchToLKA 0;
BA_ "GenSigInactiveValue" SG_ 363 EPS_AssistPraSwitchToLKA 0;
BA_ "GenSigInvalidValue" SG_ 363 EPS_AssistPraSwitchToLKA 0;
BA_ "GenSigSendType" SG_ 363 EPS_AssistPraSwitchToLKA 1;
BA_ "GenSigStartValue" SG_ 363 EPS_AssistPraSwitchToLKA 0;
BA_ "GenSigTimeoutValue" SG_ 363 EPS_AssistPraSwitchToLKA 0;
BA_ "Remark" SG_ 363 EPS_AssistPraSwitchToLKA "";
BA_ "EventCommandSignal" SG_ 363 EPS_SteerGainEnable 0;
BA_ "GatewayedSignals" SG_ 363 EPS_SteerGainEnable 0;
BA_ "GenSigInactiveValue" SG_ 363 EPS_SteerGainEnable 0;
BA_ "GenSigInvalidValue" SG_ 363 EPS_SteerGainEnable 0;
BA_ "GenSigSendType" SG_ 363 EPS_SteerGainEnable 1;
BA_ "GenSigStartValue" SG_ 363 EPS_SteerGainEnable 0;
BA_ "GenSigTimeoutValue" SG_ 363 EPS_SteerGainEnable 0;
BA_ "Remark" SG_ 363 EPS_SteerGainEnable "";
BA_ "EventCommandSignal" SG_ 363 EPS_EmSteerEnbale 0;
BA_ "GatewayedSignals" SG_ 363 EPS_EmSteerEnbale 0;
BA_ "GenSigInactiveValue" SG_ 363 EPS_EmSteerEnbale 0;
BA_ "GenSigInvalidValue" SG_ 363 EPS_EmSteerEnbale 0;
BA_ "GenSigSendType" SG_ 363 EPS_EmSteerEnbale 1;
BA_ "GenSigStartValue" SG_ 363 EPS_EmSteerEnbale 0;
BA_ "GenSigTimeoutValue" SG_ 363 EPS_EmSteerEnbale 0;
BA_ "Remark" SG_ 363 EPS_EmSteerEnbale "";
BA_ "EventCommandSignal" SG_ 363 EPS_EM_ErrFeedback 0;
BA_ "GatewayedSignals" SG_ 363 EPS_EM_ErrFeedback 0;
BA_ "GenSigInactiveValue" SG_ 363 EPS_EM_ErrFeedback 0;
BA_ "GenSigInvalidValue" SG_ 363 EPS_EM_ErrFeedback 0;
BA_ "GenSigSendType" SG_ 363 EPS_EM_ErrFeedback 1;
BA_ "GenSigStartValue" SG_ 363 EPS_EM_ErrFeedback 0;
BA_ "GenSigTimeoutValue" SG_ 363 EPS_EM_ErrFeedback 0;
BA_ "Remark" SG_ 363 EPS_EM_ErrFeedback "";
BA_ "EventCommandSignal" SG_ 363 EPS_VW_ErrFeedback 0;
BA_ "GatewayedSignals" SG_ 363 EPS_VW_ErrFeedback 0;
BA_ "GenSigInactiveValue" SG_ 363 EPS_VW_ErrFeedback 0;
BA_ "GenSigInvalidValue" SG_ 363 EPS_VW_ErrFeedback 0;
BA_ "GenSigSendType" SG_ 363 EPS_VW_ErrFeedback 1;
BA_ "GenSigStartValue" SG_ 363 EPS_VW_ErrFeedback 0;
BA_ "GenSigTimeoutValue" SG_ 363 EPS_VW_ErrFeedback 0;
BA_ "Remark" SG_ 363 EPS_VW_ErrFeedback "";
BA_ "EventCommandSignal" SG_ 363 EPS_SG_ErrFeedback 0;
BA_ "GatewayedSignals" SG_ 363 EPS_SG_ErrFeedback 0;
BA_ "GenSigInactiveValue" SG_ 363 EPS_SG_ErrFeedback 0;
BA_ "GenSigInvalidValue" SG_ 363 EPS_SG_ErrFeedback 0;
BA_ "GenSigSendType" SG_ 363 EPS_SG_ErrFeedback 1;
BA_ "GenSigStartValue" SG_ 363 EPS_SG_ErrFeedback 0;
BA_ "GenSigTimeoutValue" SG_ 363 EPS_SG_ErrFeedback 0;
BA_ "Remark" SG_ 363 EPS_SG_ErrFeedback "";
BA_ "EventCommandSignal" SG_ 363 EPS_SACMotorTorActMot 0;
BA_ "GatewayedSignals" SG_ 363 EPS_SACMotorTorActMot 0;
BA_ "GenSigInactiveValue" SG_ 363 EPS_SACMotorTorActMot 0;
BA_ "GenSigInvalidValue" SG_ 363 EPS_SACMotorTorActMot 0;
BA_ "GenSigSendType" SG_ 363 EPS_SACMotorTorActMot 1;
BA_ "GenSigStartValue" SG_ 363 EPS_SACMotorTorActMot 600;
BA_ "GenSigTimeoutValue" SG_ 363 EPS_SACMotorTorActMot 600;
BA_ "Remark" SG_ 363 EPS_SACMotorTorActMot "";
BA_ "EventCommandSignal" SG_ 363 EPS_SACMotorTorLimIntMot 0;
BA_ "GatewayedSignals" SG_ 363 EPS_SACMotorTorLimIntMot 0;
BA_ "GenSigInactiveValue" SG_ 363 EPS_SACMotorTorLimIntMot 0;
BA_ "GenSigInvalidValue" SG_ 363 EPS_SACMotorTorLimIntMot 2047;
BA_ "GenSigSendType" SG_ 363 EPS_SACMotorTorLimIntMot 1;
BA_ "GenSigStartValue" SG_ 363 EPS_SACMotorTorLimIntMot 0;
BA_ "GenSigTimeoutValue" SG_ 363 EPS_SACMotorTorLimIntMot 2047;
BA_ "Remark" SG_ 363 EPS_SACMotorTorLimIntMot "";
BA_ "EventCommandSignal" SG_ 363 EPS_SG_ActualLevel 0;
BA_ "GatewayedSignals" SG_ 363 EPS_SG_ActualLevel 0;
BA_ "GenSigInactiveValue" SG_ 363 EPS_SG_ActualLevel 0;
BA_ "GenSigInvalidValue" SG_ 363 EPS_SG_ActualLevel 255;
BA_ "GenSigSendType" SG_ 363 EPS_SG_ActualLevel 1;
BA_ "GenSigStartValue" SG_ 363 EPS_SG_ActualLevel 100;
BA_ "GenSigTimeoutValue" SG_ 363 EPS_SG_ActualLevel 0;
BA_ "Remark" SG_ 363 EPS_SG_ActualLevel "";
BA_ "EventCommandSignal" SG_ 363 EPS_MotorTorSum 0;
BA_ "GatewayedSignals" SG_ 363 EPS_MotorTorSum 0;
BA_ "GenSigInactiveValue" SG_ 363 EPS_MotorTorSum 0;
BA_ "GenSigInvalidValue" SG_ 363 EPS_MotorTorSum 0;
BA_ "GenSigSendType" SG_ 363 EPS_MotorTorSum 1;
BA_ "GenSigStartValue" SG_ 363 EPS_MotorTorSum 600;
BA_ "GenSigTimeoutValue" SG_ 363 EPS_MotorTorSum 600;
BA_ "Remark" SG_ 363 EPS_MotorTorSum "";
BA_ "EventCommandSignal" SG_ 363 EPS_WarnLamp 0;
BA_ "GatewayedSignals" SG_ 363 EPS_WarnLamp 0;
BA_ "GenSigInactiveValue" SG_ 363 EPS_WarnLamp 0;
BA_ "GenSigInvalidValue" SG_ 363 EPS_WarnLamp 0;
BA_ "GenSigSendType" SG_ 363 EPS_WarnLamp 1;
BA_ "GenSigStartValue" SG_ 363 EPS_WarnLamp 0;
BA_ "GenSigTimeoutValue" SG_ 363 EPS_WarnLamp 2;
BA_ "Remark" SG_ 363 EPS_WarnLamp "";
BA_ "EventCommandSignal" SG_ 363 EPS_AssistRatio 0;
BA_ "GatewayedSignals" SG_ 363 EPS_AssistRatio 0;
BA_ "GenSigInactiveValue" SG_ 363 EPS_AssistRatio 0;
BA_ "GenSigInvalidValue" SG_ 363 EPS_AssistRatio 50;
BA_ "GenSigSendType" SG_ 363 EPS_AssistRatio 1;
BA_ "GenSigStartValue" SG_ 363 EPS_AssistRatio 50;
BA_ "GenSigTimeoutValue" SG_ 363 EPS_AssistRatio 0;
BA_ "Remark" SG_ 363 EPS_AssistRatio "";
BA_ "EventCommandSignal" SG_ 363 EPS_SteeringWhlTorFlt 0;
BA_ "GatewayedSignals" SG_ 363 EPS_SteeringWhlTorFlt 0;
BA_ "GenSigInactiveValue" SG_ 363 EPS_SteeringWhlTorFlt 0;
BA_ "GenSigInvalidValue" SG_ 363 EPS_SteeringWhlTorFlt 4095;
BA_ "GenSigSendType" SG_ 363 EPS_SteeringWhlTorFlt 1;
BA_ "GenSigStartValue" SG_ 363 EPS_SteeringWhlTorFlt 1500;
BA_ "GenSigTimeoutValue" SG_ 363 EPS_SteeringWhlTorFlt 4095;
BA_ "Remark" SG_ 363 EPS_SteeringWhlTorFlt "";
BA_ "EventCommandSignal" SG_ 363 EPS_SteeringWhlTorFltVD 0;
BA_ "GatewayedSignals" SG_ 363 EPS_SteeringWhlTorFltVD 0;
BA_ "GenSigInactiveValue" SG_ 363 EPS_SteeringWhlTorFltVD 0;
BA_ "GenSigInvalidValue" SG_ 363 EPS_SteeringWhlTorFltVD 0;
BA_ "GenSigSendType" SG_ 363 EPS_SteeringWhlTorFltVD 1;
BA_ "GenSigStartValue" SG_ 363 EPS_SteeringWhlTorFltVD 0;
BA_ "GenSigTimeoutValue" SG_ 363 EPS_SteeringWhlTorFltVD 0;
BA_ "Remark" SG_ 363 EPS_SteeringWhlTorFltVD "";
BA_ "EventCommandSignal" SG_ 363 EPS_SteeringAngleRate 0;
BA_ "GatewayedSignals" SG_ 363 EPS_SteeringAngleRate 0;
BA_ "GenSigInactiveValue" SG_ 363 EPS_SteeringAngleRate 0;
BA_ "GenSigInvalidValue" SG_ 363 EPS_SteeringAngleRate 0;
BA_ "GenSigSendType" SG_ 363 EPS_SteeringAngleRate 1;
BA_ "GenSigStartValue" SG_ 363 EPS_SteeringAngleRate 0;
BA_ "GenSigTimeoutValue" SG_ 363 EPS_SteeringAngleRate 0;
BA_ "Remark" SG_ 363 EPS_SteeringAngleRate "";
BA_ "EventCommandSignal" SG_ 363 EPS_TqCtrlSt 0;
BA_ "GatewayedSignals" SG_ 363 EPS_TqCtrlSt 0;
BA_ "GenSigInactiveValue" SG_ 363 EPS_TqCtrlSt 0;
BA_ "GenSigInvalidValue" SG_ 363 EPS_TqCtrlSt 0;
BA_ "GenSigSendType" SG_ 363 EPS_TqCtrlSt 1;
BA_ "GenSigStartValue" SG_ 363 EPS_TqCtrlSt 0;
BA_ "GenSigTimeoutValue" SG_ 363 EPS_TqCtrlSt 0;
BA_ "Remark" SG_ 363 EPS_TqCtrlSt "";
BA_ "EventCommandSignal" SG_ 363 EPS_MotorTorForDrv 0;
BA_ "GatewayedSignals" SG_ 363 EPS_MotorTorForDrv 0;
BA_ "GenSigInactiveValue" SG_ 363 EPS_MotorTorForDrv 0;
BA_ "GenSigInvalidValue" SG_ 363 EPS_MotorTorForDrv 4095;
BA_ "GenSigSendType" SG_ 363 EPS_MotorTorForDrv 1;
BA_ "GenSigStartValue" SG_ 363 EPS_MotorTorForDrv 2000;
BA_ "GenSigTimeoutValue" SG_ 363 EPS_MotorTorForDrv 4095;
BA_ "Remark" SG_ 363 EPS_MotorTorForDrv "";
BA_ "EventCommandSignal" SG_ 363 EPS_TqCtrlAvl 0;
BA_ "GatewayedSignals" SG_ 363 EPS_TqCtrlAvl 0;
BA_ "GenSigInactiveValue" SG_ 363 EPS_TqCtrlAvl 0;
BA_ "GenSigInvalidValue" SG_ 363 EPS_TqCtrlAvl 0;
BA_ "GenSigSendType" SG_ 363 EPS_TqCtrlAvl 1;
BA_ "GenSigStartValue" SG_ 363 EPS_TqCtrlAvl 0;
BA_ "GenSigTimeoutValue" SG_ 363 EPS_TqCtrlAvl 0;
BA_ "Remark" SG_ 363 EPS_TqCtrlAvl "";
BA_ "EventCommandSignal" SG_ 363 EPS_AgCtrlAvl 0;
BA_ "GatewayedSignals" SG_ 363 EPS_AgCtrlAvl 0;
BA_ "GenSigInactiveValue" SG_ 363 EPS_AgCtrlAvl 0;
BA_ "GenSigInvalidValue" SG_ 363 EPS_AgCtrlAvl 0;
BA_ "GenSigSendType" SG_ 363 EPS_AgCtrlAvl 1;
BA_ "GenSigStartValue" SG_ 363 EPS_AgCtrlAvl 0;
BA_ "GenSigTimeoutValue" SG_ 363 EPS_AgCtrlAvl 0;
BA_ "Remark" SG_ 363 EPS_AgCtrlAvl "";
BA_ "EventCommandSignal" SG_ 363 EPS_MotorTorSumVD 0;
BA_ "GatewayedSignals" SG_ 363 EPS_MotorTorSumVD 0;
BA_ "GenSigInactiveValue" SG_ 363 EPS_MotorTorSumVD 0;
BA_ "GenSigInvalidValue" SG_ 363 EPS_MotorTorSumVD 0;
BA_ "GenSigSendType" SG_ 363 EPS_MotorTorSumVD 1;
BA_ "GenSigStartValue" SG_ 363 EPS_MotorTorSumVD 0;
BA_ "GenSigTimeoutValue" SG_ 363 EPS_MotorTorSumVD 0;
BA_ "Remark" SG_ 363 EPS_MotorTorSumVD "";
BA_ "EventCommandSignal" SG_ 363 EPS_DrvOveRideSt 0;
BA_ "GatewayedSignals" SG_ 363 EPS_DrvOveRideSt 0;
BA_ "GenSigInactiveValue" SG_ 363 EPS_DrvOveRideSt 0;
BA_ "GenSigInvalidValue" SG_ 363 EPS_DrvOveRideSt 0;
BA_ "GenSigSendType" SG_ 363 EPS_DrvOveRideSt 1;
BA_ "GenSigStartValue" SG_ 363 EPS_DrvOveRideSt 0;
BA_ "GenSigTimeoutValue" SG_ 363 EPS_DrvOveRideSt 0;
BA_ "Remark" SG_ 363 EPS_DrvOveRideSt "";
BA_ "EventCommandSignal" SG_ 363 EPS_DrvOveRideVD 0;
BA_ "GatewayedSignals" SG_ 363 EPS_DrvOveRideVD 0;
BA_ "GenSigInactiveValue" SG_ 363 EPS_DrvOveRideVD 0;
BA_ "GenSigInvalidValue" SG_ 363 EPS_DrvOveRideVD 0;
BA_ "GenSigSendType" SG_ 363 EPS_DrvOveRideVD 1;
BA_ "GenSigStartValue" SG_ 363 EPS_DrvOveRideVD 0;
BA_ "GenSigTimeoutValue" SG_ 363 EPS_DrvOveRideVD 0;
BA_ "Remark" SG_ 363 EPS_DrvOveRideVD "";
BA_ "EventCommandSignal" SG_ 363 EPS_SteerVibrlAvl 0;
BA_ "GatewayedSignals" SG_ 363 EPS_SteerVibrlAvl 0;
BA_ "GenSigInactiveValue" SG_ 363 EPS_SteerVibrlAvl 0;
BA_ "GenSigInvalidValue" SG_ 363 EPS_SteerVibrlAvl 0;
BA_ "GenSigSendType" SG_ 363 EPS_SteerVibrlAvl 1;
BA_ "GenSigStartValue" SG_ 363 EPS_SteerVibrlAvl 0;
BA_ "GenSigTimeoutValue" SG_ 363 EPS_SteerVibrlAvl 0;
BA_ "Remark" SG_ 363 EPS_SteerVibrlAvl "";
BA_ "EventCommandSignal" SG_ 363 EPS_HandsOffDetStVD 0;
BA_ "GatewayedSignals" SG_ 363 EPS_HandsOffDetStVD 0;
BA_ "GenSigInactiveValue" SG_ 363 EPS_HandsOffDetStVD 0;
BA_ "GenSigInvalidValue" SG_ 363 EPS_HandsOffDetStVD 0;
BA_ "GenSigSendType" SG_ 363 EPS_HandsOffDetStVD 1;
BA_ "GenSigStartValue" SG_ 363 EPS_HandsOffDetStVD 0;
BA_ "GenSigTimeoutValue" SG_ 363 EPS_HandsOffDetStVD 0;
BA_ "Remark" SG_ 363 EPS_HandsOffDetStVD "";
BA_ "EventCommandSignal" SG_ 363 EPS_HandsOffDetSt 0;
BA_ "GatewayedSignals" SG_ 363 EPS_HandsOffDetSt 0;
BA_ "GenSigInactiveValue" SG_ 363 EPS_HandsOffDetSt 0;
BA_ "GenSigInvalidValue" SG_ 363 EPS_HandsOffDetSt 0;
BA_ "GenSigSendType" SG_ 363 EPS_HandsOffDetSt 1;
BA_ "GenSigStartValue" SG_ 363 EPS_HandsOffDetSt 0;
BA_ "GenSigTimeoutValue" SG_ 363 EPS_HandsOffDetSt 0;
BA_ "Remark" SG_ 363 EPS_HandsOffDetSt "";
BA_ "EventCommandSignal" SG_ 363 EPS_SteerMod 0;
BA_ "GatewayedSignals" SG_ 363 EPS_SteerMod 0;
BA_ "GenSigInactiveValue" SG_ 363 EPS_SteerMod 0;
BA_ "GenSigInvalidValue" SG_ 363 EPS_SteerMod 0;
BA_ "GenSigSendType" SG_ 363 EPS_SteerMod 1;
BA_ "GenSigStartValue" SG_ 363 EPS_SteerMod 0;
BA_ "GenSigTimeoutValue" SG_ 363 EPS_SteerMod 0;
BA_ "Remark" SG_ 363 EPS_SteerMod "";
BA_ "EventCommandSignal" SG_ 363 EPS_ADCNetErrorFb 0;
BA_ "GatewayedSignals" SG_ 363 EPS_ADCNetErrorFb 0;
BA_ "GenSigInactiveValue" SG_ 363 EPS_ADCNetErrorFb 0;
BA_ "GenSigInvalidValue" SG_ 363 EPS_ADCNetErrorFb 0;
BA_ "GenSigSendType" SG_ 363 EPS_ADCNetErrorFb 1;
BA_ "GenSigStartValue" SG_ 363 EPS_ADCNetErrorFb 0;
BA_ "GenSigTimeoutValue" SG_ 363 EPS_ADCNetErrorFb 0;
BA_ "Remark" SG_ 363 EPS_ADCNetErrorFb "";
BA_ "EventCommandSignal" SG_ 363 EPS_NetModeResp 0;
BA_ "GatewayedSignals" SG_ 363 EPS_NetModeResp 0;
BA_ "GenSigInactiveValue" SG_ 363 EPS_NetModeResp 0;
BA_ "GenSigInvalidValue" SG_ 363 EPS_NetModeResp 0;
BA_ "GenSigSendType" SG_ 363 EPS_NetModeResp 1;
BA_ "GenSigStartValue" SG_ 363 EPS_NetModeResp 0;
BA_ "GenSigTimeoutValue" SG_ 363 EPS_NetModeResp 0;
BA_ "Remark" SG_ 363 EPS_NetModeResp "";
BA_ "EventCommandSignal" SG_ 433 CCU_GVS_3_CRC 0;
BA_ "GatewayedSignals" SG_ 433 CCU_GVS_3_CRC 0;
BA_ "GenSigInactiveValue" SG_ 433 CCU_GVS_3_CRC 0;
BA_ "GenSigInvalidValue" SG_ 433 CCU_GVS_3_CRC 0;
BA_ "GenSigSendType" SG_ 433 CCU_GVS_3_CRC 1;
BA_ "GenSigStartValue" SG_ 433 CCU_GVS_3_CRC 0;
BA_ "GenSigTimeoutValue" SG_ 433 CCU_GVS_3_CRC 0;
BA_ "Remark" SG_ 433 CCU_GVS_3_CRC "";
BA_ "EventCommandSignal" SG_ 433 CCU_GVS_3_Counter 0;
BA_ "GatewayedSignals" SG_ 433 CCU_GVS_3_Counter 0;
BA_ "GenSigInactiveValue" SG_ 433 CCU_GVS_3_Counter 0;
BA_ "GenSigInvalidValue" SG_ 433 CCU_GVS_3_Counter 0;
BA_ "GenSigSendType" SG_ 433 CCU_GVS_3_Counter 1;
BA_ "GenSigStartValue" SG_ 433 CCU_GVS_3_Counter 0;
BA_ "GenSigTimeoutValue" SG_ 433 CCU_GVS_3_Counter 0;
BA_ "Remark" SG_ 433 CCU_GVS_3_Counter "";
BA_ "EventCommandSignal" SG_ 433 VCU_VehActDrvTorqRR 0;
BA_ "GatewayedSignals" SG_ 433 VCU_VehActDrvTorqRR 0;
BA_ "GenSigInactiveValue" SG_ 433 VCU_VehActDrvTorqRR 0;
BA_ "GenSigInvalidValue" SG_ 433 VCU_VehActDrvTorqRR 0;
BA_ "GenSigSendType" SG_ 433 VCU_VehActDrvTorqRR 1;
BA_ "GenSigStartValue" SG_ 433 VCU_VehActDrvTorqRR 0;
BA_ "GenSigTimeoutValue" SG_ 433 VCU_VehActDrvTorqRR 0;
BA_ "Remark" SG_ 433 VCU_VehActDrvTorqRR "";
BA_ "EventCommandSignal" SG_ 433 VCU_MotorRgnCaplTqWhl 0;
BA_ "GatewayedSignals" SG_ 433 VCU_MotorRgnCaplTqWhl 0;
BA_ "GenSigInactiveValue" SG_ 433 VCU_MotorRgnCaplTqWhl 0;
BA_ "GenSigInvalidValue" SG_ 433 VCU_MotorRgnCaplTqWhl 0;
BA_ "GenSigSendType" SG_ 433 VCU_MotorRgnCaplTqWhl 1;
BA_ "GenSigStartValue" SG_ 433 VCU_MotorRgnCaplTqWhl 8191;
BA_ "GenSigTimeoutValue" SG_ 433 VCU_MotorRgnCaplTqWhl 0;
BA_ "Remark" SG_ 433 VCU_MotorRgnCaplTqWhl "";
BA_ "EventCommandSignal" SG_ 433 VCU_VehWhlReqTqFAVD 0;
BA_ "GatewayedSignals" SG_ 433 VCU_VehWhlReqTqFAVD 0;
BA_ "GenSigInactiveValue" SG_ 433 VCU_VehWhlReqTqFAVD 0;
BA_ "GenSigInvalidValue" SG_ 433 VCU_VehWhlReqTqFAVD 0;
BA_ "GenSigSendType" SG_ 433 VCU_VehWhlReqTqFAVD 1;
BA_ "GenSigStartValue" SG_ 433 VCU_VehWhlReqTqFAVD 0;
BA_ "GenSigTimeoutValue" SG_ 433 VCU_VehWhlReqTqFAVD 0;
BA_ "Remark" SG_ 433 VCU_VehWhlReqTqFAVD "";
BA_ "EventCommandSignal" SG_ 433 VCU_VehWhlReqTqRRVD 0;
BA_ "GatewayedSignals" SG_ 433 VCU_VehWhlReqTqRRVD 0;
BA_ "GenSigInactiveValue" SG_ 433 VCU_VehWhlReqTqRRVD 0;
BA_ "GenSigInvalidValue" SG_ 433 VCU_VehWhlReqTqRRVD 0;
BA_ "GenSigSendType" SG_ 433 VCU_VehWhlReqTqRRVD 1;
BA_ "GenSigStartValue" SG_ 433 VCU_VehWhlReqTqRRVD 0;
BA_ "GenSigTimeoutValue" SG_ 433 VCU_VehWhlReqTqRRVD 0;
BA_ "Remark" SG_ 433 VCU_VehWhlReqTqRRVD "";
BA_ "EventCommandSignal" SG_ 433 VCU_VehActDrvTorqRRVD 0;
BA_ "GatewayedSignals" SG_ 433 VCU_VehActDrvTorqRRVD 0;
BA_ "GenSigInactiveValue" SG_ 433 VCU_VehActDrvTorqRRVD 0;
BA_ "GenSigInvalidValue" SG_ 433 VCU_VehActDrvTorqRRVD 0;
BA_ "GenSigSendType" SG_ 433 VCU_VehActDrvTorqRRVD 1;
BA_ "GenSigStartValue" SG_ 433 VCU_VehActDrvTorqRRVD 0;
BA_ "GenSigTimeoutValue" SG_ 433 VCU_VehActDrvTorqRRVD 0;
BA_ "Remark" SG_ 433 VCU_VehActDrvTorqRRVD "";
BA_ "EventCommandSignal" SG_ 433 VCU_PreStableFlg 0;
BA_ "GatewayedSignals" SG_ 433 VCU_PreStableFlg 0;
BA_ "GenSigInactiveValue" SG_ 433 VCU_PreStableFlg 0;
BA_ "GenSigInvalidValue" SG_ 433 VCU_PreStableFlg 0;
BA_ "GenSigSendType" SG_ 433 VCU_PreStableFlg 1;
BA_ "GenSigStartValue" SG_ 433 VCU_PreStableFlg 0;
BA_ "GenSigTimeoutValue" SG_ 433 VCU_PreStableFlg 0;
BA_ "Remark" SG_ 433 VCU_PreStableFlg "";
BA_ "EventCommandSignal" SG_ 433 VCU_VehWhlReqTqRLVD 0;
BA_ "GatewayedSignals" SG_ 433 VCU_VehWhlReqTqRLVD 0;
BA_ "GenSigInactiveValue" SG_ 433 VCU_VehWhlReqTqRLVD 0;
BA_ "GenSigInvalidValue" SG_ 433 VCU_VehWhlReqTqRLVD 0;
BA_ "GenSigSendType" SG_ 433 VCU_VehWhlReqTqRLVD 1;
BA_ "GenSigStartValue" SG_ 433 VCU_VehWhlReqTqRLVD 0;
BA_ "GenSigTimeoutValue" SG_ 433 VCU_VehWhlReqTqRLVD 0;
BA_ "Remark" SG_ 433 VCU_VehWhlReqTqRLVD "";
BA_ "EventCommandSignal" SG_ 433 VCU_AccPedalActPstVD 0;
BA_ "GatewayedSignals" SG_ 433 VCU_AccPedalActPstVD 0;
BA_ "GenSigInactiveValue" SG_ 433 VCU_AccPedalActPstVD 0;
BA_ "GenSigInvalidValue" SG_ 433 VCU_AccPedalActPstVD 0;
BA_ "GenSigSendType" SG_ 433 VCU_AccPedalActPstVD 1;
BA_ "GenSigStartValue" SG_ 433 VCU_AccPedalActPstVD 0;
BA_ "GenSigTimeoutValue" SG_ 433 VCU_AccPedalActPstVD 0;
BA_ "Remark" SG_ 433 VCU_AccPedalActPstVD "";
BA_ "EventCommandSignal" SG_ 433 VCU_AccPedalActPst 0;
BA_ "GatewayedSignals" SG_ 433 VCU_AccPedalActPst 0;
BA_ "GenSigInactiveValue" SG_ 433 VCU_AccPedalActPst 0;
BA_ "GenSigInvalidValue" SG_ 433 VCU_AccPedalActPst 0;
BA_ "GenSigSendType" SG_ 433 VCU_AccPedalActPst 1;
BA_ "GenSigStartValue" SG_ 433 VCU_AccPedalActPst 0;
BA_ "GenSigTimeoutValue" SG_ 433 VCU_AccPedalActPst 0;
BA_ "Remark" SG_ 433 VCU_AccPedalActPst "";
BA_ "EventCommandSignal" SG_ 433 VCU_VehWhlReqTqFA 0;
BA_ "GatewayedSignals" SG_ 433 VCU_VehWhlReqTqFA 0;
BA_ "GenSigInactiveValue" SG_ 433 VCU_VehWhlReqTqFA 0;
BA_ "GenSigInvalidValue" SG_ 433 VCU_VehWhlReqTqFA 0;
BA_ "GenSigSendType" SG_ 433 VCU_VehWhlReqTqFA 1;
BA_ "GenSigStartValue" SG_ 433 VCU_VehWhlReqTqFA 0;
BA_ "GenSigTimeoutValue" SG_ 433 VCU_VehWhlReqTqFA 0;
BA_ "Remark" SG_ 433 VCU_VehWhlReqTqFA "";
BA_ "EventCommandSignal" SG_ 433 VCU_VehWhlReqTqRR 0;
BA_ "GatewayedSignals" SG_ 433 VCU_VehWhlReqTqRR 0;
BA_ "GenSigInactiveValue" SG_ 433 VCU_VehWhlReqTqRR 0;
BA_ "GenSigInvalidValue" SG_ 433 VCU_VehWhlReqTqRR 0;
BA_ "GenSigSendType" SG_ 433 VCU_VehWhlReqTqRR 1;
BA_ "GenSigStartValue" SG_ 433 VCU_VehWhlReqTqRR 0;
BA_ "GenSigTimeoutValue" SG_ 433 VCU_VehWhlReqTqRR 0;
BA_ "Remark" SG_ 433 VCU_VehWhlReqTqRR "";
BA_ "EventCommandSignal" SG_ 433 VCU_VehWhlReqTqRL 0;
BA_ "GatewayedSignals" SG_ 433 VCU_VehWhlReqTqRL 0;
BA_ "GenSigInactiveValue" SG_ 433 VCU_VehWhlReqTqRL 0;
BA_ "GenSigInvalidValue" SG_ 433 VCU_VehWhlReqTqRL 0;
BA_ "GenSigSendType" SG_ 433 VCU_VehWhlReqTqRL 1;
BA_ "GenSigStartValue" SG_ 433 VCU_VehWhlReqTqRL 0;
BA_ "GenSigTimeoutValue" SG_ 433 VCU_VehWhlReqTqRL 0;
BA_ "Remark" SG_ 433 VCU_VehWhlReqTqRL "";
BA_ "EventCommandSignal" SG_ 433 VCU_MotorDrvCaplTqWhlFA 0;
BA_ "GatewayedSignals" SG_ 433 VCU_MotorDrvCaplTqWhlFA 0;
BA_ "GenSigInactiveValue" SG_ 433 VCU_MotorDrvCaplTqWhlFA 0;
BA_ "GenSigInvalidValue" SG_ 433 VCU_MotorDrvCaplTqWhlFA 0;
BA_ "GenSigSendType" SG_ 433 VCU_MotorDrvCaplTqWhlFA 1;
BA_ "GenSigStartValue" SG_ 433 VCU_MotorDrvCaplTqWhlFA 0;
BA_ "GenSigTimeoutValue" SG_ 433 VCU_MotorDrvCaplTqWhlFA 65535;
BA_ "Remark" SG_ 433 VCU_MotorDrvCaplTqWhlFA "";
BA_ "EventCommandSignal" SG_ 433 VCU_MotorRgnCaplTqWhlFA 0;
BA_ "GatewayedSignals" SG_ 433 VCU_MotorRgnCaplTqWhlFA 0;
BA_ "GenSigInactiveValue" SG_ 433 VCU_MotorRgnCaplTqWhlFA 0;
BA_ "GenSigInvalidValue" SG_ 433 VCU_MotorRgnCaplTqWhlFA 0;
BA_ "GenSigSendType" SG_ 433 VCU_MotorRgnCaplTqWhlFA 1;
BA_ "GenSigStartValue" SG_ 433 VCU_MotorRgnCaplTqWhlFA 0;
BA_ "GenSigTimeoutValue" SG_ 433 VCU_MotorRgnCaplTqWhlFA 65535;
BA_ "Remark" SG_ 433 VCU_MotorRgnCaplTqWhlFA "";
BA_ "EventCommandSignal" SG_ 433 VCU_MotorDrvCaplTqWhlRL 0;
BA_ "GatewayedSignals" SG_ 433 VCU_MotorDrvCaplTqWhlRL 0;
BA_ "GenSigInactiveValue" SG_ 433 VCU_MotorDrvCaplTqWhlRL 0;
BA_ "GenSigInvalidValue" SG_ 433 VCU_MotorDrvCaplTqWhlRL 0;
BA_ "GenSigSendType" SG_ 433 VCU_MotorDrvCaplTqWhlRL 1;
BA_ "GenSigStartValue" SG_ 433 VCU_MotorDrvCaplTqWhlRL 0;
BA_ "GenSigTimeoutValue" SG_ 433 VCU_MotorDrvCaplTqWhlRL 65535;
BA_ "Remark" SG_ 433 VCU_MotorDrvCaplTqWhlRL "";
BA_ "EventCommandSignal" SG_ 433 VCU_MotorRgnCaplTqWhlRL 0;
BA_ "GatewayedSignals" SG_ 433 VCU_MotorRgnCaplTqWhlRL 0;
BA_ "GenSigInactiveValue" SG_ 433 VCU_MotorRgnCaplTqWhlRL 0;
BA_ "GenSigInvalidValue" SG_ 433 VCU_MotorRgnCaplTqWhlRL 0;
BA_ "GenSigSendType" SG_ 433 VCU_MotorRgnCaplTqWhlRL 1;
BA_ "GenSigStartValue" SG_ 433 VCU_MotorRgnCaplTqWhlRL 0;
BA_ "GenSigTimeoutValue" SG_ 433 VCU_MotorRgnCaplTqWhlRL 65535;
BA_ "Remark" SG_ 433 VCU_MotorRgnCaplTqWhlRL "";
BA_ "EventCommandSignal" SG_ 433 VCU_MotorDrvCaplTqWhlRR 0;
BA_ "GatewayedSignals" SG_ 433 VCU_MotorDrvCaplTqWhlRR 0;
BA_ "GenSigInactiveValue" SG_ 433 VCU_MotorDrvCaplTqWhlRR 0;
BA_ "GenSigInvalidValue" SG_ 433 VCU_MotorDrvCaplTqWhlRR 0;
BA_ "GenSigSendType" SG_ 433 VCU_MotorDrvCaplTqWhlRR 1;
BA_ "GenSigStartValue" SG_ 433 VCU_MotorDrvCaplTqWhlRR 0;
BA_ "GenSigTimeoutValue" SG_ 433 VCU_MotorDrvCaplTqWhlRR 65535;
BA_ "Remark" SG_ 433 VCU_MotorDrvCaplTqWhlRR "";
BA_ "EventCommandSignal" SG_ 433 VCU_GearShiftAvl 0;
BA_ "GatewayedSignals" SG_ 433 VCU_GearShiftAvl 0;
BA_ "GenSigInactiveValue" SG_ 433 VCU_GearShiftAvl 0;
BA_ "GenSigInvalidValue" SG_ 433 VCU_GearShiftAvl 0;
BA_ "GenSigSendType" SG_ 433 VCU_GearShiftAvl 1;
BA_ "GenSigStartValue" SG_ 433 VCU_GearShiftAvl 0;
BA_ "GenSigTimeoutValue" SG_ 433 VCU_GearShiftAvl 0;
BA_ "Remark" SG_ 433 VCU_GearShiftAvl "";
BA_ "EventCommandSignal" SG_ 433 VCU_MotorRgnCaplTqWhlVD 0;
BA_ "GatewayedSignals" SG_ 433 VCU_MotorRgnCaplTqWhlVD 0;
BA_ "GenSigInactiveValue" SG_ 433 VCU_MotorRgnCaplTqWhlVD 0;
BA_ "GenSigInvalidValue" SG_ 433 VCU_MotorRgnCaplTqWhlVD 0;
BA_ "GenSigSendType" SG_ 433 VCU_MotorRgnCaplTqWhlVD 1;
BA_ "GenSigStartValue" SG_ 433 VCU_MotorRgnCaplTqWhlVD 0;
BA_ "GenSigTimeoutValue" SG_ 433 VCU_MotorRgnCaplTqWhlVD 0;
BA_ "Remark" SG_ 433 VCU_MotorRgnCaplTqWhlVD "";
BA_ "EventCommandSignal" SG_ 433 VCU_VehWhlReqTqVD 0;
BA_ "GatewayedSignals" SG_ 433 VCU_VehWhlReqTqVD 0;
BA_ "GenSigInactiveValue" SG_ 433 VCU_VehWhlReqTqVD 0;
BA_ "GenSigInvalidValue" SG_ 433 VCU_VehWhlReqTqVD 0;
BA_ "GenSigSendType" SG_ 433 VCU_VehWhlReqTqVD 1;
BA_ "GenSigStartValue" SG_ 433 VCU_VehWhlReqTqVD 0;
BA_ "GenSigTimeoutValue" SG_ 433 VCU_VehWhlReqTqVD 0;
BA_ "Remark" SG_ 433 VCU_VehWhlReqTqVD "";
BA_ "EventCommandSignal" SG_ 433 VCU_ErrorFb 0;
BA_ "GatewayedSignals" SG_ 433 VCU_ErrorFb 0;
BA_ "GenSigInactiveValue" SG_ 433 VCU_ErrorFb 0;
BA_ "GenSigInvalidValue" SG_ 433 VCU_ErrorFb 0;
BA_ "GenSigSendType" SG_ 433 VCU_ErrorFb 1;
BA_ "GenSigStartValue" SG_ 433 VCU_ErrorFb 0;
BA_ "GenSigTimeoutValue" SG_ 433 VCU_ErrorFb 0;
BA_ "Remark" SG_ 433 VCU_ErrorFb "";
BA_ "EventCommandSignal" SG_ 433 VCU_PtTqActvSts 0;
BA_ "GatewayedSignals" SG_ 433 VCU_PtTqActvSts 0;
BA_ "GenSigInactiveValue" SG_ 433 VCU_PtTqActvSts 0;
BA_ "GenSigInvalidValue" SG_ 433 VCU_PtTqActvSts 0;
BA_ "GenSigSendType" SG_ 433 VCU_PtTqActvSts 1;
BA_ "GenSigStartValue" SG_ 433 VCU_PtTqActvSts 0;
BA_ "GenSigTimeoutValue" SG_ 433 VCU_PtTqActvSts 0;
BA_ "Remark" SG_ 433 VCU_PtTqActvSts "";
BA_ "EventCommandSignal" SG_ 433 VCU_PtTqAvl 0;
BA_ "GatewayedSignals" SG_ 433 VCU_PtTqAvl 0;
BA_ "GenSigInactiveValue" SG_ 433 VCU_PtTqAvl 0;
BA_ "GenSigInvalidValue" SG_ 433 VCU_PtTqAvl 0;
BA_ "GenSigSendType" SG_ 433 VCU_PtTqAvl 1;
BA_ "GenSigStartValue" SG_ 433 VCU_PtTqAvl 0;
BA_ "GenSigTimeoutValue" SG_ 433 VCU_PtTqAvl 0;
BA_ "Remark" SG_ 433 VCU_PtTqAvl "";
BA_ "EventCommandSignal" SG_ 433 VCU_DriverTorqueDesired 0;
BA_ "GatewayedSignals" SG_ 433 VCU_DriverTorqueDesired 0;
BA_ "GenSigInactiveValue" SG_ 433 VCU_DriverTorqueDesired 0;
BA_ "GenSigInvalidValue" SG_ 433 VCU_DriverTorqueDesired 0;
BA_ "GenSigSendType" SG_ 433 VCU_DriverTorqueDesired 1;
BA_ "GenSigStartValue" SG_ 433 VCU_DriverTorqueDesired 32768;
BA_ "GenSigTimeoutValue" SG_ 433 VCU_DriverTorqueDesired 0;
BA_ "Remark" SG_ 433 VCU_DriverTorqueDesired "";
BA_ "EventCommandSignal" SG_ 433 VCU_VehWhlReqTq 0;
BA_ "GatewayedSignals" SG_ 433 VCU_VehWhlReqTq 0;
BA_ "GenSigInactiveValue" SG_ 433 VCU_VehWhlReqTq 0;
BA_ "GenSigInvalidValue" SG_ 433 VCU_VehWhlReqTq 0;
BA_ "GenSigSendType" SG_ 433 VCU_VehWhlReqTq 1;
BA_ "GenSigStartValue" SG_ 433 VCU_VehWhlReqTq 32768;
BA_ "GenSigTimeoutValue" SG_ 433 VCU_VehWhlReqTq 0;
BA_ "Remark" SG_ 433 VCU_VehWhlReqTq "";
BA_ "EventCommandSignal" SG_ 433 VCU_MotorRgnCaplTqWhlRR 0;
BA_ "GatewayedSignals" SG_ 433 VCU_MotorRgnCaplTqWhlRR 0;
BA_ "GenSigInactiveValue" SG_ 433 VCU_MotorRgnCaplTqWhlRR 0;
BA_ "GenSigInvalidValue" SG_ 433 VCU_MotorRgnCaplTqWhlRR 0;
BA_ "GenSigSendType" SG_ 433 VCU_MotorRgnCaplTqWhlRR 1;
BA_ "GenSigStartValue" SG_ 433 VCU_MotorRgnCaplTqWhlRR 0;
BA_ "GenSigTimeoutValue" SG_ 433 VCU_MotorRgnCaplTqWhlRR 65535;
BA_ "Remark" SG_ 433 VCU_MotorRgnCaplTqWhlRR "";
BA_ "EventCommandSignal" SG_ 791 ZCUL_12_CRC 0;
BA_ "GatewayedSignals" SG_ 791 ZCUL_12_CRC 0;
BA_ "GenSigInactiveValue" SG_ 791 ZCUL_12_CRC 0;
BA_ "GenSigInvalidValue" SG_ 791 ZCUL_12_CRC 0;
BA_ "GenSigSendType" SG_ 791 ZCUL_12_CRC 1;
BA_ "GenSigStartValue" SG_ 791 ZCUL_12_CRC 0;
BA_ "GenSigTimeoutValue" SG_ 791 ZCUL_12_CRC 0;
BA_ "Remark" SG_ 791 ZCUL_12_CRC "";
BA_ "EventCommandSignal" SG_ 791 ZCUL_12_Counter 0;
BA_ "GatewayedSignals" SG_ 791 ZCUL_12_Counter 0;
BA_ "GenSigInactiveValue" SG_ 791 ZCUL_12_Counter 0;
BA_ "GenSigInvalidValue" SG_ 791 ZCUL_12_Counter 0;
BA_ "GenSigSendType" SG_ 791 ZCUL_12_Counter 1;
BA_ "GenSigStartValue" SG_ 791 ZCUL_12_Counter 0;
BA_ "GenSigTimeoutValue" SG_ 791 ZCUL_12_Counter 0;
BA_ "Remark" SG_ 791 ZCUL_12_Counter "";
BA_ "EventCommandSignal" SG_ 791 WW_FWPMotorSt 0;
BA_ "GatewayedSignals" SG_ 791 WW_FWPMotorSt 0;
BA_ "GenSigInactiveValue" SG_ 791 WW_FWPMotorSt 0;
BA_ "GenSigInvalidValue" SG_ 791 WW_FWPMotorSt 0;
BA_ "GenSigSendType" SG_ 791 WW_FWPMotorSt 1;
BA_ "GenSigStartValue" SG_ 791 WW_FWPMotorSt 0;
BA_ "GenSigTimeoutValue" SG_ 791 WW_FWPMotorSt 0;
BA_ "Remark" SG_ 791 WW_FWPMotorSt "";
BA_ "EventCommandSignal" SG_ 791 WW_FWSHMotorSt 0;
BA_ "GatewayedSignals" SG_ 791 WW_FWSHMotorSt 0;
BA_ "GenSigInactiveValue" SG_ 791 WW_FWSHMotorSt 0;
BA_ "GenSigInvalidValue" SG_ 791 WW_FWSHMotorSt 0;
BA_ "GenSigSendType" SG_ 791 WW_FWSHMotorSt 1;
BA_ "GenSigStartValue" SG_ 791 WW_FWSHMotorSt 0;
BA_ "GenSigTimeoutValue" SG_ 791 WW_FWSHMotorSt 0;
BA_ "Remark" SG_ 791 WW_FWSHMotorSt "";
BA_ "EventCommandSignal" SG_ 791 HRN_HornRunningSt 0;
BA_ "GatewayedSignals" SG_ 791 HRN_HornRunningSt 0;
BA_ "GenSigInactiveValue" SG_ 791 HRN_HornRunningSt 0;
BA_ "GenSigInvalidValue" SG_ 791 HRN_HornRunningSt 0;
BA_ "GenSigSendType" SG_ 791 HRN_HornRunningSt 1;
BA_ "GenSigStartValue" SG_ 791 HRN_HornRunningSt 0;
BA_ "GenSigTimeoutValue" SG_ 791 HRN_HornRunningSt 0;
BA_ "Remark" SG_ 791 HRN_HornRunningSt "";
BA_ "EventCommandSignal" SG_ 791 HRN_HornWorkingTemplet 0;
BA_ "GatewayedSignals" SG_ 791 HRN_HornWorkingTemplet 0;
BA_ "GenSigInactiveValue" SG_ 791 HRN_HornWorkingTemplet 0;
BA_ "GenSigInvalidValue" SG_ 791 HRN_HornWorkingTemplet 0;
BA_ "GenSigSendType" SG_ 791 HRN_HornWorkingTemplet 1;
BA_ "GenSigStartValue" SG_ 791 HRN_HornWorkingTemplet 0;
BA_ "GenSigTimeoutValue" SG_ 791 HRN_HornWorkingTemplet 0;
BA_ "Remark" SG_ 791 HRN_HornWorkingTemplet "";
BA_ "EventCommandSignal" SG_ 791 EL_FLPositionLightSt 0;
BA_ "GatewayedSignals" SG_ 791 EL_FLPositionLightSt 0;
BA_ "GenSigInactiveValue" SG_ 791 EL_FLPositionLightSt 0;
BA_ "GenSigInvalidValue" SG_ 791 EL_FLPositionLightSt 0;
BA_ "GenSigSendType" SG_ 791 EL_FLPositionLightSt 1;
BA_ "GenSigStartValue" SG_ 791 EL_FLPositionLightSt 0;
BA_ "GenSigTimeoutValue" SG_ 791 EL_FLPositionLightSt 0;
BA_ "Remark" SG_ 791 EL_FLPositionLightSt "";
BA_ "EventCommandSignal" SG_ 791 EL_FLPositionLightFaultSt 0;
BA_ "GatewayedSignals" SG_ 791 EL_FLPositionLightFaultSt 0;
BA_ "GenSigInactiveValue" SG_ 791 EL_FLPositionLightFaultSt 0;
BA_ "GenSigInvalidValue" SG_ 791 EL_FLPositionLightFaultSt 0;
BA_ "GenSigSendType" SG_ 791 EL_FLPositionLightFaultSt 1;
BA_ "GenSigStartValue" SG_ 791 EL_FLPositionLightFaultSt 0;
BA_ "GenSigTimeoutValue" SG_ 791 EL_FLPositionLightFaultSt 0;
BA_ "Remark" SG_ 791 EL_FLPositionLightFaultSt "";
BA_ "EventCommandSignal" SG_ 791 EL_FRPositionLightSt 0;
BA_ "GatewayedSignals" SG_ 791 EL_FRPositionLightSt 0;
BA_ "GenSigInactiveValue" SG_ 791 EL_FRPositionLightSt 0;
BA_ "GenSigInvalidValue" SG_ 791 EL_FRPositionLightSt 0;
BA_ "GenSigSendType" SG_ 791 EL_FRPositionLightSt 1;
BA_ "GenSigStartValue" SG_ 791 EL_FRPositionLightSt 0;
BA_ "GenSigTimeoutValue" SG_ 791 EL_FRPositionLightSt 0;
BA_ "Remark" SG_ 791 EL_FRPositionLightSt "";
BA_ "EventCommandSignal" SG_ 791 EL_FRPositionLightFaultSt 0;
BA_ "GatewayedSignals" SG_ 791 EL_FRPositionLightFaultSt 0;
BA_ "GenSigInactiveValue" SG_ 791 EL_FRPositionLightFaultSt 0;
BA_ "GenSigInvalidValue" SG_ 791 EL_FRPositionLightFaultSt 0;
BA_ "GenSigSendType" SG_ 791 EL_FRPositionLightFaultSt 1;
BA_ "GenSigStartValue" SG_ 791 EL_FRPositionLightFaultSt 0;
BA_ "GenSigTimeoutValue" SG_ 791 EL_FRPositionLightFaultSt 0;
BA_ "Remark" SG_ 791 EL_FRPositionLightFaultSt "";
BA_ "EventCommandSignal" SG_ 791 EL_LeftLowBeamSt 0;
BA_ "GatewayedSignals" SG_ 791 EL_LeftLowBeamSt 0;
BA_ "GenSigInactiveValue" SG_ 791 EL_LeftLowBeamSt 0;
BA_ "GenSigInvalidValue" SG_ 791 EL_LeftLowBeamSt 0;
BA_ "GenSigSendType" SG_ 791 EL_LeftLowBeamSt 1;
BA_ "GenSigStartValue" SG_ 791 EL_LeftLowBeamSt 0;
BA_ "GenSigTimeoutValue" SG_ 791 EL_LeftLowBeamSt 0;
BA_ "Remark" SG_ 791 EL_LeftLowBeamSt "";
BA_ "EventCommandSignal" SG_ 791 EL_LeftLowBeamFaultSt 0;
BA_ "GatewayedSignals" SG_ 791 EL_LeftLowBeamFaultSt 0;
BA_ "GenSigInactiveValue" SG_ 791 EL_LeftLowBeamFaultSt 0;
BA_ "GenSigInvalidValue" SG_ 791 EL_LeftLowBeamFaultSt 0;
BA_ "GenSigSendType" SG_ 791 EL_LeftLowBeamFaultSt 1;
BA_ "GenSigStartValue" SG_ 791 EL_LeftLowBeamFaultSt 0;
BA_ "GenSigTimeoutValue" SG_ 791 EL_LeftLowBeamFaultSt 0;
BA_ "Remark" SG_ 791 EL_LeftLowBeamFaultSt "";
BA_ "EventCommandSignal" SG_ 791 EL_RightLowBeamSt 0;
BA_ "GatewayedSignals" SG_ 791 EL_RightLowBeamSt 0;
BA_ "GenSigInactiveValue" SG_ 791 EL_RightLowBeamSt 0;
BA_ "GenSigInvalidValue" SG_ 791 EL_RightLowBeamSt 0;
BA_ "GenSigSendType" SG_ 791 EL_RightLowBeamSt 1;
BA_ "GenSigStartValue" SG_ 791 EL_RightLowBeamSt 0;
BA_ "GenSigTimeoutValue" SG_ 791 EL_RightLowBeamSt 0;
BA_ "Remark" SG_ 791 EL_RightLowBeamSt "";
BA_ "EventCommandSignal" SG_ 791 EL_RightLowBeamFaultSt 0;
BA_ "GatewayedSignals" SG_ 791 EL_RightLowBeamFaultSt 0;
BA_ "GenSigInactiveValue" SG_ 791 EL_RightLowBeamFaultSt 0;
BA_ "GenSigInvalidValue" SG_ 791 EL_RightLowBeamFaultSt 0;
BA_ "GenSigSendType" SG_ 791 EL_RightLowBeamFaultSt 1;
BA_ "GenSigStartValue" SG_ 791 EL_RightLowBeamFaultSt 0;
BA_ "GenSigTimeoutValue" SG_ 791 EL_RightLowBeamFaultSt 0;
BA_ "Remark" SG_ 791 EL_RightLowBeamFaultSt "";
BA_ "EventCommandSignal" SG_ 791 EL_LeftHighBeamSt 0;
BA_ "GatewayedSignals" SG_ 791 EL_LeftHighBeamSt 0;
BA_ "GenSigInactiveValue" SG_ 791 EL_LeftHighBeamSt 0;
BA_ "GenSigInvalidValue" SG_ 791 EL_LeftHighBeamSt 0;
BA_ "GenSigSendType" SG_ 791 EL_LeftHighBeamSt 1;
BA_ "GenSigStartValue" SG_ 791 EL_LeftHighBeamSt 0;
BA_ "GenSigTimeoutValue" SG_ 791 EL_LeftHighBeamSt 0;
BA_ "Remark" SG_ 791 EL_LeftHighBeamSt "";
BA_ "EventCommandSignal" SG_ 791 EL_LeftHighBeamFaultSt 0;
BA_ "GatewayedSignals" SG_ 791 EL_LeftHighBeamFaultSt 0;
BA_ "GenSigInactiveValue" SG_ 791 EL_LeftHighBeamFaultSt 0;
BA_ "GenSigInvalidValue" SG_ 791 EL_LeftHighBeamFaultSt 0;
BA_ "GenSigSendType" SG_ 791 EL_LeftHighBeamFaultSt 1;
BA_ "GenSigStartValue" SG_ 791 EL_LeftHighBeamFaultSt 0;
BA_ "GenSigTimeoutValue" SG_ 791 EL_LeftHighBeamFaultSt 0;
BA_ "Remark" SG_ 791 EL_LeftHighBeamFaultSt "";
BA_ "EventCommandSignal" SG_ 791 EL_RightHighBeamSt 0;
BA_ "GatewayedSignals" SG_ 791 EL_RightHighBeamSt 0;
BA_ "GenSigInactiveValue" SG_ 791 EL_RightHighBeamSt 0;
BA_ "GenSigInvalidValue" SG_ 791 EL_RightHighBeamSt 0;
BA_ "GenSigSendType" SG_ 791 EL_RightHighBeamSt 1;
BA_ "GenSigStartValue" SG_ 791 EL_RightHighBeamSt 0;
BA_ "GenSigTimeoutValue" SG_ 791 EL_RightHighBeamSt 0;
BA_ "Remark" SG_ 791 EL_RightHighBeamSt "";
BA_ "EventCommandSignal" SG_ 791 EL_RightHighBeamFaultSt 0;
BA_ "GatewayedSignals" SG_ 791 EL_RightHighBeamFaultSt 0;
BA_ "GenSigInactiveValue" SG_ 791 EL_RightHighBeamFaultSt 0;
BA_ "GenSigInvalidValue" SG_ 791 EL_RightHighBeamFaultSt 0;
BA_ "GenSigSendType" SG_ 791 EL_RightHighBeamFaultSt 1;
BA_ "GenSigStartValue" SG_ 791 EL_RightHighBeamFaultSt 0;
BA_ "GenSigTimeoutValue" SG_ 791 EL_RightHighBeamFaultSt 0;
BA_ "Remark" SG_ 791 EL_RightHighBeamFaultSt "";
BA_ "EventCommandSignal" SG_ 791 EL_FLFogLightSt 0;
BA_ "GatewayedSignals" SG_ 791 EL_FLFogLightSt 0;
BA_ "GenSigInactiveValue" SG_ 791 EL_FLFogLightSt 0;
BA_ "GenSigInvalidValue" SG_ 791 EL_FLFogLightSt 0;
BA_ "GenSigSendType" SG_ 791 EL_FLFogLightSt 1;
BA_ "GenSigStartValue" SG_ 791 EL_FLFogLightSt 0;
BA_ "GenSigTimeoutValue" SG_ 791 EL_FLFogLightSt 0;
BA_ "Remark" SG_ 791 EL_FLFogLightSt "";
BA_ "EventCommandSignal" SG_ 791 EL_FLFogLightFaultSt 0;
BA_ "GatewayedSignals" SG_ 791 EL_FLFogLightFaultSt 0;
BA_ "GenSigInactiveValue" SG_ 791 EL_FLFogLightFaultSt 0;
BA_ "GenSigInvalidValue" SG_ 791 EL_FLFogLightFaultSt 0;
BA_ "GenSigSendType" SG_ 791 EL_FLFogLightFaultSt 1;
BA_ "GenSigStartValue" SG_ 791 EL_FLFogLightFaultSt 0;
BA_ "GenSigTimeoutValue" SG_ 791 EL_FLFogLightFaultSt 0;
BA_ "Remark" SG_ 791 EL_FLFogLightFaultSt "";
BA_ "EventCommandSignal" SG_ 791 EL_FRFogLightSt 0;
BA_ "GatewayedSignals" SG_ 791 EL_FRFogLightSt 0;
BA_ "GenSigInactiveValue" SG_ 791 EL_FRFogLightSt 0;
BA_ "GenSigInvalidValue" SG_ 791 EL_FRFogLightSt 0;
BA_ "GenSigSendType" SG_ 791 EL_FRFogLightSt 1;
BA_ "GenSigStartValue" SG_ 791 EL_FRFogLightSt 0;
BA_ "GenSigTimeoutValue" SG_ 791 EL_FRFogLightSt 0;
BA_ "Remark" SG_ 791 EL_FRFogLightSt "";
BA_ "EventCommandSignal" SG_ 791 EL_FRFogLightFaultSt 0;
BA_ "GatewayedSignals" SG_ 791 EL_FRFogLightFaultSt 0;
BA_ "GenSigInactiveValue" SG_ 791 EL_FRFogLightFaultSt 0;
BA_ "GenSigInvalidValue" SG_ 791 EL_FRFogLightFaultSt 0;
BA_ "GenSigSendType" SG_ 791 EL_FRFogLightFaultSt 1;
BA_ "GenSigStartValue" SG_ 791 EL_FRFogLightFaultSt 0;
BA_ "GenSigTimeoutValue" SG_ 791 EL_FRFogLightFaultSt 0;
BA_ "Remark" SG_ 791 EL_FRFogLightFaultSt "";
BA_ "EventCommandSignal" SG_ 791 EL_LeftDRLSt 0;
BA_ "GatewayedSignals" SG_ 791 EL_LeftDRLSt 0;
BA_ "GenSigInactiveValue" SG_ 791 EL_LeftDRLSt 0;
BA_ "GenSigInvalidValue" SG_ 791 EL_LeftDRLSt 0;
BA_ "GenSigSendType" SG_ 791 EL_LeftDRLSt 1;
BA_ "GenSigStartValue" SG_ 791 EL_LeftDRLSt 0;
BA_ "GenSigTimeoutValue" SG_ 791 EL_LeftDRLSt 0;
BA_ "Remark" SG_ 791 EL_LeftDRLSt "";
BA_ "EventCommandSignal" SG_ 791 EL_LeftDRLFaultSt 0;
BA_ "GatewayedSignals" SG_ 791 EL_LeftDRLFaultSt 0;
BA_ "GenSigInactiveValue" SG_ 791 EL_LeftDRLFaultSt 0;
BA_ "GenSigInvalidValue" SG_ 791 EL_LeftDRLFaultSt 0;
BA_ "GenSigSendType" SG_ 791 EL_LeftDRLFaultSt 1;
BA_ "GenSigStartValue" SG_ 791 EL_LeftDRLFaultSt 0;
BA_ "GenSigTimeoutValue" SG_ 791 EL_LeftDRLFaultSt 0;
BA_ "Remark" SG_ 791 EL_LeftDRLFaultSt "";
BA_ "EventCommandSignal" SG_ 791 EL_RightDRLSt 0;
BA_ "GatewayedSignals" SG_ 791 EL_RightDRLSt 0;
BA_ "GenSigInactiveValue" SG_ 791 EL_RightDRLSt 0;
BA_ "GenSigInvalidValue" SG_ 791 EL_RightDRLSt 0;
BA_ "GenSigSendType" SG_ 791 EL_RightDRLSt 1;
BA_ "GenSigStartValue" SG_ 791 EL_RightDRLSt 0;
BA_ "GenSigTimeoutValue" SG_ 791 EL_RightDRLSt 0;
BA_ "Remark" SG_ 791 EL_RightDRLSt "";
BA_ "EventCommandSignal" SG_ 791 EL_RightDRLFaultSt 0;
BA_ "GatewayedSignals" SG_ 791 EL_RightDRLFaultSt 0;
BA_ "GenSigInactiveValue" SG_ 791 EL_RightDRLFaultSt 0;
BA_ "GenSigInvalidValue" SG_ 791 EL_RightDRLFaultSt 0;
BA_ "GenSigSendType" SG_ 791 EL_RightDRLFaultSt 1;
BA_ "GenSigStartValue" SG_ 791 EL_RightDRLFaultSt 0;
BA_ "GenSigTimeoutValue" SG_ 791 EL_RightDRLFaultSt 0;
BA_ "Remark" SG_ 791 EL_RightDRLFaultSt "";
BA_ "EventCommandSignal" SG_ 791 EL_FLTurnLightSt 0;
BA_ "GatewayedSignals" SG_ 791 EL_FLTurnLightSt 0;
BA_ "GenSigInactiveValue" SG_ 791 EL_FLTurnLightSt 0;
BA_ "GenSigInvalidValue" SG_ 791 EL_FLTurnLightSt 0;
BA_ "GenSigSendType" SG_ 791 EL_FLTurnLightSt 1;
BA_ "GenSigStartValue" SG_ 791 EL_FLTurnLightSt 0;
BA_ "GenSigTimeoutValue" SG_ 791 EL_FLTurnLightSt 0;
BA_ "Remark" SG_ 791 EL_FLTurnLightSt "";
BA_ "EventCommandSignal" SG_ 791 EL_FLTurnLightFaultSt 0;
BA_ "GatewayedSignals" SG_ 791 EL_FLTurnLightFaultSt 0;
BA_ "GenSigInactiveValue" SG_ 791 EL_FLTurnLightFaultSt 0;
BA_ "GenSigInvalidValue" SG_ 791 EL_FLTurnLightFaultSt 0;
BA_ "GenSigSendType" SG_ 791 EL_FLTurnLightFaultSt 1;
BA_ "GenSigStartValue" SG_ 791 EL_FLTurnLightFaultSt 0;
BA_ "GenSigTimeoutValue" SG_ 791 EL_FLTurnLightFaultSt 0;
BA_ "Remark" SG_ 791 EL_FLTurnLightFaultSt "";
BA_ "EventCommandSignal" SG_ 791 EL_FRTurnLightSt 0;
BA_ "GatewayedSignals" SG_ 791 EL_FRTurnLightSt 0;
BA_ "GenSigInactiveValue" SG_ 791 EL_FRTurnLightSt 0;
BA_ "GenSigInvalidValue" SG_ 791 EL_FRTurnLightSt 0;
BA_ "GenSigSendType" SG_ 791 EL_FRTurnLightSt 1;
BA_ "GenSigStartValue" SG_ 791 EL_FRTurnLightSt 0;
BA_ "GenSigTimeoutValue" SG_ 791 EL_FRTurnLightSt 0;
BA_ "Remark" SG_ 791 EL_FRTurnLightSt "";
BA_ "EventCommandSignal" SG_ 791 EL_FRTurnLightFaultSt 0;
BA_ "GatewayedSignals" SG_ 791 EL_FRTurnLightFaultSt 0;
BA_ "GenSigInactiveValue" SG_ 791 EL_FRTurnLightFaultSt 0;
BA_ "GenSigInvalidValue" SG_ 791 EL_FRTurnLightFaultSt 0;
BA_ "GenSigSendType" SG_ 791 EL_FRTurnLightFaultSt 1;
BA_ "GenSigStartValue" SG_ 791 EL_FRTurnLightFaultSt 0;
BA_ "GenSigTimeoutValue" SG_ 791 EL_FRTurnLightFaultSt 0;
BA_ "Remark" SG_ 791 EL_FRTurnLightFaultSt "";
BA_ "EventCommandSignal" SG_ 791 WW_RWSHMotorSt 0;
BA_ "GatewayedSignals" SG_ 791 WW_RWSHMotorSt 0;
BA_ "GenSigInactiveValue" SG_ 791 WW_RWSHMotorSt 0;
BA_ "GenSigInvalidValue" SG_ 791 WW_RWSHMotorSt 0;
BA_ "GenSigSendType" SG_ 791 WW_RWSHMotorSt 1;
BA_ "GenSigStartValue" SG_ 791 WW_RWSHMotorSt 0;
BA_ "GenSigTimeoutValue" SG_ 791 WW_RWSHMotorSt 0;
BA_ "Remark" SG_ 791 WW_RWSHMotorSt "";
BA_ "EventCommandSignal" SG_ 791 EL_FADASLightSt 0;
BA_ "GatewayedSignals" SG_ 791 EL_FADASLightSt 0;
BA_ "GenSigInactiveValue" SG_ 791 EL_FADASLightSt 0;
BA_ "GenSigInvalidValue" SG_ 791 EL_FADASLightSt 0;
BA_ "GenSigSendType" SG_ 791 EL_FADASLightSt 1;
BA_ "GenSigStartValue" SG_ 791 EL_FADASLightSt 0;
BA_ "GenSigTimeoutValue" SG_ 791 EL_FADASLightSt 0;
BA_ "Remark" SG_ 791 EL_FADASLightSt "";
BA_ "EventCommandSignal" SG_ 791 EBSF_BattVolt 0;
BA_ "GatewayedSignals" SG_ 791 EBSF_BattVolt 0;
BA_ "GenSigInactiveValue" SG_ 791 EBSF_BattVolt 0;
BA_ "GenSigInvalidValue" SG_ 791 EBSF_BattVolt 0;
BA_ "GenSigSendType" SG_ 791 EBSF_BattVolt 1;
BA_ "GenSigStartValue" SG_ 791 EBSF_BattVolt 16383;
BA_ "GenSigTimeoutValue" SG_ 791 EBSF_BattVolt 0;
BA_ "Remark" SG_ 791 EBSF_BattVolt "";
BA_ "EventCommandSignal" SG_ 791 EBSF_CurrentRange 0;
BA_ "GatewayedSignals" SG_ 791 EBSF_CurrentRange 0;
BA_ "GenSigInactiveValue" SG_ 791 EBSF_CurrentRange 0;
BA_ "GenSigInvalidValue" SG_ 791 EBSF_CurrentRange 0;
BA_ "GenSigSendType" SG_ 791 EBSF_CurrentRange 1;
BA_ "GenSigStartValue" SG_ 791 EBSF_CurrentRange 3;
BA_ "GenSigTimeoutValue" SG_ 791 EBSF_CurrentRange 0;
BA_ "Remark" SG_ 791 EBSF_CurrentRange "";
BA_ "EventCommandSignal" SG_ 791 EBSF_BattCurrent 0;
BA_ "GatewayedSignals" SG_ 791 EBSF_BattCurrent 0;
BA_ "GenSigInactiveValue" SG_ 791 EBSF_BattCurrent 0;
BA_ "GenSigInvalidValue" SG_ 791 EBSF_BattCurrent 0;
BA_ "GenSigSendType" SG_ 791 EBSF_BattCurrent 1;
BA_ "GenSigStartValue" SG_ 791 EBSF_BattCurrent 65535;
BA_ "GenSigTimeoutValue" SG_ 791 EBSF_BattCurrent 0;
BA_ "Remark" SG_ 791 EBSF_BattCurrent "";
VAL_ 431 VCU_TargetRecpTorqVD 1 "Valid;" 0 "Invalid;"  ;
VAL_ 431 VCU_AccDriverOrvd 0 "No override" 1 "Driver override"  ;
VAL_ 431 VCU_AccDriverOrvdVD 0 "Invalid" 1 "Valid"  ;
VAL_ 431 VCU_TargetRecpTorqFAVD 1 "Valid;" 0 "Invalid;"  ;
VAL_ 431 VCU_TargetRecpTorqRAVD 1 "Valid;" 0 "Invalid;"  ;
VAL_ 431 VCU_TorqDriverReqFAVD 1 "Valid;" 0 "Invalid;"  ;
VAL_ 431 VCU_TorqDriverReqRAVD 1 "Valid;" 0 "Invalid;"  ;
VAL_ 431 VCU_VehActDrvTorqFAVD 1 "Valid;" 0 "Invalid;"  ;
VAL_ 431 VCU_VehActDrvTorqRAVD 1 "Valid;" 0 "Invalid;"  ;
VAL_ 431 VCU_BcsDecelVD 0 "Invalid" 1 "Valid"  ;
VAL_ 431 VCU_RecpTorqRLVD 1 "Valid;" 0 "Invalid;"  ;
VAL_ 431 VCU_RecpTorqRRVD 1 "Valid;" 0 "Invalid;"  ;
VAL_ 431 VCU_ADSNetErrorFb 0 "No Error" 1 "Main Net E2E Error" 2 "Sub Net E2E Error" 3 "Both Net E2E Error" 4 "Reserved" 5 "Reserved" 6 "Reserved" 7 "Reserved"  ;
VAL_ 431 VCU_NetModeResp 0 "None" 1 "Main/sub Net active" 2 "Main/sub Net active with error" 3 "Reserved"  ;
VAL_ 431 VCU_PwrLimDrv_kWVD 0 "Not valid" 1 "Valid"  ;
VAL_ 431 VCU_PwrLimRegen_kWVD 0 "Not valid" 1 "Valid"  ;
VAL_ 431 VCU_PtTqActvStsFL 0 "Not responsed" 1 "Responsed"  ;
VAL_ 431 VCU_PtTqActvStsFR 0 "Not responsed" 1 "Responsed"  ;
VAL_ 431 VCU_PtTqActvStsRL 0 "Not responsed" 1 "Responsed"  ;
VAL_ 431 VCU_PtTqActvStsRR 0 "Not responsed" 1 "Responsed"  ;
VAL_ 615 BCS_FLWheelSpdVD 0 "Not valid" 1 "Valid"  ;
VAL_ 615 BCS_FLWheelRotatedDirectionVD 0 "Not valid" 1 "Valid"  ;
VAL_ 615 BCS_FRWheelSpdVD 0 "Not valid" 1 "Valid"  ;
VAL_ 615 BCS_FRWheelRotatedDirectionVD 0 "Not valid" 1 "Valid"  ;
VAL_ 615 BCS_RLWheelSpdVD 0 "Not valid" 1 "Valid"  ;
VAL_ 615 BCS_RLWheelRotatedDirectionVD 0 "Not valid" 1 "Valid"  ;
VAL_ 615 BCS_RRWheelSpdVD 0 "Not valid" 1 "Valid"  ;
VAL_ 615 BCS_RRWheelRotatedDirectionVD 0 "Not valid" 1 "Valid"  ;
VAL_ 615 BCS_HHCCtrlSt 0 "Not active" 1 "Active"  ;
VAL_ 615 BCS_HDCCtrlSt 0 "Off" 1 "On active braking" 2 "On not active braking" 3 "Not used"  ;
VAL_ 615 BCS_HDCErrSt 0 "No error" 1 "Error"  ;
VAL_ 615 BCS_FLWheelSpdEdgesSumVD 0 "Not valid" 1 "Valid"  ;
VAL_ 615 BCS_FRWheelSpdEdgesSumVD 0 "Not valid" 1 "Valid"  ;
VAL_ 615 BCS_RLWheelSpdEdgesSumVD 0 "Not valid" 1 "Valid"  ;
VAL_ 615 BCS_RRWheelSpdEdgesSumVD 0 "Not valid" 1 "Valid"  ;
VAL_ 615 BCS_FLWheelRotatedDirection 0 "Standstill" 1 "Forward" 2 "Backward" 3 "Unknown"  ;
VAL_ 615 BCS_FRWheelRotatedDirection 0 "Standstill" 1 "Forward" 2 "Backward" 3 "Unknown"  ;
VAL_ 615 BCS_RLWheelRotatedDirection 0 "Standstill" 1 "Forward" 2 "Backward" 3 "Unknown"  ;
VAL_ 615 BCS_RRWheelRotatedDirection 0 "Standstill" 1 "Forward" 2 "Backward" 3 "Unknown"  ;
VAL_ 615 BCS_ParkingReqToEPB 0 "No request" 1 "Release brake request" 2 "Lock brake request" 3 "Not used"  ;
VAL_ 615 BCS_VDCOff 0 "On" 1 "Off"  ;
VAL_ 615 BCS_AVHSt 0 "Not active" 1 "Active"  ;
VAL_ 615 BCS_AVHAvailable 0 "Not available" 1 "Available"  ;
VAL_ 615 BCS_TCSOff 0 "On" 1 "Off"  ;
VAL_ 615 BCS_BrakeOverHeat 0 "Not high" 1 "Temp too high"  ;
VAL_ 615 BCS_ABAactive 0 "Not active" 1 "Active"  ;
VAL_ 615 BCS_ABAavailable 0 "Not available" 1 "Available"  ;
VAL_ 615 BCS_ABPActive 0 "Not active" 1 "Active"  ;
VAL_ 615 BCS_ABPAvailable 0 "Not available" 1 "Available"  ;
VAL_ 615 BCS_AEBActive 0 "Not active" 1 "Active"  ;
VAL_ 615 BCS_AEBAvailable 0 "Not available" 1 "Available"  ;
VAL_ 615 BCS_AWBActive 0 "Not active" 1 "Active"  ;
VAL_ 615 BCS_AWBAvailable 0 "Not available" 1 "Available"  ;
VAL_ 615 BCS_VehicleStandStillSt 0 "Not standstill" 1 "standstill" 2 "Invalid (short unavailability, max 3s)" 3 "Not used"  ;
VAL_ 615 BCS_InputRodStrokeSt 0 "Valid/Init" 1 "Invalid/Default"  ;
VAL_ 615 BCS_PlungerPressureSt 0 "Valid/Init" 1 "Invalid/Default"  ;
VAL_ 615 BCS_BrkTqCtrlAvlDrivingRdn 0 "BrakeBackupStrategyAvailability_None" 1 "BrakeBackupStrategyAvailability_Full" 2 "BrakeBackupStrategyAvailability_Fault" 3 "BrakeBackupStrategyAvailability_TestPending" 4 "BrakeBackupStrategyAvailability_NotInitialized" 5 "Reserved" 6 "Reserved" 7 "Reserved"  ;
VAL_ 615 BCS_BrkTqCtrlActvRdn 0 "BrakeMain_None" 1 "BrakeMain_APAactive" 2 "BrakeMain_ACCactive" 3 "Reserved"  ;
VAL_ 615 BCS_L3ComVD 0 "Invalid" 1 "Valid"  ;
VAL_ 615 BCS_LFIActiveSt 0 "Not Active" 1 "Active"  ;
VAL_ 430 SRS_CrashOutputSt 0 "No crash,"  ;
VAL_ 430 SRS_Front_CrashOutputSt 0 "No crash,"  ;
VAL_ 430 SRS_DriverSide_CrashOutputSt 0 "No crash,"  ;
VAL_ 430 SRS_PassengerSide_CrashOutputSt 0 "No crash,"  ;
VAL_ 430 SRS_Rear_CrashOutputSt 0 "No crash,"  ;
VAL_ 430 SRS_RolloverCrashOutputSt 0 "No crash,"  ;
VAL_ 430 SRS_NearCrashOutputSt 0 "No crash," 1 "(transition lasts for 2sec)"  ;
VAL_ 430 SRS_YawSnsCalibSt 0 "Sensor Not Calibrated" 1 "Sensor Calibrated"  ;
VAL_ 430 SRS_VehLongAccelVD 0 "Initializing" 1 "Valid" 2 "Invalid" 3 "Reserved"  ;
VAL_ 430 SRS_VehLatrlAccelVD 0 "Initializing" 1 "Valid" 2 "Invalid" 3 "Reserved"  ;
VAL_ 430 SRS_YawRateVD 0 "Initializing" 1 "Valid" 2 "Invalid" 3 "Reserved"  ;
VAL_ 290 IPDS_FrontRadarPowerSup 0 "Not Active" 1 "Active" 2 "PreOFF" 3 "Invalid"  ;
VAL_ 290 IPDS_FLRadarPowerSup 0 "Not Active" 1 "Active" 2 "PreOFF" 3 "Invalid"  ;
VAL_ 290 IPDS_FRRadarPowerSup 0 "Not Active" 1 "Active" 2 "PreOFF" 3 "Invalid"  ;
VAL_ 290 IPDS_HDMapPowerSup 0 "Not Active" 1 "Active" 2 "PreOFF" 3 "Invalid"  ;
VAL_ 290 IPDS_Lidar1PowerSup 0 "Not Active" 1 "Active" 2 "PreOFF" 3 "Invalid"  ;
VAL_ 290 IPDS_RearRadarPowerSup 0 "Not Active" 1 "Active" 2 "PreOFF" 3 "Invalid"  ;
VAL_ 398 EMS_ClutchTorqVD 0 "Invalid" 1 "Valid"  ;
VAL_ 398 EMS_EngFrictionTorqVD 0 "Invalid" 1 "Valid"  ;
VAL_ 398 EMS_MinClutchTorqVD 0 "Invalid" 1 "Valid"  ;
VAL_ 398 EMS_MaxClutchTorqVD 0 "Invalid" 1 "Valid"  ;
VAL_ 398 EMS_EngSt 0 "Not run" 1 "Run"  ;
VAL_ 161 ACU_FaceID_Delete 0 "Default" 1 "Delete AUID1" 2 "Delete AUID2" 3 "Delete AUID3" 4 "Delete AUID4" 5 "Delete AUID5" 6 "Delete AUID6" 7 "Delete AUID7" 8 "Delete AUID8" 9 "Reserved" 10 "Reserved" 11 "Reserved" 12 "Reserved" 13 "Reserved" 14 "Reserved" 15 "Reserved"  ;
VAL_ 161 ACU_RegisterTriger 0 "Default" 1 "Register AUID1" 2 "Register AUID2" 3 "Register AUID3" 4 "Register AUID4" 5 "Register AUID5" 6 "Register AUID6" 7 "Register AUID7" 8 "Register AUID8" 9 "Reserved" 10 "Reserved" 11 "Reserved" 12 "Reserved" 13 "Reserved" 14 "Reserved" 15 "Reserved"  ;
VAL_ 161 ACU_VerifyTriger 0 "Default" 1 "Verify AUID1" 2 "Verify AUID2" 3 "Verify AUID3" 4 "Verify AUID4" 5 "Verify AUID5" 6 "Verify AUID6" 7 "Verify AUID7" 8 "Verify AUID8" 9 "Reserved" 10 "Reserved" 11 "Reserved" 12 "Reserved" 13 "Reserved" 14 "Reserved" 15 "Reserved"  ;
VAL_ 161 ACU_FaceIDQuit 0 "No command" 1 "Quit request"  ;
VAL_ 161 ACU_FaceIDSwitch 0 "No command" 1 "Off" 2 "On" 3 "Not used"  ;
VAL_ 161 ACU_AVAS_SwitchCfgReq 0 "No command" 1 "OFF" 2 "ON" 3 "Not used"  ;
VAL_ 363 EPS_StrngWhlTorqVD 0 "Not valid" 1 "Valid"  ;
VAL_ 363 TAS_CalibratedSt 0 "Not calibrated" 1 "Calibrated"  ;
VAL_ 363 EPS_SteeringAngleSpdVD 0 "Not valid" 1 "Valid"  ;
VAL_ 363 EPS_SteeringAngleVD 0 "Not valid" 1 "Valid"  ;
VAL_ 363 EPS_VMCErrFeedback 0 "No interruption" 1 "LKA Interruption" 2 "APA Interruption" 3 "Vehicle Speed Invalid" 4 "VMC Activation request error" 5 "VMC ECU Signal error" 6 "EPS Temp error" 7 "Request Torque Slope over limit" 8 "Request Torque Value over limit" 9 "Failed Temp Time Over Limit" 10 "EPS Permanently error" 11 "VMC Triggered safety monitor module" 12 "Drive Override" 13 "Reserved" 14 "Reserved" 15 "Reserved"  ;
VAL_ 363 EPS_PstOverlaySt 0 "Not Ready;" 1 "Ready;" 2 "100% Active;" 3 "50% Active;" 4 "Failed;" 5 "Reserved" 6 "Reserved" 7 "Reserved"  ;
VAL_ 363 EPS_HealthySt_DualSide 0 "Healthy;" 1 "Slightly failure;" 2 "Abnormal;" 3 "Shut off;"  ;
VAL_ 363 EPS_VibrationWarnSt_A 0 "Not Acitve" 1 "Active level 1" 2 "Active level 2" 3 "Active level 3"  ;
VAL_ 363 SAC_ErrFeedback_SideA 0 "No  interruption；" 1 "ADAS TqRateReq Over rangenge" 2 "Driver Override" 3 "Vehicle Speed Invalid" 4 "Activation Requestrian Error" 5 "ADC Channel A signal Error" 6 "EPS Error" 7 "IFC Signal Error" 8 "ADAS AngleReq Over range" 9 "ADAS AngleSpdReq Over range" 10 "ADAS TqReq Over range" 11 "Both ADAS Channel Error" 12 "ADC Channel B signal Error；" 13 "Reserved；" 14 "Reserved；" 15 "Reserved；"  ;
VAL_ 363 EPS_FunctionStyleSt 0 "Unknow" 1 "light" 2 "Comfort" 3 "Sport"  ;
VAL_ 363 EPS_SteeringModeSt 0 "Not ready" 1 "Ready" 2 "In transition" 3 "Fault"  ;
VAL_ 363 EPS_ReqAngOverRange 0 "Not Over Range；" 1 "Over range"  ;
VAL_ 363 EPS_ReqAngSpdOverRange 0 "Not Over Range；" 1 "Over range"  ;
VAL_ 363 EPS_AssistPraSwitchToLKA 0 "Not in LAK mode；" 1 "In LKA Mode；"  ;
VAL_ 363 EPS_SteerGainEnable 0 "Disable；" 1 "Enable；"  ;
VAL_ 363 EPS_EmSteerEnbale 0 "Disable；" 1 "Enable；"  ;
VAL_ 363 EPS_EM_ErrFeedback 0 "No interruption" 1 "Reserved" 2 "Reserved" 3 "Reserved" 4 "Reserved" 5 "ADAS Signal err" 6 "EPS error" 7 "Duration time over"  ;
VAL_ 363 EPS_VW_ErrFeedback 0 "No interruption" 1 "Reserved" 2 "Reserved" 3 "Reserved" 4 "Invalid request" 5 "ADC Signal err" 6 "EPS error"  ;
VAL_ 363 EPS_SG_ErrFeedback 0 "No  interruption；" 1 "Premise fun abort" 2 "Invalid request" 3 "Reserved" 4 "Reserved" 5 "Reserved" 6 "Reserved" 7 "Reserved" 8 "Reserved" 9 "Reserved" 10 "Reserved" 11 "Reserved" 12 "Reserved" 13 "Reserved" 14 "Reserved" 15 "Reserved"  ;
VAL_ 363 EPS_WarnLamp 0 "No Fault" 1 "Slight Fault" 2 "Urgency Fault" 3 "Severity Urgency Fault"  ;
VAL_ 363 EPS_SteeringWhlTorFltVD 0 "No Valid" 1 "Valid with fault detected" 2 "Valid and healthy" 3 "Unkown"  ;
VAL_ 363 EPS_TqCtrlSt 0 "No active" 1 "Ready" 2 "Active" 3 "Failed"  ;
VAL_ 363 EPS_TqCtrlAvl 0 "Not available" 1 "Available" 2 "Available degraded" 3 "Reseved"  ;
VAL_ 363 EPS_AgCtrlAvl 0 "Not available" 1 "Available" 2 "Available degraded" 3 "Reseved"  ;
VAL_ 363 EPS_MotorTorSumVD 0 "Invalid" 1 "Valid"  ;
VAL_ 363 EPS_DrvOveRideSt 0 "Not override" 1 "Override"  ;
VAL_ 363 EPS_DrvOveRideVD 0 "Invalid" 1 "Valid"  ;
VAL_ 363 EPS_SteerVibrlAvl 0 "Not available" 1 "Available"  ;
VAL_ 363 EPS_HandsOffDetStVD 0 "Invalid" 1 "Valid"  ;
VAL_ 363 EPS_HandsOffDetSt 0 "Not detected" 1 "Hands off" 2 "Hands on" 3 "Reserved"  ;
VAL_ 363 EPS_SteerMod 0 "Initial" 1 "Power steer" 2 "Angle control(Normal）" 3 "Angle control(Emergency)" 4 "Torque control(Normal）" 5 "Torque control(Emergency)" 6 "Failure" 7 "Reserved"  ;
VAL_ 363 EPS_ADCNetErrorFb 0 "No Error" 1 "Main Net E2E Error" 2 "Sub Net E2E Error" 3 "Both Net E2E Error" 4 "Reserved" 5 "Reserved" 6 "Reserved" 7 "Reserved"  ;
VAL_ 363 EPS_NetModeResp 0 "None" 1 "Main/sub Net active" 2 "Main/sub Net active with error" 3 "Reserved"  ;
VAL_ 433 VCU_VehWhlReqTqFAVD 0 "Invalid" 1 "Valid"  ;
VAL_ 433 VCU_VehWhlReqTqRRVD 0 "Invalid" 1 "Valid"  ;
VAL_ 433 VCU_VehActDrvTorqRRVD 1 "Valid;" 0 "Invalid;"  ;
VAL_ 433 VCU_PreStableFlg 0 "Not Active" 1 "Active"  ;
VAL_ 433 VCU_VehWhlReqTqRLVD 0 "Invalid" 1 "Valid"  ;
VAL_ 433 VCU_AccPedalActPstVD 0 "Invalid" 1 "Valid"  ;
VAL_ 433 VCU_AccPedalActPst 511 "error;" 510 "Init;"  ;
VAL_ 433 VCU_GearShiftAvl 0 "not available" 1 "available"  ;
VAL_ 433 VCU_MotorRgnCaplTqWhlVD 0 "Invalid" 1 "Valid"  ;
VAL_ 433 VCU_VehWhlReqTqVD 0 "Invalid" 1 "Valid"  ;
VAL_ 433 VCU_ErrorFb 0 "No error" 1 "ADS请求有效位无效" 2 "高压故障" 3 "MCU故障" 4 "BMS故障" 7 "ADS E2E故障或者time out"  ;
VAL_ 433 VCU_PtTqActvSts 0 "Not response" 1 "Response"  ;
VAL_ 433 VCU_PtTqAvl 0 "not available" 1 "available" 2 "available degraded"  ;
VAL_ 791 WW_FWPMotorSt 0 "Off" 1 "Reserve" 2 "Stall protection" 3 "Failure" 4 "Low speed" 5 "High speed" 6 "Hard stopped" 7 "Interval delaying"  ;
VAL_ 791 WW_FWSHMotorSt 0 "OFF" 1 "ON" 2 "Failure"  ;
VAL_ 791 HRN_HornRunningSt 0 "Off" 1 "On" 2 "Failure"  ;
VAL_ 791 HRN_HornWorkingTemplet 0 "No Action"  ;
VAL_ 791 EL_FLPositionLightSt 0 "OFF" 1 "ON"  ;
VAL_ 791 EL_FLPositionLightFaultSt 0 "Not fault" 1 "Fault"  ;
VAL_ 791 EL_FRPositionLightSt 0 "OFF" 1 "ON"  ;
VAL_ 791 EL_FRPositionLightFaultSt 0 "Not fault" 1 "Fault"  ;
VAL_ 791 EL_LeftLowBeamSt 0 "OFF" 1 "ON"  ;
VAL_ 791 EL_LeftLowBeamFaultSt 0 "Not fault" 1 "Fault"  ;
VAL_ 791 EL_RightLowBeamSt 0 "OFF" 1 "ON"  ;
VAL_ 791 EL_RightLowBeamFaultSt 0 "Not fault" 1 "Fault"  ;
VAL_ 791 EL_LeftHighBeamSt 0 "OFF" 1 "ON"  ;
VAL_ 791 EL_LeftHighBeamFaultSt 0 "Not fault" 1 "Fault"  ;
VAL_ 791 EL_RightHighBeamSt 0 "OFF" 1 "ON"  ;
VAL_ 791 EL_RightHighBeamFaultSt 0 "Not fault" 1 "Fault"  ;
VAL_ 791 EL_FLFogLightSt 0 "OFF" 1 "ON"  ;
VAL_ 791 EL_FLFogLightFaultSt 0 "Not fault" 1 "Fault"  ;
VAL_ 791 EL_FRFogLightSt 0 "OFF" 1 "ON"  ;
VAL_ 791 EL_FRFogLightFaultSt 0 "Not fault" 1 "Fault"  ;
VAL_ 791 EL_LeftDRLSt 0 "OFF" 1 "ON"  ;
VAL_ 791 EL_LeftDRLFaultSt 0 "Not fault" 1 "Fault"  ;
VAL_ 791 EL_RightDRLSt 0 "OFF" 1 "ON"  ;
VAL_ 791 EL_RightDRLFaultSt 0 "Not fault" 1 "Fault"  ;
VAL_ 791 EL_FLTurnLightSt 0 "Not active" 1 "OFF" 2 "ON" 3 "Not used"  ;
VAL_ 791 EL_FLTurnLightFaultSt 0 "Not fault" 1 "Fault"  ;
VAL_ 791 EL_FRTurnLightSt 0 "Not active" 1 "OFF" 2 "ON" 3 "Not used"  ;
VAL_ 791 EL_FRTurnLightFaultSt 0 "Not fault" 1 "Fault"  ;
VAL_ 791 WW_RWSHMotorSt 0 "OFF" 1 "ON" 2 "Failure"  ;
VAL_ 791 EL_FADASLightSt 0 "Off" 1 "On" 2 "Fault" 3 "Not used"  ;
