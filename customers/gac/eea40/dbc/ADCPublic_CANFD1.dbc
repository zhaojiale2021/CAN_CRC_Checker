VERSION "Version"

NS_ :

BS_:

BU_: Tester CCU ADC CCU_CCURT1 CCU_CCURT2 RLR RRR ZCUF ZCUL ZCUR ZCUT EMS IDM DCDC IPS NIDU NIDUF DCUR OBC OPC LPC CPC EMCM GCU DCUF IPU BMS EOPF EOPR EVCC DCDC2 EDL SRS ECS EPS EPB RBM IBCS ICM IID IDC PHUDD AMP WHUD IMR INU IFC FAPA PAS PCS SCMR SCMRL SCMRR HVSMR SCMRM MFS WSM DRM IDU FCP LBMSAD AVAS ATSS DLPFL FBLCM FLISD FLLCM FRLCM RLLCMA RLLCMB RRLCMA RRLCMB RLISD DLPML DLPMR TRM PSDL PSDR HVSPRL HVSPRR RFR SBM WCM ETC TBOX2 TBOX IDUR CBM PLGM TMC LPC2 SCMT RCP RRISD LBMS RLBMS CCURT1 CCURT2 RT1_C1 RT2_C3 RT1_C0 OTAWL RAS EBB RCICP WCMFR WCMRL SAS CD

BO_ 904 CCU_GwMsg_4: 64 CCU_CCURT2
 SG_ ACU_PCS_SVM_MODCmd : 96|1@0+ (1,0) [0|1] ""  ADC,IFC,FAPA
 SG_ ACU_HeadLightVirtualSwSt : 99|3@0+ (1,0) [0|7] ""  ADC,IFC,FAPA
 SG_ ACU_FrontFogLightVirtualSwSt : 144|1@0+ (1,0) [0|1] ""  ADC,IFC,FAPA
 SG_ ACU_RearFogLightVirtualSwSt : 145|1@0+ (1,0) [0|1] ""  ADC,IFC,FAPA
 SG_ ACU_Account_Uid : 151|4@0+ (1,0) [0|15] ""  ADC,IFC,FAPA
 SG_ ACU_IHBC_SwitchReq : 147|2@0+ (1,0) [0|3] ""  ADC,IFC,FAPA
 SG_ ACU_NDASwitchReq : 153|2@0+ (1,0) [0|3] ""  ADC,IFC,FAPA
 SG_ ACU_NDALCConSwitchReq : 155|2@0+ (1,0) [0|3] ""  ADC,IFC,FAPA
 SG_ ACU_NDALCStySwitchReq : 157|2@0+ (1,0) [0|3] ""  ADC,IFC,FAPA
 SG_ ACU_ADASWarnTypeSwitch : 159|2@0+ (1,0) [0|3] ""  ADC,IFC,FAPA
 SG_ ACU_iACC_StyleConfirmSwitchReq : 177|2@0+ (1,0) [0|3] ""  ADC,IFC,FAPA
 SG_ ACU_IFC_SpeedLimit : 167|8@0+ (1,0) [0|255] "km/h"  ADC,IFC,FAPA
 SG_ ACU_IFC_ISDRestOfdis : 175|8@0+ (0.1,0) [0|70] "km"  ADC,IFC,FAPA
 SG_ ACU_IFC_SpeedLimitUnit : 183|2@0+ (1,0) [0|3] ""  ADC,IFC,FAPA
 SG_ ACU_ThemeType : 196|1@0+ (1,0) [0|1] ""  ADC,IFC,FAPA
 SG_ ACU_IFC_SpeedLimtType : 187|4@0+ (1,0) [0|15] ""  ADC,IFC,FAPA
 SG_ ACU_IFC_RoadType : 191|4@0+ (1,0) [0|15] ""  ADC,IFC,FAPA
 SG_ ACU_IFC_ZoneCode : 199|3@0+ (1,0) [0|7] ""  ADC,IFC,FAPA
 SG_ ACU_IFC_NaviSt : 195|2@0+ (1,0) [0|3] ""  ADC,IFC,FAPA
 SG_ ACU_IFC_NaviCorp : 207|3@0+ (1,0) [0|7] ""  ADC,IFC,FAPA
 SG_ ACU_IFC_NaviNewIconDis : 204|5@0+ (0.1,0) [0|2] "km"  ADC,IFC,FAPA
 SG_ ACU_IFC_OfframpSt : 192|1@0+ (1,0) [0|1] ""  ADC,IFC,FAPA
 SG_ ACU_IFC_NaviNewIcon : 211|4@0+ (1,0) [0|15] ""  ADC,IFC,FAPA
 SG_ ACU_IFC_SLCAheadDis : 223|8@0+ (5,0) [0|1250] "m"  ADC,IFC,FAPA
 SG_ ACU_DVR_Switch : 193|1@0+ (1,0) [0|1] ""  ADC,IFC,FAPA
 SG_ ACU_IFC_OfframpDis : 231|8@0+ (10,0) [0|2000] "m"  ADC,IFC,FAPA
 SG_ SSW_DRSeatSlideCurrentPst : 239|8@0+ (0.5,0) [0|100] "%"  ADC,FAPA
 SG_ SSW_DRSeatHeightCurrentPst : 247|8@0+ (0.5,0) [0|100] "%"  ADC,FAPA
 SG_ SSW_DRSeatBackrestCurrentPst : 255|8@0+ (0.5,0) [0|100] "%"  ADC,FAPA
 SG_ DrvrSideMotResp : 263|4@0+ (1,0) [0|15] ""  ADC,IFC,FAPA
 SG_ IPDS_BAT1PowerSt : 280|1@0+ (1,0) [0|1] ""  ADC,FAPA
 SG_ IPDS_BAT2PowerSt : 299|1@0+ (1,0) [0|1] ""  ADC,FAPA
 SG_ IPDS_DCDC2PowerSt : 311|1@0+ (1,0) [0|1] ""  ADC,FAPA
 SG_ IPDS_GridIsoPowerSt : 310|1@0+ (1,0) [0|1] ""  ADC,FAPA

BO_ 935 CCU_SRM_1: 8 CCU_CCURT1
 SG_ SR_SunroofCurrentPst : 7|8@0+ (0.5,0) [0|255] "%"  ZCUR,IDC,IMR,ADC,SBM

BO_ 957 CCU_ZCUL_HOD_1: 8 CCU
 SG_ HOD_1_CRC : 7|8@0+ (1,0) [0|255] ""  ADC,IFC,FAPA
 SG_ HOD_1_Counter : 11|4@0+ (1,0) [0|14] ""  ADC,IFC,FAPA
 SG_ HOD_St : 15|4@0+ (1,0) [0|15] ""  ADC,IFC,FAPA
 SG_ HOD_TouchZone1 : 16|1@0+ (1,0) [0|1] ""  ADC,IFC,FAPA
 SG_ HOD_TouchZone2 : 17|1@0+ (1,0) [0|1] ""  ADC,IFC,FAPA
 SG_ HOD_TouchZone3 : 18|1@0+ (1,0) [0|1] ""  ADC,IFC,FAPA
 SG_ HOD_HeatingSt : 20|2@0+ (1,0) [0|3] ""  ADC,IFC,FAPA
 SG_ HOD_CalibrationSt : 22|1@0+ (1,0) [0|1] ""  ADC,IFC,FAPA
 SG_ HOD_LINComFault : 23|1@0+ (1,0) [0|1] ""  ADC,IFC,FAPA
 SG_ HOD_FaultSt : 24|1@0+ (1,0) [0|1] ""  ADC,IFC,FAPA
 SG_ HOD_VBattOORFault : 25|1@0+ (1,0) [0|1] ""  ADC,IFC,FAPA
 SG_ HOD_HeatingOtherFaultSt : 26|1@0+ (1,0) [0|1] ""  ADC,IFC,FAPA
 SG_ HOD_HeatingOverUnderCurrentSt : 27|1@0+ (1,0) [0|1] ""  ADC,IFC,FAPA
 SG_ HOD_HeatingThermSt : 28|1@0+ (1,0) [0|1] ""  ADC,IFC,FAPA
 SG_ HOD_HeatingTempOutSt : 29|1@0+ (1,0) [0|1] ""  ADC,IFC,FAPA
 SG_ HOD_Typ : 61|3@0+ (1,0) [0|7] ""  ADC,IFC,FAPA
 SG_ HOD_TouchIntensityZone1 : 39|8@0+ (1,0) [0|255] ""  ADC,IFC,FAPA
 SG_ HOD_TouchIntensityZone2 : 47|8@0+ (1,0) [0|255] ""  ADC,IFC,FAPA
 SG_ HOD_TouchIntensityZone3 : 55|8@0+ (1,0) [0|255] ""  ADC,IFC,FAPA
 SG_ HOD_SysErr : 58|2@0+ (1,0) [0|3] ""  ADC,IFC,FAPA

BO_ 360 CCU_BCS_6_C: 64 CCU
 SG_ BCS_6_CRC : 7|16@0+ (1,0) [0|65535] ""  ADC,IFC,FAPA
 SG_ BCS_6_Counter : 23|8@0+ (1,0) [0|255] ""  ADC,IFC,FAPA
 SG_ BCS_HydBrkActTorqFL : 31|16@0+ (1,-32768) [-32768|32767] "Nm"  ADC,IFC,FAPA
 SG_ BCS_HydBrkActTorqFR : 47|16@0+ (1,-32768) [-32768|32767] "Nm"  ADC,IFC,FAPA
 SG_ BCS_HydBrkActTorqRL : 63|16@0+ (1,-32768) [-32768|32767] "Nm"  ADC,IFC,FAPA
 SG_ BCS_HydBrkActTorqRR : 79|16@0+ (1,-32768) [-32768|32767] "Nm"  ADC,IFC,FAPA
 SG_ BCS_HydBrkTorqReq : 95|16@0+ (1,-32768) [-32768|32767] "Nm"  ADC,IFC,FAPA
 SG_ BCS_BrkActTorq : 111|16@0+ (1,-32768) [-32768|32767] "Nm"  ADC,IFC,FAPA
 SG_ BCS_HydBrkActTorq : 127|16@0+ (1,-32768) [-32768|32767] "Nm"  ADC,IFC,FAPA
 SG_ BCS_DycActTorq : 143|16@0+ (1,-32768) [-32768|32767] "Nm"  ADC,IFC,FAPA
 SG_ BCS_ChVehSpd : 156|13@0+ (0.05625,0) [0|240] "km/h"  ADC,IFC,FAPA
 SG_ BCS_BrkTqCtrlAvlDriving : 159|3@0+ (1,0) [0|7] ""  ADC,IFC,FAPA
 SG_ BCS_BrkTqCtrlAvlParking : 173|2@0+ (1,0) [0|3] ""  ADC,IFC,FAPA
 SG_ BCS_BrkTqCtrlActv : 175|2@0+ (1,0) [0|3] ""  ADC,IFC,FAPA
 SG_ BCS_ChVehSpdVD : 188|1@0+ (1,0) [0|1] ""  ADC,IFC,FAPA
 SG_ BCS_ESCFailSt : 189|1@0+ (1,0) [0|1] ""  ADC,IFC,FAPA
 SG_ BCS_ESCFuncActiveSt : 190|1@0+ (1,0) [0|1] ""  ADC,IFC,FAPA
 SG_ BCS_DycEscTarTqCtrlAvl : 191|1@0+ (1,0) [0|1] ""  ADC,IFC,FAPA
 SG_ BCS_errorFb : 215|4@0+ (1,0) [0|15] ""  ADC,IFC,FAPA
 SG_ BCS_DrvrBrkOvrd : 217|1@0+ (1,0) [0|1] ""  ADC,IFC,FAPA
 SG_ BCS_DrvrBrkOvrdVD : 218|1@0+ (1,0) [0|1] ""  ADC,IFC,FAPA
 SG_ BCS_DycEscTarTqActv : 219|1@0+ (1,0) [0|1] ""  ADC,IFC,FAPA
 SG_ BCS_WheelSlipFLVD : 220|1@0+ (1,0) [0|1] ""  ADC,IFC,FAPA
 SG_ BCS_WheelSlipFRVD : 221|1@0+ (1,0) [0|1] ""  ADC,IFC,FAPA
 SG_ BCS_WheelSlipRLVD : 222|1@0+ (1,0) [0|1] ""  ADC,IFC,FAPA
 SG_ BCS_WheelSlipRRVD : 223|1@0+ (1,0) [0|1] ""  ADC,IFC,FAPA
 SG_ BCS_DrvrReqBrkTorq : 231|16@0+ (1,-32768) [-32768|32767] "Nm"  ADC,IFC,FAPA
 SG_ BCS_BrkTarRecpTorqFA : 247|14@0+ (1,-6000) [-6000|10380] "Nm"  ADC,IFC,FAPA
 SG_ BCS_BrkTarRecpTorqFASt : 249|2@0+ (1,0) [0|3] ""  ADC,IFC,FAPA
 SG_ BCS_BrkTarRecpTorqRA : 263|14@0+ (1,-6000) [-6000|10380] "Nm"  ADC,IFC,FAPA
 SG_ BCS_BrkTarRecpTorqRASt : 265|2@0+ (1,0) [0|3] ""  ADC,IFC,FAPA
 SG_ BCS_BrkTarRecpTorq : 279|14@0+ (1,-6000) [-6000|10380] "Nm"  ADC,IFC,FAPA
 SG_ BCS_BrkTarRecpTorqSt : 281|2@0+ (1,0) [0|3] ""  ADC,IFC,FAPA
 SG_ BCS_BrkTqCtrlAvlParkingRdn : 187|3@0+ (1,0) [0|7] ""  ADC,IFC,FAPA
 SG_ BCS_WheelSlipFL : 199|8@0+ (0.004,0) [0|1.002] ""  ADC,IFC,FAPA
 SG_ BCS_WheelSlipFR : 207|8@0+ (0.004,0) [0|1.002] ""  ADC,IFC,FAPA
 SG_ BCS_WheelSlipRL : 343|8@0+ (0.004,0) [0|1.002] ""  ADC,IFC,FAPA
 SG_ BCS_WheelSlipRR : 351|8@0+ (0.004,0) [0|1.002] ""  ADC,IFC,FAPA
 SG_ BCS_EngTorqDecFastRL : 295|14@0+ (1,-6000) [-6000|10380] "Nm"  ADC,IFC,FAPA
 SG_ BCS_EngTorqDecActiveStRL : 183|1@0+ (1,0) [0|1] ""  ADC,IFC,FAPA
 SG_ BCS_EngTorqDecFastRR : 297|14@0+ (1,-6000) [-6000|10380] "Nm"  ADC,IFC,FAPA
 SG_ BCS_EngTorqDecActiveStRR : 216|1@0+ (1,0) [0|1] ""  ADC,IFC,FAPA
 SG_ BCS_ICCSt : 182|1@0+ (1,0) [0|1] ""  ADC,IFC,FAPA
 SG_ BCS_ICCAvl : 184|1@0+ (1,0) [0|1] ""  ADC,IFC,FAPA
 SG_ BCS_ICCErrFb : 181|4@0+ (1,0) [0|15] ""  ADC,IFC,FAPA
 SG_ BCS_SimulatorPressureSt_1 : 436|1@0+ (1,0) [0|1] ""  ADC,IFC,FAPA
 SG_ BCS_SysSt_1 : 439|3@0+ (1,0) [0|7] ""  ADC,IFC,FAPA
 SG_ BCS_FWAWarning_1 : 425|2@0+ (1,0) [0|3] ""  ADC,IFC,FAPA
 SG_ BCS_CSTSt_1 : 427|2@0+ (1,0) [0|3] ""  ADC,IFC,FAPA
 SG_ BCS_AVDCActive_1 : 428|1@0+ (1,0) [0|1] ""  ADC,IFC,FAPA
 SG_ BCS_AVDCAvailable_1 : 429|1@0+ (1,0) [0|1] ""  ADC,IFC,FAPA
 SG_ BCS_SimulatorPressure_1 : 435|12@0+ (0.1,-5) [-5|301.9] "bar"  ADC,IFC,FAPA

BO_ 475 CCU_IDC_4: 64 CCU
 SG_ ACU_MirrSteeringAdjFlag : 409|2@0+ (1,0) [0|3] ""  ADC,IFC,FAPA

BO_ 351 CCU_IDC_2: 64 CCU
 SG_ ACU_VirtualPowerOFFReq : 31|1@0+ (1,0) [0|1] ""  ZCUL,ADC,FAPA
 SG_ ACU_Account_Uld : 171|4@0+ (1,0) [0|15] ""  ADC,IFC,FAPA
 SG_ ACU_FactoryResetReq : 174|1@0+ (1,0) [0|1] ""  ZCUR,IBCS,ADC,IFC,FAPA,DLPML,DLPMR
 SG_ ACU_Account_Delete : 183|8@0+ (1,0) [0|255] ""  ZCUL,ADC,IFC,FAPA
 SG_ ACU_FrontWiperIntCfgVkReq : 191|4@0+ (1,0) [0|15] ""  ZCUL,ADC,IFC,FAPA
 SG_ ACU_FrontWiperAutoCfgVkReq : 187|4@0+ (1,0) [0|15] ""  ZCUL,ADC,IFC,FAPA
 SG_ IDC_VoicePAAReq : 364|1@0+ (1,0) [0|1] ""  ZCUR,ADC
 SG_ IDC_VoiceParkCheckReq : 365|1@0+ (1,0) [0|1] ""  ZCUR,ADC

BO_ 776 CCU_ZCUL_3: 64 CCU
 SG_ ZCUL_3_CRC : 7|16@0+ (1,0) [0|65535] ""  ADC,IFC
 SG_ ZCUL_3_Counter : 23|8@0+ (1,0) [0|255] ""  ADC,IFC
 SG_ EL_LeftBSDIndicatorSt : 26|1@0+ (1,0) [0|1] ""  ADC,IFC
 SG_ UINM_HazardLightSwSt : 39|1@0+ (1,0) [0|1] ""  ICM,IDC,ADC,IFC
 SG_ EL_MLTurnLightSt : 35|2@0+ (1,0) [0|3] ""  ICM,IDC,ADC,IFC
 SG_ EL_MLTurnLightFaultSt : 33|1@0+ (1,0) [0|1] ""  ICM,IDC,ADC,IFC
 SG_ EL_LeftBSDIndicatorFaultSt : 48|1@0+ (1,0) [0|1] ""  ADC,IFC
 SG_ EL_MLADASLightSt : 211|2@0+ (1,0) [0|3] ""  ADC,IFC
 SG_ ZCUL_FrtWindshildHeatSt : 249|2@0+ (1,0) [0|3] ""  ADC,IFC

BO_ 967 CCU_IDC_DMS_1: 64 CCU
 SG_ DMS_1_CRC : 7|16@0+ (1,0) [0|65535] ""  ADC,IFC,FAPA
 SG_ DMS_1_Counter : 23|8@0+ (1,0) [0|255] ""  ADC,IFC,FAPA
 SG_ DMS_SysErrSt : 31|3@0+ (1,0) [0|7] ""  ADC,IFC,FAPA
 SG_ DMS_DrvrDetSts : 28|3@0+ (1,0) [0|7] ""  ADC,IFC,FAPA
 SG_ DMS_InterestsRegion : 39|5@0+ (1,0) [0|31] ""  ADC,IFC,FAPA
 SG_ DMS_L3DriverDistractionSt : 33|6@0+ (1,0) [0|63] ""  ADC,IFC,FAPA
 SG_ DMS_L3DriverFatigueSt : 43|12@0+ (1,0) [0|4095] ""  ADC,IFC,FAPA
 SG_ DMS_FaceIDStatus : 60|2@0+ (1,0) [0|3] ""  ADC,IFC,FAPA
 SG_ DMS_FaceID : 58|4@0+ (1,0) [0|15] ""  ADC,IFC,FAPA
 SG_ DMS_LeftEyeOpenSt : 64|2@0+ (1,0) [0|3] ""  ADC,IFC,FAPA
 SG_ DMS_RightEyeOpenSt : 78|2@0+ (1,0) [0|3] ""  ADC,IFC,FAPA
 SG_ DMS_DriverSmokeSt : 74|2@0+ (1,0) [0|3] ""  ADC,IFC,FAPA
 SG_ DMS_DriverTelephoneSt : 72|2@0+ (1,0) [0|3] ""  ADC,IFC,FAPA
 SG_ DMS_DriverHealthSt : 86|3@0+ (1,0) [0|7] ""  ADC,IFC,FAPA
 SG_ DMS_FatigWarnSt : 81|3@0+ (1,0) [0|7] ""  ADC,IFC,FAPA
 SG_ DMS_DistrWarnSt : 94|3@0+ (1,0) [0|7] ""  ADC,IFC,FAPA
 SG_ DMS_DistEyeBowCenter : 147|11@0+ (1,0) [0|2047] "mm"  WHUD,ADC,IFC,FAPA
 SG_ DMS_FaceIDVerifyResult : 264|4@0+ (1,0) [0|15] ""  ADC,IFC,FAPA
 SG_ DMS_YawnSt : 276|2@0+ (1,0) [0|3] ""  ADC,IFC,FAPA

BO_ 342 CCU_ZCUR_8: 64 CCU
 SG_ ZCUR_8_CRC : 7|16@0+ (1,0) [0|65535] ""  ADC,IFC,FAPA
 SG_ ZCUR_8_Counter : 23|8@0+ (1,0) [0|255] ""  ADC,IFC,FAPA
 SG_ KAE_PassiveUnlockReq : 25|1@0+ (1,0) [0|1] ""  ADC,FAPA
 SG_ KAE_PassiveLockReq : 38|1@0+ (1,0) [0|1] ""  ADC,FAPA
 SG_ KAE_FOB1Position : 111|4@0+ (1,0) [0|15] ""  IDC,ADC,FAPA
 SG_ KAE_FOB2Position : 107|4@0+ (1,0) [0|15] ""  IDC,ADC,FAPA
 SG_ KAE_FOB3Position : 119|4@0+ (1,0) [0|15] ""  IDC,ADC,FAPA
 SG_ KAE_FOB2UnlockBtnPressS : 177|2@0+ (1,0) [0|3] ""  ADC,FAPA
 SG_ KAE_FOB2LockBtnPressSt : 179|2@0+ (1,0) [0|3] ""  ADC,FAPA
 SG_ KAE_FOB2TrunkBtnPressSt : 187|2@0+ (1,0) [0|3] ""  ADC,FAPA
 SG_ KAE_FOB2User_definedBtnPressSt : 191|2@0+ (1,0) [0|3] ""  ADC,FAPA
 SG_ KAE_FOB3UnlockBtnPressS : 169|2@0+ (1,0) [0|3] ""  ADC,FAPA
 SG_ KAE_FOB3LockBtnPressSt : 171|2@0+ (1,0) [0|3] ""  ADC,FAPA
 SG_ KAE_FOB3TrunkBinPressSt : 173|2@0+ (1,0) [0|3] ""  ADC,FAPA
 SG_ KAE_FOB3User_defnedBtnPressst : 175|2@0+ (1,0) [0|3] ""  ADC,FAPA
 SG_ KAE_FOBUnlockBtnPressSt : 199|2@0+ (1,0) [0|3] ""  ICM,IDC,ADC,IFC,FAPA
 SG_ KAE_FOBLockBtnPressSt : 197|2@0+ (1,0) [0|3] ""  ICM,IDC,ADC,IFC,FAPA
 SG_ KAE_FOBRESBtnPressSt : 195|2@0+ (1,0) [0|3] ""  ICM,IDC,ADC,IFC,FAPA
 SG_ KAE_FOBPSD_LBtnPressSt : 193|2@0+ (1,0) [0|3] ""  ICM,IDC,ADC,IFC,FAPA
 SG_ KAE_FOBPSD_RBtnPressSt : 207|2@0+ (1,0) [0|3] ""  ICM,IDC,ADC,IFC,FAPA
 SG_ KAE_FOBTrunkBtnPressSt : 205|2@0+ (1,0) [0|3] ""  ICM,IDC,ADC,IFC,FAPA
 SG_ KAE_FOBPanicBtnPressSt : 203|2@0+ (1,0) [0|3] ""  ICM,IDC,ADC,IFC,FAPA
 SG_ KAE_FOBUser_definedBtnPressSt : 201|2@0+ (1,0) [0|3] ""  ICM,IDC,ADC,IFC,FAPA
 SG_ KAE_FOB2RESBtnPressSt : 181|2@0+ (1,0) [0|3] ""  ADC,FAPA
 SG_ KAE_FOB2PanicBtnPressSt : 189|2@0+ (1,0) [0|3] ""  ADC,FAPA

BO_ 512 CCU_ZCUR_SBM_2: 64 CCU
 SG_ KAE_BLE1Position : 31|3@0+ (1,0) [0|7] ""  IDC,ADC,FAPA
 SG_ KAE_BLE2Position : 28|3@0+ (1,0) [0|7] ""  IDC,ADC,FAPA
 SG_ KAE_BLE3Position : 39|3@0+ (1,0) [0|7] ""  IDC,ADC,FAPA
 SG_ KAE_BLE4Position : 36|3@0+ (1,0) [0|7] ""  IDC,ADC,FAPA
 SG_ KAE_BLE5Position : 47|3@0+ (1,0) [0|7] ""  IDC,ADC,FAPA
 SG_ KAE_BLE1AuthSt : 137|2@0+ (1,0) [0|3] ""  ADC
 SG_ KAE_BLE2AuthSt : 151|2@0+ (1,0) [0|3] ""  ADC
 SG_ KAE_BLE3AuthSt : 149|2@0+ (1,0) [0|3] ""  ADC
 SG_ KAE_BLE4AuthSt : 147|2@0+ (1,0) [0|3] ""  ADC
 SG_ KAE_BLE5AuthSt : 145|2@0+ (1,0) [0|3] ""  ADC
 SG_ KAE_BLE1PKSPosition : 420|3@0+ (1,0) [0|7] ""  IDC,ADC
 SG_ KAE_BLE2PKSPosition : 423|3@0+ (1,0) [0|7] ""  IDC,ADC
 SG_ KAE_BLE3PKSPosition : 427|3@0+ (1,0) [0|7] ""  IDC,ADC
 SG_ KAE_BLE4PKSPosition : 430|3@0+ (1,0) [0|7] ""  IDC,ADC
 SG_ KAE_BLE5PKSPosition : 417|3@0+ (1,0) [0|7] ""  IDC,ADC

BO_ 939 CCU_SRS_2: 32 CCU
 SG_ SRS_PsngrSeatBeltSt : 31|2@0+ (1,0) [0|3] ""  ICM,IDC,ADC,IFC,FAPA,TBOX2,TBOX
 SG_ SRS_DriverSeatBeltSt : 29|2@0+ (1,0) [0|3] ""  ZCUF,ZCUL,ZCUR,ZCUT,ICM,IDC,ADC,IFC,FAPA,TBOX2,TBOX
 SG_ SRS_RearLeftSeatBeltSt : 27|2@0+ (1,0) [0|3] ""  ICM,IDC,ADC,IFC,FAPA,TBOX2,TBOX
 SG_ SRS_AirbagFaultSt : 25|1@0+ (1,0) [0|1] ""  ICM,IID,IDC,ADC,FAPA,TBOX
 SG_ SRS_RearRightSeatBeltSt : 39|2@0+ (1,0) [0|3] ""  ICM,IDC,ADC,IFC,FAPA,TBOX2,TBOX
 SG_ SRS_RearMiddleSeatBeltSt : 37|2@0+ (1,0) [0|3] ""  ICM,IDC,ADC,IFC,FAPA,TBOX2,TBOX

CM_ SG_ 904 ACU_PCS_SVM_MODCmd "Panorama function setting option MOD function switch";
CM_ SG_ 904 ACU_HeadLightVirtualSwSt "HeadLight virtual switch status";
CM_ SG_ 904 ACU_FrontFogLightVirtualSwSt "Front fog light virtual switch status";
CM_ SG_ 904 ACU_RearFogLightVirtualSwSt "Rear fog light virtual switch status";
CM_ SG_ 904 ACU_Account_Uid "Account_Uid";
CM_ SG_ 904 ACU_IHBC_SwitchReq "IHBC(Intelligent High Beam Control) switch signal";
CM_ SG_ 904 ACU_NDASwitchReq "NDA main switch request";
CM_ SG_ 904 ACU_NDALCConSwitchReq "NDA lane change driver confirm switch request";
CM_ SG_ 904 ACU_NDALCStySwitchReq "NDA lane change style switch request";
CM_ SG_ 904 ACU_ADASWarnTypeSwitch "ADAS warning type switch signal";
CM_ SG_ 904 ACU_iACC_StyleConfirmSwitchReq "iACC Style confirm switch";
CM_ SG_ 904 ACU_IFC_SpeedLimit "Speed limit value from navigation map dataand GPS location.";
CM_ SG_ 904 ACU_IFC_ISDRestOfdis "Interval speed detection rest of distacne.Once navigation jduge vehicle run in aninterval speed detection area of road, thissignal begin to send specific value,otherwise keep sending 0x0.";
CM_ SG_ 904 ACU_IFC_SpeedLimitUnit "Speed limit unit ";
CM_ SG_ 904 ACU_ThemeType "AVNT theme type";
CM_ SG_ 904 ACU_IFC_SpeedLimtType "speed limit type from navigation map dataand GPS location.";
CM_ SG_ 904 ACU_IFC_RoadType "Road type from navigation map data andGPS location.";
CM_ SG_ 904 ACU_IFC_ZoneCode "Zone code ";
CM_ SG_ 904 ACU_IFC_NaviSt "Navigation state ";
CM_ SG_ 904 ACU_IFC_NaviCorp "the working navigation map corporation ";
CM_ SG_ 904 ACU_IFC_NaviNewIconDis "the remain distances of navigation newIcon ";
CM_ SG_ 904 ACU_IFC_OfframpSt "The front is off-ramp or not whennavigation";
CM_ SG_ 904 ACU_IFC_NaviNewIcon "indication the navigation newIcon ";
CM_ SG_ 904 ACU_IFC_SLCAheadDis "speed limit camera ahead distacne. Oncenavigation jduge there is a speed limitcamera ahead that the vehicle will pass by,this signal begin to send specific value,otherwise keep sending 0x0.";
CM_ SG_ 904 ACU_DVR_Switch "DVR Function Switch";
CM_ SG_ 904 ACU_IFC_OfframpDis "The distance to front off-ramp ";
CM_ SG_ 904 SSW_DRSeatSlideCurrentPst "Driver Seat Slide Current  Position Percentage";
CM_ SG_ 904 SSW_DRSeatHeightCurrentPst "Driver Seat Height Current  Position Percentage ";
CM_ SG_ 904 SSW_DRSeatBackrestCurrentPst "Driver Seat Backrest Current  Position Percentage ";
CM_ SG_ 904 DrvrSideMotResp "Driver Side Seat Belt Motor Response";
CM_ SG_ 904 IPDS_BAT1PowerSt "BAT1 power  state";
CM_ SG_ 904 IPDS_BAT2PowerSt "BAT2 power  state";
CM_ SG_ 904 IPDS_DCDC2PowerSt "DCDC2 power  state";
CM_ SG_ 904 IPDS_GridIsoPowerSt "Grid Isolation Power State";
CM_ SG_ 935 SR_SunroofCurrentPst "Sunroof current Position";
CM_ SG_ 957 HOD_1_CRC "E2E Profile 1 CRC";
CM_ SG_ 957 HOD_1_Counter "E2E Profile 1 Counter";
CM_ SG_ 957 HOD_St "Indicating the working status of HOD function.";
CM_ SG_ 957 HOD_TouchZone1 "Indicating Zone 1 touch status";
CM_ SG_ 957 HOD_TouchZone2 "Indicating Zone 2 touch status";
CM_ SG_ 957 HOD_TouchZone3 "Indicating Zone 3 touch status";
CM_ SG_ 957 HOD_HeatingSt "Indicating the working status of steering heating function.";
CM_ SG_ 957 HOD_CalibrationSt "Open Wheel Recalibration Status";
CM_ SG_ 957 HOD_LINComFault "J2602 LIN Communication Status";
CM_ SG_ 957 HOD_FaultSt "Indicating Capacity sensor Erro ";
CM_ SG_ 957 HOD_VBattOORFault "Indicating Battery Voltage Out of Range Fault";
CM_ SG_ 957 HOD_HeatingOtherFaultSt "Indicating Heating Fault status";
CM_ SG_ 957 HOD_HeatingOverUnderCurrentSt "Indicating Heating over current or under current fault status";
CM_ SG_ 957 HOD_HeatingThermSt "Indicating Heating thermistor fault";
CM_ SG_ 957 HOD_HeatingTempOutSt "indaicating the set temperature is not reached within the specified time";
CM_ SG_ 957 HOD_Typ "Indicating HOD zone type";
CM_ SG_ 957 HOD_TouchIntensityZone1 " intensity of Zone1 ";
CM_ SG_ 957 HOD_TouchIntensityZone2 " intensity of Zone2";
CM_ SG_ 957 HOD_TouchIntensityZone3 " intensity of Zone3";
CM_ SG_ 957 HOD_SysErr "HOD Error information";
CM_ SG_ 360 BCS_6_CRC "E2E Profile 5 CRC";
CM_ SG_ 360 BCS_6_Counter "E2E Profile 5 Counter";
CM_ SG_ 360 BCS_HydBrkActTorqFL "Hydraulic brake torque of the  front left wheel";
CM_ SG_ 360 BCS_HydBrkActTorqFR "Hydraulic brake torque of the  front right wheel";
CM_ SG_ 360 BCS_HydBrkActTorqRL "Hydraulic brake torque of the  rear left wheel";
CM_ SG_ 360 BCS_HydBrkActTorqRR "Hydraulic brake torque of the  rear right wheel";
CM_ SG_ 360 BCS_HydBrkTorqReq "It is the target brake torque to hydraulic brake";
CM_ SG_ 360 BCS_BrkActTorq "It is the real total brake  torque carried out by electric motor（ recuperation torque or electric brake torque）and ESC/IBCS（hydraulic braketorque）.";
CM_ SG_ 360 BCS_HydBrkActTorq "It is the real hydraulic brake  torque carried out by ESC/IBCS.";
CM_ SG_ 360 BCS_DycActTorq "The real  DYC(Direct  yaw moment control)  of the ESC/IBCS";
CM_ SG_ 360 BCS_ChVehSpd "Vehicle characteristic speed ";
CM_ SG_ 360 BCS_BrkTqCtrlAvlDriving "It indicates  whether ESC/IBCS is available for cruise function.";
CM_ SG_ 360 BCS_BrkTqCtrlAvlParking "It indicates  whether ESC/IBCS is available for parking function.";
CM_ SG_ 360 BCS_BrkTqCtrlActv "It indicates  whether ESC/IBCS is  responsed for the brake request of ADAS.";
CM_ SG_ 360 BCS_ChVehSpdVD "Quality/fault information to vehicle  characteristic speed ";
CM_ SG_ 360 BCS_ESCFailSt "It indicates whether ESC/IBCS is error.When any function of ESC/IBCS is error ，it will be error。";
CM_ SG_ 360 BCS_ESCFuncActiveSt "It indicates whether ESC/IBCS is active. When any function of ESC/IBCS is active ，it will be active。";
CM_ SG_ 360 BCS_DycEscTarTqCtrlAvl "The validity  of the DYC(Direct  yaw moment control)  of the ESC/IBCS";
CM_ SG_ 360 BCS_errorFb "Errors related to the braking system(ESP/IPB).It indicates the braking system can not respond to the deceleration request（brake torque） of the ADAS。";
CM_ SG_ 360 BCS_DrvrBrkOvrd "Indicate driver brakes torque more than the ADAS/ADS. ";
CM_ SG_ 360 BCS_DrvrBrkOvrdVD "The validity  of  BCS_DrvrBrkOvrd";
CM_ SG_ 360 BCS_DycEscTarTqActv "Indicates the DYC of the ESC/IBCS in active or not";
CM_ SG_ 360 BCS_WheelSlipFLVD "The validity  of slip ratio of the  front left wheel";
CM_ SG_ 360 BCS_WheelSlipFRVD "The validity of slip ratio of the  front right wheel";
CM_ SG_ 360 BCS_WheelSlipRLVD "The validity of slip ratio of the  rear left wheel";
CM_ SG_ 360 BCS_WheelSlipRRVD "The validity of slip ratio of the  rear right wheel";
CM_ SG_ 360 BCS_DrvrReqBrkTorq "When driver prsees brake pedal，It is the brake torque calculated by ESC/IBCS corresponding to  inputRod stroke.";
CM_ SG_ 360 BCS_BrkTarRecpTorqFA "CRBS target recuperation torque requested by BCS to generator,applies to  front wheel drive ";
CM_ SG_ 360 BCS_BrkTarRecpTorqFASt "Status of BCS_BrkRecpTorqRqFA";
CM_ SG_ 360 BCS_BrkTarRecpTorqRA "CRBS target recuperation torque requested by BCS to generator,applies to  rear wheel drive ";
CM_ SG_ 360 BCS_BrkTarRecpTorqRASt "Status of BCS_BrkRecpTorqRqRA";
CM_ SG_ 360 BCS_BrkTarRecpTorq "CRBS target recuperation torque requested by BCS to generator,applies to 4WD and front wheel drive /rear wheel drive";
CM_ SG_ 360 BCS_BrkTarRecpTorqSt "CRBS target recuperation torque requested by BCS to generator,applies to 4WD and front wheel drive /rear wheel drive";
CM_ SG_ 360 BCS_BrkTqCtrlAvlParkingRdn "It indicates  whether ESP/IPB is available for parking function,in redunant mode,including L3/L4/L5.";
CM_ SG_ 360 BCS_WheelSlipFL "Slip ratio of the  front left wheel";
CM_ SG_ 360 BCS_WheelSlipFR "Slip ratio of the  front right wheel";
CM_ SG_ 360 BCS_WheelSlipRL "Slip ratio of the  rear left wheel";
CM_ SG_ 360 BCS_WheelSlipRR "Slip ratio of the  rear right wheel";
CM_ SG_ 360 BCS_EngTorqDecFastRL "Target torque(fast) is decreased  for left rear wheel hub motor";
CM_ SG_ 360 BCS_EngTorqDecActiveStRL "Status of target torque(fast) is decreased  for left rear wheel hub motor";
CM_ SG_ 360 BCS_EngTorqDecFastRR "Target torque(fast) is decreased  for right rear wheel hub motor";
CM_ SG_ 360 BCS_EngTorqDecActiveStRR "Status of target torque(fast) is decreased  for right rear wheel hub motor";
CM_ SG_ 360 BCS_ICCSt "BCS enables a response signal to the ICC brake interface";
CM_ SG_ 360 BCS_ICCAvl "BCS is available for ICC interface";
CM_ SG_ 360 BCS_ICCErrFb "The IBCS responds to the cause feedback of the ICCS brake interface exception";
CM_ SG_ 360 BCS_SimulatorPressureSt_1 "Indicate simulator pressure status";
CM_ SG_ 360 BCS_SysSt_1 "IBCS system state";
CM_ SG_ 360 BCS_FWAWarning_1 "Indicate FWA state, dashboard need warn driver";
CM_ SG_ 360 BCS_CSTSt_1 "indicates CST status. Only valid for project with CST function.";
CM_ SG_ 360 BCS_AVDCActive_1 "Indicate AVDC deceleration active or not";
CM_ SG_ 360 BCS_AVDCAvailable_1 "Indicate AVDC deceleration available ornot";
CM_ SG_ 360 BCS_SimulatorPressure_1 "Indicate simulator pressure value";
CM_ SG_ 475 ACU_MirrSteeringAdjFlag "ACU Mirror Steering wheel adjust active statue";
CM_ SG_ 351 ACU_VirtualPowerOFFReq "Virtual Power OFF Request";
CM_ SG_ 351 ACU_Account_Uld "Account_Uid";
CM_ SG_ 351 ACU_FactoryResetReq "CDC Factory Reset Request";
CM_ SG_ 351 ACU_Account_Delete "Account Delete";
CM_ SG_ 351 ACU_FrontWiperIntCfgVkReq "Front wiper interval Softkey status";
CM_ SG_ 351 ACU_FrontWiperAutoCfgVkReq "Front wiper RLS  sensitivity status";
CM_ SG_ 351 IDC_VoicePAAReq "Voice Park Request from IDC";
CM_ SG_ 351 IDC_VoiceParkCheckReq "Voice Park Check Request from IDC";
CM_ SG_ 776 ZCUL_3_CRC "E2E Profile 5 CRC";
CM_ SG_ 776 ZCUL_3_Counter "E2E Profile 5 Counter";
CM_ SG_ 776 EL_LeftBSDIndicatorSt "Left BSD indicator status";
CM_ SG_ 776 UINM_HazardLightSwSt "Hazard light switch status";
CM_ SG_ 776 EL_MLTurnLightSt "Middle left turn light status";
CM_ SG_ 776 EL_MLTurnLightFaultSt "Middle left turn light fault status";
CM_ SG_ 776 EL_LeftBSDIndicatorFaultSt "Left BSD indicator fault status";
CM_ SG_ 776 EL_MLADASLightSt "Middle left ADAS light status";
CM_ SG_ 776 ZCUL_FrtWindshildHeatSt "Front windshield heating status";
CM_ SG_ 967 DMS_1_CRC "E2E Profile 5 CRC";
CM_ SG_ 967 DMS_1_Counter "E2E Profile 5 Counter";
CM_ SG_ 967 DMS_SysErrSt "DMS system error status and person status";
CM_ SG_ 967 DMS_DrvrDetSts "States whether the driver facing camera has detected the presence of a driver.";
CM_ SG_ 967 DMS_InterestsRegion "region of interests";
CM_ SG_ 967 DMS_L3DriverDistractionSt "driver distraction state for L3";
CM_ SG_ 967 DMS_L3DriverFatigueSt "driver fatigue state for L3";
CM_ SG_ 967 DMS_FaceIDStatus "Indication FaceID Status";
CM_ SG_ 967 DMS_FaceID "FaceID";
CM_ SG_ 967 DMS_LeftEyeOpenSt "Indication Driver's Left Eye Open Status";
CM_ SG_ 967 DMS_RightEyeOpenSt "Indication Driver's Right Eye Open Status";
CM_ SG_ 967 DMS_DriverSmokeSt "Indication_DriverSmokeSt";
CM_ SG_ 967 DMS_DriverTelephoneSt "Indication_DriverTelephoneSt";
CM_ SG_ 967 DMS_DriverHealthSt "Indication_DriverHealthSt";
CM_ SG_ 967 DMS_FatigWarnSt "Indicates the fatigue level of the driver";
CM_ SG_ 967 DMS_DistrWarnSt "Provides the driver distraction determined by thedriver facing camera";
CM_ SG_ 967 DMS_DistEyeBowCenter "indicate the distance from Camera to EyeBowCenter ";
CM_ SG_ 967 DMS_FaceIDVerifyResult "Indication FaceID_Verify_result";
CM_ SG_ 967 DMS_YawnSt "Indication Driver's mouth Status";
CM_ SG_ 342 ZCUR_8_CRC "E2E Profile 5 CRC";
CM_ SG_ 342 ZCUR_8_Counter "E2E Profile 5 Counter";
CM_ SG_ 342 KAE_PassiveUnlockReq " Passive Unlock Request";
CM_ SG_ 342 KAE_PassiveLockReq "Passive Lock Request";
CM_ SG_ 342 KAE_FOB1Position " FOB1 Position";
CM_ SG_ 342 KAE_FOB2Position " FOB2 Position";
CM_ SG_ 342 KAE_FOB3Position " FOB3 Position";
CM_ SG_ 342 KAE_FOB2UnlockBtnPressS "FOB2 Unlock Button Pressed Status";
CM_ SG_ 342 KAE_FOB2LockBtnPressSt "FOB2 Lock Button Pressed Status";
CM_ SG_ 342 KAE_FOB2TrunkBtnPressSt "FOB2 Trunk Button Status";
CM_ SG_ 342 KAE_FOB2User_definedBtnPressSt "FOB2 User_defined Button Status";
CM_ SG_ 342 KAE_FOB3UnlockBtnPressS "FOB3 Unlock Button Pressed Status";
CM_ SG_ 342 KAE_FOB3LockBtnPressSt "FOB3 Lock Button Pressed Status";
CM_ SG_ 342 KAE_FOB3TrunkBinPressSt "FOB3 Trunk Button Status";
CM_ SG_ 342 KAE_FOB3User_defnedBtnPressst "FOB3 User_defined Button Status";
CM_ SG_ 342 KAE_FOBUnlockBtnPressSt "FOB Unlock Button Pressed Status";
CM_ SG_ 342 KAE_FOBLockBtnPressSt "FOB Lock Button Pressed Status";
CM_ SG_ 342 KAE_FOBRESBtnPressSt "FOB RES Button Status";
CM_ SG_ 342 KAE_FOBPSD_LBtnPressSt "FOB PSD_L Button Status";
CM_ SG_ 342 KAE_FOBPSD_RBtnPressSt "FOB PSD_R Button Status";
CM_ SG_ 342 KAE_FOBTrunkBtnPressSt "FOB Trunk Button Status";
CM_ SG_ 342 KAE_FOBPanicBtnPressSt "FOB Panic Button Status";
CM_ SG_ 342 KAE_FOBUser_definedBtnPressSt "FOB User_defined Button Status";
CM_ SG_ 342 KAE_FOB2RESBtnPressSt "FOB2 RES Button Status";
CM_ SG_ 342 KAE_FOB2PanicBtnPressSt "FOB2 Panic Button Status";
CM_ SG_ 512 KAE_BLE1Position "BLE Channel1 Key Position";
CM_ SG_ 512 KAE_BLE2Position "BLE Channel2 Key Position ";
CM_ SG_ 512 KAE_BLE3Position "BLE Channel3 Key Position ";
CM_ SG_ 512 KAE_BLE4Position "BLE Channel4 Key Position";
CM_ SG_ 512 KAE_BLE5Position "BLE Channel5 Key Position ";
CM_ SG_ 512 KAE_BLE1AuthSt "BLE Channel1 Authentication Stauts";
CM_ SG_ 512 KAE_BLE2AuthSt "BLE Channel2 Authentication Stauts";
CM_ SG_ 512 KAE_BLE3AuthSt "BLE Channel3 Authentication Stauts";
CM_ SG_ 512 KAE_BLE4AuthSt "BLE Channel4 Authentication Stauts";
CM_ SG_ 512 KAE_BLE5AuthSt "BLE Channel5 Authentication Stauts";
CM_ SG_ 512 KAE_BLE1PKSPosition "BLE Channel1 Key PKS Position";
CM_ SG_ 512 KAE_BLE2PKSPosition "BLE Channel2 Key PKS Position";
CM_ SG_ 512 KAE_BLE3PKSPosition "BLE Channel3 Key PKS Position";
CM_ SG_ 512 KAE_BLE4PKSPosition "BLE Channel4 Key PKS Position";
CM_ SG_ 512 KAE_BLE5PKSPosition "BLE Channel5 Key PKS Position";
CM_ SG_ 939 SRS_PsngrSeatBeltSt "To identify whether first row passenger seat belt is buckled.(Passenger side is the right side for the left-hand-drive vehicle, the left side for the right-hand-drive one. )";
CM_ SG_ 939 SRS_DriverSeatBeltSt "To identify whether first row driver seat belt is buckled.(Driver side is the left side for the left-hand-drive vehicle, the right side for the right-hand-drive one. )";
CM_ SG_ 939 SRS_RearLeftSeatBeltSt "To identify whetherRearDriverSeatBelt is buckled";
CM_ SG_ 939 SRS_AirbagFaultSt "To illuminate or turn off airbag warning indicator";
CM_ SG_ 939 SRS_RearRightSeatBeltSt "To identify  whetherRearPassengerSeatBelt is buckled";
CM_ SG_ 939 SRS_RearMiddleSeatBeltSt "To identify whetherRearMiddleSeatBelt is buckled";

BA_DEF_ BO_  "GenMsgCycleTime" INT 0 0;
BA_DEF_ BO_  "GenMsgCycleTimeFast" INT 0 0;
BA_DEF_ BO_  "GenMsgSendType" ENUM  "Periodic","Event","IfActive","POE","PA","FixedPeriodic","Event","EnabledPeriodic","NotUsed","NotUsed","EventPeriodic","NotUsed","NotUsed","NoMsgSendType";
BA_DEF_ BO_  "VFrameFormat" ENUM  "StandardCAN","ExtendedCAN","reserved","reserved","reserved","reserved","reserved","reserved","reserved","reserved","reserved","reserved","reserved","reserved","StandardCAN_FD","ExtendedCAN_FD";
BA_DEF_ BO_  "CANFD_BRS" ENUM  "0","1";
BA_DEF_ SG_  "EventCommandSignal" ENUM  "No","Yes";
BA_DEF_ SG_  "GatewayedSignals" ENUM  "No","Yes";
BA_DEF_ SG_  "GenSigInactiveValue" HEX 0 0;
BA_DEF_ SG_  "GenSigInvalidValue" HEX 0 0;
BA_DEF_ SG_  "GenSigSendType" ENUM  "Trigger","Passive","Cyclic","OnWrite","OnWriteWithRepetition","OnChange","OnChangeWithRepetition","IfActive","IfActiveWithRepetition","NoSigSendType";
BA_DEF_ SG_  "GenSigStartValue" HEX 0 0;
BA_DEF_ SG_  "GenSigTimeoutValue" HEX 0 0;
BA_DEF_ SG_  "Remark" STRING ;
BA_ "GenMsgCycleTime" BO_ 904 100;
BA_ "GenMsgCycleTimeFast" BO_ 904 0;
BA_ "GenMsgSendType" BO_ 904 0;
BA_ "VFrameFormat" BO_ 904 14;
BA_ "CANFD_BRS" BO_ 904 1;
BA_ "GenMsgCycleTime" BO_ 904 100;
BA_ "GenMsgCycleTimeFast" BO_ 904 0;
BA_ "GenMsgSendType" BO_ 904 0;
BA_ "VFrameFormat" BO_ 904 14;
BA_ "CANFD_BRS" BO_ 904 1;
BA_ "GenMsgCycleTime" BO_ 904 100;
BA_ "GenMsgCycleTimeFast" BO_ 904 0;
BA_ "GenMsgSendType" BO_ 904 0;
BA_ "VFrameFormat" BO_ 904 14;
BA_ "CANFD_BRS" BO_ 904 1;
BA_ "GenMsgCycleTime" BO_ 904 100;
BA_ "GenMsgCycleTimeFast" BO_ 904 0;
BA_ "GenMsgSendType" BO_ 904 0;
BA_ "VFrameFormat" BO_ 904 14;
BA_ "CANFD_BRS" BO_ 904 1;
BA_ "GenMsgCycleTime" BO_ 904 100;
BA_ "GenMsgCycleTimeFast" BO_ 904 0;
BA_ "GenMsgSendType" BO_ 904 0;
BA_ "VFrameFormat" BO_ 904 14;
BA_ "CANFD_BRS" BO_ 904 1;
BA_ "GenMsgCycleTime" BO_ 904 100;
BA_ "GenMsgCycleTimeFast" BO_ 904 0;
BA_ "GenMsgSendType" BO_ 904 0;
BA_ "VFrameFormat" BO_ 904 14;
BA_ "CANFD_BRS" BO_ 904 1;
BA_ "GenMsgCycleTime" BO_ 904 100;
BA_ "GenMsgCycleTimeFast" BO_ 904 0;
BA_ "GenMsgSendType" BO_ 904 0;
BA_ "VFrameFormat" BO_ 904 14;
BA_ "CANFD_BRS" BO_ 904 1;
BA_ "GenMsgCycleTime" BO_ 904 100;
BA_ "GenMsgCycleTimeFast" BO_ 904 0;
BA_ "GenMsgSendType" BO_ 904 0;
BA_ "VFrameFormat" BO_ 904 14;
BA_ "CANFD_BRS" BO_ 904 1;
BA_ "GenMsgCycleTime" BO_ 904 100;
BA_ "GenMsgCycleTimeFast" BO_ 904 0;
BA_ "GenMsgSendType" BO_ 904 0;
BA_ "VFrameFormat" BO_ 904 14;
BA_ "CANFD_BRS" BO_ 904 1;
BA_ "GenMsgCycleTime" BO_ 904 100;
BA_ "GenMsgCycleTimeFast" BO_ 904 0;
BA_ "GenMsgSendType" BO_ 904 0;
BA_ "VFrameFormat" BO_ 904 14;
BA_ "CANFD_BRS" BO_ 904 1;
BA_ "GenMsgCycleTime" BO_ 904 100;
BA_ "GenMsgCycleTimeFast" BO_ 904 0;
BA_ "GenMsgSendType" BO_ 904 0;
BA_ "VFrameFormat" BO_ 904 14;
BA_ "CANFD_BRS" BO_ 904 1;
BA_ "GenMsgCycleTime" BO_ 904 100;
BA_ "GenMsgCycleTimeFast" BO_ 904 0;
BA_ "GenMsgSendType" BO_ 904 0;
BA_ "VFrameFormat" BO_ 904 14;
BA_ "CANFD_BRS" BO_ 904 1;
BA_ "GenMsgCycleTime" BO_ 904 100;
BA_ "GenMsgCycleTimeFast" BO_ 904 0;
BA_ "GenMsgSendType" BO_ 904 0;
BA_ "VFrameFormat" BO_ 904 14;
BA_ "CANFD_BRS" BO_ 904 1;
BA_ "GenMsgCycleTime" BO_ 904 100;
BA_ "GenMsgCycleTimeFast" BO_ 904 0;
BA_ "GenMsgSendType" BO_ 904 0;
BA_ "VFrameFormat" BO_ 904 14;
BA_ "CANFD_BRS" BO_ 904 1;
BA_ "GenMsgCycleTime" BO_ 904 100;
BA_ "GenMsgCycleTimeFast" BO_ 904 0;
BA_ "GenMsgSendType" BO_ 904 0;
BA_ "VFrameFormat" BO_ 904 14;
BA_ "CANFD_BRS" BO_ 904 1;
BA_ "GenMsgCycleTime" BO_ 904 100;
BA_ "GenMsgCycleTimeFast" BO_ 904 0;
BA_ "GenMsgSendType" BO_ 904 0;
BA_ "VFrameFormat" BO_ 904 14;
BA_ "CANFD_BRS" BO_ 904 1;
BA_ "GenMsgCycleTime" BO_ 904 100;
BA_ "GenMsgCycleTimeFast" BO_ 904 0;
BA_ "GenMsgSendType" BO_ 904 0;
BA_ "VFrameFormat" BO_ 904 14;
BA_ "CANFD_BRS" BO_ 904 1;
BA_ "GenMsgCycleTime" BO_ 904 100;
BA_ "GenMsgCycleTimeFast" BO_ 904 0;
BA_ "GenMsgSendType" BO_ 904 0;
BA_ "VFrameFormat" BO_ 904 14;
BA_ "CANFD_BRS" BO_ 904 1;
BA_ "GenMsgCycleTime" BO_ 904 100;
BA_ "GenMsgCycleTimeFast" BO_ 904 0;
BA_ "GenMsgSendType" BO_ 904 0;
BA_ "VFrameFormat" BO_ 904 14;
BA_ "CANFD_BRS" BO_ 904 1;
BA_ "GenMsgCycleTime" BO_ 904 100;
BA_ "GenMsgCycleTimeFast" BO_ 904 0;
BA_ "GenMsgSendType" BO_ 904 0;
BA_ "VFrameFormat" BO_ 904 14;
BA_ "CANFD_BRS" BO_ 904 1;
BA_ "GenMsgCycleTime" BO_ 904 100;
BA_ "GenMsgCycleTimeFast" BO_ 904 0;
BA_ "GenMsgSendType" BO_ 904 0;
BA_ "VFrameFormat" BO_ 904 14;
BA_ "CANFD_BRS" BO_ 904 1;
BA_ "GenMsgCycleTime" BO_ 904 100;
BA_ "GenMsgCycleTimeFast" BO_ 904 0;
BA_ "GenMsgSendType" BO_ 904 0;
BA_ "VFrameFormat" BO_ 904 14;
BA_ "CANFD_BRS" BO_ 904 1;
BA_ "GenMsgCycleTime" BO_ 904 100;
BA_ "GenMsgCycleTimeFast" BO_ 904 0;
BA_ "GenMsgSendType" BO_ 904 0;
BA_ "VFrameFormat" BO_ 904 14;
BA_ "CANFD_BRS" BO_ 904 1;
BA_ "GenMsgCycleTime" BO_ 904 100;
BA_ "GenMsgCycleTimeFast" BO_ 904 0;
BA_ "GenMsgSendType" BO_ 904 0;
BA_ "VFrameFormat" BO_ 904 14;
BA_ "CANFD_BRS" BO_ 904 1;
BA_ "GenMsgCycleTime" BO_ 904 100;
BA_ "GenMsgCycleTimeFast" BO_ 904 0;
BA_ "GenMsgSendType" BO_ 904 0;
BA_ "VFrameFormat" BO_ 904 14;
BA_ "CANFD_BRS" BO_ 904 1;
BA_ "GenMsgCycleTime" BO_ 904 100;
BA_ "GenMsgCycleTimeFast" BO_ 904 0;
BA_ "GenMsgSendType" BO_ 904 0;
BA_ "VFrameFormat" BO_ 904 14;
BA_ "CANFD_BRS" BO_ 904 1;
BA_ "GenMsgCycleTime" BO_ 904 100;
BA_ "GenMsgCycleTimeFast" BO_ 904 0;
BA_ "GenMsgSendType" BO_ 904 0;
BA_ "VFrameFormat" BO_ 904 14;
BA_ "CANFD_BRS" BO_ 904 1;
BA_ "GenMsgCycleTime" BO_ 904 100;
BA_ "GenMsgCycleTimeFast" BO_ 904 0;
BA_ "GenMsgSendType" BO_ 904 0;
BA_ "VFrameFormat" BO_ 904 14;
BA_ "CANFD_BRS" BO_ 904 1;
BA_ "GenMsgCycleTime" BO_ 904 100;
BA_ "GenMsgCycleTimeFast" BO_ 904 0;
BA_ "GenMsgSendType" BO_ 904 0;
BA_ "VFrameFormat" BO_ 904 14;
BA_ "CANFD_BRS" BO_ 904 1;
BA_ "GenMsgCycleTime" BO_ 904 100;
BA_ "GenMsgCycleTimeFast" BO_ 904 0;
BA_ "GenMsgSendType" BO_ 904 0;
BA_ "VFrameFormat" BO_ 904 14;
BA_ "CANFD_BRS" BO_ 904 1;
BA_ "GenMsgCycleTime" BO_ 904 100;
BA_ "GenMsgCycleTimeFast" BO_ 904 0;
BA_ "GenMsgSendType" BO_ 904 0;
BA_ "VFrameFormat" BO_ 904 14;
BA_ "CANFD_BRS" BO_ 904 1;
BA_ "GenMsgCycleTime" BO_ 904 100;
BA_ "GenMsgCycleTimeFast" BO_ 904 0;
BA_ "GenMsgSendType" BO_ 904 0;
BA_ "VFrameFormat" BO_ 904 14;
BA_ "CANFD_BRS" BO_ 904 1;
BA_ "GenMsgCycleTime" BO_ 904 100;
BA_ "GenMsgCycleTimeFast" BO_ 904 0;
BA_ "GenMsgSendType" BO_ 904 0;
BA_ "VFrameFormat" BO_ 904 14;
BA_ "CANFD_BRS" BO_ 904 1;
BA_ "GenMsgCycleTime" BO_ 904 100;
BA_ "GenMsgCycleTimeFast" BO_ 904 0;
BA_ "GenMsgSendType" BO_ 904 0;
BA_ "VFrameFormat" BO_ 904 14;
BA_ "CANFD_BRS" BO_ 904 1;
BA_ "GenMsgCycleTime" BO_ 935 120;
BA_ "GenMsgCycleTimeFast" BO_ 935 0;
BA_ "GenMsgSendType" BO_ 935 0;
BA_ "VFrameFormat" BO_ 935 14;
BA_ "CANFD_BRS" BO_ 935 1;
BA_ "GenMsgCycleTime" BO_ 957 90;
BA_ "GenMsgCycleTimeFast" BO_ 957 0;
BA_ "GenMsgSendType" BO_ 957 0;
BA_ "VFrameFormat" BO_ 957 14;
BA_ "CANFD_BRS" BO_ 957 1;
BA_ "GenMsgCycleTime" BO_ 957 90;
BA_ "GenMsgCycleTimeFast" BO_ 957 0;
BA_ "GenMsgSendType" BO_ 957 0;
BA_ "VFrameFormat" BO_ 957 14;
BA_ "CANFD_BRS" BO_ 957 1;
BA_ "GenMsgCycleTime" BO_ 957 90;
BA_ "GenMsgCycleTimeFast" BO_ 957 0;
BA_ "GenMsgSendType" BO_ 957 0;
BA_ "VFrameFormat" BO_ 957 14;
BA_ "CANFD_BRS" BO_ 957 1;
BA_ "GenMsgCycleTime" BO_ 957 90;
BA_ "GenMsgCycleTimeFast" BO_ 957 0;
BA_ "GenMsgSendType" BO_ 957 0;
BA_ "VFrameFormat" BO_ 957 14;
BA_ "CANFD_BRS" BO_ 957 1;
BA_ "GenMsgCycleTime" BO_ 957 90;
BA_ "GenMsgCycleTimeFast" BO_ 957 0;
BA_ "GenMsgSendType" BO_ 957 0;
BA_ "VFrameFormat" BO_ 957 14;
BA_ "CANFD_BRS" BO_ 957 1;
BA_ "GenMsgCycleTime" BO_ 957 90;
BA_ "GenMsgCycleTimeFast" BO_ 957 0;
BA_ "GenMsgSendType" BO_ 957 0;
BA_ "VFrameFormat" BO_ 957 14;
BA_ "CANFD_BRS" BO_ 957 1;
BA_ "GenMsgCycleTime" BO_ 957 90;
BA_ "GenMsgCycleTimeFast" BO_ 957 0;
BA_ "GenMsgSendType" BO_ 957 0;
BA_ "VFrameFormat" BO_ 957 14;
BA_ "CANFD_BRS" BO_ 957 1;
BA_ "GenMsgCycleTime" BO_ 957 90;
BA_ "GenMsgCycleTimeFast" BO_ 957 0;
BA_ "GenMsgSendType" BO_ 957 0;
BA_ "VFrameFormat" BO_ 957 14;
BA_ "CANFD_BRS" BO_ 957 1;
BA_ "GenMsgCycleTime" BO_ 957 90;
BA_ "GenMsgCycleTimeFast" BO_ 957 0;
BA_ "GenMsgSendType" BO_ 957 0;
BA_ "VFrameFormat" BO_ 957 14;
BA_ "CANFD_BRS" BO_ 957 1;
BA_ "GenMsgCycleTime" BO_ 957 90;
BA_ "GenMsgCycleTimeFast" BO_ 957 0;
BA_ "GenMsgSendType" BO_ 957 0;
BA_ "VFrameFormat" BO_ 957 14;
BA_ "CANFD_BRS" BO_ 957 1;
BA_ "GenMsgCycleTime" BO_ 957 90;
BA_ "GenMsgCycleTimeFast" BO_ 957 0;
BA_ "GenMsgSendType" BO_ 957 0;
BA_ "VFrameFormat" BO_ 957 14;
BA_ "CANFD_BRS" BO_ 957 1;
BA_ "GenMsgCycleTime" BO_ 957 90;
BA_ "GenMsgCycleTimeFast" BO_ 957 0;
BA_ "GenMsgSendType" BO_ 957 0;
BA_ "VFrameFormat" BO_ 957 14;
BA_ "CANFD_BRS" BO_ 957 1;
BA_ "GenMsgCycleTime" BO_ 957 90;
BA_ "GenMsgCycleTimeFast" BO_ 957 0;
BA_ "GenMsgSendType" BO_ 957 0;
BA_ "VFrameFormat" BO_ 957 14;
BA_ "CANFD_BRS" BO_ 957 1;
BA_ "GenMsgCycleTime" BO_ 957 90;
BA_ "GenMsgCycleTimeFast" BO_ 957 0;
BA_ "GenMsgSendType" BO_ 957 0;
BA_ "VFrameFormat" BO_ 957 14;
BA_ "CANFD_BRS" BO_ 957 1;
BA_ "GenMsgCycleTime" BO_ 957 90;
BA_ "GenMsgCycleTimeFast" BO_ 957 0;
BA_ "GenMsgSendType" BO_ 957 0;
BA_ "VFrameFormat" BO_ 957 14;
BA_ "CANFD_BRS" BO_ 957 1;
BA_ "GenMsgCycleTime" BO_ 957 90;
BA_ "GenMsgCycleTimeFast" BO_ 957 0;
BA_ "GenMsgSendType" BO_ 957 0;
BA_ "VFrameFormat" BO_ 957 14;
BA_ "CANFD_BRS" BO_ 957 1;
BA_ "GenMsgCycleTime" BO_ 957 90;
BA_ "GenMsgCycleTimeFast" BO_ 957 0;
BA_ "GenMsgSendType" BO_ 957 0;
BA_ "VFrameFormat" BO_ 957 14;
BA_ "CANFD_BRS" BO_ 957 1;
BA_ "GenMsgCycleTime" BO_ 957 90;
BA_ "GenMsgCycleTimeFast" BO_ 957 0;
BA_ "GenMsgSendType" BO_ 957 0;
BA_ "VFrameFormat" BO_ 957 14;
BA_ "CANFD_BRS" BO_ 957 1;
BA_ "GenMsgCycleTime" BO_ 957 90;
BA_ "GenMsgCycleTimeFast" BO_ 957 0;
BA_ "GenMsgSendType" BO_ 957 0;
BA_ "VFrameFormat" BO_ 957 14;
BA_ "CANFD_BRS" BO_ 957 1;
BA_ "GenMsgCycleTime" BO_ 957 90;
BA_ "GenMsgCycleTimeFast" BO_ 957 0;
BA_ "GenMsgSendType" BO_ 957 0;
BA_ "VFrameFormat" BO_ 957 14;
BA_ "CANFD_BRS" BO_ 957 1;
BA_ "GenMsgCycleTime" BO_ 360 10;
BA_ "GenMsgCycleTimeFast" BO_ 360 0;
BA_ "GenMsgSendType" BO_ 360 0;
BA_ "VFrameFormat" BO_ 360 14;
BA_ "CANFD_BRS" BO_ 360 1;
BA_ "GenMsgCycleTime" BO_ 360 10;
BA_ "GenMsgCycleTimeFast" BO_ 360 0;
BA_ "GenMsgSendType" BO_ 360 0;
BA_ "VFrameFormat" BO_ 360 14;
BA_ "CANFD_BRS" BO_ 360 1;
BA_ "GenMsgCycleTime" BO_ 360 10;
BA_ "GenMsgCycleTimeFast" BO_ 360 0;
BA_ "GenMsgSendType" BO_ 360 0;
BA_ "VFrameFormat" BO_ 360 14;
BA_ "CANFD_BRS" BO_ 360 1;
BA_ "GenMsgCycleTime" BO_ 360 10;
BA_ "GenMsgCycleTimeFast" BO_ 360 0;
BA_ "GenMsgSendType" BO_ 360 0;
BA_ "VFrameFormat" BO_ 360 14;
BA_ "CANFD_BRS" BO_ 360 1;
BA_ "GenMsgCycleTime" BO_ 360 10;
BA_ "GenMsgCycleTimeFast" BO_ 360 0;
BA_ "GenMsgSendType" BO_ 360 0;
BA_ "VFrameFormat" BO_ 360 14;
BA_ "CANFD_BRS" BO_ 360 1;
BA_ "GenMsgCycleTime" BO_ 360 10;
BA_ "GenMsgCycleTimeFast" BO_ 360 0;
BA_ "GenMsgSendType" BO_ 360 0;
BA_ "VFrameFormat" BO_ 360 14;
BA_ "CANFD_BRS" BO_ 360 1;
BA_ "GenMsgCycleTime" BO_ 360 10;
BA_ "GenMsgCycleTimeFast" BO_ 360 0;
BA_ "GenMsgSendType" BO_ 360 0;
BA_ "VFrameFormat" BO_ 360 14;
BA_ "CANFD_BRS" BO_ 360 1;
BA_ "GenMsgCycleTime" BO_ 360 10;
BA_ "GenMsgCycleTimeFast" BO_ 360 0;
BA_ "GenMsgSendType" BO_ 360 0;
BA_ "VFrameFormat" BO_ 360 14;
BA_ "CANFD_BRS" BO_ 360 1;
BA_ "GenMsgCycleTime" BO_ 360 10;
BA_ "GenMsgCycleTimeFast" BO_ 360 0;
BA_ "GenMsgSendType" BO_ 360 0;
BA_ "VFrameFormat" BO_ 360 14;
BA_ "CANFD_BRS" BO_ 360 1;
BA_ "GenMsgCycleTime" BO_ 360 10;
BA_ "GenMsgCycleTimeFast" BO_ 360 0;
BA_ "GenMsgSendType" BO_ 360 0;
BA_ "VFrameFormat" BO_ 360 14;
BA_ "CANFD_BRS" BO_ 360 1;
BA_ "GenMsgCycleTime" BO_ 360 10;
BA_ "GenMsgCycleTimeFast" BO_ 360 0;
BA_ "GenMsgSendType" BO_ 360 0;
BA_ "VFrameFormat" BO_ 360 14;
BA_ "CANFD_BRS" BO_ 360 1;
BA_ "GenMsgCycleTime" BO_ 360 10;
BA_ "GenMsgCycleTimeFast" BO_ 360 0;
BA_ "GenMsgSendType" BO_ 360 0;
BA_ "VFrameFormat" BO_ 360 14;
BA_ "CANFD_BRS" BO_ 360 1;
BA_ "GenMsgCycleTime" BO_ 360 10;
BA_ "GenMsgCycleTimeFast" BO_ 360 0;
BA_ "GenMsgSendType" BO_ 360 0;
BA_ "VFrameFormat" BO_ 360 14;
BA_ "CANFD_BRS" BO_ 360 1;
BA_ "GenMsgCycleTime" BO_ 360 10;
BA_ "GenMsgCycleTimeFast" BO_ 360 0;
BA_ "GenMsgSendType" BO_ 360 0;
BA_ "VFrameFormat" BO_ 360 14;
BA_ "CANFD_BRS" BO_ 360 1;
BA_ "GenMsgCycleTime" BO_ 360 10;
BA_ "GenMsgCycleTimeFast" BO_ 360 0;
BA_ "GenMsgSendType" BO_ 360 0;
BA_ "VFrameFormat" BO_ 360 14;
BA_ "CANFD_BRS" BO_ 360 1;
BA_ "GenMsgCycleTime" BO_ 360 10;
BA_ "GenMsgCycleTimeFast" BO_ 360 0;
BA_ "GenMsgSendType" BO_ 360 0;
BA_ "VFrameFormat" BO_ 360 14;
BA_ "CANFD_BRS" BO_ 360 1;
BA_ "GenMsgCycleTime" BO_ 360 10;
BA_ "GenMsgCycleTimeFast" BO_ 360 0;
BA_ "GenMsgSendType" BO_ 360 0;
BA_ "VFrameFormat" BO_ 360 14;
BA_ "CANFD_BRS" BO_ 360 1;
BA_ "GenMsgCycleTime" BO_ 360 10;
BA_ "GenMsgCycleTimeFast" BO_ 360 0;
BA_ "GenMsgSendType" BO_ 360 0;
BA_ "VFrameFormat" BO_ 360 14;
BA_ "CANFD_BRS" BO_ 360 1;
BA_ "GenMsgCycleTime" BO_ 360 10;
BA_ "GenMsgCycleTimeFast" BO_ 360 0;
BA_ "GenMsgSendType" BO_ 360 0;
BA_ "VFrameFormat" BO_ 360 14;
BA_ "CANFD_BRS" BO_ 360 1;
BA_ "GenMsgCycleTime" BO_ 360 10;
BA_ "GenMsgCycleTimeFast" BO_ 360 0;
BA_ "GenMsgSendType" BO_ 360 0;
BA_ "VFrameFormat" BO_ 360 14;
BA_ "CANFD_BRS" BO_ 360 1;
BA_ "GenMsgCycleTime" BO_ 360 10;
BA_ "GenMsgCycleTimeFast" BO_ 360 0;
BA_ "GenMsgSendType" BO_ 360 0;
BA_ "VFrameFormat" BO_ 360 14;
BA_ "CANFD_BRS" BO_ 360 1;
BA_ "GenMsgCycleTime" BO_ 360 10;
BA_ "GenMsgCycleTimeFast" BO_ 360 0;
BA_ "GenMsgSendType" BO_ 360 0;
BA_ "VFrameFormat" BO_ 360 14;
BA_ "CANFD_BRS" BO_ 360 1;
BA_ "GenMsgCycleTime" BO_ 360 10;
BA_ "GenMsgCycleTimeFast" BO_ 360 0;
BA_ "GenMsgSendType" BO_ 360 0;
BA_ "VFrameFormat" BO_ 360 14;
BA_ "CANFD_BRS" BO_ 360 1;
BA_ "GenMsgCycleTime" BO_ 360 10;
BA_ "GenMsgCycleTimeFast" BO_ 360 0;
BA_ "GenMsgSendType" BO_ 360 0;
BA_ "VFrameFormat" BO_ 360 14;
BA_ "CANFD_BRS" BO_ 360 1;
BA_ "GenMsgCycleTime" BO_ 360 10;
BA_ "GenMsgCycleTimeFast" BO_ 360 0;
BA_ "GenMsgSendType" BO_ 360 0;
BA_ "VFrameFormat" BO_ 360 14;
BA_ "CANFD_BRS" BO_ 360 1;
BA_ "GenMsgCycleTime" BO_ 360 10;
BA_ "GenMsgCycleTimeFast" BO_ 360 0;
BA_ "GenMsgSendType" BO_ 360 0;
BA_ "VFrameFormat" BO_ 360 14;
BA_ "CANFD_BRS" BO_ 360 1;
BA_ "GenMsgCycleTime" BO_ 360 10;
BA_ "GenMsgCycleTimeFast" BO_ 360 0;
BA_ "GenMsgSendType" BO_ 360 0;
BA_ "VFrameFormat" BO_ 360 14;
BA_ "CANFD_BRS" BO_ 360 1;
BA_ "GenMsgCycleTime" BO_ 360 10;
BA_ "GenMsgCycleTimeFast" BO_ 360 0;
BA_ "GenMsgSendType" BO_ 360 0;
BA_ "VFrameFormat" BO_ 360 14;
BA_ "CANFD_BRS" BO_ 360 1;
BA_ "GenMsgCycleTime" BO_ 360 10;
BA_ "GenMsgCycleTimeFast" BO_ 360 0;
BA_ "GenMsgSendType" BO_ 360 0;
BA_ "VFrameFormat" BO_ 360 14;
BA_ "CANFD_BRS" BO_ 360 1;
BA_ "GenMsgCycleTime" BO_ 360 10;
BA_ "GenMsgCycleTimeFast" BO_ 360 0;
BA_ "GenMsgSendType" BO_ 360 0;
BA_ "VFrameFormat" BO_ 360 14;
BA_ "CANFD_BRS" BO_ 360 1;
BA_ "GenMsgCycleTime" BO_ 360 10;
BA_ "GenMsgCycleTimeFast" BO_ 360 0;
BA_ "GenMsgSendType" BO_ 360 0;
BA_ "VFrameFormat" BO_ 360 14;
BA_ "CANFD_BRS" BO_ 360 1;
BA_ "GenMsgCycleTime" BO_ 360 10;
BA_ "GenMsgCycleTimeFast" BO_ 360 0;
BA_ "GenMsgSendType" BO_ 360 0;
BA_ "VFrameFormat" BO_ 360 14;
BA_ "CANFD_BRS" BO_ 360 1;
BA_ "GenMsgCycleTime" BO_ 360 10;
BA_ "GenMsgCycleTimeFast" BO_ 360 0;
BA_ "GenMsgSendType" BO_ 360 0;
BA_ "VFrameFormat" BO_ 360 14;
BA_ "CANFD_BRS" BO_ 360 1;
BA_ "GenMsgCycleTime" BO_ 360 10;
BA_ "GenMsgCycleTimeFast" BO_ 360 0;
BA_ "GenMsgSendType" BO_ 360 0;
BA_ "VFrameFormat" BO_ 360 14;
BA_ "CANFD_BRS" BO_ 360 1;
BA_ "GenMsgCycleTime" BO_ 360 10;
BA_ "GenMsgCycleTimeFast" BO_ 360 0;
BA_ "GenMsgSendType" BO_ 360 0;
BA_ "VFrameFormat" BO_ 360 14;
BA_ "CANFD_BRS" BO_ 360 1;
BA_ "GenMsgCycleTime" BO_ 360 10;
BA_ "GenMsgCycleTimeFast" BO_ 360 0;
BA_ "GenMsgSendType" BO_ 360 0;
BA_ "VFrameFormat" BO_ 360 14;
BA_ "CANFD_BRS" BO_ 360 1;
BA_ "GenMsgCycleTime" BO_ 360 10;
BA_ "GenMsgCycleTimeFast" BO_ 360 0;
BA_ "GenMsgSendType" BO_ 360 0;
BA_ "VFrameFormat" BO_ 360 14;
BA_ "CANFD_BRS" BO_ 360 1;
BA_ "GenMsgCycleTime" BO_ 360 10;
BA_ "GenMsgCycleTimeFast" BO_ 360 0;
BA_ "GenMsgSendType" BO_ 360 0;
BA_ "VFrameFormat" BO_ 360 14;
BA_ "CANFD_BRS" BO_ 360 1;
BA_ "GenMsgCycleTime" BO_ 360 10;
BA_ "GenMsgCycleTimeFast" BO_ 360 0;
BA_ "GenMsgSendType" BO_ 360 0;
BA_ "VFrameFormat" BO_ 360 14;
BA_ "CANFD_BRS" BO_ 360 1;
BA_ "GenMsgCycleTime" BO_ 360 10;
BA_ "GenMsgCycleTimeFast" BO_ 360 0;
BA_ "GenMsgSendType" BO_ 360 0;
BA_ "VFrameFormat" BO_ 360 14;
BA_ "CANFD_BRS" BO_ 360 1;
BA_ "GenMsgCycleTime" BO_ 360 10;
BA_ "GenMsgCycleTimeFast" BO_ 360 0;
BA_ "GenMsgSendType" BO_ 360 0;
BA_ "VFrameFormat" BO_ 360 14;
BA_ "CANFD_BRS" BO_ 360 1;
BA_ "GenMsgCycleTime" BO_ 360 10;
BA_ "GenMsgCycleTimeFast" BO_ 360 0;
BA_ "GenMsgSendType" BO_ 360 0;
BA_ "VFrameFormat" BO_ 360 14;
BA_ "CANFD_BRS" BO_ 360 1;
BA_ "GenMsgCycleTime" BO_ 360 10;
BA_ "GenMsgCycleTimeFast" BO_ 360 0;
BA_ "GenMsgSendType" BO_ 360 0;
BA_ "VFrameFormat" BO_ 360 14;
BA_ "CANFD_BRS" BO_ 360 1;
BA_ "GenMsgCycleTime" BO_ 360 10;
BA_ "GenMsgCycleTimeFast" BO_ 360 0;
BA_ "GenMsgSendType" BO_ 360 0;
BA_ "VFrameFormat" BO_ 360 14;
BA_ "CANFD_BRS" BO_ 360 1;
BA_ "GenMsgCycleTime" BO_ 360 10;
BA_ "GenMsgCycleTimeFast" BO_ 360 0;
BA_ "GenMsgSendType" BO_ 360 0;
BA_ "VFrameFormat" BO_ 360 14;
BA_ "CANFD_BRS" BO_ 360 1;
BA_ "GenMsgCycleTime" BO_ 360 10;
BA_ "GenMsgCycleTimeFast" BO_ 360 0;
BA_ "GenMsgSendType" BO_ 360 0;
BA_ "VFrameFormat" BO_ 360 14;
BA_ "CANFD_BRS" BO_ 360 1;
BA_ "GenMsgCycleTime" BO_ 360 10;
BA_ "GenMsgCycleTimeFast" BO_ 360 0;
BA_ "GenMsgSendType" BO_ 360 0;
BA_ "VFrameFormat" BO_ 360 14;
BA_ "CANFD_BRS" BO_ 360 1;
BA_ "GenMsgCycleTime" BO_ 360 10;
BA_ "GenMsgCycleTimeFast" BO_ 360 0;
BA_ "GenMsgSendType" BO_ 360 0;
BA_ "VFrameFormat" BO_ 360 14;
BA_ "CANFD_BRS" BO_ 360 1;
BA_ "GenMsgCycleTime" BO_ 360 10;
BA_ "GenMsgCycleTimeFast" BO_ 360 0;
BA_ "GenMsgSendType" BO_ 360 0;
BA_ "VFrameFormat" BO_ 360 14;
BA_ "CANFD_BRS" BO_ 360 1;
BA_ "GenMsgCycleTime" BO_ 360 10;
BA_ "GenMsgCycleTimeFast" BO_ 360 0;
BA_ "GenMsgSendType" BO_ 360 0;
BA_ "VFrameFormat" BO_ 360 14;
BA_ "CANFD_BRS" BO_ 360 1;
BA_ "GenMsgCycleTime" BO_ 360 10;
BA_ "GenMsgCycleTimeFast" BO_ 360 0;
BA_ "GenMsgSendType" BO_ 360 0;
BA_ "VFrameFormat" BO_ 360 14;
BA_ "CANFD_BRS" BO_ 360 1;
BA_ "GenMsgCycleTime" BO_ 360 10;
BA_ "GenMsgCycleTimeFast" BO_ 360 0;
BA_ "GenMsgSendType" BO_ 360 0;
BA_ "VFrameFormat" BO_ 360 14;
BA_ "CANFD_BRS" BO_ 360 1;
BA_ "GenMsgCycleTime" BO_ 475 1000;
BA_ "GenMsgCycleTimeFast" BO_ 475 40;
BA_ "GenMsgSendType" BO_ 475 4;
BA_ "VFrameFormat" BO_ 475 14;
BA_ "CANFD_BRS" BO_ 475 1;
BA_ "GenMsgCycleTime" BO_ 351 200;
BA_ "GenMsgCycleTimeFast" BO_ 351 40;
BA_ "GenMsgSendType" BO_ 351 3;
BA_ "VFrameFormat" BO_ 351 14;
BA_ "CANFD_BRS" BO_ 351 1;
BA_ "GenMsgCycleTime" BO_ 351 200;
BA_ "GenMsgCycleTimeFast" BO_ 351 40;
BA_ "GenMsgSendType" BO_ 351 3;
BA_ "VFrameFormat" BO_ 351 14;
BA_ "CANFD_BRS" BO_ 351 1;
BA_ "GenMsgCycleTime" BO_ 351 200;
BA_ "GenMsgCycleTimeFast" BO_ 351 40;
BA_ "GenMsgSendType" BO_ 351 3;
BA_ "VFrameFormat" BO_ 351 14;
BA_ "CANFD_BRS" BO_ 351 1;
BA_ "GenMsgCycleTime" BO_ 351 200;
BA_ "GenMsgCycleTimeFast" BO_ 351 40;
BA_ "GenMsgSendType" BO_ 351 3;
BA_ "VFrameFormat" BO_ 351 14;
BA_ "CANFD_BRS" BO_ 351 1;
BA_ "GenMsgCycleTime" BO_ 351 200;
BA_ "GenMsgCycleTimeFast" BO_ 351 40;
BA_ "GenMsgSendType" BO_ 351 3;
BA_ "VFrameFormat" BO_ 351 14;
BA_ "CANFD_BRS" BO_ 351 1;
BA_ "GenMsgCycleTime" BO_ 351 200;
BA_ "GenMsgCycleTimeFast" BO_ 351 40;
BA_ "GenMsgSendType" BO_ 351 3;
BA_ "VFrameFormat" BO_ 351 14;
BA_ "CANFD_BRS" BO_ 351 1;
BA_ "GenMsgCycleTime" BO_ 351 200;
BA_ "GenMsgCycleTimeFast" BO_ 351 40;
BA_ "GenMsgSendType" BO_ 351 3;
BA_ "VFrameFormat" BO_ 351 14;
BA_ "CANFD_BRS" BO_ 351 1;
BA_ "GenMsgCycleTime" BO_ 351 200;
BA_ "GenMsgCycleTimeFast" BO_ 351 40;
BA_ "GenMsgSendType" BO_ 351 3;
BA_ "VFrameFormat" BO_ 351 14;
BA_ "CANFD_BRS" BO_ 351 1;
BA_ "GenMsgCycleTime" BO_ 776 100;
BA_ "GenMsgCycleTimeFast" BO_ 776 0;
BA_ "GenMsgSendType" BO_ 776 0;
BA_ "VFrameFormat" BO_ 776 14;
BA_ "CANFD_BRS" BO_ 776 1;
BA_ "GenMsgCycleTime" BO_ 776 100;
BA_ "GenMsgCycleTimeFast" BO_ 776 0;
BA_ "GenMsgSendType" BO_ 776 0;
BA_ "VFrameFormat" BO_ 776 14;
BA_ "CANFD_BRS" BO_ 776 1;
BA_ "GenMsgCycleTime" BO_ 776 100;
BA_ "GenMsgCycleTimeFast" BO_ 776 0;
BA_ "GenMsgSendType" BO_ 776 0;
BA_ "VFrameFormat" BO_ 776 14;
BA_ "CANFD_BRS" BO_ 776 1;
BA_ "GenMsgCycleTime" BO_ 776 100;
BA_ "GenMsgCycleTimeFast" BO_ 776 0;
BA_ "GenMsgSendType" BO_ 776 0;
BA_ "VFrameFormat" BO_ 776 14;
BA_ "CANFD_BRS" BO_ 776 1;
BA_ "GenMsgCycleTime" BO_ 776 100;
BA_ "GenMsgCycleTimeFast" BO_ 776 0;
BA_ "GenMsgSendType" BO_ 776 0;
BA_ "VFrameFormat" BO_ 776 14;
BA_ "CANFD_BRS" BO_ 776 1;
BA_ "GenMsgCycleTime" BO_ 776 100;
BA_ "GenMsgCycleTimeFast" BO_ 776 0;
BA_ "GenMsgSendType" BO_ 776 0;
BA_ "VFrameFormat" BO_ 776 14;
BA_ "CANFD_BRS" BO_ 776 1;
BA_ "GenMsgCycleTime" BO_ 776 100;
BA_ "GenMsgCycleTimeFast" BO_ 776 0;
BA_ "GenMsgSendType" BO_ 776 0;
BA_ "VFrameFormat" BO_ 776 14;
BA_ "CANFD_BRS" BO_ 776 1;
BA_ "GenMsgCycleTime" BO_ 776 100;
BA_ "GenMsgCycleTimeFast" BO_ 776 0;
BA_ "GenMsgSendType" BO_ 776 0;
BA_ "VFrameFormat" BO_ 776 14;
BA_ "CANFD_BRS" BO_ 776 1;
BA_ "GenMsgCycleTime" BO_ 776 100;
BA_ "GenMsgCycleTimeFast" BO_ 776 0;
BA_ "GenMsgSendType" BO_ 776 0;
BA_ "VFrameFormat" BO_ 776 14;
BA_ "CANFD_BRS" BO_ 776 1;
BA_ "GenMsgCycleTime" BO_ 967 200;
BA_ "GenMsgCycleTimeFast" BO_ 967 0;
BA_ "GenMsgSendType" BO_ 967 0;
BA_ "VFrameFormat" BO_ 967 14;
BA_ "CANFD_BRS" BO_ 967 1;
BA_ "GenMsgCycleTime" BO_ 967 200;
BA_ "GenMsgCycleTimeFast" BO_ 967 0;
BA_ "GenMsgSendType" BO_ 967 0;
BA_ "VFrameFormat" BO_ 967 14;
BA_ "CANFD_BRS" BO_ 967 1;
BA_ "GenMsgCycleTime" BO_ 967 200;
BA_ "GenMsgCycleTimeFast" BO_ 967 0;
BA_ "GenMsgSendType" BO_ 967 0;
BA_ "VFrameFormat" BO_ 967 14;
BA_ "CANFD_BRS" BO_ 967 1;
BA_ "GenMsgCycleTime" BO_ 967 200;
BA_ "GenMsgCycleTimeFast" BO_ 967 0;
BA_ "GenMsgSendType" BO_ 967 0;
BA_ "VFrameFormat" BO_ 967 14;
BA_ "CANFD_BRS" BO_ 967 1;
BA_ "GenMsgCycleTime" BO_ 967 200;
BA_ "GenMsgCycleTimeFast" BO_ 967 0;
BA_ "GenMsgSendType" BO_ 967 0;
BA_ "VFrameFormat" BO_ 967 14;
BA_ "CANFD_BRS" BO_ 967 1;
BA_ "GenMsgCycleTime" BO_ 967 200;
BA_ "GenMsgCycleTimeFast" BO_ 967 0;
BA_ "GenMsgSendType" BO_ 967 0;
BA_ "VFrameFormat" BO_ 967 14;
BA_ "CANFD_BRS" BO_ 967 1;
BA_ "GenMsgCycleTime" BO_ 967 200;
BA_ "GenMsgCycleTimeFast" BO_ 967 0;
BA_ "GenMsgSendType" BO_ 967 0;
BA_ "VFrameFormat" BO_ 967 14;
BA_ "CANFD_BRS" BO_ 967 1;
BA_ "GenMsgCycleTime" BO_ 967 200;
BA_ "GenMsgCycleTimeFast" BO_ 967 0;
BA_ "GenMsgSendType" BO_ 967 0;
BA_ "VFrameFormat" BO_ 967 14;
BA_ "CANFD_BRS" BO_ 967 1;
BA_ "GenMsgCycleTime" BO_ 967 200;
BA_ "GenMsgCycleTimeFast" BO_ 967 0;
BA_ "GenMsgSendType" BO_ 967 0;
BA_ "VFrameFormat" BO_ 967 14;
BA_ "CANFD_BRS" BO_ 967 1;
BA_ "GenMsgCycleTime" BO_ 967 200;
BA_ "GenMsgCycleTimeFast" BO_ 967 0;
BA_ "GenMsgSendType" BO_ 967 0;
BA_ "VFrameFormat" BO_ 967 14;
BA_ "CANFD_BRS" BO_ 967 1;
BA_ "GenMsgCycleTime" BO_ 967 200;
BA_ "GenMsgCycleTimeFast" BO_ 967 0;
BA_ "GenMsgSendType" BO_ 967 0;
BA_ "VFrameFormat" BO_ 967 14;
BA_ "CANFD_BRS" BO_ 967 1;
BA_ "GenMsgCycleTime" BO_ 967 200;
BA_ "GenMsgCycleTimeFast" BO_ 967 0;
BA_ "GenMsgSendType" BO_ 967 0;
BA_ "VFrameFormat" BO_ 967 14;
BA_ "CANFD_BRS" BO_ 967 1;
BA_ "GenMsgCycleTime" BO_ 967 200;
BA_ "GenMsgCycleTimeFast" BO_ 967 0;
BA_ "GenMsgSendType" BO_ 967 0;
BA_ "VFrameFormat" BO_ 967 14;
BA_ "CANFD_BRS" BO_ 967 1;
BA_ "GenMsgCycleTime" BO_ 967 200;
BA_ "GenMsgCycleTimeFast" BO_ 967 0;
BA_ "GenMsgSendType" BO_ 967 0;
BA_ "VFrameFormat" BO_ 967 14;
BA_ "CANFD_BRS" BO_ 967 1;
BA_ "GenMsgCycleTime" BO_ 967 200;
BA_ "GenMsgCycleTimeFast" BO_ 967 0;
BA_ "GenMsgSendType" BO_ 967 0;
BA_ "VFrameFormat" BO_ 967 14;
BA_ "CANFD_BRS" BO_ 967 1;
BA_ "GenMsgCycleTime" BO_ 967 200;
BA_ "GenMsgCycleTimeFast" BO_ 967 0;
BA_ "GenMsgSendType" BO_ 967 0;
BA_ "VFrameFormat" BO_ 967 14;
BA_ "CANFD_BRS" BO_ 967 1;
BA_ "GenMsgCycleTime" BO_ 967 200;
BA_ "GenMsgCycleTimeFast" BO_ 967 0;
BA_ "GenMsgSendType" BO_ 967 0;
BA_ "VFrameFormat" BO_ 967 14;
BA_ "CANFD_BRS" BO_ 967 1;
BA_ "GenMsgCycleTime" BO_ 967 200;
BA_ "GenMsgCycleTimeFast" BO_ 967 0;
BA_ "GenMsgSendType" BO_ 967 0;
BA_ "VFrameFormat" BO_ 967 14;
BA_ "CANFD_BRS" BO_ 967 1;
BA_ "GenMsgCycleTime" BO_ 967 200;
BA_ "GenMsgCycleTimeFast" BO_ 967 0;
BA_ "GenMsgSendType" BO_ 967 0;
BA_ "VFrameFormat" BO_ 967 14;
BA_ "CANFD_BRS" BO_ 967 1;
BA_ "GenMsgCycleTime" BO_ 342 40;
BA_ "GenMsgCycleTimeFast" BO_ 342 0;
BA_ "GenMsgSendType" BO_ 342 0;
BA_ "VFrameFormat" BO_ 342 14;
BA_ "CANFD_BRS" BO_ 342 1;
BA_ "GenMsgCycleTime" BO_ 342 40;
BA_ "GenMsgCycleTimeFast" BO_ 342 0;
BA_ "GenMsgSendType" BO_ 342 0;
BA_ "VFrameFormat" BO_ 342 14;
BA_ "CANFD_BRS" BO_ 342 1;
BA_ "GenMsgCycleTime" BO_ 342 40;
BA_ "GenMsgCycleTimeFast" BO_ 342 0;
BA_ "GenMsgSendType" BO_ 342 0;
BA_ "VFrameFormat" BO_ 342 14;
BA_ "CANFD_BRS" BO_ 342 1;
BA_ "GenMsgCycleTime" BO_ 342 40;
BA_ "GenMsgCycleTimeFast" BO_ 342 0;
BA_ "GenMsgSendType" BO_ 342 0;
BA_ "VFrameFormat" BO_ 342 14;
BA_ "CANFD_BRS" BO_ 342 1;
BA_ "GenMsgCycleTime" BO_ 342 40;
BA_ "GenMsgCycleTimeFast" BO_ 342 0;
BA_ "GenMsgSendType" BO_ 342 0;
BA_ "VFrameFormat" BO_ 342 14;
BA_ "CANFD_BRS" BO_ 342 1;
BA_ "GenMsgCycleTime" BO_ 342 40;
BA_ "GenMsgCycleTimeFast" BO_ 342 0;
BA_ "GenMsgSendType" BO_ 342 0;
BA_ "VFrameFormat" BO_ 342 14;
BA_ "CANFD_BRS" BO_ 342 1;
BA_ "GenMsgCycleTime" BO_ 342 40;
BA_ "GenMsgCycleTimeFast" BO_ 342 0;
BA_ "GenMsgSendType" BO_ 342 0;
BA_ "VFrameFormat" BO_ 342 14;
BA_ "CANFD_BRS" BO_ 342 1;
BA_ "GenMsgCycleTime" BO_ 342 40;
BA_ "GenMsgCycleTimeFast" BO_ 342 0;
BA_ "GenMsgSendType" BO_ 342 0;
BA_ "VFrameFormat" BO_ 342 14;
BA_ "CANFD_BRS" BO_ 342 1;
BA_ "GenMsgCycleTime" BO_ 342 40;
BA_ "GenMsgCycleTimeFast" BO_ 342 0;
BA_ "GenMsgSendType" BO_ 342 0;
BA_ "VFrameFormat" BO_ 342 14;
BA_ "CANFD_BRS" BO_ 342 1;
BA_ "GenMsgCycleTime" BO_ 342 40;
BA_ "GenMsgCycleTimeFast" BO_ 342 0;
BA_ "GenMsgSendType" BO_ 342 0;
BA_ "VFrameFormat" BO_ 342 14;
BA_ "CANFD_BRS" BO_ 342 1;
BA_ "GenMsgCycleTime" BO_ 342 40;
BA_ "GenMsgCycleTimeFast" BO_ 342 0;
BA_ "GenMsgSendType" BO_ 342 0;
BA_ "VFrameFormat" BO_ 342 14;
BA_ "CANFD_BRS" BO_ 342 1;
BA_ "GenMsgCycleTime" BO_ 342 40;
BA_ "GenMsgCycleTimeFast" BO_ 342 0;
BA_ "GenMsgSendType" BO_ 342 0;
BA_ "VFrameFormat" BO_ 342 14;
BA_ "CANFD_BRS" BO_ 342 1;
BA_ "GenMsgCycleTime" BO_ 342 40;
BA_ "GenMsgCycleTimeFast" BO_ 342 0;
BA_ "GenMsgSendType" BO_ 342 0;
BA_ "VFrameFormat" BO_ 342 14;
BA_ "CANFD_BRS" BO_ 342 1;
BA_ "GenMsgCycleTime" BO_ 342 40;
BA_ "GenMsgCycleTimeFast" BO_ 342 0;
BA_ "GenMsgSendType" BO_ 342 0;
BA_ "VFrameFormat" BO_ 342 14;
BA_ "CANFD_BRS" BO_ 342 1;
BA_ "GenMsgCycleTime" BO_ 342 40;
BA_ "GenMsgCycleTimeFast" BO_ 342 0;
BA_ "GenMsgSendType" BO_ 342 0;
BA_ "VFrameFormat" BO_ 342 14;
BA_ "CANFD_BRS" BO_ 342 1;
BA_ "GenMsgCycleTime" BO_ 342 40;
BA_ "GenMsgCycleTimeFast" BO_ 342 0;
BA_ "GenMsgSendType" BO_ 342 0;
BA_ "VFrameFormat" BO_ 342 14;
BA_ "CANFD_BRS" BO_ 342 1;
BA_ "GenMsgCycleTime" BO_ 342 40;
BA_ "GenMsgCycleTimeFast" BO_ 342 0;
BA_ "GenMsgSendType" BO_ 342 0;
BA_ "VFrameFormat" BO_ 342 14;
BA_ "CANFD_BRS" BO_ 342 1;
BA_ "GenMsgCycleTime" BO_ 342 40;
BA_ "GenMsgCycleTimeFast" BO_ 342 0;
BA_ "GenMsgSendType" BO_ 342 0;
BA_ "VFrameFormat" BO_ 342 14;
BA_ "CANFD_BRS" BO_ 342 1;
BA_ "GenMsgCycleTime" BO_ 342 40;
BA_ "GenMsgCycleTimeFast" BO_ 342 0;
BA_ "GenMsgSendType" BO_ 342 0;
BA_ "VFrameFormat" BO_ 342 14;
BA_ "CANFD_BRS" BO_ 342 1;
BA_ "GenMsgCycleTime" BO_ 342 40;
BA_ "GenMsgCycleTimeFast" BO_ 342 0;
BA_ "GenMsgSendType" BO_ 342 0;
BA_ "VFrameFormat" BO_ 342 14;
BA_ "CANFD_BRS" BO_ 342 1;
BA_ "GenMsgCycleTime" BO_ 342 40;
BA_ "GenMsgCycleTimeFast" BO_ 342 0;
BA_ "GenMsgSendType" BO_ 342 0;
BA_ "VFrameFormat" BO_ 342 14;
BA_ "CANFD_BRS" BO_ 342 1;
BA_ "GenMsgCycleTime" BO_ 342 40;
BA_ "GenMsgCycleTimeFast" BO_ 342 0;
BA_ "GenMsgSendType" BO_ 342 0;
BA_ "VFrameFormat" BO_ 342 14;
BA_ "CANFD_BRS" BO_ 342 1;
BA_ "GenMsgCycleTime" BO_ 342 40;
BA_ "GenMsgCycleTimeFast" BO_ 342 0;
BA_ "GenMsgSendType" BO_ 342 0;
BA_ "VFrameFormat" BO_ 342 14;
BA_ "CANFD_BRS" BO_ 342 1;
BA_ "GenMsgCycleTime" BO_ 342 40;
BA_ "GenMsgCycleTimeFast" BO_ 342 0;
BA_ "GenMsgSendType" BO_ 342 0;
BA_ "VFrameFormat" BO_ 342 14;
BA_ "CANFD_BRS" BO_ 342 1;
BA_ "GenMsgCycleTime" BO_ 342 40;
BA_ "GenMsgCycleTimeFast" BO_ 342 0;
BA_ "GenMsgSendType" BO_ 342 0;
BA_ "VFrameFormat" BO_ 342 14;
BA_ "CANFD_BRS" BO_ 342 1;
BA_ "GenMsgCycleTime" BO_ 512 500;
BA_ "GenMsgCycleTimeFast" BO_ 512 40;
BA_ "GenMsgSendType" BO_ 512 3;
BA_ "VFrameFormat" BO_ 512 14;
BA_ "CANFD_BRS" BO_ 512 1;
BA_ "GenMsgCycleTime" BO_ 512 500;
BA_ "GenMsgCycleTimeFast" BO_ 512 40;
BA_ "GenMsgSendType" BO_ 512 3;
BA_ "VFrameFormat" BO_ 512 14;
BA_ "CANFD_BRS" BO_ 512 1;
BA_ "GenMsgCycleTime" BO_ 512 500;
BA_ "GenMsgCycleTimeFast" BO_ 512 40;
BA_ "GenMsgSendType" BO_ 512 3;
BA_ "VFrameFormat" BO_ 512 14;
BA_ "CANFD_BRS" BO_ 512 1;
BA_ "GenMsgCycleTime" BO_ 512 500;
BA_ "GenMsgCycleTimeFast" BO_ 512 40;
BA_ "GenMsgSendType" BO_ 512 3;
BA_ "VFrameFormat" BO_ 512 14;
BA_ "CANFD_BRS" BO_ 512 1;
BA_ "GenMsgCycleTime" BO_ 512 500;
BA_ "GenMsgCycleTimeFast" BO_ 512 40;
BA_ "GenMsgSendType" BO_ 512 3;
BA_ "VFrameFormat" BO_ 512 14;
BA_ "CANFD_BRS" BO_ 512 1;
BA_ "GenMsgCycleTime" BO_ 512 500;
BA_ "GenMsgCycleTimeFast" BO_ 512 40;
BA_ "GenMsgSendType" BO_ 512 3;
BA_ "VFrameFormat" BO_ 512 14;
BA_ "CANFD_BRS" BO_ 512 1;
BA_ "GenMsgCycleTime" BO_ 512 500;
BA_ "GenMsgCycleTimeFast" BO_ 512 40;
BA_ "GenMsgSendType" BO_ 512 3;
BA_ "VFrameFormat" BO_ 512 14;
BA_ "CANFD_BRS" BO_ 512 1;
BA_ "GenMsgCycleTime" BO_ 512 500;
BA_ "GenMsgCycleTimeFast" BO_ 512 40;
BA_ "GenMsgSendType" BO_ 512 3;
BA_ "VFrameFormat" BO_ 512 14;
BA_ "CANFD_BRS" BO_ 512 1;
BA_ "GenMsgCycleTime" BO_ 512 500;
BA_ "GenMsgCycleTimeFast" BO_ 512 40;
BA_ "GenMsgSendType" BO_ 512 3;
BA_ "VFrameFormat" BO_ 512 14;
BA_ "CANFD_BRS" BO_ 512 1;
BA_ "GenMsgCycleTime" BO_ 512 500;
BA_ "GenMsgCycleTimeFast" BO_ 512 40;
BA_ "GenMsgSendType" BO_ 512 3;
BA_ "VFrameFormat" BO_ 512 14;
BA_ "CANFD_BRS" BO_ 512 1;
BA_ "GenMsgCycleTime" BO_ 512 500;
BA_ "GenMsgCycleTimeFast" BO_ 512 40;
BA_ "GenMsgSendType" BO_ 512 3;
BA_ "VFrameFormat" BO_ 512 14;
BA_ "CANFD_BRS" BO_ 512 1;
BA_ "GenMsgCycleTime" BO_ 512 500;
BA_ "GenMsgCycleTimeFast" BO_ 512 40;
BA_ "GenMsgSendType" BO_ 512 3;
BA_ "VFrameFormat" BO_ 512 14;
BA_ "CANFD_BRS" BO_ 512 1;
BA_ "GenMsgCycleTime" BO_ 512 500;
BA_ "GenMsgCycleTimeFast" BO_ 512 40;
BA_ "GenMsgSendType" BO_ 512 3;
BA_ "VFrameFormat" BO_ 512 14;
BA_ "CANFD_BRS" BO_ 512 1;
BA_ "GenMsgCycleTime" BO_ 512 500;
BA_ "GenMsgCycleTimeFast" BO_ 512 40;
BA_ "GenMsgSendType" BO_ 512 3;
BA_ "VFrameFormat" BO_ 512 14;
BA_ "CANFD_BRS" BO_ 512 1;
BA_ "GenMsgCycleTime" BO_ 512 500;
BA_ "GenMsgCycleTimeFast" BO_ 512 40;
BA_ "GenMsgSendType" BO_ 512 3;
BA_ "VFrameFormat" BO_ 512 14;
BA_ "CANFD_BRS" BO_ 512 1;
BA_ "GenMsgCycleTime" BO_ 939 100;
BA_ "GenMsgCycleTimeFast" BO_ 939 0;
BA_ "GenMsgSendType" BO_ 939 0;
BA_ "VFrameFormat" BO_ 939 14;
BA_ "CANFD_BRS" BO_ 939 1;
BA_ "GenMsgCycleTime" BO_ 939 100;
BA_ "GenMsgCycleTimeFast" BO_ 939 0;
BA_ "GenMsgSendType" BO_ 939 0;
BA_ "VFrameFormat" BO_ 939 14;
BA_ "CANFD_BRS" BO_ 939 1;
BA_ "GenMsgCycleTime" BO_ 939 100;
BA_ "GenMsgCycleTimeFast" BO_ 939 0;
BA_ "GenMsgSendType" BO_ 939 0;
BA_ "VFrameFormat" BO_ 939 14;
BA_ "CANFD_BRS" BO_ 939 1;
BA_ "GenMsgCycleTime" BO_ 939 100;
BA_ "GenMsgCycleTimeFast" BO_ 939 0;
BA_ "GenMsgSendType" BO_ 939 0;
BA_ "VFrameFormat" BO_ 939 14;
BA_ "CANFD_BRS" BO_ 939 1;
BA_ "GenMsgCycleTime" BO_ 939 100;
BA_ "GenMsgCycleTimeFast" BO_ 939 0;
BA_ "GenMsgSendType" BO_ 939 0;
BA_ "VFrameFormat" BO_ 939 14;
BA_ "CANFD_BRS" BO_ 939 1;
BA_ "GenMsgCycleTime" BO_ 939 100;
BA_ "GenMsgCycleTimeFast" BO_ 939 0;
BA_ "GenMsgSendType" BO_ 939 0;
BA_ "VFrameFormat" BO_ 939 14;
BA_ "CANFD_BRS" BO_ 939 1;
BA_ "EventCommandSignal" SG_ 904 ACU_PCS_SVM_MODCmd 0;
BA_ "GatewayedSignals" SG_ 904 ACU_PCS_SVM_MODCmd 0;
BA_ "GenSigInactiveValue" SG_ 904 ACU_PCS_SVM_MODCmd 0;
BA_ "GenSigInvalidValue" SG_ 904 ACU_PCS_SVM_MODCmd 0;
BA_ "GenSigSendType" SG_ 904 ACU_PCS_SVM_MODCmd 1;
BA_ "GenSigStartValue" SG_ 904 ACU_PCS_SVM_MODCmd 0;
BA_ "GenSigTimeoutValue" SG_ 904 ACU_PCS_SVM_MODCmd 0;
BA_ "Remark" SG_ 904 ACU_PCS_SVM_MODCmd "";
BA_ "EventCommandSignal" SG_ 904 ACU_HeadLightVirtualSwSt 0;
BA_ "GatewayedSignals" SG_ 904 ACU_HeadLightVirtualSwSt 0;
BA_ "GenSigInactiveValue" SG_ 904 ACU_HeadLightVirtualSwSt 0;
BA_ "GenSigInvalidValue" SG_ 904 ACU_HeadLightVirtualSwSt 0;
BA_ "GenSigSendType" SG_ 904 ACU_HeadLightVirtualSwSt 1;
BA_ "GenSigStartValue" SG_ 904 ACU_HeadLightVirtualSwSt 0;
BA_ "GenSigTimeoutValue" SG_ 904 ACU_HeadLightVirtualSwSt 0;
BA_ "Remark" SG_ 904 ACU_HeadLightVirtualSwSt "";
BA_ "EventCommandSignal" SG_ 904 ACU_FrontFogLightVirtualSwSt 0;
BA_ "GatewayedSignals" SG_ 904 ACU_FrontFogLightVirtualSwSt 0;
BA_ "GenSigInactiveValue" SG_ 904 ACU_FrontFogLightVirtualSwSt 0;
BA_ "GenSigInvalidValue" SG_ 904 ACU_FrontFogLightVirtualSwSt 0;
BA_ "GenSigSendType" SG_ 904 ACU_FrontFogLightVirtualSwSt 1;
BA_ "GenSigStartValue" SG_ 904 ACU_FrontFogLightVirtualSwSt 0;
BA_ "GenSigTimeoutValue" SG_ 904 ACU_FrontFogLightVirtualSwSt 0;
BA_ "Remark" SG_ 904 ACU_FrontFogLightVirtualSwSt "";
BA_ "EventCommandSignal" SG_ 904 ACU_RearFogLightVirtualSwSt 0;
BA_ "GatewayedSignals" SG_ 904 ACU_RearFogLightVirtualSwSt 0;
BA_ "GenSigInactiveValue" SG_ 904 ACU_RearFogLightVirtualSwSt 0;
BA_ "GenSigInvalidValue" SG_ 904 ACU_RearFogLightVirtualSwSt 0;
BA_ "GenSigSendType" SG_ 904 ACU_RearFogLightVirtualSwSt 1;
BA_ "GenSigStartValue" SG_ 904 ACU_RearFogLightVirtualSwSt 0;
BA_ "GenSigTimeoutValue" SG_ 904 ACU_RearFogLightVirtualSwSt 0;
BA_ "Remark" SG_ 904 ACU_RearFogLightVirtualSwSt "";
BA_ "EventCommandSignal" SG_ 904 ACU_Account_Uid 0;
BA_ "GatewayedSignals" SG_ 904 ACU_Account_Uid 0;
BA_ "GenSigInactiveValue" SG_ 904 ACU_Account_Uid 0;
BA_ "GenSigInvalidValue" SG_ 904 ACU_Account_Uid 0;
BA_ "GenSigSendType" SG_ 904 ACU_Account_Uid 1;
BA_ "GenSigStartValue" SG_ 904 ACU_Account_Uid 0;
BA_ "GenSigTimeoutValue" SG_ 904 ACU_Account_Uid 0;
BA_ "Remark" SG_ 904 ACU_Account_Uid "";
BA_ "EventCommandSignal" SG_ 904 ACU_IHBC_SwitchReq 0;
BA_ "GatewayedSignals" SG_ 904 ACU_IHBC_SwitchReq 0;
BA_ "GenSigInactiveValue" SG_ 904 ACU_IHBC_SwitchReq 0;
BA_ "GenSigInvalidValue" SG_ 904 ACU_IHBC_SwitchReq 0;
BA_ "GenSigSendType" SG_ 904 ACU_IHBC_SwitchReq 1;
BA_ "GenSigStartValue" SG_ 904 ACU_IHBC_SwitchReq 0;
BA_ "GenSigTimeoutValue" SG_ 904 ACU_IHBC_SwitchReq 0;
BA_ "Remark" SG_ 904 ACU_IHBC_SwitchReq "";
BA_ "EventCommandSignal" SG_ 904 ACU_NDASwitchReq 0;
BA_ "GatewayedSignals" SG_ 904 ACU_NDASwitchReq 0;
BA_ "GenSigInactiveValue" SG_ 904 ACU_NDASwitchReq 0;
BA_ "GenSigInvalidValue" SG_ 904 ACU_NDASwitchReq 0;
BA_ "GenSigSendType" SG_ 904 ACU_NDASwitchReq 1;
BA_ "GenSigStartValue" SG_ 904 ACU_NDASwitchReq 0;
BA_ "GenSigTimeoutValue" SG_ 904 ACU_NDASwitchReq 0;
BA_ "Remark" SG_ 904 ACU_NDASwitchReq "";
BA_ "EventCommandSignal" SG_ 904 ACU_NDALCConSwitchReq 0;
BA_ "GatewayedSignals" SG_ 904 ACU_NDALCConSwitchReq 0;
BA_ "GenSigInactiveValue" SG_ 904 ACU_NDALCConSwitchReq 0;
BA_ "GenSigInvalidValue" SG_ 904 ACU_NDALCConSwitchReq 0;
BA_ "GenSigSendType" SG_ 904 ACU_NDALCConSwitchReq 1;
BA_ "GenSigStartValue" SG_ 904 ACU_NDALCConSwitchReq 0;
BA_ "GenSigTimeoutValue" SG_ 904 ACU_NDALCConSwitchReq 0;
BA_ "Remark" SG_ 904 ACU_NDALCConSwitchReq "";
BA_ "EventCommandSignal" SG_ 904 ACU_NDALCStySwitchReq 0;
BA_ "GatewayedSignals" SG_ 904 ACU_NDALCStySwitchReq 0;
BA_ "GenSigInactiveValue" SG_ 904 ACU_NDALCStySwitchReq 0;
BA_ "GenSigInvalidValue" SG_ 904 ACU_NDALCStySwitchReq 0;
BA_ "GenSigSendType" SG_ 904 ACU_NDALCStySwitchReq 1;
BA_ "GenSigStartValue" SG_ 904 ACU_NDALCStySwitchReq 0;
BA_ "GenSigTimeoutValue" SG_ 904 ACU_NDALCStySwitchReq 0;
BA_ "Remark" SG_ 904 ACU_NDALCStySwitchReq "";
BA_ "EventCommandSignal" SG_ 904 ACU_ADASWarnTypeSwitch 0;
BA_ "GatewayedSignals" SG_ 904 ACU_ADASWarnTypeSwitch 0;
BA_ "GenSigInactiveValue" SG_ 904 ACU_ADASWarnTypeSwitch 0;
BA_ "GenSigInvalidValue" SG_ 904 ACU_ADASWarnTypeSwitch 0;
BA_ "GenSigSendType" SG_ 904 ACU_ADASWarnTypeSwitch 1;
BA_ "GenSigStartValue" SG_ 904 ACU_ADASWarnTypeSwitch 0;
BA_ "GenSigTimeoutValue" SG_ 904 ACU_ADASWarnTypeSwitch 0;
BA_ "Remark" SG_ 904 ACU_ADASWarnTypeSwitch "";
BA_ "EventCommandSignal" SG_ 904 ACU_iACC_StyleConfirmSwitchReq 0;
BA_ "GatewayedSignals" SG_ 904 ACU_iACC_StyleConfirmSwitchReq 0;
BA_ "GenSigInactiveValue" SG_ 904 ACU_iACC_StyleConfirmSwitchReq 0;
BA_ "GenSigInvalidValue" SG_ 904 ACU_iACC_StyleConfirmSwitchReq 0;
BA_ "GenSigSendType" SG_ 904 ACU_iACC_StyleConfirmSwitchReq 1;
BA_ "GenSigStartValue" SG_ 904 ACU_iACC_StyleConfirmSwitchReq 3;
BA_ "GenSigTimeoutValue" SG_ 904 ACU_iACC_StyleConfirmSwitchReq 0;
BA_ "Remark" SG_ 904 ACU_iACC_StyleConfirmSwitchReq "";
BA_ "EventCommandSignal" SG_ 904 ACU_IFC_SpeedLimit 0;
BA_ "GatewayedSignals" SG_ 904 ACU_IFC_SpeedLimit 0;
BA_ "GenSigInactiveValue" SG_ 904 ACU_IFC_SpeedLimit 0;
BA_ "GenSigInvalidValue" SG_ 904 ACU_IFC_SpeedLimit 0;
BA_ "GenSigSendType" SG_ 904 ACU_IFC_SpeedLimit 1;
BA_ "GenSigStartValue" SG_ 904 ACU_IFC_SpeedLimit 0;
BA_ "GenSigTimeoutValue" SG_ 904 ACU_IFC_SpeedLimit 0;
BA_ "Remark" SG_ 904 ACU_IFC_SpeedLimit "";
BA_ "EventCommandSignal" SG_ 904 ACU_IFC_ISDRestOfdis 0;
BA_ "GatewayedSignals" SG_ 904 ACU_IFC_ISDRestOfdis 0;
BA_ "GenSigInactiveValue" SG_ 904 ACU_IFC_ISDRestOfdis 0;
BA_ "GenSigInvalidValue" SG_ 904 ACU_IFC_ISDRestOfdis 0;
BA_ "GenSigSendType" SG_ 904 ACU_IFC_ISDRestOfdis 1;
BA_ "GenSigStartValue" SG_ 904 ACU_IFC_ISDRestOfdis 0;
BA_ "GenSigTimeoutValue" SG_ 904 ACU_IFC_ISDRestOfdis 0;
BA_ "Remark" SG_ 904 ACU_IFC_ISDRestOfdis "";
BA_ "EventCommandSignal" SG_ 904 ACU_IFC_SpeedLimitUnit 0;
BA_ "GatewayedSignals" SG_ 904 ACU_IFC_SpeedLimitUnit 0;
BA_ "GenSigInactiveValue" SG_ 904 ACU_IFC_SpeedLimitUnit 0;
BA_ "GenSigInvalidValue" SG_ 904 ACU_IFC_SpeedLimitUnit 0;
BA_ "GenSigSendType" SG_ 904 ACU_IFC_SpeedLimitUnit 1;
BA_ "GenSigStartValue" SG_ 904 ACU_IFC_SpeedLimitUnit 0;
BA_ "GenSigTimeoutValue" SG_ 904 ACU_IFC_SpeedLimitUnit 1;
BA_ "Remark" SG_ 904 ACU_IFC_SpeedLimitUnit "";
BA_ "EventCommandSignal" SG_ 904 ACU_ThemeType 0;
BA_ "GatewayedSignals" SG_ 904 ACU_ThemeType 0;
BA_ "GenSigInactiveValue" SG_ 904 ACU_ThemeType 0;
BA_ "GenSigInvalidValue" SG_ 904 ACU_ThemeType 0;
BA_ "GenSigSendType" SG_ 904 ACU_ThemeType 1;
BA_ "GenSigStartValue" SG_ 904 ACU_ThemeType 0;
BA_ "GenSigTimeoutValue" SG_ 904 ACU_ThemeType 0;
BA_ "Remark" SG_ 904 ACU_ThemeType "";
BA_ "EventCommandSignal" SG_ 904 ACU_IFC_SpeedLimtType 0;
BA_ "GatewayedSignals" SG_ 904 ACU_IFC_SpeedLimtType 0;
BA_ "GenSigInactiveValue" SG_ 904 ACU_IFC_SpeedLimtType 0;
BA_ "GenSigInvalidValue" SG_ 904 ACU_IFC_SpeedLimtType 0;
BA_ "GenSigSendType" SG_ 904 ACU_IFC_SpeedLimtType 1;
BA_ "GenSigStartValue" SG_ 904 ACU_IFC_SpeedLimtType 0;
BA_ "GenSigTimeoutValue" SG_ 904 ACU_IFC_SpeedLimtType 0;
BA_ "Remark" SG_ 904 ACU_IFC_SpeedLimtType "";
BA_ "EventCommandSignal" SG_ 904 ACU_IFC_RoadType 0;
BA_ "GatewayedSignals" SG_ 904 ACU_IFC_RoadType 0;
BA_ "GenSigInactiveValue" SG_ 904 ACU_IFC_RoadType 0;
BA_ "GenSigInvalidValue" SG_ 904 ACU_IFC_RoadType 0;
BA_ "GenSigSendType" SG_ 904 ACU_IFC_RoadType 1;
BA_ "GenSigStartValue" SG_ 904 ACU_IFC_RoadType 0;
BA_ "GenSigTimeoutValue" SG_ 904 ACU_IFC_RoadType 0;
BA_ "Remark" SG_ 904 ACU_IFC_RoadType "";
BA_ "EventCommandSignal" SG_ 904 ACU_IFC_ZoneCode 0;
BA_ "GatewayedSignals" SG_ 904 ACU_IFC_ZoneCode 0;
BA_ "GenSigInactiveValue" SG_ 904 ACU_IFC_ZoneCode 0;
BA_ "GenSigInvalidValue" SG_ 904 ACU_IFC_ZoneCode 0;
BA_ "GenSigSendType" SG_ 904 ACU_IFC_ZoneCode 1;
BA_ "GenSigStartValue" SG_ 904 ACU_IFC_ZoneCode 0;
BA_ "GenSigTimeoutValue" SG_ 904 ACU_IFC_ZoneCode 1;
BA_ "Remark" SG_ 904 ACU_IFC_ZoneCode "";
BA_ "EventCommandSignal" SG_ 904 ACU_IFC_NaviSt 0;
BA_ "GatewayedSignals" SG_ 904 ACU_IFC_NaviSt 0;
BA_ "GenSigInactiveValue" SG_ 904 ACU_IFC_NaviSt 0;
BA_ "GenSigInvalidValue" SG_ 904 ACU_IFC_NaviSt 0;
BA_ "GenSigSendType" SG_ 904 ACU_IFC_NaviSt 1;
BA_ "GenSigStartValue" SG_ 904 ACU_IFC_NaviSt 0;
BA_ "GenSigTimeoutValue" SG_ 904 ACU_IFC_NaviSt 0;
BA_ "Remark" SG_ 904 ACU_IFC_NaviSt "";
BA_ "EventCommandSignal" SG_ 904 ACU_IFC_NaviCorp 0;
BA_ "GatewayedSignals" SG_ 904 ACU_IFC_NaviCorp 0;
BA_ "GenSigInactiveValue" SG_ 904 ACU_IFC_NaviCorp 0;
BA_ "GenSigInvalidValue" SG_ 904 ACU_IFC_NaviCorp 0;
BA_ "GenSigSendType" SG_ 904 ACU_IFC_NaviCorp 1;
BA_ "GenSigStartValue" SG_ 904 ACU_IFC_NaviCorp 0;
BA_ "GenSigTimeoutValue" SG_ 904 ACU_IFC_NaviCorp 0;
BA_ "Remark" SG_ 904 ACU_IFC_NaviCorp "";
BA_ "EventCommandSignal" SG_ 904 ACU_IFC_NaviNewIconDis 0;
BA_ "GatewayedSignals" SG_ 904 ACU_IFC_NaviNewIconDis 0;
BA_ "GenSigInactiveValue" SG_ 904 ACU_IFC_NaviNewIconDis 0;
BA_ "GenSigInvalidValue" SG_ 904 ACU_IFC_NaviNewIconDis 0;
BA_ "GenSigSendType" SG_ 904 ACU_IFC_NaviNewIconDis 1;
BA_ "GenSigStartValue" SG_ 904 ACU_IFC_NaviNewIconDis 0;
BA_ "GenSigTimeoutValue" SG_ 904 ACU_IFC_NaviNewIconDis 0;
BA_ "Remark" SG_ 904 ACU_IFC_NaviNewIconDis "";
BA_ "EventCommandSignal" SG_ 904 ACU_IFC_OfframpSt 0;
BA_ "GatewayedSignals" SG_ 904 ACU_IFC_OfframpSt 0;
BA_ "GenSigInactiveValue" SG_ 904 ACU_IFC_OfframpSt 0;
BA_ "GenSigInvalidValue" SG_ 904 ACU_IFC_OfframpSt 0;
BA_ "GenSigSendType" SG_ 904 ACU_IFC_OfframpSt 1;
BA_ "GenSigStartValue" SG_ 904 ACU_IFC_OfframpSt 0;
BA_ "GenSigTimeoutValue" SG_ 904 ACU_IFC_OfframpSt 0;
BA_ "Remark" SG_ 904 ACU_IFC_OfframpSt "";
BA_ "EventCommandSignal" SG_ 904 ACU_IFC_NaviNewIcon 0;
BA_ "GatewayedSignals" SG_ 904 ACU_IFC_NaviNewIcon 0;
BA_ "GenSigInactiveValue" SG_ 904 ACU_IFC_NaviNewIcon 0;
BA_ "GenSigInvalidValue" SG_ 904 ACU_IFC_NaviNewIcon 0;
BA_ "GenSigSendType" SG_ 904 ACU_IFC_NaviNewIcon 1;
BA_ "GenSigStartValue" SG_ 904 ACU_IFC_NaviNewIcon 0;
BA_ "GenSigTimeoutValue" SG_ 904 ACU_IFC_NaviNewIcon 0;
BA_ "Remark" SG_ 904 ACU_IFC_NaviNewIcon "";
BA_ "EventCommandSignal" SG_ 904 ACU_IFC_SLCAheadDis 0;
BA_ "GatewayedSignals" SG_ 904 ACU_IFC_SLCAheadDis 0;
BA_ "GenSigInactiveValue" SG_ 904 ACU_IFC_SLCAheadDis 0;
BA_ "GenSigInvalidValue" SG_ 904 ACU_IFC_SLCAheadDis 0;
BA_ "GenSigSendType" SG_ 904 ACU_IFC_SLCAheadDis 1;
BA_ "GenSigStartValue" SG_ 904 ACU_IFC_SLCAheadDis 0;
BA_ "GenSigTimeoutValue" SG_ 904 ACU_IFC_SLCAheadDis 0;
BA_ "Remark" SG_ 904 ACU_IFC_SLCAheadDis "";
BA_ "EventCommandSignal" SG_ 904 ACU_DVR_Switch 0;
BA_ "GatewayedSignals" SG_ 904 ACU_DVR_Switch 0;
BA_ "GenSigInactiveValue" SG_ 904 ACU_DVR_Switch 0;
BA_ "GenSigInvalidValue" SG_ 904 ACU_DVR_Switch 0;
BA_ "GenSigSendType" SG_ 904 ACU_DVR_Switch 1;
BA_ "GenSigStartValue" SG_ 904 ACU_DVR_Switch 0;
BA_ "GenSigTimeoutValue" SG_ 904 ACU_DVR_Switch 0;
BA_ "Remark" SG_ 904 ACU_DVR_Switch "";
BA_ "EventCommandSignal" SG_ 904 ACU_IFC_OfframpDis 0;
BA_ "GatewayedSignals" SG_ 904 ACU_IFC_OfframpDis 0;
BA_ "GenSigInactiveValue" SG_ 904 ACU_IFC_OfframpDis 0;
BA_ "GenSigInvalidValue" SG_ 904 ACU_IFC_OfframpDis 0;
BA_ "GenSigSendType" SG_ 904 ACU_IFC_OfframpDis 1;
BA_ "GenSigStartValue" SG_ 904 ACU_IFC_OfframpDis 254;
BA_ "GenSigTimeoutValue" SG_ 904 ACU_IFC_OfframpDis 254;
BA_ "Remark" SG_ 904 ACU_IFC_OfframpDis "";
BA_ "EventCommandSignal" SG_ 904 SSW_DRSeatSlideCurrentPst 0;
BA_ "GatewayedSignals" SG_ 904 SSW_DRSeatSlideCurrentPst 0;
BA_ "GenSigInactiveValue" SG_ 904 SSW_DRSeatSlideCurrentPst 0;
BA_ "GenSigInvalidValue" SG_ 904 SSW_DRSeatSlideCurrentPst 0;
BA_ "GenSigSendType" SG_ 904 SSW_DRSeatSlideCurrentPst 1;
BA_ "GenSigStartValue" SG_ 904 SSW_DRSeatSlideCurrentPst 255;
BA_ "GenSigTimeoutValue" SG_ 904 SSW_DRSeatSlideCurrentPst 0;
BA_ "Remark" SG_ 904 SSW_DRSeatSlideCurrentPst "";
BA_ "EventCommandSignal" SG_ 904 SSW_DRSeatHeightCurrentPst 0;
BA_ "GatewayedSignals" SG_ 904 SSW_DRSeatHeightCurrentPst 0;
BA_ "GenSigInactiveValue" SG_ 904 SSW_DRSeatHeightCurrentPst 0;
BA_ "GenSigInvalidValue" SG_ 904 SSW_DRSeatHeightCurrentPst 0;
BA_ "GenSigSendType" SG_ 904 SSW_DRSeatHeightCurrentPst 1;
BA_ "GenSigStartValue" SG_ 904 SSW_DRSeatHeightCurrentPst 255;
BA_ "GenSigTimeoutValue" SG_ 904 SSW_DRSeatHeightCurrentPst 0;
BA_ "Remark" SG_ 904 SSW_DRSeatHeightCurrentPst "";
BA_ "EventCommandSignal" SG_ 904 SSW_DRSeatBackrestCurrentPst 0;
BA_ "GatewayedSignals" SG_ 904 SSW_DRSeatBackrestCurrentPst 0;
BA_ "GenSigInactiveValue" SG_ 904 SSW_DRSeatBackrestCurrentPst 0;
BA_ "GenSigInvalidValue" SG_ 904 SSW_DRSeatBackrestCurrentPst 0;
BA_ "GenSigSendType" SG_ 904 SSW_DRSeatBackrestCurrentPst 1;
BA_ "GenSigStartValue" SG_ 904 SSW_DRSeatBackrestCurrentPst 255;
BA_ "GenSigTimeoutValue" SG_ 904 SSW_DRSeatBackrestCurrentPst 0;
BA_ "Remark" SG_ 904 SSW_DRSeatBackrestCurrentPst "";
BA_ "EventCommandSignal" SG_ 904 DrvrSideMotResp 0;
BA_ "GatewayedSignals" SG_ 904 DrvrSideMotResp 0;
BA_ "GenSigInactiveValue" SG_ 904 DrvrSideMotResp 0;
BA_ "GenSigInvalidValue" SG_ 904 DrvrSideMotResp 0;
BA_ "GenSigSendType" SG_ 904 DrvrSideMotResp 1;
BA_ "GenSigStartValue" SG_ 904 DrvrSideMotResp 0;
BA_ "GenSigTimeoutValue" SG_ 904 DrvrSideMotResp 15;
BA_ "Remark" SG_ 904 DrvrSideMotResp "";
BA_ "EventCommandSignal" SG_ 904 IPDS_BAT1PowerSt 0;
BA_ "GatewayedSignals" SG_ 904 IPDS_BAT1PowerSt 0;
BA_ "GenSigInactiveValue" SG_ 904 IPDS_BAT1PowerSt 0;
BA_ "GenSigInvalidValue" SG_ 904 IPDS_BAT1PowerSt 0;
BA_ "GenSigSendType" SG_ 904 IPDS_BAT1PowerSt 1;
BA_ "GenSigStartValue" SG_ 904 IPDS_BAT1PowerSt 1;
BA_ "GenSigTimeoutValue" SG_ 904 IPDS_BAT1PowerSt 0;
BA_ "Remark" SG_ 904 IPDS_BAT1PowerSt "";
BA_ "EventCommandSignal" SG_ 904 IPDS_BAT2PowerSt 0;
BA_ "GatewayedSignals" SG_ 904 IPDS_BAT2PowerSt 0;
BA_ "GenSigInactiveValue" SG_ 904 IPDS_BAT2PowerSt 0;
BA_ "GenSigInvalidValue" SG_ 904 IPDS_BAT2PowerSt 0;
BA_ "GenSigSendType" SG_ 904 IPDS_BAT2PowerSt 1;
BA_ "GenSigStartValue" SG_ 904 IPDS_BAT2PowerSt 1;
BA_ "GenSigTimeoutValue" SG_ 904 IPDS_BAT2PowerSt 0;
BA_ "Remark" SG_ 904 IPDS_BAT2PowerSt "";
BA_ "EventCommandSignal" SG_ 904 IPDS_DCDC2PowerSt 0;
BA_ "GatewayedSignals" SG_ 904 IPDS_DCDC2PowerSt 0;
BA_ "GenSigInactiveValue" SG_ 904 IPDS_DCDC2PowerSt 0;
BA_ "GenSigInvalidValue" SG_ 904 IPDS_DCDC2PowerSt 0;
BA_ "GenSigSendType" SG_ 904 IPDS_DCDC2PowerSt 1;
BA_ "GenSigStartValue" SG_ 904 IPDS_DCDC2PowerSt 1;
BA_ "GenSigTimeoutValue" SG_ 904 IPDS_DCDC2PowerSt 0;
BA_ "Remark" SG_ 904 IPDS_DCDC2PowerSt "";
BA_ "EventCommandSignal" SG_ 904 IPDS_GridIsoPowerSt 0;
BA_ "GatewayedSignals" SG_ 904 IPDS_GridIsoPowerSt 0;
BA_ "GenSigInactiveValue" SG_ 904 IPDS_GridIsoPowerSt 0;
BA_ "GenSigInvalidValue" SG_ 904 IPDS_GridIsoPowerSt 0;
BA_ "GenSigSendType" SG_ 904 IPDS_GridIsoPowerSt 1;
BA_ "GenSigStartValue" SG_ 904 IPDS_GridIsoPowerSt 1;
BA_ "GenSigTimeoutValue" SG_ 904 IPDS_GridIsoPowerSt 1;
BA_ "Remark" SG_ 904 IPDS_GridIsoPowerSt "";
BA_ "EventCommandSignal" SG_ 935 SR_SunroofCurrentPst 0;
BA_ "GatewayedSignals" SG_ 935 SR_SunroofCurrentPst 0;
BA_ "GenSigInactiveValue" SG_ 935 SR_SunroofCurrentPst 0;
BA_ "GenSigInvalidValue" SG_ 935 SR_SunroofCurrentPst 0;
BA_ "GenSigSendType" SG_ 935 SR_SunroofCurrentPst 1;
BA_ "GenSigStartValue" SG_ 935 SR_SunroofCurrentPst 255;
BA_ "GenSigTimeoutValue" SG_ 935 SR_SunroofCurrentPst 0;
BA_ "Remark" SG_ 935 SR_SunroofCurrentPst "";
BA_ "EventCommandSignal" SG_ 957 HOD_1_CRC 0;
BA_ "GatewayedSignals" SG_ 957 HOD_1_CRC 0;
BA_ "GenSigInactiveValue" SG_ 957 HOD_1_CRC 0;
BA_ "GenSigInvalidValue" SG_ 957 HOD_1_CRC 0;
BA_ "GenSigSendType" SG_ 957 HOD_1_CRC 1;
BA_ "GenSigStartValue" SG_ 957 HOD_1_CRC 0;
BA_ "GenSigTimeoutValue" SG_ 957 HOD_1_CRC 0;
BA_ "Remark" SG_ 957 HOD_1_CRC "";
BA_ "EventCommandSignal" SG_ 957 HOD_1_Counter 0;
BA_ "GatewayedSignals" SG_ 957 HOD_1_Counter 0;
BA_ "GenSigInactiveValue" SG_ 957 HOD_1_Counter 0;
BA_ "GenSigInvalidValue" SG_ 957 HOD_1_Counter 0;
BA_ "GenSigSendType" SG_ 957 HOD_1_Counter 1;
BA_ "GenSigStartValue" SG_ 957 HOD_1_Counter 0;
BA_ "GenSigTimeoutValue" SG_ 957 HOD_1_Counter 0;
BA_ "Remark" SG_ 957 HOD_1_Counter "";
BA_ "EventCommandSignal" SG_ 957 HOD_St 0;
BA_ "GatewayedSignals" SG_ 957 HOD_St 0;
BA_ "GenSigInactiveValue" SG_ 957 HOD_St 0;
BA_ "GenSigInvalidValue" SG_ 957 HOD_St 0;
BA_ "GenSigSendType" SG_ 957 HOD_St 1;
BA_ "GenSigStartValue" SG_ 957 HOD_St 0;
BA_ "GenSigTimeoutValue" SG_ 957 HOD_St 0;
BA_ "Remark" SG_ 957 HOD_St "";
BA_ "EventCommandSignal" SG_ 957 HOD_TouchZone1 0;
BA_ "GatewayedSignals" SG_ 957 HOD_TouchZone1 0;
BA_ "GenSigInactiveValue" SG_ 957 HOD_TouchZone1 0;
BA_ "GenSigInvalidValue" SG_ 957 HOD_TouchZone1 0;
BA_ "GenSigSendType" SG_ 957 HOD_TouchZone1 1;
BA_ "GenSigStartValue" SG_ 957 HOD_TouchZone1 0;
BA_ "GenSigTimeoutValue" SG_ 957 HOD_TouchZone1 0;
BA_ "Remark" SG_ 957 HOD_TouchZone1 "";
BA_ "EventCommandSignal" SG_ 957 HOD_TouchZone2 0;
BA_ "GatewayedSignals" SG_ 957 HOD_TouchZone2 0;
BA_ "GenSigInactiveValue" SG_ 957 HOD_TouchZone2 0;
BA_ "GenSigInvalidValue" SG_ 957 HOD_TouchZone2 0;
BA_ "GenSigSendType" SG_ 957 HOD_TouchZone2 1;
BA_ "GenSigStartValue" SG_ 957 HOD_TouchZone2 0;
BA_ "GenSigTimeoutValue" SG_ 957 HOD_TouchZone2 0;
BA_ "Remark" SG_ 957 HOD_TouchZone2 "";
BA_ "EventCommandSignal" SG_ 957 HOD_TouchZone3 0;
BA_ "GatewayedSignals" SG_ 957 HOD_TouchZone3 0;
BA_ "GenSigInactiveValue" SG_ 957 HOD_TouchZone3 0;
BA_ "GenSigInvalidValue" SG_ 957 HOD_TouchZone3 0;
BA_ "GenSigSendType" SG_ 957 HOD_TouchZone3 1;
BA_ "GenSigStartValue" SG_ 957 HOD_TouchZone3 0;
BA_ "GenSigTimeoutValue" SG_ 957 HOD_TouchZone3 0;
BA_ "Remark" SG_ 957 HOD_TouchZone3 "";
BA_ "EventCommandSignal" SG_ 957 HOD_HeatingSt 0;
BA_ "GatewayedSignals" SG_ 957 HOD_HeatingSt 0;
BA_ "GenSigInactiveValue" SG_ 957 HOD_HeatingSt 0;
BA_ "GenSigInvalidValue" SG_ 957 HOD_HeatingSt 0;
BA_ "GenSigSendType" SG_ 957 HOD_HeatingSt 1;
BA_ "GenSigStartValue" SG_ 957 HOD_HeatingSt 0;
BA_ "GenSigTimeoutValue" SG_ 957 HOD_HeatingSt 0;
BA_ "Remark" SG_ 957 HOD_HeatingSt "";
BA_ "EventCommandSignal" SG_ 957 HOD_CalibrationSt 0;
BA_ "GatewayedSignals" SG_ 957 HOD_CalibrationSt 0;
BA_ "GenSigInactiveValue" SG_ 957 HOD_CalibrationSt 0;
BA_ "GenSigInvalidValue" SG_ 957 HOD_CalibrationSt 0;
BA_ "GenSigSendType" SG_ 957 HOD_CalibrationSt 1;
BA_ "GenSigStartValue" SG_ 957 HOD_CalibrationSt 0;
BA_ "GenSigTimeoutValue" SG_ 957 HOD_CalibrationSt 0;
BA_ "Remark" SG_ 957 HOD_CalibrationSt "";
BA_ "EventCommandSignal" SG_ 957 HOD_LINComFault 0;
BA_ "GatewayedSignals" SG_ 957 HOD_LINComFault 0;
BA_ "GenSigInactiveValue" SG_ 957 HOD_LINComFault 0;
BA_ "GenSigInvalidValue" SG_ 957 HOD_LINComFault 0;
BA_ "GenSigSendType" SG_ 957 HOD_LINComFault 1;
BA_ "GenSigStartValue" SG_ 957 HOD_LINComFault 0;
BA_ "GenSigTimeoutValue" SG_ 957 HOD_LINComFault 0;
BA_ "Remark" SG_ 957 HOD_LINComFault "";
BA_ "EventCommandSignal" SG_ 957 HOD_FaultSt 0;
BA_ "GatewayedSignals" SG_ 957 HOD_FaultSt 0;
BA_ "GenSigInactiveValue" SG_ 957 HOD_FaultSt 0;
BA_ "GenSigInvalidValue" SG_ 957 HOD_FaultSt 0;
BA_ "GenSigSendType" SG_ 957 HOD_FaultSt 1;
BA_ "GenSigStartValue" SG_ 957 HOD_FaultSt 0;
BA_ "GenSigTimeoutValue" SG_ 957 HOD_FaultSt 0;
BA_ "Remark" SG_ 957 HOD_FaultSt "";
BA_ "EventCommandSignal" SG_ 957 HOD_VBattOORFault 0;
BA_ "GatewayedSignals" SG_ 957 HOD_VBattOORFault 0;
BA_ "GenSigInactiveValue" SG_ 957 HOD_VBattOORFault 0;
BA_ "GenSigInvalidValue" SG_ 957 HOD_VBattOORFault 0;
BA_ "GenSigSendType" SG_ 957 HOD_VBattOORFault 1;
BA_ "GenSigStartValue" SG_ 957 HOD_VBattOORFault 0;
BA_ "GenSigTimeoutValue" SG_ 957 HOD_VBattOORFault 0;
BA_ "Remark" SG_ 957 HOD_VBattOORFault "";
BA_ "EventCommandSignal" SG_ 957 HOD_HeatingOtherFaultSt 0;
BA_ "GatewayedSignals" SG_ 957 HOD_HeatingOtherFaultSt 0;
BA_ "GenSigInactiveValue" SG_ 957 HOD_HeatingOtherFaultSt 0;
BA_ "GenSigInvalidValue" SG_ 957 HOD_HeatingOtherFaultSt 0;
BA_ "GenSigSendType" SG_ 957 HOD_HeatingOtherFaultSt 1;
BA_ "GenSigStartValue" SG_ 957 HOD_HeatingOtherFaultSt 0;
BA_ "GenSigTimeoutValue" SG_ 957 HOD_HeatingOtherFaultSt 0;
BA_ "Remark" SG_ 957 HOD_HeatingOtherFaultSt "";
BA_ "EventCommandSignal" SG_ 957 HOD_HeatingOverUnderCurrentSt 0;
BA_ "GatewayedSignals" SG_ 957 HOD_HeatingOverUnderCurrentSt 0;
BA_ "GenSigInactiveValue" SG_ 957 HOD_HeatingOverUnderCurrentSt 0;
BA_ "GenSigInvalidValue" SG_ 957 HOD_HeatingOverUnderCurrentSt 0;
BA_ "GenSigSendType" SG_ 957 HOD_HeatingOverUnderCurrentSt 1;
BA_ "GenSigStartValue" SG_ 957 HOD_HeatingOverUnderCurrentSt 0;
BA_ "GenSigTimeoutValue" SG_ 957 HOD_HeatingOverUnderCurrentSt 0;
BA_ "Remark" SG_ 957 HOD_HeatingOverUnderCurrentSt "";
BA_ "EventCommandSignal" SG_ 957 HOD_HeatingThermSt 0;
BA_ "GatewayedSignals" SG_ 957 HOD_HeatingThermSt 0;
BA_ "GenSigInactiveValue" SG_ 957 HOD_HeatingThermSt 0;
BA_ "GenSigInvalidValue" SG_ 957 HOD_HeatingThermSt 0;
BA_ "GenSigSendType" SG_ 957 HOD_HeatingThermSt 1;
BA_ "GenSigStartValue" SG_ 957 HOD_HeatingThermSt 0;
BA_ "GenSigTimeoutValue" SG_ 957 HOD_HeatingThermSt 0;
BA_ "Remark" SG_ 957 HOD_HeatingThermSt "";
BA_ "EventCommandSignal" SG_ 957 HOD_HeatingTempOutSt 0;
BA_ "GatewayedSignals" SG_ 957 HOD_HeatingTempOutSt 0;
BA_ "GenSigInactiveValue" SG_ 957 HOD_HeatingTempOutSt 0;
BA_ "GenSigInvalidValue" SG_ 957 HOD_HeatingTempOutSt 0;
BA_ "GenSigSendType" SG_ 957 HOD_HeatingTempOutSt 1;
BA_ "GenSigStartValue" SG_ 957 HOD_HeatingTempOutSt 0;
BA_ "GenSigTimeoutValue" SG_ 957 HOD_HeatingTempOutSt 0;
BA_ "Remark" SG_ 957 HOD_HeatingTempOutSt "";
BA_ "EventCommandSignal" SG_ 957 HOD_Typ 0;
BA_ "GatewayedSignals" SG_ 957 HOD_Typ 0;
BA_ "GenSigInactiveValue" SG_ 957 HOD_Typ 0;
BA_ "GenSigInvalidValue" SG_ 957 HOD_Typ 0;
BA_ "GenSigSendType" SG_ 957 HOD_Typ 1;
BA_ "GenSigStartValue" SG_ 957 HOD_Typ 0;
BA_ "GenSigTimeoutValue" SG_ 957 HOD_Typ 0;
BA_ "Remark" SG_ 957 HOD_Typ "";
BA_ "EventCommandSignal" SG_ 957 HOD_TouchIntensityZone1 0;
BA_ "GatewayedSignals" SG_ 957 HOD_TouchIntensityZone1 0;
BA_ "GenSigInactiveValue" SG_ 957 HOD_TouchIntensityZone1 0;
BA_ "GenSigInvalidValue" SG_ 957 HOD_TouchIntensityZone1 0;
BA_ "GenSigSendType" SG_ 957 HOD_TouchIntensityZone1 1;
BA_ "GenSigStartValue" SG_ 957 HOD_TouchIntensityZone1 0;
BA_ "GenSigTimeoutValue" SG_ 957 HOD_TouchIntensityZone1 0;
BA_ "Remark" SG_ 957 HOD_TouchIntensityZone1 "";
BA_ "EventCommandSignal" SG_ 957 HOD_TouchIntensityZone2 0;
BA_ "GatewayedSignals" SG_ 957 HOD_TouchIntensityZone2 0;
BA_ "GenSigInactiveValue" SG_ 957 HOD_TouchIntensityZone2 0;
BA_ "GenSigInvalidValue" SG_ 957 HOD_TouchIntensityZone2 0;
BA_ "GenSigSendType" SG_ 957 HOD_TouchIntensityZone2 1;
BA_ "GenSigStartValue" SG_ 957 HOD_TouchIntensityZone2 0;
BA_ "GenSigTimeoutValue" SG_ 957 HOD_TouchIntensityZone2 0;
BA_ "Remark" SG_ 957 HOD_TouchIntensityZone2 "";
BA_ "EventCommandSignal" SG_ 957 HOD_TouchIntensityZone3 0;
BA_ "GatewayedSignals" SG_ 957 HOD_TouchIntensityZone3 0;
BA_ "GenSigInactiveValue" SG_ 957 HOD_TouchIntensityZone3 0;
BA_ "GenSigInvalidValue" SG_ 957 HOD_TouchIntensityZone3 0;
BA_ "GenSigSendType" SG_ 957 HOD_TouchIntensityZone3 1;
BA_ "GenSigStartValue" SG_ 957 HOD_TouchIntensityZone3 0;
BA_ "GenSigTimeoutValue" SG_ 957 HOD_TouchIntensityZone3 0;
BA_ "Remark" SG_ 957 HOD_TouchIntensityZone3 "";
BA_ "EventCommandSignal" SG_ 957 HOD_SysErr 0;
BA_ "GatewayedSignals" SG_ 957 HOD_SysErr 0;
BA_ "GenSigInactiveValue" SG_ 957 HOD_SysErr 0;
BA_ "GenSigInvalidValue" SG_ 957 HOD_SysErr 0;
BA_ "GenSigSendType" SG_ 957 HOD_SysErr 1;
BA_ "GenSigStartValue" SG_ 957 HOD_SysErr 0;
BA_ "GenSigTimeoutValue" SG_ 957 HOD_SysErr 0;
BA_ "Remark" SG_ 957 HOD_SysErr "";
BA_ "EventCommandSignal" SG_ 360 BCS_6_CRC 0;
BA_ "GatewayedSignals" SG_ 360 BCS_6_CRC 0;
BA_ "GenSigInactiveValue" SG_ 360 BCS_6_CRC 0;
BA_ "GenSigInvalidValue" SG_ 360 BCS_6_CRC 0;
BA_ "GenSigSendType" SG_ 360 BCS_6_CRC 1;
BA_ "GenSigStartValue" SG_ 360 BCS_6_CRC 0;
BA_ "GenSigTimeoutValue" SG_ 360 BCS_6_CRC 0;
BA_ "Remark" SG_ 360 BCS_6_CRC "";
BA_ "EventCommandSignal" SG_ 360 BCS_6_Counter 0;
BA_ "GatewayedSignals" SG_ 360 BCS_6_Counter 0;
BA_ "GenSigInactiveValue" SG_ 360 BCS_6_Counter 0;
BA_ "GenSigInvalidValue" SG_ 360 BCS_6_Counter 0;
BA_ "GenSigSendType" SG_ 360 BCS_6_Counter 1;
BA_ "GenSigStartValue" SG_ 360 BCS_6_Counter 0;
BA_ "GenSigTimeoutValue" SG_ 360 BCS_6_Counter 0;
BA_ "Remark" SG_ 360 BCS_6_Counter "";
BA_ "EventCommandSignal" SG_ 360 BCS_HydBrkActTorqFL 0;
BA_ "GatewayedSignals" SG_ 360 BCS_HydBrkActTorqFL 0;
BA_ "GenSigInactiveValue" SG_ 360 BCS_HydBrkActTorqFL 0;
BA_ "GenSigInvalidValue" SG_ 360 BCS_HydBrkActTorqFL 0;
BA_ "GenSigSendType" SG_ 360 BCS_HydBrkActTorqFL 1;
BA_ "GenSigStartValue" SG_ 360 BCS_HydBrkActTorqFL 0;
BA_ "GenSigTimeoutValue" SG_ 360 BCS_HydBrkActTorqFL 0;
BA_ "Remark" SG_ 360 BCS_HydBrkActTorqFL "";
BA_ "EventCommandSignal" SG_ 360 BCS_HydBrkActTorqFR 0;
BA_ "GatewayedSignals" SG_ 360 BCS_HydBrkActTorqFR 0;
BA_ "GenSigInactiveValue" SG_ 360 BCS_HydBrkActTorqFR 0;
BA_ "GenSigInvalidValue" SG_ 360 BCS_HydBrkActTorqFR 0;
BA_ "GenSigSendType" SG_ 360 BCS_HydBrkActTorqFR 1;
BA_ "GenSigStartValue" SG_ 360 BCS_HydBrkActTorqFR 0;
BA_ "GenSigTimeoutValue" SG_ 360 BCS_HydBrkActTorqFR 0;
BA_ "Remark" SG_ 360 BCS_HydBrkActTorqFR "";
BA_ "EventCommandSignal" SG_ 360 BCS_HydBrkActTorqRL 0;
BA_ "GatewayedSignals" SG_ 360 BCS_HydBrkActTorqRL 0;
BA_ "GenSigInactiveValue" SG_ 360 BCS_HydBrkActTorqRL 0;
BA_ "GenSigInvalidValue" SG_ 360 BCS_HydBrkActTorqRL 0;
BA_ "GenSigSendType" SG_ 360 BCS_HydBrkActTorqRL 1;
BA_ "GenSigStartValue" SG_ 360 BCS_HydBrkActTorqRL 0;
BA_ "GenSigTimeoutValue" SG_ 360 BCS_HydBrkActTorqRL 0;
BA_ "Remark" SG_ 360 BCS_HydBrkActTorqRL "";
BA_ "EventCommandSignal" SG_ 360 BCS_HydBrkActTorqRR 0;
BA_ "GatewayedSignals" SG_ 360 BCS_HydBrkActTorqRR 0;
BA_ "GenSigInactiveValue" SG_ 360 BCS_HydBrkActTorqRR 0;
BA_ "GenSigInvalidValue" SG_ 360 BCS_HydBrkActTorqRR 0;
BA_ "GenSigSendType" SG_ 360 BCS_HydBrkActTorqRR 1;
BA_ "GenSigStartValue" SG_ 360 BCS_HydBrkActTorqRR 0;
BA_ "GenSigTimeoutValue" SG_ 360 BCS_HydBrkActTorqRR 0;
BA_ "Remark" SG_ 360 BCS_HydBrkActTorqRR "";
BA_ "EventCommandSignal" SG_ 360 BCS_HydBrkTorqReq 0;
BA_ "GatewayedSignals" SG_ 360 BCS_HydBrkTorqReq 0;
BA_ "GenSigInactiveValue" SG_ 360 BCS_HydBrkTorqReq 0;
BA_ "GenSigInvalidValue" SG_ 360 BCS_HydBrkTorqReq 0;
BA_ "GenSigSendType" SG_ 360 BCS_HydBrkTorqReq 1;
BA_ "GenSigStartValue" SG_ 360 BCS_HydBrkTorqReq 0;
BA_ "GenSigTimeoutValue" SG_ 360 BCS_HydBrkTorqReq 0;
BA_ "Remark" SG_ 360 BCS_HydBrkTorqReq "";
BA_ "EventCommandSignal" SG_ 360 BCS_BrkActTorq 0;
BA_ "GatewayedSignals" SG_ 360 BCS_BrkActTorq 0;
BA_ "GenSigInactiveValue" SG_ 360 BCS_BrkActTorq 0;
BA_ "GenSigInvalidValue" SG_ 360 BCS_BrkActTorq 0;
BA_ "GenSigSendType" SG_ 360 BCS_BrkActTorq 1;
BA_ "GenSigStartValue" SG_ 360 BCS_BrkActTorq 0;
BA_ "GenSigTimeoutValue" SG_ 360 BCS_BrkActTorq 0;
BA_ "Remark" SG_ 360 BCS_BrkActTorq "";
BA_ "EventCommandSignal" SG_ 360 BCS_HydBrkActTorq 0;
BA_ "GatewayedSignals" SG_ 360 BCS_HydBrkActTorq 0;
BA_ "GenSigInactiveValue" SG_ 360 BCS_HydBrkActTorq 0;
BA_ "GenSigInvalidValue" SG_ 360 BCS_HydBrkActTorq 0;
BA_ "GenSigSendType" SG_ 360 BCS_HydBrkActTorq 1;
BA_ "GenSigStartValue" SG_ 360 BCS_HydBrkActTorq 0;
BA_ "GenSigTimeoutValue" SG_ 360 BCS_HydBrkActTorq 0;
BA_ "Remark" SG_ 360 BCS_HydBrkActTorq "";
BA_ "EventCommandSignal" SG_ 360 BCS_DycActTorq 0;
BA_ "GatewayedSignals" SG_ 360 BCS_DycActTorq 0;
BA_ "GenSigInactiveValue" SG_ 360 BCS_DycActTorq 0;
BA_ "GenSigInvalidValue" SG_ 360 BCS_DycActTorq 0;
BA_ "GenSigSendType" SG_ 360 BCS_DycActTorq 1;
BA_ "GenSigStartValue" SG_ 360 BCS_DycActTorq 0;
BA_ "GenSigTimeoutValue" SG_ 360 BCS_DycActTorq 0;
BA_ "Remark" SG_ 360 BCS_DycActTorq "";
BA_ "EventCommandSignal" SG_ 360 BCS_ChVehSpd 0;
BA_ "GatewayedSignals" SG_ 360 BCS_ChVehSpd 0;
BA_ "GenSigInactiveValue" SG_ 360 BCS_ChVehSpd 0;
BA_ "GenSigInvalidValue" SG_ 360 BCS_ChVehSpd 0;
BA_ "GenSigSendType" SG_ 360 BCS_ChVehSpd 1;
BA_ "GenSigStartValue" SG_ 360 BCS_ChVehSpd 0;
BA_ "GenSigTimeoutValue" SG_ 360 BCS_ChVehSpd 0;
BA_ "Remark" SG_ 360 BCS_ChVehSpd "";
BA_ "EventCommandSignal" SG_ 360 BCS_BrkTqCtrlAvlDriving 0;
BA_ "GatewayedSignals" SG_ 360 BCS_BrkTqCtrlAvlDriving 0;
BA_ "GenSigInactiveValue" SG_ 360 BCS_BrkTqCtrlAvlDriving 0;
BA_ "GenSigInvalidValue" SG_ 360 BCS_BrkTqCtrlAvlDriving 0;
BA_ "GenSigSendType" SG_ 360 BCS_BrkTqCtrlAvlDriving 1;
BA_ "GenSigStartValue" SG_ 360 BCS_BrkTqCtrlAvlDriving 0;
BA_ "GenSigTimeoutValue" SG_ 360 BCS_BrkTqCtrlAvlDriving 0;
BA_ "Remark" SG_ 360 BCS_BrkTqCtrlAvlDriving "";
BA_ "EventCommandSignal" SG_ 360 BCS_BrkTqCtrlAvlParking 0;
BA_ "GatewayedSignals" SG_ 360 BCS_BrkTqCtrlAvlParking 0;
BA_ "GenSigInactiveValue" SG_ 360 BCS_BrkTqCtrlAvlParking 0;
BA_ "GenSigInvalidValue" SG_ 360 BCS_BrkTqCtrlAvlParking 0;
BA_ "GenSigSendType" SG_ 360 BCS_BrkTqCtrlAvlParking 1;
BA_ "GenSigStartValue" SG_ 360 BCS_BrkTqCtrlAvlParking 0;
BA_ "GenSigTimeoutValue" SG_ 360 BCS_BrkTqCtrlAvlParking 0;
BA_ "Remark" SG_ 360 BCS_BrkTqCtrlAvlParking "";
BA_ "EventCommandSignal" SG_ 360 BCS_BrkTqCtrlActv 0;
BA_ "GatewayedSignals" SG_ 360 BCS_BrkTqCtrlActv 0;
BA_ "GenSigInactiveValue" SG_ 360 BCS_BrkTqCtrlActv 0;
BA_ "GenSigInvalidValue" SG_ 360 BCS_BrkTqCtrlActv 0;
BA_ "GenSigSendType" SG_ 360 BCS_BrkTqCtrlActv 1;
BA_ "GenSigStartValue" SG_ 360 BCS_BrkTqCtrlActv 0;
BA_ "GenSigTimeoutValue" SG_ 360 BCS_BrkTqCtrlActv 0;
BA_ "Remark" SG_ 360 BCS_BrkTqCtrlActv "";
BA_ "EventCommandSignal" SG_ 360 BCS_ChVehSpdVD 0;
BA_ "GatewayedSignals" SG_ 360 BCS_ChVehSpdVD 0;
BA_ "GenSigInactiveValue" SG_ 360 BCS_ChVehSpdVD 0;
BA_ "GenSigInvalidValue" SG_ 360 BCS_ChVehSpdVD 0;
BA_ "GenSigSendType" SG_ 360 BCS_ChVehSpdVD 1;
BA_ "GenSigStartValue" SG_ 360 BCS_ChVehSpdVD 0;
BA_ "GenSigTimeoutValue" SG_ 360 BCS_ChVehSpdVD 0;
BA_ "Remark" SG_ 360 BCS_ChVehSpdVD "";
BA_ "EventCommandSignal" SG_ 360 BCS_ESCFailSt 0;
BA_ "GatewayedSignals" SG_ 360 BCS_ESCFailSt 0;
BA_ "GenSigInactiveValue" SG_ 360 BCS_ESCFailSt 0;
BA_ "GenSigInvalidValue" SG_ 360 BCS_ESCFailSt 0;
BA_ "GenSigSendType" SG_ 360 BCS_ESCFailSt 1;
BA_ "GenSigStartValue" SG_ 360 BCS_ESCFailSt 1;
BA_ "GenSigTimeoutValue" SG_ 360 BCS_ESCFailSt 1;
BA_ "Remark" SG_ 360 BCS_ESCFailSt "";
BA_ "EventCommandSignal" SG_ 360 BCS_ESCFuncActiveSt 0;
BA_ "GatewayedSignals" SG_ 360 BCS_ESCFuncActiveSt 0;
BA_ "GenSigInactiveValue" SG_ 360 BCS_ESCFuncActiveSt 0;
BA_ "GenSigInvalidValue" SG_ 360 BCS_ESCFuncActiveSt 0;
BA_ "GenSigSendType" SG_ 360 BCS_ESCFuncActiveSt 1;
BA_ "GenSigStartValue" SG_ 360 BCS_ESCFuncActiveSt 0;
BA_ "GenSigTimeoutValue" SG_ 360 BCS_ESCFuncActiveSt 0;
BA_ "Remark" SG_ 360 BCS_ESCFuncActiveSt "";
BA_ "EventCommandSignal" SG_ 360 BCS_DycEscTarTqCtrlAvl 0;
BA_ "GatewayedSignals" SG_ 360 BCS_DycEscTarTqCtrlAvl 0;
BA_ "GenSigInactiveValue" SG_ 360 BCS_DycEscTarTqCtrlAvl 0;
BA_ "GenSigInvalidValue" SG_ 360 BCS_DycEscTarTqCtrlAvl 0;
BA_ "GenSigSendType" SG_ 360 BCS_DycEscTarTqCtrlAvl 1;
BA_ "GenSigStartValue" SG_ 360 BCS_DycEscTarTqCtrlAvl 0;
BA_ "GenSigTimeoutValue" SG_ 360 BCS_DycEscTarTqCtrlAvl 0;
BA_ "Remark" SG_ 360 BCS_DycEscTarTqCtrlAvl "";
BA_ "EventCommandSignal" SG_ 360 BCS_errorFb 0;
BA_ "GatewayedSignals" SG_ 360 BCS_errorFb 0;
BA_ "GenSigInactiveValue" SG_ 360 BCS_errorFb 0;
BA_ "GenSigInvalidValue" SG_ 360 BCS_errorFb 0;
BA_ "GenSigSendType" SG_ 360 BCS_errorFb 1;
BA_ "GenSigStartValue" SG_ 360 BCS_errorFb 0;
BA_ "GenSigTimeoutValue" SG_ 360 BCS_errorFb 0;
BA_ "Remark" SG_ 360 BCS_errorFb "";
BA_ "EventCommandSignal" SG_ 360 BCS_DrvrBrkOvrd 0;
BA_ "GatewayedSignals" SG_ 360 BCS_DrvrBrkOvrd 0;
BA_ "GenSigInactiveValue" SG_ 360 BCS_DrvrBrkOvrd 0;
BA_ "GenSigInvalidValue" SG_ 360 BCS_DrvrBrkOvrd 0;
BA_ "GenSigSendType" SG_ 360 BCS_DrvrBrkOvrd 1;
BA_ "GenSigStartValue" SG_ 360 BCS_DrvrBrkOvrd 0;
BA_ "GenSigTimeoutValue" SG_ 360 BCS_DrvrBrkOvrd 0;
BA_ "Remark" SG_ 360 BCS_DrvrBrkOvrd "";
BA_ "EventCommandSignal" SG_ 360 BCS_DrvrBrkOvrdVD 0;
BA_ "GatewayedSignals" SG_ 360 BCS_DrvrBrkOvrdVD 0;
BA_ "GenSigInactiveValue" SG_ 360 BCS_DrvrBrkOvrdVD 0;
BA_ "GenSigInvalidValue" SG_ 360 BCS_DrvrBrkOvrdVD 0;
BA_ "GenSigSendType" SG_ 360 BCS_DrvrBrkOvrdVD 1;
BA_ "GenSigStartValue" SG_ 360 BCS_DrvrBrkOvrdVD 0;
BA_ "GenSigTimeoutValue" SG_ 360 BCS_DrvrBrkOvrdVD 0;
BA_ "Remark" SG_ 360 BCS_DrvrBrkOvrdVD "";
BA_ "EventCommandSignal" SG_ 360 BCS_DycEscTarTqActv 0;
BA_ "GatewayedSignals" SG_ 360 BCS_DycEscTarTqActv 0;
BA_ "GenSigInactiveValue" SG_ 360 BCS_DycEscTarTqActv 0;
BA_ "GenSigInvalidValue" SG_ 360 BCS_DycEscTarTqActv 0;
BA_ "GenSigSendType" SG_ 360 BCS_DycEscTarTqActv 1;
BA_ "GenSigStartValue" SG_ 360 BCS_DycEscTarTqActv 0;
BA_ "GenSigTimeoutValue" SG_ 360 BCS_DycEscTarTqActv 0;
BA_ "Remark" SG_ 360 BCS_DycEscTarTqActv "";
BA_ "EventCommandSignal" SG_ 360 BCS_WheelSlipFLVD 0;
BA_ "GatewayedSignals" SG_ 360 BCS_WheelSlipFLVD 0;
BA_ "GenSigInactiveValue" SG_ 360 BCS_WheelSlipFLVD 0;
BA_ "GenSigInvalidValue" SG_ 360 BCS_WheelSlipFLVD 0;
BA_ "GenSigSendType" SG_ 360 BCS_WheelSlipFLVD 1;
BA_ "GenSigStartValue" SG_ 360 BCS_WheelSlipFLVD 0;
BA_ "GenSigTimeoutValue" SG_ 360 BCS_WheelSlipFLVD 0;
BA_ "Remark" SG_ 360 BCS_WheelSlipFLVD "";
BA_ "EventCommandSignal" SG_ 360 BCS_WheelSlipFRVD 0;
BA_ "GatewayedSignals" SG_ 360 BCS_WheelSlipFRVD 0;
BA_ "GenSigInactiveValue" SG_ 360 BCS_WheelSlipFRVD 0;
BA_ "GenSigInvalidValue" SG_ 360 BCS_WheelSlipFRVD 0;
BA_ "GenSigSendType" SG_ 360 BCS_WheelSlipFRVD 1;
BA_ "GenSigStartValue" SG_ 360 BCS_WheelSlipFRVD 0;
BA_ "GenSigTimeoutValue" SG_ 360 BCS_WheelSlipFRVD 0;
BA_ "Remark" SG_ 360 BCS_WheelSlipFRVD "";
BA_ "EventCommandSignal" SG_ 360 BCS_WheelSlipRLVD 0;
BA_ "GatewayedSignals" SG_ 360 BCS_WheelSlipRLVD 0;
BA_ "GenSigInactiveValue" SG_ 360 BCS_WheelSlipRLVD 0;
BA_ "GenSigInvalidValue" SG_ 360 BCS_WheelSlipRLVD 0;
BA_ "GenSigSendType" SG_ 360 BCS_WheelSlipRLVD 1;
BA_ "GenSigStartValue" SG_ 360 BCS_WheelSlipRLVD 0;
BA_ "GenSigTimeoutValue" SG_ 360 BCS_WheelSlipRLVD 0;
BA_ "Remark" SG_ 360 BCS_WheelSlipRLVD "";
BA_ "EventCommandSignal" SG_ 360 BCS_WheelSlipRRVD 0;
BA_ "GatewayedSignals" SG_ 360 BCS_WheelSlipRRVD 0;
BA_ "GenSigInactiveValue" SG_ 360 BCS_WheelSlipRRVD 0;
BA_ "GenSigInvalidValue" SG_ 360 BCS_WheelSlipRRVD 0;
BA_ "GenSigSendType" SG_ 360 BCS_WheelSlipRRVD 1;
BA_ "GenSigStartValue" SG_ 360 BCS_WheelSlipRRVD 0;
BA_ "GenSigTimeoutValue" SG_ 360 BCS_WheelSlipRRVD 0;
BA_ "Remark" SG_ 360 BCS_WheelSlipRRVD "";
BA_ "EventCommandSignal" SG_ 360 BCS_DrvrReqBrkTorq 0;
BA_ "GatewayedSignals" SG_ 360 BCS_DrvrReqBrkTorq 0;
BA_ "GenSigInactiveValue" SG_ 360 BCS_DrvrReqBrkTorq 0;
BA_ "GenSigInvalidValue" SG_ 360 BCS_DrvrReqBrkTorq 0;
BA_ "GenSigSendType" SG_ 360 BCS_DrvrReqBrkTorq 1;
BA_ "GenSigStartValue" SG_ 360 BCS_DrvrReqBrkTorq 0;
BA_ "GenSigTimeoutValue" SG_ 360 BCS_DrvrReqBrkTorq 0;
BA_ "Remark" SG_ 360 BCS_DrvrReqBrkTorq "";
BA_ "EventCommandSignal" SG_ 360 BCS_BrkTarRecpTorqFA 0;
BA_ "GatewayedSignals" SG_ 360 BCS_BrkTarRecpTorqFA 0;
BA_ "GenSigInactiveValue" SG_ 360 BCS_BrkTarRecpTorqFA 0;
BA_ "GenSigInvalidValue" SG_ 360 BCS_BrkTarRecpTorqFA 0;
BA_ "GenSigSendType" SG_ 360 BCS_BrkTarRecpTorqFA 1;
BA_ "GenSigStartValue" SG_ 360 BCS_BrkTarRecpTorqFA 6000;
BA_ "GenSigTimeoutValue" SG_ 360 BCS_BrkTarRecpTorqFA 0;
BA_ "Remark" SG_ 360 BCS_BrkTarRecpTorqFA "";
BA_ "EventCommandSignal" SG_ 360 BCS_BrkTarRecpTorqFASt 0;
BA_ "GatewayedSignals" SG_ 360 BCS_BrkTarRecpTorqFASt 0;
BA_ "GenSigInactiveValue" SG_ 360 BCS_BrkTarRecpTorqFASt 0;
BA_ "GenSigInvalidValue" SG_ 360 BCS_BrkTarRecpTorqFASt 0;
BA_ "GenSigSendType" SG_ 360 BCS_BrkTarRecpTorqFASt 1;
BA_ "GenSigStartValue" SG_ 360 BCS_BrkTarRecpTorqFASt 0;
BA_ "GenSigTimeoutValue" SG_ 360 BCS_BrkTarRecpTorqFASt 0;
BA_ "Remark" SG_ 360 BCS_BrkTarRecpTorqFASt "";
BA_ "EventCommandSignal" SG_ 360 BCS_BrkTarRecpTorqRA 0;
BA_ "GatewayedSignals" SG_ 360 BCS_BrkTarRecpTorqRA 0;
BA_ "GenSigInactiveValue" SG_ 360 BCS_BrkTarRecpTorqRA 0;
BA_ "GenSigInvalidValue" SG_ 360 BCS_BrkTarRecpTorqRA 0;
BA_ "GenSigSendType" SG_ 360 BCS_BrkTarRecpTorqRA 1;
BA_ "GenSigStartValue" SG_ 360 BCS_BrkTarRecpTorqRA 6000;
BA_ "GenSigTimeoutValue" SG_ 360 BCS_BrkTarRecpTorqRA 0;
BA_ "Remark" SG_ 360 BCS_BrkTarRecpTorqRA "";
BA_ "EventCommandSignal" SG_ 360 BCS_BrkTarRecpTorqRASt 0;
BA_ "GatewayedSignals" SG_ 360 BCS_BrkTarRecpTorqRASt 0;
BA_ "GenSigInactiveValue" SG_ 360 BCS_BrkTarRecpTorqRASt 0;
BA_ "GenSigInvalidValue" SG_ 360 BCS_BrkTarRecpTorqRASt 0;
BA_ "GenSigSendType" SG_ 360 BCS_BrkTarRecpTorqRASt 1;
BA_ "GenSigStartValue" SG_ 360 BCS_BrkTarRecpTorqRASt 0;
BA_ "GenSigTimeoutValue" SG_ 360 BCS_BrkTarRecpTorqRASt 0;
BA_ "Remark" SG_ 360 BCS_BrkTarRecpTorqRASt "";
BA_ "EventCommandSignal" SG_ 360 BCS_BrkTarRecpTorq 0;
BA_ "GatewayedSignals" SG_ 360 BCS_BrkTarRecpTorq 0;
BA_ "GenSigInactiveValue" SG_ 360 BCS_BrkTarRecpTorq 0;
BA_ "GenSigInvalidValue" SG_ 360 BCS_BrkTarRecpTorq 0;
BA_ "GenSigSendType" SG_ 360 BCS_BrkTarRecpTorq 1;
BA_ "GenSigStartValue" SG_ 360 BCS_BrkTarRecpTorq 6000;
BA_ "GenSigTimeoutValue" SG_ 360 BCS_BrkTarRecpTorq 0;
BA_ "Remark" SG_ 360 BCS_BrkTarRecpTorq "";
BA_ "EventCommandSignal" SG_ 360 BCS_BrkTarRecpTorqSt 0;
BA_ "GatewayedSignals" SG_ 360 BCS_BrkTarRecpTorqSt 0;
BA_ "GenSigInactiveValue" SG_ 360 BCS_BrkTarRecpTorqSt 0;
BA_ "GenSigInvalidValue" SG_ 360 BCS_BrkTarRecpTorqSt 0;
BA_ "GenSigSendType" SG_ 360 BCS_BrkTarRecpTorqSt 1;
BA_ "GenSigStartValue" SG_ 360 BCS_BrkTarRecpTorqSt 0;
BA_ "GenSigTimeoutValue" SG_ 360 BCS_BrkTarRecpTorqSt 0;
BA_ "Remark" SG_ 360 BCS_BrkTarRecpTorqSt "";
BA_ "EventCommandSignal" SG_ 360 BCS_BrkTqCtrlAvlParkingRdn 0;
BA_ "GatewayedSignals" SG_ 360 BCS_BrkTqCtrlAvlParkingRdn 0;
BA_ "GenSigInactiveValue" SG_ 360 BCS_BrkTqCtrlAvlParkingRdn 0;
BA_ "GenSigInvalidValue" SG_ 360 BCS_BrkTqCtrlAvlParkingRdn 0;
BA_ "GenSigSendType" SG_ 360 BCS_BrkTqCtrlAvlParkingRdn 1;
BA_ "GenSigStartValue" SG_ 360 BCS_BrkTqCtrlAvlParkingRdn 0;
BA_ "GenSigTimeoutValue" SG_ 360 BCS_BrkTqCtrlAvlParkingRdn 0;
BA_ "Remark" SG_ 360 BCS_BrkTqCtrlAvlParkingRdn "";
BA_ "EventCommandSignal" SG_ 360 BCS_WheelSlipFL 0;
BA_ "GatewayedSignals" SG_ 360 BCS_WheelSlipFL 0;
BA_ "GenSigInactiveValue" SG_ 360 BCS_WheelSlipFL 0;
BA_ "GenSigInvalidValue" SG_ 360 BCS_WheelSlipFL 0;
BA_ "GenSigSendType" SG_ 360 BCS_WheelSlipFL 1;
BA_ "GenSigStartValue" SG_ 360 BCS_WheelSlipFL 0;
BA_ "GenSigTimeoutValue" SG_ 360 BCS_WheelSlipFL 0;
BA_ "Remark" SG_ 360 BCS_WheelSlipFL "";
BA_ "EventCommandSignal" SG_ 360 BCS_WheelSlipFR 0;
BA_ "GatewayedSignals" SG_ 360 BCS_WheelSlipFR 0;
BA_ "GenSigInactiveValue" SG_ 360 BCS_WheelSlipFR 0;
BA_ "GenSigInvalidValue" SG_ 360 BCS_WheelSlipFR 0;
BA_ "GenSigSendType" SG_ 360 BCS_WheelSlipFR 1;
BA_ "GenSigStartValue" SG_ 360 BCS_WheelSlipFR 0;
BA_ "GenSigTimeoutValue" SG_ 360 BCS_WheelSlipFR 0;
BA_ "Remark" SG_ 360 BCS_WheelSlipFR "";
BA_ "EventCommandSignal" SG_ 360 BCS_WheelSlipRL 0;
BA_ "GatewayedSignals" SG_ 360 BCS_WheelSlipRL 0;
BA_ "GenSigInactiveValue" SG_ 360 BCS_WheelSlipRL 0;
BA_ "GenSigInvalidValue" SG_ 360 BCS_WheelSlipRL 0;
BA_ "GenSigSendType" SG_ 360 BCS_WheelSlipRL 1;
BA_ "GenSigStartValue" SG_ 360 BCS_WheelSlipRL 0;
BA_ "GenSigTimeoutValue" SG_ 360 BCS_WheelSlipRL 0;
BA_ "Remark" SG_ 360 BCS_WheelSlipRL "";
BA_ "EventCommandSignal" SG_ 360 BCS_WheelSlipRR 0;
BA_ "GatewayedSignals" SG_ 360 BCS_WheelSlipRR 0;
BA_ "GenSigInactiveValue" SG_ 360 BCS_WheelSlipRR 0;
BA_ "GenSigInvalidValue" SG_ 360 BCS_WheelSlipRR 0;
BA_ "GenSigSendType" SG_ 360 BCS_WheelSlipRR 1;
BA_ "GenSigStartValue" SG_ 360 BCS_WheelSlipRR 0;
BA_ "GenSigTimeoutValue" SG_ 360 BCS_WheelSlipRR 0;
BA_ "Remark" SG_ 360 BCS_WheelSlipRR "";
BA_ "EventCommandSignal" SG_ 360 BCS_EngTorqDecFastRL 0;
BA_ "GatewayedSignals" SG_ 360 BCS_EngTorqDecFastRL 0;
BA_ "GenSigInactiveValue" SG_ 360 BCS_EngTorqDecFastRL 0;
BA_ "GenSigInvalidValue" SG_ 360 BCS_EngTorqDecFastRL 0;
BA_ "GenSigSendType" SG_ 360 BCS_EngTorqDecFastRL 1;
BA_ "GenSigStartValue" SG_ 360 BCS_EngTorqDecFastRL 16383;
BA_ "GenSigTimeoutValue" SG_ 360 BCS_EngTorqDecFastRL 0;
BA_ "Remark" SG_ 360 BCS_EngTorqDecFastRL "";
BA_ "EventCommandSignal" SG_ 360 BCS_EngTorqDecActiveStRL 0;
BA_ "GatewayedSignals" SG_ 360 BCS_EngTorqDecActiveStRL 0;
BA_ "GenSigInactiveValue" SG_ 360 BCS_EngTorqDecActiveStRL 0;
BA_ "GenSigInvalidValue" SG_ 360 BCS_EngTorqDecActiveStRL 0;
BA_ "GenSigSendType" SG_ 360 BCS_EngTorqDecActiveStRL 1;
BA_ "GenSigStartValue" SG_ 360 BCS_EngTorqDecActiveStRL 0;
BA_ "GenSigTimeoutValue" SG_ 360 BCS_EngTorqDecActiveStRL 0;
BA_ "Remark" SG_ 360 BCS_EngTorqDecActiveStRL "";
BA_ "EventCommandSignal" SG_ 360 BCS_EngTorqDecFastRR 0;
BA_ "GatewayedSignals" SG_ 360 BCS_EngTorqDecFastRR 0;
BA_ "GenSigInactiveValue" SG_ 360 BCS_EngTorqDecFastRR 0;
BA_ "GenSigInvalidValue" SG_ 360 BCS_EngTorqDecFastRR 0;
BA_ "GenSigSendType" SG_ 360 BCS_EngTorqDecFastRR 1;
BA_ "GenSigStartValue" SG_ 360 BCS_EngTorqDecFastRR 16383;
BA_ "GenSigTimeoutValue" SG_ 360 BCS_EngTorqDecFastRR 0;
BA_ "Remark" SG_ 360 BCS_EngTorqDecFastRR "";
BA_ "EventCommandSignal" SG_ 360 BCS_EngTorqDecActiveStRR 0;
BA_ "GatewayedSignals" SG_ 360 BCS_EngTorqDecActiveStRR 0;
BA_ "GenSigInactiveValue" SG_ 360 BCS_EngTorqDecActiveStRR 0;
BA_ "GenSigInvalidValue" SG_ 360 BCS_EngTorqDecActiveStRR 0;
BA_ "GenSigSendType" SG_ 360 BCS_EngTorqDecActiveStRR 1;
BA_ "GenSigStartValue" SG_ 360 BCS_EngTorqDecActiveStRR 0;
BA_ "GenSigTimeoutValue" SG_ 360 BCS_EngTorqDecActiveStRR 0;
BA_ "Remark" SG_ 360 BCS_EngTorqDecActiveStRR "";
BA_ "EventCommandSignal" SG_ 360 BCS_ICCSt 0;
BA_ "GatewayedSignals" SG_ 360 BCS_ICCSt 0;
BA_ "GenSigInactiveValue" SG_ 360 BCS_ICCSt 0;
BA_ "GenSigInvalidValue" SG_ 360 BCS_ICCSt 0;
BA_ "GenSigSendType" SG_ 360 BCS_ICCSt 1;
BA_ "GenSigStartValue" SG_ 360 BCS_ICCSt 0;
BA_ "GenSigTimeoutValue" SG_ 360 BCS_ICCSt 0;
BA_ "Remark" SG_ 360 BCS_ICCSt "";
BA_ "EventCommandSignal" SG_ 360 BCS_ICCAvl 0;
BA_ "GatewayedSignals" SG_ 360 BCS_ICCAvl 0;
BA_ "GenSigInactiveValue" SG_ 360 BCS_ICCAvl 0;
BA_ "GenSigInvalidValue" SG_ 360 BCS_ICCAvl 0;
BA_ "GenSigSendType" SG_ 360 BCS_ICCAvl 1;
BA_ "GenSigStartValue" SG_ 360 BCS_ICCAvl 0;
BA_ "GenSigTimeoutValue" SG_ 360 BCS_ICCAvl 0;
BA_ "Remark" SG_ 360 BCS_ICCAvl "";
BA_ "EventCommandSignal" SG_ 360 BCS_ICCErrFb 0;
BA_ "GatewayedSignals" SG_ 360 BCS_ICCErrFb 0;
BA_ "GenSigInactiveValue" SG_ 360 BCS_ICCErrFb 0;
BA_ "GenSigInvalidValue" SG_ 360 BCS_ICCErrFb 0;
BA_ "GenSigSendType" SG_ 360 BCS_ICCErrFb 1;
BA_ "GenSigStartValue" SG_ 360 BCS_ICCErrFb 0;
BA_ "GenSigTimeoutValue" SG_ 360 BCS_ICCErrFb 0;
BA_ "Remark" SG_ 360 BCS_ICCErrFb "";
BA_ "EventCommandSignal" SG_ 360 BCS_SimulatorPressureSt_1 0;
BA_ "GatewayedSignals" SG_ 360 BCS_SimulatorPressureSt_1 0;
BA_ "GenSigInactiveValue" SG_ 360 BCS_SimulatorPressureSt_1 0;
BA_ "GenSigInvalidValue" SG_ 360 BCS_SimulatorPressureSt_1 0;
BA_ "GenSigSendType" SG_ 360 BCS_SimulatorPressureSt_1 1;
BA_ "GenSigStartValue" SG_ 360 BCS_SimulatorPressureSt_1 0;
BA_ "GenSigTimeoutValue" SG_ 360 BCS_SimulatorPressureSt_1 0;
BA_ "Remark" SG_ 360 BCS_SimulatorPressureSt_1 "";
BA_ "EventCommandSignal" SG_ 360 BCS_SysSt_1 0;
BA_ "GatewayedSignals" SG_ 360 BCS_SysSt_1 0;
BA_ "GenSigInactiveValue" SG_ 360 BCS_SysSt_1 0;
BA_ "GenSigInvalidValue" SG_ 360 BCS_SysSt_1 0;
BA_ "GenSigSendType" SG_ 360 BCS_SysSt_1 1;
BA_ "GenSigStartValue" SG_ 360 BCS_SysSt_1 0;
BA_ "GenSigTimeoutValue" SG_ 360 BCS_SysSt_1 0;
BA_ "Remark" SG_ 360 BCS_SysSt_1 "";
BA_ "EventCommandSignal" SG_ 360 BCS_FWAWarning_1 0;
BA_ "GatewayedSignals" SG_ 360 BCS_FWAWarning_1 0;
BA_ "GenSigInactiveValue" SG_ 360 BCS_FWAWarning_1 0;
BA_ "GenSigInvalidValue" SG_ 360 BCS_FWAWarning_1 0;
BA_ "GenSigSendType" SG_ 360 BCS_FWAWarning_1 1;
BA_ "GenSigStartValue" SG_ 360 BCS_FWAWarning_1 0;
BA_ "GenSigTimeoutValue" SG_ 360 BCS_FWAWarning_1 0;
BA_ "Remark" SG_ 360 BCS_FWAWarning_1 "";
BA_ "EventCommandSignal" SG_ 360 BCS_CSTSt_1 0;
BA_ "GatewayedSignals" SG_ 360 BCS_CSTSt_1 0;
BA_ "GenSigInactiveValue" SG_ 360 BCS_CSTSt_1 0;
BA_ "GenSigInvalidValue" SG_ 360 BCS_CSTSt_1 0;
BA_ "GenSigSendType" SG_ 360 BCS_CSTSt_1 1;
BA_ "GenSigStartValue" SG_ 360 BCS_CSTSt_1 0;
BA_ "GenSigTimeoutValue" SG_ 360 BCS_CSTSt_1 0;
BA_ "Remark" SG_ 360 BCS_CSTSt_1 "";
BA_ "EventCommandSignal" SG_ 360 BCS_AVDCActive_1 0;
BA_ "GatewayedSignals" SG_ 360 BCS_AVDCActive_1 0;
BA_ "GenSigInactiveValue" SG_ 360 BCS_AVDCActive_1 0;
BA_ "GenSigInvalidValue" SG_ 360 BCS_AVDCActive_1 0;
BA_ "GenSigSendType" SG_ 360 BCS_AVDCActive_1 1;
BA_ "GenSigStartValue" SG_ 360 BCS_AVDCActive_1 0;
BA_ "GenSigTimeoutValue" SG_ 360 BCS_AVDCActive_1 0;
BA_ "Remark" SG_ 360 BCS_AVDCActive_1 "";
BA_ "EventCommandSignal" SG_ 360 BCS_AVDCAvailable_1 0;
BA_ "GatewayedSignals" SG_ 360 BCS_AVDCAvailable_1 0;
BA_ "GenSigInactiveValue" SG_ 360 BCS_AVDCAvailable_1 0;
BA_ "GenSigInvalidValue" SG_ 360 BCS_AVDCAvailable_1 0;
BA_ "GenSigSendType" SG_ 360 BCS_AVDCAvailable_1 1;
BA_ "GenSigStartValue" SG_ 360 BCS_AVDCAvailable_1 0;
BA_ "GenSigTimeoutValue" SG_ 360 BCS_AVDCAvailable_1 0;
BA_ "Remark" SG_ 360 BCS_AVDCAvailable_1 "";
BA_ "EventCommandSignal" SG_ 360 BCS_SimulatorPressure_1 0;
BA_ "GatewayedSignals" SG_ 360 BCS_SimulatorPressure_1 0;
BA_ "GenSigInactiveValue" SG_ 360 BCS_SimulatorPressure_1 0;
BA_ "GenSigInvalidValue" SG_ 360 BCS_SimulatorPressure_1 0;
BA_ "GenSigSendType" SG_ 360 BCS_SimulatorPressure_1 1;
BA_ "GenSigStartValue" SG_ 360 BCS_SimulatorPressure_1 17;
BA_ "GenSigTimeoutValue" SG_ 360 BCS_SimulatorPressure_1 0;
BA_ "Remark" SG_ 360 BCS_SimulatorPressure_1 "";
BA_ "EventCommandSignal" SG_ 475 ACU_MirrSteeringAdjFlag 1;
BA_ "GatewayedSignals" SG_ 475 ACU_MirrSteeringAdjFlag 0;
BA_ "GenSigInactiveValue" SG_ 475 ACU_MirrSteeringAdjFlag 0;
BA_ "GenSigInvalidValue" SG_ 475 ACU_MirrSteeringAdjFlag 0;
BA_ "GenSigSendType" SG_ 475 ACU_MirrSteeringAdjFlag 0;
BA_ "GenSigStartValue" SG_ 475 ACU_MirrSteeringAdjFlag 0;
BA_ "GenSigTimeoutValue" SG_ 475 ACU_MirrSteeringAdjFlag 0;
BA_ "Remark" SG_ 475 ACU_MirrSteeringAdjFlag "华为IDC控制器根据交互规范按照POE逻辑发送此报文";
BA_ "EventCommandSignal" SG_ 351 ACU_VirtualPowerOFFReq 1;
BA_ "GatewayedSignals" SG_ 351 ACU_VirtualPowerOFFReq 0;
BA_ "GenSigInactiveValue" SG_ 351 ACU_VirtualPowerOFFReq 0;
BA_ "GenSigInvalidValue" SG_ 351 ACU_VirtualPowerOFFReq 0;
BA_ "GenSigSendType" SG_ 351 ACU_VirtualPowerOFFReq 0;
BA_ "GenSigStartValue" SG_ 351 ACU_VirtualPowerOFFReq 0;
BA_ "GenSigTimeoutValue" SG_ 351 ACU_VirtualPowerOFFReq 0;
BA_ "Remark" SG_ 351 ACU_VirtualPowerOFFReq "";
BA_ "EventCommandSignal" SG_ 351 ACU_Account_Uld 1;
BA_ "GatewayedSignals" SG_ 351 ACU_Account_Uld 0;
BA_ "GenSigInactiveValue" SG_ 351 ACU_Account_Uld 0;
BA_ "GenSigInvalidValue" SG_ 351 ACU_Account_Uld 0;
BA_ "GenSigSendType" SG_ 351 ACU_Account_Uld 0;
BA_ "GenSigStartValue" SG_ 351 ACU_Account_Uld 0;
BA_ "GenSigTimeoutValue" SG_ 351 ACU_Account_Uld 0;
BA_ "Remark" SG_ 351 ACU_Account_Uld "";
BA_ "EventCommandSignal" SG_ 351 ACU_FactoryResetReq 1;
BA_ "GatewayedSignals" SG_ 351 ACU_FactoryResetReq 0;
BA_ "GenSigInactiveValue" SG_ 351 ACU_FactoryResetReq 0;
BA_ "GenSigInvalidValue" SG_ 351 ACU_FactoryResetReq 0;
BA_ "GenSigSendType" SG_ 351 ACU_FactoryResetReq 0;
BA_ "GenSigStartValue" SG_ 351 ACU_FactoryResetReq 0;
BA_ "GenSigTimeoutValue" SG_ 351 ACU_FactoryResetReq 0;
BA_ "Remark" SG_ 351 ACU_FactoryResetReq "";
BA_ "EventCommandSignal" SG_ 351 ACU_Account_Delete 1;
BA_ "GatewayedSignals" SG_ 351 ACU_Account_Delete 0;
BA_ "GenSigInactiveValue" SG_ 351 ACU_Account_Delete 0;
BA_ "GenSigInvalidValue" SG_ 351 ACU_Account_Delete 0;
BA_ "GenSigSendType" SG_ 351 ACU_Account_Delete 0;
BA_ "GenSigStartValue" SG_ 351 ACU_Account_Delete 0;
BA_ "GenSigTimeoutValue" SG_ 351 ACU_Account_Delete 0;
BA_ "Remark" SG_ 351 ACU_Account_Delete "";
BA_ "EventCommandSignal" SG_ 351 ACU_FrontWiperIntCfgVkReq 1;
BA_ "GatewayedSignals" SG_ 351 ACU_FrontWiperIntCfgVkReq 0;
BA_ "GenSigInactiveValue" SG_ 351 ACU_FrontWiperIntCfgVkReq 0;
BA_ "GenSigInvalidValue" SG_ 351 ACU_FrontWiperIntCfgVkReq 0;
BA_ "GenSigSendType" SG_ 351 ACU_FrontWiperIntCfgVkReq 0;
BA_ "GenSigStartValue" SG_ 351 ACU_FrontWiperIntCfgVkReq 0;
BA_ "GenSigTimeoutValue" SG_ 351 ACU_FrontWiperIntCfgVkReq 0;
BA_ "Remark" SG_ 351 ACU_FrontWiperIntCfgVkReq "";
BA_ "EventCommandSignal" SG_ 351 ACU_FrontWiperAutoCfgVkReq 1;
BA_ "GatewayedSignals" SG_ 351 ACU_FrontWiperAutoCfgVkReq 0;
BA_ "GenSigInactiveValue" SG_ 351 ACU_FrontWiperAutoCfgVkReq 0;
BA_ "GenSigInvalidValue" SG_ 351 ACU_FrontWiperAutoCfgVkReq 0;
BA_ "GenSigSendType" SG_ 351 ACU_FrontWiperAutoCfgVkReq 0;
BA_ "GenSigStartValue" SG_ 351 ACU_FrontWiperAutoCfgVkReq 0;
BA_ "GenSigTimeoutValue" SG_ 351 ACU_FrontWiperAutoCfgVkReq 0;
BA_ "Remark" SG_ 351 ACU_FrontWiperAutoCfgVkReq "";
BA_ "EventCommandSignal" SG_ 351 IDC_VoicePAAReq 1;
BA_ "GatewayedSignals" SG_ 351 IDC_VoicePAAReq 0;
BA_ "GenSigInactiveValue" SG_ 351 IDC_VoicePAAReq 0;
BA_ "GenSigInvalidValue" SG_ 351 IDC_VoicePAAReq 0;
BA_ "GenSigSendType" SG_ 351 IDC_VoicePAAReq 0;
BA_ "GenSigStartValue" SG_ 351 IDC_VoicePAAReq 0;
BA_ "GenSigTimeoutValue" SG_ 351 IDC_VoicePAAReq 0;
BA_ "Remark" SG_ 351 IDC_VoicePAAReq "";
BA_ "EventCommandSignal" SG_ 351 IDC_VoiceParkCheckReq 1;
BA_ "GatewayedSignals" SG_ 351 IDC_VoiceParkCheckReq 0;
BA_ "GenSigInactiveValue" SG_ 351 IDC_VoiceParkCheckReq 0;
BA_ "GenSigInvalidValue" SG_ 351 IDC_VoiceParkCheckReq 0;
BA_ "GenSigSendType" SG_ 351 IDC_VoiceParkCheckReq 0;
BA_ "GenSigStartValue" SG_ 351 IDC_VoiceParkCheckReq 0;
BA_ "GenSigTimeoutValue" SG_ 351 IDC_VoiceParkCheckReq 0;
BA_ "Remark" SG_ 351 IDC_VoiceParkCheckReq "";
BA_ "EventCommandSignal" SG_ 776 ZCUL_3_CRC 0;
BA_ "GatewayedSignals" SG_ 776 ZCUL_3_CRC 0;
BA_ "GenSigInactiveValue" SG_ 776 ZCUL_3_CRC 0;
BA_ "GenSigInvalidValue" SG_ 776 ZCUL_3_CRC 0;
BA_ "GenSigSendType" SG_ 776 ZCUL_3_CRC 1;
BA_ "GenSigStartValue" SG_ 776 ZCUL_3_CRC 0;
BA_ "GenSigTimeoutValue" SG_ 776 ZCUL_3_CRC 0;
BA_ "Remark" SG_ 776 ZCUL_3_CRC "";
BA_ "EventCommandSignal" SG_ 776 ZCUL_3_Counter 0;
BA_ "GatewayedSignals" SG_ 776 ZCUL_3_Counter 0;
BA_ "GenSigInactiveValue" SG_ 776 ZCUL_3_Counter 0;
BA_ "GenSigInvalidValue" SG_ 776 ZCUL_3_Counter 0;
BA_ "GenSigSendType" SG_ 776 ZCUL_3_Counter 1;
BA_ "GenSigStartValue" SG_ 776 ZCUL_3_Counter 0;
BA_ "GenSigTimeoutValue" SG_ 776 ZCUL_3_Counter 0;
BA_ "Remark" SG_ 776 ZCUL_3_Counter "";
BA_ "EventCommandSignal" SG_ 776 EL_LeftBSDIndicatorSt 0;
BA_ "GatewayedSignals" SG_ 776 EL_LeftBSDIndicatorSt 0;
BA_ "GenSigInactiveValue" SG_ 776 EL_LeftBSDIndicatorSt 0;
BA_ "GenSigInvalidValue" SG_ 776 EL_LeftBSDIndicatorSt 0;
BA_ "GenSigSendType" SG_ 776 EL_LeftBSDIndicatorSt 1;
BA_ "GenSigStartValue" SG_ 776 EL_LeftBSDIndicatorSt 0;
BA_ "GenSigTimeoutValue" SG_ 776 EL_LeftBSDIndicatorSt 0;
BA_ "Remark" SG_ 776 EL_LeftBSDIndicatorSt "";
BA_ "EventCommandSignal" SG_ 776 UINM_HazardLightSwSt 0;
BA_ "GatewayedSignals" SG_ 776 UINM_HazardLightSwSt 0;
BA_ "GenSigInactiveValue" SG_ 776 UINM_HazardLightSwSt 0;
BA_ "GenSigInvalidValue" SG_ 776 UINM_HazardLightSwSt 0;
BA_ "GenSigSendType" SG_ 776 UINM_HazardLightSwSt 1;
BA_ "GenSigStartValue" SG_ 776 UINM_HazardLightSwSt 0;
BA_ "GenSigTimeoutValue" SG_ 776 UINM_HazardLightSwSt 0;
BA_ "Remark" SG_ 776 UINM_HazardLightSwSt "";
BA_ "EventCommandSignal" SG_ 776 EL_MLTurnLightSt 0;
BA_ "GatewayedSignals" SG_ 776 EL_MLTurnLightSt 0;
BA_ "GenSigInactiveValue" SG_ 776 EL_MLTurnLightSt 0;
BA_ "GenSigInvalidValue" SG_ 776 EL_MLTurnLightSt 0;
BA_ "GenSigSendType" SG_ 776 EL_MLTurnLightSt 1;
BA_ "GenSigStartValue" SG_ 776 EL_MLTurnLightSt 0;
BA_ "GenSigTimeoutValue" SG_ 776 EL_MLTurnLightSt 0;
BA_ "Remark" SG_ 776 EL_MLTurnLightSt "";
BA_ "EventCommandSignal" SG_ 776 EL_MLTurnLightFaultSt 0;
BA_ "GatewayedSignals" SG_ 776 EL_MLTurnLightFaultSt 0;
BA_ "GenSigInactiveValue" SG_ 776 EL_MLTurnLightFaultSt 0;
BA_ "GenSigInvalidValue" SG_ 776 EL_MLTurnLightFaultSt 0;
BA_ "GenSigSendType" SG_ 776 EL_MLTurnLightFaultSt 1;
BA_ "GenSigStartValue" SG_ 776 EL_MLTurnLightFaultSt 0;
BA_ "GenSigTimeoutValue" SG_ 776 EL_MLTurnLightFaultSt 0;
BA_ "Remark" SG_ 776 EL_MLTurnLightFaultSt "";
BA_ "EventCommandSignal" SG_ 776 EL_LeftBSDIndicatorFaultSt 0;
BA_ "GatewayedSignals" SG_ 776 EL_LeftBSDIndicatorFaultSt 0;
BA_ "GenSigInactiveValue" SG_ 776 EL_LeftBSDIndicatorFaultSt 0;
BA_ "GenSigInvalidValue" SG_ 776 EL_LeftBSDIndicatorFaultSt 0;
BA_ "GenSigSendType" SG_ 776 EL_LeftBSDIndicatorFaultSt 1;
BA_ "GenSigStartValue" SG_ 776 EL_LeftBSDIndicatorFaultSt 0;
BA_ "GenSigTimeoutValue" SG_ 776 EL_LeftBSDIndicatorFaultSt 0;
BA_ "Remark" SG_ 776 EL_LeftBSDIndicatorFaultSt "";
BA_ "EventCommandSignal" SG_ 776 EL_MLADASLightSt 0;
BA_ "GatewayedSignals" SG_ 776 EL_MLADASLightSt 0;
BA_ "GenSigInactiveValue" SG_ 776 EL_MLADASLightSt 0;
BA_ "GenSigInvalidValue" SG_ 776 EL_MLADASLightSt 0;
BA_ "GenSigSendType" SG_ 776 EL_MLADASLightSt 1;
BA_ "GenSigStartValue" SG_ 776 EL_MLADASLightSt 0;
BA_ "GenSigTimeoutValue" SG_ 776 EL_MLADASLightSt 0;
BA_ "Remark" SG_ 776 EL_MLADASLightSt "";
BA_ "EventCommandSignal" SG_ 776 ZCUL_FrtWindshildHeatSt 0;
BA_ "GatewayedSignals" SG_ 776 ZCUL_FrtWindshildHeatSt 0;
BA_ "GenSigInactiveValue" SG_ 776 ZCUL_FrtWindshildHeatSt 0;
BA_ "GenSigInvalidValue" SG_ 776 ZCUL_FrtWindshildHeatSt 0;
BA_ "GenSigSendType" SG_ 776 ZCUL_FrtWindshildHeatSt 1;
BA_ "GenSigStartValue" SG_ 776 ZCUL_FrtWindshildHeatSt 0;
BA_ "GenSigTimeoutValue" SG_ 776 ZCUL_FrtWindshildHeatSt 0;
BA_ "Remark" SG_ 776 ZCUL_FrtWindshildHeatSt "";
BA_ "EventCommandSignal" SG_ 967 DMS_1_CRC 0;
BA_ "GatewayedSignals" SG_ 967 DMS_1_CRC 0;
BA_ "GenSigInactiveValue" SG_ 967 DMS_1_CRC 0;
BA_ "GenSigInvalidValue" SG_ 967 DMS_1_CRC 0;
BA_ "GenSigSendType" SG_ 967 DMS_1_CRC 1;
BA_ "GenSigStartValue" SG_ 967 DMS_1_CRC 0;
BA_ "GenSigTimeoutValue" SG_ 967 DMS_1_CRC 0;
BA_ "Remark" SG_ 967 DMS_1_CRC "";
BA_ "EventCommandSignal" SG_ 967 DMS_1_Counter 0;
BA_ "GatewayedSignals" SG_ 967 DMS_1_Counter 0;
BA_ "GenSigInactiveValue" SG_ 967 DMS_1_Counter 0;
BA_ "GenSigInvalidValue" SG_ 967 DMS_1_Counter 0;
BA_ "GenSigSendType" SG_ 967 DMS_1_Counter 1;
BA_ "GenSigStartValue" SG_ 967 DMS_1_Counter 0;
BA_ "GenSigTimeoutValue" SG_ 967 DMS_1_Counter 0;
BA_ "Remark" SG_ 967 DMS_1_Counter "";
BA_ "EventCommandSignal" SG_ 967 DMS_SysErrSt 0;
BA_ "GatewayedSignals" SG_ 967 DMS_SysErrSt 0;
BA_ "GenSigInactiveValue" SG_ 967 DMS_SysErrSt 0;
BA_ "GenSigInvalidValue" SG_ 967 DMS_SysErrSt 0;
BA_ "GenSigSendType" SG_ 967 DMS_SysErrSt 1;
BA_ "GenSigStartValue" SG_ 967 DMS_SysErrSt 0;
BA_ "GenSigTimeoutValue" SG_ 967 DMS_SysErrSt 0;
BA_ "Remark" SG_ 967 DMS_SysErrSt "";
BA_ "EventCommandSignal" SG_ 967 DMS_DrvrDetSts 0;
BA_ "GatewayedSignals" SG_ 967 DMS_DrvrDetSts 0;
BA_ "GenSigInactiveValue" SG_ 967 DMS_DrvrDetSts 0;
BA_ "GenSigInvalidValue" SG_ 967 DMS_DrvrDetSts 0;
BA_ "GenSigSendType" SG_ 967 DMS_DrvrDetSts 1;
BA_ "GenSigStartValue" SG_ 967 DMS_DrvrDetSts 0;
BA_ "GenSigTimeoutValue" SG_ 967 DMS_DrvrDetSts 0;
BA_ "Remark" SG_ 967 DMS_DrvrDetSts "";
BA_ "EventCommandSignal" SG_ 967 DMS_InterestsRegion 0;
BA_ "GatewayedSignals" SG_ 967 DMS_InterestsRegion 0;
BA_ "GenSigInactiveValue" SG_ 967 DMS_InterestsRegion 0;
BA_ "GenSigInvalidValue" SG_ 967 DMS_InterestsRegion 0;
BA_ "GenSigSendType" SG_ 967 DMS_InterestsRegion 1;
BA_ "GenSigStartValue" SG_ 967 DMS_InterestsRegion 0;
BA_ "GenSigTimeoutValue" SG_ 967 DMS_InterestsRegion 0;
BA_ "Remark" SG_ 967 DMS_InterestsRegion "";
BA_ "EventCommandSignal" SG_ 967 DMS_L3DriverDistractionSt 0;
BA_ "GatewayedSignals" SG_ 967 DMS_L3DriverDistractionSt 0;
BA_ "GenSigInactiveValue" SG_ 967 DMS_L3DriverDistractionSt 0;
BA_ "GenSigInvalidValue" SG_ 967 DMS_L3DriverDistractionSt 0;
BA_ "GenSigSendType" SG_ 967 DMS_L3DriverDistractionSt 1;
BA_ "GenSigStartValue" SG_ 967 DMS_L3DriverDistractionSt 0;
BA_ "GenSigTimeoutValue" SG_ 967 DMS_L3DriverDistractionSt 0;
BA_ "Remark" SG_ 967 DMS_L3DriverDistractionSt "";
BA_ "EventCommandSignal" SG_ 967 DMS_L3DriverFatigueSt 0;
BA_ "GatewayedSignals" SG_ 967 DMS_L3DriverFatigueSt 0;
BA_ "GenSigInactiveValue" SG_ 967 DMS_L3DriverFatigueSt 0;
BA_ "GenSigInvalidValue" SG_ 967 DMS_L3DriverFatigueSt 0;
BA_ "GenSigSendType" SG_ 967 DMS_L3DriverFatigueSt 1;
BA_ "GenSigStartValue" SG_ 967 DMS_L3DriverFatigueSt 0;
BA_ "GenSigTimeoutValue" SG_ 967 DMS_L3DriverFatigueSt 0;
BA_ "Remark" SG_ 967 DMS_L3DriverFatigueSt "";
BA_ "EventCommandSignal" SG_ 967 DMS_FaceIDStatus 0;
BA_ "GatewayedSignals" SG_ 967 DMS_FaceIDStatus 0;
BA_ "GenSigInactiveValue" SG_ 967 DMS_FaceIDStatus 0;
BA_ "GenSigInvalidValue" SG_ 967 DMS_FaceIDStatus 0;
BA_ "GenSigSendType" SG_ 967 DMS_FaceIDStatus 1;
BA_ "GenSigStartValue" SG_ 967 DMS_FaceIDStatus 0;
BA_ "GenSigTimeoutValue" SG_ 967 DMS_FaceIDStatus 0;
BA_ "Remark" SG_ 967 DMS_FaceIDStatus "";
BA_ "EventCommandSignal" SG_ 967 DMS_FaceID 0;
BA_ "GatewayedSignals" SG_ 967 DMS_FaceID 0;
BA_ "GenSigInactiveValue" SG_ 967 DMS_FaceID 0;
BA_ "GenSigInvalidValue" SG_ 967 DMS_FaceID 0;
BA_ "GenSigSendType" SG_ 967 DMS_FaceID 1;
BA_ "GenSigStartValue" SG_ 967 DMS_FaceID 0;
BA_ "GenSigTimeoutValue" SG_ 967 DMS_FaceID 0;
BA_ "Remark" SG_ 967 DMS_FaceID "";
BA_ "EventCommandSignal" SG_ 967 DMS_LeftEyeOpenSt 0;
BA_ "GatewayedSignals" SG_ 967 DMS_LeftEyeOpenSt 0;
BA_ "GenSigInactiveValue" SG_ 967 DMS_LeftEyeOpenSt 0;
BA_ "GenSigInvalidValue" SG_ 967 DMS_LeftEyeOpenSt 0;
BA_ "GenSigSendType" SG_ 967 DMS_LeftEyeOpenSt 1;
BA_ "GenSigStartValue" SG_ 967 DMS_LeftEyeOpenSt 0;
BA_ "GenSigTimeoutValue" SG_ 967 DMS_LeftEyeOpenSt 0;
BA_ "Remark" SG_ 967 DMS_LeftEyeOpenSt "";
BA_ "EventCommandSignal" SG_ 967 DMS_RightEyeOpenSt 0;
BA_ "GatewayedSignals" SG_ 967 DMS_RightEyeOpenSt 0;
BA_ "GenSigInactiveValue" SG_ 967 DMS_RightEyeOpenSt 0;
BA_ "GenSigInvalidValue" SG_ 967 DMS_RightEyeOpenSt 0;
BA_ "GenSigSendType" SG_ 967 DMS_RightEyeOpenSt 1;
BA_ "GenSigStartValue" SG_ 967 DMS_RightEyeOpenSt 0;
BA_ "GenSigTimeoutValue" SG_ 967 DMS_RightEyeOpenSt 0;
BA_ "Remark" SG_ 967 DMS_RightEyeOpenSt "";
BA_ "EventCommandSignal" SG_ 967 DMS_DriverSmokeSt 0;
BA_ "GatewayedSignals" SG_ 967 DMS_DriverSmokeSt 0;
BA_ "GenSigInactiveValue" SG_ 967 DMS_DriverSmokeSt 0;
BA_ "GenSigInvalidValue" SG_ 967 DMS_DriverSmokeSt 0;
BA_ "GenSigSendType" SG_ 967 DMS_DriverSmokeSt 1;
BA_ "GenSigStartValue" SG_ 967 DMS_DriverSmokeSt 0;
BA_ "GenSigTimeoutValue" SG_ 967 DMS_DriverSmokeSt 0;
BA_ "Remark" SG_ 967 DMS_DriverSmokeSt "";
BA_ "EventCommandSignal" SG_ 967 DMS_DriverTelephoneSt 0;
BA_ "GatewayedSignals" SG_ 967 DMS_DriverTelephoneSt 0;
BA_ "GenSigInactiveValue" SG_ 967 DMS_DriverTelephoneSt 0;
BA_ "GenSigInvalidValue" SG_ 967 DMS_DriverTelephoneSt 0;
BA_ "GenSigSendType" SG_ 967 DMS_DriverTelephoneSt 1;
BA_ "GenSigStartValue" SG_ 967 DMS_DriverTelephoneSt 0;
BA_ "GenSigTimeoutValue" SG_ 967 DMS_DriverTelephoneSt 0;
BA_ "Remark" SG_ 967 DMS_DriverTelephoneSt "";
BA_ "EventCommandSignal" SG_ 967 DMS_DriverHealthSt 0;
BA_ "GatewayedSignals" SG_ 967 DMS_DriverHealthSt 0;
BA_ "GenSigInactiveValue" SG_ 967 DMS_DriverHealthSt 0;
BA_ "GenSigInvalidValue" SG_ 967 DMS_DriverHealthSt 0;
BA_ "GenSigSendType" SG_ 967 DMS_DriverHealthSt 1;
BA_ "GenSigStartValue" SG_ 967 DMS_DriverHealthSt 0;
BA_ "GenSigTimeoutValue" SG_ 967 DMS_DriverHealthSt 0;
BA_ "Remark" SG_ 967 DMS_DriverHealthSt "";
BA_ "EventCommandSignal" SG_ 967 DMS_FatigWarnSt 0;
BA_ "GatewayedSignals" SG_ 967 DMS_FatigWarnSt 0;
BA_ "GenSigInactiveValue" SG_ 967 DMS_FatigWarnSt 0;
BA_ "GenSigInvalidValue" SG_ 967 DMS_FatigWarnSt 0;
BA_ "GenSigSendType" SG_ 967 DMS_FatigWarnSt 1;
BA_ "GenSigStartValue" SG_ 967 DMS_FatigWarnSt 0;
BA_ "GenSigTimeoutValue" SG_ 967 DMS_FatigWarnSt 0;
BA_ "Remark" SG_ 967 DMS_FatigWarnSt "";
BA_ "EventCommandSignal" SG_ 967 DMS_DistrWarnSt 0;
BA_ "GatewayedSignals" SG_ 967 DMS_DistrWarnSt 0;
BA_ "GenSigInactiveValue" SG_ 967 DMS_DistrWarnSt 0;
BA_ "GenSigInvalidValue" SG_ 967 DMS_DistrWarnSt 0;
BA_ "GenSigSendType" SG_ 967 DMS_DistrWarnSt 1;
BA_ "GenSigStartValue" SG_ 967 DMS_DistrWarnSt 0;
BA_ "GenSigTimeoutValue" SG_ 967 DMS_DistrWarnSt 0;
BA_ "Remark" SG_ 967 DMS_DistrWarnSt "";
BA_ "EventCommandSignal" SG_ 967 DMS_DistEyeBowCenter 0;
BA_ "GatewayedSignals" SG_ 967 DMS_DistEyeBowCenter 0;
BA_ "GenSigInactiveValue" SG_ 967 DMS_DistEyeBowCenter 0;
BA_ "GenSigInvalidValue" SG_ 967 DMS_DistEyeBowCenter 0;
BA_ "GenSigSendType" SG_ 967 DMS_DistEyeBowCenter 1;
BA_ "GenSigStartValue" SG_ 967 DMS_DistEyeBowCenter 0;
BA_ "GenSigTimeoutValue" SG_ 967 DMS_DistEyeBowCenter 0;
BA_ "Remark" SG_ 967 DMS_DistEyeBowCenter "";
BA_ "EventCommandSignal" SG_ 967 DMS_FaceIDVerifyResult 0;
BA_ "GatewayedSignals" SG_ 967 DMS_FaceIDVerifyResult 0;
BA_ "GenSigInactiveValue" SG_ 967 DMS_FaceIDVerifyResult 0;
BA_ "GenSigInvalidValue" SG_ 967 DMS_FaceIDVerifyResult 0;
BA_ "GenSigSendType" SG_ 967 DMS_FaceIDVerifyResult 1;
BA_ "GenSigStartValue" SG_ 967 DMS_FaceIDVerifyResult 0;
BA_ "GenSigTimeoutValue" SG_ 967 DMS_FaceIDVerifyResult 0;
BA_ "Remark" SG_ 967 DMS_FaceIDVerifyResult "";
BA_ "EventCommandSignal" SG_ 967 DMS_YawnSt 0;
BA_ "GatewayedSignals" SG_ 967 DMS_YawnSt 0;
BA_ "GenSigInactiveValue" SG_ 967 DMS_YawnSt 0;
BA_ "GenSigInvalidValue" SG_ 967 DMS_YawnSt 0;
BA_ "GenSigSendType" SG_ 967 DMS_YawnSt 1;
BA_ "GenSigStartValue" SG_ 967 DMS_YawnSt 0;
BA_ "GenSigTimeoutValue" SG_ 967 DMS_YawnSt 0;
BA_ "Remark" SG_ 967 DMS_YawnSt "";
BA_ "EventCommandSignal" SG_ 342 ZCUR_8_CRC 0;
BA_ "GatewayedSignals" SG_ 342 ZCUR_8_CRC 0;
BA_ "GenSigInactiveValue" SG_ 342 ZCUR_8_CRC 0;
BA_ "GenSigInvalidValue" SG_ 342 ZCUR_8_CRC 0;
BA_ "GenSigSendType" SG_ 342 ZCUR_8_CRC 1;
BA_ "GenSigStartValue" SG_ 342 ZCUR_8_CRC 0;
BA_ "GenSigTimeoutValue" SG_ 342 ZCUR_8_CRC 0;
BA_ "Remark" SG_ 342 ZCUR_8_CRC "";
BA_ "EventCommandSignal" SG_ 342 ZCUR_8_Counter 0;
BA_ "GatewayedSignals" SG_ 342 ZCUR_8_Counter 0;
BA_ "GenSigInactiveValue" SG_ 342 ZCUR_8_Counter 0;
BA_ "GenSigInvalidValue" SG_ 342 ZCUR_8_Counter 0;
BA_ "GenSigSendType" SG_ 342 ZCUR_8_Counter 1;
BA_ "GenSigStartValue" SG_ 342 ZCUR_8_Counter 0;
BA_ "GenSigTimeoutValue" SG_ 342 ZCUR_8_Counter 0;
BA_ "Remark" SG_ 342 ZCUR_8_Counter "";
BA_ "EventCommandSignal" SG_ 342 KAE_PassiveUnlockReq 0;
BA_ "GatewayedSignals" SG_ 342 KAE_PassiveUnlockReq 0;
BA_ "GenSigInactiveValue" SG_ 342 KAE_PassiveUnlockReq 0;
BA_ "GenSigInvalidValue" SG_ 342 KAE_PassiveUnlockReq 0;
BA_ "GenSigSendType" SG_ 342 KAE_PassiveUnlockReq 1;
BA_ "GenSigStartValue" SG_ 342 KAE_PassiveUnlockReq 0;
BA_ "GenSigTimeoutValue" SG_ 342 KAE_PassiveUnlockReq 0;
BA_ "Remark" SG_ 342 KAE_PassiveUnlockReq "";
BA_ "EventCommandSignal" SG_ 342 KAE_PassiveLockReq 0;
BA_ "GatewayedSignals" SG_ 342 KAE_PassiveLockReq 0;
BA_ "GenSigInactiveValue" SG_ 342 KAE_PassiveLockReq 0;
BA_ "GenSigInvalidValue" SG_ 342 KAE_PassiveLockReq 0;
BA_ "GenSigSendType" SG_ 342 KAE_PassiveLockReq 1;
BA_ "GenSigStartValue" SG_ 342 KAE_PassiveLockReq 0;
BA_ "GenSigTimeoutValue" SG_ 342 KAE_PassiveLockReq 0;
BA_ "Remark" SG_ 342 KAE_PassiveLockReq "";
BA_ "EventCommandSignal" SG_ 342 KAE_FOB1Position 0;
BA_ "GatewayedSignals" SG_ 342 KAE_FOB1Position 0;
BA_ "GenSigInactiveValue" SG_ 342 KAE_FOB1Position 0;
BA_ "GenSigInvalidValue" SG_ 342 KAE_FOB1Position 0;
BA_ "GenSigSendType" SG_ 342 KAE_FOB1Position 1;
BA_ "GenSigStartValue" SG_ 342 KAE_FOB1Position 0;
BA_ "GenSigTimeoutValue" SG_ 342 KAE_FOB1Position 0;
BA_ "Remark" SG_ 342 KAE_FOB1Position "";
BA_ "EventCommandSignal" SG_ 342 KAE_FOB2Position 0;
BA_ "GatewayedSignals" SG_ 342 KAE_FOB2Position 0;
BA_ "GenSigInactiveValue" SG_ 342 KAE_FOB2Position 0;
BA_ "GenSigInvalidValue" SG_ 342 KAE_FOB2Position 0;
BA_ "GenSigSendType" SG_ 342 KAE_FOB2Position 1;
BA_ "GenSigStartValue" SG_ 342 KAE_FOB2Position 0;
BA_ "GenSigTimeoutValue" SG_ 342 KAE_FOB2Position 0;
BA_ "Remark" SG_ 342 KAE_FOB2Position "";
BA_ "EventCommandSignal" SG_ 342 KAE_FOB3Position 0;
BA_ "GatewayedSignals" SG_ 342 KAE_FOB3Position 0;
BA_ "GenSigInactiveValue" SG_ 342 KAE_FOB3Position 0;
BA_ "GenSigInvalidValue" SG_ 342 KAE_FOB3Position 0;
BA_ "GenSigSendType" SG_ 342 KAE_FOB3Position 1;
BA_ "GenSigStartValue" SG_ 342 KAE_FOB3Position 0;
BA_ "GenSigTimeoutValue" SG_ 342 KAE_FOB3Position 0;
BA_ "Remark" SG_ 342 KAE_FOB3Position "";
BA_ "EventCommandSignal" SG_ 342 KAE_FOB2UnlockBtnPressS 0;
BA_ "GatewayedSignals" SG_ 342 KAE_FOB2UnlockBtnPressS 0;
BA_ "GenSigInactiveValue" SG_ 342 KAE_FOB2UnlockBtnPressS 0;
BA_ "GenSigInvalidValue" SG_ 342 KAE_FOB2UnlockBtnPressS 0;
BA_ "GenSigSendType" SG_ 342 KAE_FOB2UnlockBtnPressS 1;
BA_ "GenSigStartValue" SG_ 342 KAE_FOB2UnlockBtnPressS 0;
BA_ "GenSigTimeoutValue" SG_ 342 KAE_FOB2UnlockBtnPressS 0;
BA_ "Remark" SG_ 342 KAE_FOB2UnlockBtnPressS "";
BA_ "EventCommandSignal" SG_ 342 KAE_FOB2LockBtnPressSt 0;
BA_ "GatewayedSignals" SG_ 342 KAE_FOB2LockBtnPressSt 0;
BA_ "GenSigInactiveValue" SG_ 342 KAE_FOB2LockBtnPressSt 0;
BA_ "GenSigInvalidValue" SG_ 342 KAE_FOB2LockBtnPressSt 0;
BA_ "GenSigSendType" SG_ 342 KAE_FOB2LockBtnPressSt 1;
BA_ "GenSigStartValue" SG_ 342 KAE_FOB2LockBtnPressSt 0;
BA_ "GenSigTimeoutValue" SG_ 342 KAE_FOB2LockBtnPressSt 0;
BA_ "Remark" SG_ 342 KAE_FOB2LockBtnPressSt "";
BA_ "EventCommandSignal" SG_ 342 KAE_FOB2TrunkBtnPressSt 0;
BA_ "GatewayedSignals" SG_ 342 KAE_FOB2TrunkBtnPressSt 0;
BA_ "GenSigInactiveValue" SG_ 342 KAE_FOB2TrunkBtnPressSt 0;
BA_ "GenSigInvalidValue" SG_ 342 KAE_FOB2TrunkBtnPressSt 0;
BA_ "GenSigSendType" SG_ 342 KAE_FOB2TrunkBtnPressSt 1;
BA_ "GenSigStartValue" SG_ 342 KAE_FOB2TrunkBtnPressSt 0;
BA_ "GenSigTimeoutValue" SG_ 342 KAE_FOB2TrunkBtnPressSt 0;
BA_ "Remark" SG_ 342 KAE_FOB2TrunkBtnPressSt "";
BA_ "EventCommandSignal" SG_ 342 KAE_FOB2User_definedBtnPressSt 0;
BA_ "GatewayedSignals" SG_ 342 KAE_FOB2User_definedBtnPressSt 0;
BA_ "GenSigInactiveValue" SG_ 342 KAE_FOB2User_definedBtnPressSt 0;
BA_ "GenSigInvalidValue" SG_ 342 KAE_FOB2User_definedBtnPressSt 0;
BA_ "GenSigSendType" SG_ 342 KAE_FOB2User_definedBtnPressSt 1;
BA_ "GenSigStartValue" SG_ 342 KAE_FOB2User_definedBtnPressSt 0;
BA_ "GenSigTimeoutValue" SG_ 342 KAE_FOB2User_definedBtnPressSt 0;
BA_ "Remark" SG_ 342 KAE_FOB2User_definedBtnPressSt "";
BA_ "EventCommandSignal" SG_ 342 KAE_FOB3UnlockBtnPressS 0;
BA_ "GatewayedSignals" SG_ 342 KAE_FOB3UnlockBtnPressS 0;
BA_ "GenSigInactiveValue" SG_ 342 KAE_FOB3UnlockBtnPressS 0;
BA_ "GenSigInvalidValue" SG_ 342 KAE_FOB3UnlockBtnPressS 0;
BA_ "GenSigSendType" SG_ 342 KAE_FOB3UnlockBtnPressS 1;
BA_ "GenSigStartValue" SG_ 342 KAE_FOB3UnlockBtnPressS 0;
BA_ "GenSigTimeoutValue" SG_ 342 KAE_FOB3UnlockBtnPressS 0;
BA_ "Remark" SG_ 342 KAE_FOB3UnlockBtnPressS "";
BA_ "EventCommandSignal" SG_ 342 KAE_FOB3LockBtnPressSt 0;
BA_ "GatewayedSignals" SG_ 342 KAE_FOB3LockBtnPressSt 0;
BA_ "GenSigInactiveValue" SG_ 342 KAE_FOB3LockBtnPressSt 0;
BA_ "GenSigInvalidValue" SG_ 342 KAE_FOB3LockBtnPressSt 0;
BA_ "GenSigSendType" SG_ 342 KAE_FOB3LockBtnPressSt 1;
BA_ "GenSigStartValue" SG_ 342 KAE_FOB3LockBtnPressSt 0;
BA_ "GenSigTimeoutValue" SG_ 342 KAE_FOB3LockBtnPressSt 0;
BA_ "Remark" SG_ 342 KAE_FOB3LockBtnPressSt "";
BA_ "EventCommandSignal" SG_ 342 KAE_FOB3TrunkBinPressSt 0;
BA_ "GatewayedSignals" SG_ 342 KAE_FOB3TrunkBinPressSt 0;
BA_ "GenSigInactiveValue" SG_ 342 KAE_FOB3TrunkBinPressSt 0;
BA_ "GenSigInvalidValue" SG_ 342 KAE_FOB3TrunkBinPressSt 0;
BA_ "GenSigSendType" SG_ 342 KAE_FOB3TrunkBinPressSt 1;
BA_ "GenSigStartValue" SG_ 342 KAE_FOB3TrunkBinPressSt 0;
BA_ "GenSigTimeoutValue" SG_ 342 KAE_FOB3TrunkBinPressSt 0;
BA_ "Remark" SG_ 342 KAE_FOB3TrunkBinPressSt "";
BA_ "EventCommandSignal" SG_ 342 KAE_FOB3User_defnedBtnPressst 0;
BA_ "GatewayedSignals" SG_ 342 KAE_FOB3User_defnedBtnPressst 0;
BA_ "GenSigInactiveValue" SG_ 342 KAE_FOB3User_defnedBtnPressst 0;
BA_ "GenSigInvalidValue" SG_ 342 KAE_FOB3User_defnedBtnPressst 0;
BA_ "GenSigSendType" SG_ 342 KAE_FOB3User_defnedBtnPressst 1;
BA_ "GenSigStartValue" SG_ 342 KAE_FOB3User_defnedBtnPressst 0;
BA_ "GenSigTimeoutValue" SG_ 342 KAE_FOB3User_defnedBtnPressst 0;
BA_ "Remark" SG_ 342 KAE_FOB3User_defnedBtnPressst "";
BA_ "EventCommandSignal" SG_ 342 KAE_FOBUnlockBtnPressSt 0;
BA_ "GatewayedSignals" SG_ 342 KAE_FOBUnlockBtnPressSt 0;
BA_ "GenSigInactiveValue" SG_ 342 KAE_FOBUnlockBtnPressSt 0;
BA_ "GenSigInvalidValue" SG_ 342 KAE_FOBUnlockBtnPressSt 0;
BA_ "GenSigSendType" SG_ 342 KAE_FOBUnlockBtnPressSt 1;
BA_ "GenSigStartValue" SG_ 342 KAE_FOBUnlockBtnPressSt 0;
BA_ "GenSigTimeoutValue" SG_ 342 KAE_FOBUnlockBtnPressSt 0;
BA_ "Remark" SG_ 342 KAE_FOBUnlockBtnPressSt "";
BA_ "EventCommandSignal" SG_ 342 KAE_FOBLockBtnPressSt 0;
BA_ "GatewayedSignals" SG_ 342 KAE_FOBLockBtnPressSt 0;
BA_ "GenSigInactiveValue" SG_ 342 KAE_FOBLockBtnPressSt 0;
BA_ "GenSigInvalidValue" SG_ 342 KAE_FOBLockBtnPressSt 0;
BA_ "GenSigSendType" SG_ 342 KAE_FOBLockBtnPressSt 1;
BA_ "GenSigStartValue" SG_ 342 KAE_FOBLockBtnPressSt 0;
BA_ "GenSigTimeoutValue" SG_ 342 KAE_FOBLockBtnPressSt 0;
BA_ "Remark" SG_ 342 KAE_FOBLockBtnPressSt "";
BA_ "EventCommandSignal" SG_ 342 KAE_FOBRESBtnPressSt 0;
BA_ "GatewayedSignals" SG_ 342 KAE_FOBRESBtnPressSt 0;
BA_ "GenSigInactiveValue" SG_ 342 KAE_FOBRESBtnPressSt 0;
BA_ "GenSigInvalidValue" SG_ 342 KAE_FOBRESBtnPressSt 0;
BA_ "GenSigSendType" SG_ 342 KAE_FOBRESBtnPressSt 1;
BA_ "GenSigStartValue" SG_ 342 KAE_FOBRESBtnPressSt 0;
BA_ "GenSigTimeoutValue" SG_ 342 KAE_FOBRESBtnPressSt 0;
BA_ "Remark" SG_ 342 KAE_FOBRESBtnPressSt "";
BA_ "EventCommandSignal" SG_ 342 KAE_FOBPSD_LBtnPressSt 0;
BA_ "GatewayedSignals" SG_ 342 KAE_FOBPSD_LBtnPressSt 0;
BA_ "GenSigInactiveValue" SG_ 342 KAE_FOBPSD_LBtnPressSt 0;
BA_ "GenSigInvalidValue" SG_ 342 KAE_FOBPSD_LBtnPressSt 0;
BA_ "GenSigSendType" SG_ 342 KAE_FOBPSD_LBtnPressSt 1;
BA_ "GenSigStartValue" SG_ 342 KAE_FOBPSD_LBtnPressSt 0;
BA_ "GenSigTimeoutValue" SG_ 342 KAE_FOBPSD_LBtnPressSt 0;
BA_ "Remark" SG_ 342 KAE_FOBPSD_LBtnPressSt "";
BA_ "EventCommandSignal" SG_ 342 KAE_FOBPSD_RBtnPressSt 0;
BA_ "GatewayedSignals" SG_ 342 KAE_FOBPSD_RBtnPressSt 0;
BA_ "GenSigInactiveValue" SG_ 342 KAE_FOBPSD_RBtnPressSt 0;
BA_ "GenSigInvalidValue" SG_ 342 KAE_FOBPSD_RBtnPressSt 0;
BA_ "GenSigSendType" SG_ 342 KAE_FOBPSD_RBtnPressSt 1;
BA_ "GenSigStartValue" SG_ 342 KAE_FOBPSD_RBtnPressSt 0;
BA_ "GenSigTimeoutValue" SG_ 342 KAE_FOBPSD_RBtnPressSt 0;
BA_ "Remark" SG_ 342 KAE_FOBPSD_RBtnPressSt "";
BA_ "EventCommandSignal" SG_ 342 KAE_FOBTrunkBtnPressSt 0;
BA_ "GatewayedSignals" SG_ 342 KAE_FOBTrunkBtnPressSt 0;
BA_ "GenSigInactiveValue" SG_ 342 KAE_FOBTrunkBtnPressSt 0;
BA_ "GenSigInvalidValue" SG_ 342 KAE_FOBTrunkBtnPressSt 0;
BA_ "GenSigSendType" SG_ 342 KAE_FOBTrunkBtnPressSt 1;
BA_ "GenSigStartValue" SG_ 342 KAE_FOBTrunkBtnPressSt 0;
BA_ "GenSigTimeoutValue" SG_ 342 KAE_FOBTrunkBtnPressSt 0;
BA_ "Remark" SG_ 342 KAE_FOBTrunkBtnPressSt "";
BA_ "EventCommandSignal" SG_ 342 KAE_FOBPanicBtnPressSt 0;
BA_ "GatewayedSignals" SG_ 342 KAE_FOBPanicBtnPressSt 0;
BA_ "GenSigInactiveValue" SG_ 342 KAE_FOBPanicBtnPressSt 0;
BA_ "GenSigInvalidValue" SG_ 342 KAE_FOBPanicBtnPressSt 0;
BA_ "GenSigSendType" SG_ 342 KAE_FOBPanicBtnPressSt 1;
BA_ "GenSigStartValue" SG_ 342 KAE_FOBPanicBtnPressSt 0;
BA_ "GenSigTimeoutValue" SG_ 342 KAE_FOBPanicBtnPressSt 0;
BA_ "Remark" SG_ 342 KAE_FOBPanicBtnPressSt "";
BA_ "EventCommandSignal" SG_ 342 KAE_FOBUser_definedBtnPressSt 0;
BA_ "GatewayedSignals" SG_ 342 KAE_FOBUser_definedBtnPressSt 0;
BA_ "GenSigInactiveValue" SG_ 342 KAE_FOBUser_definedBtnPressSt 0;
BA_ "GenSigInvalidValue" SG_ 342 KAE_FOBUser_definedBtnPressSt 0;
BA_ "GenSigSendType" SG_ 342 KAE_FOBUser_definedBtnPressSt 1;
BA_ "GenSigStartValue" SG_ 342 KAE_FOBUser_definedBtnPressSt 0;
BA_ "GenSigTimeoutValue" SG_ 342 KAE_FOBUser_definedBtnPressSt 0;
BA_ "Remark" SG_ 342 KAE_FOBUser_definedBtnPressSt "";
BA_ "EventCommandSignal" SG_ 342 KAE_FOB2RESBtnPressSt 1;
BA_ "GatewayedSignals" SG_ 342 KAE_FOB2RESBtnPressSt 0;
BA_ "GenSigInactiveValue" SG_ 342 KAE_FOB2RESBtnPressSt 0;
BA_ "GenSigInvalidValue" SG_ 342 KAE_FOB2RESBtnPressSt 0;
BA_ "GenSigSendType" SG_ 342 KAE_FOB2RESBtnPressSt 0;
BA_ "GenSigStartValue" SG_ 342 KAE_FOB2RESBtnPressSt 0;
BA_ "GenSigTimeoutValue" SG_ 342 KAE_FOB2RESBtnPressSt 0;
BA_ "Remark" SG_ 342 KAE_FOB2RESBtnPressSt "";
BA_ "EventCommandSignal" SG_ 342 KAE_FOB2PanicBtnPressSt 1;
BA_ "GatewayedSignals" SG_ 342 KAE_FOB2PanicBtnPressSt 0;
BA_ "GenSigInactiveValue" SG_ 342 KAE_FOB2PanicBtnPressSt 0;
BA_ "GenSigInvalidValue" SG_ 342 KAE_FOB2PanicBtnPressSt 0;
BA_ "GenSigSendType" SG_ 342 KAE_FOB2PanicBtnPressSt 0;
BA_ "GenSigStartValue" SG_ 342 KAE_FOB2PanicBtnPressSt 0;
BA_ "GenSigTimeoutValue" SG_ 342 KAE_FOB2PanicBtnPressSt 0;
BA_ "Remark" SG_ 342 KAE_FOB2PanicBtnPressSt "";
BA_ "EventCommandSignal" SG_ 512 KAE_BLE1Position 1;
BA_ "GatewayedSignals" SG_ 512 KAE_BLE1Position 0;
BA_ "GenSigInactiveValue" SG_ 512 KAE_BLE1Position 0;
BA_ "GenSigInvalidValue" SG_ 512 KAE_BLE1Position 0;
BA_ "GenSigSendType" SG_ 512 KAE_BLE1Position 0;
BA_ "GenSigStartValue" SG_ 512 KAE_BLE1Position 0;
BA_ "GenSigTimeoutValue" SG_ 512 KAE_BLE1Position 0;
BA_ "Remark" SG_ 512 KAE_BLE1Position "";
BA_ "EventCommandSignal" SG_ 512 KAE_BLE2Position 1;
BA_ "GatewayedSignals" SG_ 512 KAE_BLE2Position 0;
BA_ "GenSigInactiveValue" SG_ 512 KAE_BLE2Position 0;
BA_ "GenSigInvalidValue" SG_ 512 KAE_BLE2Position 0;
BA_ "GenSigSendType" SG_ 512 KAE_BLE2Position 0;
BA_ "GenSigStartValue" SG_ 512 KAE_BLE2Position 0;
BA_ "GenSigTimeoutValue" SG_ 512 KAE_BLE2Position 0;
BA_ "Remark" SG_ 512 KAE_BLE2Position "";
BA_ "EventCommandSignal" SG_ 512 KAE_BLE3Position 1;
BA_ "GatewayedSignals" SG_ 512 KAE_BLE3Position 0;
BA_ "GenSigInactiveValue" SG_ 512 KAE_BLE3Position 0;
BA_ "GenSigInvalidValue" SG_ 512 KAE_BLE3Position 0;
BA_ "GenSigSendType" SG_ 512 KAE_BLE3Position 0;
BA_ "GenSigStartValue" SG_ 512 KAE_BLE3Position 0;
BA_ "GenSigTimeoutValue" SG_ 512 KAE_BLE3Position 0;
BA_ "Remark" SG_ 512 KAE_BLE3Position "";
BA_ "EventCommandSignal" SG_ 512 KAE_BLE4Position 1;
BA_ "GatewayedSignals" SG_ 512 KAE_BLE4Position 0;
BA_ "GenSigInactiveValue" SG_ 512 KAE_BLE4Position 0;
BA_ "GenSigInvalidValue" SG_ 512 KAE_BLE4Position 0;
BA_ "GenSigSendType" SG_ 512 KAE_BLE4Position 0;
BA_ "GenSigStartValue" SG_ 512 KAE_BLE4Position 0;
BA_ "GenSigTimeoutValue" SG_ 512 KAE_BLE4Position 0;
BA_ "Remark" SG_ 512 KAE_BLE4Position "";
BA_ "EventCommandSignal" SG_ 512 KAE_BLE5Position 1;
BA_ "GatewayedSignals" SG_ 512 KAE_BLE5Position 0;
BA_ "GenSigInactiveValue" SG_ 512 KAE_BLE5Position 0;
BA_ "GenSigInvalidValue" SG_ 512 KAE_BLE5Position 0;
BA_ "GenSigSendType" SG_ 512 KAE_BLE5Position 0;
BA_ "GenSigStartValue" SG_ 512 KAE_BLE5Position 0;
BA_ "GenSigTimeoutValue" SG_ 512 KAE_BLE5Position 0;
BA_ "Remark" SG_ 512 KAE_BLE5Position "";
BA_ "EventCommandSignal" SG_ 512 KAE_BLE1AuthSt 1;
BA_ "GatewayedSignals" SG_ 512 KAE_BLE1AuthSt 0;
BA_ "GenSigInactiveValue" SG_ 512 KAE_BLE1AuthSt 0;
BA_ "GenSigInvalidValue" SG_ 512 KAE_BLE1AuthSt 0;
BA_ "GenSigSendType" SG_ 512 KAE_BLE1AuthSt 0;
BA_ "GenSigStartValue" SG_ 512 KAE_BLE1AuthSt 0;
BA_ "GenSigTimeoutValue" SG_ 512 KAE_BLE1AuthSt 0;
BA_ "Remark" SG_ 512 KAE_BLE1AuthSt "";
BA_ "EventCommandSignal" SG_ 512 KAE_BLE2AuthSt 1;
BA_ "GatewayedSignals" SG_ 512 KAE_BLE2AuthSt 0;
BA_ "GenSigInactiveValue" SG_ 512 KAE_BLE2AuthSt 0;
BA_ "GenSigInvalidValue" SG_ 512 KAE_BLE2AuthSt 0;
BA_ "GenSigSendType" SG_ 512 KAE_BLE2AuthSt 0;
BA_ "GenSigStartValue" SG_ 512 KAE_BLE2AuthSt 0;
BA_ "GenSigTimeoutValue" SG_ 512 KAE_BLE2AuthSt 0;
BA_ "Remark" SG_ 512 KAE_BLE2AuthSt "";
BA_ "EventCommandSignal" SG_ 512 KAE_BLE3AuthSt 1;
BA_ "GatewayedSignals" SG_ 512 KAE_BLE3AuthSt 0;
BA_ "GenSigInactiveValue" SG_ 512 KAE_BLE3AuthSt 0;
BA_ "GenSigInvalidValue" SG_ 512 KAE_BLE3AuthSt 0;
BA_ "GenSigSendType" SG_ 512 KAE_BLE3AuthSt 0;
BA_ "GenSigStartValue" SG_ 512 KAE_BLE3AuthSt 0;
BA_ "GenSigTimeoutValue" SG_ 512 KAE_BLE3AuthSt 0;
BA_ "Remark" SG_ 512 KAE_BLE3AuthSt "";
BA_ "EventCommandSignal" SG_ 512 KAE_BLE4AuthSt 1;
BA_ "GatewayedSignals" SG_ 512 KAE_BLE4AuthSt 0;
BA_ "GenSigInactiveValue" SG_ 512 KAE_BLE4AuthSt 0;
BA_ "GenSigInvalidValue" SG_ 512 KAE_BLE4AuthSt 0;
BA_ "GenSigSendType" SG_ 512 KAE_BLE4AuthSt 0;
BA_ "GenSigStartValue" SG_ 512 KAE_BLE4AuthSt 0;
BA_ "GenSigTimeoutValue" SG_ 512 KAE_BLE4AuthSt 0;
BA_ "Remark" SG_ 512 KAE_BLE4AuthSt "";
BA_ "EventCommandSignal" SG_ 512 KAE_BLE5AuthSt 1;
BA_ "GatewayedSignals" SG_ 512 KAE_BLE5AuthSt 0;
BA_ "GenSigInactiveValue" SG_ 512 KAE_BLE5AuthSt 0;
BA_ "GenSigInvalidValue" SG_ 512 KAE_BLE5AuthSt 0;
BA_ "GenSigSendType" SG_ 512 KAE_BLE5AuthSt 0;
BA_ "GenSigStartValue" SG_ 512 KAE_BLE5AuthSt 0;
BA_ "GenSigTimeoutValue" SG_ 512 KAE_BLE5AuthSt 0;
BA_ "Remark" SG_ 512 KAE_BLE5AuthSt "";
BA_ "EventCommandSignal" SG_ 512 KAE_BLE1PKSPosition 1;
BA_ "GatewayedSignals" SG_ 512 KAE_BLE1PKSPosition 0;
BA_ "GenSigInactiveValue" SG_ 512 KAE_BLE1PKSPosition 0;
BA_ "GenSigInvalidValue" SG_ 512 KAE_BLE1PKSPosition 0;
BA_ "GenSigSendType" SG_ 512 KAE_BLE1PKSPosition 0;
BA_ "GenSigStartValue" SG_ 512 KAE_BLE1PKSPosition 0;
BA_ "GenSigTimeoutValue" SG_ 512 KAE_BLE1PKSPosition 0;
BA_ "Remark" SG_ 512 KAE_BLE1PKSPosition "";
BA_ "EventCommandSignal" SG_ 512 KAE_BLE2PKSPosition 1;
BA_ "GatewayedSignals" SG_ 512 KAE_BLE2PKSPosition 0;
BA_ "GenSigInactiveValue" SG_ 512 KAE_BLE2PKSPosition 0;
BA_ "GenSigInvalidValue" SG_ 512 KAE_BLE2PKSPosition 0;
BA_ "GenSigSendType" SG_ 512 KAE_BLE2PKSPosition 0;
BA_ "GenSigStartValue" SG_ 512 KAE_BLE2PKSPosition 0;
BA_ "GenSigTimeoutValue" SG_ 512 KAE_BLE2PKSPosition 0;
BA_ "Remark" SG_ 512 KAE_BLE2PKSPosition "";
BA_ "EventCommandSignal" SG_ 512 KAE_BLE3PKSPosition 1;
BA_ "GatewayedSignals" SG_ 512 KAE_BLE3PKSPosition 0;
BA_ "GenSigInactiveValue" SG_ 512 KAE_BLE3PKSPosition 0;
BA_ "GenSigInvalidValue" SG_ 512 KAE_BLE3PKSPosition 0;
BA_ "GenSigSendType" SG_ 512 KAE_BLE3PKSPosition 0;
BA_ "GenSigStartValue" SG_ 512 KAE_BLE3PKSPosition 0;
BA_ "GenSigTimeoutValue" SG_ 512 KAE_BLE3PKSPosition 0;
BA_ "Remark" SG_ 512 KAE_BLE3PKSPosition "";
BA_ "EventCommandSignal" SG_ 512 KAE_BLE4PKSPosition 1;
BA_ "GatewayedSignals" SG_ 512 KAE_BLE4PKSPosition 0;
BA_ "GenSigInactiveValue" SG_ 512 KAE_BLE4PKSPosition 0;
BA_ "GenSigInvalidValue" SG_ 512 KAE_BLE4PKSPosition 0;
BA_ "GenSigSendType" SG_ 512 KAE_BLE4PKSPosition 0;
BA_ "GenSigStartValue" SG_ 512 KAE_BLE4PKSPosition 0;
BA_ "GenSigTimeoutValue" SG_ 512 KAE_BLE4PKSPosition 0;
BA_ "Remark" SG_ 512 KAE_BLE4PKSPosition "";
BA_ "EventCommandSignal" SG_ 512 KAE_BLE5PKSPosition 1;
BA_ "GatewayedSignals" SG_ 512 KAE_BLE5PKSPosition 0;
BA_ "GenSigInactiveValue" SG_ 512 KAE_BLE5PKSPosition 0;
BA_ "GenSigInvalidValue" SG_ 512 KAE_BLE5PKSPosition 0;
BA_ "GenSigSendType" SG_ 512 KAE_BLE5PKSPosition 0;
BA_ "GenSigStartValue" SG_ 512 KAE_BLE5PKSPosition 0;
BA_ "GenSigTimeoutValue" SG_ 512 KAE_BLE5PKSPosition 0;
BA_ "Remark" SG_ 512 KAE_BLE5PKSPosition "";
BA_ "EventCommandSignal" SG_ 939 SRS_PsngrSeatBeltSt 0;
BA_ "GatewayedSignals" SG_ 939 SRS_PsngrSeatBeltSt 0;
BA_ "GenSigInactiveValue" SG_ 939 SRS_PsngrSeatBeltSt 0;
BA_ "GenSigInvalidValue" SG_ 939 SRS_PsngrSeatBeltSt 3;
BA_ "GenSigSendType" SG_ 939 SRS_PsngrSeatBeltSt 1;
BA_ "GenSigStartValue" SG_ 939 SRS_PsngrSeatBeltSt 0;
BA_ "GenSigTimeoutValue" SG_ 939 SRS_PsngrSeatBeltSt 3;
BA_ "Remark" SG_ 939 SRS_PsngrSeatBeltSt "";
BA_ "EventCommandSignal" SG_ 939 SRS_DriverSeatBeltSt 0;
BA_ "GatewayedSignals" SG_ 939 SRS_DriverSeatBeltSt 0;
BA_ "GenSigInactiveValue" SG_ 939 SRS_DriverSeatBeltSt 0;
BA_ "GenSigInvalidValue" SG_ 939 SRS_DriverSeatBeltSt 3;
BA_ "GenSigSendType" SG_ 939 SRS_DriverSeatBeltSt 1;
BA_ "GenSigStartValue" SG_ 939 SRS_DriverSeatBeltSt 0;
BA_ "GenSigTimeoutValue" SG_ 939 SRS_DriverSeatBeltSt 3;
BA_ "Remark" SG_ 939 SRS_DriverSeatBeltSt "";
BA_ "EventCommandSignal" SG_ 939 SRS_RearLeftSeatBeltSt 0;
BA_ "GatewayedSignals" SG_ 939 SRS_RearLeftSeatBeltSt 0;
BA_ "GenSigInactiveValue" SG_ 939 SRS_RearLeftSeatBeltSt 0;
BA_ "GenSigInvalidValue" SG_ 939 SRS_RearLeftSeatBeltSt 3;
BA_ "GenSigSendType" SG_ 939 SRS_RearLeftSeatBeltSt 1;
BA_ "GenSigStartValue" SG_ 939 SRS_RearLeftSeatBeltSt 0;
BA_ "GenSigTimeoutValue" SG_ 939 SRS_RearLeftSeatBeltSt 3;
BA_ "Remark" SG_ 939 SRS_RearLeftSeatBeltSt "";
BA_ "EventCommandSignal" SG_ 939 SRS_AirbagFaultSt 0;
BA_ "GatewayedSignals" SG_ 939 SRS_AirbagFaultSt 0;
BA_ "GenSigInactiveValue" SG_ 939 SRS_AirbagFaultSt 0;
BA_ "GenSigInvalidValue" SG_ 939 SRS_AirbagFaultSt 0;
BA_ "GenSigSendType" SG_ 939 SRS_AirbagFaultSt 1;
BA_ "GenSigStartValue" SG_ 939 SRS_AirbagFaultSt 0;
BA_ "GenSigTimeoutValue" SG_ 939 SRS_AirbagFaultSt 1;
BA_ "Remark" SG_ 939 SRS_AirbagFaultSt "";
BA_ "EventCommandSignal" SG_ 939 SRS_RearRightSeatBeltSt 0;
BA_ "GatewayedSignals" SG_ 939 SRS_RearRightSeatBeltSt 0;
BA_ "GenSigInactiveValue" SG_ 939 SRS_RearRightSeatBeltSt 0;
BA_ "GenSigInvalidValue" SG_ 939 SRS_RearRightSeatBeltSt 3;
BA_ "GenSigSendType" SG_ 939 SRS_RearRightSeatBeltSt 1;
BA_ "GenSigStartValue" SG_ 939 SRS_RearRightSeatBeltSt 0;
BA_ "GenSigTimeoutValue" SG_ 939 SRS_RearRightSeatBeltSt 3;
BA_ "Remark" SG_ 939 SRS_RearRightSeatBeltSt "";
BA_ "EventCommandSignal" SG_ 939 SRS_RearMiddleSeatBeltSt 0;
BA_ "GatewayedSignals" SG_ 939 SRS_RearMiddleSeatBeltSt 0;
BA_ "GenSigInactiveValue" SG_ 939 SRS_RearMiddleSeatBeltSt 0;
BA_ "GenSigInvalidValue" SG_ 939 SRS_RearMiddleSeatBeltSt 3;
BA_ "GenSigSendType" SG_ 939 SRS_RearMiddleSeatBeltSt 1;
BA_ "GenSigStartValue" SG_ 939 SRS_RearMiddleSeatBeltSt 0;
BA_ "GenSigTimeoutValue" SG_ 939 SRS_RearMiddleSeatBeltSt 3;
BA_ "Remark" SG_ 939 SRS_RearMiddleSeatBeltSt "";
VAL_ 904 ACU_PCS_SVM_MODCmd 0 "Disable" 1 "Enalbe"  ;
VAL_ 904 ACU_HeadLightVirtualSwSt 0 "NotActive" 1 "PositionLight" 2 "LowBeam" 3 "AutoLight"  ;
VAL_ 904 ACU_FrontFogLightVirtualSwSt 0 "Not Active" 1 "Active"  ;
VAL_ 904 ACU_RearFogLightVirtualSwSt 0 "Not Active" 1 "Active"  ;
VAL_ 904 ACU_Account_Uid 0 "No command" 1 "account 0" 2 "account 1" 3 "account 2" 4 "account 3" 5 "account 4" 6 "account 5" 7 "account 6" 8 "account 7" 9 "account 8" 10 "Not used" 11 "Not used" 12 "Not used" 13 "Not used" 14 "Not used" 15 "Not used"  ;
VAL_ 904 ACU_IHBC_SwitchReq 0 "No command" 1 "Not active" 2 "Active" 3 "Not used"  ;
VAL_ 904 ACU_NDASwitchReq 0 "No command" 1 "Not active" 2 "Active" 3 "Not used"  ;
VAL_ 904 ACU_NDALCConSwitchReq 0 "No command" 1 "Need confirm" 2 "No need confirm" 3 "Not used"  ;
VAL_ 904 ACU_NDALCStySwitchReq 0 "No command" 1 "Standard" 2 "Radical" 3 "Not used"  ;
VAL_ 904 ACU_ADASWarnTypeSwitch 0 "No command" 1 "Sound" 2 "Voice" 3 "Seat vibration"  ;
VAL_ 904 ACU_iACC_StyleConfirmSwitchReq 0 "No Command" 1 "Need confirm" 2 "No need confirm" 3 "OFF"  ;
VAL_ 904 ACU_IFC_ISDRestOfdis 0 "not in ISD" 251 "over 70km"  ;
VAL_ 904 ACU_IFC_SpeedLimitUnit 0 "Not used" 1 "Km/h" 2 "Miles/h" 3 "Not used"  ;
VAL_ 904 ACU_ThemeType 0 "Day mode" 1 "Night mode"  ;
VAL_ 904 ACU_IFC_SpeedLimtType 0 "Not specific" 1 "Speed limit camera detection" 2 "Interval speed detectionlimit"  ;
VAL_ 904 ACU_IFC_RoadType 0 "unknown" 1 "High way" 2 "National road" 3 "Provincial road" 4 "County road" 5 "Village road" 6 "City express way" 7 "Major urban road" 8 "Secondary urban road" 9 "Normal urban road" 10 "Non-Navigation Road" 11 "Ramp" 12 "Reserve" 13 "Reserve" 14 "Reserve" 15 "Reserve"  ;
VAL_ 904 ACU_IFC_ZoneCode 0 "Not used" 1 "China"  ;
VAL_ 904 ACU_IFC_NaviSt 0 "Unknown" 1 "Cruise" 2 "Navigate" 3 "Failure"  ;
VAL_ 904 ACU_IFC_NaviCorp 0 "unknown" 1 "Gaode Map" 2 "Tescent Map" 3 "Baidu Map" 4 "Ruitu Map"  ;
VAL_ 904 ACU_IFC_NaviNewIconDis 0 "no newIcon ahead" 21 "over 2.0km"  ;
VAL_ 904 ACU_IFC_OfframpSt 0 "Not off-ramp" 1 "Off-ramp"  ;
VAL_ 904 ACU_IFC_NaviNewIcon 0 "unknown" 1 "left" 2 "right" 3 "left front" 4 "right front" 5 "left rear" 6 "right rear" 7 "left u-turn" 8 "right u-turn" 9 "go straight" 10 "roundabout entrance" 11 "roundabout exit" 12 "service area" 13 "toll station" 14 "tunnel" 15 "not used"  ;
VAL_ 904 ACU_IFC_SLCAheadDis 251 "over 1.25km"  ;
VAL_ 904 ACU_DVR_Switch 0 "Off" 1 "On"  ;
VAL_ 904 ACU_IFC_OfframpDis 254 "over 2km"  ;
VAL_ 904 DrvrSideMotResp 0 "No Action" 1 "Executing Retraction Assistance" 2 "Executing Clearance Removal 1" 3 "Executing Clearance Removal 2" 4 "Executing Dynamic Support 1" 5 "Executing Dynamic Support 2" 6 "Executing Pre-crash Protection" 7 "Executing Vibration Warning 1" 8 "Executing Vibration Warning 2" 9 "Reserved" 10 "Retraction Assistance Completed" 11 "Clearance Removal Completed" 12 "Executing Dynamic Support 3" 13 "Executing Dynamic Support 4" 14 "Executing Vibration Notification" 15 "Timeout"  ;
VAL_ 904 IPDS_BAT1PowerSt 0 "Not Active" 1 "Active"  ;
VAL_ 904 IPDS_BAT2PowerSt 0 "Not Active" 1 "Active"  ;
VAL_ 904 IPDS_DCDC2PowerSt 0 "Not Active" 1 "Active"  ;
VAL_ 904 IPDS_GridIsoPowerSt 0 "Not Active" 1 "Active"  ;
VAL_ 935 SR_SunroofCurrentPst 255 "Undefined Sunroof position"  ;
VAL_ 957 HOD_St 0 "Hands Off；" 1 "Left Touch；" 2 "Right Touch；" 3 "Inside Touch；" 4 "Outer Touch；" 5 "Front Touch；" 6 "Rear Touch；" 7 "Both side touch；" 8 "Left Grip；" 9 "Right Grip；" 10 "Both side Grip；" 11 "Hands On；" 12 "Reserved" 13 "Temporal Failure" 14 "Permanent Failure" 15 "int"  ;
VAL_ 957 HOD_TouchZone1 0 "False" 1 "True"  ;
VAL_ 957 HOD_TouchZone2 0 "False" 1 "True"  ;
VAL_ 957 HOD_TouchZone3 0 "False" 1 "True"  ;
VAL_ 957 HOD_HeatingSt 0 "off" 1 "heating" 2 "Preservation" 3 "Reserved"  ;
VAL_ 957 HOD_CalibrationSt 0 "Not Calibrated" 1 "Calibrated"  ;
VAL_ 957 HOD_LINComFault 0 "Not Fault" 1 "Fault"  ;
VAL_ 957 HOD_FaultSt 0 "Not Fault" 1 "Fault"  ;
VAL_ 957 HOD_VBattOORFault 0 "Not Fault" 1 "Fault"  ;
VAL_ 957 HOD_HeatingOtherFaultSt 0 "Not Fault" 1 "Fault"  ;
VAL_ 957 HOD_HeatingOverUnderCurrentSt 0 "Not Fault" 1 "Fault"  ;
VAL_ 957 HOD_HeatingThermSt 0 "Not Fault" 1 "Fault"  ;
VAL_ 957 HOD_HeatingTempOutSt 0 "Not Fault" 1 "Fault"  ;
VAL_ 957 HOD_Typ 0 "0" 1 "one zone" 2 "L/R zone" 3 "I/O zone" 4 "L/R/Inner zone" 5 "L/R/Rear zone"  ;
VAL_ 957 HOD_TouchIntensityZone1 0 "Intensity" 1 "Intensity" 2 "Intensity" 3 "Intensity" 4 "Intensity" 5 "Intensity" 6 "Intensity" 7 "Intensity" 8 "Intensity" 9 "Intensity" 10 "Intensity" 11 "Intensity" 12 "Intensity" 13 "Intensity" 14 "Intensity" 15 "Intensity" 16 "Intensity" 17 "Intensity" 18 "Intensity" 19 "Intensity" 20 "Intensity" 21 "Intensity" 22 "Intensity" 23 "Intensity" 24 "Intensity" 25 "Intensity" 26 "Intensity" 27 "Intensity" 28 "Intensity" 29 "Intensity" 30 "Intensity" 31 "Intensity" 32 "Intensity" 33 "Intensity" 34 "Intensity" 35 "Intensity" 36 "Intensity" 37 "Intensity" 38 "Intensity" 39 "Intensity" 40 "Intensity" 41 "Intensity" 42 "Intensity" 43 "Intensity" 44 "Intensity" 45 "Intensity" 46 "Intensity" 47 "Intensity" 48 "Intensity" 49 "Intensity" 50 "Intensity" 51 "Intensity" 52 "Intensity" 53 "Intensity" 54 "Intensity" 55 "Intensity" 56 "Intensity" 57 "Intensity" 58 "Intensity" 59 "Intensity" 60 "Intensity" 61 "Intensity" 62 "Intensity" 63 "Intensity" 64 "Intensity" 65 "Intensity" 66 "Intensity" 67 "Intensity" 68 "Intensity" 69 "Intensity" 70 "Intensity" 71 "Intensity" 72 "Intensity" 73 "Intensity" 74 "Intensity" 75 "Intensity" 76 "Intensity" 77 "Intensity" 78 "Intensity" 79 "Intensity" 80 "Intensity" 81 "Intensity" 82 "Intensity" 83 "Intensity" 84 "Intensity" 85 "Intensity" 86 "Intensity" 87 "Intensity" 88 "Intensity" 89 "Intensity" 90 "Intensity" 91 "Intensity" 92 "Intensity" 93 "Intensity" 94 "Intensity" 95 "Intensity" 96 "Intensity" 97 "Intensity" 98 "Intensity" 99 "Intensity" 100 "Intensity" 101 "Intensity" 102 "Intensity" 103 "Intensity" 104 "Intensity" 105 "Intensity" 106 "Intensity" 107 "Intensity" 108 "Intensity" 109 "Intensity" 110 "Intensity" 111 "Intensity" 112 "Intensity" 113 "Intensity" 114 "Intensity" 115 "Intensity" 116 "Intensity" 117 "Intensity" 118 "Intensity" 119 "Intensity" 120 "Intensity" 121 "Intensity" 122 "Intensity" 123 "Intensity" 124 "Intensity" 125 "Intensity" 126 "Intensity" 127 "Intensity" 128 "Intensity" 129 "Intensity" 130 "Intensity" 131 "Intensity" 132 "Intensity" 133 "Intensity" 134 "Intensity" 135 "Intensity" 136 "Intensity" 137 "Intensity" 138 "Intensity" 139 "Intensity" 140 "Intensity" 141 "Intensity" 142 "Intensity" 143 "Intensity" 144 "Intensity" 145 "Intensity" 146 "Intensity" 147 "Intensity" 148 "Intensity" 149 "Intensity" 150 "Intensity" 151 "Intensity" 152 "Intensity" 153 "Intensity" 154 "Intensity" 155 "Intensity" 156 "Intensity" 157 "Intensity" 158 "Intensity" 159 "Intensity" 160 "Intensity" 161 "Intensity" 162 "Intensity" 163 "Intensity" 164 "Intensity" 165 "Intensity" 166 "Intensity" 167 "Intensity" 168 "Intensity" 169 "Intensity" 170 "Intensity" 171 "Intensity" 172 "Intensity" 173 "Intensity" 174 "Intensity" 175 "Intensity" 176 "Intensity" 177 "Intensity" 178 "Intensity" 179 "Intensity" 180 "Intensity" 181 "Intensity" 182 "Intensity" 183 "Intensity" 184 "Intensity" 185 "Intensity" 186 "Intensity" 187 "Intensity" 188 "Intensity" 189 "Intensity" 190 "Intensity" 191 "Intensity" 192 "Intensity" 193 "Intensity" 194 "Intensity" 195 "Intensity" 196 "Intensity" 197 "Intensity" 198 "Intensity" 199 "Intensity" 200 "Intensity" 201 "Intensity" 202 "Intensity" 203 "Intensity" 204 "Intensity" 205 "Intensity" 206 "Intensity" 207 "Intensity" 208 "Intensity" 209 "Intensity" 210 "Intensity" 211 "Intensity" 212 "Intensity" 213 "Intensity" 214 "Intensity" 215 "Intensity" 216 "Intensity" 217 "Intensity" 218 "Intensity" 219 "Intensity" 220 "Intensity" 221 "Intensity" 222 "Intensity" 223 "Intensity" 224 "Intensity" 225 "Intensity" 226 "Intensity" 227 "Intensity" 228 "Intensity" 229 "Intensity" 230 "Intensity" 231 "Intensity" 232 "Intensity" 233 "Intensity" 234 "Intensity" 235 "Intensity" 236 "Intensity" 237 "Intensity" 238 "Intensity" 239 "Intensity" 240 "Intensity" 241 "Intensity" 242 "Intensity" 243 "Intensity" 244 "Intensity" 245 "Intensity" 246 "Intensity" 247 "Intensity" 248 "Intensity" 249 "Intensity" 250 "Intensity" 251 "Reserved" 252 "Not Available" 253 "Reserved" 254 "Init" 255 "Failure"  ;
VAL_ 957 HOD_TouchIntensityZone2 0 "Intensity" 1 "Intensity" 2 "Intensity" 3 "Intensity" 4 "Intensity" 5 "Intensity" 6 "Intensity" 7 "Intensity" 8 "Intensity" 9 "Intensity" 10 "Intensity" 11 "Intensity" 12 "Intensity" 13 "Intensity" 14 "Intensity" 15 "Intensity" 16 "Intensity" 17 "Intensity" 18 "Intensity" 19 "Intensity" 20 "Intensity" 21 "Intensity" 22 "Intensity" 23 "Intensity" 24 "Intensity" 25 "Intensity" 26 "Intensity" 27 "Intensity" 28 "Intensity" 29 "Intensity" 30 "Intensity" 31 "Intensity" 32 "Intensity" 33 "Intensity" 34 "Intensity" 35 "Intensity" 36 "Intensity" 37 "Intensity" 38 "Intensity" 39 "Intensity" 40 "Intensity" 41 "Intensity" 42 "Intensity" 43 "Intensity" 44 "Intensity" 45 "Intensity" 46 "Intensity" 47 "Intensity" 48 "Intensity" 49 "Intensity" 50 "Intensity" 51 "Intensity" 52 "Intensity" 53 "Intensity" 54 "Intensity" 55 "Intensity" 56 "Intensity" 57 "Intensity" 58 "Intensity" 59 "Intensity" 60 "Intensity" 61 "Intensity" 62 "Intensity" 63 "Intensity" 64 "Intensity" 65 "Intensity" 66 "Intensity" 67 "Intensity" 68 "Intensity" 69 "Intensity" 70 "Intensity" 71 "Intensity" 72 "Intensity" 73 "Intensity" 74 "Intensity" 75 "Intensity" 76 "Intensity" 77 "Intensity" 78 "Intensity" 79 "Intensity" 80 "Intensity" 81 "Intensity" 82 "Intensity" 83 "Intensity" 84 "Intensity" 85 "Intensity" 86 "Intensity" 87 "Intensity" 88 "Intensity" 89 "Intensity" 90 "Intensity" 91 "Intensity" 92 "Intensity" 93 "Intensity" 94 "Intensity" 95 "Intensity" 96 "Intensity" 97 "Intensity" 98 "Intensity" 99 "Intensity" 100 "Intensity" 101 "Intensity" 102 "Intensity" 103 "Intensity" 104 "Intensity" 105 "Intensity" 106 "Intensity" 107 "Intensity" 108 "Intensity" 109 "Intensity" 110 "Intensity" 111 "Intensity" 112 "Intensity" 113 "Intensity" 114 "Intensity" 115 "Intensity" 116 "Intensity" 117 "Intensity" 118 "Intensity" 119 "Intensity" 120 "Intensity" 121 "Intensity" 122 "Intensity" 123 "Intensity" 124 "Intensity" 125 "Intensity" 126 "Intensity" 127 "Intensity" 128 "Intensity" 129 "Intensity" 130 "Intensity" 131 "Intensity" 132 "Intensity" 133 "Intensity" 134 "Intensity" 135 "Intensity" 136 "Intensity" 137 "Intensity" 138 "Intensity" 139 "Intensity" 140 "Intensity" 141 "Intensity" 142 "Intensity" 143 "Intensity" 144 "Intensity" 145 "Intensity" 146 "Intensity" 147 "Intensity" 148 "Intensity" 149 "Intensity" 150 "Intensity" 151 "Intensity" 152 "Intensity" 153 "Intensity" 154 "Intensity" 155 "Intensity" 156 "Intensity" 157 "Intensity" 158 "Intensity" 159 "Intensity" 160 "Intensity" 161 "Intensity" 162 "Intensity" 163 "Intensity" 164 "Intensity" 165 "Intensity" 166 "Intensity" 167 "Intensity" 168 "Intensity" 169 "Intensity" 170 "Intensity" 171 "Intensity" 172 "Intensity" 173 "Intensity" 174 "Intensity" 175 "Intensity" 176 "Intensity" 177 "Intensity" 178 "Intensity" 179 "Intensity" 180 "Intensity" 181 "Intensity" 182 "Intensity" 183 "Intensity" 184 "Intensity" 185 "Intensity" 186 "Intensity" 187 "Intensity" 188 "Intensity" 189 "Intensity" 190 "Intensity" 191 "Intensity" 192 "Intensity" 193 "Intensity" 194 "Intensity" 195 "Intensity" 196 "Intensity" 197 "Intensity" 198 "Intensity" 199 "Intensity" 200 "Intensity" 201 "Intensity" 202 "Intensity" 203 "Intensity" 204 "Intensity" 205 "Intensity" 206 "Intensity" 207 "Intensity" 208 "Intensity" 209 "Intensity" 210 "Intensity" 211 "Intensity" 212 "Intensity" 213 "Intensity" 214 "Intensity" 215 "Intensity" 216 "Intensity" 217 "Intensity" 218 "Intensity" 219 "Intensity" 220 "Intensity" 221 "Intensity" 222 "Intensity" 223 "Intensity" 224 "Intensity" 225 "Intensity" 226 "Intensity" 227 "Intensity" 228 "Intensity" 229 "Intensity" 230 "Intensity" 231 "Intensity" 232 "Intensity" 233 "Intensity" 234 "Intensity" 235 "Intensity" 236 "Intensity" 237 "Intensity" 238 "Intensity" 239 "Intensity" 240 "Intensity" 241 "Intensity" 242 "Intensity" 243 "Intensity" 244 "Intensity" 245 "Intensity" 246 "Intensity" 247 "Intensity" 248 "Intensity" 249 "Intensity" 250 "Intensity" 251 "Reserved" 252 "Not Available" 253 "Reserved" 254 "Init" 255 "Failure"  ;
VAL_ 957 HOD_TouchIntensityZone3 0 "Intensity" 1 "Intensity" 2 "Intensity" 3 "Intensity" 4 "Intensity" 5 "Intensity" 6 "Intensity" 7 "Intensity" 8 "Intensity" 9 "Intensity" 10 "Intensity" 11 "Intensity" 12 "Intensity" 13 "Intensity" 14 "Intensity" 15 "Intensity" 16 "Intensity" 17 "Intensity" 18 "Intensity" 19 "Intensity" 20 "Intensity" 21 "Intensity" 22 "Intensity" 23 "Intensity" 24 "Intensity" 25 "Intensity" 26 "Intensity" 27 "Intensity" 28 "Intensity" 29 "Intensity" 30 "Intensity" 31 "Intensity" 32 "Intensity" 33 "Intensity" 34 "Intensity" 35 "Intensity" 36 "Intensity" 37 "Intensity" 38 "Intensity" 39 "Intensity" 40 "Intensity" 41 "Intensity" 42 "Intensity" 43 "Intensity" 44 "Intensity" 45 "Intensity" 46 "Intensity" 47 "Intensity" 48 "Intensity" 49 "Intensity" 50 "Intensity" 51 "Intensity" 52 "Intensity" 53 "Intensity" 54 "Intensity" 55 "Intensity" 56 "Intensity" 57 "Intensity" 58 "Intensity" 59 "Intensity" 60 "Intensity" 61 "Intensity" 62 "Intensity" 63 "Intensity" 64 "Intensity" 65 "Intensity" 66 "Intensity" 67 "Intensity" 68 "Intensity" 69 "Intensity" 70 "Intensity" 71 "Intensity" 72 "Intensity" 73 "Intensity" 74 "Intensity" 75 "Intensity" 76 "Intensity" 77 "Intensity" 78 "Intensity" 79 "Intensity" 80 "Intensity" 81 "Intensity" 82 "Intensity" 83 "Intensity" 84 "Intensity" 85 "Intensity" 86 "Intensity" 87 "Intensity" 88 "Intensity" 89 "Intensity" 90 "Intensity" 91 "Intensity" 92 "Intensity" 93 "Intensity" 94 "Intensity" 95 "Intensity" 96 "Intensity" 97 "Intensity" 98 "Intensity" 99 "Intensity" 100 "Intensity" 101 "Intensity" 102 "Intensity" 103 "Intensity" 104 "Intensity" 105 "Intensity" 106 "Intensity" 107 "Intensity" 108 "Intensity" 109 "Intensity" 110 "Intensity" 111 "Intensity" 112 "Intensity" 113 "Intensity" 114 "Intensity" 115 "Intensity" 116 "Intensity" 117 "Intensity" 118 "Intensity" 119 "Intensity" 120 "Intensity" 121 "Intensity" 122 "Intensity" 123 "Intensity" 124 "Intensity" 125 "Intensity" 126 "Intensity" 127 "Intensity" 128 "Intensity" 129 "Intensity" 130 "Intensity" 131 "Intensity" 132 "Intensity" 133 "Intensity" 134 "Intensity" 135 "Intensity" 136 "Intensity" 137 "Intensity" 138 "Intensity" 139 "Intensity" 140 "Intensity" 141 "Intensity" 142 "Intensity" 143 "Intensity" 144 "Intensity" 145 "Intensity" 146 "Intensity" 147 "Intensity" 148 "Intensity" 149 "Intensity" 150 "Intensity" 151 "Intensity" 152 "Intensity" 153 "Intensity" 154 "Intensity" 155 "Intensity" 156 "Intensity" 157 "Intensity" 158 "Intensity" 159 "Intensity" 160 "Intensity" 161 "Intensity" 162 "Intensity" 163 "Intensity" 164 "Intensity" 165 "Intensity" 166 "Intensity" 167 "Intensity" 168 "Intensity" 169 "Intensity" 170 "Intensity" 171 "Intensity" 172 "Intensity" 173 "Intensity" 174 "Intensity" 175 "Intensity" 176 "Intensity" 177 "Intensity" 178 "Intensity" 179 "Intensity" 180 "Intensity" 181 "Intensity" 182 "Intensity" 183 "Intensity" 184 "Intensity" 185 "Intensity" 186 "Intensity" 187 "Intensity" 188 "Intensity" 189 "Intensity" 190 "Intensity" 191 "Intensity" 192 "Intensity" 193 "Intensity" 194 "Intensity" 195 "Intensity" 196 "Intensity" 197 "Intensity" 198 "Intensity" 199 "Intensity" 200 "Intensity" 201 "Intensity" 202 "Intensity" 203 "Intensity" 204 "Intensity" 205 "Intensity" 206 "Intensity" 207 "Intensity" 208 "Intensity" 209 "Intensity" 210 "Intensity" 211 "Intensity" 212 "Intensity" 213 "Intensity" 214 "Intensity" 215 "Intensity" 216 "Intensity" 217 "Intensity" 218 "Intensity" 219 "Intensity" 220 "Intensity" 221 "Intensity" 222 "Intensity" 223 "Intensity" 224 "Intensity" 225 "Intensity" 226 "Intensity" 227 "Intensity" 228 "Intensity" 229 "Intensity" 230 "Intensity" 231 "Intensity" 232 "Intensity" 233 "Intensity" 234 "Intensity" 235 "Intensity" 236 "Intensity" 237 "Intensity" 238 "Intensity" 239 "Intensity" 240 "Intensity" 241 "Intensity" 242 "Intensity" 243 "Intensity" 244 "Intensity" 245 "Intensity" 246 "Intensity" 247 "Intensity" 248 "Intensity" 249 "Intensity" 250 "Intensity" 251 "Reserved" 252 "Not Available" 253 "Reserved" 254 "Init" 255 "Failure"  ;
VAL_ 957 HOD_SysErr 0 "no fault" 1 "Temporal fault" 2 "Permanent fault" 3 "Reserved"  ;
VAL_ 360 BCS_BrkTqCtrlAvlDriving 0 "Not available" 1 "Available" 2 "Available degraded1（Redundant Project）" 3 "Available degraded2 （Redundant Project）" 4 "Reserved" 5 "Reserved" 6 "Reserved" 7 "Reserved"  ;
VAL_ 360 BCS_BrkTqCtrlAvlParking 0 "Not available" 1 "available" 2 "parking overspeed--for BOSCH ADAS" 3 "Reserved"  ;
VAL_ 360 BCS_BrkTqCtrlActv 0 "NotActive" 1 "APA Active" 2 "ACC Active" 3 "BCS Active"  ;
VAL_ 360 BCS_ChVehSpdVD 0 "Invalid" 1 "Valid"  ;
VAL_ 360 BCS_ESCFailSt 0 "No error" 1 "Error"  ;
VAL_ 360 BCS_ESCFuncActiveSt 0 "Not active" 1 "Active"  ;
VAL_ 360 BCS_DycEscTarTqCtrlAvl 0 "Not available" 1 "Available"  ;
VAL_ 360 BCS_errorFb 0 "No error" 1 "Invalid Request of ADAS" 2 "Fault related to wheelspd" 2 "Fault related to steeringangel" 3 "Fault related to powertrain" 4 "Fault related to EPB" 7 "ADAS E2E fault or timeoutt"  ;
VAL_ 360 BCS_DrvrBrkOvrd 0 "Not override" 1 "Override"  ;
VAL_ 360 BCS_DrvrBrkOvrdVD 0 "Invalid" 1 "Valid"  ;
VAL_ 360 BCS_DycEscTarTqActv 0 "NotActive" 1 "Active"  ;
VAL_ 360 BCS_WheelSlipFLVD 0 "Invalid" 1 "Valid"  ;
VAL_ 360 BCS_WheelSlipFRVD 0 "Invalid" 1 "Valid"  ;
VAL_ 360 BCS_WheelSlipRLVD 0 "Invalid" 1 "Valid"  ;
VAL_ 360 BCS_WheelSlipRRVD 0 "Invalid" 1 "Valid"  ;
VAL_ 360 BCS_BrkTarRecpTorqFASt 0 "NotIntialized" 1 "Normal（valid）" 2 "Faulty（invalid）" 3 "Reserved"  ;
VAL_ 360 BCS_BrkTarRecpTorqRASt 0 "NotIntialized" 1 "Normal（valid）" 2 "Faulty（invalid）" 3 "Reserved"  ;
VAL_ 360 BCS_BrkTarRecpTorqSt 0 "NotIntialized" 1 "Normal（valid）" 2 "Faulty（invalid）" 3 "Reserved"  ;
VAL_ 360 BCS_BrkTqCtrlAvlParkingRdn 0 "BrakeBackupStrategyAvailability_None" 1 "BrakeBackupStrategyAvailability_Full" 2 "BrakeBackupStrategyAvailability_Fault" 3 "BrakeBackupStrategyAvailability_TestPending" 4 "BrakeBackupStrategyAvailability_NotInitialized" 5 "Parking_Overspeed" 6 "Reserved" 7 "Reserved"  ;
VAL_ 360 BCS_EngTorqDecActiveStRL 0 "Not active" 1 "Active"  ;
VAL_ 360 BCS_EngTorqDecActiveStRR 0 "Not active" 1 "Active"  ;
VAL_ 360 BCS_ICCSt 0 "Not Active" 1 "Active"  ;
VAL_ 360 BCS_ICCAvl 0 "Not Available" 1 "Available"  ;
VAL_ 360 BCS_ICCErrFb 0 "Normal；" 1 "internal function active；" 2 "ICC abnormal；" 3 "BCS internal falut" 4 "execute higher-priority function；"  ;
VAL_ 360 BCS_SimulatorPressureSt_1 0 "Valid/Init" 1 "Invalid/Default"  ;
VAL_ 360 BCS_SysSt_1 0 "BBF_FullSys/Init/Default" 1 "BBF_DegradedPedalFeel" 2 "BBF_CircuitSperation" 3 "BBF_C1/2BoostOnly" 4 "HydBack w/ act / HydBack w/o act"  ;
VAL_ 360 BCS_FWAWarning_1 0 "no failure/Init/Default" 1 "Warnig level 1 for high Temp. of Brake system" 2 "Warnig level 2 for high Temp. of Brake system" 3 "reserved"  ;
VAL_ 360 BCS_CSTSt_1 0 "CST is disabled/Init/Default" 1 "CST is Standby" 2 "CST is Active" 3 "CST is Failure"  ;
VAL_ 360 BCS_AVDCActive_1 0 "Not active" 1 "Active"  ;
VAL_ 360 BCS_AVDCAvailable_1 0 "Not active" 1 "Active"  ;
VAL_ 475 ACU_MirrSteeringAdjFlag 0 "Not active" 1 "Mirror adjust active" 2 "Steering adjust active" 3 "Steering learning guidance"  ;
VAL_ 351 ACU_VirtualPowerOFFReq 0 "No request" 1 "Request"  ;
VAL_ 351 ACU_Account_Uld 0 "No command" 1 "account 0" 2 "account 1" 3 "account 2" 4 "account 3" 5 "account 4" 6 "account 5" 7 "account 6" 8 "account 7" 9 "account 8" 10 "Not used" 11 "Not used" 12 "Not used" 13 "Not used" 14 "Not used" 15 "Not used"  ;
VAL_ 351 ACU_FactoryResetReq 0 "NoRequest" 1 "Request"  ;
VAL_ 351 ACU_FrontWiperIntCfgVkReq 0 "No command"  ;
VAL_ 351 ACU_FrontWiperAutoCfgVkReq 0 "No command"  ;
VAL_ 351 IDC_VoicePAAReq 0 "No request" 1 "Request"  ;
VAL_ 351 IDC_VoiceParkCheckReq 0 "No request" 1 "Request"  ;
VAL_ 776 EL_LeftBSDIndicatorSt 0 "OFF" 1 "ON"  ;
VAL_ 776 UINM_HazardLightSwSt 0 "No Request" 1 "Request"  ;
VAL_ 776 EL_MLTurnLightSt 0 "Not active" 1 "OFF" 2 "ON" 3 "Not used"  ;
VAL_ 776 EL_MLTurnLightFaultSt 0 "Not fault" 1 "Fault"  ;
VAL_ 776 EL_LeftBSDIndicatorFaultSt 0 "Not fault" 1 "Fault"  ;
VAL_ 776 EL_MLADASLightSt 0 "Off" 1 "On" 2 "Fault" 3 "Not used"  ;
VAL_ 776 ZCUL_FrtWindshildHeatSt 0 "No" 1 "Heating" 2 "Fault" 3 "reserve"  ;
VAL_ 967 DMS_SysErrSt 0 "Unavailable_Default value" 1 "DMS blocked by steeringwheel" 2 "DMS blocked" 3 "FF lose templates" 4 "IR-proof sunglass detected" 5 "DMS system error" 6 "Normal Running" 7 "reserved"  ;
VAL_ 967 DMS_DrvrDetSts 1 "Not detected--driver is not detected" 2 "Eye detected--driver's eye can be detected" 3 "Head detected--driver's head can be detected" 4 "Reserved" 5 "Reserved" 6 "Reserved" 7 "Reserved"  ;
VAL_ 967 DMS_InterestsRegion 0 "Unavailable-default value" 1 "Driver side window" 2 "Rear view mirror" 3 "Driver side windshield" 4 "Codriver side windshield" 5 "Instrument cluster" 6 "Infotaiment display" 7 "Driver side door panel" 8 "Driver side footwell" 9 "Codriver side footwell" 10 "Codriver side window" 11 "Left outer mirror" 12 "Right outer mirror" 13 "Gear" 14 "Driver side windshield  top" 15 "Codriver side windshield top" 16 "Other Area" 17 "Reserved" 18 "Reserved" 19 "Reserved" 20 "Reserved" 21 "Reserved" 22 "Reserved" 23 "Reserved" 24 "Reserved" 25 "Reserved" 26 "Reserved" 27 "Reserved" 28 "Reserved" 29 "Reserved" 30 "Reserved" 31 "Reserved"  ;
VAL_ 967 DMS_L3DriverDistractionSt 0 "Unavailable--default value" 21 "Unknown--can not determine the distraction level" 42 "Distractive--Looking at red area or yellow area and over the limit condition" 63 "Non-Distractive--Looking at green area or yellow area with limit condition"  ;
VAL_ 967 DMS_L3DriverFatigueSt 0 "unavailable" 585 "unknown" 1170 "alert" 1755 "fatigue" 2340 "highly fatigue" 2925 "suspected unresponsive" 3510 "confirmed unresponsive" 4095 "not used"  ;
VAL_ 967 DMS_FaceIDStatus 0 "Default" 1 "Registering" 2 "Recognizing" 3 "Erorr"  ;
VAL_ 967 DMS_FaceID 0 "Default" 1 "AUID 1" 2 "AUID 2" 3 "AUID 3" 4 "AUID 4" 5 "AUID 5" 6 "AUID 6" 7 "AUID 7" 8 "AUID 8" 9 "Other" 10 "Other" 11 "Other" 12 "Other" 13 "Other" 14 "Other" 15 "Other"  ;
VAL_ 967 DMS_LeftEyeOpenSt 0 "Unavailable-default value" 1 "open" 2 "closed" 3 "can not detected"  ;
VAL_ 967 DMS_RightEyeOpenSt 0 "Unavailable-default value" 1 "open" 2 "closed" 3 "can not detected"  ;
VAL_ 967 DMS_DriverSmokeSt 0 "Unavailable-default value" 1 "smoking" 2 "non-smoking" 3 "reserved"  ;
VAL_ 967 DMS_DriverTelephoneSt 0 "Unavailable-default value" 1 "phoning" 2 "non-phoning" 3 "reserved"  ;
VAL_ 967 DMS_DriverHealthSt 0 "Unavailable-default value" 1 "Heart rate" 2 "Heart rate variability" 3 "Blood oxygen saturation" 4 "Blood pressure" 5 "Respiratory rate"  ;
VAL_ 967 DMS_FatigWarnSt 0 "Unavailable--driver not detected or default value or Deactivated" 1 "Unknown--driver detected, but can't determine the" 2 "alert" 3 "Drowsiness" 4 "Mircosleep" 5 "Sleep" 6 "Unresponsive driver" 7 "Reserved"  ;
VAL_ 967 DMS_DistrWarnSt 0 "Unavailable--driver not detected or default value or Deactivated" 1 "Unknown--driver detected, but can't determine the" 2 "Long Distraction--During the driving,the driver is looking at the incorrect zones for 3s." 3 "Short Distraction--During the driving,the driver is repeated glances away from the forward road view" 4 "Special Long Distractive--During the driving,the driver is looking at the incorrect zones for 1s." 5 "Non-Distractive--During the driving,the driver is looking" 6 "Reserved" 7 "Reserved"  ;
VAL_ 967 DMS_FaceIDVerifyResult 0 "Default" 1 "Face_ID_1_Verify_success" 2 "Face_ID_2_Verify_success" 3 "Face_ID_3_Verify_success" 4 "Face_ID_4_Verify_success" 5 "Face_ID_5_Verify_success" 6 "Face_ID_6_Verify_success" 7 "Face_ID_7_Verify_success" 8 "Face_ID_8_Verify_success" 9 "Fail" 10 "Timeout（10S）—other reasons" 11 "Verify Canceled" 12 "OtherReqWorking" 13 "Error_ServiceUnavailable" 14 "Error_CurrentAbnormal" 15 "Error_VoltageAbnormal" 16 "Error_DeviceAbnormal" 17 "Timeout_Can't detect faces （无法检测人脸）" 18 "Timeout_Angle is too large（人脸角度过大）" 19 "Timeout_The face is too close to the camera（距摄像头过近）" 20 "Timeout_The face is too far from the camera（距摄像头过远）" 21 "reserved"  ;
VAL_ 967 DMS_YawnSt 0 "Unavailable-default value" 1 "True" 2 "False" 3 "can not detected"  ;
VAL_ 342 KAE_PassiveUnlockReq 0 "No command" 1 "Unlock"  ;
VAL_ 342 KAE_PassiveLockReq 0 "No command" 1 "Lock"  ;
VAL_ 342 KAE_FOB1Position 0 "Undifiend" 1 "Inside vehicle" 2 "Outside vehicle" 3 "Not used" 4 "Inside trunk"  ;
VAL_ 342 KAE_FOB2Position 0 "Undifiend" 1 "Inside vehicle" 2 "Outside vehicle" 3 "Not used" 4 "Inside trunk"  ;
VAL_ 342 KAE_FOB3Position 0 "Undifiend" 1 "Inside vehicle" 2 "Outside vehicle" 3 "Not used" 4 "Inside trunk"  ;
VAL_ 342 KAE_FOB2UnlockBtnPressS 0 "Undefined" 1 "Short Press" 2 "Twice short Press" 3 "Long Press"  ;
VAL_ 342 KAE_FOB2LockBtnPressSt 0 "Undefined" 1 "Short Press" 2 "Twice short Press" 3 "Long Press"  ;
VAL_ 342 KAE_FOB2TrunkBtnPressSt 0 "Undefined" 1 "Short Press" 2 "Twice short Press" 3 "Long Press"  ;
VAL_ 342 KAE_FOB2User_definedBtnPressSt 0 "Undefined" 1 "Short Press" 2 "Twice short Press" 3 "Long Press"  ;
VAL_ 342 KAE_FOB3UnlockBtnPressS 0 "Undefined" 1 "Short Press" 2 "Twice short Press" 3 "Long Press"  ;
VAL_ 342 KAE_FOB3LockBtnPressSt 0 "Undefined" 1 "Short Press" 2 "Twice short Press" 3 "Long Press"  ;
VAL_ 342 KAE_FOB3TrunkBinPressSt 0 "Undefined" 1 "Short Press" 2 "Twice short Press" 3 "Long Press"  ;
VAL_ 342 KAE_FOB3User_defnedBtnPressst 0 "Undefined" 1 "Short Press" 2 "Twice short Press" 3 "Long Press"  ;
VAL_ 342 KAE_FOBUnlockBtnPressSt 0 "Not press" 1 "Short press" 2 "Twice short press" 3 "Long press"  ;
VAL_ 342 KAE_FOBLockBtnPressSt 0 "Not press" 1 "Short press" 2 "Twice short press" 3 "Long press"  ;
VAL_ 342 KAE_FOBRESBtnPressSt 0 "Not press" 1 "Short press" 2 "Twice short press" 3 "Long press"  ;
VAL_ 342 KAE_FOBPSD_LBtnPressSt 0 "Not press" 1 "Short press" 2 "Twice short press" 3 "Long press"  ;
VAL_ 342 KAE_FOBPSD_RBtnPressSt 0 "Not press" 1 "Short press" 2 "Twice short press" 3 "Long press"  ;
VAL_ 342 KAE_FOBTrunkBtnPressSt 0 "Not press" 1 "Short press" 2 "Twice short press" 3 "Long press"  ;
VAL_ 342 KAE_FOBPanicBtnPressSt 0 "Not press" 1 "Short press" 2 "Twice short press" 3 "Long press"  ;
VAL_ 342 KAE_FOBUser_definedBtnPressSt 0 "Not press" 1 "Short press" 2 "Twice short press" 3 "Long press"  ;
VAL_ 342 KAE_FOB2RESBtnPressSt 0 "Undifiend" 1 "Short press" 2 "Twice short press" 3 "Long press"  ;
VAL_ 342 KAE_FOB2PanicBtnPressSt 0 "Undifiend" 1 "Short press" 2 "Twice short press" 3 "Long press"  ;
VAL_ 512 KAE_BLE1Position 0 "Undefined" 1 "Passive start zone" 2 "Inside trunk zone" 3 "In  passive access left zone" 4 "In  paasive access right zone" 5 "In trunk passive access zone" 6 "In Passive start and paasive access zone"  ;
VAL_ 512 KAE_BLE2Position 0 "Undefined" 1 "Passive start zone" 2 "Inside trunk zone" 3 "In  passive access left zone" 4 "In  paasive access right zone" 5 "In trunk passive access zone" 6 "In Passive start and paasive access zone"  ;
VAL_ 512 KAE_BLE3Position 0 "Undefined" 1 "Passive start zone" 2 "Inside trunk zone" 3 "In  passive access left zone" 4 "In  paasive access right zone" 5 "In trunk passive access zone" 6 "In Passive start and paasive access zone"  ;
VAL_ 512 KAE_BLE4Position 0 "Undefined" 1 "Passive start zone" 2 "Inside trunk zone" 3 "In  passive access left zone" 4 "In  paasive access right zone" 5 "In trunk passive access zone" 6 "In Passive start and paasive access zone"  ;
VAL_ 512 KAE_BLE5Position 0 "Undefined" 1 "Passive start zone" 2 "Inside trunk zone" 3 "In  passive access left zone" 4 "In  paasive access right zone" 5 "In trunk passive access zone" 6 "In Passive start and paasive access zone"  ;
VAL_ 512 KAE_BLE1AuthSt 0 "Undefined" 1 "Failed" 2 "Pass" 3 "Busy"  ;
VAL_ 512 KAE_BLE2AuthSt 0 "Undefined" 1 "Failed" 2 "Pass" 3 "Busy"  ;
VAL_ 512 KAE_BLE3AuthSt 0 "Undefined" 1 "Failed" 2 "Pass" 3 "Busy"  ;
VAL_ 512 KAE_BLE4AuthSt 0 "Undefined" 1 "Failed" 2 "Pass" 3 "Busy"  ;
VAL_ 512 KAE_BLE5AuthSt 0 "Undefined" 1 "Failed" 2 "Pass" 3 "Busy"  ;
VAL_ 512 KAE_BLE1PKSPosition 0 "Undefined" 1 "Passive start zone" 2 "Inside trunk zone" 3 "In  passive access left zone" 4 "In  paasive access right zone" 5 "In trunk passive access zone" 6 "In Passive start and paasive access zone"  ;
VAL_ 512 KAE_BLE2PKSPosition 0 "Undefined" 1 "Passive start zone" 2 "Inside trunk zone" 3 "In  passive access left zone" 4 "In  paasive access right zone" 5 "In trunk passive access zone" 6 "In Passive start and paasive access zone"  ;
VAL_ 512 KAE_BLE3PKSPosition 0 "Undefined" 1 "Passive start zone" 2 "Inside trunk zone" 3 "In  passive access left zone" 4 "In  paasive access right zone" 5 "In trunk passive access zone" 6 "In Passive start and paasive access zone"  ;
VAL_ 512 KAE_BLE4PKSPosition 0 "Undefined" 1 "Passive start zone" 2 "Inside trunk zone" 3 "In  passive access left zone" 4 "In  paasive access right zone" 5 "In trunk passive access zone" 6 "In Passive start and paasive access zone"  ;
VAL_ 512 KAE_BLE5PKSPosition 0 "Undefined" 1 "Passive start zone" 2 "Inside trunk zone" 3 "In  passive access left zone" 4 "In  paasive access right zone" 5 "In trunk passive access zone" 6 "In Passive start and paasive access zone"  ;
VAL_ 939 SRS_PsngrSeatBeltSt 0 "Fastened" 1 "Unfastened" 2 "Not_used" 3 "Invalid"  ;
VAL_ 939 SRS_DriverSeatBeltSt 0 "Fastened" 1 "Unfastened" 2 "Notused" 3 "Invalid"  ;
VAL_ 939 SRS_RearLeftSeatBeltSt 0 "Fastened" 1 "Unfastened" 2 "Not_used" 3 "Invalid"  ;
VAL_ 939 SRS_AirbagFaultSt 0 "Not fault" 1 "Fault"  ;
VAL_ 939 SRS_RearRightSeatBeltSt 0 "Fastened" 1 "Unfastened" 2 "Not_used" 3 "Invalid"  ;
VAL_ 939 SRS_RearMiddleSeatBeltSt 0 "Fastened" 1 "Unfastened" 2 "Not_used" 3 "Invalid"  ;
