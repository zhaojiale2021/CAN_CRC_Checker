VERSION "Version"

NS_ :

BS_:

BU_: ADC FLR FRR Tester

BO_ 526 FLR_Obj_13: 32 FLR
 SG_ SGU13_Msg_CheckSum : 7|8@0+ (1,0) [0|255] ""  ADC
 SG_ SGU13_Msg_AliveCounter : 11|4@0+ (1,0) [0|14] ""  ADC
 SG_ SGU13_BlockCounter : 15|4@0+ (1,0) [0|15] ""  ADC
 SG_ SGU13_Object_ID : 23|8@0+ (1,0) [0|255] ""  ADC
 SG_ SGU13_Object_wExist : 28|5@0+ (0.03125,0) [0|0.96875] ""  ADC
 SG_ SGU13_Object_Type : 31|3@0+ (1,0) [0|7] ""  ADC
 SG_ SGU13_Object_Motion_Pattern : 34|3@0+ (1,0) [0|7] ""  ADC
 SG_ SGU13_Object_wObstacle : 39|5@0+ (0.03125,0) [0|0.96875] ""  ADC
 SG_ SGU13_Object_dx : 43|12@0+ (0.0625,-128) [-128|127.9375] "m"  ADC
 SG_ SGU13_Object_dy : 59|12@0+ (0.125,-128) [-128|127.875] "m"  ADC
 SG_ SGU13_Object_DistLong_rms : 79|16@0+ (0.001953125,0) [0|127.998046875] "m"  ADC
 SG_ SGU13_Obj_DistLat_rms : 95|16@0+ (0.001953125,0) [0|127.998046875] "m"  ADC
 SG_ SGU13_Object_vx : 107|12@0+ (0.0625,-128) [-128|127.9375] "m/s"  ADC
 SG_ SGU13_Object_vy : 123|12@0+ (0.0625,-128) [-128|127.9375] "m/s"  ADC
 SG_ SGU13_Obj_VrelLong_rms : 143|16@0+ (0.001953125,0) [0|127.998046875] "m/s"  ADC
 SG_ SGU13_Obj_Vrelat_rms : 159|16@0+ (0.001953125,0) [0|127.998046875] "m/s"  ADC
 SG_ SGU13_Object_ax : 170|11@0+ (0.03125,-16) [-16|15.96875] "m/s^2"  ADC
 SG_ SGU13_Object_ay : 191|11@0+ (0.03125,-16) [-16|15.96875] "m/s^2"  ADC
 SG_ SGU13_Object_DetStatus : 173|3@0+ (1,0) [0|7] ""  ADC
 SG_ SGU13_LifeCycles_OBJ : 196|8@0+ (1,0) [0|255] ""  ADC
 SG_ SGU13_ObjRCS_13 : 204|10@0+ (0.125,-50) [-50|70] "dBm2"  ADC
 SG_ SGU13_Object_dx_Rear : 209|12@0+ (0.0625,-128) [-128|127.9375] "m"  ADC
 SG_ SGU13_Object_dy_Rear : 229|12@0+ (0.125,-128) [-128|127.875] "m"  ADC

BO_ 527 FLR_Obj_14: 32 FLR
 SG_ SGU14_Msg_CheckSum : 7|8@0+ (1,0) [0|255] ""  ADC
 SG_ SGU14_Msg_AliveCounter : 11|4@0+ (1,0) [0|14] ""  ADC
 SG_ SGU14_BlockCounter : 15|4@0+ (1,0) [0|15] ""  ADC
 SG_ SGU14_Object_ID : 23|8@0+ (1,0) [0|255] ""  ADC
 SG_ SGU14_Object_wExist : 28|5@0+ (0.03125,0) [0|0.96875] ""  ADC
 SG_ SGU14_Object_Type : 31|3@0+ (1,0) [0|7] ""  ADC
 SG_ SGU14_Object_Motion_Pattern : 34|3@0+ (1,0) [0|7] ""  ADC
 SG_ SGU14_Object_wObstacle : 39|5@0+ (0.03125,0) [0|0.96875] ""  ADC
 SG_ SGU14_Object_dx : 43|12@0+ (0.0625,-128) [-128|127.9375] "m"  ADC
 SG_ SGU14_Object_dy : 59|12@0+ (0.125,-128) [-128|127.875] "m"  ADC
 SG_ SGU14_Object_DistLong_rms : 79|16@0+ (0.001953125,0) [0|127.998046875] "m"  ADC
 SG_ SGU14_Obj_DistLat_rms : 95|16@0+ (0.001953125,0) [0|127.998046875] "m"  ADC
 SG_ SGU14_Object_vx : 107|12@0+ (0.0625,-128) [-128|127.9375] "m/s"  ADC
 SG_ SGU14_Object_vy : 123|12@0+ (0.0625,-128) [-128|127.9375] "m/s"  ADC
 SG_ SGU14_Obj_VrelLong_rms : 143|16@0+ (0.001953125,0) [0|127.998046875] "m/s"  ADC
 SG_ SGU14_Obj_Vrelat_rms : 159|16@0+ (0.001953125,0) [0|127.998046875] "m/s"  ADC
 SG_ SGU14_Object_ax : 170|11@0+ (0.03125,-16) [-16|15.96875] "m/s^2"  ADC
 SG_ SGU14_Object_ay : 191|11@0+ (0.03125,-16) [-16|15.96875] "m/s^2"  ADC
 SG_ SGU14_Object_DetStatus : 173|3@0+ (1,0) [0|7] ""  ADC
 SG_ SGU14_LifeCycles_OBJ : 196|8@0+ (1,0) [0|255] ""  ADC
 SG_ SGU14_ObjRCS_14 : 204|10@0+ (0.125,-50) [-50|70] "dBm2"  ADC
 SG_ SGU14_Object_dx_Rear : 209|12@0+ (0.0625,-128) [-128|127.9375] "m"  ADC
 SG_ SGU14_Object_dy_Rear : 229|12@0+ (0.125,-128) [-128|127.875] "m"  ADC

BO_ 528 FLR_Obj_15: 32 FLR
 SG_ SGU15_Msg_CheckSum : 7|8@0+ (1,0) [0|255] ""  ADC
 SG_ SGU15_Msg_AliveCounter : 11|4@0+ (1,0) [0|14] ""  ADC
 SG_ SGU15_BlockCounter : 15|4@0+ (1,0) [0|15] ""  ADC
 SG_ SGU15_Object_ID : 23|8@0+ (1,0) [0|255] ""  ADC
 SG_ SGU15_Object_wExist : 28|5@0+ (0.03125,0) [0|0.96875] ""  ADC
 SG_ SGU15_Object_Type : 31|3@0+ (1,0) [0|7] ""  ADC
 SG_ SGU15_Object_Motion_Pattern : 34|3@0+ (1,0) [0|7] ""  ADC
 SG_ SGU15_Object_wObstacle : 39|5@0+ (0.03125,0) [0|0.96875] ""  ADC
 SG_ SGU15_Object_dx : 43|12@0+ (0.0625,-128) [-128|127.9375] "m"  ADC
 SG_ SGU15_Object_dy : 59|12@0+ (0.125,-128) [-128|127.875] "m"  ADC
 SG_ SGU15_Object_DistLong_rms : 79|16@0+ (0.001953125,0) [0|127.998046875] "m"  ADC
 SG_ SGU15_Obj_DistLat_rms : 95|16@0+ (0.001953125,0) [0|127.998046875] "m"  ADC
 SG_ SGU15_Object_vx : 107|12@0+ (0.0625,-128) [-128|127.9375] "m/s"  ADC
 SG_ SGU15_Object_vy : 123|12@0+ (0.0625,-128) [-128|127.9375] "m/s"  ADC
 SG_ SGU15_Obj_VrelLong_rms : 143|16@0+ (0.001953125,0) [0|127.998046875] "m/s"  ADC
 SG_ SGU15_Obj_Vrelat_rms : 159|16@0+ (0.001953125,0) [0|127.998046875] "m/s"  ADC
 SG_ SGU15_Object_ax : 170|11@0+ (0.03125,-16) [-16|15.96875] "m/s^2"  ADC
 SG_ SGU15_Object_ay : 191|11@0+ (0.03125,-16) [-16|15.96875] "m/s^2"  ADC
 SG_ SGU15_Object_DetStatus : 173|3@0+ (1,0) [0|7] ""  ADC
 SG_ SGU15_LifeCycles_OBJ : 196|8@0+ (1,0) [0|255] ""  ADC
 SG_ SGU15_ObjRCS_15 : 204|10@0+ (0.125,-50) [-50|70] "dBm2"  ADC
 SG_ SGU15_Object_dx_Rear : 209|12@0+ (0.0625,-128) [-128|127.9375] "m"  ADC
 SG_ SGU15_Object_dy_Rear : 229|12@0+ (0.125,-128) [-128|127.875] "m"  ADC

BO_ 529 FLR_Obj_16: 32 FLR
 SG_ SGU16_Msg_CheckSum : 7|8@0+ (1,0) [0|255] ""  ADC
 SG_ SGU16_Msg_AliveCounter : 11|4@0+ (1,0) [0|14] ""  ADC
 SG_ SGU16_BlockCounter : 15|4@0+ (1,0) [0|15] ""  ADC
 SG_ SGU16_Object_ID : 23|8@0+ (1,0) [0|255] ""  ADC
 SG_ SGU16_Object_wExist : 28|5@0+ (0.03125,0) [0|0.96875] ""  ADC
 SG_ SGU16_Object_Type : 31|3@0+ (1,0) [0|7] ""  ADC
 SG_ SGU16_Object_Motion_Pattern : 34|3@0+ (1,0) [0|7] ""  ADC
 SG_ SGU16_Object_wObstacle : 39|5@0+ (0.03125,0) [0|0.96875] ""  ADC
 SG_ SGU16_Object_dx : 43|12@0+ (0.0625,-128) [-128|127.9375] "m"  ADC
 SG_ SGU16_Object_dy : 59|12@0+ (0.125,-128) [-128|127.875] "m"  ADC
 SG_ SGU16_Object_DistLong_rms : 79|16@0+ (0.001953125,0) [0|127.998046875] "m"  ADC
 SG_ SGU16_Obj_DistLat_rms : 95|16@0+ (0.001953125,0) [0|127.998046875] "m"  ADC
 SG_ SGU16_Object_vx : 107|12@0+ (0.0625,-128) [-128|127.9375] "m/s"  ADC
 SG_ SGU16_Object_vy : 123|12@0+ (0.0625,-128) [-128|127.9375] "m/s"  ADC
 SG_ SGU16_Obj_VrelLong_rms : 143|16@0+ (0.001953125,0) [0|127.998046875] "m/s"  ADC
 SG_ SGU16_Obj_Vrelat_rms : 159|16@0+ (0.001953125,0) [0|127.998046875] "m/s"  ADC
 SG_ SGU16_Object_ax : 170|11@0+ (0.03125,-16) [-16|15.96875] "m/s^2"  ADC
 SG_ SGU16_Object_ay : 191|11@0+ (0.03125,-16) [-16|15.96875] "m/s^2"  ADC
 SG_ SGU16_Object_DetStatus : 173|3@0+ (1,0) [0|7] ""  ADC
 SG_ SGU16_LifeCycles_OBJ : 196|8@0+ (1,0) [0|255] ""  ADC
 SG_ SGU16_ObjRCS_16 : 204|10@0+ (0.125,-50) [-50|70] "dBm2"  ADC
 SG_ SGU16_Object_dx_Rear : 209|12@0+ (0.0625,-128) [-128|127.9375] "m"  ADC
 SG_ SGU16_Object_dy_Rear : 229|12@0+ (0.125,-128) [-128|127.875] "m"  ADC

BO_ 530 FLR_Obj_17: 32 FLR
 SG_ SGU17_Msg_CheckSum : 7|8@0+ (1,0) [0|255] ""  ADC
 SG_ SGU17_Msg_AliveCounter : 11|4@0+ (1,0) [0|14] ""  ADC
 SG_ SGU17_BlockCounter : 15|4@0+ (1,0) [0|15] ""  ADC
 SG_ SGU17_Object_ID : 23|8@0+ (1,0) [0|255] ""  ADC
 SG_ SGU17_Object_wExist : 28|5@0+ (0.03125,0) [0|0.96875] ""  ADC
 SG_ SGU17_Object_Type : 31|3@0+ (1,0) [0|7] ""  ADC
 SG_ SGU17_Object_Motion_Pattern : 34|3@0+ (1,0) [0|7] ""  ADC
 SG_ SGU17_Object_wObstacle : 39|5@0+ (0.03125,0) [0|0.96875] ""  ADC
 SG_ SGU17_Object_dx : 43|12@0+ (0.0625,-128) [-128|127.9375] "m"  ADC
 SG_ SGU17_Object_dy : 59|12@0+ (0.125,-128) [-128|127.875] "m"  ADC
 SG_ SGU17_Object_DistLong_rms : 79|16@0+ (0.001953125,0) [0|127.998046875] "m"  ADC
 SG_ SGU17_Obj_DistLat_rms : 95|16@0+ (0.001953125,0) [0|127.998046875] "m"  ADC
 SG_ SGU17_Object_vx : 107|12@0+ (0.0625,-128) [-128|127.9375] "m/s"  ADC
 SG_ SGU17_Object_vy : 123|12@0+ (0.0625,-128) [-128|127.9375] "m/s"  ADC
 SG_ SGU17_Obj_VrelLong_rms : 143|16@0+ (0.001953125,0) [0|127.998046875] "m/s"  ADC
 SG_ SGU17_Obj_Vrelat_rms : 159|16@0+ (0.001953125,0) [0|127.998046875] "m/s"  ADC
 SG_ SGU17_Object_ax : 170|11@0+ (0.03125,-16) [-16|15.96875] "m/s^2"  ADC
 SG_ SGU17_Object_ay : 191|11@0+ (0.03125,-16) [-16|15.96875] "m/s^2"  ADC
 SG_ SGU17_Object_DetStatus : 173|3@0+ (1,0) [0|7] ""  ADC
 SG_ SGU17_LifeCycles_OBJ : 196|8@0+ (1,0) [0|255] ""  ADC
 SG_ SGU17_ObjRCS_17 : 204|10@0+ (0.125,-50) [-50|70] "dBm2"  ADC
 SG_ SGU17_Object_dx_Rear : 209|12@0+ (0.0625,-128) [-128|127.9375] "m"  ADC
 SG_ SGU17_Object_dy_Rear : 229|12@0+ (0.125,-128) [-128|127.875] "m"  ADC

BO_ 531 FLR_Obj_18: 32 FLR
 SG_ SGU18_Msg_CheckSum : 7|8@0+ (1,0) [0|255] ""  ADC
 SG_ SGU18_Msg_AliveCounter : 11|4@0+ (1,0) [0|14] ""  ADC
 SG_ SGU18_BlockCounter : 15|4@0+ (1,0) [0|15] ""  ADC
 SG_ SGU18_Object_ID : 23|8@0+ (1,0) [0|255] ""  ADC
 SG_ SGU18_Object_wExist : 28|5@0+ (0.03125,0) [0|0.96875] ""  ADC
 SG_ SGU18_Object_Type : 31|3@0+ (1,0) [0|7] ""  ADC
 SG_ SGU18_Object_Motion_Pattern : 34|3@0+ (1,0) [0|7] ""  ADC
 SG_ SGU18_Object_wObstacle : 39|5@0+ (0.03125,0) [0|0.96875] ""  ADC
 SG_ SGU18_Object_dx : 43|12@0+ (0.0625,-128) [-128|127.9375] "m"  ADC
 SG_ SGU18_Object_dy : 59|12@0+ (0.125,-128) [-128|127.875] "m"  ADC
 SG_ SGU18_Object_DistLong_rms : 79|16@0+ (0.001953125,0) [0|127.998046875] "m"  ADC
 SG_ SGU18_Obj_DistLat_rms : 95|16@0+ (0.001953125,0) [0|127.998046875] "m"  ADC
 SG_ SGU18_Object_vx : 107|12@0+ (0.0625,-128) [-128|127.9375] "m/s"  ADC
 SG_ SGU18_Object_vy : 123|12@0+ (0.0625,-128) [-128|127.9375] "m/s"  ADC
 SG_ SGU18_Obj_VrelLong_rms : 143|16@0+ (0.001953125,0) [0|127.998046875] "m/s"  ADC
 SG_ SGU18_Obj_Vrelat_rms : 159|16@0+ (0.001953125,0) [0|127.998046875] "m/s"  ADC
 SG_ SGU18_Object_ax : 170|11@0+ (0.03125,-16) [-16|15.96875] "m/s^2"  ADC
 SG_ SGU18_Object_ay : 191|11@0+ (0.03125,-16) [-16|15.96875] "m/s^2"  ADC
 SG_ SGU18_Object_DetStatus : 173|3@0+ (1,0) [0|7] ""  ADC
 SG_ SGU18_LifeCycles_OBJ : 196|8@0+ (1,0) [0|255] ""  ADC
 SG_ SGU18_ObjRCS_18 : 204|10@0+ (0.125,-50) [-50|70] "dBm2"  ADC
 SG_ SGU18_Object_dx_Rear : 209|12@0+ (0.0625,-128) [-128|127.9375] "m"  ADC
 SG_ SGU18_Object_dy_Rear : 229|12@0+ (0.125,-128) [-128|127.875] "m"  ADC

BO_ 532 FLR_Obj_19: 32 FLR
 SG_ SGU19_Msg_CheckSum : 7|8@0+ (1,0) [0|255] ""  ADC
 SG_ SGU19_Msg_AliveCounter : 11|4@0+ (1,0) [0|14] ""  ADC
 SG_ SGU19_BlockCounter : 15|4@0+ (1,0) [0|15] ""  ADC
 SG_ SGU19_Object_ID : 23|8@0+ (1,0) [0|255] ""  ADC
 SG_ SGU19_Object_wExist : 28|5@0+ (0.03125,0) [0|0.96875] ""  ADC
 SG_ SGU19_Object_Type : 31|3@0+ (1,0) [0|7] ""  ADC
 SG_ SGU19_Object_Motion_Pattern : 34|3@0+ (1,0) [0|7] ""  ADC
 SG_ SGU19_Object_wObstacle : 39|5@0+ (0.03125,0) [0|0.96875] ""  ADC
 SG_ SGU19_Object_dx : 43|12@0+ (0.0625,-128) [-128|127.9375] "m"  ADC
 SG_ SGU19_Object_dy : 59|12@0+ (0.125,-128) [-128|127.875] "m"  ADC
 SG_ SGU19_Object_DistLong_rms : 79|16@0+ (0.001953125,0) [0|127.998046875] "m"  ADC
 SG_ SGU19_Obj_DistLat_rms : 95|16@0+ (0.001953125,0) [0|127.998046875] "m"  ADC
 SG_ SGU19_Object_vx : 107|12@0+ (0.0625,-128) [-128|127.9375] "m/s"  ADC
 SG_ SGU19_Object_vy : 123|12@0+ (0.0625,-128) [-128|127.9375] "m/s"  ADC
 SG_ SGU19_Obj_VrelLong_rms : 143|16@0+ (0.001953125,0) [0|127.998046875] "m/s"  ADC
 SG_ SGU19_Obj_Vrelat_rms : 159|16@0+ (0.001953125,0) [0|127.998046875] "m/s"  ADC
 SG_ SGU19_Object_ax : 170|11@0+ (0.03125,-16) [-16|15.96875] "m/s^2"  ADC
 SG_ SGU19_Object_ay : 191|11@0+ (0.03125,-16) [-16|15.96875] "m/s^2"  ADC
 SG_ SGU19_Object_DetStatus : 173|3@0+ (1,0) [0|7] ""  ADC
 SG_ SGU19_LifeCycles_OBJ : 196|8@0+ (1,0) [0|255] ""  ADC
 SG_ SGU19_ObjRCS_19 : 204|10@0+ (0.125,-50) [-50|70] "dBm2"  ADC
 SG_ SGU19_Object_dx_Rear : 209|12@0+ (0.0625,-128) [-128|127.9375] "m"  ADC
 SG_ SGU19_Object_dy_Rear : 229|12@0+ (0.125,-128) [-128|127.875] "m"  ADC

BO_ 533 FLR_Obj_20: 32 FLR
 SG_ SGU20_Msg_CheckSum : 7|8@0+ (1,0) [0|255] ""  ADC
 SG_ SGU20_Msg_AliveCounter : 11|4@0+ (1,0) [0|14] ""  ADC
 SG_ SGU20_BlockCounter : 15|4@0+ (1,0) [0|15] ""  ADC
 SG_ SGU20_Object_ID : 23|8@0+ (1,0) [0|255] ""  ADC
 SG_ SGU20_Object_wExist : 28|5@0+ (0.03125,0) [0|0.96875] ""  ADC
 SG_ SGU20_Object_Type : 31|3@0+ (1,0) [0|7] ""  ADC
 SG_ SGU20_Object_Motion_Pattern : 34|3@0+ (1,0) [0|7] ""  ADC
 SG_ SGU20_Object_wObstacle : 39|5@0+ (0.03125,0) [0|0.96875] ""  ADC
 SG_ SGU20_Object_dx : 43|12@0+ (0.0625,-128) [-128|127.9375] "m"  ADC
 SG_ SGU20_Object_dy : 59|12@0+ (0.125,-128) [-128|127.875] "m"  ADC
 SG_ SGU20_Object_DistLong_rms : 79|16@0+ (0.001953125,0) [0|127.998046875] "m"  ADC
 SG_ SGU20_Obj_DistLat_rms : 95|16@0+ (0.001953125,0) [0|127.998046875] "m"  ADC
 SG_ SGU20_Object_vx : 107|12@0+ (0.0625,-128) [-128|127.9375] "m/s"  ADC
 SG_ SGU20_Object_vy : 123|12@0+ (0.0625,-128) [-128|127.9375] "m/s"  ADC
 SG_ SGU20_Obj_VrelLong_rms : 143|16@0+ (0.001953125,0) [0|127.998046875] "m/s"  ADC
 SG_ SGU20_Obj_Vrelat_rms : 159|16@0+ (0.001953125,0) [0|127.998046875] "m/s"  ADC
 SG_ SGU20_Object_ax : 170|11@0+ (0.03125,-16) [-16|15.96875] "m/s^2"  ADC
 SG_ SGU20_Object_ay : 191|11@0+ (0.03125,-16) [-16|15.96875] "m/s^2"  ADC
 SG_ SGU20_Object_DetStatus : 173|3@0+ (1,0) [0|7] ""  ADC
 SG_ SGU20_LifeCycles_OBJ : 196|8@0+ (1,0) [0|255] ""  ADC
 SG_ SGU20_ObjRCS_20 : 204|10@0+ (0.125,-50) [-50|70] "dBm2"  ADC
 SG_ SGU20_Object_dx_Rear : 209|12@0+ (0.0625,-128) [-128|127.9375] "m"  ADC
 SG_ SGU20_Object_dy_Rear : 229|12@0+ (0.125,-128) [-128|127.875] "m"  ADC

BO_ 534 FLR_Obj_21: 32 FLR
 SG_ SGU21_Msg_CheckSum : 7|8@0+ (1,0) [0|255] ""  ADC
 SG_ SGU21_Msg_AliveCounter : 11|4@0+ (1,0) [0|14] ""  ADC
 SG_ SGU21_BlockCounter : 15|4@0+ (1,0) [0|15] ""  ADC
 SG_ SGU21_Object_ID : 23|8@0+ (1,0) [0|255] ""  ADC
 SG_ SGU21_Object_wExist : 28|5@0+ (0.03125,0) [0|0.96875] ""  ADC
 SG_ SGU21_Object_Type : 31|3@0+ (1,0) [0|7] ""  ADC
 SG_ SGU21_Object_Motion_Pattern : 34|3@0+ (1,0) [0|7] ""  ADC
 SG_ SGU21_Object_wObstacle : 39|5@0+ (0.03125,0) [0|0.96875] ""  ADC
 SG_ SGU21_Object_dx : 43|12@0+ (0.0625,-128) [-128|127.9375] "m"  ADC
 SG_ SGU21_Object_dy : 59|12@0+ (0.125,-128) [-128|127.875] "m"  ADC
 SG_ SGU21_Object_DistLong_rms : 79|16@0+ (0.001953125,0) [0|127.998046875] "m"  ADC
 SG_ SGU21_Obj_DistLat_rms : 95|16@0+ (0.001953125,0) [0|127.998046875] "m"  ADC
 SG_ SGU21_Object_vx : 107|12@0+ (0.0625,-128) [-128|127.9375] "m/s"  ADC
 SG_ SGU21_Object_vy : 123|12@0+ (0.0625,-128) [-128|127.9375] "m/s"  ADC
 SG_ SGU21_Obj_VrelLong_rms : 143|16@0+ (0.001953125,0) [0|127.998046875] "m/s"  ADC
 SG_ SGU21_Obj_Vrelat_rms : 159|16@0+ (0.001953125,0) [0|127.998046875] "m/s"  ADC
 SG_ SGU21_Object_ax : 170|11@0+ (0.03125,-16) [-16|15.96875] "m/s^2"  ADC
 SG_ SGU21_Object_ay : 191|11@0+ (0.03125,-16) [-16|15.96875] "m/s^2"  ADC
 SG_ SGU21_Object_DetStatus : 173|3@0+ (1,0) [0|7] ""  ADC
 SG_ SGU21_LifeCycles_OBJ : 196|8@0+ (1,0) [0|255] ""  ADC
 SG_ SGU21_ObjRCS_21 : 204|10@0+ (0.125,-50) [-50|70] "dBm2"  ADC
 SG_ SGU21_Object_dx_Rear : 209|12@0+ (0.0625,-128) [-128|127.9375] "m"  ADC
 SG_ SGU21_Object_dy_Rear : 229|12@0+ (0.125,-128) [-128|127.875] "m"  ADC

BO_ 535 FLR_Obj_22: 32 FLR
 SG_ SGU22_Msg_CheckSum : 7|8@0+ (1,0) [0|255] ""  ADC
 SG_ SGU22_Msg_AliveCounter : 11|4@0+ (1,0) [0|14] ""  ADC
 SG_ SGU22_BlockCounter : 15|4@0+ (1,0) [0|15] ""  ADC
 SG_ SGU22_Object_ID : 23|8@0+ (1,0) [0|255] ""  ADC
 SG_ SGU22_Object_wExist : 28|5@0+ (0.03125,0) [0|0.96875] ""  ADC
 SG_ SGU22_Object_Type : 31|3@0+ (1,0) [0|7] ""  ADC
 SG_ SGU22_Object_Motion_Pattern : 34|3@0+ (1,0) [0|7] ""  ADC
 SG_ SGU22_Object_wObstacle : 39|5@0+ (0.03125,0) [0|0.96875] ""  ADC
 SG_ SGU22_Object_dx : 43|12@0+ (0.0625,-128) [-128|127.9375] "m"  ADC
 SG_ SGU22_Object_dy : 59|12@0+ (0.125,-128) [-128|127.875] "m"  ADC
 SG_ SGU22_Object_DistLong_rms : 79|16@0+ (0.001953125,0) [0|127.998046875] "m"  ADC
 SG_ SGU22_Obj_DistLat_rms : 95|16@0+ (0.001953125,0) [0|127.998046875] "m"  ADC
 SG_ SGU22_Object_vx : 107|12@0+ (0.0625,-128) [-128|127.9375] "m/s"  ADC
 SG_ SGU22_Object_vy : 123|12@0+ (0.0625,-128) [-128|127.9375] "m/s"  ADC
 SG_ SGU22_Obj_VrelLong_rms : 143|16@0+ (0.001953125,0) [0|127.998046875] "m/s"  ADC
 SG_ SGU22_Obj_Vrelat_rms : 159|16@0+ (0.001953125,0) [0|127.998046875] "m/s"  ADC
 SG_ SGU22_Object_ax : 170|11@0+ (0.03125,-16) [-16|15.96875] "m/s^2"  ADC
 SG_ SGU22_Object_ay : 191|11@0+ (0.03125,-16) [-16|15.96875] "m/s^2"  ADC
 SG_ SGU22_Object_DetStatus : 173|3@0+ (1,0) [0|7] ""  ADC
 SG_ SGU22_LifeCycles_OBJ : 196|8@0+ (1,0) [0|255] ""  ADC
 SG_ SGU22_ObjRCS_22 : 204|10@0+ (0.125,-50) [-50|70] "dBm2"  ADC
 SG_ SGU22_Object_dx_Rear : 209|12@0+ (0.0625,-128) [-128|127.9375] "m"  ADC
 SG_ SGU22_Object_dy_Rear : 229|12@0+ (0.125,-128) [-128|127.875] "m"  ADC

BO_ 536 FLR_Obj_23: 32 FLR
 SG_ SGU23_Msg_CheckSum : 7|8@0+ (1,0) [0|255] ""  ADC
 SG_ SGU23_Msg_AliveCounter : 11|4@0+ (1,0) [0|14] ""  ADC
 SG_ SGU23_BlockCounter : 15|4@0+ (1,0) [0|15] ""  ADC
 SG_ SGU23_Object_ID : 23|8@0+ (1,0) [0|255] ""  ADC
 SG_ SGU23_Object_wExist : 28|5@0+ (0.03125,0) [0|0.96875] ""  ADC
 SG_ SGU23_Object_Type : 31|3@0+ (1,0) [0|7] ""  ADC
 SG_ SGU23_Object_Motion_Pattern : 34|3@0+ (1,0) [0|7] ""  ADC
 SG_ SGU23_Object_wObstacle : 39|5@0+ (0.03125,0) [0|0.96875] ""  ADC
 SG_ SGU23_Object_dx : 43|12@0+ (0.0625,-128) [-128|127.9375] "m"  ADC
 SG_ SGU23_Object_dy : 59|12@0+ (0.125,-128) [-128|127.875] "m"  ADC
 SG_ SGU23_Object_DistLong_rms : 79|16@0+ (0.001953125,0) [0|127.998046875] "m"  ADC
 SG_ SGU23_Obj_DistLat_rms : 95|16@0+ (0.001953125,0) [0|127.998046875] "m"  ADC
 SG_ SGU23_Object_vx : 107|12@0+ (0.0625,-128) [-128|127.9375] "m/s"  ADC
 SG_ SGU23_Object_vy : 123|12@0+ (0.0625,-128) [-128|127.9375] "m/s"  ADC
 SG_ SGU23_Obj_VrelLong_rms : 143|16@0+ (0.001953125,0) [0|127.998046875] "m/s"  ADC
 SG_ SGU23_Obj_Vrelat_rms : 159|16@0+ (0.001953125,0) [0|127.998046875] "m/s"  ADC
 SG_ SGU23_Object_ax : 170|11@0+ (0.03125,-16) [-16|15.96875] "m/s^2"  ADC
 SG_ SGU23_Object_ay : 191|11@0+ (0.03125,-16) [-16|15.96875] "m/s^2"  ADC
 SG_ SGU23_Object_DetStatus : 173|3@0+ (1,0) [0|7] ""  ADC
 SG_ SGU23_LifeCycles_OBJ : 196|8@0+ (1,0) [0|255] ""  ADC
 SG_ SGU23_ObjRCS_23 : 204|10@0+ (0.125,-50) [-50|70] "dBm2"  ADC
 SG_ SGU23_Object_dx_Rear : 209|12@0+ (0.0625,-128) [-128|127.9375] "m"  ADC
 SG_ SGU23_Object_dy_Rear : 229|12@0+ (0.125,-128) [-128|127.875] "m"  ADC

BO_ 537 FLR_Obj_24: 32 FLR
 SG_ SGU24_Msg_CheckSum : 7|8@0+ (1,0) [0|255] ""  ADC
 SG_ SGU24_Msg_AliveCounter : 11|4@0+ (1,0) [0|14] ""  ADC
 SG_ SGU24_BlockCounter : 15|4@0+ (1,0) [0|15] ""  ADC
 SG_ SGU24_Object_ID : 23|8@0+ (1,0) [0|255] ""  ADC
 SG_ SGU24_Object_wExist : 28|5@0+ (0.03125,0) [0|0.96875] ""  ADC
 SG_ SGU24_Object_Type : 31|3@0+ (1,0) [0|7] ""  ADC
 SG_ SGU24_Object_Motion_Pattern : 34|3@0+ (1,0) [0|7] ""  ADC
 SG_ SGU24_Object_wObstacle : 39|5@0+ (0.03125,0) [0|0.96875] ""  ADC
 SG_ SGU24_Object_dx : 43|12@0+ (0.0625,-128) [-128|127.9375] "m"  ADC
 SG_ SGU24_Object_dy : 59|12@0+ (0.125,-128) [-128|127.875] "m"  ADC
 SG_ SGU24_Object_DistLong_rms : 79|16@0+ (0.001953125,0) [0|127.998046875] "m"  ADC
 SG_ SGU24_Obj_DistLat_rms : 95|16@0+ (0.001953125,0) [0|127.998046875] "m"  ADC
 SG_ SGU24_Object_vx : 107|12@0+ (0.0625,-128) [-128|127.9375] "m/s"  ADC
 SG_ SGU24_Object_vy : 123|12@0+ (0.0625,-128) [-128|127.9375] "m/s"  ADC
 SG_ SGU24_Obj_VrelLong_rms : 143|16@0+ (0.001953125,0) [0|127.998046875] "m/s"  ADC
 SG_ SGU24_Obj_Vrelat_rms : 159|16@0+ (0.001953125,0) [0|127.998046875] "m/s"  ADC
 SG_ SGU24_Object_ax : 170|11@0+ (0.03125,-16) [-16|15.96875] "m/s^2"  ADC
 SG_ SGU24_Object_ay : 191|11@0+ (0.03125,-16) [-16|15.96875] "m/s^2"  ADC
 SG_ SGU24_Object_DetStatus : 173|3@0+ (1,0) [0|7] ""  ADC
 SG_ SGU24_LifeCycles_OBJ : 196|8@0+ (1,0) [0|255] ""  ADC
 SG_ SGU24_ObjRCS_24 : 204|10@0+ (0.125,-50) [-50|70] "dBm2"  ADC
 SG_ SGU24_Object_dx_Rear : 209|12@0+ (0.0625,-128) [-128|127.9375] "m"  ADC
 SG_ SGU24_Object_dy_Rear : 229|12@0+ (0.125,-128) [-128|127.875] "m"  ADC

BO_ 538 FLR_Obj_25: 32 FLR
 SG_ SGU25_Msg_CheckSum : 7|8@0+ (1,0) [0|255] ""  ADC
 SG_ SGU25_Msg_AliveCounter : 11|4@0+ (1,0) [0|14] ""  ADC
 SG_ SGU25_BlockCounter : 15|4@0+ (1,0) [0|15] ""  ADC
 SG_ SGU25_Object_ID : 23|8@0+ (1,0) [0|255] ""  ADC
 SG_ SGU25_Object_wExist : 28|5@0+ (0.03125,0) [0|0.96875] ""  ADC
 SG_ SGU25_Object_Type : 31|3@0+ (1,0) [0|7] ""  ADC
 SG_ SGU25_Object_Motion_Pattern : 34|3@0+ (1,0) [0|7] ""  ADC
 SG_ SGU25_Object_wObstacle : 39|5@0+ (0.03125,0) [0|0.96875] ""  ADC
 SG_ SGU25_Object_dx : 43|12@0+ (0.0625,-128) [-128|127.9375] "m"  ADC
 SG_ SGU25_Object_dy : 59|12@0+ (0.125,-128) [-128|127.875] "m"  ADC
 SG_ SGU25_Object_DistLong_rms : 79|16@0+ (0.001953125,0) [0|127.998046875] "m"  ADC
 SG_ SGU25_Obj_DistLat_rms : 95|16@0+ (0.001953125,0) [0|127.998046875] "m"  ADC
 SG_ SGU25_Object_vx : 107|12@0+ (0.0625,-128) [-128|127.9375] "m/s"  ADC
 SG_ SGU25_Object_vy : 123|12@0+ (0.0625,-128) [-128|127.9375] "m/s"  ADC
 SG_ SGU25_Obj_VrelLong_rms : 143|16@0+ (0.001953125,0) [0|127.998046875] "m/s"  ADC
 SG_ SGU25_Obj_Vrelat_rms : 159|16@0+ (0.001953125,0) [0|127.998046875] "m/s"  ADC
 SG_ SGU25_Object_ax : 170|11@0+ (0.03125,-16) [-16|15.96875] "m/s^2"  ADC
 SG_ SGU25_Object_ay : 191|11@0+ (0.03125,-16) [-16|15.96875] "m/s^2"  ADC
 SG_ SGU25_Object_DetStatus : 173|3@0+ (1,0) [0|7] ""  ADC
 SG_ SGU25_LifeCycles_OBJ : 196|8@0+ (1,0) [0|255] ""  ADC
 SG_ SGU25_ObjRCS_25 : 204|10@0+ (0.125,-50) [-50|70] "dBm2"  ADC
 SG_ SGU25_Object_dx_Rear : 209|12@0+ (0.0625,-128) [-128|127.9375] "m"  ADC
 SG_ SGU25_Object_dy_Rear : 229|12@0+ (0.125,-128) [-128|127.875] "m"  ADC

BO_ 539 FLR_Obj_26: 32 FLR
 SG_ SGU26_Msg_CheckSum : 7|8@0+ (1,0) [0|255] ""  ADC
 SG_ SGU26_Msg_AliveCounter : 11|4@0+ (1,0) [0|14] ""  ADC
 SG_ SGU26_BlockCounter : 15|4@0+ (1,0) [0|15] ""  ADC
 SG_ SGU26_Object_ID : 23|8@0+ (1,0) [0|255] ""  ADC
 SG_ SGU26_Object_wExist : 28|5@0+ (0.03125,0) [0|0.96875] ""  ADC
 SG_ SGU26_Object_Type : 31|3@0+ (1,0) [0|7] ""  ADC
 SG_ SGU26_Object_Motion_Pattern : 34|3@0+ (1,0) [0|7] ""  ADC
 SG_ SGU26_Object_wObstacle : 39|5@0+ (0.03125,0) [0|0.96875] ""  ADC
 SG_ SGU26_Object_dx : 43|12@0+ (0.0625,-128) [-128|127.9375] "m"  ADC
 SG_ SGU26_Object_dy : 59|12@0+ (0.125,-128) [-128|127.875] "m"  ADC
 SG_ SGU26_Object_DistLong_rms : 79|16@0+ (0.001953125,0) [0|127.998046875] "m"  ADC
 SG_ SGU26_Obj_DistLat_rms : 95|16@0+ (0.001953125,0) [0|127.998046875] "m"  ADC
 SG_ SGU26_Object_vx : 107|12@0+ (0.0625,-128) [-128|127.9375] "m/s"  ADC
 SG_ SGU26_Object_vy : 123|12@0+ (0.0625,-128) [-128|127.9375] "m/s"  ADC
 SG_ SGU26_Obj_VrelLong_rms : 143|16@0+ (0.001953125,0) [0|127.998046875] "m/s"  ADC
 SG_ SGU26_Obj_Vrelat_rms : 159|16@0+ (0.001953125,0) [0|127.998046875] "m/s"  ADC
 SG_ SGU26_Object_ax : 170|11@0+ (0.03125,-16) [-16|15.96875] "m/s^2"  ADC
 SG_ SGU26_Object_ay : 191|11@0+ (0.03125,-16) [-16|15.96875] "m/s^2"  ADC
 SG_ SGU26_Object_DetStatus : 173|3@0+ (1,0) [0|7] ""  ADC
 SG_ SGU26_LifeCycles_OBJ : 196|8@0+ (1,0) [0|255] ""  ADC
 SG_ SGU26_ObjRCS_26 : 204|10@0+ (0.125,-50) [-50|70] "dBm2"  ADC
 SG_ SGU26_Object_dx_Rear : 209|12@0+ (0.0625,-128) [-128|127.9375] "m"  ADC
 SG_ SGU26_Object_dy_Rear : 229|12@0+ (0.125,-128) [-128|127.875] "m"  ADC

BO_ 540 FLR_Obj_27: 32 FLR
 SG_ SGU27_Msg_CheckSum : 7|8@0+ (1,0) [0|255] ""  ADC
 SG_ SGU27_Msg_AliveCounter : 11|4@0+ (1,0) [0|14] ""  ADC
 SG_ SGU27_BlockCounter : 15|4@0+ (1,0) [0|15] ""  ADC
 SG_ SGU27_Object_ID : 23|8@0+ (1,0) [0|255] ""  ADC
 SG_ SGU27_Object_wExist : 28|5@0+ (0.03125,0) [0|0.96875] ""  ADC
 SG_ SGU27_Object_Type : 31|3@0+ (1,0) [0|7] ""  ADC
 SG_ SGU27_Object_Motion_Pattern : 34|3@0+ (1,0) [0|7] ""  ADC
 SG_ SGU27_Object_wObstacle : 39|5@0+ (0.03125,0) [0|0.96875] ""  ADC
 SG_ SGU27_Object_dx : 43|12@0+ (0.0625,-128) [-128|127.9375] "m"  ADC
 SG_ SGU27_Object_dy : 59|12@0+ (0.125,-128) [-128|127.875] "m"  ADC
 SG_ SGU27_Object_DistLong_rms : 79|16@0+ (0.001953125,0) [0|127.998046875] "m"  ADC
 SG_ SGU27_Obj_DistLat_rms : 95|16@0+ (0.001953125,0) [0|127.998046875] "m"  ADC
 SG_ SGU27_Object_vx : 107|12@0+ (0.0625,-128) [-128|127.9375] "m/s"  ADC
 SG_ SGU27_Object_vy : 123|12@0+ (0.0625,-128) [-128|127.9375] "m/s"  ADC
 SG_ SGU27_Obj_VrelLong_rms : 143|16@0+ (0.001953125,0) [0|127.998046875] "m/s"  ADC
 SG_ SGU27_Obj_Vrelat_rms : 159|16@0+ (0.001953125,0) [0|127.998046875] "m/s"  ADC
 SG_ SGU27_Object_ax : 170|11@0+ (0.03125,-16) [-16|15.96875] "m/s^2"  ADC
 SG_ SGU27_Object_ay : 191|11@0+ (0.03125,-16) [-16|15.96875] "m/s^2"  ADC
 SG_ SGU27_Object_DetStatus : 173|3@0+ (1,0) [0|7] ""  ADC
 SG_ SGU27_LifeCycles_OBJ : 196|8@0+ (1,0) [0|255] ""  ADC
 SG_ SGU27_ObjRCS_27 : 204|10@0+ (0.125,-50) [-50|70] "dBm2"  ADC
 SG_ SGU27_Object_dx_Rear : 209|12@0+ (0.0625,-128) [-128|127.9375] "m"  ADC
 SG_ SGU27_Object_dy_Rear : 229|12@0+ (0.125,-128) [-128|127.875] "m"  ADC

BA_DEF_ BO_  "CANFD_BRS" ENUM  "0","1";
BA_DEF_ BO_  "GenMsgCycleTime" INT 0 0;
BA_DEF_ BO_  "GenMsgCycleTimeFast" INT 0 0;
BA_DEF_ BO_  "GenMsgSendType" ENUM  "Periodic","Event","IfActive","POE","PA","FixedPeriodic","Event","EnabledPeriodic","NotUsed","NotUsed","EventPeriodic","NotUsed","NotUsed","NoMsgSendType";
BA_DEF_ BO_  "VFrameFormat" ENUM  "StandardCAN","ExtendedCAN","reserved","reserved","reserved","reserved","reserved","reserved","reserved","reserved","reserved","reserved","reserved","reserved","StandardCAN_FD","ExtendedCAN_FD";
BA_DEF_ SG_  "EventCommandSignal" ENUM  "No","Yes";
BA_DEF_ SG_  "GatewayedSignals" ENUM  "No","Yes";
BA_DEF_ SG_  "GenSigInactiveValue" HEX 0 0;
BA_DEF_ SG_  "GenSigInvalidValue" HEX 0 0;
BA_DEF_ SG_  "GenSigSendType" ENUM  "Trigger","Passive","Cyclic","OnWrite","OnWriteWithRepetition","OnChange","OnChangeWithRepetition","IfActive","IfActiveWithRepetition","NoSigSendType";
BA_DEF_ SG_  "GenSigStartValue" HEX 0 0;
BA_DEF_ SG_  "GenSigTimeoutValue" HEX 0 0;
BA_DEF_ SG_  "Remark" STRING ;
BA_DEF_ BO_  "GenMsgILSupport" ENUM  "No","Yes";
BA_DEF_ BO_  "MsgType" ENUM  "Normal","NM","Diag","vector_leerstring";
BA_DEF_ BO_  "NmAsrMessage" ENUM  "No","Yes";
BA_DEF_ SG_  "IsCrcSignal" ENUM  "No","Yes";
BA_DEF_ SG_  "SystemSignalLongSymbol" STRING ;

BA_DEF_DEF_  "GenMsgILSupport" "Yes";
BA_DEF_DEF_  "IsCrcSignal" "No";
BA_DEF_DEF_  "MsgType" "";
BA_DEF_DEF_  "NmAsrMessage" "No";
BA_DEF_DEF_  "SystemSignalLongSymbol" "";
BA_ "CANFD_BRS" BO_ 526 1;
BA_ "CANFD_BRS" BO_ 527 1;
BA_ "CANFD_BRS" BO_ 528 1;
BA_ "CANFD_BRS" BO_ 529 1;
BA_ "CANFD_BRS" BO_ 530 1;
BA_ "CANFD_BRS" BO_ 531 1;
BA_ "CANFD_BRS" BO_ 532 1;
BA_ "CANFD_BRS" BO_ 533 1;
BA_ "CANFD_BRS" BO_ 534 1;
BA_ "CANFD_BRS" BO_ 535 1;
BA_ "CANFD_BRS" BO_ 536 1;
BA_ "CANFD_BRS" BO_ 537 1;
BA_ "CANFD_BRS" BO_ 538 1;
BA_ "CANFD_BRS" BO_ 539 1;
BA_ "CANFD_BRS" BO_ 540 1;
BA_ "GenMsgCycleTime" BO_ 526 0;
BA_ "GenMsgCycleTime" BO_ 527 0;
BA_ "GenMsgCycleTime" BO_ 528 0;
BA_ "GenMsgCycleTime" BO_ 529 0;
BA_ "GenMsgCycleTime" BO_ 530 0;
BA_ "GenMsgCycleTime" BO_ 531 0;
BA_ "GenMsgCycleTime" BO_ 532 0;
BA_ "GenMsgCycleTime" BO_ 533 0;
BA_ "GenMsgCycleTime" BO_ 534 0;
BA_ "GenMsgCycleTime" BO_ 535 0;
BA_ "GenMsgCycleTime" BO_ 536 0;
BA_ "GenMsgCycleTime" BO_ 537 0;
BA_ "GenMsgCycleTime" BO_ 538 0;
BA_ "GenMsgCycleTime" BO_ 539 0;
BA_ "GenMsgCycleTime" BO_ 540 0;
BA_ "GenMsgCycleTimeFast" BO_ 526 0;
BA_ "GenMsgCycleTimeFast" BO_ 527 0;
BA_ "GenMsgCycleTimeFast" BO_ 528 0;
BA_ "GenMsgCycleTimeFast" BO_ 529 0;
BA_ "GenMsgCycleTimeFast" BO_ 530 0;
BA_ "GenMsgCycleTimeFast" BO_ 531 0;
BA_ "GenMsgCycleTimeFast" BO_ 532 0;
BA_ "GenMsgCycleTimeFast" BO_ 533 0;
BA_ "GenMsgCycleTimeFast" BO_ 534 0;
BA_ "GenMsgCycleTimeFast" BO_ 535 0;
BA_ "GenMsgCycleTimeFast" BO_ 536 0;
BA_ "GenMsgCycleTimeFast" BO_ 537 0;
BA_ "GenMsgCycleTimeFast" BO_ 538 0;
BA_ "GenMsgCycleTimeFast" BO_ 539 0;
BA_ "GenMsgCycleTimeFast" BO_ 540 0;
BA_ "GenMsgSendType" BO_ 526 1;
BA_ "GenMsgSendType" BO_ 527 1;
BA_ "GenMsgSendType" BO_ 528 1;
BA_ "GenMsgSendType" BO_ 529 1;
BA_ "GenMsgSendType" BO_ 530 1;
BA_ "GenMsgSendType" BO_ 531 1;
BA_ "GenMsgSendType" BO_ 532 1;
BA_ "GenMsgSendType" BO_ 533 1;
BA_ "GenMsgSendType" BO_ 534 1;
BA_ "GenMsgSendType" BO_ 535 1;
BA_ "GenMsgSendType" BO_ 536 1;
BA_ "GenMsgSendType" BO_ 537 1;
BA_ "GenMsgSendType" BO_ 538 1;
BA_ "GenMsgSendType" BO_ 539 1;
BA_ "GenMsgSendType" BO_ 540 1;
BA_ "VFrameFormat" BO_ 526 14;
BA_ "VFrameFormat" BO_ 527 14;
BA_ "VFrameFormat" BO_ 528 14;
BA_ "VFrameFormat" BO_ 529 14;
BA_ "VFrameFormat" BO_ 530 14;
BA_ "VFrameFormat" BO_ 531 14;
BA_ "VFrameFormat" BO_ 532 14;
BA_ "VFrameFormat" BO_ 533 14;
BA_ "VFrameFormat" BO_ 534 14;
BA_ "VFrameFormat" BO_ 535 14;
BA_ "VFrameFormat" BO_ 536 14;
BA_ "VFrameFormat" BO_ 537 14;
BA_ "VFrameFormat" BO_ 538 14;
BA_ "VFrameFormat" BO_ 539 14;
BA_ "VFrameFormat" BO_ 540 14;
BA_ "EventCommandSignal" SG_ 526 SGU13_BlockCounter 0;
BA_ "GatewayedSignals" SG_ 526 SGU13_BlockCounter 0;
BA_ "GenSigInactiveValue" SG_ 526 SGU13_BlockCounter 0;
BA_ "GenSigInvalidValue" SG_ 526 SGU13_BlockCounter 0;
BA_ "GenSigSendType" SG_ 526 SGU13_BlockCounter 1;
BA_ "GenSigStartValue" SG_ 526 SGU13_BlockCounter 0;
BA_ "GenSigTimeoutValue" SG_ 526 SGU13_BlockCounter 0;
BA_ "Remark" SG_ 526 SGU13_BlockCounter "";
BA_ "EventCommandSignal" SG_ 526 SGU13_LifeCycles_OBJ 0;
BA_ "GatewayedSignals" SG_ 526 SGU13_LifeCycles_OBJ 0;
BA_ "GenSigInactiveValue" SG_ 526 SGU13_LifeCycles_OBJ 0;
BA_ "GenSigInvalidValue" SG_ 526 SGU13_LifeCycles_OBJ 0;
BA_ "GenSigSendType" SG_ 526 SGU13_LifeCycles_OBJ 1;
BA_ "GenSigStartValue" SG_ 526 SGU13_LifeCycles_OBJ 0;
BA_ "GenSigTimeoutValue" SG_ 526 SGU13_LifeCycles_OBJ 0;
BA_ "Remark" SG_ 526 SGU13_LifeCycles_OBJ "";
BA_ "EventCommandSignal" SG_ 526 SGU13_Msg_AliveCounter 0;
BA_ "GatewayedSignals" SG_ 526 SGU13_Msg_AliveCounter 0;
BA_ "GenSigInactiveValue" SG_ 526 SGU13_Msg_AliveCounter 0;
BA_ "GenSigInvalidValue" SG_ 526 SGU13_Msg_AliveCounter 0;
BA_ "GenSigSendType" SG_ 526 SGU13_Msg_AliveCounter 1;
BA_ "GenSigStartValue" SG_ 526 SGU13_Msg_AliveCounter 0;
BA_ "GenSigTimeoutValue" SG_ 526 SGU13_Msg_AliveCounter 0;
BA_ "Remark" SG_ 526 SGU13_Msg_AliveCounter "";
BA_ "EventCommandSignal" SG_ 526 SGU13_Msg_CheckSum 0;
BA_ "GatewayedSignals" SG_ 526 SGU13_Msg_CheckSum 0;
BA_ "GenSigInactiveValue" SG_ 526 SGU13_Msg_CheckSum 0;
BA_ "GenSigInvalidValue" SG_ 526 SGU13_Msg_CheckSum 0;
BA_ "GenSigSendType" SG_ 526 SGU13_Msg_CheckSum 1;
BA_ "GenSigStartValue" SG_ 526 SGU13_Msg_CheckSum 0;
BA_ "GenSigTimeoutValue" SG_ 526 SGU13_Msg_CheckSum 0;
BA_ "Remark" SG_ 526 SGU13_Msg_CheckSum "";
BA_ "EventCommandSignal" SG_ 526 SGU13_ObjRCS_13 0;
BA_ "GatewayedSignals" SG_ 526 SGU13_ObjRCS_13 0;
BA_ "GenSigInactiveValue" SG_ 526 SGU13_ObjRCS_13 0;
BA_ "GenSigInvalidValue" SG_ 526 SGU13_ObjRCS_13 0;
BA_ "GenSigSendType" SG_ 526 SGU13_ObjRCS_13 1;
BA_ "GenSigStartValue" SG_ 526 SGU13_ObjRCS_13 0;
BA_ "GenSigTimeoutValue" SG_ 526 SGU13_ObjRCS_13 0;
BA_ "Remark" SG_ 526 SGU13_ObjRCS_13 "";
BA_ "EventCommandSignal" SG_ 526 SGU13_Obj_DistLat_rms 0;
BA_ "GatewayedSignals" SG_ 526 SGU13_Obj_DistLat_rms 0;
BA_ "GenSigInactiveValue" SG_ 526 SGU13_Obj_DistLat_rms 0;
BA_ "GenSigInvalidValue" SG_ 526 SGU13_Obj_DistLat_rms 0;
BA_ "GenSigSendType" SG_ 526 SGU13_Obj_DistLat_rms 1;
BA_ "GenSigStartValue" SG_ 526 SGU13_Obj_DistLat_rms 0;
BA_ "GenSigTimeoutValue" SG_ 526 SGU13_Obj_DistLat_rms 0;
BA_ "Remark" SG_ 526 SGU13_Obj_DistLat_rms "";
BA_ "EventCommandSignal" SG_ 526 SGU13_Obj_VrelLong_rms 0;
BA_ "GatewayedSignals" SG_ 526 SGU13_Obj_VrelLong_rms 0;
BA_ "GenSigInactiveValue" SG_ 526 SGU13_Obj_VrelLong_rms 0;
BA_ "GenSigInvalidValue" SG_ 526 SGU13_Obj_VrelLong_rms 0;
BA_ "GenSigSendType" SG_ 526 SGU13_Obj_VrelLong_rms 1;
BA_ "GenSigStartValue" SG_ 526 SGU13_Obj_VrelLong_rms 0;
BA_ "GenSigTimeoutValue" SG_ 526 SGU13_Obj_VrelLong_rms 0;
BA_ "Remark" SG_ 526 SGU13_Obj_VrelLong_rms "";
BA_ "EventCommandSignal" SG_ 526 SGU13_Obj_Vrelat_rms 0;
BA_ "GatewayedSignals" SG_ 526 SGU13_Obj_Vrelat_rms 0;
BA_ "GenSigInactiveValue" SG_ 526 SGU13_Obj_Vrelat_rms 0;
BA_ "GenSigInvalidValue" SG_ 526 SGU13_Obj_Vrelat_rms 0;
BA_ "GenSigSendType" SG_ 526 SGU13_Obj_Vrelat_rms 1;
BA_ "GenSigStartValue" SG_ 526 SGU13_Obj_Vrelat_rms 0;
BA_ "GenSigTimeoutValue" SG_ 526 SGU13_Obj_Vrelat_rms 0;
BA_ "Remark" SG_ 526 SGU13_Obj_Vrelat_rms "";
BA_ "EventCommandSignal" SG_ 526 SGU13_Object_DetStatus 0;
BA_ "GatewayedSignals" SG_ 526 SGU13_Object_DetStatus 0;
BA_ "GenSigInactiveValue" SG_ 526 SGU13_Object_DetStatus 0;
BA_ "GenSigInvalidValue" SG_ 526 SGU13_Object_DetStatus 0;
BA_ "GenSigSendType" SG_ 526 SGU13_Object_DetStatus 1;
BA_ "GenSigStartValue" SG_ 526 SGU13_Object_DetStatus 0;
BA_ "GenSigTimeoutValue" SG_ 526 SGU13_Object_DetStatus 0;
BA_ "Remark" SG_ 526 SGU13_Object_DetStatus "";
BA_ "EventCommandSignal" SG_ 526 SGU13_Object_DistLong_rms 0;
BA_ "GatewayedSignals" SG_ 526 SGU13_Object_DistLong_rms 0;
BA_ "GenSigInactiveValue" SG_ 526 SGU13_Object_DistLong_rms 0;
BA_ "GenSigInvalidValue" SG_ 526 SGU13_Object_DistLong_rms 0;
BA_ "GenSigSendType" SG_ 526 SGU13_Object_DistLong_rms 1;
BA_ "GenSigStartValue" SG_ 526 SGU13_Object_DistLong_rms 0;
BA_ "GenSigTimeoutValue" SG_ 526 SGU13_Object_DistLong_rms 0;
BA_ "Remark" SG_ 526 SGU13_Object_DistLong_rms "";
BA_ "EventCommandSignal" SG_ 526 SGU13_Object_ID 0;
BA_ "GatewayedSignals" SG_ 526 SGU13_Object_ID 0;
BA_ "GenSigInactiveValue" SG_ 526 SGU13_Object_ID 0;
BA_ "GenSigInvalidValue" SG_ 526 SGU13_Object_ID 0;
BA_ "GenSigSendType" SG_ 526 SGU13_Object_ID 1;
BA_ "GenSigStartValue" SG_ 526 SGU13_Object_ID 0;
BA_ "GenSigTimeoutValue" SG_ 526 SGU13_Object_ID 0;
BA_ "Remark" SG_ 526 SGU13_Object_ID "";
BA_ "EventCommandSignal" SG_ 526 SGU13_Object_Motion_Pattern 0;
BA_ "GatewayedSignals" SG_ 526 SGU13_Object_Motion_Pattern 0;
BA_ "GenSigInactiveValue" SG_ 526 SGU13_Object_Motion_Pattern 0;
BA_ "GenSigInvalidValue" SG_ 526 SGU13_Object_Motion_Pattern 0;
BA_ "GenSigSendType" SG_ 526 SGU13_Object_Motion_Pattern 1;
BA_ "GenSigStartValue" SG_ 526 SGU13_Object_Motion_Pattern 0;
BA_ "GenSigTimeoutValue" SG_ 526 SGU13_Object_Motion_Pattern 0;
BA_ "Remark" SG_ 526 SGU13_Object_Motion_Pattern "";
BA_ "EventCommandSignal" SG_ 526 SGU13_Object_Type 0;
BA_ "GatewayedSignals" SG_ 526 SGU13_Object_Type 0;
BA_ "GenSigInactiveValue" SG_ 526 SGU13_Object_Type 0;
BA_ "GenSigInvalidValue" SG_ 526 SGU13_Object_Type 0;
BA_ "GenSigSendType" SG_ 526 SGU13_Object_Type 1;
BA_ "GenSigStartValue" SG_ 526 SGU13_Object_Type 0;
BA_ "GenSigTimeoutValue" SG_ 526 SGU13_Object_Type 0;
BA_ "Remark" SG_ 526 SGU13_Object_Type "";
BA_ "EventCommandSignal" SG_ 526 SGU13_Object_ax 0;
BA_ "GatewayedSignals" SG_ 526 SGU13_Object_ax 0;
BA_ "GenSigInactiveValue" SG_ 526 SGU13_Object_ax 0;
BA_ "GenSigInvalidValue" SG_ 526 SGU13_Object_ax 0;
BA_ "GenSigSendType" SG_ 526 SGU13_Object_ax 1;
BA_ "GenSigStartValue" SG_ 526 SGU13_Object_ax 0;
BA_ "GenSigTimeoutValue" SG_ 526 SGU13_Object_ax 0;
BA_ "Remark" SG_ 526 SGU13_Object_ax "";
BA_ "EventCommandSignal" SG_ 526 SGU13_Object_ay 0;
BA_ "GatewayedSignals" SG_ 526 SGU13_Object_ay 0;
BA_ "GenSigInactiveValue" SG_ 526 SGU13_Object_ay 0;
BA_ "GenSigInvalidValue" SG_ 526 SGU13_Object_ay 0;
BA_ "GenSigSendType" SG_ 526 SGU13_Object_ay 1;
BA_ "GenSigStartValue" SG_ 526 SGU13_Object_ay 0;
BA_ "GenSigTimeoutValue" SG_ 526 SGU13_Object_ay 0;
BA_ "Remark" SG_ 526 SGU13_Object_ay "";
BA_ "EventCommandSignal" SG_ 526 SGU13_Object_dx 0;
BA_ "GatewayedSignals" SG_ 526 SGU13_Object_dx 0;
BA_ "GenSigInactiveValue" SG_ 526 SGU13_Object_dx 0;
BA_ "GenSigInvalidValue" SG_ 526 SGU13_Object_dx 0;
BA_ "GenSigSendType" SG_ 526 SGU13_Object_dx 1;
BA_ "GenSigStartValue" SG_ 526 SGU13_Object_dx 0;
BA_ "GenSigTimeoutValue" SG_ 526 SGU13_Object_dx 0;
BA_ "Remark" SG_ 526 SGU13_Object_dx "";
BA_ "EventCommandSignal" SG_ 526 SGU13_Object_dx_Rear 0;
BA_ "GatewayedSignals" SG_ 526 SGU13_Object_dx_Rear 0;
BA_ "GenSigInactiveValue" SG_ 526 SGU13_Object_dx_Rear 0;
BA_ "GenSigInvalidValue" SG_ 526 SGU13_Object_dx_Rear 0;
BA_ "GenSigSendType" SG_ 526 SGU13_Object_dx_Rear 1;
BA_ "GenSigStartValue" SG_ 526 SGU13_Object_dx_Rear 0;
BA_ "GenSigTimeoutValue" SG_ 526 SGU13_Object_dx_Rear 0;
BA_ "Remark" SG_ 526 SGU13_Object_dx_Rear "";
BA_ "EventCommandSignal" SG_ 526 SGU13_Object_dy 0;
BA_ "GatewayedSignals" SG_ 526 SGU13_Object_dy 0;
BA_ "GenSigInactiveValue" SG_ 526 SGU13_Object_dy 0;
BA_ "GenSigInvalidValue" SG_ 526 SGU13_Object_dy 0;
BA_ "GenSigSendType" SG_ 526 SGU13_Object_dy 1;
BA_ "GenSigStartValue" SG_ 526 SGU13_Object_dy 0;
BA_ "GenSigTimeoutValue" SG_ 526 SGU13_Object_dy 0;
BA_ "Remark" SG_ 526 SGU13_Object_dy "";
BA_ "EventCommandSignal" SG_ 526 SGU13_Object_dy_Rear 0;
BA_ "GatewayedSignals" SG_ 526 SGU13_Object_dy_Rear 0;
BA_ "GenSigInactiveValue" SG_ 526 SGU13_Object_dy_Rear 0;
BA_ "GenSigInvalidValue" SG_ 526 SGU13_Object_dy_Rear 0;
BA_ "GenSigSendType" SG_ 526 SGU13_Object_dy_Rear 1;
BA_ "GenSigStartValue" SG_ 526 SGU13_Object_dy_Rear 0;
BA_ "GenSigTimeoutValue" SG_ 526 SGU13_Object_dy_Rear 0;
BA_ "Remark" SG_ 526 SGU13_Object_dy_Rear "";
BA_ "EventCommandSignal" SG_ 526 SGU13_Object_vx 0;
BA_ "GatewayedSignals" SG_ 526 SGU13_Object_vx 0;
BA_ "GenSigInactiveValue" SG_ 526 SGU13_Object_vx 0;
BA_ "GenSigInvalidValue" SG_ 526 SGU13_Object_vx 0;
BA_ "GenSigSendType" SG_ 526 SGU13_Object_vx 1;
BA_ "GenSigStartValue" SG_ 526 SGU13_Object_vx 0;
BA_ "GenSigTimeoutValue" SG_ 526 SGU13_Object_vx 0;
BA_ "Remark" SG_ 526 SGU13_Object_vx "";
BA_ "EventCommandSignal" SG_ 526 SGU13_Object_vy 0;
BA_ "GatewayedSignals" SG_ 526 SGU13_Object_vy 0;
BA_ "GenSigInactiveValue" SG_ 526 SGU13_Object_vy 0;
BA_ "GenSigInvalidValue" SG_ 526 SGU13_Object_vy 0;
BA_ "GenSigSendType" SG_ 526 SGU13_Object_vy 1;
BA_ "GenSigStartValue" SG_ 526 SGU13_Object_vy 0;
BA_ "GenSigTimeoutValue" SG_ 526 SGU13_Object_vy 0;
BA_ "Remark" SG_ 526 SGU13_Object_vy "";
BA_ "EventCommandSignal" SG_ 526 SGU13_Object_wExist 0;
BA_ "GatewayedSignals" SG_ 526 SGU13_Object_wExist 0;
BA_ "GenSigInactiveValue" SG_ 526 SGU13_Object_wExist 0;
BA_ "GenSigInvalidValue" SG_ 526 SGU13_Object_wExist 0;
BA_ "GenSigSendType" SG_ 526 SGU13_Object_wExist 1;
BA_ "GenSigStartValue" SG_ 526 SGU13_Object_wExist 0;
BA_ "GenSigTimeoutValue" SG_ 526 SGU13_Object_wExist 0;
BA_ "Remark" SG_ 526 SGU13_Object_wExist "";
BA_ "EventCommandSignal" SG_ 526 SGU13_Object_wObstacle 0;
BA_ "GatewayedSignals" SG_ 526 SGU13_Object_wObstacle 0;
BA_ "GenSigInactiveValue" SG_ 526 SGU13_Object_wObstacle 0;
BA_ "GenSigInvalidValue" SG_ 526 SGU13_Object_wObstacle 0;
BA_ "GenSigSendType" SG_ 526 SGU13_Object_wObstacle 1;
BA_ "GenSigStartValue" SG_ 526 SGU13_Object_wObstacle 0;
BA_ "GenSigTimeoutValue" SG_ 526 SGU13_Object_wObstacle 0;
BA_ "Remark" SG_ 526 SGU13_Object_wObstacle "";
BA_ "EventCommandSignal" SG_ 527 SGU14_BlockCounter 0;
BA_ "GatewayedSignals" SG_ 527 SGU14_BlockCounter 0;
BA_ "GenSigInactiveValue" SG_ 527 SGU14_BlockCounter 0;
BA_ "GenSigInvalidValue" SG_ 527 SGU14_BlockCounter 0;
BA_ "GenSigSendType" SG_ 527 SGU14_BlockCounter 1;
BA_ "GenSigStartValue" SG_ 527 SGU14_BlockCounter 0;
BA_ "GenSigTimeoutValue" SG_ 527 SGU14_BlockCounter 0;
BA_ "Remark" SG_ 527 SGU14_BlockCounter "";
BA_ "EventCommandSignal" SG_ 527 SGU14_LifeCycles_OBJ 0;
BA_ "GatewayedSignals" SG_ 527 SGU14_LifeCycles_OBJ 0;
BA_ "GenSigInactiveValue" SG_ 527 SGU14_LifeCycles_OBJ 0;
BA_ "GenSigInvalidValue" SG_ 527 SGU14_LifeCycles_OBJ 0;
BA_ "GenSigSendType" SG_ 527 SGU14_LifeCycles_OBJ 1;
BA_ "GenSigStartValue" SG_ 527 SGU14_LifeCycles_OBJ 0;
BA_ "GenSigTimeoutValue" SG_ 527 SGU14_LifeCycles_OBJ 0;
BA_ "Remark" SG_ 527 SGU14_LifeCycles_OBJ "";
BA_ "EventCommandSignal" SG_ 527 SGU14_Msg_AliveCounter 0;
BA_ "GatewayedSignals" SG_ 527 SGU14_Msg_AliveCounter 0;
BA_ "GenSigInactiveValue" SG_ 527 SGU14_Msg_AliveCounter 0;
BA_ "GenSigInvalidValue" SG_ 527 SGU14_Msg_AliveCounter 0;
BA_ "GenSigSendType" SG_ 527 SGU14_Msg_AliveCounter 1;
BA_ "GenSigStartValue" SG_ 527 SGU14_Msg_AliveCounter 0;
BA_ "GenSigTimeoutValue" SG_ 527 SGU14_Msg_AliveCounter 0;
BA_ "Remark" SG_ 527 SGU14_Msg_AliveCounter "";
BA_ "EventCommandSignal" SG_ 527 SGU14_Msg_CheckSum 0;
BA_ "GatewayedSignals" SG_ 527 SGU14_Msg_CheckSum 0;
BA_ "GenSigInactiveValue" SG_ 527 SGU14_Msg_CheckSum 0;
BA_ "GenSigInvalidValue" SG_ 527 SGU14_Msg_CheckSum 0;
BA_ "GenSigSendType" SG_ 527 SGU14_Msg_CheckSum 1;
BA_ "GenSigStartValue" SG_ 527 SGU14_Msg_CheckSum 0;
BA_ "GenSigTimeoutValue" SG_ 527 SGU14_Msg_CheckSum 0;
BA_ "Remark" SG_ 527 SGU14_Msg_CheckSum "";
BA_ "EventCommandSignal" SG_ 527 SGU14_ObjRCS_14 0;
BA_ "GatewayedSignals" SG_ 527 SGU14_ObjRCS_14 0;
BA_ "GenSigInactiveValue" SG_ 527 SGU14_ObjRCS_14 0;
BA_ "GenSigInvalidValue" SG_ 527 SGU14_ObjRCS_14 0;
BA_ "GenSigSendType" SG_ 527 SGU14_ObjRCS_14 1;
BA_ "GenSigStartValue" SG_ 527 SGU14_ObjRCS_14 0;
BA_ "GenSigTimeoutValue" SG_ 527 SGU14_ObjRCS_14 0;
BA_ "Remark" SG_ 527 SGU14_ObjRCS_14 "";
BA_ "EventCommandSignal" SG_ 527 SGU14_Obj_DistLat_rms 0;
BA_ "GatewayedSignals" SG_ 527 SGU14_Obj_DistLat_rms 0;
BA_ "GenSigInactiveValue" SG_ 527 SGU14_Obj_DistLat_rms 0;
BA_ "GenSigInvalidValue" SG_ 527 SGU14_Obj_DistLat_rms 0;
BA_ "GenSigSendType" SG_ 527 SGU14_Obj_DistLat_rms 1;
BA_ "GenSigStartValue" SG_ 527 SGU14_Obj_DistLat_rms 0;
BA_ "GenSigTimeoutValue" SG_ 527 SGU14_Obj_DistLat_rms 0;
BA_ "Remark" SG_ 527 SGU14_Obj_DistLat_rms "";
BA_ "EventCommandSignal" SG_ 527 SGU14_Obj_VrelLong_rms 0;
BA_ "GatewayedSignals" SG_ 527 SGU14_Obj_VrelLong_rms 0;
BA_ "GenSigInactiveValue" SG_ 527 SGU14_Obj_VrelLong_rms 0;
BA_ "GenSigInvalidValue" SG_ 527 SGU14_Obj_VrelLong_rms 0;
BA_ "GenSigSendType" SG_ 527 SGU14_Obj_VrelLong_rms 1;
BA_ "GenSigStartValue" SG_ 527 SGU14_Obj_VrelLong_rms 0;
BA_ "GenSigTimeoutValue" SG_ 527 SGU14_Obj_VrelLong_rms 0;
BA_ "Remark" SG_ 527 SGU14_Obj_VrelLong_rms "";
BA_ "EventCommandSignal" SG_ 527 SGU14_Obj_Vrelat_rms 0;
BA_ "GatewayedSignals" SG_ 527 SGU14_Obj_Vrelat_rms 0;
BA_ "GenSigInactiveValue" SG_ 527 SGU14_Obj_Vrelat_rms 0;
BA_ "GenSigInvalidValue" SG_ 527 SGU14_Obj_Vrelat_rms 0;
BA_ "GenSigSendType" SG_ 527 SGU14_Obj_Vrelat_rms 1;
BA_ "GenSigStartValue" SG_ 527 SGU14_Obj_Vrelat_rms 0;
BA_ "GenSigTimeoutValue" SG_ 527 SGU14_Obj_Vrelat_rms 0;
BA_ "Remark" SG_ 527 SGU14_Obj_Vrelat_rms "";
BA_ "EventCommandSignal" SG_ 527 SGU14_Object_DetStatus 0;
BA_ "GatewayedSignals" SG_ 527 SGU14_Object_DetStatus 0;
BA_ "GenSigInactiveValue" SG_ 527 SGU14_Object_DetStatus 0;
BA_ "GenSigInvalidValue" SG_ 527 SGU14_Object_DetStatus 0;
BA_ "GenSigSendType" SG_ 527 SGU14_Object_DetStatus 1;
BA_ "GenSigStartValue" SG_ 527 SGU14_Object_DetStatus 0;
BA_ "GenSigTimeoutValue" SG_ 527 SGU14_Object_DetStatus 0;
BA_ "Remark" SG_ 527 SGU14_Object_DetStatus "";
BA_ "EventCommandSignal" SG_ 527 SGU14_Object_DistLong_rms 0;
BA_ "GatewayedSignals" SG_ 527 SGU14_Object_DistLong_rms 0;
BA_ "GenSigInactiveValue" SG_ 527 SGU14_Object_DistLong_rms 0;
BA_ "GenSigInvalidValue" SG_ 527 SGU14_Object_DistLong_rms 0;
BA_ "GenSigSendType" SG_ 527 SGU14_Object_DistLong_rms 1;
BA_ "GenSigStartValue" SG_ 527 SGU14_Object_DistLong_rms 0;
BA_ "GenSigTimeoutValue" SG_ 527 SGU14_Object_DistLong_rms 0;
BA_ "Remark" SG_ 527 SGU14_Object_DistLong_rms "";
BA_ "EventCommandSignal" SG_ 527 SGU14_Object_ID 0;
BA_ "GatewayedSignals" SG_ 527 SGU14_Object_ID 0;
BA_ "GenSigInactiveValue" SG_ 527 SGU14_Object_ID 0;
BA_ "GenSigInvalidValue" SG_ 527 SGU14_Object_ID 0;
BA_ "GenSigSendType" SG_ 527 SGU14_Object_ID 1;
BA_ "GenSigStartValue" SG_ 527 SGU14_Object_ID 0;
BA_ "GenSigTimeoutValue" SG_ 527 SGU14_Object_ID 0;
BA_ "Remark" SG_ 527 SGU14_Object_ID "";
BA_ "EventCommandSignal" SG_ 527 SGU14_Object_Motion_Pattern 0;
BA_ "GatewayedSignals" SG_ 527 SGU14_Object_Motion_Pattern 0;
BA_ "GenSigInactiveValue" SG_ 527 SGU14_Object_Motion_Pattern 0;
BA_ "GenSigInvalidValue" SG_ 527 SGU14_Object_Motion_Pattern 0;
BA_ "GenSigSendType" SG_ 527 SGU14_Object_Motion_Pattern 1;
BA_ "GenSigStartValue" SG_ 527 SGU14_Object_Motion_Pattern 0;
BA_ "GenSigTimeoutValue" SG_ 527 SGU14_Object_Motion_Pattern 0;
BA_ "Remark" SG_ 527 SGU14_Object_Motion_Pattern "";
BA_ "EventCommandSignal" SG_ 527 SGU14_Object_Type 0;
BA_ "GatewayedSignals" SG_ 527 SGU14_Object_Type 0;
BA_ "GenSigInactiveValue" SG_ 527 SGU14_Object_Type 0;
BA_ "GenSigInvalidValue" SG_ 527 SGU14_Object_Type 0;
BA_ "GenSigSendType" SG_ 527 SGU14_Object_Type 1;
BA_ "GenSigStartValue" SG_ 527 SGU14_Object_Type 0;
BA_ "GenSigTimeoutValue" SG_ 527 SGU14_Object_Type 0;
BA_ "Remark" SG_ 527 SGU14_Object_Type "";
BA_ "EventCommandSignal" SG_ 527 SGU14_Object_ax 0;
BA_ "GatewayedSignals" SG_ 527 SGU14_Object_ax 0;
BA_ "GenSigInactiveValue" SG_ 527 SGU14_Object_ax 0;
BA_ "GenSigInvalidValue" SG_ 527 SGU14_Object_ax 0;
BA_ "GenSigSendType" SG_ 527 SGU14_Object_ax 1;
BA_ "GenSigStartValue" SG_ 527 SGU14_Object_ax 0;
BA_ "GenSigTimeoutValue" SG_ 527 SGU14_Object_ax 0;
BA_ "Remark" SG_ 527 SGU14_Object_ax "";
BA_ "EventCommandSignal" SG_ 527 SGU14_Object_ay 0;
BA_ "GatewayedSignals" SG_ 527 SGU14_Object_ay 0;
BA_ "GenSigInactiveValue" SG_ 527 SGU14_Object_ay 0;
BA_ "GenSigInvalidValue" SG_ 527 SGU14_Object_ay 0;
BA_ "GenSigSendType" SG_ 527 SGU14_Object_ay 1;
BA_ "GenSigStartValue" SG_ 527 SGU14_Object_ay 0;
BA_ "GenSigTimeoutValue" SG_ 527 SGU14_Object_ay 0;
BA_ "Remark" SG_ 527 SGU14_Object_ay "";
BA_ "EventCommandSignal" SG_ 527 SGU14_Object_dx 0;
BA_ "GatewayedSignals" SG_ 527 SGU14_Object_dx 0;
BA_ "GenSigInactiveValue" SG_ 527 SGU14_Object_dx 0;
BA_ "GenSigInvalidValue" SG_ 527 SGU14_Object_dx 0;
BA_ "GenSigSendType" SG_ 527 SGU14_Object_dx 1;
BA_ "GenSigStartValue" SG_ 527 SGU14_Object_dx 0;
BA_ "GenSigTimeoutValue" SG_ 527 SGU14_Object_dx 0;
BA_ "Remark" SG_ 527 SGU14_Object_dx "";
BA_ "EventCommandSignal" SG_ 527 SGU14_Object_dx_Rear 0;
BA_ "GatewayedSignals" SG_ 527 SGU14_Object_dx_Rear 0;
BA_ "GenSigInactiveValue" SG_ 527 SGU14_Object_dx_Rear 0;
BA_ "GenSigInvalidValue" SG_ 527 SGU14_Object_dx_Rear 0;
BA_ "GenSigSendType" SG_ 527 SGU14_Object_dx_Rear 1;
BA_ "GenSigStartValue" SG_ 527 SGU14_Object_dx_Rear 0;
BA_ "GenSigTimeoutValue" SG_ 527 SGU14_Object_dx_Rear 0;
BA_ "Remark" SG_ 527 SGU14_Object_dx_Rear "";
BA_ "EventCommandSignal" SG_ 527 SGU14_Object_dy 0;
BA_ "GatewayedSignals" SG_ 527 SGU14_Object_dy 0;
BA_ "GenSigInactiveValue" SG_ 527 SGU14_Object_dy 0;
BA_ "GenSigInvalidValue" SG_ 527 SGU14_Object_dy 0;
BA_ "GenSigSendType" SG_ 527 SGU14_Object_dy 1;
BA_ "GenSigStartValue" SG_ 527 SGU14_Object_dy 0;
BA_ "GenSigTimeoutValue" SG_ 527 SGU14_Object_dy 0;
BA_ "Remark" SG_ 527 SGU14_Object_dy "";
BA_ "EventCommandSignal" SG_ 527 SGU14_Object_dy_Rear 0;
BA_ "GatewayedSignals" SG_ 527 SGU14_Object_dy_Rear 0;
BA_ "GenSigInactiveValue" SG_ 527 SGU14_Object_dy_Rear 0;
BA_ "GenSigInvalidValue" SG_ 527 SGU14_Object_dy_Rear 0;
BA_ "GenSigSendType" SG_ 527 SGU14_Object_dy_Rear 1;
BA_ "GenSigStartValue" SG_ 527 SGU14_Object_dy_Rear 0;
BA_ "GenSigTimeoutValue" SG_ 527 SGU14_Object_dy_Rear 0;
BA_ "Remark" SG_ 527 SGU14_Object_dy_Rear "";
BA_ "EventCommandSignal" SG_ 527 SGU14_Object_vx 0;
BA_ "GatewayedSignals" SG_ 527 SGU14_Object_vx 0;
BA_ "GenSigInactiveValue" SG_ 527 SGU14_Object_vx 0;
BA_ "GenSigInvalidValue" SG_ 527 SGU14_Object_vx 0;
BA_ "GenSigSendType" SG_ 527 SGU14_Object_vx 1;
BA_ "GenSigStartValue" SG_ 527 SGU14_Object_vx 0;
BA_ "GenSigTimeoutValue" SG_ 527 SGU14_Object_vx 0;
BA_ "Remark" SG_ 527 SGU14_Object_vx "";
BA_ "EventCommandSignal" SG_ 527 SGU14_Object_vy 0;
BA_ "GatewayedSignals" SG_ 527 SGU14_Object_vy 0;
BA_ "GenSigInactiveValue" SG_ 527 SGU14_Object_vy 0;
BA_ "GenSigInvalidValue" SG_ 527 SGU14_Object_vy 0;
BA_ "GenSigSendType" SG_ 527 SGU14_Object_vy 1;
BA_ "GenSigStartValue" SG_ 527 SGU14_Object_vy 0;
BA_ "GenSigTimeoutValue" SG_ 527 SGU14_Object_vy 0;
BA_ "Remark" SG_ 527 SGU14_Object_vy "";
BA_ "EventCommandSignal" SG_ 527 SGU14_Object_wExist 0;
BA_ "GatewayedSignals" SG_ 527 SGU14_Object_wExist 0;
BA_ "GenSigInactiveValue" SG_ 527 SGU14_Object_wExist 0;
BA_ "GenSigInvalidValue" SG_ 527 SGU14_Object_wExist 0;
BA_ "GenSigSendType" SG_ 527 SGU14_Object_wExist 1;
BA_ "GenSigStartValue" SG_ 527 SGU14_Object_wExist 0;
BA_ "GenSigTimeoutValue" SG_ 527 SGU14_Object_wExist 0;
BA_ "Remark" SG_ 527 SGU14_Object_wExist "";
BA_ "EventCommandSignal" SG_ 527 SGU14_Object_wObstacle 0;
BA_ "GatewayedSignals" SG_ 527 SGU14_Object_wObstacle 0;
BA_ "GenSigInactiveValue" SG_ 527 SGU14_Object_wObstacle 0;
BA_ "GenSigInvalidValue" SG_ 527 SGU14_Object_wObstacle 0;
BA_ "GenSigSendType" SG_ 527 SGU14_Object_wObstacle 1;
BA_ "GenSigStartValue" SG_ 527 SGU14_Object_wObstacle 0;
BA_ "GenSigTimeoutValue" SG_ 527 SGU14_Object_wObstacle 0;
BA_ "Remark" SG_ 527 SGU14_Object_wObstacle "";
BA_ "EventCommandSignal" SG_ 528 SGU15_BlockCounter 0;
BA_ "GatewayedSignals" SG_ 528 SGU15_BlockCounter 0;
BA_ "GenSigInactiveValue" SG_ 528 SGU15_BlockCounter 0;
BA_ "GenSigInvalidValue" SG_ 528 SGU15_BlockCounter 0;
BA_ "GenSigSendType" SG_ 528 SGU15_BlockCounter 1;
BA_ "GenSigStartValue" SG_ 528 SGU15_BlockCounter 0;
BA_ "GenSigTimeoutValue" SG_ 528 SGU15_BlockCounter 0;
BA_ "Remark" SG_ 528 SGU15_BlockCounter "";
BA_ "EventCommandSignal" SG_ 528 SGU15_LifeCycles_OBJ 0;
BA_ "GatewayedSignals" SG_ 528 SGU15_LifeCycles_OBJ 0;
BA_ "GenSigInactiveValue" SG_ 528 SGU15_LifeCycles_OBJ 0;
BA_ "GenSigInvalidValue" SG_ 528 SGU15_LifeCycles_OBJ 0;
BA_ "GenSigSendType" SG_ 528 SGU15_LifeCycles_OBJ 1;
BA_ "GenSigStartValue" SG_ 528 SGU15_LifeCycles_OBJ 0;
BA_ "GenSigTimeoutValue" SG_ 528 SGU15_LifeCycles_OBJ 0;
BA_ "Remark" SG_ 528 SGU15_LifeCycles_OBJ "";
BA_ "EventCommandSignal" SG_ 528 SGU15_Msg_AliveCounter 0;
BA_ "GatewayedSignals" SG_ 528 SGU15_Msg_AliveCounter 0;
BA_ "GenSigInactiveValue" SG_ 528 SGU15_Msg_AliveCounter 0;
BA_ "GenSigInvalidValue" SG_ 528 SGU15_Msg_AliveCounter 0;
BA_ "GenSigSendType" SG_ 528 SGU15_Msg_AliveCounter 1;
BA_ "GenSigStartValue" SG_ 528 SGU15_Msg_AliveCounter 0;
BA_ "GenSigTimeoutValue" SG_ 528 SGU15_Msg_AliveCounter 0;
BA_ "Remark" SG_ 528 SGU15_Msg_AliveCounter "";
BA_ "EventCommandSignal" SG_ 528 SGU15_Msg_CheckSum 0;
BA_ "GatewayedSignals" SG_ 528 SGU15_Msg_CheckSum 0;
BA_ "GenSigInactiveValue" SG_ 528 SGU15_Msg_CheckSum 0;
BA_ "GenSigInvalidValue" SG_ 528 SGU15_Msg_CheckSum 0;
BA_ "GenSigSendType" SG_ 528 SGU15_Msg_CheckSum 1;
BA_ "GenSigStartValue" SG_ 528 SGU15_Msg_CheckSum 0;
BA_ "GenSigTimeoutValue" SG_ 528 SGU15_Msg_CheckSum 0;
BA_ "Remark" SG_ 528 SGU15_Msg_CheckSum "";
BA_ "EventCommandSignal" SG_ 528 SGU15_ObjRCS_15 0;
BA_ "GatewayedSignals" SG_ 528 SGU15_ObjRCS_15 0;
BA_ "GenSigInactiveValue" SG_ 528 SGU15_ObjRCS_15 0;
BA_ "GenSigInvalidValue" SG_ 528 SGU15_ObjRCS_15 0;
BA_ "GenSigSendType" SG_ 528 SGU15_ObjRCS_15 1;
BA_ "GenSigStartValue" SG_ 528 SGU15_ObjRCS_15 0;
BA_ "GenSigTimeoutValue" SG_ 528 SGU15_ObjRCS_15 0;
BA_ "Remark" SG_ 528 SGU15_ObjRCS_15 "";
BA_ "EventCommandSignal" SG_ 528 SGU15_Obj_DistLat_rms 0;
BA_ "GatewayedSignals" SG_ 528 SGU15_Obj_DistLat_rms 0;
BA_ "GenSigInactiveValue" SG_ 528 SGU15_Obj_DistLat_rms 0;
BA_ "GenSigInvalidValue" SG_ 528 SGU15_Obj_DistLat_rms 0;
BA_ "GenSigSendType" SG_ 528 SGU15_Obj_DistLat_rms 1;
BA_ "GenSigStartValue" SG_ 528 SGU15_Obj_DistLat_rms 0;
BA_ "GenSigTimeoutValue" SG_ 528 SGU15_Obj_DistLat_rms 0;
BA_ "Remark" SG_ 528 SGU15_Obj_DistLat_rms "";
BA_ "EventCommandSignal" SG_ 528 SGU15_Obj_VrelLong_rms 0;
BA_ "GatewayedSignals" SG_ 528 SGU15_Obj_VrelLong_rms 0;
BA_ "GenSigInactiveValue" SG_ 528 SGU15_Obj_VrelLong_rms 0;
BA_ "GenSigInvalidValue" SG_ 528 SGU15_Obj_VrelLong_rms 0;
BA_ "GenSigSendType" SG_ 528 SGU15_Obj_VrelLong_rms 1;
BA_ "GenSigStartValue" SG_ 528 SGU15_Obj_VrelLong_rms 0;
BA_ "GenSigTimeoutValue" SG_ 528 SGU15_Obj_VrelLong_rms 0;
BA_ "Remark" SG_ 528 SGU15_Obj_VrelLong_rms "";
BA_ "EventCommandSignal" SG_ 528 SGU15_Obj_Vrelat_rms 0;
BA_ "GatewayedSignals" SG_ 528 SGU15_Obj_Vrelat_rms 0;
BA_ "GenSigInactiveValue" SG_ 528 SGU15_Obj_Vrelat_rms 0;
BA_ "GenSigInvalidValue" SG_ 528 SGU15_Obj_Vrelat_rms 0;
BA_ "GenSigSendType" SG_ 528 SGU15_Obj_Vrelat_rms 1;
BA_ "GenSigStartValue" SG_ 528 SGU15_Obj_Vrelat_rms 0;
BA_ "GenSigTimeoutValue" SG_ 528 SGU15_Obj_Vrelat_rms 0;
BA_ "Remark" SG_ 528 SGU15_Obj_Vrelat_rms "";
BA_ "EventCommandSignal" SG_ 528 SGU15_Object_DetStatus 0;
BA_ "GatewayedSignals" SG_ 528 SGU15_Object_DetStatus 0;
BA_ "GenSigInactiveValue" SG_ 528 SGU15_Object_DetStatus 0;
BA_ "GenSigInvalidValue" SG_ 528 SGU15_Object_DetStatus 0;
BA_ "GenSigSendType" SG_ 528 SGU15_Object_DetStatus 1;
BA_ "GenSigStartValue" SG_ 528 SGU15_Object_DetStatus 0;
BA_ "GenSigTimeoutValue" SG_ 528 SGU15_Object_DetStatus 0;
BA_ "Remark" SG_ 528 SGU15_Object_DetStatus "";
BA_ "EventCommandSignal" SG_ 528 SGU15_Object_DistLong_rms 0;
BA_ "GatewayedSignals" SG_ 528 SGU15_Object_DistLong_rms 0;
BA_ "GenSigInactiveValue" SG_ 528 SGU15_Object_DistLong_rms 0;
BA_ "GenSigInvalidValue" SG_ 528 SGU15_Object_DistLong_rms 0;
BA_ "GenSigSendType" SG_ 528 SGU15_Object_DistLong_rms 1;
BA_ "GenSigStartValue" SG_ 528 SGU15_Object_DistLong_rms 0;
BA_ "GenSigTimeoutValue" SG_ 528 SGU15_Object_DistLong_rms 0;
BA_ "Remark" SG_ 528 SGU15_Object_DistLong_rms "";
BA_ "EventCommandSignal" SG_ 528 SGU15_Object_ID 0;
BA_ "GatewayedSignals" SG_ 528 SGU15_Object_ID 0;
BA_ "GenSigInactiveValue" SG_ 528 SGU15_Object_ID 0;
BA_ "GenSigInvalidValue" SG_ 528 SGU15_Object_ID 0;
BA_ "GenSigSendType" SG_ 528 SGU15_Object_ID 1;
BA_ "GenSigStartValue" SG_ 528 SGU15_Object_ID 0;
BA_ "GenSigTimeoutValue" SG_ 528 SGU15_Object_ID 0;
BA_ "Remark" SG_ 528 SGU15_Object_ID "";
BA_ "EventCommandSignal" SG_ 528 SGU15_Object_Motion_Pattern 0;
BA_ "GatewayedSignals" SG_ 528 SGU15_Object_Motion_Pattern 0;
BA_ "GenSigInactiveValue" SG_ 528 SGU15_Object_Motion_Pattern 0;
BA_ "GenSigInvalidValue" SG_ 528 SGU15_Object_Motion_Pattern 0;
BA_ "GenSigSendType" SG_ 528 SGU15_Object_Motion_Pattern 1;
BA_ "GenSigStartValue" SG_ 528 SGU15_Object_Motion_Pattern 0;
BA_ "GenSigTimeoutValue" SG_ 528 SGU15_Object_Motion_Pattern 0;
BA_ "Remark" SG_ 528 SGU15_Object_Motion_Pattern "";
BA_ "EventCommandSignal" SG_ 528 SGU15_Object_Type 0;
BA_ "GatewayedSignals" SG_ 528 SGU15_Object_Type 0;
BA_ "GenSigInactiveValue" SG_ 528 SGU15_Object_Type 0;
BA_ "GenSigInvalidValue" SG_ 528 SGU15_Object_Type 0;
BA_ "GenSigSendType" SG_ 528 SGU15_Object_Type 1;
BA_ "GenSigStartValue" SG_ 528 SGU15_Object_Type 0;
BA_ "GenSigTimeoutValue" SG_ 528 SGU15_Object_Type 0;
BA_ "Remark" SG_ 528 SGU15_Object_Type "";
BA_ "EventCommandSignal" SG_ 528 SGU15_Object_ax 0;
BA_ "GatewayedSignals" SG_ 528 SGU15_Object_ax 0;
BA_ "GenSigInactiveValue" SG_ 528 SGU15_Object_ax 0;
BA_ "GenSigInvalidValue" SG_ 528 SGU15_Object_ax 0;
BA_ "GenSigSendType" SG_ 528 SGU15_Object_ax 1;
BA_ "GenSigStartValue" SG_ 528 SGU15_Object_ax 0;
BA_ "GenSigTimeoutValue" SG_ 528 SGU15_Object_ax 0;
BA_ "Remark" SG_ 528 SGU15_Object_ax "";
BA_ "EventCommandSignal" SG_ 528 SGU15_Object_ay 0;
BA_ "GatewayedSignals" SG_ 528 SGU15_Object_ay 0;
BA_ "GenSigInactiveValue" SG_ 528 SGU15_Object_ay 0;
BA_ "GenSigInvalidValue" SG_ 528 SGU15_Object_ay 0;
BA_ "GenSigSendType" SG_ 528 SGU15_Object_ay 1;
BA_ "GenSigStartValue" SG_ 528 SGU15_Object_ay 0;
BA_ "GenSigTimeoutValue" SG_ 528 SGU15_Object_ay 0;
BA_ "Remark" SG_ 528 SGU15_Object_ay "";
BA_ "EventCommandSignal" SG_ 528 SGU15_Object_dx 0;
BA_ "GatewayedSignals" SG_ 528 SGU15_Object_dx 0;
BA_ "GenSigInactiveValue" SG_ 528 SGU15_Object_dx 0;
BA_ "GenSigInvalidValue" SG_ 528 SGU15_Object_dx 0;
BA_ "GenSigSendType" SG_ 528 SGU15_Object_dx 1;
BA_ "GenSigStartValue" SG_ 528 SGU15_Object_dx 0;
BA_ "GenSigTimeoutValue" SG_ 528 SGU15_Object_dx 0;
BA_ "Remark" SG_ 528 SGU15_Object_dx "";
BA_ "EventCommandSignal" SG_ 528 SGU15_Object_dx_Rear 0;
BA_ "GatewayedSignals" SG_ 528 SGU15_Object_dx_Rear 0;
BA_ "GenSigInactiveValue" SG_ 528 SGU15_Object_dx_Rear 0;
BA_ "GenSigInvalidValue" SG_ 528 SGU15_Object_dx_Rear 0;
BA_ "GenSigSendType" SG_ 528 SGU15_Object_dx_Rear 1;
BA_ "GenSigStartValue" SG_ 528 SGU15_Object_dx_Rear 0;
BA_ "GenSigTimeoutValue" SG_ 528 SGU15_Object_dx_Rear 0;
BA_ "Remark" SG_ 528 SGU15_Object_dx_Rear "";
BA_ "EventCommandSignal" SG_ 528 SGU15_Object_dy 0;
BA_ "GatewayedSignals" SG_ 528 SGU15_Object_dy 0;
BA_ "GenSigInactiveValue" SG_ 528 SGU15_Object_dy 0;
BA_ "GenSigInvalidValue" SG_ 528 SGU15_Object_dy 0;
BA_ "GenSigSendType" SG_ 528 SGU15_Object_dy 1;
BA_ "GenSigStartValue" SG_ 528 SGU15_Object_dy 0;
BA_ "GenSigTimeoutValue" SG_ 528 SGU15_Object_dy 0;
BA_ "Remark" SG_ 528 SGU15_Object_dy "";
BA_ "EventCommandSignal" SG_ 528 SGU15_Object_dy_Rear 0;
BA_ "GatewayedSignals" SG_ 528 SGU15_Object_dy_Rear 0;
BA_ "GenSigInactiveValue" SG_ 528 SGU15_Object_dy_Rear 0;
BA_ "GenSigInvalidValue" SG_ 528 SGU15_Object_dy_Rear 0;
BA_ "GenSigSendType" SG_ 528 SGU15_Object_dy_Rear 1;
BA_ "GenSigStartValue" SG_ 528 SGU15_Object_dy_Rear 0;
BA_ "GenSigTimeoutValue" SG_ 528 SGU15_Object_dy_Rear 0;
BA_ "Remark" SG_ 528 SGU15_Object_dy_Rear "";
BA_ "EventCommandSignal" SG_ 528 SGU15_Object_vx 0;
BA_ "GatewayedSignals" SG_ 528 SGU15_Object_vx 0;
BA_ "GenSigInactiveValue" SG_ 528 SGU15_Object_vx 0;
BA_ "GenSigInvalidValue" SG_ 528 SGU15_Object_vx 0;
BA_ "GenSigSendType" SG_ 528 SGU15_Object_vx 1;
BA_ "GenSigStartValue" SG_ 528 SGU15_Object_vx 0;
BA_ "GenSigTimeoutValue" SG_ 528 SGU15_Object_vx 0;
BA_ "Remark" SG_ 528 SGU15_Object_vx "";
BA_ "EventCommandSignal" SG_ 528 SGU15_Object_vy 0;
BA_ "GatewayedSignals" SG_ 528 SGU15_Object_vy 0;
BA_ "GenSigInactiveValue" SG_ 528 SGU15_Object_vy 0;
BA_ "GenSigInvalidValue" SG_ 528 SGU15_Object_vy 0;
BA_ "GenSigSendType" SG_ 528 SGU15_Object_vy 1;
BA_ "GenSigStartValue" SG_ 528 SGU15_Object_vy 0;
BA_ "GenSigTimeoutValue" SG_ 528 SGU15_Object_vy 0;
BA_ "Remark" SG_ 528 SGU15_Object_vy "";
BA_ "EventCommandSignal" SG_ 528 SGU15_Object_wExist 0;
BA_ "GatewayedSignals" SG_ 528 SGU15_Object_wExist 0;
BA_ "GenSigInactiveValue" SG_ 528 SGU15_Object_wExist 0;
BA_ "GenSigInvalidValue" SG_ 528 SGU15_Object_wExist 0;
BA_ "GenSigSendType" SG_ 528 SGU15_Object_wExist 1;
BA_ "GenSigStartValue" SG_ 528 SGU15_Object_wExist 0;
BA_ "GenSigTimeoutValue" SG_ 528 SGU15_Object_wExist 0;
BA_ "Remark" SG_ 528 SGU15_Object_wExist "";
BA_ "EventCommandSignal" SG_ 528 SGU15_Object_wObstacle 0;
BA_ "GatewayedSignals" SG_ 528 SGU15_Object_wObstacle 0;
BA_ "GenSigInactiveValue" SG_ 528 SGU15_Object_wObstacle 0;
BA_ "GenSigInvalidValue" SG_ 528 SGU15_Object_wObstacle 0;
BA_ "GenSigSendType" SG_ 528 SGU15_Object_wObstacle 1;
BA_ "GenSigStartValue" SG_ 528 SGU15_Object_wObstacle 0;
BA_ "GenSigTimeoutValue" SG_ 528 SGU15_Object_wObstacle 0;
BA_ "Remark" SG_ 528 SGU15_Object_wObstacle "";
BA_ "EventCommandSignal" SG_ 529 SGU16_BlockCounter 0;
BA_ "GatewayedSignals" SG_ 529 SGU16_BlockCounter 0;
BA_ "GenSigInactiveValue" SG_ 529 SGU16_BlockCounter 0;
BA_ "GenSigInvalidValue" SG_ 529 SGU16_BlockCounter 0;
BA_ "GenSigSendType" SG_ 529 SGU16_BlockCounter 1;
BA_ "GenSigStartValue" SG_ 529 SGU16_BlockCounter 0;
BA_ "GenSigTimeoutValue" SG_ 529 SGU16_BlockCounter 0;
BA_ "Remark" SG_ 529 SGU16_BlockCounter "";
BA_ "EventCommandSignal" SG_ 529 SGU16_LifeCycles_OBJ 0;
BA_ "GatewayedSignals" SG_ 529 SGU16_LifeCycles_OBJ 0;
BA_ "GenSigInactiveValue" SG_ 529 SGU16_LifeCycles_OBJ 0;
BA_ "GenSigInvalidValue" SG_ 529 SGU16_LifeCycles_OBJ 0;
BA_ "GenSigSendType" SG_ 529 SGU16_LifeCycles_OBJ 1;
BA_ "GenSigStartValue" SG_ 529 SGU16_LifeCycles_OBJ 0;
BA_ "GenSigTimeoutValue" SG_ 529 SGU16_LifeCycles_OBJ 0;
BA_ "Remark" SG_ 529 SGU16_LifeCycles_OBJ "";
BA_ "EventCommandSignal" SG_ 529 SGU16_Msg_AliveCounter 0;
BA_ "GatewayedSignals" SG_ 529 SGU16_Msg_AliveCounter 0;
BA_ "GenSigInactiveValue" SG_ 529 SGU16_Msg_AliveCounter 0;
BA_ "GenSigInvalidValue" SG_ 529 SGU16_Msg_AliveCounter 0;
BA_ "GenSigSendType" SG_ 529 SGU16_Msg_AliveCounter 1;
BA_ "GenSigStartValue" SG_ 529 SGU16_Msg_AliveCounter 0;
BA_ "GenSigTimeoutValue" SG_ 529 SGU16_Msg_AliveCounter 0;
BA_ "Remark" SG_ 529 SGU16_Msg_AliveCounter "";
BA_ "EventCommandSignal" SG_ 529 SGU16_Msg_CheckSum 0;
BA_ "GatewayedSignals" SG_ 529 SGU16_Msg_CheckSum 0;
BA_ "GenSigInactiveValue" SG_ 529 SGU16_Msg_CheckSum 0;
BA_ "GenSigInvalidValue" SG_ 529 SGU16_Msg_CheckSum 0;
BA_ "GenSigSendType" SG_ 529 SGU16_Msg_CheckSum 1;
BA_ "GenSigStartValue" SG_ 529 SGU16_Msg_CheckSum 0;
BA_ "GenSigTimeoutValue" SG_ 529 SGU16_Msg_CheckSum 0;
BA_ "Remark" SG_ 529 SGU16_Msg_CheckSum "";
BA_ "EventCommandSignal" SG_ 529 SGU16_ObjRCS_16 0;
BA_ "GatewayedSignals" SG_ 529 SGU16_ObjRCS_16 0;
BA_ "GenSigInactiveValue" SG_ 529 SGU16_ObjRCS_16 0;
BA_ "GenSigInvalidValue" SG_ 529 SGU16_ObjRCS_16 0;
BA_ "GenSigSendType" SG_ 529 SGU16_ObjRCS_16 1;
BA_ "GenSigStartValue" SG_ 529 SGU16_ObjRCS_16 0;
BA_ "GenSigTimeoutValue" SG_ 529 SGU16_ObjRCS_16 0;
BA_ "Remark" SG_ 529 SGU16_ObjRCS_16 "";
BA_ "EventCommandSignal" SG_ 529 SGU16_Obj_DistLat_rms 0;
BA_ "GatewayedSignals" SG_ 529 SGU16_Obj_DistLat_rms 0;
BA_ "GenSigInactiveValue" SG_ 529 SGU16_Obj_DistLat_rms 0;
BA_ "GenSigInvalidValue" SG_ 529 SGU16_Obj_DistLat_rms 0;
BA_ "GenSigSendType" SG_ 529 SGU16_Obj_DistLat_rms 1;
BA_ "GenSigStartValue" SG_ 529 SGU16_Obj_DistLat_rms 0;
BA_ "GenSigTimeoutValue" SG_ 529 SGU16_Obj_DistLat_rms 0;
BA_ "Remark" SG_ 529 SGU16_Obj_DistLat_rms "";
BA_ "EventCommandSignal" SG_ 529 SGU16_Obj_VrelLong_rms 0;
BA_ "GatewayedSignals" SG_ 529 SGU16_Obj_VrelLong_rms 0;
BA_ "GenSigInactiveValue" SG_ 529 SGU16_Obj_VrelLong_rms 0;
BA_ "GenSigInvalidValue" SG_ 529 SGU16_Obj_VrelLong_rms 0;
BA_ "GenSigSendType" SG_ 529 SGU16_Obj_VrelLong_rms 1;
BA_ "GenSigStartValue" SG_ 529 SGU16_Obj_VrelLong_rms 0;
BA_ "GenSigTimeoutValue" SG_ 529 SGU16_Obj_VrelLong_rms 0;
BA_ "Remark" SG_ 529 SGU16_Obj_VrelLong_rms "";
BA_ "EventCommandSignal" SG_ 529 SGU16_Obj_Vrelat_rms 0;
BA_ "GatewayedSignals" SG_ 529 SGU16_Obj_Vrelat_rms 0;
BA_ "GenSigInactiveValue" SG_ 529 SGU16_Obj_Vrelat_rms 0;
BA_ "GenSigInvalidValue" SG_ 529 SGU16_Obj_Vrelat_rms 0;
BA_ "GenSigSendType" SG_ 529 SGU16_Obj_Vrelat_rms 1;
BA_ "GenSigStartValue" SG_ 529 SGU16_Obj_Vrelat_rms 0;
BA_ "GenSigTimeoutValue" SG_ 529 SGU16_Obj_Vrelat_rms 0;
BA_ "Remark" SG_ 529 SGU16_Obj_Vrelat_rms "";
BA_ "EventCommandSignal" SG_ 529 SGU16_Object_DetStatus 0;
BA_ "GatewayedSignals" SG_ 529 SGU16_Object_DetStatus 0;
BA_ "GenSigInactiveValue" SG_ 529 SGU16_Object_DetStatus 0;
BA_ "GenSigInvalidValue" SG_ 529 SGU16_Object_DetStatus 0;
BA_ "GenSigSendType" SG_ 529 SGU16_Object_DetStatus 1;
BA_ "GenSigStartValue" SG_ 529 SGU16_Object_DetStatus 0;
BA_ "GenSigTimeoutValue" SG_ 529 SGU16_Object_DetStatus 0;
BA_ "Remark" SG_ 529 SGU16_Object_DetStatus "";
BA_ "EventCommandSignal" SG_ 529 SGU16_Object_DistLong_rms 0;
BA_ "GatewayedSignals" SG_ 529 SGU16_Object_DistLong_rms 0;
BA_ "GenSigInactiveValue" SG_ 529 SGU16_Object_DistLong_rms 0;
BA_ "GenSigInvalidValue" SG_ 529 SGU16_Object_DistLong_rms 0;
BA_ "GenSigSendType" SG_ 529 SGU16_Object_DistLong_rms 1;
BA_ "GenSigStartValue" SG_ 529 SGU16_Object_DistLong_rms 0;
BA_ "GenSigTimeoutValue" SG_ 529 SGU16_Object_DistLong_rms 0;
BA_ "Remark" SG_ 529 SGU16_Object_DistLong_rms "";
BA_ "EventCommandSignal" SG_ 529 SGU16_Object_ID 0;
BA_ "GatewayedSignals" SG_ 529 SGU16_Object_ID 0;
BA_ "GenSigInactiveValue" SG_ 529 SGU16_Object_ID 0;
BA_ "GenSigInvalidValue" SG_ 529 SGU16_Object_ID 0;
BA_ "GenSigSendType" SG_ 529 SGU16_Object_ID 1;
BA_ "GenSigStartValue" SG_ 529 SGU16_Object_ID 0;
BA_ "GenSigTimeoutValue" SG_ 529 SGU16_Object_ID 0;
BA_ "Remark" SG_ 529 SGU16_Object_ID "";
BA_ "EventCommandSignal" SG_ 529 SGU16_Object_Motion_Pattern 0;
BA_ "GatewayedSignals" SG_ 529 SGU16_Object_Motion_Pattern 0;
BA_ "GenSigInactiveValue" SG_ 529 SGU16_Object_Motion_Pattern 0;
BA_ "GenSigInvalidValue" SG_ 529 SGU16_Object_Motion_Pattern 0;
BA_ "GenSigSendType" SG_ 529 SGU16_Object_Motion_Pattern 1;
BA_ "GenSigStartValue" SG_ 529 SGU16_Object_Motion_Pattern 0;
BA_ "GenSigTimeoutValue" SG_ 529 SGU16_Object_Motion_Pattern 0;
BA_ "Remark" SG_ 529 SGU16_Object_Motion_Pattern "";
BA_ "EventCommandSignal" SG_ 529 SGU16_Object_Type 0;
BA_ "GatewayedSignals" SG_ 529 SGU16_Object_Type 0;
BA_ "GenSigInactiveValue" SG_ 529 SGU16_Object_Type 0;
BA_ "GenSigInvalidValue" SG_ 529 SGU16_Object_Type 0;
BA_ "GenSigSendType" SG_ 529 SGU16_Object_Type 1;
BA_ "GenSigStartValue" SG_ 529 SGU16_Object_Type 0;
BA_ "GenSigTimeoutValue" SG_ 529 SGU16_Object_Type 0;
BA_ "Remark" SG_ 529 SGU16_Object_Type "";
BA_ "EventCommandSignal" SG_ 529 SGU16_Object_ax 0;
BA_ "GatewayedSignals" SG_ 529 SGU16_Object_ax 0;
BA_ "GenSigInactiveValue" SG_ 529 SGU16_Object_ax 0;
BA_ "GenSigInvalidValue" SG_ 529 SGU16_Object_ax 0;
BA_ "GenSigSendType" SG_ 529 SGU16_Object_ax 1;
BA_ "GenSigStartValue" SG_ 529 SGU16_Object_ax 0;
BA_ "GenSigTimeoutValue" SG_ 529 SGU16_Object_ax 0;
BA_ "Remark" SG_ 529 SGU16_Object_ax "";
BA_ "EventCommandSignal" SG_ 529 SGU16_Object_ay 0;
BA_ "GatewayedSignals" SG_ 529 SGU16_Object_ay 0;
BA_ "GenSigInactiveValue" SG_ 529 SGU16_Object_ay 0;
BA_ "GenSigInvalidValue" SG_ 529 SGU16_Object_ay 0;
BA_ "GenSigSendType" SG_ 529 SGU16_Object_ay 1;
BA_ "GenSigStartValue" SG_ 529 SGU16_Object_ay 0;
BA_ "GenSigTimeoutValue" SG_ 529 SGU16_Object_ay 0;
BA_ "Remark" SG_ 529 SGU16_Object_ay "";
BA_ "EventCommandSignal" SG_ 529 SGU16_Object_dx 0;
BA_ "GatewayedSignals" SG_ 529 SGU16_Object_dx 0;
BA_ "GenSigInactiveValue" SG_ 529 SGU16_Object_dx 0;
BA_ "GenSigInvalidValue" SG_ 529 SGU16_Object_dx 0;
BA_ "GenSigSendType" SG_ 529 SGU16_Object_dx 1;
BA_ "GenSigStartValue" SG_ 529 SGU16_Object_dx 0;
BA_ "GenSigTimeoutValue" SG_ 529 SGU16_Object_dx 0;
BA_ "Remark" SG_ 529 SGU16_Object_dx "";
BA_ "EventCommandSignal" SG_ 529 SGU16_Object_dx_Rear 0;
BA_ "GatewayedSignals" SG_ 529 SGU16_Object_dx_Rear 0;
BA_ "GenSigInactiveValue" SG_ 529 SGU16_Object_dx_Rear 0;
BA_ "GenSigInvalidValue" SG_ 529 SGU16_Object_dx_Rear 0;
BA_ "GenSigSendType" SG_ 529 SGU16_Object_dx_Rear 1;
BA_ "GenSigStartValue" SG_ 529 SGU16_Object_dx_Rear 0;
BA_ "GenSigTimeoutValue" SG_ 529 SGU16_Object_dx_Rear 0;
BA_ "Remark" SG_ 529 SGU16_Object_dx_Rear "";
BA_ "EventCommandSignal" SG_ 529 SGU16_Object_dy 0;
BA_ "GatewayedSignals" SG_ 529 SGU16_Object_dy 0;
BA_ "GenSigInactiveValue" SG_ 529 SGU16_Object_dy 0;
BA_ "GenSigInvalidValue" SG_ 529 SGU16_Object_dy 0;
BA_ "GenSigSendType" SG_ 529 SGU16_Object_dy 1;
BA_ "GenSigStartValue" SG_ 529 SGU16_Object_dy 0;
BA_ "GenSigTimeoutValue" SG_ 529 SGU16_Object_dy 0;
BA_ "Remark" SG_ 529 SGU16_Object_dy "";
BA_ "EventCommandSignal" SG_ 529 SGU16_Object_dy_Rear 0;
BA_ "GatewayedSignals" SG_ 529 SGU16_Object_dy_Rear 0;
BA_ "GenSigInactiveValue" SG_ 529 SGU16_Object_dy_Rear 0;
BA_ "GenSigInvalidValue" SG_ 529 SGU16_Object_dy_Rear 0;
BA_ "GenSigSendType" SG_ 529 SGU16_Object_dy_Rear 1;
BA_ "GenSigStartValue" SG_ 529 SGU16_Object_dy_Rear 0;
BA_ "GenSigTimeoutValue" SG_ 529 SGU16_Object_dy_Rear 0;
BA_ "Remark" SG_ 529 SGU16_Object_dy_Rear "";
BA_ "EventCommandSignal" SG_ 529 SGU16_Object_vx 0;
BA_ "GatewayedSignals" SG_ 529 SGU16_Object_vx 0;
BA_ "GenSigInactiveValue" SG_ 529 SGU16_Object_vx 0;
BA_ "GenSigInvalidValue" SG_ 529 SGU16_Object_vx 0;
BA_ "GenSigSendType" SG_ 529 SGU16_Object_vx 1;
BA_ "GenSigStartValue" SG_ 529 SGU16_Object_vx 0;
BA_ "GenSigTimeoutValue" SG_ 529 SGU16_Object_vx 0;
BA_ "Remark" SG_ 529 SGU16_Object_vx "";
BA_ "EventCommandSignal" SG_ 529 SGU16_Object_vy 0;
BA_ "GatewayedSignals" SG_ 529 SGU16_Object_vy 0;
BA_ "GenSigInactiveValue" SG_ 529 SGU16_Object_vy 0;
BA_ "GenSigInvalidValue" SG_ 529 SGU16_Object_vy 0;
BA_ "GenSigSendType" SG_ 529 SGU16_Object_vy 1;
BA_ "GenSigStartValue" SG_ 529 SGU16_Object_vy 0;
BA_ "GenSigTimeoutValue" SG_ 529 SGU16_Object_vy 0;
BA_ "Remark" SG_ 529 SGU16_Object_vy "";
BA_ "EventCommandSignal" SG_ 529 SGU16_Object_wExist 0;
BA_ "GatewayedSignals" SG_ 529 SGU16_Object_wExist 0;
BA_ "GenSigInactiveValue" SG_ 529 SGU16_Object_wExist 0;
BA_ "GenSigInvalidValue" SG_ 529 SGU16_Object_wExist 0;
BA_ "GenSigSendType" SG_ 529 SGU16_Object_wExist 1;
BA_ "GenSigStartValue" SG_ 529 SGU16_Object_wExist 0;
BA_ "GenSigTimeoutValue" SG_ 529 SGU16_Object_wExist 0;
BA_ "Remark" SG_ 529 SGU16_Object_wExist "";
BA_ "EventCommandSignal" SG_ 529 SGU16_Object_wObstacle 0;
BA_ "GatewayedSignals" SG_ 529 SGU16_Object_wObstacle 0;
BA_ "GenSigInactiveValue" SG_ 529 SGU16_Object_wObstacle 0;
BA_ "GenSigInvalidValue" SG_ 529 SGU16_Object_wObstacle 0;
BA_ "GenSigSendType" SG_ 529 SGU16_Object_wObstacle 1;
BA_ "GenSigStartValue" SG_ 529 SGU16_Object_wObstacle 0;
BA_ "GenSigTimeoutValue" SG_ 529 SGU16_Object_wObstacle 0;
BA_ "Remark" SG_ 529 SGU16_Object_wObstacle "";
BA_ "EventCommandSignal" SG_ 530 SGU17_BlockCounter 0;
BA_ "GatewayedSignals" SG_ 530 SGU17_BlockCounter 0;
BA_ "GenSigInactiveValue" SG_ 530 SGU17_BlockCounter 0;
BA_ "GenSigInvalidValue" SG_ 530 SGU17_BlockCounter 0;
BA_ "GenSigSendType" SG_ 530 SGU17_BlockCounter 1;
BA_ "GenSigStartValue" SG_ 530 SGU17_BlockCounter 0;
BA_ "GenSigTimeoutValue" SG_ 530 SGU17_BlockCounter 0;
BA_ "Remark" SG_ 530 SGU17_BlockCounter "";
BA_ "EventCommandSignal" SG_ 530 SGU17_LifeCycles_OBJ 0;
BA_ "GatewayedSignals" SG_ 530 SGU17_LifeCycles_OBJ 0;
BA_ "GenSigInactiveValue" SG_ 530 SGU17_LifeCycles_OBJ 0;
BA_ "GenSigInvalidValue" SG_ 530 SGU17_LifeCycles_OBJ 0;
BA_ "GenSigSendType" SG_ 530 SGU17_LifeCycles_OBJ 1;
BA_ "GenSigStartValue" SG_ 530 SGU17_LifeCycles_OBJ 0;
BA_ "GenSigTimeoutValue" SG_ 530 SGU17_LifeCycles_OBJ 0;
BA_ "Remark" SG_ 530 SGU17_LifeCycles_OBJ "";
BA_ "EventCommandSignal" SG_ 530 SGU17_Msg_AliveCounter 0;
BA_ "GatewayedSignals" SG_ 530 SGU17_Msg_AliveCounter 0;
BA_ "GenSigInactiveValue" SG_ 530 SGU17_Msg_AliveCounter 0;
BA_ "GenSigInvalidValue" SG_ 530 SGU17_Msg_AliveCounter 0;
BA_ "GenSigSendType" SG_ 530 SGU17_Msg_AliveCounter 1;
BA_ "GenSigStartValue" SG_ 530 SGU17_Msg_AliveCounter 0;
BA_ "GenSigTimeoutValue" SG_ 530 SGU17_Msg_AliveCounter 0;
BA_ "Remark" SG_ 530 SGU17_Msg_AliveCounter "";
BA_ "EventCommandSignal" SG_ 530 SGU17_Msg_CheckSum 0;
BA_ "GatewayedSignals" SG_ 530 SGU17_Msg_CheckSum 0;
BA_ "GenSigInactiveValue" SG_ 530 SGU17_Msg_CheckSum 0;
BA_ "GenSigInvalidValue" SG_ 530 SGU17_Msg_CheckSum 0;
BA_ "GenSigSendType" SG_ 530 SGU17_Msg_CheckSum 1;
BA_ "GenSigStartValue" SG_ 530 SGU17_Msg_CheckSum 0;
BA_ "GenSigTimeoutValue" SG_ 530 SGU17_Msg_CheckSum 0;
BA_ "Remark" SG_ 530 SGU17_Msg_CheckSum "";
BA_ "EventCommandSignal" SG_ 530 SGU17_ObjRCS_17 0;
BA_ "GatewayedSignals" SG_ 530 SGU17_ObjRCS_17 0;
BA_ "GenSigInactiveValue" SG_ 530 SGU17_ObjRCS_17 0;
BA_ "GenSigInvalidValue" SG_ 530 SGU17_ObjRCS_17 0;
BA_ "GenSigSendType" SG_ 530 SGU17_ObjRCS_17 1;
BA_ "GenSigStartValue" SG_ 530 SGU17_ObjRCS_17 0;
BA_ "GenSigTimeoutValue" SG_ 530 SGU17_ObjRCS_17 0;
BA_ "Remark" SG_ 530 SGU17_ObjRCS_17 "";
BA_ "EventCommandSignal" SG_ 530 SGU17_Obj_DistLat_rms 0;
BA_ "GatewayedSignals" SG_ 530 SGU17_Obj_DistLat_rms 0;
BA_ "GenSigInactiveValue" SG_ 530 SGU17_Obj_DistLat_rms 0;
BA_ "GenSigInvalidValue" SG_ 530 SGU17_Obj_DistLat_rms 0;
BA_ "GenSigSendType" SG_ 530 SGU17_Obj_DistLat_rms 1;
BA_ "GenSigStartValue" SG_ 530 SGU17_Obj_DistLat_rms 0;
BA_ "GenSigTimeoutValue" SG_ 530 SGU17_Obj_DistLat_rms 0;
BA_ "Remark" SG_ 530 SGU17_Obj_DistLat_rms "";
BA_ "EventCommandSignal" SG_ 530 SGU17_Obj_VrelLong_rms 0;
BA_ "GatewayedSignals" SG_ 530 SGU17_Obj_VrelLong_rms 0;
BA_ "GenSigInactiveValue" SG_ 530 SGU17_Obj_VrelLong_rms 0;
BA_ "GenSigInvalidValue" SG_ 530 SGU17_Obj_VrelLong_rms 0;
BA_ "GenSigSendType" SG_ 530 SGU17_Obj_VrelLong_rms 1;
BA_ "GenSigStartValue" SG_ 530 SGU17_Obj_VrelLong_rms 0;
BA_ "GenSigTimeoutValue" SG_ 530 SGU17_Obj_VrelLong_rms 0;
BA_ "Remark" SG_ 530 SGU17_Obj_VrelLong_rms "";
BA_ "EventCommandSignal" SG_ 530 SGU17_Obj_Vrelat_rms 0;
BA_ "GatewayedSignals" SG_ 530 SGU17_Obj_Vrelat_rms 0;
BA_ "GenSigInactiveValue" SG_ 530 SGU17_Obj_Vrelat_rms 0;
BA_ "GenSigInvalidValue" SG_ 530 SGU17_Obj_Vrelat_rms 0;
BA_ "GenSigSendType" SG_ 530 SGU17_Obj_Vrelat_rms 1;
BA_ "GenSigStartValue" SG_ 530 SGU17_Obj_Vrelat_rms 0;
BA_ "GenSigTimeoutValue" SG_ 530 SGU17_Obj_Vrelat_rms 0;
BA_ "Remark" SG_ 530 SGU17_Obj_Vrelat_rms "";
BA_ "EventCommandSignal" SG_ 530 SGU17_Object_DetStatus 0;
BA_ "GatewayedSignals" SG_ 530 SGU17_Object_DetStatus 0;
BA_ "GenSigInactiveValue" SG_ 530 SGU17_Object_DetStatus 0;
BA_ "GenSigInvalidValue" SG_ 530 SGU17_Object_DetStatus 0;
BA_ "GenSigSendType" SG_ 530 SGU17_Object_DetStatus 1;
BA_ "GenSigStartValue" SG_ 530 SGU17_Object_DetStatus 0;
BA_ "GenSigTimeoutValue" SG_ 530 SGU17_Object_DetStatus 0;
BA_ "Remark" SG_ 530 SGU17_Object_DetStatus "";
BA_ "EventCommandSignal" SG_ 530 SGU17_Object_DistLong_rms 0;
BA_ "GatewayedSignals" SG_ 530 SGU17_Object_DistLong_rms 0;
BA_ "GenSigInactiveValue" SG_ 530 SGU17_Object_DistLong_rms 0;
BA_ "GenSigInvalidValue" SG_ 530 SGU17_Object_DistLong_rms 0;
BA_ "GenSigSendType" SG_ 530 SGU17_Object_DistLong_rms 1;
BA_ "GenSigStartValue" SG_ 530 SGU17_Object_DistLong_rms 0;
BA_ "GenSigTimeoutValue" SG_ 530 SGU17_Object_DistLong_rms 0;
BA_ "Remark" SG_ 530 SGU17_Object_DistLong_rms "";
BA_ "EventCommandSignal" SG_ 530 SGU17_Object_ID 0;
BA_ "GatewayedSignals" SG_ 530 SGU17_Object_ID 0;
BA_ "GenSigInactiveValue" SG_ 530 SGU17_Object_ID 0;
BA_ "GenSigInvalidValue" SG_ 530 SGU17_Object_ID 0;
BA_ "GenSigSendType" SG_ 530 SGU17_Object_ID 1;
BA_ "GenSigStartValue" SG_ 530 SGU17_Object_ID 0;
BA_ "GenSigTimeoutValue" SG_ 530 SGU17_Object_ID 0;
BA_ "Remark" SG_ 530 SGU17_Object_ID "";
BA_ "EventCommandSignal" SG_ 530 SGU17_Object_Motion_Pattern 0;
BA_ "GatewayedSignals" SG_ 530 SGU17_Object_Motion_Pattern 0;
BA_ "GenSigInactiveValue" SG_ 530 SGU17_Object_Motion_Pattern 0;
BA_ "GenSigInvalidValue" SG_ 530 SGU17_Object_Motion_Pattern 0;
BA_ "GenSigSendType" SG_ 530 SGU17_Object_Motion_Pattern 1;
BA_ "GenSigStartValue" SG_ 530 SGU17_Object_Motion_Pattern 0;
BA_ "GenSigTimeoutValue" SG_ 530 SGU17_Object_Motion_Pattern 0;
BA_ "Remark" SG_ 530 SGU17_Object_Motion_Pattern "";
BA_ "EventCommandSignal" SG_ 530 SGU17_Object_Type 0;
BA_ "GatewayedSignals" SG_ 530 SGU17_Object_Type 0;
BA_ "GenSigInactiveValue" SG_ 530 SGU17_Object_Type 0;
BA_ "GenSigInvalidValue" SG_ 530 SGU17_Object_Type 0;
BA_ "GenSigSendType" SG_ 530 SGU17_Object_Type 1;
BA_ "GenSigStartValue" SG_ 530 SGU17_Object_Type 0;
BA_ "GenSigTimeoutValue" SG_ 530 SGU17_Object_Type 0;
BA_ "Remark" SG_ 530 SGU17_Object_Type "";
BA_ "EventCommandSignal" SG_ 530 SGU17_Object_ax 0;
BA_ "GatewayedSignals" SG_ 530 SGU17_Object_ax 0;
BA_ "GenSigInactiveValue" SG_ 530 SGU17_Object_ax 0;
BA_ "GenSigInvalidValue" SG_ 530 SGU17_Object_ax 0;
BA_ "GenSigSendType" SG_ 530 SGU17_Object_ax 1;
BA_ "GenSigStartValue" SG_ 530 SGU17_Object_ax 0;
BA_ "GenSigTimeoutValue" SG_ 530 SGU17_Object_ax 0;
BA_ "Remark" SG_ 530 SGU17_Object_ax "";
BA_ "EventCommandSignal" SG_ 530 SGU17_Object_ay 0;
BA_ "GatewayedSignals" SG_ 530 SGU17_Object_ay 0;
BA_ "GenSigInactiveValue" SG_ 530 SGU17_Object_ay 0;
BA_ "GenSigInvalidValue" SG_ 530 SGU17_Object_ay 0;
BA_ "GenSigSendType" SG_ 530 SGU17_Object_ay 1;
BA_ "GenSigStartValue" SG_ 530 SGU17_Object_ay 0;
BA_ "GenSigTimeoutValue" SG_ 530 SGU17_Object_ay 0;
BA_ "Remark" SG_ 530 SGU17_Object_ay "";
BA_ "EventCommandSignal" SG_ 530 SGU17_Object_dx 0;
BA_ "GatewayedSignals" SG_ 530 SGU17_Object_dx 0;
BA_ "GenSigInactiveValue" SG_ 530 SGU17_Object_dx 0;
BA_ "GenSigInvalidValue" SG_ 530 SGU17_Object_dx 0;
BA_ "GenSigSendType" SG_ 530 SGU17_Object_dx 1;
BA_ "GenSigStartValue" SG_ 530 SGU17_Object_dx 0;
BA_ "GenSigTimeoutValue" SG_ 530 SGU17_Object_dx 0;
BA_ "Remark" SG_ 530 SGU17_Object_dx "";
BA_ "EventCommandSignal" SG_ 530 SGU17_Object_dx_Rear 0;
BA_ "GatewayedSignals" SG_ 530 SGU17_Object_dx_Rear 0;
BA_ "GenSigInactiveValue" SG_ 530 SGU17_Object_dx_Rear 0;
BA_ "GenSigInvalidValue" SG_ 530 SGU17_Object_dx_Rear 0;
BA_ "GenSigSendType" SG_ 530 SGU17_Object_dx_Rear 1;
BA_ "GenSigStartValue" SG_ 530 SGU17_Object_dx_Rear 0;
BA_ "GenSigTimeoutValue" SG_ 530 SGU17_Object_dx_Rear 0;
BA_ "Remark" SG_ 530 SGU17_Object_dx_Rear "";
BA_ "EventCommandSignal" SG_ 530 SGU17_Object_dy 0;
BA_ "GatewayedSignals" SG_ 530 SGU17_Object_dy 0;
BA_ "GenSigInactiveValue" SG_ 530 SGU17_Object_dy 0;
BA_ "GenSigInvalidValue" SG_ 530 SGU17_Object_dy 0;
BA_ "GenSigSendType" SG_ 530 SGU17_Object_dy 1;
BA_ "GenSigStartValue" SG_ 530 SGU17_Object_dy 0;
BA_ "GenSigTimeoutValue" SG_ 530 SGU17_Object_dy 0;
BA_ "Remark" SG_ 530 SGU17_Object_dy "";
BA_ "EventCommandSignal" SG_ 530 SGU17_Object_dy_Rear 0;
BA_ "GatewayedSignals" SG_ 530 SGU17_Object_dy_Rear 0;
BA_ "GenSigInactiveValue" SG_ 530 SGU17_Object_dy_Rear 0;
BA_ "GenSigInvalidValue" SG_ 530 SGU17_Object_dy_Rear 0;
BA_ "GenSigSendType" SG_ 530 SGU17_Object_dy_Rear 1;
BA_ "GenSigStartValue" SG_ 530 SGU17_Object_dy_Rear 0;
BA_ "GenSigTimeoutValue" SG_ 530 SGU17_Object_dy_Rear 0;
BA_ "Remark" SG_ 530 SGU17_Object_dy_Rear "";
BA_ "EventCommandSignal" SG_ 530 SGU17_Object_vx 0;
BA_ "GatewayedSignals" SG_ 530 SGU17_Object_vx 0;
BA_ "GenSigInactiveValue" SG_ 530 SGU17_Object_vx 0;
BA_ "GenSigInvalidValue" SG_ 530 SGU17_Object_vx 0;
BA_ "GenSigSendType" SG_ 530 SGU17_Object_vx 1;
BA_ "GenSigStartValue" SG_ 530 SGU17_Object_vx 0;
BA_ "GenSigTimeoutValue" SG_ 530 SGU17_Object_vx 0;
BA_ "Remark" SG_ 530 SGU17_Object_vx "";
BA_ "EventCommandSignal" SG_ 530 SGU17_Object_vy 0;
BA_ "GatewayedSignals" SG_ 530 SGU17_Object_vy 0;
BA_ "GenSigInactiveValue" SG_ 530 SGU17_Object_vy 0;
BA_ "GenSigInvalidValue" SG_ 530 SGU17_Object_vy 0;
BA_ "GenSigSendType" SG_ 530 SGU17_Object_vy 1;
BA_ "GenSigStartValue" SG_ 530 SGU17_Object_vy 0;
BA_ "GenSigTimeoutValue" SG_ 530 SGU17_Object_vy 0;
BA_ "Remark" SG_ 530 SGU17_Object_vy "";
BA_ "EventCommandSignal" SG_ 530 SGU17_Object_wExist 0;
BA_ "GatewayedSignals" SG_ 530 SGU17_Object_wExist 0;
BA_ "GenSigInactiveValue" SG_ 530 SGU17_Object_wExist 0;
BA_ "GenSigInvalidValue" SG_ 530 SGU17_Object_wExist 0;
BA_ "GenSigSendType" SG_ 530 SGU17_Object_wExist 1;
BA_ "GenSigStartValue" SG_ 530 SGU17_Object_wExist 0;
BA_ "GenSigTimeoutValue" SG_ 530 SGU17_Object_wExist 0;
BA_ "Remark" SG_ 530 SGU17_Object_wExist "";
BA_ "EventCommandSignal" SG_ 530 SGU17_Object_wObstacle 0;
BA_ "GatewayedSignals" SG_ 530 SGU17_Object_wObstacle 0;
BA_ "GenSigInactiveValue" SG_ 530 SGU17_Object_wObstacle 0;
BA_ "GenSigInvalidValue" SG_ 530 SGU17_Object_wObstacle 0;
BA_ "GenSigSendType" SG_ 530 SGU17_Object_wObstacle 1;
BA_ "GenSigStartValue" SG_ 530 SGU17_Object_wObstacle 0;
BA_ "GenSigTimeoutValue" SG_ 530 SGU17_Object_wObstacle 0;
BA_ "Remark" SG_ 530 SGU17_Object_wObstacle "";
BA_ "EventCommandSignal" SG_ 531 SGU18_BlockCounter 0;
BA_ "GatewayedSignals" SG_ 531 SGU18_BlockCounter 0;
BA_ "GenSigInactiveValue" SG_ 531 SGU18_BlockCounter 0;
BA_ "GenSigInvalidValue" SG_ 531 SGU18_BlockCounter 0;
BA_ "GenSigSendType" SG_ 531 SGU18_BlockCounter 1;
BA_ "GenSigStartValue" SG_ 531 SGU18_BlockCounter 0;
BA_ "GenSigTimeoutValue" SG_ 531 SGU18_BlockCounter 0;
BA_ "Remark" SG_ 531 SGU18_BlockCounter "";
BA_ "EventCommandSignal" SG_ 531 SGU18_LifeCycles_OBJ 0;
BA_ "GatewayedSignals" SG_ 531 SGU18_LifeCycles_OBJ 0;
BA_ "GenSigInactiveValue" SG_ 531 SGU18_LifeCycles_OBJ 0;
BA_ "GenSigInvalidValue" SG_ 531 SGU18_LifeCycles_OBJ 0;
BA_ "GenSigSendType" SG_ 531 SGU18_LifeCycles_OBJ 1;
BA_ "GenSigStartValue" SG_ 531 SGU18_LifeCycles_OBJ 0;
BA_ "GenSigTimeoutValue" SG_ 531 SGU18_LifeCycles_OBJ 0;
BA_ "Remark" SG_ 531 SGU18_LifeCycles_OBJ "";
BA_ "EventCommandSignal" SG_ 531 SGU18_Msg_AliveCounter 0;
BA_ "GatewayedSignals" SG_ 531 SGU18_Msg_AliveCounter 0;
BA_ "GenSigInactiveValue" SG_ 531 SGU18_Msg_AliveCounter 0;
BA_ "GenSigInvalidValue" SG_ 531 SGU18_Msg_AliveCounter 0;
BA_ "GenSigSendType" SG_ 531 SGU18_Msg_AliveCounter 1;
BA_ "GenSigStartValue" SG_ 531 SGU18_Msg_AliveCounter 0;
BA_ "GenSigTimeoutValue" SG_ 531 SGU18_Msg_AliveCounter 0;
BA_ "Remark" SG_ 531 SGU18_Msg_AliveCounter "";
BA_ "EventCommandSignal" SG_ 531 SGU18_Msg_CheckSum 0;
BA_ "GatewayedSignals" SG_ 531 SGU18_Msg_CheckSum 0;
BA_ "GenSigInactiveValue" SG_ 531 SGU18_Msg_CheckSum 0;
BA_ "GenSigInvalidValue" SG_ 531 SGU18_Msg_CheckSum 0;
BA_ "GenSigSendType" SG_ 531 SGU18_Msg_CheckSum 1;
BA_ "GenSigStartValue" SG_ 531 SGU18_Msg_CheckSum 0;
BA_ "GenSigTimeoutValue" SG_ 531 SGU18_Msg_CheckSum 0;
BA_ "Remark" SG_ 531 SGU18_Msg_CheckSum "";
BA_ "EventCommandSignal" SG_ 531 SGU18_ObjRCS_18 0;
BA_ "GatewayedSignals" SG_ 531 SGU18_ObjRCS_18 0;
BA_ "GenSigInactiveValue" SG_ 531 SGU18_ObjRCS_18 0;
BA_ "GenSigInvalidValue" SG_ 531 SGU18_ObjRCS_18 0;
BA_ "GenSigSendType" SG_ 531 SGU18_ObjRCS_18 1;
BA_ "GenSigStartValue" SG_ 531 SGU18_ObjRCS_18 0;
BA_ "GenSigTimeoutValue" SG_ 531 SGU18_ObjRCS_18 0;
BA_ "Remark" SG_ 531 SGU18_ObjRCS_18 "";
BA_ "EventCommandSignal" SG_ 531 SGU18_Obj_DistLat_rms 0;
BA_ "GatewayedSignals" SG_ 531 SGU18_Obj_DistLat_rms 0;
BA_ "GenSigInactiveValue" SG_ 531 SGU18_Obj_DistLat_rms 0;
BA_ "GenSigInvalidValue" SG_ 531 SGU18_Obj_DistLat_rms 0;
BA_ "GenSigSendType" SG_ 531 SGU18_Obj_DistLat_rms 1;
BA_ "GenSigStartValue" SG_ 531 SGU18_Obj_DistLat_rms 0;
BA_ "GenSigTimeoutValue" SG_ 531 SGU18_Obj_DistLat_rms 0;
BA_ "Remark" SG_ 531 SGU18_Obj_DistLat_rms "";
BA_ "EventCommandSignal" SG_ 531 SGU18_Obj_VrelLong_rms 0;
BA_ "GatewayedSignals" SG_ 531 SGU18_Obj_VrelLong_rms 0;
BA_ "GenSigInactiveValue" SG_ 531 SGU18_Obj_VrelLong_rms 0;
BA_ "GenSigInvalidValue" SG_ 531 SGU18_Obj_VrelLong_rms 0;
BA_ "GenSigSendType" SG_ 531 SGU18_Obj_VrelLong_rms 1;
BA_ "GenSigStartValue" SG_ 531 SGU18_Obj_VrelLong_rms 0;
BA_ "GenSigTimeoutValue" SG_ 531 SGU18_Obj_VrelLong_rms 0;
BA_ "Remark" SG_ 531 SGU18_Obj_VrelLong_rms "";
BA_ "EventCommandSignal" SG_ 531 SGU18_Obj_Vrelat_rms 0;
BA_ "GatewayedSignals" SG_ 531 SGU18_Obj_Vrelat_rms 0;
BA_ "GenSigInactiveValue" SG_ 531 SGU18_Obj_Vrelat_rms 0;
BA_ "GenSigInvalidValue" SG_ 531 SGU18_Obj_Vrelat_rms 0;
BA_ "GenSigSendType" SG_ 531 SGU18_Obj_Vrelat_rms 1;
BA_ "GenSigStartValue" SG_ 531 SGU18_Obj_Vrelat_rms 0;
BA_ "GenSigTimeoutValue" SG_ 531 SGU18_Obj_Vrelat_rms 0;
BA_ "Remark" SG_ 531 SGU18_Obj_Vrelat_rms "";
BA_ "EventCommandSignal" SG_ 531 SGU18_Object_DetStatus 0;
BA_ "GatewayedSignals" SG_ 531 SGU18_Object_DetStatus 0;
BA_ "GenSigInactiveValue" SG_ 531 SGU18_Object_DetStatus 0;
BA_ "GenSigInvalidValue" SG_ 531 SGU18_Object_DetStatus 0;
BA_ "GenSigSendType" SG_ 531 SGU18_Object_DetStatus 1;
BA_ "GenSigStartValue" SG_ 531 SGU18_Object_DetStatus 0;
BA_ "GenSigTimeoutValue" SG_ 531 SGU18_Object_DetStatus 0;
BA_ "Remark" SG_ 531 SGU18_Object_DetStatus "";
BA_ "EventCommandSignal" SG_ 531 SGU18_Object_DistLong_rms 0;
BA_ "GatewayedSignals" SG_ 531 SGU18_Object_DistLong_rms 0;
BA_ "GenSigInactiveValue" SG_ 531 SGU18_Object_DistLong_rms 0;
BA_ "GenSigInvalidValue" SG_ 531 SGU18_Object_DistLong_rms 0;
BA_ "GenSigSendType" SG_ 531 SGU18_Object_DistLong_rms 1;
BA_ "GenSigStartValue" SG_ 531 SGU18_Object_DistLong_rms 0;
BA_ "GenSigTimeoutValue" SG_ 531 SGU18_Object_DistLong_rms 0;
BA_ "Remark" SG_ 531 SGU18_Object_DistLong_rms "";
BA_ "EventCommandSignal" SG_ 531 SGU18_Object_ID 0;
BA_ "GatewayedSignals" SG_ 531 SGU18_Object_ID 0;
BA_ "GenSigInactiveValue" SG_ 531 SGU18_Object_ID 0;
BA_ "GenSigInvalidValue" SG_ 531 SGU18_Object_ID 0;
BA_ "GenSigSendType" SG_ 531 SGU18_Object_ID 1;
BA_ "GenSigStartValue" SG_ 531 SGU18_Object_ID 0;
BA_ "GenSigTimeoutValue" SG_ 531 SGU18_Object_ID 0;
BA_ "Remark" SG_ 531 SGU18_Object_ID "";
BA_ "EventCommandSignal" SG_ 531 SGU18_Object_Motion_Pattern 0;
BA_ "GatewayedSignals" SG_ 531 SGU18_Object_Motion_Pattern 0;
BA_ "GenSigInactiveValue" SG_ 531 SGU18_Object_Motion_Pattern 0;
BA_ "GenSigInvalidValue" SG_ 531 SGU18_Object_Motion_Pattern 0;
BA_ "GenSigSendType" SG_ 531 SGU18_Object_Motion_Pattern 1;
BA_ "GenSigStartValue" SG_ 531 SGU18_Object_Motion_Pattern 0;
BA_ "GenSigTimeoutValue" SG_ 531 SGU18_Object_Motion_Pattern 0;
BA_ "Remark" SG_ 531 SGU18_Object_Motion_Pattern "";
BA_ "EventCommandSignal" SG_ 531 SGU18_Object_Type 0;
BA_ "GatewayedSignals" SG_ 531 SGU18_Object_Type 0;
BA_ "GenSigInactiveValue" SG_ 531 SGU18_Object_Type 0;
BA_ "GenSigInvalidValue" SG_ 531 SGU18_Object_Type 0;
BA_ "GenSigSendType" SG_ 531 SGU18_Object_Type 1;
BA_ "GenSigStartValue" SG_ 531 SGU18_Object_Type 0;
BA_ "GenSigTimeoutValue" SG_ 531 SGU18_Object_Type 0;
BA_ "Remark" SG_ 531 SGU18_Object_Type "";
BA_ "EventCommandSignal" SG_ 531 SGU18_Object_ax 0;
BA_ "GatewayedSignals" SG_ 531 SGU18_Object_ax 0;
BA_ "GenSigInactiveValue" SG_ 531 SGU18_Object_ax 0;
BA_ "GenSigInvalidValue" SG_ 531 SGU18_Object_ax 0;
BA_ "GenSigSendType" SG_ 531 SGU18_Object_ax 1;
BA_ "GenSigStartValue" SG_ 531 SGU18_Object_ax 0;
BA_ "GenSigTimeoutValue" SG_ 531 SGU18_Object_ax 0;
BA_ "Remark" SG_ 531 SGU18_Object_ax "";
BA_ "EventCommandSignal" SG_ 531 SGU18_Object_ay 0;
BA_ "GatewayedSignals" SG_ 531 SGU18_Object_ay 0;
BA_ "GenSigInactiveValue" SG_ 531 SGU18_Object_ay 0;
BA_ "GenSigInvalidValue" SG_ 531 SGU18_Object_ay 0;
BA_ "GenSigSendType" SG_ 531 SGU18_Object_ay 1;
BA_ "GenSigStartValue" SG_ 531 SGU18_Object_ay 0;
BA_ "GenSigTimeoutValue" SG_ 531 SGU18_Object_ay 0;
BA_ "Remark" SG_ 531 SGU18_Object_ay "";
BA_ "EventCommandSignal" SG_ 531 SGU18_Object_dx 0;
BA_ "GatewayedSignals" SG_ 531 SGU18_Object_dx 0;
BA_ "GenSigInactiveValue" SG_ 531 SGU18_Object_dx 0;
BA_ "GenSigInvalidValue" SG_ 531 SGU18_Object_dx 0;
BA_ "GenSigSendType" SG_ 531 SGU18_Object_dx 1;
BA_ "GenSigStartValue" SG_ 531 SGU18_Object_dx 0;
BA_ "GenSigTimeoutValue" SG_ 531 SGU18_Object_dx 0;
BA_ "Remark" SG_ 531 SGU18_Object_dx "";
BA_ "EventCommandSignal" SG_ 531 SGU18_Object_dx_Rear 0;
BA_ "GatewayedSignals" SG_ 531 SGU18_Object_dx_Rear 0;
BA_ "GenSigInactiveValue" SG_ 531 SGU18_Object_dx_Rear 0;
BA_ "GenSigInvalidValue" SG_ 531 SGU18_Object_dx_Rear 0;
BA_ "GenSigSendType" SG_ 531 SGU18_Object_dx_Rear 1;
BA_ "GenSigStartValue" SG_ 531 SGU18_Object_dx_Rear 0;
BA_ "GenSigTimeoutValue" SG_ 531 SGU18_Object_dx_Rear 0;
BA_ "Remark" SG_ 531 SGU18_Object_dx_Rear "";
BA_ "EventCommandSignal" SG_ 531 SGU18_Object_dy 0;
BA_ "GatewayedSignals" SG_ 531 SGU18_Object_dy 0;
BA_ "GenSigInactiveValue" SG_ 531 SGU18_Object_dy 0;
BA_ "GenSigInvalidValue" SG_ 531 SGU18_Object_dy 0;
BA_ "GenSigSendType" SG_ 531 SGU18_Object_dy 1;
BA_ "GenSigStartValue" SG_ 531 SGU18_Object_dy 0;
BA_ "GenSigTimeoutValue" SG_ 531 SGU18_Object_dy 0;
BA_ "Remark" SG_ 531 SGU18_Object_dy "";
BA_ "EventCommandSignal" SG_ 531 SGU18_Object_dy_Rear 0;
BA_ "GatewayedSignals" SG_ 531 SGU18_Object_dy_Rear 0;
BA_ "GenSigInactiveValue" SG_ 531 SGU18_Object_dy_Rear 0;
BA_ "GenSigInvalidValue" SG_ 531 SGU18_Object_dy_Rear 0;
BA_ "GenSigSendType" SG_ 531 SGU18_Object_dy_Rear 1;
BA_ "GenSigStartValue" SG_ 531 SGU18_Object_dy_Rear 0;
BA_ "GenSigTimeoutValue" SG_ 531 SGU18_Object_dy_Rear 0;
BA_ "Remark" SG_ 531 SGU18_Object_dy_Rear "";
BA_ "EventCommandSignal" SG_ 531 SGU18_Object_vx 0;
BA_ "GatewayedSignals" SG_ 531 SGU18_Object_vx 0;
BA_ "GenSigInactiveValue" SG_ 531 SGU18_Object_vx 0;
BA_ "GenSigInvalidValue" SG_ 531 SGU18_Object_vx 0;
BA_ "GenSigSendType" SG_ 531 SGU18_Object_vx 1;
BA_ "GenSigStartValue" SG_ 531 SGU18_Object_vx 0;
BA_ "GenSigTimeoutValue" SG_ 531 SGU18_Object_vx 0;
BA_ "Remark" SG_ 531 SGU18_Object_vx "";
BA_ "EventCommandSignal" SG_ 531 SGU18_Object_vy 0;
BA_ "GatewayedSignals" SG_ 531 SGU18_Object_vy 0;
BA_ "GenSigInactiveValue" SG_ 531 SGU18_Object_vy 0;
BA_ "GenSigInvalidValue" SG_ 531 SGU18_Object_vy 0;
BA_ "GenSigSendType" SG_ 531 SGU18_Object_vy 1;
BA_ "GenSigStartValue" SG_ 531 SGU18_Object_vy 0;
BA_ "GenSigTimeoutValue" SG_ 531 SGU18_Object_vy 0;
BA_ "Remark" SG_ 531 SGU18_Object_vy "";
BA_ "EventCommandSignal" SG_ 531 SGU18_Object_wExist 0;
BA_ "GatewayedSignals" SG_ 531 SGU18_Object_wExist 0;
BA_ "GenSigInactiveValue" SG_ 531 SGU18_Object_wExist 0;
BA_ "GenSigInvalidValue" SG_ 531 SGU18_Object_wExist 0;
BA_ "GenSigSendType" SG_ 531 SGU18_Object_wExist 1;
BA_ "GenSigStartValue" SG_ 531 SGU18_Object_wExist 0;
BA_ "GenSigTimeoutValue" SG_ 531 SGU18_Object_wExist 0;
BA_ "Remark" SG_ 531 SGU18_Object_wExist "";
BA_ "EventCommandSignal" SG_ 531 SGU18_Object_wObstacle 0;
BA_ "GatewayedSignals" SG_ 531 SGU18_Object_wObstacle 0;
BA_ "GenSigInactiveValue" SG_ 531 SGU18_Object_wObstacle 0;
BA_ "GenSigInvalidValue" SG_ 531 SGU18_Object_wObstacle 0;
BA_ "GenSigSendType" SG_ 531 SGU18_Object_wObstacle 1;
BA_ "GenSigStartValue" SG_ 531 SGU18_Object_wObstacle 0;
BA_ "GenSigTimeoutValue" SG_ 531 SGU18_Object_wObstacle 0;
BA_ "Remark" SG_ 531 SGU18_Object_wObstacle "";
BA_ "EventCommandSignal" SG_ 532 SGU19_BlockCounter 0;
BA_ "GatewayedSignals" SG_ 532 SGU19_BlockCounter 0;
BA_ "GenSigInactiveValue" SG_ 532 SGU19_BlockCounter 0;
BA_ "GenSigInvalidValue" SG_ 532 SGU19_BlockCounter 0;
BA_ "GenSigSendType" SG_ 532 SGU19_BlockCounter 1;
BA_ "GenSigStartValue" SG_ 532 SGU19_BlockCounter 0;
BA_ "GenSigTimeoutValue" SG_ 532 SGU19_BlockCounter 0;
BA_ "Remark" SG_ 532 SGU19_BlockCounter "";
BA_ "EventCommandSignal" SG_ 532 SGU19_LifeCycles_OBJ 0;
BA_ "GatewayedSignals" SG_ 532 SGU19_LifeCycles_OBJ 0;
BA_ "GenSigInactiveValue" SG_ 532 SGU19_LifeCycles_OBJ 0;
BA_ "GenSigInvalidValue" SG_ 532 SGU19_LifeCycles_OBJ 0;
BA_ "GenSigSendType" SG_ 532 SGU19_LifeCycles_OBJ 1;
BA_ "GenSigStartValue" SG_ 532 SGU19_LifeCycles_OBJ 0;
BA_ "GenSigTimeoutValue" SG_ 532 SGU19_LifeCycles_OBJ 0;
BA_ "Remark" SG_ 532 SGU19_LifeCycles_OBJ "";
BA_ "EventCommandSignal" SG_ 532 SGU19_Msg_AliveCounter 0;
BA_ "GatewayedSignals" SG_ 532 SGU19_Msg_AliveCounter 0;
BA_ "GenSigInactiveValue" SG_ 532 SGU19_Msg_AliveCounter 0;
BA_ "GenSigInvalidValue" SG_ 532 SGU19_Msg_AliveCounter 0;
BA_ "GenSigSendType" SG_ 532 SGU19_Msg_AliveCounter 1;
BA_ "GenSigStartValue" SG_ 532 SGU19_Msg_AliveCounter 0;
BA_ "GenSigTimeoutValue" SG_ 532 SGU19_Msg_AliveCounter 0;
BA_ "Remark" SG_ 532 SGU19_Msg_AliveCounter "";
BA_ "EventCommandSignal" SG_ 532 SGU19_Msg_CheckSum 0;
BA_ "GatewayedSignals" SG_ 532 SGU19_Msg_CheckSum 0;
BA_ "GenSigInactiveValue" SG_ 532 SGU19_Msg_CheckSum 0;
BA_ "GenSigInvalidValue" SG_ 532 SGU19_Msg_CheckSum 0;
BA_ "GenSigSendType" SG_ 532 SGU19_Msg_CheckSum 1;
BA_ "GenSigStartValue" SG_ 532 SGU19_Msg_CheckSum 0;
BA_ "GenSigTimeoutValue" SG_ 532 SGU19_Msg_CheckSum 0;
BA_ "Remark" SG_ 532 SGU19_Msg_CheckSum "";
BA_ "EventCommandSignal" SG_ 532 SGU19_ObjRCS_19 0;
BA_ "GatewayedSignals" SG_ 532 SGU19_ObjRCS_19 0;
BA_ "GenSigInactiveValue" SG_ 532 SGU19_ObjRCS_19 0;
BA_ "GenSigInvalidValue" SG_ 532 SGU19_ObjRCS_19 0;
BA_ "GenSigSendType" SG_ 532 SGU19_ObjRCS_19 1;
BA_ "GenSigStartValue" SG_ 532 SGU19_ObjRCS_19 0;
BA_ "GenSigTimeoutValue" SG_ 532 SGU19_ObjRCS_19 0;
BA_ "Remark" SG_ 532 SGU19_ObjRCS_19 "";
BA_ "EventCommandSignal" SG_ 532 SGU19_Obj_DistLat_rms 0;
BA_ "GatewayedSignals" SG_ 532 SGU19_Obj_DistLat_rms 0;
BA_ "GenSigInactiveValue" SG_ 532 SGU19_Obj_DistLat_rms 0;
BA_ "GenSigInvalidValue" SG_ 532 SGU19_Obj_DistLat_rms 0;
BA_ "GenSigSendType" SG_ 532 SGU19_Obj_DistLat_rms 1;
BA_ "GenSigStartValue" SG_ 532 SGU19_Obj_DistLat_rms 0;
BA_ "GenSigTimeoutValue" SG_ 532 SGU19_Obj_DistLat_rms 0;
BA_ "Remark" SG_ 532 SGU19_Obj_DistLat_rms "";
BA_ "EventCommandSignal" SG_ 532 SGU19_Obj_VrelLong_rms 0;
BA_ "GatewayedSignals" SG_ 532 SGU19_Obj_VrelLong_rms 0;
BA_ "GenSigInactiveValue" SG_ 532 SGU19_Obj_VrelLong_rms 0;
BA_ "GenSigInvalidValue" SG_ 532 SGU19_Obj_VrelLong_rms 0;
BA_ "GenSigSendType" SG_ 532 SGU19_Obj_VrelLong_rms 1;
BA_ "GenSigStartValue" SG_ 532 SGU19_Obj_VrelLong_rms 0;
BA_ "GenSigTimeoutValue" SG_ 532 SGU19_Obj_VrelLong_rms 0;
BA_ "Remark" SG_ 532 SGU19_Obj_VrelLong_rms "";
BA_ "EventCommandSignal" SG_ 532 SGU19_Obj_Vrelat_rms 0;
BA_ "GatewayedSignals" SG_ 532 SGU19_Obj_Vrelat_rms 0;
BA_ "GenSigInactiveValue" SG_ 532 SGU19_Obj_Vrelat_rms 0;
BA_ "GenSigInvalidValue" SG_ 532 SGU19_Obj_Vrelat_rms 0;
BA_ "GenSigSendType" SG_ 532 SGU19_Obj_Vrelat_rms 1;
BA_ "GenSigStartValue" SG_ 532 SGU19_Obj_Vrelat_rms 0;
BA_ "GenSigTimeoutValue" SG_ 532 SGU19_Obj_Vrelat_rms 0;
BA_ "Remark" SG_ 532 SGU19_Obj_Vrelat_rms "";
BA_ "EventCommandSignal" SG_ 532 SGU19_Object_DetStatus 0;
BA_ "GatewayedSignals" SG_ 532 SGU19_Object_DetStatus 0;
BA_ "GenSigInactiveValue" SG_ 532 SGU19_Object_DetStatus 0;
BA_ "GenSigInvalidValue" SG_ 532 SGU19_Object_DetStatus 0;
BA_ "GenSigSendType" SG_ 532 SGU19_Object_DetStatus 1;
BA_ "GenSigStartValue" SG_ 532 SGU19_Object_DetStatus 0;
BA_ "GenSigTimeoutValue" SG_ 532 SGU19_Object_DetStatus 0;
BA_ "Remark" SG_ 532 SGU19_Object_DetStatus "";
BA_ "EventCommandSignal" SG_ 532 SGU19_Object_DistLong_rms 0;
BA_ "GatewayedSignals" SG_ 532 SGU19_Object_DistLong_rms 0;
BA_ "GenSigInactiveValue" SG_ 532 SGU19_Object_DistLong_rms 0;
BA_ "GenSigInvalidValue" SG_ 532 SGU19_Object_DistLong_rms 0;
BA_ "GenSigSendType" SG_ 532 SGU19_Object_DistLong_rms 1;
BA_ "GenSigStartValue" SG_ 532 SGU19_Object_DistLong_rms 0;
BA_ "GenSigTimeoutValue" SG_ 532 SGU19_Object_DistLong_rms 0;
BA_ "Remark" SG_ 532 SGU19_Object_DistLong_rms "";
BA_ "EventCommandSignal" SG_ 532 SGU19_Object_ID 0;
BA_ "GatewayedSignals" SG_ 532 SGU19_Object_ID 0;
BA_ "GenSigInactiveValue" SG_ 532 SGU19_Object_ID 0;
BA_ "GenSigInvalidValue" SG_ 532 SGU19_Object_ID 0;
BA_ "GenSigSendType" SG_ 532 SGU19_Object_ID 1;
BA_ "GenSigStartValue" SG_ 532 SGU19_Object_ID 0;
BA_ "GenSigTimeoutValue" SG_ 532 SGU19_Object_ID 0;
BA_ "Remark" SG_ 532 SGU19_Object_ID "";
BA_ "EventCommandSignal" SG_ 532 SGU19_Object_Motion_Pattern 0;
BA_ "GatewayedSignals" SG_ 532 SGU19_Object_Motion_Pattern 0;
BA_ "GenSigInactiveValue" SG_ 532 SGU19_Object_Motion_Pattern 0;
BA_ "GenSigInvalidValue" SG_ 532 SGU19_Object_Motion_Pattern 0;
BA_ "GenSigSendType" SG_ 532 SGU19_Object_Motion_Pattern 1;
BA_ "GenSigStartValue" SG_ 532 SGU19_Object_Motion_Pattern 0;
BA_ "GenSigTimeoutValue" SG_ 532 SGU19_Object_Motion_Pattern 0;
BA_ "Remark" SG_ 532 SGU19_Object_Motion_Pattern "";
BA_ "EventCommandSignal" SG_ 532 SGU19_Object_Type 0;
BA_ "GatewayedSignals" SG_ 532 SGU19_Object_Type 0;
BA_ "GenSigInactiveValue" SG_ 532 SGU19_Object_Type 0;
BA_ "GenSigInvalidValue" SG_ 532 SGU19_Object_Type 0;
BA_ "GenSigSendType" SG_ 532 SGU19_Object_Type 1;
BA_ "GenSigStartValue" SG_ 532 SGU19_Object_Type 0;
BA_ "GenSigTimeoutValue" SG_ 532 SGU19_Object_Type 0;
BA_ "Remark" SG_ 532 SGU19_Object_Type "";
BA_ "EventCommandSignal" SG_ 532 SGU19_Object_ax 0;
BA_ "GatewayedSignals" SG_ 532 SGU19_Object_ax 0;
BA_ "GenSigInactiveValue" SG_ 532 SGU19_Object_ax 0;
BA_ "GenSigInvalidValue" SG_ 532 SGU19_Object_ax 0;
BA_ "GenSigSendType" SG_ 532 SGU19_Object_ax 1;
BA_ "GenSigStartValue" SG_ 532 SGU19_Object_ax 0;
BA_ "GenSigTimeoutValue" SG_ 532 SGU19_Object_ax 0;
BA_ "Remark" SG_ 532 SGU19_Object_ax "";
BA_ "EventCommandSignal" SG_ 532 SGU19_Object_ay 0;
BA_ "GatewayedSignals" SG_ 532 SGU19_Object_ay 0;
BA_ "GenSigInactiveValue" SG_ 532 SGU19_Object_ay 0;
BA_ "GenSigInvalidValue" SG_ 532 SGU19_Object_ay 0;
BA_ "GenSigSendType" SG_ 532 SGU19_Object_ay 1;
BA_ "GenSigStartValue" SG_ 532 SGU19_Object_ay 0;
BA_ "GenSigTimeoutValue" SG_ 532 SGU19_Object_ay 0;
BA_ "Remark" SG_ 532 SGU19_Object_ay "";
BA_ "EventCommandSignal" SG_ 532 SGU19_Object_dx 0;
BA_ "GatewayedSignals" SG_ 532 SGU19_Object_dx 0;
BA_ "GenSigInactiveValue" SG_ 532 SGU19_Object_dx 0;
BA_ "GenSigInvalidValue" SG_ 532 SGU19_Object_dx 0;
BA_ "GenSigSendType" SG_ 532 SGU19_Object_dx 1;
BA_ "GenSigStartValue" SG_ 532 SGU19_Object_dx 0;
BA_ "GenSigTimeoutValue" SG_ 532 SGU19_Object_dx 0;
BA_ "Remark" SG_ 532 SGU19_Object_dx "";
BA_ "EventCommandSignal" SG_ 532 SGU19_Object_dx_Rear 0;
BA_ "GatewayedSignals" SG_ 532 SGU19_Object_dx_Rear 0;
BA_ "GenSigInactiveValue" SG_ 532 SGU19_Object_dx_Rear 0;
BA_ "GenSigInvalidValue" SG_ 532 SGU19_Object_dx_Rear 0;
BA_ "GenSigSendType" SG_ 532 SGU19_Object_dx_Rear 1;
BA_ "GenSigStartValue" SG_ 532 SGU19_Object_dx_Rear 0;
BA_ "GenSigTimeoutValue" SG_ 532 SGU19_Object_dx_Rear 0;
BA_ "Remark" SG_ 532 SGU19_Object_dx_Rear "";
BA_ "EventCommandSignal" SG_ 532 SGU19_Object_dy 0;
BA_ "GatewayedSignals" SG_ 532 SGU19_Object_dy 0;
BA_ "GenSigInactiveValue" SG_ 532 SGU19_Object_dy 0;
BA_ "GenSigInvalidValue" SG_ 532 SGU19_Object_dy 0;
BA_ "GenSigSendType" SG_ 532 SGU19_Object_dy 1;
BA_ "GenSigStartValue" SG_ 532 SGU19_Object_dy 0;
BA_ "GenSigTimeoutValue" SG_ 532 SGU19_Object_dy 0;
BA_ "Remark" SG_ 532 SGU19_Object_dy "";
BA_ "EventCommandSignal" SG_ 532 SGU19_Object_dy_Rear 0;
BA_ "GatewayedSignals" SG_ 532 SGU19_Object_dy_Rear 0;
BA_ "GenSigInactiveValue" SG_ 532 SGU19_Object_dy_Rear 0;
BA_ "GenSigInvalidValue" SG_ 532 SGU19_Object_dy_Rear 0;
BA_ "GenSigSendType" SG_ 532 SGU19_Object_dy_Rear 1;
BA_ "GenSigStartValue" SG_ 532 SGU19_Object_dy_Rear 0;
BA_ "GenSigTimeoutValue" SG_ 532 SGU19_Object_dy_Rear 0;
BA_ "Remark" SG_ 532 SGU19_Object_dy_Rear "";
BA_ "EventCommandSignal" SG_ 532 SGU19_Object_vx 0;
BA_ "GatewayedSignals" SG_ 532 SGU19_Object_vx 0;
BA_ "GenSigInactiveValue" SG_ 532 SGU19_Object_vx 0;
BA_ "GenSigInvalidValue" SG_ 532 SGU19_Object_vx 0;
BA_ "GenSigSendType" SG_ 532 SGU19_Object_vx 1;
BA_ "GenSigStartValue" SG_ 532 SGU19_Object_vx 0;
BA_ "GenSigTimeoutValue" SG_ 532 SGU19_Object_vx 0;
BA_ "Remark" SG_ 532 SGU19_Object_vx "";
BA_ "EventCommandSignal" SG_ 532 SGU19_Object_vy 0;
BA_ "GatewayedSignals" SG_ 532 SGU19_Object_vy 0;
BA_ "GenSigInactiveValue" SG_ 532 SGU19_Object_vy 0;
BA_ "GenSigInvalidValue" SG_ 532 SGU19_Object_vy 0;
BA_ "GenSigSendType" SG_ 532 SGU19_Object_vy 1;
BA_ "GenSigStartValue" SG_ 532 SGU19_Object_vy 0;
BA_ "GenSigTimeoutValue" SG_ 532 SGU19_Object_vy 0;
BA_ "Remark" SG_ 532 SGU19_Object_vy "";
BA_ "EventCommandSignal" SG_ 532 SGU19_Object_wExist 0;
BA_ "GatewayedSignals" SG_ 532 SGU19_Object_wExist 0;
BA_ "GenSigInactiveValue" SG_ 532 SGU19_Object_wExist 0;
BA_ "GenSigInvalidValue" SG_ 532 SGU19_Object_wExist 0;
BA_ "GenSigSendType" SG_ 532 SGU19_Object_wExist 1;
BA_ "GenSigStartValue" SG_ 532 SGU19_Object_wExist 0;
BA_ "GenSigTimeoutValue" SG_ 532 SGU19_Object_wExist 0;
BA_ "Remark" SG_ 532 SGU19_Object_wExist "";
BA_ "EventCommandSignal" SG_ 532 SGU19_Object_wObstacle 0;
BA_ "GatewayedSignals" SG_ 532 SGU19_Object_wObstacle 0;
BA_ "GenSigInactiveValue" SG_ 532 SGU19_Object_wObstacle 0;
BA_ "GenSigInvalidValue" SG_ 532 SGU19_Object_wObstacle 0;
BA_ "GenSigSendType" SG_ 532 SGU19_Object_wObstacle 1;
BA_ "GenSigStartValue" SG_ 532 SGU19_Object_wObstacle 0;
BA_ "GenSigTimeoutValue" SG_ 532 SGU19_Object_wObstacle 0;
BA_ "Remark" SG_ 532 SGU19_Object_wObstacle "";
BA_ "EventCommandSignal" SG_ 533 SGU20_BlockCounter 0;
BA_ "GatewayedSignals" SG_ 533 SGU20_BlockCounter 0;
BA_ "GenSigInactiveValue" SG_ 533 SGU20_BlockCounter 0;
BA_ "GenSigInvalidValue" SG_ 533 SGU20_BlockCounter 0;
BA_ "GenSigSendType" SG_ 533 SGU20_BlockCounter 1;
BA_ "GenSigStartValue" SG_ 533 SGU20_BlockCounter 0;
BA_ "GenSigTimeoutValue" SG_ 533 SGU20_BlockCounter 0;
BA_ "Remark" SG_ 533 SGU20_BlockCounter "";
BA_ "EventCommandSignal" SG_ 533 SGU20_LifeCycles_OBJ 0;
BA_ "GatewayedSignals" SG_ 533 SGU20_LifeCycles_OBJ 0;
BA_ "GenSigInactiveValue" SG_ 533 SGU20_LifeCycles_OBJ 0;
BA_ "GenSigInvalidValue" SG_ 533 SGU20_LifeCycles_OBJ 0;
BA_ "GenSigSendType" SG_ 533 SGU20_LifeCycles_OBJ 1;
BA_ "GenSigStartValue" SG_ 533 SGU20_LifeCycles_OBJ 0;
BA_ "GenSigTimeoutValue" SG_ 533 SGU20_LifeCycles_OBJ 0;
BA_ "Remark" SG_ 533 SGU20_LifeCycles_OBJ "";
BA_ "EventCommandSignal" SG_ 533 SGU20_Msg_AliveCounter 0;
BA_ "GatewayedSignals" SG_ 533 SGU20_Msg_AliveCounter 0;
BA_ "GenSigInactiveValue" SG_ 533 SGU20_Msg_AliveCounter 0;
BA_ "GenSigInvalidValue" SG_ 533 SGU20_Msg_AliveCounter 0;
BA_ "GenSigSendType" SG_ 533 SGU20_Msg_AliveCounter 1;
BA_ "GenSigStartValue" SG_ 533 SGU20_Msg_AliveCounter 0;
BA_ "GenSigTimeoutValue" SG_ 533 SGU20_Msg_AliveCounter 0;
BA_ "Remark" SG_ 533 SGU20_Msg_AliveCounter "";
BA_ "EventCommandSignal" SG_ 533 SGU20_Msg_CheckSum 0;
BA_ "GatewayedSignals" SG_ 533 SGU20_Msg_CheckSum 0;
BA_ "GenSigInactiveValue" SG_ 533 SGU20_Msg_CheckSum 0;
BA_ "GenSigInvalidValue" SG_ 533 SGU20_Msg_CheckSum 0;
BA_ "GenSigSendType" SG_ 533 SGU20_Msg_CheckSum 1;
BA_ "GenSigStartValue" SG_ 533 SGU20_Msg_CheckSum 0;
BA_ "GenSigTimeoutValue" SG_ 533 SGU20_Msg_CheckSum 0;
BA_ "Remark" SG_ 533 SGU20_Msg_CheckSum "";
BA_ "EventCommandSignal" SG_ 533 SGU20_ObjRCS_20 0;
BA_ "GatewayedSignals" SG_ 533 SGU20_ObjRCS_20 0;
BA_ "GenSigInactiveValue" SG_ 533 SGU20_ObjRCS_20 0;
BA_ "GenSigInvalidValue" SG_ 533 SGU20_ObjRCS_20 0;
BA_ "GenSigSendType" SG_ 533 SGU20_ObjRCS_20 1;
BA_ "GenSigStartValue" SG_ 533 SGU20_ObjRCS_20 0;
BA_ "GenSigTimeoutValue" SG_ 533 SGU20_ObjRCS_20 0;
BA_ "Remark" SG_ 533 SGU20_ObjRCS_20 "";
BA_ "EventCommandSignal" SG_ 533 SGU20_Obj_DistLat_rms 0;
BA_ "GatewayedSignals" SG_ 533 SGU20_Obj_DistLat_rms 0;
BA_ "GenSigInactiveValue" SG_ 533 SGU20_Obj_DistLat_rms 0;
BA_ "GenSigInvalidValue" SG_ 533 SGU20_Obj_DistLat_rms 0;
BA_ "GenSigSendType" SG_ 533 SGU20_Obj_DistLat_rms 1;
BA_ "GenSigStartValue" SG_ 533 SGU20_Obj_DistLat_rms 0;
BA_ "GenSigTimeoutValue" SG_ 533 SGU20_Obj_DistLat_rms 0;
BA_ "Remark" SG_ 533 SGU20_Obj_DistLat_rms "";
BA_ "EventCommandSignal" SG_ 533 SGU20_Obj_VrelLong_rms 0;
BA_ "GatewayedSignals" SG_ 533 SGU20_Obj_VrelLong_rms 0;
BA_ "GenSigInactiveValue" SG_ 533 SGU20_Obj_VrelLong_rms 0;
BA_ "GenSigInvalidValue" SG_ 533 SGU20_Obj_VrelLong_rms 0;
BA_ "GenSigSendType" SG_ 533 SGU20_Obj_VrelLong_rms 1;
BA_ "GenSigStartValue" SG_ 533 SGU20_Obj_VrelLong_rms 0;
BA_ "GenSigTimeoutValue" SG_ 533 SGU20_Obj_VrelLong_rms 0;
BA_ "Remark" SG_ 533 SGU20_Obj_VrelLong_rms "";
BA_ "EventCommandSignal" SG_ 533 SGU20_Obj_Vrelat_rms 0;
BA_ "GatewayedSignals" SG_ 533 SGU20_Obj_Vrelat_rms 0;
BA_ "GenSigInactiveValue" SG_ 533 SGU20_Obj_Vrelat_rms 0;
BA_ "GenSigInvalidValue" SG_ 533 SGU20_Obj_Vrelat_rms 0;
BA_ "GenSigSendType" SG_ 533 SGU20_Obj_Vrelat_rms 1;
BA_ "GenSigStartValue" SG_ 533 SGU20_Obj_Vrelat_rms 0;
BA_ "GenSigTimeoutValue" SG_ 533 SGU20_Obj_Vrelat_rms 0;
BA_ "Remark" SG_ 533 SGU20_Obj_Vrelat_rms "";
BA_ "EventCommandSignal" SG_ 533 SGU20_Object_DetStatus 0;
BA_ "GatewayedSignals" SG_ 533 SGU20_Object_DetStatus 0;
BA_ "GenSigInactiveValue" SG_ 533 SGU20_Object_DetStatus 0;
BA_ "GenSigInvalidValue" SG_ 533 SGU20_Object_DetStatus 0;
BA_ "GenSigSendType" SG_ 533 SGU20_Object_DetStatus 1;
BA_ "GenSigStartValue" SG_ 533 SGU20_Object_DetStatus 0;
BA_ "GenSigTimeoutValue" SG_ 533 SGU20_Object_DetStatus 0;
BA_ "Remark" SG_ 533 SGU20_Object_DetStatus "";
BA_ "EventCommandSignal" SG_ 533 SGU20_Object_DistLong_rms 0;
BA_ "GatewayedSignals" SG_ 533 SGU20_Object_DistLong_rms 0;
BA_ "GenSigInactiveValue" SG_ 533 SGU20_Object_DistLong_rms 0;
BA_ "GenSigInvalidValue" SG_ 533 SGU20_Object_DistLong_rms 0;
BA_ "GenSigSendType" SG_ 533 SGU20_Object_DistLong_rms 1;
BA_ "GenSigStartValue" SG_ 533 SGU20_Object_DistLong_rms 0;
BA_ "GenSigTimeoutValue" SG_ 533 SGU20_Object_DistLong_rms 0;
BA_ "Remark" SG_ 533 SGU20_Object_DistLong_rms "";
BA_ "EventCommandSignal" SG_ 533 SGU20_Object_ID 0;
BA_ "GatewayedSignals" SG_ 533 SGU20_Object_ID 0;
BA_ "GenSigInactiveValue" SG_ 533 SGU20_Object_ID 0;
BA_ "GenSigInvalidValue" SG_ 533 SGU20_Object_ID 0;
BA_ "GenSigSendType" SG_ 533 SGU20_Object_ID 1;
BA_ "GenSigStartValue" SG_ 533 SGU20_Object_ID 0;
BA_ "GenSigTimeoutValue" SG_ 533 SGU20_Object_ID 0;
BA_ "Remark" SG_ 533 SGU20_Object_ID "";
BA_ "EventCommandSignal" SG_ 533 SGU20_Object_Motion_Pattern 0;
BA_ "GatewayedSignals" SG_ 533 SGU20_Object_Motion_Pattern 0;
BA_ "GenSigInactiveValue" SG_ 533 SGU20_Object_Motion_Pattern 0;
BA_ "GenSigInvalidValue" SG_ 533 SGU20_Object_Motion_Pattern 0;
BA_ "GenSigSendType" SG_ 533 SGU20_Object_Motion_Pattern 1;
BA_ "GenSigStartValue" SG_ 533 SGU20_Object_Motion_Pattern 0;
BA_ "GenSigTimeoutValue" SG_ 533 SGU20_Object_Motion_Pattern 0;
BA_ "Remark" SG_ 533 SGU20_Object_Motion_Pattern "";
BA_ "EventCommandSignal" SG_ 533 SGU20_Object_Type 0;
BA_ "GatewayedSignals" SG_ 533 SGU20_Object_Type 0;
BA_ "GenSigInactiveValue" SG_ 533 SGU20_Object_Type 0;
BA_ "GenSigInvalidValue" SG_ 533 SGU20_Object_Type 0;
BA_ "GenSigSendType" SG_ 533 SGU20_Object_Type 1;
BA_ "GenSigStartValue" SG_ 533 SGU20_Object_Type 0;
BA_ "GenSigTimeoutValue" SG_ 533 SGU20_Object_Type 0;
BA_ "Remark" SG_ 533 SGU20_Object_Type "";
BA_ "EventCommandSignal" SG_ 533 SGU20_Object_ax 0;
BA_ "GatewayedSignals" SG_ 533 SGU20_Object_ax 0;
BA_ "GenSigInactiveValue" SG_ 533 SGU20_Object_ax 0;
BA_ "GenSigInvalidValue" SG_ 533 SGU20_Object_ax 0;
BA_ "GenSigSendType" SG_ 533 SGU20_Object_ax 1;
BA_ "GenSigStartValue" SG_ 533 SGU20_Object_ax 0;
BA_ "GenSigTimeoutValue" SG_ 533 SGU20_Object_ax 0;
BA_ "Remark" SG_ 533 SGU20_Object_ax "";
BA_ "EventCommandSignal" SG_ 533 SGU20_Object_ay 0;
BA_ "GatewayedSignals" SG_ 533 SGU20_Object_ay 0;
BA_ "GenSigInactiveValue" SG_ 533 SGU20_Object_ay 0;
BA_ "GenSigInvalidValue" SG_ 533 SGU20_Object_ay 0;
BA_ "GenSigSendType" SG_ 533 SGU20_Object_ay 1;
BA_ "GenSigStartValue" SG_ 533 SGU20_Object_ay 0;
BA_ "GenSigTimeoutValue" SG_ 533 SGU20_Object_ay 0;
BA_ "Remark" SG_ 533 SGU20_Object_ay "";
BA_ "EventCommandSignal" SG_ 533 SGU20_Object_dx 0;
BA_ "GatewayedSignals" SG_ 533 SGU20_Object_dx 0;
BA_ "GenSigInactiveValue" SG_ 533 SGU20_Object_dx 0;
BA_ "GenSigInvalidValue" SG_ 533 SGU20_Object_dx 0;
BA_ "GenSigSendType" SG_ 533 SGU20_Object_dx 1;
BA_ "GenSigStartValue" SG_ 533 SGU20_Object_dx 0;
BA_ "GenSigTimeoutValue" SG_ 533 SGU20_Object_dx 0;
BA_ "Remark" SG_ 533 SGU20_Object_dx "";
BA_ "EventCommandSignal" SG_ 533 SGU20_Object_dx_Rear 0;
BA_ "GatewayedSignals" SG_ 533 SGU20_Object_dx_Rear 0;
BA_ "GenSigInactiveValue" SG_ 533 SGU20_Object_dx_Rear 0;
BA_ "GenSigInvalidValue" SG_ 533 SGU20_Object_dx_Rear 0;
BA_ "GenSigSendType" SG_ 533 SGU20_Object_dx_Rear 1;
BA_ "GenSigStartValue" SG_ 533 SGU20_Object_dx_Rear 0;
BA_ "GenSigTimeoutValue" SG_ 533 SGU20_Object_dx_Rear 0;
BA_ "Remark" SG_ 533 SGU20_Object_dx_Rear "";
BA_ "EventCommandSignal" SG_ 533 SGU20_Object_dy 0;
BA_ "GatewayedSignals" SG_ 533 SGU20_Object_dy 0;
BA_ "GenSigInactiveValue" SG_ 533 SGU20_Object_dy 0;
BA_ "GenSigInvalidValue" SG_ 533 SGU20_Object_dy 0;
BA_ "GenSigSendType" SG_ 533 SGU20_Object_dy 1;
BA_ "GenSigStartValue" SG_ 533 SGU20_Object_dy 0;
BA_ "GenSigTimeoutValue" SG_ 533 SGU20_Object_dy 0;
BA_ "Remark" SG_ 533 SGU20_Object_dy "";
BA_ "EventCommandSignal" SG_ 533 SGU20_Object_dy_Rear 0;
BA_ "GatewayedSignals" SG_ 533 SGU20_Object_dy_Rear 0;
BA_ "GenSigInactiveValue" SG_ 533 SGU20_Object_dy_Rear 0;
BA_ "GenSigInvalidValue" SG_ 533 SGU20_Object_dy_Rear 0;
BA_ "GenSigSendType" SG_ 533 SGU20_Object_dy_Rear 1;
BA_ "GenSigStartValue" SG_ 533 SGU20_Object_dy_Rear 0;
BA_ "GenSigTimeoutValue" SG_ 533 SGU20_Object_dy_Rear 0;
BA_ "Remark" SG_ 533 SGU20_Object_dy_Rear "";
BA_ "EventCommandSignal" SG_ 533 SGU20_Object_vx 0;
BA_ "GatewayedSignals" SG_ 533 SGU20_Object_vx 0;
BA_ "GenSigInactiveValue" SG_ 533 SGU20_Object_vx 0;
BA_ "GenSigInvalidValue" SG_ 533 SGU20_Object_vx 0;
BA_ "GenSigSendType" SG_ 533 SGU20_Object_vx 1;
BA_ "GenSigStartValue" SG_ 533 SGU20_Object_vx 0;
BA_ "GenSigTimeoutValue" SG_ 533 SGU20_Object_vx 0;
BA_ "Remark" SG_ 533 SGU20_Object_vx "";
BA_ "EventCommandSignal" SG_ 533 SGU20_Object_vy 0;
BA_ "GatewayedSignals" SG_ 533 SGU20_Object_vy 0;
BA_ "GenSigInactiveValue" SG_ 533 SGU20_Object_vy 0;
BA_ "GenSigInvalidValue" SG_ 533 SGU20_Object_vy 0;
BA_ "GenSigSendType" SG_ 533 SGU20_Object_vy 1;
BA_ "GenSigStartValue" SG_ 533 SGU20_Object_vy 0;
BA_ "GenSigTimeoutValue" SG_ 533 SGU20_Object_vy 0;
BA_ "Remark" SG_ 533 SGU20_Object_vy "";
BA_ "EventCommandSignal" SG_ 533 SGU20_Object_wExist 0;
BA_ "GatewayedSignals" SG_ 533 SGU20_Object_wExist 0;
BA_ "GenSigInactiveValue" SG_ 533 SGU20_Object_wExist 0;
BA_ "GenSigInvalidValue" SG_ 533 SGU20_Object_wExist 0;
BA_ "GenSigSendType" SG_ 533 SGU20_Object_wExist 1;
BA_ "GenSigStartValue" SG_ 533 SGU20_Object_wExist 0;
BA_ "GenSigTimeoutValue" SG_ 533 SGU20_Object_wExist 0;
BA_ "Remark" SG_ 533 SGU20_Object_wExist "";
BA_ "EventCommandSignal" SG_ 533 SGU20_Object_wObstacle 0;
BA_ "GatewayedSignals" SG_ 533 SGU20_Object_wObstacle 0;
BA_ "GenSigInactiveValue" SG_ 533 SGU20_Object_wObstacle 0;
BA_ "GenSigInvalidValue" SG_ 533 SGU20_Object_wObstacle 0;
BA_ "GenSigSendType" SG_ 533 SGU20_Object_wObstacle 1;
BA_ "GenSigStartValue" SG_ 533 SGU20_Object_wObstacle 0;
BA_ "GenSigTimeoutValue" SG_ 533 SGU20_Object_wObstacle 0;
BA_ "Remark" SG_ 533 SGU20_Object_wObstacle "";
BA_ "EventCommandSignal" SG_ 534 SGU21_BlockCounter 0;
BA_ "GatewayedSignals" SG_ 534 SGU21_BlockCounter 0;
BA_ "GenSigInactiveValue" SG_ 534 SGU21_BlockCounter 0;
BA_ "GenSigInvalidValue" SG_ 534 SGU21_BlockCounter 0;
BA_ "GenSigSendType" SG_ 534 SGU21_BlockCounter 1;
BA_ "GenSigStartValue" SG_ 534 SGU21_BlockCounter 0;
BA_ "GenSigTimeoutValue" SG_ 534 SGU21_BlockCounter 0;
BA_ "Remark" SG_ 534 SGU21_BlockCounter "";
BA_ "EventCommandSignal" SG_ 534 SGU21_LifeCycles_OBJ 0;
BA_ "GatewayedSignals" SG_ 534 SGU21_LifeCycles_OBJ 0;
BA_ "GenSigInactiveValue" SG_ 534 SGU21_LifeCycles_OBJ 0;
BA_ "GenSigInvalidValue" SG_ 534 SGU21_LifeCycles_OBJ 0;
BA_ "GenSigSendType" SG_ 534 SGU21_LifeCycles_OBJ 1;
BA_ "GenSigStartValue" SG_ 534 SGU21_LifeCycles_OBJ 0;
BA_ "GenSigTimeoutValue" SG_ 534 SGU21_LifeCycles_OBJ 0;
BA_ "Remark" SG_ 534 SGU21_LifeCycles_OBJ "";
BA_ "EventCommandSignal" SG_ 534 SGU21_Msg_AliveCounter 0;
BA_ "GatewayedSignals" SG_ 534 SGU21_Msg_AliveCounter 0;
BA_ "GenSigInactiveValue" SG_ 534 SGU21_Msg_AliveCounter 0;
BA_ "GenSigInvalidValue" SG_ 534 SGU21_Msg_AliveCounter 0;
BA_ "GenSigSendType" SG_ 534 SGU21_Msg_AliveCounter 1;
BA_ "GenSigStartValue" SG_ 534 SGU21_Msg_AliveCounter 0;
BA_ "GenSigTimeoutValue" SG_ 534 SGU21_Msg_AliveCounter 0;
BA_ "Remark" SG_ 534 SGU21_Msg_AliveCounter "";
BA_ "EventCommandSignal" SG_ 534 SGU21_Msg_CheckSum 0;
BA_ "GatewayedSignals" SG_ 534 SGU21_Msg_CheckSum 0;
BA_ "GenSigInactiveValue" SG_ 534 SGU21_Msg_CheckSum 0;
BA_ "GenSigInvalidValue" SG_ 534 SGU21_Msg_CheckSum 0;
BA_ "GenSigSendType" SG_ 534 SGU21_Msg_CheckSum 1;
BA_ "GenSigStartValue" SG_ 534 SGU21_Msg_CheckSum 0;
BA_ "GenSigTimeoutValue" SG_ 534 SGU21_Msg_CheckSum 0;
BA_ "Remark" SG_ 534 SGU21_Msg_CheckSum "";
BA_ "EventCommandSignal" SG_ 534 SGU21_ObjRCS_21 0;
BA_ "GatewayedSignals" SG_ 534 SGU21_ObjRCS_21 0;
BA_ "GenSigInactiveValue" SG_ 534 SGU21_ObjRCS_21 0;
BA_ "GenSigInvalidValue" SG_ 534 SGU21_ObjRCS_21 0;
BA_ "GenSigSendType" SG_ 534 SGU21_ObjRCS_21 1;
BA_ "GenSigStartValue" SG_ 534 SGU21_ObjRCS_21 0;
BA_ "GenSigTimeoutValue" SG_ 534 SGU21_ObjRCS_21 0;
BA_ "Remark" SG_ 534 SGU21_ObjRCS_21 "";
BA_ "EventCommandSignal" SG_ 534 SGU21_Obj_DistLat_rms 0;
BA_ "GatewayedSignals" SG_ 534 SGU21_Obj_DistLat_rms 0;
BA_ "GenSigInactiveValue" SG_ 534 SGU21_Obj_DistLat_rms 0;
BA_ "GenSigInvalidValue" SG_ 534 SGU21_Obj_DistLat_rms 0;
BA_ "GenSigSendType" SG_ 534 SGU21_Obj_DistLat_rms 1;
BA_ "GenSigStartValue" SG_ 534 SGU21_Obj_DistLat_rms 0;
BA_ "GenSigTimeoutValue" SG_ 534 SGU21_Obj_DistLat_rms 0;
BA_ "Remark" SG_ 534 SGU21_Obj_DistLat_rms "";
BA_ "EventCommandSignal" SG_ 534 SGU21_Obj_VrelLong_rms 0;
BA_ "GatewayedSignals" SG_ 534 SGU21_Obj_VrelLong_rms 0;
BA_ "GenSigInactiveValue" SG_ 534 SGU21_Obj_VrelLong_rms 0;
BA_ "GenSigInvalidValue" SG_ 534 SGU21_Obj_VrelLong_rms 0;
BA_ "GenSigSendType" SG_ 534 SGU21_Obj_VrelLong_rms 1;
BA_ "GenSigStartValue" SG_ 534 SGU21_Obj_VrelLong_rms 0;
BA_ "GenSigTimeoutValue" SG_ 534 SGU21_Obj_VrelLong_rms 0;
BA_ "Remark" SG_ 534 SGU21_Obj_VrelLong_rms "";
BA_ "EventCommandSignal" SG_ 534 SGU21_Obj_Vrelat_rms 0;
BA_ "GatewayedSignals" SG_ 534 SGU21_Obj_Vrelat_rms 0;
BA_ "GenSigInactiveValue" SG_ 534 SGU21_Obj_Vrelat_rms 0;
BA_ "GenSigInvalidValue" SG_ 534 SGU21_Obj_Vrelat_rms 0;
BA_ "GenSigSendType" SG_ 534 SGU21_Obj_Vrelat_rms 1;
BA_ "GenSigStartValue" SG_ 534 SGU21_Obj_Vrelat_rms 0;
BA_ "GenSigTimeoutValue" SG_ 534 SGU21_Obj_Vrelat_rms 0;
BA_ "Remark" SG_ 534 SGU21_Obj_Vrelat_rms "";
BA_ "EventCommandSignal" SG_ 534 SGU21_Object_DetStatus 0;
BA_ "GatewayedSignals" SG_ 534 SGU21_Object_DetStatus 0;
BA_ "GenSigInactiveValue" SG_ 534 SGU21_Object_DetStatus 0;
BA_ "GenSigInvalidValue" SG_ 534 SGU21_Object_DetStatus 0;
BA_ "GenSigSendType" SG_ 534 SGU21_Object_DetStatus 1;
BA_ "GenSigStartValue" SG_ 534 SGU21_Object_DetStatus 0;
BA_ "GenSigTimeoutValue" SG_ 534 SGU21_Object_DetStatus 0;
BA_ "Remark" SG_ 534 SGU21_Object_DetStatus "";
BA_ "EventCommandSignal" SG_ 534 SGU21_Object_DistLong_rms 0;
BA_ "GatewayedSignals" SG_ 534 SGU21_Object_DistLong_rms 0;
BA_ "GenSigInactiveValue" SG_ 534 SGU21_Object_DistLong_rms 0;
BA_ "GenSigInvalidValue" SG_ 534 SGU21_Object_DistLong_rms 0;
BA_ "GenSigSendType" SG_ 534 SGU21_Object_DistLong_rms 1;
BA_ "GenSigStartValue" SG_ 534 SGU21_Object_DistLong_rms 0;
BA_ "GenSigTimeoutValue" SG_ 534 SGU21_Object_DistLong_rms 0;
BA_ "Remark" SG_ 534 SGU21_Object_DistLong_rms "";
BA_ "EventCommandSignal" SG_ 534 SGU21_Object_ID 0;
BA_ "GatewayedSignals" SG_ 534 SGU21_Object_ID 0;
BA_ "GenSigInactiveValue" SG_ 534 SGU21_Object_ID 0;
BA_ "GenSigInvalidValue" SG_ 534 SGU21_Object_ID 0;
BA_ "GenSigSendType" SG_ 534 SGU21_Object_ID 1;
BA_ "GenSigStartValue" SG_ 534 SGU21_Object_ID 0;
BA_ "GenSigTimeoutValue" SG_ 534 SGU21_Object_ID 0;
BA_ "Remark" SG_ 534 SGU21_Object_ID "";
BA_ "EventCommandSignal" SG_ 534 SGU21_Object_Motion_Pattern 0;
BA_ "GatewayedSignals" SG_ 534 SGU21_Object_Motion_Pattern 0;
BA_ "GenSigInactiveValue" SG_ 534 SGU21_Object_Motion_Pattern 0;
BA_ "GenSigInvalidValue" SG_ 534 SGU21_Object_Motion_Pattern 0;
BA_ "GenSigSendType" SG_ 534 SGU21_Object_Motion_Pattern 1;
BA_ "GenSigStartValue" SG_ 534 SGU21_Object_Motion_Pattern 0;
BA_ "GenSigTimeoutValue" SG_ 534 SGU21_Object_Motion_Pattern 0;
BA_ "Remark" SG_ 534 SGU21_Object_Motion_Pattern "";
BA_ "EventCommandSignal" SG_ 534 SGU21_Object_Type 0;
BA_ "GatewayedSignals" SG_ 534 SGU21_Object_Type 0;
BA_ "GenSigInactiveValue" SG_ 534 SGU21_Object_Type 0;
BA_ "GenSigInvalidValue" SG_ 534 SGU21_Object_Type 0;
BA_ "GenSigSendType" SG_ 534 SGU21_Object_Type 1;
BA_ "GenSigStartValue" SG_ 534 SGU21_Object_Type 0;
BA_ "GenSigTimeoutValue" SG_ 534 SGU21_Object_Type 0;
BA_ "Remark" SG_ 534 SGU21_Object_Type "";
BA_ "EventCommandSignal" SG_ 534 SGU21_Object_ax 0;
BA_ "GatewayedSignals" SG_ 534 SGU21_Object_ax 0;
BA_ "GenSigInactiveValue" SG_ 534 SGU21_Object_ax 0;
BA_ "GenSigInvalidValue" SG_ 534 SGU21_Object_ax 0;
BA_ "GenSigSendType" SG_ 534 SGU21_Object_ax 1;
BA_ "GenSigStartValue" SG_ 534 SGU21_Object_ax 0;
BA_ "GenSigTimeoutValue" SG_ 534 SGU21_Object_ax 0;
BA_ "Remark" SG_ 534 SGU21_Object_ax "";
BA_ "EventCommandSignal" SG_ 534 SGU21_Object_ay 0;
BA_ "GatewayedSignals" SG_ 534 SGU21_Object_ay 0;
BA_ "GenSigInactiveValue" SG_ 534 SGU21_Object_ay 0;
BA_ "GenSigInvalidValue" SG_ 534 SGU21_Object_ay 0;
BA_ "GenSigSendType" SG_ 534 SGU21_Object_ay 1;
BA_ "GenSigStartValue" SG_ 534 SGU21_Object_ay 0;
BA_ "GenSigTimeoutValue" SG_ 534 SGU21_Object_ay 0;
BA_ "Remark" SG_ 534 SGU21_Object_ay "";
BA_ "EventCommandSignal" SG_ 534 SGU21_Object_dx 0;
BA_ "GatewayedSignals" SG_ 534 SGU21_Object_dx 0;
BA_ "GenSigInactiveValue" SG_ 534 SGU21_Object_dx 0;
BA_ "GenSigInvalidValue" SG_ 534 SGU21_Object_dx 0;
BA_ "GenSigSendType" SG_ 534 SGU21_Object_dx 1;
BA_ "GenSigStartValue" SG_ 534 SGU21_Object_dx 0;
BA_ "GenSigTimeoutValue" SG_ 534 SGU21_Object_dx 0;
BA_ "Remark" SG_ 534 SGU21_Object_dx "";
BA_ "EventCommandSignal" SG_ 534 SGU21_Object_dx_Rear 0;
BA_ "GatewayedSignals" SG_ 534 SGU21_Object_dx_Rear 0;
BA_ "GenSigInactiveValue" SG_ 534 SGU21_Object_dx_Rear 0;
BA_ "GenSigInvalidValue" SG_ 534 SGU21_Object_dx_Rear 0;
BA_ "GenSigSendType" SG_ 534 SGU21_Object_dx_Rear 1;
BA_ "GenSigStartValue" SG_ 534 SGU21_Object_dx_Rear 0;
BA_ "GenSigTimeoutValue" SG_ 534 SGU21_Object_dx_Rear 0;
BA_ "Remark" SG_ 534 SGU21_Object_dx_Rear "";
BA_ "EventCommandSignal" SG_ 534 SGU21_Object_dy 0;
BA_ "GatewayedSignals" SG_ 534 SGU21_Object_dy 0;
BA_ "GenSigInactiveValue" SG_ 534 SGU21_Object_dy 0;
BA_ "GenSigInvalidValue" SG_ 534 SGU21_Object_dy 0;
BA_ "GenSigSendType" SG_ 534 SGU21_Object_dy 1;
BA_ "GenSigStartValue" SG_ 534 SGU21_Object_dy 0;
BA_ "GenSigTimeoutValue" SG_ 534 SGU21_Object_dy 0;
BA_ "Remark" SG_ 534 SGU21_Object_dy "";
BA_ "EventCommandSignal" SG_ 534 SGU21_Object_dy_Rear 0;
BA_ "GatewayedSignals" SG_ 534 SGU21_Object_dy_Rear 0;
BA_ "GenSigInactiveValue" SG_ 534 SGU21_Object_dy_Rear 0;
BA_ "GenSigInvalidValue" SG_ 534 SGU21_Object_dy_Rear 0;
BA_ "GenSigSendType" SG_ 534 SGU21_Object_dy_Rear 1;
BA_ "GenSigStartValue" SG_ 534 SGU21_Object_dy_Rear 0;
BA_ "GenSigTimeoutValue" SG_ 534 SGU21_Object_dy_Rear 0;
BA_ "Remark" SG_ 534 SGU21_Object_dy_Rear "";
BA_ "EventCommandSignal" SG_ 534 SGU21_Object_vx 0;
BA_ "GatewayedSignals" SG_ 534 SGU21_Object_vx 0;
BA_ "GenSigInactiveValue" SG_ 534 SGU21_Object_vx 0;
BA_ "GenSigInvalidValue" SG_ 534 SGU21_Object_vx 0;
BA_ "GenSigSendType" SG_ 534 SGU21_Object_vx 1;
BA_ "GenSigStartValue" SG_ 534 SGU21_Object_vx 0;
BA_ "GenSigTimeoutValue" SG_ 534 SGU21_Object_vx 0;
BA_ "Remark" SG_ 534 SGU21_Object_vx "";
BA_ "EventCommandSignal" SG_ 534 SGU21_Object_vy 0;
BA_ "GatewayedSignals" SG_ 534 SGU21_Object_vy 0;
BA_ "GenSigInactiveValue" SG_ 534 SGU21_Object_vy 0;
BA_ "GenSigInvalidValue" SG_ 534 SGU21_Object_vy 0;
BA_ "GenSigSendType" SG_ 534 SGU21_Object_vy 1;
BA_ "GenSigStartValue" SG_ 534 SGU21_Object_vy 0;
BA_ "GenSigTimeoutValue" SG_ 534 SGU21_Object_vy 0;
BA_ "Remark" SG_ 534 SGU21_Object_vy "";
BA_ "EventCommandSignal" SG_ 534 SGU21_Object_wExist 0;
BA_ "GatewayedSignals" SG_ 534 SGU21_Object_wExist 0;
BA_ "GenSigInactiveValue" SG_ 534 SGU21_Object_wExist 0;
BA_ "GenSigInvalidValue" SG_ 534 SGU21_Object_wExist 0;
BA_ "GenSigSendType" SG_ 534 SGU21_Object_wExist 1;
BA_ "GenSigStartValue" SG_ 534 SGU21_Object_wExist 0;
BA_ "GenSigTimeoutValue" SG_ 534 SGU21_Object_wExist 0;
BA_ "Remark" SG_ 534 SGU21_Object_wExist "";
BA_ "EventCommandSignal" SG_ 534 SGU21_Object_wObstacle 0;
BA_ "GatewayedSignals" SG_ 534 SGU21_Object_wObstacle 0;
BA_ "GenSigInactiveValue" SG_ 534 SGU21_Object_wObstacle 0;
BA_ "GenSigInvalidValue" SG_ 534 SGU21_Object_wObstacle 0;
BA_ "GenSigSendType" SG_ 534 SGU21_Object_wObstacle 1;
BA_ "GenSigStartValue" SG_ 534 SGU21_Object_wObstacle 0;
BA_ "GenSigTimeoutValue" SG_ 534 SGU21_Object_wObstacle 0;
BA_ "Remark" SG_ 534 SGU21_Object_wObstacle "";
BA_ "EventCommandSignal" SG_ 535 SGU22_BlockCounter 0;
BA_ "GatewayedSignals" SG_ 535 SGU22_BlockCounter 0;
BA_ "GenSigInactiveValue" SG_ 535 SGU22_BlockCounter 0;
BA_ "GenSigInvalidValue" SG_ 535 SGU22_BlockCounter 0;
BA_ "GenSigSendType" SG_ 535 SGU22_BlockCounter 1;
BA_ "GenSigStartValue" SG_ 535 SGU22_BlockCounter 0;
BA_ "GenSigTimeoutValue" SG_ 535 SGU22_BlockCounter 0;
BA_ "Remark" SG_ 535 SGU22_BlockCounter "";
BA_ "EventCommandSignal" SG_ 535 SGU22_LifeCycles_OBJ 0;
BA_ "GatewayedSignals" SG_ 535 SGU22_LifeCycles_OBJ 0;
BA_ "GenSigInactiveValue" SG_ 535 SGU22_LifeCycles_OBJ 0;
BA_ "GenSigInvalidValue" SG_ 535 SGU22_LifeCycles_OBJ 0;
BA_ "GenSigSendType" SG_ 535 SGU22_LifeCycles_OBJ 1;
BA_ "GenSigStartValue" SG_ 535 SGU22_LifeCycles_OBJ 0;
BA_ "GenSigTimeoutValue" SG_ 535 SGU22_LifeCycles_OBJ 0;
BA_ "Remark" SG_ 535 SGU22_LifeCycles_OBJ "";
BA_ "EventCommandSignal" SG_ 535 SGU22_Msg_AliveCounter 0;
BA_ "GatewayedSignals" SG_ 535 SGU22_Msg_AliveCounter 0;
BA_ "GenSigInactiveValue" SG_ 535 SGU22_Msg_AliveCounter 0;
BA_ "GenSigInvalidValue" SG_ 535 SGU22_Msg_AliveCounter 0;
BA_ "GenSigSendType" SG_ 535 SGU22_Msg_AliveCounter 1;
BA_ "GenSigStartValue" SG_ 535 SGU22_Msg_AliveCounter 0;
BA_ "GenSigTimeoutValue" SG_ 535 SGU22_Msg_AliveCounter 0;
BA_ "Remark" SG_ 535 SGU22_Msg_AliveCounter "";
BA_ "EventCommandSignal" SG_ 535 SGU22_Msg_CheckSum 0;
BA_ "GatewayedSignals" SG_ 535 SGU22_Msg_CheckSum 0;
BA_ "GenSigInactiveValue" SG_ 535 SGU22_Msg_CheckSum 0;
BA_ "GenSigInvalidValue" SG_ 535 SGU22_Msg_CheckSum 0;
BA_ "GenSigSendType" SG_ 535 SGU22_Msg_CheckSum 1;
BA_ "GenSigStartValue" SG_ 535 SGU22_Msg_CheckSum 0;
BA_ "GenSigTimeoutValue" SG_ 535 SGU22_Msg_CheckSum 0;
BA_ "Remark" SG_ 535 SGU22_Msg_CheckSum "";
BA_ "EventCommandSignal" SG_ 535 SGU22_ObjRCS_22 0;
BA_ "GatewayedSignals" SG_ 535 SGU22_ObjRCS_22 0;
BA_ "GenSigInactiveValue" SG_ 535 SGU22_ObjRCS_22 0;
BA_ "GenSigInvalidValue" SG_ 535 SGU22_ObjRCS_22 0;
BA_ "GenSigSendType" SG_ 535 SGU22_ObjRCS_22 1;
BA_ "GenSigStartValue" SG_ 535 SGU22_ObjRCS_22 0;
BA_ "GenSigTimeoutValue" SG_ 535 SGU22_ObjRCS_22 0;
BA_ "Remark" SG_ 535 SGU22_ObjRCS_22 "";
BA_ "EventCommandSignal" SG_ 535 SGU22_Obj_DistLat_rms 0;
BA_ "GatewayedSignals" SG_ 535 SGU22_Obj_DistLat_rms 0;
BA_ "GenSigInactiveValue" SG_ 535 SGU22_Obj_DistLat_rms 0;
BA_ "GenSigInvalidValue" SG_ 535 SGU22_Obj_DistLat_rms 0;
BA_ "GenSigSendType" SG_ 535 SGU22_Obj_DistLat_rms 1;
BA_ "GenSigStartValue" SG_ 535 SGU22_Obj_DistLat_rms 0;
BA_ "GenSigTimeoutValue" SG_ 535 SGU22_Obj_DistLat_rms 0;
BA_ "Remark" SG_ 535 SGU22_Obj_DistLat_rms "";
BA_ "EventCommandSignal" SG_ 535 SGU22_Obj_VrelLong_rms 0;
BA_ "GatewayedSignals" SG_ 535 SGU22_Obj_VrelLong_rms 0;
BA_ "GenSigInactiveValue" SG_ 535 SGU22_Obj_VrelLong_rms 0;
BA_ "GenSigInvalidValue" SG_ 535 SGU22_Obj_VrelLong_rms 0;
BA_ "GenSigSendType" SG_ 535 SGU22_Obj_VrelLong_rms 1;
BA_ "GenSigStartValue" SG_ 535 SGU22_Obj_VrelLong_rms 0;
BA_ "GenSigTimeoutValue" SG_ 535 SGU22_Obj_VrelLong_rms 0;
BA_ "Remark" SG_ 535 SGU22_Obj_VrelLong_rms "";
BA_ "EventCommandSignal" SG_ 535 SGU22_Obj_Vrelat_rms 0;
BA_ "GatewayedSignals" SG_ 535 SGU22_Obj_Vrelat_rms 0;
BA_ "GenSigInactiveValue" SG_ 535 SGU22_Obj_Vrelat_rms 0;
BA_ "GenSigInvalidValue" SG_ 535 SGU22_Obj_Vrelat_rms 0;
BA_ "GenSigSendType" SG_ 535 SGU22_Obj_Vrelat_rms 1;
BA_ "GenSigStartValue" SG_ 535 SGU22_Obj_Vrelat_rms 0;
BA_ "GenSigTimeoutValue" SG_ 535 SGU22_Obj_Vrelat_rms 0;
BA_ "Remark" SG_ 535 SGU22_Obj_Vrelat_rms "";
BA_ "EventCommandSignal" SG_ 535 SGU22_Object_DetStatus 0;
BA_ "GatewayedSignals" SG_ 535 SGU22_Object_DetStatus 0;
BA_ "GenSigInactiveValue" SG_ 535 SGU22_Object_DetStatus 0;
BA_ "GenSigInvalidValue" SG_ 535 SGU22_Object_DetStatus 0;
BA_ "GenSigSendType" SG_ 535 SGU22_Object_DetStatus 1;
BA_ "GenSigStartValue" SG_ 535 SGU22_Object_DetStatus 0;
BA_ "GenSigTimeoutValue" SG_ 535 SGU22_Object_DetStatus 0;
BA_ "Remark" SG_ 535 SGU22_Object_DetStatus "";
BA_ "EventCommandSignal" SG_ 535 SGU22_Object_DistLong_rms 0;
BA_ "GatewayedSignals" SG_ 535 SGU22_Object_DistLong_rms 0;
BA_ "GenSigInactiveValue" SG_ 535 SGU22_Object_DistLong_rms 0;
BA_ "GenSigInvalidValue" SG_ 535 SGU22_Object_DistLong_rms 0;
BA_ "GenSigSendType" SG_ 535 SGU22_Object_DistLong_rms 1;
BA_ "GenSigStartValue" SG_ 535 SGU22_Object_DistLong_rms 0;
BA_ "GenSigTimeoutValue" SG_ 535 SGU22_Object_DistLong_rms 0;
BA_ "Remark" SG_ 535 SGU22_Object_DistLong_rms "";
BA_ "EventCommandSignal" SG_ 535 SGU22_Object_ID 0;
BA_ "GatewayedSignals" SG_ 535 SGU22_Object_ID 0;
BA_ "GenSigInactiveValue" SG_ 535 SGU22_Object_ID 0;
BA_ "GenSigInvalidValue" SG_ 535 SGU22_Object_ID 0;
BA_ "GenSigSendType" SG_ 535 SGU22_Object_ID 1;
BA_ "GenSigStartValue" SG_ 535 SGU22_Object_ID 0;
BA_ "GenSigTimeoutValue" SG_ 535 SGU22_Object_ID 0;
BA_ "Remark" SG_ 535 SGU22_Object_ID "";
BA_ "EventCommandSignal" SG_ 535 SGU22_Object_Motion_Pattern 0;
BA_ "GatewayedSignals" SG_ 535 SGU22_Object_Motion_Pattern 0;
BA_ "GenSigInactiveValue" SG_ 535 SGU22_Object_Motion_Pattern 0;
BA_ "GenSigInvalidValue" SG_ 535 SGU22_Object_Motion_Pattern 0;
BA_ "GenSigSendType" SG_ 535 SGU22_Object_Motion_Pattern 1;
BA_ "GenSigStartValue" SG_ 535 SGU22_Object_Motion_Pattern 0;
BA_ "GenSigTimeoutValue" SG_ 535 SGU22_Object_Motion_Pattern 0;
BA_ "Remark" SG_ 535 SGU22_Object_Motion_Pattern "";
BA_ "EventCommandSignal" SG_ 535 SGU22_Object_Type 0;
BA_ "GatewayedSignals" SG_ 535 SGU22_Object_Type 0;
BA_ "GenSigInactiveValue" SG_ 535 SGU22_Object_Type 0;
BA_ "GenSigInvalidValue" SG_ 535 SGU22_Object_Type 0;
BA_ "GenSigSendType" SG_ 535 SGU22_Object_Type 1;
BA_ "GenSigStartValue" SG_ 535 SGU22_Object_Type 0;
BA_ "GenSigTimeoutValue" SG_ 535 SGU22_Object_Type 0;
BA_ "Remark" SG_ 535 SGU22_Object_Type "";
BA_ "EventCommandSignal" SG_ 535 SGU22_Object_ax 0;
BA_ "GatewayedSignals" SG_ 535 SGU22_Object_ax 0;
BA_ "GenSigInactiveValue" SG_ 535 SGU22_Object_ax 0;
BA_ "GenSigInvalidValue" SG_ 535 SGU22_Object_ax 0;
BA_ "GenSigSendType" SG_ 535 SGU22_Object_ax 1;
BA_ "GenSigStartValue" SG_ 535 SGU22_Object_ax 0;
BA_ "GenSigTimeoutValue" SG_ 535 SGU22_Object_ax 0;
BA_ "Remark" SG_ 535 SGU22_Object_ax "";
BA_ "EventCommandSignal" SG_ 535 SGU22_Object_ay 0;
BA_ "GatewayedSignals" SG_ 535 SGU22_Object_ay 0;
BA_ "GenSigInactiveValue" SG_ 535 SGU22_Object_ay 0;
BA_ "GenSigInvalidValue" SG_ 535 SGU22_Object_ay 0;
BA_ "GenSigSendType" SG_ 535 SGU22_Object_ay 1;
BA_ "GenSigStartValue" SG_ 535 SGU22_Object_ay 0;
BA_ "GenSigTimeoutValue" SG_ 535 SGU22_Object_ay 0;
BA_ "Remark" SG_ 535 SGU22_Object_ay "";
BA_ "EventCommandSignal" SG_ 535 SGU22_Object_dx 0;
BA_ "GatewayedSignals" SG_ 535 SGU22_Object_dx 0;
BA_ "GenSigInactiveValue" SG_ 535 SGU22_Object_dx 0;
BA_ "GenSigInvalidValue" SG_ 535 SGU22_Object_dx 0;
BA_ "GenSigSendType" SG_ 535 SGU22_Object_dx 1;
BA_ "GenSigStartValue" SG_ 535 SGU22_Object_dx 0;
BA_ "GenSigTimeoutValue" SG_ 535 SGU22_Object_dx 0;
BA_ "Remark" SG_ 535 SGU22_Object_dx "";
BA_ "EventCommandSignal" SG_ 535 SGU22_Object_dx_Rear 0;
BA_ "GatewayedSignals" SG_ 535 SGU22_Object_dx_Rear 0;
BA_ "GenSigInactiveValue" SG_ 535 SGU22_Object_dx_Rear 0;
BA_ "GenSigInvalidValue" SG_ 535 SGU22_Object_dx_Rear 0;
BA_ "GenSigSendType" SG_ 535 SGU22_Object_dx_Rear 1;
BA_ "GenSigStartValue" SG_ 535 SGU22_Object_dx_Rear 0;
BA_ "GenSigTimeoutValue" SG_ 535 SGU22_Object_dx_Rear 0;
BA_ "Remark" SG_ 535 SGU22_Object_dx_Rear "";
BA_ "EventCommandSignal" SG_ 535 SGU22_Object_dy 0;
BA_ "GatewayedSignals" SG_ 535 SGU22_Object_dy 0;
BA_ "GenSigInactiveValue" SG_ 535 SGU22_Object_dy 0;
BA_ "GenSigInvalidValue" SG_ 535 SGU22_Object_dy 0;
BA_ "GenSigSendType" SG_ 535 SGU22_Object_dy 1;
BA_ "GenSigStartValue" SG_ 535 SGU22_Object_dy 0;
BA_ "GenSigTimeoutValue" SG_ 535 SGU22_Object_dy 0;
BA_ "Remark" SG_ 535 SGU22_Object_dy "";
BA_ "EventCommandSignal" SG_ 535 SGU22_Object_dy_Rear 0;
BA_ "GatewayedSignals" SG_ 535 SGU22_Object_dy_Rear 0;
BA_ "GenSigInactiveValue" SG_ 535 SGU22_Object_dy_Rear 0;
BA_ "GenSigInvalidValue" SG_ 535 SGU22_Object_dy_Rear 0;
BA_ "GenSigSendType" SG_ 535 SGU22_Object_dy_Rear 1;
BA_ "GenSigStartValue" SG_ 535 SGU22_Object_dy_Rear 0;
BA_ "GenSigTimeoutValue" SG_ 535 SGU22_Object_dy_Rear 0;
BA_ "Remark" SG_ 535 SGU22_Object_dy_Rear "";
BA_ "EventCommandSignal" SG_ 535 SGU22_Object_vx 0;
BA_ "GatewayedSignals" SG_ 535 SGU22_Object_vx 0;
BA_ "GenSigInactiveValue" SG_ 535 SGU22_Object_vx 0;
BA_ "GenSigInvalidValue" SG_ 535 SGU22_Object_vx 0;
BA_ "GenSigSendType" SG_ 535 SGU22_Object_vx 1;
BA_ "GenSigStartValue" SG_ 535 SGU22_Object_vx 0;
BA_ "GenSigTimeoutValue" SG_ 535 SGU22_Object_vx 0;
BA_ "Remark" SG_ 535 SGU22_Object_vx "";
BA_ "EventCommandSignal" SG_ 535 SGU22_Object_vy 0;
BA_ "GatewayedSignals" SG_ 535 SGU22_Object_vy 0;
BA_ "GenSigInactiveValue" SG_ 535 SGU22_Object_vy 0;
BA_ "GenSigInvalidValue" SG_ 535 SGU22_Object_vy 0;
BA_ "GenSigSendType" SG_ 535 SGU22_Object_vy 1;
BA_ "GenSigStartValue" SG_ 535 SGU22_Object_vy 0;
BA_ "GenSigTimeoutValue" SG_ 535 SGU22_Object_vy 0;
BA_ "Remark" SG_ 535 SGU22_Object_vy "";
BA_ "EventCommandSignal" SG_ 535 SGU22_Object_wExist 0;
BA_ "GatewayedSignals" SG_ 535 SGU22_Object_wExist 0;
BA_ "GenSigInactiveValue" SG_ 535 SGU22_Object_wExist 0;
BA_ "GenSigInvalidValue" SG_ 535 SGU22_Object_wExist 0;
BA_ "GenSigSendType" SG_ 535 SGU22_Object_wExist 1;
BA_ "GenSigStartValue" SG_ 535 SGU22_Object_wExist 0;
BA_ "GenSigTimeoutValue" SG_ 535 SGU22_Object_wExist 0;
BA_ "Remark" SG_ 535 SGU22_Object_wExist "";
BA_ "EventCommandSignal" SG_ 535 SGU22_Object_wObstacle 0;
BA_ "GatewayedSignals" SG_ 535 SGU22_Object_wObstacle 0;
BA_ "GenSigInactiveValue" SG_ 535 SGU22_Object_wObstacle 0;
BA_ "GenSigInvalidValue" SG_ 535 SGU22_Object_wObstacle 0;
BA_ "GenSigSendType" SG_ 535 SGU22_Object_wObstacle 1;
BA_ "GenSigStartValue" SG_ 535 SGU22_Object_wObstacle 0;
BA_ "GenSigTimeoutValue" SG_ 535 SGU22_Object_wObstacle 0;
BA_ "Remark" SG_ 535 SGU22_Object_wObstacle "";
BA_ "EventCommandSignal" SG_ 536 SGU23_BlockCounter 0;
BA_ "GatewayedSignals" SG_ 536 SGU23_BlockCounter 0;
BA_ "GenSigInactiveValue" SG_ 536 SGU23_BlockCounter 0;
BA_ "GenSigInvalidValue" SG_ 536 SGU23_BlockCounter 0;
BA_ "GenSigSendType" SG_ 536 SGU23_BlockCounter 1;
BA_ "GenSigStartValue" SG_ 536 SGU23_BlockCounter 0;
BA_ "GenSigTimeoutValue" SG_ 536 SGU23_BlockCounter 0;
BA_ "Remark" SG_ 536 SGU23_BlockCounter "";
BA_ "EventCommandSignal" SG_ 536 SGU23_LifeCycles_OBJ 0;
BA_ "GatewayedSignals" SG_ 536 SGU23_LifeCycles_OBJ 0;
BA_ "GenSigInactiveValue" SG_ 536 SGU23_LifeCycles_OBJ 0;
BA_ "GenSigInvalidValue" SG_ 536 SGU23_LifeCycles_OBJ 0;
BA_ "GenSigSendType" SG_ 536 SGU23_LifeCycles_OBJ 1;
BA_ "GenSigStartValue" SG_ 536 SGU23_LifeCycles_OBJ 0;
BA_ "GenSigTimeoutValue" SG_ 536 SGU23_LifeCycles_OBJ 0;
BA_ "Remark" SG_ 536 SGU23_LifeCycles_OBJ "";
BA_ "EventCommandSignal" SG_ 536 SGU23_Msg_AliveCounter 0;
BA_ "GatewayedSignals" SG_ 536 SGU23_Msg_AliveCounter 0;
BA_ "GenSigInactiveValue" SG_ 536 SGU23_Msg_AliveCounter 0;
BA_ "GenSigInvalidValue" SG_ 536 SGU23_Msg_AliveCounter 0;
BA_ "GenSigSendType" SG_ 536 SGU23_Msg_AliveCounter 1;
BA_ "GenSigStartValue" SG_ 536 SGU23_Msg_AliveCounter 0;
BA_ "GenSigTimeoutValue" SG_ 536 SGU23_Msg_AliveCounter 0;
BA_ "Remark" SG_ 536 SGU23_Msg_AliveCounter "";
BA_ "EventCommandSignal" SG_ 536 SGU23_Msg_CheckSum 0;
BA_ "GatewayedSignals" SG_ 536 SGU23_Msg_CheckSum 0;
BA_ "GenSigInactiveValue" SG_ 536 SGU23_Msg_CheckSum 0;
BA_ "GenSigInvalidValue" SG_ 536 SGU23_Msg_CheckSum 0;
BA_ "GenSigSendType" SG_ 536 SGU23_Msg_CheckSum 1;
BA_ "GenSigStartValue" SG_ 536 SGU23_Msg_CheckSum 0;
BA_ "GenSigTimeoutValue" SG_ 536 SGU23_Msg_CheckSum 0;
BA_ "Remark" SG_ 536 SGU23_Msg_CheckSum "";
BA_ "EventCommandSignal" SG_ 536 SGU23_ObjRCS_23 0;
BA_ "GatewayedSignals" SG_ 536 SGU23_ObjRCS_23 0;
BA_ "GenSigInactiveValue" SG_ 536 SGU23_ObjRCS_23 0;
BA_ "GenSigInvalidValue" SG_ 536 SGU23_ObjRCS_23 0;
BA_ "GenSigSendType" SG_ 536 SGU23_ObjRCS_23 1;
BA_ "GenSigStartValue" SG_ 536 SGU23_ObjRCS_23 0;
BA_ "GenSigTimeoutValue" SG_ 536 SGU23_ObjRCS_23 0;
BA_ "Remark" SG_ 536 SGU23_ObjRCS_23 "";
BA_ "EventCommandSignal" SG_ 536 SGU23_Obj_DistLat_rms 0;
BA_ "GatewayedSignals" SG_ 536 SGU23_Obj_DistLat_rms 0;
BA_ "GenSigInactiveValue" SG_ 536 SGU23_Obj_DistLat_rms 0;
BA_ "GenSigInvalidValue" SG_ 536 SGU23_Obj_DistLat_rms 0;
BA_ "GenSigSendType" SG_ 536 SGU23_Obj_DistLat_rms 1;
BA_ "GenSigStartValue" SG_ 536 SGU23_Obj_DistLat_rms 0;
BA_ "GenSigTimeoutValue" SG_ 536 SGU23_Obj_DistLat_rms 0;
BA_ "Remark" SG_ 536 SGU23_Obj_DistLat_rms "";
BA_ "EventCommandSignal" SG_ 536 SGU23_Obj_VrelLong_rms 0;
BA_ "GatewayedSignals" SG_ 536 SGU23_Obj_VrelLong_rms 0;
BA_ "GenSigInactiveValue" SG_ 536 SGU23_Obj_VrelLong_rms 0;
BA_ "GenSigInvalidValue" SG_ 536 SGU23_Obj_VrelLong_rms 0;
BA_ "GenSigSendType" SG_ 536 SGU23_Obj_VrelLong_rms 1;
BA_ "GenSigStartValue" SG_ 536 SGU23_Obj_VrelLong_rms 0;
BA_ "GenSigTimeoutValue" SG_ 536 SGU23_Obj_VrelLong_rms 0;
BA_ "Remark" SG_ 536 SGU23_Obj_VrelLong_rms "";
BA_ "EventCommandSignal" SG_ 536 SGU23_Obj_Vrelat_rms 0;
BA_ "GatewayedSignals" SG_ 536 SGU23_Obj_Vrelat_rms 0;
BA_ "GenSigInactiveValue" SG_ 536 SGU23_Obj_Vrelat_rms 0;
BA_ "GenSigInvalidValue" SG_ 536 SGU23_Obj_Vrelat_rms 0;
BA_ "GenSigSendType" SG_ 536 SGU23_Obj_Vrelat_rms 1;
BA_ "GenSigStartValue" SG_ 536 SGU23_Obj_Vrelat_rms 0;
BA_ "GenSigTimeoutValue" SG_ 536 SGU23_Obj_Vrelat_rms 0;
BA_ "Remark" SG_ 536 SGU23_Obj_Vrelat_rms "";
BA_ "EventCommandSignal" SG_ 536 SGU23_Object_DetStatus 0;
BA_ "GatewayedSignals" SG_ 536 SGU23_Object_DetStatus 0;
BA_ "GenSigInactiveValue" SG_ 536 SGU23_Object_DetStatus 0;
BA_ "GenSigInvalidValue" SG_ 536 SGU23_Object_DetStatus 0;
BA_ "GenSigSendType" SG_ 536 SGU23_Object_DetStatus 1;
BA_ "GenSigStartValue" SG_ 536 SGU23_Object_DetStatus 0;
BA_ "GenSigTimeoutValue" SG_ 536 SGU23_Object_DetStatus 0;
BA_ "Remark" SG_ 536 SGU23_Object_DetStatus "";
BA_ "EventCommandSignal" SG_ 536 SGU23_Object_DistLong_rms 0;
BA_ "GatewayedSignals" SG_ 536 SGU23_Object_DistLong_rms 0;
BA_ "GenSigInactiveValue" SG_ 536 SGU23_Object_DistLong_rms 0;
BA_ "GenSigInvalidValue" SG_ 536 SGU23_Object_DistLong_rms 0;
BA_ "GenSigSendType" SG_ 536 SGU23_Object_DistLong_rms 1;
BA_ "GenSigStartValue" SG_ 536 SGU23_Object_DistLong_rms 0;
BA_ "GenSigTimeoutValue" SG_ 536 SGU23_Object_DistLong_rms 0;
BA_ "Remark" SG_ 536 SGU23_Object_DistLong_rms "";
BA_ "EventCommandSignal" SG_ 536 SGU23_Object_ID 0;
BA_ "GatewayedSignals" SG_ 536 SGU23_Object_ID 0;
BA_ "GenSigInactiveValue" SG_ 536 SGU23_Object_ID 0;
BA_ "GenSigInvalidValue" SG_ 536 SGU23_Object_ID 0;
BA_ "GenSigSendType" SG_ 536 SGU23_Object_ID 1;
BA_ "GenSigStartValue" SG_ 536 SGU23_Object_ID 0;
BA_ "GenSigTimeoutValue" SG_ 536 SGU23_Object_ID 0;
BA_ "Remark" SG_ 536 SGU23_Object_ID "";
BA_ "EventCommandSignal" SG_ 536 SGU23_Object_Motion_Pattern 0;
BA_ "GatewayedSignals" SG_ 536 SGU23_Object_Motion_Pattern 0;
BA_ "GenSigInactiveValue" SG_ 536 SGU23_Object_Motion_Pattern 0;
BA_ "GenSigInvalidValue" SG_ 536 SGU23_Object_Motion_Pattern 0;
BA_ "GenSigSendType" SG_ 536 SGU23_Object_Motion_Pattern 1;
BA_ "GenSigStartValue" SG_ 536 SGU23_Object_Motion_Pattern 0;
BA_ "GenSigTimeoutValue" SG_ 536 SGU23_Object_Motion_Pattern 0;
BA_ "Remark" SG_ 536 SGU23_Object_Motion_Pattern "";
BA_ "EventCommandSignal" SG_ 536 SGU23_Object_Type 0;
BA_ "GatewayedSignals" SG_ 536 SGU23_Object_Type 0;
BA_ "GenSigInactiveValue" SG_ 536 SGU23_Object_Type 0;
BA_ "GenSigInvalidValue" SG_ 536 SGU23_Object_Type 0;
BA_ "GenSigSendType" SG_ 536 SGU23_Object_Type 1;
BA_ "GenSigStartValue" SG_ 536 SGU23_Object_Type 0;
BA_ "GenSigTimeoutValue" SG_ 536 SGU23_Object_Type 0;
BA_ "Remark" SG_ 536 SGU23_Object_Type "";
BA_ "EventCommandSignal" SG_ 536 SGU23_Object_ax 0;
BA_ "GatewayedSignals" SG_ 536 SGU23_Object_ax 0;
BA_ "GenSigInactiveValue" SG_ 536 SGU23_Object_ax 0;
BA_ "GenSigInvalidValue" SG_ 536 SGU23_Object_ax 0;
BA_ "GenSigSendType" SG_ 536 SGU23_Object_ax 1;
BA_ "GenSigStartValue" SG_ 536 SGU23_Object_ax 0;
BA_ "GenSigTimeoutValue" SG_ 536 SGU23_Object_ax 0;
BA_ "Remark" SG_ 536 SGU23_Object_ax "";
BA_ "EventCommandSignal" SG_ 536 SGU23_Object_ay 0;
BA_ "GatewayedSignals" SG_ 536 SGU23_Object_ay 0;
BA_ "GenSigInactiveValue" SG_ 536 SGU23_Object_ay 0;
BA_ "GenSigInvalidValue" SG_ 536 SGU23_Object_ay 0;
BA_ "GenSigSendType" SG_ 536 SGU23_Object_ay 1;
BA_ "GenSigStartValue" SG_ 536 SGU23_Object_ay 0;
BA_ "GenSigTimeoutValue" SG_ 536 SGU23_Object_ay 0;
BA_ "Remark" SG_ 536 SGU23_Object_ay "";
BA_ "EventCommandSignal" SG_ 536 SGU23_Object_dx 0;
BA_ "GatewayedSignals" SG_ 536 SGU23_Object_dx 0;
BA_ "GenSigInactiveValue" SG_ 536 SGU23_Object_dx 0;
BA_ "GenSigInvalidValue" SG_ 536 SGU23_Object_dx 0;
BA_ "GenSigSendType" SG_ 536 SGU23_Object_dx 1;
BA_ "GenSigStartValue" SG_ 536 SGU23_Object_dx 0;
BA_ "GenSigTimeoutValue" SG_ 536 SGU23_Object_dx 0;
BA_ "Remark" SG_ 536 SGU23_Object_dx "";
BA_ "EventCommandSignal" SG_ 536 SGU23_Object_dx_Rear 0;
BA_ "GatewayedSignals" SG_ 536 SGU23_Object_dx_Rear 0;
BA_ "GenSigInactiveValue" SG_ 536 SGU23_Object_dx_Rear 0;
BA_ "GenSigInvalidValue" SG_ 536 SGU23_Object_dx_Rear 0;
BA_ "GenSigSendType" SG_ 536 SGU23_Object_dx_Rear 1;
BA_ "GenSigStartValue" SG_ 536 SGU23_Object_dx_Rear 0;
BA_ "GenSigTimeoutValue" SG_ 536 SGU23_Object_dx_Rear 0;
BA_ "Remark" SG_ 536 SGU23_Object_dx_Rear "";
BA_ "EventCommandSignal" SG_ 536 SGU23_Object_dy 0;
BA_ "GatewayedSignals" SG_ 536 SGU23_Object_dy 0;
BA_ "GenSigInactiveValue" SG_ 536 SGU23_Object_dy 0;
BA_ "GenSigInvalidValue" SG_ 536 SGU23_Object_dy 0;
BA_ "GenSigSendType" SG_ 536 SGU23_Object_dy 1;
BA_ "GenSigStartValue" SG_ 536 SGU23_Object_dy 0;
BA_ "GenSigTimeoutValue" SG_ 536 SGU23_Object_dy 0;
BA_ "Remark" SG_ 536 SGU23_Object_dy "";
BA_ "EventCommandSignal" SG_ 536 SGU23_Object_dy_Rear 0;
BA_ "GatewayedSignals" SG_ 536 SGU23_Object_dy_Rear 0;
BA_ "GenSigInactiveValue" SG_ 536 SGU23_Object_dy_Rear 0;
BA_ "GenSigInvalidValue" SG_ 536 SGU23_Object_dy_Rear 0;
BA_ "GenSigSendType" SG_ 536 SGU23_Object_dy_Rear 1;
BA_ "GenSigStartValue" SG_ 536 SGU23_Object_dy_Rear 0;
BA_ "GenSigTimeoutValue" SG_ 536 SGU23_Object_dy_Rear 0;
BA_ "Remark" SG_ 536 SGU23_Object_dy_Rear "";
BA_ "EventCommandSignal" SG_ 536 SGU23_Object_vx 0;
BA_ "GatewayedSignals" SG_ 536 SGU23_Object_vx 0;
BA_ "GenSigInactiveValue" SG_ 536 SGU23_Object_vx 0;
BA_ "GenSigInvalidValue" SG_ 536 SGU23_Object_vx 0;
BA_ "GenSigSendType" SG_ 536 SGU23_Object_vx 1;
BA_ "GenSigStartValue" SG_ 536 SGU23_Object_vx 0;
BA_ "GenSigTimeoutValue" SG_ 536 SGU23_Object_vx 0;
BA_ "Remark" SG_ 536 SGU23_Object_vx "";
BA_ "EventCommandSignal" SG_ 536 SGU23_Object_vy 0;
BA_ "GatewayedSignals" SG_ 536 SGU23_Object_vy 0;
BA_ "GenSigInactiveValue" SG_ 536 SGU23_Object_vy 0;
BA_ "GenSigInvalidValue" SG_ 536 SGU23_Object_vy 0;
BA_ "GenSigSendType" SG_ 536 SGU23_Object_vy 1;
BA_ "GenSigStartValue" SG_ 536 SGU23_Object_vy 0;
BA_ "GenSigTimeoutValue" SG_ 536 SGU23_Object_vy 0;
BA_ "Remark" SG_ 536 SGU23_Object_vy "";
BA_ "EventCommandSignal" SG_ 536 SGU23_Object_wExist 0;
BA_ "GatewayedSignals" SG_ 536 SGU23_Object_wExist 0;
BA_ "GenSigInactiveValue" SG_ 536 SGU23_Object_wExist 0;
BA_ "GenSigInvalidValue" SG_ 536 SGU23_Object_wExist 0;
BA_ "GenSigSendType" SG_ 536 SGU23_Object_wExist 1;
BA_ "GenSigStartValue" SG_ 536 SGU23_Object_wExist 0;
BA_ "GenSigTimeoutValue" SG_ 536 SGU23_Object_wExist 0;
BA_ "Remark" SG_ 536 SGU23_Object_wExist "";
BA_ "EventCommandSignal" SG_ 536 SGU23_Object_wObstacle 0;
BA_ "GatewayedSignals" SG_ 536 SGU23_Object_wObstacle 0;
BA_ "GenSigInactiveValue" SG_ 536 SGU23_Object_wObstacle 0;
BA_ "GenSigInvalidValue" SG_ 536 SGU23_Object_wObstacle 0;
BA_ "GenSigSendType" SG_ 536 SGU23_Object_wObstacle 1;
BA_ "GenSigStartValue" SG_ 536 SGU23_Object_wObstacle 0;
BA_ "GenSigTimeoutValue" SG_ 536 SGU23_Object_wObstacle 0;
BA_ "Remark" SG_ 536 SGU23_Object_wObstacle "";
BA_ "EventCommandSignal" SG_ 537 SGU24_BlockCounter 0;
BA_ "GatewayedSignals" SG_ 537 SGU24_BlockCounter 0;
BA_ "GenSigInactiveValue" SG_ 537 SGU24_BlockCounter 0;
BA_ "GenSigInvalidValue" SG_ 537 SGU24_BlockCounter 0;
BA_ "GenSigSendType" SG_ 537 SGU24_BlockCounter 1;
BA_ "GenSigStartValue" SG_ 537 SGU24_BlockCounter 0;
BA_ "GenSigTimeoutValue" SG_ 537 SGU24_BlockCounter 0;
BA_ "Remark" SG_ 537 SGU24_BlockCounter "";
BA_ "EventCommandSignal" SG_ 537 SGU24_LifeCycles_OBJ 0;
BA_ "GatewayedSignals" SG_ 537 SGU24_LifeCycles_OBJ 0;
BA_ "GenSigInactiveValue" SG_ 537 SGU24_LifeCycles_OBJ 0;
BA_ "GenSigInvalidValue" SG_ 537 SGU24_LifeCycles_OBJ 0;
BA_ "GenSigSendType" SG_ 537 SGU24_LifeCycles_OBJ 1;
BA_ "GenSigStartValue" SG_ 537 SGU24_LifeCycles_OBJ 0;
BA_ "GenSigTimeoutValue" SG_ 537 SGU24_LifeCycles_OBJ 0;
BA_ "Remark" SG_ 537 SGU24_LifeCycles_OBJ "";
BA_ "EventCommandSignal" SG_ 537 SGU24_Msg_AliveCounter 0;
BA_ "GatewayedSignals" SG_ 537 SGU24_Msg_AliveCounter 0;
BA_ "GenSigInactiveValue" SG_ 537 SGU24_Msg_AliveCounter 0;
BA_ "GenSigInvalidValue" SG_ 537 SGU24_Msg_AliveCounter 0;
BA_ "GenSigSendType" SG_ 537 SGU24_Msg_AliveCounter 1;
BA_ "GenSigStartValue" SG_ 537 SGU24_Msg_AliveCounter 0;
BA_ "GenSigTimeoutValue" SG_ 537 SGU24_Msg_AliveCounter 0;
BA_ "Remark" SG_ 537 SGU24_Msg_AliveCounter "";
BA_ "EventCommandSignal" SG_ 537 SGU24_Msg_CheckSum 0;
BA_ "GatewayedSignals" SG_ 537 SGU24_Msg_CheckSum 0;
BA_ "GenSigInactiveValue" SG_ 537 SGU24_Msg_CheckSum 0;
BA_ "GenSigInvalidValue" SG_ 537 SGU24_Msg_CheckSum 0;
BA_ "GenSigSendType" SG_ 537 SGU24_Msg_CheckSum 1;
BA_ "GenSigStartValue" SG_ 537 SGU24_Msg_CheckSum 0;
BA_ "GenSigTimeoutValue" SG_ 537 SGU24_Msg_CheckSum 0;
BA_ "Remark" SG_ 537 SGU24_Msg_CheckSum "";
BA_ "EventCommandSignal" SG_ 537 SGU24_ObjRCS_24 0;
BA_ "GatewayedSignals" SG_ 537 SGU24_ObjRCS_24 0;
BA_ "GenSigInactiveValue" SG_ 537 SGU24_ObjRCS_24 0;
BA_ "GenSigInvalidValue" SG_ 537 SGU24_ObjRCS_24 0;
BA_ "GenSigSendType" SG_ 537 SGU24_ObjRCS_24 1;
BA_ "GenSigStartValue" SG_ 537 SGU24_ObjRCS_24 0;
BA_ "GenSigTimeoutValue" SG_ 537 SGU24_ObjRCS_24 0;
BA_ "Remark" SG_ 537 SGU24_ObjRCS_24 "";
BA_ "EventCommandSignal" SG_ 537 SGU24_Obj_DistLat_rms 0;
BA_ "GatewayedSignals" SG_ 537 SGU24_Obj_DistLat_rms 0;
BA_ "GenSigInactiveValue" SG_ 537 SGU24_Obj_DistLat_rms 0;
BA_ "GenSigInvalidValue" SG_ 537 SGU24_Obj_DistLat_rms 0;
BA_ "GenSigSendType" SG_ 537 SGU24_Obj_DistLat_rms 1;
BA_ "GenSigStartValue" SG_ 537 SGU24_Obj_DistLat_rms 0;
BA_ "GenSigTimeoutValue" SG_ 537 SGU24_Obj_DistLat_rms 0;
BA_ "Remark" SG_ 537 SGU24_Obj_DistLat_rms "";
BA_ "EventCommandSignal" SG_ 537 SGU24_Obj_VrelLong_rms 0;
BA_ "GatewayedSignals" SG_ 537 SGU24_Obj_VrelLong_rms 0;
BA_ "GenSigInactiveValue" SG_ 537 SGU24_Obj_VrelLong_rms 0;
BA_ "GenSigInvalidValue" SG_ 537 SGU24_Obj_VrelLong_rms 0;
BA_ "GenSigSendType" SG_ 537 SGU24_Obj_VrelLong_rms 1;
BA_ "GenSigStartValue" SG_ 537 SGU24_Obj_VrelLong_rms 0;
BA_ "GenSigTimeoutValue" SG_ 537 SGU24_Obj_VrelLong_rms 0;
BA_ "Remark" SG_ 537 SGU24_Obj_VrelLong_rms "";
BA_ "EventCommandSignal" SG_ 537 SGU24_Obj_Vrelat_rms 0;
BA_ "GatewayedSignals" SG_ 537 SGU24_Obj_Vrelat_rms 0;
BA_ "GenSigInactiveValue" SG_ 537 SGU24_Obj_Vrelat_rms 0;
BA_ "GenSigInvalidValue" SG_ 537 SGU24_Obj_Vrelat_rms 0;
BA_ "GenSigSendType" SG_ 537 SGU24_Obj_Vrelat_rms 1;
BA_ "GenSigStartValue" SG_ 537 SGU24_Obj_Vrelat_rms 0;
BA_ "GenSigTimeoutValue" SG_ 537 SGU24_Obj_Vrelat_rms 0;
BA_ "Remark" SG_ 537 SGU24_Obj_Vrelat_rms "";
BA_ "EventCommandSignal" SG_ 537 SGU24_Object_DetStatus 0;
BA_ "GatewayedSignals" SG_ 537 SGU24_Object_DetStatus 0;
BA_ "GenSigInactiveValue" SG_ 537 SGU24_Object_DetStatus 0;
BA_ "GenSigInvalidValue" SG_ 537 SGU24_Object_DetStatus 0;
BA_ "GenSigSendType" SG_ 537 SGU24_Object_DetStatus 1;
BA_ "GenSigStartValue" SG_ 537 SGU24_Object_DetStatus 0;
BA_ "GenSigTimeoutValue" SG_ 537 SGU24_Object_DetStatus 0;
BA_ "Remark" SG_ 537 SGU24_Object_DetStatus "";
BA_ "EventCommandSignal" SG_ 537 SGU24_Object_DistLong_rms 0;
BA_ "GatewayedSignals" SG_ 537 SGU24_Object_DistLong_rms 0;
BA_ "GenSigInactiveValue" SG_ 537 SGU24_Object_DistLong_rms 0;
BA_ "GenSigInvalidValue" SG_ 537 SGU24_Object_DistLong_rms 0;
BA_ "GenSigSendType" SG_ 537 SGU24_Object_DistLong_rms 1;
BA_ "GenSigStartValue" SG_ 537 SGU24_Object_DistLong_rms 0;
BA_ "GenSigTimeoutValue" SG_ 537 SGU24_Object_DistLong_rms 0;
BA_ "Remark" SG_ 537 SGU24_Object_DistLong_rms "";
BA_ "EventCommandSignal" SG_ 537 SGU24_Object_ID 0;
BA_ "GatewayedSignals" SG_ 537 SGU24_Object_ID 0;
BA_ "GenSigInactiveValue" SG_ 537 SGU24_Object_ID 0;
BA_ "GenSigInvalidValue" SG_ 537 SGU24_Object_ID 0;
BA_ "GenSigSendType" SG_ 537 SGU24_Object_ID 1;
BA_ "GenSigStartValue" SG_ 537 SGU24_Object_ID 0;
BA_ "GenSigTimeoutValue" SG_ 537 SGU24_Object_ID 0;
BA_ "Remark" SG_ 537 SGU24_Object_ID "";
BA_ "EventCommandSignal" SG_ 537 SGU24_Object_Motion_Pattern 0;
BA_ "GatewayedSignals" SG_ 537 SGU24_Object_Motion_Pattern 0;
BA_ "GenSigInactiveValue" SG_ 537 SGU24_Object_Motion_Pattern 0;
BA_ "GenSigInvalidValue" SG_ 537 SGU24_Object_Motion_Pattern 0;
BA_ "GenSigSendType" SG_ 537 SGU24_Object_Motion_Pattern 1;
BA_ "GenSigStartValue" SG_ 537 SGU24_Object_Motion_Pattern 0;
BA_ "GenSigTimeoutValue" SG_ 537 SGU24_Object_Motion_Pattern 0;
BA_ "Remark" SG_ 537 SGU24_Object_Motion_Pattern "";
BA_ "EventCommandSignal" SG_ 537 SGU24_Object_Type 0;
BA_ "GatewayedSignals" SG_ 537 SGU24_Object_Type 0;
BA_ "GenSigInactiveValue" SG_ 537 SGU24_Object_Type 0;
BA_ "GenSigInvalidValue" SG_ 537 SGU24_Object_Type 0;
BA_ "GenSigSendType" SG_ 537 SGU24_Object_Type 1;
BA_ "GenSigStartValue" SG_ 537 SGU24_Object_Type 0;
BA_ "GenSigTimeoutValue" SG_ 537 SGU24_Object_Type 0;
BA_ "Remark" SG_ 537 SGU24_Object_Type "";
BA_ "EventCommandSignal" SG_ 537 SGU24_Object_ax 0;
BA_ "GatewayedSignals" SG_ 537 SGU24_Object_ax 0;
BA_ "GenSigInactiveValue" SG_ 537 SGU24_Object_ax 0;
BA_ "GenSigInvalidValue" SG_ 537 SGU24_Object_ax 0;
BA_ "GenSigSendType" SG_ 537 SGU24_Object_ax 1;
BA_ "GenSigStartValue" SG_ 537 SGU24_Object_ax 0;
BA_ "GenSigTimeoutValue" SG_ 537 SGU24_Object_ax 0;
BA_ "Remark" SG_ 537 SGU24_Object_ax "";
BA_ "EventCommandSignal" SG_ 537 SGU24_Object_ay 0;
BA_ "GatewayedSignals" SG_ 537 SGU24_Object_ay 0;
BA_ "GenSigInactiveValue" SG_ 537 SGU24_Object_ay 0;
BA_ "GenSigInvalidValue" SG_ 537 SGU24_Object_ay 0;
BA_ "GenSigSendType" SG_ 537 SGU24_Object_ay 1;
BA_ "GenSigStartValue" SG_ 537 SGU24_Object_ay 0;
BA_ "GenSigTimeoutValue" SG_ 537 SGU24_Object_ay 0;
BA_ "Remark" SG_ 537 SGU24_Object_ay "";
BA_ "EventCommandSignal" SG_ 537 SGU24_Object_dx 0;
BA_ "GatewayedSignals" SG_ 537 SGU24_Object_dx 0;
BA_ "GenSigInactiveValue" SG_ 537 SGU24_Object_dx 0;
BA_ "GenSigInvalidValue" SG_ 537 SGU24_Object_dx 0;
BA_ "GenSigSendType" SG_ 537 SGU24_Object_dx 1;
BA_ "GenSigStartValue" SG_ 537 SGU24_Object_dx 0;
BA_ "GenSigTimeoutValue" SG_ 537 SGU24_Object_dx 0;
BA_ "Remark" SG_ 537 SGU24_Object_dx "";
BA_ "EventCommandSignal" SG_ 537 SGU24_Object_dx_Rear 0;
BA_ "GatewayedSignals" SG_ 537 SGU24_Object_dx_Rear 0;
BA_ "GenSigInactiveValue" SG_ 537 SGU24_Object_dx_Rear 0;
BA_ "GenSigInvalidValue" SG_ 537 SGU24_Object_dx_Rear 0;
BA_ "GenSigSendType" SG_ 537 SGU24_Object_dx_Rear 1;
BA_ "GenSigStartValue" SG_ 537 SGU24_Object_dx_Rear 0;
BA_ "GenSigTimeoutValue" SG_ 537 SGU24_Object_dx_Rear 0;
BA_ "Remark" SG_ 537 SGU24_Object_dx_Rear "";
BA_ "EventCommandSignal" SG_ 537 SGU24_Object_dy 0;
BA_ "GatewayedSignals" SG_ 537 SGU24_Object_dy 0;
BA_ "GenSigInactiveValue" SG_ 537 SGU24_Object_dy 0;
BA_ "GenSigInvalidValue" SG_ 537 SGU24_Object_dy 0;
BA_ "GenSigSendType" SG_ 537 SGU24_Object_dy 1;
BA_ "GenSigStartValue" SG_ 537 SGU24_Object_dy 0;
BA_ "GenSigTimeoutValue" SG_ 537 SGU24_Object_dy 0;
BA_ "Remark" SG_ 537 SGU24_Object_dy "";
BA_ "EventCommandSignal" SG_ 537 SGU24_Object_dy_Rear 0;
BA_ "GatewayedSignals" SG_ 537 SGU24_Object_dy_Rear 0;
BA_ "GenSigInactiveValue" SG_ 537 SGU24_Object_dy_Rear 0;
BA_ "GenSigInvalidValue" SG_ 537 SGU24_Object_dy_Rear 0;
BA_ "GenSigSendType" SG_ 537 SGU24_Object_dy_Rear 1;
BA_ "GenSigStartValue" SG_ 537 SGU24_Object_dy_Rear 0;
BA_ "GenSigTimeoutValue" SG_ 537 SGU24_Object_dy_Rear 0;
BA_ "Remark" SG_ 537 SGU24_Object_dy_Rear "";
BA_ "EventCommandSignal" SG_ 537 SGU24_Object_vx 0;
BA_ "GatewayedSignals" SG_ 537 SGU24_Object_vx 0;
BA_ "GenSigInactiveValue" SG_ 537 SGU24_Object_vx 0;
BA_ "GenSigInvalidValue" SG_ 537 SGU24_Object_vx 0;
BA_ "GenSigSendType" SG_ 537 SGU24_Object_vx 1;
BA_ "GenSigStartValue" SG_ 537 SGU24_Object_vx 0;
BA_ "GenSigTimeoutValue" SG_ 537 SGU24_Object_vx 0;
BA_ "Remark" SG_ 537 SGU24_Object_vx "";
BA_ "EventCommandSignal" SG_ 537 SGU24_Object_vy 0;
BA_ "GatewayedSignals" SG_ 537 SGU24_Object_vy 0;
BA_ "GenSigInactiveValue" SG_ 537 SGU24_Object_vy 0;
BA_ "GenSigInvalidValue" SG_ 537 SGU24_Object_vy 0;
BA_ "GenSigSendType" SG_ 537 SGU24_Object_vy 1;
BA_ "GenSigStartValue" SG_ 537 SGU24_Object_vy 0;
BA_ "GenSigTimeoutValue" SG_ 537 SGU24_Object_vy 0;
BA_ "Remark" SG_ 537 SGU24_Object_vy "";
BA_ "EventCommandSignal" SG_ 537 SGU24_Object_wExist 0;
BA_ "GatewayedSignals" SG_ 537 SGU24_Object_wExist 0;
BA_ "GenSigInactiveValue" SG_ 537 SGU24_Object_wExist 0;
BA_ "GenSigInvalidValue" SG_ 537 SGU24_Object_wExist 0;
BA_ "GenSigSendType" SG_ 537 SGU24_Object_wExist 1;
BA_ "GenSigStartValue" SG_ 537 SGU24_Object_wExist 0;
BA_ "GenSigTimeoutValue" SG_ 537 SGU24_Object_wExist 0;
BA_ "Remark" SG_ 537 SGU24_Object_wExist "";
BA_ "EventCommandSignal" SG_ 537 SGU24_Object_wObstacle 0;
BA_ "GatewayedSignals" SG_ 537 SGU24_Object_wObstacle 0;
BA_ "GenSigInactiveValue" SG_ 537 SGU24_Object_wObstacle 0;
BA_ "GenSigInvalidValue" SG_ 537 SGU24_Object_wObstacle 0;
BA_ "GenSigSendType" SG_ 537 SGU24_Object_wObstacle 1;
BA_ "GenSigStartValue" SG_ 537 SGU24_Object_wObstacle 0;
BA_ "GenSigTimeoutValue" SG_ 537 SGU24_Object_wObstacle 0;
BA_ "Remark" SG_ 537 SGU24_Object_wObstacle "";
BA_ "EventCommandSignal" SG_ 538 SGU25_BlockCounter 0;
BA_ "GatewayedSignals" SG_ 538 SGU25_BlockCounter 0;
BA_ "GenSigInactiveValue" SG_ 538 SGU25_BlockCounter 0;
BA_ "GenSigInvalidValue" SG_ 538 SGU25_BlockCounter 0;
BA_ "GenSigSendType" SG_ 538 SGU25_BlockCounter 1;
BA_ "GenSigStartValue" SG_ 538 SGU25_BlockCounter 0;
BA_ "GenSigTimeoutValue" SG_ 538 SGU25_BlockCounter 0;
BA_ "Remark" SG_ 538 SGU25_BlockCounter "";
BA_ "EventCommandSignal" SG_ 538 SGU25_LifeCycles_OBJ 0;
BA_ "GatewayedSignals" SG_ 538 SGU25_LifeCycles_OBJ 0;
BA_ "GenSigInactiveValue" SG_ 538 SGU25_LifeCycles_OBJ 0;
BA_ "GenSigInvalidValue" SG_ 538 SGU25_LifeCycles_OBJ 0;
BA_ "GenSigSendType" SG_ 538 SGU25_LifeCycles_OBJ 1;
BA_ "GenSigStartValue" SG_ 538 SGU25_LifeCycles_OBJ 0;
BA_ "GenSigTimeoutValue" SG_ 538 SGU25_LifeCycles_OBJ 0;
BA_ "Remark" SG_ 538 SGU25_LifeCycles_OBJ "";
BA_ "EventCommandSignal" SG_ 538 SGU25_Msg_AliveCounter 0;
BA_ "GatewayedSignals" SG_ 538 SGU25_Msg_AliveCounter 0;
BA_ "GenSigInactiveValue" SG_ 538 SGU25_Msg_AliveCounter 0;
BA_ "GenSigInvalidValue" SG_ 538 SGU25_Msg_AliveCounter 0;
BA_ "GenSigSendType" SG_ 538 SGU25_Msg_AliveCounter 1;
BA_ "GenSigStartValue" SG_ 538 SGU25_Msg_AliveCounter 0;
BA_ "GenSigTimeoutValue" SG_ 538 SGU25_Msg_AliveCounter 0;
BA_ "Remark" SG_ 538 SGU25_Msg_AliveCounter "";
BA_ "EventCommandSignal" SG_ 538 SGU25_Msg_CheckSum 0;
BA_ "GatewayedSignals" SG_ 538 SGU25_Msg_CheckSum 0;
BA_ "GenSigInactiveValue" SG_ 538 SGU25_Msg_CheckSum 0;
BA_ "GenSigInvalidValue" SG_ 538 SGU25_Msg_CheckSum 0;
BA_ "GenSigSendType" SG_ 538 SGU25_Msg_CheckSum 1;
BA_ "GenSigStartValue" SG_ 538 SGU25_Msg_CheckSum 0;
BA_ "GenSigTimeoutValue" SG_ 538 SGU25_Msg_CheckSum 0;
BA_ "Remark" SG_ 538 SGU25_Msg_CheckSum "";
BA_ "EventCommandSignal" SG_ 538 SGU25_ObjRCS_25 0;
BA_ "GatewayedSignals" SG_ 538 SGU25_ObjRCS_25 0;
BA_ "GenSigInactiveValue" SG_ 538 SGU25_ObjRCS_25 0;
BA_ "GenSigInvalidValue" SG_ 538 SGU25_ObjRCS_25 0;
BA_ "GenSigSendType" SG_ 538 SGU25_ObjRCS_25 1;
BA_ "GenSigStartValue" SG_ 538 SGU25_ObjRCS_25 0;
BA_ "GenSigTimeoutValue" SG_ 538 SGU25_ObjRCS_25 0;
BA_ "Remark" SG_ 538 SGU25_ObjRCS_25 "";
BA_ "EventCommandSignal" SG_ 538 SGU25_Obj_DistLat_rms 0;
BA_ "GatewayedSignals" SG_ 538 SGU25_Obj_DistLat_rms 0;
BA_ "GenSigInactiveValue" SG_ 538 SGU25_Obj_DistLat_rms 0;
BA_ "GenSigInvalidValue" SG_ 538 SGU25_Obj_DistLat_rms 0;
BA_ "GenSigSendType" SG_ 538 SGU25_Obj_DistLat_rms 1;
BA_ "GenSigStartValue" SG_ 538 SGU25_Obj_DistLat_rms 0;
BA_ "GenSigTimeoutValue" SG_ 538 SGU25_Obj_DistLat_rms 0;
BA_ "Remark" SG_ 538 SGU25_Obj_DistLat_rms "";
BA_ "EventCommandSignal" SG_ 538 SGU25_Obj_VrelLong_rms 0;
BA_ "GatewayedSignals" SG_ 538 SGU25_Obj_VrelLong_rms 0;
BA_ "GenSigInactiveValue" SG_ 538 SGU25_Obj_VrelLong_rms 0;
BA_ "GenSigInvalidValue" SG_ 538 SGU25_Obj_VrelLong_rms 0;
BA_ "GenSigSendType" SG_ 538 SGU25_Obj_VrelLong_rms 1;
BA_ "GenSigStartValue" SG_ 538 SGU25_Obj_VrelLong_rms 0;
BA_ "GenSigTimeoutValue" SG_ 538 SGU25_Obj_VrelLong_rms 0;
BA_ "Remark" SG_ 538 SGU25_Obj_VrelLong_rms "";
BA_ "EventCommandSignal" SG_ 538 SGU25_Obj_Vrelat_rms 0;
BA_ "GatewayedSignals" SG_ 538 SGU25_Obj_Vrelat_rms 0;
BA_ "GenSigInactiveValue" SG_ 538 SGU25_Obj_Vrelat_rms 0;
BA_ "GenSigInvalidValue" SG_ 538 SGU25_Obj_Vrelat_rms 0;
BA_ "GenSigSendType" SG_ 538 SGU25_Obj_Vrelat_rms 1;
BA_ "GenSigStartValue" SG_ 538 SGU25_Obj_Vrelat_rms 0;
BA_ "GenSigTimeoutValue" SG_ 538 SGU25_Obj_Vrelat_rms 0;
BA_ "Remark" SG_ 538 SGU25_Obj_Vrelat_rms "";
BA_ "EventCommandSignal" SG_ 538 SGU25_Object_DetStatus 0;
BA_ "GatewayedSignals" SG_ 538 SGU25_Object_DetStatus 0;
BA_ "GenSigInactiveValue" SG_ 538 SGU25_Object_DetStatus 0;
BA_ "GenSigInvalidValue" SG_ 538 SGU25_Object_DetStatus 0;
BA_ "GenSigSendType" SG_ 538 SGU25_Object_DetStatus 1;
BA_ "GenSigStartValue" SG_ 538 SGU25_Object_DetStatus 0;
BA_ "GenSigTimeoutValue" SG_ 538 SGU25_Object_DetStatus 0;
BA_ "Remark" SG_ 538 SGU25_Object_DetStatus "";
BA_ "EventCommandSignal" SG_ 538 SGU25_Object_DistLong_rms 0;
BA_ "GatewayedSignals" SG_ 538 SGU25_Object_DistLong_rms 0;
BA_ "GenSigInactiveValue" SG_ 538 SGU25_Object_DistLong_rms 0;
BA_ "GenSigInvalidValue" SG_ 538 SGU25_Object_DistLong_rms 0;
BA_ "GenSigSendType" SG_ 538 SGU25_Object_DistLong_rms 1;
BA_ "GenSigStartValue" SG_ 538 SGU25_Object_DistLong_rms 0;
BA_ "GenSigTimeoutValue" SG_ 538 SGU25_Object_DistLong_rms 0;
BA_ "Remark" SG_ 538 SGU25_Object_DistLong_rms "";
BA_ "EventCommandSignal" SG_ 538 SGU25_Object_ID 0;
BA_ "GatewayedSignals" SG_ 538 SGU25_Object_ID 0;
BA_ "GenSigInactiveValue" SG_ 538 SGU25_Object_ID 0;
BA_ "GenSigInvalidValue" SG_ 538 SGU25_Object_ID 0;
BA_ "GenSigSendType" SG_ 538 SGU25_Object_ID 1;
BA_ "GenSigStartValue" SG_ 538 SGU25_Object_ID 0;
BA_ "GenSigTimeoutValue" SG_ 538 SGU25_Object_ID 0;
BA_ "Remark" SG_ 538 SGU25_Object_ID "";
BA_ "EventCommandSignal" SG_ 538 SGU25_Object_Motion_Pattern 0;
BA_ "GatewayedSignals" SG_ 538 SGU25_Object_Motion_Pattern 0;
BA_ "GenSigInactiveValue" SG_ 538 SGU25_Object_Motion_Pattern 0;
BA_ "GenSigInvalidValue" SG_ 538 SGU25_Object_Motion_Pattern 0;
BA_ "GenSigSendType" SG_ 538 SGU25_Object_Motion_Pattern 1;
BA_ "GenSigStartValue" SG_ 538 SGU25_Object_Motion_Pattern 0;
BA_ "GenSigTimeoutValue" SG_ 538 SGU25_Object_Motion_Pattern 0;
BA_ "Remark" SG_ 538 SGU25_Object_Motion_Pattern "";
BA_ "EventCommandSignal" SG_ 538 SGU25_Object_Type 0;
BA_ "GatewayedSignals" SG_ 538 SGU25_Object_Type 0;
BA_ "GenSigInactiveValue" SG_ 538 SGU25_Object_Type 0;
BA_ "GenSigInvalidValue" SG_ 538 SGU25_Object_Type 0;
BA_ "GenSigSendType" SG_ 538 SGU25_Object_Type 1;
BA_ "GenSigStartValue" SG_ 538 SGU25_Object_Type 0;
BA_ "GenSigTimeoutValue" SG_ 538 SGU25_Object_Type 0;
BA_ "Remark" SG_ 538 SGU25_Object_Type "";
BA_ "EventCommandSignal" SG_ 538 SGU25_Object_ax 0;
BA_ "GatewayedSignals" SG_ 538 SGU25_Object_ax 0;
BA_ "GenSigInactiveValue" SG_ 538 SGU25_Object_ax 0;
BA_ "GenSigInvalidValue" SG_ 538 SGU25_Object_ax 0;
BA_ "GenSigSendType" SG_ 538 SGU25_Object_ax 1;
BA_ "GenSigStartValue" SG_ 538 SGU25_Object_ax 0;
BA_ "GenSigTimeoutValue" SG_ 538 SGU25_Object_ax 0;
BA_ "Remark" SG_ 538 SGU25_Object_ax "";
BA_ "EventCommandSignal" SG_ 538 SGU25_Object_ay 0;
BA_ "GatewayedSignals" SG_ 538 SGU25_Object_ay 0;
BA_ "GenSigInactiveValue" SG_ 538 SGU25_Object_ay 0;
BA_ "GenSigInvalidValue" SG_ 538 SGU25_Object_ay 0;
BA_ "GenSigSendType" SG_ 538 SGU25_Object_ay 1;
BA_ "GenSigStartValue" SG_ 538 SGU25_Object_ay 0;
BA_ "GenSigTimeoutValue" SG_ 538 SGU25_Object_ay 0;
BA_ "Remark" SG_ 538 SGU25_Object_ay "";
BA_ "EventCommandSignal" SG_ 538 SGU25_Object_dx 0;
BA_ "GatewayedSignals" SG_ 538 SGU25_Object_dx 0;
BA_ "GenSigInactiveValue" SG_ 538 SGU25_Object_dx 0;
BA_ "GenSigInvalidValue" SG_ 538 SGU25_Object_dx 0;
BA_ "GenSigSendType" SG_ 538 SGU25_Object_dx 1;
BA_ "GenSigStartValue" SG_ 538 SGU25_Object_dx 0;
BA_ "GenSigTimeoutValue" SG_ 538 SGU25_Object_dx 0;
BA_ "Remark" SG_ 538 SGU25_Object_dx "";
BA_ "EventCommandSignal" SG_ 538 SGU25_Object_dx_Rear 0;
BA_ "GatewayedSignals" SG_ 538 SGU25_Object_dx_Rear 0;
BA_ "GenSigInactiveValue" SG_ 538 SGU25_Object_dx_Rear 0;
BA_ "GenSigInvalidValue" SG_ 538 SGU25_Object_dx_Rear 0;
BA_ "GenSigSendType" SG_ 538 SGU25_Object_dx_Rear 1;
BA_ "GenSigStartValue" SG_ 538 SGU25_Object_dx_Rear 0;
BA_ "GenSigTimeoutValue" SG_ 538 SGU25_Object_dx_Rear 0;
BA_ "Remark" SG_ 538 SGU25_Object_dx_Rear "";
BA_ "EventCommandSignal" SG_ 538 SGU25_Object_dy 0;
BA_ "GatewayedSignals" SG_ 538 SGU25_Object_dy 0;
BA_ "GenSigInactiveValue" SG_ 538 SGU25_Object_dy 0;
BA_ "GenSigInvalidValue" SG_ 538 SGU25_Object_dy 0;
BA_ "GenSigSendType" SG_ 538 SGU25_Object_dy 1;
BA_ "GenSigStartValue" SG_ 538 SGU25_Object_dy 0;
BA_ "GenSigTimeoutValue" SG_ 538 SGU25_Object_dy 0;
BA_ "Remark" SG_ 538 SGU25_Object_dy "";
BA_ "EventCommandSignal" SG_ 538 SGU25_Object_dy_Rear 0;
BA_ "GatewayedSignals" SG_ 538 SGU25_Object_dy_Rear 0;
BA_ "GenSigInactiveValue" SG_ 538 SGU25_Object_dy_Rear 0;
BA_ "GenSigInvalidValue" SG_ 538 SGU25_Object_dy_Rear 0;
BA_ "GenSigSendType" SG_ 538 SGU25_Object_dy_Rear 1;
BA_ "GenSigStartValue" SG_ 538 SGU25_Object_dy_Rear 0;
BA_ "GenSigTimeoutValue" SG_ 538 SGU25_Object_dy_Rear 0;
BA_ "Remark" SG_ 538 SGU25_Object_dy_Rear "";
BA_ "EventCommandSignal" SG_ 538 SGU25_Object_vx 0;
BA_ "GatewayedSignals" SG_ 538 SGU25_Object_vx 0;
BA_ "GenSigInactiveValue" SG_ 538 SGU25_Object_vx 0;
BA_ "GenSigInvalidValue" SG_ 538 SGU25_Object_vx 0;
BA_ "GenSigSendType" SG_ 538 SGU25_Object_vx 1;
BA_ "GenSigStartValue" SG_ 538 SGU25_Object_vx 0;
BA_ "GenSigTimeoutValue" SG_ 538 SGU25_Object_vx 0;
BA_ "Remark" SG_ 538 SGU25_Object_vx "";
BA_ "EventCommandSignal" SG_ 538 SGU25_Object_vy 0;
BA_ "GatewayedSignals" SG_ 538 SGU25_Object_vy 0;
BA_ "GenSigInactiveValue" SG_ 538 SGU25_Object_vy 0;
BA_ "GenSigInvalidValue" SG_ 538 SGU25_Object_vy 0;
BA_ "GenSigSendType" SG_ 538 SGU25_Object_vy 1;
BA_ "GenSigStartValue" SG_ 538 SGU25_Object_vy 0;
BA_ "GenSigTimeoutValue" SG_ 538 SGU25_Object_vy 0;
BA_ "Remark" SG_ 538 SGU25_Object_vy "";
BA_ "EventCommandSignal" SG_ 538 SGU25_Object_wExist 0;
BA_ "GatewayedSignals" SG_ 538 SGU25_Object_wExist 0;
BA_ "GenSigInactiveValue" SG_ 538 SGU25_Object_wExist 0;
BA_ "GenSigInvalidValue" SG_ 538 SGU25_Object_wExist 0;
BA_ "GenSigSendType" SG_ 538 SGU25_Object_wExist 1;
BA_ "GenSigStartValue" SG_ 538 SGU25_Object_wExist 0;
BA_ "GenSigTimeoutValue" SG_ 538 SGU25_Object_wExist 0;
BA_ "Remark" SG_ 538 SGU25_Object_wExist "";
BA_ "EventCommandSignal" SG_ 538 SGU25_Object_wObstacle 0;
BA_ "GatewayedSignals" SG_ 538 SGU25_Object_wObstacle 0;
BA_ "GenSigInactiveValue" SG_ 538 SGU25_Object_wObstacle 0;
BA_ "GenSigInvalidValue" SG_ 538 SGU25_Object_wObstacle 0;
BA_ "GenSigSendType" SG_ 538 SGU25_Object_wObstacle 1;
BA_ "GenSigStartValue" SG_ 538 SGU25_Object_wObstacle 0;
BA_ "GenSigTimeoutValue" SG_ 538 SGU25_Object_wObstacle 0;
BA_ "Remark" SG_ 538 SGU25_Object_wObstacle "";
BA_ "EventCommandSignal" SG_ 539 SGU26_BlockCounter 0;
BA_ "GatewayedSignals" SG_ 539 SGU26_BlockCounter 0;
BA_ "GenSigInactiveValue" SG_ 539 SGU26_BlockCounter 0;
BA_ "GenSigInvalidValue" SG_ 539 SGU26_BlockCounter 0;
BA_ "GenSigSendType" SG_ 539 SGU26_BlockCounter 1;
BA_ "GenSigStartValue" SG_ 539 SGU26_BlockCounter 0;
BA_ "GenSigTimeoutValue" SG_ 539 SGU26_BlockCounter 0;
BA_ "Remark" SG_ 539 SGU26_BlockCounter "";
BA_ "EventCommandSignal" SG_ 539 SGU26_LifeCycles_OBJ 0;
BA_ "GatewayedSignals" SG_ 539 SGU26_LifeCycles_OBJ 0;
BA_ "GenSigInactiveValue" SG_ 539 SGU26_LifeCycles_OBJ 0;
BA_ "GenSigInvalidValue" SG_ 539 SGU26_LifeCycles_OBJ 0;
BA_ "GenSigSendType" SG_ 539 SGU26_LifeCycles_OBJ 1;
BA_ "GenSigStartValue" SG_ 539 SGU26_LifeCycles_OBJ 0;
BA_ "GenSigTimeoutValue" SG_ 539 SGU26_LifeCycles_OBJ 0;
BA_ "Remark" SG_ 539 SGU26_LifeCycles_OBJ "";
BA_ "EventCommandSignal" SG_ 539 SGU26_Msg_AliveCounter 0;
BA_ "GatewayedSignals" SG_ 539 SGU26_Msg_AliveCounter 0;
BA_ "GenSigInactiveValue" SG_ 539 SGU26_Msg_AliveCounter 0;
BA_ "GenSigInvalidValue" SG_ 539 SGU26_Msg_AliveCounter 0;
BA_ "GenSigSendType" SG_ 539 SGU26_Msg_AliveCounter 1;
BA_ "GenSigStartValue" SG_ 539 SGU26_Msg_AliveCounter 0;
BA_ "GenSigTimeoutValue" SG_ 539 SGU26_Msg_AliveCounter 0;
BA_ "Remark" SG_ 539 SGU26_Msg_AliveCounter "";
BA_ "EventCommandSignal" SG_ 539 SGU26_Msg_CheckSum 0;
BA_ "GatewayedSignals" SG_ 539 SGU26_Msg_CheckSum 0;
BA_ "GenSigInactiveValue" SG_ 539 SGU26_Msg_CheckSum 0;
BA_ "GenSigInvalidValue" SG_ 539 SGU26_Msg_CheckSum 0;
BA_ "GenSigSendType" SG_ 539 SGU26_Msg_CheckSum 1;
BA_ "GenSigStartValue" SG_ 539 SGU26_Msg_CheckSum 0;
BA_ "GenSigTimeoutValue" SG_ 539 SGU26_Msg_CheckSum 0;
BA_ "Remark" SG_ 539 SGU26_Msg_CheckSum "";
BA_ "EventCommandSignal" SG_ 539 SGU26_ObjRCS_26 0;
BA_ "GatewayedSignals" SG_ 539 SGU26_ObjRCS_26 0;
BA_ "GenSigInactiveValue" SG_ 539 SGU26_ObjRCS_26 0;
BA_ "GenSigInvalidValue" SG_ 539 SGU26_ObjRCS_26 0;
BA_ "GenSigSendType" SG_ 539 SGU26_ObjRCS_26 1;
BA_ "GenSigStartValue" SG_ 539 SGU26_ObjRCS_26 0;
BA_ "GenSigTimeoutValue" SG_ 539 SGU26_ObjRCS_26 0;
BA_ "Remark" SG_ 539 SGU26_ObjRCS_26 "";
BA_ "EventCommandSignal" SG_ 539 SGU26_Obj_DistLat_rms 0;
BA_ "GatewayedSignals" SG_ 539 SGU26_Obj_DistLat_rms 0;
BA_ "GenSigInactiveValue" SG_ 539 SGU26_Obj_DistLat_rms 0;
BA_ "GenSigInvalidValue" SG_ 539 SGU26_Obj_DistLat_rms 0;
BA_ "GenSigSendType" SG_ 539 SGU26_Obj_DistLat_rms 1;
BA_ "GenSigStartValue" SG_ 539 SGU26_Obj_DistLat_rms 0;
BA_ "GenSigTimeoutValue" SG_ 539 SGU26_Obj_DistLat_rms 0;
BA_ "Remark" SG_ 539 SGU26_Obj_DistLat_rms "";
BA_ "EventCommandSignal" SG_ 539 SGU26_Obj_VrelLong_rms 0;
BA_ "GatewayedSignals" SG_ 539 SGU26_Obj_VrelLong_rms 0;
BA_ "GenSigInactiveValue" SG_ 539 SGU26_Obj_VrelLong_rms 0;
BA_ "GenSigInvalidValue" SG_ 539 SGU26_Obj_VrelLong_rms 0;
BA_ "GenSigSendType" SG_ 539 SGU26_Obj_VrelLong_rms 1;
BA_ "GenSigStartValue" SG_ 539 SGU26_Obj_VrelLong_rms 0;
BA_ "GenSigTimeoutValue" SG_ 539 SGU26_Obj_VrelLong_rms 0;
BA_ "Remark" SG_ 539 SGU26_Obj_VrelLong_rms "";
BA_ "EventCommandSignal" SG_ 539 SGU26_Obj_Vrelat_rms 0;
BA_ "GatewayedSignals" SG_ 539 SGU26_Obj_Vrelat_rms 0;
BA_ "GenSigInactiveValue" SG_ 539 SGU26_Obj_Vrelat_rms 0;
BA_ "GenSigInvalidValue" SG_ 539 SGU26_Obj_Vrelat_rms 0;
BA_ "GenSigSendType" SG_ 539 SGU26_Obj_Vrelat_rms 1;
BA_ "GenSigStartValue" SG_ 539 SGU26_Obj_Vrelat_rms 0;
BA_ "GenSigTimeoutValue" SG_ 539 SGU26_Obj_Vrelat_rms 0;
BA_ "Remark" SG_ 539 SGU26_Obj_Vrelat_rms "";
BA_ "EventCommandSignal" SG_ 539 SGU26_Object_DetStatus 0;
BA_ "GatewayedSignals" SG_ 539 SGU26_Object_DetStatus 0;
BA_ "GenSigInactiveValue" SG_ 539 SGU26_Object_DetStatus 0;
BA_ "GenSigInvalidValue" SG_ 539 SGU26_Object_DetStatus 0;
BA_ "GenSigSendType" SG_ 539 SGU26_Object_DetStatus 1;
BA_ "GenSigStartValue" SG_ 539 SGU26_Object_DetStatus 0;
BA_ "GenSigTimeoutValue" SG_ 539 SGU26_Object_DetStatus 0;
BA_ "Remark" SG_ 539 SGU26_Object_DetStatus "";
BA_ "EventCommandSignal" SG_ 539 SGU26_Object_DistLong_rms 0;
BA_ "GatewayedSignals" SG_ 539 SGU26_Object_DistLong_rms 0;
BA_ "GenSigInactiveValue" SG_ 539 SGU26_Object_DistLong_rms 0;
BA_ "GenSigInvalidValue" SG_ 539 SGU26_Object_DistLong_rms 0;
BA_ "GenSigSendType" SG_ 539 SGU26_Object_DistLong_rms 1;
BA_ "GenSigStartValue" SG_ 539 SGU26_Object_DistLong_rms 0;
BA_ "GenSigTimeoutValue" SG_ 539 SGU26_Object_DistLong_rms 0;
BA_ "Remark" SG_ 539 SGU26_Object_DistLong_rms "";
BA_ "EventCommandSignal" SG_ 539 SGU26_Object_ID 0;
BA_ "GatewayedSignals" SG_ 539 SGU26_Object_ID 0;
BA_ "GenSigInactiveValue" SG_ 539 SGU26_Object_ID 0;
BA_ "GenSigInvalidValue" SG_ 539 SGU26_Object_ID 0;
BA_ "GenSigSendType" SG_ 539 SGU26_Object_ID 1;
BA_ "GenSigStartValue" SG_ 539 SGU26_Object_ID 0;
BA_ "GenSigTimeoutValue" SG_ 539 SGU26_Object_ID 0;
BA_ "Remark" SG_ 539 SGU26_Object_ID "";
BA_ "EventCommandSignal" SG_ 539 SGU26_Object_Motion_Pattern 0;
BA_ "GatewayedSignals" SG_ 539 SGU26_Object_Motion_Pattern 0;
BA_ "GenSigInactiveValue" SG_ 539 SGU26_Object_Motion_Pattern 0;
BA_ "GenSigInvalidValue" SG_ 539 SGU26_Object_Motion_Pattern 0;
BA_ "GenSigSendType" SG_ 539 SGU26_Object_Motion_Pattern 1;
BA_ "GenSigStartValue" SG_ 539 SGU26_Object_Motion_Pattern 0;
BA_ "GenSigTimeoutValue" SG_ 539 SGU26_Object_Motion_Pattern 0;
BA_ "Remark" SG_ 539 SGU26_Object_Motion_Pattern "";
BA_ "EventCommandSignal" SG_ 539 SGU26_Object_Type 0;
BA_ "GatewayedSignals" SG_ 539 SGU26_Object_Type 0;
BA_ "GenSigInactiveValue" SG_ 539 SGU26_Object_Type 0;
BA_ "GenSigInvalidValue" SG_ 539 SGU26_Object_Type 0;
BA_ "GenSigSendType" SG_ 539 SGU26_Object_Type 1;
BA_ "GenSigStartValue" SG_ 539 SGU26_Object_Type 0;
BA_ "GenSigTimeoutValue" SG_ 539 SGU26_Object_Type 0;
BA_ "Remark" SG_ 539 SGU26_Object_Type "";
BA_ "EventCommandSignal" SG_ 539 SGU26_Object_ax 0;
BA_ "GatewayedSignals" SG_ 539 SGU26_Object_ax 0;
BA_ "GenSigInactiveValue" SG_ 539 SGU26_Object_ax 0;
BA_ "GenSigInvalidValue" SG_ 539 SGU26_Object_ax 0;
BA_ "GenSigSendType" SG_ 539 SGU26_Object_ax 1;
BA_ "GenSigStartValue" SG_ 539 SGU26_Object_ax 0;
BA_ "GenSigTimeoutValue" SG_ 539 SGU26_Object_ax 0;
BA_ "Remark" SG_ 539 SGU26_Object_ax "";
BA_ "EventCommandSignal" SG_ 539 SGU26_Object_ay 0;
BA_ "GatewayedSignals" SG_ 539 SGU26_Object_ay 0;
BA_ "GenSigInactiveValue" SG_ 539 SGU26_Object_ay 0;
BA_ "GenSigInvalidValue" SG_ 539 SGU26_Object_ay 0;
BA_ "GenSigSendType" SG_ 539 SGU26_Object_ay 1;
BA_ "GenSigStartValue" SG_ 539 SGU26_Object_ay 0;
BA_ "GenSigTimeoutValue" SG_ 539 SGU26_Object_ay 0;
BA_ "Remark" SG_ 539 SGU26_Object_ay "";
BA_ "EventCommandSignal" SG_ 539 SGU26_Object_dx 0;
BA_ "GatewayedSignals" SG_ 539 SGU26_Object_dx 0;
BA_ "GenSigInactiveValue" SG_ 539 SGU26_Object_dx 0;
BA_ "GenSigInvalidValue" SG_ 539 SGU26_Object_dx 0;
BA_ "GenSigSendType" SG_ 539 SGU26_Object_dx 1;
BA_ "GenSigStartValue" SG_ 539 SGU26_Object_dx 0;
BA_ "GenSigTimeoutValue" SG_ 539 SGU26_Object_dx 0;
BA_ "Remark" SG_ 539 SGU26_Object_dx "";
BA_ "EventCommandSignal" SG_ 539 SGU26_Object_dx_Rear 0;
BA_ "GatewayedSignals" SG_ 539 SGU26_Object_dx_Rear 0;
BA_ "GenSigInactiveValue" SG_ 539 SGU26_Object_dx_Rear 0;
BA_ "GenSigInvalidValue" SG_ 539 SGU26_Object_dx_Rear 0;
BA_ "GenSigSendType" SG_ 539 SGU26_Object_dx_Rear 1;
BA_ "GenSigStartValue" SG_ 539 SGU26_Object_dx_Rear 0;
BA_ "GenSigTimeoutValue" SG_ 539 SGU26_Object_dx_Rear 0;
BA_ "Remark" SG_ 539 SGU26_Object_dx_Rear "";
BA_ "EventCommandSignal" SG_ 539 SGU26_Object_dy 0;
BA_ "GatewayedSignals" SG_ 539 SGU26_Object_dy 0;
BA_ "GenSigInactiveValue" SG_ 539 SGU26_Object_dy 0;
BA_ "GenSigInvalidValue" SG_ 539 SGU26_Object_dy 0;
BA_ "GenSigSendType" SG_ 539 SGU26_Object_dy 1;
BA_ "GenSigStartValue" SG_ 539 SGU26_Object_dy 0;
BA_ "GenSigTimeoutValue" SG_ 539 SGU26_Object_dy 0;
BA_ "Remark" SG_ 539 SGU26_Object_dy "";
BA_ "EventCommandSignal" SG_ 539 SGU26_Object_dy_Rear 0;
BA_ "GatewayedSignals" SG_ 539 SGU26_Object_dy_Rear 0;
BA_ "GenSigInactiveValue" SG_ 539 SGU26_Object_dy_Rear 0;
BA_ "GenSigInvalidValue" SG_ 539 SGU26_Object_dy_Rear 0;
BA_ "GenSigSendType" SG_ 539 SGU26_Object_dy_Rear 1;
BA_ "GenSigStartValue" SG_ 539 SGU26_Object_dy_Rear 0;
BA_ "GenSigTimeoutValue" SG_ 539 SGU26_Object_dy_Rear 0;
BA_ "Remark" SG_ 539 SGU26_Object_dy_Rear "";
BA_ "EventCommandSignal" SG_ 539 SGU26_Object_vx 0;
BA_ "GatewayedSignals" SG_ 539 SGU26_Object_vx 0;
BA_ "GenSigInactiveValue" SG_ 539 SGU26_Object_vx 0;
BA_ "GenSigInvalidValue" SG_ 539 SGU26_Object_vx 0;
BA_ "GenSigSendType" SG_ 539 SGU26_Object_vx 1;
BA_ "GenSigStartValue" SG_ 539 SGU26_Object_vx 0;
BA_ "GenSigTimeoutValue" SG_ 539 SGU26_Object_vx 0;
BA_ "Remark" SG_ 539 SGU26_Object_vx "";
BA_ "EventCommandSignal" SG_ 539 SGU26_Object_vy 0;
BA_ "GatewayedSignals" SG_ 539 SGU26_Object_vy 0;
BA_ "GenSigInactiveValue" SG_ 539 SGU26_Object_vy 0;
BA_ "GenSigInvalidValue" SG_ 539 SGU26_Object_vy 0;
BA_ "GenSigSendType" SG_ 539 SGU26_Object_vy 1;
BA_ "GenSigStartValue" SG_ 539 SGU26_Object_vy 0;
BA_ "GenSigTimeoutValue" SG_ 539 SGU26_Object_vy 0;
BA_ "Remark" SG_ 539 SGU26_Object_vy "";
BA_ "EventCommandSignal" SG_ 539 SGU26_Object_wExist 0;
BA_ "GatewayedSignals" SG_ 539 SGU26_Object_wExist 0;
BA_ "GenSigInactiveValue" SG_ 539 SGU26_Object_wExist 0;
BA_ "GenSigInvalidValue" SG_ 539 SGU26_Object_wExist 0;
BA_ "GenSigSendType" SG_ 539 SGU26_Object_wExist 1;
BA_ "GenSigStartValue" SG_ 539 SGU26_Object_wExist 0;
BA_ "GenSigTimeoutValue" SG_ 539 SGU26_Object_wExist 0;
BA_ "Remark" SG_ 539 SGU26_Object_wExist "";
BA_ "EventCommandSignal" SG_ 539 SGU26_Object_wObstacle 0;
BA_ "GatewayedSignals" SG_ 539 SGU26_Object_wObstacle 0;
BA_ "GenSigInactiveValue" SG_ 539 SGU26_Object_wObstacle 0;
BA_ "GenSigInvalidValue" SG_ 539 SGU26_Object_wObstacle 0;
BA_ "GenSigSendType" SG_ 539 SGU26_Object_wObstacle 1;
BA_ "GenSigStartValue" SG_ 539 SGU26_Object_wObstacle 0;
BA_ "GenSigTimeoutValue" SG_ 539 SGU26_Object_wObstacle 0;
BA_ "Remark" SG_ 539 SGU26_Object_wObstacle "";
BA_ "EventCommandSignal" SG_ 540 SGU27_BlockCounter 0;
BA_ "GatewayedSignals" SG_ 540 SGU27_BlockCounter 0;
BA_ "GenSigInactiveValue" SG_ 540 SGU27_BlockCounter 0;
BA_ "GenSigInvalidValue" SG_ 540 SGU27_BlockCounter 0;
BA_ "GenSigSendType" SG_ 540 SGU27_BlockCounter 1;
BA_ "GenSigStartValue" SG_ 540 SGU27_BlockCounter 0;
BA_ "GenSigTimeoutValue" SG_ 540 SGU27_BlockCounter 0;
BA_ "Remark" SG_ 540 SGU27_BlockCounter "";
BA_ "EventCommandSignal" SG_ 540 SGU27_LifeCycles_OBJ 0;
BA_ "GatewayedSignals" SG_ 540 SGU27_LifeCycles_OBJ 0;
BA_ "GenSigInactiveValue" SG_ 540 SGU27_LifeCycles_OBJ 0;
BA_ "GenSigInvalidValue" SG_ 540 SGU27_LifeCycles_OBJ 0;
BA_ "GenSigSendType" SG_ 540 SGU27_LifeCycles_OBJ 1;
BA_ "GenSigStartValue" SG_ 540 SGU27_LifeCycles_OBJ 0;
BA_ "GenSigTimeoutValue" SG_ 540 SGU27_LifeCycles_OBJ 0;
BA_ "Remark" SG_ 540 SGU27_LifeCycles_OBJ "";
BA_ "EventCommandSignal" SG_ 540 SGU27_Msg_AliveCounter 0;
BA_ "GatewayedSignals" SG_ 540 SGU27_Msg_AliveCounter 0;
BA_ "GenSigInactiveValue" SG_ 540 SGU27_Msg_AliveCounter 0;
BA_ "GenSigInvalidValue" SG_ 540 SGU27_Msg_AliveCounter 0;
BA_ "GenSigSendType" SG_ 540 SGU27_Msg_AliveCounter 1;
BA_ "GenSigStartValue" SG_ 540 SGU27_Msg_AliveCounter 0;
BA_ "GenSigTimeoutValue" SG_ 540 SGU27_Msg_AliveCounter 0;
BA_ "Remark" SG_ 540 SGU27_Msg_AliveCounter "";
BA_ "EventCommandSignal" SG_ 540 SGU27_Msg_CheckSum 0;
BA_ "GatewayedSignals" SG_ 540 SGU27_Msg_CheckSum 0;
BA_ "GenSigInactiveValue" SG_ 540 SGU27_Msg_CheckSum 0;
BA_ "GenSigInvalidValue" SG_ 540 SGU27_Msg_CheckSum 0;
BA_ "GenSigSendType" SG_ 540 SGU27_Msg_CheckSum 1;
BA_ "GenSigStartValue" SG_ 540 SGU27_Msg_CheckSum 0;
BA_ "GenSigTimeoutValue" SG_ 540 SGU27_Msg_CheckSum 0;
BA_ "Remark" SG_ 540 SGU27_Msg_CheckSum "";
BA_ "EventCommandSignal" SG_ 540 SGU27_ObjRCS_27 0;
BA_ "GatewayedSignals" SG_ 540 SGU27_ObjRCS_27 0;
BA_ "GenSigInactiveValue" SG_ 540 SGU27_ObjRCS_27 0;
BA_ "GenSigInvalidValue" SG_ 540 SGU27_ObjRCS_27 0;
BA_ "GenSigSendType" SG_ 540 SGU27_ObjRCS_27 1;
BA_ "GenSigStartValue" SG_ 540 SGU27_ObjRCS_27 0;
BA_ "GenSigTimeoutValue" SG_ 540 SGU27_ObjRCS_27 0;
BA_ "Remark" SG_ 540 SGU27_ObjRCS_27 "";
BA_ "EventCommandSignal" SG_ 540 SGU27_Obj_DistLat_rms 0;
BA_ "GatewayedSignals" SG_ 540 SGU27_Obj_DistLat_rms 0;
BA_ "GenSigInactiveValue" SG_ 540 SGU27_Obj_DistLat_rms 0;
BA_ "GenSigInvalidValue" SG_ 540 SGU27_Obj_DistLat_rms 0;
BA_ "GenSigSendType" SG_ 540 SGU27_Obj_DistLat_rms 1;
BA_ "GenSigStartValue" SG_ 540 SGU27_Obj_DistLat_rms 0;
BA_ "GenSigTimeoutValue" SG_ 540 SGU27_Obj_DistLat_rms 0;
BA_ "Remark" SG_ 540 SGU27_Obj_DistLat_rms "";
BA_ "EventCommandSignal" SG_ 540 SGU27_Obj_VrelLong_rms 0;
BA_ "GatewayedSignals" SG_ 540 SGU27_Obj_VrelLong_rms 0;
BA_ "GenSigInactiveValue" SG_ 540 SGU27_Obj_VrelLong_rms 0;
BA_ "GenSigInvalidValue" SG_ 540 SGU27_Obj_VrelLong_rms 0;
BA_ "GenSigSendType" SG_ 540 SGU27_Obj_VrelLong_rms 1;
BA_ "GenSigStartValue" SG_ 540 SGU27_Obj_VrelLong_rms 0;
BA_ "GenSigTimeoutValue" SG_ 540 SGU27_Obj_VrelLong_rms 0;
BA_ "Remark" SG_ 540 SGU27_Obj_VrelLong_rms "";
BA_ "EventCommandSignal" SG_ 540 SGU27_Obj_Vrelat_rms 0;
BA_ "GatewayedSignals" SG_ 540 SGU27_Obj_Vrelat_rms 0;
BA_ "GenSigInactiveValue" SG_ 540 SGU27_Obj_Vrelat_rms 0;
BA_ "GenSigInvalidValue" SG_ 540 SGU27_Obj_Vrelat_rms 0;
BA_ "GenSigSendType" SG_ 540 SGU27_Obj_Vrelat_rms 1;
BA_ "GenSigStartValue" SG_ 540 SGU27_Obj_Vrelat_rms 0;
BA_ "GenSigTimeoutValue" SG_ 540 SGU27_Obj_Vrelat_rms 0;
BA_ "Remark" SG_ 540 SGU27_Obj_Vrelat_rms "";
BA_ "EventCommandSignal" SG_ 540 SGU27_Object_DetStatus 0;
BA_ "GatewayedSignals" SG_ 540 SGU27_Object_DetStatus 0;
BA_ "GenSigInactiveValue" SG_ 540 SGU27_Object_DetStatus 0;
BA_ "GenSigInvalidValue" SG_ 540 SGU27_Object_DetStatus 0;
BA_ "GenSigSendType" SG_ 540 SGU27_Object_DetStatus 1;
BA_ "GenSigStartValue" SG_ 540 SGU27_Object_DetStatus 0;
BA_ "GenSigTimeoutValue" SG_ 540 SGU27_Object_DetStatus 0;
BA_ "Remark" SG_ 540 SGU27_Object_DetStatus "";
BA_ "EventCommandSignal" SG_ 540 SGU27_Object_DistLong_rms 0;
BA_ "GatewayedSignals" SG_ 540 SGU27_Object_DistLong_rms 0;
BA_ "GenSigInactiveValue" SG_ 540 SGU27_Object_DistLong_rms 0;
BA_ "GenSigInvalidValue" SG_ 540 SGU27_Object_DistLong_rms 0;
BA_ "GenSigSendType" SG_ 540 SGU27_Object_DistLong_rms 1;
BA_ "GenSigStartValue" SG_ 540 SGU27_Object_DistLong_rms 0;
BA_ "GenSigTimeoutValue" SG_ 540 SGU27_Object_DistLong_rms 0;
BA_ "Remark" SG_ 540 SGU27_Object_DistLong_rms "";
BA_ "EventCommandSignal" SG_ 540 SGU27_Object_ID 0;
BA_ "GatewayedSignals" SG_ 540 SGU27_Object_ID 0;
BA_ "GenSigInactiveValue" SG_ 540 SGU27_Object_ID 0;
BA_ "GenSigInvalidValue" SG_ 540 SGU27_Object_ID 0;
BA_ "GenSigSendType" SG_ 540 SGU27_Object_ID 1;
BA_ "GenSigStartValue" SG_ 540 SGU27_Object_ID 0;
BA_ "GenSigTimeoutValue" SG_ 540 SGU27_Object_ID 0;
BA_ "Remark" SG_ 540 SGU27_Object_ID "";
BA_ "EventCommandSignal" SG_ 540 SGU27_Object_Motion_Pattern 0;
BA_ "GatewayedSignals" SG_ 540 SGU27_Object_Motion_Pattern 0;
BA_ "GenSigInactiveValue" SG_ 540 SGU27_Object_Motion_Pattern 0;
BA_ "GenSigInvalidValue" SG_ 540 SGU27_Object_Motion_Pattern 0;
BA_ "GenSigSendType" SG_ 540 SGU27_Object_Motion_Pattern 1;
BA_ "GenSigStartValue" SG_ 540 SGU27_Object_Motion_Pattern 0;
BA_ "GenSigTimeoutValue" SG_ 540 SGU27_Object_Motion_Pattern 0;
BA_ "Remark" SG_ 540 SGU27_Object_Motion_Pattern "";
BA_ "EventCommandSignal" SG_ 540 SGU27_Object_Type 0;
BA_ "GatewayedSignals" SG_ 540 SGU27_Object_Type 0;
BA_ "GenSigInactiveValue" SG_ 540 SGU27_Object_Type 0;
BA_ "GenSigInvalidValue" SG_ 540 SGU27_Object_Type 0;
BA_ "GenSigSendType" SG_ 540 SGU27_Object_Type 1;
BA_ "GenSigStartValue" SG_ 540 SGU27_Object_Type 0;
BA_ "GenSigTimeoutValue" SG_ 540 SGU27_Object_Type 0;
BA_ "Remark" SG_ 540 SGU27_Object_Type "";
BA_ "EventCommandSignal" SG_ 540 SGU27_Object_ax 0;
BA_ "GatewayedSignals" SG_ 540 SGU27_Object_ax 0;
BA_ "GenSigInactiveValue" SG_ 540 SGU27_Object_ax 0;
BA_ "GenSigInvalidValue" SG_ 540 SGU27_Object_ax 0;
BA_ "GenSigSendType" SG_ 540 SGU27_Object_ax 1;
BA_ "GenSigStartValue" SG_ 540 SGU27_Object_ax 0;
BA_ "GenSigTimeoutValue" SG_ 540 SGU27_Object_ax 0;
BA_ "Remark" SG_ 540 SGU27_Object_ax "";
BA_ "EventCommandSignal" SG_ 540 SGU27_Object_ay 0;
BA_ "GatewayedSignals" SG_ 540 SGU27_Object_ay 0;
BA_ "GenSigInactiveValue" SG_ 540 SGU27_Object_ay 0;
BA_ "GenSigInvalidValue" SG_ 540 SGU27_Object_ay 0;
BA_ "GenSigSendType" SG_ 540 SGU27_Object_ay 1;
BA_ "GenSigStartValue" SG_ 540 SGU27_Object_ay 0;
BA_ "GenSigTimeoutValue" SG_ 540 SGU27_Object_ay 0;
BA_ "Remark" SG_ 540 SGU27_Object_ay "";
BA_ "EventCommandSignal" SG_ 540 SGU27_Object_dx 0;
BA_ "GatewayedSignals" SG_ 540 SGU27_Object_dx 0;
BA_ "GenSigInactiveValue" SG_ 540 SGU27_Object_dx 0;
BA_ "GenSigInvalidValue" SG_ 540 SGU27_Object_dx 0;
BA_ "GenSigSendType" SG_ 540 SGU27_Object_dx 1;
BA_ "GenSigStartValue" SG_ 540 SGU27_Object_dx 0;
BA_ "GenSigTimeoutValue" SG_ 540 SGU27_Object_dx 0;
BA_ "Remark" SG_ 540 SGU27_Object_dx "";
BA_ "EventCommandSignal" SG_ 540 SGU27_Object_dx_Rear 0;
BA_ "GatewayedSignals" SG_ 540 SGU27_Object_dx_Rear 0;
BA_ "GenSigInactiveValue" SG_ 540 SGU27_Object_dx_Rear 0;
BA_ "GenSigInvalidValue" SG_ 540 SGU27_Object_dx_Rear 0;
BA_ "GenSigSendType" SG_ 540 SGU27_Object_dx_Rear 1;
BA_ "GenSigStartValue" SG_ 540 SGU27_Object_dx_Rear 0;
BA_ "GenSigTimeoutValue" SG_ 540 SGU27_Object_dx_Rear 0;
BA_ "Remark" SG_ 540 SGU27_Object_dx_Rear "";
BA_ "EventCommandSignal" SG_ 540 SGU27_Object_dy 0;
BA_ "GatewayedSignals" SG_ 540 SGU27_Object_dy 0;
BA_ "GenSigInactiveValue" SG_ 540 SGU27_Object_dy 0;
BA_ "GenSigInvalidValue" SG_ 540 SGU27_Object_dy 0;
BA_ "GenSigSendType" SG_ 540 SGU27_Object_dy 1;
BA_ "GenSigStartValue" SG_ 540 SGU27_Object_dy 0;
BA_ "GenSigTimeoutValue" SG_ 540 SGU27_Object_dy 0;
BA_ "Remark" SG_ 540 SGU27_Object_dy "";
BA_ "EventCommandSignal" SG_ 540 SGU27_Object_dy_Rear 0;
BA_ "GatewayedSignals" SG_ 540 SGU27_Object_dy_Rear 0;
BA_ "GenSigInactiveValue" SG_ 540 SGU27_Object_dy_Rear 0;
BA_ "GenSigInvalidValue" SG_ 540 SGU27_Object_dy_Rear 0;
BA_ "GenSigSendType" SG_ 540 SGU27_Object_dy_Rear 1;
BA_ "GenSigStartValue" SG_ 540 SGU27_Object_dy_Rear 0;
BA_ "GenSigTimeoutValue" SG_ 540 SGU27_Object_dy_Rear 0;
BA_ "Remark" SG_ 540 SGU27_Object_dy_Rear "";
BA_ "EventCommandSignal" SG_ 540 SGU27_Object_vx 0;
BA_ "GatewayedSignals" SG_ 540 SGU27_Object_vx 0;
BA_ "GenSigInactiveValue" SG_ 540 SGU27_Object_vx 0;
BA_ "GenSigInvalidValue" SG_ 540 SGU27_Object_vx 0;
BA_ "GenSigSendType" SG_ 540 SGU27_Object_vx 1;
BA_ "GenSigStartValue" SG_ 540 SGU27_Object_vx 0;
BA_ "GenSigTimeoutValue" SG_ 540 SGU27_Object_vx 0;
BA_ "Remark" SG_ 540 SGU27_Object_vx "";
BA_ "EventCommandSignal" SG_ 540 SGU27_Object_vy 0;
BA_ "GatewayedSignals" SG_ 540 SGU27_Object_vy 0;
BA_ "GenSigInactiveValue" SG_ 540 SGU27_Object_vy 0;
BA_ "GenSigInvalidValue" SG_ 540 SGU27_Object_vy 0;
BA_ "GenSigSendType" SG_ 540 SGU27_Object_vy 1;
BA_ "GenSigStartValue" SG_ 540 SGU27_Object_vy 0;
BA_ "GenSigTimeoutValue" SG_ 540 SGU27_Object_vy 0;
BA_ "Remark" SG_ 540 SGU27_Object_vy "";
BA_ "EventCommandSignal" SG_ 540 SGU27_Object_wExist 0;
BA_ "GatewayedSignals" SG_ 540 SGU27_Object_wExist 0;
BA_ "GenSigInactiveValue" SG_ 540 SGU27_Object_wExist 0;
BA_ "GenSigInvalidValue" SG_ 540 SGU27_Object_wExist 0;
BA_ "GenSigSendType" SG_ 540 SGU27_Object_wExist 1;
BA_ "GenSigStartValue" SG_ 540 SGU27_Object_wExist 0;
BA_ "GenSigTimeoutValue" SG_ 540 SGU27_Object_wExist 0;
BA_ "Remark" SG_ 540 SGU27_Object_wExist "";
BA_ "EventCommandSignal" SG_ 540 SGU27_Object_wObstacle 0;
BA_ "GatewayedSignals" SG_ 540 SGU27_Object_wObstacle 0;
BA_ "GenSigInactiveValue" SG_ 540 SGU27_Object_wObstacle 0;
BA_ "GenSigInvalidValue" SG_ 540 SGU27_Object_wObstacle 0;
BA_ "GenSigSendType" SG_ 540 SGU27_Object_wObstacle 1;
BA_ "GenSigStartValue" SG_ 540 SGU27_Object_wObstacle 0;
BA_ "GenSigTimeoutValue" SG_ 540 SGU27_Object_wObstacle 0;
BA_ "Remark" SG_ 540 SGU27_Object_wObstacle "";
BA_ "MsgType" BO_ 526 0;
BA_ "MsgType" BO_ 527 0;
BA_ "MsgType" BO_ 528 0;
BA_ "MsgType" BO_ 529 0;
BA_ "MsgType" BO_ 530 0;
BA_ "MsgType" BO_ 531 0;
BA_ "MsgType" BO_ 532 0;
BA_ "MsgType" BO_ 533 0;
BA_ "MsgType" BO_ 534 0;
BA_ "MsgType" BO_ 535 0;
BA_ "MsgType" BO_ 536 0;
BA_ "MsgType" BO_ 537 0;
BA_ "MsgType" BO_ 538 0;
BA_ "MsgType" BO_ 539 0;
BA_ "MsgType" BO_ 540 0;
BA_ "IsCrcSignal" SG_ 526 SGU13_Msg_CheckSum 1;
BA_ "IsCrcSignal" SG_ 527 SGU14_Msg_CheckSum 1;
BA_ "IsCrcSignal" SG_ 528 SGU15_Msg_CheckSum 1;
BA_ "IsCrcSignal" SG_ 529 SGU16_Msg_CheckSum 1;
BA_ "IsCrcSignal" SG_ 530 SGU17_Msg_CheckSum 1;
BA_ "IsCrcSignal" SG_ 531 SGU18_Msg_CheckSum 1;
BA_ "IsCrcSignal" SG_ 532 SGU19_Msg_CheckSum 1;
BA_ "IsCrcSignal" SG_ 533 SGU20_Msg_CheckSum 1;
BA_ "IsCrcSignal" SG_ 534 SGU21_Msg_CheckSum 1;
BA_ "IsCrcSignal" SG_ 535 SGU22_Msg_CheckSum 1;
BA_ "IsCrcSignal" SG_ 536 SGU23_Msg_CheckSum 1;
BA_ "IsCrcSignal" SG_ 537 SGU24_Msg_CheckSum 1;
BA_ "IsCrcSignal" SG_ 538 SGU25_Msg_CheckSum 1;
BA_ "IsCrcSignal" SG_ 539 SGU26_Msg_CheckSum 1;
BA_ "IsCrcSignal" SG_ 540 SGU27_Msg_CheckSum 1;
VAL_ 526 SGU13_Object_DetStatus 0 "deleted" 1 "new" 2 "measured" 3 "predicted" 4 "deleted for merge" 5 "new from  merge"  ;
VAL_ 526 SGU13_Object_Motion_Pattern 0 "Unknown" 1 "Stationary" 2 "Stopped" 3 "Moving"  ;
VAL_ 526 SGU13_Object_Type 0 "Unknown" 1 "4 wheeler" 2 "2 wheeler" 3 "Pedestrian"  ;
VAL_ 527 SGU14_Object_DetStatus 0 "deleted" 1 "new" 2 "measured" 3 "predicted" 4 "deleted for merge" 5 "new from  merge"  ;
VAL_ 527 SGU14_Object_Motion_Pattern 0 "Unknown" 1 "Stationary" 2 "Stopped" 3 "Moving"  ;
VAL_ 527 SGU14_Object_Type 0 "Unknown" 1 "4 wheeler" 2 "2 wheeler" 3 "Pedestrian"  ;
VAL_ 528 SGU15_Object_DetStatus 0 "deleted" 1 "new" 2 "measured" 3 "predicted" 4 "deleted for merge" 5 "new from  merge"  ;
VAL_ 528 SGU15_Object_Motion_Pattern 0 "Unknown" 1 "Stationary" 2 "Stopped" 3 "Moving"  ;
VAL_ 528 SGU15_Object_Type 0 "Unknown" 1 "4 wheeler" 2 "2 wheeler" 3 "Pedestrian"  ;
VAL_ 529 SGU16_Object_DetStatus 0 "deleted" 1 "new" 2 "measured" 3 "predicted" 4 "deleted for merge" 5 "new from  merge"  ;
VAL_ 529 SGU16_Object_Motion_Pattern 0 "Unknown" 1 "Stationary" 2 "Stopped" 3 "Moving"  ;
VAL_ 529 SGU16_Object_Type 0 "Unknown" 1 "4 wheeler" 2 "2 wheeler" 3 "Pedestrian"  ;
VAL_ 530 SGU17_Object_DetStatus 0 "deleted" 1 "new" 2 "measured" 3 "predicted" 4 "deleted for merge" 5 "new from  merge"  ;
VAL_ 530 SGU17_Object_Motion_Pattern 0 "Unknown" 1 "Stationary" 2 "Stopped" 3 "Moving"  ;
VAL_ 530 SGU17_Object_Type 0 "Unknown" 1 "4 wheeler" 2 "2 wheeler" 3 "Pedestrian"  ;
VAL_ 531 SGU18_Object_DetStatus 0 "deleted" 1 "new" 2 "measured" 3 "predicted" 4 "deleted for merge" 5 "new from  merge"  ;
VAL_ 531 SGU18_Object_Motion_Pattern 0 "Unknown" 1 "Stationary" 2 "Stopped" 3 "Moving"  ;
VAL_ 531 SGU18_Object_Type 0 "Unknown" 1 "4 wheeler" 2 "2 wheeler" 3 "Pedestrian"  ;
VAL_ 532 SGU19_Object_DetStatus 0 "deleted" 1 "new" 2 "measured" 3 "predicted" 4 "deleted for merge" 5 "new from  merge"  ;
VAL_ 532 SGU19_Object_Motion_Pattern 0 "Unknown" 1 "Stationary" 2 "Stopped" 3 "Moving"  ;
VAL_ 532 SGU19_Object_Type 0 "Unknown" 1 "4 wheeler" 2 "2 wheeler" 3 "Pedestrian"  ;
VAL_ 533 SGU20_Object_DetStatus 0 "deleted" 1 "new" 2 "measured" 3 "predicted" 4 "deleted for merge" 5 "new from  merge"  ;
VAL_ 533 SGU20_Object_Motion_Pattern 0 "Unknown" 1 "Stationary" 2 "Stopped" 3 "Moving"  ;
VAL_ 533 SGU20_Object_Type 0 "Unknown" 1 "4 wheeler" 2 "2 wheeler" 3 "Pedestrian"  ;
VAL_ 534 SGU21_Object_DetStatus 0 "deleted" 1 "new" 2 "measured" 3 "predicted" 4 "deleted for merge" 5 "new from  merge"  ;
VAL_ 534 SGU21_Object_Motion_Pattern 0 "Unknown" 1 "Stationary" 2 "Stopped" 3 "Moving"  ;
VAL_ 534 SGU21_Object_Type 0 "Unknown" 1 "4 wheeler" 2 "2 wheeler" 3 "Pedestrian"  ;
VAL_ 535 SGU22_Object_DetStatus 0 "deleted" 1 "new" 2 "measured" 3 "predicted" 4 "deleted for merge" 5 "new from  merge"  ;
VAL_ 535 SGU22_Object_Motion_Pattern 0 "Unknown" 1 "Stationary" 2 "Stopped" 3 "Moving"  ;
VAL_ 535 SGU22_Object_Type 0 "Unknown" 1 "4 wheeler" 2 "2 wheeler" 3 "Pedestrian"  ;
VAL_ 536 SGU23_Object_DetStatus 0 "deleted" 1 "new" 2 "measured" 3 "predicted" 4 "deleted for merge" 5 "new from  merge"  ;
VAL_ 536 SGU23_Object_Motion_Pattern 0 "Unknown" 1 "Stationary" 2 "Stopped" 3 "Moving"  ;
VAL_ 536 SGU23_Object_Type 0 "Unknown" 1 "4 wheeler" 2 "2 wheeler" 3 "Pedestrian"  ;
VAL_ 537 SGU24_Object_DetStatus 0 "deleted" 1 "new" 2 "measured" 3 "predicted" 4 "deleted for merge" 5 "new from  merge"  ;
VAL_ 537 SGU24_Object_Motion_Pattern 0 "Unknown" 1 "Stationary" 2 "Stopped" 3 "Moving"  ;
VAL_ 537 SGU24_Object_Type 0 "Unknown" 1 "4 wheeler" 2 "2 wheeler" 3 "Pedestrian"  ;
VAL_ 538 SGU25_Object_DetStatus 0 "deleted" 1 "new" 2 "measured" 3 "predicted" 4 "deleted for merge" 5 "new from  merge"  ;
VAL_ 538 SGU25_Object_Motion_Pattern 0 "Unknown" 1 "Stationary" 2 "Stopped" 3 "Moving"  ;
VAL_ 538 SGU25_Object_Type 0 "Unknown" 1 "4 wheeler" 2 "2 wheeler" 3 "Pedestrian"  ;
VAL_ 539 SGU26_Object_DetStatus 0 "deleted" 1 "new" 2 "measured" 3 "predicted" 4 "deleted for merge" 5 "new from  merge"  ;
VAL_ 539 SGU26_Object_Motion_Pattern 0 "Unknown" 1 "Stationary" 2 "Stopped" 3 "Moving"  ;
VAL_ 539 SGU26_Object_Type 0 "Unknown" 1 "4 wheeler" 2 "2 wheeler" 3 "Pedestrian"  ;
VAL_ 540 SGU27_Object_DetStatus 0 "deleted" 1 "new" 2 "measured" 3 "predicted" 4 "deleted for merge" 5 "new from  merge"  ;
VAL_ 540 SGU27_Object_Motion_Pattern 0 "Unknown" 1 "Stationary" 2 "Stopped" 3 "Moving"  ;
VAL_ 540 SGU27_Object_Type 0 "Unknown" 1 "4 wheeler" 2 "2 wheeler" 3 "Pedestrian"  ;
