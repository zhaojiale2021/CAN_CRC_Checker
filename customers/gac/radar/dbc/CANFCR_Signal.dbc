VERSION "Version"

NS_ :

BS_:

BU_: ADC FLR FRR Tester

BO_ 776 FRR_Obj_07: 32 FRR
 SG_ SGU7_Msg_CheckSum : 7|8@0+ (1,0) [0|255] ""  ADC
 SG_ SGU7_Msg_AliveCounter : 11|4@0+ (1,0) [0|14] ""  ADC
 SG_ SGU7_BlockCounter : 15|4@0+ (1,0) [0|15] ""  ADC
 SG_ SGU7_Object_ID : 23|8@0+ (1,0) [0|255] ""  ADC
 SG_ SGU7_Object_wExist : 28|5@0+ (0.03125,0) [0|0.96875] ""  ADC
 SG_ SGU7_Object_Type : 31|3@0+ (1,0) [0|7] ""  ADC
 SG_ SGU7_Object_Motion_Pattern : 34|3@0+ (1,0) [0|7] ""  ADC
 SG_ SGU7_Object_wObstacle : 39|5@0+ (0.03125,0) [0|0.96875] ""  ADC
 SG_ SGU7_Object_dx : 43|12@0+ (0.0625,-128) [-128|127.9375] "m"  ADC
 SG_ SGU7_Object_dy : 59|12@0+ (0.125,-128) [-128|127.875] "m"  ADC
 SG_ SGU7_Object_DistLong_rms : 79|16@0+ (0.001953125,0) [0|127.998046875] "m"  ADC
 SG_ SGU7_Obj_DistLat_rms : 95|16@0+ (0.001953125,0) [0|127.998046875] "m"  ADC
 SG_ SGU7_Object_vx : 107|12@0+ (0.0625,-128) [-128|127.9375] "m/s"  ADC
 SG_ SGU7_Object_vy : 123|12@0+ (0.0625,-128) [-128|127.9375] "m/s"  ADC
 SG_ SGU7_Obj_VrelLong_rms : 143|16@0+ (0.001953125,0) [0|127.998046875] "m/s"  ADC
 SG_ SGU7_Obj_Vrelat_rms : 159|16@0+ (0.001953125,0) [0|127.998046875] "m/s"  ADC
 SG_ SGU7_Object_ax : 170|11@0+ (0.03125,-16) [-16|15.96875] "m/s^2"  ADC
 SG_ SGU7_Object_ay : 191|11@0+ (0.03125,-16) [-16|15.96875] "m/s^2"  ADC
 SG_ SGU7_Object_DetStatus : 173|3@0+ (1,0) [0|7] ""  ADC
 SG_ SGU7_LifeCycles_OBJ : 196|8@0+ (1,0) [0|255] ""  ADC
 SG_ SGU7_ObjRCS_07 : 204|10@0+ (0.125,-50) [-50|70] "dBm2"  ADC
 SG_ SGU7_Object_dx_Rear : 209|12@0+ (0.0625,-128) [-128|127.9375] "m"  ADC
 SG_ SGU7_Object_dy_Rear : 229|12@0+ (0.125,-128) [-128|127.875] "m"  ADC

BO_ 777 FRR_Obj_08: 32 FRR
 SG_ SGU8_Msg_CheckSum : 7|8@0+ (1,0) [0|255] ""  ADC
 SG_ SGU8_Msg_AliveCounter : 11|4@0+ (1,0) [0|14] ""  ADC
 SG_ SGU8_BlockCounter : 15|4@0+ (1,0) [0|15] ""  ADC
 SG_ SGU8_Object_ID : 23|8@0+ (1,0) [0|255] ""  ADC
 SG_ SGU8_Object_wExist : 28|5@0+ (0.03125,0) [0|0.96875] ""  ADC
 SG_ SGU8_Object_Type : 31|3@0+ (1,0) [0|7] ""  ADC
 SG_ SGU8_Object_Motion_Pattern : 34|3@0+ (1,0) [0|7] ""  ADC
 SG_ SGU8_Object_wObstacle : 39|5@0+ (0.03125,0) [0|0.96875] ""  ADC
 SG_ SGU8_Object_dx : 43|12@0+ (0.0625,-128) [-128|127.9375] "m"  ADC
 SG_ SGU8_Object_dy : 59|12@0+ (0.125,-128) [-128|127.875] "m"  ADC
 SG_ SGU8_Object_DistLong_rms : 79|16@0+ (0.001953125,0) [0|127.998046875] "m"  ADC
 SG_ SGU8_Obj_DistLat_rms : 95|16@0+ (0.001953125,0) [0|127.998046875] "m"  ADC
 SG_ SGU8_Object_vx : 107|12@0+ (0.0625,-128) [-128|127.9375] "m/s"  ADC
 SG_ SGU8_Object_vy : 123|12@0+ (0.0625,-128) [-128|127.9375] "m/s"  ADC
 SG_ SGU8_Obj_VrelLong_rms : 143|16@0+ (0.001953125,0) [0|127.998046875] "m/s"  ADC
 SG_ SGU8_Obj_Vrelat_rms : 159|16@0+ (0.001953125,0) [0|127.998046875] "m/s"  ADC
 SG_ SGU8_Object_ax : 170|11@0+ (0.03125,-16) [-16|15.96875] "m/s^2"  ADC
 SG_ SGU8_Object_ay : 191|11@0+ (0.03125,-16) [-16|15.96875] "m/s^2"  ADC
 SG_ SGU8_Object_DetStatus : 173|3@0+ (1,0) [0|7] ""  ADC
 SG_ SGU8_LifeCycles_OBJ : 196|8@0+ (1,0) [0|255] ""  ADC
 SG_ SGU8_ObjRCS_08 : 204|10@0+ (0.125,-50) [-50|70] "dBm2"  ADC
 SG_ SGU8_Object_dx_Rear : 209|12@0+ (0.0625,-128) [-128|127.9375] "m"  ADC
 SG_ SGU8_Object_dy_Rear : 229|12@0+ (0.125,-128) [-128|127.875] "m"  ADC

BO_ 778 FRR_Obj_09: 32 FRR
 SG_ SGU9_Msg_CheckSum : 7|8@0+ (1,0) [0|255] ""  ADC
 SG_ SGU9_Msg_AliveCounter : 11|4@0+ (1,0) [0|14] ""  ADC
 SG_ SGU9_BlockCounter : 15|4@0+ (1,0) [0|15] ""  ADC
 SG_ SGU9_Object_ID : 23|8@0+ (1,0) [0|255] ""  ADC
 SG_ SGU9_Object_wExist : 28|5@0+ (0.03125,0) [0|0.96875] ""  ADC
 SG_ SGU9_Object_Type : 31|3@0+ (1,0) [0|7] ""  ADC
 SG_ SGU9_Object_Motion_Pattern : 34|3@0+ (1,0) [0|7] ""  ADC
 SG_ SGU9_Object_wObstacle : 39|5@0+ (0.03125,0) [0|0.96875] ""  ADC
 SG_ SGU9_Object_dx : 43|12@0+ (0.0625,-128) [-128|127.9375] "m"  ADC
 SG_ SGU9_Object_dy : 59|12@0+ (0.125,-128) [-128|127.875] "m"  ADC
 SG_ SGU9_Object_DistLong_rms : 79|16@0+ (0.001953125,0) [0|127.998046875] "m"  ADC
 SG_ SGU9_Obj_DistLat_rms : 95|16@0+ (0.001953125,0) [0|127.998046875] "m"  ADC
 SG_ SGU9_Object_vx : 107|12@0+ (0.0625,-128) [-128|127.9375] "m/s"  ADC
 SG_ SGU9_Object_vy : 123|12@0+ (0.0625,-128) [-128|127.9375] "m/s"  ADC
 SG_ SGU9_Obj_VrelLong_rms : 143|16@0+ (0.001953125,0) [0|127.998046875] "m/s"  ADC
 SG_ SGU9_Obj_Vrelat_rms : 159|16@0+ (0.001953125,0) [0|127.998046875] "m/s"  ADC
 SG_ SGU9_Object_ax : 170|11@0+ (0.03125,-16) [-16|15.96875] "m/s^2"  ADC
 SG_ SGU9_Object_ay : 191|11@0+ (0.03125,-16) [-16|15.96875] "m/s^2"  ADC
 SG_ SGU9_Object_DetStatus : 173|3@0+ (1,0) [0|7] ""  ADC
 SG_ SGU9_LifeCycles_OBJ : 196|8@0+ (1,0) [0|255] ""  ADC
 SG_ SGU9_ObjRCS_09 : 204|10@0+ (0.125,-50) [-50|70] "dBm2"  ADC
 SG_ SGU9_Object_dx_Rear : 209|12@0+ (0.0625,-128) [-128|127.9375] "m"  ADC
 SG_ SGU9_Object_dy_Rear : 229|12@0+ (0.125,-128) [-128|127.875] "m"  ADC

BO_ 779 FRR_Obj_10: 32 FRR
 SG_ SGU10_Msg_CheckSum : 7|8@0+ (1,0) [0|255] ""  ADC
 SG_ SGU10_Msg_AliveCounter : 11|4@0+ (1,0) [0|14] ""  ADC
 SG_ SGU10_BlockCounter : 15|4@0+ (1,0) [0|15] ""  ADC
 SG_ SGU10_Object_ID : 23|8@0+ (1,0) [0|255] ""  ADC
 SG_ SGU10_Object_wExist : 28|5@0+ (0.03125,0) [0|0.96875] ""  ADC
 SG_ SGU10_Object_Type : 31|3@0+ (1,0) [0|7] ""  ADC
 SG_ SGU10_Object_Motion_Pattern : 34|3@0+ (1,0) [0|7] ""  ADC
 SG_ SGU10_Object_wObstacle : 39|5@0+ (0.03125,0) [0|0.96875] ""  ADC
 SG_ SGU10_Object_dx : 43|12@0+ (0.0625,-128) [-128|127.9375] "m"  ADC
 SG_ SGU10_Object_dy : 59|12@0+ (0.125,-128) [-128|127.875] "m"  ADC
 SG_ SGU10_Object_DistLong_rms : 79|16@0+ (0.001953125,0) [0|127.998046875] "m"  ADC
 SG_ SGU10_Obj_DistLat_rms : 95|16@0+ (0.001953125,0) [0|127.998046875] "m"  ADC
 SG_ SGU10_Object_vx : 107|12@0+ (0.0625,-128) [-128|127.9375] "m/s"  ADC
 SG_ SGU10_Object_vy : 123|12@0+ (0.0625,-128) [-128|127.9375] "m/s"  ADC
 SG_ SGU10_Obj_VrelLong_rms : 143|16@0+ (0.001953125,0) [0|127.998046875] "m/s"  ADC
 SG_ SGU10_Obj_Vrelat_rms : 159|16@0+ (0.001953125,0) [0|127.998046875] "m/s"  ADC
 SG_ SGU10_Object_ax : 170|11@0+ (0.03125,-16) [-16|15.96875] "m/s^2"  ADC
 SG_ SGU10_Object_ay : 191|11@0+ (0.03125,-16) [-16|15.96875] "m/s^2"  ADC
 SG_ SGU10_Object_DetStatus : 173|3@0+ (1,0) [0|7] ""  ADC
 SG_ SGU10_LifeCycles_OBJ : 196|8@0+ (1,0) [0|255] ""  ADC
 SG_ SGU10_ObjRCS_10 : 204|10@0+ (0.125,-50) [-50|70] "dBm2"  ADC
 SG_ SGU10_Object_dx_Rear : 209|12@0+ (0.0625,-128) [-128|127.9375] "m"  ADC
 SG_ SGU10_Object_dy_Rear : 229|12@0+ (0.125,-128) [-128|127.875] "m"  ADC

BO_ 780 FRR_Obj_11: 32 FRR
 SG_ SGU11_Msg_CheckSum : 7|8@0+ (1,0) [0|255] ""  ADC
 SG_ SGU11_Msg_AliveCounter : 11|4@0+ (1,0) [0|14] ""  ADC
 SG_ SGU11_BlockCounter : 15|4@0+ (1,0) [0|15] ""  ADC
 SG_ SGU11_Object_ID : 23|8@0+ (1,0) [0|255] ""  ADC
 SG_ SGU11_Object_wExist : 28|5@0+ (0.03125,0) [0|0.96875] ""  ADC
 SG_ SGU11_Object_Type : 31|3@0+ (1,0) [0|7] ""  ADC
 SG_ SGU11_Object_Motion_Pattern : 34|3@0+ (1,0) [0|7] ""  ADC
 SG_ SGU11_Object_wObstacle : 39|5@0+ (0.03125,0) [0|0.96875] ""  ADC
 SG_ SGU11_Object_dx : 43|12@0+ (0.0625,-128) [-128|127.9375] "m"  ADC
 SG_ SGU11_Object_dy : 59|12@0+ (0.125,-128) [-128|127.875] "m"  ADC
 SG_ SGU11_Object_DistLong_rms : 79|16@0+ (0.001953125,0) [0|127.998046875] "m"  ADC
 SG_ SGU11_Obj_DistLat_rms : 95|16@0+ (0.001953125,0) [0|127.998046875] "m"  ADC
 SG_ SGU11_Object_vx : 107|12@0+ (0.0625,-128) [-128|127.9375] "m/s"  ADC
 SG_ SGU11_Object_vy : 123|12@0+ (0.0625,-128) [-128|127.9375] "m/s"  ADC
 SG_ SGU11_Obj_VrelLong_rms : 143|16@0+ (0.001953125,0) [0|127.998046875] "m/s"  ADC
 SG_ SGU11_Obj_Vrelat_rms : 159|16@0+ (0.001953125,0) [0|127.998046875] "m/s"  ADC
 SG_ SGU11_Object_ax : 170|11@0+ (0.03125,-16) [-16|15.96875] "m/s^2"  ADC
 SG_ SGU11_Object_ay : 191|11@0+ (0.03125,-16) [-16|15.96875] "m/s^2"  ADC
 SG_ SGU11_Object_DetStatus : 173|3@0+ (1,0) [0|7] ""  ADC
 SG_ SGU11_LifeCycles_OBJ : 196|8@0+ (1,0) [0|255] ""  ADC
 SG_ SGU11_ObjRCS_11 : 204|10@0+ (0.125,-50) [-50|70] "dBm2"  ADC
 SG_ SGU11_Object_dx_Rear : 209|12@0+ (0.0625,-128) [-128|127.9375] "m"  ADC
 SG_ SGU11_Object_dy_Rear : 229|12@0+ (0.125,-128) [-128|127.875] "m"  ADC

BO_ 781 FRR_Obj_12: 32 FRR
 SG_ SGU12_Msg_CheckSum : 7|8@0+ (1,0) [0|255] ""  ADC
 SG_ SGU12_Msg_AliveCounter : 11|4@0+ (1,0) [0|14] ""  ADC
 SG_ SGU12_BlockCounter : 15|4@0+ (1,0) [0|15] ""  ADC
 SG_ SGU12_Object_ID : 23|8@0+ (1,0) [0|255] ""  ADC
 SG_ SGU12_Object_wExist : 28|5@0+ (0.03125,0) [0|0.96875] ""  ADC
 SG_ SGU12_Object_Type : 31|3@0+ (1,0) [0|7] ""  ADC
 SG_ SGU12_Object_Motion_Pattern : 34|3@0+ (1,0) [0|7] ""  ADC
 SG_ SGU12_Object_wObstacle : 39|5@0+ (0.03125,0) [0|0.96875] ""  ADC
 SG_ SGU12_Object_dx : 43|12@0+ (0.0625,-128) [-128|127.9375] "m"  ADC
 SG_ SGU12_Object_dy : 59|12@0+ (0.125,-128) [-128|127.875] "m"  ADC
 SG_ SGU12_Object_DistLong_rms : 79|16@0+ (0.001953125,0) [0|127.998046875] "m"  ADC
 SG_ SGU12_Obj_DistLat_rms : 95|16@0+ (0.001953125,0) [0|127.998046875] "m"  ADC
 SG_ SGU12_Object_vx : 107|12@0+ (0.0625,-128) [-128|127.9375] "m/s"  ADC
 SG_ SGU12_Object_vy : 123|12@0+ (0.0625,-128) [-128|127.9375] "m/s"  ADC
 SG_ SGU12_Obj_VrelLong_rms : 143|16@0+ (0.001953125,0) [0|127.998046875] "m/s"  ADC
 SG_ SGU12_Obj_Vrelat_rms : 159|16@0+ (0.001953125,0) [0|127.998046875] "m/s"  ADC
 SG_ SGU12_Object_ax : 170|11@0+ (0.03125,-16) [-16|15.96875] "m/s^2"  ADC
 SG_ SGU12_Object_ay : 191|11@0+ (0.03125,-16) [-16|15.96875] "m/s^2"  ADC
 SG_ SGU12_Object_DetStatus : 173|3@0+ (1,0) [0|7] ""  ADC
 SG_ SGU12_LifeCycles_OBJ : 196|8@0+ (1,0) [0|255] ""  ADC
 SG_ SGU12_ObjRCS_12 : 204|10@0+ (0.125,-50) [-50|70] "dBm2"  ADC
 SG_ SGU12_Object_dx_Rear : 209|12@0+ (0.0625,-128) [-128|127.9375] "m"  ADC
 SG_ SGU12_Object_dy_Rear : 229|12@0+ (0.125,-128) [-128|127.875] "m"  ADC

BO_ 782 FRR_Obj_13: 32 FRR
 SG_ SGU13_Msg_CheckSum : 7|8@0+ (1,0) [0|255] ""  ADC
 SG_ SGU13_Msg_AliveCounter : 11|4@0+ (1,0) [0|14] ""  ADC
 SG_ SGU13_BlockCounter : 15|4@0+ (1,0) [0|15] ""  ADC
 SG_ SGU13_Object_ID : 23|8@0+ (1,0) [0|255] ""  ADC
 SG_ SGU13_Object_wExist : 28|5@0+ (0.03125,0) [0|0.96875] ""  ADC
 SG_ SGU13_Object_Type : 31|3@0+ (1,0) [0|7] ""  ADC
 SG_ SGU13_Object_Motion_Pattern : 34|3@0+ (1,0) [0|7] ""  ADC
 SG_ SGU13_Object_wObstacle : 39|5@0+ (0.03125,0) [0|0.96875] ""  ADC
 SG_ SGU13_Object_dx : 43|12@0+ (0.0625,-128) [-128|127.9375] "m"  ADC
 SG_ SGU13_Object_dy : 59|12@0+ (0.125,-128) [-128|127.875] "m"  ADC
 SG_ SGU13_Object_DistLong_rms : 79|16@0+ (0.001953125,0) [0|127.998046875] "m"  ADC
 SG_ SGU13_Obj_DistLat_rms : 95|16@0+ (0.001953125,0) [0|127.998046875] "m"  ADC
 SG_ SGU13_Object_vx : 107|12@0+ (0.0625,-128) [-128|127.9375] "m/s"  ADC
 SG_ SGU13_Object_vy : 123|12@0+ (0.0625,-128) [-128|127.9375] "m/s"  ADC
 SG_ SGU13_Obj_VrelLong_rms : 143|16@0+ (0.001953125,0) [0|127.998046875] "m/s"  ADC
 SG_ SGU13_Obj_Vrelat_rms : 159|16@0+ (0.001953125,0) [0|127.998046875] "m/s"  ADC
 SG_ SGU13_Object_ax : 170|11@0+ (0.03125,-16) [-16|15.96875] "m/s^2"  ADC
 SG_ SGU13_Object_ay : 191|11@0+ (0.03125,-16) [-16|15.96875] "m/s^2"  ADC
 SG_ SGU13_Object_DetStatus : 173|3@0+ (1,0) [0|7] ""  ADC
 SG_ SGU13_LifeCycles_OBJ : 196|8@0+ (1,0) [0|255] ""  ADC
 SG_ SGU13_ObjRCS_13 : 204|10@0+ (0.125,-50) [-50|70] "dBm2"  ADC
 SG_ SGU13_Object_dx_Rear : 209|12@0+ (0.0625,-128) [-128|127.9375] "m"  ADC
 SG_ SGU13_Object_dy_Rear : 229|12@0+ (0.125,-128) [-128|127.875] "m"  ADC

BO_ 783 FRR_Obj_14: 32 FRR
 SG_ SGU14_Msg_CheckSum : 7|8@0+ (1,0) [0|255] ""  ADC
 SG_ SGU14_Msg_AliveCounter : 11|4@0+ (1,0) [0|14] ""  ADC
 SG_ SGU14_BlockCounter : 15|4@0+ (1,0) [0|15] ""  ADC
 SG_ SGU14_Object_ID : 23|8@0+ (1,0) [0|255] ""  ADC
 SG_ SGU14_Object_wExist : 28|5@0+ (0.03125,0) [0|0.96875] ""  ADC
 SG_ SGU14_Object_Type : 31|3@0+ (1,0) [0|7] ""  ADC
 SG_ SGU14_Object_Motion_Pattern : 34|3@0+ (1,0) [0|7] ""  ADC
 SG_ SGU14_Object_wObstacle : 39|5@0+ (0.03125,0) [0|0.96875] ""  ADC
 SG_ SGU14_Object_dx : 43|12@0+ (0.0625,-128) [-128|127.9375] "m"  ADC
 SG_ SGU14_Object_dy : 59|12@0+ (0.125,-128) [-128|127.875] "m"  ADC
 SG_ SGU14_Object_DistLong_rms : 79|16@0+ (0.001953125,0) [0|127.998046875] "m"  ADC
 SG_ SGU14_Obj_DistLat_rms : 95|16@0+ (0.001953125,0) [0|127.998046875] "m"  ADC
 SG_ SGU14_Object_vx : 107|12@0+ (0.0625,-128) [-128|127.9375] "m/s"  ADC
 SG_ SGU14_Object_vy : 123|12@0+ (0.0625,-128) [-128|127.9375] "m/s"  ADC
 SG_ SGU14_Obj_VrelLong_rms : 143|16@0+ (0.001953125,0) [0|127.998046875] "m/s"  ADC
 SG_ SGU14_Obj_Vrelat_rms : 159|16@0+ (0.001953125,0) [0|127.998046875] "m/s"  ADC
 SG_ SGU14_Object_ax : 170|11@0+ (0.03125,-16) [-16|15.96875] "m/s^2"  ADC
 SG_ SGU14_Object_ay : 191|11@0+ (0.03125,-16) [-16|15.96875] "m/s^2"  ADC
 SG_ SGU14_Object_DetStatus : 173|3@0+ (1,0) [0|7] ""  ADC
 SG_ SGU14_LifeCycles_OBJ : 196|8@0+ (1,0) [0|255] ""  ADC
 SG_ SGU14_ObjRCS_14 : 204|10@0+ (0.125,-50) [-50|70] "dBm2"  ADC
 SG_ SGU14_Object_dx_Rear : 209|12@0+ (0.0625,-128) [-128|127.9375] "m"  ADC
 SG_ SGU14_Object_dy_Rear : 229|12@0+ (0.125,-128) [-128|127.875] "m"  ADC

BO_ 784 FRR_Obj_15: 32 FRR
 SG_ SGU15_Msg_CheckSum : 7|8@0+ (1,0) [0|255] ""  ADC
 SG_ SGU15_Msg_AliveCounter : 11|4@0+ (1,0) [0|14] ""  ADC
 SG_ SGU15_BlockCounter : 15|4@0+ (1,0) [0|15] ""  ADC
 SG_ SGU15_Object_ID : 23|8@0+ (1,0) [0|255] ""  ADC
 SG_ SGU15_Object_wExist : 28|5@0+ (0.03125,0) [0|0.96875] ""  ADC
 SG_ SGU15_Object_Type : 31|3@0+ (1,0) [0|7] ""  ADC
 SG_ SGU15_Object_Motion_Pattern : 34|3@0+ (1,0) [0|7] ""  ADC
 SG_ SGU15_Object_wObstacle : 39|5@0+ (0.03125,0) [0|0.96875] ""  ADC
 SG_ SGU15_Object_dx : 43|12@0+ (0.0625,-128) [-128|127.9375] "m"  ADC
 SG_ SGU15_Object_dy : 59|12@0+ (0.125,-128) [-128|127.875] "m"  ADC
 SG_ SGU15_Object_DistLong_rms : 79|16@0+ (0.001953125,0) [0|127.998046875] "m"  ADC
 SG_ SGU15_Obj_DistLat_rms : 95|16@0+ (0.001953125,0) [0|127.998046875] "m"  ADC
 SG_ SGU15_Object_vx : 107|12@0+ (0.0625,-128) [-128|127.9375] "m/s"  ADC
 SG_ SGU15_Object_vy : 123|12@0+ (0.0625,-128) [-128|127.9375] "m/s"  ADC
 SG_ SGU15_Obj_VrelLong_rms : 143|16@0+ (0.001953125,0) [0|127.998046875] "m/s"  ADC
 SG_ SGU15_Obj_Vrelat_rms : 159|16@0+ (0.001953125,0) [0|127.998046875] "m/s"  ADC
 SG_ SGU15_Object_ax : 170|11@0+ (0.03125,-16) [-16|15.96875] "m/s^2"  ADC
 SG_ SGU15_Object_ay : 191|11@0+ (0.03125,-16) [-16|15.96875] "m/s^2"  ADC
 SG_ SGU15_Object_DetStatus : 173|3@0+ (1,0) [0|7] ""  ADC
 SG_ SGU15_LifeCycles_OBJ : 196|8@0+ (1,0) [0|255] ""  ADC
 SG_ SGU15_ObjRCS_15 : 204|10@0+ (0.125,-50) [-50|70] "dBm2"  ADC
 SG_ SGU15_Object_dx_Rear : 209|12@0+ (0.0625,-128) [-128|127.9375] "m"  ADC
 SG_ SGU15_Object_dy_Rear : 229|12@0+ (0.125,-128) [-128|127.875] "m"  ADC

BO_ 785 FRR_Obj_16: 32 FRR
 SG_ SGU16_Msg_CheckSum : 7|8@0+ (1,0) [0|255] ""  ADC
 SG_ SGU16_Msg_AliveCounter : 11|4@0+ (1,0) [0|14] ""  ADC
 SG_ SGU16_BlockCounter : 15|4@0+ (1,0) [0|15] ""  ADC
 SG_ SGU16_Object_ID : 23|8@0+ (1,0) [0|255] ""  ADC
 SG_ SGU16_Object_wExist : 28|5@0+ (0.03125,0) [0|0.96875] ""  ADC
 SG_ SGU16_Object_Type : 31|3@0+ (1,0) [0|7] ""  ADC
 SG_ SGU16_Object_Motion_Pattern : 34|3@0+ (1,0) [0|7] ""  ADC
 SG_ SGU16_Object_wObstacle : 39|5@0+ (0.03125,0) [0|0.96875] ""  ADC
 SG_ SGU16_Object_dx : 43|12@0+ (0.0625,-128) [-128|127.9375] "m"  ADC
 SG_ SGU16_Object_dy : 59|12@0+ (0.125,-128) [-128|127.875] "m"  ADC
 SG_ SGU16_Object_DistLong_rms : 79|16@0+ (0.001953125,0) [0|127.998046875] "m"  ADC
 SG_ SGU16_Obj_DistLat_rms : 95|16@0+ (0.001953125,0) [0|127.998046875] "m"  ADC
 SG_ SGU16_Object_vx : 107|12@0+ (0.0625,-128) [-128|127.9375] "m/s"  ADC
 SG_ SGU16_Object_vy : 123|12@0+ (0.0625,-128) [-128|127.9375] "m/s"  ADC
 SG_ SGU16_Obj_VrelLong_rms : 143|16@0+ (0.001953125,0) [0|127.998046875] "m/s"  ADC
 SG_ SGU16_Obj_Vrelat_rms : 159|16@0+ (0.001953125,0) [0|127.998046875] "m/s"  ADC
 SG_ SGU16_Object_ax : 170|11@0+ (0.03125,-16) [-16|15.96875] "m/s^2"  ADC
 SG_ SGU16_Object_ay : 191|11@0+ (0.03125,-16) [-16|15.96875] "m/s^2"  ADC
 SG_ SGU16_Object_DetStatus : 173|3@0+ (1,0) [0|7] ""  ADC
 SG_ SGU16_LifeCycles_OBJ : 196|8@0+ (1,0) [0|255] ""  ADC
 SG_ SGU16_ObjRCS_16 : 204|10@0+ (0.125,-50) [-50|70] "dBm2"  ADC
 SG_ SGU16_Object_dx_Rear : 209|12@0+ (0.0625,-128) [-128|127.9375] "m"  ADC
 SG_ SGU16_Object_dy_Rear : 229|12@0+ (0.125,-128) [-128|127.875] "m"  ADC

BO_ 786 FRR_Obj_17: 32 FRR
 SG_ SGU17_Msg_CheckSum : 7|8@0+ (1,0) [0|255] ""  ADC
 SG_ SGU17_Msg_AliveCounter : 11|4@0+ (1,0) [0|14] ""  ADC
 SG_ SGU17_BlockCounter : 15|4@0+ (1,0) [0|15] ""  ADC
 SG_ SGU17_Object_ID : 23|8@0+ (1,0) [0|255] ""  ADC
 SG_ SGU17_Object_wExist : 28|5@0+ (0.03125,0) [0|0.96875] ""  ADC
 SG_ SGU17_Object_Type : 31|3@0+ (1,0) [0|7] ""  ADC
 SG_ SGU17_Object_Motion_Pattern : 34|3@0+ (1,0) [0|7] ""  ADC
 SG_ SGU17_Object_wObstacle : 39|5@0+ (0.03125,0) [0|0.96875] ""  ADC
 SG_ SGU17_Object_dx : 43|12@0+ (0.0625,-128) [-128|127.9375] "m"  ADC
 SG_ SGU17_Object_dy : 59|12@0+ (0.125,-128) [-128|127.875] "m"  ADC
 SG_ SGU17_Object_DistLong_rms : 79|16@0+ (0.001953125,0) [0|127.998046875] "m"  ADC
 SG_ SGU17_Obj_DistLat_rms : 95|16@0+ (0.001953125,0) [0|127.998046875] "m"  ADC
 SG_ SGU17_Object_vx : 107|12@0+ (0.0625,-128) [-128|127.9375] "m/s"  ADC
 SG_ SGU17_Object_vy : 123|12@0+ (0.0625,-128) [-128|127.9375] "m/s"  ADC
 SG_ SGU17_Obj_VrelLong_rms : 143|16@0+ (0.001953125,0) [0|127.998046875] "m/s"  ADC
 SG_ SGU17_Obj_Vrelat_rms : 159|16@0+ (0.001953125,0) [0|127.998046875] "m/s"  ADC
 SG_ SGU17_Object_ax : 170|11@0+ (0.03125,-16) [-16|15.96875] "m/s^2"  ADC
 SG_ SGU17_Object_ay : 191|11@0+ (0.03125,-16) [-16|15.96875] "m/s^2"  ADC
 SG_ SGU17_Object_DetStatus : 173|3@0+ (1,0) [0|7] ""  ADC
 SG_ SGU17_LifeCycles_OBJ : 196|8@0+ (1,0) [0|255] ""  ADC
 SG_ SGU17_ObjRCS_17 : 204|10@0+ (0.125,-50) [-50|70] "dBm2"  ADC
 SG_ SGU17_Object_dx_Rear : 209|12@0+ (0.0625,-128) [-128|127.9375] "m"  ADC
 SG_ SGU17_Object_dy_Rear : 229|12@0+ (0.125,-128) [-128|127.875] "m"  ADC

BO_ 787 FRR_Obj_18: 32 FRR
 SG_ SGU18_Msg_CheckSum : 7|8@0+ (1,0) [0|255] ""  ADC
 SG_ SGU18_Msg_AliveCounter : 11|4@0+ (1,0) [0|14] ""  ADC
 SG_ SGU18_BlockCounter : 15|4@0+ (1,0) [0|15] ""  ADC
 SG_ SGU18_Object_ID : 23|8@0+ (1,0) [0|255] ""  ADC
 SG_ SGU18_Object_wExist : 28|5@0+ (0.03125,0) [0|0.96875] ""  ADC
 SG_ SGU18_Object_Type : 31|3@0+ (1,0) [0|7] ""  ADC
 SG_ SGU18_Object_Motion_Pattern : 34|3@0+ (1,0) [0|7] ""  ADC
 SG_ SGU18_Object_wObstacle : 39|5@0+ (0.03125,0) [0|0.96875] ""  ADC
 SG_ SGU18_Object_dx : 43|12@0+ (0.0625,-128) [-128|127.9375] "m"  ADC
 SG_ SGU18_Object_dy : 59|12@0+ (0.125,-128) [-128|127.875] "m"  ADC
 SG_ SGU18_Object_DistLong_rms : 79|16@0+ (0.001953125,0) [0|127.998046875] "m"  ADC
 SG_ SGU18_Obj_DistLat_rms : 95|16@0+ (0.001953125,0) [0|127.998046875] "m"  ADC
 SG_ SGU18_Object_vx : 107|12@0+ (0.0625,-128) [-128|127.9375] "m/s"  ADC
 SG_ SGU18_Object_vy : 123|12@0+ (0.0625,-128) [-128|127.9375] "m/s"  ADC
 SG_ SGU18_Obj_VrelLong_rms : 143|16@0+ (0.001953125,0) [0|127.998046875] "m/s"  ADC
 SG_ SGU18_Obj_Vrelat_rms : 159|16@0+ (0.001953125,0) [0|127.998046875] "m/s"  ADC
 SG_ SGU18_Object_ax : 170|11@0+ (0.03125,-16) [-16|15.96875] "m/s^2"  ADC
 SG_ SGU18_Object_ay : 191|11@0+ (0.03125,-16) [-16|15.96875] "m/s^2"  ADC
 SG_ SGU18_Object_DetStatus : 173|3@0+ (1,0) [0|7] ""  ADC
 SG_ SGU18_LifeCycles_OBJ : 196|8@0+ (1,0) [0|255] ""  ADC
 SG_ SGU18_ObjRCS_18 : 204|10@0+ (0.125,-50) [-50|70] "dBm2"  ADC
 SG_ SGU18_Object_dx_Rear : 209|12@0+ (0.0625,-128) [-128|127.9375] "m"  ADC
 SG_ SGU18_Object_dy_Rear : 229|12@0+ (0.125,-128) [-128|127.875] "m"  ADC

BO_ 788 FRR_Obj_19: 32 FRR
 SG_ SGU19_Msg_CheckSum : 7|8@0+ (1,0) [0|255] ""  ADC
 SG_ SGU19_Msg_AliveCounter : 11|4@0+ (1,0) [0|14] ""  ADC
 SG_ SGU19_BlockCounter : 15|4@0+ (1,0) [0|15] ""  ADC
 SG_ SGU19_Object_ID : 23|8@0+ (1,0) [0|255] ""  ADC
 SG_ SGU19_Object_wExist : 28|5@0+ (0.03125,0) [0|0.96875] ""  ADC
 SG_ SGU19_Object_Type : 31|3@0+ (1,0) [0|7] ""  ADC
 SG_ SGU19_Object_Motion_Pattern : 34|3@0+ (1,0) [0|7] ""  ADC
 SG_ SGU19_Object_wObstacle : 39|5@0+ (0.03125,0) [0|0.96875] ""  ADC
 SG_ SGU19_Object_dx : 43|12@0+ (0.0625,-128) [-128|127.9375] "m"  ADC
 SG_ SGU19_Object_dy : 59|12@0+ (0.125,-128) [-128|127.875] "m"  ADC
 SG_ SGU19_Object_DistLong_rms : 79|16@0+ (0.001953125,0) [0|127.998046875] "m"  ADC
 SG_ SGU19_Obj_DistLat_rms : 95|16@0+ (0.001953125,0) [0|127.998046875] "m"  ADC
 SG_ SGU19_Object_vx : 107|12@0+ (0.0625,-128) [-128|127.9375] "m/s"  ADC
 SG_ SGU19_Object_vy : 123|12@0+ (0.0625,-128) [-128|127.9375] "m/s"  ADC
 SG_ SGU19_Obj_VrelLong_rms : 143|16@0+ (0.001953125,0) [0|127.998046875] "m/s"  ADC
 SG_ SGU19_Obj_Vrelat_rms : 159|16@0+ (0.001953125,0) [0|127.998046875] "m/s"  ADC
 SG_ SGU19_Object_ax : 170|11@0+ (0.03125,-16) [-16|15.96875] "m/s^2"  ADC
 SG_ SGU19_Object_ay : 191|11@0+ (0.03125,-16) [-16|15.96875] "m/s^2"  ADC
 SG_ SGU19_Object_DetStatus : 173|3@0+ (1,0) [0|7] ""  ADC
 SG_ SGU19_LifeCycles_OBJ : 196|8@0+ (1,0) [0|255] ""  ADC
 SG_ SGU19_ObjRCS_19 : 204|10@0+ (0.125,-50) [-50|70] "dBm2"  ADC
 SG_ SGU19_Object_dx_Rear : 209|12@0+ (0.0625,-128) [-128|127.9375] "m"  ADC
 SG_ SGU19_Object_dy_Rear : 229|12@0+ (0.125,-128) [-128|127.875] "m"  ADC

BO_ 789 FRR_Obj_20: 32 FRR
 SG_ SGU20_Msg_CheckSum : 7|8@0+ (1,0) [0|255] ""  ADC
 SG_ SGU20_Msg_AliveCounter : 11|4@0+ (1,0) [0|14] ""  ADC
 SG_ SGU20_BlockCounter : 15|4@0+ (1,0) [0|15] ""  ADC
 SG_ SGU20_Object_ID : 23|8@0+ (1,0) [0|255] ""  ADC
 SG_ SGU20_Object_wExist : 28|5@0+ (0.03125,0) [0|0.96875] ""  ADC
 SG_ SGU20_Object_Type : 31|3@0+ (1,0) [0|7] ""  ADC
 SG_ SGU20_Object_Motion_Pattern : 34|3@0+ (1,0) [0|7] ""  ADC
 SG_ SGU20_Object_wObstacle : 39|5@0+ (0.03125,0) [0|0.96875] ""  ADC
 SG_ SGU20_Object_dx : 43|12@0+ (0.0625,-128) [-128|127.9375] "m"  ADC
 SG_ SGU20_Object_dy : 59|12@0+ (0.125,-128) [-128|127.875] "m"  ADC
 SG_ SGU20_Object_DistLong_rms : 79|16@0+ (0.001953125,0) [0|127.998046875] "m"  ADC
 SG_ SGU20_Obj_DistLat_rms : 95|16@0+ (0.001953125,0) [0|127.998046875] "m"  ADC
 SG_ SGU20_Object_vx : 107|12@0+ (0.0625,-128) [-128|127.9375] "m/s"  ADC
 SG_ SGU20_Object_vy : 123|12@0+ (0.0625,-128) [-128|127.9375] "m/s"  ADC
 SG_ SGU20_Obj_VrelLong_rms : 143|16@0+ (0.001953125,0) [0|127.998046875] "m/s"  ADC
 SG_ SGU20_Obj_Vrelat_rms : 159|16@0+ (0.001953125,0) [0|127.998046875] "m/s"  ADC
 SG_ SGU20_Object_ax : 170|11@0+ (0.03125,-16) [-16|15.96875] "m/s^2"  ADC
 SG_ SGU20_Object_ay : 191|11@0+ (0.03125,-16) [-16|15.96875] "m/s^2"  ADC
 SG_ SGU20_Object_DetStatus : 173|3@0+ (1,0) [0|7] ""  ADC
 SG_ SGU20_LifeCycles_OBJ : 196|8@0+ (1,0) [0|255] ""  ADC
 SG_ SGU20_ObjRCS_20 : 204|10@0+ (0.125,-50) [-50|70] "dBm2"  ADC
 SG_ SGU20_Object_dx_Rear : 209|12@0+ (0.0625,-128) [-128|127.9375] "m"  ADC
 SG_ SGU20_Object_dy_Rear : 229|12@0+ (0.125,-128) [-128|127.875] "m"  ADC

BO_ 790 FRR_Obj_21: 32 FRR
 SG_ SGU21_Msg_CheckSum : 7|8@0+ (1,0) [0|255] ""  ADC
 SG_ SGU21_Msg_AliveCounter : 11|4@0+ (1,0) [0|14] ""  ADC
 SG_ SGU21_BlockCounter : 15|4@0+ (1,0) [0|15] ""  ADC
 SG_ SGU21_Object_ID : 23|8@0+ (1,0) [0|255] ""  ADC
 SG_ SGU21_Object_wExist : 28|5@0+ (0.03125,0) [0|0.96875] ""  ADC
 SG_ SGU21_Object_Type : 31|3@0+ (1,0) [0|7] ""  ADC
 SG_ SGU21_Object_Motion_Pattern : 34|3@0+ (1,0) [0|7] ""  ADC
 SG_ SGU21_Object_wObstacle : 39|5@0+ (0.03125,0) [0|0.96875] ""  ADC
 SG_ SGU21_Object_dx : 43|12@0+ (0.0625,-128) [-128|127.9375] "m"  ADC
 SG_ SGU21_Object_dy : 59|12@0+ (0.125,-128) [-128|127.875] "m"  ADC
 SG_ SGU21_Object_DistLong_rms : 79|16@0+ (0.001953125,0) [0|127.998046875] "m"  ADC
 SG_ SGU21_Obj_DistLat_rms : 95|16@0+ (0.001953125,0) [0|127.998046875] "m"  ADC
 SG_ SGU21_Object_vx : 107|12@0+ (0.0625,-128) [-128|127.9375] "m/s"  ADC
 SG_ SGU21_Object_vy : 123|12@0+ (0.0625,-128) [-128|127.9375] "m/s"  ADC
 SG_ SGU21_Obj_VrelLong_rms : 143|16@0+ (0.001953125,0) [0|127.998046875] "m/s"  ADC
 SG_ SGU21_Obj_Vrelat_rms : 159|16@0+ (0.001953125,0) [0|127.998046875] "m/s"  ADC
 SG_ SGU21_Object_ax : 170|11@0+ (0.03125,-16) [-16|15.96875] "m/s^2"  ADC
 SG_ SGU21_Object_ay : 191|11@0+ (0.03125,-16) [-16|15.96875] "m/s^2"  ADC
 SG_ SGU21_Object_DetStatus : 173|3@0+ (1,0) [0|7] ""  ADC
 SG_ SGU21_LifeCycles_OBJ : 196|8@0+ (1,0) [0|255] ""  ADC
 SG_ SGU21_ObjRCS_21 : 204|10@0+ (0.125,-50) [-50|70] "dBm2"  ADC
 SG_ SGU21_Object_dx_Rear : 209|12@0+ (0.0625,-128) [-128|127.9375] "m"  ADC
 SG_ SGU21_Object_dy_Rear : 229|12@0+ (0.125,-128) [-128|127.875] "m"  ADC

BA_DEF_ BO_  "CANFD_BRS" ENUM  "0","1";
BA_DEF_ BO_  "GenMsgCycleTime" INT 0 0;
BA_DEF_ BO_  "GenMsgCycleTimeFast" INT 0 0;
BA_DEF_ BO_  "GenMsgSendType" ENUM  "Periodic","Event","IfActive","POE","PA","FixedPeriodic","Event","EnabledPeriodic","NotUsed","NotUsed","EventPeriodic","NotUsed","NotUsed","NoMsgSendType";
BA_DEF_ BO_  "VFrameFormat" ENUM  "StandardCAN","ExtendedCAN","reserved","reserved","reserved","reserved","reserved","reserved","reserved","reserved","reserved","reserved","reserved","reserved","StandardCAN_FD","ExtendedCAN_FD";
BA_DEF_ SG_  "EventCommandSignal" ENUM  "No","Yes";
BA_DEF_ SG_  "GatewayedSignals" ENUM  "No","Yes";
BA_DEF_ SG_  "GenSigInactiveValue" HEX 0 0;
BA_DEF_ SG_  "GenSigInvalidValue" HEX 0 0;
BA_DEF_ SG_  "GenSigSendType" ENUM  "Trigger","Passive","Cyclic","OnWrite","OnWriteWithRepetition","OnChange","OnChangeWithRepetition","IfActive","IfActiveWithRepetition","NoSigSendType";
BA_DEF_ SG_  "GenSigStartValue" HEX 0 0;
BA_DEF_ SG_  "GenSigTimeoutValue" HEX 0 0;
BA_DEF_ SG_  "Remark" STRING ;
BA_DEF_ BO_  "GenMsgILSupport" ENUM  "No","Yes";
BA_DEF_ BO_  "MsgType" ENUM  "Normal","NM","Diag","vector_leerstring";
BA_DEF_ BO_  "NmAsrMessage" ENUM  "No","Yes";
BA_DEF_ SG_  "IsCrcSignal" ENUM  "No","Yes";
BA_DEF_ SG_  "SystemSignalLongSymbol" STRING ;

BA_DEF_DEF_  "GenMsgILSupport" "Yes";
BA_DEF_DEF_  "IsCrcSignal" "No";
BA_DEF_DEF_  "MsgType" "";
BA_DEF_DEF_  "NmAsrMessage" "No";
BA_DEF_DEF_  "SystemSignalLongSymbol" "";
BA_ "CANFD_BRS" BO_ 776 1;
BA_ "CANFD_BRS" BO_ 777 1;
BA_ "CANFD_BRS" BO_ 778 1;
BA_ "CANFD_BRS" BO_ 779 1;
BA_ "CANFD_BRS" BO_ 780 1;
BA_ "CANFD_BRS" BO_ 781 1;
BA_ "CANFD_BRS" BO_ 782 1;
BA_ "CANFD_BRS" BO_ 783 1;
BA_ "CANFD_BRS" BO_ 784 1;
BA_ "CANFD_BRS" BO_ 785 1;
BA_ "CANFD_BRS" BO_ 786 1;
BA_ "CANFD_BRS" BO_ 787 1;
BA_ "CANFD_BRS" BO_ 788 1;
BA_ "CANFD_BRS" BO_ 789 1;
BA_ "CANFD_BRS" BO_ 790 1;
BA_ "GenMsgCycleTime" BO_ 776 0;
BA_ "GenMsgCycleTime" BO_ 777 0;
BA_ "GenMsgCycleTime" BO_ 778 0;
BA_ "GenMsgCycleTime" BO_ 779 0;
BA_ "GenMsgCycleTime" BO_ 780 0;
BA_ "GenMsgCycleTime" BO_ 781 0;
BA_ "GenMsgCycleTime" BO_ 782 0;
BA_ "GenMsgCycleTime" BO_ 783 0;
BA_ "GenMsgCycleTime" BO_ 784 0;
BA_ "GenMsgCycleTime" BO_ 785 0;
BA_ "GenMsgCycleTime" BO_ 786 0;
BA_ "GenMsgCycleTime" BO_ 787 0;
BA_ "GenMsgCycleTime" BO_ 788 0;
BA_ "GenMsgCycleTime" BO_ 789 0;
BA_ "GenMsgCycleTime" BO_ 790 0;
BA_ "GenMsgCycleTimeFast" BO_ 776 0;
BA_ "GenMsgCycleTimeFast" BO_ 777 0;
BA_ "GenMsgCycleTimeFast" BO_ 778 0;
BA_ "GenMsgCycleTimeFast" BO_ 779 0;
BA_ "GenMsgCycleTimeFast" BO_ 780 0;
BA_ "GenMsgCycleTimeFast" BO_ 781 0;
BA_ "GenMsgCycleTimeFast" BO_ 782 0;
BA_ "GenMsgCycleTimeFast" BO_ 783 0;
BA_ "GenMsgCycleTimeFast" BO_ 784 0;
BA_ "GenMsgCycleTimeFast" BO_ 785 0;
BA_ "GenMsgCycleTimeFast" BO_ 786 0;
BA_ "GenMsgCycleTimeFast" BO_ 787 0;
BA_ "GenMsgCycleTimeFast" BO_ 788 0;
BA_ "GenMsgCycleTimeFast" BO_ 789 0;
BA_ "GenMsgCycleTimeFast" BO_ 790 0;
BA_ "GenMsgSendType" BO_ 776 1;
BA_ "GenMsgSendType" BO_ 777 1;
BA_ "GenMsgSendType" BO_ 778 1;
BA_ "GenMsgSendType" BO_ 779 1;
BA_ "GenMsgSendType" BO_ 780 1;
BA_ "GenMsgSendType" BO_ 781 1;
BA_ "GenMsgSendType" BO_ 782 1;
BA_ "GenMsgSendType" BO_ 783 1;
BA_ "GenMsgSendType" BO_ 784 1;
BA_ "GenMsgSendType" BO_ 785 1;
BA_ "GenMsgSendType" BO_ 786 1;
BA_ "GenMsgSendType" BO_ 787 1;
BA_ "GenMsgSendType" BO_ 788 1;
BA_ "GenMsgSendType" BO_ 789 1;
BA_ "GenMsgSendType" BO_ 790 1;
BA_ "VFrameFormat" BO_ 776 14;
BA_ "VFrameFormat" BO_ 777 14;
BA_ "VFrameFormat" BO_ 778 14;
BA_ "VFrameFormat" BO_ 779 14;
BA_ "VFrameFormat" BO_ 780 14;
BA_ "VFrameFormat" BO_ 781 14;
BA_ "VFrameFormat" BO_ 782 14;
BA_ "VFrameFormat" BO_ 783 14;
BA_ "VFrameFormat" BO_ 784 14;
BA_ "VFrameFormat" BO_ 785 14;
BA_ "VFrameFormat" BO_ 786 14;
BA_ "VFrameFormat" BO_ 787 14;
BA_ "VFrameFormat" BO_ 788 14;
BA_ "VFrameFormat" BO_ 789 14;
BA_ "VFrameFormat" BO_ 790 14;
BA_ "EventCommandSignal" SG_ 776 SGU7_BlockCounter 0;
BA_ "GatewayedSignals" SG_ 776 SGU7_BlockCounter 0;
BA_ "GenSigInactiveValue" SG_ 776 SGU7_BlockCounter 0;
BA_ "GenSigInvalidValue" SG_ 776 SGU7_BlockCounter 0;
BA_ "GenSigSendType" SG_ 776 SGU7_BlockCounter 1;
BA_ "GenSigStartValue" SG_ 776 SGU7_BlockCounter 0;
BA_ "GenSigTimeoutValue" SG_ 776 SGU7_BlockCounter 0;
BA_ "Remark" SG_ 776 SGU7_BlockCounter "";
BA_ "EventCommandSignal" SG_ 776 SGU7_LifeCycles_OBJ 0;
BA_ "GatewayedSignals" SG_ 776 SGU7_LifeCycles_OBJ 0;
BA_ "GenSigInactiveValue" SG_ 776 SGU7_LifeCycles_OBJ 0;
BA_ "GenSigInvalidValue" SG_ 776 SGU7_LifeCycles_OBJ 0;
BA_ "GenSigSendType" SG_ 776 SGU7_LifeCycles_OBJ 1;
BA_ "GenSigStartValue" SG_ 776 SGU7_LifeCycles_OBJ 0;
BA_ "GenSigTimeoutValue" SG_ 776 SGU7_LifeCycles_OBJ 0;
BA_ "Remark" SG_ 776 SGU7_LifeCycles_OBJ "";
BA_ "EventCommandSignal" SG_ 776 SGU7_Msg_AliveCounter 0;
BA_ "GatewayedSignals" SG_ 776 SGU7_Msg_AliveCounter 0;
BA_ "GenSigInactiveValue" SG_ 776 SGU7_Msg_AliveCounter 0;
BA_ "GenSigInvalidValue" SG_ 776 SGU7_Msg_AliveCounter 0;
BA_ "GenSigSendType" SG_ 776 SGU7_Msg_AliveCounter 1;
BA_ "GenSigStartValue" SG_ 776 SGU7_Msg_AliveCounter 0;
BA_ "GenSigTimeoutValue" SG_ 776 SGU7_Msg_AliveCounter 0;
BA_ "Remark" SG_ 776 SGU7_Msg_AliveCounter "";
BA_ "EventCommandSignal" SG_ 776 SGU7_Msg_CheckSum 0;
BA_ "GatewayedSignals" SG_ 776 SGU7_Msg_CheckSum 0;
BA_ "GenSigInactiveValue" SG_ 776 SGU7_Msg_CheckSum 0;
BA_ "GenSigInvalidValue" SG_ 776 SGU7_Msg_CheckSum 0;
BA_ "GenSigSendType" SG_ 776 SGU7_Msg_CheckSum 1;
BA_ "GenSigStartValue" SG_ 776 SGU7_Msg_CheckSum 0;
BA_ "GenSigTimeoutValue" SG_ 776 SGU7_Msg_CheckSum 0;
BA_ "Remark" SG_ 776 SGU7_Msg_CheckSum "";
BA_ "EventCommandSignal" SG_ 776 SGU7_ObjRCS_07 0;
BA_ "GatewayedSignals" SG_ 776 SGU7_ObjRCS_07 0;
BA_ "GenSigInactiveValue" SG_ 776 SGU7_ObjRCS_07 0;
BA_ "GenSigInvalidValue" SG_ 776 SGU7_ObjRCS_07 0;
BA_ "GenSigSendType" SG_ 776 SGU7_ObjRCS_07 1;
BA_ "GenSigStartValue" SG_ 776 SGU7_ObjRCS_07 0;
BA_ "GenSigTimeoutValue" SG_ 776 SGU7_ObjRCS_07 0;
BA_ "Remark" SG_ 776 SGU7_ObjRCS_07 "";
BA_ "EventCommandSignal" SG_ 776 SGU7_Obj_DistLat_rms 0;
BA_ "GatewayedSignals" SG_ 776 SGU7_Obj_DistLat_rms 0;
BA_ "GenSigInactiveValue" SG_ 776 SGU7_Obj_DistLat_rms 0;
BA_ "GenSigInvalidValue" SG_ 776 SGU7_Obj_DistLat_rms 0;
BA_ "GenSigSendType" SG_ 776 SGU7_Obj_DistLat_rms 1;
BA_ "GenSigStartValue" SG_ 776 SGU7_Obj_DistLat_rms 0;
BA_ "GenSigTimeoutValue" SG_ 776 SGU7_Obj_DistLat_rms 0;
BA_ "Remark" SG_ 776 SGU7_Obj_DistLat_rms "";
BA_ "EventCommandSignal" SG_ 776 SGU7_Obj_VrelLong_rms 0;
BA_ "GatewayedSignals" SG_ 776 SGU7_Obj_VrelLong_rms 0;
BA_ "GenSigInactiveValue" SG_ 776 SGU7_Obj_VrelLong_rms 0;
BA_ "GenSigInvalidValue" SG_ 776 SGU7_Obj_VrelLong_rms 0;
BA_ "GenSigSendType" SG_ 776 SGU7_Obj_VrelLong_rms 1;
BA_ "GenSigStartValue" SG_ 776 SGU7_Obj_VrelLong_rms 0;
BA_ "GenSigTimeoutValue" SG_ 776 SGU7_Obj_VrelLong_rms 0;
BA_ "Remark" SG_ 776 SGU7_Obj_VrelLong_rms "";
BA_ "EventCommandSignal" SG_ 776 SGU7_Obj_Vrelat_rms 0;
BA_ "GatewayedSignals" SG_ 776 SGU7_Obj_Vrelat_rms 0;
BA_ "GenSigInactiveValue" SG_ 776 SGU7_Obj_Vrelat_rms 0;
BA_ "GenSigInvalidValue" SG_ 776 SGU7_Obj_Vrelat_rms 0;
BA_ "GenSigSendType" SG_ 776 SGU7_Obj_Vrelat_rms 1;
BA_ "GenSigStartValue" SG_ 776 SGU7_Obj_Vrelat_rms 0;
BA_ "GenSigTimeoutValue" SG_ 776 SGU7_Obj_Vrelat_rms 0;
BA_ "Remark" SG_ 776 SGU7_Obj_Vrelat_rms "";
BA_ "EventCommandSignal" SG_ 776 SGU7_Object_DetStatus 0;
BA_ "GatewayedSignals" SG_ 776 SGU7_Object_DetStatus 0;
BA_ "GenSigInactiveValue" SG_ 776 SGU7_Object_DetStatus 0;
BA_ "GenSigInvalidValue" SG_ 776 SGU7_Object_DetStatus 0;
BA_ "GenSigSendType" SG_ 776 SGU7_Object_DetStatus 1;
BA_ "GenSigStartValue" SG_ 776 SGU7_Object_DetStatus 0;
BA_ "GenSigTimeoutValue" SG_ 776 SGU7_Object_DetStatus 0;
BA_ "Remark" SG_ 776 SGU7_Object_DetStatus "";
BA_ "EventCommandSignal" SG_ 776 SGU7_Object_DistLong_rms 0;
BA_ "GatewayedSignals" SG_ 776 SGU7_Object_DistLong_rms 0;
BA_ "GenSigInactiveValue" SG_ 776 SGU7_Object_DistLong_rms 0;
BA_ "GenSigInvalidValue" SG_ 776 SGU7_Object_DistLong_rms 0;
BA_ "GenSigSendType" SG_ 776 SGU7_Object_DistLong_rms 1;
BA_ "GenSigStartValue" SG_ 776 SGU7_Object_DistLong_rms 0;
BA_ "GenSigTimeoutValue" SG_ 776 SGU7_Object_DistLong_rms 0;
BA_ "Remark" SG_ 776 SGU7_Object_DistLong_rms "";
BA_ "EventCommandSignal" SG_ 776 SGU7_Object_ID 0;
BA_ "GatewayedSignals" SG_ 776 SGU7_Object_ID 0;
BA_ "GenSigInactiveValue" SG_ 776 SGU7_Object_ID 0;
BA_ "GenSigInvalidValue" SG_ 776 SGU7_Object_ID 0;
BA_ "GenSigSendType" SG_ 776 SGU7_Object_ID 1;
BA_ "GenSigStartValue" SG_ 776 SGU7_Object_ID 0;
BA_ "GenSigTimeoutValue" SG_ 776 SGU7_Object_ID 0;
BA_ "Remark" SG_ 776 SGU7_Object_ID "";
BA_ "EventCommandSignal" SG_ 776 SGU7_Object_Motion_Pattern 0;
BA_ "GatewayedSignals" SG_ 776 SGU7_Object_Motion_Pattern 0;
BA_ "GenSigInactiveValue" SG_ 776 SGU7_Object_Motion_Pattern 0;
BA_ "GenSigInvalidValue" SG_ 776 SGU7_Object_Motion_Pattern 0;
BA_ "GenSigSendType" SG_ 776 SGU7_Object_Motion_Pattern 1;
BA_ "GenSigStartValue" SG_ 776 SGU7_Object_Motion_Pattern 0;
BA_ "GenSigTimeoutValue" SG_ 776 SGU7_Object_Motion_Pattern 0;
BA_ "Remark" SG_ 776 SGU7_Object_Motion_Pattern "";
BA_ "EventCommandSignal" SG_ 776 SGU7_Object_Type 0;
BA_ "GatewayedSignals" SG_ 776 SGU7_Object_Type 0;
BA_ "GenSigInactiveValue" SG_ 776 SGU7_Object_Type 0;
BA_ "GenSigInvalidValue" SG_ 776 SGU7_Object_Type 0;
BA_ "GenSigSendType" SG_ 776 SGU7_Object_Type 1;
BA_ "GenSigStartValue" SG_ 776 SGU7_Object_Type 0;
BA_ "GenSigTimeoutValue" SG_ 776 SGU7_Object_Type 0;
BA_ "Remark" SG_ 776 SGU7_Object_Type "";
BA_ "EventCommandSignal" SG_ 776 SGU7_Object_ax 0;
BA_ "GatewayedSignals" SG_ 776 SGU7_Object_ax 0;
BA_ "GenSigInactiveValue" SG_ 776 SGU7_Object_ax 0;
BA_ "GenSigInvalidValue" SG_ 776 SGU7_Object_ax 0;
BA_ "GenSigSendType" SG_ 776 SGU7_Object_ax 1;
BA_ "GenSigStartValue" SG_ 776 SGU7_Object_ax 0;
BA_ "GenSigTimeoutValue" SG_ 776 SGU7_Object_ax 0;
BA_ "Remark" SG_ 776 SGU7_Object_ax "";
BA_ "EventCommandSignal" SG_ 776 SGU7_Object_ay 0;
BA_ "GatewayedSignals" SG_ 776 SGU7_Object_ay 0;
BA_ "GenSigInactiveValue" SG_ 776 SGU7_Object_ay 0;
BA_ "GenSigInvalidValue" SG_ 776 SGU7_Object_ay 0;
BA_ "GenSigSendType" SG_ 776 SGU7_Object_ay 1;
BA_ "GenSigStartValue" SG_ 776 SGU7_Object_ay 0;
BA_ "GenSigTimeoutValue" SG_ 776 SGU7_Object_ay 0;
BA_ "Remark" SG_ 776 SGU7_Object_ay "";
BA_ "EventCommandSignal" SG_ 776 SGU7_Object_dx 0;
BA_ "GatewayedSignals" SG_ 776 SGU7_Object_dx 0;
BA_ "GenSigInactiveValue" SG_ 776 SGU7_Object_dx 0;
BA_ "GenSigInvalidValue" SG_ 776 SGU7_Object_dx 0;
BA_ "GenSigSendType" SG_ 776 SGU7_Object_dx 1;
BA_ "GenSigStartValue" SG_ 776 SGU7_Object_dx 0;
BA_ "GenSigTimeoutValue" SG_ 776 SGU7_Object_dx 0;
BA_ "Remark" SG_ 776 SGU7_Object_dx "";
BA_ "EventCommandSignal" SG_ 776 SGU7_Object_dx_Rear 0;
BA_ "GatewayedSignals" SG_ 776 SGU7_Object_dx_Rear 0;
BA_ "GenSigInactiveValue" SG_ 776 SGU7_Object_dx_Rear 0;
BA_ "GenSigInvalidValue" SG_ 776 SGU7_Object_dx_Rear 0;
BA_ "GenSigSendType" SG_ 776 SGU7_Object_dx_Rear 1;
BA_ "GenSigStartValue" SG_ 776 SGU7_Object_dx_Rear 0;
BA_ "GenSigTimeoutValue" SG_ 776 SGU7_Object_dx_Rear 0;
BA_ "Remark" SG_ 776 SGU7_Object_dx_Rear "";
BA_ "EventCommandSignal" SG_ 776 SGU7_Object_dy 0;
BA_ "GatewayedSignals" SG_ 776 SGU7_Object_dy 0;
BA_ "GenSigInactiveValue" SG_ 776 SGU7_Object_dy 0;
BA_ "GenSigInvalidValue" SG_ 776 SGU7_Object_dy 0;
BA_ "GenSigSendType" SG_ 776 SGU7_Object_dy 1;
BA_ "GenSigStartValue" SG_ 776 SGU7_Object_dy 0;
BA_ "GenSigTimeoutValue" SG_ 776 SGU7_Object_dy 0;
BA_ "Remark" SG_ 776 SGU7_Object_dy "";
BA_ "EventCommandSignal" SG_ 776 SGU7_Object_dy_Rear 0;
BA_ "GatewayedSignals" SG_ 776 SGU7_Object_dy_Rear 0;
BA_ "GenSigInactiveValue" SG_ 776 SGU7_Object_dy_Rear 0;
BA_ "GenSigInvalidValue" SG_ 776 SGU7_Object_dy_Rear 0;
BA_ "GenSigSendType" SG_ 776 SGU7_Object_dy_Rear 1;
BA_ "GenSigStartValue" SG_ 776 SGU7_Object_dy_Rear 0;
BA_ "GenSigTimeoutValue" SG_ 776 SGU7_Object_dy_Rear 0;
BA_ "Remark" SG_ 776 SGU7_Object_dy_Rear "";
BA_ "EventCommandSignal" SG_ 776 SGU7_Object_vx 0;
BA_ "GatewayedSignals" SG_ 776 SGU7_Object_vx 0;
BA_ "GenSigInactiveValue" SG_ 776 SGU7_Object_vx 0;
BA_ "GenSigInvalidValue" SG_ 776 SGU7_Object_vx 0;
BA_ "GenSigSendType" SG_ 776 SGU7_Object_vx 1;
BA_ "GenSigStartValue" SG_ 776 SGU7_Object_vx 0;
BA_ "GenSigTimeoutValue" SG_ 776 SGU7_Object_vx 0;
BA_ "Remark" SG_ 776 SGU7_Object_vx "";
BA_ "EventCommandSignal" SG_ 776 SGU7_Object_vy 0;
BA_ "GatewayedSignals" SG_ 776 SGU7_Object_vy 0;
BA_ "GenSigInactiveValue" SG_ 776 SGU7_Object_vy 0;
BA_ "GenSigInvalidValue" SG_ 776 SGU7_Object_vy 0;
BA_ "GenSigSendType" SG_ 776 SGU7_Object_vy 1;
BA_ "GenSigStartValue" SG_ 776 SGU7_Object_vy 0;
BA_ "GenSigTimeoutValue" SG_ 776 SGU7_Object_vy 0;
BA_ "Remark" SG_ 776 SGU7_Object_vy "";
BA_ "EventCommandSignal" SG_ 776 SGU7_Object_wExist 0;
BA_ "GatewayedSignals" SG_ 776 SGU7_Object_wExist 0;
BA_ "GenSigInactiveValue" SG_ 776 SGU7_Object_wExist 0;
BA_ "GenSigInvalidValue" SG_ 776 SGU7_Object_wExist 0;
BA_ "GenSigSendType" SG_ 776 SGU7_Object_wExist 1;
BA_ "GenSigStartValue" SG_ 776 SGU7_Object_wExist 0;
BA_ "GenSigTimeoutValue" SG_ 776 SGU7_Object_wExist 0;
BA_ "Remark" SG_ 776 SGU7_Object_wExist "";
BA_ "EventCommandSignal" SG_ 776 SGU7_Object_wObstacle 0;
BA_ "GatewayedSignals" SG_ 776 SGU7_Object_wObstacle 0;
BA_ "GenSigInactiveValue" SG_ 776 SGU7_Object_wObstacle 0;
BA_ "GenSigInvalidValue" SG_ 776 SGU7_Object_wObstacle 0;
BA_ "GenSigSendType" SG_ 776 SGU7_Object_wObstacle 1;
BA_ "GenSigStartValue" SG_ 776 SGU7_Object_wObstacle 0;
BA_ "GenSigTimeoutValue" SG_ 776 SGU7_Object_wObstacle 0;
BA_ "Remark" SG_ 776 SGU7_Object_wObstacle "";
BA_ "EventCommandSignal" SG_ 777 SGU8_BlockCounter 0;
BA_ "GatewayedSignals" SG_ 777 SGU8_BlockCounter 0;
BA_ "GenSigInactiveValue" SG_ 777 SGU8_BlockCounter 0;
BA_ "GenSigInvalidValue" SG_ 777 SGU8_BlockCounter 0;
BA_ "GenSigSendType" SG_ 777 SGU8_BlockCounter 1;
BA_ "GenSigStartValue" SG_ 777 SGU8_BlockCounter 0;
BA_ "GenSigTimeoutValue" SG_ 777 SGU8_BlockCounter 0;
BA_ "Remark" SG_ 777 SGU8_BlockCounter "";
BA_ "EventCommandSignal" SG_ 777 SGU8_LifeCycles_OBJ 0;
BA_ "GatewayedSignals" SG_ 777 SGU8_LifeCycles_OBJ 0;
BA_ "GenSigInactiveValue" SG_ 777 SGU8_LifeCycles_OBJ 0;
BA_ "GenSigInvalidValue" SG_ 777 SGU8_LifeCycles_OBJ 0;
BA_ "GenSigSendType" SG_ 777 SGU8_LifeCycles_OBJ 1;
BA_ "GenSigStartValue" SG_ 777 SGU8_LifeCycles_OBJ 0;
BA_ "GenSigTimeoutValue" SG_ 777 SGU8_LifeCycles_OBJ 0;
BA_ "Remark" SG_ 777 SGU8_LifeCycles_OBJ "";
BA_ "EventCommandSignal" SG_ 777 SGU8_Msg_AliveCounter 0;
BA_ "GatewayedSignals" SG_ 777 SGU8_Msg_AliveCounter 0;
BA_ "GenSigInactiveValue" SG_ 777 SGU8_Msg_AliveCounter 0;
BA_ "GenSigInvalidValue" SG_ 777 SGU8_Msg_AliveCounter 0;
BA_ "GenSigSendType" SG_ 777 SGU8_Msg_AliveCounter 1;
BA_ "GenSigStartValue" SG_ 777 SGU8_Msg_AliveCounter 0;
BA_ "GenSigTimeoutValue" SG_ 777 SGU8_Msg_AliveCounter 0;
BA_ "Remark" SG_ 777 SGU8_Msg_AliveCounter "";
BA_ "EventCommandSignal" SG_ 777 SGU8_Msg_CheckSum 0;
BA_ "GatewayedSignals" SG_ 777 SGU8_Msg_CheckSum 0;
BA_ "GenSigInactiveValue" SG_ 777 SGU8_Msg_CheckSum 0;
BA_ "GenSigInvalidValue" SG_ 777 SGU8_Msg_CheckSum 0;
BA_ "GenSigSendType" SG_ 777 SGU8_Msg_CheckSum 1;
BA_ "GenSigStartValue" SG_ 777 SGU8_Msg_CheckSum 0;
BA_ "GenSigTimeoutValue" SG_ 777 SGU8_Msg_CheckSum 0;
BA_ "Remark" SG_ 777 SGU8_Msg_CheckSum "";
BA_ "EventCommandSignal" SG_ 777 SGU8_ObjRCS_08 0;
BA_ "GatewayedSignals" SG_ 777 SGU8_ObjRCS_08 0;
BA_ "GenSigInactiveValue" SG_ 777 SGU8_ObjRCS_08 0;
BA_ "GenSigInvalidValue" SG_ 777 SGU8_ObjRCS_08 0;
BA_ "GenSigSendType" SG_ 777 SGU8_ObjRCS_08 1;
BA_ "GenSigStartValue" SG_ 777 SGU8_ObjRCS_08 0;
BA_ "GenSigTimeoutValue" SG_ 777 SGU8_ObjRCS_08 0;
BA_ "Remark" SG_ 777 SGU8_ObjRCS_08 "";
BA_ "EventCommandSignal" SG_ 777 SGU8_Obj_DistLat_rms 0;
BA_ "GatewayedSignals" SG_ 777 SGU8_Obj_DistLat_rms 0;
BA_ "GenSigInactiveValue" SG_ 777 SGU8_Obj_DistLat_rms 0;
BA_ "GenSigInvalidValue" SG_ 777 SGU8_Obj_DistLat_rms 0;
BA_ "GenSigSendType" SG_ 777 SGU8_Obj_DistLat_rms 1;
BA_ "GenSigStartValue" SG_ 777 SGU8_Obj_DistLat_rms 0;
BA_ "GenSigTimeoutValue" SG_ 777 SGU8_Obj_DistLat_rms 0;
BA_ "Remark" SG_ 777 SGU8_Obj_DistLat_rms "";
BA_ "EventCommandSignal" SG_ 777 SGU8_Obj_VrelLong_rms 0;
BA_ "GatewayedSignals" SG_ 777 SGU8_Obj_VrelLong_rms 0;
BA_ "GenSigInactiveValue" SG_ 777 SGU8_Obj_VrelLong_rms 0;
BA_ "GenSigInvalidValue" SG_ 777 SGU8_Obj_VrelLong_rms 0;
BA_ "GenSigSendType" SG_ 777 SGU8_Obj_VrelLong_rms 1;
BA_ "GenSigStartValue" SG_ 777 SGU8_Obj_VrelLong_rms 0;
BA_ "GenSigTimeoutValue" SG_ 777 SGU8_Obj_VrelLong_rms 0;
BA_ "Remark" SG_ 777 SGU8_Obj_VrelLong_rms "";
BA_ "EventCommandSignal" SG_ 777 SGU8_Obj_Vrelat_rms 0;
BA_ "GatewayedSignals" SG_ 777 SGU8_Obj_Vrelat_rms 0;
BA_ "GenSigInactiveValue" SG_ 777 SGU8_Obj_Vrelat_rms 0;
BA_ "GenSigInvalidValue" SG_ 777 SGU8_Obj_Vrelat_rms 0;
BA_ "GenSigSendType" SG_ 777 SGU8_Obj_Vrelat_rms 1;
BA_ "GenSigStartValue" SG_ 777 SGU8_Obj_Vrelat_rms 0;
BA_ "GenSigTimeoutValue" SG_ 777 SGU8_Obj_Vrelat_rms 0;
BA_ "Remark" SG_ 777 SGU8_Obj_Vrelat_rms "";
BA_ "EventCommandSignal" SG_ 777 SGU8_Object_DetStatus 0;
BA_ "GatewayedSignals" SG_ 777 SGU8_Object_DetStatus 0;
BA_ "GenSigInactiveValue" SG_ 777 SGU8_Object_DetStatus 0;
BA_ "GenSigInvalidValue" SG_ 777 SGU8_Object_DetStatus 0;
BA_ "GenSigSendType" SG_ 777 SGU8_Object_DetStatus 1;
BA_ "GenSigStartValue" SG_ 777 SGU8_Object_DetStatus 0;
BA_ "GenSigTimeoutValue" SG_ 777 SGU8_Object_DetStatus 0;
BA_ "Remark" SG_ 777 SGU8_Object_DetStatus "";
BA_ "EventCommandSignal" SG_ 777 SGU8_Object_DistLong_rms 0;
BA_ "GatewayedSignals" SG_ 777 SGU8_Object_DistLong_rms 0;
BA_ "GenSigInactiveValue" SG_ 777 SGU8_Object_DistLong_rms 0;
BA_ "GenSigInvalidValue" SG_ 777 SGU8_Object_DistLong_rms 0;
BA_ "GenSigSendType" SG_ 777 SGU8_Object_DistLong_rms 1;
BA_ "GenSigStartValue" SG_ 777 SGU8_Object_DistLong_rms 0;
BA_ "GenSigTimeoutValue" SG_ 777 SGU8_Object_DistLong_rms 0;
BA_ "Remark" SG_ 777 SGU8_Object_DistLong_rms "";
BA_ "EventCommandSignal" SG_ 777 SGU8_Object_ID 0;
BA_ "GatewayedSignals" SG_ 777 SGU8_Object_ID 0;
BA_ "GenSigInactiveValue" SG_ 777 SGU8_Object_ID 0;
BA_ "GenSigInvalidValue" SG_ 777 SGU8_Object_ID 0;
BA_ "GenSigSendType" SG_ 777 SGU8_Object_ID 1;
BA_ "GenSigStartValue" SG_ 777 SGU8_Object_ID 0;
BA_ "GenSigTimeoutValue" SG_ 777 SGU8_Object_ID 0;
BA_ "Remark" SG_ 777 SGU8_Object_ID "";
BA_ "EventCommandSignal" SG_ 777 SGU8_Object_Motion_Pattern 0;
BA_ "GatewayedSignals" SG_ 777 SGU8_Object_Motion_Pattern 0;
BA_ "GenSigInactiveValue" SG_ 777 SGU8_Object_Motion_Pattern 0;
BA_ "GenSigInvalidValue" SG_ 777 SGU8_Object_Motion_Pattern 0;
BA_ "GenSigSendType" SG_ 777 SGU8_Object_Motion_Pattern 1;
BA_ "GenSigStartValue" SG_ 777 SGU8_Object_Motion_Pattern 0;
BA_ "GenSigTimeoutValue" SG_ 777 SGU8_Object_Motion_Pattern 0;
BA_ "Remark" SG_ 777 SGU8_Object_Motion_Pattern "";
BA_ "EventCommandSignal" SG_ 777 SGU8_Object_Type 0;
BA_ "GatewayedSignals" SG_ 777 SGU8_Object_Type 0;
BA_ "GenSigInactiveValue" SG_ 777 SGU8_Object_Type 0;
BA_ "GenSigInvalidValue" SG_ 777 SGU8_Object_Type 0;
BA_ "GenSigSendType" SG_ 777 SGU8_Object_Type 1;
BA_ "GenSigStartValue" SG_ 777 SGU8_Object_Type 0;
BA_ "GenSigTimeoutValue" SG_ 777 SGU8_Object_Type 0;
BA_ "Remark" SG_ 777 SGU8_Object_Type "";
BA_ "EventCommandSignal" SG_ 777 SGU8_Object_ax 0;
BA_ "GatewayedSignals" SG_ 777 SGU8_Object_ax 0;
BA_ "GenSigInactiveValue" SG_ 777 SGU8_Object_ax 0;
BA_ "GenSigInvalidValue" SG_ 777 SGU8_Object_ax 0;
BA_ "GenSigSendType" SG_ 777 SGU8_Object_ax 1;
BA_ "GenSigStartValue" SG_ 777 SGU8_Object_ax 0;
BA_ "GenSigTimeoutValue" SG_ 777 SGU8_Object_ax 0;
BA_ "Remark" SG_ 777 SGU8_Object_ax "";
BA_ "EventCommandSignal" SG_ 777 SGU8_Object_ay 0;
BA_ "GatewayedSignals" SG_ 777 SGU8_Object_ay 0;
BA_ "GenSigInactiveValue" SG_ 777 SGU8_Object_ay 0;
BA_ "GenSigInvalidValue" SG_ 777 SGU8_Object_ay 0;
BA_ "GenSigSendType" SG_ 777 SGU8_Object_ay 1;
BA_ "GenSigStartValue" SG_ 777 SGU8_Object_ay 0;
BA_ "GenSigTimeoutValue" SG_ 777 SGU8_Object_ay 0;
BA_ "Remark" SG_ 777 SGU8_Object_ay "";
BA_ "EventCommandSignal" SG_ 777 SGU8_Object_dx 0;
BA_ "GatewayedSignals" SG_ 777 SGU8_Object_dx 0;
BA_ "GenSigInactiveValue" SG_ 777 SGU8_Object_dx 0;
BA_ "GenSigInvalidValue" SG_ 777 SGU8_Object_dx 0;
BA_ "GenSigSendType" SG_ 777 SGU8_Object_dx 1;
BA_ "GenSigStartValue" SG_ 777 SGU8_Object_dx 0;
BA_ "GenSigTimeoutValue" SG_ 777 SGU8_Object_dx 0;
BA_ "Remark" SG_ 777 SGU8_Object_dx "";
BA_ "EventCommandSignal" SG_ 777 SGU8_Object_dx_Rear 0;
BA_ "GatewayedSignals" SG_ 777 SGU8_Object_dx_Rear 0;
BA_ "GenSigInactiveValue" SG_ 777 SGU8_Object_dx_Rear 0;
BA_ "GenSigInvalidValue" SG_ 777 SGU8_Object_dx_Rear 0;
BA_ "GenSigSendType" SG_ 777 SGU8_Object_dx_Rear 1;
BA_ "GenSigStartValue" SG_ 777 SGU8_Object_dx_Rear 0;
BA_ "GenSigTimeoutValue" SG_ 777 SGU8_Object_dx_Rear 0;
BA_ "Remark" SG_ 777 SGU8_Object_dx_Rear "";
BA_ "EventCommandSignal" SG_ 777 SGU8_Object_dy 0;
BA_ "GatewayedSignals" SG_ 777 SGU8_Object_dy 0;
BA_ "GenSigInactiveValue" SG_ 777 SGU8_Object_dy 0;
BA_ "GenSigInvalidValue" SG_ 777 SGU8_Object_dy 0;
BA_ "GenSigSendType" SG_ 777 SGU8_Object_dy 1;
BA_ "GenSigStartValue" SG_ 777 SGU8_Object_dy 0;
BA_ "GenSigTimeoutValue" SG_ 777 SGU8_Object_dy 0;
BA_ "Remark" SG_ 777 SGU8_Object_dy "";
BA_ "EventCommandSignal" SG_ 777 SGU8_Object_dy_Rear 0;
BA_ "GatewayedSignals" SG_ 777 SGU8_Object_dy_Rear 0;
BA_ "GenSigInactiveValue" SG_ 777 SGU8_Object_dy_Rear 0;
BA_ "GenSigInvalidValue" SG_ 777 SGU8_Object_dy_Rear 0;
BA_ "GenSigSendType" SG_ 777 SGU8_Object_dy_Rear 1;
BA_ "GenSigStartValue" SG_ 777 SGU8_Object_dy_Rear 0;
BA_ "GenSigTimeoutValue" SG_ 777 SGU8_Object_dy_Rear 0;
BA_ "Remark" SG_ 777 SGU8_Object_dy_Rear "";
BA_ "EventCommandSignal" SG_ 777 SGU8_Object_vx 0;
BA_ "GatewayedSignals" SG_ 777 SGU8_Object_vx 0;
BA_ "GenSigInactiveValue" SG_ 777 SGU8_Object_vx 0;
BA_ "GenSigInvalidValue" SG_ 777 SGU8_Object_vx 0;
BA_ "GenSigSendType" SG_ 777 SGU8_Object_vx 1;
BA_ "GenSigStartValue" SG_ 777 SGU8_Object_vx 0;
BA_ "GenSigTimeoutValue" SG_ 777 SGU8_Object_vx 0;
BA_ "Remark" SG_ 777 SGU8_Object_vx "";
BA_ "EventCommandSignal" SG_ 777 SGU8_Object_vy 0;
BA_ "GatewayedSignals" SG_ 777 SGU8_Object_vy 0;
BA_ "GenSigInactiveValue" SG_ 777 SGU8_Object_vy 0;
BA_ "GenSigInvalidValue" SG_ 777 SGU8_Object_vy 0;
BA_ "GenSigSendType" SG_ 777 SGU8_Object_vy 1;
BA_ "GenSigStartValue" SG_ 777 SGU8_Object_vy 0;
BA_ "GenSigTimeoutValue" SG_ 777 SGU8_Object_vy 0;
BA_ "Remark" SG_ 777 SGU8_Object_vy "";
BA_ "EventCommandSignal" SG_ 777 SGU8_Object_wExist 0;
BA_ "GatewayedSignals" SG_ 777 SGU8_Object_wExist 0;
BA_ "GenSigInactiveValue" SG_ 777 SGU8_Object_wExist 0;
BA_ "GenSigInvalidValue" SG_ 777 SGU8_Object_wExist 0;
BA_ "GenSigSendType" SG_ 777 SGU8_Object_wExist 1;
BA_ "GenSigStartValue" SG_ 777 SGU8_Object_wExist 0;
BA_ "GenSigTimeoutValue" SG_ 777 SGU8_Object_wExist 0;
BA_ "Remark" SG_ 777 SGU8_Object_wExist "";
BA_ "EventCommandSignal" SG_ 777 SGU8_Object_wObstacle 0;
BA_ "GatewayedSignals" SG_ 777 SGU8_Object_wObstacle 0;
BA_ "GenSigInactiveValue" SG_ 777 SGU8_Object_wObstacle 0;
BA_ "GenSigInvalidValue" SG_ 777 SGU8_Object_wObstacle 0;
BA_ "GenSigSendType" SG_ 777 SGU8_Object_wObstacle 1;
BA_ "GenSigStartValue" SG_ 777 SGU8_Object_wObstacle 0;
BA_ "GenSigTimeoutValue" SG_ 777 SGU8_Object_wObstacle 0;
BA_ "Remark" SG_ 777 SGU8_Object_wObstacle "";
BA_ "EventCommandSignal" SG_ 778 SGU9_BlockCounter 0;
BA_ "GatewayedSignals" SG_ 778 SGU9_BlockCounter 0;
BA_ "GenSigInactiveValue" SG_ 778 SGU9_BlockCounter 0;
BA_ "GenSigInvalidValue" SG_ 778 SGU9_BlockCounter 0;
BA_ "GenSigSendType" SG_ 778 SGU9_BlockCounter 1;
BA_ "GenSigStartValue" SG_ 778 SGU9_BlockCounter 0;
BA_ "GenSigTimeoutValue" SG_ 778 SGU9_BlockCounter 0;
BA_ "Remark" SG_ 778 SGU9_BlockCounter "";
BA_ "EventCommandSignal" SG_ 778 SGU9_LifeCycles_OBJ 0;
BA_ "GatewayedSignals" SG_ 778 SGU9_LifeCycles_OBJ 0;
BA_ "GenSigInactiveValue" SG_ 778 SGU9_LifeCycles_OBJ 0;
BA_ "GenSigInvalidValue" SG_ 778 SGU9_LifeCycles_OBJ 0;
BA_ "GenSigSendType" SG_ 778 SGU9_LifeCycles_OBJ 1;
BA_ "GenSigStartValue" SG_ 778 SGU9_LifeCycles_OBJ 0;
BA_ "GenSigTimeoutValue" SG_ 778 SGU9_LifeCycles_OBJ 0;
BA_ "Remark" SG_ 778 SGU9_LifeCycles_OBJ "";
BA_ "EventCommandSignal" SG_ 778 SGU9_Msg_AliveCounter 0;
BA_ "GatewayedSignals" SG_ 778 SGU9_Msg_AliveCounter 0;
BA_ "GenSigInactiveValue" SG_ 778 SGU9_Msg_AliveCounter 0;
BA_ "GenSigInvalidValue" SG_ 778 SGU9_Msg_AliveCounter 0;
BA_ "GenSigSendType" SG_ 778 SGU9_Msg_AliveCounter 1;
BA_ "GenSigStartValue" SG_ 778 SGU9_Msg_AliveCounter 0;
BA_ "GenSigTimeoutValue" SG_ 778 SGU9_Msg_AliveCounter 0;
BA_ "Remark" SG_ 778 SGU9_Msg_AliveCounter "";
BA_ "EventCommandSignal" SG_ 778 SGU9_Msg_CheckSum 0;
BA_ "GatewayedSignals" SG_ 778 SGU9_Msg_CheckSum 0;
BA_ "GenSigInactiveValue" SG_ 778 SGU9_Msg_CheckSum 0;
BA_ "GenSigInvalidValue" SG_ 778 SGU9_Msg_CheckSum 0;
BA_ "GenSigSendType" SG_ 778 SGU9_Msg_CheckSum 1;
BA_ "GenSigStartValue" SG_ 778 SGU9_Msg_CheckSum 0;
BA_ "GenSigTimeoutValue" SG_ 778 SGU9_Msg_CheckSum 0;
BA_ "Remark" SG_ 778 SGU9_Msg_CheckSum "";
BA_ "EventCommandSignal" SG_ 778 SGU9_ObjRCS_09 0;
BA_ "GatewayedSignals" SG_ 778 SGU9_ObjRCS_09 0;
BA_ "GenSigInactiveValue" SG_ 778 SGU9_ObjRCS_09 0;
BA_ "GenSigInvalidValue" SG_ 778 SGU9_ObjRCS_09 0;
BA_ "GenSigSendType" SG_ 778 SGU9_ObjRCS_09 1;
BA_ "GenSigStartValue" SG_ 778 SGU9_ObjRCS_09 0;
BA_ "GenSigTimeoutValue" SG_ 778 SGU9_ObjRCS_09 0;
BA_ "Remark" SG_ 778 SGU9_ObjRCS_09 "";
BA_ "EventCommandSignal" SG_ 778 SGU9_Obj_DistLat_rms 0;
BA_ "GatewayedSignals" SG_ 778 SGU9_Obj_DistLat_rms 0;
BA_ "GenSigInactiveValue" SG_ 778 SGU9_Obj_DistLat_rms 0;
BA_ "GenSigInvalidValue" SG_ 778 SGU9_Obj_DistLat_rms 0;
BA_ "GenSigSendType" SG_ 778 SGU9_Obj_DistLat_rms 1;
BA_ "GenSigStartValue" SG_ 778 SGU9_Obj_DistLat_rms 0;
BA_ "GenSigTimeoutValue" SG_ 778 SGU9_Obj_DistLat_rms 0;
BA_ "Remark" SG_ 778 SGU9_Obj_DistLat_rms "";
BA_ "EventCommandSignal" SG_ 778 SGU9_Obj_VrelLong_rms 0;
BA_ "GatewayedSignals" SG_ 778 SGU9_Obj_VrelLong_rms 0;
BA_ "GenSigInactiveValue" SG_ 778 SGU9_Obj_VrelLong_rms 0;
BA_ "GenSigInvalidValue" SG_ 778 SGU9_Obj_VrelLong_rms 0;
BA_ "GenSigSendType" SG_ 778 SGU9_Obj_VrelLong_rms 1;
BA_ "GenSigStartValue" SG_ 778 SGU9_Obj_VrelLong_rms 0;
BA_ "GenSigTimeoutValue" SG_ 778 SGU9_Obj_VrelLong_rms 0;
BA_ "Remark" SG_ 778 SGU9_Obj_VrelLong_rms "";
BA_ "EventCommandSignal" SG_ 778 SGU9_Obj_Vrelat_rms 0;
BA_ "GatewayedSignals" SG_ 778 SGU9_Obj_Vrelat_rms 0;
BA_ "GenSigInactiveValue" SG_ 778 SGU9_Obj_Vrelat_rms 0;
BA_ "GenSigInvalidValue" SG_ 778 SGU9_Obj_Vrelat_rms 0;
BA_ "GenSigSendType" SG_ 778 SGU9_Obj_Vrelat_rms 1;
BA_ "GenSigStartValue" SG_ 778 SGU9_Obj_Vrelat_rms 0;
BA_ "GenSigTimeoutValue" SG_ 778 SGU9_Obj_Vrelat_rms 0;
BA_ "Remark" SG_ 778 SGU9_Obj_Vrelat_rms "";
BA_ "EventCommandSignal" SG_ 778 SGU9_Object_DetStatus 0;
BA_ "GatewayedSignals" SG_ 778 SGU9_Object_DetStatus 0;
BA_ "GenSigInactiveValue" SG_ 778 SGU9_Object_DetStatus 0;
BA_ "GenSigInvalidValue" SG_ 778 SGU9_Object_DetStatus 0;
BA_ "GenSigSendType" SG_ 778 SGU9_Object_DetStatus 1;
BA_ "GenSigStartValue" SG_ 778 SGU9_Object_DetStatus 0;
BA_ "GenSigTimeoutValue" SG_ 778 SGU9_Object_DetStatus 0;
BA_ "Remark" SG_ 778 SGU9_Object_DetStatus "";
BA_ "EventCommandSignal" SG_ 778 SGU9_Object_DistLong_rms 0;
BA_ "GatewayedSignals" SG_ 778 SGU9_Object_DistLong_rms 0;
BA_ "GenSigInactiveValue" SG_ 778 SGU9_Object_DistLong_rms 0;
BA_ "GenSigInvalidValue" SG_ 778 SGU9_Object_DistLong_rms 0;
BA_ "GenSigSendType" SG_ 778 SGU9_Object_DistLong_rms 1;
BA_ "GenSigStartValue" SG_ 778 SGU9_Object_DistLong_rms 0;
BA_ "GenSigTimeoutValue" SG_ 778 SGU9_Object_DistLong_rms 0;
BA_ "Remark" SG_ 778 SGU9_Object_DistLong_rms "";
BA_ "EventCommandSignal" SG_ 778 SGU9_Object_ID 0;
BA_ "GatewayedSignals" SG_ 778 SGU9_Object_ID 0;
BA_ "GenSigInactiveValue" SG_ 778 SGU9_Object_ID 0;
BA_ "GenSigInvalidValue" SG_ 778 SGU9_Object_ID 0;
BA_ "GenSigSendType" SG_ 778 SGU9_Object_ID 1;
BA_ "GenSigStartValue" SG_ 778 SGU9_Object_ID 0;
BA_ "GenSigTimeoutValue" SG_ 778 SGU9_Object_ID 0;
BA_ "Remark" SG_ 778 SGU9_Object_ID "";
BA_ "EventCommandSignal" SG_ 778 SGU9_Object_Motion_Pattern 0;
BA_ "GatewayedSignals" SG_ 778 SGU9_Object_Motion_Pattern 0;
BA_ "GenSigInactiveValue" SG_ 778 SGU9_Object_Motion_Pattern 0;
BA_ "GenSigInvalidValue" SG_ 778 SGU9_Object_Motion_Pattern 0;
BA_ "GenSigSendType" SG_ 778 SGU9_Object_Motion_Pattern 1;
BA_ "GenSigStartValue" SG_ 778 SGU9_Object_Motion_Pattern 0;
BA_ "GenSigTimeoutValue" SG_ 778 SGU9_Object_Motion_Pattern 0;
BA_ "Remark" SG_ 778 SGU9_Object_Motion_Pattern "";
BA_ "EventCommandSignal" SG_ 778 SGU9_Object_Type 0;
BA_ "GatewayedSignals" SG_ 778 SGU9_Object_Type 0;
BA_ "GenSigInactiveValue" SG_ 778 SGU9_Object_Type 0;
BA_ "GenSigInvalidValue" SG_ 778 SGU9_Object_Type 0;
BA_ "GenSigSendType" SG_ 778 SGU9_Object_Type 1;
BA_ "GenSigStartValue" SG_ 778 SGU9_Object_Type 0;
BA_ "GenSigTimeoutValue" SG_ 778 SGU9_Object_Type 0;
BA_ "Remark" SG_ 778 SGU9_Object_Type "";
BA_ "EventCommandSignal" SG_ 778 SGU9_Object_ax 0;
BA_ "GatewayedSignals" SG_ 778 SGU9_Object_ax 0;
BA_ "GenSigInactiveValue" SG_ 778 SGU9_Object_ax 0;
BA_ "GenSigInvalidValue" SG_ 778 SGU9_Object_ax 0;
BA_ "GenSigSendType" SG_ 778 SGU9_Object_ax 1;
BA_ "GenSigStartValue" SG_ 778 SGU9_Object_ax 0;
BA_ "GenSigTimeoutValue" SG_ 778 SGU9_Object_ax 0;
BA_ "Remark" SG_ 778 SGU9_Object_ax "";
BA_ "EventCommandSignal" SG_ 778 SGU9_Object_ay 0;
BA_ "GatewayedSignals" SG_ 778 SGU9_Object_ay 0;
BA_ "GenSigInactiveValue" SG_ 778 SGU9_Object_ay 0;
BA_ "GenSigInvalidValue" SG_ 778 SGU9_Object_ay 0;
BA_ "GenSigSendType" SG_ 778 SGU9_Object_ay 1;
BA_ "GenSigStartValue" SG_ 778 SGU9_Object_ay 0;
BA_ "GenSigTimeoutValue" SG_ 778 SGU9_Object_ay 0;
BA_ "Remark" SG_ 778 SGU9_Object_ay "";
BA_ "EventCommandSignal" SG_ 778 SGU9_Object_dx 0;
BA_ "GatewayedSignals" SG_ 778 SGU9_Object_dx 0;
BA_ "GenSigInactiveValue" SG_ 778 SGU9_Object_dx 0;
BA_ "GenSigInvalidValue" SG_ 778 SGU9_Object_dx 0;
BA_ "GenSigSendType" SG_ 778 SGU9_Object_dx 1;
BA_ "GenSigStartValue" SG_ 778 SGU9_Object_dx 0;
BA_ "GenSigTimeoutValue" SG_ 778 SGU9_Object_dx 0;
BA_ "Remark" SG_ 778 SGU9_Object_dx "";
BA_ "EventCommandSignal" SG_ 778 SGU9_Object_dx_Rear 0;
BA_ "GatewayedSignals" SG_ 778 SGU9_Object_dx_Rear 0;
BA_ "GenSigInactiveValue" SG_ 778 SGU9_Object_dx_Rear 0;
BA_ "GenSigInvalidValue" SG_ 778 SGU9_Object_dx_Rear 0;
BA_ "GenSigSendType" SG_ 778 SGU9_Object_dx_Rear 1;
BA_ "GenSigStartValue" SG_ 778 SGU9_Object_dx_Rear 0;
BA_ "GenSigTimeoutValue" SG_ 778 SGU9_Object_dx_Rear 0;
BA_ "Remark" SG_ 778 SGU9_Object_dx_Rear "";
BA_ "EventCommandSignal" SG_ 778 SGU9_Object_dy 0;
BA_ "GatewayedSignals" SG_ 778 SGU9_Object_dy 0;
BA_ "GenSigInactiveValue" SG_ 778 SGU9_Object_dy 0;
BA_ "GenSigInvalidValue" SG_ 778 SGU9_Object_dy 0;
BA_ "GenSigSendType" SG_ 778 SGU9_Object_dy 1;
BA_ "GenSigStartValue" SG_ 778 SGU9_Object_dy 0;
BA_ "GenSigTimeoutValue" SG_ 778 SGU9_Object_dy 0;
BA_ "Remark" SG_ 778 SGU9_Object_dy "";
BA_ "EventCommandSignal" SG_ 778 SGU9_Object_dy_Rear 0;
BA_ "GatewayedSignals" SG_ 778 SGU9_Object_dy_Rear 0;
BA_ "GenSigInactiveValue" SG_ 778 SGU9_Object_dy_Rear 0;
BA_ "GenSigInvalidValue" SG_ 778 SGU9_Object_dy_Rear 0;
BA_ "GenSigSendType" SG_ 778 SGU9_Object_dy_Rear 1;
BA_ "GenSigStartValue" SG_ 778 SGU9_Object_dy_Rear 0;
BA_ "GenSigTimeoutValue" SG_ 778 SGU9_Object_dy_Rear 0;
BA_ "Remark" SG_ 778 SGU9_Object_dy_Rear "";
BA_ "EventCommandSignal" SG_ 778 SGU9_Object_vx 0;
BA_ "GatewayedSignals" SG_ 778 SGU9_Object_vx 0;
BA_ "GenSigInactiveValue" SG_ 778 SGU9_Object_vx 0;
BA_ "GenSigInvalidValue" SG_ 778 SGU9_Object_vx 0;
BA_ "GenSigSendType" SG_ 778 SGU9_Object_vx 1;
BA_ "GenSigStartValue" SG_ 778 SGU9_Object_vx 0;
BA_ "GenSigTimeoutValue" SG_ 778 SGU9_Object_vx 0;
BA_ "Remark" SG_ 778 SGU9_Object_vx "";
BA_ "EventCommandSignal" SG_ 778 SGU9_Object_vy 0;
BA_ "GatewayedSignals" SG_ 778 SGU9_Object_vy 0;
BA_ "GenSigInactiveValue" SG_ 778 SGU9_Object_vy 0;
BA_ "GenSigInvalidValue" SG_ 778 SGU9_Object_vy 0;
BA_ "GenSigSendType" SG_ 778 SGU9_Object_vy 1;
BA_ "GenSigStartValue" SG_ 778 SGU9_Object_vy 0;
BA_ "GenSigTimeoutValue" SG_ 778 SGU9_Object_vy 0;
BA_ "Remark" SG_ 778 SGU9_Object_vy "";
BA_ "EventCommandSignal" SG_ 778 SGU9_Object_wExist 0;
BA_ "GatewayedSignals" SG_ 778 SGU9_Object_wExist 0;
BA_ "GenSigInactiveValue" SG_ 778 SGU9_Object_wExist 0;
BA_ "GenSigInvalidValue" SG_ 778 SGU9_Object_wExist 0;
BA_ "GenSigSendType" SG_ 778 SGU9_Object_wExist 1;
BA_ "GenSigStartValue" SG_ 778 SGU9_Object_wExist 0;
BA_ "GenSigTimeoutValue" SG_ 778 SGU9_Object_wExist 0;
BA_ "Remark" SG_ 778 SGU9_Object_wExist "";
BA_ "EventCommandSignal" SG_ 778 SGU9_Object_wObstacle 0;
BA_ "GatewayedSignals" SG_ 778 SGU9_Object_wObstacle 0;
BA_ "GenSigInactiveValue" SG_ 778 SGU9_Object_wObstacle 0;
BA_ "GenSigInvalidValue" SG_ 778 SGU9_Object_wObstacle 0;
BA_ "GenSigSendType" SG_ 778 SGU9_Object_wObstacle 1;
BA_ "GenSigStartValue" SG_ 778 SGU9_Object_wObstacle 0;
BA_ "GenSigTimeoutValue" SG_ 778 SGU9_Object_wObstacle 0;
BA_ "Remark" SG_ 778 SGU9_Object_wObstacle "";
BA_ "EventCommandSignal" SG_ 779 SGU10_BlockCounter 0;
BA_ "GatewayedSignals" SG_ 779 SGU10_BlockCounter 0;
BA_ "GenSigInactiveValue" SG_ 779 SGU10_BlockCounter 0;
BA_ "GenSigInvalidValue" SG_ 779 SGU10_BlockCounter 0;
BA_ "GenSigSendType" SG_ 779 SGU10_BlockCounter 1;
BA_ "GenSigStartValue" SG_ 779 SGU10_BlockCounter 0;
BA_ "GenSigTimeoutValue" SG_ 779 SGU10_BlockCounter 0;
BA_ "Remark" SG_ 779 SGU10_BlockCounter "";
BA_ "EventCommandSignal" SG_ 779 SGU10_LifeCycles_OBJ 0;
BA_ "GatewayedSignals" SG_ 779 SGU10_LifeCycles_OBJ 0;
BA_ "GenSigInactiveValue" SG_ 779 SGU10_LifeCycles_OBJ 0;
BA_ "GenSigInvalidValue" SG_ 779 SGU10_LifeCycles_OBJ 0;
BA_ "GenSigSendType" SG_ 779 SGU10_LifeCycles_OBJ 1;
BA_ "GenSigStartValue" SG_ 779 SGU10_LifeCycles_OBJ 0;
BA_ "GenSigTimeoutValue" SG_ 779 SGU10_LifeCycles_OBJ 0;
BA_ "Remark" SG_ 779 SGU10_LifeCycles_OBJ "";
BA_ "EventCommandSignal" SG_ 779 SGU10_Msg_AliveCounter 0;
BA_ "GatewayedSignals" SG_ 779 SGU10_Msg_AliveCounter 0;
BA_ "GenSigInactiveValue" SG_ 779 SGU10_Msg_AliveCounter 0;
BA_ "GenSigInvalidValue" SG_ 779 SGU10_Msg_AliveCounter 0;
BA_ "GenSigSendType" SG_ 779 SGU10_Msg_AliveCounter 1;
BA_ "GenSigStartValue" SG_ 779 SGU10_Msg_AliveCounter 0;
BA_ "GenSigTimeoutValue" SG_ 779 SGU10_Msg_AliveCounter 0;
BA_ "Remark" SG_ 779 SGU10_Msg_AliveCounter "";
BA_ "EventCommandSignal" SG_ 779 SGU10_Msg_CheckSum 0;
BA_ "GatewayedSignals" SG_ 779 SGU10_Msg_CheckSum 0;
BA_ "GenSigInactiveValue" SG_ 779 SGU10_Msg_CheckSum 0;
BA_ "GenSigInvalidValue" SG_ 779 SGU10_Msg_CheckSum 0;
BA_ "GenSigSendType" SG_ 779 SGU10_Msg_CheckSum 1;
BA_ "GenSigStartValue" SG_ 779 SGU10_Msg_CheckSum 0;
BA_ "GenSigTimeoutValue" SG_ 779 SGU10_Msg_CheckSum 0;
BA_ "Remark" SG_ 779 SGU10_Msg_CheckSum "";
BA_ "EventCommandSignal" SG_ 779 SGU10_ObjRCS_10 0;
BA_ "GatewayedSignals" SG_ 779 SGU10_ObjRCS_10 0;
BA_ "GenSigInactiveValue" SG_ 779 SGU10_ObjRCS_10 0;
BA_ "GenSigInvalidValue" SG_ 779 SGU10_ObjRCS_10 0;
BA_ "GenSigSendType" SG_ 779 SGU10_ObjRCS_10 1;
BA_ "GenSigStartValue" SG_ 779 SGU10_ObjRCS_10 0;
BA_ "GenSigTimeoutValue" SG_ 779 SGU10_ObjRCS_10 0;
BA_ "Remark" SG_ 779 SGU10_ObjRCS_10 "";
BA_ "EventCommandSignal" SG_ 779 SGU10_Obj_DistLat_rms 0;
BA_ "GatewayedSignals" SG_ 779 SGU10_Obj_DistLat_rms 0;
BA_ "GenSigInactiveValue" SG_ 779 SGU10_Obj_DistLat_rms 0;
BA_ "GenSigInvalidValue" SG_ 779 SGU10_Obj_DistLat_rms 0;
BA_ "GenSigSendType" SG_ 779 SGU10_Obj_DistLat_rms 1;
BA_ "GenSigStartValue" SG_ 779 SGU10_Obj_DistLat_rms 0;
BA_ "GenSigTimeoutValue" SG_ 779 SGU10_Obj_DistLat_rms 0;
BA_ "Remark" SG_ 779 SGU10_Obj_DistLat_rms "";
BA_ "EventCommandSignal" SG_ 779 SGU10_Obj_VrelLong_rms 0;
BA_ "GatewayedSignals" SG_ 779 SGU10_Obj_VrelLong_rms 0;
BA_ "GenSigInactiveValue" SG_ 779 SGU10_Obj_VrelLong_rms 0;
BA_ "GenSigInvalidValue" SG_ 779 SGU10_Obj_VrelLong_rms 0;
BA_ "GenSigSendType" SG_ 779 SGU10_Obj_VrelLong_rms 1;
BA_ "GenSigStartValue" SG_ 779 SGU10_Obj_VrelLong_rms 0;
BA_ "GenSigTimeoutValue" SG_ 779 SGU10_Obj_VrelLong_rms 0;
BA_ "Remark" SG_ 779 SGU10_Obj_VrelLong_rms "";
BA_ "EventCommandSignal" SG_ 779 SGU10_Obj_Vrelat_rms 0;
BA_ "GatewayedSignals" SG_ 779 SGU10_Obj_Vrelat_rms 0;
BA_ "GenSigInactiveValue" SG_ 779 SGU10_Obj_Vrelat_rms 0;
BA_ "GenSigInvalidValue" SG_ 779 SGU10_Obj_Vrelat_rms 0;
BA_ "GenSigSendType" SG_ 779 SGU10_Obj_Vrelat_rms 1;
BA_ "GenSigStartValue" SG_ 779 SGU10_Obj_Vrelat_rms 0;
BA_ "GenSigTimeoutValue" SG_ 779 SGU10_Obj_Vrelat_rms 0;
BA_ "Remark" SG_ 779 SGU10_Obj_Vrelat_rms "";
BA_ "EventCommandSignal" SG_ 779 SGU10_Object_DetStatus 0;
BA_ "GatewayedSignals" SG_ 779 SGU10_Object_DetStatus 0;
BA_ "GenSigInactiveValue" SG_ 779 SGU10_Object_DetStatus 0;
BA_ "GenSigInvalidValue" SG_ 779 SGU10_Object_DetStatus 0;
BA_ "GenSigSendType" SG_ 779 SGU10_Object_DetStatus 1;
BA_ "GenSigStartValue" SG_ 779 SGU10_Object_DetStatus 0;
BA_ "GenSigTimeoutValue" SG_ 779 SGU10_Object_DetStatus 0;
BA_ "Remark" SG_ 779 SGU10_Object_DetStatus "";
BA_ "EventCommandSignal" SG_ 779 SGU10_Object_DistLong_rms 0;
BA_ "GatewayedSignals" SG_ 779 SGU10_Object_DistLong_rms 0;
BA_ "GenSigInactiveValue" SG_ 779 SGU10_Object_DistLong_rms 0;
BA_ "GenSigInvalidValue" SG_ 779 SGU10_Object_DistLong_rms 0;
BA_ "GenSigSendType" SG_ 779 SGU10_Object_DistLong_rms 1;
BA_ "GenSigStartValue" SG_ 779 SGU10_Object_DistLong_rms 0;
BA_ "GenSigTimeoutValue" SG_ 779 SGU10_Object_DistLong_rms 0;
BA_ "Remark" SG_ 779 SGU10_Object_DistLong_rms "";
BA_ "EventCommandSignal" SG_ 779 SGU10_Object_ID 0;
BA_ "GatewayedSignals" SG_ 779 SGU10_Object_ID 0;
BA_ "GenSigInactiveValue" SG_ 779 SGU10_Object_ID 0;
BA_ "GenSigInvalidValue" SG_ 779 SGU10_Object_ID 0;
BA_ "GenSigSendType" SG_ 779 SGU10_Object_ID 1;
BA_ "GenSigStartValue" SG_ 779 SGU10_Object_ID 0;
BA_ "GenSigTimeoutValue" SG_ 779 SGU10_Object_ID 0;
BA_ "Remark" SG_ 779 SGU10_Object_ID "";
BA_ "EventCommandSignal" SG_ 779 SGU10_Object_Motion_Pattern 0;
BA_ "GatewayedSignals" SG_ 779 SGU10_Object_Motion_Pattern 0;
BA_ "GenSigInactiveValue" SG_ 779 SGU10_Object_Motion_Pattern 0;
BA_ "GenSigInvalidValue" SG_ 779 SGU10_Object_Motion_Pattern 0;
BA_ "GenSigSendType" SG_ 779 SGU10_Object_Motion_Pattern 1;
BA_ "GenSigStartValue" SG_ 779 SGU10_Object_Motion_Pattern 0;
BA_ "GenSigTimeoutValue" SG_ 779 SGU10_Object_Motion_Pattern 0;
BA_ "Remark" SG_ 779 SGU10_Object_Motion_Pattern "";
BA_ "EventCommandSignal" SG_ 779 SGU10_Object_Type 0;
BA_ "GatewayedSignals" SG_ 779 SGU10_Object_Type 0;
BA_ "GenSigInactiveValue" SG_ 779 SGU10_Object_Type 0;
BA_ "GenSigInvalidValue" SG_ 779 SGU10_Object_Type 0;
BA_ "GenSigSendType" SG_ 779 SGU10_Object_Type 1;
BA_ "GenSigStartValue" SG_ 779 SGU10_Object_Type 0;
BA_ "GenSigTimeoutValue" SG_ 779 SGU10_Object_Type 0;
BA_ "Remark" SG_ 779 SGU10_Object_Type "";
BA_ "EventCommandSignal" SG_ 779 SGU10_Object_ax 0;
BA_ "GatewayedSignals" SG_ 779 SGU10_Object_ax 0;
BA_ "GenSigInactiveValue" SG_ 779 SGU10_Object_ax 0;
BA_ "GenSigInvalidValue" SG_ 779 SGU10_Object_ax 0;
BA_ "GenSigSendType" SG_ 779 SGU10_Object_ax 1;
BA_ "GenSigStartValue" SG_ 779 SGU10_Object_ax 0;
BA_ "GenSigTimeoutValue" SG_ 779 SGU10_Object_ax 0;
BA_ "Remark" SG_ 779 SGU10_Object_ax "";
BA_ "EventCommandSignal" SG_ 779 SGU10_Object_ay 0;
BA_ "GatewayedSignals" SG_ 779 SGU10_Object_ay 0;
BA_ "GenSigInactiveValue" SG_ 779 SGU10_Object_ay 0;
BA_ "GenSigInvalidValue" SG_ 779 SGU10_Object_ay 0;
BA_ "GenSigSendType" SG_ 779 SGU10_Object_ay 1;
BA_ "GenSigStartValue" SG_ 779 SGU10_Object_ay 0;
BA_ "GenSigTimeoutValue" SG_ 779 SGU10_Object_ay 0;
BA_ "Remark" SG_ 779 SGU10_Object_ay "";
BA_ "EventCommandSignal" SG_ 779 SGU10_Object_dx 0;
BA_ "GatewayedSignals" SG_ 779 SGU10_Object_dx 0;
BA_ "GenSigInactiveValue" SG_ 779 SGU10_Object_dx 0;
BA_ "GenSigInvalidValue" SG_ 779 SGU10_Object_dx 0;
BA_ "GenSigSendType" SG_ 779 SGU10_Object_dx 1;
BA_ "GenSigStartValue" SG_ 779 SGU10_Object_dx 0;
BA_ "GenSigTimeoutValue" SG_ 779 SGU10_Object_dx 0;
BA_ "Remark" SG_ 779 SGU10_Object_dx "";
BA_ "EventCommandSignal" SG_ 779 SGU10_Object_dx_Rear 0;
BA_ "GatewayedSignals" SG_ 779 SGU10_Object_dx_Rear 0;
BA_ "GenSigInactiveValue" SG_ 779 SGU10_Object_dx_Rear 0;
BA_ "GenSigInvalidValue" SG_ 779 SGU10_Object_dx_Rear 0;
BA_ "GenSigSendType" SG_ 779 SGU10_Object_dx_Rear 1;
BA_ "GenSigStartValue" SG_ 779 SGU10_Object_dx_Rear 0;
BA_ "GenSigTimeoutValue" SG_ 779 SGU10_Object_dx_Rear 0;
BA_ "Remark" SG_ 779 SGU10_Object_dx_Rear "";
BA_ "EventCommandSignal" SG_ 779 SGU10_Object_dy 0;
BA_ "GatewayedSignals" SG_ 779 SGU10_Object_dy 0;
BA_ "GenSigInactiveValue" SG_ 779 SGU10_Object_dy 0;
BA_ "GenSigInvalidValue" SG_ 779 SGU10_Object_dy 0;
BA_ "GenSigSendType" SG_ 779 SGU10_Object_dy 1;
BA_ "GenSigStartValue" SG_ 779 SGU10_Object_dy 0;
BA_ "GenSigTimeoutValue" SG_ 779 SGU10_Object_dy 0;
BA_ "Remark" SG_ 779 SGU10_Object_dy "";
BA_ "EventCommandSignal" SG_ 779 SGU10_Object_dy_Rear 0;
BA_ "GatewayedSignals" SG_ 779 SGU10_Object_dy_Rear 0;
BA_ "GenSigInactiveValue" SG_ 779 SGU10_Object_dy_Rear 0;
BA_ "GenSigInvalidValue" SG_ 779 SGU10_Object_dy_Rear 0;
BA_ "GenSigSendType" SG_ 779 SGU10_Object_dy_Rear 1;
BA_ "GenSigStartValue" SG_ 779 SGU10_Object_dy_Rear 0;
BA_ "GenSigTimeoutValue" SG_ 779 SGU10_Object_dy_Rear 0;
BA_ "Remark" SG_ 779 SGU10_Object_dy_Rear "";
BA_ "EventCommandSignal" SG_ 779 SGU10_Object_vx 0;
BA_ "GatewayedSignals" SG_ 779 SGU10_Object_vx 0;
BA_ "GenSigInactiveValue" SG_ 779 SGU10_Object_vx 0;
BA_ "GenSigInvalidValue" SG_ 779 SGU10_Object_vx 0;
BA_ "GenSigSendType" SG_ 779 SGU10_Object_vx 1;
BA_ "GenSigStartValue" SG_ 779 SGU10_Object_vx 0;
BA_ "GenSigTimeoutValue" SG_ 779 SGU10_Object_vx 0;
BA_ "Remark" SG_ 779 SGU10_Object_vx "";
BA_ "EventCommandSignal" SG_ 779 SGU10_Object_vy 0;
BA_ "GatewayedSignals" SG_ 779 SGU10_Object_vy 0;
BA_ "GenSigInactiveValue" SG_ 779 SGU10_Object_vy 0;
BA_ "GenSigInvalidValue" SG_ 779 SGU10_Object_vy 0;
BA_ "GenSigSendType" SG_ 779 SGU10_Object_vy 1;
BA_ "GenSigStartValue" SG_ 779 SGU10_Object_vy 0;
BA_ "GenSigTimeoutValue" SG_ 779 SGU10_Object_vy 0;
BA_ "Remark" SG_ 779 SGU10_Object_vy "";
BA_ "EventCommandSignal" SG_ 779 SGU10_Object_wExist 0;
BA_ "GatewayedSignals" SG_ 779 SGU10_Object_wExist 0;
BA_ "GenSigInactiveValue" SG_ 779 SGU10_Object_wExist 0;
BA_ "GenSigInvalidValue" SG_ 779 SGU10_Object_wExist 0;
BA_ "GenSigSendType" SG_ 779 SGU10_Object_wExist 1;
BA_ "GenSigStartValue" SG_ 779 SGU10_Object_wExist 0;
BA_ "GenSigTimeoutValue" SG_ 779 SGU10_Object_wExist 0;
BA_ "Remark" SG_ 779 SGU10_Object_wExist "";
BA_ "EventCommandSignal" SG_ 779 SGU10_Object_wObstacle 0;
BA_ "GatewayedSignals" SG_ 779 SGU10_Object_wObstacle 0;
BA_ "GenSigInactiveValue" SG_ 779 SGU10_Object_wObstacle 0;
BA_ "GenSigInvalidValue" SG_ 779 SGU10_Object_wObstacle 0;
BA_ "GenSigSendType" SG_ 779 SGU10_Object_wObstacle 1;
BA_ "GenSigStartValue" SG_ 779 SGU10_Object_wObstacle 0;
BA_ "GenSigTimeoutValue" SG_ 779 SGU10_Object_wObstacle 0;
BA_ "Remark" SG_ 779 SGU10_Object_wObstacle "";
BA_ "EventCommandSignal" SG_ 780 SGU11_BlockCounter 0;
BA_ "GatewayedSignals" SG_ 780 SGU11_BlockCounter 0;
BA_ "GenSigInactiveValue" SG_ 780 SGU11_BlockCounter 0;
BA_ "GenSigInvalidValue" SG_ 780 SGU11_BlockCounter 0;
BA_ "GenSigSendType" SG_ 780 SGU11_BlockCounter 1;
BA_ "GenSigStartValue" SG_ 780 SGU11_BlockCounter 0;
BA_ "GenSigTimeoutValue" SG_ 780 SGU11_BlockCounter 0;
BA_ "Remark" SG_ 780 SGU11_BlockCounter "";
BA_ "EventCommandSignal" SG_ 780 SGU11_LifeCycles_OBJ 0;
BA_ "GatewayedSignals" SG_ 780 SGU11_LifeCycles_OBJ 0;
BA_ "GenSigInactiveValue" SG_ 780 SGU11_LifeCycles_OBJ 0;
BA_ "GenSigInvalidValue" SG_ 780 SGU11_LifeCycles_OBJ 0;
BA_ "GenSigSendType" SG_ 780 SGU11_LifeCycles_OBJ 1;
BA_ "GenSigStartValue" SG_ 780 SGU11_LifeCycles_OBJ 0;
BA_ "GenSigTimeoutValue" SG_ 780 SGU11_LifeCycles_OBJ 0;
BA_ "Remark" SG_ 780 SGU11_LifeCycles_OBJ "";
BA_ "EventCommandSignal" SG_ 780 SGU11_Msg_AliveCounter 0;
BA_ "GatewayedSignals" SG_ 780 SGU11_Msg_AliveCounter 0;
BA_ "GenSigInactiveValue" SG_ 780 SGU11_Msg_AliveCounter 0;
BA_ "GenSigInvalidValue" SG_ 780 SGU11_Msg_AliveCounter 0;
BA_ "GenSigSendType" SG_ 780 SGU11_Msg_AliveCounter 1;
BA_ "GenSigStartValue" SG_ 780 SGU11_Msg_AliveCounter 0;
BA_ "GenSigTimeoutValue" SG_ 780 SGU11_Msg_AliveCounter 0;
BA_ "Remark" SG_ 780 SGU11_Msg_AliveCounter "";
BA_ "EventCommandSignal" SG_ 780 SGU11_Msg_CheckSum 0;
BA_ "GatewayedSignals" SG_ 780 SGU11_Msg_CheckSum 0;
BA_ "GenSigInactiveValue" SG_ 780 SGU11_Msg_CheckSum 0;
BA_ "GenSigInvalidValue" SG_ 780 SGU11_Msg_CheckSum 0;
BA_ "GenSigSendType" SG_ 780 SGU11_Msg_CheckSum 1;
BA_ "GenSigStartValue" SG_ 780 SGU11_Msg_CheckSum 0;
BA_ "GenSigTimeoutValue" SG_ 780 SGU11_Msg_CheckSum 0;
BA_ "Remark" SG_ 780 SGU11_Msg_CheckSum "";
BA_ "EventCommandSignal" SG_ 780 SGU11_ObjRCS_11 0;
BA_ "GatewayedSignals" SG_ 780 SGU11_ObjRCS_11 0;
BA_ "GenSigInactiveValue" SG_ 780 SGU11_ObjRCS_11 0;
BA_ "GenSigInvalidValue" SG_ 780 SGU11_ObjRCS_11 0;
BA_ "GenSigSendType" SG_ 780 SGU11_ObjRCS_11 1;
BA_ "GenSigStartValue" SG_ 780 SGU11_ObjRCS_11 0;
BA_ "GenSigTimeoutValue" SG_ 780 SGU11_ObjRCS_11 0;
BA_ "Remark" SG_ 780 SGU11_ObjRCS_11 "";
BA_ "EventCommandSignal" SG_ 780 SGU11_Obj_DistLat_rms 0;
BA_ "GatewayedSignals" SG_ 780 SGU11_Obj_DistLat_rms 0;
BA_ "GenSigInactiveValue" SG_ 780 SGU11_Obj_DistLat_rms 0;
BA_ "GenSigInvalidValue" SG_ 780 SGU11_Obj_DistLat_rms 0;
BA_ "GenSigSendType" SG_ 780 SGU11_Obj_DistLat_rms 1;
BA_ "GenSigStartValue" SG_ 780 SGU11_Obj_DistLat_rms 0;
BA_ "GenSigTimeoutValue" SG_ 780 SGU11_Obj_DistLat_rms 0;
BA_ "Remark" SG_ 780 SGU11_Obj_DistLat_rms "";
BA_ "EventCommandSignal" SG_ 780 SGU11_Obj_VrelLong_rms 0;
BA_ "GatewayedSignals" SG_ 780 SGU11_Obj_VrelLong_rms 0;
BA_ "GenSigInactiveValue" SG_ 780 SGU11_Obj_VrelLong_rms 0;
BA_ "GenSigInvalidValue" SG_ 780 SGU11_Obj_VrelLong_rms 0;
BA_ "GenSigSendType" SG_ 780 SGU11_Obj_VrelLong_rms 1;
BA_ "GenSigStartValue" SG_ 780 SGU11_Obj_VrelLong_rms 0;
BA_ "GenSigTimeoutValue" SG_ 780 SGU11_Obj_VrelLong_rms 0;
BA_ "Remark" SG_ 780 SGU11_Obj_VrelLong_rms "";
BA_ "EventCommandSignal" SG_ 780 SGU11_Obj_Vrelat_rms 0;
BA_ "GatewayedSignals" SG_ 780 SGU11_Obj_Vrelat_rms 0;
BA_ "GenSigInactiveValue" SG_ 780 SGU11_Obj_Vrelat_rms 0;
BA_ "GenSigInvalidValue" SG_ 780 SGU11_Obj_Vrelat_rms 0;
BA_ "GenSigSendType" SG_ 780 SGU11_Obj_Vrelat_rms 1;
BA_ "GenSigStartValue" SG_ 780 SGU11_Obj_Vrelat_rms 0;
BA_ "GenSigTimeoutValue" SG_ 780 SGU11_Obj_Vrelat_rms 0;
BA_ "Remark" SG_ 780 SGU11_Obj_Vrelat_rms "";
BA_ "EventCommandSignal" SG_ 780 SGU11_Object_DetStatus 0;
BA_ "GatewayedSignals" SG_ 780 SGU11_Object_DetStatus 0;
BA_ "GenSigInactiveValue" SG_ 780 SGU11_Object_DetStatus 0;
BA_ "GenSigInvalidValue" SG_ 780 SGU11_Object_DetStatus 0;
BA_ "GenSigSendType" SG_ 780 SGU11_Object_DetStatus 1;
BA_ "GenSigStartValue" SG_ 780 SGU11_Object_DetStatus 0;
BA_ "GenSigTimeoutValue" SG_ 780 SGU11_Object_DetStatus 0;
BA_ "Remark" SG_ 780 SGU11_Object_DetStatus "";
BA_ "EventCommandSignal" SG_ 780 SGU11_Object_DistLong_rms 0;
BA_ "GatewayedSignals" SG_ 780 SGU11_Object_DistLong_rms 0;
BA_ "GenSigInactiveValue" SG_ 780 SGU11_Object_DistLong_rms 0;
BA_ "GenSigInvalidValue" SG_ 780 SGU11_Object_DistLong_rms 0;
BA_ "GenSigSendType" SG_ 780 SGU11_Object_DistLong_rms 1;
BA_ "GenSigStartValue" SG_ 780 SGU11_Object_DistLong_rms 0;
BA_ "GenSigTimeoutValue" SG_ 780 SGU11_Object_DistLong_rms 0;
BA_ "Remark" SG_ 780 SGU11_Object_DistLong_rms "";
BA_ "EventCommandSignal" SG_ 780 SGU11_Object_ID 0;
BA_ "GatewayedSignals" SG_ 780 SGU11_Object_ID 0;
BA_ "GenSigInactiveValue" SG_ 780 SGU11_Object_ID 0;
BA_ "GenSigInvalidValue" SG_ 780 SGU11_Object_ID 0;
BA_ "GenSigSendType" SG_ 780 SGU11_Object_ID 1;
BA_ "GenSigStartValue" SG_ 780 SGU11_Object_ID 0;
BA_ "GenSigTimeoutValue" SG_ 780 SGU11_Object_ID 0;
BA_ "Remark" SG_ 780 SGU11_Object_ID "";
BA_ "EventCommandSignal" SG_ 780 SGU11_Object_Motion_Pattern 0;
BA_ "GatewayedSignals" SG_ 780 SGU11_Object_Motion_Pattern 0;
BA_ "GenSigInactiveValue" SG_ 780 SGU11_Object_Motion_Pattern 0;
BA_ "GenSigInvalidValue" SG_ 780 SGU11_Object_Motion_Pattern 0;
BA_ "GenSigSendType" SG_ 780 SGU11_Object_Motion_Pattern 1;
BA_ "GenSigStartValue" SG_ 780 SGU11_Object_Motion_Pattern 0;
BA_ "GenSigTimeoutValue" SG_ 780 SGU11_Object_Motion_Pattern 0;
BA_ "Remark" SG_ 780 SGU11_Object_Motion_Pattern "";
BA_ "EventCommandSignal" SG_ 780 SGU11_Object_Type 0;
BA_ "GatewayedSignals" SG_ 780 SGU11_Object_Type 0;
BA_ "GenSigInactiveValue" SG_ 780 SGU11_Object_Type 0;
BA_ "GenSigInvalidValue" SG_ 780 SGU11_Object_Type 0;
BA_ "GenSigSendType" SG_ 780 SGU11_Object_Type 1;
BA_ "GenSigStartValue" SG_ 780 SGU11_Object_Type 0;
BA_ "GenSigTimeoutValue" SG_ 780 SGU11_Object_Type 0;
BA_ "Remark" SG_ 780 SGU11_Object_Type "";
BA_ "EventCommandSignal" SG_ 780 SGU11_Object_ax 0;
BA_ "GatewayedSignals" SG_ 780 SGU11_Object_ax 0;
BA_ "GenSigInactiveValue" SG_ 780 SGU11_Object_ax 0;
BA_ "GenSigInvalidValue" SG_ 780 SGU11_Object_ax 0;
BA_ "GenSigSendType" SG_ 780 SGU11_Object_ax 1;
BA_ "GenSigStartValue" SG_ 780 SGU11_Object_ax 0;
BA_ "GenSigTimeoutValue" SG_ 780 SGU11_Object_ax 0;
BA_ "Remark" SG_ 780 SGU11_Object_ax "";
BA_ "EventCommandSignal" SG_ 780 SGU11_Object_ay 0;
BA_ "GatewayedSignals" SG_ 780 SGU11_Object_ay 0;
BA_ "GenSigInactiveValue" SG_ 780 SGU11_Object_ay 0;
BA_ "GenSigInvalidValue" SG_ 780 SGU11_Object_ay 0;
BA_ "GenSigSendType" SG_ 780 SGU11_Object_ay 1;
BA_ "GenSigStartValue" SG_ 780 SGU11_Object_ay 0;
BA_ "GenSigTimeoutValue" SG_ 780 SGU11_Object_ay 0;
BA_ "Remark" SG_ 780 SGU11_Object_ay "";
BA_ "EventCommandSignal" SG_ 780 SGU11_Object_dx 0;
BA_ "GatewayedSignals" SG_ 780 SGU11_Object_dx 0;
BA_ "GenSigInactiveValue" SG_ 780 SGU11_Object_dx 0;
BA_ "GenSigInvalidValue" SG_ 780 SGU11_Object_dx 0;
BA_ "GenSigSendType" SG_ 780 SGU11_Object_dx 1;
BA_ "GenSigStartValue" SG_ 780 SGU11_Object_dx 0;
BA_ "GenSigTimeoutValue" SG_ 780 SGU11_Object_dx 0;
BA_ "Remark" SG_ 780 SGU11_Object_dx "";
BA_ "EventCommandSignal" SG_ 780 SGU11_Object_dx_Rear 0;
BA_ "GatewayedSignals" SG_ 780 SGU11_Object_dx_Rear 0;
BA_ "GenSigInactiveValue" SG_ 780 SGU11_Object_dx_Rear 0;
BA_ "GenSigInvalidValue" SG_ 780 SGU11_Object_dx_Rear 0;
BA_ "GenSigSendType" SG_ 780 SGU11_Object_dx_Rear 1;
BA_ "GenSigStartValue" SG_ 780 SGU11_Object_dx_Rear 0;
BA_ "GenSigTimeoutValue" SG_ 780 SGU11_Object_dx_Rear 0;
BA_ "Remark" SG_ 780 SGU11_Object_dx_Rear "";
BA_ "EventCommandSignal" SG_ 780 SGU11_Object_dy 0;
BA_ "GatewayedSignals" SG_ 780 SGU11_Object_dy 0;
BA_ "GenSigInactiveValue" SG_ 780 SGU11_Object_dy 0;
BA_ "GenSigInvalidValue" SG_ 780 SGU11_Object_dy 0;
BA_ "GenSigSendType" SG_ 780 SGU11_Object_dy 1;
BA_ "GenSigStartValue" SG_ 780 SGU11_Object_dy 0;
BA_ "GenSigTimeoutValue" SG_ 780 SGU11_Object_dy 0;
BA_ "Remark" SG_ 780 SGU11_Object_dy "";
BA_ "EventCommandSignal" SG_ 780 SGU11_Object_dy_Rear 0;
BA_ "GatewayedSignals" SG_ 780 SGU11_Object_dy_Rear 0;
BA_ "GenSigInactiveValue" SG_ 780 SGU11_Object_dy_Rear 0;
BA_ "GenSigInvalidValue" SG_ 780 SGU11_Object_dy_Rear 0;
BA_ "GenSigSendType" SG_ 780 SGU11_Object_dy_Rear 1;
BA_ "GenSigStartValue" SG_ 780 SGU11_Object_dy_Rear 0;
BA_ "GenSigTimeoutValue" SG_ 780 SGU11_Object_dy_Rear 0;
BA_ "Remark" SG_ 780 SGU11_Object_dy_Rear "";
BA_ "EventCommandSignal" SG_ 780 SGU11_Object_vx 0;
BA_ "GatewayedSignals" SG_ 780 SGU11_Object_vx 0;
BA_ "GenSigInactiveValue" SG_ 780 SGU11_Object_vx 0;
BA_ "GenSigInvalidValue" SG_ 780 SGU11_Object_vx 0;
BA_ "GenSigSendType" SG_ 780 SGU11_Object_vx 1;
BA_ "GenSigStartValue" SG_ 780 SGU11_Object_vx 0;
BA_ "GenSigTimeoutValue" SG_ 780 SGU11_Object_vx 0;
BA_ "Remark" SG_ 780 SGU11_Object_vx "";
BA_ "EventCommandSignal" SG_ 780 SGU11_Object_vy 0;
BA_ "GatewayedSignals" SG_ 780 SGU11_Object_vy 0;
BA_ "GenSigInactiveValue" SG_ 780 SGU11_Object_vy 0;
BA_ "GenSigInvalidValue" SG_ 780 SGU11_Object_vy 0;
BA_ "GenSigSendType" SG_ 780 SGU11_Object_vy 1;
BA_ "GenSigStartValue" SG_ 780 SGU11_Object_vy 0;
BA_ "GenSigTimeoutValue" SG_ 780 SGU11_Object_vy 0;
BA_ "Remark" SG_ 780 SGU11_Object_vy "";
BA_ "EventCommandSignal" SG_ 780 SGU11_Object_wExist 0;
BA_ "GatewayedSignals" SG_ 780 SGU11_Object_wExist 0;
BA_ "GenSigInactiveValue" SG_ 780 SGU11_Object_wExist 0;
BA_ "GenSigInvalidValue" SG_ 780 SGU11_Object_wExist 0;
BA_ "GenSigSendType" SG_ 780 SGU11_Object_wExist 1;
BA_ "GenSigStartValue" SG_ 780 SGU11_Object_wExist 0;
BA_ "GenSigTimeoutValue" SG_ 780 SGU11_Object_wExist 0;
BA_ "Remark" SG_ 780 SGU11_Object_wExist "";
BA_ "EventCommandSignal" SG_ 780 SGU11_Object_wObstacle 0;
BA_ "GatewayedSignals" SG_ 780 SGU11_Object_wObstacle 0;
BA_ "GenSigInactiveValue" SG_ 780 SGU11_Object_wObstacle 0;
BA_ "GenSigInvalidValue" SG_ 780 SGU11_Object_wObstacle 0;
BA_ "GenSigSendType" SG_ 780 SGU11_Object_wObstacle 1;
BA_ "GenSigStartValue" SG_ 780 SGU11_Object_wObstacle 0;
BA_ "GenSigTimeoutValue" SG_ 780 SGU11_Object_wObstacle 0;
BA_ "Remark" SG_ 780 SGU11_Object_wObstacle "";
BA_ "EventCommandSignal" SG_ 781 SGU12_BlockCounter 0;
BA_ "GatewayedSignals" SG_ 781 SGU12_BlockCounter 0;
BA_ "GenSigInactiveValue" SG_ 781 SGU12_BlockCounter 0;
BA_ "GenSigInvalidValue" SG_ 781 SGU12_BlockCounter 0;
BA_ "GenSigSendType" SG_ 781 SGU12_BlockCounter 1;
BA_ "GenSigStartValue" SG_ 781 SGU12_BlockCounter 0;
BA_ "GenSigTimeoutValue" SG_ 781 SGU12_BlockCounter 0;
BA_ "Remark" SG_ 781 SGU12_BlockCounter "";
BA_ "EventCommandSignal" SG_ 781 SGU12_LifeCycles_OBJ 0;
BA_ "GatewayedSignals" SG_ 781 SGU12_LifeCycles_OBJ 0;
BA_ "GenSigInactiveValue" SG_ 781 SGU12_LifeCycles_OBJ 0;
BA_ "GenSigInvalidValue" SG_ 781 SGU12_LifeCycles_OBJ 0;
BA_ "GenSigSendType" SG_ 781 SGU12_LifeCycles_OBJ 1;
BA_ "GenSigStartValue" SG_ 781 SGU12_LifeCycles_OBJ 0;
BA_ "GenSigTimeoutValue" SG_ 781 SGU12_LifeCycles_OBJ 0;
BA_ "Remark" SG_ 781 SGU12_LifeCycles_OBJ "";
BA_ "EventCommandSignal" SG_ 781 SGU12_Msg_AliveCounter 0;
BA_ "GatewayedSignals" SG_ 781 SGU12_Msg_AliveCounter 0;
BA_ "GenSigInactiveValue" SG_ 781 SGU12_Msg_AliveCounter 0;
BA_ "GenSigInvalidValue" SG_ 781 SGU12_Msg_AliveCounter 0;
BA_ "GenSigSendType" SG_ 781 SGU12_Msg_AliveCounter 1;
BA_ "GenSigStartValue" SG_ 781 SGU12_Msg_AliveCounter 0;
BA_ "GenSigTimeoutValue" SG_ 781 SGU12_Msg_AliveCounter 0;
BA_ "Remark" SG_ 781 SGU12_Msg_AliveCounter "";
BA_ "EventCommandSignal" SG_ 781 SGU12_Msg_CheckSum 0;
BA_ "GatewayedSignals" SG_ 781 SGU12_Msg_CheckSum 0;
BA_ "GenSigInactiveValue" SG_ 781 SGU12_Msg_CheckSum 0;
BA_ "GenSigInvalidValue" SG_ 781 SGU12_Msg_CheckSum 0;
BA_ "GenSigSendType" SG_ 781 SGU12_Msg_CheckSum 1;
BA_ "GenSigStartValue" SG_ 781 SGU12_Msg_CheckSum 0;
BA_ "GenSigTimeoutValue" SG_ 781 SGU12_Msg_CheckSum 0;
BA_ "Remark" SG_ 781 SGU12_Msg_CheckSum "";
BA_ "EventCommandSignal" SG_ 781 SGU12_ObjRCS_12 0;
BA_ "GatewayedSignals" SG_ 781 SGU12_ObjRCS_12 0;
BA_ "GenSigInactiveValue" SG_ 781 SGU12_ObjRCS_12 0;
BA_ "GenSigInvalidValue" SG_ 781 SGU12_ObjRCS_12 0;
BA_ "GenSigSendType" SG_ 781 SGU12_ObjRCS_12 1;
BA_ "GenSigStartValue" SG_ 781 SGU12_ObjRCS_12 0;
BA_ "GenSigTimeoutValue" SG_ 781 SGU12_ObjRCS_12 0;
BA_ "Remark" SG_ 781 SGU12_ObjRCS_12 "";
BA_ "EventCommandSignal" SG_ 781 SGU12_Obj_DistLat_rms 0;
BA_ "GatewayedSignals" SG_ 781 SGU12_Obj_DistLat_rms 0;
BA_ "GenSigInactiveValue" SG_ 781 SGU12_Obj_DistLat_rms 0;
BA_ "GenSigInvalidValue" SG_ 781 SGU12_Obj_DistLat_rms 0;
BA_ "GenSigSendType" SG_ 781 SGU12_Obj_DistLat_rms 1;
BA_ "GenSigStartValue" SG_ 781 SGU12_Obj_DistLat_rms 0;
BA_ "GenSigTimeoutValue" SG_ 781 SGU12_Obj_DistLat_rms 0;
BA_ "Remark" SG_ 781 SGU12_Obj_DistLat_rms "";
BA_ "EventCommandSignal" SG_ 781 SGU12_Obj_VrelLong_rms 0;
BA_ "GatewayedSignals" SG_ 781 SGU12_Obj_VrelLong_rms 0;
BA_ "GenSigInactiveValue" SG_ 781 SGU12_Obj_VrelLong_rms 0;
BA_ "GenSigInvalidValue" SG_ 781 SGU12_Obj_VrelLong_rms 0;
BA_ "GenSigSendType" SG_ 781 SGU12_Obj_VrelLong_rms 1;
BA_ "GenSigStartValue" SG_ 781 SGU12_Obj_VrelLong_rms 0;
BA_ "GenSigTimeoutValue" SG_ 781 SGU12_Obj_VrelLong_rms 0;
BA_ "Remark" SG_ 781 SGU12_Obj_VrelLong_rms "";
BA_ "EventCommandSignal" SG_ 781 SGU12_Obj_Vrelat_rms 0;
BA_ "GatewayedSignals" SG_ 781 SGU12_Obj_Vrelat_rms 0;
BA_ "GenSigInactiveValue" SG_ 781 SGU12_Obj_Vrelat_rms 0;
BA_ "GenSigInvalidValue" SG_ 781 SGU12_Obj_Vrelat_rms 0;
BA_ "GenSigSendType" SG_ 781 SGU12_Obj_Vrelat_rms 1;
BA_ "GenSigStartValue" SG_ 781 SGU12_Obj_Vrelat_rms 0;
BA_ "GenSigTimeoutValue" SG_ 781 SGU12_Obj_Vrelat_rms 0;
BA_ "Remark" SG_ 781 SGU12_Obj_Vrelat_rms "";
BA_ "EventCommandSignal" SG_ 781 SGU12_Object_DetStatus 0;
BA_ "GatewayedSignals" SG_ 781 SGU12_Object_DetStatus 0;
BA_ "GenSigInactiveValue" SG_ 781 SGU12_Object_DetStatus 0;
BA_ "GenSigInvalidValue" SG_ 781 SGU12_Object_DetStatus 0;
BA_ "GenSigSendType" SG_ 781 SGU12_Object_DetStatus 1;
BA_ "GenSigStartValue" SG_ 781 SGU12_Object_DetStatus 0;
BA_ "GenSigTimeoutValue" SG_ 781 SGU12_Object_DetStatus 0;
BA_ "Remark" SG_ 781 SGU12_Object_DetStatus "";
BA_ "EventCommandSignal" SG_ 781 SGU12_Object_DistLong_rms 0;
BA_ "GatewayedSignals" SG_ 781 SGU12_Object_DistLong_rms 0;
BA_ "GenSigInactiveValue" SG_ 781 SGU12_Object_DistLong_rms 0;
BA_ "GenSigInvalidValue" SG_ 781 SGU12_Object_DistLong_rms 0;
BA_ "GenSigSendType" SG_ 781 SGU12_Object_DistLong_rms 1;
BA_ "GenSigStartValue" SG_ 781 SGU12_Object_DistLong_rms 0;
BA_ "GenSigTimeoutValue" SG_ 781 SGU12_Object_DistLong_rms 0;
BA_ "Remark" SG_ 781 SGU12_Object_DistLong_rms "";
BA_ "EventCommandSignal" SG_ 781 SGU12_Object_ID 0;
BA_ "GatewayedSignals" SG_ 781 SGU12_Object_ID 0;
BA_ "GenSigInactiveValue" SG_ 781 SGU12_Object_ID 0;
BA_ "GenSigInvalidValue" SG_ 781 SGU12_Object_ID 0;
BA_ "GenSigSendType" SG_ 781 SGU12_Object_ID 1;
BA_ "GenSigStartValue" SG_ 781 SGU12_Object_ID 0;
BA_ "GenSigTimeoutValue" SG_ 781 SGU12_Object_ID 0;
BA_ "Remark" SG_ 781 SGU12_Object_ID "";
BA_ "EventCommandSignal" SG_ 781 SGU12_Object_Motion_Pattern 0;
BA_ "GatewayedSignals" SG_ 781 SGU12_Object_Motion_Pattern 0;
BA_ "GenSigInactiveValue" SG_ 781 SGU12_Object_Motion_Pattern 0;
BA_ "GenSigInvalidValue" SG_ 781 SGU12_Object_Motion_Pattern 0;
BA_ "GenSigSendType" SG_ 781 SGU12_Object_Motion_Pattern 1;
BA_ "GenSigStartValue" SG_ 781 SGU12_Object_Motion_Pattern 0;
BA_ "GenSigTimeoutValue" SG_ 781 SGU12_Object_Motion_Pattern 0;
BA_ "Remark" SG_ 781 SGU12_Object_Motion_Pattern "";
BA_ "EventCommandSignal" SG_ 781 SGU12_Object_Type 0;
BA_ "GatewayedSignals" SG_ 781 SGU12_Object_Type 0;
BA_ "GenSigInactiveValue" SG_ 781 SGU12_Object_Type 0;
BA_ "GenSigInvalidValue" SG_ 781 SGU12_Object_Type 0;
BA_ "GenSigSendType" SG_ 781 SGU12_Object_Type 1;
BA_ "GenSigStartValue" SG_ 781 SGU12_Object_Type 0;
BA_ "GenSigTimeoutValue" SG_ 781 SGU12_Object_Type 0;
BA_ "Remark" SG_ 781 SGU12_Object_Type "";
BA_ "EventCommandSignal" SG_ 781 SGU12_Object_ax 0;
BA_ "GatewayedSignals" SG_ 781 SGU12_Object_ax 0;
BA_ "GenSigInactiveValue" SG_ 781 SGU12_Object_ax 0;
BA_ "GenSigInvalidValue" SG_ 781 SGU12_Object_ax 0;
BA_ "GenSigSendType" SG_ 781 SGU12_Object_ax 1;
BA_ "GenSigStartValue" SG_ 781 SGU12_Object_ax 0;
BA_ "GenSigTimeoutValue" SG_ 781 SGU12_Object_ax 0;
BA_ "Remark" SG_ 781 SGU12_Object_ax "";
BA_ "EventCommandSignal" SG_ 781 SGU12_Object_ay 0;
BA_ "GatewayedSignals" SG_ 781 SGU12_Object_ay 0;
BA_ "GenSigInactiveValue" SG_ 781 SGU12_Object_ay 0;
BA_ "GenSigInvalidValue" SG_ 781 SGU12_Object_ay 0;
BA_ "GenSigSendType" SG_ 781 SGU12_Object_ay 1;
BA_ "GenSigStartValue" SG_ 781 SGU12_Object_ay 0;
BA_ "GenSigTimeoutValue" SG_ 781 SGU12_Object_ay 0;
BA_ "Remark" SG_ 781 SGU12_Object_ay "";
BA_ "EventCommandSignal" SG_ 781 SGU12_Object_dx 0;
BA_ "GatewayedSignals" SG_ 781 SGU12_Object_dx 0;
BA_ "GenSigInactiveValue" SG_ 781 SGU12_Object_dx 0;
BA_ "GenSigInvalidValue" SG_ 781 SGU12_Object_dx 0;
BA_ "GenSigSendType" SG_ 781 SGU12_Object_dx 1;
BA_ "GenSigStartValue" SG_ 781 SGU12_Object_dx 0;
BA_ "GenSigTimeoutValue" SG_ 781 SGU12_Object_dx 0;
BA_ "Remark" SG_ 781 SGU12_Object_dx "";
BA_ "EventCommandSignal" SG_ 781 SGU12_Object_dx_Rear 0;
BA_ "GatewayedSignals" SG_ 781 SGU12_Object_dx_Rear 0;
BA_ "GenSigInactiveValue" SG_ 781 SGU12_Object_dx_Rear 0;
BA_ "GenSigInvalidValue" SG_ 781 SGU12_Object_dx_Rear 0;
BA_ "GenSigSendType" SG_ 781 SGU12_Object_dx_Rear 1;
BA_ "GenSigStartValue" SG_ 781 SGU12_Object_dx_Rear 0;
BA_ "GenSigTimeoutValue" SG_ 781 SGU12_Object_dx_Rear 0;
BA_ "Remark" SG_ 781 SGU12_Object_dx_Rear "";
BA_ "EventCommandSignal" SG_ 781 SGU12_Object_dy 0;
BA_ "GatewayedSignals" SG_ 781 SGU12_Object_dy 0;
BA_ "GenSigInactiveValue" SG_ 781 SGU12_Object_dy 0;
BA_ "GenSigInvalidValue" SG_ 781 SGU12_Object_dy 0;
BA_ "GenSigSendType" SG_ 781 SGU12_Object_dy 1;
BA_ "GenSigStartValue" SG_ 781 SGU12_Object_dy 0;
BA_ "GenSigTimeoutValue" SG_ 781 SGU12_Object_dy 0;
BA_ "Remark" SG_ 781 SGU12_Object_dy "";
BA_ "EventCommandSignal" SG_ 781 SGU12_Object_dy_Rear 0;
BA_ "GatewayedSignals" SG_ 781 SGU12_Object_dy_Rear 0;
BA_ "GenSigInactiveValue" SG_ 781 SGU12_Object_dy_Rear 0;
BA_ "GenSigInvalidValue" SG_ 781 SGU12_Object_dy_Rear 0;
BA_ "GenSigSendType" SG_ 781 SGU12_Object_dy_Rear 1;
BA_ "GenSigStartValue" SG_ 781 SGU12_Object_dy_Rear 0;
BA_ "GenSigTimeoutValue" SG_ 781 SGU12_Object_dy_Rear 0;
BA_ "Remark" SG_ 781 SGU12_Object_dy_Rear "";
BA_ "EventCommandSignal" SG_ 781 SGU12_Object_vx 0;
BA_ "GatewayedSignals" SG_ 781 SGU12_Object_vx 0;
BA_ "GenSigInactiveValue" SG_ 781 SGU12_Object_vx 0;
BA_ "GenSigInvalidValue" SG_ 781 SGU12_Object_vx 0;
BA_ "GenSigSendType" SG_ 781 SGU12_Object_vx 1;
BA_ "GenSigStartValue" SG_ 781 SGU12_Object_vx 0;
BA_ "GenSigTimeoutValue" SG_ 781 SGU12_Object_vx 0;
BA_ "Remark" SG_ 781 SGU12_Object_vx "";
BA_ "EventCommandSignal" SG_ 781 SGU12_Object_vy 0;
BA_ "GatewayedSignals" SG_ 781 SGU12_Object_vy 0;
BA_ "GenSigInactiveValue" SG_ 781 SGU12_Object_vy 0;
BA_ "GenSigInvalidValue" SG_ 781 SGU12_Object_vy 0;
BA_ "GenSigSendType" SG_ 781 SGU12_Object_vy 1;
BA_ "GenSigStartValue" SG_ 781 SGU12_Object_vy 0;
BA_ "GenSigTimeoutValue" SG_ 781 SGU12_Object_vy 0;
BA_ "Remark" SG_ 781 SGU12_Object_vy "";
BA_ "EventCommandSignal" SG_ 781 SGU12_Object_wExist 0;
BA_ "GatewayedSignals" SG_ 781 SGU12_Object_wExist 0;
BA_ "GenSigInactiveValue" SG_ 781 SGU12_Object_wExist 0;
BA_ "GenSigInvalidValue" SG_ 781 SGU12_Object_wExist 0;
BA_ "GenSigSendType" SG_ 781 SGU12_Object_wExist 1;
BA_ "GenSigStartValue" SG_ 781 SGU12_Object_wExist 0;
BA_ "GenSigTimeoutValue" SG_ 781 SGU12_Object_wExist 0;
BA_ "Remark" SG_ 781 SGU12_Object_wExist "";
BA_ "EventCommandSignal" SG_ 781 SGU12_Object_wObstacle 0;
BA_ "GatewayedSignals" SG_ 781 SGU12_Object_wObstacle 0;
BA_ "GenSigInactiveValue" SG_ 781 SGU12_Object_wObstacle 0;
BA_ "GenSigInvalidValue" SG_ 781 SGU12_Object_wObstacle 0;
BA_ "GenSigSendType" SG_ 781 SGU12_Object_wObstacle 1;
BA_ "GenSigStartValue" SG_ 781 SGU12_Object_wObstacle 0;
BA_ "GenSigTimeoutValue" SG_ 781 SGU12_Object_wObstacle 0;
BA_ "Remark" SG_ 781 SGU12_Object_wObstacle "";
BA_ "EventCommandSignal" SG_ 782 SGU13_BlockCounter 0;
BA_ "GatewayedSignals" SG_ 782 SGU13_BlockCounter 0;
BA_ "GenSigInactiveValue" SG_ 782 SGU13_BlockCounter 0;
BA_ "GenSigInvalidValue" SG_ 782 SGU13_BlockCounter 0;
BA_ "GenSigSendType" SG_ 782 SGU13_BlockCounter 1;
BA_ "GenSigStartValue" SG_ 782 SGU13_BlockCounter 0;
BA_ "GenSigTimeoutValue" SG_ 782 SGU13_BlockCounter 0;
BA_ "Remark" SG_ 782 SGU13_BlockCounter "";
BA_ "EventCommandSignal" SG_ 782 SGU13_LifeCycles_OBJ 0;
BA_ "GatewayedSignals" SG_ 782 SGU13_LifeCycles_OBJ 0;
BA_ "GenSigInactiveValue" SG_ 782 SGU13_LifeCycles_OBJ 0;
BA_ "GenSigInvalidValue" SG_ 782 SGU13_LifeCycles_OBJ 0;
BA_ "GenSigSendType" SG_ 782 SGU13_LifeCycles_OBJ 1;
BA_ "GenSigStartValue" SG_ 782 SGU13_LifeCycles_OBJ 0;
BA_ "GenSigTimeoutValue" SG_ 782 SGU13_LifeCycles_OBJ 0;
BA_ "Remark" SG_ 782 SGU13_LifeCycles_OBJ "";
BA_ "EventCommandSignal" SG_ 782 SGU13_Msg_AliveCounter 0;
BA_ "GatewayedSignals" SG_ 782 SGU13_Msg_AliveCounter 0;
BA_ "GenSigInactiveValue" SG_ 782 SGU13_Msg_AliveCounter 0;
BA_ "GenSigInvalidValue" SG_ 782 SGU13_Msg_AliveCounter 0;
BA_ "GenSigSendType" SG_ 782 SGU13_Msg_AliveCounter 1;
BA_ "GenSigStartValue" SG_ 782 SGU13_Msg_AliveCounter 0;
BA_ "GenSigTimeoutValue" SG_ 782 SGU13_Msg_AliveCounter 0;
BA_ "Remark" SG_ 782 SGU13_Msg_AliveCounter "";
BA_ "EventCommandSignal" SG_ 782 SGU13_Msg_CheckSum 0;
BA_ "GatewayedSignals" SG_ 782 SGU13_Msg_CheckSum 0;
BA_ "GenSigInactiveValue" SG_ 782 SGU13_Msg_CheckSum 0;
BA_ "GenSigInvalidValue" SG_ 782 SGU13_Msg_CheckSum 0;
BA_ "GenSigSendType" SG_ 782 SGU13_Msg_CheckSum 1;
BA_ "GenSigStartValue" SG_ 782 SGU13_Msg_CheckSum 0;
BA_ "GenSigTimeoutValue" SG_ 782 SGU13_Msg_CheckSum 0;
BA_ "Remark" SG_ 782 SGU13_Msg_CheckSum "";
BA_ "EventCommandSignal" SG_ 782 SGU13_ObjRCS_13 0;
BA_ "GatewayedSignals" SG_ 782 SGU13_ObjRCS_13 0;
BA_ "GenSigInactiveValue" SG_ 782 SGU13_ObjRCS_13 0;
BA_ "GenSigInvalidValue" SG_ 782 SGU13_ObjRCS_13 0;
BA_ "GenSigSendType" SG_ 782 SGU13_ObjRCS_13 1;
BA_ "GenSigStartValue" SG_ 782 SGU13_ObjRCS_13 0;
BA_ "GenSigTimeoutValue" SG_ 782 SGU13_ObjRCS_13 0;
BA_ "Remark" SG_ 782 SGU13_ObjRCS_13 "";
BA_ "EventCommandSignal" SG_ 782 SGU13_Obj_DistLat_rms 0;
BA_ "GatewayedSignals" SG_ 782 SGU13_Obj_DistLat_rms 0;
BA_ "GenSigInactiveValue" SG_ 782 SGU13_Obj_DistLat_rms 0;
BA_ "GenSigInvalidValue" SG_ 782 SGU13_Obj_DistLat_rms 0;
BA_ "GenSigSendType" SG_ 782 SGU13_Obj_DistLat_rms 1;
BA_ "GenSigStartValue" SG_ 782 SGU13_Obj_DistLat_rms 0;
BA_ "GenSigTimeoutValue" SG_ 782 SGU13_Obj_DistLat_rms 0;
BA_ "Remark" SG_ 782 SGU13_Obj_DistLat_rms "";
BA_ "EventCommandSignal" SG_ 782 SGU13_Obj_VrelLong_rms 0;
BA_ "GatewayedSignals" SG_ 782 SGU13_Obj_VrelLong_rms 0;
BA_ "GenSigInactiveValue" SG_ 782 SGU13_Obj_VrelLong_rms 0;
BA_ "GenSigInvalidValue" SG_ 782 SGU13_Obj_VrelLong_rms 0;
BA_ "GenSigSendType" SG_ 782 SGU13_Obj_VrelLong_rms 1;
BA_ "GenSigStartValue" SG_ 782 SGU13_Obj_VrelLong_rms 0;
BA_ "GenSigTimeoutValue" SG_ 782 SGU13_Obj_VrelLong_rms 0;
BA_ "Remark" SG_ 782 SGU13_Obj_VrelLong_rms "";
BA_ "EventCommandSignal" SG_ 782 SGU13_Obj_Vrelat_rms 0;
BA_ "GatewayedSignals" SG_ 782 SGU13_Obj_Vrelat_rms 0;
BA_ "GenSigInactiveValue" SG_ 782 SGU13_Obj_Vrelat_rms 0;
BA_ "GenSigInvalidValue" SG_ 782 SGU13_Obj_Vrelat_rms 0;
BA_ "GenSigSendType" SG_ 782 SGU13_Obj_Vrelat_rms 1;
BA_ "GenSigStartValue" SG_ 782 SGU13_Obj_Vrelat_rms 0;
BA_ "GenSigTimeoutValue" SG_ 782 SGU13_Obj_Vrelat_rms 0;
BA_ "Remark" SG_ 782 SGU13_Obj_Vrelat_rms "";
BA_ "EventCommandSignal" SG_ 782 SGU13_Object_DetStatus 0;
BA_ "GatewayedSignals" SG_ 782 SGU13_Object_DetStatus 0;
BA_ "GenSigInactiveValue" SG_ 782 SGU13_Object_DetStatus 0;
BA_ "GenSigInvalidValue" SG_ 782 SGU13_Object_DetStatus 0;
BA_ "GenSigSendType" SG_ 782 SGU13_Object_DetStatus 1;
BA_ "GenSigStartValue" SG_ 782 SGU13_Object_DetStatus 0;
BA_ "GenSigTimeoutValue" SG_ 782 SGU13_Object_DetStatus 0;
BA_ "Remark" SG_ 782 SGU13_Object_DetStatus "";
BA_ "EventCommandSignal" SG_ 782 SGU13_Object_DistLong_rms 0;
BA_ "GatewayedSignals" SG_ 782 SGU13_Object_DistLong_rms 0;
BA_ "GenSigInactiveValue" SG_ 782 SGU13_Object_DistLong_rms 0;
BA_ "GenSigInvalidValue" SG_ 782 SGU13_Object_DistLong_rms 0;
BA_ "GenSigSendType" SG_ 782 SGU13_Object_DistLong_rms 1;
BA_ "GenSigStartValue" SG_ 782 SGU13_Object_DistLong_rms 0;
BA_ "GenSigTimeoutValue" SG_ 782 SGU13_Object_DistLong_rms 0;
BA_ "Remark" SG_ 782 SGU13_Object_DistLong_rms "";
BA_ "EventCommandSignal" SG_ 782 SGU13_Object_ID 0;
BA_ "GatewayedSignals" SG_ 782 SGU13_Object_ID 0;
BA_ "GenSigInactiveValue" SG_ 782 SGU13_Object_ID 0;
BA_ "GenSigInvalidValue" SG_ 782 SGU13_Object_ID 0;
BA_ "GenSigSendType" SG_ 782 SGU13_Object_ID 1;
BA_ "GenSigStartValue" SG_ 782 SGU13_Object_ID 0;
BA_ "GenSigTimeoutValue" SG_ 782 SGU13_Object_ID 0;
BA_ "Remark" SG_ 782 SGU13_Object_ID "";
BA_ "EventCommandSignal" SG_ 782 SGU13_Object_Motion_Pattern 0;
BA_ "GatewayedSignals" SG_ 782 SGU13_Object_Motion_Pattern 0;
BA_ "GenSigInactiveValue" SG_ 782 SGU13_Object_Motion_Pattern 0;
BA_ "GenSigInvalidValue" SG_ 782 SGU13_Object_Motion_Pattern 0;
BA_ "GenSigSendType" SG_ 782 SGU13_Object_Motion_Pattern 1;
BA_ "GenSigStartValue" SG_ 782 SGU13_Object_Motion_Pattern 0;
BA_ "GenSigTimeoutValue" SG_ 782 SGU13_Object_Motion_Pattern 0;
BA_ "Remark" SG_ 782 SGU13_Object_Motion_Pattern "";
BA_ "EventCommandSignal" SG_ 782 SGU13_Object_Type 0;
BA_ "GatewayedSignals" SG_ 782 SGU13_Object_Type 0;
BA_ "GenSigInactiveValue" SG_ 782 SGU13_Object_Type 0;
BA_ "GenSigInvalidValue" SG_ 782 SGU13_Object_Type 0;
BA_ "GenSigSendType" SG_ 782 SGU13_Object_Type 1;
BA_ "GenSigStartValue" SG_ 782 SGU13_Object_Type 0;
BA_ "GenSigTimeoutValue" SG_ 782 SGU13_Object_Type 0;
BA_ "Remark" SG_ 782 SGU13_Object_Type "";
BA_ "EventCommandSignal" SG_ 782 SGU13_Object_ax 0;
BA_ "GatewayedSignals" SG_ 782 SGU13_Object_ax 0;
BA_ "GenSigInactiveValue" SG_ 782 SGU13_Object_ax 0;
BA_ "GenSigInvalidValue" SG_ 782 SGU13_Object_ax 0;
BA_ "GenSigSendType" SG_ 782 SGU13_Object_ax 1;
BA_ "GenSigStartValue" SG_ 782 SGU13_Object_ax 0;
BA_ "GenSigTimeoutValue" SG_ 782 SGU13_Object_ax 0;
BA_ "Remark" SG_ 782 SGU13_Object_ax "";
BA_ "EventCommandSignal" SG_ 782 SGU13_Object_ay 0;
BA_ "GatewayedSignals" SG_ 782 SGU13_Object_ay 0;
BA_ "GenSigInactiveValue" SG_ 782 SGU13_Object_ay 0;
BA_ "GenSigInvalidValue" SG_ 782 SGU13_Object_ay 0;
BA_ "GenSigSendType" SG_ 782 SGU13_Object_ay 1;
BA_ "GenSigStartValue" SG_ 782 SGU13_Object_ay 0;
BA_ "GenSigTimeoutValue" SG_ 782 SGU13_Object_ay 0;
BA_ "Remark" SG_ 782 SGU13_Object_ay "";
BA_ "EventCommandSignal" SG_ 782 SGU13_Object_dx 0;
BA_ "GatewayedSignals" SG_ 782 SGU13_Object_dx 0;
BA_ "GenSigInactiveValue" SG_ 782 SGU13_Object_dx 0;
BA_ "GenSigInvalidValue" SG_ 782 SGU13_Object_dx 0;
BA_ "GenSigSendType" SG_ 782 SGU13_Object_dx 1;
BA_ "GenSigStartValue" SG_ 782 SGU13_Object_dx 0;
BA_ "GenSigTimeoutValue" SG_ 782 SGU13_Object_dx 0;
BA_ "Remark" SG_ 782 SGU13_Object_dx "";
BA_ "EventCommandSignal" SG_ 782 SGU13_Object_dx_Rear 0;
BA_ "GatewayedSignals" SG_ 782 SGU13_Object_dx_Rear 0;
BA_ "GenSigInactiveValue" SG_ 782 SGU13_Object_dx_Rear 0;
BA_ "GenSigInvalidValue" SG_ 782 SGU13_Object_dx_Rear 0;
BA_ "GenSigSendType" SG_ 782 SGU13_Object_dx_Rear 1;
BA_ "GenSigStartValue" SG_ 782 SGU13_Object_dx_Rear 0;
BA_ "GenSigTimeoutValue" SG_ 782 SGU13_Object_dx_Rear 0;
BA_ "Remark" SG_ 782 SGU13_Object_dx_Rear "";
BA_ "EventCommandSignal" SG_ 782 SGU13_Object_dy 0;
BA_ "GatewayedSignals" SG_ 782 SGU13_Object_dy 0;
BA_ "GenSigInactiveValue" SG_ 782 SGU13_Object_dy 0;
BA_ "GenSigInvalidValue" SG_ 782 SGU13_Object_dy 0;
BA_ "GenSigSendType" SG_ 782 SGU13_Object_dy 1;
BA_ "GenSigStartValue" SG_ 782 SGU13_Object_dy 0;
BA_ "GenSigTimeoutValue" SG_ 782 SGU13_Object_dy 0;
BA_ "Remark" SG_ 782 SGU13_Object_dy "";
BA_ "EventCommandSignal" SG_ 782 SGU13_Object_dy_Rear 0;
BA_ "GatewayedSignals" SG_ 782 SGU13_Object_dy_Rear 0;
BA_ "GenSigInactiveValue" SG_ 782 SGU13_Object_dy_Rear 0;
BA_ "GenSigInvalidValue" SG_ 782 SGU13_Object_dy_Rear 0;
BA_ "GenSigSendType" SG_ 782 SGU13_Object_dy_Rear 1;
BA_ "GenSigStartValue" SG_ 782 SGU13_Object_dy_Rear 0;
BA_ "GenSigTimeoutValue" SG_ 782 SGU13_Object_dy_Rear 0;
BA_ "Remark" SG_ 782 SGU13_Object_dy_Rear "";
BA_ "EventCommandSignal" SG_ 782 SGU13_Object_vx 0;
BA_ "GatewayedSignals" SG_ 782 SGU13_Object_vx 0;
BA_ "GenSigInactiveValue" SG_ 782 SGU13_Object_vx 0;
BA_ "GenSigInvalidValue" SG_ 782 SGU13_Object_vx 0;
BA_ "GenSigSendType" SG_ 782 SGU13_Object_vx 1;
BA_ "GenSigStartValue" SG_ 782 SGU13_Object_vx 0;
BA_ "GenSigTimeoutValue" SG_ 782 SGU13_Object_vx 0;
BA_ "Remark" SG_ 782 SGU13_Object_vx "";
BA_ "EventCommandSignal" SG_ 782 SGU13_Object_vy 0;
BA_ "GatewayedSignals" SG_ 782 SGU13_Object_vy 0;
BA_ "GenSigInactiveValue" SG_ 782 SGU13_Object_vy 0;
BA_ "GenSigInvalidValue" SG_ 782 SGU13_Object_vy 0;
BA_ "GenSigSendType" SG_ 782 SGU13_Object_vy 1;
BA_ "GenSigStartValue" SG_ 782 SGU13_Object_vy 0;
BA_ "GenSigTimeoutValue" SG_ 782 SGU13_Object_vy 0;
BA_ "Remark" SG_ 782 SGU13_Object_vy "";
BA_ "EventCommandSignal" SG_ 782 SGU13_Object_wExist 0;
BA_ "GatewayedSignals" SG_ 782 SGU13_Object_wExist 0;
BA_ "GenSigInactiveValue" SG_ 782 SGU13_Object_wExist 0;
BA_ "GenSigInvalidValue" SG_ 782 SGU13_Object_wExist 0;
BA_ "GenSigSendType" SG_ 782 SGU13_Object_wExist 1;
BA_ "GenSigStartValue" SG_ 782 SGU13_Object_wExist 0;
BA_ "GenSigTimeoutValue" SG_ 782 SGU13_Object_wExist 0;
BA_ "Remark" SG_ 782 SGU13_Object_wExist "";
BA_ "EventCommandSignal" SG_ 782 SGU13_Object_wObstacle 0;
BA_ "GatewayedSignals" SG_ 782 SGU13_Object_wObstacle 0;
BA_ "GenSigInactiveValue" SG_ 782 SGU13_Object_wObstacle 0;
BA_ "GenSigInvalidValue" SG_ 782 SGU13_Object_wObstacle 0;
BA_ "GenSigSendType" SG_ 782 SGU13_Object_wObstacle 1;
BA_ "GenSigStartValue" SG_ 782 SGU13_Object_wObstacle 0;
BA_ "GenSigTimeoutValue" SG_ 782 SGU13_Object_wObstacle 0;
BA_ "Remark" SG_ 782 SGU13_Object_wObstacle "";
BA_ "EventCommandSignal" SG_ 783 SGU14_BlockCounter 0;
BA_ "GatewayedSignals" SG_ 783 SGU14_BlockCounter 0;
BA_ "GenSigInactiveValue" SG_ 783 SGU14_BlockCounter 0;
BA_ "GenSigInvalidValue" SG_ 783 SGU14_BlockCounter 0;
BA_ "GenSigSendType" SG_ 783 SGU14_BlockCounter 1;
BA_ "GenSigStartValue" SG_ 783 SGU14_BlockCounter 0;
BA_ "GenSigTimeoutValue" SG_ 783 SGU14_BlockCounter 0;
BA_ "Remark" SG_ 783 SGU14_BlockCounter "";
BA_ "EventCommandSignal" SG_ 783 SGU14_LifeCycles_OBJ 0;
BA_ "GatewayedSignals" SG_ 783 SGU14_LifeCycles_OBJ 0;
BA_ "GenSigInactiveValue" SG_ 783 SGU14_LifeCycles_OBJ 0;
BA_ "GenSigInvalidValue" SG_ 783 SGU14_LifeCycles_OBJ 0;
BA_ "GenSigSendType" SG_ 783 SGU14_LifeCycles_OBJ 1;
BA_ "GenSigStartValue" SG_ 783 SGU14_LifeCycles_OBJ 0;
BA_ "GenSigTimeoutValue" SG_ 783 SGU14_LifeCycles_OBJ 0;
BA_ "Remark" SG_ 783 SGU14_LifeCycles_OBJ "";
BA_ "EventCommandSignal" SG_ 783 SGU14_Msg_AliveCounter 0;
BA_ "GatewayedSignals" SG_ 783 SGU14_Msg_AliveCounter 0;
BA_ "GenSigInactiveValue" SG_ 783 SGU14_Msg_AliveCounter 0;
BA_ "GenSigInvalidValue" SG_ 783 SGU14_Msg_AliveCounter 0;
BA_ "GenSigSendType" SG_ 783 SGU14_Msg_AliveCounter 1;
BA_ "GenSigStartValue" SG_ 783 SGU14_Msg_AliveCounter 0;
BA_ "GenSigTimeoutValue" SG_ 783 SGU14_Msg_AliveCounter 0;
BA_ "Remark" SG_ 783 SGU14_Msg_AliveCounter "";
BA_ "EventCommandSignal" SG_ 783 SGU14_Msg_CheckSum 0;
BA_ "GatewayedSignals" SG_ 783 SGU14_Msg_CheckSum 0;
BA_ "GenSigInactiveValue" SG_ 783 SGU14_Msg_CheckSum 0;
BA_ "GenSigInvalidValue" SG_ 783 SGU14_Msg_CheckSum 0;
BA_ "GenSigSendType" SG_ 783 SGU14_Msg_CheckSum 1;
BA_ "GenSigStartValue" SG_ 783 SGU14_Msg_CheckSum 0;
BA_ "GenSigTimeoutValue" SG_ 783 SGU14_Msg_CheckSum 0;
BA_ "Remark" SG_ 783 SGU14_Msg_CheckSum "";
BA_ "EventCommandSignal" SG_ 783 SGU14_ObjRCS_14 0;
BA_ "GatewayedSignals" SG_ 783 SGU14_ObjRCS_14 0;
BA_ "GenSigInactiveValue" SG_ 783 SGU14_ObjRCS_14 0;
BA_ "GenSigInvalidValue" SG_ 783 SGU14_ObjRCS_14 0;
BA_ "GenSigSendType" SG_ 783 SGU14_ObjRCS_14 1;
BA_ "GenSigStartValue" SG_ 783 SGU14_ObjRCS_14 0;
BA_ "GenSigTimeoutValue" SG_ 783 SGU14_ObjRCS_14 0;
BA_ "Remark" SG_ 783 SGU14_ObjRCS_14 "";
BA_ "EventCommandSignal" SG_ 783 SGU14_Obj_DistLat_rms 0;
BA_ "GatewayedSignals" SG_ 783 SGU14_Obj_DistLat_rms 0;
BA_ "GenSigInactiveValue" SG_ 783 SGU14_Obj_DistLat_rms 0;
BA_ "GenSigInvalidValue" SG_ 783 SGU14_Obj_DistLat_rms 0;
BA_ "GenSigSendType" SG_ 783 SGU14_Obj_DistLat_rms 1;
BA_ "GenSigStartValue" SG_ 783 SGU14_Obj_DistLat_rms 0;
BA_ "GenSigTimeoutValue" SG_ 783 SGU14_Obj_DistLat_rms 0;
BA_ "Remark" SG_ 783 SGU14_Obj_DistLat_rms "";
BA_ "EventCommandSignal" SG_ 783 SGU14_Obj_VrelLong_rms 0;
BA_ "GatewayedSignals" SG_ 783 SGU14_Obj_VrelLong_rms 0;
BA_ "GenSigInactiveValue" SG_ 783 SGU14_Obj_VrelLong_rms 0;
BA_ "GenSigInvalidValue" SG_ 783 SGU14_Obj_VrelLong_rms 0;
BA_ "GenSigSendType" SG_ 783 SGU14_Obj_VrelLong_rms 1;
BA_ "GenSigStartValue" SG_ 783 SGU14_Obj_VrelLong_rms 0;
BA_ "GenSigTimeoutValue" SG_ 783 SGU14_Obj_VrelLong_rms 0;
BA_ "Remark" SG_ 783 SGU14_Obj_VrelLong_rms "";
BA_ "EventCommandSignal" SG_ 783 SGU14_Obj_Vrelat_rms 0;
BA_ "GatewayedSignals" SG_ 783 SGU14_Obj_Vrelat_rms 0;
BA_ "GenSigInactiveValue" SG_ 783 SGU14_Obj_Vrelat_rms 0;
BA_ "GenSigInvalidValue" SG_ 783 SGU14_Obj_Vrelat_rms 0;
BA_ "GenSigSendType" SG_ 783 SGU14_Obj_Vrelat_rms 1;
BA_ "GenSigStartValue" SG_ 783 SGU14_Obj_Vrelat_rms 0;
BA_ "GenSigTimeoutValue" SG_ 783 SGU14_Obj_Vrelat_rms 0;
BA_ "Remark" SG_ 783 SGU14_Obj_Vrelat_rms "";
BA_ "EventCommandSignal" SG_ 783 SGU14_Object_DetStatus 0;
BA_ "GatewayedSignals" SG_ 783 SGU14_Object_DetStatus 0;
BA_ "GenSigInactiveValue" SG_ 783 SGU14_Object_DetStatus 0;
BA_ "GenSigInvalidValue" SG_ 783 SGU14_Object_DetStatus 0;
BA_ "GenSigSendType" SG_ 783 SGU14_Object_DetStatus 1;
BA_ "GenSigStartValue" SG_ 783 SGU14_Object_DetStatus 0;
BA_ "GenSigTimeoutValue" SG_ 783 SGU14_Object_DetStatus 0;
BA_ "Remark" SG_ 783 SGU14_Object_DetStatus "";
BA_ "EventCommandSignal" SG_ 783 SGU14_Object_DistLong_rms 0;
BA_ "GatewayedSignals" SG_ 783 SGU14_Object_DistLong_rms 0;
BA_ "GenSigInactiveValue" SG_ 783 SGU14_Object_DistLong_rms 0;
BA_ "GenSigInvalidValue" SG_ 783 SGU14_Object_DistLong_rms 0;
BA_ "GenSigSendType" SG_ 783 SGU14_Object_DistLong_rms 1;
BA_ "GenSigStartValue" SG_ 783 SGU14_Object_DistLong_rms 0;
BA_ "GenSigTimeoutValue" SG_ 783 SGU14_Object_DistLong_rms 0;
BA_ "Remark" SG_ 783 SGU14_Object_DistLong_rms "";
BA_ "EventCommandSignal" SG_ 783 SGU14_Object_ID 0;
BA_ "GatewayedSignals" SG_ 783 SGU14_Object_ID 0;
BA_ "GenSigInactiveValue" SG_ 783 SGU14_Object_ID 0;
BA_ "GenSigInvalidValue" SG_ 783 SGU14_Object_ID 0;
BA_ "GenSigSendType" SG_ 783 SGU14_Object_ID 1;
BA_ "GenSigStartValue" SG_ 783 SGU14_Object_ID 0;
BA_ "GenSigTimeoutValue" SG_ 783 SGU14_Object_ID 0;
BA_ "Remark" SG_ 783 SGU14_Object_ID "";
BA_ "EventCommandSignal" SG_ 783 SGU14_Object_Motion_Pattern 0;
BA_ "GatewayedSignals" SG_ 783 SGU14_Object_Motion_Pattern 0;
BA_ "GenSigInactiveValue" SG_ 783 SGU14_Object_Motion_Pattern 0;
BA_ "GenSigInvalidValue" SG_ 783 SGU14_Object_Motion_Pattern 0;
BA_ "GenSigSendType" SG_ 783 SGU14_Object_Motion_Pattern 1;
BA_ "GenSigStartValue" SG_ 783 SGU14_Object_Motion_Pattern 0;
BA_ "GenSigTimeoutValue" SG_ 783 SGU14_Object_Motion_Pattern 0;
BA_ "Remark" SG_ 783 SGU14_Object_Motion_Pattern "";
BA_ "EventCommandSignal" SG_ 783 SGU14_Object_Type 0;
BA_ "GatewayedSignals" SG_ 783 SGU14_Object_Type 0;
BA_ "GenSigInactiveValue" SG_ 783 SGU14_Object_Type 0;
BA_ "GenSigInvalidValue" SG_ 783 SGU14_Object_Type 0;
BA_ "GenSigSendType" SG_ 783 SGU14_Object_Type 1;
BA_ "GenSigStartValue" SG_ 783 SGU14_Object_Type 0;
BA_ "GenSigTimeoutValue" SG_ 783 SGU14_Object_Type 0;
BA_ "Remark" SG_ 783 SGU14_Object_Type "";
BA_ "EventCommandSignal" SG_ 783 SGU14_Object_ax 0;
BA_ "GatewayedSignals" SG_ 783 SGU14_Object_ax 0;
BA_ "GenSigInactiveValue" SG_ 783 SGU14_Object_ax 0;
BA_ "GenSigInvalidValue" SG_ 783 SGU14_Object_ax 0;
BA_ "GenSigSendType" SG_ 783 SGU14_Object_ax 1;
BA_ "GenSigStartValue" SG_ 783 SGU14_Object_ax 0;
BA_ "GenSigTimeoutValue" SG_ 783 SGU14_Object_ax 0;
BA_ "Remark" SG_ 783 SGU14_Object_ax "";
BA_ "EventCommandSignal" SG_ 783 SGU14_Object_ay 0;
BA_ "GatewayedSignals" SG_ 783 SGU14_Object_ay 0;
BA_ "GenSigInactiveValue" SG_ 783 SGU14_Object_ay 0;
BA_ "GenSigInvalidValue" SG_ 783 SGU14_Object_ay 0;
BA_ "GenSigSendType" SG_ 783 SGU14_Object_ay 1;
BA_ "GenSigStartValue" SG_ 783 SGU14_Object_ay 0;
BA_ "GenSigTimeoutValue" SG_ 783 SGU14_Object_ay 0;
BA_ "Remark" SG_ 783 SGU14_Object_ay "";
BA_ "EventCommandSignal" SG_ 783 SGU14_Object_dx 0;
BA_ "GatewayedSignals" SG_ 783 SGU14_Object_dx 0;
BA_ "GenSigInactiveValue" SG_ 783 SGU14_Object_dx 0;
BA_ "GenSigInvalidValue" SG_ 783 SGU14_Object_dx 0;
BA_ "GenSigSendType" SG_ 783 SGU14_Object_dx 1;
BA_ "GenSigStartValue" SG_ 783 SGU14_Object_dx 0;
BA_ "GenSigTimeoutValue" SG_ 783 SGU14_Object_dx 0;
BA_ "Remark" SG_ 783 SGU14_Object_dx "";
BA_ "EventCommandSignal" SG_ 783 SGU14_Object_dx_Rear 0;
BA_ "GatewayedSignals" SG_ 783 SGU14_Object_dx_Rear 0;
BA_ "GenSigInactiveValue" SG_ 783 SGU14_Object_dx_Rear 0;
BA_ "GenSigInvalidValue" SG_ 783 SGU14_Object_dx_Rear 0;
BA_ "GenSigSendType" SG_ 783 SGU14_Object_dx_Rear 1;
BA_ "GenSigStartValue" SG_ 783 SGU14_Object_dx_Rear 0;
BA_ "GenSigTimeoutValue" SG_ 783 SGU14_Object_dx_Rear 0;
BA_ "Remark" SG_ 783 SGU14_Object_dx_Rear "";
BA_ "EventCommandSignal" SG_ 783 SGU14_Object_dy 0;
BA_ "GatewayedSignals" SG_ 783 SGU14_Object_dy 0;
BA_ "GenSigInactiveValue" SG_ 783 SGU14_Object_dy 0;
BA_ "GenSigInvalidValue" SG_ 783 SGU14_Object_dy 0;
BA_ "GenSigSendType" SG_ 783 SGU14_Object_dy 1;
BA_ "GenSigStartValue" SG_ 783 SGU14_Object_dy 0;
BA_ "GenSigTimeoutValue" SG_ 783 SGU14_Object_dy 0;
BA_ "Remark" SG_ 783 SGU14_Object_dy "";
BA_ "EventCommandSignal" SG_ 783 SGU14_Object_dy_Rear 0;
BA_ "GatewayedSignals" SG_ 783 SGU14_Object_dy_Rear 0;
BA_ "GenSigInactiveValue" SG_ 783 SGU14_Object_dy_Rear 0;
BA_ "GenSigInvalidValue" SG_ 783 SGU14_Object_dy_Rear 0;
BA_ "GenSigSendType" SG_ 783 SGU14_Object_dy_Rear 1;
BA_ "GenSigStartValue" SG_ 783 SGU14_Object_dy_Rear 0;
BA_ "GenSigTimeoutValue" SG_ 783 SGU14_Object_dy_Rear 0;
BA_ "Remark" SG_ 783 SGU14_Object_dy_Rear "";
BA_ "EventCommandSignal" SG_ 783 SGU14_Object_vx 0;
BA_ "GatewayedSignals" SG_ 783 SGU14_Object_vx 0;
BA_ "GenSigInactiveValue" SG_ 783 SGU14_Object_vx 0;
BA_ "GenSigInvalidValue" SG_ 783 SGU14_Object_vx 0;
BA_ "GenSigSendType" SG_ 783 SGU14_Object_vx 1;
BA_ "GenSigStartValue" SG_ 783 SGU14_Object_vx 0;
BA_ "GenSigTimeoutValue" SG_ 783 SGU14_Object_vx 0;
BA_ "Remark" SG_ 783 SGU14_Object_vx "";
BA_ "EventCommandSignal" SG_ 783 SGU14_Object_vy 0;
BA_ "GatewayedSignals" SG_ 783 SGU14_Object_vy 0;
BA_ "GenSigInactiveValue" SG_ 783 SGU14_Object_vy 0;
BA_ "GenSigInvalidValue" SG_ 783 SGU14_Object_vy 0;
BA_ "GenSigSendType" SG_ 783 SGU14_Object_vy 1;
BA_ "GenSigStartValue" SG_ 783 SGU14_Object_vy 0;
BA_ "GenSigTimeoutValue" SG_ 783 SGU14_Object_vy 0;
BA_ "Remark" SG_ 783 SGU14_Object_vy "";
BA_ "EventCommandSignal" SG_ 783 SGU14_Object_wExist 0;
BA_ "GatewayedSignals" SG_ 783 SGU14_Object_wExist 0;
BA_ "GenSigInactiveValue" SG_ 783 SGU14_Object_wExist 0;
BA_ "GenSigInvalidValue" SG_ 783 SGU14_Object_wExist 0;
BA_ "GenSigSendType" SG_ 783 SGU14_Object_wExist 1;
BA_ "GenSigStartValue" SG_ 783 SGU14_Object_wExist 0;
BA_ "GenSigTimeoutValue" SG_ 783 SGU14_Object_wExist 0;
BA_ "Remark" SG_ 783 SGU14_Object_wExist "";
BA_ "EventCommandSignal" SG_ 783 SGU14_Object_wObstacle 0;
BA_ "GatewayedSignals" SG_ 783 SGU14_Object_wObstacle 0;
BA_ "GenSigInactiveValue" SG_ 783 SGU14_Object_wObstacle 0;
BA_ "GenSigInvalidValue" SG_ 783 SGU14_Object_wObstacle 0;
BA_ "GenSigSendType" SG_ 783 SGU14_Object_wObstacle 1;
BA_ "GenSigStartValue" SG_ 783 SGU14_Object_wObstacle 0;
BA_ "GenSigTimeoutValue" SG_ 783 SGU14_Object_wObstacle 0;
BA_ "Remark" SG_ 783 SGU14_Object_wObstacle "";
BA_ "EventCommandSignal" SG_ 784 SGU15_BlockCounter 0;
BA_ "GatewayedSignals" SG_ 784 SGU15_BlockCounter 0;
BA_ "GenSigInactiveValue" SG_ 784 SGU15_BlockCounter 0;
BA_ "GenSigInvalidValue" SG_ 784 SGU15_BlockCounter 0;
BA_ "GenSigSendType" SG_ 784 SGU15_BlockCounter 1;
BA_ "GenSigStartValue" SG_ 784 SGU15_BlockCounter 0;
BA_ "GenSigTimeoutValue" SG_ 784 SGU15_BlockCounter 0;
BA_ "Remark" SG_ 784 SGU15_BlockCounter "";
BA_ "EventCommandSignal" SG_ 784 SGU15_LifeCycles_OBJ 0;
BA_ "GatewayedSignals" SG_ 784 SGU15_LifeCycles_OBJ 0;
BA_ "GenSigInactiveValue" SG_ 784 SGU15_LifeCycles_OBJ 0;
BA_ "GenSigInvalidValue" SG_ 784 SGU15_LifeCycles_OBJ 0;
BA_ "GenSigSendType" SG_ 784 SGU15_LifeCycles_OBJ 1;
BA_ "GenSigStartValue" SG_ 784 SGU15_LifeCycles_OBJ 0;
BA_ "GenSigTimeoutValue" SG_ 784 SGU15_LifeCycles_OBJ 0;
BA_ "Remark" SG_ 784 SGU15_LifeCycles_OBJ "";
BA_ "EventCommandSignal" SG_ 784 SGU15_Msg_AliveCounter 0;
BA_ "GatewayedSignals" SG_ 784 SGU15_Msg_AliveCounter 0;
BA_ "GenSigInactiveValue" SG_ 784 SGU15_Msg_AliveCounter 0;
BA_ "GenSigInvalidValue" SG_ 784 SGU15_Msg_AliveCounter 0;
BA_ "GenSigSendType" SG_ 784 SGU15_Msg_AliveCounter 1;
BA_ "GenSigStartValue" SG_ 784 SGU15_Msg_AliveCounter 0;
BA_ "GenSigTimeoutValue" SG_ 784 SGU15_Msg_AliveCounter 0;
BA_ "Remark" SG_ 784 SGU15_Msg_AliveCounter "";
BA_ "EventCommandSignal" SG_ 784 SGU15_Msg_CheckSum 0;
BA_ "GatewayedSignals" SG_ 784 SGU15_Msg_CheckSum 0;
BA_ "GenSigInactiveValue" SG_ 784 SGU15_Msg_CheckSum 0;
BA_ "GenSigInvalidValue" SG_ 784 SGU15_Msg_CheckSum 0;
BA_ "GenSigSendType" SG_ 784 SGU15_Msg_CheckSum 1;
BA_ "GenSigStartValue" SG_ 784 SGU15_Msg_CheckSum 0;
BA_ "GenSigTimeoutValue" SG_ 784 SGU15_Msg_CheckSum 0;
BA_ "Remark" SG_ 784 SGU15_Msg_CheckSum "";
BA_ "EventCommandSignal" SG_ 784 SGU15_ObjRCS_15 0;
BA_ "GatewayedSignals" SG_ 784 SGU15_ObjRCS_15 0;
BA_ "GenSigInactiveValue" SG_ 784 SGU15_ObjRCS_15 0;
BA_ "GenSigInvalidValue" SG_ 784 SGU15_ObjRCS_15 0;
BA_ "GenSigSendType" SG_ 784 SGU15_ObjRCS_15 1;
BA_ "GenSigStartValue" SG_ 784 SGU15_ObjRCS_15 0;
BA_ "GenSigTimeoutValue" SG_ 784 SGU15_ObjRCS_15 0;
BA_ "Remark" SG_ 784 SGU15_ObjRCS_15 "";
BA_ "EventCommandSignal" SG_ 784 SGU15_Obj_DistLat_rms 0;
BA_ "GatewayedSignals" SG_ 784 SGU15_Obj_DistLat_rms 0;
BA_ "GenSigInactiveValue" SG_ 784 SGU15_Obj_DistLat_rms 0;
BA_ "GenSigInvalidValue" SG_ 784 SGU15_Obj_DistLat_rms 0;
BA_ "GenSigSendType" SG_ 784 SGU15_Obj_DistLat_rms 1;
BA_ "GenSigStartValue" SG_ 784 SGU15_Obj_DistLat_rms 0;
BA_ "GenSigTimeoutValue" SG_ 784 SGU15_Obj_DistLat_rms 0;
BA_ "Remark" SG_ 784 SGU15_Obj_DistLat_rms "";
BA_ "EventCommandSignal" SG_ 784 SGU15_Obj_VrelLong_rms 0;
BA_ "GatewayedSignals" SG_ 784 SGU15_Obj_VrelLong_rms 0;
BA_ "GenSigInactiveValue" SG_ 784 SGU15_Obj_VrelLong_rms 0;
BA_ "GenSigInvalidValue" SG_ 784 SGU15_Obj_VrelLong_rms 0;
BA_ "GenSigSendType" SG_ 784 SGU15_Obj_VrelLong_rms 1;
BA_ "GenSigStartValue" SG_ 784 SGU15_Obj_VrelLong_rms 0;
BA_ "GenSigTimeoutValue" SG_ 784 SGU15_Obj_VrelLong_rms 0;
BA_ "Remark" SG_ 784 SGU15_Obj_VrelLong_rms "";
BA_ "EventCommandSignal" SG_ 784 SGU15_Obj_Vrelat_rms 0;
BA_ "GatewayedSignals" SG_ 784 SGU15_Obj_Vrelat_rms 0;
BA_ "GenSigInactiveValue" SG_ 784 SGU15_Obj_Vrelat_rms 0;
BA_ "GenSigInvalidValue" SG_ 784 SGU15_Obj_Vrelat_rms 0;
BA_ "GenSigSendType" SG_ 784 SGU15_Obj_Vrelat_rms 1;
BA_ "GenSigStartValue" SG_ 784 SGU15_Obj_Vrelat_rms 0;
BA_ "GenSigTimeoutValue" SG_ 784 SGU15_Obj_Vrelat_rms 0;
BA_ "Remark" SG_ 784 SGU15_Obj_Vrelat_rms "";
BA_ "EventCommandSignal" SG_ 784 SGU15_Object_DetStatus 0;
BA_ "GatewayedSignals" SG_ 784 SGU15_Object_DetStatus 0;
BA_ "GenSigInactiveValue" SG_ 784 SGU15_Object_DetStatus 0;
BA_ "GenSigInvalidValue" SG_ 784 SGU15_Object_DetStatus 0;
BA_ "GenSigSendType" SG_ 784 SGU15_Object_DetStatus 1;
BA_ "GenSigStartValue" SG_ 784 SGU15_Object_DetStatus 0;
BA_ "GenSigTimeoutValue" SG_ 784 SGU15_Object_DetStatus 0;
BA_ "Remark" SG_ 784 SGU15_Object_DetStatus "";
BA_ "EventCommandSignal" SG_ 784 SGU15_Object_DistLong_rms 0;
BA_ "GatewayedSignals" SG_ 784 SGU15_Object_DistLong_rms 0;
BA_ "GenSigInactiveValue" SG_ 784 SGU15_Object_DistLong_rms 0;
BA_ "GenSigInvalidValue" SG_ 784 SGU15_Object_DistLong_rms 0;
BA_ "GenSigSendType" SG_ 784 SGU15_Object_DistLong_rms 1;
BA_ "GenSigStartValue" SG_ 784 SGU15_Object_DistLong_rms 0;
BA_ "GenSigTimeoutValue" SG_ 784 SGU15_Object_DistLong_rms 0;
BA_ "Remark" SG_ 784 SGU15_Object_DistLong_rms "";
BA_ "EventCommandSignal" SG_ 784 SGU15_Object_ID 0;
BA_ "GatewayedSignals" SG_ 784 SGU15_Object_ID 0;
BA_ "GenSigInactiveValue" SG_ 784 SGU15_Object_ID 0;
BA_ "GenSigInvalidValue" SG_ 784 SGU15_Object_ID 0;
BA_ "GenSigSendType" SG_ 784 SGU15_Object_ID 1;
BA_ "GenSigStartValue" SG_ 784 SGU15_Object_ID 0;
BA_ "GenSigTimeoutValue" SG_ 784 SGU15_Object_ID 0;
BA_ "Remark" SG_ 784 SGU15_Object_ID "";
BA_ "EventCommandSignal" SG_ 784 SGU15_Object_Motion_Pattern 0;
BA_ "GatewayedSignals" SG_ 784 SGU15_Object_Motion_Pattern 0;
BA_ "GenSigInactiveValue" SG_ 784 SGU15_Object_Motion_Pattern 0;
BA_ "GenSigInvalidValue" SG_ 784 SGU15_Object_Motion_Pattern 0;
BA_ "GenSigSendType" SG_ 784 SGU15_Object_Motion_Pattern 1;
BA_ "GenSigStartValue" SG_ 784 SGU15_Object_Motion_Pattern 0;
BA_ "GenSigTimeoutValue" SG_ 784 SGU15_Object_Motion_Pattern 0;
BA_ "Remark" SG_ 784 SGU15_Object_Motion_Pattern "";
BA_ "EventCommandSignal" SG_ 784 SGU15_Object_Type 0;
BA_ "GatewayedSignals" SG_ 784 SGU15_Object_Type 0;
BA_ "GenSigInactiveValue" SG_ 784 SGU15_Object_Type 0;
BA_ "GenSigInvalidValue" SG_ 784 SGU15_Object_Type 0;
BA_ "GenSigSendType" SG_ 784 SGU15_Object_Type 1;
BA_ "GenSigStartValue" SG_ 784 SGU15_Object_Type 0;
BA_ "GenSigTimeoutValue" SG_ 784 SGU15_Object_Type 0;
BA_ "Remark" SG_ 784 SGU15_Object_Type "";
BA_ "EventCommandSignal" SG_ 784 SGU15_Object_ax 0;
BA_ "GatewayedSignals" SG_ 784 SGU15_Object_ax 0;
BA_ "GenSigInactiveValue" SG_ 784 SGU15_Object_ax 0;
BA_ "GenSigInvalidValue" SG_ 784 SGU15_Object_ax 0;
BA_ "GenSigSendType" SG_ 784 SGU15_Object_ax 1;
BA_ "GenSigStartValue" SG_ 784 SGU15_Object_ax 0;
BA_ "GenSigTimeoutValue" SG_ 784 SGU15_Object_ax 0;
BA_ "Remark" SG_ 784 SGU15_Object_ax "";
BA_ "EventCommandSignal" SG_ 784 SGU15_Object_ay 0;
BA_ "GatewayedSignals" SG_ 784 SGU15_Object_ay 0;
BA_ "GenSigInactiveValue" SG_ 784 SGU15_Object_ay 0;
BA_ "GenSigInvalidValue" SG_ 784 SGU15_Object_ay 0;
BA_ "GenSigSendType" SG_ 784 SGU15_Object_ay 1;
BA_ "GenSigStartValue" SG_ 784 SGU15_Object_ay 0;
BA_ "GenSigTimeoutValue" SG_ 784 SGU15_Object_ay 0;
BA_ "Remark" SG_ 784 SGU15_Object_ay "";
BA_ "EventCommandSignal" SG_ 784 SGU15_Object_dx 0;
BA_ "GatewayedSignals" SG_ 784 SGU15_Object_dx 0;
BA_ "GenSigInactiveValue" SG_ 784 SGU15_Object_dx 0;
BA_ "GenSigInvalidValue" SG_ 784 SGU15_Object_dx 0;
BA_ "GenSigSendType" SG_ 784 SGU15_Object_dx 1;
BA_ "GenSigStartValue" SG_ 784 SGU15_Object_dx 0;
BA_ "GenSigTimeoutValue" SG_ 784 SGU15_Object_dx 0;
BA_ "Remark" SG_ 784 SGU15_Object_dx "";
BA_ "EventCommandSignal" SG_ 784 SGU15_Object_dx_Rear 0;
BA_ "GatewayedSignals" SG_ 784 SGU15_Object_dx_Rear 0;
BA_ "GenSigInactiveValue" SG_ 784 SGU15_Object_dx_Rear 0;
BA_ "GenSigInvalidValue" SG_ 784 SGU15_Object_dx_Rear 0;
BA_ "GenSigSendType" SG_ 784 SGU15_Object_dx_Rear 1;
BA_ "GenSigStartValue" SG_ 784 SGU15_Object_dx_Rear 0;
BA_ "GenSigTimeoutValue" SG_ 784 SGU15_Object_dx_Rear 0;
BA_ "Remark" SG_ 784 SGU15_Object_dx_Rear "";
BA_ "EventCommandSignal" SG_ 784 SGU15_Object_dy 0;
BA_ "GatewayedSignals" SG_ 784 SGU15_Object_dy 0;
BA_ "GenSigInactiveValue" SG_ 784 SGU15_Object_dy 0;
BA_ "GenSigInvalidValue" SG_ 784 SGU15_Object_dy 0;
BA_ "GenSigSendType" SG_ 784 SGU15_Object_dy 1;
BA_ "GenSigStartValue" SG_ 784 SGU15_Object_dy 0;
BA_ "GenSigTimeoutValue" SG_ 784 SGU15_Object_dy 0;
BA_ "Remark" SG_ 784 SGU15_Object_dy "";
BA_ "EventCommandSignal" SG_ 784 SGU15_Object_dy_Rear 0;
BA_ "GatewayedSignals" SG_ 784 SGU15_Object_dy_Rear 0;
BA_ "GenSigInactiveValue" SG_ 784 SGU15_Object_dy_Rear 0;
BA_ "GenSigInvalidValue" SG_ 784 SGU15_Object_dy_Rear 0;
BA_ "GenSigSendType" SG_ 784 SGU15_Object_dy_Rear 1;
BA_ "GenSigStartValue" SG_ 784 SGU15_Object_dy_Rear 0;
BA_ "GenSigTimeoutValue" SG_ 784 SGU15_Object_dy_Rear 0;
BA_ "Remark" SG_ 784 SGU15_Object_dy_Rear "";
BA_ "EventCommandSignal" SG_ 784 SGU15_Object_vx 0;
BA_ "GatewayedSignals" SG_ 784 SGU15_Object_vx 0;
BA_ "GenSigInactiveValue" SG_ 784 SGU15_Object_vx 0;
BA_ "GenSigInvalidValue" SG_ 784 SGU15_Object_vx 0;
BA_ "GenSigSendType" SG_ 784 SGU15_Object_vx 1;
BA_ "GenSigStartValue" SG_ 784 SGU15_Object_vx 0;
BA_ "GenSigTimeoutValue" SG_ 784 SGU15_Object_vx 0;
BA_ "Remark" SG_ 784 SGU15_Object_vx "";
BA_ "EventCommandSignal" SG_ 784 SGU15_Object_vy 0;
BA_ "GatewayedSignals" SG_ 784 SGU15_Object_vy 0;
BA_ "GenSigInactiveValue" SG_ 784 SGU15_Object_vy 0;
BA_ "GenSigInvalidValue" SG_ 784 SGU15_Object_vy 0;
BA_ "GenSigSendType" SG_ 784 SGU15_Object_vy 1;
BA_ "GenSigStartValue" SG_ 784 SGU15_Object_vy 0;
BA_ "GenSigTimeoutValue" SG_ 784 SGU15_Object_vy 0;
BA_ "Remark" SG_ 784 SGU15_Object_vy "";
BA_ "EventCommandSignal" SG_ 784 SGU15_Object_wExist 0;
BA_ "GatewayedSignals" SG_ 784 SGU15_Object_wExist 0;
BA_ "GenSigInactiveValue" SG_ 784 SGU15_Object_wExist 0;
BA_ "GenSigInvalidValue" SG_ 784 SGU15_Object_wExist 0;
BA_ "GenSigSendType" SG_ 784 SGU15_Object_wExist 1;
BA_ "GenSigStartValue" SG_ 784 SGU15_Object_wExist 0;
BA_ "GenSigTimeoutValue" SG_ 784 SGU15_Object_wExist 0;
BA_ "Remark" SG_ 784 SGU15_Object_wExist "";
BA_ "EventCommandSignal" SG_ 784 SGU15_Object_wObstacle 0;
BA_ "GatewayedSignals" SG_ 784 SGU15_Object_wObstacle 0;
BA_ "GenSigInactiveValue" SG_ 784 SGU15_Object_wObstacle 0;
BA_ "GenSigInvalidValue" SG_ 784 SGU15_Object_wObstacle 0;
BA_ "GenSigSendType" SG_ 784 SGU15_Object_wObstacle 1;
BA_ "GenSigStartValue" SG_ 784 SGU15_Object_wObstacle 0;
BA_ "GenSigTimeoutValue" SG_ 784 SGU15_Object_wObstacle 0;
BA_ "Remark" SG_ 784 SGU15_Object_wObstacle "";
BA_ "EventCommandSignal" SG_ 785 SGU16_BlockCounter 0;
BA_ "GatewayedSignals" SG_ 785 SGU16_BlockCounter 0;
BA_ "GenSigInactiveValue" SG_ 785 SGU16_BlockCounter 0;
BA_ "GenSigInvalidValue" SG_ 785 SGU16_BlockCounter 0;
BA_ "GenSigSendType" SG_ 785 SGU16_BlockCounter 1;
BA_ "GenSigStartValue" SG_ 785 SGU16_BlockCounter 0;
BA_ "GenSigTimeoutValue" SG_ 785 SGU16_BlockCounter 0;
BA_ "Remark" SG_ 785 SGU16_BlockCounter "";
BA_ "EventCommandSignal" SG_ 785 SGU16_LifeCycles_OBJ 0;
BA_ "GatewayedSignals" SG_ 785 SGU16_LifeCycles_OBJ 0;
BA_ "GenSigInactiveValue" SG_ 785 SGU16_LifeCycles_OBJ 0;
BA_ "GenSigInvalidValue" SG_ 785 SGU16_LifeCycles_OBJ 0;
BA_ "GenSigSendType" SG_ 785 SGU16_LifeCycles_OBJ 1;
BA_ "GenSigStartValue" SG_ 785 SGU16_LifeCycles_OBJ 0;
BA_ "GenSigTimeoutValue" SG_ 785 SGU16_LifeCycles_OBJ 0;
BA_ "Remark" SG_ 785 SGU16_LifeCycles_OBJ "";
BA_ "EventCommandSignal" SG_ 785 SGU16_Msg_AliveCounter 0;
BA_ "GatewayedSignals" SG_ 785 SGU16_Msg_AliveCounter 0;
BA_ "GenSigInactiveValue" SG_ 785 SGU16_Msg_AliveCounter 0;
BA_ "GenSigInvalidValue" SG_ 785 SGU16_Msg_AliveCounter 0;
BA_ "GenSigSendType" SG_ 785 SGU16_Msg_AliveCounter 1;
BA_ "GenSigStartValue" SG_ 785 SGU16_Msg_AliveCounter 0;
BA_ "GenSigTimeoutValue" SG_ 785 SGU16_Msg_AliveCounter 0;
BA_ "Remark" SG_ 785 SGU16_Msg_AliveCounter "";
BA_ "EventCommandSignal" SG_ 785 SGU16_Msg_CheckSum 0;
BA_ "GatewayedSignals" SG_ 785 SGU16_Msg_CheckSum 0;
BA_ "GenSigInactiveValue" SG_ 785 SGU16_Msg_CheckSum 0;
BA_ "GenSigInvalidValue" SG_ 785 SGU16_Msg_CheckSum 0;
BA_ "GenSigSendType" SG_ 785 SGU16_Msg_CheckSum 1;
BA_ "GenSigStartValue" SG_ 785 SGU16_Msg_CheckSum 0;
BA_ "GenSigTimeoutValue" SG_ 785 SGU16_Msg_CheckSum 0;
BA_ "Remark" SG_ 785 SGU16_Msg_CheckSum "";
BA_ "EventCommandSignal" SG_ 785 SGU16_ObjRCS_16 0;
BA_ "GatewayedSignals" SG_ 785 SGU16_ObjRCS_16 0;
BA_ "GenSigInactiveValue" SG_ 785 SGU16_ObjRCS_16 0;
BA_ "GenSigInvalidValue" SG_ 785 SGU16_ObjRCS_16 0;
BA_ "GenSigSendType" SG_ 785 SGU16_ObjRCS_16 1;
BA_ "GenSigStartValue" SG_ 785 SGU16_ObjRCS_16 0;
BA_ "GenSigTimeoutValue" SG_ 785 SGU16_ObjRCS_16 0;
BA_ "Remark" SG_ 785 SGU16_ObjRCS_16 "";
BA_ "EventCommandSignal" SG_ 785 SGU16_Obj_DistLat_rms 0;
BA_ "GatewayedSignals" SG_ 785 SGU16_Obj_DistLat_rms 0;
BA_ "GenSigInactiveValue" SG_ 785 SGU16_Obj_DistLat_rms 0;
BA_ "GenSigInvalidValue" SG_ 785 SGU16_Obj_DistLat_rms 0;
BA_ "GenSigSendType" SG_ 785 SGU16_Obj_DistLat_rms 1;
BA_ "GenSigStartValue" SG_ 785 SGU16_Obj_DistLat_rms 0;
BA_ "GenSigTimeoutValue" SG_ 785 SGU16_Obj_DistLat_rms 0;
BA_ "Remark" SG_ 785 SGU16_Obj_DistLat_rms "";
BA_ "EventCommandSignal" SG_ 785 SGU16_Obj_VrelLong_rms 0;
BA_ "GatewayedSignals" SG_ 785 SGU16_Obj_VrelLong_rms 0;
BA_ "GenSigInactiveValue" SG_ 785 SGU16_Obj_VrelLong_rms 0;
BA_ "GenSigInvalidValue" SG_ 785 SGU16_Obj_VrelLong_rms 0;
BA_ "GenSigSendType" SG_ 785 SGU16_Obj_VrelLong_rms 1;
BA_ "GenSigStartValue" SG_ 785 SGU16_Obj_VrelLong_rms 0;
BA_ "GenSigTimeoutValue" SG_ 785 SGU16_Obj_VrelLong_rms 0;
BA_ "Remark" SG_ 785 SGU16_Obj_VrelLong_rms "";
BA_ "EventCommandSignal" SG_ 785 SGU16_Obj_Vrelat_rms 0;
BA_ "GatewayedSignals" SG_ 785 SGU16_Obj_Vrelat_rms 0;
BA_ "GenSigInactiveValue" SG_ 785 SGU16_Obj_Vrelat_rms 0;
BA_ "GenSigInvalidValue" SG_ 785 SGU16_Obj_Vrelat_rms 0;
BA_ "GenSigSendType" SG_ 785 SGU16_Obj_Vrelat_rms 1;
BA_ "GenSigStartValue" SG_ 785 SGU16_Obj_Vrelat_rms 0;
BA_ "GenSigTimeoutValue" SG_ 785 SGU16_Obj_Vrelat_rms 0;
BA_ "Remark" SG_ 785 SGU16_Obj_Vrelat_rms "";
BA_ "EventCommandSignal" SG_ 785 SGU16_Object_DetStatus 0;
BA_ "GatewayedSignals" SG_ 785 SGU16_Object_DetStatus 0;
BA_ "GenSigInactiveValue" SG_ 785 SGU16_Object_DetStatus 0;
BA_ "GenSigInvalidValue" SG_ 785 SGU16_Object_DetStatus 0;
BA_ "GenSigSendType" SG_ 785 SGU16_Object_DetStatus 1;
BA_ "GenSigStartValue" SG_ 785 SGU16_Object_DetStatus 0;
BA_ "GenSigTimeoutValue" SG_ 785 SGU16_Object_DetStatus 0;
BA_ "Remark" SG_ 785 SGU16_Object_DetStatus "";
BA_ "EventCommandSignal" SG_ 785 SGU16_Object_DistLong_rms 0;
BA_ "GatewayedSignals" SG_ 785 SGU16_Object_DistLong_rms 0;
BA_ "GenSigInactiveValue" SG_ 785 SGU16_Object_DistLong_rms 0;
BA_ "GenSigInvalidValue" SG_ 785 SGU16_Object_DistLong_rms 0;
BA_ "GenSigSendType" SG_ 785 SGU16_Object_DistLong_rms 1;
BA_ "GenSigStartValue" SG_ 785 SGU16_Object_DistLong_rms 0;
BA_ "GenSigTimeoutValue" SG_ 785 SGU16_Object_DistLong_rms 0;
BA_ "Remark" SG_ 785 SGU16_Object_DistLong_rms "";
BA_ "EventCommandSignal" SG_ 785 SGU16_Object_ID 0;
BA_ "GatewayedSignals" SG_ 785 SGU16_Object_ID 0;
BA_ "GenSigInactiveValue" SG_ 785 SGU16_Object_ID 0;
BA_ "GenSigInvalidValue" SG_ 785 SGU16_Object_ID 0;
BA_ "GenSigSendType" SG_ 785 SGU16_Object_ID 1;
BA_ "GenSigStartValue" SG_ 785 SGU16_Object_ID 0;
BA_ "GenSigTimeoutValue" SG_ 785 SGU16_Object_ID 0;
BA_ "Remark" SG_ 785 SGU16_Object_ID "";
BA_ "EventCommandSignal" SG_ 785 SGU16_Object_Motion_Pattern 0;
BA_ "GatewayedSignals" SG_ 785 SGU16_Object_Motion_Pattern 0;
BA_ "GenSigInactiveValue" SG_ 785 SGU16_Object_Motion_Pattern 0;
BA_ "GenSigInvalidValue" SG_ 785 SGU16_Object_Motion_Pattern 0;
BA_ "GenSigSendType" SG_ 785 SGU16_Object_Motion_Pattern 1;
BA_ "GenSigStartValue" SG_ 785 SGU16_Object_Motion_Pattern 0;
BA_ "GenSigTimeoutValue" SG_ 785 SGU16_Object_Motion_Pattern 0;
BA_ "Remark" SG_ 785 SGU16_Object_Motion_Pattern "";
BA_ "EventCommandSignal" SG_ 785 SGU16_Object_Type 0;
BA_ "GatewayedSignals" SG_ 785 SGU16_Object_Type 0;
BA_ "GenSigInactiveValue" SG_ 785 SGU16_Object_Type 0;
BA_ "GenSigInvalidValue" SG_ 785 SGU16_Object_Type 0;
BA_ "GenSigSendType" SG_ 785 SGU16_Object_Type 1;
BA_ "GenSigStartValue" SG_ 785 SGU16_Object_Type 0;
BA_ "GenSigTimeoutValue" SG_ 785 SGU16_Object_Type 0;
BA_ "Remark" SG_ 785 SGU16_Object_Type "";
BA_ "EventCommandSignal" SG_ 785 SGU16_Object_ax 0;
BA_ "GatewayedSignals" SG_ 785 SGU16_Object_ax 0;
BA_ "GenSigInactiveValue" SG_ 785 SGU16_Object_ax 0;
BA_ "GenSigInvalidValue" SG_ 785 SGU16_Object_ax 0;
BA_ "GenSigSendType" SG_ 785 SGU16_Object_ax 1;
BA_ "GenSigStartValue" SG_ 785 SGU16_Object_ax 0;
BA_ "GenSigTimeoutValue" SG_ 785 SGU16_Object_ax 0;
BA_ "Remark" SG_ 785 SGU16_Object_ax "";
BA_ "EventCommandSignal" SG_ 785 SGU16_Object_ay 0;
BA_ "GatewayedSignals" SG_ 785 SGU16_Object_ay 0;
BA_ "GenSigInactiveValue" SG_ 785 SGU16_Object_ay 0;
BA_ "GenSigInvalidValue" SG_ 785 SGU16_Object_ay 0;
BA_ "GenSigSendType" SG_ 785 SGU16_Object_ay 1;
BA_ "GenSigStartValue" SG_ 785 SGU16_Object_ay 0;
BA_ "GenSigTimeoutValue" SG_ 785 SGU16_Object_ay 0;
BA_ "Remark" SG_ 785 SGU16_Object_ay "";
BA_ "EventCommandSignal" SG_ 785 SGU16_Object_dx 0;
BA_ "GatewayedSignals" SG_ 785 SGU16_Object_dx 0;
BA_ "GenSigInactiveValue" SG_ 785 SGU16_Object_dx 0;
BA_ "GenSigInvalidValue" SG_ 785 SGU16_Object_dx 0;
BA_ "GenSigSendType" SG_ 785 SGU16_Object_dx 1;
BA_ "GenSigStartValue" SG_ 785 SGU16_Object_dx 0;
BA_ "GenSigTimeoutValue" SG_ 785 SGU16_Object_dx 0;
BA_ "Remark" SG_ 785 SGU16_Object_dx "";
BA_ "EventCommandSignal" SG_ 785 SGU16_Object_dx_Rear 0;
BA_ "GatewayedSignals" SG_ 785 SGU16_Object_dx_Rear 0;
BA_ "GenSigInactiveValue" SG_ 785 SGU16_Object_dx_Rear 0;
BA_ "GenSigInvalidValue" SG_ 785 SGU16_Object_dx_Rear 0;
BA_ "GenSigSendType" SG_ 785 SGU16_Object_dx_Rear 1;
BA_ "GenSigStartValue" SG_ 785 SGU16_Object_dx_Rear 0;
BA_ "GenSigTimeoutValue" SG_ 785 SGU16_Object_dx_Rear 0;
BA_ "Remark" SG_ 785 SGU16_Object_dx_Rear "";
BA_ "EventCommandSignal" SG_ 785 SGU16_Object_dy 0;
BA_ "GatewayedSignals" SG_ 785 SGU16_Object_dy 0;
BA_ "GenSigInactiveValue" SG_ 785 SGU16_Object_dy 0;
BA_ "GenSigInvalidValue" SG_ 785 SGU16_Object_dy 0;
BA_ "GenSigSendType" SG_ 785 SGU16_Object_dy 1;
BA_ "GenSigStartValue" SG_ 785 SGU16_Object_dy 0;
BA_ "GenSigTimeoutValue" SG_ 785 SGU16_Object_dy 0;
BA_ "Remark" SG_ 785 SGU16_Object_dy "";
BA_ "EventCommandSignal" SG_ 785 SGU16_Object_dy_Rear 0;
BA_ "GatewayedSignals" SG_ 785 SGU16_Object_dy_Rear 0;
BA_ "GenSigInactiveValue" SG_ 785 SGU16_Object_dy_Rear 0;
BA_ "GenSigInvalidValue" SG_ 785 SGU16_Object_dy_Rear 0;
BA_ "GenSigSendType" SG_ 785 SGU16_Object_dy_Rear 1;
BA_ "GenSigStartValue" SG_ 785 SGU16_Object_dy_Rear 0;
BA_ "GenSigTimeoutValue" SG_ 785 SGU16_Object_dy_Rear 0;
BA_ "Remark" SG_ 785 SGU16_Object_dy_Rear "";
BA_ "EventCommandSignal" SG_ 785 SGU16_Object_vx 0;
BA_ "GatewayedSignals" SG_ 785 SGU16_Object_vx 0;
BA_ "GenSigInactiveValue" SG_ 785 SGU16_Object_vx 0;
BA_ "GenSigInvalidValue" SG_ 785 SGU16_Object_vx 0;
BA_ "GenSigSendType" SG_ 785 SGU16_Object_vx 1;
BA_ "GenSigStartValue" SG_ 785 SGU16_Object_vx 0;
BA_ "GenSigTimeoutValue" SG_ 785 SGU16_Object_vx 0;
BA_ "Remark" SG_ 785 SGU16_Object_vx "";
BA_ "EventCommandSignal" SG_ 785 SGU16_Object_vy 0;
BA_ "GatewayedSignals" SG_ 785 SGU16_Object_vy 0;
BA_ "GenSigInactiveValue" SG_ 785 SGU16_Object_vy 0;
BA_ "GenSigInvalidValue" SG_ 785 SGU16_Object_vy 0;
BA_ "GenSigSendType" SG_ 785 SGU16_Object_vy 1;
BA_ "GenSigStartValue" SG_ 785 SGU16_Object_vy 0;
BA_ "GenSigTimeoutValue" SG_ 785 SGU16_Object_vy 0;
BA_ "Remark" SG_ 785 SGU16_Object_vy "";
BA_ "EventCommandSignal" SG_ 785 SGU16_Object_wExist 0;
BA_ "GatewayedSignals" SG_ 785 SGU16_Object_wExist 0;
BA_ "GenSigInactiveValue" SG_ 785 SGU16_Object_wExist 0;
BA_ "GenSigInvalidValue" SG_ 785 SGU16_Object_wExist 0;
BA_ "GenSigSendType" SG_ 785 SGU16_Object_wExist 1;
BA_ "GenSigStartValue" SG_ 785 SGU16_Object_wExist 0;
BA_ "GenSigTimeoutValue" SG_ 785 SGU16_Object_wExist 0;
BA_ "Remark" SG_ 785 SGU16_Object_wExist "";
BA_ "EventCommandSignal" SG_ 785 SGU16_Object_wObstacle 0;
BA_ "GatewayedSignals" SG_ 785 SGU16_Object_wObstacle 0;
BA_ "GenSigInactiveValue" SG_ 785 SGU16_Object_wObstacle 0;
BA_ "GenSigInvalidValue" SG_ 785 SGU16_Object_wObstacle 0;
BA_ "GenSigSendType" SG_ 785 SGU16_Object_wObstacle 1;
BA_ "GenSigStartValue" SG_ 785 SGU16_Object_wObstacle 0;
BA_ "GenSigTimeoutValue" SG_ 785 SGU16_Object_wObstacle 0;
BA_ "Remark" SG_ 785 SGU16_Object_wObstacle "";
BA_ "EventCommandSignal" SG_ 786 SGU17_BlockCounter 0;
BA_ "GatewayedSignals" SG_ 786 SGU17_BlockCounter 0;
BA_ "GenSigInactiveValue" SG_ 786 SGU17_BlockCounter 0;
BA_ "GenSigInvalidValue" SG_ 786 SGU17_BlockCounter 0;
BA_ "GenSigSendType" SG_ 786 SGU17_BlockCounter 1;
BA_ "GenSigStartValue" SG_ 786 SGU17_BlockCounter 0;
BA_ "GenSigTimeoutValue" SG_ 786 SGU17_BlockCounter 0;
BA_ "Remark" SG_ 786 SGU17_BlockCounter "";
BA_ "EventCommandSignal" SG_ 786 SGU17_LifeCycles_OBJ 0;
BA_ "GatewayedSignals" SG_ 786 SGU17_LifeCycles_OBJ 0;
BA_ "GenSigInactiveValue" SG_ 786 SGU17_LifeCycles_OBJ 0;
BA_ "GenSigInvalidValue" SG_ 786 SGU17_LifeCycles_OBJ 0;
BA_ "GenSigSendType" SG_ 786 SGU17_LifeCycles_OBJ 1;
BA_ "GenSigStartValue" SG_ 786 SGU17_LifeCycles_OBJ 0;
BA_ "GenSigTimeoutValue" SG_ 786 SGU17_LifeCycles_OBJ 0;
BA_ "Remark" SG_ 786 SGU17_LifeCycles_OBJ "";
BA_ "EventCommandSignal" SG_ 786 SGU17_Msg_AliveCounter 0;
BA_ "GatewayedSignals" SG_ 786 SGU17_Msg_AliveCounter 0;
BA_ "GenSigInactiveValue" SG_ 786 SGU17_Msg_AliveCounter 0;
BA_ "GenSigInvalidValue" SG_ 786 SGU17_Msg_AliveCounter 0;
BA_ "GenSigSendType" SG_ 786 SGU17_Msg_AliveCounter 1;
BA_ "GenSigStartValue" SG_ 786 SGU17_Msg_AliveCounter 0;
BA_ "GenSigTimeoutValue" SG_ 786 SGU17_Msg_AliveCounter 0;
BA_ "Remark" SG_ 786 SGU17_Msg_AliveCounter "";
BA_ "EventCommandSignal" SG_ 786 SGU17_Msg_CheckSum 0;
BA_ "GatewayedSignals" SG_ 786 SGU17_Msg_CheckSum 0;
BA_ "GenSigInactiveValue" SG_ 786 SGU17_Msg_CheckSum 0;
BA_ "GenSigInvalidValue" SG_ 786 SGU17_Msg_CheckSum 0;
BA_ "GenSigSendType" SG_ 786 SGU17_Msg_CheckSum 1;
BA_ "GenSigStartValue" SG_ 786 SGU17_Msg_CheckSum 0;
BA_ "GenSigTimeoutValue" SG_ 786 SGU17_Msg_CheckSum 0;
BA_ "Remark" SG_ 786 SGU17_Msg_CheckSum "";
BA_ "EventCommandSignal" SG_ 786 SGU17_ObjRCS_17 0;
BA_ "GatewayedSignals" SG_ 786 SGU17_ObjRCS_17 0;
BA_ "GenSigInactiveValue" SG_ 786 SGU17_ObjRCS_17 0;
BA_ "GenSigInvalidValue" SG_ 786 SGU17_ObjRCS_17 0;
BA_ "GenSigSendType" SG_ 786 SGU17_ObjRCS_17 1;
BA_ "GenSigStartValue" SG_ 786 SGU17_ObjRCS_17 0;
BA_ "GenSigTimeoutValue" SG_ 786 SGU17_ObjRCS_17 0;
BA_ "Remark" SG_ 786 SGU17_ObjRCS_17 "";
BA_ "EventCommandSignal" SG_ 786 SGU17_Obj_DistLat_rms 0;
BA_ "GatewayedSignals" SG_ 786 SGU17_Obj_DistLat_rms 0;
BA_ "GenSigInactiveValue" SG_ 786 SGU17_Obj_DistLat_rms 0;
BA_ "GenSigInvalidValue" SG_ 786 SGU17_Obj_DistLat_rms 0;
BA_ "GenSigSendType" SG_ 786 SGU17_Obj_DistLat_rms 1;
BA_ "GenSigStartValue" SG_ 786 SGU17_Obj_DistLat_rms 0;
BA_ "GenSigTimeoutValue" SG_ 786 SGU17_Obj_DistLat_rms 0;
BA_ "Remark" SG_ 786 SGU17_Obj_DistLat_rms "";
BA_ "EventCommandSignal" SG_ 786 SGU17_Obj_VrelLong_rms 0;
BA_ "GatewayedSignals" SG_ 786 SGU17_Obj_VrelLong_rms 0;
BA_ "GenSigInactiveValue" SG_ 786 SGU17_Obj_VrelLong_rms 0;
BA_ "GenSigInvalidValue" SG_ 786 SGU17_Obj_VrelLong_rms 0;
BA_ "GenSigSendType" SG_ 786 SGU17_Obj_VrelLong_rms 1;
BA_ "GenSigStartValue" SG_ 786 SGU17_Obj_VrelLong_rms 0;
BA_ "GenSigTimeoutValue" SG_ 786 SGU17_Obj_VrelLong_rms 0;
BA_ "Remark" SG_ 786 SGU17_Obj_VrelLong_rms "";
BA_ "EventCommandSignal" SG_ 786 SGU17_Obj_Vrelat_rms 0;
BA_ "GatewayedSignals" SG_ 786 SGU17_Obj_Vrelat_rms 0;
BA_ "GenSigInactiveValue" SG_ 786 SGU17_Obj_Vrelat_rms 0;
BA_ "GenSigInvalidValue" SG_ 786 SGU17_Obj_Vrelat_rms 0;
BA_ "GenSigSendType" SG_ 786 SGU17_Obj_Vrelat_rms 1;
BA_ "GenSigStartValue" SG_ 786 SGU17_Obj_Vrelat_rms 0;
BA_ "GenSigTimeoutValue" SG_ 786 SGU17_Obj_Vrelat_rms 0;
BA_ "Remark" SG_ 786 SGU17_Obj_Vrelat_rms "";
BA_ "EventCommandSignal" SG_ 786 SGU17_Object_DetStatus 0;
BA_ "GatewayedSignals" SG_ 786 SGU17_Object_DetStatus 0;
BA_ "GenSigInactiveValue" SG_ 786 SGU17_Object_DetStatus 0;
BA_ "GenSigInvalidValue" SG_ 786 SGU17_Object_DetStatus 0;
BA_ "GenSigSendType" SG_ 786 SGU17_Object_DetStatus 1;
BA_ "GenSigStartValue" SG_ 786 SGU17_Object_DetStatus 0;
BA_ "GenSigTimeoutValue" SG_ 786 SGU17_Object_DetStatus 0;
BA_ "Remark" SG_ 786 SGU17_Object_DetStatus "";
BA_ "EventCommandSignal" SG_ 786 SGU17_Object_DistLong_rms 0;
BA_ "GatewayedSignals" SG_ 786 SGU17_Object_DistLong_rms 0;
BA_ "GenSigInactiveValue" SG_ 786 SGU17_Object_DistLong_rms 0;
BA_ "GenSigInvalidValue" SG_ 786 SGU17_Object_DistLong_rms 0;
BA_ "GenSigSendType" SG_ 786 SGU17_Object_DistLong_rms 1;
BA_ "GenSigStartValue" SG_ 786 SGU17_Object_DistLong_rms 0;
BA_ "GenSigTimeoutValue" SG_ 786 SGU17_Object_DistLong_rms 0;
BA_ "Remark" SG_ 786 SGU17_Object_DistLong_rms "";
BA_ "EventCommandSignal" SG_ 786 SGU17_Object_ID 0;
BA_ "GatewayedSignals" SG_ 786 SGU17_Object_ID 0;
BA_ "GenSigInactiveValue" SG_ 786 SGU17_Object_ID 0;
BA_ "GenSigInvalidValue" SG_ 786 SGU17_Object_ID 0;
BA_ "GenSigSendType" SG_ 786 SGU17_Object_ID 1;
BA_ "GenSigStartValue" SG_ 786 SGU17_Object_ID 0;
BA_ "GenSigTimeoutValue" SG_ 786 SGU17_Object_ID 0;
BA_ "Remark" SG_ 786 SGU17_Object_ID "";
BA_ "EventCommandSignal" SG_ 786 SGU17_Object_Motion_Pattern 0;
BA_ "GatewayedSignals" SG_ 786 SGU17_Object_Motion_Pattern 0;
BA_ "GenSigInactiveValue" SG_ 786 SGU17_Object_Motion_Pattern 0;
BA_ "GenSigInvalidValue" SG_ 786 SGU17_Object_Motion_Pattern 0;
BA_ "GenSigSendType" SG_ 786 SGU17_Object_Motion_Pattern 1;
BA_ "GenSigStartValue" SG_ 786 SGU17_Object_Motion_Pattern 0;
BA_ "GenSigTimeoutValue" SG_ 786 SGU17_Object_Motion_Pattern 0;
BA_ "Remark" SG_ 786 SGU17_Object_Motion_Pattern "";
BA_ "EventCommandSignal" SG_ 786 SGU17_Object_Type 0;
BA_ "GatewayedSignals" SG_ 786 SGU17_Object_Type 0;
BA_ "GenSigInactiveValue" SG_ 786 SGU17_Object_Type 0;
BA_ "GenSigInvalidValue" SG_ 786 SGU17_Object_Type 0;
BA_ "GenSigSendType" SG_ 786 SGU17_Object_Type 1;
BA_ "GenSigStartValue" SG_ 786 SGU17_Object_Type 0;
BA_ "GenSigTimeoutValue" SG_ 786 SGU17_Object_Type 0;
BA_ "Remark" SG_ 786 SGU17_Object_Type "";
BA_ "EventCommandSignal" SG_ 786 SGU17_Object_ax 0;
BA_ "GatewayedSignals" SG_ 786 SGU17_Object_ax 0;
BA_ "GenSigInactiveValue" SG_ 786 SGU17_Object_ax 0;
BA_ "GenSigInvalidValue" SG_ 786 SGU17_Object_ax 0;
BA_ "GenSigSendType" SG_ 786 SGU17_Object_ax 1;
BA_ "GenSigStartValue" SG_ 786 SGU17_Object_ax 0;
BA_ "GenSigTimeoutValue" SG_ 786 SGU17_Object_ax 0;
BA_ "Remark" SG_ 786 SGU17_Object_ax "";
BA_ "EventCommandSignal" SG_ 786 SGU17_Object_ay 0;
BA_ "GatewayedSignals" SG_ 786 SGU17_Object_ay 0;
BA_ "GenSigInactiveValue" SG_ 786 SGU17_Object_ay 0;
BA_ "GenSigInvalidValue" SG_ 786 SGU17_Object_ay 0;
BA_ "GenSigSendType" SG_ 786 SGU17_Object_ay 1;
BA_ "GenSigStartValue" SG_ 786 SGU17_Object_ay 0;
BA_ "GenSigTimeoutValue" SG_ 786 SGU17_Object_ay 0;
BA_ "Remark" SG_ 786 SGU17_Object_ay "";
BA_ "EventCommandSignal" SG_ 786 SGU17_Object_dx 0;
BA_ "GatewayedSignals" SG_ 786 SGU17_Object_dx 0;
BA_ "GenSigInactiveValue" SG_ 786 SGU17_Object_dx 0;
BA_ "GenSigInvalidValue" SG_ 786 SGU17_Object_dx 0;
BA_ "GenSigSendType" SG_ 786 SGU17_Object_dx 1;
BA_ "GenSigStartValue" SG_ 786 SGU17_Object_dx 0;
BA_ "GenSigTimeoutValue" SG_ 786 SGU17_Object_dx 0;
BA_ "Remark" SG_ 786 SGU17_Object_dx "";
BA_ "EventCommandSignal" SG_ 786 SGU17_Object_dx_Rear 0;
BA_ "GatewayedSignals" SG_ 786 SGU17_Object_dx_Rear 0;
BA_ "GenSigInactiveValue" SG_ 786 SGU17_Object_dx_Rear 0;
BA_ "GenSigInvalidValue" SG_ 786 SGU17_Object_dx_Rear 0;
BA_ "GenSigSendType" SG_ 786 SGU17_Object_dx_Rear 1;
BA_ "GenSigStartValue" SG_ 786 SGU17_Object_dx_Rear 0;
BA_ "GenSigTimeoutValue" SG_ 786 SGU17_Object_dx_Rear 0;
BA_ "Remark" SG_ 786 SGU17_Object_dx_Rear "";
BA_ "EventCommandSignal" SG_ 786 SGU17_Object_dy 0;
BA_ "GatewayedSignals" SG_ 786 SGU17_Object_dy 0;
BA_ "GenSigInactiveValue" SG_ 786 SGU17_Object_dy 0;
BA_ "GenSigInvalidValue" SG_ 786 SGU17_Object_dy 0;
BA_ "GenSigSendType" SG_ 786 SGU17_Object_dy 1;
BA_ "GenSigStartValue" SG_ 786 SGU17_Object_dy 0;
BA_ "GenSigTimeoutValue" SG_ 786 SGU17_Object_dy 0;
BA_ "Remark" SG_ 786 SGU17_Object_dy "";
BA_ "EventCommandSignal" SG_ 786 SGU17_Object_dy_Rear 0;
BA_ "GatewayedSignals" SG_ 786 SGU17_Object_dy_Rear 0;
BA_ "GenSigInactiveValue" SG_ 786 SGU17_Object_dy_Rear 0;
BA_ "GenSigInvalidValue" SG_ 786 SGU17_Object_dy_Rear 0;
BA_ "GenSigSendType" SG_ 786 SGU17_Object_dy_Rear 1;
BA_ "GenSigStartValue" SG_ 786 SGU17_Object_dy_Rear 0;
BA_ "GenSigTimeoutValue" SG_ 786 SGU17_Object_dy_Rear 0;
BA_ "Remark" SG_ 786 SGU17_Object_dy_Rear "";
BA_ "EventCommandSignal" SG_ 786 SGU17_Object_vx 0;
BA_ "GatewayedSignals" SG_ 786 SGU17_Object_vx 0;
BA_ "GenSigInactiveValue" SG_ 786 SGU17_Object_vx 0;
BA_ "GenSigInvalidValue" SG_ 786 SGU17_Object_vx 0;
BA_ "GenSigSendType" SG_ 786 SGU17_Object_vx 1;
BA_ "GenSigStartValue" SG_ 786 SGU17_Object_vx 0;
BA_ "GenSigTimeoutValue" SG_ 786 SGU17_Object_vx 0;
BA_ "Remark" SG_ 786 SGU17_Object_vx "";
BA_ "EventCommandSignal" SG_ 786 SGU17_Object_vy 0;
BA_ "GatewayedSignals" SG_ 786 SGU17_Object_vy 0;
BA_ "GenSigInactiveValue" SG_ 786 SGU17_Object_vy 0;
BA_ "GenSigInvalidValue" SG_ 786 SGU17_Object_vy 0;
BA_ "GenSigSendType" SG_ 786 SGU17_Object_vy 1;
BA_ "GenSigStartValue" SG_ 786 SGU17_Object_vy 0;
BA_ "GenSigTimeoutValue" SG_ 786 SGU17_Object_vy 0;
BA_ "Remark" SG_ 786 SGU17_Object_vy "";
BA_ "EventCommandSignal" SG_ 786 SGU17_Object_wExist 0;
BA_ "GatewayedSignals" SG_ 786 SGU17_Object_wExist 0;
BA_ "GenSigInactiveValue" SG_ 786 SGU17_Object_wExist 0;
BA_ "GenSigInvalidValue" SG_ 786 SGU17_Object_wExist 0;
BA_ "GenSigSendType" SG_ 786 SGU17_Object_wExist 1;
BA_ "GenSigStartValue" SG_ 786 SGU17_Object_wExist 0;
BA_ "GenSigTimeoutValue" SG_ 786 SGU17_Object_wExist 0;
BA_ "Remark" SG_ 786 SGU17_Object_wExist "";
BA_ "EventCommandSignal" SG_ 786 SGU17_Object_wObstacle 0;
BA_ "GatewayedSignals" SG_ 786 SGU17_Object_wObstacle 0;
BA_ "GenSigInactiveValue" SG_ 786 SGU17_Object_wObstacle 0;
BA_ "GenSigInvalidValue" SG_ 786 SGU17_Object_wObstacle 0;
BA_ "GenSigSendType" SG_ 786 SGU17_Object_wObstacle 1;
BA_ "GenSigStartValue" SG_ 786 SGU17_Object_wObstacle 0;
BA_ "GenSigTimeoutValue" SG_ 786 SGU17_Object_wObstacle 0;
BA_ "Remark" SG_ 786 SGU17_Object_wObstacle "";
BA_ "EventCommandSignal" SG_ 787 SGU18_BlockCounter 0;
BA_ "GatewayedSignals" SG_ 787 SGU18_BlockCounter 0;
BA_ "GenSigInactiveValue" SG_ 787 SGU18_BlockCounter 0;
BA_ "GenSigInvalidValue" SG_ 787 SGU18_BlockCounter 0;
BA_ "GenSigSendType" SG_ 787 SGU18_BlockCounter 1;
BA_ "GenSigStartValue" SG_ 787 SGU18_BlockCounter 0;
BA_ "GenSigTimeoutValue" SG_ 787 SGU18_BlockCounter 0;
BA_ "Remark" SG_ 787 SGU18_BlockCounter "";
BA_ "EventCommandSignal" SG_ 787 SGU18_LifeCycles_OBJ 0;
BA_ "GatewayedSignals" SG_ 787 SGU18_LifeCycles_OBJ 0;
BA_ "GenSigInactiveValue" SG_ 787 SGU18_LifeCycles_OBJ 0;
BA_ "GenSigInvalidValue" SG_ 787 SGU18_LifeCycles_OBJ 0;
BA_ "GenSigSendType" SG_ 787 SGU18_LifeCycles_OBJ 1;
BA_ "GenSigStartValue" SG_ 787 SGU18_LifeCycles_OBJ 0;
BA_ "GenSigTimeoutValue" SG_ 787 SGU18_LifeCycles_OBJ 0;
BA_ "Remark" SG_ 787 SGU18_LifeCycles_OBJ "";
BA_ "EventCommandSignal" SG_ 787 SGU18_Msg_AliveCounter 0;
BA_ "GatewayedSignals" SG_ 787 SGU18_Msg_AliveCounter 0;
BA_ "GenSigInactiveValue" SG_ 787 SGU18_Msg_AliveCounter 0;
BA_ "GenSigInvalidValue" SG_ 787 SGU18_Msg_AliveCounter 0;
BA_ "GenSigSendType" SG_ 787 SGU18_Msg_AliveCounter 1;
BA_ "GenSigStartValue" SG_ 787 SGU18_Msg_AliveCounter 0;
BA_ "GenSigTimeoutValue" SG_ 787 SGU18_Msg_AliveCounter 0;
BA_ "Remark" SG_ 787 SGU18_Msg_AliveCounter "";
BA_ "EventCommandSignal" SG_ 787 SGU18_Msg_CheckSum 0;
BA_ "GatewayedSignals" SG_ 787 SGU18_Msg_CheckSum 0;
BA_ "GenSigInactiveValue" SG_ 787 SGU18_Msg_CheckSum 0;
BA_ "GenSigInvalidValue" SG_ 787 SGU18_Msg_CheckSum 0;
BA_ "GenSigSendType" SG_ 787 SGU18_Msg_CheckSum 1;
BA_ "GenSigStartValue" SG_ 787 SGU18_Msg_CheckSum 0;
BA_ "GenSigTimeoutValue" SG_ 787 SGU18_Msg_CheckSum 0;
BA_ "Remark" SG_ 787 SGU18_Msg_CheckSum "";
BA_ "EventCommandSignal" SG_ 787 SGU18_ObjRCS_18 0;
BA_ "GatewayedSignals" SG_ 787 SGU18_ObjRCS_18 0;
BA_ "GenSigInactiveValue" SG_ 787 SGU18_ObjRCS_18 0;
BA_ "GenSigInvalidValue" SG_ 787 SGU18_ObjRCS_18 0;
BA_ "GenSigSendType" SG_ 787 SGU18_ObjRCS_18 1;
BA_ "GenSigStartValue" SG_ 787 SGU18_ObjRCS_18 0;
BA_ "GenSigTimeoutValue" SG_ 787 SGU18_ObjRCS_18 0;
BA_ "Remark" SG_ 787 SGU18_ObjRCS_18 "";
BA_ "EventCommandSignal" SG_ 787 SGU18_Obj_DistLat_rms 0;
BA_ "GatewayedSignals" SG_ 787 SGU18_Obj_DistLat_rms 0;
BA_ "GenSigInactiveValue" SG_ 787 SGU18_Obj_DistLat_rms 0;
BA_ "GenSigInvalidValue" SG_ 787 SGU18_Obj_DistLat_rms 0;
BA_ "GenSigSendType" SG_ 787 SGU18_Obj_DistLat_rms 1;
BA_ "GenSigStartValue" SG_ 787 SGU18_Obj_DistLat_rms 0;
BA_ "GenSigTimeoutValue" SG_ 787 SGU18_Obj_DistLat_rms 0;
BA_ "Remark" SG_ 787 SGU18_Obj_DistLat_rms "";
BA_ "EventCommandSignal" SG_ 787 SGU18_Obj_VrelLong_rms 0;
BA_ "GatewayedSignals" SG_ 787 SGU18_Obj_VrelLong_rms 0;
BA_ "GenSigInactiveValue" SG_ 787 SGU18_Obj_VrelLong_rms 0;
BA_ "GenSigInvalidValue" SG_ 787 SGU18_Obj_VrelLong_rms 0;
BA_ "GenSigSendType" SG_ 787 SGU18_Obj_VrelLong_rms 1;
BA_ "GenSigStartValue" SG_ 787 SGU18_Obj_VrelLong_rms 0;
BA_ "GenSigTimeoutValue" SG_ 787 SGU18_Obj_VrelLong_rms 0;
BA_ "Remark" SG_ 787 SGU18_Obj_VrelLong_rms "";
BA_ "EventCommandSignal" SG_ 787 SGU18_Obj_Vrelat_rms 0;
BA_ "GatewayedSignals" SG_ 787 SGU18_Obj_Vrelat_rms 0;
BA_ "GenSigInactiveValue" SG_ 787 SGU18_Obj_Vrelat_rms 0;
BA_ "GenSigInvalidValue" SG_ 787 SGU18_Obj_Vrelat_rms 0;
BA_ "GenSigSendType" SG_ 787 SGU18_Obj_Vrelat_rms 1;
BA_ "GenSigStartValue" SG_ 787 SGU18_Obj_Vrelat_rms 0;
BA_ "GenSigTimeoutValue" SG_ 787 SGU18_Obj_Vrelat_rms 0;
BA_ "Remark" SG_ 787 SGU18_Obj_Vrelat_rms "";
BA_ "EventCommandSignal" SG_ 787 SGU18_Object_DetStatus 0;
BA_ "GatewayedSignals" SG_ 787 SGU18_Object_DetStatus 0;
BA_ "GenSigInactiveValue" SG_ 787 SGU18_Object_DetStatus 0;
BA_ "GenSigInvalidValue" SG_ 787 SGU18_Object_DetStatus 0;
BA_ "GenSigSendType" SG_ 787 SGU18_Object_DetStatus 1;
BA_ "GenSigStartValue" SG_ 787 SGU18_Object_DetStatus 0;
BA_ "GenSigTimeoutValue" SG_ 787 SGU18_Object_DetStatus 0;
BA_ "Remark" SG_ 787 SGU18_Object_DetStatus "";
BA_ "EventCommandSignal" SG_ 787 SGU18_Object_DistLong_rms 0;
BA_ "GatewayedSignals" SG_ 787 SGU18_Object_DistLong_rms 0;
BA_ "GenSigInactiveValue" SG_ 787 SGU18_Object_DistLong_rms 0;
BA_ "GenSigInvalidValue" SG_ 787 SGU18_Object_DistLong_rms 0;
BA_ "GenSigSendType" SG_ 787 SGU18_Object_DistLong_rms 1;
BA_ "GenSigStartValue" SG_ 787 SGU18_Object_DistLong_rms 0;
BA_ "GenSigTimeoutValue" SG_ 787 SGU18_Object_DistLong_rms 0;
BA_ "Remark" SG_ 787 SGU18_Object_DistLong_rms "";
BA_ "EventCommandSignal" SG_ 787 SGU18_Object_ID 0;
BA_ "GatewayedSignals" SG_ 787 SGU18_Object_ID 0;
BA_ "GenSigInactiveValue" SG_ 787 SGU18_Object_ID 0;
BA_ "GenSigInvalidValue" SG_ 787 SGU18_Object_ID 0;
BA_ "GenSigSendType" SG_ 787 SGU18_Object_ID 1;
BA_ "GenSigStartValue" SG_ 787 SGU18_Object_ID 0;
BA_ "GenSigTimeoutValue" SG_ 787 SGU18_Object_ID 0;
BA_ "Remark" SG_ 787 SGU18_Object_ID "";
BA_ "EventCommandSignal" SG_ 787 SGU18_Object_Motion_Pattern 0;
BA_ "GatewayedSignals" SG_ 787 SGU18_Object_Motion_Pattern 0;
BA_ "GenSigInactiveValue" SG_ 787 SGU18_Object_Motion_Pattern 0;
BA_ "GenSigInvalidValue" SG_ 787 SGU18_Object_Motion_Pattern 0;
BA_ "GenSigSendType" SG_ 787 SGU18_Object_Motion_Pattern 1;
BA_ "GenSigStartValue" SG_ 787 SGU18_Object_Motion_Pattern 0;
BA_ "GenSigTimeoutValue" SG_ 787 SGU18_Object_Motion_Pattern 0;
BA_ "Remark" SG_ 787 SGU18_Object_Motion_Pattern "";
BA_ "EventCommandSignal" SG_ 787 SGU18_Object_Type 0;
BA_ "GatewayedSignals" SG_ 787 SGU18_Object_Type 0;
BA_ "GenSigInactiveValue" SG_ 787 SGU18_Object_Type 0;
BA_ "GenSigInvalidValue" SG_ 787 SGU18_Object_Type 0;
BA_ "GenSigSendType" SG_ 787 SGU18_Object_Type 1;
BA_ "GenSigStartValue" SG_ 787 SGU18_Object_Type 0;
BA_ "GenSigTimeoutValue" SG_ 787 SGU18_Object_Type 0;
BA_ "Remark" SG_ 787 SGU18_Object_Type "";
BA_ "EventCommandSignal" SG_ 787 SGU18_Object_ax 0;
BA_ "GatewayedSignals" SG_ 787 SGU18_Object_ax 0;
BA_ "GenSigInactiveValue" SG_ 787 SGU18_Object_ax 0;
BA_ "GenSigInvalidValue" SG_ 787 SGU18_Object_ax 0;
BA_ "GenSigSendType" SG_ 787 SGU18_Object_ax 1;
BA_ "GenSigStartValue" SG_ 787 SGU18_Object_ax 0;
BA_ "GenSigTimeoutValue" SG_ 787 SGU18_Object_ax 0;
BA_ "Remark" SG_ 787 SGU18_Object_ax "";
BA_ "EventCommandSignal" SG_ 787 SGU18_Object_ay 0;
BA_ "GatewayedSignals" SG_ 787 SGU18_Object_ay 0;
BA_ "GenSigInactiveValue" SG_ 787 SGU18_Object_ay 0;
BA_ "GenSigInvalidValue" SG_ 787 SGU18_Object_ay 0;
BA_ "GenSigSendType" SG_ 787 SGU18_Object_ay 1;
BA_ "GenSigStartValue" SG_ 787 SGU18_Object_ay 0;
BA_ "GenSigTimeoutValue" SG_ 787 SGU18_Object_ay 0;
BA_ "Remark" SG_ 787 SGU18_Object_ay "";
BA_ "EventCommandSignal" SG_ 787 SGU18_Object_dx 0;
BA_ "GatewayedSignals" SG_ 787 SGU18_Object_dx 0;
BA_ "GenSigInactiveValue" SG_ 787 SGU18_Object_dx 0;
BA_ "GenSigInvalidValue" SG_ 787 SGU18_Object_dx 0;
BA_ "GenSigSendType" SG_ 787 SGU18_Object_dx 1;
BA_ "GenSigStartValue" SG_ 787 SGU18_Object_dx 0;
BA_ "GenSigTimeoutValue" SG_ 787 SGU18_Object_dx 0;
BA_ "Remark" SG_ 787 SGU18_Object_dx "";
BA_ "EventCommandSignal" SG_ 787 SGU18_Object_dx_Rear 0;
BA_ "GatewayedSignals" SG_ 787 SGU18_Object_dx_Rear 0;
BA_ "GenSigInactiveValue" SG_ 787 SGU18_Object_dx_Rear 0;
BA_ "GenSigInvalidValue" SG_ 787 SGU18_Object_dx_Rear 0;
BA_ "GenSigSendType" SG_ 787 SGU18_Object_dx_Rear 1;
BA_ "GenSigStartValue" SG_ 787 SGU18_Object_dx_Rear 0;
BA_ "GenSigTimeoutValue" SG_ 787 SGU18_Object_dx_Rear 0;
BA_ "Remark" SG_ 787 SGU18_Object_dx_Rear "";
BA_ "EventCommandSignal" SG_ 787 SGU18_Object_dy 0;
BA_ "GatewayedSignals" SG_ 787 SGU18_Object_dy 0;
BA_ "GenSigInactiveValue" SG_ 787 SGU18_Object_dy 0;
BA_ "GenSigInvalidValue" SG_ 787 SGU18_Object_dy 0;
BA_ "GenSigSendType" SG_ 787 SGU18_Object_dy 1;
BA_ "GenSigStartValue" SG_ 787 SGU18_Object_dy 0;
BA_ "GenSigTimeoutValue" SG_ 787 SGU18_Object_dy 0;
BA_ "Remark" SG_ 787 SGU18_Object_dy "";
BA_ "EventCommandSignal" SG_ 787 SGU18_Object_dy_Rear 0;
BA_ "GatewayedSignals" SG_ 787 SGU18_Object_dy_Rear 0;
BA_ "GenSigInactiveValue" SG_ 787 SGU18_Object_dy_Rear 0;
BA_ "GenSigInvalidValue" SG_ 787 SGU18_Object_dy_Rear 0;
BA_ "GenSigSendType" SG_ 787 SGU18_Object_dy_Rear 1;
BA_ "GenSigStartValue" SG_ 787 SGU18_Object_dy_Rear 0;
BA_ "GenSigTimeoutValue" SG_ 787 SGU18_Object_dy_Rear 0;
BA_ "Remark" SG_ 787 SGU18_Object_dy_Rear "";
BA_ "EventCommandSignal" SG_ 787 SGU18_Object_vx 0;
BA_ "GatewayedSignals" SG_ 787 SGU18_Object_vx 0;
BA_ "GenSigInactiveValue" SG_ 787 SGU18_Object_vx 0;
BA_ "GenSigInvalidValue" SG_ 787 SGU18_Object_vx 0;
BA_ "GenSigSendType" SG_ 787 SGU18_Object_vx 1;
BA_ "GenSigStartValue" SG_ 787 SGU18_Object_vx 0;
BA_ "GenSigTimeoutValue" SG_ 787 SGU18_Object_vx 0;
BA_ "Remark" SG_ 787 SGU18_Object_vx "";
BA_ "EventCommandSignal" SG_ 787 SGU18_Object_vy 0;
BA_ "GatewayedSignals" SG_ 787 SGU18_Object_vy 0;
BA_ "GenSigInactiveValue" SG_ 787 SGU18_Object_vy 0;
BA_ "GenSigInvalidValue" SG_ 787 SGU18_Object_vy 0;
BA_ "GenSigSendType" SG_ 787 SGU18_Object_vy 1;
BA_ "GenSigStartValue" SG_ 787 SGU18_Object_vy 0;
BA_ "GenSigTimeoutValue" SG_ 787 SGU18_Object_vy 0;
BA_ "Remark" SG_ 787 SGU18_Object_vy "";
BA_ "EventCommandSignal" SG_ 787 SGU18_Object_wExist 0;
BA_ "GatewayedSignals" SG_ 787 SGU18_Object_wExist 0;
BA_ "GenSigInactiveValue" SG_ 787 SGU18_Object_wExist 0;
BA_ "GenSigInvalidValue" SG_ 787 SGU18_Object_wExist 0;
BA_ "GenSigSendType" SG_ 787 SGU18_Object_wExist 1;
BA_ "GenSigStartValue" SG_ 787 SGU18_Object_wExist 0;
BA_ "GenSigTimeoutValue" SG_ 787 SGU18_Object_wExist 0;
BA_ "Remark" SG_ 787 SGU18_Object_wExist "";
BA_ "EventCommandSignal" SG_ 787 SGU18_Object_wObstacle 0;
BA_ "GatewayedSignals" SG_ 787 SGU18_Object_wObstacle 0;
BA_ "GenSigInactiveValue" SG_ 787 SGU18_Object_wObstacle 0;
BA_ "GenSigInvalidValue" SG_ 787 SGU18_Object_wObstacle 0;
BA_ "GenSigSendType" SG_ 787 SGU18_Object_wObstacle 1;
BA_ "GenSigStartValue" SG_ 787 SGU18_Object_wObstacle 0;
BA_ "GenSigTimeoutValue" SG_ 787 SGU18_Object_wObstacle 0;
BA_ "Remark" SG_ 787 SGU18_Object_wObstacle "";
BA_ "EventCommandSignal" SG_ 788 SGU19_BlockCounter 0;
BA_ "GatewayedSignals" SG_ 788 SGU19_BlockCounter 0;
BA_ "GenSigInactiveValue" SG_ 788 SGU19_BlockCounter 0;
BA_ "GenSigInvalidValue" SG_ 788 SGU19_BlockCounter 0;
BA_ "GenSigSendType" SG_ 788 SGU19_BlockCounter 1;
BA_ "GenSigStartValue" SG_ 788 SGU19_BlockCounter 0;
BA_ "GenSigTimeoutValue" SG_ 788 SGU19_BlockCounter 0;
BA_ "Remark" SG_ 788 SGU19_BlockCounter "";
BA_ "EventCommandSignal" SG_ 788 SGU19_LifeCycles_OBJ 0;
BA_ "GatewayedSignals" SG_ 788 SGU19_LifeCycles_OBJ 0;
BA_ "GenSigInactiveValue" SG_ 788 SGU19_LifeCycles_OBJ 0;
BA_ "GenSigInvalidValue" SG_ 788 SGU19_LifeCycles_OBJ 0;
BA_ "GenSigSendType" SG_ 788 SGU19_LifeCycles_OBJ 1;
BA_ "GenSigStartValue" SG_ 788 SGU19_LifeCycles_OBJ 0;
BA_ "GenSigTimeoutValue" SG_ 788 SGU19_LifeCycles_OBJ 0;
BA_ "Remark" SG_ 788 SGU19_LifeCycles_OBJ "";
BA_ "EventCommandSignal" SG_ 788 SGU19_Msg_AliveCounter 0;
BA_ "GatewayedSignals" SG_ 788 SGU19_Msg_AliveCounter 0;
BA_ "GenSigInactiveValue" SG_ 788 SGU19_Msg_AliveCounter 0;
BA_ "GenSigInvalidValue" SG_ 788 SGU19_Msg_AliveCounter 0;
BA_ "GenSigSendType" SG_ 788 SGU19_Msg_AliveCounter 1;
BA_ "GenSigStartValue" SG_ 788 SGU19_Msg_AliveCounter 0;
BA_ "GenSigTimeoutValue" SG_ 788 SGU19_Msg_AliveCounter 0;
BA_ "Remark" SG_ 788 SGU19_Msg_AliveCounter "";
BA_ "EventCommandSignal" SG_ 788 SGU19_Msg_CheckSum 0;
BA_ "GatewayedSignals" SG_ 788 SGU19_Msg_CheckSum 0;
BA_ "GenSigInactiveValue" SG_ 788 SGU19_Msg_CheckSum 0;
BA_ "GenSigInvalidValue" SG_ 788 SGU19_Msg_CheckSum 0;
BA_ "GenSigSendType" SG_ 788 SGU19_Msg_CheckSum 1;
BA_ "GenSigStartValue" SG_ 788 SGU19_Msg_CheckSum 0;
BA_ "GenSigTimeoutValue" SG_ 788 SGU19_Msg_CheckSum 0;
BA_ "Remark" SG_ 788 SGU19_Msg_CheckSum "";
BA_ "EventCommandSignal" SG_ 788 SGU19_ObjRCS_19 0;
BA_ "GatewayedSignals" SG_ 788 SGU19_ObjRCS_19 0;
BA_ "GenSigInactiveValue" SG_ 788 SGU19_ObjRCS_19 0;
BA_ "GenSigInvalidValue" SG_ 788 SGU19_ObjRCS_19 0;
BA_ "GenSigSendType" SG_ 788 SGU19_ObjRCS_19 1;
BA_ "GenSigStartValue" SG_ 788 SGU19_ObjRCS_19 0;
BA_ "GenSigTimeoutValue" SG_ 788 SGU19_ObjRCS_19 0;
BA_ "Remark" SG_ 788 SGU19_ObjRCS_19 "";
BA_ "EventCommandSignal" SG_ 788 SGU19_Obj_DistLat_rms 0;
BA_ "GatewayedSignals" SG_ 788 SGU19_Obj_DistLat_rms 0;
BA_ "GenSigInactiveValue" SG_ 788 SGU19_Obj_DistLat_rms 0;
BA_ "GenSigInvalidValue" SG_ 788 SGU19_Obj_DistLat_rms 0;
BA_ "GenSigSendType" SG_ 788 SGU19_Obj_DistLat_rms 1;
BA_ "GenSigStartValue" SG_ 788 SGU19_Obj_DistLat_rms 0;
BA_ "GenSigTimeoutValue" SG_ 788 SGU19_Obj_DistLat_rms 0;
BA_ "Remark" SG_ 788 SGU19_Obj_DistLat_rms "";
BA_ "EventCommandSignal" SG_ 788 SGU19_Obj_VrelLong_rms 0;
BA_ "GatewayedSignals" SG_ 788 SGU19_Obj_VrelLong_rms 0;
BA_ "GenSigInactiveValue" SG_ 788 SGU19_Obj_VrelLong_rms 0;
BA_ "GenSigInvalidValue" SG_ 788 SGU19_Obj_VrelLong_rms 0;
BA_ "GenSigSendType" SG_ 788 SGU19_Obj_VrelLong_rms 1;
BA_ "GenSigStartValue" SG_ 788 SGU19_Obj_VrelLong_rms 0;
BA_ "GenSigTimeoutValue" SG_ 788 SGU19_Obj_VrelLong_rms 0;
BA_ "Remark" SG_ 788 SGU19_Obj_VrelLong_rms "";
BA_ "EventCommandSignal" SG_ 788 SGU19_Obj_Vrelat_rms 0;
BA_ "GatewayedSignals" SG_ 788 SGU19_Obj_Vrelat_rms 0;
BA_ "GenSigInactiveValue" SG_ 788 SGU19_Obj_Vrelat_rms 0;
BA_ "GenSigInvalidValue" SG_ 788 SGU19_Obj_Vrelat_rms 0;
BA_ "GenSigSendType" SG_ 788 SGU19_Obj_Vrelat_rms 1;
BA_ "GenSigStartValue" SG_ 788 SGU19_Obj_Vrelat_rms 0;
BA_ "GenSigTimeoutValue" SG_ 788 SGU19_Obj_Vrelat_rms 0;
BA_ "Remark" SG_ 788 SGU19_Obj_Vrelat_rms "";
BA_ "EventCommandSignal" SG_ 788 SGU19_Object_DetStatus 0;
BA_ "GatewayedSignals" SG_ 788 SGU19_Object_DetStatus 0;
BA_ "GenSigInactiveValue" SG_ 788 SGU19_Object_DetStatus 0;
BA_ "GenSigInvalidValue" SG_ 788 SGU19_Object_DetStatus 0;
BA_ "GenSigSendType" SG_ 788 SGU19_Object_DetStatus 1;
BA_ "GenSigStartValue" SG_ 788 SGU19_Object_DetStatus 0;
BA_ "GenSigTimeoutValue" SG_ 788 SGU19_Object_DetStatus 0;
BA_ "Remark" SG_ 788 SGU19_Object_DetStatus "";
BA_ "EventCommandSignal" SG_ 788 SGU19_Object_DistLong_rms 0;
BA_ "GatewayedSignals" SG_ 788 SGU19_Object_DistLong_rms 0;
BA_ "GenSigInactiveValue" SG_ 788 SGU19_Object_DistLong_rms 0;
BA_ "GenSigInvalidValue" SG_ 788 SGU19_Object_DistLong_rms 0;
BA_ "GenSigSendType" SG_ 788 SGU19_Object_DistLong_rms 1;
BA_ "GenSigStartValue" SG_ 788 SGU19_Object_DistLong_rms 0;
BA_ "GenSigTimeoutValue" SG_ 788 SGU19_Object_DistLong_rms 0;
BA_ "Remark" SG_ 788 SGU19_Object_DistLong_rms "";
BA_ "EventCommandSignal" SG_ 788 SGU19_Object_ID 0;
BA_ "GatewayedSignals" SG_ 788 SGU19_Object_ID 0;
BA_ "GenSigInactiveValue" SG_ 788 SGU19_Object_ID 0;
BA_ "GenSigInvalidValue" SG_ 788 SGU19_Object_ID 0;
BA_ "GenSigSendType" SG_ 788 SGU19_Object_ID 1;
BA_ "GenSigStartValue" SG_ 788 SGU19_Object_ID 0;
BA_ "GenSigTimeoutValue" SG_ 788 SGU19_Object_ID 0;
BA_ "Remark" SG_ 788 SGU19_Object_ID "";
BA_ "EventCommandSignal" SG_ 788 SGU19_Object_Motion_Pattern 0;
BA_ "GatewayedSignals" SG_ 788 SGU19_Object_Motion_Pattern 0;
BA_ "GenSigInactiveValue" SG_ 788 SGU19_Object_Motion_Pattern 0;
BA_ "GenSigInvalidValue" SG_ 788 SGU19_Object_Motion_Pattern 0;
BA_ "GenSigSendType" SG_ 788 SGU19_Object_Motion_Pattern 1;
BA_ "GenSigStartValue" SG_ 788 SGU19_Object_Motion_Pattern 0;
BA_ "GenSigTimeoutValue" SG_ 788 SGU19_Object_Motion_Pattern 0;
BA_ "Remark" SG_ 788 SGU19_Object_Motion_Pattern "";
BA_ "EventCommandSignal" SG_ 788 SGU19_Object_Type 0;
BA_ "GatewayedSignals" SG_ 788 SGU19_Object_Type 0;
BA_ "GenSigInactiveValue" SG_ 788 SGU19_Object_Type 0;
BA_ "GenSigInvalidValue" SG_ 788 SGU19_Object_Type 0;
BA_ "GenSigSendType" SG_ 788 SGU19_Object_Type 1;
BA_ "GenSigStartValue" SG_ 788 SGU19_Object_Type 0;
BA_ "GenSigTimeoutValue" SG_ 788 SGU19_Object_Type 0;
BA_ "Remark" SG_ 788 SGU19_Object_Type "";
BA_ "EventCommandSignal" SG_ 788 SGU19_Object_ax 0;
BA_ "GatewayedSignals" SG_ 788 SGU19_Object_ax 0;
BA_ "GenSigInactiveValue" SG_ 788 SGU19_Object_ax 0;
BA_ "GenSigInvalidValue" SG_ 788 SGU19_Object_ax 0;
BA_ "GenSigSendType" SG_ 788 SGU19_Object_ax 1;
BA_ "GenSigStartValue" SG_ 788 SGU19_Object_ax 0;
BA_ "GenSigTimeoutValue" SG_ 788 SGU19_Object_ax 0;
BA_ "Remark" SG_ 788 SGU19_Object_ax "";
BA_ "EventCommandSignal" SG_ 788 SGU19_Object_ay 0;
BA_ "GatewayedSignals" SG_ 788 SGU19_Object_ay 0;
BA_ "GenSigInactiveValue" SG_ 788 SGU19_Object_ay 0;
BA_ "GenSigInvalidValue" SG_ 788 SGU19_Object_ay 0;
BA_ "GenSigSendType" SG_ 788 SGU19_Object_ay 1;
BA_ "GenSigStartValue" SG_ 788 SGU19_Object_ay 0;
BA_ "GenSigTimeoutValue" SG_ 788 SGU19_Object_ay 0;
BA_ "Remark" SG_ 788 SGU19_Object_ay "";
BA_ "EventCommandSignal" SG_ 788 SGU19_Object_dx 0;
BA_ "GatewayedSignals" SG_ 788 SGU19_Object_dx 0;
BA_ "GenSigInactiveValue" SG_ 788 SGU19_Object_dx 0;
BA_ "GenSigInvalidValue" SG_ 788 SGU19_Object_dx 0;
BA_ "GenSigSendType" SG_ 788 SGU19_Object_dx 1;
BA_ "GenSigStartValue" SG_ 788 SGU19_Object_dx 0;
BA_ "GenSigTimeoutValue" SG_ 788 SGU19_Object_dx 0;
BA_ "Remark" SG_ 788 SGU19_Object_dx "";
BA_ "EventCommandSignal" SG_ 788 SGU19_Object_dx_Rear 0;
BA_ "GatewayedSignals" SG_ 788 SGU19_Object_dx_Rear 0;
BA_ "GenSigInactiveValue" SG_ 788 SGU19_Object_dx_Rear 0;
BA_ "GenSigInvalidValue" SG_ 788 SGU19_Object_dx_Rear 0;
BA_ "GenSigSendType" SG_ 788 SGU19_Object_dx_Rear 1;
BA_ "GenSigStartValue" SG_ 788 SGU19_Object_dx_Rear 0;
BA_ "GenSigTimeoutValue" SG_ 788 SGU19_Object_dx_Rear 0;
BA_ "Remark" SG_ 788 SGU19_Object_dx_Rear "";
BA_ "EventCommandSignal" SG_ 788 SGU19_Object_dy 0;
BA_ "GatewayedSignals" SG_ 788 SGU19_Object_dy 0;
BA_ "GenSigInactiveValue" SG_ 788 SGU19_Object_dy 0;
BA_ "GenSigInvalidValue" SG_ 788 SGU19_Object_dy 0;
BA_ "GenSigSendType" SG_ 788 SGU19_Object_dy 1;
BA_ "GenSigStartValue" SG_ 788 SGU19_Object_dy 0;
BA_ "GenSigTimeoutValue" SG_ 788 SGU19_Object_dy 0;
BA_ "Remark" SG_ 788 SGU19_Object_dy "";
BA_ "EventCommandSignal" SG_ 788 SGU19_Object_dy_Rear 0;
BA_ "GatewayedSignals" SG_ 788 SGU19_Object_dy_Rear 0;
BA_ "GenSigInactiveValue" SG_ 788 SGU19_Object_dy_Rear 0;
BA_ "GenSigInvalidValue" SG_ 788 SGU19_Object_dy_Rear 0;
BA_ "GenSigSendType" SG_ 788 SGU19_Object_dy_Rear 1;
BA_ "GenSigStartValue" SG_ 788 SGU19_Object_dy_Rear 0;
BA_ "GenSigTimeoutValue" SG_ 788 SGU19_Object_dy_Rear 0;
BA_ "Remark" SG_ 788 SGU19_Object_dy_Rear "";
BA_ "EventCommandSignal" SG_ 788 SGU19_Object_vx 0;
BA_ "GatewayedSignals" SG_ 788 SGU19_Object_vx 0;
BA_ "GenSigInactiveValue" SG_ 788 SGU19_Object_vx 0;
BA_ "GenSigInvalidValue" SG_ 788 SGU19_Object_vx 0;
BA_ "GenSigSendType" SG_ 788 SGU19_Object_vx 1;
BA_ "GenSigStartValue" SG_ 788 SGU19_Object_vx 0;
BA_ "GenSigTimeoutValue" SG_ 788 SGU19_Object_vx 0;
BA_ "Remark" SG_ 788 SGU19_Object_vx "";
BA_ "EventCommandSignal" SG_ 788 SGU19_Object_vy 0;
BA_ "GatewayedSignals" SG_ 788 SGU19_Object_vy 0;
BA_ "GenSigInactiveValue" SG_ 788 SGU19_Object_vy 0;
BA_ "GenSigInvalidValue" SG_ 788 SGU19_Object_vy 0;
BA_ "GenSigSendType" SG_ 788 SGU19_Object_vy 1;
BA_ "GenSigStartValue" SG_ 788 SGU19_Object_vy 0;
BA_ "GenSigTimeoutValue" SG_ 788 SGU19_Object_vy 0;
BA_ "Remark" SG_ 788 SGU19_Object_vy "";
BA_ "EventCommandSignal" SG_ 788 SGU19_Object_wExist 0;
BA_ "GatewayedSignals" SG_ 788 SGU19_Object_wExist 0;
BA_ "GenSigInactiveValue" SG_ 788 SGU19_Object_wExist 0;
BA_ "GenSigInvalidValue" SG_ 788 SGU19_Object_wExist 0;
BA_ "GenSigSendType" SG_ 788 SGU19_Object_wExist 1;
BA_ "GenSigStartValue" SG_ 788 SGU19_Object_wExist 0;
BA_ "GenSigTimeoutValue" SG_ 788 SGU19_Object_wExist 0;
BA_ "Remark" SG_ 788 SGU19_Object_wExist "";
BA_ "EventCommandSignal" SG_ 788 SGU19_Object_wObstacle 0;
BA_ "GatewayedSignals" SG_ 788 SGU19_Object_wObstacle 0;
BA_ "GenSigInactiveValue" SG_ 788 SGU19_Object_wObstacle 0;
BA_ "GenSigInvalidValue" SG_ 788 SGU19_Object_wObstacle 0;
BA_ "GenSigSendType" SG_ 788 SGU19_Object_wObstacle 1;
BA_ "GenSigStartValue" SG_ 788 SGU19_Object_wObstacle 0;
BA_ "GenSigTimeoutValue" SG_ 788 SGU19_Object_wObstacle 0;
BA_ "Remark" SG_ 788 SGU19_Object_wObstacle "";
BA_ "EventCommandSignal" SG_ 789 SGU20_BlockCounter 0;
BA_ "GatewayedSignals" SG_ 789 SGU20_BlockCounter 0;
BA_ "GenSigInactiveValue" SG_ 789 SGU20_BlockCounter 0;
BA_ "GenSigInvalidValue" SG_ 789 SGU20_BlockCounter 0;
BA_ "GenSigSendType" SG_ 789 SGU20_BlockCounter 1;
BA_ "GenSigStartValue" SG_ 789 SGU20_BlockCounter 0;
BA_ "GenSigTimeoutValue" SG_ 789 SGU20_BlockCounter 0;
BA_ "Remark" SG_ 789 SGU20_BlockCounter "";
BA_ "EventCommandSignal" SG_ 789 SGU20_LifeCycles_OBJ 0;
BA_ "GatewayedSignals" SG_ 789 SGU20_LifeCycles_OBJ 0;
BA_ "GenSigInactiveValue" SG_ 789 SGU20_LifeCycles_OBJ 0;
BA_ "GenSigInvalidValue" SG_ 789 SGU20_LifeCycles_OBJ 0;
BA_ "GenSigSendType" SG_ 789 SGU20_LifeCycles_OBJ 1;
BA_ "GenSigStartValue" SG_ 789 SGU20_LifeCycles_OBJ 0;
BA_ "GenSigTimeoutValue" SG_ 789 SGU20_LifeCycles_OBJ 0;
BA_ "Remark" SG_ 789 SGU20_LifeCycles_OBJ "";
BA_ "EventCommandSignal" SG_ 789 SGU20_Msg_AliveCounter 0;
BA_ "GatewayedSignals" SG_ 789 SGU20_Msg_AliveCounter 0;
BA_ "GenSigInactiveValue" SG_ 789 SGU20_Msg_AliveCounter 0;
BA_ "GenSigInvalidValue" SG_ 789 SGU20_Msg_AliveCounter 0;
BA_ "GenSigSendType" SG_ 789 SGU20_Msg_AliveCounter 1;
BA_ "GenSigStartValue" SG_ 789 SGU20_Msg_AliveCounter 0;
BA_ "GenSigTimeoutValue" SG_ 789 SGU20_Msg_AliveCounter 0;
BA_ "Remark" SG_ 789 SGU20_Msg_AliveCounter "";
BA_ "EventCommandSignal" SG_ 789 SGU20_Msg_CheckSum 0;
BA_ "GatewayedSignals" SG_ 789 SGU20_Msg_CheckSum 0;
BA_ "GenSigInactiveValue" SG_ 789 SGU20_Msg_CheckSum 0;
BA_ "GenSigInvalidValue" SG_ 789 SGU20_Msg_CheckSum 0;
BA_ "GenSigSendType" SG_ 789 SGU20_Msg_CheckSum 1;
BA_ "GenSigStartValue" SG_ 789 SGU20_Msg_CheckSum 0;
BA_ "GenSigTimeoutValue" SG_ 789 SGU20_Msg_CheckSum 0;
BA_ "Remark" SG_ 789 SGU20_Msg_CheckSum "";
BA_ "EventCommandSignal" SG_ 789 SGU20_ObjRCS_20 0;
BA_ "GatewayedSignals" SG_ 789 SGU20_ObjRCS_20 0;
BA_ "GenSigInactiveValue" SG_ 789 SGU20_ObjRCS_20 0;
BA_ "GenSigInvalidValue" SG_ 789 SGU20_ObjRCS_20 0;
BA_ "GenSigSendType" SG_ 789 SGU20_ObjRCS_20 1;
BA_ "GenSigStartValue" SG_ 789 SGU20_ObjRCS_20 0;
BA_ "GenSigTimeoutValue" SG_ 789 SGU20_ObjRCS_20 0;
BA_ "Remark" SG_ 789 SGU20_ObjRCS_20 "";
BA_ "EventCommandSignal" SG_ 789 SGU20_Obj_DistLat_rms 0;
BA_ "GatewayedSignals" SG_ 789 SGU20_Obj_DistLat_rms 0;
BA_ "GenSigInactiveValue" SG_ 789 SGU20_Obj_DistLat_rms 0;
BA_ "GenSigInvalidValue" SG_ 789 SGU20_Obj_DistLat_rms 0;
BA_ "GenSigSendType" SG_ 789 SGU20_Obj_DistLat_rms 1;
BA_ "GenSigStartValue" SG_ 789 SGU20_Obj_DistLat_rms 0;
BA_ "GenSigTimeoutValue" SG_ 789 SGU20_Obj_DistLat_rms 0;
BA_ "Remark" SG_ 789 SGU20_Obj_DistLat_rms "";
BA_ "EventCommandSignal" SG_ 789 SGU20_Obj_VrelLong_rms 0;
BA_ "GatewayedSignals" SG_ 789 SGU20_Obj_VrelLong_rms 0;
BA_ "GenSigInactiveValue" SG_ 789 SGU20_Obj_VrelLong_rms 0;
BA_ "GenSigInvalidValue" SG_ 789 SGU20_Obj_VrelLong_rms 0;
BA_ "GenSigSendType" SG_ 789 SGU20_Obj_VrelLong_rms 1;
BA_ "GenSigStartValue" SG_ 789 SGU20_Obj_VrelLong_rms 0;
BA_ "GenSigTimeoutValue" SG_ 789 SGU20_Obj_VrelLong_rms 0;
BA_ "Remark" SG_ 789 SGU20_Obj_VrelLong_rms "";
BA_ "EventCommandSignal" SG_ 789 SGU20_Obj_Vrelat_rms 0;
BA_ "GatewayedSignals" SG_ 789 SGU20_Obj_Vrelat_rms 0;
BA_ "GenSigInactiveValue" SG_ 789 SGU20_Obj_Vrelat_rms 0;
BA_ "GenSigInvalidValue" SG_ 789 SGU20_Obj_Vrelat_rms 0;
BA_ "GenSigSendType" SG_ 789 SGU20_Obj_Vrelat_rms 1;
BA_ "GenSigStartValue" SG_ 789 SGU20_Obj_Vrelat_rms 0;
BA_ "GenSigTimeoutValue" SG_ 789 SGU20_Obj_Vrelat_rms 0;
BA_ "Remark" SG_ 789 SGU20_Obj_Vrelat_rms "";
BA_ "EventCommandSignal" SG_ 789 SGU20_Object_DetStatus 0;
BA_ "GatewayedSignals" SG_ 789 SGU20_Object_DetStatus 0;
BA_ "GenSigInactiveValue" SG_ 789 SGU20_Object_DetStatus 0;
BA_ "GenSigInvalidValue" SG_ 789 SGU20_Object_DetStatus 0;
BA_ "GenSigSendType" SG_ 789 SGU20_Object_DetStatus 1;
BA_ "GenSigStartValue" SG_ 789 SGU20_Object_DetStatus 0;
BA_ "GenSigTimeoutValue" SG_ 789 SGU20_Object_DetStatus 0;
BA_ "Remark" SG_ 789 SGU20_Object_DetStatus "";
BA_ "EventCommandSignal" SG_ 789 SGU20_Object_DistLong_rms 0;
BA_ "GatewayedSignals" SG_ 789 SGU20_Object_DistLong_rms 0;
BA_ "GenSigInactiveValue" SG_ 789 SGU20_Object_DistLong_rms 0;
BA_ "GenSigInvalidValue" SG_ 789 SGU20_Object_DistLong_rms 0;
BA_ "GenSigSendType" SG_ 789 SGU20_Object_DistLong_rms 1;
BA_ "GenSigStartValue" SG_ 789 SGU20_Object_DistLong_rms 0;
BA_ "GenSigTimeoutValue" SG_ 789 SGU20_Object_DistLong_rms 0;
BA_ "Remark" SG_ 789 SGU20_Object_DistLong_rms "";
BA_ "EventCommandSignal" SG_ 789 SGU20_Object_ID 0;
BA_ "GatewayedSignals" SG_ 789 SGU20_Object_ID 0;
BA_ "GenSigInactiveValue" SG_ 789 SGU20_Object_ID 0;
BA_ "GenSigInvalidValue" SG_ 789 SGU20_Object_ID 0;
BA_ "GenSigSendType" SG_ 789 SGU20_Object_ID 1;
BA_ "GenSigStartValue" SG_ 789 SGU20_Object_ID 0;
BA_ "GenSigTimeoutValue" SG_ 789 SGU20_Object_ID 0;
BA_ "Remark" SG_ 789 SGU20_Object_ID "";
BA_ "EventCommandSignal" SG_ 789 SGU20_Object_Motion_Pattern 0;
BA_ "GatewayedSignals" SG_ 789 SGU20_Object_Motion_Pattern 0;
BA_ "GenSigInactiveValue" SG_ 789 SGU20_Object_Motion_Pattern 0;
BA_ "GenSigInvalidValue" SG_ 789 SGU20_Object_Motion_Pattern 0;
BA_ "GenSigSendType" SG_ 789 SGU20_Object_Motion_Pattern 1;
BA_ "GenSigStartValue" SG_ 789 SGU20_Object_Motion_Pattern 0;
BA_ "GenSigTimeoutValue" SG_ 789 SGU20_Object_Motion_Pattern 0;
BA_ "Remark" SG_ 789 SGU20_Object_Motion_Pattern "";
BA_ "EventCommandSignal" SG_ 789 SGU20_Object_Type 0;
BA_ "GatewayedSignals" SG_ 789 SGU20_Object_Type 0;
BA_ "GenSigInactiveValue" SG_ 789 SGU20_Object_Type 0;
BA_ "GenSigInvalidValue" SG_ 789 SGU20_Object_Type 0;
BA_ "GenSigSendType" SG_ 789 SGU20_Object_Type 1;
BA_ "GenSigStartValue" SG_ 789 SGU20_Object_Type 0;
BA_ "GenSigTimeoutValue" SG_ 789 SGU20_Object_Type 0;
BA_ "Remark" SG_ 789 SGU20_Object_Type "";
BA_ "EventCommandSignal" SG_ 789 SGU20_Object_ax 0;
BA_ "GatewayedSignals" SG_ 789 SGU20_Object_ax 0;
BA_ "GenSigInactiveValue" SG_ 789 SGU20_Object_ax 0;
BA_ "GenSigInvalidValue" SG_ 789 SGU20_Object_ax 0;
BA_ "GenSigSendType" SG_ 789 SGU20_Object_ax 1;
BA_ "GenSigStartValue" SG_ 789 SGU20_Object_ax 0;
BA_ "GenSigTimeoutValue" SG_ 789 SGU20_Object_ax 0;
BA_ "Remark" SG_ 789 SGU20_Object_ax "";
BA_ "EventCommandSignal" SG_ 789 SGU20_Object_ay 0;
BA_ "GatewayedSignals" SG_ 789 SGU20_Object_ay 0;
BA_ "GenSigInactiveValue" SG_ 789 SGU20_Object_ay 0;
BA_ "GenSigInvalidValue" SG_ 789 SGU20_Object_ay 0;
BA_ "GenSigSendType" SG_ 789 SGU20_Object_ay 1;
BA_ "GenSigStartValue" SG_ 789 SGU20_Object_ay 0;
BA_ "GenSigTimeoutValue" SG_ 789 SGU20_Object_ay 0;
BA_ "Remark" SG_ 789 SGU20_Object_ay "";
BA_ "EventCommandSignal" SG_ 789 SGU20_Object_dx 0;
BA_ "GatewayedSignals" SG_ 789 SGU20_Object_dx 0;
BA_ "GenSigInactiveValue" SG_ 789 SGU20_Object_dx 0;
BA_ "GenSigInvalidValue" SG_ 789 SGU20_Object_dx 0;
BA_ "GenSigSendType" SG_ 789 SGU20_Object_dx 1;
BA_ "GenSigStartValue" SG_ 789 SGU20_Object_dx 0;
BA_ "GenSigTimeoutValue" SG_ 789 SGU20_Object_dx 0;
BA_ "Remark" SG_ 789 SGU20_Object_dx "";
BA_ "EventCommandSignal" SG_ 789 SGU20_Object_dx_Rear 0;
BA_ "GatewayedSignals" SG_ 789 SGU20_Object_dx_Rear 0;
BA_ "GenSigInactiveValue" SG_ 789 SGU20_Object_dx_Rear 0;
BA_ "GenSigInvalidValue" SG_ 789 SGU20_Object_dx_Rear 0;
BA_ "GenSigSendType" SG_ 789 SGU20_Object_dx_Rear 1;
BA_ "GenSigStartValue" SG_ 789 SGU20_Object_dx_Rear 0;
BA_ "GenSigTimeoutValue" SG_ 789 SGU20_Object_dx_Rear 0;
BA_ "Remark" SG_ 789 SGU20_Object_dx_Rear "";
BA_ "EventCommandSignal" SG_ 789 SGU20_Object_dy 0;
BA_ "GatewayedSignals" SG_ 789 SGU20_Object_dy 0;
BA_ "GenSigInactiveValue" SG_ 789 SGU20_Object_dy 0;
BA_ "GenSigInvalidValue" SG_ 789 SGU20_Object_dy 0;
BA_ "GenSigSendType" SG_ 789 SGU20_Object_dy 1;
BA_ "GenSigStartValue" SG_ 789 SGU20_Object_dy 0;
BA_ "GenSigTimeoutValue" SG_ 789 SGU20_Object_dy 0;
BA_ "Remark" SG_ 789 SGU20_Object_dy "";
BA_ "EventCommandSignal" SG_ 789 SGU20_Object_dy_Rear 0;
BA_ "GatewayedSignals" SG_ 789 SGU20_Object_dy_Rear 0;
BA_ "GenSigInactiveValue" SG_ 789 SGU20_Object_dy_Rear 0;
BA_ "GenSigInvalidValue" SG_ 789 SGU20_Object_dy_Rear 0;
BA_ "GenSigSendType" SG_ 789 SGU20_Object_dy_Rear 1;
BA_ "GenSigStartValue" SG_ 789 SGU20_Object_dy_Rear 0;
BA_ "GenSigTimeoutValue" SG_ 789 SGU20_Object_dy_Rear 0;
BA_ "Remark" SG_ 789 SGU20_Object_dy_Rear "";
BA_ "EventCommandSignal" SG_ 789 SGU20_Object_vx 0;
BA_ "GatewayedSignals" SG_ 789 SGU20_Object_vx 0;
BA_ "GenSigInactiveValue" SG_ 789 SGU20_Object_vx 0;
BA_ "GenSigInvalidValue" SG_ 789 SGU20_Object_vx 0;
BA_ "GenSigSendType" SG_ 789 SGU20_Object_vx 1;
BA_ "GenSigStartValue" SG_ 789 SGU20_Object_vx 0;
BA_ "GenSigTimeoutValue" SG_ 789 SGU20_Object_vx 0;
BA_ "Remark" SG_ 789 SGU20_Object_vx "";
BA_ "EventCommandSignal" SG_ 789 SGU20_Object_vy 0;
BA_ "GatewayedSignals" SG_ 789 SGU20_Object_vy 0;
BA_ "GenSigInactiveValue" SG_ 789 SGU20_Object_vy 0;
BA_ "GenSigInvalidValue" SG_ 789 SGU20_Object_vy 0;
BA_ "GenSigSendType" SG_ 789 SGU20_Object_vy 1;
BA_ "GenSigStartValue" SG_ 789 SGU20_Object_vy 0;
BA_ "GenSigTimeoutValue" SG_ 789 SGU20_Object_vy 0;
BA_ "Remark" SG_ 789 SGU20_Object_vy "";
BA_ "EventCommandSignal" SG_ 789 SGU20_Object_wExist 0;
BA_ "GatewayedSignals" SG_ 789 SGU20_Object_wExist 0;
BA_ "GenSigInactiveValue" SG_ 789 SGU20_Object_wExist 0;
BA_ "GenSigInvalidValue" SG_ 789 SGU20_Object_wExist 0;
BA_ "GenSigSendType" SG_ 789 SGU20_Object_wExist 1;
BA_ "GenSigStartValue" SG_ 789 SGU20_Object_wExist 0;
BA_ "GenSigTimeoutValue" SG_ 789 SGU20_Object_wExist 0;
BA_ "Remark" SG_ 789 SGU20_Object_wExist "";
BA_ "EventCommandSignal" SG_ 789 SGU20_Object_wObstacle 0;
BA_ "GatewayedSignals" SG_ 789 SGU20_Object_wObstacle 0;
BA_ "GenSigInactiveValue" SG_ 789 SGU20_Object_wObstacle 0;
BA_ "GenSigInvalidValue" SG_ 789 SGU20_Object_wObstacle 0;
BA_ "GenSigSendType" SG_ 789 SGU20_Object_wObstacle 1;
BA_ "GenSigStartValue" SG_ 789 SGU20_Object_wObstacle 0;
BA_ "GenSigTimeoutValue" SG_ 789 SGU20_Object_wObstacle 0;
BA_ "Remark" SG_ 789 SGU20_Object_wObstacle "";
BA_ "EventCommandSignal" SG_ 790 SGU21_BlockCounter 0;
BA_ "GatewayedSignals" SG_ 790 SGU21_BlockCounter 0;
BA_ "GenSigInactiveValue" SG_ 790 SGU21_BlockCounter 0;
BA_ "GenSigInvalidValue" SG_ 790 SGU21_BlockCounter 0;
BA_ "GenSigSendType" SG_ 790 SGU21_BlockCounter 1;
BA_ "GenSigStartValue" SG_ 790 SGU21_BlockCounter 0;
BA_ "GenSigTimeoutValue" SG_ 790 SGU21_BlockCounter 0;
BA_ "Remark" SG_ 790 SGU21_BlockCounter "";
BA_ "EventCommandSignal" SG_ 790 SGU21_LifeCycles_OBJ 0;
BA_ "GatewayedSignals" SG_ 790 SGU21_LifeCycles_OBJ 0;
BA_ "GenSigInactiveValue" SG_ 790 SGU21_LifeCycles_OBJ 0;
BA_ "GenSigInvalidValue" SG_ 790 SGU21_LifeCycles_OBJ 0;
BA_ "GenSigSendType" SG_ 790 SGU21_LifeCycles_OBJ 1;
BA_ "GenSigStartValue" SG_ 790 SGU21_LifeCycles_OBJ 0;
BA_ "GenSigTimeoutValue" SG_ 790 SGU21_LifeCycles_OBJ 0;
BA_ "Remark" SG_ 790 SGU21_LifeCycles_OBJ "";
BA_ "EventCommandSignal" SG_ 790 SGU21_Msg_AliveCounter 0;
BA_ "GatewayedSignals" SG_ 790 SGU21_Msg_AliveCounter 0;
BA_ "GenSigInactiveValue" SG_ 790 SGU21_Msg_AliveCounter 0;
BA_ "GenSigInvalidValue" SG_ 790 SGU21_Msg_AliveCounter 0;
BA_ "GenSigSendType" SG_ 790 SGU21_Msg_AliveCounter 1;
BA_ "GenSigStartValue" SG_ 790 SGU21_Msg_AliveCounter 0;
BA_ "GenSigTimeoutValue" SG_ 790 SGU21_Msg_AliveCounter 0;
BA_ "Remark" SG_ 790 SGU21_Msg_AliveCounter "";
BA_ "EventCommandSignal" SG_ 790 SGU21_Msg_CheckSum 0;
BA_ "GatewayedSignals" SG_ 790 SGU21_Msg_CheckSum 0;
BA_ "GenSigInactiveValue" SG_ 790 SGU21_Msg_CheckSum 0;
BA_ "GenSigInvalidValue" SG_ 790 SGU21_Msg_CheckSum 0;
BA_ "GenSigSendType" SG_ 790 SGU21_Msg_CheckSum 1;
BA_ "GenSigStartValue" SG_ 790 SGU21_Msg_CheckSum 0;
BA_ "GenSigTimeoutValue" SG_ 790 SGU21_Msg_CheckSum 0;
BA_ "Remark" SG_ 790 SGU21_Msg_CheckSum "";
BA_ "EventCommandSignal" SG_ 790 SGU21_ObjRCS_21 0;
BA_ "GatewayedSignals" SG_ 790 SGU21_ObjRCS_21 0;
BA_ "GenSigInactiveValue" SG_ 790 SGU21_ObjRCS_21 0;
BA_ "GenSigInvalidValue" SG_ 790 SGU21_ObjRCS_21 0;
BA_ "GenSigSendType" SG_ 790 SGU21_ObjRCS_21 1;
BA_ "GenSigStartValue" SG_ 790 SGU21_ObjRCS_21 0;
BA_ "GenSigTimeoutValue" SG_ 790 SGU21_ObjRCS_21 0;
BA_ "Remark" SG_ 790 SGU21_ObjRCS_21 "";
BA_ "EventCommandSignal" SG_ 790 SGU21_Obj_DistLat_rms 0;
BA_ "GatewayedSignals" SG_ 790 SGU21_Obj_DistLat_rms 0;
BA_ "GenSigInactiveValue" SG_ 790 SGU21_Obj_DistLat_rms 0;
BA_ "GenSigInvalidValue" SG_ 790 SGU21_Obj_DistLat_rms 0;
BA_ "GenSigSendType" SG_ 790 SGU21_Obj_DistLat_rms 1;
BA_ "GenSigStartValue" SG_ 790 SGU21_Obj_DistLat_rms 0;
BA_ "GenSigTimeoutValue" SG_ 790 SGU21_Obj_DistLat_rms 0;
BA_ "Remark" SG_ 790 SGU21_Obj_DistLat_rms "";
BA_ "EventCommandSignal" SG_ 790 SGU21_Obj_VrelLong_rms 0;
BA_ "GatewayedSignals" SG_ 790 SGU21_Obj_VrelLong_rms 0;
BA_ "GenSigInactiveValue" SG_ 790 SGU21_Obj_VrelLong_rms 0;
BA_ "GenSigInvalidValue" SG_ 790 SGU21_Obj_VrelLong_rms 0;
BA_ "GenSigSendType" SG_ 790 SGU21_Obj_VrelLong_rms 1;
BA_ "GenSigStartValue" SG_ 790 SGU21_Obj_VrelLong_rms 0;
BA_ "GenSigTimeoutValue" SG_ 790 SGU21_Obj_VrelLong_rms 0;
BA_ "Remark" SG_ 790 SGU21_Obj_VrelLong_rms "";
BA_ "EventCommandSignal" SG_ 790 SGU21_Obj_Vrelat_rms 0;
BA_ "GatewayedSignals" SG_ 790 SGU21_Obj_Vrelat_rms 0;
BA_ "GenSigInactiveValue" SG_ 790 SGU21_Obj_Vrelat_rms 0;
BA_ "GenSigInvalidValue" SG_ 790 SGU21_Obj_Vrelat_rms 0;
BA_ "GenSigSendType" SG_ 790 SGU21_Obj_Vrelat_rms 1;
BA_ "GenSigStartValue" SG_ 790 SGU21_Obj_Vrelat_rms 0;
BA_ "GenSigTimeoutValue" SG_ 790 SGU21_Obj_Vrelat_rms 0;
BA_ "Remark" SG_ 790 SGU21_Obj_Vrelat_rms "";
BA_ "EventCommandSignal" SG_ 790 SGU21_Object_DetStatus 0;
BA_ "GatewayedSignals" SG_ 790 SGU21_Object_DetStatus 0;
BA_ "GenSigInactiveValue" SG_ 790 SGU21_Object_DetStatus 0;
BA_ "GenSigInvalidValue" SG_ 790 SGU21_Object_DetStatus 0;
BA_ "GenSigSendType" SG_ 790 SGU21_Object_DetStatus 1;
BA_ "GenSigStartValue" SG_ 790 SGU21_Object_DetStatus 0;
BA_ "GenSigTimeoutValue" SG_ 790 SGU21_Object_DetStatus 0;
BA_ "Remark" SG_ 790 SGU21_Object_DetStatus "";
BA_ "EventCommandSignal" SG_ 790 SGU21_Object_DistLong_rms 0;
BA_ "GatewayedSignals" SG_ 790 SGU21_Object_DistLong_rms 0;
BA_ "GenSigInactiveValue" SG_ 790 SGU21_Object_DistLong_rms 0;
BA_ "GenSigInvalidValue" SG_ 790 SGU21_Object_DistLong_rms 0;
BA_ "GenSigSendType" SG_ 790 SGU21_Object_DistLong_rms 1;
BA_ "GenSigStartValue" SG_ 790 SGU21_Object_DistLong_rms 0;
BA_ "GenSigTimeoutValue" SG_ 790 SGU21_Object_DistLong_rms 0;
BA_ "Remark" SG_ 790 SGU21_Object_DistLong_rms "";
BA_ "EventCommandSignal" SG_ 790 SGU21_Object_ID 0;
BA_ "GatewayedSignals" SG_ 790 SGU21_Object_ID 0;
BA_ "GenSigInactiveValue" SG_ 790 SGU21_Object_ID 0;
BA_ "GenSigInvalidValue" SG_ 790 SGU21_Object_ID 0;
BA_ "GenSigSendType" SG_ 790 SGU21_Object_ID 1;
BA_ "GenSigStartValue" SG_ 790 SGU21_Object_ID 0;
BA_ "GenSigTimeoutValue" SG_ 790 SGU21_Object_ID 0;
BA_ "Remark" SG_ 790 SGU21_Object_ID "";
BA_ "EventCommandSignal" SG_ 790 SGU21_Object_Motion_Pattern 0;
BA_ "GatewayedSignals" SG_ 790 SGU21_Object_Motion_Pattern 0;
BA_ "GenSigInactiveValue" SG_ 790 SGU21_Object_Motion_Pattern 0;
BA_ "GenSigInvalidValue" SG_ 790 SGU21_Object_Motion_Pattern 0;
BA_ "GenSigSendType" SG_ 790 SGU21_Object_Motion_Pattern 1;
BA_ "GenSigStartValue" SG_ 790 SGU21_Object_Motion_Pattern 0;
BA_ "GenSigTimeoutValue" SG_ 790 SGU21_Object_Motion_Pattern 0;
BA_ "Remark" SG_ 790 SGU21_Object_Motion_Pattern "";
BA_ "EventCommandSignal" SG_ 790 SGU21_Object_Type 0;
BA_ "GatewayedSignals" SG_ 790 SGU21_Object_Type 0;
BA_ "GenSigInactiveValue" SG_ 790 SGU21_Object_Type 0;
BA_ "GenSigInvalidValue" SG_ 790 SGU21_Object_Type 0;
BA_ "GenSigSendType" SG_ 790 SGU21_Object_Type 1;
BA_ "GenSigStartValue" SG_ 790 SGU21_Object_Type 0;
BA_ "GenSigTimeoutValue" SG_ 790 SGU21_Object_Type 0;
BA_ "Remark" SG_ 790 SGU21_Object_Type "";
BA_ "EventCommandSignal" SG_ 790 SGU21_Object_ax 0;
BA_ "GatewayedSignals" SG_ 790 SGU21_Object_ax 0;
BA_ "GenSigInactiveValue" SG_ 790 SGU21_Object_ax 0;
BA_ "GenSigInvalidValue" SG_ 790 SGU21_Object_ax 0;
BA_ "GenSigSendType" SG_ 790 SGU21_Object_ax 1;
BA_ "GenSigStartValue" SG_ 790 SGU21_Object_ax 0;
BA_ "GenSigTimeoutValue" SG_ 790 SGU21_Object_ax 0;
BA_ "Remark" SG_ 790 SGU21_Object_ax "";
BA_ "EventCommandSignal" SG_ 790 SGU21_Object_ay 0;
BA_ "GatewayedSignals" SG_ 790 SGU21_Object_ay 0;
BA_ "GenSigInactiveValue" SG_ 790 SGU21_Object_ay 0;
BA_ "GenSigInvalidValue" SG_ 790 SGU21_Object_ay 0;
BA_ "GenSigSendType" SG_ 790 SGU21_Object_ay 1;
BA_ "GenSigStartValue" SG_ 790 SGU21_Object_ay 0;
BA_ "GenSigTimeoutValue" SG_ 790 SGU21_Object_ay 0;
BA_ "Remark" SG_ 790 SGU21_Object_ay "";
BA_ "EventCommandSignal" SG_ 790 SGU21_Object_dx 0;
BA_ "GatewayedSignals" SG_ 790 SGU21_Object_dx 0;
BA_ "GenSigInactiveValue" SG_ 790 SGU21_Object_dx 0;
BA_ "GenSigInvalidValue" SG_ 790 SGU21_Object_dx 0;
BA_ "GenSigSendType" SG_ 790 SGU21_Object_dx 1;
BA_ "GenSigStartValue" SG_ 790 SGU21_Object_dx 0;
BA_ "GenSigTimeoutValue" SG_ 790 SGU21_Object_dx 0;
BA_ "Remark" SG_ 790 SGU21_Object_dx "";
BA_ "EventCommandSignal" SG_ 790 SGU21_Object_dx_Rear 0;
BA_ "GatewayedSignals" SG_ 790 SGU21_Object_dx_Rear 0;
BA_ "GenSigInactiveValue" SG_ 790 SGU21_Object_dx_Rear 0;
BA_ "GenSigInvalidValue" SG_ 790 SGU21_Object_dx_Rear 0;
BA_ "GenSigSendType" SG_ 790 SGU21_Object_dx_Rear 1;
BA_ "GenSigStartValue" SG_ 790 SGU21_Object_dx_Rear 0;
BA_ "GenSigTimeoutValue" SG_ 790 SGU21_Object_dx_Rear 0;
BA_ "Remark" SG_ 790 SGU21_Object_dx_Rear "";
BA_ "EventCommandSignal" SG_ 790 SGU21_Object_dy 0;
BA_ "GatewayedSignals" SG_ 790 SGU21_Object_dy 0;
BA_ "GenSigInactiveValue" SG_ 790 SGU21_Object_dy 0;
BA_ "GenSigInvalidValue" SG_ 790 SGU21_Object_dy 0;
BA_ "GenSigSendType" SG_ 790 SGU21_Object_dy 1;
BA_ "GenSigStartValue" SG_ 790 SGU21_Object_dy 0;
BA_ "GenSigTimeoutValue" SG_ 790 SGU21_Object_dy 0;
BA_ "Remark" SG_ 790 SGU21_Object_dy "";
BA_ "EventCommandSignal" SG_ 790 SGU21_Object_dy_Rear 0;
BA_ "GatewayedSignals" SG_ 790 SGU21_Object_dy_Rear 0;
BA_ "GenSigInactiveValue" SG_ 790 SGU21_Object_dy_Rear 0;
BA_ "GenSigInvalidValue" SG_ 790 SGU21_Object_dy_Rear 0;
BA_ "GenSigSendType" SG_ 790 SGU21_Object_dy_Rear 1;
BA_ "GenSigStartValue" SG_ 790 SGU21_Object_dy_Rear 0;
BA_ "GenSigTimeoutValue" SG_ 790 SGU21_Object_dy_Rear 0;
BA_ "Remark" SG_ 790 SGU21_Object_dy_Rear "";
BA_ "EventCommandSignal" SG_ 790 SGU21_Object_vx 0;
BA_ "GatewayedSignals" SG_ 790 SGU21_Object_vx 0;
BA_ "GenSigInactiveValue" SG_ 790 SGU21_Object_vx 0;
BA_ "GenSigInvalidValue" SG_ 790 SGU21_Object_vx 0;
BA_ "GenSigSendType" SG_ 790 SGU21_Object_vx 1;
BA_ "GenSigStartValue" SG_ 790 SGU21_Object_vx 0;
BA_ "GenSigTimeoutValue" SG_ 790 SGU21_Object_vx 0;
BA_ "Remark" SG_ 790 SGU21_Object_vx "";
BA_ "EventCommandSignal" SG_ 790 SGU21_Object_vy 0;
BA_ "GatewayedSignals" SG_ 790 SGU21_Object_vy 0;
BA_ "GenSigInactiveValue" SG_ 790 SGU21_Object_vy 0;
BA_ "GenSigInvalidValue" SG_ 790 SGU21_Object_vy 0;
BA_ "GenSigSendType" SG_ 790 SGU21_Object_vy 1;
BA_ "GenSigStartValue" SG_ 790 SGU21_Object_vy 0;
BA_ "GenSigTimeoutValue" SG_ 790 SGU21_Object_vy 0;
BA_ "Remark" SG_ 790 SGU21_Object_vy "";
BA_ "EventCommandSignal" SG_ 790 SGU21_Object_wExist 0;
BA_ "GatewayedSignals" SG_ 790 SGU21_Object_wExist 0;
BA_ "GenSigInactiveValue" SG_ 790 SGU21_Object_wExist 0;
BA_ "GenSigInvalidValue" SG_ 790 SGU21_Object_wExist 0;
BA_ "GenSigSendType" SG_ 790 SGU21_Object_wExist 1;
BA_ "GenSigStartValue" SG_ 790 SGU21_Object_wExist 0;
BA_ "GenSigTimeoutValue" SG_ 790 SGU21_Object_wExist 0;
BA_ "Remark" SG_ 790 SGU21_Object_wExist "";
BA_ "EventCommandSignal" SG_ 790 SGU21_Object_wObstacle 0;
BA_ "GatewayedSignals" SG_ 790 SGU21_Object_wObstacle 0;
BA_ "GenSigInactiveValue" SG_ 790 SGU21_Object_wObstacle 0;
BA_ "GenSigInvalidValue" SG_ 790 SGU21_Object_wObstacle 0;
BA_ "GenSigSendType" SG_ 790 SGU21_Object_wObstacle 1;
BA_ "GenSigStartValue" SG_ 790 SGU21_Object_wObstacle 0;
BA_ "GenSigTimeoutValue" SG_ 790 SGU21_Object_wObstacle 0;
BA_ "Remark" SG_ 790 SGU21_Object_wObstacle "";
BA_ "MsgType" BO_ 776 0;
BA_ "MsgType" BO_ 777 0;
BA_ "MsgType" BO_ 778 0;
BA_ "MsgType" BO_ 779 0;
BA_ "MsgType" BO_ 780 0;
BA_ "MsgType" BO_ 781 0;
BA_ "MsgType" BO_ 782 0;
BA_ "MsgType" BO_ 783 0;
BA_ "MsgType" BO_ 784 0;
BA_ "MsgType" BO_ 785 0;
BA_ "MsgType" BO_ 786 0;
BA_ "MsgType" BO_ 787 0;
BA_ "MsgType" BO_ 788 0;
BA_ "MsgType" BO_ 789 0;
BA_ "MsgType" BO_ 790 0;
BA_ "IsCrcSignal" SG_ 776 SGU7_Msg_CheckSum 1;
BA_ "IsCrcSignal" SG_ 777 SGU8_Msg_CheckSum 1;
BA_ "IsCrcSignal" SG_ 778 SGU9_Msg_CheckSum 1;
BA_ "IsCrcSignal" SG_ 779 SGU10_Msg_CheckSum 1;
BA_ "IsCrcSignal" SG_ 780 SGU11_Msg_CheckSum 1;
BA_ "IsCrcSignal" SG_ 781 SGU12_Msg_CheckSum 1;
BA_ "IsCrcSignal" SG_ 782 SGU13_Msg_CheckSum 1;
BA_ "IsCrcSignal" SG_ 783 SGU14_Msg_CheckSum 1;
BA_ "IsCrcSignal" SG_ 784 SGU15_Msg_CheckSum 1;
BA_ "IsCrcSignal" SG_ 785 SGU16_Msg_CheckSum 1;
BA_ "IsCrcSignal" SG_ 786 SGU17_Msg_CheckSum 1;
BA_ "IsCrcSignal" SG_ 787 SGU18_Msg_CheckSum 1;
BA_ "IsCrcSignal" SG_ 788 SGU19_Msg_CheckSum 1;
BA_ "IsCrcSignal" SG_ 789 SGU20_Msg_CheckSum 1;
BA_ "IsCrcSignal" SG_ 790 SGU21_Msg_CheckSum 1;
VAL_ 776 SGU7_Object_DetStatus 0 "deleted" 1 "new" 2 "measured" 3 "predicted" 4 "deleted for merge" 5 "new from  merge"  ;
VAL_ 776 SGU7_Object_Motion_Pattern 0 "Unknown" 1 "Stationary" 2 "Stopped" 3 "Moving"  ;
VAL_ 776 SGU7_Object_Type 0 "Unknown" 1 "4 wheeler" 2 "2 wheeler" 3 "Pedestrian"  ;
VAL_ 777 SGU8_Object_DetStatus 0 "deleted" 1 "new" 2 "measured" 3 "predicted" 4 "deleted for merge" 5 "new from  merge"  ;
VAL_ 777 SGU8_Object_Motion_Pattern 0 "Unknown" 1 "Stationary" 2 "Stopped" 3 "Moving"  ;
VAL_ 777 SGU8_Object_Type 0 "Unknown" 1 "4 wheeler" 2 "2 wheeler" 3 "Pedestrian"  ;
VAL_ 778 SGU9_Object_DetStatus 0 "deleted" 1 "new" 2 "measured" 3 "predicted" 4 "deleted for merge" 5 "new from  merge"  ;
VAL_ 778 SGU9_Object_Motion_Pattern 0 "Unknown" 1 "Stationary" 2 "Stopped" 3 "Moving"  ;
VAL_ 778 SGU9_Object_Type 0 "Unknown" 1 "4 wheeler" 2 "2 wheeler" 3 "Pedestrian"  ;
VAL_ 779 SGU10_Object_DetStatus 0 "deleted" 1 "new" 2 "measured" 3 "predicted" 4 "deleted for merge" 5 "new from  merge"  ;
VAL_ 779 SGU10_Object_Motion_Pattern 0 "Unknown" 1 "Stationary" 2 "Stopped" 3 "Moving"  ;
VAL_ 779 SGU10_Object_Type 0 "Unknown" 1 "4 wheeler" 2 "2 wheeler" 3 "Pedestrian"  ;
VAL_ 780 SGU11_Object_DetStatus 0 "deleted" 1 "new" 2 "measured" 3 "predicted" 4 "deleted for merge" 5 "new from  merge"  ;
VAL_ 780 SGU11_Object_Motion_Pattern 0 "Unknown" 1 "Stationary" 2 "Stopped" 3 "Moving"  ;
VAL_ 780 SGU11_Object_Type 0 "Unknown" 1 "4 wheeler" 2 "2 wheeler" 3 "Pedestrian"  ;
VAL_ 781 SGU12_Object_DetStatus 0 "deleted" 1 "new" 2 "measured" 3 "predicted" 4 "deleted for merge" 5 "new from  merge"  ;
VAL_ 781 SGU12_Object_Motion_Pattern 0 "Unknown" 1 "Stationary" 2 "Stopped" 3 "Moving"  ;
VAL_ 781 SGU12_Object_Type 0 "Unknown" 1 "4 wheeler" 2 "2 wheeler" 3 "Pedestrian"  ;
VAL_ 782 SGU13_Object_DetStatus 0 "deleted" 1 "new" 2 "measured" 3 "predicted" 4 "deleted for merge" 5 "new from  merge"  ;
VAL_ 782 SGU13_Object_Motion_Pattern 0 "Unknown" 1 "Stationary" 2 "Stopped" 3 "Moving"  ;
VAL_ 782 SGU13_Object_Type 0 "Unknown" 1 "4 wheeler" 2 "2 wheeler" 3 "Pedestrian"  ;
VAL_ 783 SGU14_Object_DetStatus 0 "deleted" 1 "new" 2 "measured" 3 "predicted" 4 "deleted for merge" 5 "new from  merge"  ;
VAL_ 783 SGU14_Object_Motion_Pattern 0 "Unknown" 1 "Stationary" 2 "Stopped" 3 "Moving"  ;
VAL_ 783 SGU14_Object_Type 0 "Unknown" 1 "4 wheeler" 2 "2 wheeler" 3 "Pedestrian"  ;
VAL_ 784 SGU15_Object_DetStatus 0 "deleted" 1 "new" 2 "measured" 3 "predicted" 4 "deleted for merge" 5 "new from  merge"  ;
VAL_ 784 SGU15_Object_Motion_Pattern 0 "Unknown" 1 "Stationary" 2 "Stopped" 3 "Moving"  ;
VAL_ 784 SGU15_Object_Type 0 "Unknown" 1 "4 wheeler" 2 "2 wheeler" 3 "Pedestrian"  ;
VAL_ 785 SGU16_Object_DetStatus 0 "deleted" 1 "new" 2 "measured" 3 "predicted" 4 "deleted for merge" 5 "new from  merge"  ;
VAL_ 785 SGU16_Object_Motion_Pattern 0 "Unknown" 1 "Stationary" 2 "Stopped" 3 "Moving"  ;
VAL_ 785 SGU16_Object_Type 0 "Unknown" 1 "4 wheeler" 2 "2 wheeler" 3 "Pedestrian"  ;
VAL_ 786 SGU17_Object_DetStatus 0 "deleted" 1 "new" 2 "measured" 3 "predicted" 4 "deleted for merge" 5 "new from  merge"  ;
VAL_ 786 SGU17_Object_Motion_Pattern 0 "Unknown" 1 "Stationary" 2 "Stopped" 3 "Moving"  ;
VAL_ 786 SGU17_Object_Type 0 "Unknown" 1 "4 wheeler" 2 "2 wheeler" 3 "Pedestrian"  ;
VAL_ 787 SGU18_Object_DetStatus 0 "deleted" 1 "new" 2 "measured" 3 "predicted" 4 "deleted for merge" 5 "new from  merge"  ;
VAL_ 787 SGU18_Object_Motion_Pattern 0 "Unknown" 1 "Stationary" 2 "Stopped" 3 "Moving"  ;
VAL_ 787 SGU18_Object_Type 0 "Unknown" 1 "4 wheeler" 2 "2 wheeler" 3 "Pedestrian"  ;
VAL_ 788 SGU19_Object_DetStatus 0 "deleted" 1 "new" 2 "measured" 3 "predicted" 4 "deleted for merge" 5 "new from  merge"  ;
VAL_ 788 SGU19_Object_Motion_Pattern 0 "Unknown" 1 "Stationary" 2 "Stopped" 3 "Moving"  ;
VAL_ 788 SGU19_Object_Type 0 "Unknown" 1 "4 wheeler" 2 "2 wheeler" 3 "Pedestrian"  ;
VAL_ 789 SGU20_Object_DetStatus 0 "deleted" 1 "new" 2 "measured" 3 "predicted" 4 "deleted for merge" 5 "new from  merge"  ;
VAL_ 789 SGU20_Object_Motion_Pattern 0 "Unknown" 1 "Stationary" 2 "Stopped" 3 "Moving"  ;
VAL_ 789 SGU20_Object_Type 0 "Unknown" 1 "4 wheeler" 2 "2 wheeler" 3 "Pedestrian"  ;
VAL_ 790 SGU21_Object_DetStatus 0 "deleted" 1 "new" 2 "measured" 3 "predicted" 4 "deleted for merge" 5 "new from  merge"  ;
VAL_ 790 SGU21_Object_Motion_Pattern 0 "Unknown" 1 "Stationary" 2 "Stopped" 3 "Moving"  ;
VAL_ 790 SGU21_Object_Type 0 "Unknown" 1 "4 wheeler" 2 "2 wheeler" 3 "Pedestrian"  ;
