VERSION "Version"

NS_ :

BS_:

BU_: ADC FR Tester

BO_ 524 FR_Obj_11: 32 FR
 SG_ SGU11_Msg_CheckSum_Can03 : 7|8@0+ (1,0) [0|255] ""  ADC
 SG_ SGU11_Msg_AliveCounter_Can03 : 11|4@0+ (1,0) [0|14] ""  ADC
 SG_ SGU11_BlockCounter_Can03 : 15|4@0+ (1,0) [0|15] ""  ADC
 SG_ SGU11_Object_ID_Can03 : 23|8@0+ (1,0) [0|255] ""  ADC
 SG_ SGU11_Object_wExist_Can03 : 28|5@0+ (0.03125,0) [0|0.96875] ""  ADC
 SG_ SGU11_Object_Type_Can03 : 31|3@0+ (1,0) [0|7] ""  ADC
 SG_ SGU11_Object_MotionPattern_Can03 : 34|3@0+ (1,0) [0|7] ""  ADC
 SG_ SGU11_Object_wObstacle_Can03 : 39|5@0+ (0.03125,0) [0|0.96875] ""  ADC
 SG_ SGU11_Object_dx_Nearest_Can03 : 44|13@0+ (0.0625,-255) [-255|254.9375] "m"  ADC
 SG_ SGU11_Object_dy_Nearest_Can03 : 59|12@0+ (0.125,-128) [-128|127.875] "m"  ADC
 SG_ SGU11_Object_DistLong_rms_Can03 : 79|16@0+ (0.001953125,0) [0|127.998046875] "m"  ADC
 SG_ SGU11_Obj_DistLat_rms_Can03 : 95|16@0+ (0.001953125,0) [0|127.998046875] "m"  ADC
 SG_ SGU11_Object_vx_Can03 : 107|12@0+ (0.0625,-128) [-128|127.9375] "m/s"  ADC
 SG_ SGU11_Object_vy_Can03 : 123|12@0+ (0.0625,-128) [-128|127.9375] "m/s"  ADC
 SG_ SGU11_Obj_VrelLong_rms_Can03 : 143|16@0+ (0.001953125,0) [0|127.998046875] "m/s"  ADC
 SG_ SGU11_Obj_Vrelat_rms_Can03 : 159|16@0+ (0.001953125,0) [0|127.998046875] "m/s"  ADC
 SG_ SGU11_Object_DetStatus_Can03 : 173|3@0+ (1,0) [0|7] ""  ADC
 SG_ SGU11_Object_ax_Can03 : 170|11@0+ (0.03125,-16) [-16|15.96875] "m/s^2"  ADC
 SG_ SGU11_Object_ay_Can03 : 191|11@0+ (0.03125,-16) [-16|15.96875] "m/s^2"  ADC
 SG_ SGU11_LifeCycles_OBJ_Can03 : 196|8@0+ (1,0) [0|255] ""  ADC
 SG_ SGU11_ObjRCS_11_Can03 : 204|10@0+ (0.125,-50) [-50|70] "dBm2"  ADC
 SG_ SGU11_Object_dx_Rear_Can03 : 210|13@0+ (0.0625,-255) [-255|254.9375] "m"  ADC
 SG_ SGU11_Object_dy_Rear_Can03 : 229|12@0+ (0.125,-128) [-128|127.875] "m"  ADC

BO_ 525 FR_Obj_12: 32 FR
 SG_ SGU12_Msg_CheckSum_Can03 : 7|8@0+ (1,0) [0|255] ""  ADC
 SG_ SGU12_Msg_AliveCounter_Can03 : 11|4@0+ (1,0) [0|14] ""  ADC
 SG_ SGU12_BlockCounter_Can03 : 15|4@0+ (1,0) [0|15] ""  ADC
 SG_ SGU12_Object_ID_Can03 : 23|8@0+ (1,0) [0|255] ""  ADC
 SG_ SGU12_Object_wExist_Can03 : 28|5@0+ (0.03125,0) [0|0.96875] ""  ADC
 SG_ SGU12_Object_Type_Can03 : 31|3@0+ (1,0) [0|7] ""  ADC
 SG_ SGU12_Object_MotionPattern_Can03 : 34|3@0+ (1,0) [0|7] ""  ADC
 SG_ SGU12_Object_wObstacle_Can03 : 39|5@0+ (0.03125,0) [0|0.96875] ""  ADC
 SG_ SGU12_Object_dx_Nearest_Can03 : 44|13@0+ (0.0625,-255) [-255|254.9375] "m"  ADC
 SG_ SGU12_Object_dy_Nearest_Can03 : 59|12@0+ (0.125,-128) [-128|127.875] "m"  ADC
 SG_ SGU12_Object_DistLong_rms_Can03 : 79|16@0+ (0.001953125,0) [0|127.998046875] "m"  ADC
 SG_ SGU12_Obj_DistLat_rms_Can03 : 95|16@0+ (0.001953125,0) [0|127.998046875] "m"  ADC
 SG_ SGU12_Object_vx_Can03 : 107|12@0+ (0.0625,-128) [-128|127.9375] "m/s"  ADC
 SG_ SGU12_Object_vy_Can03 : 123|12@0+ (0.0625,-128) [-128|127.9375] "m/s"  ADC
 SG_ SGU12_Obj_VrelLong_rms_Can03 : 143|16@0+ (0.001953125,0) [0|127.998046875] "m/s"  ADC
 SG_ SGU12_Obj_Vrelat_rms_Can03 : 159|16@0+ (0.001953125,0) [0|127.998046875] "m/s"  ADC
 SG_ SGU12_Object_DetStatus_Can03 : 173|3@0+ (1,0) [0|7] ""  ADC
 SG_ SGU12_Object_ax_Can03 : 170|11@0+ (0.03125,-16) [-16|15.96875] "m/s^2"  ADC
 SG_ SGU12_Object_ay_Can03 : 191|11@0+ (0.03125,-16) [-16|15.96875] "m/s^2"  ADC
 SG_ SGU12_LifeCycles_OBJ_Can03 : 196|8@0+ (1,0) [0|255] ""  ADC
 SG_ SGU12_ObjRCS_12_Can03 : 204|10@0+ (0.125,-50) [-50|70] "dBm2"  ADC
 SG_ SGU12_Object_dx_Rear_Can03 : 210|13@0+ (0.0625,-255) [-255|254.9375] "m"  ADC
 SG_ SGU12_Object_dy_Rear_Can03 : 229|12@0+ (0.125,-128) [-128|127.875] "m"  ADC

BO_ 526 FR_Obj_13: 32 FR
 SG_ SGU13_Msg_CheckSum_Can03 : 7|8@0+ (1,0) [0|255] ""  ADC
 SG_ SGU13_Msg_AliveCounter_Can03 : 11|4@0+ (1,0) [0|14] ""  ADC
 SG_ SGU13_BlockCounter_Can03 : 15|4@0+ (1,0) [0|15] ""  ADC
 SG_ SGU13_Object_ID_Can03 : 23|8@0+ (1,0) [0|255] ""  ADC
 SG_ SGU13_Object_wExist_Can03 : 28|5@0+ (0.03125,0) [0|0.96875] ""  ADC
 SG_ SGU13_Object_Type_Can03 : 31|3@0+ (1,0) [0|7] ""  ADC
 SG_ SGU13_Object_MotionPattern_Can03 : 34|3@0+ (1,0) [0|7] ""  ADC
 SG_ SGU13_Object_wObstacle_Can03 : 39|5@0+ (0.03125,0) [0|0.96875] ""  ADC
 SG_ SGU13_Object_dx_Nearest_Can03 : 44|13@0+ (0.0625,-255) [-255|254.9375] "m"  ADC
 SG_ SGU13_Object_dy_Nearest_Can03 : 59|12@0+ (0.125,-128) [-128|127.875] "m"  ADC
 SG_ SGU13_Object_DistLong_rms_Can03 : 79|16@0+ (0.001953125,0) [0|127.998046875] "m"  ADC
 SG_ SGU13_Obj_DistLat_rms_Can03 : 95|16@0+ (0.001953125,0) [0|127.998046875] "m"  ADC
 SG_ SGU13_Object_vx_Can03 : 107|12@0+ (0.0625,-128) [-128|127.9375] "m/s"  ADC
 SG_ SGU13_Object_vy_Can03 : 123|12@0+ (0.0625,-128) [-128|127.9375] "m/s"  ADC
 SG_ SGU13_Obj_VrelLong_rms_Can03 : 143|16@0+ (0.001953125,0) [0|127.998046875] "m/s"  ADC
 SG_ SGU13_Obj_Vrelat_rms_Can03 : 159|16@0+ (0.001953125,0) [0|127.998046875] "m/s"  ADC
 SG_ SGU13_Object_DetStatus_Can03 : 173|3@0+ (1,0) [0|7] ""  ADC
 SG_ SGU13_Object_ax_Can03 : 170|11@0+ (0.03125,-16) [-16|15.96875] "m/s^2"  ADC
 SG_ SGU13_Object_ay_Can03 : 191|11@0+ (0.03125,-16) [-16|15.96875] "m/s^2"  ADC
 SG_ SGU13_LifeCycles_OBJ_Can03 : 196|8@0+ (1,0) [0|255] ""  ADC
 SG_ SGU13_ObjRCS_13_Can03 : 204|10@0+ (0.125,-50) [-50|70] "dBm2"  ADC
 SG_ SGU13_Object_dx_Rear_Can03 : 210|13@0+ (0.0625,-255) [-255|254.9375] "m"  ADC
 SG_ SGU13_Object_dy_Rear_Can03 : 229|12@0+ (0.125,-128) [-128|127.875] "m"  ADC

BO_ 527 FR_Obj_14: 32 FR
 SG_ SGU14_Msg_CheckSum_Can03 : 7|8@0+ (1,0) [0|255] ""  ADC
 SG_ SGU14_Msg_AliveCounter_Can03 : 11|4@0+ (1,0) [0|14] ""  ADC
 SG_ SGU14_BlockCounter_Can03 : 15|4@0+ (1,0) [0|15] ""  ADC
 SG_ SGU14_Object_ID_Can03 : 23|8@0+ (1,0) [0|255] ""  ADC
 SG_ SGU14_Object_wExist_Can03 : 28|5@0+ (0.03125,0) [0|0.96875] ""  ADC
 SG_ SGU14_Object_Type_Can03 : 31|3@0+ (1,0) [0|7] ""  ADC
 SG_ SGU14_Object_MotionPattern_Can03 : 34|3@0+ (1,0) [0|7] ""  ADC
 SG_ SGU14_Object_wObstacle_Can03 : 39|5@0+ (0.03125,0) [0|0.96875] ""  ADC
 SG_ SGU14_Object_dx_Nearest_Can03 : 44|13@0+ (0.0625,-255) [-255|254.9375] "m"  ADC
 SG_ SGU14_Object_dy_Nearest_Can03 : 59|12@0+ (0.125,-128) [-128|127.875] "m"  ADC
 SG_ SGU14_Object_DistLong_rms_Can03 : 79|16@0+ (0.001953125,0) [0|127.998046875] "m"  ADC
 SG_ SGU14_Obj_DistLat_rms_Can03 : 95|16@0+ (0.001953125,0) [0|127.998046875] "m"  ADC
 SG_ SGU14_Object_vx_Can03 : 107|12@0+ (0.0625,-128) [-128|127.9375] "m/s"  ADC
 SG_ SGU14_Object_vy_Can03 : 123|12@0+ (0.0625,-128) [-128|127.9375] "m/s"  ADC
 SG_ SGU14_Obj_VrelLong_rms_Can03 : 143|16@0+ (0.001953125,0) [0|127.998046875] "m/s"  ADC
 SG_ SGU14_Obj_Vrelat_rms_Can03 : 159|16@0+ (0.001953125,0) [0|127.998046875] "m/s"  ADC
 SG_ SGU14_Object_DetStatus_Can03 : 173|3@0+ (1,0) [0|7] ""  ADC
 SG_ SGU14_Object_ax_Can03 : 170|11@0+ (0.03125,-16) [-16|15.96875] "m/s^2"  ADC
 SG_ SGU14_Object_ay_Can03 : 191|11@0+ (0.03125,-16) [-16|15.96875] "m/s^2"  ADC
 SG_ SGU14_LifeCycles_OBJ_Can03 : 196|8@0+ (1,0) [0|255] ""  ADC
 SG_ SGU14_ObjRCS_14_Can03 : 204|10@0+ (0.125,-50) [-50|70] "dBm2"  ADC
 SG_ SGU14_Object_dx_Rear_Can03 : 210|13@0+ (0.0625,-255) [-255|254.9375] "m"  ADC
 SG_ SGU14_Object_dy_Rear_Can03 : 229|12@0+ (0.125,-128) [-128|127.875] "m"  ADC

BO_ 528 FR_Obj_15: 32 FR
 SG_ SGU15_Msg_CheckSum_Can03 : 7|8@0+ (1,0) [0|255] ""  ADC
 SG_ SGU15_Msg_AliveCounter_Can03 : 11|4@0+ (1,0) [0|14] ""  ADC
 SG_ SGU15_BlockCounter_Can03 : 15|4@0+ (1,0) [0|15] ""  ADC
 SG_ SGU15_Object_ID_Can03 : 23|8@0+ (1,0) [0|255] ""  ADC
 SG_ SGU15_Object_wExist_Can03 : 28|5@0+ (0.03125,0) [0|0.96875] ""  ADC
 SG_ SGU15_Object_Type_Can03 : 31|3@0+ (1,0) [0|7] ""  ADC
 SG_ SGU15_Object_MotionPattern_Can03 : 34|3@0+ (1,0) [0|7] ""  ADC
 SG_ SGU15_Object_wObstacle_Can03 : 39|5@0+ (0.03125,0) [0|0.96875] ""  ADC
 SG_ SGU15_Object_dx_Nearest_Can03 : 44|13@0+ (0.0625,-255) [-255|254.9375] "m"  ADC
 SG_ SGU15_Object_dy_Nearest_Can03 : 59|12@0+ (0.125,-128) [-128|127.875] "m"  ADC
 SG_ SGU15_Object_DistLong_rms_Can03 : 79|16@0+ (0.001953125,0) [0|127.998046875] "m"  ADC
 SG_ SGU15_Obj_DistLat_rms_Can03 : 95|16@0+ (0.001953125,0) [0|127.998046875] "m"  ADC
 SG_ SGU15_Object_vx_Can03 : 107|12@0+ (0.0625,-128) [-128|127.9375] "m/s"  ADC
 SG_ SGU15_Object_vy_Can03 : 123|12@0+ (0.0625,-128) [-128|127.9375] "m/s"  ADC
 SG_ SGU15_Obj_VrelLong_rms_Can03 : 143|16@0+ (0.001953125,0) [0|127.998046875] "m/s"  ADC
 SG_ SGU15_Obj_Vrelat_rms_Can03 : 159|16@0+ (0.001953125,0) [0|127.998046875] "m/s"  ADC
 SG_ SGU15_Object_DetStatus_Can03 : 173|3@0+ (1,0) [0|7] ""  ADC
 SG_ SGU15_Object_ax_Can03 : 170|11@0+ (0.03125,-16) [-16|15.96875] "m/s^2"  ADC
 SG_ SGU15_Object_ay_Can03 : 191|11@0+ (0.03125,-16) [-16|15.96875] "m/s^2"  ADC
 SG_ SGU15_LifeCycles_OBJ_Can03 : 196|8@0+ (1,0) [0|255] ""  ADC
 SG_ SGU15_ObjRCS_15_Can03 : 204|10@0+ (0.125,-50) [-50|70] "dBm2"  ADC
 SG_ SGU15_Object_dx_Rear_Can03 : 210|13@0+ (0.0625,-255) [-255|254.9375] "m"  ADC
 SG_ SGU15_Object_dy_Rear_Can03 : 229|12@0+ (0.125,-128) [-128|127.875] "m"  ADC

BO_ 529 FR_Obj_16: 32 FR
 SG_ SGU16_Msg_CheckSum_Can03 : 7|8@0+ (1,0) [0|255] ""  ADC
 SG_ SGU16_Msg_AliveCounter_Can03 : 11|4@0+ (1,0) [0|14] ""  ADC
 SG_ SGU16_BlockCounter_Can03 : 15|4@0+ (1,0) [0|15] ""  ADC
 SG_ SGU16_Object_ID_Can03 : 23|8@0+ (1,0) [0|255] ""  ADC
 SG_ SGU16_Object_wExist_Can03 : 28|5@0+ (0.03125,0) [0|0.96875] ""  ADC
 SG_ SGU16_Object_Type_Can03 : 31|3@0+ (1,0) [0|7] ""  ADC
 SG_ SGU16_Object_MotionPattern_Can03 : 34|3@0+ (1,0) [0|7] ""  ADC
 SG_ SGU16_Object_wObstacle_Can03 : 39|5@0+ (0.03125,0) [0|0.96875] ""  ADC
 SG_ SGU16_Object_dx_Nearest_Can03 : 44|13@0+ (0.0625,-255) [-255|254.9375] "m"  ADC
 SG_ SGU16_Object_dy_Nearest_Can03 : 59|12@0+ (0.125,-128) [-128|127.875] "m"  ADC
 SG_ SGU16_Object_DistLong_rms_Can03 : 79|16@0+ (0.001953125,0) [0|127.998046875] "m"  ADC
 SG_ SGU16_Obj_DistLat_rms_Can03 : 95|16@0+ (0.001953125,0) [0|127.998046875] "m"  ADC
 SG_ SGU16_Object_vx_Can03 : 107|12@0+ (0.0625,-128) [-128|127.9375] "m/s"  ADC
 SG_ SGU16_Object_vy_Can03 : 123|12@0+ (0.0625,-128) [-128|127.9375] "m/s"  ADC
 SG_ SGU16_Obj_VrelLong_rms_Can03 : 143|16@0+ (0.001953125,0) [0|127.998046875] "m/s"  ADC
 SG_ SGU16_Obj_Vrelat_rms_Can03 : 159|16@0+ (0.001953125,0) [0|127.998046875] "m/s"  ADC
 SG_ SGU16_Object_DetStatus_Can03 : 173|3@0+ (1,0) [0|7] ""  ADC
 SG_ SGU16_Object_ax_Can03 : 170|11@0+ (0.03125,-16) [-16|15.96875] "m/s^2"  ADC
 SG_ SGU16_Object_ay_Can03 : 191|11@0+ (0.03125,-16) [-16|15.96875] "m/s^2"  ADC
 SG_ SGU16_LifeCycles_OBJ_Can03 : 196|8@0+ (1,0) [0|255] ""  ADC
 SG_ SGU16_ObjRCS_16_Can03 : 204|10@0+ (0.125,-50) [-50|70] "dBm2"  ADC
 SG_ SGU16_Object_dx_Rear_Can03 : 210|13@0+ (0.0625,-255) [-255|254.9375] "m"  ADC
 SG_ SGU16_Object_dy_Rear_Can03 : 229|12@0+ (0.125,-128) [-128|127.875] "m"  ADC

BO_ 530 FR_Obj_17: 32 FR
 SG_ SGU17_Msg_CheckSum_Can03 : 7|8@0+ (1,0) [0|255] ""  ADC
 SG_ SGU17_Msg_AliveCounter_Can03 : 11|4@0+ (1,0) [0|14] ""  ADC
 SG_ SGU17_BlockCounter_Can03 : 15|4@0+ (1,0) [0|15] ""  ADC
 SG_ SGU17_Object_ID_Can03 : 23|8@0+ (1,0) [0|255] ""  ADC
 SG_ SGU17_Object_wExist_Can03 : 28|5@0+ (0.03125,0) [0|0.96875] ""  ADC
 SG_ SGU17_Object_Type_Can03 : 31|3@0+ (1,0) [0|7] ""  ADC
 SG_ SGU17_Object_MotionPattern_Can03 : 34|3@0+ (1,0) [0|7] ""  ADC
 SG_ SGU17_Object_wObstacle_Can03 : 39|5@0+ (0.03125,0) [0|0.96875] ""  ADC
 SG_ SGU17_Object_dx_Nearest_Can03 : 44|13@0+ (0.0625,-255) [-255|254.9375] "m"  ADC
 SG_ SGU17_Object_dy_Nearest_Can03 : 59|12@0+ (0.125,-128) [-128|127.875] "m"  ADC
 SG_ SGU17_Object_DistLong_rms_Can03 : 79|16@0+ (0.001953125,0) [0|127.998046875] "m"  ADC
 SG_ SGU17_Obj_DistLat_rms_Can03 : 95|16@0+ (0.001953125,0) [0|127.998046875] "m"  ADC
 SG_ SGU17_Object_vx_Can03 : 107|12@0+ (0.0625,-128) [-128|127.9375] "m/s"  ADC
 SG_ SGU17_Object_vy_Can03 : 123|12@0+ (0.0625,-128) [-128|127.9375] "m/s"  ADC
 SG_ SGU17_Obj_VrelLong_rms_Can03 : 143|16@0+ (0.001953125,0) [0|127.998046875] "m/s"  ADC
 SG_ SGU17_Obj_Vrelat_rms_Can03 : 159|16@0+ (0.001953125,0) [0|127.998046875] "m/s"  ADC
 SG_ SGU17_Object_DetStatus_Can03 : 173|3@0+ (1,0) [0|7] ""  ADC
 SG_ SGU17_Object_ax_Can03 : 170|11@0+ (0.03125,-16) [-16|15.96875] "m/s^2"  ADC
 SG_ SGU17_Object_ay_Can03 : 191|11@0+ (0.03125,-16) [-16|15.96875] "m/s^2"  ADC
 SG_ SGU17_LifeCycles_OBJ_Can03 : 196|8@0+ (1,0) [0|255] ""  ADC
 SG_ SGU17_ObjRCS_17_Can03 : 204|10@0+ (0.125,-50) [-50|70] "dBm2"  ADC
 SG_ SGU17_Object_dx_Rear_Can03 : 210|13@0+ (0.0625,-255) [-255|254.9375] "m"  ADC
 SG_ SGU17_Object_dy_Rear_Can03 : 229|12@0+ (0.125,-128) [-128|127.875] "m"  ADC

BO_ 531 FR_Obj_18: 32 FR
 SG_ SGU18_Msg_CheckSum_Can03 : 7|8@0+ (1,0) [0|255] ""  ADC
 SG_ SGU18_Msg_AliveCounter_Can03 : 11|4@0+ (1,0) [0|14] ""  ADC
 SG_ SGU18_BlockCounter_Can03 : 15|4@0+ (1,0) [0|15] ""  ADC
 SG_ SGU18_Object_ID_Can03 : 23|8@0+ (1,0) [0|255] ""  ADC
 SG_ SGU18_Object_wExist_Can03 : 28|5@0+ (0.03125,0) [0|0.96875] ""  ADC
 SG_ SGU18_Object_Type_Can03 : 31|3@0+ (1,0) [0|7] ""  ADC
 SG_ SGU18_Object_MotionPattern_Can03 : 34|3@0+ (1,0) [0|7] ""  ADC
 SG_ SGU18_Object_wObstacle_Can03 : 39|5@0+ (0.03125,0) [0|0.96875] ""  ADC
 SG_ SGU18_Object_dx_Nearest_Can03 : 44|13@0+ (0.0625,-255) [-255|254.9375] "m"  ADC
 SG_ SGU18_Object_dy_Nearest_Can03 : 59|12@0+ (0.125,-128) [-128|127.875] "m"  ADC
 SG_ SGU18_Object_DistLong_rms_Can03 : 79|16@0+ (0.001953125,0) [0|127.998046875] "m"  ADC
 SG_ SGU18_Obj_DistLat_rms_Can03 : 95|16@0+ (0.001953125,0) [0|127.998046875] "m"  ADC
 SG_ SGU18_Object_vx_Can03 : 107|12@0+ (0.0625,-128) [-128|127.9375] "m/s"  ADC
 SG_ SGU18_Object_vy_Can03 : 123|12@0+ (0.0625,-128) [-128|127.9375] "m/s"  ADC
 SG_ SGU18_Obj_VrelLong_rms_Can03 : 143|16@0+ (0.001953125,0) [0|127.998046875] "m/s"  ADC
 SG_ SGU18_Obj_Vrelat_rms_Can03 : 159|16@0+ (0.001953125,0) [0|127.998046875] "m/s"  ADC
 SG_ SGU18_Object_DetStatus_Can03 : 173|3@0+ (1,0) [0|7] ""  ADC
 SG_ SGU18_Object_ax_Can03 : 170|11@0+ (0.03125,-16) [-16|15.96875] "m/s^2"  ADC
 SG_ SGU18_Object_ay_Can03 : 191|11@0+ (0.03125,-16) [-16|15.96875] "m/s^2"  ADC
 SG_ SGU18_LifeCycles_OBJ_Can03 : 196|8@0+ (1,0) [0|255] ""  ADC
 SG_ SGU18_ObjRCS_18_Can03 : 204|10@0+ (0.125,-50) [-50|70] "dBm2"  ADC
 SG_ SGU18_Object_dx_Rear_Can03 : 210|13@0+ (0.0625,-255) [-255|254.9375] "m"  ADC
 SG_ SGU18_Object_dy_Rear_Can03 : 229|12@0+ (0.125,-128) [-128|127.875] "m"  ADC

BO_ 532 FR_Obj_19: 32 FR
 SG_ SGU19_Msg_CheckSum_Can03 : 7|8@0+ (1,0) [0|255] ""  ADC
 SG_ SGU19_Msg_AliveCounter_Can03 : 11|4@0+ (1,0) [0|14] ""  ADC
 SG_ SGU19_BlockCounter_Can03 : 15|4@0+ (1,0) [0|15] ""  ADC
 SG_ SGU19_Object_ID_Can03 : 23|8@0+ (1,0) [0|255] ""  ADC
 SG_ SGU19_Object_wExist_Can03 : 28|5@0+ (0.03125,0) [0|0.96875] ""  ADC
 SG_ SGU19_Object_Type_Can03 : 31|3@0+ (1,0) [0|7] ""  ADC
 SG_ SGU19_Object_MotionPattern_Can03 : 34|3@0+ (1,0) [0|7] ""  ADC
 SG_ SGU19_Object_wObstacle_Can03 : 39|5@0+ (0.03125,0) [0|0.96875] ""  ADC
 SG_ SGU19_Object_dx_Nearest_Can03 : 44|13@0+ (0.0625,-255) [-255|254.9375] "m"  ADC
 SG_ SGU19_Object_dy_Nearest_Can03 : 59|12@0+ (0.125,-128) [-128|127.875] "m"  ADC
 SG_ SGU19_Object_DistLong_rms_Can03 : 79|16@0+ (0.001953125,0) [0|127.998046875] "m"  ADC
 SG_ SGU19_Obj_DistLat_rms_Can03 : 95|16@0+ (0.001953125,0) [0|127.998046875] "m"  ADC
 SG_ SGU19_Object_vx_Can03 : 107|12@0+ (0.0625,-128) [-128|127.9375] "m/s"  ADC
 SG_ SGU19_Object_vy_Can03 : 123|12@0+ (0.0625,-128) [-128|127.9375] "m/s"  ADC
 SG_ SGU19_Obj_VrelLong_rms_Can03 : 143|16@0+ (0.001953125,0) [0|127.998046875] "m/s"  ADC
 SG_ SGU19_Obj_Vrelat_rms_Can03 : 159|16@0+ (0.001953125,0) [0|127.998046875] "m/s"  ADC
 SG_ SGU19_Object_DetStatus_Can03 : 173|3@0+ (1,0) [0|7] ""  ADC
 SG_ SGU19_Object_ax_Can03 : 170|11@0+ (0.03125,-16) [-16|15.96875] "m/s^2"  ADC
 SG_ SGU19_Object_ay_Can03 : 191|11@0+ (0.03125,-16) [-16|15.96875] "m/s^2"  ADC
 SG_ SGU19_LifeCycles_OBJ_Can03 : 196|8@0+ (1,0) [0|255] ""  ADC
 SG_ SGU19_ObjRCS_19_Can03 : 204|10@0+ (0.125,-50) [-50|70] "dBm2"  ADC
 SG_ SGU19_Object_dx_Rear_Can03 : 210|13@0+ (0.0625,-255) [-255|254.9375] "m"  ADC
 SG_ SGU19_Object_dy_Rear_Can03 : 229|12@0+ (0.125,-128) [-128|127.875] "m"  ADC

BO_ 533 FR_Obj_20: 32 FR
 SG_ SGU20_Msg_CheckSum_Can03 : 7|8@0+ (1,0) [0|255] ""  ADC
 SG_ SGU20_Msg_AliveCounter_Can03 : 11|4@0+ (1,0) [0|14] ""  ADC
 SG_ SGU20_BlockCounter_Can03 : 15|4@0+ (1,0) [0|15] ""  ADC
 SG_ SGU20_Object_ID_Can03 : 23|8@0+ (1,0) [0|255] ""  ADC
 SG_ SGU20_Object_wExist_Can03 : 28|5@0+ (0.03125,0) [0|0.96875] ""  ADC
 SG_ SGU20_Object_Type_Can03 : 31|3@0+ (1,0) [0|7] ""  ADC
 SG_ SGU20_Object_MotionPattern_Can03 : 34|3@0+ (1,0) [0|7] ""  ADC
 SG_ SGU20_Object_wObstacle_Can03 : 39|5@0+ (0.03125,0) [0|0.96875] ""  ADC
 SG_ SGU20_Object_dx_Nearest_Can03 : 44|13@0+ (0.0625,-255) [-255|254.9375] "m"  ADC
 SG_ SGU20_Object_dy_Nearest_Can03 : 59|12@0+ (0.125,-128) [-128|127.875] "m"  ADC
 SG_ SGU20_Object_DistLong_rms_Can03 : 79|16@0+ (0.001953125,0) [0|127.998046875] "m"  ADC
 SG_ SGU20_Obj_DistLat_rms_Can03 : 95|16@0+ (0.001953125,0) [0|127.998046875] "m"  ADC
 SG_ SGU20_Object_vx_Can03 : 107|12@0+ (0.0625,-128) [-128|127.9375] "m/s"  ADC
 SG_ SGU20_Object_vy_Can03 : 123|12@0+ (0.0625,-128) [-128|127.9375] "m/s"  ADC
 SG_ SGU20_Obj_VrelLong_rms_Can03 : 143|16@0+ (0.001953125,0) [0|127.998046875] "m/s"  ADC
 SG_ SGU20_Obj_Vrelat_rms_Can03 : 159|16@0+ (0.001953125,0) [0|127.998046875] "m/s"  ADC
 SG_ SGU20_Object_DetStatus_Can03 : 173|3@0+ (1,0) [0|7] ""  ADC
 SG_ SGU20_Object_ax_Can03 : 170|11@0+ (0.03125,-16) [-16|15.96875] "m/s^2"  ADC
 SG_ SGU20_Object_ay_Can03 : 191|11@0+ (0.03125,-16) [-16|15.96875] "m/s^2"  ADC
 SG_ SGU20_LifeCycles_OBJ_Can03 : 196|8@0+ (1,0) [0|255] ""  ADC
 SG_ SGU20_ObjRCS_20_Can03 : 204|10@0+ (0.125,-50) [-50|70] "dBm2"  ADC
 SG_ SGU20_Object_dx_Rear_Can03 : 210|13@0+ (0.0625,-255) [-255|254.9375] "m"  ADC
 SG_ SGU20_Object_dy_Rear_Can03 : 229|12@0+ (0.125,-128) [-128|127.875] "m"  ADC

BO_ 534 FR_Obj_21: 32 FR
 SG_ SGU21_Msg_CheckSum_Can03 : 7|8@0+ (1,0) [0|255] ""  ADC
 SG_ SGU21_Msg_AliveCounter_Can03 : 11|4@0+ (1,0) [0|14] ""  ADC
 SG_ SGU21_BlockCounter_Can03 : 15|4@0+ (1,0) [0|15] ""  ADC
 SG_ SGU21_Object_ID_Can03 : 23|8@0+ (1,0) [0|255] ""  ADC
 SG_ SGU21_Object_wExist_Can03 : 28|5@0+ (0.03125,0) [0|0.96875] ""  ADC
 SG_ SGU21_Object_Type_Can03 : 31|3@0+ (1,0) [0|7] ""  ADC
 SG_ SGU21_Object_MotionPattern_Can03 : 34|3@0+ (1,0) [0|7] ""  ADC
 SG_ SGU21_Object_wObstacle_Can03 : 39|5@0+ (0.03125,0) [0|0.96875] ""  ADC
 SG_ SGU21_Object_dx_Nearest_Can03 : 44|13@0+ (0.0625,-255) [-255|254.9375] "m"  ADC
 SG_ SGU21_Object_dy_Nearest_Can03 : 59|12@0+ (0.125,-128) [-128|127.875] "m"  ADC
 SG_ SGU21_Object_DistLong_rms_Can03 : 79|16@0+ (0.001953125,0) [0|127.998046875] "m"  ADC
 SG_ SGU21_Obj_DistLat_rms_Can03 : 95|16@0+ (0.001953125,0) [0|127.998046875] "m"  ADC
 SG_ SGU21_Object_vx_Can03 : 107|12@0+ (0.0625,-128) [-128|127.9375] "m/s"  ADC
 SG_ SGU21_Object_vy_Can03 : 123|12@0+ (0.0625,-128) [-128|127.9375] "m/s"  ADC
 SG_ SGU21_Obj_VrelLong_rms_Can03 : 143|16@0+ (0.001953125,0) [0|127.998046875] "m/s"  ADC
 SG_ SGU21_Obj_Vrelat_rms_Can03 : 159|16@0+ (0.001953125,0) [0|127.998046875] "m/s"  ADC
 SG_ SGU21_Object_DetStatus_Can03 : 173|3@0+ (1,0) [0|7] ""  ADC
 SG_ SGU21_Object_ax_Can03 : 170|11@0+ (0.03125,-16) [-16|15.96875] "m/s^2"  ADC
 SG_ SGU21_Object_ay_Can03 : 191|11@0+ (0.03125,-16) [-16|15.96875] "m/s^2"  ADC
 SG_ SGU21_LifeCycles_OBJ_Can03 : 196|8@0+ (1,0) [0|255] ""  ADC
 SG_ SGU21_ObjRCS_21_Can03 : 204|10@0+ (0.125,-50) [-50|70] "dBm2"  ADC
 SG_ SGU21_Object_dx_Rear_Can03 : 210|13@0+ (0.0625,-255) [-255|254.9375] "m"  ADC
 SG_ SGU21_Object_dy_Rear_Can03 : 229|12@0+ (0.125,-128) [-128|127.875] "m"  ADC

BO_ 535 FR_Obj_22: 32 FR
 SG_ SGU22_Msg_CheckSum_Can03 : 7|8@0+ (1,0) [0|255] ""  ADC
 SG_ SGU22_Msg_AliveCounter_Can03 : 11|4@0+ (1,0) [0|14] ""  ADC
 SG_ SGU22_BlockCounter_Can03 : 15|4@0+ (1,0) [0|15] ""  ADC
 SG_ SGU22_Object_ID_Can03 : 23|8@0+ (1,0) [0|255] ""  ADC
 SG_ SGU22_Object_wExist_Can03 : 28|5@0+ (0.03125,0) [0|0.96875] ""  ADC
 SG_ SGU22_Object_Type_Can03 : 31|3@0+ (1,0) [0|7] ""  ADC
 SG_ SGU22_Object_MotionPattern_Can03 : 34|3@0+ (1,0) [0|7] ""  ADC
 SG_ SGU22_Object_wObstacle_Can03 : 39|5@0+ (0.03125,0) [0|0.96875] ""  ADC
 SG_ SGU22_Object_dx_Nearest_Can03 : 44|13@0+ (0.0625,-255) [-255|254.9375] "m"  ADC
 SG_ SGU22_Object_dy_Nearest_Can03 : 59|12@0+ (0.125,-128) [-128|127.875] "m"  ADC
 SG_ SGU22_Object_DistLong_rms_Can03 : 79|16@0+ (0.001953125,0) [0|127.998046875] "m"  ADC
 SG_ SGU22_Obj_DistLat_rms_Can03 : 95|16@0+ (0.001953125,0) [0|127.998046875] "m"  ADC
 SG_ SGU22_Object_vx_Can03 : 107|12@0+ (0.0625,-128) [-128|127.9375] "m/s"  ADC
 SG_ SGU22_Object_vy_Can03 : 123|12@0+ (0.0625,-128) [-128|127.9375] "m/s"  ADC
 SG_ SGU22_Obj_VrelLong_rms_Can03 : 143|16@0+ (0.001953125,0) [0|127.998046875] "m/s"  ADC
 SG_ SGU22_Obj_Vrelat_rms_Can03 : 159|16@0+ (0.001953125,0) [0|127.998046875] "m/s"  ADC
 SG_ SGU22_Object_DetStatus_Can03 : 173|3@0+ (1,0) [0|7] ""  ADC
 SG_ SGU22_Object_ax_Can03 : 170|11@0+ (0.03125,-16) [-16|15.96875] "m/s^2"  ADC
 SG_ SGU22_Object_ay_Can03 : 191|11@0+ (0.03125,-16) [-16|15.96875] "m/s^2"  ADC
 SG_ SGU22_LifeCycles_OBJ_Can03 : 196|8@0+ (1,0) [0|255] ""  ADC
 SG_ SGU22_ObjRCS_22_Can03 : 204|10@0+ (0.125,-50) [-50|70] "dBm2"  ADC
 SG_ SGU22_Object_dx_Rear_Can03 : 210|13@0+ (0.0625,-255) [-255|254.9375] "m"  ADC
 SG_ SGU22_Object_dy_Rear_Can03 : 229|12@0+ (0.125,-128) [-128|127.875] "m"  ADC

BO_ 536 FR_Obj_23: 32 FR
 SG_ SGU23_Msg_CheckSum_Can03 : 7|8@0+ (1,0) [0|255] ""  ADC
 SG_ SGU23_Msg_AliveCounter_Can03 : 11|4@0+ (1,0) [0|14] ""  ADC
 SG_ SGU23_BlockCounter_Can03 : 15|4@0+ (1,0) [0|15] ""  ADC
 SG_ SGU23_Object_ID_Can03 : 23|8@0+ (1,0) [0|255] ""  ADC
 SG_ SGU23_Object_wExist_Can03 : 28|5@0+ (0.03125,0) [0|0.96875] ""  ADC
 SG_ SGU23_Object_Type_Can03 : 31|3@0+ (1,0) [0|7] ""  ADC
 SG_ SGU23_Object_MotionPattern_Can03 : 34|3@0+ (1,0) [0|7] ""  ADC
 SG_ SGU23_Object_wObstacle_Can03 : 39|5@0+ (0.03125,0) [0|0.96875] ""  ADC
 SG_ SGU23_Object_dx_Nearest_Can03 : 44|13@0+ (0.0625,-255) [-255|254.9375] "m"  ADC
 SG_ SGU23_Object_dy_Nearest_Can03 : 59|12@0+ (0.125,-128) [-128|127.875] "m"  ADC
 SG_ SGU23_Object_DistLong_rms_Can03 : 79|16@0+ (0.001953125,0) [0|127.998046875] "m"  ADC
 SG_ SGU23_Obj_DistLat_rms_Can03 : 95|16@0+ (0.001953125,0) [0|127.998046875] "m"  ADC
 SG_ SGU23_Object_vx_Can03 : 107|12@0+ (0.0625,-128) [-128|127.9375] "m/s"  ADC
 SG_ SGU23_Object_vy_Can03 : 123|12@0+ (0.0625,-128) [-128|127.9375] "m/s"  ADC
 SG_ SGU23_Obj_VrelLong_rms_Can03 : 143|16@0+ (0.001953125,0) [0|127.998046875] "m/s"  ADC
 SG_ SGU23_Obj_Vrelat_rms_Can03 : 159|16@0+ (0.001953125,0) [0|127.998046875] "m/s"  ADC
 SG_ SGU23_Object_DetStatus_Can03 : 173|3@0+ (1,0) [0|7] ""  ADC
 SG_ SGU23_Object_ax_Can03 : 170|11@0+ (0.03125,-16) [-16|15.96875] "m/s^2"  ADC
 SG_ SGU23_Object_ay_Can03 : 191|11@0+ (0.03125,-16) [-16|15.96875] "m/s^2"  ADC
 SG_ SGU23_LifeCycles_OBJ_Can03 : 196|8@0+ (1,0) [0|255] ""  ADC
 SG_ SGU23_ObjRCS_23_Can03 : 204|10@0+ (0.125,-50) [-50|70] "dBm2"  ADC
 SG_ SGU23_Object_dx_Rear_Can03 : 210|13@0+ (0.0625,-255) [-255|254.9375] "m"  ADC
 SG_ SGU23_Object_dy_Rear_Can03 : 229|12@0+ (0.125,-128) [-128|127.875] "m"  ADC

CM_ SG_ 524 SGU11_Msg_CheckSum_Can03 "E2E Profile Variant 1A CRC";
CM_ SG_ 524 SGU11_Msg_AliveCounter_Can03 "E2E Profile Variant 1A Counter";
CM_ SG_ 524 SGU11_BlockCounter_Can03 "Block counter for every messages";
CM_ SG_ 524 SGU11_Object_ID_Can03 "ID is an identifier number that allows for tracking of persistent objects over time";
CM_ SG_ 524 SGU11_Object_wExist_Can03 "Existence probability of the object";
CM_ SG_ 524 SGU11_Object_Type_Can03 "To indicate the estimated type of Object";
CM_ SG_ 524 SGU11_Object_MotionPattern_Can03 "Motion type of object";
CM_ SG_ 524 SGU11_Object_wObstacle_Can03 "The probability of an object being an obstacle";
CM_ SG_ 524 SGU11_Object_dx_Nearest_Can03 "Position of target object in x-direction [m]";
CM_ SG_ 524 SGU11_Object_dy_Nearest_Can03 "Nearest position of target object in y-direction [m]";
CM_ SG_ 524 SGU11_Object_DistLong_rms_Can03 "Standard deviation of longitudinal distance";
CM_ SG_ 524 SGU11_Obj_DistLat_rms_Can03 "Standard deviation of lateral distance";
CM_ SG_ 524 SGU11_Object_vx_Can03 "Relative target object velocity in x-direction [m/s]";
CM_ SG_ 524 SGU11_Object_vy_Can03 "Relative target object velocity in y-direction [m/s]";
CM_ SG_ 524 SGU11_Obj_VrelLong_rms_Can03 "Standard deviation of longitudinal relative velocity";
CM_ SG_ 524 SGU11_Obj_Vrelat_rms_Can03 "Standard deviation of lateral relative velocity";
CM_ SG_ 524 SGU11_Object_DetStatus_Can03 "Detection Staus Of Object";
CM_ SG_ 524 SGU11_Object_ax_Can03 "Relative target object acceleration in x-direction, in the vehicle coordinatesystem";
CM_ SG_ 524 SGU11_Object_ay_Can03 "Relative target object acceleration in y-direction, in the vehicle coordinate system";
CM_ SG_ 524 SGU11_LifeCycles_OBJ_Can03 "-";
CM_ SG_ 524 SGU11_ObjRCS_11_Can03 "Radar Cross Section (RCS) estimation";
CM_ SG_ 524 SGU11_Object_dx_Rear_Can03 "Position of target object rear bumper in x-direction [m]";
CM_ SG_ 524 SGU11_Object_dy_Rear_Can03 "Position of target object rear bumper in y-direction [m]";
CM_ SG_ 525 SGU12_Msg_CheckSum_Can03 "E2E Profile Variant 1A CRC";
CM_ SG_ 525 SGU12_Msg_AliveCounter_Can03 "E2E Profile Variant 1A Counter";
CM_ SG_ 525 SGU12_BlockCounter_Can03 "Block counter for every messages";
CM_ SG_ 525 SGU12_Object_ID_Can03 "ID is an identifier number that allows for tracking of persistent objects over time";
CM_ SG_ 525 SGU12_Object_wExist_Can03 "Existence probability of the object";
CM_ SG_ 525 SGU12_Object_Type_Can03 "To indicate the estimated type of Object";
CM_ SG_ 525 SGU12_Object_MotionPattern_Can03 "Motion type of object";
CM_ SG_ 525 SGU12_Object_wObstacle_Can03 "The probability of an object being an obstacle";
CM_ SG_ 525 SGU12_Object_dx_Nearest_Can03 "Position of target object in x-direction [m]";
CM_ SG_ 525 SGU12_Object_dy_Nearest_Can03 "Nearest position of target object in y-direction [m]";
CM_ SG_ 525 SGU12_Object_DistLong_rms_Can03 "Standard deviation of longitudinal distance";
CM_ SG_ 525 SGU12_Obj_DistLat_rms_Can03 "Standard deviation of lateral distance";
CM_ SG_ 525 SGU12_Object_vx_Can03 "Relative target object velocity in x-direction [m/s]";
CM_ SG_ 525 SGU12_Object_vy_Can03 "Relative target object velocity in y-direction [m/s]";
CM_ SG_ 525 SGU12_Obj_VrelLong_rms_Can03 "Standard deviation of longitudinal relative velocity";
CM_ SG_ 525 SGU12_Obj_Vrelat_rms_Can03 "Standard deviation of lateral relative velocity";
CM_ SG_ 525 SGU12_Object_DetStatus_Can03 "Detection Staus Of Object";
CM_ SG_ 525 SGU12_Object_ax_Can03 "Relative target object acceleration in x-direction, in the vehicle coordinatesystem";
CM_ SG_ 525 SGU12_Object_ay_Can03 "Relative target object acceleration in y-direction, in the vehicle coordinate system";
CM_ SG_ 525 SGU12_LifeCycles_OBJ_Can03 "-";
CM_ SG_ 525 SGU12_ObjRCS_12_Can03 "Radar Cross Section (RCS) estimation";
CM_ SG_ 525 SGU12_Object_dx_Rear_Can03 "Position of target object rear bumper in x-direction [m]";
CM_ SG_ 525 SGU12_Object_dy_Rear_Can03 "Position of target object rear bumper in y-direction [m]";
CM_ SG_ 526 SGU13_Msg_CheckSum_Can03 "E2E Profile Variant 1A CRC";
CM_ SG_ 526 SGU13_Msg_AliveCounter_Can03 "E2E Profile Variant 1A Counter";
CM_ SG_ 526 SGU13_BlockCounter_Can03 "Block counter for every messages";
CM_ SG_ 526 SGU13_Object_ID_Can03 "ID is an identifier number that allows for tracking of persistent objects over time";
CM_ SG_ 526 SGU13_Object_wExist_Can03 "Existence probability of the object";
CM_ SG_ 526 SGU13_Object_Type_Can03 "To indicate the estimated type of Object";
CM_ SG_ 526 SGU13_Object_MotionPattern_Can03 "Motion type of object";
CM_ SG_ 526 SGU13_Object_wObstacle_Can03 "The probability of an object being an obstacle";
CM_ SG_ 526 SGU13_Object_dx_Nearest_Can03 "Position of target object in x-direction [m]";
CM_ SG_ 526 SGU13_Object_dy_Nearest_Can03 "Nearest position of target object in y-direction [m]";
CM_ SG_ 526 SGU13_Object_DistLong_rms_Can03 "Standard deviation of longitudinal distance";
CM_ SG_ 526 SGU13_Obj_DistLat_rms_Can03 "Standard deviation of lateral distance";
CM_ SG_ 526 SGU13_Object_vx_Can03 "Relative target object velocity in x-direction [m/s]";
CM_ SG_ 526 SGU13_Object_vy_Can03 "Relative target object velocity in y-direction [m/s]";
CM_ SG_ 526 SGU13_Obj_VrelLong_rms_Can03 "Standard deviation of longitudinal relative velocity";
CM_ SG_ 526 SGU13_Obj_Vrelat_rms_Can03 "Standard deviation of lateral relative velocity";
CM_ SG_ 526 SGU13_Object_DetStatus_Can03 "Detection Staus Of Object";
CM_ SG_ 526 SGU13_Object_ax_Can03 "Relative target object acceleration in x-direction, in the vehicle coordinatesystem";
CM_ SG_ 526 SGU13_Object_ay_Can03 "Relative target object acceleration in y-direction, in the vehicle coordinate system";
CM_ SG_ 526 SGU13_LifeCycles_OBJ_Can03 "-";
CM_ SG_ 526 SGU13_ObjRCS_13_Can03 "Radar Cross Section (RCS) estimation";
CM_ SG_ 526 SGU13_Object_dx_Rear_Can03 "Position of target object rear bumper in x-direction [m]";
CM_ SG_ 526 SGU13_Object_dy_Rear_Can03 "Position of target object rear bumper in y-direction [m]";
CM_ SG_ 527 SGU14_Msg_CheckSum_Can03 "E2E Profile Variant 1A CRC";
CM_ SG_ 527 SGU14_Msg_AliveCounter_Can03 "E2E Profile Variant 1A Counter";
CM_ SG_ 527 SGU14_BlockCounter_Can03 "Block counter for every messages";
CM_ SG_ 527 SGU14_Object_ID_Can03 "ID is an identifier number that allows for tracking of persistent objects over time";
CM_ SG_ 527 SGU14_Object_wExist_Can03 "Existence probability of the object";
CM_ SG_ 527 SGU14_Object_Type_Can03 "To indicate the estimated type of Object";
CM_ SG_ 527 SGU14_Object_MotionPattern_Can03 "Motion type of object";
CM_ SG_ 527 SGU14_Object_wObstacle_Can03 "The probability of an object being an obstacle";
CM_ SG_ 527 SGU14_Object_dx_Nearest_Can03 "Position of target object in x-direction [m]";
CM_ SG_ 527 SGU14_Object_dy_Nearest_Can03 "Nearest position of target object in y-direction [m]";
CM_ SG_ 527 SGU14_Object_DistLong_rms_Can03 "Standard deviation of longitudinal distance";
CM_ SG_ 527 SGU14_Obj_DistLat_rms_Can03 "Standard deviation of lateral distance";
CM_ SG_ 527 SGU14_Object_vx_Can03 "Relative target object velocity in x-direction [m/s]";
CM_ SG_ 527 SGU14_Object_vy_Can03 "Relative target object velocity in y-direction [m/s]";
CM_ SG_ 527 SGU14_Obj_VrelLong_rms_Can03 "Standard deviation of longitudinal relative velocity";
CM_ SG_ 527 SGU14_Obj_Vrelat_rms_Can03 "Standard deviation of lateral relative velocity";
CM_ SG_ 527 SGU14_Object_DetStatus_Can03 "Detection Staus Of Object";
CM_ SG_ 527 SGU14_Object_ax_Can03 "Relative target object acceleration in x-direction, in the vehicle coordinatesystem";
CM_ SG_ 527 SGU14_Object_ay_Can03 "Relative target object acceleration in y-direction, in the vehicle coordinate system";
CM_ SG_ 527 SGU14_LifeCycles_OBJ_Can03 "-";
CM_ SG_ 527 SGU14_ObjRCS_14_Can03 "Radar Cross Section (RCS) estimation";
CM_ SG_ 527 SGU14_Object_dx_Rear_Can03 "Position of target object rear bumper in x-direction [m]";
CM_ SG_ 527 SGU14_Object_dy_Rear_Can03 "Position of target object rear bumper in y-direction [m]";
CM_ SG_ 528 SGU15_Msg_CheckSum_Can03 "E2E Profile Variant 1A CRC";
CM_ SG_ 528 SGU15_Msg_AliveCounter_Can03 "E2E Profile Variant 1A Counter";
CM_ SG_ 528 SGU15_BlockCounter_Can03 "Block counter for every messages";
CM_ SG_ 528 SGU15_Object_ID_Can03 "ID is an identifier number that allows for tracking of persistent objects over time";
CM_ SG_ 528 SGU15_Object_wExist_Can03 "Existence probability of the object";
CM_ SG_ 528 SGU15_Object_Type_Can03 "To indicate the estimated type of Object";
CM_ SG_ 528 SGU15_Object_MotionPattern_Can03 "Motion type of object";
CM_ SG_ 528 SGU15_Object_wObstacle_Can03 "The probability of an object being an obstacle";
CM_ SG_ 528 SGU15_Object_dx_Nearest_Can03 "Position of target object in x-direction [m]";
CM_ SG_ 528 SGU15_Object_dy_Nearest_Can03 "Nearest position of target object in y-direction [m]";
CM_ SG_ 528 SGU15_Object_DistLong_rms_Can03 "Standard deviation of longitudinal distance";
CM_ SG_ 528 SGU15_Obj_DistLat_rms_Can03 "Standard deviation of lateral distance";
CM_ SG_ 528 SGU15_Object_vx_Can03 "Relative target object velocity in x-direction [m/s]";
CM_ SG_ 528 SGU15_Object_vy_Can03 "Relative target object velocity in y-direction [m/s]";
CM_ SG_ 528 SGU15_Obj_VrelLong_rms_Can03 "Standard deviation of longitudinal relative velocity";
CM_ SG_ 528 SGU15_Obj_Vrelat_rms_Can03 "Standard deviation of lateral relative velocity";
CM_ SG_ 528 SGU15_Object_DetStatus_Can03 "Detection Staus Of Object";
CM_ SG_ 528 SGU15_Object_ax_Can03 "Relative target object acceleration in x-direction, in the vehicle coordinatesystem";
CM_ SG_ 528 SGU15_Object_ay_Can03 "Relative target object acceleration in y-direction, in the vehicle coordinate system";
CM_ SG_ 528 SGU15_LifeCycles_OBJ_Can03 "-";
CM_ SG_ 528 SGU15_ObjRCS_15_Can03 "Radar Cross Section (RCS) estimation";
CM_ SG_ 528 SGU15_Object_dx_Rear_Can03 "Position of target object rear bumper in x-direction [m]";
CM_ SG_ 528 SGU15_Object_dy_Rear_Can03 "Position of target object rear bumper in y-direction [m]";
CM_ SG_ 529 SGU16_Msg_CheckSum_Can03 "E2E Profile Variant 1A CRC";
CM_ SG_ 529 SGU16_Msg_AliveCounter_Can03 "E2E Profile Variant 1A Counter";
CM_ SG_ 529 SGU16_BlockCounter_Can03 "Block counter for every messages";
CM_ SG_ 529 SGU16_Object_ID_Can03 "ID is an identifier number that allows for tracking of persistent objects over time";
CM_ SG_ 529 SGU16_Object_wExist_Can03 "Existence probability of the object";
CM_ SG_ 529 SGU16_Object_Type_Can03 "To indicate the estimated type of Object";
CM_ SG_ 529 SGU16_Object_MotionPattern_Can03 "Motion type of object";
CM_ SG_ 529 SGU16_Object_wObstacle_Can03 "The probability of an object being an obstacle";
CM_ SG_ 529 SGU16_Object_dx_Nearest_Can03 "Position of target object in x-direction [m]";
CM_ SG_ 529 SGU16_Object_dy_Nearest_Can03 "Nearest position of target object in y-direction [m]";
CM_ SG_ 529 SGU16_Object_DistLong_rms_Can03 "Standard deviation of longitudinal distance";
CM_ SG_ 529 SGU16_Obj_DistLat_rms_Can03 "Standard deviation of lateral distance";
CM_ SG_ 529 SGU16_Object_vx_Can03 "Relative target object velocity in x-direction [m/s]";
CM_ SG_ 529 SGU16_Object_vy_Can03 "Relative target object velocity in y-direction [m/s]";
CM_ SG_ 529 SGU16_Obj_VrelLong_rms_Can03 "Standard deviation of longitudinal relative velocity";
CM_ SG_ 529 SGU16_Obj_Vrelat_rms_Can03 "Standard deviation of lateral relative velocity";
CM_ SG_ 529 SGU16_Object_DetStatus_Can03 "Detection Staus Of Object";
CM_ SG_ 529 SGU16_Object_ax_Can03 "Relative target object acceleration in x-direction, in the vehicle coordinatesystem";
CM_ SG_ 529 SGU16_Object_ay_Can03 "Relative target object acceleration in y-direction, in the vehicle coordinate system";
CM_ SG_ 529 SGU16_LifeCycles_OBJ_Can03 "-";
CM_ SG_ 529 SGU16_ObjRCS_16_Can03 "Radar Cross Section (RCS) estimation";
CM_ SG_ 529 SGU16_Object_dx_Rear_Can03 "Position of target object rear bumper in x-direction [m]";
CM_ SG_ 529 SGU16_Object_dy_Rear_Can03 "Position of target object rear bumper in y-direction [m]";
CM_ SG_ 530 SGU17_Msg_CheckSum_Can03 "E2E Profile Variant 1A CRC";
CM_ SG_ 530 SGU17_Msg_AliveCounter_Can03 "E2E Profile Variant 1A Counter";
CM_ SG_ 530 SGU17_BlockCounter_Can03 "Block counter for every messages";
CM_ SG_ 530 SGU17_Object_ID_Can03 "ID is an identifier number that allows for tracking of persistent objects over time";
CM_ SG_ 530 SGU17_Object_wExist_Can03 "Existence probability of the object";
CM_ SG_ 530 SGU17_Object_Type_Can03 "To indicate the estimated type of Object";
CM_ SG_ 530 SGU17_Object_MotionPattern_Can03 "Motion type of object";
CM_ SG_ 530 SGU17_Object_wObstacle_Can03 "The probability of an object being an obstacle";
CM_ SG_ 530 SGU17_Object_dx_Nearest_Can03 "Position of target object in x-direction [m]";
CM_ SG_ 530 SGU17_Object_dy_Nearest_Can03 "Nearest position of target object in y-direction [m]";
CM_ SG_ 530 SGU17_Object_DistLong_rms_Can03 "Standard deviation of longitudinal distance";
CM_ SG_ 530 SGU17_Obj_DistLat_rms_Can03 "Standard deviation of lateral distance";
CM_ SG_ 530 SGU17_Object_vx_Can03 "Relative target object velocity in x-direction [m/s]";
CM_ SG_ 530 SGU17_Object_vy_Can03 "Relative target object velocity in y-direction [m/s]";
CM_ SG_ 530 SGU17_Obj_VrelLong_rms_Can03 "Standard deviation of longitudinal relative velocity";
CM_ SG_ 530 SGU17_Obj_Vrelat_rms_Can03 "Standard deviation of lateral relative velocity";
CM_ SG_ 530 SGU17_Object_DetStatus_Can03 "Detection Staus Of Object";
CM_ SG_ 530 SGU17_Object_ax_Can03 "Relative target object acceleration in x-direction, in the vehicle coordinatesystem";
CM_ SG_ 530 SGU17_Object_ay_Can03 "Relative target object acceleration in y-direction, in the vehicle coordinate system";
CM_ SG_ 530 SGU17_LifeCycles_OBJ_Can03 "-";
CM_ SG_ 530 SGU17_ObjRCS_17_Can03 "Radar Cross Section (RCS) estimation";
CM_ SG_ 530 SGU17_Object_dx_Rear_Can03 "Position of target object rear bumper in x-direction [m]";
CM_ SG_ 530 SGU17_Object_dy_Rear_Can03 "Position of target object rear bumper in y-direction [m]";
CM_ SG_ 531 SGU18_Msg_CheckSum_Can03 "E2E Profile Variant 1A CRC";
CM_ SG_ 531 SGU18_Msg_AliveCounter_Can03 "E2E Profile Variant 1A Counter";
CM_ SG_ 531 SGU18_BlockCounter_Can03 "Block counter for every messages";
CM_ SG_ 531 SGU18_Object_ID_Can03 "ID is an identifier number that allows for tracking of persistent objects over time";
CM_ SG_ 531 SGU18_Object_wExist_Can03 "Existence probability of the object";
CM_ SG_ 531 SGU18_Object_Type_Can03 "To indicate the estimated type of Object";
CM_ SG_ 531 SGU18_Object_MotionPattern_Can03 "Motion type of object";
CM_ SG_ 531 SGU18_Object_wObstacle_Can03 "The probability of an object being an obstacle";
CM_ SG_ 531 SGU18_Object_dx_Nearest_Can03 "Position of target object in x-direction [m]";
CM_ SG_ 531 SGU18_Object_dy_Nearest_Can03 "Nearest position of target object in y-direction [m]";
CM_ SG_ 531 SGU18_Object_DistLong_rms_Can03 "Standard deviation of longitudinal distance";
CM_ SG_ 531 SGU18_Obj_DistLat_rms_Can03 "Standard deviation of lateral distance";
CM_ SG_ 531 SGU18_Object_vx_Can03 "Relative target object velocity in x-direction [m/s]";
CM_ SG_ 531 SGU18_Object_vy_Can03 "Relative target object velocity in y-direction [m/s]";
CM_ SG_ 531 SGU18_Obj_VrelLong_rms_Can03 "Standard deviation of longitudinal relative velocity";
CM_ SG_ 531 SGU18_Obj_Vrelat_rms_Can03 "Standard deviation of lateral relative velocity";
CM_ SG_ 531 SGU18_Object_DetStatus_Can03 "Detection Staus Of Object";
CM_ SG_ 531 SGU18_Object_ax_Can03 "Relative target object acceleration in x-direction, in the vehicle coordinatesystem";
CM_ SG_ 531 SGU18_Object_ay_Can03 "Relative target object acceleration in y-direction, in the vehicle coordinate system";
CM_ SG_ 531 SGU18_LifeCycles_OBJ_Can03 "-";
CM_ SG_ 531 SGU18_ObjRCS_18_Can03 "Radar Cross Section (RCS) estimation";
CM_ SG_ 531 SGU18_Object_dx_Rear_Can03 "Position of target object rear bumper in x-direction [m]";
CM_ SG_ 531 SGU18_Object_dy_Rear_Can03 "Position of target object rear bumper in y-direction [m]";
CM_ SG_ 532 SGU19_Msg_CheckSum_Can03 "E2E Profile Variant 1A CRC";
CM_ SG_ 532 SGU19_Msg_AliveCounter_Can03 "E2E Profile Variant 1A Counter";
CM_ SG_ 532 SGU19_BlockCounter_Can03 "Block counter for every messages";
CM_ SG_ 532 SGU19_Object_ID_Can03 "ID is an identifier number that allows for tracking of persistent objects over time";
CM_ SG_ 532 SGU19_Object_wExist_Can03 "Existence probability of the object";
CM_ SG_ 532 SGU19_Object_Type_Can03 "To indicate the estimated type of Object";
CM_ SG_ 532 SGU19_Object_MotionPattern_Can03 "Motion type of object";
CM_ SG_ 532 SGU19_Object_wObstacle_Can03 "The probability of an object being an obstacle";
CM_ SG_ 532 SGU19_Object_dx_Nearest_Can03 "Position of target object in x-direction [m]";
CM_ SG_ 532 SGU19_Object_dy_Nearest_Can03 "Nearest position of target object in y-direction [m]";
CM_ SG_ 532 SGU19_Object_DistLong_rms_Can03 "Standard deviation of longitudinal distance";
CM_ SG_ 532 SGU19_Obj_DistLat_rms_Can03 "Standard deviation of lateral distance";
CM_ SG_ 532 SGU19_Object_vx_Can03 "Relative target object velocity in x-direction [m/s]";
CM_ SG_ 532 SGU19_Object_vy_Can03 "Relative target object velocity in y-direction [m/s]";
CM_ SG_ 532 SGU19_Obj_VrelLong_rms_Can03 "Standard deviation of longitudinal relative velocity";
CM_ SG_ 532 SGU19_Obj_Vrelat_rms_Can03 "Standard deviation of lateral relative velocity";
CM_ SG_ 532 SGU19_Object_DetStatus_Can03 "Detection Staus Of Object";
CM_ SG_ 532 SGU19_Object_ax_Can03 "Relative target object acceleration in x-direction, in the vehicle coordinatesystem";
CM_ SG_ 532 SGU19_Object_ay_Can03 "Relative target object acceleration in y-direction, in the vehicle coordinate system";
CM_ SG_ 532 SGU19_LifeCycles_OBJ_Can03 "-";
CM_ SG_ 532 SGU19_ObjRCS_19_Can03 "Radar Cross Section (RCS) estimation";
CM_ SG_ 532 SGU19_Object_dx_Rear_Can03 "Position of target object rear bumper in x-direction [m]";
CM_ SG_ 532 SGU19_Object_dy_Rear_Can03 "Position of target object rear bumper in y-direction [m]";
CM_ SG_ 533 SGU20_Msg_CheckSum_Can03 "E2E Profile Variant 1A CRC";
CM_ SG_ 533 SGU20_Msg_AliveCounter_Can03 "E2E Profile Variant 1A Counter";
CM_ SG_ 533 SGU20_BlockCounter_Can03 "Block counter for every messages";
CM_ SG_ 533 SGU20_Object_ID_Can03 "ID is an identifier number that allows for tracking of persistent objects over time";
CM_ SG_ 533 SGU20_Object_wExist_Can03 "Existence probability of the object";
CM_ SG_ 533 SGU20_Object_Type_Can03 "To indicate the estimated type of Object";
CM_ SG_ 533 SGU20_Object_MotionPattern_Can03 "Motion type of object";
CM_ SG_ 533 SGU20_Object_wObstacle_Can03 "The probability of an object being an obstacle";
CM_ SG_ 533 SGU20_Object_dx_Nearest_Can03 "Position of target object in x-direction [m]";
CM_ SG_ 533 SGU20_Object_dy_Nearest_Can03 "Nearest position of target object in y-direction [m]";
CM_ SG_ 533 SGU20_Object_DistLong_rms_Can03 "Standard deviation of longitudinal distance";
CM_ SG_ 533 SGU20_Obj_DistLat_rms_Can03 "Standard deviation of lateral distance";
CM_ SG_ 533 SGU20_Object_vx_Can03 "Relative target object velocity in x-direction [m/s]";
CM_ SG_ 533 SGU20_Object_vy_Can03 "Relative target object velocity in y-direction [m/s]";
CM_ SG_ 533 SGU20_Obj_VrelLong_rms_Can03 "Standard deviation of longitudinal relative velocity";
CM_ SG_ 533 SGU20_Obj_Vrelat_rms_Can03 "Standard deviation of lateral relative velocity";
CM_ SG_ 533 SGU20_Object_DetStatus_Can03 "Detection Staus Of Object";
CM_ SG_ 533 SGU20_Object_ax_Can03 "Relative target object acceleration in x-direction, in the vehicle coordinatesystem";
CM_ SG_ 533 SGU20_Object_ay_Can03 "Relative target object acceleration in y-direction, in the vehicle coordinate system";
CM_ SG_ 533 SGU20_LifeCycles_OBJ_Can03 "-";
CM_ SG_ 533 SGU20_ObjRCS_20_Can03 "Radar Cross Section (RCS) estimation";
CM_ SG_ 533 SGU20_Object_dx_Rear_Can03 "Position of target object rear bumper in x-direction [m]";
CM_ SG_ 533 SGU20_Object_dy_Rear_Can03 "Position of target object rear bumper in y-direction [m]";
CM_ SG_ 534 SGU21_Msg_CheckSum_Can03 "E2E Profile Variant 1A CRC";
CM_ SG_ 534 SGU21_Msg_AliveCounter_Can03 "E2E Profile Variant 1A Counter";
CM_ SG_ 534 SGU21_BlockCounter_Can03 "Block counter for every messages";
CM_ SG_ 534 SGU21_Object_ID_Can03 "ID is an identifier number that allows for tracking of persistent objects over time";
CM_ SG_ 534 SGU21_Object_wExist_Can03 "Existence probability of the object";
CM_ SG_ 534 SGU21_Object_Type_Can03 "To indicate the estimated type of Object";
CM_ SG_ 534 SGU21_Object_MotionPattern_Can03 "Motion type of object";
CM_ SG_ 534 SGU21_Object_wObstacle_Can03 "The probability of an object being an obstacle";
CM_ SG_ 534 SGU21_Object_dx_Nearest_Can03 "Position of target object in x-direction [m]";
CM_ SG_ 534 SGU21_Object_dy_Nearest_Can03 "Nearest position of target object in y-direction [m]";
CM_ SG_ 534 SGU21_Object_DistLong_rms_Can03 "Standard deviation of longitudinal distance";
CM_ SG_ 534 SGU21_Obj_DistLat_rms_Can03 "Standard deviation of lateral distance";
CM_ SG_ 534 SGU21_Object_vx_Can03 "Relative target object velocity in x-direction [m/s]";
CM_ SG_ 534 SGU21_Object_vy_Can03 "Relative target object velocity in y-direction [m/s]";
CM_ SG_ 534 SGU21_Obj_VrelLong_rms_Can03 "Standard deviation of longitudinal relative velocity";
CM_ SG_ 534 SGU21_Obj_Vrelat_rms_Can03 "Standard deviation of lateral relative velocity";
CM_ SG_ 534 SGU21_Object_DetStatus_Can03 "Detection Staus Of Object";
CM_ SG_ 534 SGU21_Object_ax_Can03 "Relative target object acceleration in x-direction, in the vehicle coordinatesystem";
CM_ SG_ 534 SGU21_Object_ay_Can03 "Relative target object acceleration in y-direction, in the vehicle coordinate system";
CM_ SG_ 534 SGU21_LifeCycles_OBJ_Can03 "-";
CM_ SG_ 534 SGU21_ObjRCS_21_Can03 "Radar Cross Section (RCS) estimation";
CM_ SG_ 534 SGU21_Object_dx_Rear_Can03 "Position of target object rear bumper in x-direction [m]";
CM_ SG_ 534 SGU21_Object_dy_Rear_Can03 "Position of target object rear bumper in y-direction [m]";
CM_ SG_ 535 SGU22_Msg_CheckSum_Can03 "E2E Profile Variant 1A CRC";
CM_ SG_ 535 SGU22_Msg_AliveCounter_Can03 "E2E Profile Variant 1A Counter";
CM_ SG_ 535 SGU22_BlockCounter_Can03 "Block counter for every messages";
CM_ SG_ 535 SGU22_Object_ID_Can03 "ID is an identifier number that allows for tracking of persistent objects over time";
CM_ SG_ 535 SGU22_Object_wExist_Can03 "Existence probability of the object";
CM_ SG_ 535 SGU22_Object_Type_Can03 "To indicate the estimated type of Object";
CM_ SG_ 535 SGU22_Object_MotionPattern_Can03 "Motion type of object";
CM_ SG_ 535 SGU22_Object_wObstacle_Can03 "The probability of an object being an obstacle";
CM_ SG_ 535 SGU22_Object_dx_Nearest_Can03 "Position of target object in x-direction [m]";
CM_ SG_ 535 SGU22_Object_dy_Nearest_Can03 "Nearest position of target object in y-direction [m]";
CM_ SG_ 535 SGU22_Object_DistLong_rms_Can03 "Standard deviation of longitudinal distance";
CM_ SG_ 535 SGU22_Obj_DistLat_rms_Can03 "Standard deviation of lateral distance";
CM_ SG_ 535 SGU22_Object_vx_Can03 "Relative target object velocity in x-direction [m/s]";
CM_ SG_ 535 SGU22_Object_vy_Can03 "Relative target object velocity in y-direction [m/s]";
CM_ SG_ 535 SGU22_Obj_VrelLong_rms_Can03 "Standard deviation of longitudinal relative velocity";
CM_ SG_ 535 SGU22_Obj_Vrelat_rms_Can03 "Standard deviation of lateral relative velocity";
CM_ SG_ 535 SGU22_Object_DetStatus_Can03 "Detection Staus Of Object";
CM_ SG_ 535 SGU22_Object_ax_Can03 "Relative target object acceleration in x-direction, in the vehicle coordinatesystem";
CM_ SG_ 535 SGU22_Object_ay_Can03 "Relative target object acceleration in y-direction, in the vehicle coordinate system";
CM_ SG_ 535 SGU22_LifeCycles_OBJ_Can03 "-";
CM_ SG_ 535 SGU22_ObjRCS_22_Can03 "Radar Cross Section (RCS) estimation";
CM_ SG_ 535 SGU22_Object_dx_Rear_Can03 "Position of target object rear bumper in x-direction [m]";
CM_ SG_ 535 SGU22_Object_dy_Rear_Can03 "Position of target object rear bumper in y-direction [m]";
CM_ SG_ 536 SGU23_Msg_CheckSum_Can03 "E2E Profile Variant 1A CRC";
CM_ SG_ 536 SGU23_Msg_AliveCounter_Can03 "E2E Profile Variant 1A Counter";
CM_ SG_ 536 SGU23_BlockCounter_Can03 "Block counter for every messages";
CM_ SG_ 536 SGU23_Object_ID_Can03 "ID is an identifier number that allows for tracking of persistent objects over time";
CM_ SG_ 536 SGU23_Object_wExist_Can03 "Existence probability of the object";
CM_ SG_ 536 SGU23_Object_Type_Can03 "To indicate the estimated type of Object";
CM_ SG_ 536 SGU23_Object_MotionPattern_Can03 "Motion type of object";
CM_ SG_ 536 SGU23_Object_wObstacle_Can03 "The probability of an object being an obstacle";
CM_ SG_ 536 SGU23_Object_dx_Nearest_Can03 "Position of target object in x-direction [m]";
CM_ SG_ 536 SGU23_Object_dy_Nearest_Can03 "Nearest position of target object in y-direction [m]";
CM_ SG_ 536 SGU23_Object_DistLong_rms_Can03 "Standard deviation of longitudinal distance";
CM_ SG_ 536 SGU23_Obj_DistLat_rms_Can03 "Standard deviation of lateral distance";
CM_ SG_ 536 SGU23_Object_vx_Can03 "Relative target object velocity in x-direction [m/s]";
CM_ SG_ 536 SGU23_Object_vy_Can03 "Relative target object velocity in y-direction [m/s]";
CM_ SG_ 536 SGU23_Obj_VrelLong_rms_Can03 "Standard deviation of longitudinal relative velocity";
CM_ SG_ 536 SGU23_Obj_Vrelat_rms_Can03 "Standard deviation of lateral relative velocity";
CM_ SG_ 536 SGU23_Object_DetStatus_Can03 "Detection Staus Of Object";
CM_ SG_ 536 SGU23_Object_ax_Can03 "Relative target object acceleration in x-direction, in the vehicle coordinatesystem";
CM_ SG_ 536 SGU23_Object_ay_Can03 "Relative target object acceleration in y-direction, in the vehicle coordinate system";
CM_ SG_ 536 SGU23_LifeCycles_OBJ_Can03 "-";
CM_ SG_ 536 SGU23_ObjRCS_23_Can03 "Radar Cross Section (RCS) estimation";
CM_ SG_ 536 SGU23_Object_dx_Rear_Can03 "Position of target object rear bumper in x-direction [m]";
CM_ SG_ 536 SGU23_Object_dy_Rear_Can03 "Position of target object rear bumper in y-direction [m]";
BA_DEF_ BO_  "GenMsgCycleTime" INT 0 65535;
BA_DEF_ BO_  "GenMsgCycleTimeFast" INT 0 65535;
BA_DEF_ BO_  "GenMsgILSupport" ENUM  "No","Yes";
BA_DEF_ BO_  "GenMsgSendType" ENUM  "Cyclic","Event","CE","NotUsed","NotUsed","NotUsed","NotUsed","NotUsed","NoMsgSendType","IfActive","IfActiveWithRepetition","CyclicAndSpontanX";
BA_DEF_ BO_  "MsgType" ENUM  "Normal","NM","Diag","vector_leerstring";
BA_DEF_ BO_  "NmAsrMessage" ENUM  "No","Yes";
BA_DEF_ BO_  "VFrameFormat" ENUM  "StandardCAN","ExtendedCAN","reserved","reserved","reserved","reserved","reserved","reserved","reserved","reserved","reserved","reserved","reserved","reserved","StandardCAN_FD","ExtendedCAN_FD";
BA_DEF_ SG_  "GenSigInactiveValue" INT 0 2147483647;
BA_DEF_ SG_  "GenSigSendType" ENUM  "Cyclic","OnWrite","OnWriteWithRepetition","OnChange","OnChangeWithRepetition","IfActive","IfActiveWithRepetition","NoSigSendType","CyclicAndSpontanX","NotUsed","Event","CE";
BA_DEF_ SG_  "GenSigStartValue" INT 0 2147483647;
BA_DEF_ SG_  "Internal_type" ENUM  "*","UB","UW","UL","SB","SW","SL";
BA_DEF_ SG_  "IsCrcSignal" ENUM  "No","Yes";
BA_DEF_ SG_  "IsMonitor" ENUM  "*","Monitor";
BA_DEF_ SG_  "Remark" STRING ;
BA_DEF_ SG_  "SigInvalidSetFlag" ENUM  "*","Yes";
BA_DEF_ SG_  "UnitConversionFactor" FLOAT -100 100;
BA_DEF_ BO_  "CANFD_BRS" ENUM  "0","1";
BA_DEF_ SG_  "EventCommandSignal" ENUM  "No","Yes";
BA_DEF_ SG_  "GatewayedSignals" ENUM  "No","Yes";
BA_DEF_ SG_  "GenSigInvalidValue" HEX 0 0;
BA_DEF_ SG_  "GenSigTimeoutValue" HEX 0 0;
BA_DEF_DEF_  "GenMsgCycleTime" 0;
BA_DEF_DEF_  "GenMsgCycleTimeFast" 0;
BA_DEF_DEF_  "GenMsgILSupport" "Yes";
BA_DEF_DEF_  "GenMsgSendType" "Cyclic";
BA_DEF_DEF_  "GenSigInactiveValue" 0;
BA_DEF_DEF_  "GenSigSendType" "Cyclic";
BA_DEF_DEF_  "GenSigStartValue" 0;
BA_DEF_DEF_  "Internal_type" "*";
BA_DEF_DEF_  "IsCrcSignal" "No";
BA_DEF_DEF_  "IsMonitor" "*";
BA_DEF_DEF_  "MsgType" "";
BA_DEF_DEF_  "NmAsrMessage" "No";
BA_DEF_DEF_  "Remark" "";
BA_DEF_DEF_  "SigInvalidSetFlag" "*";
BA_DEF_DEF_  "UnitConversionFactor" 1;
BA_DEF_DEF_  "VFrameFormat" "StandardCAN";
BA_ "CANFD_BRS" BO_ 524 1;
BA_ "CANFD_BRS" BO_ 525 1;
BA_ "CANFD_BRS" BO_ 526 1;
BA_ "CANFD_BRS" BO_ 527 1;
BA_ "CANFD_BRS" BO_ 528 1;
BA_ "CANFD_BRS" BO_ 529 1;
BA_ "CANFD_BRS" BO_ 530 1;
BA_ "CANFD_BRS" BO_ 531 1;
BA_ "CANFD_BRS" BO_ 532 1;
BA_ "CANFD_BRS" BO_ 533 1;
BA_ "CANFD_BRS" BO_ 534 1;
BA_ "CANFD_BRS" BO_ 535 1;
BA_ "CANFD_BRS" BO_ 536 1;
BA_ "GenMsgSendType" BO_ 524 1;
BA_ "GenMsgSendType" BO_ 525 1;
BA_ "GenMsgSendType" BO_ 526 1;
BA_ "GenMsgSendType" BO_ 527 1;
BA_ "GenMsgSendType" BO_ 528 1;
BA_ "GenMsgSendType" BO_ 529 1;
BA_ "GenMsgSendType" BO_ 530 1;
BA_ "GenMsgSendType" BO_ 531 1;
BA_ "GenMsgSendType" BO_ 532 1;
BA_ "GenMsgSendType" BO_ 533 1;
BA_ "GenMsgSendType" BO_ 534 1;
BA_ "GenMsgSendType" BO_ 535 1;
BA_ "GenMsgSendType" BO_ 536 1;
BA_ "MsgType" BO_ 524 0;
BA_ "MsgType" BO_ 525 0;
BA_ "MsgType" BO_ 526 0;
BA_ "MsgType" BO_ 527 0;
BA_ "MsgType" BO_ 528 0;
BA_ "MsgType" BO_ 529 0;
BA_ "MsgType" BO_ 530 0;
BA_ "MsgType" BO_ 531 0;
BA_ "MsgType" BO_ 532 0;
BA_ "MsgType" BO_ 533 0;
BA_ "MsgType" BO_ 534 0;
BA_ "MsgType" BO_ 535 0;
BA_ "MsgType" BO_ 536 0;
BA_ "EventCommandSignal" SG_ 524 SGU11_BlockCounter_Can03 0;
BA_ "GatewayedSignals" SG_ 524 SGU11_BlockCounter_Can03 0;
BA_ "GenSigInvalidValue" SG_ 524 SGU11_BlockCounter_Can03 0;
BA_ "GenSigSendType" SG_ 524 SGU11_BlockCounter_Can03 10;
BA_ "GenSigTimeoutValue" SG_ 524 SGU11_BlockCounter_Can03 0;
BA_ "EventCommandSignal" SG_ 524 SGU11_LifeCycles_OBJ_Can03 0;
BA_ "GatewayedSignals" SG_ 524 SGU11_LifeCycles_OBJ_Can03 0;
BA_ "GenSigInvalidValue" SG_ 524 SGU11_LifeCycles_OBJ_Can03 0;
BA_ "GenSigSendType" SG_ 524 SGU11_LifeCycles_OBJ_Can03 10;
BA_ "GenSigTimeoutValue" SG_ 524 SGU11_LifeCycles_OBJ_Can03 0;
BA_ "EventCommandSignal" SG_ 524 SGU11_Msg_AliveCounter_Can03 0;
BA_ "GatewayedSignals" SG_ 524 SGU11_Msg_AliveCounter_Can03 0;
BA_ "GenSigInvalidValue" SG_ 524 SGU11_Msg_AliveCounter_Can03 0;
BA_ "GenSigSendType" SG_ 524 SGU11_Msg_AliveCounter_Can03 10;
BA_ "GenSigTimeoutValue" SG_ 524 SGU11_Msg_AliveCounter_Can03 0;
BA_ "EventCommandSignal" SG_ 524 SGU11_Msg_CheckSum_Can03 0;
BA_ "GatewayedSignals" SG_ 524 SGU11_Msg_CheckSum_Can03 0;
BA_ "GenSigInvalidValue" SG_ 524 SGU11_Msg_CheckSum_Can03 0;
BA_ "GenSigSendType" SG_ 524 SGU11_Msg_CheckSum_Can03 10;
BA_ "GenSigTimeoutValue" SG_ 524 SGU11_Msg_CheckSum_Can03 0;
BA_ "IsCrcSignal" SG_ 524 SGU11_Msg_CheckSum_Can03 1;
BA_ "EventCommandSignal" SG_ 524 SGU11_ObjRCS_11_Can03 0;
BA_ "GatewayedSignals" SG_ 524 SGU11_ObjRCS_11_Can03 0;
BA_ "GenSigInvalidValue" SG_ 524 SGU11_ObjRCS_11_Can03 0;
BA_ "GenSigSendType" SG_ 524 SGU11_ObjRCS_11_Can03 10;
BA_ "GenSigTimeoutValue" SG_ 524 SGU11_ObjRCS_11_Can03 0;
BA_ "EventCommandSignal" SG_ 524 SGU11_Obj_DistLat_rms_Can03 0;
BA_ "GatewayedSignals" SG_ 524 SGU11_Obj_DistLat_rms_Can03 0;
BA_ "GenSigInvalidValue" SG_ 524 SGU11_Obj_DistLat_rms_Can03 0;
BA_ "GenSigSendType" SG_ 524 SGU11_Obj_DistLat_rms_Can03 10;
BA_ "GenSigTimeoutValue" SG_ 524 SGU11_Obj_DistLat_rms_Can03 0;
BA_ "EventCommandSignal" SG_ 524 SGU11_Obj_VrelLong_rms_Can03 0;
BA_ "GatewayedSignals" SG_ 524 SGU11_Obj_VrelLong_rms_Can03 0;
BA_ "GenSigInvalidValue" SG_ 524 SGU11_Obj_VrelLong_rms_Can03 0;
BA_ "GenSigSendType" SG_ 524 SGU11_Obj_VrelLong_rms_Can03 10;
BA_ "GenSigTimeoutValue" SG_ 524 SGU11_Obj_VrelLong_rms_Can03 0;
BA_ "EventCommandSignal" SG_ 524 SGU11_Obj_Vrelat_rms_Can03 0;
BA_ "GatewayedSignals" SG_ 524 SGU11_Obj_Vrelat_rms_Can03 0;
BA_ "GenSigInvalidValue" SG_ 524 SGU11_Obj_Vrelat_rms_Can03 0;
BA_ "GenSigSendType" SG_ 524 SGU11_Obj_Vrelat_rms_Can03 10;
BA_ "GenSigTimeoutValue" SG_ 524 SGU11_Obj_Vrelat_rms_Can03 0;
BA_ "EventCommandSignal" SG_ 524 SGU11_Object_DetStatus_Can03 0;
BA_ "GatewayedSignals" SG_ 524 SGU11_Object_DetStatus_Can03 0;
BA_ "GenSigInvalidValue" SG_ 524 SGU11_Object_DetStatus_Can03 0;
BA_ "GenSigSendType" SG_ 524 SGU11_Object_DetStatus_Can03 10;
BA_ "GenSigTimeoutValue" SG_ 524 SGU11_Object_DetStatus_Can03 0;
BA_ "EventCommandSignal" SG_ 524 SGU11_Object_DistLong_rms_Can03 0;
BA_ "GatewayedSignals" SG_ 524 SGU11_Object_DistLong_rms_Can03 0;
BA_ "GenSigInvalidValue" SG_ 524 SGU11_Object_DistLong_rms_Can03 0;
BA_ "GenSigSendType" SG_ 524 SGU11_Object_DistLong_rms_Can03 10;
BA_ "GenSigTimeoutValue" SG_ 524 SGU11_Object_DistLong_rms_Can03 0;
BA_ "EventCommandSignal" SG_ 524 SGU11_Object_ID_Can03 0;
BA_ "GatewayedSignals" SG_ 524 SGU11_Object_ID_Can03 0;
BA_ "GenSigInvalidValue" SG_ 524 SGU11_Object_ID_Can03 0;
BA_ "GenSigSendType" SG_ 524 SGU11_Object_ID_Can03 10;
BA_ "GenSigTimeoutValue" SG_ 524 SGU11_Object_ID_Can03 0;
BA_ "EventCommandSignal" SG_ 524 SGU11_Object_MotionPattern_Can03 0;
BA_ "GatewayedSignals" SG_ 524 SGU11_Object_MotionPattern_Can03 0;
BA_ "GenSigInvalidValue" SG_ 524 SGU11_Object_MotionPattern_Can03 0;
BA_ "GenSigSendType" SG_ 524 SGU11_Object_MotionPattern_Can03 10;
BA_ "GenSigTimeoutValue" SG_ 524 SGU11_Object_MotionPattern_Can03 0;
BA_ "EventCommandSignal" SG_ 524 SGU11_Object_Type_Can03 0;
BA_ "GatewayedSignals" SG_ 524 SGU11_Object_Type_Can03 0;
BA_ "GenSigInvalidValue" SG_ 524 SGU11_Object_Type_Can03 0;
BA_ "GenSigSendType" SG_ 524 SGU11_Object_Type_Can03 10;
BA_ "GenSigTimeoutValue" SG_ 524 SGU11_Object_Type_Can03 0;
BA_ "EventCommandSignal" SG_ 524 SGU11_Object_ax_Can03 0;
BA_ "GatewayedSignals" SG_ 524 SGU11_Object_ax_Can03 0;
BA_ "GenSigInvalidValue" SG_ 524 SGU11_Object_ax_Can03 0;
BA_ "GenSigSendType" SG_ 524 SGU11_Object_ax_Can03 10;
BA_ "GenSigTimeoutValue" SG_ 524 SGU11_Object_ax_Can03 0;
BA_ "EventCommandSignal" SG_ 524 SGU11_Object_ay_Can03 0;
BA_ "GatewayedSignals" SG_ 524 SGU11_Object_ay_Can03 0;
BA_ "GenSigInvalidValue" SG_ 524 SGU11_Object_ay_Can03 0;
BA_ "GenSigSendType" SG_ 524 SGU11_Object_ay_Can03 10;
BA_ "GenSigTimeoutValue" SG_ 524 SGU11_Object_ay_Can03 0;
BA_ "EventCommandSignal" SG_ 524 SGU11_Object_dx_Nearest_Can03 0;
BA_ "GatewayedSignals" SG_ 524 SGU11_Object_dx_Nearest_Can03 0;
BA_ "GenSigInvalidValue" SG_ 524 SGU11_Object_dx_Nearest_Can03 0;
BA_ "GenSigSendType" SG_ 524 SGU11_Object_dx_Nearest_Can03 1;
BA_ "GenSigTimeoutValue" SG_ 524 SGU11_Object_dx_Nearest_Can03 0;
BA_ "EventCommandSignal" SG_ 524 SGU11_Object_dx_Rear_Can03 0;
BA_ "GatewayedSignals" SG_ 524 SGU11_Object_dx_Rear_Can03 0;
BA_ "GenSigInvalidValue" SG_ 524 SGU11_Object_dx_Rear_Can03 0;
BA_ "GenSigSendType" SG_ 524 SGU11_Object_dx_Rear_Can03 10;
BA_ "GenSigTimeoutValue" SG_ 524 SGU11_Object_dx_Rear_Can03 0;
BA_ "EventCommandSignal" SG_ 524 SGU11_Object_dy_Nearest_Can03 0;
BA_ "GatewayedSignals" SG_ 524 SGU11_Object_dy_Nearest_Can03 0;
BA_ "GenSigInvalidValue" SG_ 524 SGU11_Object_dy_Nearest_Can03 0;
BA_ "GenSigSendType" SG_ 524 SGU11_Object_dy_Nearest_Can03 1;
BA_ "GenSigTimeoutValue" SG_ 524 SGU11_Object_dy_Nearest_Can03 0;
BA_ "EventCommandSignal" SG_ 524 SGU11_Object_dy_Rear_Can03 0;
BA_ "GatewayedSignals" SG_ 524 SGU11_Object_dy_Rear_Can03 0;
BA_ "GenSigInvalidValue" SG_ 524 SGU11_Object_dy_Rear_Can03 0;
BA_ "GenSigSendType" SG_ 524 SGU11_Object_dy_Rear_Can03 10;
BA_ "GenSigTimeoutValue" SG_ 524 SGU11_Object_dy_Rear_Can03 0;
BA_ "EventCommandSignal" SG_ 524 SGU11_Object_vx_Can03 0;
BA_ "GatewayedSignals" SG_ 524 SGU11_Object_vx_Can03 0;
BA_ "GenSigInvalidValue" SG_ 524 SGU11_Object_vx_Can03 0;
BA_ "GenSigSendType" SG_ 524 SGU11_Object_vx_Can03 10;
BA_ "GenSigTimeoutValue" SG_ 524 SGU11_Object_vx_Can03 0;
BA_ "EventCommandSignal" SG_ 524 SGU11_Object_vy_Can03 0;
BA_ "GatewayedSignals" SG_ 524 SGU11_Object_vy_Can03 0;
BA_ "GenSigInvalidValue" SG_ 524 SGU11_Object_vy_Can03 0;
BA_ "GenSigSendType" SG_ 524 SGU11_Object_vy_Can03 10;
BA_ "GenSigTimeoutValue" SG_ 524 SGU11_Object_vy_Can03 0;
BA_ "EventCommandSignal" SG_ 524 SGU11_Object_wExist_Can03 0;
BA_ "GatewayedSignals" SG_ 524 SGU11_Object_wExist_Can03 0;
BA_ "GenSigInvalidValue" SG_ 524 SGU11_Object_wExist_Can03 0;
BA_ "GenSigSendType" SG_ 524 SGU11_Object_wExist_Can03 10;
BA_ "GenSigTimeoutValue" SG_ 524 SGU11_Object_wExist_Can03 0;
BA_ "EventCommandSignal" SG_ 524 SGU11_Object_wObstacle_Can03 0;
BA_ "GatewayedSignals" SG_ 524 SGU11_Object_wObstacle_Can03 0;
BA_ "GenSigInvalidValue" SG_ 524 SGU11_Object_wObstacle_Can03 0;
BA_ "GenSigSendType" SG_ 524 SGU11_Object_wObstacle_Can03 10;
BA_ "GenSigTimeoutValue" SG_ 524 SGU11_Object_wObstacle_Can03 0;
BA_ "EventCommandSignal" SG_ 525 SGU12_BlockCounter_Can03 0;
BA_ "GatewayedSignals" SG_ 525 SGU12_BlockCounter_Can03 0;
BA_ "GenSigInvalidValue" SG_ 525 SGU12_BlockCounter_Can03 0;
BA_ "GenSigSendType" SG_ 525 SGU12_BlockCounter_Can03 10;
BA_ "GenSigTimeoutValue" SG_ 525 SGU12_BlockCounter_Can03 0;
BA_ "EventCommandSignal" SG_ 525 SGU12_LifeCycles_OBJ_Can03 0;
BA_ "GatewayedSignals" SG_ 525 SGU12_LifeCycles_OBJ_Can03 0;
BA_ "GenSigInvalidValue" SG_ 525 SGU12_LifeCycles_OBJ_Can03 0;
BA_ "GenSigSendType" SG_ 525 SGU12_LifeCycles_OBJ_Can03 10;
BA_ "GenSigTimeoutValue" SG_ 525 SGU12_LifeCycles_OBJ_Can03 0;
BA_ "EventCommandSignal" SG_ 525 SGU12_Msg_AliveCounter_Can03 0;
BA_ "GatewayedSignals" SG_ 525 SGU12_Msg_AliveCounter_Can03 0;
BA_ "GenSigInvalidValue" SG_ 525 SGU12_Msg_AliveCounter_Can03 0;
BA_ "GenSigSendType" SG_ 525 SGU12_Msg_AliveCounter_Can03 10;
BA_ "GenSigTimeoutValue" SG_ 525 SGU12_Msg_AliveCounter_Can03 0;
BA_ "EventCommandSignal" SG_ 525 SGU12_Msg_CheckSum_Can03 0;
BA_ "GatewayedSignals" SG_ 525 SGU12_Msg_CheckSum_Can03 0;
BA_ "GenSigInvalidValue" SG_ 525 SGU12_Msg_CheckSum_Can03 0;
BA_ "GenSigSendType" SG_ 525 SGU12_Msg_CheckSum_Can03 10;
BA_ "GenSigTimeoutValue" SG_ 525 SGU12_Msg_CheckSum_Can03 0;
BA_ "IsCrcSignal" SG_ 525 SGU12_Msg_CheckSum_Can03 1;
BA_ "EventCommandSignal" SG_ 525 SGU12_ObjRCS_12_Can03 0;
BA_ "GatewayedSignals" SG_ 525 SGU12_ObjRCS_12_Can03 0;
BA_ "GenSigInvalidValue" SG_ 525 SGU12_ObjRCS_12_Can03 0;
BA_ "GenSigSendType" SG_ 525 SGU12_ObjRCS_12_Can03 10;
BA_ "GenSigTimeoutValue" SG_ 525 SGU12_ObjRCS_12_Can03 0;
BA_ "EventCommandSignal" SG_ 525 SGU12_Obj_DistLat_rms_Can03 0;
BA_ "GatewayedSignals" SG_ 525 SGU12_Obj_DistLat_rms_Can03 0;
BA_ "GenSigInvalidValue" SG_ 525 SGU12_Obj_DistLat_rms_Can03 0;
BA_ "GenSigSendType" SG_ 525 SGU12_Obj_DistLat_rms_Can03 10;
BA_ "GenSigTimeoutValue" SG_ 525 SGU12_Obj_DistLat_rms_Can03 0;
BA_ "EventCommandSignal" SG_ 525 SGU12_Obj_VrelLong_rms_Can03 0;
BA_ "GatewayedSignals" SG_ 525 SGU12_Obj_VrelLong_rms_Can03 0;
BA_ "GenSigInvalidValue" SG_ 525 SGU12_Obj_VrelLong_rms_Can03 0;
BA_ "GenSigSendType" SG_ 525 SGU12_Obj_VrelLong_rms_Can03 10;
BA_ "GenSigTimeoutValue" SG_ 525 SGU12_Obj_VrelLong_rms_Can03 0;
BA_ "EventCommandSignal" SG_ 525 SGU12_Obj_Vrelat_rms_Can03 0;
BA_ "GatewayedSignals" SG_ 525 SGU12_Obj_Vrelat_rms_Can03 0;
BA_ "GenSigInvalidValue" SG_ 525 SGU12_Obj_Vrelat_rms_Can03 0;
BA_ "GenSigSendType" SG_ 525 SGU12_Obj_Vrelat_rms_Can03 10;
BA_ "GenSigTimeoutValue" SG_ 525 SGU12_Obj_Vrelat_rms_Can03 0;
BA_ "EventCommandSignal" SG_ 525 SGU12_Object_DetStatus_Can03 0;
BA_ "GatewayedSignals" SG_ 525 SGU12_Object_DetStatus_Can03 0;
BA_ "GenSigInvalidValue" SG_ 525 SGU12_Object_DetStatus_Can03 0;
BA_ "GenSigSendType" SG_ 525 SGU12_Object_DetStatus_Can03 10;
BA_ "GenSigTimeoutValue" SG_ 525 SGU12_Object_DetStatus_Can03 0;
BA_ "EventCommandSignal" SG_ 525 SGU12_Object_DistLong_rms_Can03 0;
BA_ "GatewayedSignals" SG_ 525 SGU12_Object_DistLong_rms_Can03 0;
BA_ "GenSigInvalidValue" SG_ 525 SGU12_Object_DistLong_rms_Can03 0;
BA_ "GenSigSendType" SG_ 525 SGU12_Object_DistLong_rms_Can03 10;
BA_ "GenSigTimeoutValue" SG_ 525 SGU12_Object_DistLong_rms_Can03 0;
BA_ "EventCommandSignal" SG_ 525 SGU12_Object_ID_Can03 0;
BA_ "GatewayedSignals" SG_ 525 SGU12_Object_ID_Can03 0;
BA_ "GenSigInvalidValue" SG_ 525 SGU12_Object_ID_Can03 0;
BA_ "GenSigSendType" SG_ 525 SGU12_Object_ID_Can03 10;
BA_ "GenSigTimeoutValue" SG_ 525 SGU12_Object_ID_Can03 0;
BA_ "EventCommandSignal" SG_ 525 SGU12_Object_MotionPattern_Can03 0;
BA_ "GatewayedSignals" SG_ 525 SGU12_Object_MotionPattern_Can03 0;
BA_ "GenSigInvalidValue" SG_ 525 SGU12_Object_MotionPattern_Can03 0;
BA_ "GenSigSendType" SG_ 525 SGU12_Object_MotionPattern_Can03 10;
BA_ "GenSigTimeoutValue" SG_ 525 SGU12_Object_MotionPattern_Can03 0;
BA_ "EventCommandSignal" SG_ 525 SGU12_Object_Type_Can03 0;
BA_ "GatewayedSignals" SG_ 525 SGU12_Object_Type_Can03 0;
BA_ "GenSigInvalidValue" SG_ 525 SGU12_Object_Type_Can03 0;
BA_ "GenSigSendType" SG_ 525 SGU12_Object_Type_Can03 10;
BA_ "GenSigTimeoutValue" SG_ 525 SGU12_Object_Type_Can03 0;
BA_ "EventCommandSignal" SG_ 525 SGU12_Object_ax_Can03 0;
BA_ "GatewayedSignals" SG_ 525 SGU12_Object_ax_Can03 0;
BA_ "GenSigInvalidValue" SG_ 525 SGU12_Object_ax_Can03 0;
BA_ "GenSigSendType" SG_ 525 SGU12_Object_ax_Can03 10;
BA_ "GenSigTimeoutValue" SG_ 525 SGU12_Object_ax_Can03 0;
BA_ "EventCommandSignal" SG_ 525 SGU12_Object_ay_Can03 0;
BA_ "GatewayedSignals" SG_ 525 SGU12_Object_ay_Can03 0;
BA_ "GenSigInvalidValue" SG_ 525 SGU12_Object_ay_Can03 0;
BA_ "GenSigSendType" SG_ 525 SGU12_Object_ay_Can03 10;
BA_ "GenSigTimeoutValue" SG_ 525 SGU12_Object_ay_Can03 0;
BA_ "EventCommandSignal" SG_ 525 SGU12_Object_dx_Nearest_Can03 0;
BA_ "GatewayedSignals" SG_ 525 SGU12_Object_dx_Nearest_Can03 0;
BA_ "GenSigInvalidValue" SG_ 525 SGU12_Object_dx_Nearest_Can03 0;
BA_ "GenSigSendType" SG_ 525 SGU12_Object_dx_Nearest_Can03 1;
BA_ "GenSigTimeoutValue" SG_ 525 SGU12_Object_dx_Nearest_Can03 0;
BA_ "EventCommandSignal" SG_ 525 SGU12_Object_dx_Rear_Can03 0;
BA_ "GatewayedSignals" SG_ 525 SGU12_Object_dx_Rear_Can03 0;
BA_ "GenSigInvalidValue" SG_ 525 SGU12_Object_dx_Rear_Can03 0;
BA_ "GenSigSendType" SG_ 525 SGU12_Object_dx_Rear_Can03 10;
BA_ "GenSigTimeoutValue" SG_ 525 SGU12_Object_dx_Rear_Can03 0;
BA_ "EventCommandSignal" SG_ 525 SGU12_Object_dy_Nearest_Can03 0;
BA_ "GatewayedSignals" SG_ 525 SGU12_Object_dy_Nearest_Can03 0;
BA_ "GenSigInvalidValue" SG_ 525 SGU12_Object_dy_Nearest_Can03 0;
BA_ "GenSigSendType" SG_ 525 SGU12_Object_dy_Nearest_Can03 1;
BA_ "GenSigTimeoutValue" SG_ 525 SGU12_Object_dy_Nearest_Can03 0;
BA_ "EventCommandSignal" SG_ 525 SGU12_Object_dy_Rear_Can03 0;
BA_ "GatewayedSignals" SG_ 525 SGU12_Object_dy_Rear_Can03 0;
BA_ "GenSigInvalidValue" SG_ 525 SGU12_Object_dy_Rear_Can03 0;
BA_ "GenSigSendType" SG_ 525 SGU12_Object_dy_Rear_Can03 10;
BA_ "GenSigTimeoutValue" SG_ 525 SGU12_Object_dy_Rear_Can03 0;
BA_ "EventCommandSignal" SG_ 525 SGU12_Object_vx_Can03 0;
BA_ "GatewayedSignals" SG_ 525 SGU12_Object_vx_Can03 0;
BA_ "GenSigInvalidValue" SG_ 525 SGU12_Object_vx_Can03 0;
BA_ "GenSigSendType" SG_ 525 SGU12_Object_vx_Can03 10;
BA_ "GenSigTimeoutValue" SG_ 525 SGU12_Object_vx_Can03 0;
BA_ "EventCommandSignal" SG_ 525 SGU12_Object_vy_Can03 0;
BA_ "GatewayedSignals" SG_ 525 SGU12_Object_vy_Can03 0;
BA_ "GenSigInvalidValue" SG_ 525 SGU12_Object_vy_Can03 0;
BA_ "GenSigSendType" SG_ 525 SGU12_Object_vy_Can03 10;
BA_ "GenSigTimeoutValue" SG_ 525 SGU12_Object_vy_Can03 0;
BA_ "EventCommandSignal" SG_ 525 SGU12_Object_wExist_Can03 0;
BA_ "GatewayedSignals" SG_ 525 SGU12_Object_wExist_Can03 0;
BA_ "GenSigInvalidValue" SG_ 525 SGU12_Object_wExist_Can03 0;
BA_ "GenSigSendType" SG_ 525 SGU12_Object_wExist_Can03 10;
BA_ "GenSigTimeoutValue" SG_ 525 SGU12_Object_wExist_Can03 0;
BA_ "EventCommandSignal" SG_ 525 SGU12_Object_wObstacle_Can03 0;
BA_ "GatewayedSignals" SG_ 525 SGU12_Object_wObstacle_Can03 0;
BA_ "GenSigInvalidValue" SG_ 525 SGU12_Object_wObstacle_Can03 0;
BA_ "GenSigSendType" SG_ 525 SGU12_Object_wObstacle_Can03 10;
BA_ "GenSigTimeoutValue" SG_ 525 SGU12_Object_wObstacle_Can03 0;
BA_ "EventCommandSignal" SG_ 526 SGU13_BlockCounter_Can03 0;
BA_ "GatewayedSignals" SG_ 526 SGU13_BlockCounter_Can03 0;
BA_ "GenSigInvalidValue" SG_ 526 SGU13_BlockCounter_Can03 0;
BA_ "GenSigSendType" SG_ 526 SGU13_BlockCounter_Can03 10;
BA_ "GenSigTimeoutValue" SG_ 526 SGU13_BlockCounter_Can03 0;
BA_ "EventCommandSignal" SG_ 526 SGU13_LifeCycles_OBJ_Can03 0;
BA_ "GatewayedSignals" SG_ 526 SGU13_LifeCycles_OBJ_Can03 0;
BA_ "GenSigInvalidValue" SG_ 526 SGU13_LifeCycles_OBJ_Can03 0;
BA_ "GenSigSendType" SG_ 526 SGU13_LifeCycles_OBJ_Can03 10;
BA_ "GenSigTimeoutValue" SG_ 526 SGU13_LifeCycles_OBJ_Can03 0;
BA_ "EventCommandSignal" SG_ 526 SGU13_Msg_AliveCounter_Can03 0;
BA_ "GatewayedSignals" SG_ 526 SGU13_Msg_AliveCounter_Can03 0;
BA_ "GenSigInvalidValue" SG_ 526 SGU13_Msg_AliveCounter_Can03 0;
BA_ "GenSigSendType" SG_ 526 SGU13_Msg_AliveCounter_Can03 10;
BA_ "GenSigTimeoutValue" SG_ 526 SGU13_Msg_AliveCounter_Can03 0;
BA_ "EventCommandSignal" SG_ 526 SGU13_Msg_CheckSum_Can03 0;
BA_ "GatewayedSignals" SG_ 526 SGU13_Msg_CheckSum_Can03 0;
BA_ "GenSigInvalidValue" SG_ 526 SGU13_Msg_CheckSum_Can03 0;
BA_ "GenSigSendType" SG_ 526 SGU13_Msg_CheckSum_Can03 10;
BA_ "GenSigTimeoutValue" SG_ 526 SGU13_Msg_CheckSum_Can03 0;
BA_ "IsCrcSignal" SG_ 526 SGU13_Msg_CheckSum_Can03 1;
BA_ "EventCommandSignal" SG_ 526 SGU13_ObjRCS_13_Can03 0;
BA_ "GatewayedSignals" SG_ 526 SGU13_ObjRCS_13_Can03 0;
BA_ "GenSigInvalidValue" SG_ 526 SGU13_ObjRCS_13_Can03 0;
BA_ "GenSigSendType" SG_ 526 SGU13_ObjRCS_13_Can03 10;
BA_ "GenSigTimeoutValue" SG_ 526 SGU13_ObjRCS_13_Can03 0;
BA_ "EventCommandSignal" SG_ 526 SGU13_Obj_DistLat_rms_Can03 0;
BA_ "GatewayedSignals" SG_ 526 SGU13_Obj_DistLat_rms_Can03 0;
BA_ "GenSigInvalidValue" SG_ 526 SGU13_Obj_DistLat_rms_Can03 0;
BA_ "GenSigSendType" SG_ 526 SGU13_Obj_DistLat_rms_Can03 10;
BA_ "GenSigTimeoutValue" SG_ 526 SGU13_Obj_DistLat_rms_Can03 0;
BA_ "EventCommandSignal" SG_ 526 SGU13_Obj_VrelLong_rms_Can03 0;
BA_ "GatewayedSignals" SG_ 526 SGU13_Obj_VrelLong_rms_Can03 0;
BA_ "GenSigInvalidValue" SG_ 526 SGU13_Obj_VrelLong_rms_Can03 0;
BA_ "GenSigSendType" SG_ 526 SGU13_Obj_VrelLong_rms_Can03 10;
BA_ "GenSigTimeoutValue" SG_ 526 SGU13_Obj_VrelLong_rms_Can03 0;
BA_ "EventCommandSignal" SG_ 526 SGU13_Obj_Vrelat_rms_Can03 0;
BA_ "GatewayedSignals" SG_ 526 SGU13_Obj_Vrelat_rms_Can03 0;
BA_ "GenSigInvalidValue" SG_ 526 SGU13_Obj_Vrelat_rms_Can03 0;
BA_ "GenSigSendType" SG_ 526 SGU13_Obj_Vrelat_rms_Can03 10;
BA_ "GenSigTimeoutValue" SG_ 526 SGU13_Obj_Vrelat_rms_Can03 0;
BA_ "EventCommandSignal" SG_ 526 SGU13_Object_DetStatus_Can03 0;
BA_ "GatewayedSignals" SG_ 526 SGU13_Object_DetStatus_Can03 0;
BA_ "GenSigInvalidValue" SG_ 526 SGU13_Object_DetStatus_Can03 0;
BA_ "GenSigSendType" SG_ 526 SGU13_Object_DetStatus_Can03 10;
BA_ "GenSigTimeoutValue" SG_ 526 SGU13_Object_DetStatus_Can03 0;
BA_ "EventCommandSignal" SG_ 526 SGU13_Object_DistLong_rms_Can03 0;
BA_ "GatewayedSignals" SG_ 526 SGU13_Object_DistLong_rms_Can03 0;
BA_ "GenSigInvalidValue" SG_ 526 SGU13_Object_DistLong_rms_Can03 0;
BA_ "GenSigSendType" SG_ 526 SGU13_Object_DistLong_rms_Can03 10;
BA_ "GenSigTimeoutValue" SG_ 526 SGU13_Object_DistLong_rms_Can03 0;
BA_ "EventCommandSignal" SG_ 526 SGU13_Object_ID_Can03 0;
BA_ "GatewayedSignals" SG_ 526 SGU13_Object_ID_Can03 0;
BA_ "GenSigInvalidValue" SG_ 526 SGU13_Object_ID_Can03 0;
BA_ "GenSigSendType" SG_ 526 SGU13_Object_ID_Can03 10;
BA_ "GenSigTimeoutValue" SG_ 526 SGU13_Object_ID_Can03 0;
BA_ "EventCommandSignal" SG_ 526 SGU13_Object_MotionPattern_Can03 0;
BA_ "GatewayedSignals" SG_ 526 SGU13_Object_MotionPattern_Can03 0;
BA_ "GenSigInvalidValue" SG_ 526 SGU13_Object_MotionPattern_Can03 0;
BA_ "GenSigSendType" SG_ 526 SGU13_Object_MotionPattern_Can03 10;
BA_ "GenSigTimeoutValue" SG_ 526 SGU13_Object_MotionPattern_Can03 0;
BA_ "EventCommandSignal" SG_ 526 SGU13_Object_Type_Can03 0;
BA_ "GatewayedSignals" SG_ 526 SGU13_Object_Type_Can03 0;
BA_ "GenSigInvalidValue" SG_ 526 SGU13_Object_Type_Can03 0;
BA_ "GenSigSendType" SG_ 526 SGU13_Object_Type_Can03 10;
BA_ "GenSigTimeoutValue" SG_ 526 SGU13_Object_Type_Can03 0;
BA_ "EventCommandSignal" SG_ 526 SGU13_Object_ax_Can03 0;
BA_ "GatewayedSignals" SG_ 526 SGU13_Object_ax_Can03 0;
BA_ "GenSigInvalidValue" SG_ 526 SGU13_Object_ax_Can03 0;
BA_ "GenSigSendType" SG_ 526 SGU13_Object_ax_Can03 10;
BA_ "GenSigTimeoutValue" SG_ 526 SGU13_Object_ax_Can03 0;
BA_ "EventCommandSignal" SG_ 526 SGU13_Object_ay_Can03 0;
BA_ "GatewayedSignals" SG_ 526 SGU13_Object_ay_Can03 0;
BA_ "GenSigInvalidValue" SG_ 526 SGU13_Object_ay_Can03 0;
BA_ "GenSigSendType" SG_ 526 SGU13_Object_ay_Can03 10;
BA_ "GenSigTimeoutValue" SG_ 526 SGU13_Object_ay_Can03 0;
BA_ "EventCommandSignal" SG_ 526 SGU13_Object_dx_Nearest_Can03 0;
BA_ "GatewayedSignals" SG_ 526 SGU13_Object_dx_Nearest_Can03 0;
BA_ "GenSigInvalidValue" SG_ 526 SGU13_Object_dx_Nearest_Can03 0;
BA_ "GenSigSendType" SG_ 526 SGU13_Object_dx_Nearest_Can03 1;
BA_ "GenSigTimeoutValue" SG_ 526 SGU13_Object_dx_Nearest_Can03 0;
BA_ "EventCommandSignal" SG_ 526 SGU13_Object_dx_Rear_Can03 0;
BA_ "GatewayedSignals" SG_ 526 SGU13_Object_dx_Rear_Can03 0;
BA_ "GenSigInvalidValue" SG_ 526 SGU13_Object_dx_Rear_Can03 0;
BA_ "GenSigSendType" SG_ 526 SGU13_Object_dx_Rear_Can03 10;
BA_ "GenSigTimeoutValue" SG_ 526 SGU13_Object_dx_Rear_Can03 0;
BA_ "EventCommandSignal" SG_ 526 SGU13_Object_dy_Nearest_Can03 0;
BA_ "GatewayedSignals" SG_ 526 SGU13_Object_dy_Nearest_Can03 0;
BA_ "GenSigInvalidValue" SG_ 526 SGU13_Object_dy_Nearest_Can03 0;
BA_ "GenSigSendType" SG_ 526 SGU13_Object_dy_Nearest_Can03 1;
BA_ "GenSigTimeoutValue" SG_ 526 SGU13_Object_dy_Nearest_Can03 0;
BA_ "EventCommandSignal" SG_ 526 SGU13_Object_dy_Rear_Can03 0;
BA_ "GatewayedSignals" SG_ 526 SGU13_Object_dy_Rear_Can03 0;
BA_ "GenSigInvalidValue" SG_ 526 SGU13_Object_dy_Rear_Can03 0;
BA_ "GenSigSendType" SG_ 526 SGU13_Object_dy_Rear_Can03 10;
BA_ "GenSigTimeoutValue" SG_ 526 SGU13_Object_dy_Rear_Can03 0;
BA_ "EventCommandSignal" SG_ 526 SGU13_Object_vx_Can03 0;
BA_ "GatewayedSignals" SG_ 526 SGU13_Object_vx_Can03 0;
BA_ "GenSigInvalidValue" SG_ 526 SGU13_Object_vx_Can03 0;
BA_ "GenSigSendType" SG_ 526 SGU13_Object_vx_Can03 10;
BA_ "GenSigTimeoutValue" SG_ 526 SGU13_Object_vx_Can03 0;
BA_ "EventCommandSignal" SG_ 526 SGU13_Object_vy_Can03 0;
BA_ "GatewayedSignals" SG_ 526 SGU13_Object_vy_Can03 0;
BA_ "GenSigInvalidValue" SG_ 526 SGU13_Object_vy_Can03 0;
BA_ "GenSigSendType" SG_ 526 SGU13_Object_vy_Can03 10;
BA_ "GenSigTimeoutValue" SG_ 526 SGU13_Object_vy_Can03 0;
BA_ "EventCommandSignal" SG_ 526 SGU13_Object_wExist_Can03 0;
BA_ "GatewayedSignals" SG_ 526 SGU13_Object_wExist_Can03 0;
BA_ "GenSigInvalidValue" SG_ 526 SGU13_Object_wExist_Can03 0;
BA_ "GenSigSendType" SG_ 526 SGU13_Object_wExist_Can03 10;
BA_ "GenSigTimeoutValue" SG_ 526 SGU13_Object_wExist_Can03 0;
BA_ "EventCommandSignal" SG_ 526 SGU13_Object_wObstacle_Can03 0;
BA_ "GatewayedSignals" SG_ 526 SGU13_Object_wObstacle_Can03 0;
BA_ "GenSigInvalidValue" SG_ 526 SGU13_Object_wObstacle_Can03 0;
BA_ "GenSigSendType" SG_ 526 SGU13_Object_wObstacle_Can03 10;
BA_ "GenSigTimeoutValue" SG_ 526 SGU13_Object_wObstacle_Can03 0;
BA_ "EventCommandSignal" SG_ 527 SGU14_BlockCounter_Can03 0;
BA_ "GatewayedSignals" SG_ 527 SGU14_BlockCounter_Can03 0;
BA_ "GenSigInvalidValue" SG_ 527 SGU14_BlockCounter_Can03 0;
BA_ "GenSigSendType" SG_ 527 SGU14_BlockCounter_Can03 10;
BA_ "GenSigTimeoutValue" SG_ 527 SGU14_BlockCounter_Can03 0;
BA_ "EventCommandSignal" SG_ 527 SGU14_LifeCycles_OBJ_Can03 0;
BA_ "GatewayedSignals" SG_ 527 SGU14_LifeCycles_OBJ_Can03 0;
BA_ "GenSigInvalidValue" SG_ 527 SGU14_LifeCycles_OBJ_Can03 0;
BA_ "GenSigSendType" SG_ 527 SGU14_LifeCycles_OBJ_Can03 10;
BA_ "GenSigTimeoutValue" SG_ 527 SGU14_LifeCycles_OBJ_Can03 0;
BA_ "EventCommandSignal" SG_ 527 SGU14_Msg_AliveCounter_Can03 0;
BA_ "GatewayedSignals" SG_ 527 SGU14_Msg_AliveCounter_Can03 0;
BA_ "GenSigInvalidValue" SG_ 527 SGU14_Msg_AliveCounter_Can03 0;
BA_ "GenSigSendType" SG_ 527 SGU14_Msg_AliveCounter_Can03 10;
BA_ "GenSigTimeoutValue" SG_ 527 SGU14_Msg_AliveCounter_Can03 0;
BA_ "EventCommandSignal" SG_ 527 SGU14_Msg_CheckSum_Can03 0;
BA_ "GatewayedSignals" SG_ 527 SGU14_Msg_CheckSum_Can03 0;
BA_ "GenSigInvalidValue" SG_ 527 SGU14_Msg_CheckSum_Can03 0;
BA_ "GenSigSendType" SG_ 527 SGU14_Msg_CheckSum_Can03 10;
BA_ "GenSigTimeoutValue" SG_ 527 SGU14_Msg_CheckSum_Can03 0;
BA_ "IsCrcSignal" SG_ 527 SGU14_Msg_CheckSum_Can03 1;
BA_ "EventCommandSignal" SG_ 527 SGU14_ObjRCS_14_Can03 0;
BA_ "GatewayedSignals" SG_ 527 SGU14_ObjRCS_14_Can03 0;
BA_ "GenSigInvalidValue" SG_ 527 SGU14_ObjRCS_14_Can03 0;
BA_ "GenSigSendType" SG_ 527 SGU14_ObjRCS_14_Can03 10;
BA_ "GenSigTimeoutValue" SG_ 527 SGU14_ObjRCS_14_Can03 0;
BA_ "EventCommandSignal" SG_ 527 SGU14_Obj_DistLat_rms_Can03 0;
BA_ "GatewayedSignals" SG_ 527 SGU14_Obj_DistLat_rms_Can03 0;
BA_ "GenSigInvalidValue" SG_ 527 SGU14_Obj_DistLat_rms_Can03 0;
BA_ "GenSigSendType" SG_ 527 SGU14_Obj_DistLat_rms_Can03 10;
BA_ "GenSigTimeoutValue" SG_ 527 SGU14_Obj_DistLat_rms_Can03 0;
BA_ "EventCommandSignal" SG_ 527 SGU14_Obj_VrelLong_rms_Can03 0;
BA_ "GatewayedSignals" SG_ 527 SGU14_Obj_VrelLong_rms_Can03 0;
BA_ "GenSigInvalidValue" SG_ 527 SGU14_Obj_VrelLong_rms_Can03 0;
BA_ "GenSigSendType" SG_ 527 SGU14_Obj_VrelLong_rms_Can03 10;
BA_ "GenSigTimeoutValue" SG_ 527 SGU14_Obj_VrelLong_rms_Can03 0;
BA_ "EventCommandSignal" SG_ 527 SGU14_Obj_Vrelat_rms_Can03 0;
BA_ "GatewayedSignals" SG_ 527 SGU14_Obj_Vrelat_rms_Can03 0;
BA_ "GenSigInvalidValue" SG_ 527 SGU14_Obj_Vrelat_rms_Can03 0;
BA_ "GenSigSendType" SG_ 527 SGU14_Obj_Vrelat_rms_Can03 10;
BA_ "GenSigTimeoutValue" SG_ 527 SGU14_Obj_Vrelat_rms_Can03 0;
BA_ "EventCommandSignal" SG_ 527 SGU14_Object_DetStatus_Can03 0;
BA_ "GatewayedSignals" SG_ 527 SGU14_Object_DetStatus_Can03 0;
BA_ "GenSigInvalidValue" SG_ 527 SGU14_Object_DetStatus_Can03 0;
BA_ "GenSigSendType" SG_ 527 SGU14_Object_DetStatus_Can03 10;
BA_ "GenSigTimeoutValue" SG_ 527 SGU14_Object_DetStatus_Can03 0;
BA_ "EventCommandSignal" SG_ 527 SGU14_Object_DistLong_rms_Can03 0;
BA_ "GatewayedSignals" SG_ 527 SGU14_Object_DistLong_rms_Can03 0;
BA_ "GenSigInvalidValue" SG_ 527 SGU14_Object_DistLong_rms_Can03 0;
BA_ "GenSigSendType" SG_ 527 SGU14_Object_DistLong_rms_Can03 10;
BA_ "GenSigTimeoutValue" SG_ 527 SGU14_Object_DistLong_rms_Can03 0;
BA_ "EventCommandSignal" SG_ 527 SGU14_Object_ID_Can03 0;
BA_ "GatewayedSignals" SG_ 527 SGU14_Object_ID_Can03 0;
BA_ "GenSigInvalidValue" SG_ 527 SGU14_Object_ID_Can03 0;
BA_ "GenSigSendType" SG_ 527 SGU14_Object_ID_Can03 10;
BA_ "GenSigTimeoutValue" SG_ 527 SGU14_Object_ID_Can03 0;
BA_ "EventCommandSignal" SG_ 527 SGU14_Object_MotionPattern_Can03 0;
BA_ "GatewayedSignals" SG_ 527 SGU14_Object_MotionPattern_Can03 0;
BA_ "GenSigInvalidValue" SG_ 527 SGU14_Object_MotionPattern_Can03 0;
BA_ "GenSigSendType" SG_ 527 SGU14_Object_MotionPattern_Can03 10;
BA_ "GenSigTimeoutValue" SG_ 527 SGU14_Object_MotionPattern_Can03 0;
BA_ "EventCommandSignal" SG_ 527 SGU14_Object_Type_Can03 0;
BA_ "GatewayedSignals" SG_ 527 SGU14_Object_Type_Can03 0;
BA_ "GenSigInvalidValue" SG_ 527 SGU14_Object_Type_Can03 0;
BA_ "GenSigSendType" SG_ 527 SGU14_Object_Type_Can03 10;
BA_ "GenSigTimeoutValue" SG_ 527 SGU14_Object_Type_Can03 0;
BA_ "EventCommandSignal" SG_ 527 SGU14_Object_ax_Can03 0;
BA_ "GatewayedSignals" SG_ 527 SGU14_Object_ax_Can03 0;
BA_ "GenSigInvalidValue" SG_ 527 SGU14_Object_ax_Can03 0;
BA_ "GenSigSendType" SG_ 527 SGU14_Object_ax_Can03 10;
BA_ "GenSigTimeoutValue" SG_ 527 SGU14_Object_ax_Can03 0;
BA_ "EventCommandSignal" SG_ 527 SGU14_Object_ay_Can03 0;
BA_ "GatewayedSignals" SG_ 527 SGU14_Object_ay_Can03 0;
BA_ "GenSigInvalidValue" SG_ 527 SGU14_Object_ay_Can03 0;
BA_ "GenSigSendType" SG_ 527 SGU14_Object_ay_Can03 10;
BA_ "GenSigTimeoutValue" SG_ 527 SGU14_Object_ay_Can03 0;
BA_ "EventCommandSignal" SG_ 527 SGU14_Object_dx_Nearest_Can03 0;
BA_ "GatewayedSignals" SG_ 527 SGU14_Object_dx_Nearest_Can03 0;
BA_ "GenSigInvalidValue" SG_ 527 SGU14_Object_dx_Nearest_Can03 0;
BA_ "GenSigSendType" SG_ 527 SGU14_Object_dx_Nearest_Can03 1;
BA_ "GenSigTimeoutValue" SG_ 527 SGU14_Object_dx_Nearest_Can03 0;
BA_ "EventCommandSignal" SG_ 527 SGU14_Object_dx_Rear_Can03 0;
BA_ "GatewayedSignals" SG_ 527 SGU14_Object_dx_Rear_Can03 0;
BA_ "GenSigInvalidValue" SG_ 527 SGU14_Object_dx_Rear_Can03 0;
BA_ "GenSigSendType" SG_ 527 SGU14_Object_dx_Rear_Can03 10;
BA_ "GenSigTimeoutValue" SG_ 527 SGU14_Object_dx_Rear_Can03 0;
BA_ "EventCommandSignal" SG_ 527 SGU14_Object_dy_Nearest_Can03 0;
BA_ "GatewayedSignals" SG_ 527 SGU14_Object_dy_Nearest_Can03 0;
BA_ "GenSigInvalidValue" SG_ 527 SGU14_Object_dy_Nearest_Can03 0;
BA_ "GenSigSendType" SG_ 527 SGU14_Object_dy_Nearest_Can03 1;
BA_ "GenSigTimeoutValue" SG_ 527 SGU14_Object_dy_Nearest_Can03 0;
BA_ "EventCommandSignal" SG_ 527 SGU14_Object_dy_Rear_Can03 0;
BA_ "GatewayedSignals" SG_ 527 SGU14_Object_dy_Rear_Can03 0;
BA_ "GenSigInvalidValue" SG_ 527 SGU14_Object_dy_Rear_Can03 0;
BA_ "GenSigSendType" SG_ 527 SGU14_Object_dy_Rear_Can03 10;
BA_ "GenSigTimeoutValue" SG_ 527 SGU14_Object_dy_Rear_Can03 0;
BA_ "EventCommandSignal" SG_ 527 SGU14_Object_vx_Can03 0;
BA_ "GatewayedSignals" SG_ 527 SGU14_Object_vx_Can03 0;
BA_ "GenSigInvalidValue" SG_ 527 SGU14_Object_vx_Can03 0;
BA_ "GenSigSendType" SG_ 527 SGU14_Object_vx_Can03 10;
BA_ "GenSigTimeoutValue" SG_ 527 SGU14_Object_vx_Can03 0;
BA_ "EventCommandSignal" SG_ 527 SGU14_Object_vy_Can03 0;
BA_ "GatewayedSignals" SG_ 527 SGU14_Object_vy_Can03 0;
BA_ "GenSigInvalidValue" SG_ 527 SGU14_Object_vy_Can03 0;
BA_ "GenSigSendType" SG_ 527 SGU14_Object_vy_Can03 10;
BA_ "GenSigTimeoutValue" SG_ 527 SGU14_Object_vy_Can03 0;
BA_ "EventCommandSignal" SG_ 527 SGU14_Object_wExist_Can03 0;
BA_ "GatewayedSignals" SG_ 527 SGU14_Object_wExist_Can03 0;
BA_ "GenSigInvalidValue" SG_ 527 SGU14_Object_wExist_Can03 0;
BA_ "GenSigSendType" SG_ 527 SGU14_Object_wExist_Can03 10;
BA_ "GenSigTimeoutValue" SG_ 527 SGU14_Object_wExist_Can03 0;
BA_ "EventCommandSignal" SG_ 527 SGU14_Object_wObstacle_Can03 0;
BA_ "GatewayedSignals" SG_ 527 SGU14_Object_wObstacle_Can03 0;
BA_ "GenSigInvalidValue" SG_ 527 SGU14_Object_wObstacle_Can03 0;
BA_ "GenSigSendType" SG_ 527 SGU14_Object_wObstacle_Can03 10;
BA_ "GenSigTimeoutValue" SG_ 527 SGU14_Object_wObstacle_Can03 0;
BA_ "EventCommandSignal" SG_ 528 SGU15_BlockCounter_Can03 0;
BA_ "GatewayedSignals" SG_ 528 SGU15_BlockCounter_Can03 0;
BA_ "GenSigInvalidValue" SG_ 528 SGU15_BlockCounter_Can03 0;
BA_ "GenSigSendType" SG_ 528 SGU15_BlockCounter_Can03 10;
BA_ "GenSigTimeoutValue" SG_ 528 SGU15_BlockCounter_Can03 0;
BA_ "EventCommandSignal" SG_ 528 SGU15_LifeCycles_OBJ_Can03 0;
BA_ "GatewayedSignals" SG_ 528 SGU15_LifeCycles_OBJ_Can03 0;
BA_ "GenSigInvalidValue" SG_ 528 SGU15_LifeCycles_OBJ_Can03 0;
BA_ "GenSigSendType" SG_ 528 SGU15_LifeCycles_OBJ_Can03 10;
BA_ "GenSigTimeoutValue" SG_ 528 SGU15_LifeCycles_OBJ_Can03 0;
BA_ "EventCommandSignal" SG_ 528 SGU15_Msg_AliveCounter_Can03 0;
BA_ "GatewayedSignals" SG_ 528 SGU15_Msg_AliveCounter_Can03 0;
BA_ "GenSigInvalidValue" SG_ 528 SGU15_Msg_AliveCounter_Can03 0;
BA_ "GenSigSendType" SG_ 528 SGU15_Msg_AliveCounter_Can03 10;
BA_ "GenSigTimeoutValue" SG_ 528 SGU15_Msg_AliveCounter_Can03 0;
BA_ "EventCommandSignal" SG_ 528 SGU15_Msg_CheckSum_Can03 0;
BA_ "GatewayedSignals" SG_ 528 SGU15_Msg_CheckSum_Can03 0;
BA_ "GenSigInvalidValue" SG_ 528 SGU15_Msg_CheckSum_Can03 0;
BA_ "GenSigSendType" SG_ 528 SGU15_Msg_CheckSum_Can03 10;
BA_ "GenSigTimeoutValue" SG_ 528 SGU15_Msg_CheckSum_Can03 0;
BA_ "IsCrcSignal" SG_ 528 SGU15_Msg_CheckSum_Can03 1;
BA_ "EventCommandSignal" SG_ 528 SGU15_ObjRCS_15_Can03 0;
BA_ "GatewayedSignals" SG_ 528 SGU15_ObjRCS_15_Can03 0;
BA_ "GenSigInvalidValue" SG_ 528 SGU15_ObjRCS_15_Can03 0;
BA_ "GenSigSendType" SG_ 528 SGU15_ObjRCS_15_Can03 10;
BA_ "GenSigTimeoutValue" SG_ 528 SGU15_ObjRCS_15_Can03 0;
BA_ "EventCommandSignal" SG_ 528 SGU15_Obj_DistLat_rms_Can03 0;
BA_ "GatewayedSignals" SG_ 528 SGU15_Obj_DistLat_rms_Can03 0;
BA_ "GenSigInvalidValue" SG_ 528 SGU15_Obj_DistLat_rms_Can03 0;
BA_ "GenSigSendType" SG_ 528 SGU15_Obj_DistLat_rms_Can03 10;
BA_ "GenSigTimeoutValue" SG_ 528 SGU15_Obj_DistLat_rms_Can03 0;
BA_ "EventCommandSignal" SG_ 528 SGU15_Obj_VrelLong_rms_Can03 0;
BA_ "GatewayedSignals" SG_ 528 SGU15_Obj_VrelLong_rms_Can03 0;
BA_ "GenSigInvalidValue" SG_ 528 SGU15_Obj_VrelLong_rms_Can03 0;
BA_ "GenSigSendType" SG_ 528 SGU15_Obj_VrelLong_rms_Can03 10;
BA_ "GenSigTimeoutValue" SG_ 528 SGU15_Obj_VrelLong_rms_Can03 0;
BA_ "EventCommandSignal" SG_ 528 SGU15_Obj_Vrelat_rms_Can03 0;
BA_ "GatewayedSignals" SG_ 528 SGU15_Obj_Vrelat_rms_Can03 0;
BA_ "GenSigInvalidValue" SG_ 528 SGU15_Obj_Vrelat_rms_Can03 0;
BA_ "GenSigSendType" SG_ 528 SGU15_Obj_Vrelat_rms_Can03 10;
BA_ "GenSigTimeoutValue" SG_ 528 SGU15_Obj_Vrelat_rms_Can03 0;
BA_ "EventCommandSignal" SG_ 528 SGU15_Object_DetStatus_Can03 0;
BA_ "GatewayedSignals" SG_ 528 SGU15_Object_DetStatus_Can03 0;
BA_ "GenSigInvalidValue" SG_ 528 SGU15_Object_DetStatus_Can03 0;
BA_ "GenSigSendType" SG_ 528 SGU15_Object_DetStatus_Can03 10;
BA_ "GenSigTimeoutValue" SG_ 528 SGU15_Object_DetStatus_Can03 0;
BA_ "EventCommandSignal" SG_ 528 SGU15_Object_DistLong_rms_Can03 0;
BA_ "GatewayedSignals" SG_ 528 SGU15_Object_DistLong_rms_Can03 0;
BA_ "GenSigInvalidValue" SG_ 528 SGU15_Object_DistLong_rms_Can03 0;
BA_ "GenSigSendType" SG_ 528 SGU15_Object_DistLong_rms_Can03 10;
BA_ "GenSigTimeoutValue" SG_ 528 SGU15_Object_DistLong_rms_Can03 0;
BA_ "EventCommandSignal" SG_ 528 SGU15_Object_ID_Can03 0;
BA_ "GatewayedSignals" SG_ 528 SGU15_Object_ID_Can03 0;
BA_ "GenSigInvalidValue" SG_ 528 SGU15_Object_ID_Can03 0;
BA_ "GenSigSendType" SG_ 528 SGU15_Object_ID_Can03 10;
BA_ "GenSigTimeoutValue" SG_ 528 SGU15_Object_ID_Can03 0;
BA_ "EventCommandSignal" SG_ 528 SGU15_Object_MotionPattern_Can03 0;
BA_ "GatewayedSignals" SG_ 528 SGU15_Object_MotionPattern_Can03 0;
BA_ "GenSigInvalidValue" SG_ 528 SGU15_Object_MotionPattern_Can03 0;
BA_ "GenSigSendType" SG_ 528 SGU15_Object_MotionPattern_Can03 10;
BA_ "GenSigTimeoutValue" SG_ 528 SGU15_Object_MotionPattern_Can03 0;
BA_ "EventCommandSignal" SG_ 528 SGU15_Object_Type_Can03 0;
BA_ "GatewayedSignals" SG_ 528 SGU15_Object_Type_Can03 0;
BA_ "GenSigInvalidValue" SG_ 528 SGU15_Object_Type_Can03 0;
BA_ "GenSigSendType" SG_ 528 SGU15_Object_Type_Can03 10;
BA_ "GenSigTimeoutValue" SG_ 528 SGU15_Object_Type_Can03 0;
BA_ "EventCommandSignal" SG_ 528 SGU15_Object_ax_Can03 0;
BA_ "GatewayedSignals" SG_ 528 SGU15_Object_ax_Can03 0;
BA_ "GenSigInvalidValue" SG_ 528 SGU15_Object_ax_Can03 0;
BA_ "GenSigSendType" SG_ 528 SGU15_Object_ax_Can03 10;
BA_ "GenSigTimeoutValue" SG_ 528 SGU15_Object_ax_Can03 0;
BA_ "EventCommandSignal" SG_ 528 SGU15_Object_ay_Can03 0;
BA_ "GatewayedSignals" SG_ 528 SGU15_Object_ay_Can03 0;
BA_ "GenSigInvalidValue" SG_ 528 SGU15_Object_ay_Can03 0;
BA_ "GenSigSendType" SG_ 528 SGU15_Object_ay_Can03 10;
BA_ "GenSigTimeoutValue" SG_ 528 SGU15_Object_ay_Can03 0;
BA_ "EventCommandSignal" SG_ 528 SGU15_Object_dx_Nearest_Can03 0;
BA_ "GatewayedSignals" SG_ 528 SGU15_Object_dx_Nearest_Can03 0;
BA_ "GenSigInvalidValue" SG_ 528 SGU15_Object_dx_Nearest_Can03 0;
BA_ "GenSigSendType" SG_ 528 SGU15_Object_dx_Nearest_Can03 1;
BA_ "GenSigTimeoutValue" SG_ 528 SGU15_Object_dx_Nearest_Can03 0;
BA_ "EventCommandSignal" SG_ 528 SGU15_Object_dx_Rear_Can03 0;
BA_ "GatewayedSignals" SG_ 528 SGU15_Object_dx_Rear_Can03 0;
BA_ "GenSigInvalidValue" SG_ 528 SGU15_Object_dx_Rear_Can03 0;
BA_ "GenSigSendType" SG_ 528 SGU15_Object_dx_Rear_Can03 10;
BA_ "GenSigTimeoutValue" SG_ 528 SGU15_Object_dx_Rear_Can03 0;
BA_ "EventCommandSignal" SG_ 528 SGU15_Object_dy_Nearest_Can03 0;
BA_ "GatewayedSignals" SG_ 528 SGU15_Object_dy_Nearest_Can03 0;
BA_ "GenSigInvalidValue" SG_ 528 SGU15_Object_dy_Nearest_Can03 0;
BA_ "GenSigSendType" SG_ 528 SGU15_Object_dy_Nearest_Can03 1;
BA_ "GenSigTimeoutValue" SG_ 528 SGU15_Object_dy_Nearest_Can03 0;
BA_ "EventCommandSignal" SG_ 528 SGU15_Object_dy_Rear_Can03 0;
BA_ "GatewayedSignals" SG_ 528 SGU15_Object_dy_Rear_Can03 0;
BA_ "GenSigInvalidValue" SG_ 528 SGU15_Object_dy_Rear_Can03 0;
BA_ "GenSigSendType" SG_ 528 SGU15_Object_dy_Rear_Can03 10;
BA_ "GenSigTimeoutValue" SG_ 528 SGU15_Object_dy_Rear_Can03 0;
BA_ "EventCommandSignal" SG_ 528 SGU15_Object_vx_Can03 0;
BA_ "GatewayedSignals" SG_ 528 SGU15_Object_vx_Can03 0;
BA_ "GenSigInvalidValue" SG_ 528 SGU15_Object_vx_Can03 0;
BA_ "GenSigSendType" SG_ 528 SGU15_Object_vx_Can03 10;
BA_ "GenSigTimeoutValue" SG_ 528 SGU15_Object_vx_Can03 0;
BA_ "EventCommandSignal" SG_ 528 SGU15_Object_vy_Can03 0;
BA_ "GatewayedSignals" SG_ 528 SGU15_Object_vy_Can03 0;
BA_ "GenSigInvalidValue" SG_ 528 SGU15_Object_vy_Can03 0;
BA_ "GenSigSendType" SG_ 528 SGU15_Object_vy_Can03 10;
BA_ "GenSigTimeoutValue" SG_ 528 SGU15_Object_vy_Can03 0;
BA_ "EventCommandSignal" SG_ 528 SGU15_Object_wExist_Can03 0;
BA_ "GatewayedSignals" SG_ 528 SGU15_Object_wExist_Can03 0;
BA_ "GenSigInvalidValue" SG_ 528 SGU15_Object_wExist_Can03 0;
BA_ "GenSigSendType" SG_ 528 SGU15_Object_wExist_Can03 10;
BA_ "GenSigTimeoutValue" SG_ 528 SGU15_Object_wExist_Can03 0;
BA_ "EventCommandSignal" SG_ 528 SGU15_Object_wObstacle_Can03 0;
BA_ "GatewayedSignals" SG_ 528 SGU15_Object_wObstacle_Can03 0;
BA_ "GenSigInvalidValue" SG_ 528 SGU15_Object_wObstacle_Can03 0;
BA_ "GenSigSendType" SG_ 528 SGU15_Object_wObstacle_Can03 10;
BA_ "GenSigTimeoutValue" SG_ 528 SGU15_Object_wObstacle_Can03 0;
BA_ "EventCommandSignal" SG_ 529 SGU16_BlockCounter_Can03 0;
BA_ "GatewayedSignals" SG_ 529 SGU16_BlockCounter_Can03 0;
BA_ "GenSigInvalidValue" SG_ 529 SGU16_BlockCounter_Can03 0;
BA_ "GenSigSendType" SG_ 529 SGU16_BlockCounter_Can03 10;
BA_ "GenSigTimeoutValue" SG_ 529 SGU16_BlockCounter_Can03 0;
BA_ "EventCommandSignal" SG_ 529 SGU16_LifeCycles_OBJ_Can03 0;
BA_ "GatewayedSignals" SG_ 529 SGU16_LifeCycles_OBJ_Can03 0;
BA_ "GenSigInvalidValue" SG_ 529 SGU16_LifeCycles_OBJ_Can03 0;
BA_ "GenSigSendType" SG_ 529 SGU16_LifeCycles_OBJ_Can03 10;
BA_ "GenSigTimeoutValue" SG_ 529 SGU16_LifeCycles_OBJ_Can03 0;
BA_ "EventCommandSignal" SG_ 529 SGU16_Msg_AliveCounter_Can03 0;
BA_ "GatewayedSignals" SG_ 529 SGU16_Msg_AliveCounter_Can03 0;
BA_ "GenSigInvalidValue" SG_ 529 SGU16_Msg_AliveCounter_Can03 0;
BA_ "GenSigSendType" SG_ 529 SGU16_Msg_AliveCounter_Can03 10;
BA_ "GenSigTimeoutValue" SG_ 529 SGU16_Msg_AliveCounter_Can03 0;
BA_ "EventCommandSignal" SG_ 529 SGU16_Msg_CheckSum_Can03 0;
BA_ "GatewayedSignals" SG_ 529 SGU16_Msg_CheckSum_Can03 0;
BA_ "GenSigInvalidValue" SG_ 529 SGU16_Msg_CheckSum_Can03 0;
BA_ "GenSigSendType" SG_ 529 SGU16_Msg_CheckSum_Can03 10;
BA_ "GenSigTimeoutValue" SG_ 529 SGU16_Msg_CheckSum_Can03 0;
BA_ "IsCrcSignal" SG_ 529 SGU16_Msg_CheckSum_Can03 1;
BA_ "EventCommandSignal" SG_ 529 SGU16_ObjRCS_16_Can03 0;
BA_ "GatewayedSignals" SG_ 529 SGU16_ObjRCS_16_Can03 0;
BA_ "GenSigInvalidValue" SG_ 529 SGU16_ObjRCS_16_Can03 0;
BA_ "GenSigSendType" SG_ 529 SGU16_ObjRCS_16_Can03 10;
BA_ "GenSigTimeoutValue" SG_ 529 SGU16_ObjRCS_16_Can03 0;
BA_ "EventCommandSignal" SG_ 529 SGU16_Obj_DistLat_rms_Can03 0;
BA_ "GatewayedSignals" SG_ 529 SGU16_Obj_DistLat_rms_Can03 0;
BA_ "GenSigInvalidValue" SG_ 529 SGU16_Obj_DistLat_rms_Can03 0;
BA_ "GenSigSendType" SG_ 529 SGU16_Obj_DistLat_rms_Can03 10;
BA_ "GenSigTimeoutValue" SG_ 529 SGU16_Obj_DistLat_rms_Can03 0;
BA_ "EventCommandSignal" SG_ 529 SGU16_Obj_VrelLong_rms_Can03 0;
BA_ "GatewayedSignals" SG_ 529 SGU16_Obj_VrelLong_rms_Can03 0;
BA_ "GenSigInvalidValue" SG_ 529 SGU16_Obj_VrelLong_rms_Can03 0;
BA_ "GenSigSendType" SG_ 529 SGU16_Obj_VrelLong_rms_Can03 10;
BA_ "GenSigTimeoutValue" SG_ 529 SGU16_Obj_VrelLong_rms_Can03 0;
BA_ "EventCommandSignal" SG_ 529 SGU16_Obj_Vrelat_rms_Can03 0;
BA_ "GatewayedSignals" SG_ 529 SGU16_Obj_Vrelat_rms_Can03 0;
BA_ "GenSigInvalidValue" SG_ 529 SGU16_Obj_Vrelat_rms_Can03 0;
BA_ "GenSigSendType" SG_ 529 SGU16_Obj_Vrelat_rms_Can03 10;
BA_ "GenSigTimeoutValue" SG_ 529 SGU16_Obj_Vrelat_rms_Can03 0;
BA_ "EventCommandSignal" SG_ 529 SGU16_Object_DetStatus_Can03 0;
BA_ "GatewayedSignals" SG_ 529 SGU16_Object_DetStatus_Can03 0;
BA_ "GenSigInvalidValue" SG_ 529 SGU16_Object_DetStatus_Can03 0;
BA_ "GenSigSendType" SG_ 529 SGU16_Object_DetStatus_Can03 10;
BA_ "GenSigTimeoutValue" SG_ 529 SGU16_Object_DetStatus_Can03 0;
BA_ "EventCommandSignal" SG_ 529 SGU16_Object_DistLong_rms_Can03 0;
BA_ "GatewayedSignals" SG_ 529 SGU16_Object_DistLong_rms_Can03 0;
BA_ "GenSigInvalidValue" SG_ 529 SGU16_Object_DistLong_rms_Can03 0;
BA_ "GenSigSendType" SG_ 529 SGU16_Object_DistLong_rms_Can03 10;
BA_ "GenSigTimeoutValue" SG_ 529 SGU16_Object_DistLong_rms_Can03 0;
BA_ "EventCommandSignal" SG_ 529 SGU16_Object_ID_Can03 0;
BA_ "GatewayedSignals" SG_ 529 SGU16_Object_ID_Can03 0;
BA_ "GenSigInvalidValue" SG_ 529 SGU16_Object_ID_Can03 0;
BA_ "GenSigSendType" SG_ 529 SGU16_Object_ID_Can03 10;
BA_ "GenSigTimeoutValue" SG_ 529 SGU16_Object_ID_Can03 0;
BA_ "EventCommandSignal" SG_ 529 SGU16_Object_MotionPattern_Can03 0;
BA_ "GatewayedSignals" SG_ 529 SGU16_Object_MotionPattern_Can03 0;
BA_ "GenSigInvalidValue" SG_ 529 SGU16_Object_MotionPattern_Can03 0;
BA_ "GenSigSendType" SG_ 529 SGU16_Object_MotionPattern_Can03 10;
BA_ "GenSigTimeoutValue" SG_ 529 SGU16_Object_MotionPattern_Can03 0;
BA_ "EventCommandSignal" SG_ 529 SGU16_Object_Type_Can03 0;
BA_ "GatewayedSignals" SG_ 529 SGU16_Object_Type_Can03 0;
BA_ "GenSigInvalidValue" SG_ 529 SGU16_Object_Type_Can03 0;
BA_ "GenSigSendType" SG_ 529 SGU16_Object_Type_Can03 10;
BA_ "GenSigTimeoutValue" SG_ 529 SGU16_Object_Type_Can03 0;
BA_ "EventCommandSignal" SG_ 529 SGU16_Object_ax_Can03 0;
BA_ "GatewayedSignals" SG_ 529 SGU16_Object_ax_Can03 0;
BA_ "GenSigInvalidValue" SG_ 529 SGU16_Object_ax_Can03 0;
BA_ "GenSigSendType" SG_ 529 SGU16_Object_ax_Can03 10;
BA_ "GenSigTimeoutValue" SG_ 529 SGU16_Object_ax_Can03 0;
BA_ "EventCommandSignal" SG_ 529 SGU16_Object_ay_Can03 0;
BA_ "GatewayedSignals" SG_ 529 SGU16_Object_ay_Can03 0;
BA_ "GenSigInvalidValue" SG_ 529 SGU16_Object_ay_Can03 0;
BA_ "GenSigSendType" SG_ 529 SGU16_Object_ay_Can03 10;
BA_ "GenSigTimeoutValue" SG_ 529 SGU16_Object_ay_Can03 0;
BA_ "EventCommandSignal" SG_ 529 SGU16_Object_dx_Nearest_Can03 0;
BA_ "GatewayedSignals" SG_ 529 SGU16_Object_dx_Nearest_Can03 0;
BA_ "GenSigInvalidValue" SG_ 529 SGU16_Object_dx_Nearest_Can03 0;
BA_ "GenSigSendType" SG_ 529 SGU16_Object_dx_Nearest_Can03 1;
BA_ "GenSigTimeoutValue" SG_ 529 SGU16_Object_dx_Nearest_Can03 0;
BA_ "EventCommandSignal" SG_ 529 SGU16_Object_dx_Rear_Can03 0;
BA_ "GatewayedSignals" SG_ 529 SGU16_Object_dx_Rear_Can03 0;
BA_ "GenSigInvalidValue" SG_ 529 SGU16_Object_dx_Rear_Can03 0;
BA_ "GenSigSendType" SG_ 529 SGU16_Object_dx_Rear_Can03 10;
BA_ "GenSigTimeoutValue" SG_ 529 SGU16_Object_dx_Rear_Can03 0;
BA_ "EventCommandSignal" SG_ 529 SGU16_Object_dy_Nearest_Can03 0;
BA_ "GatewayedSignals" SG_ 529 SGU16_Object_dy_Nearest_Can03 0;
BA_ "GenSigInvalidValue" SG_ 529 SGU16_Object_dy_Nearest_Can03 0;
BA_ "GenSigSendType" SG_ 529 SGU16_Object_dy_Nearest_Can03 1;
BA_ "GenSigTimeoutValue" SG_ 529 SGU16_Object_dy_Nearest_Can03 0;
BA_ "EventCommandSignal" SG_ 529 SGU16_Object_dy_Rear_Can03 0;
BA_ "GatewayedSignals" SG_ 529 SGU16_Object_dy_Rear_Can03 0;
BA_ "GenSigInvalidValue" SG_ 529 SGU16_Object_dy_Rear_Can03 0;
BA_ "GenSigSendType" SG_ 529 SGU16_Object_dy_Rear_Can03 10;
BA_ "GenSigTimeoutValue" SG_ 529 SGU16_Object_dy_Rear_Can03 0;
BA_ "EventCommandSignal" SG_ 529 SGU16_Object_vx_Can03 0;
BA_ "GatewayedSignals" SG_ 529 SGU16_Object_vx_Can03 0;
BA_ "GenSigInvalidValue" SG_ 529 SGU16_Object_vx_Can03 0;
BA_ "GenSigSendType" SG_ 529 SGU16_Object_vx_Can03 10;
BA_ "GenSigTimeoutValue" SG_ 529 SGU16_Object_vx_Can03 0;
BA_ "EventCommandSignal" SG_ 529 SGU16_Object_vy_Can03 0;
BA_ "GatewayedSignals" SG_ 529 SGU16_Object_vy_Can03 0;
BA_ "GenSigInvalidValue" SG_ 529 SGU16_Object_vy_Can03 0;
BA_ "GenSigSendType" SG_ 529 SGU16_Object_vy_Can03 10;
BA_ "GenSigTimeoutValue" SG_ 529 SGU16_Object_vy_Can03 0;
BA_ "EventCommandSignal" SG_ 529 SGU16_Object_wExist_Can03 0;
BA_ "GatewayedSignals" SG_ 529 SGU16_Object_wExist_Can03 0;
BA_ "GenSigInvalidValue" SG_ 529 SGU16_Object_wExist_Can03 0;
BA_ "GenSigSendType" SG_ 529 SGU16_Object_wExist_Can03 10;
BA_ "GenSigTimeoutValue" SG_ 529 SGU16_Object_wExist_Can03 0;
BA_ "EventCommandSignal" SG_ 529 SGU16_Object_wObstacle_Can03 0;
BA_ "GatewayedSignals" SG_ 529 SGU16_Object_wObstacle_Can03 0;
BA_ "GenSigInvalidValue" SG_ 529 SGU16_Object_wObstacle_Can03 0;
BA_ "GenSigSendType" SG_ 529 SGU16_Object_wObstacle_Can03 10;
BA_ "GenSigTimeoutValue" SG_ 529 SGU16_Object_wObstacle_Can03 0;
BA_ "EventCommandSignal" SG_ 530 SGU17_BlockCounter_Can03 0;
BA_ "GatewayedSignals" SG_ 530 SGU17_BlockCounter_Can03 0;
BA_ "GenSigInvalidValue" SG_ 530 SGU17_BlockCounter_Can03 0;
BA_ "GenSigSendType" SG_ 530 SGU17_BlockCounter_Can03 10;
BA_ "GenSigTimeoutValue" SG_ 530 SGU17_BlockCounter_Can03 0;
BA_ "EventCommandSignal" SG_ 530 SGU17_LifeCycles_OBJ_Can03 0;
BA_ "GatewayedSignals" SG_ 530 SGU17_LifeCycles_OBJ_Can03 0;
BA_ "GenSigInvalidValue" SG_ 530 SGU17_LifeCycles_OBJ_Can03 0;
BA_ "GenSigSendType" SG_ 530 SGU17_LifeCycles_OBJ_Can03 10;
BA_ "GenSigTimeoutValue" SG_ 530 SGU17_LifeCycles_OBJ_Can03 0;
BA_ "EventCommandSignal" SG_ 530 SGU17_Msg_AliveCounter_Can03 0;
BA_ "GatewayedSignals" SG_ 530 SGU17_Msg_AliveCounter_Can03 0;
BA_ "GenSigInvalidValue" SG_ 530 SGU17_Msg_AliveCounter_Can03 0;
BA_ "GenSigSendType" SG_ 530 SGU17_Msg_AliveCounter_Can03 10;
BA_ "GenSigTimeoutValue" SG_ 530 SGU17_Msg_AliveCounter_Can03 0;
BA_ "EventCommandSignal" SG_ 530 SGU17_Msg_CheckSum_Can03 0;
BA_ "GatewayedSignals" SG_ 530 SGU17_Msg_CheckSum_Can03 0;
BA_ "GenSigInvalidValue" SG_ 530 SGU17_Msg_CheckSum_Can03 0;
BA_ "GenSigSendType" SG_ 530 SGU17_Msg_CheckSum_Can03 10;
BA_ "GenSigTimeoutValue" SG_ 530 SGU17_Msg_CheckSum_Can03 0;
BA_ "IsCrcSignal" SG_ 530 SGU17_Msg_CheckSum_Can03 1;
BA_ "EventCommandSignal" SG_ 530 SGU17_ObjRCS_17_Can03 0;
BA_ "GatewayedSignals" SG_ 530 SGU17_ObjRCS_17_Can03 0;
BA_ "GenSigInvalidValue" SG_ 530 SGU17_ObjRCS_17_Can03 0;
BA_ "GenSigSendType" SG_ 530 SGU17_ObjRCS_17_Can03 10;
BA_ "GenSigTimeoutValue" SG_ 530 SGU17_ObjRCS_17_Can03 0;
BA_ "EventCommandSignal" SG_ 530 SGU17_Obj_DistLat_rms_Can03 0;
BA_ "GatewayedSignals" SG_ 530 SGU17_Obj_DistLat_rms_Can03 0;
BA_ "GenSigInvalidValue" SG_ 530 SGU17_Obj_DistLat_rms_Can03 0;
BA_ "GenSigSendType" SG_ 530 SGU17_Obj_DistLat_rms_Can03 10;
BA_ "GenSigTimeoutValue" SG_ 530 SGU17_Obj_DistLat_rms_Can03 0;
BA_ "EventCommandSignal" SG_ 530 SGU17_Obj_VrelLong_rms_Can03 0;
BA_ "GatewayedSignals" SG_ 530 SGU17_Obj_VrelLong_rms_Can03 0;
BA_ "GenSigInvalidValue" SG_ 530 SGU17_Obj_VrelLong_rms_Can03 0;
BA_ "GenSigSendType" SG_ 530 SGU17_Obj_VrelLong_rms_Can03 10;
BA_ "GenSigTimeoutValue" SG_ 530 SGU17_Obj_VrelLong_rms_Can03 0;
BA_ "EventCommandSignal" SG_ 530 SGU17_Obj_Vrelat_rms_Can03 0;
BA_ "GatewayedSignals" SG_ 530 SGU17_Obj_Vrelat_rms_Can03 0;
BA_ "GenSigInvalidValue" SG_ 530 SGU17_Obj_Vrelat_rms_Can03 0;
BA_ "GenSigSendType" SG_ 530 SGU17_Obj_Vrelat_rms_Can03 10;
BA_ "GenSigTimeoutValue" SG_ 530 SGU17_Obj_Vrelat_rms_Can03 0;
BA_ "EventCommandSignal" SG_ 530 SGU17_Object_DetStatus_Can03 0;
BA_ "GatewayedSignals" SG_ 530 SGU17_Object_DetStatus_Can03 0;
BA_ "GenSigInvalidValue" SG_ 530 SGU17_Object_DetStatus_Can03 0;
BA_ "GenSigSendType" SG_ 530 SGU17_Object_DetStatus_Can03 10;
BA_ "GenSigTimeoutValue" SG_ 530 SGU17_Object_DetStatus_Can03 0;
BA_ "EventCommandSignal" SG_ 530 SGU17_Object_DistLong_rms_Can03 0;
BA_ "GatewayedSignals" SG_ 530 SGU17_Object_DistLong_rms_Can03 0;
BA_ "GenSigInvalidValue" SG_ 530 SGU17_Object_DistLong_rms_Can03 0;
BA_ "GenSigSendType" SG_ 530 SGU17_Object_DistLong_rms_Can03 10;
BA_ "GenSigTimeoutValue" SG_ 530 SGU17_Object_DistLong_rms_Can03 0;
BA_ "EventCommandSignal" SG_ 530 SGU17_Object_ID_Can03 0;
BA_ "GatewayedSignals" SG_ 530 SGU17_Object_ID_Can03 0;
BA_ "GenSigInvalidValue" SG_ 530 SGU17_Object_ID_Can03 0;
BA_ "GenSigSendType" SG_ 530 SGU17_Object_ID_Can03 10;
BA_ "GenSigTimeoutValue" SG_ 530 SGU17_Object_ID_Can03 0;
BA_ "EventCommandSignal" SG_ 530 SGU17_Object_MotionPattern_Can03 0;
BA_ "GatewayedSignals" SG_ 530 SGU17_Object_MotionPattern_Can03 0;
BA_ "GenSigInvalidValue" SG_ 530 SGU17_Object_MotionPattern_Can03 0;
BA_ "GenSigSendType" SG_ 530 SGU17_Object_MotionPattern_Can03 10;
BA_ "GenSigTimeoutValue" SG_ 530 SGU17_Object_MotionPattern_Can03 0;
BA_ "EventCommandSignal" SG_ 530 SGU17_Object_Type_Can03 0;
BA_ "GatewayedSignals" SG_ 530 SGU17_Object_Type_Can03 0;
BA_ "GenSigInvalidValue" SG_ 530 SGU17_Object_Type_Can03 0;
BA_ "GenSigSendType" SG_ 530 SGU17_Object_Type_Can03 10;
BA_ "GenSigTimeoutValue" SG_ 530 SGU17_Object_Type_Can03 0;
BA_ "EventCommandSignal" SG_ 530 SGU17_Object_ax_Can03 0;
BA_ "GatewayedSignals" SG_ 530 SGU17_Object_ax_Can03 0;
BA_ "GenSigInvalidValue" SG_ 530 SGU17_Object_ax_Can03 0;
BA_ "GenSigSendType" SG_ 530 SGU17_Object_ax_Can03 10;
BA_ "GenSigTimeoutValue" SG_ 530 SGU17_Object_ax_Can03 0;
BA_ "EventCommandSignal" SG_ 530 SGU17_Object_ay_Can03 0;
BA_ "GatewayedSignals" SG_ 530 SGU17_Object_ay_Can03 0;
BA_ "GenSigInvalidValue" SG_ 530 SGU17_Object_ay_Can03 0;
BA_ "GenSigSendType" SG_ 530 SGU17_Object_ay_Can03 10;
BA_ "GenSigTimeoutValue" SG_ 530 SGU17_Object_ay_Can03 0;
BA_ "EventCommandSignal" SG_ 530 SGU17_Object_dx_Nearest_Can03 0;
BA_ "GatewayedSignals" SG_ 530 SGU17_Object_dx_Nearest_Can03 0;
BA_ "GenSigInvalidValue" SG_ 530 SGU17_Object_dx_Nearest_Can03 0;
BA_ "GenSigSendType" SG_ 530 SGU17_Object_dx_Nearest_Can03 1;
BA_ "GenSigTimeoutValue" SG_ 530 SGU17_Object_dx_Nearest_Can03 0;
BA_ "EventCommandSignal" SG_ 530 SGU17_Object_dx_Rear_Can03 0;
BA_ "GatewayedSignals" SG_ 530 SGU17_Object_dx_Rear_Can03 0;
BA_ "GenSigInvalidValue" SG_ 530 SGU17_Object_dx_Rear_Can03 0;
BA_ "GenSigSendType" SG_ 530 SGU17_Object_dx_Rear_Can03 10;
BA_ "GenSigTimeoutValue" SG_ 530 SGU17_Object_dx_Rear_Can03 0;
BA_ "EventCommandSignal" SG_ 530 SGU17_Object_dy_Nearest_Can03 0;
BA_ "GatewayedSignals" SG_ 530 SGU17_Object_dy_Nearest_Can03 0;
BA_ "GenSigInvalidValue" SG_ 530 SGU17_Object_dy_Nearest_Can03 0;
BA_ "GenSigSendType" SG_ 530 SGU17_Object_dy_Nearest_Can03 1;
BA_ "GenSigTimeoutValue" SG_ 530 SGU17_Object_dy_Nearest_Can03 0;
BA_ "EventCommandSignal" SG_ 530 SGU17_Object_dy_Rear_Can03 0;
BA_ "GatewayedSignals" SG_ 530 SGU17_Object_dy_Rear_Can03 0;
BA_ "GenSigInvalidValue" SG_ 530 SGU17_Object_dy_Rear_Can03 0;
BA_ "GenSigSendType" SG_ 530 SGU17_Object_dy_Rear_Can03 10;
BA_ "GenSigTimeoutValue" SG_ 530 SGU17_Object_dy_Rear_Can03 0;
BA_ "EventCommandSignal" SG_ 530 SGU17_Object_vx_Can03 0;
BA_ "GatewayedSignals" SG_ 530 SGU17_Object_vx_Can03 0;
BA_ "GenSigInvalidValue" SG_ 530 SGU17_Object_vx_Can03 0;
BA_ "GenSigSendType" SG_ 530 SGU17_Object_vx_Can03 10;
BA_ "GenSigTimeoutValue" SG_ 530 SGU17_Object_vx_Can03 0;
BA_ "EventCommandSignal" SG_ 530 SGU17_Object_vy_Can03 0;
BA_ "GatewayedSignals" SG_ 530 SGU17_Object_vy_Can03 0;
BA_ "GenSigInvalidValue" SG_ 530 SGU17_Object_vy_Can03 0;
BA_ "GenSigSendType" SG_ 530 SGU17_Object_vy_Can03 10;
BA_ "GenSigTimeoutValue" SG_ 530 SGU17_Object_vy_Can03 0;
BA_ "EventCommandSignal" SG_ 530 SGU17_Object_wExist_Can03 0;
BA_ "GatewayedSignals" SG_ 530 SGU17_Object_wExist_Can03 0;
BA_ "GenSigInvalidValue" SG_ 530 SGU17_Object_wExist_Can03 0;
BA_ "GenSigSendType" SG_ 530 SGU17_Object_wExist_Can03 10;
BA_ "GenSigTimeoutValue" SG_ 530 SGU17_Object_wExist_Can03 0;
BA_ "EventCommandSignal" SG_ 530 SGU17_Object_wObstacle_Can03 0;
BA_ "GatewayedSignals" SG_ 530 SGU17_Object_wObstacle_Can03 0;
BA_ "GenSigInvalidValue" SG_ 530 SGU17_Object_wObstacle_Can03 0;
BA_ "GenSigSendType" SG_ 530 SGU17_Object_wObstacle_Can03 10;
BA_ "GenSigTimeoutValue" SG_ 530 SGU17_Object_wObstacle_Can03 0;
BA_ "EventCommandSignal" SG_ 531 SGU18_BlockCounter_Can03 0;
BA_ "GatewayedSignals" SG_ 531 SGU18_BlockCounter_Can03 0;
BA_ "GenSigInvalidValue" SG_ 531 SGU18_BlockCounter_Can03 0;
BA_ "GenSigSendType" SG_ 531 SGU18_BlockCounter_Can03 10;
BA_ "GenSigTimeoutValue" SG_ 531 SGU18_BlockCounter_Can03 0;
BA_ "EventCommandSignal" SG_ 531 SGU18_LifeCycles_OBJ_Can03 0;
BA_ "GatewayedSignals" SG_ 531 SGU18_LifeCycles_OBJ_Can03 0;
BA_ "GenSigInvalidValue" SG_ 531 SGU18_LifeCycles_OBJ_Can03 0;
BA_ "GenSigSendType" SG_ 531 SGU18_LifeCycles_OBJ_Can03 10;
BA_ "GenSigTimeoutValue" SG_ 531 SGU18_LifeCycles_OBJ_Can03 0;
BA_ "EventCommandSignal" SG_ 531 SGU18_Msg_AliveCounter_Can03 0;
BA_ "GatewayedSignals" SG_ 531 SGU18_Msg_AliveCounter_Can03 0;
BA_ "GenSigInvalidValue" SG_ 531 SGU18_Msg_AliveCounter_Can03 0;
BA_ "GenSigSendType" SG_ 531 SGU18_Msg_AliveCounter_Can03 10;
BA_ "GenSigTimeoutValue" SG_ 531 SGU18_Msg_AliveCounter_Can03 0;
BA_ "EventCommandSignal" SG_ 531 SGU18_Msg_CheckSum_Can03 0;
BA_ "GatewayedSignals" SG_ 531 SGU18_Msg_CheckSum_Can03 0;
BA_ "GenSigInvalidValue" SG_ 531 SGU18_Msg_CheckSum_Can03 0;
BA_ "GenSigSendType" SG_ 531 SGU18_Msg_CheckSum_Can03 10;
BA_ "GenSigTimeoutValue" SG_ 531 SGU18_Msg_CheckSum_Can03 0;
BA_ "IsCrcSignal" SG_ 531 SGU18_Msg_CheckSum_Can03 1;
BA_ "EventCommandSignal" SG_ 531 SGU18_ObjRCS_18_Can03 0;
BA_ "GatewayedSignals" SG_ 531 SGU18_ObjRCS_18_Can03 0;
BA_ "GenSigInvalidValue" SG_ 531 SGU18_ObjRCS_18_Can03 0;
BA_ "GenSigSendType" SG_ 531 SGU18_ObjRCS_18_Can03 10;
BA_ "GenSigTimeoutValue" SG_ 531 SGU18_ObjRCS_18_Can03 0;
BA_ "EventCommandSignal" SG_ 531 SGU18_Obj_DistLat_rms_Can03 0;
BA_ "GatewayedSignals" SG_ 531 SGU18_Obj_DistLat_rms_Can03 0;
BA_ "GenSigInvalidValue" SG_ 531 SGU18_Obj_DistLat_rms_Can03 0;
BA_ "GenSigSendType" SG_ 531 SGU18_Obj_DistLat_rms_Can03 10;
BA_ "GenSigTimeoutValue" SG_ 531 SGU18_Obj_DistLat_rms_Can03 0;
BA_ "EventCommandSignal" SG_ 531 SGU18_Obj_VrelLong_rms_Can03 0;
BA_ "GatewayedSignals" SG_ 531 SGU18_Obj_VrelLong_rms_Can03 0;
BA_ "GenSigInvalidValue" SG_ 531 SGU18_Obj_VrelLong_rms_Can03 0;
BA_ "GenSigSendType" SG_ 531 SGU18_Obj_VrelLong_rms_Can03 10;
BA_ "GenSigTimeoutValue" SG_ 531 SGU18_Obj_VrelLong_rms_Can03 0;
BA_ "EventCommandSignal" SG_ 531 SGU18_Obj_Vrelat_rms_Can03 0;
BA_ "GatewayedSignals" SG_ 531 SGU18_Obj_Vrelat_rms_Can03 0;
BA_ "GenSigInvalidValue" SG_ 531 SGU18_Obj_Vrelat_rms_Can03 0;
BA_ "GenSigSendType" SG_ 531 SGU18_Obj_Vrelat_rms_Can03 10;
BA_ "GenSigTimeoutValue" SG_ 531 SGU18_Obj_Vrelat_rms_Can03 0;
BA_ "EventCommandSignal" SG_ 531 SGU18_Object_DetStatus_Can03 0;
BA_ "GatewayedSignals" SG_ 531 SGU18_Object_DetStatus_Can03 0;
BA_ "GenSigInvalidValue" SG_ 531 SGU18_Object_DetStatus_Can03 0;
BA_ "GenSigSendType" SG_ 531 SGU18_Object_DetStatus_Can03 10;
BA_ "GenSigTimeoutValue" SG_ 531 SGU18_Object_DetStatus_Can03 0;
BA_ "EventCommandSignal" SG_ 531 SGU18_Object_DistLong_rms_Can03 0;
BA_ "GatewayedSignals" SG_ 531 SGU18_Object_DistLong_rms_Can03 0;
BA_ "GenSigInvalidValue" SG_ 531 SGU18_Object_DistLong_rms_Can03 0;
BA_ "GenSigSendType" SG_ 531 SGU18_Object_DistLong_rms_Can03 10;
BA_ "GenSigTimeoutValue" SG_ 531 SGU18_Object_DistLong_rms_Can03 0;
BA_ "EventCommandSignal" SG_ 531 SGU18_Object_ID_Can03 0;
BA_ "GatewayedSignals" SG_ 531 SGU18_Object_ID_Can03 0;
BA_ "GenSigInvalidValue" SG_ 531 SGU18_Object_ID_Can03 0;
BA_ "GenSigSendType" SG_ 531 SGU18_Object_ID_Can03 10;
BA_ "GenSigTimeoutValue" SG_ 531 SGU18_Object_ID_Can03 0;
BA_ "EventCommandSignal" SG_ 531 SGU18_Object_MotionPattern_Can03 0;
BA_ "GatewayedSignals" SG_ 531 SGU18_Object_MotionPattern_Can03 0;
BA_ "GenSigInvalidValue" SG_ 531 SGU18_Object_MotionPattern_Can03 0;
BA_ "GenSigSendType" SG_ 531 SGU18_Object_MotionPattern_Can03 10;
BA_ "GenSigTimeoutValue" SG_ 531 SGU18_Object_MotionPattern_Can03 0;
BA_ "EventCommandSignal" SG_ 531 SGU18_Object_Type_Can03 0;
BA_ "GatewayedSignals" SG_ 531 SGU18_Object_Type_Can03 0;
BA_ "GenSigInvalidValue" SG_ 531 SGU18_Object_Type_Can03 0;
BA_ "GenSigSendType" SG_ 531 SGU18_Object_Type_Can03 10;
BA_ "GenSigTimeoutValue" SG_ 531 SGU18_Object_Type_Can03 0;
BA_ "EventCommandSignal" SG_ 531 SGU18_Object_ax_Can03 0;
BA_ "GatewayedSignals" SG_ 531 SGU18_Object_ax_Can03 0;
BA_ "GenSigInvalidValue" SG_ 531 SGU18_Object_ax_Can03 0;
BA_ "GenSigSendType" SG_ 531 SGU18_Object_ax_Can03 10;
BA_ "GenSigTimeoutValue" SG_ 531 SGU18_Object_ax_Can03 0;
BA_ "EventCommandSignal" SG_ 531 SGU18_Object_ay_Can03 0;
BA_ "GatewayedSignals" SG_ 531 SGU18_Object_ay_Can03 0;
BA_ "GenSigInvalidValue" SG_ 531 SGU18_Object_ay_Can03 0;
BA_ "GenSigSendType" SG_ 531 SGU18_Object_ay_Can03 10;
BA_ "GenSigTimeoutValue" SG_ 531 SGU18_Object_ay_Can03 0;
BA_ "EventCommandSignal" SG_ 531 SGU18_Object_dx_Nearest_Can03 0;
BA_ "GatewayedSignals" SG_ 531 SGU18_Object_dx_Nearest_Can03 0;
BA_ "GenSigInvalidValue" SG_ 531 SGU18_Object_dx_Nearest_Can03 0;
BA_ "GenSigSendType" SG_ 531 SGU18_Object_dx_Nearest_Can03 1;
BA_ "GenSigTimeoutValue" SG_ 531 SGU18_Object_dx_Nearest_Can03 0;
BA_ "EventCommandSignal" SG_ 531 SGU18_Object_dx_Rear_Can03 0;
BA_ "GatewayedSignals" SG_ 531 SGU18_Object_dx_Rear_Can03 0;
BA_ "GenSigInvalidValue" SG_ 531 SGU18_Object_dx_Rear_Can03 0;
BA_ "GenSigSendType" SG_ 531 SGU18_Object_dx_Rear_Can03 10;
BA_ "GenSigTimeoutValue" SG_ 531 SGU18_Object_dx_Rear_Can03 0;
BA_ "EventCommandSignal" SG_ 531 SGU18_Object_dy_Nearest_Can03 0;
BA_ "GatewayedSignals" SG_ 531 SGU18_Object_dy_Nearest_Can03 0;
BA_ "GenSigInvalidValue" SG_ 531 SGU18_Object_dy_Nearest_Can03 0;
BA_ "GenSigSendType" SG_ 531 SGU18_Object_dy_Nearest_Can03 1;
BA_ "GenSigTimeoutValue" SG_ 531 SGU18_Object_dy_Nearest_Can03 0;
BA_ "EventCommandSignal" SG_ 531 SGU18_Object_dy_Rear_Can03 0;
BA_ "GatewayedSignals" SG_ 531 SGU18_Object_dy_Rear_Can03 0;
BA_ "GenSigInvalidValue" SG_ 531 SGU18_Object_dy_Rear_Can03 0;
BA_ "GenSigSendType" SG_ 531 SGU18_Object_dy_Rear_Can03 10;
BA_ "GenSigTimeoutValue" SG_ 531 SGU18_Object_dy_Rear_Can03 0;
BA_ "EventCommandSignal" SG_ 531 SGU18_Object_vx_Can03 0;
BA_ "GatewayedSignals" SG_ 531 SGU18_Object_vx_Can03 0;
BA_ "GenSigInvalidValue" SG_ 531 SGU18_Object_vx_Can03 0;
BA_ "GenSigSendType" SG_ 531 SGU18_Object_vx_Can03 10;
BA_ "GenSigTimeoutValue" SG_ 531 SGU18_Object_vx_Can03 0;
BA_ "EventCommandSignal" SG_ 531 SGU18_Object_vy_Can03 0;
BA_ "GatewayedSignals" SG_ 531 SGU18_Object_vy_Can03 0;
BA_ "GenSigInvalidValue" SG_ 531 SGU18_Object_vy_Can03 0;
BA_ "GenSigSendType" SG_ 531 SGU18_Object_vy_Can03 10;
BA_ "GenSigTimeoutValue" SG_ 531 SGU18_Object_vy_Can03 0;
BA_ "EventCommandSignal" SG_ 531 SGU18_Object_wExist_Can03 0;
BA_ "GatewayedSignals" SG_ 531 SGU18_Object_wExist_Can03 0;
BA_ "GenSigInvalidValue" SG_ 531 SGU18_Object_wExist_Can03 0;
BA_ "GenSigSendType" SG_ 531 SGU18_Object_wExist_Can03 10;
BA_ "GenSigTimeoutValue" SG_ 531 SGU18_Object_wExist_Can03 0;
BA_ "EventCommandSignal" SG_ 531 SGU18_Object_wObstacle_Can03 0;
BA_ "GatewayedSignals" SG_ 531 SGU18_Object_wObstacle_Can03 0;
BA_ "GenSigInvalidValue" SG_ 531 SGU18_Object_wObstacle_Can03 0;
BA_ "GenSigSendType" SG_ 531 SGU18_Object_wObstacle_Can03 10;
BA_ "GenSigTimeoutValue" SG_ 531 SGU18_Object_wObstacle_Can03 0;
BA_ "EventCommandSignal" SG_ 532 SGU19_BlockCounter_Can03 0;
BA_ "GatewayedSignals" SG_ 532 SGU19_BlockCounter_Can03 0;
BA_ "GenSigInvalidValue" SG_ 532 SGU19_BlockCounter_Can03 0;
BA_ "GenSigSendType" SG_ 532 SGU19_BlockCounter_Can03 10;
BA_ "GenSigTimeoutValue" SG_ 532 SGU19_BlockCounter_Can03 0;
BA_ "EventCommandSignal" SG_ 532 SGU19_LifeCycles_OBJ_Can03 0;
BA_ "GatewayedSignals" SG_ 532 SGU19_LifeCycles_OBJ_Can03 0;
BA_ "GenSigInvalidValue" SG_ 532 SGU19_LifeCycles_OBJ_Can03 0;
BA_ "GenSigSendType" SG_ 532 SGU19_LifeCycles_OBJ_Can03 10;
BA_ "GenSigTimeoutValue" SG_ 532 SGU19_LifeCycles_OBJ_Can03 0;
BA_ "EventCommandSignal" SG_ 532 SGU19_Msg_AliveCounter_Can03 0;
BA_ "GatewayedSignals" SG_ 532 SGU19_Msg_AliveCounter_Can03 0;
BA_ "GenSigInvalidValue" SG_ 532 SGU19_Msg_AliveCounter_Can03 0;
BA_ "GenSigSendType" SG_ 532 SGU19_Msg_AliveCounter_Can03 10;
BA_ "GenSigTimeoutValue" SG_ 532 SGU19_Msg_AliveCounter_Can03 0;
BA_ "EventCommandSignal" SG_ 532 SGU19_Msg_CheckSum_Can03 0;
BA_ "GatewayedSignals" SG_ 532 SGU19_Msg_CheckSum_Can03 0;
BA_ "GenSigInvalidValue" SG_ 532 SGU19_Msg_CheckSum_Can03 0;
BA_ "GenSigSendType" SG_ 532 SGU19_Msg_CheckSum_Can03 10;
BA_ "GenSigTimeoutValue" SG_ 532 SGU19_Msg_CheckSum_Can03 0;
BA_ "IsCrcSignal" SG_ 532 SGU19_Msg_CheckSum_Can03 1;
BA_ "EventCommandSignal" SG_ 532 SGU19_ObjRCS_19_Can03 0;
BA_ "GatewayedSignals" SG_ 532 SGU19_ObjRCS_19_Can03 0;
BA_ "GenSigInvalidValue" SG_ 532 SGU19_ObjRCS_19_Can03 0;
BA_ "GenSigSendType" SG_ 532 SGU19_ObjRCS_19_Can03 10;
BA_ "GenSigTimeoutValue" SG_ 532 SGU19_ObjRCS_19_Can03 0;
BA_ "EventCommandSignal" SG_ 532 SGU19_Obj_DistLat_rms_Can03 0;
BA_ "GatewayedSignals" SG_ 532 SGU19_Obj_DistLat_rms_Can03 0;
BA_ "GenSigInvalidValue" SG_ 532 SGU19_Obj_DistLat_rms_Can03 0;
BA_ "GenSigSendType" SG_ 532 SGU19_Obj_DistLat_rms_Can03 10;
BA_ "GenSigTimeoutValue" SG_ 532 SGU19_Obj_DistLat_rms_Can03 0;
BA_ "EventCommandSignal" SG_ 532 SGU19_Obj_VrelLong_rms_Can03 0;
BA_ "GatewayedSignals" SG_ 532 SGU19_Obj_VrelLong_rms_Can03 0;
BA_ "GenSigInvalidValue" SG_ 532 SGU19_Obj_VrelLong_rms_Can03 0;
BA_ "GenSigSendType" SG_ 532 SGU19_Obj_VrelLong_rms_Can03 10;
BA_ "GenSigTimeoutValue" SG_ 532 SGU19_Obj_VrelLong_rms_Can03 0;
BA_ "EventCommandSignal" SG_ 532 SGU19_Obj_Vrelat_rms_Can03 0;
BA_ "GatewayedSignals" SG_ 532 SGU19_Obj_Vrelat_rms_Can03 0;
BA_ "GenSigInvalidValue" SG_ 532 SGU19_Obj_Vrelat_rms_Can03 0;
BA_ "GenSigSendType" SG_ 532 SGU19_Obj_Vrelat_rms_Can03 10;
BA_ "GenSigTimeoutValue" SG_ 532 SGU19_Obj_Vrelat_rms_Can03 0;
BA_ "EventCommandSignal" SG_ 532 SGU19_Object_DetStatus_Can03 0;
BA_ "GatewayedSignals" SG_ 532 SGU19_Object_DetStatus_Can03 0;
BA_ "GenSigInvalidValue" SG_ 532 SGU19_Object_DetStatus_Can03 0;
BA_ "GenSigSendType" SG_ 532 SGU19_Object_DetStatus_Can03 10;
BA_ "GenSigTimeoutValue" SG_ 532 SGU19_Object_DetStatus_Can03 0;
BA_ "EventCommandSignal" SG_ 532 SGU19_Object_DistLong_rms_Can03 0;
BA_ "GatewayedSignals" SG_ 532 SGU19_Object_DistLong_rms_Can03 0;
BA_ "GenSigInvalidValue" SG_ 532 SGU19_Object_DistLong_rms_Can03 0;
BA_ "GenSigSendType" SG_ 532 SGU19_Object_DistLong_rms_Can03 10;
BA_ "GenSigTimeoutValue" SG_ 532 SGU19_Object_DistLong_rms_Can03 0;
BA_ "EventCommandSignal" SG_ 532 SGU19_Object_ID_Can03 0;
BA_ "GatewayedSignals" SG_ 532 SGU19_Object_ID_Can03 0;
BA_ "GenSigInvalidValue" SG_ 532 SGU19_Object_ID_Can03 0;
BA_ "GenSigSendType" SG_ 532 SGU19_Object_ID_Can03 10;
BA_ "GenSigTimeoutValue" SG_ 532 SGU19_Object_ID_Can03 0;
BA_ "EventCommandSignal" SG_ 532 SGU19_Object_MotionPattern_Can03 0;
BA_ "GatewayedSignals" SG_ 532 SGU19_Object_MotionPattern_Can03 0;
BA_ "GenSigInvalidValue" SG_ 532 SGU19_Object_MotionPattern_Can03 0;
BA_ "GenSigSendType" SG_ 532 SGU19_Object_MotionPattern_Can03 10;
BA_ "GenSigTimeoutValue" SG_ 532 SGU19_Object_MotionPattern_Can03 0;
BA_ "EventCommandSignal" SG_ 532 SGU19_Object_Type_Can03 0;
BA_ "GatewayedSignals" SG_ 532 SGU19_Object_Type_Can03 0;
BA_ "GenSigInvalidValue" SG_ 532 SGU19_Object_Type_Can03 0;
BA_ "GenSigSendType" SG_ 532 SGU19_Object_Type_Can03 10;
BA_ "GenSigTimeoutValue" SG_ 532 SGU19_Object_Type_Can03 0;
BA_ "EventCommandSignal" SG_ 532 SGU19_Object_ax_Can03 0;
BA_ "GatewayedSignals" SG_ 532 SGU19_Object_ax_Can03 0;
BA_ "GenSigInvalidValue" SG_ 532 SGU19_Object_ax_Can03 0;
BA_ "GenSigSendType" SG_ 532 SGU19_Object_ax_Can03 10;
BA_ "GenSigTimeoutValue" SG_ 532 SGU19_Object_ax_Can03 0;
BA_ "EventCommandSignal" SG_ 532 SGU19_Object_ay_Can03 0;
BA_ "GatewayedSignals" SG_ 532 SGU19_Object_ay_Can03 0;
BA_ "GenSigInvalidValue" SG_ 532 SGU19_Object_ay_Can03 0;
BA_ "GenSigSendType" SG_ 532 SGU19_Object_ay_Can03 10;
BA_ "GenSigTimeoutValue" SG_ 532 SGU19_Object_ay_Can03 0;
BA_ "EventCommandSignal" SG_ 532 SGU19_Object_dx_Nearest_Can03 0;
BA_ "GatewayedSignals" SG_ 532 SGU19_Object_dx_Nearest_Can03 0;
BA_ "GenSigInvalidValue" SG_ 532 SGU19_Object_dx_Nearest_Can03 0;
BA_ "GenSigSendType" SG_ 532 SGU19_Object_dx_Nearest_Can03 1;
BA_ "GenSigTimeoutValue" SG_ 532 SGU19_Object_dx_Nearest_Can03 0;
BA_ "EventCommandSignal" SG_ 532 SGU19_Object_dx_Rear_Can03 0;
BA_ "GatewayedSignals" SG_ 532 SGU19_Object_dx_Rear_Can03 0;
BA_ "GenSigInvalidValue" SG_ 532 SGU19_Object_dx_Rear_Can03 0;
BA_ "GenSigSendType" SG_ 532 SGU19_Object_dx_Rear_Can03 10;
BA_ "GenSigTimeoutValue" SG_ 532 SGU19_Object_dx_Rear_Can03 0;
BA_ "EventCommandSignal" SG_ 532 SGU19_Object_dy_Nearest_Can03 0;
BA_ "GatewayedSignals" SG_ 532 SGU19_Object_dy_Nearest_Can03 0;
BA_ "GenSigInvalidValue" SG_ 532 SGU19_Object_dy_Nearest_Can03 0;
BA_ "GenSigSendType" SG_ 532 SGU19_Object_dy_Nearest_Can03 1;
BA_ "GenSigTimeoutValue" SG_ 532 SGU19_Object_dy_Nearest_Can03 0;
BA_ "EventCommandSignal" SG_ 532 SGU19_Object_dy_Rear_Can03 0;
BA_ "GatewayedSignals" SG_ 532 SGU19_Object_dy_Rear_Can03 0;
BA_ "GenSigInvalidValue" SG_ 532 SGU19_Object_dy_Rear_Can03 0;
BA_ "GenSigSendType" SG_ 532 SGU19_Object_dy_Rear_Can03 10;
BA_ "GenSigTimeoutValue" SG_ 532 SGU19_Object_dy_Rear_Can03 0;
BA_ "EventCommandSignal" SG_ 532 SGU19_Object_vx_Can03 0;
BA_ "GatewayedSignals" SG_ 532 SGU19_Object_vx_Can03 0;
BA_ "GenSigInvalidValue" SG_ 532 SGU19_Object_vx_Can03 0;
BA_ "GenSigSendType" SG_ 532 SGU19_Object_vx_Can03 10;
BA_ "GenSigTimeoutValue" SG_ 532 SGU19_Object_vx_Can03 0;
BA_ "EventCommandSignal" SG_ 532 SGU19_Object_vy_Can03 0;
BA_ "GatewayedSignals" SG_ 532 SGU19_Object_vy_Can03 0;
BA_ "GenSigInvalidValue" SG_ 532 SGU19_Object_vy_Can03 0;
BA_ "GenSigSendType" SG_ 532 SGU19_Object_vy_Can03 10;
BA_ "GenSigTimeoutValue" SG_ 532 SGU19_Object_vy_Can03 0;
BA_ "EventCommandSignal" SG_ 532 SGU19_Object_wExist_Can03 0;
BA_ "GatewayedSignals" SG_ 532 SGU19_Object_wExist_Can03 0;
BA_ "GenSigInvalidValue" SG_ 532 SGU19_Object_wExist_Can03 0;
BA_ "GenSigSendType" SG_ 532 SGU19_Object_wExist_Can03 10;
BA_ "GenSigTimeoutValue" SG_ 532 SGU19_Object_wExist_Can03 0;
BA_ "EventCommandSignal" SG_ 532 SGU19_Object_wObstacle_Can03 0;
BA_ "GatewayedSignals" SG_ 532 SGU19_Object_wObstacle_Can03 0;
BA_ "GenSigInvalidValue" SG_ 532 SGU19_Object_wObstacle_Can03 0;
BA_ "GenSigSendType" SG_ 532 SGU19_Object_wObstacle_Can03 10;
BA_ "GenSigTimeoutValue" SG_ 532 SGU19_Object_wObstacle_Can03 0;
BA_ "EventCommandSignal" SG_ 533 SGU20_BlockCounter_Can03 0;
BA_ "GatewayedSignals" SG_ 533 SGU20_BlockCounter_Can03 0;
BA_ "GenSigInvalidValue" SG_ 533 SGU20_BlockCounter_Can03 0;
BA_ "GenSigSendType" SG_ 533 SGU20_BlockCounter_Can03 10;
BA_ "GenSigTimeoutValue" SG_ 533 SGU20_BlockCounter_Can03 0;
BA_ "EventCommandSignal" SG_ 533 SGU20_LifeCycles_OBJ_Can03 0;
BA_ "GatewayedSignals" SG_ 533 SGU20_LifeCycles_OBJ_Can03 0;
BA_ "GenSigInvalidValue" SG_ 533 SGU20_LifeCycles_OBJ_Can03 0;
BA_ "GenSigSendType" SG_ 533 SGU20_LifeCycles_OBJ_Can03 10;
BA_ "GenSigTimeoutValue" SG_ 533 SGU20_LifeCycles_OBJ_Can03 0;
BA_ "EventCommandSignal" SG_ 533 SGU20_Msg_AliveCounter_Can03 0;
BA_ "GatewayedSignals" SG_ 533 SGU20_Msg_AliveCounter_Can03 0;
BA_ "GenSigInvalidValue" SG_ 533 SGU20_Msg_AliveCounter_Can03 0;
BA_ "GenSigSendType" SG_ 533 SGU20_Msg_AliveCounter_Can03 10;
BA_ "GenSigTimeoutValue" SG_ 533 SGU20_Msg_AliveCounter_Can03 0;
BA_ "EventCommandSignal" SG_ 533 SGU20_Msg_CheckSum_Can03 0;
BA_ "GatewayedSignals" SG_ 533 SGU20_Msg_CheckSum_Can03 0;
BA_ "GenSigInvalidValue" SG_ 533 SGU20_Msg_CheckSum_Can03 0;
BA_ "GenSigSendType" SG_ 533 SGU20_Msg_CheckSum_Can03 10;
BA_ "GenSigTimeoutValue" SG_ 533 SGU20_Msg_CheckSum_Can03 0;
BA_ "IsCrcSignal" SG_ 533 SGU20_Msg_CheckSum_Can03 1;
BA_ "EventCommandSignal" SG_ 533 SGU20_ObjRCS_20_Can03 0;
BA_ "GatewayedSignals" SG_ 533 SGU20_ObjRCS_20_Can03 0;
BA_ "GenSigInvalidValue" SG_ 533 SGU20_ObjRCS_20_Can03 0;
BA_ "GenSigSendType" SG_ 533 SGU20_ObjRCS_20_Can03 10;
BA_ "GenSigTimeoutValue" SG_ 533 SGU20_ObjRCS_20_Can03 0;
BA_ "EventCommandSignal" SG_ 533 SGU20_Obj_DistLat_rms_Can03 0;
BA_ "GatewayedSignals" SG_ 533 SGU20_Obj_DistLat_rms_Can03 0;
BA_ "GenSigInvalidValue" SG_ 533 SGU20_Obj_DistLat_rms_Can03 0;
BA_ "GenSigSendType" SG_ 533 SGU20_Obj_DistLat_rms_Can03 10;
BA_ "GenSigTimeoutValue" SG_ 533 SGU20_Obj_DistLat_rms_Can03 0;
BA_ "EventCommandSignal" SG_ 533 SGU20_Obj_VrelLong_rms_Can03 0;
BA_ "GatewayedSignals" SG_ 533 SGU20_Obj_VrelLong_rms_Can03 0;
BA_ "GenSigInvalidValue" SG_ 533 SGU20_Obj_VrelLong_rms_Can03 0;
BA_ "GenSigSendType" SG_ 533 SGU20_Obj_VrelLong_rms_Can03 10;
BA_ "GenSigTimeoutValue" SG_ 533 SGU20_Obj_VrelLong_rms_Can03 0;
BA_ "EventCommandSignal" SG_ 533 SGU20_Obj_Vrelat_rms_Can03 0;
BA_ "GatewayedSignals" SG_ 533 SGU20_Obj_Vrelat_rms_Can03 0;
BA_ "GenSigInvalidValue" SG_ 533 SGU20_Obj_Vrelat_rms_Can03 0;
BA_ "GenSigSendType" SG_ 533 SGU20_Obj_Vrelat_rms_Can03 10;
BA_ "GenSigTimeoutValue" SG_ 533 SGU20_Obj_Vrelat_rms_Can03 0;
BA_ "EventCommandSignal" SG_ 533 SGU20_Object_DetStatus_Can03 0;
BA_ "GatewayedSignals" SG_ 533 SGU20_Object_DetStatus_Can03 0;
BA_ "GenSigInvalidValue" SG_ 533 SGU20_Object_DetStatus_Can03 0;
BA_ "GenSigSendType" SG_ 533 SGU20_Object_DetStatus_Can03 10;
BA_ "GenSigTimeoutValue" SG_ 533 SGU20_Object_DetStatus_Can03 0;
BA_ "EventCommandSignal" SG_ 533 SGU20_Object_DistLong_rms_Can03 0;
BA_ "GatewayedSignals" SG_ 533 SGU20_Object_DistLong_rms_Can03 0;
BA_ "GenSigInvalidValue" SG_ 533 SGU20_Object_DistLong_rms_Can03 0;
BA_ "GenSigSendType" SG_ 533 SGU20_Object_DistLong_rms_Can03 10;
BA_ "GenSigTimeoutValue" SG_ 533 SGU20_Object_DistLong_rms_Can03 0;
BA_ "EventCommandSignal" SG_ 533 SGU20_Object_ID_Can03 0;
BA_ "GatewayedSignals" SG_ 533 SGU20_Object_ID_Can03 0;
BA_ "GenSigInvalidValue" SG_ 533 SGU20_Object_ID_Can03 0;
BA_ "GenSigSendType" SG_ 533 SGU20_Object_ID_Can03 10;
BA_ "GenSigTimeoutValue" SG_ 533 SGU20_Object_ID_Can03 0;
BA_ "EventCommandSignal" SG_ 533 SGU20_Object_MotionPattern_Can03 0;
BA_ "GatewayedSignals" SG_ 533 SGU20_Object_MotionPattern_Can03 0;
BA_ "GenSigInvalidValue" SG_ 533 SGU20_Object_MotionPattern_Can03 0;
BA_ "GenSigSendType" SG_ 533 SGU20_Object_MotionPattern_Can03 10;
BA_ "GenSigTimeoutValue" SG_ 533 SGU20_Object_MotionPattern_Can03 0;
BA_ "EventCommandSignal" SG_ 533 SGU20_Object_Type_Can03 0;
BA_ "GatewayedSignals" SG_ 533 SGU20_Object_Type_Can03 0;
BA_ "GenSigInvalidValue" SG_ 533 SGU20_Object_Type_Can03 0;
BA_ "GenSigSendType" SG_ 533 SGU20_Object_Type_Can03 10;
BA_ "GenSigTimeoutValue" SG_ 533 SGU20_Object_Type_Can03 0;
BA_ "EventCommandSignal" SG_ 533 SGU20_Object_ax_Can03 0;
BA_ "GatewayedSignals" SG_ 533 SGU20_Object_ax_Can03 0;
BA_ "GenSigInvalidValue" SG_ 533 SGU20_Object_ax_Can03 0;
BA_ "GenSigSendType" SG_ 533 SGU20_Object_ax_Can03 10;
BA_ "GenSigTimeoutValue" SG_ 533 SGU20_Object_ax_Can03 0;
BA_ "EventCommandSignal" SG_ 533 SGU20_Object_ay_Can03 0;
BA_ "GatewayedSignals" SG_ 533 SGU20_Object_ay_Can03 0;
BA_ "GenSigInvalidValue" SG_ 533 SGU20_Object_ay_Can03 0;
BA_ "GenSigSendType" SG_ 533 SGU20_Object_ay_Can03 10;
BA_ "GenSigTimeoutValue" SG_ 533 SGU20_Object_ay_Can03 0;
BA_ "EventCommandSignal" SG_ 533 SGU20_Object_dx_Nearest_Can03 0;
BA_ "GatewayedSignals" SG_ 533 SGU20_Object_dx_Nearest_Can03 0;
BA_ "GenSigInvalidValue" SG_ 533 SGU20_Object_dx_Nearest_Can03 0;
BA_ "GenSigSendType" SG_ 533 SGU20_Object_dx_Nearest_Can03 1;
BA_ "GenSigTimeoutValue" SG_ 533 SGU20_Object_dx_Nearest_Can03 0;
BA_ "EventCommandSignal" SG_ 533 SGU20_Object_dx_Rear_Can03 0;
BA_ "GatewayedSignals" SG_ 533 SGU20_Object_dx_Rear_Can03 0;
BA_ "GenSigInvalidValue" SG_ 533 SGU20_Object_dx_Rear_Can03 0;
BA_ "GenSigSendType" SG_ 533 SGU20_Object_dx_Rear_Can03 10;
BA_ "GenSigTimeoutValue" SG_ 533 SGU20_Object_dx_Rear_Can03 0;
BA_ "EventCommandSignal" SG_ 533 SGU20_Object_dy_Nearest_Can03 0;
BA_ "GatewayedSignals" SG_ 533 SGU20_Object_dy_Nearest_Can03 0;
BA_ "GenSigInvalidValue" SG_ 533 SGU20_Object_dy_Nearest_Can03 0;
BA_ "GenSigSendType" SG_ 533 SGU20_Object_dy_Nearest_Can03 1;
BA_ "GenSigTimeoutValue" SG_ 533 SGU20_Object_dy_Nearest_Can03 0;
BA_ "EventCommandSignal" SG_ 533 SGU20_Object_dy_Rear_Can03 0;
BA_ "GatewayedSignals" SG_ 533 SGU20_Object_dy_Rear_Can03 0;
BA_ "GenSigInvalidValue" SG_ 533 SGU20_Object_dy_Rear_Can03 0;
BA_ "GenSigSendType" SG_ 533 SGU20_Object_dy_Rear_Can03 10;
BA_ "GenSigTimeoutValue" SG_ 533 SGU20_Object_dy_Rear_Can03 0;
BA_ "EventCommandSignal" SG_ 533 SGU20_Object_vx_Can03 0;
BA_ "GatewayedSignals" SG_ 533 SGU20_Object_vx_Can03 0;
BA_ "GenSigInvalidValue" SG_ 533 SGU20_Object_vx_Can03 0;
BA_ "GenSigSendType" SG_ 533 SGU20_Object_vx_Can03 10;
BA_ "GenSigTimeoutValue" SG_ 533 SGU20_Object_vx_Can03 0;
BA_ "EventCommandSignal" SG_ 533 SGU20_Object_vy_Can03 0;
BA_ "GatewayedSignals" SG_ 533 SGU20_Object_vy_Can03 0;
BA_ "GenSigInvalidValue" SG_ 533 SGU20_Object_vy_Can03 0;
BA_ "GenSigSendType" SG_ 533 SGU20_Object_vy_Can03 10;
BA_ "GenSigTimeoutValue" SG_ 533 SGU20_Object_vy_Can03 0;
BA_ "EventCommandSignal" SG_ 533 SGU20_Object_wExist_Can03 0;
BA_ "GatewayedSignals" SG_ 533 SGU20_Object_wExist_Can03 0;
BA_ "GenSigInvalidValue" SG_ 533 SGU20_Object_wExist_Can03 0;
BA_ "GenSigSendType" SG_ 533 SGU20_Object_wExist_Can03 10;
BA_ "GenSigTimeoutValue" SG_ 533 SGU20_Object_wExist_Can03 0;
BA_ "EventCommandSignal" SG_ 533 SGU20_Object_wObstacle_Can03 0;
BA_ "GatewayedSignals" SG_ 533 SGU20_Object_wObstacle_Can03 0;
BA_ "GenSigInvalidValue" SG_ 533 SGU20_Object_wObstacle_Can03 0;
BA_ "GenSigSendType" SG_ 533 SGU20_Object_wObstacle_Can03 10;
BA_ "GenSigTimeoutValue" SG_ 533 SGU20_Object_wObstacle_Can03 0;
BA_ "EventCommandSignal" SG_ 534 SGU21_BlockCounter_Can03 0;
BA_ "GatewayedSignals" SG_ 534 SGU21_BlockCounter_Can03 0;
BA_ "GenSigInvalidValue" SG_ 534 SGU21_BlockCounter_Can03 0;
BA_ "GenSigSendType" SG_ 534 SGU21_BlockCounter_Can03 10;
BA_ "GenSigTimeoutValue" SG_ 534 SGU21_BlockCounter_Can03 0;
BA_ "EventCommandSignal" SG_ 534 SGU21_LifeCycles_OBJ_Can03 0;
BA_ "GatewayedSignals" SG_ 534 SGU21_LifeCycles_OBJ_Can03 0;
BA_ "GenSigInvalidValue" SG_ 534 SGU21_LifeCycles_OBJ_Can03 0;
BA_ "GenSigSendType" SG_ 534 SGU21_LifeCycles_OBJ_Can03 10;
BA_ "GenSigTimeoutValue" SG_ 534 SGU21_LifeCycles_OBJ_Can03 0;
BA_ "EventCommandSignal" SG_ 534 SGU21_Msg_AliveCounter_Can03 0;
BA_ "GatewayedSignals" SG_ 534 SGU21_Msg_AliveCounter_Can03 0;
BA_ "GenSigInvalidValue" SG_ 534 SGU21_Msg_AliveCounter_Can03 0;
BA_ "GenSigSendType" SG_ 534 SGU21_Msg_AliveCounter_Can03 10;
BA_ "GenSigTimeoutValue" SG_ 534 SGU21_Msg_AliveCounter_Can03 0;
BA_ "EventCommandSignal" SG_ 534 SGU21_Msg_CheckSum_Can03 0;
BA_ "GatewayedSignals" SG_ 534 SGU21_Msg_CheckSum_Can03 0;
BA_ "GenSigInvalidValue" SG_ 534 SGU21_Msg_CheckSum_Can03 0;
BA_ "GenSigSendType" SG_ 534 SGU21_Msg_CheckSum_Can03 10;
BA_ "GenSigTimeoutValue" SG_ 534 SGU21_Msg_CheckSum_Can03 0;
BA_ "IsCrcSignal" SG_ 534 SGU21_Msg_CheckSum_Can03 1;
BA_ "EventCommandSignal" SG_ 534 SGU21_ObjRCS_21_Can03 0;
BA_ "GatewayedSignals" SG_ 534 SGU21_ObjRCS_21_Can03 0;
BA_ "GenSigInvalidValue" SG_ 534 SGU21_ObjRCS_21_Can03 0;
BA_ "GenSigSendType" SG_ 534 SGU21_ObjRCS_21_Can03 10;
BA_ "GenSigTimeoutValue" SG_ 534 SGU21_ObjRCS_21_Can03 0;
BA_ "EventCommandSignal" SG_ 534 SGU21_Obj_DistLat_rms_Can03 0;
BA_ "GatewayedSignals" SG_ 534 SGU21_Obj_DistLat_rms_Can03 0;
BA_ "GenSigInvalidValue" SG_ 534 SGU21_Obj_DistLat_rms_Can03 0;
BA_ "GenSigSendType" SG_ 534 SGU21_Obj_DistLat_rms_Can03 10;
BA_ "GenSigTimeoutValue" SG_ 534 SGU21_Obj_DistLat_rms_Can03 0;
BA_ "EventCommandSignal" SG_ 534 SGU21_Obj_VrelLong_rms_Can03 0;
BA_ "GatewayedSignals" SG_ 534 SGU21_Obj_VrelLong_rms_Can03 0;
BA_ "GenSigInvalidValue" SG_ 534 SGU21_Obj_VrelLong_rms_Can03 0;
BA_ "GenSigSendType" SG_ 534 SGU21_Obj_VrelLong_rms_Can03 10;
BA_ "GenSigTimeoutValue" SG_ 534 SGU21_Obj_VrelLong_rms_Can03 0;
BA_ "EventCommandSignal" SG_ 534 SGU21_Obj_Vrelat_rms_Can03 0;
BA_ "GatewayedSignals" SG_ 534 SGU21_Obj_Vrelat_rms_Can03 0;
BA_ "GenSigInvalidValue" SG_ 534 SGU21_Obj_Vrelat_rms_Can03 0;
BA_ "GenSigSendType" SG_ 534 SGU21_Obj_Vrelat_rms_Can03 10;
BA_ "GenSigTimeoutValue" SG_ 534 SGU21_Obj_Vrelat_rms_Can03 0;
BA_ "EventCommandSignal" SG_ 534 SGU21_Object_DetStatus_Can03 0;
BA_ "GatewayedSignals" SG_ 534 SGU21_Object_DetStatus_Can03 0;
BA_ "GenSigInvalidValue" SG_ 534 SGU21_Object_DetStatus_Can03 0;
BA_ "GenSigSendType" SG_ 534 SGU21_Object_DetStatus_Can03 10;
BA_ "GenSigTimeoutValue" SG_ 534 SGU21_Object_DetStatus_Can03 0;
BA_ "EventCommandSignal" SG_ 534 SGU21_Object_DistLong_rms_Can03 0;
BA_ "GatewayedSignals" SG_ 534 SGU21_Object_DistLong_rms_Can03 0;
BA_ "GenSigInvalidValue" SG_ 534 SGU21_Object_DistLong_rms_Can03 0;
BA_ "GenSigSendType" SG_ 534 SGU21_Object_DistLong_rms_Can03 10;
BA_ "GenSigTimeoutValue" SG_ 534 SGU21_Object_DistLong_rms_Can03 0;
BA_ "EventCommandSignal" SG_ 534 SGU21_Object_ID_Can03 0;
BA_ "GatewayedSignals" SG_ 534 SGU21_Object_ID_Can03 0;
BA_ "GenSigInvalidValue" SG_ 534 SGU21_Object_ID_Can03 0;
BA_ "GenSigSendType" SG_ 534 SGU21_Object_ID_Can03 10;
BA_ "GenSigTimeoutValue" SG_ 534 SGU21_Object_ID_Can03 0;
BA_ "EventCommandSignal" SG_ 534 SGU21_Object_MotionPattern_Can03 0;
BA_ "GatewayedSignals" SG_ 534 SGU21_Object_MotionPattern_Can03 0;
BA_ "GenSigInvalidValue" SG_ 534 SGU21_Object_MotionPattern_Can03 0;
BA_ "GenSigSendType" SG_ 534 SGU21_Object_MotionPattern_Can03 10;
BA_ "GenSigTimeoutValue" SG_ 534 SGU21_Object_MotionPattern_Can03 0;
BA_ "EventCommandSignal" SG_ 534 SGU21_Object_Type_Can03 0;
BA_ "GatewayedSignals" SG_ 534 SGU21_Object_Type_Can03 0;
BA_ "GenSigInvalidValue" SG_ 534 SGU21_Object_Type_Can03 0;
BA_ "GenSigSendType" SG_ 534 SGU21_Object_Type_Can03 10;
BA_ "GenSigTimeoutValue" SG_ 534 SGU21_Object_Type_Can03 0;
BA_ "EventCommandSignal" SG_ 534 SGU21_Object_ax_Can03 0;
BA_ "GatewayedSignals" SG_ 534 SGU21_Object_ax_Can03 0;
BA_ "GenSigInvalidValue" SG_ 534 SGU21_Object_ax_Can03 0;
BA_ "GenSigSendType" SG_ 534 SGU21_Object_ax_Can03 10;
BA_ "GenSigTimeoutValue" SG_ 534 SGU21_Object_ax_Can03 0;
BA_ "EventCommandSignal" SG_ 534 SGU21_Object_ay_Can03 0;
BA_ "GatewayedSignals" SG_ 534 SGU21_Object_ay_Can03 0;
BA_ "GenSigInvalidValue" SG_ 534 SGU21_Object_ay_Can03 0;
BA_ "GenSigSendType" SG_ 534 SGU21_Object_ay_Can03 10;
BA_ "GenSigTimeoutValue" SG_ 534 SGU21_Object_ay_Can03 0;
BA_ "EventCommandSignal" SG_ 534 SGU21_Object_dx_Nearest_Can03 0;
BA_ "GatewayedSignals" SG_ 534 SGU21_Object_dx_Nearest_Can03 0;
BA_ "GenSigInvalidValue" SG_ 534 SGU21_Object_dx_Nearest_Can03 0;
BA_ "GenSigSendType" SG_ 534 SGU21_Object_dx_Nearest_Can03 1;
BA_ "GenSigTimeoutValue" SG_ 534 SGU21_Object_dx_Nearest_Can03 0;
BA_ "EventCommandSignal" SG_ 534 SGU21_Object_dx_Rear_Can03 0;
BA_ "GatewayedSignals" SG_ 534 SGU21_Object_dx_Rear_Can03 0;
BA_ "GenSigInvalidValue" SG_ 534 SGU21_Object_dx_Rear_Can03 0;
BA_ "GenSigSendType" SG_ 534 SGU21_Object_dx_Rear_Can03 10;
BA_ "GenSigTimeoutValue" SG_ 534 SGU21_Object_dx_Rear_Can03 0;
BA_ "EventCommandSignal" SG_ 534 SGU21_Object_dy_Nearest_Can03 0;
BA_ "GatewayedSignals" SG_ 534 SGU21_Object_dy_Nearest_Can03 0;
BA_ "GenSigInvalidValue" SG_ 534 SGU21_Object_dy_Nearest_Can03 0;
BA_ "GenSigSendType" SG_ 534 SGU21_Object_dy_Nearest_Can03 1;
BA_ "GenSigTimeoutValue" SG_ 534 SGU21_Object_dy_Nearest_Can03 0;
BA_ "EventCommandSignal" SG_ 534 SGU21_Object_dy_Rear_Can03 0;
BA_ "GatewayedSignals" SG_ 534 SGU21_Object_dy_Rear_Can03 0;
BA_ "GenSigInvalidValue" SG_ 534 SGU21_Object_dy_Rear_Can03 0;
BA_ "GenSigSendType" SG_ 534 SGU21_Object_dy_Rear_Can03 10;
BA_ "GenSigTimeoutValue" SG_ 534 SGU21_Object_dy_Rear_Can03 0;
BA_ "EventCommandSignal" SG_ 534 SGU21_Object_vx_Can03 0;
BA_ "GatewayedSignals" SG_ 534 SGU21_Object_vx_Can03 0;
BA_ "GenSigInvalidValue" SG_ 534 SGU21_Object_vx_Can03 0;
BA_ "GenSigSendType" SG_ 534 SGU21_Object_vx_Can03 10;
BA_ "GenSigTimeoutValue" SG_ 534 SGU21_Object_vx_Can03 0;
BA_ "EventCommandSignal" SG_ 534 SGU21_Object_vy_Can03 0;
BA_ "GatewayedSignals" SG_ 534 SGU21_Object_vy_Can03 0;
BA_ "GenSigInvalidValue" SG_ 534 SGU21_Object_vy_Can03 0;
BA_ "GenSigSendType" SG_ 534 SGU21_Object_vy_Can03 10;
BA_ "GenSigTimeoutValue" SG_ 534 SGU21_Object_vy_Can03 0;
BA_ "EventCommandSignal" SG_ 534 SGU21_Object_wExist_Can03 0;
BA_ "GatewayedSignals" SG_ 534 SGU21_Object_wExist_Can03 0;
BA_ "GenSigInvalidValue" SG_ 534 SGU21_Object_wExist_Can03 0;
BA_ "GenSigSendType" SG_ 534 SGU21_Object_wExist_Can03 10;
BA_ "GenSigTimeoutValue" SG_ 534 SGU21_Object_wExist_Can03 0;
BA_ "EventCommandSignal" SG_ 534 SGU21_Object_wObstacle_Can03 0;
BA_ "GatewayedSignals" SG_ 534 SGU21_Object_wObstacle_Can03 0;
BA_ "GenSigInvalidValue" SG_ 534 SGU21_Object_wObstacle_Can03 0;
BA_ "GenSigSendType" SG_ 534 SGU21_Object_wObstacle_Can03 10;
BA_ "GenSigTimeoutValue" SG_ 534 SGU21_Object_wObstacle_Can03 0;
BA_ "EventCommandSignal" SG_ 535 SGU22_BlockCounter_Can03 0;
BA_ "GatewayedSignals" SG_ 535 SGU22_BlockCounter_Can03 0;
BA_ "GenSigInvalidValue" SG_ 535 SGU22_BlockCounter_Can03 0;
BA_ "GenSigSendType" SG_ 535 SGU22_BlockCounter_Can03 10;
BA_ "GenSigTimeoutValue" SG_ 535 SGU22_BlockCounter_Can03 0;
BA_ "EventCommandSignal" SG_ 535 SGU22_LifeCycles_OBJ_Can03 0;
BA_ "GatewayedSignals" SG_ 535 SGU22_LifeCycles_OBJ_Can03 0;
BA_ "GenSigInvalidValue" SG_ 535 SGU22_LifeCycles_OBJ_Can03 0;
BA_ "GenSigSendType" SG_ 535 SGU22_LifeCycles_OBJ_Can03 10;
BA_ "GenSigTimeoutValue" SG_ 535 SGU22_LifeCycles_OBJ_Can03 0;
BA_ "EventCommandSignal" SG_ 535 SGU22_Msg_AliveCounter_Can03 0;
BA_ "GatewayedSignals" SG_ 535 SGU22_Msg_AliveCounter_Can03 0;
BA_ "GenSigInvalidValue" SG_ 535 SGU22_Msg_AliveCounter_Can03 0;
BA_ "GenSigSendType" SG_ 535 SGU22_Msg_AliveCounter_Can03 10;
BA_ "GenSigTimeoutValue" SG_ 535 SGU22_Msg_AliveCounter_Can03 0;
BA_ "EventCommandSignal" SG_ 535 SGU22_Msg_CheckSum_Can03 0;
BA_ "GatewayedSignals" SG_ 535 SGU22_Msg_CheckSum_Can03 0;
BA_ "GenSigInvalidValue" SG_ 535 SGU22_Msg_CheckSum_Can03 0;
BA_ "GenSigSendType" SG_ 535 SGU22_Msg_CheckSum_Can03 10;
BA_ "GenSigTimeoutValue" SG_ 535 SGU22_Msg_CheckSum_Can03 0;
BA_ "IsCrcSignal" SG_ 535 SGU22_Msg_CheckSum_Can03 1;
BA_ "EventCommandSignal" SG_ 535 SGU22_ObjRCS_22_Can03 0;
BA_ "GatewayedSignals" SG_ 535 SGU22_ObjRCS_22_Can03 0;
BA_ "GenSigInvalidValue" SG_ 535 SGU22_ObjRCS_22_Can03 0;
BA_ "GenSigSendType" SG_ 535 SGU22_ObjRCS_22_Can03 10;
BA_ "GenSigTimeoutValue" SG_ 535 SGU22_ObjRCS_22_Can03 0;
BA_ "EventCommandSignal" SG_ 535 SGU22_Obj_DistLat_rms_Can03 0;
BA_ "GatewayedSignals" SG_ 535 SGU22_Obj_DistLat_rms_Can03 0;
BA_ "GenSigInvalidValue" SG_ 535 SGU22_Obj_DistLat_rms_Can03 0;
BA_ "GenSigSendType" SG_ 535 SGU22_Obj_DistLat_rms_Can03 10;
BA_ "GenSigTimeoutValue" SG_ 535 SGU22_Obj_DistLat_rms_Can03 0;
BA_ "EventCommandSignal" SG_ 535 SGU22_Obj_VrelLong_rms_Can03 0;
BA_ "GatewayedSignals" SG_ 535 SGU22_Obj_VrelLong_rms_Can03 0;
BA_ "GenSigInvalidValue" SG_ 535 SGU22_Obj_VrelLong_rms_Can03 0;
BA_ "GenSigSendType" SG_ 535 SGU22_Obj_VrelLong_rms_Can03 10;
BA_ "GenSigTimeoutValue" SG_ 535 SGU22_Obj_VrelLong_rms_Can03 0;
BA_ "EventCommandSignal" SG_ 535 SGU22_Obj_Vrelat_rms_Can03 0;
BA_ "GatewayedSignals" SG_ 535 SGU22_Obj_Vrelat_rms_Can03 0;
BA_ "GenSigInvalidValue" SG_ 535 SGU22_Obj_Vrelat_rms_Can03 0;
BA_ "GenSigSendType" SG_ 535 SGU22_Obj_Vrelat_rms_Can03 10;
BA_ "GenSigTimeoutValue" SG_ 535 SGU22_Obj_Vrelat_rms_Can03 0;
BA_ "EventCommandSignal" SG_ 535 SGU22_Object_DetStatus_Can03 0;
BA_ "GatewayedSignals" SG_ 535 SGU22_Object_DetStatus_Can03 0;
BA_ "GenSigInvalidValue" SG_ 535 SGU22_Object_DetStatus_Can03 0;
BA_ "GenSigSendType" SG_ 535 SGU22_Object_DetStatus_Can03 10;
BA_ "GenSigTimeoutValue" SG_ 535 SGU22_Object_DetStatus_Can03 0;
BA_ "EventCommandSignal" SG_ 535 SGU22_Object_DistLong_rms_Can03 0;
BA_ "GatewayedSignals" SG_ 535 SGU22_Object_DistLong_rms_Can03 0;
BA_ "GenSigInvalidValue" SG_ 535 SGU22_Object_DistLong_rms_Can03 0;
BA_ "GenSigSendType" SG_ 535 SGU22_Object_DistLong_rms_Can03 10;
BA_ "GenSigTimeoutValue" SG_ 535 SGU22_Object_DistLong_rms_Can03 0;
BA_ "EventCommandSignal" SG_ 535 SGU22_Object_ID_Can03 0;
BA_ "GatewayedSignals" SG_ 535 SGU22_Object_ID_Can03 0;
BA_ "GenSigInvalidValue" SG_ 535 SGU22_Object_ID_Can03 0;
BA_ "GenSigSendType" SG_ 535 SGU22_Object_ID_Can03 10;
BA_ "GenSigTimeoutValue" SG_ 535 SGU22_Object_ID_Can03 0;
BA_ "EventCommandSignal" SG_ 535 SGU22_Object_MotionPattern_Can03 0;
BA_ "GatewayedSignals" SG_ 535 SGU22_Object_MotionPattern_Can03 0;
BA_ "GenSigInvalidValue" SG_ 535 SGU22_Object_MotionPattern_Can03 0;
BA_ "GenSigSendType" SG_ 535 SGU22_Object_MotionPattern_Can03 10;
BA_ "GenSigTimeoutValue" SG_ 535 SGU22_Object_MotionPattern_Can03 0;
BA_ "EventCommandSignal" SG_ 535 SGU22_Object_Type_Can03 0;
BA_ "GatewayedSignals" SG_ 535 SGU22_Object_Type_Can03 0;
BA_ "GenSigInvalidValue" SG_ 535 SGU22_Object_Type_Can03 0;
BA_ "GenSigSendType" SG_ 535 SGU22_Object_Type_Can03 10;
BA_ "GenSigTimeoutValue" SG_ 535 SGU22_Object_Type_Can03 0;
BA_ "EventCommandSignal" SG_ 535 SGU22_Object_ax_Can03 0;
BA_ "GatewayedSignals" SG_ 535 SGU22_Object_ax_Can03 0;
BA_ "GenSigInvalidValue" SG_ 535 SGU22_Object_ax_Can03 0;
BA_ "GenSigSendType" SG_ 535 SGU22_Object_ax_Can03 10;
BA_ "GenSigTimeoutValue" SG_ 535 SGU22_Object_ax_Can03 0;
BA_ "EventCommandSignal" SG_ 535 SGU22_Object_ay_Can03 0;
BA_ "GatewayedSignals" SG_ 535 SGU22_Object_ay_Can03 0;
BA_ "GenSigInvalidValue" SG_ 535 SGU22_Object_ay_Can03 0;
BA_ "GenSigSendType" SG_ 535 SGU22_Object_ay_Can03 10;
BA_ "GenSigTimeoutValue" SG_ 535 SGU22_Object_ay_Can03 0;
BA_ "EventCommandSignal" SG_ 535 SGU22_Object_dx_Nearest_Can03 0;
BA_ "GatewayedSignals" SG_ 535 SGU22_Object_dx_Nearest_Can03 0;
BA_ "GenSigInvalidValue" SG_ 535 SGU22_Object_dx_Nearest_Can03 0;
BA_ "GenSigSendType" SG_ 535 SGU22_Object_dx_Nearest_Can03 1;
BA_ "GenSigTimeoutValue" SG_ 535 SGU22_Object_dx_Nearest_Can03 0;
BA_ "EventCommandSignal" SG_ 535 SGU22_Object_dx_Rear_Can03 0;
BA_ "GatewayedSignals" SG_ 535 SGU22_Object_dx_Rear_Can03 0;
BA_ "GenSigInvalidValue" SG_ 535 SGU22_Object_dx_Rear_Can03 0;
BA_ "GenSigSendType" SG_ 535 SGU22_Object_dx_Rear_Can03 10;
BA_ "GenSigTimeoutValue" SG_ 535 SGU22_Object_dx_Rear_Can03 0;
BA_ "EventCommandSignal" SG_ 535 SGU22_Object_dy_Nearest_Can03 0;
BA_ "GatewayedSignals" SG_ 535 SGU22_Object_dy_Nearest_Can03 0;
BA_ "GenSigInvalidValue" SG_ 535 SGU22_Object_dy_Nearest_Can03 0;
BA_ "GenSigSendType" SG_ 535 SGU22_Object_dy_Nearest_Can03 1;
BA_ "GenSigTimeoutValue" SG_ 535 SGU22_Object_dy_Nearest_Can03 0;
BA_ "EventCommandSignal" SG_ 535 SGU22_Object_dy_Rear_Can03 0;
BA_ "GatewayedSignals" SG_ 535 SGU22_Object_dy_Rear_Can03 0;
BA_ "GenSigInvalidValue" SG_ 535 SGU22_Object_dy_Rear_Can03 0;
BA_ "GenSigSendType" SG_ 535 SGU22_Object_dy_Rear_Can03 10;
BA_ "GenSigTimeoutValue" SG_ 535 SGU22_Object_dy_Rear_Can03 0;
BA_ "EventCommandSignal" SG_ 535 SGU22_Object_vx_Can03 0;
BA_ "GatewayedSignals" SG_ 535 SGU22_Object_vx_Can03 0;
BA_ "GenSigInvalidValue" SG_ 535 SGU22_Object_vx_Can03 0;
BA_ "GenSigSendType" SG_ 535 SGU22_Object_vx_Can03 10;
BA_ "GenSigTimeoutValue" SG_ 535 SGU22_Object_vx_Can03 0;
BA_ "EventCommandSignal" SG_ 535 SGU22_Object_vy_Can03 0;
BA_ "GatewayedSignals" SG_ 535 SGU22_Object_vy_Can03 0;
BA_ "GenSigInvalidValue" SG_ 535 SGU22_Object_vy_Can03 0;
BA_ "GenSigSendType" SG_ 535 SGU22_Object_vy_Can03 10;
BA_ "GenSigTimeoutValue" SG_ 535 SGU22_Object_vy_Can03 0;
BA_ "EventCommandSignal" SG_ 535 SGU22_Object_wExist_Can03 0;
BA_ "GatewayedSignals" SG_ 535 SGU22_Object_wExist_Can03 0;
BA_ "GenSigInvalidValue" SG_ 535 SGU22_Object_wExist_Can03 0;
BA_ "GenSigSendType" SG_ 535 SGU22_Object_wExist_Can03 10;
BA_ "GenSigTimeoutValue" SG_ 535 SGU22_Object_wExist_Can03 0;
BA_ "EventCommandSignal" SG_ 535 SGU22_Object_wObstacle_Can03 0;
BA_ "GatewayedSignals" SG_ 535 SGU22_Object_wObstacle_Can03 0;
BA_ "GenSigInvalidValue" SG_ 535 SGU22_Object_wObstacle_Can03 0;
BA_ "GenSigSendType" SG_ 535 SGU22_Object_wObstacle_Can03 10;
BA_ "GenSigTimeoutValue" SG_ 535 SGU22_Object_wObstacle_Can03 0;
BA_ "EventCommandSignal" SG_ 536 SGU23_BlockCounter_Can03 0;
BA_ "GatewayedSignals" SG_ 536 SGU23_BlockCounter_Can03 0;
BA_ "GenSigInvalidValue" SG_ 536 SGU23_BlockCounter_Can03 0;
BA_ "GenSigSendType" SG_ 536 SGU23_BlockCounter_Can03 10;
BA_ "GenSigTimeoutValue" SG_ 536 SGU23_BlockCounter_Can03 0;
BA_ "EventCommandSignal" SG_ 536 SGU23_LifeCycles_OBJ_Can03 0;
BA_ "GatewayedSignals" SG_ 536 SGU23_LifeCycles_OBJ_Can03 0;
BA_ "GenSigInvalidValue" SG_ 536 SGU23_LifeCycles_OBJ_Can03 0;
BA_ "GenSigSendType" SG_ 536 SGU23_LifeCycles_OBJ_Can03 10;
BA_ "GenSigTimeoutValue" SG_ 536 SGU23_LifeCycles_OBJ_Can03 0;
BA_ "EventCommandSignal" SG_ 536 SGU23_Msg_AliveCounter_Can03 0;
BA_ "GatewayedSignals" SG_ 536 SGU23_Msg_AliveCounter_Can03 0;
BA_ "GenSigInvalidValue" SG_ 536 SGU23_Msg_AliveCounter_Can03 0;
BA_ "GenSigSendType" SG_ 536 SGU23_Msg_AliveCounter_Can03 10;
BA_ "GenSigTimeoutValue" SG_ 536 SGU23_Msg_AliveCounter_Can03 0;
BA_ "EventCommandSignal" SG_ 536 SGU23_Msg_CheckSum_Can03 0;
BA_ "GatewayedSignals" SG_ 536 SGU23_Msg_CheckSum_Can03 0;
BA_ "GenSigInvalidValue" SG_ 536 SGU23_Msg_CheckSum_Can03 0;
BA_ "GenSigSendType" SG_ 536 SGU23_Msg_CheckSum_Can03 10;
BA_ "GenSigTimeoutValue" SG_ 536 SGU23_Msg_CheckSum_Can03 0;
BA_ "IsCrcSignal" SG_ 536 SGU23_Msg_CheckSum_Can03 1;
BA_ "EventCommandSignal" SG_ 536 SGU23_ObjRCS_23_Can03 0;
BA_ "GatewayedSignals" SG_ 536 SGU23_ObjRCS_23_Can03 0;
BA_ "GenSigInvalidValue" SG_ 536 SGU23_ObjRCS_23_Can03 0;
BA_ "GenSigSendType" SG_ 536 SGU23_ObjRCS_23_Can03 10;
BA_ "GenSigTimeoutValue" SG_ 536 SGU23_ObjRCS_23_Can03 0;
BA_ "EventCommandSignal" SG_ 536 SGU23_Obj_DistLat_rms_Can03 0;
BA_ "GatewayedSignals" SG_ 536 SGU23_Obj_DistLat_rms_Can03 0;
BA_ "GenSigInvalidValue" SG_ 536 SGU23_Obj_DistLat_rms_Can03 0;
BA_ "GenSigSendType" SG_ 536 SGU23_Obj_DistLat_rms_Can03 10;
BA_ "GenSigTimeoutValue" SG_ 536 SGU23_Obj_DistLat_rms_Can03 0;
BA_ "EventCommandSignal" SG_ 536 SGU23_Obj_VrelLong_rms_Can03 0;
BA_ "GatewayedSignals" SG_ 536 SGU23_Obj_VrelLong_rms_Can03 0;
BA_ "GenSigInvalidValue" SG_ 536 SGU23_Obj_VrelLong_rms_Can03 0;
BA_ "GenSigSendType" SG_ 536 SGU23_Obj_VrelLong_rms_Can03 10;
BA_ "GenSigTimeoutValue" SG_ 536 SGU23_Obj_VrelLong_rms_Can03 0;
BA_ "EventCommandSignal" SG_ 536 SGU23_Obj_Vrelat_rms_Can03 0;
BA_ "GatewayedSignals" SG_ 536 SGU23_Obj_Vrelat_rms_Can03 0;
BA_ "GenSigInvalidValue" SG_ 536 SGU23_Obj_Vrelat_rms_Can03 0;
BA_ "GenSigSendType" SG_ 536 SGU23_Obj_Vrelat_rms_Can03 10;
BA_ "GenSigTimeoutValue" SG_ 536 SGU23_Obj_Vrelat_rms_Can03 0;
BA_ "EventCommandSignal" SG_ 536 SGU23_Object_DetStatus_Can03 0;
BA_ "GatewayedSignals" SG_ 536 SGU23_Object_DetStatus_Can03 0;
BA_ "GenSigInvalidValue" SG_ 536 SGU23_Object_DetStatus_Can03 0;
BA_ "GenSigSendType" SG_ 536 SGU23_Object_DetStatus_Can03 10;
BA_ "GenSigTimeoutValue" SG_ 536 SGU23_Object_DetStatus_Can03 0;
BA_ "EventCommandSignal" SG_ 536 SGU23_Object_DistLong_rms_Can03 0;
BA_ "GatewayedSignals" SG_ 536 SGU23_Object_DistLong_rms_Can03 0;
BA_ "GenSigInvalidValue" SG_ 536 SGU23_Object_DistLong_rms_Can03 0;
BA_ "GenSigSendType" SG_ 536 SGU23_Object_DistLong_rms_Can03 10;
BA_ "GenSigTimeoutValue" SG_ 536 SGU23_Object_DistLong_rms_Can03 0;
BA_ "EventCommandSignal" SG_ 536 SGU23_Object_ID_Can03 0;
BA_ "GatewayedSignals" SG_ 536 SGU23_Object_ID_Can03 0;
BA_ "GenSigInvalidValue" SG_ 536 SGU23_Object_ID_Can03 0;
BA_ "GenSigSendType" SG_ 536 SGU23_Object_ID_Can03 10;
BA_ "GenSigTimeoutValue" SG_ 536 SGU23_Object_ID_Can03 0;
BA_ "EventCommandSignal" SG_ 536 SGU23_Object_MotionPattern_Can03 0;
BA_ "GatewayedSignals" SG_ 536 SGU23_Object_MotionPattern_Can03 0;
BA_ "GenSigInvalidValue" SG_ 536 SGU23_Object_MotionPattern_Can03 0;
BA_ "GenSigSendType" SG_ 536 SGU23_Object_MotionPattern_Can03 10;
BA_ "GenSigTimeoutValue" SG_ 536 SGU23_Object_MotionPattern_Can03 0;
BA_ "EventCommandSignal" SG_ 536 SGU23_Object_Type_Can03 0;
BA_ "GatewayedSignals" SG_ 536 SGU23_Object_Type_Can03 0;
BA_ "GenSigInvalidValue" SG_ 536 SGU23_Object_Type_Can03 0;
BA_ "GenSigSendType" SG_ 536 SGU23_Object_Type_Can03 10;
BA_ "GenSigTimeoutValue" SG_ 536 SGU23_Object_Type_Can03 0;
BA_ "EventCommandSignal" SG_ 536 SGU23_Object_ax_Can03 0;
BA_ "GatewayedSignals" SG_ 536 SGU23_Object_ax_Can03 0;
BA_ "GenSigInvalidValue" SG_ 536 SGU23_Object_ax_Can03 0;
BA_ "GenSigSendType" SG_ 536 SGU23_Object_ax_Can03 10;
BA_ "GenSigTimeoutValue" SG_ 536 SGU23_Object_ax_Can03 0;
BA_ "EventCommandSignal" SG_ 536 SGU23_Object_ay_Can03 0;
BA_ "GatewayedSignals" SG_ 536 SGU23_Object_ay_Can03 0;
BA_ "GenSigInvalidValue" SG_ 536 SGU23_Object_ay_Can03 0;
BA_ "GenSigSendType" SG_ 536 SGU23_Object_ay_Can03 10;
BA_ "GenSigTimeoutValue" SG_ 536 SGU23_Object_ay_Can03 0;
BA_ "EventCommandSignal" SG_ 536 SGU23_Object_dx_Nearest_Can03 0;
BA_ "GatewayedSignals" SG_ 536 SGU23_Object_dx_Nearest_Can03 0;
BA_ "GenSigInvalidValue" SG_ 536 SGU23_Object_dx_Nearest_Can03 0;
BA_ "GenSigSendType" SG_ 536 SGU23_Object_dx_Nearest_Can03 1;
BA_ "GenSigTimeoutValue" SG_ 536 SGU23_Object_dx_Nearest_Can03 0;
BA_ "EventCommandSignal" SG_ 536 SGU23_Object_dx_Rear_Can03 0;
BA_ "GatewayedSignals" SG_ 536 SGU23_Object_dx_Rear_Can03 0;
BA_ "GenSigInvalidValue" SG_ 536 SGU23_Object_dx_Rear_Can03 0;
BA_ "GenSigSendType" SG_ 536 SGU23_Object_dx_Rear_Can03 10;
BA_ "GenSigTimeoutValue" SG_ 536 SGU23_Object_dx_Rear_Can03 0;
BA_ "EventCommandSignal" SG_ 536 SGU23_Object_dy_Nearest_Can03 0;
BA_ "GatewayedSignals" SG_ 536 SGU23_Object_dy_Nearest_Can03 0;
BA_ "GenSigInvalidValue" SG_ 536 SGU23_Object_dy_Nearest_Can03 0;
BA_ "GenSigSendType" SG_ 536 SGU23_Object_dy_Nearest_Can03 1;
BA_ "GenSigTimeoutValue" SG_ 536 SGU23_Object_dy_Nearest_Can03 0;
BA_ "EventCommandSignal" SG_ 536 SGU23_Object_dy_Rear_Can03 0;
BA_ "GatewayedSignals" SG_ 536 SGU23_Object_dy_Rear_Can03 0;
BA_ "GenSigInvalidValue" SG_ 536 SGU23_Object_dy_Rear_Can03 0;
BA_ "GenSigSendType" SG_ 536 SGU23_Object_dy_Rear_Can03 10;
BA_ "GenSigTimeoutValue" SG_ 536 SGU23_Object_dy_Rear_Can03 0;
BA_ "EventCommandSignal" SG_ 536 SGU23_Object_vx_Can03 0;
BA_ "GatewayedSignals" SG_ 536 SGU23_Object_vx_Can03 0;
BA_ "GenSigInvalidValue" SG_ 536 SGU23_Object_vx_Can03 0;
BA_ "GenSigSendType" SG_ 536 SGU23_Object_vx_Can03 10;
BA_ "GenSigTimeoutValue" SG_ 536 SGU23_Object_vx_Can03 0;
BA_ "EventCommandSignal" SG_ 536 SGU23_Object_vy_Can03 0;
BA_ "GatewayedSignals" SG_ 536 SGU23_Object_vy_Can03 0;
BA_ "GenSigInvalidValue" SG_ 536 SGU23_Object_vy_Can03 0;
BA_ "GenSigSendType" SG_ 536 SGU23_Object_vy_Can03 10;
BA_ "GenSigTimeoutValue" SG_ 536 SGU23_Object_vy_Can03 0;
BA_ "EventCommandSignal" SG_ 536 SGU23_Object_wExist_Can03 0;
BA_ "GatewayedSignals" SG_ 536 SGU23_Object_wExist_Can03 0;
BA_ "GenSigInvalidValue" SG_ 536 SGU23_Object_wExist_Can03 0;
BA_ "GenSigSendType" SG_ 536 SGU23_Object_wExist_Can03 10;
BA_ "GenSigTimeoutValue" SG_ 536 SGU23_Object_wExist_Can03 0;
BA_ "EventCommandSignal" SG_ 536 SGU23_Object_wObstacle_Can03 0;
BA_ "GatewayedSignals" SG_ 536 SGU23_Object_wObstacle_Can03 0;
BA_ "GenSigInvalidValue" SG_ 536 SGU23_Object_wObstacle_Can03 0;
BA_ "GenSigSendType" SG_ 536 SGU23_Object_wObstacle_Can03 10;
BA_ "GenSigTimeoutValue" SG_ 536 SGU23_Object_wObstacle_Can03 0;
BA_ "VFrameFormat" BO_ 524 14;
BA_ "VFrameFormat" BO_ 525 14;
BA_ "VFrameFormat" BO_ 526 14;
BA_ "VFrameFormat" BO_ 527 14;
BA_ "VFrameFormat" BO_ 528 14;
BA_ "VFrameFormat" BO_ 529 14;
BA_ "VFrameFormat" BO_ 530 14;
BA_ "VFrameFormat" BO_ 531 14;
BA_ "VFrameFormat" BO_ 532 14;
BA_ "VFrameFormat" BO_ 533 14;
BA_ "VFrameFormat" BO_ 534 14;
BA_ "VFrameFormat" BO_ 535 14;
BA_ "VFrameFormat" BO_ 536 14;
VAL_ 524 SGU11_Object_DetStatus_Can03 0 "deleted" 1 "new" 2 "measured" 3 "predicted" 4 "deleted for merge" 5 "new from merge"  ;
VAL_ 524 SGU11_Object_MotionPattern_Can03 0 "Unknown" 1 "Stationary" 2 "Stopped" 3 "Moving"  ;
VAL_ 524 SGU11_Object_Type_Can03 0 "Unknown" 1 "4 wheeler" 2 "2 wheeler" 3 "Pedestrian"  ;
VAL_ 525 SGU12_Object_DetStatus_Can03 0 "deleted" 1 "new" 2 "measured" 3 "predicted" 4 "deleted for merge" 5 "new from merge"  ;
VAL_ 525 SGU12_Object_MotionPattern_Can03 0 "Unknown" 1 "Stationary" 2 "Stopped" 3 "Moving"  ;
VAL_ 525 SGU12_Object_Type_Can03 0 "Unknown" 1 "4 wheeler" 2 "2 wheeler" 3 "Pedestrian"  ;
VAL_ 526 SGU13_Object_DetStatus_Can03 0 "deleted" 1 "new" 2 "measured" 3 "predicted" 4 "deleted for merge" 5 "new from merge"  ;
VAL_ 526 SGU13_Object_MotionPattern_Can03 0 "Unknown" 1 "Stationary" 2 "Stopped" 3 "Moving"  ;
VAL_ 526 SGU13_Object_Type_Can03 0 "Unknown" 1 "4 wheeler" 2 "2 wheeler" 3 "Pedestrian"  ;
VAL_ 527 SGU14_Object_DetStatus_Can03 0 "deleted" 1 "new" 2 "measured" 3 "predicted" 4 "deleted for merge" 5 "new from merge"  ;
VAL_ 527 SGU14_Object_MotionPattern_Can03 0 "Unknown" 1 "Stationary" 2 "Stopped" 3 "Moving"  ;
VAL_ 527 SGU14_Object_Type_Can03 0 "Unknown" 1 "4 wheeler" 2 "2 wheeler" 3 "Pedestrian"  ;
VAL_ 528 SGU15_Object_DetStatus_Can03 0 "deleted" 1 "new" 2 "measured" 3 "predicted" 4 "deleted for merge" 5 "new from merge"  ;
VAL_ 528 SGU15_Object_MotionPattern_Can03 0 "Unknown" 1 "Stationary" 2 "Stopped" 3 "Moving"  ;
VAL_ 528 SGU15_Object_Type_Can03 0 "Unknown" 1 "4 wheeler" 2 "2 wheeler" 3 "Pedestrian"  ;
VAL_ 529 SGU16_Object_DetStatus_Can03 0 "deleted" 1 "new" 2 "measured" 3 "predicted" 4 "deleted for merge" 5 "new from merge"  ;
VAL_ 529 SGU16_Object_MotionPattern_Can03 0 "Unknown" 1 "Stationary" 2 "Stopped" 3 "Moving"  ;
VAL_ 529 SGU16_Object_Type_Can03 0 "Unknown" 1 "4 wheeler" 2 "2 wheeler" 3 "Pedestrian"  ;
VAL_ 530 SGU17_Object_DetStatus_Can03 0 "deleted" 1 "new" 2 "measured" 3 "predicted" 4 "deleted for merge" 5 "new from merge"  ;
VAL_ 530 SGU17_Object_MotionPattern_Can03 0 "Unknown" 1 "Stationary" 2 "Stopped" 3 "Moving"  ;
VAL_ 530 SGU17_Object_Type_Can03 0 "Unknown" 1 "4 wheeler" 2 "2 wheeler" 3 "Pedestrian"  ;
VAL_ 531 SGU18_Object_DetStatus_Can03 0 "deleted" 1 "new" 2 "measured" 3 "predicted" 4 "deleted for merge" 5 "new from merge"  ;
VAL_ 531 SGU18_Object_MotionPattern_Can03 0 "Unknown" 1 "Stationary" 2 "Stopped" 3 "Moving"  ;
VAL_ 531 SGU18_Object_Type_Can03 0 "Unknown" 1 "4 wheeler" 2 "2 wheeler" 3 "Pedestrian"  ;
VAL_ 532 SGU19_Object_DetStatus_Can03 0 "deleted" 1 "new" 2 "measured" 3 "predicted" 4 "deleted for merge" 5 "new from merge"  ;
VAL_ 532 SGU19_Object_MotionPattern_Can03 0 "Unknown" 1 "Stationary" 2 "Stopped" 3 "Moving"  ;
VAL_ 532 SGU19_Object_Type_Can03 0 "Unknown" 1 "4 wheeler" 2 "2 wheeler" 3 "Pedestrian"  ;
VAL_ 533 SGU20_Object_DetStatus_Can03 0 "deleted" 1 "new" 2 "measured" 3 "predicted" 4 "deleted for merge" 5 "new from merge"  ;
VAL_ 533 SGU20_Object_MotionPattern_Can03 0 "Unknown" 1 "Stationary" 2 "Stopped" 3 "Moving"  ;
VAL_ 533 SGU20_Object_Type_Can03 0 "Unknown" 1 "4 wheeler" 2 "2 wheeler" 3 "Pedestrian"  ;
VAL_ 534 SGU21_Object_DetStatus_Can03 0 "deleted" 1 "new" 2 "measured" 3 "predicted" 4 "deleted for merge" 5 "new from merge"  ;
VAL_ 534 SGU21_Object_MotionPattern_Can03 0 "Unknown" 1 "Stationary" 2 "Stopped" 3 "Moving"  ;
VAL_ 534 SGU21_Object_Type_Can03 0 "Unknown" 1 "4 wheeler" 2 "2 wheeler" 3 "Pedestrian"  ;
VAL_ 535 SGU22_Object_DetStatus_Can03 0 "deleted" 1 "new" 2 "measured" 3 "predicted" 4 "deleted for merge" 5 "new from merge"  ;
VAL_ 535 SGU22_Object_MotionPattern_Can03 0 "Unknown" 1 "Stationary" 2 "Stopped" 3 "Moving"  ;
VAL_ 535 SGU22_Object_Type_Can03 0 "Unknown" 1 "4 wheeler" 2 "2 wheeler" 3 "Pedestrian"  ;
VAL_ 536 SGU23_Object_DetStatus_Can03 0 "deleted" 1 "new" 2 "measured" 3 "predicted" 4 "deleted for merge" 5 "new from merge"  ;
VAL_ 536 SGU23_Object_MotionPattern_Can03 0 "Unknown" 1 "Stationary" 2 "Stopped" 3 "Moving"  ;
VAL_ 536 SGU23_Object_Type_Can03 0 "Unknown" 1 "4 wheeler" 2 "2 wheeler" 3 "Pedestrian"  ;
