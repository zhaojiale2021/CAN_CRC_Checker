VERSION "Version"

NS_ :

BS_:

BU_: ADC RRR SOC Tester

BO_ 38 ADC_SOC_Status: 32 ADC
 SG_ ADC_SOC_Status_Msg_CheckSum_Can03 : 7|8@0+ (1,0) [0|255] ""  RRR
 SG_ SOC_ADCFaultSt_Can03 : 172|4@0+ (1,0) [0|15] "/"  RRR

BO_ 352 BCS_2_A: 32 ADC
 SG_ BCS_2_CRC : 7|8@0+ (1,0) [0|255] ""  RRR
 SG_ BCS_2_Counter : 11|4@0+ (1,0) [0|14] ""  RRR
 SG_ BCS_ABSActiveSt : 33|1@0+ (1,0) [0|1] ""  RRR
 SG_ BCS_ABSFaultSt : 34|1@0+ (1,0) [0|1] ""  RRR
 SG_ BCS_TCSActiveSt : 35|1@0+ (1,0) [0|1] ""  RRR
 SG_ BCS_TCSFaultSt : 36|1@0+ (1,0) [0|1] ""  RRR
 SG_ BCS_VDCActiveSt : 37|1@0+ (1,0) [0|1] ""  RRR
 SG_ BCS_VDCFaultSt : 38|1@0+ (1,0) [0|1] ""  RRR
 SG_ SOC_VehSpd : 46|13@0+ (0.05625,0) [0|240] "km/h"  RRR
 SG_ SOC_VehSpdVD : 49|1@0+ (1,0) [0|1] ""  RRR

BO_ 353 BCS_1_A: 32 ADC
 SG_ BCS_1_CRC : 7|8@0+ (1,0) [0|255] ""  RRR
 SG_ BCS_1_Counter : 11|4@0+ (1,0) [0|14] ""  RRR
 SG_ BCS_VehicleStandStillSt : 31|2@0+ (1,0) [0|3] ""  RRR

BO_ 363 EPS_1: 16 ADC
 SG_ EPS_1_CRC : 7|8@0+ (1,0) [0|255] ""  RRR
 SG_ EPS_1_Counter : 11|4@0+ (1,0) [0|14] ""  RRR
 SG_ EPS_SteeringAngleSpdVD : 19|1@0+ (1,0) [0|1] ""  RRR
 SG_ EPS_FunctionStyleSt : 23|2@0+ (1,0) [0|3] ""  RRR
 SG_ EPS_SteeringAngle : 31|16@0+ (0.1,-780) [-780|779.9] "deg"  RRR
 SG_ EPS_SteeringAngleVD : 40|1@0+ (1,0) [0|1] ""  RRR
 SG_ EPS_SteeringModeSt : 42|2@0+ (1,0) [0|3] ""  RRR
 SG_ EPS_SteeringAngleSpd : 55|8@0+ (4,0) [0|1016] "deg/sec"  RRR

BO_ 394 BCS_3_A: 32 ADC
 SG_ BCS_3_CRC1 : 7|8@0+ (1,0) [0|255] ""  RRR
 SG_ BCS_3_Counter1 : 11|4@0+ (1,0) [0|14] ""  RRR
 SG_ BCS_FLWheelSpd : 23|13@0+ (0.05625,0) [0|240] "km/h"  RRR
 SG_ BCS_FLWheelSpdVD : 26|1@0+ (1,0) [0|1] ""  RRR
 SG_ BCS_FLWheelRotatedDirection : 25|1@0+ (1,0) [0|1] ""  RRR
 SG_ BCS_FLWheelRotatedDirectionVD : 24|1@0+ (1,0) [0|1] ""  RRR
 SG_ BCS_FRWheelSpd : 39|13@0+ (0.05625,0) [0|240] "km/h"  RRR
 SG_ BCS_FRWheelSpdVD : 42|1@0+ (1,0) [0|1] ""  RRR
 SG_ BCS_FRWheelRotatedDirection : 41|1@0+ (1,0) [0|1] ""  RRR
 SG_ BCS_FRWheelRotatedDirectionVD : 40|1@0+ (1,0) [0|1] ""  RRR
 SG_ BCS_RLWheelSpd : 55|13@0+ (0.05625,0) [0|240] "km/h"  RRR
 SG_ BCS_RLWheelSpdVD : 58|1@0+ (1,0) [0|1] ""  RRR
 SG_ BCS_RLWheelRotatedDirection : 57|1@0+ (1,0) [0|1] ""  RRR
 SG_ BCS_RLWheelRotatedDirectionVD : 56|1@0+ (1,0) [0|1] ""  RRR
 SG_ BCS_RRWheelSpd : 71|13@0+ (0.05625,0) [0|240] "km/h"  RRR
 SG_ BCS_RRWheelSpdVD : 74|1@0+ (1,0) [0|1] ""  RRR
 SG_ BCS_RRWheelRotatedDirection : 73|1@0+ (1,0) [0|1] ""  RRR
 SG_ BCS_RRWheelRotatedDirectionVD : 72|1@0+ (1,0) [0|1] ""  RRR
 SG_ BCS_YawRateSt : 87|1@0+ (1,0) [0|1] ""  RRR
 SG_ BCS_YawRate : 95|12@0+ (0.0009765625,-2.0943) [-2.0943|1.9047234375] "rad/s"  RRR
 SG_ BCS_ActVehLongAccel : 119|12@0+ (0.027126736,-21.593) [-21.593|21.593] "m/s^2"  RRR
 SG_ BCS_ActVehLaltrlAccel : 143|12@0+ (0.027126736,-21.593) [-21.593|21.593] "m/s^2"  RRR
 SG_ BCS_ActVehLongAccelVD : 160|1@0+ (1,0) [0|1] ""  RRR
 SG_ BCS_ActVehLaltrlAccelVD : 161|1@0+ (1,0) [0|1] ""  RRR

BO_ 513 RRR_SensorState: 32 RRR
 SG_ RRR_Msg_CheckSum : 7|8@0+ (1,0) [0|255] ""  ADC
 SG_ RRR_Msg_AliveCounter : 11|4@0+ (1,0) [0|14] ""  ADC
 SG_ RRR_BlockCounter : 15|4@0+ (1,0) [0|15] ""  ADC
 SG_ RRR_OperationMode : 20|3@0+ (1,0) [0|7] ""  ADC
 SG_ RRR_SensorType : 23|3@0+ (1,0) [0|7] ""  ADC
 SG_ RRR_Num_Of_Objects : 29|6@0+ (1,0) [0|32] ""  ADC
 SG_ RRR_SGUFail : 16|3@0+ (1,0) [0|7] ""  ADC
 SG_ RRR_TimerStampStatus : 39|8@0+ (1,0) [0|255] ""  ADC
 SG_ RRR_Object_Mea_timestamp_1 : 79|64@0+ (1,0) [0|18.4467440737096] "ns"  ADC
 SG_ RRR_Object_Mea_timestamp_2 : 143|32@0+ (1,0) [0|4294967295] "ns"  ADC
 SG_ RRR_SDA_HorzDeviationAngle_Can03 : 175|16@0+ (0.01,-180) [-180|180] "degree"  ADC
 SG_ RRR_SDA_VertDeviationAngle_Can03 : 191|16@0+ (0.01,-180) [-180|180] "degree"  ADC
 SG_ RRR_Signal_Operation_State : 210|3@0+ (1,0) [0|7] ""  ADC
 SG_ RRR_TimeSync_Operation_State : 213|3@0+ (1,0) [0|7] ""  ADC
 SG_ RRR_Signal_Operatation_Channel : 215|2@0+ (1,0) [0|4] ""  ADC
 SG_ RRR_TimeSync_Operatation_Channel : 217|2@0+ (1,0) [0|4] ""  ADC
 SG_ RRR_Moudulation_State : 220|3@0+ (1,0) [0|7] ""  ADC

BO_ 514 RRR_Obj_01: 32 RRR
 SG_ SGU1_Msg_CheckSum : 7|8@0+ (1,0) [0|255] ""  ADC
 SG_ SGU1_Msg_AliveCounter : 11|4@0+ (1,0) [0|14] ""  ADC
 SG_ SGU1_BlockCounter : 15|4@0+ (1,0) [0|15] ""  ADC
 SG_ SGU1_Object_ID : 23|8@0+ (1,0) [0|255] ""  ADC
 SG_ SGU1_Object_wExist : 28|5@0+ (0.03125,0) [0|0.96875] ""  ADC
 SG_ SGU1_Object_Type : 31|3@0+ (1,0) [0|7] ""  ADC
 SG_ SGU1_Object_Motion_Pattern : 34|3@0+ (1,0) [0|7] ""  ADC
 SG_ SGU1_Object_wObstacle : 39|5@0+ (0.03125,0) [0|0.96875] ""  ADC
 SG_ SGU1_Object_dx : 43|12@0+ (0.0625,-128) [-128|127.9375] "m"  ADC
 SG_ SGU1_Object_dy : 59|12@0+ (0.125,-128) [-128|127.875] "m"  ADC
 SG_ SGU1_Object_DistLong_rms : 79|16@0+ (0.001953125,0) [0|127.998046875] "m"  ADC
 SG_ SGU1_Obj_DistLat_rms : 95|16@0+ (0.001953125,0) [0|127.998046875] "m"  ADC
 SG_ SGU1_Object_vx : 107|12@0+ (0.0625,-128) [-128|127.9375] "m/s"  ADC
 SG_ SGU1_Object_vy : 123|12@0+ (0.0625,-128) [-128|127.9375] "m/s"  ADC
 SG_ SGU1_Obj_VrelLong_rms : 143|16@0+ (0.001953125,0) [0|127.998046875] "m/s"  ADC
 SG_ SGU1_Obj_Vrelat_rms : 159|16@0+ (0.001953125,0) [0|127.998046875] "m/s"  ADC
 SG_ SGU1_Object_ax : 170|11@0+ (0.03125,-16) [-16|15.96875] "m/s^2"  ADC
 SG_ SGU1_Object_ay : 191|11@0+ (0.03125,-16) [-16|15.96875] "m/s^2"  ADC
 SG_ SGU1_Object_DetStatus : 173|3@0+ (1,0) [0|7] ""  ADC
 SG_ SGU1_LifeCycles_OBJ : 196|8@0+ (1,0) [0|255] ""  ADC
 SG_ SGU1_ObjRCS_01 : 204|10@0+ (0.125,-50) [-50|70] "dBm2"  ADC
 SG_ SGU1_Object_dx_Rear : 209|12@0+ (0.0625,-128) [-128|127.9375] "m"  ADC
 SG_ SGU1_Object_dy_Rear : 229|12@0+ (0.125,-128) [-128|127.875] "m"  ADC

BO_ 515 RRR_Obj_02: 32 RRR
 SG_ SGU2_Msg_CheckSum : 7|8@0+ (1,0) [0|255] ""  ADC
 SG_ SGU2_Msg_AliveCounter : 11|4@0+ (1,0) [0|14] ""  ADC
 SG_ SGU2_BlockCounter : 15|4@0+ (1,0) [0|15] ""  ADC
 SG_ SGU2_Object_ID : 23|8@0+ (1,0) [0|255] ""  ADC
 SG_ SGU2_Object_wExist : 28|5@0+ (0.03125,0) [0|0.96875] ""  ADC
 SG_ SGU2_Object_Type : 31|3@0+ (1,0) [0|7] ""  ADC
 SG_ SGU2_Object_Motion_Pattern : 34|3@0+ (1,0) [0|7] ""  ADC
 SG_ SGU2_Object_wObstacle : 39|5@0+ (0.03125,0) [0|0.96875] ""  ADC
 SG_ SGU2_Object_dx : 43|12@0+ (0.0625,-128) [-128|127.9375] "m"  ADC
 SG_ SGU2_Object_dy : 59|12@0+ (0.125,-128) [-128|127.875] "m"  ADC
 SG_ SGU2_Object_DistLong_rms : 79|16@0+ (0.001953125,0) [0|127.998046875] "m"  ADC
 SG_ SGU2_Obj_DistLat_rms : 95|16@0+ (0.001953125,0) [0|127.998046875] "m"  ADC
 SG_ SGU2_Object_vx : 107|12@0+ (0.0625,-128) [-128|127.9375] "m/s"  ADC
 SG_ SGU2_Object_vy : 123|12@0+ (0.0625,-128) [-128|127.9375] "m/s"  ADC
 SG_ SGU2_Obj_VrelLong_rms : 143|16@0+ (0.001953125,0) [0|127.998046875] "m/s"  ADC
 SG_ SGU2_Obj_Vrelat_rms : 159|16@0+ (0.001953125,0) [0|127.998046875] "m/s"  ADC
 SG_ SGU2_Object_ax : 170|11@0+ (0.03125,-16) [-16|15.96875] "m/s^2"  ADC
 SG_ SGU2_Object_ay : 191|11@0+ (0.03125,-16) [-16|15.96875] "m/s^2"  ADC
 SG_ SGU2_Object_DetStatus : 173|3@0+ (1,0) [0|7] ""  ADC
 SG_ SGU2_LifeCycles_OBJ : 196|8@0+ (1,0) [0|255] ""  ADC
 SG_ SGU2_ObjRCS_02 : 204|10@0+ (0.125,-50) [-50|70] "dBm2"  ADC
 SG_ SGU2_Object_dx_Rear : 209|12@0+ (0.0625,-128) [-128|127.9375] "m"  ADC
 SG_ SGU2_Object_dy_Rear : 229|12@0+ (0.125,-128) [-128|127.875] "m"  ADC

BO_ 516 RRR_Obj_03: 32 RRR
 SG_ SGU3_Msg_CheckSum : 7|8@0+ (1,0) [0|255] ""  ADC
 SG_ SGU3_Msg_AliveCounter : 11|4@0+ (1,0) [0|14] ""  ADC
 SG_ SGU3_BlockCounter : 15|4@0+ (1,0) [0|15] ""  ADC
 SG_ SGU3_Object_ID : 23|8@0+ (1,0) [0|255] ""  ADC
 SG_ SGU3_Object_wExist : 28|5@0+ (0.03125,0) [0|0.96875] ""  ADC
 SG_ SGU3_Object_Type : 31|3@0+ (1,0) [0|7] ""  ADC
 SG_ SGU3_Object_Motion_Pattern : 34|3@0+ (1,0) [0|7] ""  ADC
 SG_ SGU3_Object_wObstacle : 39|5@0+ (0.03125,0) [0|0.96875] ""  ADC
 SG_ SGU3_Object_dx : 43|12@0+ (0.0625,-128) [-128|127.9375] "m"  ADC
 SG_ SGU3_Object_dy : 59|12@0+ (0.125,-128) [-128|127.875] "m"  ADC
 SG_ SGU3_Object_DistLong_rms : 79|16@0+ (0.001953125,0) [0|127.998046875] "m"  ADC
 SG_ SGU3_Obj_DistLat_rms : 95|16@0+ (0.001953125,0) [0|127.998046875] "m"  ADC
 SG_ SGU3_Object_vx : 107|12@0+ (0.0625,-128) [-128|127.9375] "m/s"  ADC
 SG_ SGU3_Object_vy : 123|12@0+ (0.0625,-128) [-128|127.9375] "m/s"  ADC
 SG_ SGU3_Obj_VrelLong_rms : 143|16@0+ (0.001953125,0) [0|127.998046875] "m/s"  ADC
 SG_ SGU3_Obj_Vrelat_rms : 159|16@0+ (0.001953125,0) [0|127.998046875] "m/s"  ADC
 SG_ SGU3_Object_ax : 170|11@0+ (0.03125,-16) [-16|15.96875] "m/s^2"  ADC
 SG_ SGU3_Object_ay : 191|11@0+ (0.03125,-16) [-16|15.96875] "m/s^2"  ADC
 SG_ SGU3_Object_DetStatus : 173|3@0+ (1,0) [0|7] ""  ADC
 SG_ SGU3_LifeCycles_OBJ : 196|8@0+ (1,0) [0|255] ""  ADC
 SG_ SGU3_ObjRCS_03 : 204|10@0+ (0.125,-50) [-50|70] "dBm2"  ADC
 SG_ SGU3_Object_dx_Rear : 209|12@0+ (0.0625,-128) [-128|127.9375] "m"  ADC
 SG_ SGU3_Object_dy_Rear : 229|12@0+ (0.125,-128) [-128|127.875] "m"  ADC

BO_ 517 RRR_Obj_04: 32 RRR
 SG_ SGU4_Msg_CheckSum : 7|8@0+ (1,0) [0|255] ""  ADC
 SG_ SGU4_Msg_AliveCounter : 11|4@0+ (1,0) [0|14] ""  ADC
 SG_ SGU4_BlockCounter : 15|4@0+ (1,0) [0|15] ""  ADC
 SG_ SGU4_Object_ID : 23|8@0+ (1,0) [0|255] ""  ADC
 SG_ SGU4_Object_wExist : 28|5@0+ (0.03125,0) [0|0.96875] ""  ADC
 SG_ SGU4_Object_Type : 31|3@0+ (1,0) [0|7] ""  ADC
 SG_ SGU4_Object_Motion_Pattern : 34|3@0+ (1,0) [0|7] ""  ADC
 SG_ SGU4_Object_wObstacle : 39|5@0+ (0.03125,0) [0|0.96875] ""  ADC
 SG_ SGU4_Object_dx : 43|12@0+ (0.0625,-128) [-128|127.9375] "m"  ADC
 SG_ SGU4_Object_dy : 59|12@0+ (0.125,-128) [-128|127.875] "m"  ADC
 SG_ SGU4_Object_DistLong_rms : 79|16@0+ (0.001953125,0) [0|127.998046875] "m"  ADC
 SG_ SGU4_Obj_DistLat_rms : 95|16@0+ (0.001953125,0) [0|127.998046875] "m"  ADC
 SG_ SGU4_Object_vx : 107|12@0+ (0.0625,-128) [-128|127.9375] "m/s"  ADC
 SG_ SGU4_Object_vy : 123|12@0+ (0.0625,-128) [-128|127.9375] "m/s"  ADC
 SG_ SGU4_Obj_VrelLong_rms : 143|16@0+ (0.001953125,0) [0|127.998046875] "m/s"  ADC
 SG_ SGU4_Obj_Vrelat_rms : 159|16@0+ (0.001953125,0) [0|127.998046875] "m/s"  ADC
 SG_ SGU4_Object_ax : 170|11@0+ (0.03125,-16) [-16|15.96875] "m/s^2"  ADC
 SG_ SGU4_Object_ay : 191|11@0+ (0.03125,-16) [-16|15.96875] "m/s^2"  ADC
 SG_ SGU4_Object_DetStatus : 173|3@0+ (1,0) [0|7] ""  ADC
 SG_ SGU4_LifeCycles_OBJ : 196|8@0+ (1,0) [0|255] ""  ADC
 SG_ SGU4_ObjRCS_04 : 204|10@0+ (0.125,-50) [-50|70] "dBm2"  ADC
 SG_ SGU4_Object_dx_Rear : 209|12@0+ (0.0625,-128) [-128|127.9375] "m"  ADC
 SG_ SGU4_Object_dy_Rear : 229|12@0+ (0.125,-128) [-128|127.875] "m"  ADC

BO_ 518 RRR_Obj_05: 32 RRR
 SG_ SGU5_Msg_CheckSum : 7|8@0+ (1,0) [0|255] ""  ADC
 SG_ SGU5_Msg_AliveCounter : 11|4@0+ (1,0) [0|14] ""  ADC
 SG_ SGU5_BlockCounter : 15|4@0+ (1,0) [0|15] ""  ADC
 SG_ SGU5_Object_ID : 23|8@0+ (1,0) [0|255] ""  ADC
 SG_ SGU5_Object_wExist : 28|5@0+ (0.03125,0) [0|0.96875] ""  ADC
 SG_ SGU5_Object_Type : 31|3@0+ (1,0) [0|7] ""  ADC
 SG_ SGU5_Object_Motion_Pattern : 34|3@0+ (1,0) [0|7] ""  ADC
 SG_ SGU5_Object_wObstacle : 39|5@0+ (0.03125,0) [0|0.96875] ""  ADC
 SG_ SGU5_Object_dx : 43|12@0+ (0.0625,-128) [-128|127.9375] "m"  ADC
 SG_ SGU5_Object_dy : 59|12@0+ (0.125,-128) [-128|127.875] "m"  ADC
 SG_ SGU5_Object_DistLong_rms : 79|16@0+ (0.001953125,0) [0|127.998046875] "m"  ADC
 SG_ SGU5_Obj_DistLat_rms : 95|16@0+ (0.001953125,0) [0|127.998046875] "m"  ADC
 SG_ SGU5_Object_vx : 107|12@0+ (0.0625,-128) [-128|127.9375] "m/s"  ADC
 SG_ SGU5_Object_vy : 123|12@0+ (0.0625,-128) [-128|127.9375] "m/s"  ADC
 SG_ SGU5_Obj_VrelLong_rms : 143|16@0+ (0.001953125,0) [0|127.998046875] "m/s"  ADC
 SG_ SGU5_Obj_Vrelat_rms : 159|16@0+ (0.001953125,0) [0|127.998046875] "m/s"  ADC
 SG_ SGU5_Object_ax : 170|11@0+ (0.03125,-16) [-16|15.96875] "m/s^2"  ADC
 SG_ SGU5_Object_ay : 191|11@0+ (0.03125,-16) [-16|15.96875] "m/s^2"  ADC
 SG_ SGU5_Object_DetStatus : 173|3@0+ (1,0) [0|7] ""  ADC
 SG_ SGU5_LifeCycles_OBJ : 196|8@0+ (1,0) [0|255] ""  ADC
 SG_ SGU5_ObjRCS_05 : 204|10@0+ (0.125,-50) [-50|70] "dBm2"  ADC
 SG_ SGU5_Object_dx_Rear : 209|12@0+ (0.0625,-128) [-128|127.9375] "m"  ADC
 SG_ SGU5_Object_dy_Rear : 229|12@0+ (0.125,-128) [-128|127.875] "m"  ADC

BO_ 519 RRR_Obj_06: 32 RRR
 SG_ SGU6_Msg_CheckSum : 7|8@0+ (1,0) [0|255] ""  ADC
 SG_ SGU6_Msg_AliveCounter : 11|4@0+ (1,0) [0|14] ""  ADC
 SG_ SGU6_BlockCounter : 15|4@0+ (1,0) [0|15] ""  ADC
 SG_ SGU6_Object_ID : 23|8@0+ (1,0) [0|255] ""  ADC
 SG_ SGU6_Object_wExist : 28|5@0+ (0.03125,0) [0|0.96875] ""  ADC
 SG_ SGU6_Object_Type : 31|3@0+ (1,0) [0|7] ""  ADC
 SG_ SGU6_Object_Motion_Pattern : 34|3@0+ (1,0) [0|7] ""  ADC
 SG_ SGU6_Object_wObstacle : 39|5@0+ (0.03125,0) [0|0.96875] ""  ADC
 SG_ SGU6_Object_dx : 43|12@0+ (0.0625,-128) [-128|127.9375] "m"  ADC
 SG_ SGU6_Object_dy : 59|12@0+ (0.125,-128) [-128|127.875] "m"  ADC
 SG_ SGU6_Object_DistLong_rms : 79|16@0+ (0.001953125,0) [0|127.998046875] "m"  ADC
 SG_ SGU6_Obj_DistLat_rms : 95|16@0+ (0.001953125,0) [0|127.998046875] "m"  ADC
 SG_ SGU6_Object_vx : 107|12@0+ (0.0625,-128) [-128|127.9375] "m/s"  ADC
 SG_ SGU6_Object_vy : 123|12@0+ (0.0625,-128) [-128|127.9375] "m/s"  ADC
 SG_ SGU6_Obj_VrelLong_rms : 143|16@0+ (0.001953125,0) [0|127.998046875] "m/s"  ADC
 SG_ SGU6_Obj_Vrelat_rms : 159|16@0+ (0.001953125,0) [0|127.998046875] "m/s"  ADC
 SG_ SGU6_Object_ax : 170|11@0+ (0.03125,-16) [-16|15.96875] "m/s^2"  ADC
 SG_ SGU6_Object_ay : 191|11@0+ (0.03125,-16) [-16|15.96875] "m/s^2"  ADC
 SG_ SGU6_Object_DetStatus : 173|3@0+ (1,0) [0|7] ""  ADC
 SG_ SGU6_LifeCycles_OBJ : 196|8@0+ (1,0) [0|255] ""  ADC
 SG_ SGU6_ObjRCS_06 : 204|10@0+ (0.125,-50) [-50|70] "dBm2"  ADC
 SG_ SGU6_Object_dx_Rear : 209|12@0+ (0.0625,-128) [-128|127.9375] "m"  ADC
 SG_ SGU6_Object_dy_Rear : 229|12@0+ (0.125,-128) [-128|127.875] "m"  ADC

BO_ 520 RRR_Obj_07: 32 RRR
 SG_ SGU7_Msg_CheckSum : 7|8@0+ (1,0) [0|255] ""  ADC
 SG_ SGU7_Msg_AliveCounter : 11|4@0+ (1,0) [0|14] ""  ADC
 SG_ SGU7_BlockCounter : 15|4@0+ (1,0) [0|15] ""  ADC
 SG_ SGU7_Object_ID : 23|8@0+ (1,0) [0|255] ""  ADC
 SG_ SGU7_Object_wExist : 28|5@0+ (0.03125,0) [0|0.96875] ""  ADC
 SG_ SGU7_Object_Type : 31|3@0+ (1,0) [0|7] ""  ADC
 SG_ SGU7_Object_Motion_Pattern : 34|3@0+ (1,0) [0|7] ""  ADC
 SG_ SGU7_Object_wObstacle : 39|5@0+ (0.03125,0) [0|0.96875] ""  ADC
 SG_ SGU7_Object_dx : 43|12@0+ (0.0625,-128) [-128|127.9375] "m"  ADC
 SG_ SGU7_Object_dy : 59|12@0+ (0.125,-128) [-128|127.875] "m"  ADC
 SG_ SGU7_Object_DistLong_rms : 79|16@0+ (0.001953125,0) [0|127.998046875] "m"  ADC
 SG_ SGU7_Obj_DistLat_rms : 95|16@0+ (0.001953125,0) [0|127.998046875] "m"  ADC
 SG_ SGU7_Object_vx : 107|12@0+ (0.0625,-128) [-128|127.9375] "m/s"  ADC
 SG_ SGU7_Object_vy : 123|12@0+ (0.0625,-128) [-128|127.9375] "m/s"  ADC
 SG_ SGU7_Obj_VrelLong_rms : 143|16@0+ (0.001953125,0) [0|127.998046875] "m/s"  ADC
 SG_ SGU7_Obj_Vrelat_rms : 159|16@0+ (0.001953125,0) [0|127.998046875] "m/s"  ADC
 SG_ SGU7_Object_ax : 170|11@0+ (0.03125,-16) [-16|15.96875] "m/s^2"  ADC
 SG_ SGU7_Object_ay : 191|11@0+ (0.03125,-16) [-16|15.96875] "m/s^2"  ADC
 SG_ SGU7_Object_DetStatus : 173|3@0+ (1,0) [0|7] ""  ADC
 SG_ SGU7_LifeCycles_OBJ : 196|8@0+ (1,0) [0|255] ""  ADC
 SG_ SGU7_ObjRCS_07 : 204|10@0+ (0.125,-50) [-50|70] "dBm2"  ADC
 SG_ SGU7_Object_dx_Rear : 209|12@0+ (0.0625,-128) [-128|127.9375] "m"  ADC
 SG_ SGU7_Object_dy_Rear : 229|12@0+ (0.125,-128) [-128|127.875] "m"  ADC

BO_ 521 RRR_Obj_08: 32 RRR
 SG_ SGU8_Msg_CheckSum : 7|8@0+ (1,0) [0|255] ""  ADC
 SG_ SGU8_Msg_AliveCounter : 11|4@0+ (1,0) [0|14] ""  ADC
 SG_ SGU8_BlockCounter : 15|4@0+ (1,0) [0|15] ""  ADC
 SG_ SGU8_Object_ID : 23|8@0+ (1,0) [0|255] ""  ADC
 SG_ SGU8_Object_wExist : 28|5@0+ (0.03125,0) [0|0.96875] ""  ADC
 SG_ SGU8_Object_Type : 31|3@0+ (1,0) [0|7] ""  ADC
 SG_ SGU8_Object_Motion_Pattern : 34|3@0+ (1,0) [0|7] ""  ADC
 SG_ SGU8_Object_wObstacle : 39|5@0+ (0.03125,0) [0|0.96875] ""  ADC
 SG_ SGU8_Object_dx : 43|12@0+ (0.0625,-128) [-128|127.9375] "m"  ADC
 SG_ SGU8_Object_dy : 59|12@0+ (0.125,-128) [-128|127.875] "m"  ADC
 SG_ SGU8_Object_DistLong_rms : 79|16@0+ (0.001953125,0) [0|127.998046875] "m"  ADC
 SG_ SGU8_Obj_DistLat_rms : 95|16@0+ (0.001953125,0) [0|127.998046875] "m"  ADC
 SG_ SGU8_Object_vx : 107|12@0+ (0.0625,-128) [-128|127.9375] "m/s"  ADC
 SG_ SGU8_Object_vy : 123|12@0+ (0.0625,-128) [-128|127.9375] "m/s"  ADC
 SG_ SGU8_Obj_VrelLong_rms : 143|16@0+ (0.001953125,0) [0|127.998046875] "m/s"  ADC
 SG_ SGU8_Obj_Vrelat_rms : 159|16@0+ (0.001953125,0) [0|127.998046875] "m/s"  ADC
 SG_ SGU8_Object_ax : 170|11@0+ (0.03125,-16) [-16|15.96875] "m/s^2"  ADC
 SG_ SGU8_Object_ay : 191|11@0+ (0.03125,-16) [-16|15.96875] "m/s^2"  ADC
 SG_ SGU8_Object_DetStatus : 173|3@0+ (1,0) [0|7] ""  ADC
 SG_ SGU8_LifeCycles_OBJ : 196|8@0+ (1,0) [0|255] ""  ADC
 SG_ SGU8_ObjRCS_08 : 204|10@0+ (0.125,-50) [-50|70] "dBm2"  ADC
 SG_ SGU8_Object_dx_Rear : 209|12@0+ (0.0625,-128) [-128|127.9375] "m"  ADC
 SG_ SGU8_Object_dy_Rear : 229|12@0+ (0.125,-128) [-128|127.875] "m"  ADC

BO_ 522 RRR_Obj_09: 32 RRR
 SG_ SGU9_Msg_CheckSum : 7|8@0+ (1,0) [0|255] ""  ADC
 SG_ SGU9_Msg_AliveCounter : 11|4@0+ (1,0) [0|14] ""  ADC
 SG_ SGU9_BlockCounter : 15|4@0+ (1,0) [0|15] ""  ADC
 SG_ SGU9_Object_ID : 23|8@0+ (1,0) [0|255] ""  ADC
 SG_ SGU9_Object_wExist : 28|5@0+ (0.03125,0) [0|0.96875] ""  ADC
 SG_ SGU9_Object_Type : 31|3@0+ (1,0) [0|7] ""  ADC
 SG_ SGU9_Object_Motion_Pattern : 34|3@0+ (1,0) [0|7] ""  ADC
 SG_ SGU9_Object_wObstacle : 39|5@0+ (0.03125,0) [0|0.96875] ""  ADC
 SG_ SGU9_Object_dx : 43|12@0+ (0.0625,-128) [-128|127.9375] "m"  ADC
 SG_ SGU9_Object_dy : 59|12@0+ (0.125,-128) [-128|127.875] "m"  ADC
 SG_ SGU9_Object_DistLong_rms : 79|16@0+ (0.001953125,0) [0|127.998046875] "m"  ADC
 SG_ SGU9_Obj_DistLat_rms : 95|16@0+ (0.001953125,0) [0|127.998046875] "m"  ADC
 SG_ SGU9_Object_vx : 107|12@0+ (0.0625,-128) [-128|127.9375] "m/s"  ADC
 SG_ SGU9_Object_vy : 123|12@0+ (0.0625,-128) [-128|127.9375] "m/s"  ADC
 SG_ SGU9_Obj_VrelLong_rms : 143|16@0+ (0.001953125,0) [0|127.998046875] "m/s"  ADC
 SG_ SGU9_Obj_Vrelat_rms : 159|16@0+ (0.001953125,0) [0|127.998046875] "m/s"  ADC
 SG_ SGU9_Object_ax : 170|11@0+ (0.03125,-16) [-16|15.96875] "m/s^2"  ADC
 SG_ SGU9_Object_ay : 191|11@0+ (0.03125,-16) [-16|15.96875] "m/s^2"  ADC
 SG_ SGU9_Object_DetStatus : 173|3@0+ (1,0) [0|7] ""  ADC
 SG_ SGU9_LifeCycles_OBJ : 196|8@0+ (1,0) [0|255] ""  ADC
 SG_ SGU9_ObjRCS_09 : 204|10@0+ (0.125,-50) [-50|70] "dBm2"  ADC
 SG_ SGU9_Object_dx_Rear : 209|12@0+ (0.0625,-128) [-128|127.9375] "m"  ADC
 SG_ SGU9_Object_dy_Rear : 229|12@0+ (0.125,-128) [-128|127.875] "m"  ADC

BO_ 523 RRR_Obj_10: 32 RRR
 SG_ SGU10_Msg_CheckSum : 7|8@0+ (1,0) [0|255] ""  ADC
 SG_ SGU10_Msg_AliveCounter : 11|4@0+ (1,0) [0|14] ""  ADC
 SG_ SGU10_BlockCounter : 15|4@0+ (1,0) [0|15] ""  ADC
 SG_ SGU10_Object_ID : 23|8@0+ (1,0) [0|255] ""  ADC
 SG_ SGU10_Object_wExist : 28|5@0+ (0.03125,0) [0|0.96875] ""  ADC
 SG_ SGU10_Object_Type : 31|3@0+ (1,0) [0|7] ""  ADC
 SG_ SGU10_Object_Motion_Pattern : 34|3@0+ (1,0) [0|7] ""  ADC
 SG_ SGU10_Object_wObstacle : 39|5@0+ (0.03125,0) [0|0.96875] ""  ADC
 SG_ SGU10_Object_dx : 43|12@0+ (0.0625,-128) [-128|127.9375] "m"  ADC
 SG_ SGU10_Object_dy : 59|12@0+ (0.125,-128) [-128|127.875] "m"  ADC
 SG_ SGU10_Object_DistLong_rms : 79|16@0+ (0.001953125,0) [0|127.998046875] "m"  ADC
 SG_ SGU10_Obj_DistLat_rms : 95|16@0+ (0.001953125,0) [0|127.998046875] "m"  ADC
 SG_ SGU10_Object_vx : 107|12@0+ (0.0625,-128) [-128|127.9375] "m/s"  ADC
 SG_ SGU10_Object_vy : 123|12@0+ (0.0625,-128) [-128|127.9375] "m/s"  ADC
 SG_ SGU10_Obj_VrelLong_rms : 143|16@0+ (0.001953125,0) [0|127.998046875] "m/s"  ADC
 SG_ SGU10_Obj_Vrelat_rms : 159|16@0+ (0.001953125,0) [0|127.998046875] "m/s"  ADC
 SG_ SGU10_Object_ax : 170|11@0+ (0.03125,-16) [-16|15.96875] "m/s^2"  ADC
 SG_ SGU10_Object_ay : 191|11@0+ (0.03125,-16) [-16|15.96875] "m/s^2"  ADC
 SG_ SGU10_Object_DetStatus : 173|3@0+ (1,0) [0|7] ""  ADC
 SG_ SGU10_LifeCycles_OBJ : 196|8@0+ (1,0) [0|255] ""  ADC
 SG_ SGU10_ObjRCS_10 : 204|10@0+ (0.125,-50) [-50|70] "dBm2"  ADC
 SG_ SGU10_Object_dx_Rear : 209|12@0+ (0.0625,-128) [-128|127.9375] "m"  ADC
 SG_ SGU10_Object_dy_Rear : 229|12@0+ (0.125,-128) [-128|127.875] "m"  ADC

BO_ 524 RRR_Obj_11: 32 RRR
 SG_ SGU11_Msg_CheckSum : 7|8@0+ (1,0) [0|255] ""  ADC
 SG_ SGU11_Msg_AliveCounter : 11|4@0+ (1,0) [0|14] ""  ADC
 SG_ SGU11_BlockCounter : 15|4@0+ (1,0) [0|15] ""  ADC
 SG_ SGU11_Object_ID : 23|8@0+ (1,0) [0|255] ""  ADC
 SG_ SGU11_Object_wExist : 28|5@0+ (0.03125,0) [0|0.96875] ""  ADC
 SG_ SGU11_Object_Type : 31|3@0+ (1,0) [0|7] ""  ADC
 SG_ SGU11_Object_Motion_Pattern : 34|3@0+ (1,0) [0|7] ""  ADC
 SG_ SGU11_Object_wObstacle : 39|5@0+ (0.03125,0) [0|0.96875] ""  ADC
 SG_ SGU11_Object_dx : 43|12@0+ (0.0625,-128) [-128|127.9375] "m"  ADC
 SG_ SGU11_Object_dy : 59|12@0+ (0.125,-128) [-128|127.875] "m"  ADC
 SG_ SGU11_Object_DistLong_rms : 79|16@0+ (0.001953125,0) [0|127.998046875] "m"  ADC
 SG_ SGU11_Obj_DistLat_rms : 95|16@0+ (0.001953125,0) [0|127.998046875] "m"  ADC
 SG_ SGU11_Object_vx : 107|12@0+ (0.0625,-128) [-128|127.9375] "m/s"  ADC
 SG_ SGU11_Object_vy : 123|12@0+ (0.0625,-128) [-128|127.9375] "m/s"  ADC
 SG_ SGU11_Obj_VrelLong_rms : 143|16@0+ (0.001953125,0) [0|127.998046875] "m/s"  ADC
 SG_ SGU11_Obj_Vrelat_rms : 159|16@0+ (0.001953125,0) [0|127.998046875] "m/s"  ADC
 SG_ SGU11_Object_ax : 170|11@0+ (0.03125,-16) [-16|15.96875] "m/s^2"  ADC
 SG_ SGU11_Object_ay : 191|11@0+ (0.03125,-16) [-16|15.96875] "m/s^2"  ADC
 SG_ SGU11_Object_DetStatus : 173|3@0+ (1,0) [0|7] ""  ADC
 SG_ SGU11_LifeCycles_OBJ : 196|8@0+ (1,0) [0|255] ""  ADC
 SG_ SGU11_ObjRCS_11 : 204|10@0+ (0.125,-50) [-50|70] "dBm2"  ADC
 SG_ SGU11_Object_dx_Rear : 209|12@0+ (0.0625,-128) [-128|127.9375] "m"  ADC
 SG_ SGU11_Object_dy_Rear : 229|12@0+ (0.125,-128) [-128|127.875] "m"  ADC

BO_ 525 RRR_Obj_12: 32 RRR
 SG_ SGU12_Msg_CheckSum : 7|8@0+ (1,0) [0|255] ""  ADC
 SG_ SGU12_Msg_AliveCounter : 11|4@0+ (1,0) [0|14] ""  ADC
 SG_ SGU12_BlockCounter : 15|4@0+ (1,0) [0|15] ""  ADC
 SG_ SGU12_Object_ID : 23|8@0+ (1,0) [0|255] ""  ADC
 SG_ SGU12_Object_wExist : 28|5@0+ (0.03125,0) [0|0.96875] ""  ADC
 SG_ SGU12_Object_Type : 31|3@0+ (1,0) [0|7] ""  ADC
 SG_ SGU12_Object_Motion_Pattern : 34|3@0+ (1,0) [0|7] ""  ADC
 SG_ SGU12_Object_wObstacle : 39|5@0+ (0.03125,0) [0|0.96875] ""  ADC
 SG_ SGU12_Object_dx : 43|12@0+ (0.0625,-128) [-128|127.9375] "m"  ADC
 SG_ SGU12_Object_dy : 59|12@0+ (0.125,-128) [-128|127.875] "m"  ADC
 SG_ SGU12_Object_DistLong_rms : 79|16@0+ (0.001953125,0) [0|127.998046875] "m"  ADC
 SG_ SGU12_Obj_DistLat_rms : 95|16@0+ (0.001953125,0) [0|127.998046875] "m"  ADC
 SG_ SGU12_Object_vx : 107|12@0+ (0.0625,-128) [-128|127.9375] "m/s"  ADC
 SG_ SGU12_Object_vy : 123|12@0+ (0.0625,-128) [-128|127.9375] "m/s"  ADC
 SG_ SGU12_Obj_VrelLong_rms : 143|16@0+ (0.001953125,0) [0|127.998046875] "m/s"  ADC
 SG_ SGU12_Obj_Vrelat_rms : 159|16@0+ (0.001953125,0) [0|127.998046875] "m/s"  ADC
 SG_ SGU12_Object_ax : 170|11@0+ (0.03125,-16) [-16|15.96875] "m/s^2"  ADC
 SG_ SGU12_Object_ay : 191|11@0+ (0.03125,-16) [-16|15.96875] "m/s^2"  ADC
 SG_ SGU12_Object_DetStatus : 173|3@0+ (1,0) [0|7] ""  ADC
 SG_ SGU12_LifeCycles_OBJ : 196|8@0+ (1,0) [0|255] ""  ADC
 SG_ SGU12_ObjRCS_12 : 204|10@0+ (0.125,-50) [-50|70] "dBm2"  ADC
 SG_ SGU12_Object_dx_Rear : 209|12@0+ (0.0625,-128) [-128|127.9375] "m"  ADC
 SG_ SGU12_Object_dy_Rear : 229|12@0+ (0.125,-128) [-128|127.875] "m"  ADC

BO_ 526 RRR_Obj_13: 32 RRR
 SG_ SGU13_Msg_CheckSum : 7|8@0+ (1,0) [0|255] ""  ADC
 SG_ SGU13_Msg_AliveCounter : 11|4@0+ (1,0) [0|14] ""  ADC
 SG_ SGU13_BlockCounter : 15|4@0+ (1,0) [0|15] ""  ADC
 SG_ SGU13_Object_ID : 23|8@0+ (1,0) [0|255] ""  ADC
 SG_ SGU13_Object_wExist : 28|5@0+ (0.03125,0) [0|0.96875] ""  ADC
 SG_ SGU13_Object_Type : 31|3@0+ (1,0) [0|7] ""  ADC
 SG_ SGU13_Object_Motion_Pattern : 34|3@0+ (1,0) [0|7] ""  ADC
 SG_ SGU13_Object_wObstacle : 39|5@0+ (0.03125,0) [0|0.96875] ""  ADC
 SG_ SGU13_Object_dx : 43|12@0+ (0.0625,-128) [-128|127.9375] "m"  ADC
 SG_ SGU13_Object_dy : 59|12@0+ (0.125,-128) [-128|127.875] "m"  ADC
 SG_ SGU13_Object_DistLong_rms : 79|16@0+ (0.001953125,0) [0|127.998046875] "m"  ADC
 SG_ SGU13_Obj_DistLat_rms : 95|16@0+ (0.001953125,0) [0|127.998046875] "m"  ADC
 SG_ SGU13_Object_vx : 107|12@0+ (0.0625,-128) [-128|127.9375] "m/s"  ADC
 SG_ SGU13_Object_vy : 123|12@0+ (0.0625,-128) [-128|127.9375] "m/s"  ADC
 SG_ SGU13_Obj_VrelLong_rms : 143|16@0+ (0.001953125,0) [0|127.998046875] "m/s"  ADC
 SG_ SGU13_Obj_Vrelat_rms : 159|16@0+ (0.001953125,0) [0|127.998046875] "m/s"  ADC
 SG_ SGU13_Object_ax : 170|11@0+ (0.03125,-16) [-16|15.96875] "m/s^2"  ADC
 SG_ SGU13_Object_ay : 191|11@0+ (0.03125,-16) [-16|15.96875] "m/s^2"  ADC
 SG_ SGU13_Object_DetStatus : 173|3@0+ (1,0) [0|7] ""  ADC
 SG_ SGU13_LifeCycles_OBJ : 196|8@0+ (1,0) [0|255] ""  ADC
 SG_ SGU13_ObjRCS_13 : 204|10@0+ (0.125,-50) [-50|70] "dBm2"  ADC
 SG_ SGU13_Object_dx_Rear : 209|12@0+ (0.0625,-128) [-128|127.9375] "m"  ADC
 SG_ SGU13_Object_dy_Rear : 229|12@0+ (0.125,-128) [-128|127.875] "m"  ADC

BO_ 527 RRR_Obj_14: 32 RRR
 SG_ SGU14_Msg_CheckSum : 7|8@0+ (1,0) [0|255] ""  ADC
 SG_ SGU14_Msg_AliveCounter : 11|4@0+ (1,0) [0|14] ""  ADC
 SG_ SGU14_BlockCounter : 15|4@0+ (1,0) [0|15] ""  ADC
 SG_ SGU14_Object_ID : 23|8@0+ (1,0) [0|255] ""  ADC
 SG_ SGU14_Object_wExist : 28|5@0+ (0.03125,0) [0|0.96875] ""  ADC
 SG_ SGU14_Object_Type : 31|3@0+ (1,0) [0|7] ""  ADC
 SG_ SGU14_Object_Motion_Pattern : 34|3@0+ (1,0) [0|7] ""  ADC
 SG_ SGU14_Object_wObstacle : 39|5@0+ (0.03125,0) [0|0.96875] ""  ADC
 SG_ SGU14_Object_dx : 43|12@0+ (0.0625,-128) [-128|127.9375] "m"  ADC
 SG_ SGU14_Object_dy : 59|12@0+ (0.125,-128) [-128|127.875] "m"  ADC
 SG_ SGU14_Object_DistLong_rms : 79|16@0+ (0.001953125,0) [0|127.998046875] "m"  ADC
 SG_ SGU14_Obj_DistLat_rms : 95|16@0+ (0.001953125,0) [0|127.998046875] "m"  ADC
 SG_ SGU14_Object_vx : 107|12@0+ (0.0625,-128) [-128|127.9375] "m/s"  ADC
 SG_ SGU14_Object_vy : 123|12@0+ (0.0625,-128) [-128|127.9375] "m/s"  ADC
 SG_ SGU14_Obj_VrelLong_rms : 143|16@0+ (0.001953125,0) [0|127.998046875] "m/s"  ADC
 SG_ SGU14_Obj_Vrelat_rms : 159|16@0+ (0.001953125,0) [0|127.998046875] "m/s"  ADC
 SG_ SGU14_Object_ax : 170|11@0+ (0.03125,-16) [-16|15.96875] "m/s^2"  ADC
 SG_ SGU14_Object_ay : 191|11@0+ (0.03125,-16) [-16|15.96875] "m/s^2"  ADC
 SG_ SGU14_Object_DetStatus : 173|3@0+ (1,0) [0|7] ""  ADC
 SG_ SGU14_LifeCycles_OBJ : 196|8@0+ (1,0) [0|255] ""  ADC
 SG_ SGU14_ObjRCS_14 : 204|10@0+ (0.125,-50) [-50|70] "dBm2"  ADC
 SG_ SGU14_Object_dx_Rear : 209|12@0+ (0.0625,-128) [-128|127.9375] "m"  ADC
 SG_ SGU14_Object_dy_Rear : 229|12@0+ (0.125,-128) [-128|127.875] "m"  ADC

BO_ 528 RRR_Obj_15: 32 RRR
 SG_ SGU15_Msg_CheckSum : 7|8@0+ (1,0) [0|255] ""  ADC
 SG_ SGU15_Msg_AliveCounter : 11|4@0+ (1,0) [0|14] ""  ADC
 SG_ SGU15_BlockCounter : 15|4@0+ (1,0) [0|15] ""  ADC
 SG_ SGU15_Object_ID : 23|8@0+ (1,0) [0|255] ""  ADC
 SG_ SGU15_Object_wExist : 28|5@0+ (0.03125,0) [0|0.96875] ""  ADC
 SG_ SGU15_Object_Type : 31|3@0+ (1,0) [0|7] ""  ADC
 SG_ SGU15_Object_Motion_Pattern : 34|3@0+ (1,0) [0|7] ""  ADC
 SG_ SGU15_Object_wObstacle : 39|5@0+ (0.03125,0) [0|0.96875] ""  ADC
 SG_ SGU15_Object_dx : 43|12@0+ (0.0625,-128) [-128|127.9375] "m"  ADC
 SG_ SGU15_Object_dy : 59|12@0+ (0.125,-128) [-128|127.875] "m"  ADC
 SG_ SGU15_Object_DistLong_rms : 79|16@0+ (0.001953125,0) [0|127.998046875] "m"  ADC
 SG_ SGU15_Obj_DistLat_rms : 95|16@0+ (0.001953125,0) [0|127.998046875] "m"  ADC
 SG_ SGU15_Object_vx : 107|12@0+ (0.0625,-128) [-128|127.9375] "m/s"  ADC
 SG_ SGU15_Object_vy : 123|12@0+ (0.0625,-128) [-128|127.9375] "m/s"  ADC
 SG_ SGU15_Obj_VrelLong_rms : 143|16@0+ (0.001953125,0) [0|127.998046875] "m/s"  ADC
 SG_ SGU15_Obj_Vrelat_rms : 159|16@0+ (0.001953125,0) [0|127.998046875] "m/s"  ADC
 SG_ SGU15_Object_ax : 170|11@0+ (0.03125,-16) [-16|15.96875] "m/s^2"  ADC
 SG_ SGU15_Object_ay : 191|11@0+ (0.03125,-16) [-16|15.96875] "m/s^2"  ADC
 SG_ SGU15_Object_DetStatus : 173|3@0+ (1,0) [0|7] ""  ADC
 SG_ SGU15_LifeCycles_OBJ : 196|8@0+ (1,0) [0|255] ""  ADC
 SG_ SGU15_ObjRCS_15 : 204|10@0+ (0.125,-50) [-50|70] "dBm2"  ADC
 SG_ SGU15_Object_dx_Rear : 209|12@0+ (0.0625,-128) [-128|127.9375] "m"  ADC
 SG_ SGU15_Object_dy_Rear : 229|12@0+ (0.125,-128) [-128|127.875] "m"  ADC

BO_ 529 RRR_Obj_16: 32 RRR
 SG_ SGU16_Msg_CheckSum : 7|8@0+ (1,0) [0|255] ""  ADC
 SG_ SGU16_Msg_AliveCounter : 11|4@0+ (1,0) [0|14] ""  ADC
 SG_ SGU16_BlockCounter : 15|4@0+ (1,0) [0|15] ""  ADC
 SG_ SGU16_Object_ID : 23|8@0+ (1,0) [0|255] ""  ADC
 SG_ SGU16_Object_wExist : 28|5@0+ (0.03125,0) [0|0.96875] ""  ADC
 SG_ SGU16_Object_Type : 31|3@0+ (1,0) [0|7] ""  ADC
 SG_ SGU16_Object_Motion_Pattern : 34|3@0+ (1,0) [0|7] ""  ADC
 SG_ SGU16_Object_wObstacle : 39|5@0+ (0.03125,0) [0|0.96875] ""  ADC
 SG_ SGU16_Object_dx : 43|12@0+ (0.0625,-128) [-128|127.9375] "m"  ADC
 SG_ SGU16_Object_dy : 59|12@0+ (0.125,-128) [-128|127.875] "m"  ADC
 SG_ SGU16_Object_DistLong_rms : 79|16@0+ (0.001953125,0) [0|127.998046875] "m"  ADC
 SG_ SGU16_Obj_DistLat_rms : 95|16@0+ (0.001953125,0) [0|127.998046875] "m"  ADC
 SG_ SGU16_Object_vx : 107|12@0+ (0.0625,-128) [-128|127.9375] "m/s"  ADC
 SG_ SGU16_Object_vy : 123|12@0+ (0.0625,-128) [-128|127.9375] "m/s"  ADC
 SG_ SGU16_Obj_VrelLong_rms : 143|16@0+ (0.001953125,0) [0|127.998046875] "m/s"  ADC
 SG_ SGU16_Obj_Vrelat_rms : 159|16@0+ (0.001953125,0) [0|127.998046875] "m/s"  ADC
 SG_ SGU16_Object_ax : 170|11@0+ (0.03125,-16) [-16|15.96875] "m/s^2"  ADC
 SG_ SGU16_Object_ay : 191|11@0+ (0.03125,-16) [-16|15.96875] "m/s^2"  ADC
 SG_ SGU16_Object_DetStatus : 173|3@0+ (1,0) [0|7] ""  ADC
 SG_ SGU16_LifeCycles_OBJ : 196|8@0+ (1,0) [0|255] ""  ADC
 SG_ SGU16_ObjRCS_16 : 204|10@0+ (0.125,-50) [-50|70] "dBm2"  ADC
 SG_ SGU16_Object_dx_Rear : 209|12@0+ (0.0625,-128) [-128|127.9375] "m"  ADC
 SG_ SGU16_Object_dy_Rear : 229|12@0+ (0.125,-128) [-128|127.875] "m"  ADC

CM_ SG_ 513 RRR_Msg_CheckSum "E2E Profile Variant 1A CRC";
CM_ SG_ 513 RRR_Msg_AliveCounter "E2E Profile Variant 1A Counter";
CM_ SG_ 513 RRR_BlockCounter "Block counter for every messages";
CM_ SG_ 513 RRR_OperationMode "FR systems ON OFF and Error Status";
CM_ SG_ 513 RRR_SensorType "Identify the sensor type";
CM_ SG_ 513 RRR_Num_Of_Objects "Numbers of object being set in this cycle.";
CM_ SG_ 513 RRR_SGUFail "Indicates an error in the SGU system which prevents object information being sent on CAN including misalignment and other failure status";
CM_ SG_ 513 RRR_TimerStampStatus "Timer Stamp Status:Bit 0:TIMEOUTBit 1:SOC SYNC Status  Bit 2:SYNC_TO_GATWAYBit 3:GLOBAL_TIME_BASEBit 4:TIMELEAP_FUTUREBit 5:TIMELAP_PASTBit 6:MCU SYNC StatusBit 7:Extension:GENERAL_ERRORAdd comment: \"0\" is normal,\"1\" is abnormal";
CM_ SG_ 513 RRR_Object_Mea_timestamp_1 "Synchronized Timestamp for Sensor Measurement";
CM_ SG_ 513 RRR_Object_Mea_timestamp_2 "Synchronized Timestamp for Sensor Measurement";
CM_ SG_ 513 RRR_SDA_HorzDeviationAngle_Can03 "SDA Horizontal Deviation Angles";
CM_ SG_ 513 RRR_SDA_VertDeviationAngle_Can03 "SDA Vertical Deviation Angles";
CM_ SG_ 513 RRR_Signal_Operation_State "Radar Receiving Signal operation state after key status is on";
CM_ SG_ 513 RRR_TimeSync_Operation_State "Radar Time Sync operation state after key status is on";
CM_ SG_ 513 RRR_Signal_Operatation_Channel "Radar received messages from SOC/IFC/MCU channel";
CM_ SG_ 513 RRR_TimeSync_Operatation_Channel "Radar received Time Sync message from SOC/IFC/MCU channel";
CM_ SG_ 513 RRR_Moudulation_State "Radar Moudulation state";
CM_ SG_ 514 SGU1_Msg_CheckSum "E2E Profile Variant 1A CRC";
CM_ SG_ 514 SGU1_Msg_AliveCounter "E2E Profile Variant 1A Counter";
CM_ SG_ 514 SGU1_BlockCounter "Block counter for every messages";
CM_ SG_ 514 SGU1_Object_ID "ID is an identifier number that allows for tracking of persistent objects over time";
CM_ SG_ 514 SGU1_Object_wExist "Existence probability of the object";
CM_ SG_ 514 SGU1_Object_Type "To indicate the estimated type of Object";
CM_ SG_ 514 SGU1_Object_Motion_Pattern "Motion type of object";
CM_ SG_ 514 SGU1_Object_wObstacle "The probability of an object being an obstacle";
CM_ SG_ 514 SGU1_Object_dx "Position of target object in x-direction [m]";
CM_ SG_ 514 SGU1_Object_dy "Position of target object in y-direction [m]";
CM_ SG_ 514 SGU1_Object_DistLong_rms "Standard deviation of longitudinal distance";
CM_ SG_ 514 SGU1_Obj_DistLat_rms "Standard deviation of lateral distance";
CM_ SG_ 514 SGU1_Object_vx "Relative target object velocity in x-direction [m/s]";
CM_ SG_ 514 SGU1_Object_vy "Relative target object velocity in y-direction [m/s]";
CM_ SG_ 514 SGU1_Obj_VrelLong_rms "Standard deviation of longitudinal relative velocity";
CM_ SG_ 514 SGU1_Obj_Vrelat_rms "Standard deviation of lateral relative velocity";
CM_ SG_ 514 SGU1_Object_ax "Relative target object acceleration in x-direction, in the vehicle coordinatesystem";
CM_ SG_ 514 SGU1_Object_ay "Relative target object acceleration in y-direction, in the vehicle coordinate system";
CM_ SG_ 514 SGU1_Object_DetStatus "Detection Staus Of Object";
CM_ SG_ 514 SGU1_LifeCycles_OBJ "-";
CM_ SG_ 514 SGU1_ObjRCS_01 "Radar Cross Section (RCS) estimation";
CM_ SG_ 514 SGU1_Object_dx_Rear "Position of target object in x-direction [m]";
CM_ SG_ 514 SGU1_Object_dy_Rear "Position of target object in y-direction [m]";
CM_ SG_ 515 SGU2_Msg_CheckSum "E2E Profile Variant 1A CRC";
CM_ SG_ 515 SGU2_Msg_AliveCounter "E2E Profile Variant 1A Counter";
CM_ SG_ 515 SGU2_BlockCounter "Block counter for every messages";
CM_ SG_ 515 SGU2_Object_ID "ID is an identifier number that allows for tracking of persistent objects over time";
CM_ SG_ 515 SGU2_Object_wExist "Existence probability of the object";
CM_ SG_ 515 SGU2_Object_Type "To indicate the estimated type of Object";
CM_ SG_ 515 SGU2_Object_Motion_Pattern "Motion type of object";
CM_ SG_ 515 SGU2_Object_wObstacle "The probability of an object being an obstacle";
CM_ SG_ 515 SGU2_Object_dx "Position of target object in x-direction [m]";
CM_ SG_ 515 SGU2_Object_dy "Position of target object in y-direction [m]";
CM_ SG_ 515 SGU2_Object_DistLong_rms "Standard deviation of longitudinal distance";
CM_ SG_ 515 SGU2_Obj_DistLat_rms "Standard deviation of lateral distance";
CM_ SG_ 515 SGU2_Object_vx "Relative target object velocity in x-direction [m/s]";
CM_ SG_ 515 SGU2_Object_vy "Relative target object velocity in y-direction [m/s]";
CM_ SG_ 515 SGU2_Obj_VrelLong_rms "Standard deviation of longitudinal relative velocity";
CM_ SG_ 515 SGU2_Obj_Vrelat_rms "Standard deviation of lateral relative velocity";
CM_ SG_ 515 SGU2_Object_ax "Relative target object acceleration in x-direction, in the vehicle coordinatesystem";
CM_ SG_ 515 SGU2_Object_ay "Relative target object acceleration in y-direction, in the vehicle coordinate system";
CM_ SG_ 515 SGU2_Object_DetStatus "Detection Staus Of Object";
CM_ SG_ 515 SGU2_LifeCycles_OBJ "-";
CM_ SG_ 515 SGU2_ObjRCS_02 "Radar Cross Section (RCS) estimation";
CM_ SG_ 515 SGU2_Object_dx_Rear "Position of target object in x-direction [m]";
CM_ SG_ 515 SGU2_Object_dy_Rear "Position of target object in y-direction [m]";
CM_ SG_ 516 SGU3_Msg_CheckSum "E2E Profile Variant 1A CRC";
CM_ SG_ 516 SGU3_Msg_AliveCounter "E2E Profile Variant 1A Counter";
CM_ SG_ 516 SGU3_BlockCounter "Block counter for every messages";
CM_ SG_ 516 SGU3_Object_ID "ID is an identifier number that allows for tracking of persistent objects over time";
CM_ SG_ 516 SGU3_Object_wExist "Existence probability of the object";
CM_ SG_ 516 SGU3_Object_Type "To indicate the estimated type of Object";
CM_ SG_ 516 SGU3_Object_Motion_Pattern "Motion type of object";
CM_ SG_ 516 SGU3_Object_wObstacle "The probability of an object being an obstacle";
CM_ SG_ 516 SGU3_Object_dx "Position of target object in x-direction [m]";
CM_ SG_ 516 SGU3_Object_dy "Position of target object in y-direction [m]";
CM_ SG_ 516 SGU3_Object_DistLong_rms "Standard deviation of longitudinal distance";
CM_ SG_ 516 SGU3_Obj_DistLat_rms "Standard deviation of lateral distance";
CM_ SG_ 516 SGU3_Object_vx "Relative target object velocity in x-direction [m/s]";
CM_ SG_ 516 SGU3_Object_vy "Relative target object velocity in y-direction [m/s]";
CM_ SG_ 516 SGU3_Obj_VrelLong_rms "Standard deviation of longitudinal relative velocity";
CM_ SG_ 516 SGU3_Obj_Vrelat_rms "Standard deviation of lateral relative velocity";
CM_ SG_ 516 SGU3_Object_ax "Relative target object acceleration in x-direction, in the vehicle coordinatesystem";
CM_ SG_ 516 SGU3_Object_ay "Relative target object acceleration in y-direction, in the vehicle coordinate system";
CM_ SG_ 516 SGU3_Object_DetStatus "Detection Staus Of Object";
CM_ SG_ 516 SGU3_LifeCycles_OBJ "-";
CM_ SG_ 516 SGU3_ObjRCS_03 "Radar Cross Section (RCS) estimation";
CM_ SG_ 516 SGU3_Object_dx_Rear "Position of target object in x-direction [m]";
CM_ SG_ 516 SGU3_Object_dy_Rear "Position of target object in y-direction [m]";
CM_ SG_ 517 SGU4_Msg_CheckSum "E2E Profile Variant 1A CRC";
CM_ SG_ 517 SGU4_Msg_AliveCounter "E2E Profile Variant 1A Counter";
CM_ SG_ 517 SGU4_BlockCounter "Block counter for every messages";
CM_ SG_ 517 SGU4_Object_ID "ID is an identifier number that allows for tracking of persistent objects over time";
CM_ SG_ 517 SGU4_Object_wExist "Existence probability of the object";
CM_ SG_ 517 SGU4_Object_Type "To indicate the estimated type of Object";
CM_ SG_ 517 SGU4_Object_Motion_Pattern "Motion type of object";
CM_ SG_ 517 SGU4_Object_wObstacle "The probability of an object being an obstacle";
CM_ SG_ 517 SGU4_Object_dx "Position of target object in x-direction [m]";
CM_ SG_ 517 SGU4_Object_dy "Position of target object in y-direction [m]";
CM_ SG_ 517 SGU4_Object_DistLong_rms "Standard deviation of longitudinal distance";
CM_ SG_ 517 SGU4_Obj_DistLat_rms "Standard deviation of lateral distance";
CM_ SG_ 517 SGU4_Object_vx "Relative target object velocity in x-direction [m/s]";
CM_ SG_ 517 SGU4_Object_vy "Relative target object velocity in y-direction [m/s]";
CM_ SG_ 517 SGU4_Obj_VrelLong_rms "Standard deviation of longitudinal relative velocity";
CM_ SG_ 517 SGU4_Obj_Vrelat_rms "Standard deviation of lateral relative velocity";
CM_ SG_ 517 SGU4_Object_ax "Relative target object acceleration in x-direction, in the vehicle coordinatesystem";
CM_ SG_ 517 SGU4_Object_ay "Relative target object acceleration in y-direction, in the vehicle coordinate system";
CM_ SG_ 517 SGU4_Object_DetStatus "Detection Staus Of Object";
CM_ SG_ 517 SGU4_LifeCycles_OBJ "-";
CM_ SG_ 517 SGU4_ObjRCS_04 "Radar Cross Section (RCS) estimation";
CM_ SG_ 517 SGU4_Object_dx_Rear "Position of target object in x-direction [m]";
CM_ SG_ 517 SGU4_Object_dy_Rear "Position of target object in y-direction [m]";
CM_ SG_ 518 SGU5_Msg_CheckSum "E2E Profile Variant 1A CRC";
CM_ SG_ 518 SGU5_Msg_AliveCounter "E2E Profile Variant 1A Counter";
CM_ SG_ 518 SGU5_BlockCounter "Block counter for every messages";
CM_ SG_ 518 SGU5_Object_ID "ID is an identifier number that allows for tracking of persistent objects over time";
CM_ SG_ 518 SGU5_Object_wExist "Existence probability of the object";
CM_ SG_ 518 SGU5_Object_Type "To indicate the estimated type of Object";
CM_ SG_ 518 SGU5_Object_Motion_Pattern "Motion type of object";
CM_ SG_ 518 SGU5_Object_wObstacle "The probability of an object being an obstacle";
CM_ SG_ 518 SGU5_Object_dx "Position of target object in x-direction [m]";
CM_ SG_ 518 SGU5_Object_dy "Position of target object in y-direction [m]";
CM_ SG_ 518 SGU5_Object_DistLong_rms "Standard deviation of longitudinal distance";
CM_ SG_ 518 SGU5_Obj_DistLat_rms "Standard deviation of lateral distance";
CM_ SG_ 518 SGU5_Object_vx "Relative target object velocity in x-direction [m/s]";
CM_ SG_ 518 SGU5_Object_vy "Relative target object velocity in y-direction [m/s]";
CM_ SG_ 518 SGU5_Obj_VrelLong_rms "Standard deviation of longitudinal relative velocity";
CM_ SG_ 518 SGU5_Obj_Vrelat_rms "Standard deviation of lateral relative velocity";
CM_ SG_ 518 SGU5_Object_ax "Relative target object acceleration in x-direction, in the vehicle coordinatesystem";
CM_ SG_ 518 SGU5_Object_ay "Relative target object acceleration in y-direction, in the vehicle coordinate system";
CM_ SG_ 518 SGU5_Object_DetStatus "Detection Staus Of Object";
CM_ SG_ 518 SGU5_LifeCycles_OBJ "-";
CM_ SG_ 518 SGU5_ObjRCS_05 "Radar Cross Section (RCS) estimation";
CM_ SG_ 518 SGU5_Object_dx_Rear "Position of target object in x-direction [m]";
CM_ SG_ 518 SGU5_Object_dy_Rear "Position of target object in y-direction [m]";
CM_ SG_ 519 SGU6_Msg_CheckSum "E2E Profile Variant 1A CRC";
CM_ SG_ 519 SGU6_Msg_AliveCounter "E2E Profile Variant 1A Counter";
CM_ SG_ 519 SGU6_BlockCounter "Block counter for every messages";
CM_ SG_ 519 SGU6_Object_ID "ID is an identifier number that allows for tracking of persistent objects over time";
CM_ SG_ 519 SGU6_Object_wExist "Existence probability of the object";
CM_ SG_ 519 SGU6_Object_Type "To indicate the estimated type of Object";
CM_ SG_ 519 SGU6_Object_Motion_Pattern "Motion type of object";
CM_ SG_ 519 SGU6_Object_wObstacle "The probability of an object being an obstacle";
CM_ SG_ 519 SGU6_Object_dx "Position of target object in x-direction [m]";
CM_ SG_ 519 SGU6_Object_dy "Position of target object in y-direction [m]";
CM_ SG_ 519 SGU6_Object_DistLong_rms "Standard deviation of longitudinal distance";
CM_ SG_ 519 SGU6_Obj_DistLat_rms "Standard deviation of lateral distance";
CM_ SG_ 519 SGU6_Object_vx "Relative target object velocity in x-direction [m/s]";
CM_ SG_ 519 SGU6_Object_vy "Relative target object velocity in y-direction [m/s]";
CM_ SG_ 519 SGU6_Obj_VrelLong_rms "Standard deviation of longitudinal relative velocity";
CM_ SG_ 519 SGU6_Obj_Vrelat_rms "Standard deviation of lateral relative velocity";
CM_ SG_ 519 SGU6_Object_ax "Relative target object acceleration in x-direction, in the vehicle coordinatesystem";
CM_ SG_ 519 SGU6_Object_ay "Relative target object acceleration in y-direction, in the vehicle coordinate system";
CM_ SG_ 519 SGU6_Object_DetStatus "Detection Staus Of Object";
CM_ SG_ 519 SGU6_LifeCycles_OBJ "-";
CM_ SG_ 519 SGU6_ObjRCS_06 "Radar Cross Section (RCS) estimation";
CM_ SG_ 519 SGU6_Object_dx_Rear "Position of target object in x-direction [m]";
CM_ SG_ 519 SGU6_Object_dy_Rear "Position of target object in y-direction [m]";
CM_ SG_ 520 SGU7_Msg_CheckSum "E2E Profile Variant 1A CRC";
CM_ SG_ 520 SGU7_Msg_AliveCounter "E2E Profile Variant 1A Counter";
CM_ SG_ 520 SGU7_BlockCounter "Block counter for every messages";
CM_ SG_ 520 SGU7_Object_ID "ID is an identifier number that allows for tracking of persistent objects over time";
CM_ SG_ 520 SGU7_Object_wExist "Existence probability of the object";
CM_ SG_ 520 SGU7_Object_Type "To indicate the estimated type of Object";
CM_ SG_ 520 SGU7_Object_Motion_Pattern "Motion type of object";
CM_ SG_ 520 SGU7_Object_wObstacle "The probability of an object being an obstacle";
CM_ SG_ 520 SGU7_Object_dx "Position of target object in x-direction [m]";
CM_ SG_ 520 SGU7_Object_dy "Position of target object in y-direction [m]";
CM_ SG_ 520 SGU7_Object_DistLong_rms "Standard deviation of longitudinal distance";
CM_ SG_ 520 SGU7_Obj_DistLat_rms "Standard deviation of lateral distance";
CM_ SG_ 520 SGU7_Object_vx "Relative target object velocity in x-direction [m/s]";
CM_ SG_ 520 SGU7_Object_vy "Relative target object velocity in y-direction [m/s]";
CM_ SG_ 520 SGU7_Obj_VrelLong_rms "Standard deviation of longitudinal relative velocity";
CM_ SG_ 520 SGU7_Obj_Vrelat_rms "Standard deviation of lateral relative velocity";
CM_ SG_ 520 SGU7_Object_ax "Relative target object acceleration in x-direction, in the vehicle coordinatesystem";
CM_ SG_ 520 SGU7_Object_ay "Relative target object acceleration in y-direction, in the vehicle coordinate system";
CM_ SG_ 520 SGU7_Object_DetStatus "Detection Staus Of Object";
CM_ SG_ 520 SGU7_LifeCycles_OBJ "-";
CM_ SG_ 520 SGU7_ObjRCS_07 "Radar Cross Section (RCS) estimation";
CM_ SG_ 520 SGU7_Object_dx_Rear "Position of target object in x-direction [m]";
CM_ SG_ 520 SGU7_Object_dy_Rear "Position of target object in y-direction [m]";
CM_ SG_ 521 SGU8_Msg_CheckSum "E2E Profile Variant 1A CRC";
CM_ SG_ 521 SGU8_Msg_AliveCounter "E2E Profile Variant 1A Counter";
CM_ SG_ 521 SGU8_BlockCounter "Block counter for every messages";
CM_ SG_ 521 SGU8_Object_ID "ID is an identifier number that allows for tracking of persistent objects over time";
CM_ SG_ 521 SGU8_Object_wExist "Existence probability of the object";
CM_ SG_ 521 SGU8_Object_Type "To indicate the estimated type of Object";
CM_ SG_ 521 SGU8_Object_Motion_Pattern "Motion type of object";
CM_ SG_ 521 SGU8_Object_wObstacle "The probability of an object being an obstacle";
CM_ SG_ 521 SGU8_Object_dx "Position of target object in x-direction [m]";
CM_ SG_ 521 SGU8_Object_dy "Position of target object in y-direction [m]";
CM_ SG_ 521 SGU8_Object_DistLong_rms "Standard deviation of longitudinal distance";
CM_ SG_ 521 SGU8_Obj_DistLat_rms "Standard deviation of lateral distance";
CM_ SG_ 521 SGU8_Object_vx "Relative target object velocity in x-direction [m/s]";
CM_ SG_ 521 SGU8_Object_vy "Relative target object velocity in y-direction [m/s]";
CM_ SG_ 521 SGU8_Obj_VrelLong_rms "Standard deviation of longitudinal relative velocity";
CM_ SG_ 521 SGU8_Obj_Vrelat_rms "Standard deviation of lateral relative velocity";
CM_ SG_ 521 SGU8_Object_ax "Relative target object acceleration in x-direction, in the vehicle coordinatesystem";
CM_ SG_ 521 SGU8_Object_ay "Relative target object acceleration in y-direction, in the vehicle coordinate system";
CM_ SG_ 521 SGU8_Object_DetStatus "Detection Staus Of Object";
CM_ SG_ 521 SGU8_LifeCycles_OBJ "-";
CM_ SG_ 521 SGU8_ObjRCS_08 "Radar Cross Section (RCS) estimation";
CM_ SG_ 521 SGU8_Object_dx_Rear "Position of target object in x-direction [m]";
CM_ SG_ 521 SGU8_Object_dy_Rear "Position of target object in y-direction [m]";
CM_ SG_ 522 SGU9_Msg_CheckSum "E2E Profile Variant 1A CRC";
CM_ SG_ 522 SGU9_Msg_AliveCounter "E2E Profile Variant 1A Counter";
CM_ SG_ 522 SGU9_BlockCounter "Block counter for every messages";
CM_ SG_ 522 SGU9_Object_ID "ID is an identifier number that allows for tracking of persistent objects over time";
CM_ SG_ 522 SGU9_Object_wExist "Existence probability of the object";
CM_ SG_ 522 SGU9_Object_Type "To indicate the estimated type of Object";
CM_ SG_ 522 SGU9_Object_Motion_Pattern "Motion type of object";
CM_ SG_ 522 SGU9_Object_wObstacle "The probability of an object being an obstacle";
CM_ SG_ 522 SGU9_Object_dx "Position of target object in x-direction [m]";
CM_ SG_ 522 SGU9_Object_dy "Position of target object in y-direction [m]";
CM_ SG_ 522 SGU9_Object_DistLong_rms "Standard deviation of longitudinal distance";
CM_ SG_ 522 SGU9_Obj_DistLat_rms "Standard deviation of lateral distance";
CM_ SG_ 522 SGU9_Object_vx "Relative target object velocity in x-direction [m/s]";
CM_ SG_ 522 SGU9_Object_vy "Relative target object velocity in y-direction [m/s]";
CM_ SG_ 522 SGU9_Obj_VrelLong_rms "Standard deviation of longitudinal relative velocity";
CM_ SG_ 522 SGU9_Obj_Vrelat_rms "Standard deviation of lateral relative velocity";
CM_ SG_ 522 SGU9_Object_ax "Relative target object acceleration in x-direction, in the vehicle coordinatesystem";
CM_ SG_ 522 SGU9_Object_ay "Relative target object acceleration in y-direction, in the vehicle coordinate system";
CM_ SG_ 522 SGU9_Object_DetStatus "Detection Staus Of Object";
CM_ SG_ 522 SGU9_LifeCycles_OBJ "-";
CM_ SG_ 522 SGU9_ObjRCS_09 "Radar Cross Section (RCS) estimation";
CM_ SG_ 522 SGU9_Object_dx_Rear "Position of target object in x-direction [m]";
CM_ SG_ 522 SGU9_Object_dy_Rear "Position of target object in y-direction [m]";
CM_ SG_ 523 SGU10_Msg_CheckSum "E2E Profile Variant 1A CRC";
CM_ SG_ 523 SGU10_Msg_AliveCounter "E2E Profile Variant 1A Counter";
CM_ SG_ 523 SGU10_BlockCounter "Block counter for every messages";
CM_ SG_ 523 SGU10_Object_ID "ID is an identifier number that allows for tracking of persistent objects over time";
CM_ SG_ 523 SGU10_Object_wExist "Existence probability of the object";
CM_ SG_ 523 SGU10_Object_Type "To indicate the estimated type of Object";
CM_ SG_ 523 SGU10_Object_Motion_Pattern "Motion type of object";
CM_ SG_ 523 SGU10_Object_wObstacle "The probability of an object being an obstacle";
CM_ SG_ 523 SGU10_Object_dx "Position of target object in x-direction [m]";
CM_ SG_ 523 SGU10_Object_dy "Position of target object in y-direction [m]";
CM_ SG_ 523 SGU10_Object_DistLong_rms "Standard deviation of longitudinal distance";
CM_ SG_ 523 SGU10_Obj_DistLat_rms "Standard deviation of lateral distance";
CM_ SG_ 523 SGU10_Object_vx "Relative target object velocity in x-direction [m/s]";
CM_ SG_ 523 SGU10_Object_vy "Relative target object velocity in y-direction [m/s]";
CM_ SG_ 523 SGU10_Obj_VrelLong_rms "Standard deviation of longitudinal relative velocity";
CM_ SG_ 523 SGU10_Obj_Vrelat_rms "Standard deviation of lateral relative velocity";
CM_ SG_ 523 SGU10_Object_ax "Relative target object acceleration in x-direction, in the vehicle coordinatesystem";
CM_ SG_ 523 SGU10_Object_ay "Relative target object acceleration in y-direction, in the vehicle coordinate system";
CM_ SG_ 523 SGU10_Object_DetStatus "Detection Staus Of Object";
CM_ SG_ 523 SGU10_LifeCycles_OBJ "-";
CM_ SG_ 523 SGU10_ObjRCS_10 "Radar Cross Section (RCS) estimation";
CM_ SG_ 523 SGU10_Object_dx_Rear "Position of target object in x-direction [m]";
CM_ SG_ 523 SGU10_Object_dy_Rear "Position of target object in y-direction [m]";
CM_ SG_ 524 SGU11_Msg_CheckSum "E2E Profile Variant 1A CRC";
CM_ SG_ 524 SGU11_Msg_AliveCounter "E2E Profile Variant 1A Counter";
CM_ SG_ 524 SGU11_BlockCounter "Block counter for every messages";
CM_ SG_ 524 SGU11_Object_ID "ID is an identifier number that allows for tracking of persistent objects over time";
CM_ SG_ 524 SGU11_Object_wExist "Existence probability of the object";
CM_ SG_ 524 SGU11_Object_Type "To indicate the estimated type of Object";
CM_ SG_ 524 SGU11_Object_Motion_Pattern "Motion type of object";
CM_ SG_ 524 SGU11_Object_wObstacle "The probability of an object being an obstacle";
CM_ SG_ 524 SGU11_Object_dx "Position of target object in x-direction [m]";
CM_ SG_ 524 SGU11_Object_dy "Position of target object in y-direction [m]";
CM_ SG_ 524 SGU11_Object_DistLong_rms "Standard deviation of longitudinal distance";
CM_ SG_ 524 SGU11_Obj_DistLat_rms "Standard deviation of lateral distance";
CM_ SG_ 524 SGU11_Object_vx "Relative target object velocity in x-direction [m/s]";
CM_ SG_ 524 SGU11_Object_vy "Relative target object velocity in y-direction [m/s]";
CM_ SG_ 524 SGU11_Obj_VrelLong_rms "Standard deviation of longitudinal relative velocity";
CM_ SG_ 524 SGU11_Obj_Vrelat_rms "Standard deviation of lateral relative velocity";
CM_ SG_ 524 SGU11_Object_ax "Relative target object acceleration in x-direction, in the vehicle coordinatesystem";
CM_ SG_ 524 SGU11_Object_ay "Relative target object acceleration in y-direction, in the vehicle coordinate system";
CM_ SG_ 524 SGU11_Object_DetStatus "Detection Staus Of Object";
CM_ SG_ 524 SGU11_LifeCycles_OBJ "-";
CM_ SG_ 524 SGU11_ObjRCS_11 "Radar Cross Section (RCS) estimation";
CM_ SG_ 524 SGU11_Object_dx_Rear "Position of target object in x-direction [m]";
CM_ SG_ 524 SGU11_Object_dy_Rear "Position of target object in y-direction [m]";
CM_ SG_ 525 SGU12_Msg_CheckSum "E2E Profile Variant 1A CRC";
CM_ SG_ 525 SGU12_Msg_AliveCounter "E2E Profile Variant 1A Counter";
CM_ SG_ 525 SGU12_BlockCounter "Block counter for every messages";
CM_ SG_ 525 SGU12_Object_ID "ID is an identifier number that allows for tracking of persistent objects over time";
CM_ SG_ 525 SGU12_Object_wExist "Existence probability of the object";
CM_ SG_ 525 SGU12_Object_Type "To indicate the estimated type of Object";
CM_ SG_ 525 SGU12_Object_Motion_Pattern "Motion type of object";
CM_ SG_ 525 SGU12_Object_wObstacle "The probability of an object being an obstacle";
CM_ SG_ 525 SGU12_Object_dx "Position of target object in x-direction [m]";
CM_ SG_ 525 SGU12_Object_dy "Position of target object in y-direction [m]";
CM_ SG_ 525 SGU12_Object_DistLong_rms "Standard deviation of longitudinal distance";
CM_ SG_ 525 SGU12_Obj_DistLat_rms "Standard deviation of lateral distance";
CM_ SG_ 525 SGU12_Object_vx "Relative target object velocity in x-direction [m/s]";
CM_ SG_ 525 SGU12_Object_vy "Relative target object velocity in y-direction [m/s]";
CM_ SG_ 525 SGU12_Obj_VrelLong_rms "Standard deviation of longitudinal relative velocity";
CM_ SG_ 525 SGU12_Obj_Vrelat_rms "Standard deviation of lateral relative velocity";
CM_ SG_ 525 SGU12_Object_ax "Relative target object acceleration in x-direction, in the vehicle coordinatesystem";
CM_ SG_ 525 SGU12_Object_ay "Relative target object acceleration in y-direction, in the vehicle coordinate system";
CM_ SG_ 525 SGU12_Object_DetStatus "Detection Staus Of Object";
CM_ SG_ 525 SGU12_LifeCycles_OBJ "-";
CM_ SG_ 525 SGU12_ObjRCS_12 "Radar Cross Section (RCS) estimation";
CM_ SG_ 525 SGU12_Object_dx_Rear "Position of target object in x-direction [m]";
CM_ SG_ 525 SGU12_Object_dy_Rear "Position of target object in y-direction [m]";
CM_ SG_ 526 SGU13_Msg_CheckSum "E2E Profile Variant 1A CRC";
CM_ SG_ 526 SGU13_Msg_AliveCounter "E2E Profile Variant 1A Counter";
CM_ SG_ 526 SGU13_BlockCounter "Block counter for every messages";
CM_ SG_ 526 SGU13_Object_ID "ID is an identifier number that allows for tracking of persistent objects over time";
CM_ SG_ 526 SGU13_Object_wExist "Existence probability of the object";
CM_ SG_ 526 SGU13_Object_Type "To indicate the estimated type of Object";
CM_ SG_ 526 SGU13_Object_Motion_Pattern "Motion type of object";
CM_ SG_ 526 SGU13_Object_wObstacle "The probability of an object being an obstacle";
CM_ SG_ 526 SGU13_Object_dx "Position of target object in x-direction [m]";
CM_ SG_ 526 SGU13_Object_dy "Position of target object in y-direction [m]";
CM_ SG_ 526 SGU13_Object_DistLong_rms "Standard deviation of longitudinal distance";
CM_ SG_ 526 SGU13_Obj_DistLat_rms "Standard deviation of lateral distance";
CM_ SG_ 526 SGU13_Object_vx "Relative target object velocity in x-direction [m/s]";
CM_ SG_ 526 SGU13_Object_vy "Relative target object velocity in y-direction [m/s]";
CM_ SG_ 526 SGU13_Obj_VrelLong_rms "Standard deviation of longitudinal relative velocity";
CM_ SG_ 526 SGU13_Obj_Vrelat_rms "Standard deviation of lateral relative velocity";
CM_ SG_ 526 SGU13_Object_ax "Relative target object acceleration in x-direction, in the vehicle coordinatesystem";
CM_ SG_ 526 SGU13_Object_ay "Relative target object acceleration in y-direction, in the vehicle coordinate system";
CM_ SG_ 526 SGU13_Object_DetStatus "Detection Staus Of Object";
CM_ SG_ 526 SGU13_LifeCycles_OBJ "-";
CM_ SG_ 526 SGU13_ObjRCS_13 "Radar Cross Section (RCS) estimation";
CM_ SG_ 526 SGU13_Object_dx_Rear "Position of target object in x-direction [m]";
CM_ SG_ 526 SGU13_Object_dy_Rear "Position of target object in y-direction [m]";
CM_ SG_ 527 SGU14_Msg_CheckSum "E2E Profile Variant 1A CRC";
CM_ SG_ 527 SGU14_Msg_AliveCounter "E2E Profile Variant 1A Counter";
CM_ SG_ 527 SGU14_BlockCounter "Block counter for every messages";
CM_ SG_ 527 SGU14_Object_ID "ID is an identifier number that allows for tracking of persistent objects over time";
CM_ SG_ 527 SGU14_Object_wExist "Existence probability of the object";
CM_ SG_ 527 SGU14_Object_Type "To indicate the estimated type of Object";
CM_ SG_ 527 SGU14_Object_Motion_Pattern "Motion type of object";
CM_ SG_ 527 SGU14_Object_wObstacle "The probability of an object being an obstacle";
CM_ SG_ 527 SGU14_Object_dx "Position of target object in x-direction [m]";
CM_ SG_ 527 SGU14_Object_dy "Position of target object in y-direction [m]";
CM_ SG_ 527 SGU14_Object_DistLong_rms "Standard deviation of longitudinal distance";
CM_ SG_ 527 SGU14_Obj_DistLat_rms "Standard deviation of lateral distance";
CM_ SG_ 527 SGU14_Object_vx "Relative target object velocity in x-direction [m/s]";
CM_ SG_ 527 SGU14_Object_vy "Relative target object velocity in y-direction [m/s]";
CM_ SG_ 527 SGU14_Obj_VrelLong_rms "Standard deviation of longitudinal relative velocity";
CM_ SG_ 527 SGU14_Obj_Vrelat_rms "Standard deviation of lateral relative velocity";
CM_ SG_ 527 SGU14_Object_ax "Relative target object acceleration in x-direction, in the vehicle coordinatesystem";
CM_ SG_ 527 SGU14_Object_ay "Relative target object acceleration in y-direction, in the vehicle coordinate system";
CM_ SG_ 527 SGU14_Object_DetStatus "Detection Staus Of Object";
CM_ SG_ 527 SGU14_LifeCycles_OBJ "-";
CM_ SG_ 527 SGU14_ObjRCS_14 "Radar Cross Section (RCS) estimation";
CM_ SG_ 527 SGU14_Object_dx_Rear "Position of target object in x-direction [m]";
CM_ SG_ 527 SGU14_Object_dy_Rear "Position of target object in y-direction [m]";
CM_ SG_ 528 SGU15_Msg_CheckSum "E2E Profile Variant 1A CRC";
CM_ SG_ 528 SGU15_Msg_AliveCounter "E2E Profile Variant 1A Counter";
CM_ SG_ 528 SGU15_BlockCounter "Block counter for every messages";
CM_ SG_ 528 SGU15_Object_ID "ID is an identifier number that allows for tracking of persistent objects over time";
CM_ SG_ 528 SGU15_Object_wExist "Existence probability of the object";
CM_ SG_ 528 SGU15_Object_Type "To indicate the estimated type of Object";
CM_ SG_ 528 SGU15_Object_Motion_Pattern "Motion type of object";
CM_ SG_ 528 SGU15_Object_wObstacle "The probability of an object being an obstacle";
CM_ SG_ 528 SGU15_Object_dx "Position of target object in x-direction [m]";
CM_ SG_ 528 SGU15_Object_dy "Position of target object in y-direction [m]";
CM_ SG_ 528 SGU15_Object_DistLong_rms "Standard deviation of longitudinal distance";
CM_ SG_ 528 SGU15_Obj_DistLat_rms "Standard deviation of lateral distance";
CM_ SG_ 528 SGU15_Object_vx "Relative target object velocity in x-direction [m/s]";
CM_ SG_ 528 SGU15_Object_vy "Relative target object velocity in y-direction [m/s]";
CM_ SG_ 528 SGU15_Obj_VrelLong_rms "Standard deviation of longitudinal relative velocity";
CM_ SG_ 528 SGU15_Obj_Vrelat_rms "Standard deviation of lateral relative velocity";
CM_ SG_ 528 SGU15_Object_ax "Relative target object acceleration in x-direction, in the vehicle coordinatesystem";
CM_ SG_ 528 SGU15_Object_ay "Relative target object acceleration in y-direction, in the vehicle coordinate system";
CM_ SG_ 528 SGU15_Object_DetStatus "Detection Staus Of Object";
CM_ SG_ 528 SGU15_LifeCycles_OBJ "-";
CM_ SG_ 528 SGU15_ObjRCS_15 "Radar Cross Section (RCS) estimation";
CM_ SG_ 528 SGU15_Object_dx_Rear "Position of target object in x-direction [m]";
CM_ SG_ 528 SGU15_Object_dy_Rear "Position of target object in y-direction [m]";
CM_ SG_ 529 SGU16_Msg_CheckSum "E2E Profile Variant 1A CRC";
CM_ SG_ 529 SGU16_Msg_AliveCounter "E2E Profile Variant 1A Counter";
CM_ SG_ 529 SGU16_BlockCounter "Block counter for every messages";
CM_ SG_ 529 SGU16_Object_ID "ID is an identifier number that allows for tracking of persistent objects over time";
CM_ SG_ 529 SGU16_Object_wExist "Existence probability of the object";
CM_ SG_ 529 SGU16_Object_Type "To indicate the estimated type of Object";
CM_ SG_ 529 SGU16_Object_Motion_Pattern "Motion type of object";
CM_ SG_ 529 SGU16_Object_wObstacle "The probability of an object being an obstacle";
CM_ SG_ 529 SGU16_Object_dx "Position of target object in x-direction [m]";
CM_ SG_ 529 SGU16_Object_dy "Position of target object in y-direction [m]";
CM_ SG_ 529 SGU16_Object_DistLong_rms "Standard deviation of longitudinal distance";
CM_ SG_ 529 SGU16_Obj_DistLat_rms "Standard deviation of lateral distance";
CM_ SG_ 529 SGU16_Object_vx "Relative target object velocity in x-direction [m/s]";
CM_ SG_ 529 SGU16_Object_vy "Relative target object velocity in y-direction [m/s]";
CM_ SG_ 529 SGU16_Obj_VrelLong_rms "Standard deviation of longitudinal relative velocity";
CM_ SG_ 529 SGU16_Obj_Vrelat_rms "Standard deviation of lateral relative velocity";
CM_ SG_ 529 SGU16_Object_ax "Relative target object acceleration in x-direction, in the vehicle coordinatesystem";
CM_ SG_ 529 SGU16_Object_ay "Relative target object acceleration in y-direction, in the vehicle coordinate system";
CM_ SG_ 529 SGU16_Object_DetStatus "Detection Staus Of Object";
CM_ SG_ 529 SGU16_LifeCycles_OBJ "-";
CM_ SG_ 529 SGU16_ObjRCS_16 "Radar Cross Section (RCS) estimation";
CM_ SG_ 529 SGU16_Object_dx_Rear "Position of target object in x-direction [m]";
CM_ SG_ 529 SGU16_Object_dy_Rear "Position of target object in y-direction [m]";
CM_ SG_ 394 BCS_3_CRC1 "E2E Profile Variant 1A CRC";
CM_ SG_ 394 BCS_3_Counter1 "E2E Profile Variant 1A Counter";
CM_ SG_ 394 BCS_FLWheelSpd "Current wheel speed information of front left wheel";
CM_ SG_ 394 BCS_FLWheelSpdVD "Quality/fault information to current wheel speed of front left wheel";
CM_ SG_ 394 BCS_FLWheelRotatedDirection "FL wheel rotate direction";
CM_ SG_ 394 BCS_FLWheelRotatedDirectionVD "FL wheel rotate direction validity";
CM_ SG_ 394 BCS_FRWheelSpd "Current wheel speed information of front right wheel";
CM_ SG_ 394 BCS_FRWheelSpdVD "Quality/fault information to current wheel speed of front rightwheel";
CM_ SG_ 394 BCS_FRWheelRotatedDirection "FR wheel rotate direction";
CM_ SG_ 394 BCS_FRWheelRotatedDirectionVD " FR wheel rotate direction validity";
CM_ SG_ 394 BCS_RLWheelSpd "Current wheel speed information of RL wheel";
CM_ SG_ 394 BCS_RLWheelSpdVD "Quality/fault information to current wheel speed of RL wheel";
CM_ SG_ 394 BCS_RLWheelRotatedDirection "RL wheel rotate direction";
CM_ SG_ 394 BCS_RLWheelRotatedDirectionVD "RL wheel rotate direction validity";
CM_ SG_ 394 BCS_RRWheelSpd "Current wheel speed information of RR wheel";
CM_ SG_ 394 BCS_RRWheelSpdVD "Quality/fault information to current wheel speed of RR wheel";
CM_ SG_ 394 BCS_RRWheelRotatedDirection "RR wheel rotate direction";
CM_ SG_ 394 BCS_RRWheelRotatedDirectionVD "RR wheel rotate direction validity";
CM_ SG_ 394 BCS_YawRateSt "Yaw rate status";
CM_ SG_ 394 BCS_YawRate "Yaw rate";
CM_ SG_ 394 BCS_ActVehLongAccel "Actual vehicle longitudinal acceleration";
CM_ SG_ 394 BCS_ActVehLaltrlAccel "Actual vehicle lateral acceleration";
CM_ SG_ 394 BCS_ActVehLongAccelVD "Quality/fault information to actual vehicle longitudinal acceleration";
CM_ SG_ 394 BCS_ActVehLaltrlAccelVD "Quality/fault information to actual vehicle lateral acceleration";
CM_ SG_ 352 BCS_2_CRC "E2E Profile Variant 1A CRC";
CM_ SG_ 352 BCS_2_Counter "E2E Profile Variant 1A Counter";
CM_ SG_ 352 BCS_ABSActiveSt "Indication that ABS system currently performs a brake intervention";
CM_ SG_ 352 BCS_ABSFaultSt "ABS system has detected a failure which does no allow a reliable ABS regulation and is therefore switched off";
CM_ SG_ 352 BCS_TCSActiveSt "Indication that TCS system currently performs a brake/engine intervention";
CM_ SG_ 352 BCS_TCSFaultSt "TCS is switched off due to detected failure";
CM_ SG_ 352 BCS_VDCActiveSt "Indication that VDC system currently performs a brake/engine intervention when ESP adjust the posture of vehicle";
CM_ SG_ 352 BCS_VDCFaultSt "VDC is switched off due to detected failure ";
CM_ SG_ 352 SOC_VehSpd "SOC transmit BCS Vehicle speed, IFC/MCU transmit CCU_RBM_1_C Vehicle speed";
CM_ SG_ 352 SOC_VehSpdVD "SOC transmit BCS Vehicle speed, IFC/MCU transmit CCU_RBM_1_C Vehicle speed";
CM_ SG_ 353 BCS_1_CRC "E2E Profile Variant 1A CRC";
CM_ SG_ 353 BCS_1_Counter "E2E Profile Variant 1A Counter";
CM_ SG_ 353 BCS_VehicleStandStillSt "Indicating whether the vehicle is standstill or not; must not be set until standstill is surely reached.";
CM_ SG_ 363 EPS_1_CRC "E2E Profile Variant 1A CRC ";
CM_ SG_ 363 EPS_1_Counter "E2E Profile Variant 1A Counter";
CM_ SG_ 363 EPS_FunctionStyleSt "EPS function style state";
CM_ SG_ 363 EPS_SteeringAngle "steering wheel angle";
CM_ SG_ 363 EPS_SteeringModeSt "EPS steering mode status";
CM_ SG_ 363 EPS_SteeringAngleSpd "steering wheel angle speed";
CM_ SG_ 38 ADC_SOC_Status_Msg_CheckSum_Can03 "E2E Profile Variant 1A CRC";
CM_ SG_ 38 SOC_ADCFaultSt_Can03 "ADC Status detected by SOC";

BA_DEF_  "BusType" STRING ;
BA_DEF_  "DBName" STRING ;
BA_DEF_  "Manufacturer" STRING ;
BA_DEF_ BO_  "GenMsgCycleTime" INT 0 65535;
BA_DEF_ BO_  "GenMsgCycleTimeFast" INT 0 65535;
BA_DEF_ BO_  "GenMsgILSupport" ENUM  "No","Yes";
BA_DEF_ BO_  "GenMsgSendType" ENUM  "Cyclic","Event","CE","NotUsed","NotUsed","NotUsed","NotUsed","NotUsed","NoMsgSendType","IfActive","IfActiveWithRepetition","CyclicAndSpontanX";
BA_DEF_ BO_  "MsgType" ENUM  "Normal","NM","Diag","vector_leerstring";
BA_DEF_ BO_  "NmAsrMessage" ENUM  "No","Yes";
BA_DEF_ BO_  "VFrameFormat" ENUM  "StandardCAN","ExtendedCAN","reserved","reserved","reserved","reserved","reserved","reserved","reserved","reserved","reserved","reserved","reserved","reserved","StandardCAN_FD","ExtendedCAN_FD";
BA_DEF_ SG_  "GenSigInactiveValue" INT 0 2147483647;
BA_DEF_ SG_  "GenSigSendType" ENUM  "Cyclic","OnWrite","OnWriteWithRepetition","OnChange","OnChangeWithRepetition","IfActive","IfActiveWithRepetition","NoSigSendType","CyclicAndSpontanX","NotUsed","Event","CE";
BA_DEF_ SG_  "GenSigStartValue" INT 0 2147483647;
BA_DEF_ SG_  "Internal_type" ENUM  "*","UB","UW","UL","SB","SW","SL";
BA_DEF_ SG_  "IsCrcSignal" ENUM  "No","Yes";
BA_DEF_ SG_  "IsMonitor" ENUM  "*","Monitor";
BA_DEF_ SG_  "Remark" STRING ;
BA_DEF_ SG_  "SigInvalidSetFlag" ENUM  "*","Yes";
BA_DEF_ SG_  "UnitConversionFactor" FLOAT -100 100;
BA_DEF_  "Approver" STRING ;
BA_DEF_  "Author" STRING ;
BA_DEF_  "Checker" STRING ;
BA_DEF_  "Date" STRING ;
BA_DEF_  "Project" STRING ;
BA_DEF_  "Version" STRING ;
BA_DEF_ BO_  "CANFD_BRS" ENUM  "0","1";
BA_DEF_ SG_  "EventCommandSignal" ENUM  "No","Yes";
BA_DEF_ SG_  "GatewayedSignals" ENUM  "No","Yes";
BA_DEF_ SG_  "GenSigInvalidValue" HEX 0 0;
BA_DEF_ SG_  "GenSigTimeoutValue" HEX 0 0;

BA_DEF_DEF_  "BusType" "";
BA_DEF_DEF_  "DBName" "";
BA_DEF_DEF_  "GenMsgCycleTime" 0;
BA_DEF_DEF_  "GenMsgCycleTimeFast" 0;
BA_DEF_DEF_  "GenMsgILSupport" "Yes";
BA_DEF_DEF_  "GenMsgSendType" "Cyclic";
BA_DEF_DEF_  "GenSigInactiveValue" 0;
BA_DEF_DEF_  "GenSigSendType" "Cyclic";
BA_DEF_DEF_  "GenSigStartValue" 0;
BA_DEF_DEF_  "Internal_type" "*";
BA_DEF_DEF_  "IsCrcSignal" "No";
BA_DEF_DEF_  "IsMonitor" "*";
BA_DEF_DEF_  "Manufacturer" "Vector";
BA_DEF_DEF_  "MsgType" "";
BA_DEF_DEF_  "NmAsrMessage" "No";
BA_DEF_DEF_  "Remark" "";
BA_DEF_DEF_  "SigInvalidSetFlag" "*";
BA_DEF_DEF_  "UnitConversionFactor" 1;
BA_DEF_DEF_  "VFrameFormat" "StandardCAN";

BA_ "Manufacturer" "GACRND";
BA_ "Project" "E9";
BA_ "Version" "1.0";
BA_ "Date" "2025/5/13 16:34:54";
BA_ "Author" "";
BA_ "DBName" "CAN4";
BA_ "BusType" "CAN FD";
BA_ "Checker" "";
BA_ "Approver" "";
BA_ "CANFD_BRS" BO_ 352 1;
BA_ "CANFD_BRS" BO_ 353 1;
BA_ "CANFD_BRS" BO_ 363 1;
BA_ "CANFD_BRS" BO_ 38 1;
BA_ "CANFD_BRS" BO_ 394 1;
BA_ "CANFD_BRS" BO_ 513 1;
BA_ "CANFD_BRS" BO_ 514 1;
BA_ "CANFD_BRS" BO_ 515 1;
BA_ "CANFD_BRS" BO_ 516 1;
BA_ "CANFD_BRS" BO_ 517 1;
BA_ "CANFD_BRS" BO_ 518 1;
BA_ "CANFD_BRS" BO_ 519 1;
BA_ "CANFD_BRS" BO_ 520 1;
BA_ "CANFD_BRS" BO_ 521 1;
BA_ "CANFD_BRS" BO_ 522 1;
BA_ "CANFD_BRS" BO_ 523 1;
BA_ "CANFD_BRS" BO_ 524 1;
BA_ "CANFD_BRS" BO_ 525 1;
BA_ "CANFD_BRS" BO_ 526 1;
BA_ "CANFD_BRS" BO_ 527 1;
BA_ "CANFD_BRS" BO_ 528 1;
BA_ "CANFD_BRS" BO_ 529 1;
BA_ "GenMsgCycleTime" BO_ 352 10;
BA_ "GenMsgCycleTime" BO_ 353 10;
BA_ "GenMsgCycleTime" BO_ 363 10;
BA_ "GenMsgCycleTime" BO_ 38 20;
BA_ "GenMsgCycleTime" BO_ 394 20;
BA_ "GenMsgSendType" BO_ 513 1;
BA_ "GenMsgSendType" BO_ 514 1;
BA_ "GenMsgSendType" BO_ 515 1;
BA_ "GenMsgSendType" BO_ 516 1;
BA_ "GenMsgSendType" BO_ 517 1;
BA_ "GenMsgSendType" BO_ 518 1;
BA_ "GenMsgSendType" BO_ 519 1;
BA_ "GenMsgSendType" BO_ 520 1;
BA_ "GenMsgSendType" BO_ 521 1;
BA_ "GenMsgSendType" BO_ 522 1;
BA_ "GenMsgSendType" BO_ 523 1;
BA_ "GenMsgSendType" BO_ 524 1;
BA_ "GenMsgSendType" BO_ 525 1;
BA_ "GenMsgSendType" BO_ 526 1;
BA_ "GenMsgSendType" BO_ 527 1;
BA_ "GenMsgSendType" BO_ 528 1;
BA_ "GenMsgSendType" BO_ 529 1;
BA_ "MsgType" BO_ 352 0;
BA_ "MsgType" BO_ 353 0;
BA_ "MsgType" BO_ 363 0;
BA_ "MsgType" BO_ 38 0;
BA_ "MsgType" BO_ 394 0;
BA_ "MsgType" BO_ 513 0;
BA_ "MsgType" BO_ 514 0;
BA_ "MsgType" BO_ 515 0;
BA_ "MsgType" BO_ 516 0;
BA_ "MsgType" BO_ 517 0;
BA_ "MsgType" BO_ 518 0;
BA_ "MsgType" BO_ 519 0;
BA_ "MsgType" BO_ 520 0;
BA_ "MsgType" BO_ 521 0;
BA_ "MsgType" BO_ 522 0;
BA_ "MsgType" BO_ 523 0;
BA_ "MsgType" BO_ 524 0;
BA_ "MsgType" BO_ 525 0;
BA_ "MsgType" BO_ 526 0;
BA_ "MsgType" BO_ 527 0;
BA_ "MsgType" BO_ 528 0;
BA_ "MsgType" BO_ 529 0;
BA_ "EventCommandSignal" SG_ 352 BCS_2_CRC 0;
BA_ "GatewayedSignals" SG_ 352 BCS_2_CRC 0;
BA_ "GenSigInvalidValue" SG_ 352 BCS_2_CRC 0;
BA_ "GenSigSendType" SG_ 352 BCS_2_CRC 1;
BA_ "GenSigTimeoutValue" SG_ 352 BCS_2_CRC 0;
BA_ "EventCommandSignal" SG_ 352 BCS_2_Counter 0;
BA_ "GatewayedSignals" SG_ 352 BCS_2_Counter 0;
BA_ "GenSigInvalidValue" SG_ 352 BCS_2_Counter 0;
BA_ "GenSigSendType" SG_ 352 BCS_2_Counter 1;
BA_ "GenSigTimeoutValue" SG_ 352 BCS_2_Counter 0;
BA_ "EventCommandSignal" SG_ 352 BCS_ABSActiveSt 0;
BA_ "GatewayedSignals" SG_ 352 BCS_ABSActiveSt 0;
BA_ "GenSigInvalidValue" SG_ 352 BCS_ABSActiveSt 0;
BA_ "GenSigSendType" SG_ 352 BCS_ABSActiveSt 1;
BA_ "GenSigTimeoutValue" SG_ 352 BCS_ABSActiveSt 0;
BA_ "EventCommandSignal" SG_ 352 BCS_ABSFaultSt 0;
BA_ "GatewayedSignals" SG_ 352 BCS_ABSFaultSt 0;
BA_ "GenSigInvalidValue" SG_ 352 BCS_ABSFaultSt 0;
BA_ "GenSigSendType" SG_ 352 BCS_ABSFaultSt 1;
BA_ "GenSigStartValue" SG_ 352 BCS_ABSFaultSt 1;
BA_ "GenSigTimeoutValue" SG_ 352 BCS_ABSFaultSt 0;
BA_ "EventCommandSignal" SG_ 352 BCS_TCSActiveSt 0;
BA_ "GatewayedSignals" SG_ 352 BCS_TCSActiveSt 0;
BA_ "GenSigInvalidValue" SG_ 352 BCS_TCSActiveSt 0;
BA_ "GenSigSendType" SG_ 352 BCS_TCSActiveSt 1;
BA_ "GenSigTimeoutValue" SG_ 352 BCS_TCSActiveSt 0;
BA_ "EventCommandSignal" SG_ 352 BCS_TCSFaultSt 0;
BA_ "GatewayedSignals" SG_ 352 BCS_TCSFaultSt 0;
BA_ "GenSigInvalidValue" SG_ 352 BCS_TCSFaultSt 0;
BA_ "GenSigSendType" SG_ 352 BCS_TCSFaultSt 1;
BA_ "GenSigStartValue" SG_ 352 BCS_TCSFaultSt 1;
BA_ "GenSigTimeoutValue" SG_ 352 BCS_TCSFaultSt 0;
BA_ "EventCommandSignal" SG_ 352 BCS_VDCActiveSt 0;
BA_ "GatewayedSignals" SG_ 352 BCS_VDCActiveSt 0;
BA_ "GenSigInvalidValue" SG_ 352 BCS_VDCActiveSt 0;
BA_ "GenSigSendType" SG_ 352 BCS_VDCActiveSt 1;
BA_ "GenSigTimeoutValue" SG_ 352 BCS_VDCActiveSt 0;
BA_ "EventCommandSignal" SG_ 352 BCS_VDCFaultSt 0;
BA_ "GatewayedSignals" SG_ 352 BCS_VDCFaultSt 0;
BA_ "GenSigInvalidValue" SG_ 352 BCS_VDCFaultSt 0;
BA_ "GenSigSendType" SG_ 352 BCS_VDCFaultSt 1;
BA_ "GenSigStartValue" SG_ 352 BCS_VDCFaultSt 1;
BA_ "GenSigTimeoutValue" SG_ 352 BCS_VDCFaultSt 0;
BA_ "EventCommandSignal" SG_ 352 SOC_VehSpd 0;
BA_ "GatewayedSignals" SG_ 352 SOC_VehSpd 0;
BA_ "GenSigInvalidValue" SG_ 352 SOC_VehSpd 0;
BA_ "GenSigSendType" SG_ 352 SOC_VehSpd 1;
BA_ "GenSigTimeoutValue" SG_ 352 SOC_VehSpd 0;
BA_ "EventCommandSignal" SG_ 352 SOC_VehSpdVD 0;
BA_ "GatewayedSignals" SG_ 352 SOC_VehSpdVD 0;
BA_ "GenSigInvalidValue" SG_ 352 SOC_VehSpdVD 0;
BA_ "GenSigSendType" SG_ 352 SOC_VehSpdVD 1;
BA_ "GenSigTimeoutValue" SG_ 352 SOC_VehSpdVD 0;
BA_ "EventCommandSignal" SG_ 353 BCS_1_CRC 0;
BA_ "GatewayedSignals" SG_ 353 BCS_1_CRC 0;
BA_ "GenSigInvalidValue" SG_ 353 BCS_1_CRC 0;
BA_ "GenSigSendType" SG_ 353 BCS_1_CRC 1;
BA_ "GenSigTimeoutValue" SG_ 353 BCS_1_CRC 0;
BA_ "EventCommandSignal" SG_ 353 BCS_1_Counter 0;
BA_ "GatewayedSignals" SG_ 353 BCS_1_Counter 0;
BA_ "GenSigInvalidValue" SG_ 353 BCS_1_Counter 0;
BA_ "GenSigSendType" SG_ 353 BCS_1_Counter 1;
BA_ "GenSigTimeoutValue" SG_ 353 BCS_1_Counter 0;
BA_ "EventCommandSignal" SG_ 353 BCS_VehicleStandStillSt 0;
BA_ "GatewayedSignals" SG_ 353 BCS_VehicleStandStillSt 0;
BA_ "GenSigInvalidValue" SG_ 353 BCS_VehicleStandStillSt 0;
BA_ "GenSigSendType" SG_ 353 BCS_VehicleStandStillSt 1;
BA_ "GenSigTimeoutValue" SG_ 353 BCS_VehicleStandStillSt 0;
BA_ "EventCommandSignal" SG_ 363 EPS_1_CRC 0;
BA_ "GatewayedSignals" SG_ 363 EPS_1_CRC 0;
BA_ "GenSigInvalidValue" SG_ 363 EPS_1_CRC 0;
BA_ "GenSigSendType" SG_ 363 EPS_1_CRC 1;
BA_ "GenSigTimeoutValue" SG_ 363 EPS_1_CRC 0;
BA_ "EventCommandSignal" SG_ 363 EPS_1_Counter 0;
BA_ "GatewayedSignals" SG_ 363 EPS_1_Counter 0;
BA_ "GenSigInvalidValue" SG_ 363 EPS_1_Counter 0;
BA_ "GenSigSendType" SG_ 363 EPS_1_Counter 1;
BA_ "GenSigTimeoutValue" SG_ 363 EPS_1_Counter 0;
BA_ "EventCommandSignal" SG_ 363 EPS_FunctionStyleSt 0;
BA_ "GatewayedSignals" SG_ 363 EPS_FunctionStyleSt 0;
BA_ "GenSigInvalidValue" SG_ 363 EPS_FunctionStyleSt 0;
BA_ "GenSigSendType" SG_ 363 EPS_FunctionStyleSt 1;
BA_ "GenSigTimeoutValue" SG_ 363 EPS_FunctionStyleSt 0;
BA_ "EventCommandSignal" SG_ 363 EPS_SteeringAngle 0;
BA_ "GatewayedSignals" SG_ 363 EPS_SteeringAngle 0;
BA_ "GenSigInvalidValue" SG_ 363 EPS_SteeringAngle 65535;
BA_ "GenSigSendType" SG_ 363 EPS_SteeringAngle 1;
BA_ "GenSigTimeoutValue" SG_ 363 EPS_SteeringAngle 65535;
BA_ "EventCommandSignal" SG_ 363 EPS_SteeringAngleSpd 0;
BA_ "GatewayedSignals" SG_ 363 EPS_SteeringAngleSpd 0;
BA_ "GenSigInvalidValue" SG_ 363 EPS_SteeringAngleSpd 255;
BA_ "GenSigSendType" SG_ 363 EPS_SteeringAngleSpd 1;
BA_ "GenSigTimeoutValue" SG_ 363 EPS_SteeringAngleSpd 255;
BA_ "EventCommandSignal" SG_ 363 EPS_SteeringAngleSpdVD 0;
BA_ "GatewayedSignals" SG_ 363 EPS_SteeringAngleSpdVD 0;
BA_ "GenSigInvalidValue" SG_ 363 EPS_SteeringAngleSpdVD 0;
BA_ "GenSigSendType" SG_ 363 EPS_SteeringAngleSpdVD 1;
BA_ "GenSigTimeoutValue" SG_ 363 EPS_SteeringAngleSpdVD 0;
BA_ "EventCommandSignal" SG_ 363 EPS_SteeringAngleVD 0;
BA_ "GatewayedSignals" SG_ 363 EPS_SteeringAngleVD 0;
BA_ "GenSigInvalidValue" SG_ 363 EPS_SteeringAngleVD 0;
BA_ "GenSigSendType" SG_ 363 EPS_SteeringAngleVD 1;
BA_ "GenSigTimeoutValue" SG_ 363 EPS_SteeringAngleVD 0;
BA_ "EventCommandSignal" SG_ 363 EPS_SteeringModeSt 0;
BA_ "GatewayedSignals" SG_ 363 EPS_SteeringModeSt 0;
BA_ "GenSigInvalidValue" SG_ 363 EPS_SteeringModeSt 0;
BA_ "GenSigSendType" SG_ 363 EPS_SteeringModeSt 1;
BA_ "GenSigTimeoutValue" SG_ 363 EPS_SteeringModeSt 0;
BA_ "EventCommandSignal" SG_ 38 ADC_SOC_Status_Msg_CheckSum_Can03 0;
BA_ "GatewayedSignals" SG_ 38 ADC_SOC_Status_Msg_CheckSum_Can03 0;
BA_ "GenSigInvalidValue" SG_ 38 ADC_SOC_Status_Msg_CheckSum_Can03 0;
BA_ "GenSigSendType" SG_ 38 ADC_SOC_Status_Msg_CheckSum_Can03 1;
BA_ "GenSigTimeoutValue" SG_ 38 ADC_SOC_Status_Msg_CheckSum_Can03 0;
BA_ "EventCommandSignal" SG_ 38 SOC_ADCFaultSt_Can03 0;
BA_ "GatewayedSignals" SG_ 38 SOC_ADCFaultSt_Can03 0;
BA_ "GenSigInvalidValue" SG_ 38 SOC_ADCFaultSt_Can03 0;
BA_ "GenSigSendType" SG_ 38 SOC_ADCFaultSt_Can03 1;
BA_ "GenSigTimeoutValue" SG_ 38 SOC_ADCFaultSt_Can03 0;
BA_ "EventCommandSignal" SG_ 394 BCS_3_CRC1 0;
BA_ "GatewayedSignals" SG_ 394 BCS_3_CRC1 0;
BA_ "GenSigInvalidValue" SG_ 394 BCS_3_CRC1 0;
BA_ "GenSigSendType" SG_ 394 BCS_3_CRC1 1;
BA_ "GenSigTimeoutValue" SG_ 394 BCS_3_CRC1 0;
BA_ "EventCommandSignal" SG_ 394 BCS_3_Counter1 0;
BA_ "GatewayedSignals" SG_ 394 BCS_3_Counter1 0;
BA_ "GenSigInvalidValue" SG_ 394 BCS_3_Counter1 0;
BA_ "GenSigSendType" SG_ 394 BCS_3_Counter1 1;
BA_ "GenSigTimeoutValue" SG_ 394 BCS_3_Counter1 0;
BA_ "EventCommandSignal" SG_ 394 BCS_ActVehLaltrlAccel 0;
BA_ "GatewayedSignals" SG_ 394 BCS_ActVehLaltrlAccel 0;
BA_ "GenSigInvalidValue" SG_ 394 BCS_ActVehLaltrlAccel 0;
BA_ "GenSigSendType" SG_ 394 BCS_ActVehLaltrlAccel 1;
BA_ "GenSigStartValue" SG_ 394 BCS_ActVehLaltrlAccel 796;
BA_ "GenSigTimeoutValue" SG_ 394 BCS_ActVehLaltrlAccel 0;
BA_ "EventCommandSignal" SG_ 394 BCS_ActVehLaltrlAccelVD 0;
BA_ "GatewayedSignals" SG_ 394 BCS_ActVehLaltrlAccelVD 0;
BA_ "GenSigInvalidValue" SG_ 394 BCS_ActVehLaltrlAccelVD 0;
BA_ "GenSigSendType" SG_ 394 BCS_ActVehLaltrlAccelVD 1;
BA_ "GenSigTimeoutValue" SG_ 394 BCS_ActVehLaltrlAccelVD 0;
BA_ "EventCommandSignal" SG_ 394 BCS_ActVehLongAccel 0;
BA_ "GatewayedSignals" SG_ 394 BCS_ActVehLongAccel 0;
BA_ "GenSigInvalidValue" SG_ 394 BCS_ActVehLongAccel 0;
BA_ "GenSigSendType" SG_ 394 BCS_ActVehLongAccel 1;
BA_ "GenSigStartValue" SG_ 394 BCS_ActVehLongAccel 796;
BA_ "GenSigTimeoutValue" SG_ 394 BCS_ActVehLongAccel 0;
BA_ "EventCommandSignal" SG_ 394 BCS_ActVehLongAccelVD 0;
BA_ "GatewayedSignals" SG_ 394 BCS_ActVehLongAccelVD 0;
BA_ "GenSigInvalidValue" SG_ 394 BCS_ActVehLongAccelVD 0;
BA_ "GenSigSendType" SG_ 394 BCS_ActVehLongAccelVD 1;
BA_ "GenSigTimeoutValue" SG_ 394 BCS_ActVehLongAccelVD 0;
BA_ "EventCommandSignal" SG_ 394 BCS_FLWheelRotatedDirection 0;
BA_ "GatewayedSignals" SG_ 394 BCS_FLWheelRotatedDirection 0;
BA_ "GenSigInvalidValue" SG_ 394 BCS_FLWheelRotatedDirection 0;
BA_ "GenSigSendType" SG_ 394 BCS_FLWheelRotatedDirection 1;
BA_ "GenSigTimeoutValue" SG_ 394 BCS_FLWheelRotatedDirection 0;
BA_ "EventCommandSignal" SG_ 394 BCS_FLWheelRotatedDirectionVD 0;
BA_ "GatewayedSignals" SG_ 394 BCS_FLWheelRotatedDirectionVD 0;
BA_ "GenSigInvalidValue" SG_ 394 BCS_FLWheelRotatedDirectionVD 0;
BA_ "GenSigSendType" SG_ 394 BCS_FLWheelRotatedDirectionVD 1;
BA_ "GenSigTimeoutValue" SG_ 394 BCS_FLWheelRotatedDirectionVD 0;
BA_ "EventCommandSignal" SG_ 394 BCS_FLWheelSpd 0;
BA_ "GatewayedSignals" SG_ 394 BCS_FLWheelSpd 0;
BA_ "GenSigInvalidValue" SG_ 394 BCS_FLWheelSpd 0;
BA_ "GenSigSendType" SG_ 394 BCS_FLWheelSpd 1;
BA_ "GenSigTimeoutValue" SG_ 394 BCS_FLWheelSpd 0;
BA_ "EventCommandSignal" SG_ 394 BCS_FLWheelSpdVD 0;
BA_ "GatewayedSignals" SG_ 394 BCS_FLWheelSpdVD 0;
BA_ "GenSigInvalidValue" SG_ 394 BCS_FLWheelSpdVD 0;
BA_ "GenSigSendType" SG_ 394 BCS_FLWheelSpdVD 1;
BA_ "GenSigTimeoutValue" SG_ 394 BCS_FLWheelSpdVD 0;
BA_ "EventCommandSignal" SG_ 394 BCS_FRWheelRotatedDirection 0;
BA_ "GatewayedSignals" SG_ 394 BCS_FRWheelRotatedDirection 0;
BA_ "GenSigInvalidValue" SG_ 394 BCS_FRWheelRotatedDirection 0;
BA_ "GenSigSendType" SG_ 394 BCS_FRWheelRotatedDirection 1;
BA_ "GenSigTimeoutValue" SG_ 394 BCS_FRWheelRotatedDirection 0;
BA_ "EventCommandSignal" SG_ 394 BCS_FRWheelRotatedDirectionVD 0;
BA_ "GatewayedSignals" SG_ 394 BCS_FRWheelRotatedDirectionVD 0;
BA_ "GenSigInvalidValue" SG_ 394 BCS_FRWheelRotatedDirectionVD 0;
BA_ "GenSigSendType" SG_ 394 BCS_FRWheelRotatedDirectionVD 1;
BA_ "GenSigTimeoutValue" SG_ 394 BCS_FRWheelRotatedDirectionVD 0;
BA_ "EventCommandSignal" SG_ 394 BCS_FRWheelSpd 0;
BA_ "GatewayedSignals" SG_ 394 BCS_FRWheelSpd 0;
BA_ "GenSigInvalidValue" SG_ 394 BCS_FRWheelSpd 0;
BA_ "GenSigSendType" SG_ 394 BCS_FRWheelSpd 1;
BA_ "GenSigTimeoutValue" SG_ 394 BCS_FRWheelSpd 0;
BA_ "EventCommandSignal" SG_ 394 BCS_FRWheelSpdVD 0;
BA_ "GatewayedSignals" SG_ 394 BCS_FRWheelSpdVD 0;
BA_ "GenSigInvalidValue" SG_ 394 BCS_FRWheelSpdVD 0;
BA_ "GenSigSendType" SG_ 394 BCS_FRWheelSpdVD 1;
BA_ "GenSigTimeoutValue" SG_ 394 BCS_FRWheelSpdVD 0;
BA_ "EventCommandSignal" SG_ 394 BCS_RLWheelRotatedDirection 0;
BA_ "GatewayedSignals" SG_ 394 BCS_RLWheelRotatedDirection 0;
BA_ "GenSigInvalidValue" SG_ 394 BCS_RLWheelRotatedDirection 0;
BA_ "GenSigSendType" SG_ 394 BCS_RLWheelRotatedDirection 1;
BA_ "GenSigTimeoutValue" SG_ 394 BCS_RLWheelRotatedDirection 0;
BA_ "EventCommandSignal" SG_ 394 BCS_RLWheelRotatedDirectionVD 0;
BA_ "GatewayedSignals" SG_ 394 BCS_RLWheelRotatedDirectionVD 0;
BA_ "GenSigInvalidValue" SG_ 394 BCS_RLWheelRotatedDirectionVD 0;
BA_ "GenSigSendType" SG_ 394 BCS_RLWheelRotatedDirectionVD 1;
BA_ "GenSigTimeoutValue" SG_ 394 BCS_RLWheelRotatedDirectionVD 0;
BA_ "EventCommandSignal" SG_ 394 BCS_RLWheelSpd 0;
BA_ "GatewayedSignals" SG_ 394 BCS_RLWheelSpd 0;
BA_ "GenSigInvalidValue" SG_ 394 BCS_RLWheelSpd 0;
BA_ "GenSigSendType" SG_ 394 BCS_RLWheelSpd 1;
BA_ "GenSigTimeoutValue" SG_ 394 BCS_RLWheelSpd 0;
BA_ "EventCommandSignal" SG_ 394 BCS_RLWheelSpdVD 0;
BA_ "GatewayedSignals" SG_ 394 BCS_RLWheelSpdVD 0;
BA_ "GenSigInvalidValue" SG_ 394 BCS_RLWheelSpdVD 0;
BA_ "GenSigSendType" SG_ 394 BCS_RLWheelSpdVD 1;
BA_ "GenSigTimeoutValue" SG_ 394 BCS_RLWheelSpdVD 0;
BA_ "EventCommandSignal" SG_ 394 BCS_RRWheelRotatedDirection 0;
BA_ "GatewayedSignals" SG_ 394 BCS_RRWheelRotatedDirection 0;
BA_ "GenSigInvalidValue" SG_ 394 BCS_RRWheelRotatedDirection 0;
BA_ "GenSigSendType" SG_ 394 BCS_RRWheelRotatedDirection 1;
BA_ "GenSigTimeoutValue" SG_ 394 BCS_RRWheelRotatedDirection 0;
BA_ "EventCommandSignal" SG_ 394 BCS_RRWheelRotatedDirectionVD 0;
BA_ "GatewayedSignals" SG_ 394 BCS_RRWheelRotatedDirectionVD 0;
BA_ "GenSigInvalidValue" SG_ 394 BCS_RRWheelRotatedDirectionVD 0;
BA_ "GenSigSendType" SG_ 394 BCS_RRWheelRotatedDirectionVD 1;
BA_ "GenSigTimeoutValue" SG_ 394 BCS_RRWheelRotatedDirectionVD 0;
BA_ "EventCommandSignal" SG_ 394 BCS_RRWheelSpd 0;
BA_ "GatewayedSignals" SG_ 394 BCS_RRWheelSpd 0;
BA_ "GenSigInvalidValue" SG_ 394 BCS_RRWheelSpd 0;
BA_ "GenSigSendType" SG_ 394 BCS_RRWheelSpd 1;
BA_ "GenSigTimeoutValue" SG_ 394 BCS_RRWheelSpd 0;
BA_ "EventCommandSignal" SG_ 394 BCS_RRWheelSpdVD 0;
BA_ "GatewayedSignals" SG_ 394 BCS_RRWheelSpdVD 0;
BA_ "GenSigInvalidValue" SG_ 394 BCS_RRWheelSpdVD 0;
BA_ "GenSigSendType" SG_ 394 BCS_RRWheelSpdVD 1;
BA_ "GenSigTimeoutValue" SG_ 394 BCS_RRWheelSpdVD 0;
BA_ "EventCommandSignal" SG_ 394 BCS_YawRate 0;
BA_ "GatewayedSignals" SG_ 394 BCS_YawRate 0;
BA_ "GenSigInvalidValue" SG_ 394 BCS_YawRate 0;
BA_ "GenSigSendType" SG_ 394 BCS_YawRate 1;
BA_ "GenSigStartValue" SG_ 394 BCS_YawRate 2144;
BA_ "GenSigTimeoutValue" SG_ 394 BCS_YawRate 982;
BA_ "EventCommandSignal" SG_ 394 BCS_YawRateSt 0;
BA_ "GatewayedSignals" SG_ 394 BCS_YawRateSt 0;
BA_ "GenSigInvalidValue" SG_ 394 BCS_YawRateSt 0;
BA_ "GenSigSendType" SG_ 394 BCS_YawRateSt 1;
BA_ "GenSigTimeoutValue" SG_ 394 BCS_YawRateSt 0;
BA_ "EventCommandSignal" SG_ 513 RRR_BlockCounter 0;
BA_ "GatewayedSignals" SG_ 513 RRR_BlockCounter 0;
BA_ "GenSigInvalidValue" SG_ 513 RRR_BlockCounter 0;
BA_ "GenSigTimeoutValue" SG_ 513 RRR_BlockCounter 0;
BA_ "EventCommandSignal" SG_ 513 RRR_Moudulation_State 0;
BA_ "GatewayedSignals" SG_ 513 RRR_Moudulation_State 0;
BA_ "GenSigInvalidValue" SG_ 513 RRR_Moudulation_State 0;
BA_ "GenSigTimeoutValue" SG_ 513 RRR_Moudulation_State 0;
BA_ "EventCommandSignal" SG_ 513 RRR_Msg_AliveCounter 0;
BA_ "GatewayedSignals" SG_ 513 RRR_Msg_AliveCounter 0;
BA_ "GenSigInvalidValue" SG_ 513 RRR_Msg_AliveCounter 0;
BA_ "GenSigTimeoutValue" SG_ 513 RRR_Msg_AliveCounter 0;
BA_ "EventCommandSignal" SG_ 513 RRR_Msg_CheckSum 0;
BA_ "GatewayedSignals" SG_ 513 RRR_Msg_CheckSum 0;
BA_ "GenSigInvalidValue" SG_ 513 RRR_Msg_CheckSum 0;
BA_ "GenSigTimeoutValue" SG_ 513 RRR_Msg_CheckSum 0;
BA_ "IsCrcSignal" SG_ 513 RRR_Msg_CheckSum 1;
BA_ "EventCommandSignal" SG_ 513 RRR_Num_Of_Objects 0;
BA_ "GatewayedSignals" SG_ 513 RRR_Num_Of_Objects 0;
BA_ "GenSigInvalidValue" SG_ 513 RRR_Num_Of_Objects 0;
BA_ "GenSigTimeoutValue" SG_ 513 RRR_Num_Of_Objects 0;
BA_ "EventCommandSignal" SG_ 513 RRR_Object_Mea_timestamp_1 0;
BA_ "GatewayedSignals" SG_ 513 RRR_Object_Mea_timestamp_1 0;
BA_ "GenSigInvalidValue" SG_ 513 RRR_Object_Mea_timestamp_1 0;
BA_ "GenSigTimeoutValue" SG_ 513 RRR_Object_Mea_timestamp_1 0;
BA_ "EventCommandSignal" SG_ 513 RRR_Object_Mea_timestamp_2 0;
BA_ "GatewayedSignals" SG_ 513 RRR_Object_Mea_timestamp_2 0;
BA_ "GenSigInvalidValue" SG_ 513 RRR_Object_Mea_timestamp_2 0;
BA_ "GenSigTimeoutValue" SG_ 513 RRR_Object_Mea_timestamp_2 0;
BA_ "EventCommandSignal" SG_ 513 RRR_OperationMode 0;
BA_ "GatewayedSignals" SG_ 513 RRR_OperationMode 0;
BA_ "GenSigInvalidValue" SG_ 513 RRR_OperationMode 0;
BA_ "GenSigTimeoutValue" SG_ 513 RRR_OperationMode 0;
BA_ "EventCommandSignal" SG_ 513 RRR_SDA_HorzDeviationAngle_Can03 0;
BA_ "GatewayedSignals" SG_ 513 RRR_SDA_HorzDeviationAngle_Can03 0;
BA_ "GenSigInvalidValue" SG_ 513 RRR_SDA_HorzDeviationAngle_Can03 0;
BA_ "GenSigTimeoutValue" SG_ 513 RRR_SDA_HorzDeviationAngle_Can03 0;
BA_ "EventCommandSignal" SG_ 513 RRR_SDA_VertDeviationAngle_Can03 0;
BA_ "GatewayedSignals" SG_ 513 RRR_SDA_VertDeviationAngle_Can03 0;
BA_ "GenSigInvalidValue" SG_ 513 RRR_SDA_VertDeviationAngle_Can03 0;
BA_ "GenSigTimeoutValue" SG_ 513 RRR_SDA_VertDeviationAngle_Can03 0;
BA_ "EventCommandSignal" SG_ 513 RRR_SGUFail 0;
BA_ "GatewayedSignals" SG_ 513 RRR_SGUFail 0;
BA_ "GenSigInvalidValue" SG_ 513 RRR_SGUFail 0;
BA_ "GenSigTimeoutValue" SG_ 513 RRR_SGUFail 0;
BA_ "EventCommandSignal" SG_ 513 RRR_SensorType 0;
BA_ "GatewayedSignals" SG_ 513 RRR_SensorType 0;
BA_ "GenSigInvalidValue" SG_ 513 RRR_SensorType 0;
BA_ "GenSigTimeoutValue" SG_ 513 RRR_SensorType 0;
BA_ "EventCommandSignal" SG_ 513 RRR_Signal_Operatation_Channel 0;
BA_ "GatewayedSignals" SG_ 513 RRR_Signal_Operatation_Channel 0;
BA_ "GenSigInvalidValue" SG_ 513 RRR_Signal_Operatation_Channel 0;
BA_ "GenSigTimeoutValue" SG_ 513 RRR_Signal_Operatation_Channel 0;
BA_ "EventCommandSignal" SG_ 513 RRR_Signal_Operation_State 0;
BA_ "GatewayedSignals" SG_ 513 RRR_Signal_Operation_State 0;
BA_ "GenSigInvalidValue" SG_ 513 RRR_Signal_Operation_State 0;
BA_ "GenSigTimeoutValue" SG_ 513 RRR_Signal_Operation_State 0;
BA_ "EventCommandSignal" SG_ 513 RRR_TimeSync_Operatation_Channel 0;
BA_ "GatewayedSignals" SG_ 513 RRR_TimeSync_Operatation_Channel 0;
BA_ "GenSigInvalidValue" SG_ 513 RRR_TimeSync_Operatation_Channel 0;
BA_ "GenSigSendType" SG_ 513 RRR_TimeSync_Operatation_Channel 1;
BA_ "GenSigTimeoutValue" SG_ 513 RRR_TimeSync_Operatation_Channel 0;
BA_ "EventCommandSignal" SG_ 513 RRR_TimeSync_Operation_State 0;
BA_ "GatewayedSignals" SG_ 513 RRR_TimeSync_Operation_State 0;
BA_ "GenSigInvalidValue" SG_ 513 RRR_TimeSync_Operation_State 0;
BA_ "GenSigTimeoutValue" SG_ 513 RRR_TimeSync_Operation_State 0;
BA_ "EventCommandSignal" SG_ 513 RRR_TimerStampStatus 0;
BA_ "GatewayedSignals" SG_ 513 RRR_TimerStampStatus 0;
BA_ "GenSigInvalidValue" SG_ 513 RRR_TimerStampStatus 0;
BA_ "GenSigTimeoutValue" SG_ 513 RRR_TimerStampStatus 0;
BA_ "EventCommandSignal" SG_ 514 SGU1_BlockCounter 0;
BA_ "GatewayedSignals" SG_ 514 SGU1_BlockCounter 0;
BA_ "GenSigInvalidValue" SG_ 514 SGU1_BlockCounter 0;
BA_ "GenSigTimeoutValue" SG_ 514 SGU1_BlockCounter 0;
BA_ "EventCommandSignal" SG_ 514 SGU1_LifeCycles_OBJ 0;
BA_ "GatewayedSignals" SG_ 514 SGU1_LifeCycles_OBJ 0;
BA_ "GenSigInvalidValue" SG_ 514 SGU1_LifeCycles_OBJ 0;
BA_ "GenSigTimeoutValue" SG_ 514 SGU1_LifeCycles_OBJ 0;
BA_ "EventCommandSignal" SG_ 514 SGU1_Msg_AliveCounter 0;
BA_ "GatewayedSignals" SG_ 514 SGU1_Msg_AliveCounter 0;
BA_ "GenSigInvalidValue" SG_ 514 SGU1_Msg_AliveCounter 0;
BA_ "GenSigTimeoutValue" SG_ 514 SGU1_Msg_AliveCounter 0;
BA_ "EventCommandSignal" SG_ 514 SGU1_Msg_CheckSum 0;
BA_ "GatewayedSignals" SG_ 514 SGU1_Msg_CheckSum 0;
BA_ "GenSigInvalidValue" SG_ 514 SGU1_Msg_CheckSum 0;
BA_ "GenSigTimeoutValue" SG_ 514 SGU1_Msg_CheckSum 0;
BA_ "IsCrcSignal" SG_ 514 SGU1_Msg_CheckSum 1;
BA_ "EventCommandSignal" SG_ 514 SGU1_ObjRCS_01 0;
BA_ "GatewayedSignals" SG_ 514 SGU1_ObjRCS_01 0;
BA_ "GenSigInvalidValue" SG_ 514 SGU1_ObjRCS_01 0;
BA_ "GenSigTimeoutValue" SG_ 514 SGU1_ObjRCS_01 0;
BA_ "EventCommandSignal" SG_ 514 SGU1_Obj_DistLat_rms 0;
BA_ "GatewayedSignals" SG_ 514 SGU1_Obj_DistLat_rms 0;
BA_ "GenSigInvalidValue" SG_ 514 SGU1_Obj_DistLat_rms 0;
BA_ "GenSigTimeoutValue" SG_ 514 SGU1_Obj_DistLat_rms 0;
BA_ "EventCommandSignal" SG_ 514 SGU1_Obj_VrelLong_rms 0;
BA_ "GatewayedSignals" SG_ 514 SGU1_Obj_VrelLong_rms 0;
BA_ "GenSigInvalidValue" SG_ 514 SGU1_Obj_VrelLong_rms 0;
BA_ "GenSigTimeoutValue" SG_ 514 SGU1_Obj_VrelLong_rms 0;
BA_ "EventCommandSignal" SG_ 514 SGU1_Obj_Vrelat_rms 0;
BA_ "GatewayedSignals" SG_ 514 SGU1_Obj_Vrelat_rms 0;
BA_ "GenSigInvalidValue" SG_ 514 SGU1_Obj_Vrelat_rms 0;
BA_ "GenSigTimeoutValue" SG_ 514 SGU1_Obj_Vrelat_rms 0;
BA_ "EventCommandSignal" SG_ 514 SGU1_Object_DetStatus 0;
BA_ "GatewayedSignals" SG_ 514 SGU1_Object_DetStatus 0;
BA_ "GenSigInvalidValue" SG_ 514 SGU1_Object_DetStatus 0;
BA_ "GenSigTimeoutValue" SG_ 514 SGU1_Object_DetStatus 0;
BA_ "EventCommandSignal" SG_ 514 SGU1_Object_DistLong_rms 0;
BA_ "GatewayedSignals" SG_ 514 SGU1_Object_DistLong_rms 0;
BA_ "GenSigInvalidValue" SG_ 514 SGU1_Object_DistLong_rms 0;
BA_ "GenSigTimeoutValue" SG_ 514 SGU1_Object_DistLong_rms 0;
BA_ "EventCommandSignal" SG_ 514 SGU1_Object_ID 0;
BA_ "GatewayedSignals" SG_ 514 SGU1_Object_ID 0;
BA_ "GenSigInvalidValue" SG_ 514 SGU1_Object_ID 0;
BA_ "GenSigTimeoutValue" SG_ 514 SGU1_Object_ID 0;
BA_ "EventCommandSignal" SG_ 514 SGU1_Object_Motion_Pattern 0;
BA_ "GatewayedSignals" SG_ 514 SGU1_Object_Motion_Pattern 0;
BA_ "GenSigInvalidValue" SG_ 514 SGU1_Object_Motion_Pattern 0;
BA_ "GenSigTimeoutValue" SG_ 514 SGU1_Object_Motion_Pattern 0;
BA_ "EventCommandSignal" SG_ 514 SGU1_Object_Type 0;
BA_ "GatewayedSignals" SG_ 514 SGU1_Object_Type 0;
BA_ "GenSigInvalidValue" SG_ 514 SGU1_Object_Type 0;
BA_ "GenSigTimeoutValue" SG_ 514 SGU1_Object_Type 0;
BA_ "EventCommandSignal" SG_ 514 SGU1_Object_ax 0;
BA_ "GatewayedSignals" SG_ 514 SGU1_Object_ax 0;
BA_ "GenSigInvalidValue" SG_ 514 SGU1_Object_ax 0;
BA_ "GenSigTimeoutValue" SG_ 514 SGU1_Object_ax 0;
BA_ "EventCommandSignal" SG_ 514 SGU1_Object_ay 0;
BA_ "GatewayedSignals" SG_ 514 SGU1_Object_ay 0;
BA_ "GenSigInvalidValue" SG_ 514 SGU1_Object_ay 0;
BA_ "GenSigTimeoutValue" SG_ 514 SGU1_Object_ay 0;
BA_ "EventCommandSignal" SG_ 514 SGU1_Object_dx 0;
BA_ "GatewayedSignals" SG_ 514 SGU1_Object_dx 0;
BA_ "GenSigInvalidValue" SG_ 514 SGU1_Object_dx 0;
BA_ "GenSigTimeoutValue" SG_ 514 SGU1_Object_dx 0;
BA_ "EventCommandSignal" SG_ 514 SGU1_Object_dx_Rear 0;
BA_ "GatewayedSignals" SG_ 514 SGU1_Object_dx_Rear 0;
BA_ "GenSigInvalidValue" SG_ 514 SGU1_Object_dx_Rear 0;
BA_ "GenSigTimeoutValue" SG_ 514 SGU1_Object_dx_Rear 0;
BA_ "EventCommandSignal" SG_ 514 SGU1_Object_dy 0;
BA_ "GatewayedSignals" SG_ 514 SGU1_Object_dy 0;
BA_ "GenSigInvalidValue" SG_ 514 SGU1_Object_dy 0;
BA_ "GenSigTimeoutValue" SG_ 514 SGU1_Object_dy 0;
BA_ "EventCommandSignal" SG_ 514 SGU1_Object_dy_Rear 0;
BA_ "GatewayedSignals" SG_ 514 SGU1_Object_dy_Rear 0;
BA_ "GenSigInvalidValue" SG_ 514 SGU1_Object_dy_Rear 0;
BA_ "GenSigTimeoutValue" SG_ 514 SGU1_Object_dy_Rear 0;
BA_ "EventCommandSignal" SG_ 514 SGU1_Object_vx 0;
BA_ "GatewayedSignals" SG_ 514 SGU1_Object_vx 0;
BA_ "GenSigInvalidValue" SG_ 514 SGU1_Object_vx 0;
BA_ "GenSigTimeoutValue" SG_ 514 SGU1_Object_vx 0;
BA_ "EventCommandSignal" SG_ 514 SGU1_Object_vy 0;
BA_ "GatewayedSignals" SG_ 514 SGU1_Object_vy 0;
BA_ "GenSigInvalidValue" SG_ 514 SGU1_Object_vy 0;
BA_ "GenSigTimeoutValue" SG_ 514 SGU1_Object_vy 0;
BA_ "EventCommandSignal" SG_ 514 SGU1_Object_wExist 0;
BA_ "GatewayedSignals" SG_ 514 SGU1_Object_wExist 0;
BA_ "GenSigInvalidValue" SG_ 514 SGU1_Object_wExist 0;
BA_ "GenSigTimeoutValue" SG_ 514 SGU1_Object_wExist 0;
BA_ "EventCommandSignal" SG_ 514 SGU1_Object_wObstacle 0;
BA_ "GatewayedSignals" SG_ 514 SGU1_Object_wObstacle 0;
BA_ "GenSigInvalidValue" SG_ 514 SGU1_Object_wObstacle 0;
BA_ "GenSigTimeoutValue" SG_ 514 SGU1_Object_wObstacle 0;
BA_ "EventCommandSignal" SG_ 515 SGU2_BlockCounter 0;
BA_ "GatewayedSignals" SG_ 515 SGU2_BlockCounter 0;
BA_ "GenSigInvalidValue" SG_ 515 SGU2_BlockCounter 0;
BA_ "GenSigTimeoutValue" SG_ 515 SGU2_BlockCounter 0;
BA_ "EventCommandSignal" SG_ 515 SGU2_LifeCycles_OBJ 0;
BA_ "GatewayedSignals" SG_ 515 SGU2_LifeCycles_OBJ 0;
BA_ "GenSigInvalidValue" SG_ 515 SGU2_LifeCycles_OBJ 0;
BA_ "GenSigTimeoutValue" SG_ 515 SGU2_LifeCycles_OBJ 0;
BA_ "EventCommandSignal" SG_ 515 SGU2_Msg_AliveCounter 0;
BA_ "GatewayedSignals" SG_ 515 SGU2_Msg_AliveCounter 0;
BA_ "GenSigInvalidValue" SG_ 515 SGU2_Msg_AliveCounter 0;
BA_ "GenSigTimeoutValue" SG_ 515 SGU2_Msg_AliveCounter 0;
BA_ "EventCommandSignal" SG_ 515 SGU2_Msg_CheckSum 0;
BA_ "GatewayedSignals" SG_ 515 SGU2_Msg_CheckSum 0;
BA_ "GenSigInvalidValue" SG_ 515 SGU2_Msg_CheckSum 0;
BA_ "GenSigTimeoutValue" SG_ 515 SGU2_Msg_CheckSum 0;
BA_ "IsCrcSignal" SG_ 515 SGU2_Msg_CheckSum 1;
BA_ "EventCommandSignal" SG_ 515 SGU2_ObjRCS_02 0;
BA_ "GatewayedSignals" SG_ 515 SGU2_ObjRCS_02 0;
BA_ "GenSigInvalidValue" SG_ 515 SGU2_ObjRCS_02 0;
BA_ "GenSigTimeoutValue" SG_ 515 SGU2_ObjRCS_02 0;
BA_ "EventCommandSignal" SG_ 515 SGU2_Obj_DistLat_rms 0;
BA_ "GatewayedSignals" SG_ 515 SGU2_Obj_DistLat_rms 0;
BA_ "GenSigInvalidValue" SG_ 515 SGU2_Obj_DistLat_rms 0;
BA_ "GenSigTimeoutValue" SG_ 515 SGU2_Obj_DistLat_rms 0;
BA_ "EventCommandSignal" SG_ 515 SGU2_Obj_VrelLong_rms 0;
BA_ "GatewayedSignals" SG_ 515 SGU2_Obj_VrelLong_rms 0;
BA_ "GenSigInvalidValue" SG_ 515 SGU2_Obj_VrelLong_rms 0;
BA_ "GenSigTimeoutValue" SG_ 515 SGU2_Obj_VrelLong_rms 0;
BA_ "EventCommandSignal" SG_ 515 SGU2_Obj_Vrelat_rms 0;
BA_ "GatewayedSignals" SG_ 515 SGU2_Obj_Vrelat_rms 0;
BA_ "GenSigInvalidValue" SG_ 515 SGU2_Obj_Vrelat_rms 0;
BA_ "GenSigTimeoutValue" SG_ 515 SGU2_Obj_Vrelat_rms 0;
BA_ "EventCommandSignal" SG_ 515 SGU2_Object_DetStatus 0;
BA_ "GatewayedSignals" SG_ 515 SGU2_Object_DetStatus 0;
BA_ "GenSigInvalidValue" SG_ 515 SGU2_Object_DetStatus 0;
BA_ "GenSigTimeoutValue" SG_ 515 SGU2_Object_DetStatus 0;
BA_ "EventCommandSignal" SG_ 515 SGU2_Object_DistLong_rms 0;
BA_ "GatewayedSignals" SG_ 515 SGU2_Object_DistLong_rms 0;
BA_ "GenSigInvalidValue" SG_ 515 SGU2_Object_DistLong_rms 0;
BA_ "GenSigTimeoutValue" SG_ 515 SGU2_Object_DistLong_rms 0;
BA_ "EventCommandSignal" SG_ 515 SGU2_Object_ID 0;
BA_ "GatewayedSignals" SG_ 515 SGU2_Object_ID 0;
BA_ "GenSigInvalidValue" SG_ 515 SGU2_Object_ID 0;
BA_ "GenSigTimeoutValue" SG_ 515 SGU2_Object_ID 0;
BA_ "EventCommandSignal" SG_ 515 SGU2_Object_Motion_Pattern 0;
BA_ "GatewayedSignals" SG_ 515 SGU2_Object_Motion_Pattern 0;
BA_ "GenSigInvalidValue" SG_ 515 SGU2_Object_Motion_Pattern 0;
BA_ "GenSigTimeoutValue" SG_ 515 SGU2_Object_Motion_Pattern 0;
BA_ "EventCommandSignal" SG_ 515 SGU2_Object_Type 0;
BA_ "GatewayedSignals" SG_ 515 SGU2_Object_Type 0;
BA_ "GenSigInvalidValue" SG_ 515 SGU2_Object_Type 0;
BA_ "GenSigTimeoutValue" SG_ 515 SGU2_Object_Type 0;
BA_ "EventCommandSignal" SG_ 515 SGU2_Object_ax 0;
BA_ "GatewayedSignals" SG_ 515 SGU2_Object_ax 0;
BA_ "GenSigInvalidValue" SG_ 515 SGU2_Object_ax 0;
BA_ "GenSigTimeoutValue" SG_ 515 SGU2_Object_ax 0;
BA_ "EventCommandSignal" SG_ 515 SGU2_Object_ay 0;
BA_ "GatewayedSignals" SG_ 515 SGU2_Object_ay 0;
BA_ "GenSigInvalidValue" SG_ 515 SGU2_Object_ay 0;
BA_ "GenSigTimeoutValue" SG_ 515 SGU2_Object_ay 0;
BA_ "EventCommandSignal" SG_ 515 SGU2_Object_dx 0;
BA_ "GatewayedSignals" SG_ 515 SGU2_Object_dx 0;
BA_ "GenSigInvalidValue" SG_ 515 SGU2_Object_dx 0;
BA_ "GenSigTimeoutValue" SG_ 515 SGU2_Object_dx 0;
BA_ "EventCommandSignal" SG_ 515 SGU2_Object_dx_Rear 0;
BA_ "GatewayedSignals" SG_ 515 SGU2_Object_dx_Rear 0;
BA_ "GenSigInvalidValue" SG_ 515 SGU2_Object_dx_Rear 0;
BA_ "GenSigTimeoutValue" SG_ 515 SGU2_Object_dx_Rear 0;
BA_ "EventCommandSignal" SG_ 515 SGU2_Object_dy 0;
BA_ "GatewayedSignals" SG_ 515 SGU2_Object_dy 0;
BA_ "GenSigInvalidValue" SG_ 515 SGU2_Object_dy 0;
BA_ "GenSigTimeoutValue" SG_ 515 SGU2_Object_dy 0;
BA_ "EventCommandSignal" SG_ 515 SGU2_Object_dy_Rear 0;
BA_ "GatewayedSignals" SG_ 515 SGU2_Object_dy_Rear 0;
BA_ "GenSigInvalidValue" SG_ 515 SGU2_Object_dy_Rear 0;
BA_ "GenSigTimeoutValue" SG_ 515 SGU2_Object_dy_Rear 0;
BA_ "EventCommandSignal" SG_ 515 SGU2_Object_vx 0;
BA_ "GatewayedSignals" SG_ 515 SGU2_Object_vx 0;
BA_ "GenSigInvalidValue" SG_ 515 SGU2_Object_vx 0;
BA_ "GenSigTimeoutValue" SG_ 515 SGU2_Object_vx 0;
BA_ "EventCommandSignal" SG_ 515 SGU2_Object_vy 0;
BA_ "GatewayedSignals" SG_ 515 SGU2_Object_vy 0;
BA_ "GenSigInvalidValue" SG_ 515 SGU2_Object_vy 0;
BA_ "GenSigTimeoutValue" SG_ 515 SGU2_Object_vy 0;
BA_ "EventCommandSignal" SG_ 515 SGU2_Object_wExist 0;
BA_ "GatewayedSignals" SG_ 515 SGU2_Object_wExist 0;
BA_ "GenSigInvalidValue" SG_ 515 SGU2_Object_wExist 0;
BA_ "GenSigTimeoutValue" SG_ 515 SGU2_Object_wExist 0;
BA_ "EventCommandSignal" SG_ 515 SGU2_Object_wObstacle 0;
BA_ "GatewayedSignals" SG_ 515 SGU2_Object_wObstacle 0;
BA_ "GenSigInvalidValue" SG_ 515 SGU2_Object_wObstacle 0;
BA_ "GenSigTimeoutValue" SG_ 515 SGU2_Object_wObstacle 0;
BA_ "EventCommandSignal" SG_ 516 SGU3_BlockCounter 0;
BA_ "GatewayedSignals" SG_ 516 SGU3_BlockCounter 0;
BA_ "GenSigInvalidValue" SG_ 516 SGU3_BlockCounter 0;
BA_ "GenSigTimeoutValue" SG_ 516 SGU3_BlockCounter 0;
BA_ "EventCommandSignal" SG_ 516 SGU3_LifeCycles_OBJ 0;
BA_ "GatewayedSignals" SG_ 516 SGU3_LifeCycles_OBJ 0;
BA_ "GenSigInvalidValue" SG_ 516 SGU3_LifeCycles_OBJ 0;
BA_ "GenSigTimeoutValue" SG_ 516 SGU3_LifeCycles_OBJ 0;
BA_ "EventCommandSignal" SG_ 516 SGU3_Msg_AliveCounter 0;
BA_ "GatewayedSignals" SG_ 516 SGU3_Msg_AliveCounter 0;
BA_ "GenSigInvalidValue" SG_ 516 SGU3_Msg_AliveCounter 0;
BA_ "GenSigTimeoutValue" SG_ 516 SGU3_Msg_AliveCounter 0;
BA_ "EventCommandSignal" SG_ 516 SGU3_Msg_CheckSum 0;
BA_ "GatewayedSignals" SG_ 516 SGU3_Msg_CheckSum 0;
BA_ "GenSigInvalidValue" SG_ 516 SGU3_Msg_CheckSum 0;
BA_ "GenSigTimeoutValue" SG_ 516 SGU3_Msg_CheckSum 0;
BA_ "IsCrcSignal" SG_ 516 SGU3_Msg_CheckSum 1;
BA_ "EventCommandSignal" SG_ 516 SGU3_ObjRCS_03 0;
BA_ "GatewayedSignals" SG_ 516 SGU3_ObjRCS_03 0;
BA_ "GenSigInvalidValue" SG_ 516 SGU3_ObjRCS_03 0;
BA_ "GenSigTimeoutValue" SG_ 516 SGU3_ObjRCS_03 0;
BA_ "EventCommandSignal" SG_ 516 SGU3_Obj_DistLat_rms 0;
BA_ "GatewayedSignals" SG_ 516 SGU3_Obj_DistLat_rms 0;
BA_ "GenSigInvalidValue" SG_ 516 SGU3_Obj_DistLat_rms 0;
BA_ "GenSigTimeoutValue" SG_ 516 SGU3_Obj_DistLat_rms 0;
BA_ "EventCommandSignal" SG_ 516 SGU3_Obj_VrelLong_rms 0;
BA_ "GatewayedSignals" SG_ 516 SGU3_Obj_VrelLong_rms 0;
BA_ "GenSigInvalidValue" SG_ 516 SGU3_Obj_VrelLong_rms 0;
BA_ "GenSigTimeoutValue" SG_ 516 SGU3_Obj_VrelLong_rms 0;
BA_ "EventCommandSignal" SG_ 516 SGU3_Obj_Vrelat_rms 0;
BA_ "GatewayedSignals" SG_ 516 SGU3_Obj_Vrelat_rms 0;
BA_ "GenSigInvalidValue" SG_ 516 SGU3_Obj_Vrelat_rms 0;
BA_ "GenSigTimeoutValue" SG_ 516 SGU3_Obj_Vrelat_rms 0;
BA_ "EventCommandSignal" SG_ 516 SGU3_Object_DetStatus 0;
BA_ "GatewayedSignals" SG_ 516 SGU3_Object_DetStatus 0;
BA_ "GenSigInvalidValue" SG_ 516 SGU3_Object_DetStatus 0;
BA_ "GenSigTimeoutValue" SG_ 516 SGU3_Object_DetStatus 0;
BA_ "EventCommandSignal" SG_ 516 SGU3_Object_DistLong_rms 0;
BA_ "GatewayedSignals" SG_ 516 SGU3_Object_DistLong_rms 0;
BA_ "GenSigInvalidValue" SG_ 516 SGU3_Object_DistLong_rms 0;
BA_ "GenSigTimeoutValue" SG_ 516 SGU3_Object_DistLong_rms 0;
BA_ "EventCommandSignal" SG_ 516 SGU3_Object_ID 0;
BA_ "GatewayedSignals" SG_ 516 SGU3_Object_ID 0;
BA_ "GenSigInvalidValue" SG_ 516 SGU3_Object_ID 0;
BA_ "GenSigTimeoutValue" SG_ 516 SGU3_Object_ID 0;
BA_ "EventCommandSignal" SG_ 516 SGU3_Object_Motion_Pattern 0;
BA_ "GatewayedSignals" SG_ 516 SGU3_Object_Motion_Pattern 0;
BA_ "GenSigInvalidValue" SG_ 516 SGU3_Object_Motion_Pattern 0;
BA_ "GenSigTimeoutValue" SG_ 516 SGU3_Object_Motion_Pattern 0;
BA_ "EventCommandSignal" SG_ 516 SGU3_Object_Type 0;
BA_ "GatewayedSignals" SG_ 516 SGU3_Object_Type 0;
BA_ "GenSigInvalidValue" SG_ 516 SGU3_Object_Type 0;
BA_ "GenSigTimeoutValue" SG_ 516 SGU3_Object_Type 0;
BA_ "EventCommandSignal" SG_ 516 SGU3_Object_ax 0;
BA_ "GatewayedSignals" SG_ 516 SGU3_Object_ax 0;
BA_ "GenSigInvalidValue" SG_ 516 SGU3_Object_ax 0;
BA_ "GenSigTimeoutValue" SG_ 516 SGU3_Object_ax 0;
BA_ "EventCommandSignal" SG_ 516 SGU3_Object_ay 0;
BA_ "GatewayedSignals" SG_ 516 SGU3_Object_ay 0;
BA_ "GenSigInvalidValue" SG_ 516 SGU3_Object_ay 0;
BA_ "GenSigTimeoutValue" SG_ 516 SGU3_Object_ay 0;
BA_ "EventCommandSignal" SG_ 516 SGU3_Object_dx 0;
BA_ "GatewayedSignals" SG_ 516 SGU3_Object_dx 0;
BA_ "GenSigInvalidValue" SG_ 516 SGU3_Object_dx 0;
BA_ "GenSigTimeoutValue" SG_ 516 SGU3_Object_dx 0;
BA_ "EventCommandSignal" SG_ 516 SGU3_Object_dx_Rear 0;
BA_ "GatewayedSignals" SG_ 516 SGU3_Object_dx_Rear 0;
BA_ "GenSigInvalidValue" SG_ 516 SGU3_Object_dx_Rear 0;
BA_ "GenSigTimeoutValue" SG_ 516 SGU3_Object_dx_Rear 0;
BA_ "EventCommandSignal" SG_ 516 SGU3_Object_dy 0;
BA_ "GatewayedSignals" SG_ 516 SGU3_Object_dy 0;
BA_ "GenSigInvalidValue" SG_ 516 SGU3_Object_dy 0;
BA_ "GenSigTimeoutValue" SG_ 516 SGU3_Object_dy 0;
BA_ "EventCommandSignal" SG_ 516 SGU3_Object_dy_Rear 0;
BA_ "GatewayedSignals" SG_ 516 SGU3_Object_dy_Rear 0;
BA_ "GenSigInvalidValue" SG_ 516 SGU3_Object_dy_Rear 0;
BA_ "GenSigTimeoutValue" SG_ 516 SGU3_Object_dy_Rear 0;
BA_ "EventCommandSignal" SG_ 516 SGU3_Object_vx 0;
BA_ "GatewayedSignals" SG_ 516 SGU3_Object_vx 0;
BA_ "GenSigInvalidValue" SG_ 516 SGU3_Object_vx 0;
BA_ "GenSigTimeoutValue" SG_ 516 SGU3_Object_vx 0;
BA_ "EventCommandSignal" SG_ 516 SGU3_Object_vy 0;
BA_ "GatewayedSignals" SG_ 516 SGU3_Object_vy 0;
BA_ "GenSigInvalidValue" SG_ 516 SGU3_Object_vy 0;
BA_ "GenSigTimeoutValue" SG_ 516 SGU3_Object_vy 0;
BA_ "EventCommandSignal" SG_ 516 SGU3_Object_wExist 0;
BA_ "GatewayedSignals" SG_ 516 SGU3_Object_wExist 0;
BA_ "GenSigInvalidValue" SG_ 516 SGU3_Object_wExist 0;
BA_ "GenSigTimeoutValue" SG_ 516 SGU3_Object_wExist 0;
BA_ "EventCommandSignal" SG_ 516 SGU3_Object_wObstacle 0;
BA_ "GatewayedSignals" SG_ 516 SGU3_Object_wObstacle 0;
BA_ "GenSigInvalidValue" SG_ 516 SGU3_Object_wObstacle 0;
BA_ "GenSigTimeoutValue" SG_ 516 SGU3_Object_wObstacle 0;
BA_ "EventCommandSignal" SG_ 517 SGU4_BlockCounter 0;
BA_ "GatewayedSignals" SG_ 517 SGU4_BlockCounter 0;
BA_ "GenSigInvalidValue" SG_ 517 SGU4_BlockCounter 0;
BA_ "GenSigTimeoutValue" SG_ 517 SGU4_BlockCounter 0;
BA_ "EventCommandSignal" SG_ 517 SGU4_LifeCycles_OBJ 0;
BA_ "GatewayedSignals" SG_ 517 SGU4_LifeCycles_OBJ 0;
BA_ "GenSigInvalidValue" SG_ 517 SGU4_LifeCycles_OBJ 0;
BA_ "GenSigTimeoutValue" SG_ 517 SGU4_LifeCycles_OBJ 0;
BA_ "EventCommandSignal" SG_ 517 SGU4_Msg_AliveCounter 0;
BA_ "GatewayedSignals" SG_ 517 SGU4_Msg_AliveCounter 0;
BA_ "GenSigInvalidValue" SG_ 517 SGU4_Msg_AliveCounter 0;
BA_ "GenSigTimeoutValue" SG_ 517 SGU4_Msg_AliveCounter 0;
BA_ "EventCommandSignal" SG_ 517 SGU4_Msg_CheckSum 0;
BA_ "GatewayedSignals" SG_ 517 SGU4_Msg_CheckSum 0;
BA_ "GenSigInvalidValue" SG_ 517 SGU4_Msg_CheckSum 0;
BA_ "GenSigTimeoutValue" SG_ 517 SGU4_Msg_CheckSum 0;
BA_ "IsCrcSignal" SG_ 517 SGU4_Msg_CheckSum 1;
BA_ "EventCommandSignal" SG_ 517 SGU4_ObjRCS_04 0;
BA_ "GatewayedSignals" SG_ 517 SGU4_ObjRCS_04 0;
BA_ "GenSigInvalidValue" SG_ 517 SGU4_ObjRCS_04 0;
BA_ "GenSigTimeoutValue" SG_ 517 SGU4_ObjRCS_04 0;
BA_ "EventCommandSignal" SG_ 517 SGU4_Obj_DistLat_rms 0;
BA_ "GatewayedSignals" SG_ 517 SGU4_Obj_DistLat_rms 0;
BA_ "GenSigInvalidValue" SG_ 517 SGU4_Obj_DistLat_rms 0;
BA_ "GenSigTimeoutValue" SG_ 517 SGU4_Obj_DistLat_rms 0;
BA_ "EventCommandSignal" SG_ 517 SGU4_Obj_VrelLong_rms 0;
BA_ "GatewayedSignals" SG_ 517 SGU4_Obj_VrelLong_rms 0;
BA_ "GenSigInvalidValue" SG_ 517 SGU4_Obj_VrelLong_rms 0;
BA_ "GenSigTimeoutValue" SG_ 517 SGU4_Obj_VrelLong_rms 0;
BA_ "EventCommandSignal" SG_ 517 SGU4_Obj_Vrelat_rms 0;
BA_ "GatewayedSignals" SG_ 517 SGU4_Obj_Vrelat_rms 0;
BA_ "GenSigInvalidValue" SG_ 517 SGU4_Obj_Vrelat_rms 0;
BA_ "GenSigTimeoutValue" SG_ 517 SGU4_Obj_Vrelat_rms 0;
BA_ "EventCommandSignal" SG_ 517 SGU4_Object_DetStatus 0;
BA_ "GatewayedSignals" SG_ 517 SGU4_Object_DetStatus 0;
BA_ "GenSigInvalidValue" SG_ 517 SGU4_Object_DetStatus 0;
BA_ "GenSigTimeoutValue" SG_ 517 SGU4_Object_DetStatus 0;
BA_ "EventCommandSignal" SG_ 517 SGU4_Object_DistLong_rms 0;
BA_ "GatewayedSignals" SG_ 517 SGU4_Object_DistLong_rms 0;
BA_ "GenSigInvalidValue" SG_ 517 SGU4_Object_DistLong_rms 0;
BA_ "GenSigTimeoutValue" SG_ 517 SGU4_Object_DistLong_rms 0;
BA_ "EventCommandSignal" SG_ 517 SGU4_Object_ID 0;
BA_ "GatewayedSignals" SG_ 517 SGU4_Object_ID 0;
BA_ "GenSigInvalidValue" SG_ 517 SGU4_Object_ID 0;
BA_ "GenSigTimeoutValue" SG_ 517 SGU4_Object_ID 0;
BA_ "EventCommandSignal" SG_ 517 SGU4_Object_Motion_Pattern 0;
BA_ "GatewayedSignals" SG_ 517 SGU4_Object_Motion_Pattern 0;
BA_ "GenSigInvalidValue" SG_ 517 SGU4_Object_Motion_Pattern 0;
BA_ "GenSigTimeoutValue" SG_ 517 SGU4_Object_Motion_Pattern 0;
BA_ "EventCommandSignal" SG_ 517 SGU4_Object_Type 0;
BA_ "GatewayedSignals" SG_ 517 SGU4_Object_Type 0;
BA_ "GenSigInvalidValue" SG_ 517 SGU4_Object_Type 0;
BA_ "GenSigTimeoutValue" SG_ 517 SGU4_Object_Type 0;
BA_ "EventCommandSignal" SG_ 517 SGU4_Object_ax 0;
BA_ "GatewayedSignals" SG_ 517 SGU4_Object_ax 0;
BA_ "GenSigInvalidValue" SG_ 517 SGU4_Object_ax 0;
BA_ "GenSigTimeoutValue" SG_ 517 SGU4_Object_ax 0;
BA_ "EventCommandSignal" SG_ 517 SGU4_Object_ay 0;
BA_ "GatewayedSignals" SG_ 517 SGU4_Object_ay 0;
BA_ "GenSigInvalidValue" SG_ 517 SGU4_Object_ay 0;
BA_ "GenSigTimeoutValue" SG_ 517 SGU4_Object_ay 0;
BA_ "EventCommandSignal" SG_ 517 SGU4_Object_dx 0;
BA_ "GatewayedSignals" SG_ 517 SGU4_Object_dx 0;
BA_ "GenSigInvalidValue" SG_ 517 SGU4_Object_dx 0;
BA_ "GenSigTimeoutValue" SG_ 517 SGU4_Object_dx 0;
BA_ "EventCommandSignal" SG_ 517 SGU4_Object_dx_Rear 0;
BA_ "GatewayedSignals" SG_ 517 SGU4_Object_dx_Rear 0;
BA_ "GenSigInvalidValue" SG_ 517 SGU4_Object_dx_Rear 0;
BA_ "GenSigTimeoutValue" SG_ 517 SGU4_Object_dx_Rear 0;
BA_ "EventCommandSignal" SG_ 517 SGU4_Object_dy 0;
BA_ "GatewayedSignals" SG_ 517 SGU4_Object_dy 0;
BA_ "GenSigInvalidValue" SG_ 517 SGU4_Object_dy 0;
BA_ "GenSigTimeoutValue" SG_ 517 SGU4_Object_dy 0;
BA_ "EventCommandSignal" SG_ 517 SGU4_Object_dy_Rear 0;
BA_ "GatewayedSignals" SG_ 517 SGU4_Object_dy_Rear 0;
BA_ "GenSigInvalidValue" SG_ 517 SGU4_Object_dy_Rear 0;
BA_ "GenSigTimeoutValue" SG_ 517 SGU4_Object_dy_Rear 0;
BA_ "EventCommandSignal" SG_ 517 SGU4_Object_vx 0;
BA_ "GatewayedSignals" SG_ 517 SGU4_Object_vx 0;
BA_ "GenSigInvalidValue" SG_ 517 SGU4_Object_vx 0;
BA_ "GenSigTimeoutValue" SG_ 517 SGU4_Object_vx 0;
BA_ "EventCommandSignal" SG_ 517 SGU4_Object_vy 0;
BA_ "GatewayedSignals" SG_ 517 SGU4_Object_vy 0;
BA_ "GenSigInvalidValue" SG_ 517 SGU4_Object_vy 0;
BA_ "GenSigTimeoutValue" SG_ 517 SGU4_Object_vy 0;
BA_ "EventCommandSignal" SG_ 517 SGU4_Object_wExist 0;
BA_ "GatewayedSignals" SG_ 517 SGU4_Object_wExist 0;
BA_ "GenSigInvalidValue" SG_ 517 SGU4_Object_wExist 0;
BA_ "GenSigTimeoutValue" SG_ 517 SGU4_Object_wExist 0;
BA_ "EventCommandSignal" SG_ 517 SGU4_Object_wObstacle 0;
BA_ "GatewayedSignals" SG_ 517 SGU4_Object_wObstacle 0;
BA_ "GenSigInvalidValue" SG_ 517 SGU4_Object_wObstacle 0;
BA_ "GenSigTimeoutValue" SG_ 517 SGU4_Object_wObstacle 0;
BA_ "EventCommandSignal" SG_ 518 SGU5_BlockCounter 0;
BA_ "GatewayedSignals" SG_ 518 SGU5_BlockCounter 0;
BA_ "GenSigInvalidValue" SG_ 518 SGU5_BlockCounter 0;
BA_ "GenSigTimeoutValue" SG_ 518 SGU5_BlockCounter 0;
BA_ "EventCommandSignal" SG_ 518 SGU5_LifeCycles_OBJ 0;
BA_ "GatewayedSignals" SG_ 518 SGU5_LifeCycles_OBJ 0;
BA_ "GenSigInvalidValue" SG_ 518 SGU5_LifeCycles_OBJ 0;
BA_ "GenSigTimeoutValue" SG_ 518 SGU5_LifeCycles_OBJ 0;
BA_ "EventCommandSignal" SG_ 518 SGU5_Msg_AliveCounter 0;
BA_ "GatewayedSignals" SG_ 518 SGU5_Msg_AliveCounter 0;
BA_ "GenSigInvalidValue" SG_ 518 SGU5_Msg_AliveCounter 0;
BA_ "GenSigTimeoutValue" SG_ 518 SGU5_Msg_AliveCounter 0;
BA_ "EventCommandSignal" SG_ 518 SGU5_Msg_CheckSum 0;
BA_ "GatewayedSignals" SG_ 518 SGU5_Msg_CheckSum 0;
BA_ "GenSigInvalidValue" SG_ 518 SGU5_Msg_CheckSum 0;
BA_ "GenSigTimeoutValue" SG_ 518 SGU5_Msg_CheckSum 0;
BA_ "IsCrcSignal" SG_ 518 SGU5_Msg_CheckSum 1;
BA_ "EventCommandSignal" SG_ 518 SGU5_ObjRCS_05 0;
BA_ "GatewayedSignals" SG_ 518 SGU5_ObjRCS_05 0;
BA_ "GenSigInvalidValue" SG_ 518 SGU5_ObjRCS_05 0;
BA_ "GenSigTimeoutValue" SG_ 518 SGU5_ObjRCS_05 0;
BA_ "EventCommandSignal" SG_ 518 SGU5_Obj_DistLat_rms 0;
BA_ "GatewayedSignals" SG_ 518 SGU5_Obj_DistLat_rms 0;
BA_ "GenSigInvalidValue" SG_ 518 SGU5_Obj_DistLat_rms 0;
BA_ "GenSigTimeoutValue" SG_ 518 SGU5_Obj_DistLat_rms 0;
BA_ "EventCommandSignal" SG_ 518 SGU5_Obj_VrelLong_rms 0;
BA_ "GatewayedSignals" SG_ 518 SGU5_Obj_VrelLong_rms 0;
BA_ "GenSigInvalidValue" SG_ 518 SGU5_Obj_VrelLong_rms 0;
BA_ "GenSigTimeoutValue" SG_ 518 SGU5_Obj_VrelLong_rms 0;
BA_ "EventCommandSignal" SG_ 518 SGU5_Obj_Vrelat_rms 0;
BA_ "GatewayedSignals" SG_ 518 SGU5_Obj_Vrelat_rms 0;
BA_ "GenSigInvalidValue" SG_ 518 SGU5_Obj_Vrelat_rms 0;
BA_ "GenSigTimeoutValue" SG_ 518 SGU5_Obj_Vrelat_rms 0;
BA_ "EventCommandSignal" SG_ 518 SGU5_Object_DetStatus 0;
BA_ "GatewayedSignals" SG_ 518 SGU5_Object_DetStatus 0;
BA_ "GenSigInvalidValue" SG_ 518 SGU5_Object_DetStatus 0;
BA_ "GenSigTimeoutValue" SG_ 518 SGU5_Object_DetStatus 0;
BA_ "EventCommandSignal" SG_ 518 SGU5_Object_DistLong_rms 0;
BA_ "GatewayedSignals" SG_ 518 SGU5_Object_DistLong_rms 0;
BA_ "GenSigInvalidValue" SG_ 518 SGU5_Object_DistLong_rms 0;
BA_ "GenSigTimeoutValue" SG_ 518 SGU5_Object_DistLong_rms 0;
BA_ "EventCommandSignal" SG_ 518 SGU5_Object_ID 0;
BA_ "GatewayedSignals" SG_ 518 SGU5_Object_ID 0;
BA_ "GenSigInvalidValue" SG_ 518 SGU5_Object_ID 0;
BA_ "GenSigTimeoutValue" SG_ 518 SGU5_Object_ID 0;
BA_ "EventCommandSignal" SG_ 518 SGU5_Object_Motion_Pattern 0;
BA_ "GatewayedSignals" SG_ 518 SGU5_Object_Motion_Pattern 0;
BA_ "GenSigInvalidValue" SG_ 518 SGU5_Object_Motion_Pattern 0;
BA_ "GenSigTimeoutValue" SG_ 518 SGU5_Object_Motion_Pattern 0;
BA_ "EventCommandSignal" SG_ 518 SGU5_Object_Type 0;
BA_ "GatewayedSignals" SG_ 518 SGU5_Object_Type 0;
BA_ "GenSigInvalidValue" SG_ 518 SGU5_Object_Type 0;
BA_ "GenSigTimeoutValue" SG_ 518 SGU5_Object_Type 0;
BA_ "EventCommandSignal" SG_ 518 SGU5_Object_ax 0;
BA_ "GatewayedSignals" SG_ 518 SGU5_Object_ax 0;
BA_ "GenSigInvalidValue" SG_ 518 SGU5_Object_ax 0;
BA_ "GenSigTimeoutValue" SG_ 518 SGU5_Object_ax 0;
BA_ "EventCommandSignal" SG_ 518 SGU5_Object_ay 0;
BA_ "GatewayedSignals" SG_ 518 SGU5_Object_ay 0;
BA_ "GenSigInvalidValue" SG_ 518 SGU5_Object_ay 0;
BA_ "GenSigTimeoutValue" SG_ 518 SGU5_Object_ay 0;
BA_ "EventCommandSignal" SG_ 518 SGU5_Object_dx 0;
BA_ "GatewayedSignals" SG_ 518 SGU5_Object_dx 0;
BA_ "GenSigInvalidValue" SG_ 518 SGU5_Object_dx 0;
BA_ "GenSigTimeoutValue" SG_ 518 SGU5_Object_dx 0;
BA_ "EventCommandSignal" SG_ 518 SGU5_Object_dx_Rear 0;
BA_ "GatewayedSignals" SG_ 518 SGU5_Object_dx_Rear 0;
BA_ "GenSigInvalidValue" SG_ 518 SGU5_Object_dx_Rear 0;
BA_ "GenSigTimeoutValue" SG_ 518 SGU5_Object_dx_Rear 0;
BA_ "EventCommandSignal" SG_ 518 SGU5_Object_dy 0;
BA_ "GatewayedSignals" SG_ 518 SGU5_Object_dy 0;
BA_ "GenSigInvalidValue" SG_ 518 SGU5_Object_dy 0;
BA_ "GenSigTimeoutValue" SG_ 518 SGU5_Object_dy 0;
BA_ "EventCommandSignal" SG_ 518 SGU5_Object_dy_Rear 0;
BA_ "GatewayedSignals" SG_ 518 SGU5_Object_dy_Rear 0;
BA_ "GenSigInvalidValue" SG_ 518 SGU5_Object_dy_Rear 0;
BA_ "GenSigTimeoutValue" SG_ 518 SGU5_Object_dy_Rear 0;
BA_ "EventCommandSignal" SG_ 518 SGU5_Object_vx 0;
BA_ "GatewayedSignals" SG_ 518 SGU5_Object_vx 0;
BA_ "GenSigInvalidValue" SG_ 518 SGU5_Object_vx 0;
BA_ "GenSigTimeoutValue" SG_ 518 SGU5_Object_vx 0;
BA_ "EventCommandSignal" SG_ 518 SGU5_Object_vy 0;
BA_ "GatewayedSignals" SG_ 518 SGU5_Object_vy 0;
BA_ "GenSigInvalidValue" SG_ 518 SGU5_Object_vy 0;
BA_ "GenSigTimeoutValue" SG_ 518 SGU5_Object_vy 0;
BA_ "EventCommandSignal" SG_ 518 SGU5_Object_wExist 0;
BA_ "GatewayedSignals" SG_ 518 SGU5_Object_wExist 0;
BA_ "GenSigInvalidValue" SG_ 518 SGU5_Object_wExist 0;
BA_ "GenSigTimeoutValue" SG_ 518 SGU5_Object_wExist 0;
BA_ "EventCommandSignal" SG_ 518 SGU5_Object_wObstacle 0;
BA_ "GatewayedSignals" SG_ 518 SGU5_Object_wObstacle 0;
BA_ "GenSigInvalidValue" SG_ 518 SGU5_Object_wObstacle 0;
BA_ "GenSigTimeoutValue" SG_ 518 SGU5_Object_wObstacle 0;
BA_ "EventCommandSignal" SG_ 519 SGU6_BlockCounter 0;
BA_ "GatewayedSignals" SG_ 519 SGU6_BlockCounter 0;
BA_ "GenSigInvalidValue" SG_ 519 SGU6_BlockCounter 0;
BA_ "GenSigTimeoutValue" SG_ 519 SGU6_BlockCounter 0;
BA_ "EventCommandSignal" SG_ 519 SGU6_LifeCycles_OBJ 0;
BA_ "GatewayedSignals" SG_ 519 SGU6_LifeCycles_OBJ 0;
BA_ "GenSigInvalidValue" SG_ 519 SGU6_LifeCycles_OBJ 0;
BA_ "GenSigTimeoutValue" SG_ 519 SGU6_LifeCycles_OBJ 0;
BA_ "EventCommandSignal" SG_ 519 SGU6_Msg_AliveCounter 0;
BA_ "GatewayedSignals" SG_ 519 SGU6_Msg_AliveCounter 0;
BA_ "GenSigInvalidValue" SG_ 519 SGU6_Msg_AliveCounter 0;
BA_ "GenSigTimeoutValue" SG_ 519 SGU6_Msg_AliveCounter 0;
BA_ "EventCommandSignal" SG_ 519 SGU6_Msg_CheckSum 0;
BA_ "GatewayedSignals" SG_ 519 SGU6_Msg_CheckSum 0;
BA_ "GenSigInvalidValue" SG_ 519 SGU6_Msg_CheckSum 0;
BA_ "GenSigTimeoutValue" SG_ 519 SGU6_Msg_CheckSum 0;
BA_ "IsCrcSignal" SG_ 519 SGU6_Msg_CheckSum 1;
BA_ "EventCommandSignal" SG_ 519 SGU6_ObjRCS_06 0;
BA_ "GatewayedSignals" SG_ 519 SGU6_ObjRCS_06 0;
BA_ "GenSigInvalidValue" SG_ 519 SGU6_ObjRCS_06 0;
BA_ "GenSigTimeoutValue" SG_ 519 SGU6_ObjRCS_06 0;
BA_ "EventCommandSignal" SG_ 519 SGU6_Obj_DistLat_rms 0;
BA_ "GatewayedSignals" SG_ 519 SGU6_Obj_DistLat_rms 0;
BA_ "GenSigInvalidValue" SG_ 519 SGU6_Obj_DistLat_rms 0;
BA_ "GenSigTimeoutValue" SG_ 519 SGU6_Obj_DistLat_rms 0;
BA_ "EventCommandSignal" SG_ 519 SGU6_Obj_VrelLong_rms 0;
BA_ "GatewayedSignals" SG_ 519 SGU6_Obj_VrelLong_rms 0;
BA_ "GenSigInvalidValue" SG_ 519 SGU6_Obj_VrelLong_rms 0;
BA_ "GenSigTimeoutValue" SG_ 519 SGU6_Obj_VrelLong_rms 0;
BA_ "EventCommandSignal" SG_ 519 SGU6_Obj_Vrelat_rms 0;
BA_ "GatewayedSignals" SG_ 519 SGU6_Obj_Vrelat_rms 0;
BA_ "GenSigInvalidValue" SG_ 519 SGU6_Obj_Vrelat_rms 0;
BA_ "GenSigTimeoutValue" SG_ 519 SGU6_Obj_Vrelat_rms 0;
BA_ "EventCommandSignal" SG_ 519 SGU6_Object_DetStatus 0;
BA_ "GatewayedSignals" SG_ 519 SGU6_Object_DetStatus 0;
BA_ "GenSigInvalidValue" SG_ 519 SGU6_Object_DetStatus 0;
BA_ "GenSigTimeoutValue" SG_ 519 SGU6_Object_DetStatus 0;
BA_ "EventCommandSignal" SG_ 519 SGU6_Object_DistLong_rms 0;
BA_ "GatewayedSignals" SG_ 519 SGU6_Object_DistLong_rms 0;
BA_ "GenSigInvalidValue" SG_ 519 SGU6_Object_DistLong_rms 0;
BA_ "GenSigTimeoutValue" SG_ 519 SGU6_Object_DistLong_rms 0;
BA_ "EventCommandSignal" SG_ 519 SGU6_Object_ID 0;
BA_ "GatewayedSignals" SG_ 519 SGU6_Object_ID 0;
BA_ "GenSigInvalidValue" SG_ 519 SGU6_Object_ID 0;
BA_ "GenSigTimeoutValue" SG_ 519 SGU6_Object_ID 0;
BA_ "EventCommandSignal" SG_ 519 SGU6_Object_Motion_Pattern 0;
BA_ "GatewayedSignals" SG_ 519 SGU6_Object_Motion_Pattern 0;
BA_ "GenSigInvalidValue" SG_ 519 SGU6_Object_Motion_Pattern 0;
BA_ "GenSigTimeoutValue" SG_ 519 SGU6_Object_Motion_Pattern 0;
BA_ "EventCommandSignal" SG_ 519 SGU6_Object_Type 0;
BA_ "GatewayedSignals" SG_ 519 SGU6_Object_Type 0;
BA_ "GenSigInvalidValue" SG_ 519 SGU6_Object_Type 0;
BA_ "GenSigTimeoutValue" SG_ 519 SGU6_Object_Type 0;
BA_ "EventCommandSignal" SG_ 519 SGU6_Object_ax 0;
BA_ "GatewayedSignals" SG_ 519 SGU6_Object_ax 0;
BA_ "GenSigInvalidValue" SG_ 519 SGU6_Object_ax 0;
BA_ "GenSigTimeoutValue" SG_ 519 SGU6_Object_ax 0;
BA_ "EventCommandSignal" SG_ 519 SGU6_Object_ay 0;
BA_ "GatewayedSignals" SG_ 519 SGU6_Object_ay 0;
BA_ "GenSigInvalidValue" SG_ 519 SGU6_Object_ay 0;
BA_ "GenSigTimeoutValue" SG_ 519 SGU6_Object_ay 0;
BA_ "EventCommandSignal" SG_ 519 SGU6_Object_dx 0;
BA_ "GatewayedSignals" SG_ 519 SGU6_Object_dx 0;
BA_ "GenSigInvalidValue" SG_ 519 SGU6_Object_dx 0;
BA_ "GenSigTimeoutValue" SG_ 519 SGU6_Object_dx 0;
BA_ "EventCommandSignal" SG_ 519 SGU6_Object_dx_Rear 0;
BA_ "GatewayedSignals" SG_ 519 SGU6_Object_dx_Rear 0;
BA_ "GenSigInvalidValue" SG_ 519 SGU6_Object_dx_Rear 0;
BA_ "GenSigTimeoutValue" SG_ 519 SGU6_Object_dx_Rear 0;
BA_ "EventCommandSignal" SG_ 519 SGU6_Object_dy 0;
BA_ "GatewayedSignals" SG_ 519 SGU6_Object_dy 0;
BA_ "GenSigInvalidValue" SG_ 519 SGU6_Object_dy 0;
BA_ "GenSigTimeoutValue" SG_ 519 SGU6_Object_dy 0;
BA_ "EventCommandSignal" SG_ 519 SGU6_Object_dy_Rear 0;
BA_ "GatewayedSignals" SG_ 519 SGU6_Object_dy_Rear 0;
BA_ "GenSigInvalidValue" SG_ 519 SGU6_Object_dy_Rear 0;
BA_ "GenSigTimeoutValue" SG_ 519 SGU6_Object_dy_Rear 0;
BA_ "EventCommandSignal" SG_ 519 SGU6_Object_vx 0;
BA_ "GatewayedSignals" SG_ 519 SGU6_Object_vx 0;
BA_ "GenSigInvalidValue" SG_ 519 SGU6_Object_vx 0;
BA_ "GenSigTimeoutValue" SG_ 519 SGU6_Object_vx 0;
BA_ "EventCommandSignal" SG_ 519 SGU6_Object_vy 0;
BA_ "GatewayedSignals" SG_ 519 SGU6_Object_vy 0;
BA_ "GenSigInvalidValue" SG_ 519 SGU6_Object_vy 0;
BA_ "GenSigTimeoutValue" SG_ 519 SGU6_Object_vy 0;
BA_ "EventCommandSignal" SG_ 519 SGU6_Object_wExist 0;
BA_ "GatewayedSignals" SG_ 519 SGU6_Object_wExist 0;
BA_ "GenSigInvalidValue" SG_ 519 SGU6_Object_wExist 0;
BA_ "GenSigTimeoutValue" SG_ 519 SGU6_Object_wExist 0;
BA_ "EventCommandSignal" SG_ 519 SGU6_Object_wObstacle 0;
BA_ "GatewayedSignals" SG_ 519 SGU6_Object_wObstacle 0;
BA_ "GenSigInvalidValue" SG_ 519 SGU6_Object_wObstacle 0;
BA_ "GenSigTimeoutValue" SG_ 519 SGU6_Object_wObstacle 0;
BA_ "EventCommandSignal" SG_ 520 SGU7_BlockCounter 0;
BA_ "GatewayedSignals" SG_ 520 SGU7_BlockCounter 0;
BA_ "GenSigInvalidValue" SG_ 520 SGU7_BlockCounter 0;
BA_ "GenSigTimeoutValue" SG_ 520 SGU7_BlockCounter 0;
BA_ "EventCommandSignal" SG_ 520 SGU7_LifeCycles_OBJ 0;
BA_ "GatewayedSignals" SG_ 520 SGU7_LifeCycles_OBJ 0;
BA_ "GenSigInvalidValue" SG_ 520 SGU7_LifeCycles_OBJ 0;
BA_ "GenSigTimeoutValue" SG_ 520 SGU7_LifeCycles_OBJ 0;
BA_ "EventCommandSignal" SG_ 520 SGU7_Msg_AliveCounter 0;
BA_ "GatewayedSignals" SG_ 520 SGU7_Msg_AliveCounter 0;
BA_ "GenSigInvalidValue" SG_ 520 SGU7_Msg_AliveCounter 0;
BA_ "GenSigTimeoutValue" SG_ 520 SGU7_Msg_AliveCounter 0;
BA_ "EventCommandSignal" SG_ 520 SGU7_Msg_CheckSum 0;
BA_ "GatewayedSignals" SG_ 520 SGU7_Msg_CheckSum 0;
BA_ "GenSigInvalidValue" SG_ 520 SGU7_Msg_CheckSum 0;
BA_ "GenSigTimeoutValue" SG_ 520 SGU7_Msg_CheckSum 0;
BA_ "IsCrcSignal" SG_ 520 SGU7_Msg_CheckSum 1;
BA_ "EventCommandSignal" SG_ 520 SGU7_ObjRCS_07 0;
BA_ "GatewayedSignals" SG_ 520 SGU7_ObjRCS_07 0;
BA_ "GenSigInvalidValue" SG_ 520 SGU7_ObjRCS_07 0;
BA_ "GenSigTimeoutValue" SG_ 520 SGU7_ObjRCS_07 0;
BA_ "EventCommandSignal" SG_ 520 SGU7_Obj_DistLat_rms 0;
BA_ "GatewayedSignals" SG_ 520 SGU7_Obj_DistLat_rms 0;
BA_ "GenSigInvalidValue" SG_ 520 SGU7_Obj_DistLat_rms 0;
BA_ "GenSigTimeoutValue" SG_ 520 SGU7_Obj_DistLat_rms 0;
BA_ "EventCommandSignal" SG_ 520 SGU7_Obj_VrelLong_rms 0;
BA_ "GatewayedSignals" SG_ 520 SGU7_Obj_VrelLong_rms 0;
BA_ "GenSigInvalidValue" SG_ 520 SGU7_Obj_VrelLong_rms 0;
BA_ "GenSigTimeoutValue" SG_ 520 SGU7_Obj_VrelLong_rms 0;
BA_ "EventCommandSignal" SG_ 520 SGU7_Obj_Vrelat_rms 0;
BA_ "GatewayedSignals" SG_ 520 SGU7_Obj_Vrelat_rms 0;
BA_ "GenSigInvalidValue" SG_ 520 SGU7_Obj_Vrelat_rms 0;
BA_ "GenSigTimeoutValue" SG_ 520 SGU7_Obj_Vrelat_rms 0;
BA_ "EventCommandSignal" SG_ 520 SGU7_Object_DetStatus 0;
BA_ "GatewayedSignals" SG_ 520 SGU7_Object_DetStatus 0;
BA_ "GenSigInvalidValue" SG_ 520 SGU7_Object_DetStatus 0;
BA_ "GenSigTimeoutValue" SG_ 520 SGU7_Object_DetStatus 0;
BA_ "EventCommandSignal" SG_ 520 SGU7_Object_DistLong_rms 0;
BA_ "GatewayedSignals" SG_ 520 SGU7_Object_DistLong_rms 0;
BA_ "GenSigInvalidValue" SG_ 520 SGU7_Object_DistLong_rms 0;
BA_ "GenSigTimeoutValue" SG_ 520 SGU7_Object_DistLong_rms 0;
BA_ "EventCommandSignal" SG_ 520 SGU7_Object_ID 0;
BA_ "GatewayedSignals" SG_ 520 SGU7_Object_ID 0;
BA_ "GenSigInvalidValue" SG_ 520 SGU7_Object_ID 0;
BA_ "GenSigTimeoutValue" SG_ 520 SGU7_Object_ID 0;
BA_ "EventCommandSignal" SG_ 520 SGU7_Object_Motion_Pattern 0;
BA_ "GatewayedSignals" SG_ 520 SGU7_Object_Motion_Pattern 0;
BA_ "GenSigInvalidValue" SG_ 520 SGU7_Object_Motion_Pattern 0;
BA_ "GenSigTimeoutValue" SG_ 520 SGU7_Object_Motion_Pattern 0;
BA_ "EventCommandSignal" SG_ 520 SGU7_Object_Type 0;
BA_ "GatewayedSignals" SG_ 520 SGU7_Object_Type 0;
BA_ "GenSigInvalidValue" SG_ 520 SGU7_Object_Type 0;
BA_ "GenSigTimeoutValue" SG_ 520 SGU7_Object_Type 0;
BA_ "EventCommandSignal" SG_ 520 SGU7_Object_ax 0;
BA_ "GatewayedSignals" SG_ 520 SGU7_Object_ax 0;
BA_ "GenSigInvalidValue" SG_ 520 SGU7_Object_ax 0;
BA_ "GenSigTimeoutValue" SG_ 520 SGU7_Object_ax 0;
BA_ "EventCommandSignal" SG_ 520 SGU7_Object_ay 0;
BA_ "GatewayedSignals" SG_ 520 SGU7_Object_ay 0;
BA_ "GenSigInvalidValue" SG_ 520 SGU7_Object_ay 0;
BA_ "GenSigTimeoutValue" SG_ 520 SGU7_Object_ay 0;
BA_ "EventCommandSignal" SG_ 520 SGU7_Object_dx 0;
BA_ "GatewayedSignals" SG_ 520 SGU7_Object_dx 0;
BA_ "GenSigInvalidValue" SG_ 520 SGU7_Object_dx 0;
BA_ "GenSigTimeoutValue" SG_ 520 SGU7_Object_dx 0;
BA_ "EventCommandSignal" SG_ 520 SGU7_Object_dx_Rear 0;
BA_ "GatewayedSignals" SG_ 520 SGU7_Object_dx_Rear 0;
BA_ "GenSigInvalidValue" SG_ 520 SGU7_Object_dx_Rear 0;
BA_ "GenSigTimeoutValue" SG_ 520 SGU7_Object_dx_Rear 0;
BA_ "EventCommandSignal" SG_ 520 SGU7_Object_dy 0;
BA_ "GatewayedSignals" SG_ 520 SGU7_Object_dy 0;
BA_ "GenSigInvalidValue" SG_ 520 SGU7_Object_dy 0;
BA_ "GenSigTimeoutValue" SG_ 520 SGU7_Object_dy 0;
BA_ "EventCommandSignal" SG_ 520 SGU7_Object_dy_Rear 0;
BA_ "GatewayedSignals" SG_ 520 SGU7_Object_dy_Rear 0;
BA_ "GenSigInvalidValue" SG_ 520 SGU7_Object_dy_Rear 0;
BA_ "GenSigTimeoutValue" SG_ 520 SGU7_Object_dy_Rear 0;
BA_ "EventCommandSignal" SG_ 520 SGU7_Object_vx 0;
BA_ "GatewayedSignals" SG_ 520 SGU7_Object_vx 0;
BA_ "GenSigInvalidValue" SG_ 520 SGU7_Object_vx 0;
BA_ "GenSigTimeoutValue" SG_ 520 SGU7_Object_vx 0;
BA_ "EventCommandSignal" SG_ 520 SGU7_Object_vy 0;
BA_ "GatewayedSignals" SG_ 520 SGU7_Object_vy 0;
BA_ "GenSigInvalidValue" SG_ 520 SGU7_Object_vy 0;
BA_ "GenSigTimeoutValue" SG_ 520 SGU7_Object_vy 0;
BA_ "EventCommandSignal" SG_ 520 SGU7_Object_wExist 0;
BA_ "GatewayedSignals" SG_ 520 SGU7_Object_wExist 0;
BA_ "GenSigInvalidValue" SG_ 520 SGU7_Object_wExist 0;
BA_ "GenSigTimeoutValue" SG_ 520 SGU7_Object_wExist 0;
BA_ "EventCommandSignal" SG_ 520 SGU7_Object_wObstacle 0;
BA_ "GatewayedSignals" SG_ 520 SGU7_Object_wObstacle 0;
BA_ "GenSigInvalidValue" SG_ 520 SGU7_Object_wObstacle 0;
BA_ "GenSigTimeoutValue" SG_ 520 SGU7_Object_wObstacle 0;
BA_ "EventCommandSignal" SG_ 521 SGU8_BlockCounter 0;
BA_ "GatewayedSignals" SG_ 521 SGU8_BlockCounter 0;
BA_ "GenSigInvalidValue" SG_ 521 SGU8_BlockCounter 0;
BA_ "GenSigTimeoutValue" SG_ 521 SGU8_BlockCounter 0;
BA_ "EventCommandSignal" SG_ 521 SGU8_LifeCycles_OBJ 0;
BA_ "GatewayedSignals" SG_ 521 SGU8_LifeCycles_OBJ 0;
BA_ "GenSigInvalidValue" SG_ 521 SGU8_LifeCycles_OBJ 0;
BA_ "GenSigTimeoutValue" SG_ 521 SGU8_LifeCycles_OBJ 0;
BA_ "EventCommandSignal" SG_ 521 SGU8_Msg_AliveCounter 0;
BA_ "GatewayedSignals" SG_ 521 SGU8_Msg_AliveCounter 0;
BA_ "GenSigInvalidValue" SG_ 521 SGU8_Msg_AliveCounter 0;
BA_ "GenSigTimeoutValue" SG_ 521 SGU8_Msg_AliveCounter 0;
BA_ "EventCommandSignal" SG_ 521 SGU8_Msg_CheckSum 0;
BA_ "GatewayedSignals" SG_ 521 SGU8_Msg_CheckSum 0;
BA_ "GenSigInvalidValue" SG_ 521 SGU8_Msg_CheckSum 0;
BA_ "GenSigTimeoutValue" SG_ 521 SGU8_Msg_CheckSum 0;
BA_ "IsCrcSignal" SG_ 521 SGU8_Msg_CheckSum 1;
BA_ "EventCommandSignal" SG_ 521 SGU8_ObjRCS_08 0;
BA_ "GatewayedSignals" SG_ 521 SGU8_ObjRCS_08 0;
BA_ "GenSigInvalidValue" SG_ 521 SGU8_ObjRCS_08 0;
BA_ "GenSigTimeoutValue" SG_ 521 SGU8_ObjRCS_08 0;
BA_ "EventCommandSignal" SG_ 521 SGU8_Obj_DistLat_rms 0;
BA_ "GatewayedSignals" SG_ 521 SGU8_Obj_DistLat_rms 0;
BA_ "GenSigInvalidValue" SG_ 521 SGU8_Obj_DistLat_rms 0;
BA_ "GenSigTimeoutValue" SG_ 521 SGU8_Obj_DistLat_rms 0;
BA_ "EventCommandSignal" SG_ 521 SGU8_Obj_VrelLong_rms 0;
BA_ "GatewayedSignals" SG_ 521 SGU8_Obj_VrelLong_rms 0;
BA_ "GenSigInvalidValue" SG_ 521 SGU8_Obj_VrelLong_rms 0;
BA_ "GenSigTimeoutValue" SG_ 521 SGU8_Obj_VrelLong_rms 0;
BA_ "EventCommandSignal" SG_ 521 SGU8_Obj_Vrelat_rms 0;
BA_ "GatewayedSignals" SG_ 521 SGU8_Obj_Vrelat_rms 0;
BA_ "GenSigInvalidValue" SG_ 521 SGU8_Obj_Vrelat_rms 0;
BA_ "GenSigTimeoutValue" SG_ 521 SGU8_Obj_Vrelat_rms 0;
BA_ "EventCommandSignal" SG_ 521 SGU8_Object_DetStatus 0;
BA_ "GatewayedSignals" SG_ 521 SGU8_Object_DetStatus 0;
BA_ "GenSigInvalidValue" SG_ 521 SGU8_Object_DetStatus 0;
BA_ "GenSigTimeoutValue" SG_ 521 SGU8_Object_DetStatus 0;
BA_ "EventCommandSignal" SG_ 521 SGU8_Object_DistLong_rms 0;
BA_ "GatewayedSignals" SG_ 521 SGU8_Object_DistLong_rms 0;
BA_ "GenSigInvalidValue" SG_ 521 SGU8_Object_DistLong_rms 0;
BA_ "GenSigTimeoutValue" SG_ 521 SGU8_Object_DistLong_rms 0;
BA_ "EventCommandSignal" SG_ 521 SGU8_Object_ID 0;
BA_ "GatewayedSignals" SG_ 521 SGU8_Object_ID 0;
BA_ "GenSigInvalidValue" SG_ 521 SGU8_Object_ID 0;
BA_ "GenSigTimeoutValue" SG_ 521 SGU8_Object_ID 0;
BA_ "EventCommandSignal" SG_ 521 SGU8_Object_Motion_Pattern 0;
BA_ "GatewayedSignals" SG_ 521 SGU8_Object_Motion_Pattern 0;
BA_ "GenSigInvalidValue" SG_ 521 SGU8_Object_Motion_Pattern 0;
BA_ "GenSigTimeoutValue" SG_ 521 SGU8_Object_Motion_Pattern 0;
BA_ "EventCommandSignal" SG_ 521 SGU8_Object_Type 0;
BA_ "GatewayedSignals" SG_ 521 SGU8_Object_Type 0;
BA_ "GenSigInvalidValue" SG_ 521 SGU8_Object_Type 0;
BA_ "GenSigTimeoutValue" SG_ 521 SGU8_Object_Type 0;
BA_ "EventCommandSignal" SG_ 521 SGU8_Object_ax 0;
BA_ "GatewayedSignals" SG_ 521 SGU8_Object_ax 0;
BA_ "GenSigInvalidValue" SG_ 521 SGU8_Object_ax 0;
BA_ "GenSigTimeoutValue" SG_ 521 SGU8_Object_ax 0;
BA_ "EventCommandSignal" SG_ 521 SGU8_Object_ay 0;
BA_ "GatewayedSignals" SG_ 521 SGU8_Object_ay 0;
BA_ "GenSigInvalidValue" SG_ 521 SGU8_Object_ay 0;
BA_ "GenSigTimeoutValue" SG_ 521 SGU8_Object_ay 0;
BA_ "EventCommandSignal" SG_ 521 SGU8_Object_dx 0;
BA_ "GatewayedSignals" SG_ 521 SGU8_Object_dx 0;
BA_ "GenSigInvalidValue" SG_ 521 SGU8_Object_dx 0;
BA_ "GenSigTimeoutValue" SG_ 521 SGU8_Object_dx 0;
BA_ "EventCommandSignal" SG_ 521 SGU8_Object_dx_Rear 0;
BA_ "GatewayedSignals" SG_ 521 SGU8_Object_dx_Rear 0;
BA_ "GenSigInvalidValue" SG_ 521 SGU8_Object_dx_Rear 0;
BA_ "GenSigTimeoutValue" SG_ 521 SGU8_Object_dx_Rear 0;
BA_ "EventCommandSignal" SG_ 521 SGU8_Object_dy 0;
BA_ "GatewayedSignals" SG_ 521 SGU8_Object_dy 0;
BA_ "GenSigInvalidValue" SG_ 521 SGU8_Object_dy 0;
BA_ "GenSigTimeoutValue" SG_ 521 SGU8_Object_dy 0;
BA_ "EventCommandSignal" SG_ 521 SGU8_Object_dy_Rear 0;
BA_ "GatewayedSignals" SG_ 521 SGU8_Object_dy_Rear 0;
BA_ "GenSigInvalidValue" SG_ 521 SGU8_Object_dy_Rear 0;
BA_ "GenSigTimeoutValue" SG_ 521 SGU8_Object_dy_Rear 0;
BA_ "EventCommandSignal" SG_ 521 SGU8_Object_vx 0;
BA_ "GatewayedSignals" SG_ 521 SGU8_Object_vx 0;
BA_ "GenSigInvalidValue" SG_ 521 SGU8_Object_vx 0;
BA_ "GenSigTimeoutValue" SG_ 521 SGU8_Object_vx 0;
BA_ "EventCommandSignal" SG_ 521 SGU8_Object_vy 0;
BA_ "GatewayedSignals" SG_ 521 SGU8_Object_vy 0;
BA_ "GenSigInvalidValue" SG_ 521 SGU8_Object_vy 0;
BA_ "GenSigTimeoutValue" SG_ 521 SGU8_Object_vy 0;
BA_ "EventCommandSignal" SG_ 521 SGU8_Object_wExist 0;
BA_ "GatewayedSignals" SG_ 521 SGU8_Object_wExist 0;
BA_ "GenSigInvalidValue" SG_ 521 SGU8_Object_wExist 0;
BA_ "GenSigTimeoutValue" SG_ 521 SGU8_Object_wExist 0;
BA_ "EventCommandSignal" SG_ 521 SGU8_Object_wObstacle 0;
BA_ "GatewayedSignals" SG_ 521 SGU8_Object_wObstacle 0;
BA_ "GenSigInvalidValue" SG_ 521 SGU8_Object_wObstacle 0;
BA_ "GenSigTimeoutValue" SG_ 521 SGU8_Object_wObstacle 0;
BA_ "EventCommandSignal" SG_ 522 SGU9_BlockCounter 0;
BA_ "GatewayedSignals" SG_ 522 SGU9_BlockCounter 0;
BA_ "GenSigInvalidValue" SG_ 522 SGU9_BlockCounter 0;
BA_ "GenSigTimeoutValue" SG_ 522 SGU9_BlockCounter 0;
BA_ "EventCommandSignal" SG_ 522 SGU9_LifeCycles_OBJ 0;
BA_ "GatewayedSignals" SG_ 522 SGU9_LifeCycles_OBJ 0;
BA_ "GenSigInvalidValue" SG_ 522 SGU9_LifeCycles_OBJ 0;
BA_ "GenSigTimeoutValue" SG_ 522 SGU9_LifeCycles_OBJ 0;
BA_ "EventCommandSignal" SG_ 522 SGU9_Msg_AliveCounter 0;
BA_ "GatewayedSignals" SG_ 522 SGU9_Msg_AliveCounter 0;
BA_ "GenSigInvalidValue" SG_ 522 SGU9_Msg_AliveCounter 0;
BA_ "GenSigTimeoutValue" SG_ 522 SGU9_Msg_AliveCounter 0;
BA_ "EventCommandSignal" SG_ 522 SGU9_Msg_CheckSum 0;
BA_ "GatewayedSignals" SG_ 522 SGU9_Msg_CheckSum 0;
BA_ "GenSigInvalidValue" SG_ 522 SGU9_Msg_CheckSum 0;
BA_ "GenSigTimeoutValue" SG_ 522 SGU9_Msg_CheckSum 0;
BA_ "IsCrcSignal" SG_ 522 SGU9_Msg_CheckSum 1;
BA_ "EventCommandSignal" SG_ 522 SGU9_ObjRCS_09 0;
BA_ "GatewayedSignals" SG_ 522 SGU9_ObjRCS_09 0;
BA_ "GenSigInvalidValue" SG_ 522 SGU9_ObjRCS_09 0;
BA_ "GenSigTimeoutValue" SG_ 522 SGU9_ObjRCS_09 0;
BA_ "EventCommandSignal" SG_ 522 SGU9_Obj_DistLat_rms 0;
BA_ "GatewayedSignals" SG_ 522 SGU9_Obj_DistLat_rms 0;
BA_ "GenSigInvalidValue" SG_ 522 SGU9_Obj_DistLat_rms 0;
BA_ "GenSigTimeoutValue" SG_ 522 SGU9_Obj_DistLat_rms 0;
BA_ "EventCommandSignal" SG_ 522 SGU9_Obj_VrelLong_rms 0;
BA_ "GatewayedSignals" SG_ 522 SGU9_Obj_VrelLong_rms 0;
BA_ "GenSigInvalidValue" SG_ 522 SGU9_Obj_VrelLong_rms 0;
BA_ "GenSigTimeoutValue" SG_ 522 SGU9_Obj_VrelLong_rms 0;
BA_ "EventCommandSignal" SG_ 522 SGU9_Obj_Vrelat_rms 0;
BA_ "GatewayedSignals" SG_ 522 SGU9_Obj_Vrelat_rms 0;
BA_ "GenSigInvalidValue" SG_ 522 SGU9_Obj_Vrelat_rms 0;
BA_ "GenSigTimeoutValue" SG_ 522 SGU9_Obj_Vrelat_rms 0;
BA_ "EventCommandSignal" SG_ 522 SGU9_Object_DetStatus 0;
BA_ "GatewayedSignals" SG_ 522 SGU9_Object_DetStatus 0;
BA_ "GenSigInvalidValue" SG_ 522 SGU9_Object_DetStatus 0;
BA_ "GenSigTimeoutValue" SG_ 522 SGU9_Object_DetStatus 0;
BA_ "EventCommandSignal" SG_ 522 SGU9_Object_DistLong_rms 0;
BA_ "GatewayedSignals" SG_ 522 SGU9_Object_DistLong_rms 0;
BA_ "GenSigInvalidValue" SG_ 522 SGU9_Object_DistLong_rms 0;
BA_ "GenSigTimeoutValue" SG_ 522 SGU9_Object_DistLong_rms 0;
BA_ "EventCommandSignal" SG_ 522 SGU9_Object_ID 0;
BA_ "GatewayedSignals" SG_ 522 SGU9_Object_ID 0;
BA_ "GenSigInvalidValue" SG_ 522 SGU9_Object_ID 0;
BA_ "GenSigTimeoutValue" SG_ 522 SGU9_Object_ID 0;
BA_ "EventCommandSignal" SG_ 522 SGU9_Object_Motion_Pattern 0;
BA_ "GatewayedSignals" SG_ 522 SGU9_Object_Motion_Pattern 0;
BA_ "GenSigInvalidValue" SG_ 522 SGU9_Object_Motion_Pattern 0;
BA_ "GenSigTimeoutValue" SG_ 522 SGU9_Object_Motion_Pattern 0;
BA_ "EventCommandSignal" SG_ 522 SGU9_Object_Type 0;
BA_ "GatewayedSignals" SG_ 522 SGU9_Object_Type 0;
BA_ "GenSigInvalidValue" SG_ 522 SGU9_Object_Type 0;
BA_ "GenSigTimeoutValue" SG_ 522 SGU9_Object_Type 0;
BA_ "EventCommandSignal" SG_ 522 SGU9_Object_ax 0;
BA_ "GatewayedSignals" SG_ 522 SGU9_Object_ax 0;
BA_ "GenSigInvalidValue" SG_ 522 SGU9_Object_ax 0;
BA_ "GenSigTimeoutValue" SG_ 522 SGU9_Object_ax 0;
BA_ "EventCommandSignal" SG_ 522 SGU9_Object_ay 0;
BA_ "GatewayedSignals" SG_ 522 SGU9_Object_ay 0;
BA_ "GenSigInvalidValue" SG_ 522 SGU9_Object_ay 0;
BA_ "GenSigTimeoutValue" SG_ 522 SGU9_Object_ay 0;
BA_ "EventCommandSignal" SG_ 522 SGU9_Object_dx 0;
BA_ "GatewayedSignals" SG_ 522 SGU9_Object_dx 0;
BA_ "GenSigInvalidValue" SG_ 522 SGU9_Object_dx 0;
BA_ "GenSigTimeoutValue" SG_ 522 SGU9_Object_dx 0;
BA_ "EventCommandSignal" SG_ 522 SGU9_Object_dx_Rear 0;
BA_ "GatewayedSignals" SG_ 522 SGU9_Object_dx_Rear 0;
BA_ "GenSigInvalidValue" SG_ 522 SGU9_Object_dx_Rear 0;
BA_ "GenSigTimeoutValue" SG_ 522 SGU9_Object_dx_Rear 0;
BA_ "EventCommandSignal" SG_ 522 SGU9_Object_dy 0;
BA_ "GatewayedSignals" SG_ 522 SGU9_Object_dy 0;
BA_ "GenSigInvalidValue" SG_ 522 SGU9_Object_dy 0;
BA_ "GenSigTimeoutValue" SG_ 522 SGU9_Object_dy 0;
BA_ "EventCommandSignal" SG_ 522 SGU9_Object_dy_Rear 0;
BA_ "GatewayedSignals" SG_ 522 SGU9_Object_dy_Rear 0;
BA_ "GenSigInvalidValue" SG_ 522 SGU9_Object_dy_Rear 0;
BA_ "GenSigTimeoutValue" SG_ 522 SGU9_Object_dy_Rear 0;
BA_ "EventCommandSignal" SG_ 522 SGU9_Object_vx 0;
BA_ "GatewayedSignals" SG_ 522 SGU9_Object_vx 0;
BA_ "GenSigInvalidValue" SG_ 522 SGU9_Object_vx 0;
BA_ "GenSigTimeoutValue" SG_ 522 SGU9_Object_vx 0;
BA_ "EventCommandSignal" SG_ 522 SGU9_Object_vy 0;
BA_ "GatewayedSignals" SG_ 522 SGU9_Object_vy 0;
BA_ "GenSigInvalidValue" SG_ 522 SGU9_Object_vy 0;
BA_ "GenSigTimeoutValue" SG_ 522 SGU9_Object_vy 0;
BA_ "EventCommandSignal" SG_ 522 SGU9_Object_wExist 0;
BA_ "GatewayedSignals" SG_ 522 SGU9_Object_wExist 0;
BA_ "GenSigInvalidValue" SG_ 522 SGU9_Object_wExist 0;
BA_ "GenSigTimeoutValue" SG_ 522 SGU9_Object_wExist 0;
BA_ "EventCommandSignal" SG_ 522 SGU9_Object_wObstacle 0;
BA_ "GatewayedSignals" SG_ 522 SGU9_Object_wObstacle 0;
BA_ "GenSigInvalidValue" SG_ 522 SGU9_Object_wObstacle 0;
BA_ "GenSigTimeoutValue" SG_ 522 SGU9_Object_wObstacle 0;
BA_ "EventCommandSignal" SG_ 523 SGU10_BlockCounter 0;
BA_ "GatewayedSignals" SG_ 523 SGU10_BlockCounter 0;
BA_ "GenSigInvalidValue" SG_ 523 SGU10_BlockCounter 0;
BA_ "GenSigTimeoutValue" SG_ 523 SGU10_BlockCounter 0;
BA_ "EventCommandSignal" SG_ 523 SGU10_LifeCycles_OBJ 0;
BA_ "GatewayedSignals" SG_ 523 SGU10_LifeCycles_OBJ 0;
BA_ "GenSigInvalidValue" SG_ 523 SGU10_LifeCycles_OBJ 0;
BA_ "GenSigTimeoutValue" SG_ 523 SGU10_LifeCycles_OBJ 0;
BA_ "EventCommandSignal" SG_ 523 SGU10_Msg_AliveCounter 0;
BA_ "GatewayedSignals" SG_ 523 SGU10_Msg_AliveCounter 0;
BA_ "GenSigInvalidValue" SG_ 523 SGU10_Msg_AliveCounter 0;
BA_ "GenSigTimeoutValue" SG_ 523 SGU10_Msg_AliveCounter 0;
BA_ "EventCommandSignal" SG_ 523 SGU10_Msg_CheckSum 0;
BA_ "GatewayedSignals" SG_ 523 SGU10_Msg_CheckSum 0;
BA_ "GenSigInvalidValue" SG_ 523 SGU10_Msg_CheckSum 0;
BA_ "GenSigTimeoutValue" SG_ 523 SGU10_Msg_CheckSum 0;
BA_ "IsCrcSignal" SG_ 523 SGU10_Msg_CheckSum 1;
BA_ "EventCommandSignal" SG_ 523 SGU10_ObjRCS_10 0;
BA_ "GatewayedSignals" SG_ 523 SGU10_ObjRCS_10 0;
BA_ "GenSigInvalidValue" SG_ 523 SGU10_ObjRCS_10 0;
BA_ "GenSigTimeoutValue" SG_ 523 SGU10_ObjRCS_10 0;
BA_ "EventCommandSignal" SG_ 523 SGU10_Obj_DistLat_rms 0;
BA_ "GatewayedSignals" SG_ 523 SGU10_Obj_DistLat_rms 0;
BA_ "GenSigInvalidValue" SG_ 523 SGU10_Obj_DistLat_rms 0;
BA_ "GenSigTimeoutValue" SG_ 523 SGU10_Obj_DistLat_rms 0;
BA_ "EventCommandSignal" SG_ 523 SGU10_Obj_VrelLong_rms 0;
BA_ "GatewayedSignals" SG_ 523 SGU10_Obj_VrelLong_rms 0;
BA_ "GenSigInvalidValue" SG_ 523 SGU10_Obj_VrelLong_rms 0;
BA_ "GenSigTimeoutValue" SG_ 523 SGU10_Obj_VrelLong_rms 0;
BA_ "EventCommandSignal" SG_ 523 SGU10_Obj_Vrelat_rms 0;
BA_ "GatewayedSignals" SG_ 523 SGU10_Obj_Vrelat_rms 0;
BA_ "GenSigInvalidValue" SG_ 523 SGU10_Obj_Vrelat_rms 0;
BA_ "GenSigTimeoutValue" SG_ 523 SGU10_Obj_Vrelat_rms 0;
BA_ "EventCommandSignal" SG_ 523 SGU10_Object_DetStatus 0;
BA_ "GatewayedSignals" SG_ 523 SGU10_Object_DetStatus 0;
BA_ "GenSigInvalidValue" SG_ 523 SGU10_Object_DetStatus 0;
BA_ "GenSigTimeoutValue" SG_ 523 SGU10_Object_DetStatus 0;
BA_ "EventCommandSignal" SG_ 523 SGU10_Object_DistLong_rms 0;
BA_ "GatewayedSignals" SG_ 523 SGU10_Object_DistLong_rms 0;
BA_ "GenSigInvalidValue" SG_ 523 SGU10_Object_DistLong_rms 0;
BA_ "GenSigTimeoutValue" SG_ 523 SGU10_Object_DistLong_rms 0;
BA_ "EventCommandSignal" SG_ 523 SGU10_Object_ID 0;
BA_ "GatewayedSignals" SG_ 523 SGU10_Object_ID 0;
BA_ "GenSigInvalidValue" SG_ 523 SGU10_Object_ID 0;
BA_ "GenSigTimeoutValue" SG_ 523 SGU10_Object_ID 0;
BA_ "EventCommandSignal" SG_ 523 SGU10_Object_Motion_Pattern 0;
BA_ "GatewayedSignals" SG_ 523 SGU10_Object_Motion_Pattern 0;
BA_ "GenSigInvalidValue" SG_ 523 SGU10_Object_Motion_Pattern 0;
BA_ "GenSigTimeoutValue" SG_ 523 SGU10_Object_Motion_Pattern 0;
BA_ "EventCommandSignal" SG_ 523 SGU10_Object_Type 0;
BA_ "GatewayedSignals" SG_ 523 SGU10_Object_Type 0;
BA_ "GenSigInvalidValue" SG_ 523 SGU10_Object_Type 0;
BA_ "GenSigTimeoutValue" SG_ 523 SGU10_Object_Type 0;
BA_ "EventCommandSignal" SG_ 523 SGU10_Object_ax 0;
BA_ "GatewayedSignals" SG_ 523 SGU10_Object_ax 0;
BA_ "GenSigInvalidValue" SG_ 523 SGU10_Object_ax 0;
BA_ "GenSigTimeoutValue" SG_ 523 SGU10_Object_ax 0;
BA_ "EventCommandSignal" SG_ 523 SGU10_Object_ay 0;
BA_ "GatewayedSignals" SG_ 523 SGU10_Object_ay 0;
BA_ "GenSigInvalidValue" SG_ 523 SGU10_Object_ay 0;
BA_ "GenSigTimeoutValue" SG_ 523 SGU10_Object_ay 0;
BA_ "EventCommandSignal" SG_ 523 SGU10_Object_dx 0;
BA_ "GatewayedSignals" SG_ 523 SGU10_Object_dx 0;
BA_ "GenSigInvalidValue" SG_ 523 SGU10_Object_dx 0;
BA_ "GenSigTimeoutValue" SG_ 523 SGU10_Object_dx 0;
BA_ "EventCommandSignal" SG_ 523 SGU10_Object_dx_Rear 0;
BA_ "GatewayedSignals" SG_ 523 SGU10_Object_dx_Rear 0;
BA_ "GenSigInvalidValue" SG_ 523 SGU10_Object_dx_Rear 0;
BA_ "GenSigTimeoutValue" SG_ 523 SGU10_Object_dx_Rear 0;
BA_ "EventCommandSignal" SG_ 523 SGU10_Object_dy 0;
BA_ "GatewayedSignals" SG_ 523 SGU10_Object_dy 0;
BA_ "GenSigInvalidValue" SG_ 523 SGU10_Object_dy 0;
BA_ "GenSigTimeoutValue" SG_ 523 SGU10_Object_dy 0;
BA_ "EventCommandSignal" SG_ 523 SGU10_Object_dy_Rear 0;
BA_ "GatewayedSignals" SG_ 523 SGU10_Object_dy_Rear 0;
BA_ "GenSigInvalidValue" SG_ 523 SGU10_Object_dy_Rear 0;
BA_ "GenSigTimeoutValue" SG_ 523 SGU10_Object_dy_Rear 0;
BA_ "EventCommandSignal" SG_ 523 SGU10_Object_vx 0;
BA_ "GatewayedSignals" SG_ 523 SGU10_Object_vx 0;
BA_ "GenSigInvalidValue" SG_ 523 SGU10_Object_vx 0;
BA_ "GenSigTimeoutValue" SG_ 523 SGU10_Object_vx 0;
BA_ "EventCommandSignal" SG_ 523 SGU10_Object_vy 0;
BA_ "GatewayedSignals" SG_ 523 SGU10_Object_vy 0;
BA_ "GenSigInvalidValue" SG_ 523 SGU10_Object_vy 0;
BA_ "GenSigTimeoutValue" SG_ 523 SGU10_Object_vy 0;
BA_ "EventCommandSignal" SG_ 523 SGU10_Object_wExist 0;
BA_ "GatewayedSignals" SG_ 523 SGU10_Object_wExist 0;
BA_ "GenSigInvalidValue" SG_ 523 SGU10_Object_wExist 0;
BA_ "GenSigTimeoutValue" SG_ 523 SGU10_Object_wExist 0;
BA_ "EventCommandSignal" SG_ 523 SGU10_Object_wObstacle 0;
BA_ "GatewayedSignals" SG_ 523 SGU10_Object_wObstacle 0;
BA_ "GenSigInvalidValue" SG_ 523 SGU10_Object_wObstacle 0;
BA_ "GenSigTimeoutValue" SG_ 523 SGU10_Object_wObstacle 0;
BA_ "EventCommandSignal" SG_ 524 SGU11_BlockCounter 0;
BA_ "GatewayedSignals" SG_ 524 SGU11_BlockCounter 0;
BA_ "GenSigInvalidValue" SG_ 524 SGU11_BlockCounter 0;
BA_ "GenSigTimeoutValue" SG_ 524 SGU11_BlockCounter 0;
BA_ "EventCommandSignal" SG_ 524 SGU11_LifeCycles_OBJ 0;
BA_ "GatewayedSignals" SG_ 524 SGU11_LifeCycles_OBJ 0;
BA_ "GenSigInvalidValue" SG_ 524 SGU11_LifeCycles_OBJ 0;
BA_ "GenSigTimeoutValue" SG_ 524 SGU11_LifeCycles_OBJ 0;
BA_ "EventCommandSignal" SG_ 524 SGU11_Msg_AliveCounter 0;
BA_ "GatewayedSignals" SG_ 524 SGU11_Msg_AliveCounter 0;
BA_ "GenSigInvalidValue" SG_ 524 SGU11_Msg_AliveCounter 0;
BA_ "GenSigTimeoutValue" SG_ 524 SGU11_Msg_AliveCounter 0;
BA_ "EventCommandSignal" SG_ 524 SGU11_Msg_CheckSum 0;
BA_ "GatewayedSignals" SG_ 524 SGU11_Msg_CheckSum 0;
BA_ "GenSigInvalidValue" SG_ 524 SGU11_Msg_CheckSum 0;
BA_ "GenSigTimeoutValue" SG_ 524 SGU11_Msg_CheckSum 0;
BA_ "IsCrcSignal" SG_ 524 SGU11_Msg_CheckSum 1;
BA_ "EventCommandSignal" SG_ 524 SGU11_ObjRCS_11 0;
BA_ "GatewayedSignals" SG_ 524 SGU11_ObjRCS_11 0;
BA_ "GenSigInvalidValue" SG_ 524 SGU11_ObjRCS_11 0;
BA_ "GenSigTimeoutValue" SG_ 524 SGU11_ObjRCS_11 0;
BA_ "EventCommandSignal" SG_ 524 SGU11_Obj_DistLat_rms 0;
BA_ "GatewayedSignals" SG_ 524 SGU11_Obj_DistLat_rms 0;
BA_ "GenSigInvalidValue" SG_ 524 SGU11_Obj_DistLat_rms 0;
BA_ "GenSigTimeoutValue" SG_ 524 SGU11_Obj_DistLat_rms 0;
BA_ "EventCommandSignal" SG_ 524 SGU11_Obj_VrelLong_rms 0;
BA_ "GatewayedSignals" SG_ 524 SGU11_Obj_VrelLong_rms 0;
BA_ "GenSigInvalidValue" SG_ 524 SGU11_Obj_VrelLong_rms 0;
BA_ "GenSigTimeoutValue" SG_ 524 SGU11_Obj_VrelLong_rms 0;
BA_ "EventCommandSignal" SG_ 524 SGU11_Obj_Vrelat_rms 0;
BA_ "GatewayedSignals" SG_ 524 SGU11_Obj_Vrelat_rms 0;
BA_ "GenSigInvalidValue" SG_ 524 SGU11_Obj_Vrelat_rms 0;
BA_ "GenSigTimeoutValue" SG_ 524 SGU11_Obj_Vrelat_rms 0;
BA_ "EventCommandSignal" SG_ 524 SGU11_Object_DetStatus 0;
BA_ "GatewayedSignals" SG_ 524 SGU11_Object_DetStatus 0;
BA_ "GenSigInvalidValue" SG_ 524 SGU11_Object_DetStatus 0;
BA_ "GenSigTimeoutValue" SG_ 524 SGU11_Object_DetStatus 0;
BA_ "EventCommandSignal" SG_ 524 SGU11_Object_DistLong_rms 0;
BA_ "GatewayedSignals" SG_ 524 SGU11_Object_DistLong_rms 0;
BA_ "GenSigInvalidValue" SG_ 524 SGU11_Object_DistLong_rms 0;
BA_ "GenSigTimeoutValue" SG_ 524 SGU11_Object_DistLong_rms 0;
BA_ "EventCommandSignal" SG_ 524 SGU11_Object_ID 0;
BA_ "GatewayedSignals" SG_ 524 SGU11_Object_ID 0;
BA_ "GenSigInvalidValue" SG_ 524 SGU11_Object_ID 0;
BA_ "GenSigTimeoutValue" SG_ 524 SGU11_Object_ID 0;
BA_ "EventCommandSignal" SG_ 524 SGU11_Object_Motion_Pattern 0;
BA_ "GatewayedSignals" SG_ 524 SGU11_Object_Motion_Pattern 0;
BA_ "GenSigInvalidValue" SG_ 524 SGU11_Object_Motion_Pattern 0;
BA_ "GenSigTimeoutValue" SG_ 524 SGU11_Object_Motion_Pattern 0;
BA_ "EventCommandSignal" SG_ 524 SGU11_Object_Type 0;
BA_ "GatewayedSignals" SG_ 524 SGU11_Object_Type 0;
BA_ "GenSigInvalidValue" SG_ 524 SGU11_Object_Type 0;
BA_ "GenSigTimeoutValue" SG_ 524 SGU11_Object_Type 0;
BA_ "EventCommandSignal" SG_ 524 SGU11_Object_ax 0;
BA_ "GatewayedSignals" SG_ 524 SGU11_Object_ax 0;
BA_ "GenSigInvalidValue" SG_ 524 SGU11_Object_ax 0;
BA_ "GenSigTimeoutValue" SG_ 524 SGU11_Object_ax 0;
BA_ "EventCommandSignal" SG_ 524 SGU11_Object_ay 0;
BA_ "GatewayedSignals" SG_ 524 SGU11_Object_ay 0;
BA_ "GenSigInvalidValue" SG_ 524 SGU11_Object_ay 0;
BA_ "GenSigTimeoutValue" SG_ 524 SGU11_Object_ay 0;
BA_ "EventCommandSignal" SG_ 524 SGU11_Object_dx 0;
BA_ "GatewayedSignals" SG_ 524 SGU11_Object_dx 0;
BA_ "GenSigInvalidValue" SG_ 524 SGU11_Object_dx 0;
BA_ "GenSigTimeoutValue" SG_ 524 SGU11_Object_dx 0;
BA_ "EventCommandSignal" SG_ 524 SGU11_Object_dx_Rear 0;
BA_ "GatewayedSignals" SG_ 524 SGU11_Object_dx_Rear 0;
BA_ "GenSigInvalidValue" SG_ 524 SGU11_Object_dx_Rear 0;
BA_ "GenSigTimeoutValue" SG_ 524 SGU11_Object_dx_Rear 0;
BA_ "EventCommandSignal" SG_ 524 SGU11_Object_dy 0;
BA_ "GatewayedSignals" SG_ 524 SGU11_Object_dy 0;
BA_ "GenSigInvalidValue" SG_ 524 SGU11_Object_dy 0;
BA_ "GenSigTimeoutValue" SG_ 524 SGU11_Object_dy 0;
BA_ "EventCommandSignal" SG_ 524 SGU11_Object_dy_Rear 0;
BA_ "GatewayedSignals" SG_ 524 SGU11_Object_dy_Rear 0;
BA_ "GenSigInvalidValue" SG_ 524 SGU11_Object_dy_Rear 0;
BA_ "GenSigTimeoutValue" SG_ 524 SGU11_Object_dy_Rear 0;
BA_ "EventCommandSignal" SG_ 524 SGU11_Object_vx 0;
BA_ "GatewayedSignals" SG_ 524 SGU11_Object_vx 0;
BA_ "GenSigInvalidValue" SG_ 524 SGU11_Object_vx 0;
BA_ "GenSigTimeoutValue" SG_ 524 SGU11_Object_vx 0;
BA_ "EventCommandSignal" SG_ 524 SGU11_Object_vy 0;
BA_ "GatewayedSignals" SG_ 524 SGU11_Object_vy 0;
BA_ "GenSigInvalidValue" SG_ 524 SGU11_Object_vy 0;
BA_ "GenSigTimeoutValue" SG_ 524 SGU11_Object_vy 0;
BA_ "EventCommandSignal" SG_ 524 SGU11_Object_wExist 0;
BA_ "GatewayedSignals" SG_ 524 SGU11_Object_wExist 0;
BA_ "GenSigInvalidValue" SG_ 524 SGU11_Object_wExist 0;
BA_ "GenSigTimeoutValue" SG_ 524 SGU11_Object_wExist 0;
BA_ "EventCommandSignal" SG_ 524 SGU11_Object_wObstacle 0;
BA_ "GatewayedSignals" SG_ 524 SGU11_Object_wObstacle 0;
BA_ "GenSigInvalidValue" SG_ 524 SGU11_Object_wObstacle 0;
BA_ "GenSigTimeoutValue" SG_ 524 SGU11_Object_wObstacle 0;
BA_ "EventCommandSignal" SG_ 525 SGU12_BlockCounter 0;
BA_ "GatewayedSignals" SG_ 525 SGU12_BlockCounter 0;
BA_ "GenSigInvalidValue" SG_ 525 SGU12_BlockCounter 0;
BA_ "GenSigTimeoutValue" SG_ 525 SGU12_BlockCounter 0;
BA_ "EventCommandSignal" SG_ 525 SGU12_LifeCycles_OBJ 0;
BA_ "GatewayedSignals" SG_ 525 SGU12_LifeCycles_OBJ 0;
BA_ "GenSigInvalidValue" SG_ 525 SGU12_LifeCycles_OBJ 0;
BA_ "GenSigTimeoutValue" SG_ 525 SGU12_LifeCycles_OBJ 0;
BA_ "EventCommandSignal" SG_ 525 SGU12_Msg_AliveCounter 0;
BA_ "GatewayedSignals" SG_ 525 SGU12_Msg_AliveCounter 0;
BA_ "GenSigInvalidValue" SG_ 525 SGU12_Msg_AliveCounter 0;
BA_ "GenSigTimeoutValue" SG_ 525 SGU12_Msg_AliveCounter 0;
BA_ "EventCommandSignal" SG_ 525 SGU12_Msg_CheckSum 0;
BA_ "GatewayedSignals" SG_ 525 SGU12_Msg_CheckSum 0;
BA_ "GenSigInvalidValue" SG_ 525 SGU12_Msg_CheckSum 0;
BA_ "GenSigTimeoutValue" SG_ 525 SGU12_Msg_CheckSum 0;
BA_ "IsCrcSignal" SG_ 525 SGU12_Msg_CheckSum 1;
BA_ "EventCommandSignal" SG_ 525 SGU12_ObjRCS_12 0;
BA_ "GatewayedSignals" SG_ 525 SGU12_ObjRCS_12 0;
BA_ "GenSigInvalidValue" SG_ 525 SGU12_ObjRCS_12 0;
BA_ "GenSigTimeoutValue" SG_ 525 SGU12_ObjRCS_12 0;
BA_ "EventCommandSignal" SG_ 525 SGU12_Obj_DistLat_rms 0;
BA_ "GatewayedSignals" SG_ 525 SGU12_Obj_DistLat_rms 0;
BA_ "GenSigInvalidValue" SG_ 525 SGU12_Obj_DistLat_rms 0;
BA_ "GenSigTimeoutValue" SG_ 525 SGU12_Obj_DistLat_rms 0;
BA_ "EventCommandSignal" SG_ 525 SGU12_Obj_VrelLong_rms 0;
BA_ "GatewayedSignals" SG_ 525 SGU12_Obj_VrelLong_rms 0;
BA_ "GenSigInvalidValue" SG_ 525 SGU12_Obj_VrelLong_rms 0;
BA_ "GenSigTimeoutValue" SG_ 525 SGU12_Obj_VrelLong_rms 0;
BA_ "EventCommandSignal" SG_ 525 SGU12_Obj_Vrelat_rms 0;
BA_ "GatewayedSignals" SG_ 525 SGU12_Obj_Vrelat_rms 0;
BA_ "GenSigInvalidValue" SG_ 525 SGU12_Obj_Vrelat_rms 0;
BA_ "GenSigTimeoutValue" SG_ 525 SGU12_Obj_Vrelat_rms 0;
BA_ "EventCommandSignal" SG_ 525 SGU12_Object_DetStatus 0;
BA_ "GatewayedSignals" SG_ 525 SGU12_Object_DetStatus 0;
BA_ "GenSigInvalidValue" SG_ 525 SGU12_Object_DetStatus 0;
BA_ "GenSigTimeoutValue" SG_ 525 SGU12_Object_DetStatus 0;
BA_ "EventCommandSignal" SG_ 525 SGU12_Object_DistLong_rms 0;
BA_ "GatewayedSignals" SG_ 525 SGU12_Object_DistLong_rms 0;
BA_ "GenSigInvalidValue" SG_ 525 SGU12_Object_DistLong_rms 0;
BA_ "GenSigTimeoutValue" SG_ 525 SGU12_Object_DistLong_rms 0;
BA_ "EventCommandSignal" SG_ 525 SGU12_Object_ID 0;
BA_ "GatewayedSignals" SG_ 525 SGU12_Object_ID 0;
BA_ "GenSigInvalidValue" SG_ 525 SGU12_Object_ID 0;
BA_ "GenSigTimeoutValue" SG_ 525 SGU12_Object_ID 0;
BA_ "EventCommandSignal" SG_ 525 SGU12_Object_Motion_Pattern 0;
BA_ "GatewayedSignals" SG_ 525 SGU12_Object_Motion_Pattern 0;
BA_ "GenSigInvalidValue" SG_ 525 SGU12_Object_Motion_Pattern 0;
BA_ "GenSigTimeoutValue" SG_ 525 SGU12_Object_Motion_Pattern 0;
BA_ "EventCommandSignal" SG_ 525 SGU12_Object_Type 0;
BA_ "GatewayedSignals" SG_ 525 SGU12_Object_Type 0;
BA_ "GenSigInvalidValue" SG_ 525 SGU12_Object_Type 0;
BA_ "GenSigTimeoutValue" SG_ 525 SGU12_Object_Type 0;
BA_ "EventCommandSignal" SG_ 525 SGU12_Object_ax 0;
BA_ "GatewayedSignals" SG_ 525 SGU12_Object_ax 0;
BA_ "GenSigInvalidValue" SG_ 525 SGU12_Object_ax 0;
BA_ "GenSigTimeoutValue" SG_ 525 SGU12_Object_ax 0;
BA_ "EventCommandSignal" SG_ 525 SGU12_Object_ay 0;
BA_ "GatewayedSignals" SG_ 525 SGU12_Object_ay 0;
BA_ "GenSigInvalidValue" SG_ 525 SGU12_Object_ay 0;
BA_ "GenSigTimeoutValue" SG_ 525 SGU12_Object_ay 0;
BA_ "EventCommandSignal" SG_ 525 SGU12_Object_dx 0;
BA_ "GatewayedSignals" SG_ 525 SGU12_Object_dx 0;
BA_ "GenSigInvalidValue" SG_ 525 SGU12_Object_dx 0;
BA_ "GenSigTimeoutValue" SG_ 525 SGU12_Object_dx 0;
BA_ "EventCommandSignal" SG_ 525 SGU12_Object_dx_Rear 0;
BA_ "GatewayedSignals" SG_ 525 SGU12_Object_dx_Rear 0;
BA_ "GenSigInvalidValue" SG_ 525 SGU12_Object_dx_Rear 0;
BA_ "GenSigTimeoutValue" SG_ 525 SGU12_Object_dx_Rear 0;
BA_ "EventCommandSignal" SG_ 525 SGU12_Object_dy 0;
BA_ "GatewayedSignals" SG_ 525 SGU12_Object_dy 0;
BA_ "GenSigInvalidValue" SG_ 525 SGU12_Object_dy 0;
BA_ "GenSigTimeoutValue" SG_ 525 SGU12_Object_dy 0;
BA_ "EventCommandSignal" SG_ 525 SGU12_Object_dy_Rear 0;
BA_ "GatewayedSignals" SG_ 525 SGU12_Object_dy_Rear 0;
BA_ "GenSigInvalidValue" SG_ 525 SGU12_Object_dy_Rear 0;
BA_ "GenSigTimeoutValue" SG_ 525 SGU12_Object_dy_Rear 0;
BA_ "EventCommandSignal" SG_ 525 SGU12_Object_vx 0;
BA_ "GatewayedSignals" SG_ 525 SGU12_Object_vx 0;
BA_ "GenSigInvalidValue" SG_ 525 SGU12_Object_vx 0;
BA_ "GenSigTimeoutValue" SG_ 525 SGU12_Object_vx 0;
BA_ "EventCommandSignal" SG_ 525 SGU12_Object_vy 0;
BA_ "GatewayedSignals" SG_ 525 SGU12_Object_vy 0;
BA_ "GenSigInvalidValue" SG_ 525 SGU12_Object_vy 0;
BA_ "GenSigTimeoutValue" SG_ 525 SGU12_Object_vy 0;
BA_ "EventCommandSignal" SG_ 525 SGU12_Object_wExist 0;
BA_ "GatewayedSignals" SG_ 525 SGU12_Object_wExist 0;
BA_ "GenSigInvalidValue" SG_ 525 SGU12_Object_wExist 0;
BA_ "GenSigTimeoutValue" SG_ 525 SGU12_Object_wExist 0;
BA_ "EventCommandSignal" SG_ 525 SGU12_Object_wObstacle 0;
BA_ "GatewayedSignals" SG_ 525 SGU12_Object_wObstacle 0;
BA_ "GenSigInvalidValue" SG_ 525 SGU12_Object_wObstacle 0;
BA_ "GenSigTimeoutValue" SG_ 525 SGU12_Object_wObstacle 0;
BA_ "EventCommandSignal" SG_ 526 SGU13_BlockCounter 0;
BA_ "GatewayedSignals" SG_ 526 SGU13_BlockCounter 0;
BA_ "GenSigInvalidValue" SG_ 526 SGU13_BlockCounter 0;
BA_ "GenSigTimeoutValue" SG_ 526 SGU13_BlockCounter 0;
BA_ "EventCommandSignal" SG_ 526 SGU13_LifeCycles_OBJ 0;
BA_ "GatewayedSignals" SG_ 526 SGU13_LifeCycles_OBJ 0;
BA_ "GenSigInvalidValue" SG_ 526 SGU13_LifeCycles_OBJ 0;
BA_ "GenSigTimeoutValue" SG_ 526 SGU13_LifeCycles_OBJ 0;
BA_ "EventCommandSignal" SG_ 526 SGU13_Msg_AliveCounter 0;
BA_ "GatewayedSignals" SG_ 526 SGU13_Msg_AliveCounter 0;
BA_ "GenSigInvalidValue" SG_ 526 SGU13_Msg_AliveCounter 0;
BA_ "GenSigTimeoutValue" SG_ 526 SGU13_Msg_AliveCounter 0;
BA_ "EventCommandSignal" SG_ 526 SGU13_Msg_CheckSum 0;
BA_ "GatewayedSignals" SG_ 526 SGU13_Msg_CheckSum 0;
BA_ "GenSigInvalidValue" SG_ 526 SGU13_Msg_CheckSum 0;
BA_ "GenSigTimeoutValue" SG_ 526 SGU13_Msg_CheckSum 0;
BA_ "IsCrcSignal" SG_ 526 SGU13_Msg_CheckSum 1;
BA_ "EventCommandSignal" SG_ 526 SGU13_ObjRCS_13 0;
BA_ "GatewayedSignals" SG_ 526 SGU13_ObjRCS_13 0;
BA_ "GenSigInvalidValue" SG_ 526 SGU13_ObjRCS_13 0;
BA_ "GenSigTimeoutValue" SG_ 526 SGU13_ObjRCS_13 0;
BA_ "EventCommandSignal" SG_ 526 SGU13_Obj_DistLat_rms 0;
BA_ "GatewayedSignals" SG_ 526 SGU13_Obj_DistLat_rms 0;
BA_ "GenSigInvalidValue" SG_ 526 SGU13_Obj_DistLat_rms 0;
BA_ "GenSigTimeoutValue" SG_ 526 SGU13_Obj_DistLat_rms 0;
BA_ "EventCommandSignal" SG_ 526 SGU13_Obj_VrelLong_rms 0;
BA_ "GatewayedSignals" SG_ 526 SGU13_Obj_VrelLong_rms 0;
BA_ "GenSigInvalidValue" SG_ 526 SGU13_Obj_VrelLong_rms 0;
BA_ "GenSigTimeoutValue" SG_ 526 SGU13_Obj_VrelLong_rms 0;
BA_ "EventCommandSignal" SG_ 526 SGU13_Obj_Vrelat_rms 0;
BA_ "GatewayedSignals" SG_ 526 SGU13_Obj_Vrelat_rms 0;
BA_ "GenSigInvalidValue" SG_ 526 SGU13_Obj_Vrelat_rms 0;
BA_ "GenSigTimeoutValue" SG_ 526 SGU13_Obj_Vrelat_rms 0;
BA_ "EventCommandSignal" SG_ 526 SGU13_Object_DetStatus 0;
BA_ "GatewayedSignals" SG_ 526 SGU13_Object_DetStatus 0;
BA_ "GenSigInvalidValue" SG_ 526 SGU13_Object_DetStatus 0;
BA_ "GenSigTimeoutValue" SG_ 526 SGU13_Object_DetStatus 0;
BA_ "EventCommandSignal" SG_ 526 SGU13_Object_DistLong_rms 0;
BA_ "GatewayedSignals" SG_ 526 SGU13_Object_DistLong_rms 0;
BA_ "GenSigInvalidValue" SG_ 526 SGU13_Object_DistLong_rms 0;
BA_ "GenSigTimeoutValue" SG_ 526 SGU13_Object_DistLong_rms 0;
BA_ "EventCommandSignal" SG_ 526 SGU13_Object_ID 0;
BA_ "GatewayedSignals" SG_ 526 SGU13_Object_ID 0;
BA_ "GenSigInvalidValue" SG_ 526 SGU13_Object_ID 0;
BA_ "GenSigTimeoutValue" SG_ 526 SGU13_Object_ID 0;
BA_ "EventCommandSignal" SG_ 526 SGU13_Object_Motion_Pattern 0;
BA_ "GatewayedSignals" SG_ 526 SGU13_Object_Motion_Pattern 0;
BA_ "GenSigInvalidValue" SG_ 526 SGU13_Object_Motion_Pattern 0;
BA_ "GenSigTimeoutValue" SG_ 526 SGU13_Object_Motion_Pattern 0;
BA_ "EventCommandSignal" SG_ 526 SGU13_Object_Type 0;
BA_ "GatewayedSignals" SG_ 526 SGU13_Object_Type 0;
BA_ "GenSigInvalidValue" SG_ 526 SGU13_Object_Type 0;
BA_ "GenSigTimeoutValue" SG_ 526 SGU13_Object_Type 0;
BA_ "EventCommandSignal" SG_ 526 SGU13_Object_ax 0;
BA_ "GatewayedSignals" SG_ 526 SGU13_Object_ax 0;
BA_ "GenSigInvalidValue" SG_ 526 SGU13_Object_ax 0;
BA_ "GenSigTimeoutValue" SG_ 526 SGU13_Object_ax 0;
BA_ "EventCommandSignal" SG_ 526 SGU13_Object_ay 0;
BA_ "GatewayedSignals" SG_ 526 SGU13_Object_ay 0;
BA_ "GenSigInvalidValue" SG_ 526 SGU13_Object_ay 0;
BA_ "GenSigTimeoutValue" SG_ 526 SGU13_Object_ay 0;
BA_ "EventCommandSignal" SG_ 526 SGU13_Object_dx 0;
BA_ "GatewayedSignals" SG_ 526 SGU13_Object_dx 0;
BA_ "GenSigInvalidValue" SG_ 526 SGU13_Object_dx 0;
BA_ "GenSigTimeoutValue" SG_ 526 SGU13_Object_dx 0;
BA_ "EventCommandSignal" SG_ 526 SGU13_Object_dx_Rear 0;
BA_ "GatewayedSignals" SG_ 526 SGU13_Object_dx_Rear 0;
BA_ "GenSigInvalidValue" SG_ 526 SGU13_Object_dx_Rear 0;
BA_ "GenSigTimeoutValue" SG_ 526 SGU13_Object_dx_Rear 0;
BA_ "EventCommandSignal" SG_ 526 SGU13_Object_dy 0;
BA_ "GatewayedSignals" SG_ 526 SGU13_Object_dy 0;
BA_ "GenSigInvalidValue" SG_ 526 SGU13_Object_dy 0;
BA_ "GenSigTimeoutValue" SG_ 526 SGU13_Object_dy 0;
BA_ "EventCommandSignal" SG_ 526 SGU13_Object_dy_Rear 0;
BA_ "GatewayedSignals" SG_ 526 SGU13_Object_dy_Rear 0;
BA_ "GenSigInvalidValue" SG_ 526 SGU13_Object_dy_Rear 0;
BA_ "GenSigTimeoutValue" SG_ 526 SGU13_Object_dy_Rear 0;
BA_ "EventCommandSignal" SG_ 526 SGU13_Object_vx 0;
BA_ "GatewayedSignals" SG_ 526 SGU13_Object_vx 0;
BA_ "GenSigInvalidValue" SG_ 526 SGU13_Object_vx 0;
BA_ "GenSigTimeoutValue" SG_ 526 SGU13_Object_vx 0;
BA_ "EventCommandSignal" SG_ 526 SGU13_Object_vy 0;
BA_ "GatewayedSignals" SG_ 526 SGU13_Object_vy 0;
BA_ "GenSigInvalidValue" SG_ 526 SGU13_Object_vy 0;
BA_ "GenSigTimeoutValue" SG_ 526 SGU13_Object_vy 0;
BA_ "EventCommandSignal" SG_ 526 SGU13_Object_wExist 0;
BA_ "GatewayedSignals" SG_ 526 SGU13_Object_wExist 0;
BA_ "GenSigInvalidValue" SG_ 526 SGU13_Object_wExist 0;
BA_ "GenSigTimeoutValue" SG_ 526 SGU13_Object_wExist 0;
BA_ "EventCommandSignal" SG_ 526 SGU13_Object_wObstacle 0;
BA_ "GatewayedSignals" SG_ 526 SGU13_Object_wObstacle 0;
BA_ "GenSigInvalidValue" SG_ 526 SGU13_Object_wObstacle 0;
BA_ "GenSigTimeoutValue" SG_ 526 SGU13_Object_wObstacle 0;
BA_ "EventCommandSignal" SG_ 527 SGU14_BlockCounter 0;
BA_ "GatewayedSignals" SG_ 527 SGU14_BlockCounter 0;
BA_ "GenSigInvalidValue" SG_ 527 SGU14_BlockCounter 0;
BA_ "GenSigTimeoutValue" SG_ 527 SGU14_BlockCounter 0;
BA_ "EventCommandSignal" SG_ 527 SGU14_LifeCycles_OBJ 0;
BA_ "GatewayedSignals" SG_ 527 SGU14_LifeCycles_OBJ 0;
BA_ "GenSigInvalidValue" SG_ 527 SGU14_LifeCycles_OBJ 0;
BA_ "GenSigTimeoutValue" SG_ 527 SGU14_LifeCycles_OBJ 0;
BA_ "EventCommandSignal" SG_ 527 SGU14_Msg_AliveCounter 0;
BA_ "GatewayedSignals" SG_ 527 SGU14_Msg_AliveCounter 0;
BA_ "GenSigInvalidValue" SG_ 527 SGU14_Msg_AliveCounter 0;
BA_ "GenSigTimeoutValue" SG_ 527 SGU14_Msg_AliveCounter 0;
BA_ "EventCommandSignal" SG_ 527 SGU14_Msg_CheckSum 0;
BA_ "GatewayedSignals" SG_ 527 SGU14_Msg_CheckSum 0;
BA_ "GenSigInvalidValue" SG_ 527 SGU14_Msg_CheckSum 0;
BA_ "GenSigTimeoutValue" SG_ 527 SGU14_Msg_CheckSum 0;
BA_ "IsCrcSignal" SG_ 527 SGU14_Msg_CheckSum 1;
BA_ "EventCommandSignal" SG_ 527 SGU14_ObjRCS_14 0;
BA_ "GatewayedSignals" SG_ 527 SGU14_ObjRCS_14 0;
BA_ "GenSigInvalidValue" SG_ 527 SGU14_ObjRCS_14 0;
BA_ "GenSigTimeoutValue" SG_ 527 SGU14_ObjRCS_14 0;
BA_ "EventCommandSignal" SG_ 527 SGU14_Obj_DistLat_rms 0;
BA_ "GatewayedSignals" SG_ 527 SGU14_Obj_DistLat_rms 0;
BA_ "GenSigInvalidValue" SG_ 527 SGU14_Obj_DistLat_rms 0;
BA_ "GenSigTimeoutValue" SG_ 527 SGU14_Obj_DistLat_rms 0;
BA_ "EventCommandSignal" SG_ 527 SGU14_Obj_VrelLong_rms 0;
BA_ "GatewayedSignals" SG_ 527 SGU14_Obj_VrelLong_rms 0;
BA_ "GenSigInvalidValue" SG_ 527 SGU14_Obj_VrelLong_rms 0;
BA_ "GenSigTimeoutValue" SG_ 527 SGU14_Obj_VrelLong_rms 0;
BA_ "EventCommandSignal" SG_ 527 SGU14_Obj_Vrelat_rms 0;
BA_ "GatewayedSignals" SG_ 527 SGU14_Obj_Vrelat_rms 0;
BA_ "GenSigInvalidValue" SG_ 527 SGU14_Obj_Vrelat_rms 0;
BA_ "GenSigTimeoutValue" SG_ 527 SGU14_Obj_Vrelat_rms 0;
BA_ "EventCommandSignal" SG_ 527 SGU14_Object_DetStatus 0;
BA_ "GatewayedSignals" SG_ 527 SGU14_Object_DetStatus 0;
BA_ "GenSigInvalidValue" SG_ 527 SGU14_Object_DetStatus 0;
BA_ "GenSigTimeoutValue" SG_ 527 SGU14_Object_DetStatus 0;
BA_ "EventCommandSignal" SG_ 527 SGU14_Object_DistLong_rms 0;
BA_ "GatewayedSignals" SG_ 527 SGU14_Object_DistLong_rms 0;
BA_ "GenSigInvalidValue" SG_ 527 SGU14_Object_DistLong_rms 0;
BA_ "GenSigTimeoutValue" SG_ 527 SGU14_Object_DistLong_rms 0;
BA_ "EventCommandSignal" SG_ 527 SGU14_Object_ID 0;
BA_ "GatewayedSignals" SG_ 527 SGU14_Object_ID 0;
BA_ "GenSigInvalidValue" SG_ 527 SGU14_Object_ID 0;
BA_ "GenSigTimeoutValue" SG_ 527 SGU14_Object_ID 0;
BA_ "EventCommandSignal" SG_ 527 SGU14_Object_Motion_Pattern 0;
BA_ "GatewayedSignals" SG_ 527 SGU14_Object_Motion_Pattern 0;
BA_ "GenSigInvalidValue" SG_ 527 SGU14_Object_Motion_Pattern 0;
BA_ "GenSigTimeoutValue" SG_ 527 SGU14_Object_Motion_Pattern 0;
BA_ "EventCommandSignal" SG_ 527 SGU14_Object_Type 0;
BA_ "GatewayedSignals" SG_ 527 SGU14_Object_Type 0;
BA_ "GenSigInvalidValue" SG_ 527 SGU14_Object_Type 0;
BA_ "GenSigTimeoutValue" SG_ 527 SGU14_Object_Type 0;
BA_ "EventCommandSignal" SG_ 527 SGU14_Object_ax 0;
BA_ "GatewayedSignals" SG_ 527 SGU14_Object_ax 0;
BA_ "GenSigInvalidValue" SG_ 527 SGU14_Object_ax 0;
BA_ "GenSigTimeoutValue" SG_ 527 SGU14_Object_ax 0;
BA_ "EventCommandSignal" SG_ 527 SGU14_Object_ay 0;
BA_ "GatewayedSignals" SG_ 527 SGU14_Object_ay 0;
BA_ "GenSigInvalidValue" SG_ 527 SGU14_Object_ay 0;
BA_ "GenSigTimeoutValue" SG_ 527 SGU14_Object_ay 0;
BA_ "EventCommandSignal" SG_ 527 SGU14_Object_dx 0;
BA_ "GatewayedSignals" SG_ 527 SGU14_Object_dx 0;
BA_ "GenSigInvalidValue" SG_ 527 SGU14_Object_dx 0;
BA_ "GenSigTimeoutValue" SG_ 527 SGU14_Object_dx 0;
BA_ "EventCommandSignal" SG_ 527 SGU14_Object_dx_Rear 0;
BA_ "GatewayedSignals" SG_ 527 SGU14_Object_dx_Rear 0;
BA_ "GenSigInvalidValue" SG_ 527 SGU14_Object_dx_Rear 0;
BA_ "GenSigTimeoutValue" SG_ 527 SGU14_Object_dx_Rear 0;
BA_ "EventCommandSignal" SG_ 527 SGU14_Object_dy 0;
BA_ "GatewayedSignals" SG_ 527 SGU14_Object_dy 0;
BA_ "GenSigInvalidValue" SG_ 527 SGU14_Object_dy 0;
BA_ "GenSigTimeoutValue" SG_ 527 SGU14_Object_dy 0;
BA_ "EventCommandSignal" SG_ 527 SGU14_Object_dy_Rear 0;
BA_ "GatewayedSignals" SG_ 527 SGU14_Object_dy_Rear 0;
BA_ "GenSigInvalidValue" SG_ 527 SGU14_Object_dy_Rear 0;
BA_ "GenSigTimeoutValue" SG_ 527 SGU14_Object_dy_Rear 0;
BA_ "EventCommandSignal" SG_ 527 SGU14_Object_vx 0;
BA_ "GatewayedSignals" SG_ 527 SGU14_Object_vx 0;
BA_ "GenSigInvalidValue" SG_ 527 SGU14_Object_vx 0;
BA_ "GenSigTimeoutValue" SG_ 527 SGU14_Object_vx 0;
BA_ "EventCommandSignal" SG_ 527 SGU14_Object_vy 0;
BA_ "GatewayedSignals" SG_ 527 SGU14_Object_vy 0;
BA_ "GenSigInvalidValue" SG_ 527 SGU14_Object_vy 0;
BA_ "GenSigTimeoutValue" SG_ 527 SGU14_Object_vy 0;
BA_ "EventCommandSignal" SG_ 527 SGU14_Object_wExist 0;
BA_ "GatewayedSignals" SG_ 527 SGU14_Object_wExist 0;
BA_ "GenSigInvalidValue" SG_ 527 SGU14_Object_wExist 0;
BA_ "GenSigTimeoutValue" SG_ 527 SGU14_Object_wExist 0;
BA_ "EventCommandSignal" SG_ 527 SGU14_Object_wObstacle 0;
BA_ "GatewayedSignals" SG_ 527 SGU14_Object_wObstacle 0;
BA_ "GenSigInvalidValue" SG_ 527 SGU14_Object_wObstacle 0;
BA_ "GenSigTimeoutValue" SG_ 527 SGU14_Object_wObstacle 0;
BA_ "EventCommandSignal" SG_ 528 SGU15_BlockCounter 0;
BA_ "GatewayedSignals" SG_ 528 SGU15_BlockCounter 0;
BA_ "GenSigInvalidValue" SG_ 528 SGU15_BlockCounter 0;
BA_ "GenSigTimeoutValue" SG_ 528 SGU15_BlockCounter 0;
BA_ "EventCommandSignal" SG_ 528 SGU15_LifeCycles_OBJ 0;
BA_ "GatewayedSignals" SG_ 528 SGU15_LifeCycles_OBJ 0;
BA_ "GenSigInvalidValue" SG_ 528 SGU15_LifeCycles_OBJ 0;
BA_ "GenSigTimeoutValue" SG_ 528 SGU15_LifeCycles_OBJ 0;
BA_ "EventCommandSignal" SG_ 528 SGU15_Msg_AliveCounter 0;
BA_ "GatewayedSignals" SG_ 528 SGU15_Msg_AliveCounter 0;
BA_ "GenSigInvalidValue" SG_ 528 SGU15_Msg_AliveCounter 0;
BA_ "GenSigTimeoutValue" SG_ 528 SGU15_Msg_AliveCounter 0;
BA_ "EventCommandSignal" SG_ 528 SGU15_Msg_CheckSum 0;
BA_ "GatewayedSignals" SG_ 528 SGU15_Msg_CheckSum 0;
BA_ "GenSigInvalidValue" SG_ 528 SGU15_Msg_CheckSum 0;
BA_ "GenSigTimeoutValue" SG_ 528 SGU15_Msg_CheckSum 0;
BA_ "IsCrcSignal" SG_ 528 SGU15_Msg_CheckSum 1;
BA_ "EventCommandSignal" SG_ 528 SGU15_ObjRCS_15 0;
BA_ "GatewayedSignals" SG_ 528 SGU15_ObjRCS_15 0;
BA_ "GenSigInvalidValue" SG_ 528 SGU15_ObjRCS_15 0;
BA_ "GenSigTimeoutValue" SG_ 528 SGU15_ObjRCS_15 0;
BA_ "EventCommandSignal" SG_ 528 SGU15_Obj_DistLat_rms 0;
BA_ "GatewayedSignals" SG_ 528 SGU15_Obj_DistLat_rms 0;
BA_ "GenSigInvalidValue" SG_ 528 SGU15_Obj_DistLat_rms 0;
BA_ "GenSigTimeoutValue" SG_ 528 SGU15_Obj_DistLat_rms 0;
BA_ "EventCommandSignal" SG_ 528 SGU15_Obj_VrelLong_rms 0;
BA_ "GatewayedSignals" SG_ 528 SGU15_Obj_VrelLong_rms 0;
BA_ "GenSigInvalidValue" SG_ 528 SGU15_Obj_VrelLong_rms 0;
BA_ "GenSigTimeoutValue" SG_ 528 SGU15_Obj_VrelLong_rms 0;
BA_ "EventCommandSignal" SG_ 528 SGU15_Obj_Vrelat_rms 0;
BA_ "GatewayedSignals" SG_ 528 SGU15_Obj_Vrelat_rms 0;
BA_ "GenSigInvalidValue" SG_ 528 SGU15_Obj_Vrelat_rms 0;
BA_ "GenSigTimeoutValue" SG_ 528 SGU15_Obj_Vrelat_rms 0;
BA_ "EventCommandSignal" SG_ 528 SGU15_Object_DetStatus 0;
BA_ "GatewayedSignals" SG_ 528 SGU15_Object_DetStatus 0;
BA_ "GenSigInvalidValue" SG_ 528 SGU15_Object_DetStatus 0;
BA_ "GenSigTimeoutValue" SG_ 528 SGU15_Object_DetStatus 0;
BA_ "EventCommandSignal" SG_ 528 SGU15_Object_DistLong_rms 0;
BA_ "GatewayedSignals" SG_ 528 SGU15_Object_DistLong_rms 0;
BA_ "GenSigInvalidValue" SG_ 528 SGU15_Object_DistLong_rms 0;
BA_ "GenSigTimeoutValue" SG_ 528 SGU15_Object_DistLong_rms 0;
BA_ "EventCommandSignal" SG_ 528 SGU15_Object_ID 0;
BA_ "GatewayedSignals" SG_ 528 SGU15_Object_ID 0;
BA_ "GenSigInvalidValue" SG_ 528 SGU15_Object_ID 0;
BA_ "GenSigTimeoutValue" SG_ 528 SGU15_Object_ID 0;
BA_ "EventCommandSignal" SG_ 528 SGU15_Object_Motion_Pattern 0;
BA_ "GatewayedSignals" SG_ 528 SGU15_Object_Motion_Pattern 0;
BA_ "GenSigInvalidValue" SG_ 528 SGU15_Object_Motion_Pattern 0;
BA_ "GenSigTimeoutValue" SG_ 528 SGU15_Object_Motion_Pattern 0;
BA_ "EventCommandSignal" SG_ 528 SGU15_Object_Type 0;
BA_ "GatewayedSignals" SG_ 528 SGU15_Object_Type 0;
BA_ "GenSigInvalidValue" SG_ 528 SGU15_Object_Type 0;
BA_ "GenSigTimeoutValue" SG_ 528 SGU15_Object_Type 0;
BA_ "EventCommandSignal" SG_ 528 SGU15_Object_ax 0;
BA_ "GatewayedSignals" SG_ 528 SGU15_Object_ax 0;
BA_ "GenSigInvalidValue" SG_ 528 SGU15_Object_ax 0;
BA_ "GenSigTimeoutValue" SG_ 528 SGU15_Object_ax 0;
BA_ "EventCommandSignal" SG_ 528 SGU15_Object_ay 0;
BA_ "GatewayedSignals" SG_ 528 SGU15_Object_ay 0;
BA_ "GenSigInvalidValue" SG_ 528 SGU15_Object_ay 0;
BA_ "GenSigTimeoutValue" SG_ 528 SGU15_Object_ay 0;
BA_ "EventCommandSignal" SG_ 528 SGU15_Object_dx 0;
BA_ "GatewayedSignals" SG_ 528 SGU15_Object_dx 0;
BA_ "GenSigInvalidValue" SG_ 528 SGU15_Object_dx 0;
BA_ "GenSigTimeoutValue" SG_ 528 SGU15_Object_dx 0;
BA_ "EventCommandSignal" SG_ 528 SGU15_Object_dx_Rear 0;
BA_ "GatewayedSignals" SG_ 528 SGU15_Object_dx_Rear 0;
BA_ "GenSigInvalidValue" SG_ 528 SGU15_Object_dx_Rear 0;
BA_ "GenSigTimeoutValue" SG_ 528 SGU15_Object_dx_Rear 0;
BA_ "EventCommandSignal" SG_ 528 SGU15_Object_dy 0;
BA_ "GatewayedSignals" SG_ 528 SGU15_Object_dy 0;
BA_ "GenSigInvalidValue" SG_ 528 SGU15_Object_dy 0;
BA_ "GenSigTimeoutValue" SG_ 528 SGU15_Object_dy 0;
BA_ "EventCommandSignal" SG_ 528 SGU15_Object_dy_Rear 0;
BA_ "GatewayedSignals" SG_ 528 SGU15_Object_dy_Rear 0;
BA_ "GenSigInvalidValue" SG_ 528 SGU15_Object_dy_Rear 0;
BA_ "GenSigTimeoutValue" SG_ 528 SGU15_Object_dy_Rear 0;
BA_ "EventCommandSignal" SG_ 528 SGU15_Object_vx 0;
BA_ "GatewayedSignals" SG_ 528 SGU15_Object_vx 0;
BA_ "GenSigInvalidValue" SG_ 528 SGU15_Object_vx 0;
BA_ "GenSigTimeoutValue" SG_ 528 SGU15_Object_vx 0;
BA_ "EventCommandSignal" SG_ 528 SGU15_Object_vy 0;
BA_ "GatewayedSignals" SG_ 528 SGU15_Object_vy 0;
BA_ "GenSigInvalidValue" SG_ 528 SGU15_Object_vy 0;
BA_ "GenSigTimeoutValue" SG_ 528 SGU15_Object_vy 0;
BA_ "EventCommandSignal" SG_ 528 SGU15_Object_wExist 0;
BA_ "GatewayedSignals" SG_ 528 SGU15_Object_wExist 0;
BA_ "GenSigInvalidValue" SG_ 528 SGU15_Object_wExist 0;
BA_ "GenSigTimeoutValue" SG_ 528 SGU15_Object_wExist 0;
BA_ "EventCommandSignal" SG_ 528 SGU15_Object_wObstacle 0;
BA_ "GatewayedSignals" SG_ 528 SGU15_Object_wObstacle 0;
BA_ "GenSigInvalidValue" SG_ 528 SGU15_Object_wObstacle 0;
BA_ "GenSigTimeoutValue" SG_ 528 SGU15_Object_wObstacle 0;
BA_ "EventCommandSignal" SG_ 529 SGU16_BlockCounter 0;
BA_ "GatewayedSignals" SG_ 529 SGU16_BlockCounter 0;
BA_ "GenSigInvalidValue" SG_ 529 SGU16_BlockCounter 0;
BA_ "GenSigTimeoutValue" SG_ 529 SGU16_BlockCounter 0;
BA_ "EventCommandSignal" SG_ 529 SGU16_LifeCycles_OBJ 0;
BA_ "GatewayedSignals" SG_ 529 SGU16_LifeCycles_OBJ 0;
BA_ "GenSigInvalidValue" SG_ 529 SGU16_LifeCycles_OBJ 0;
BA_ "GenSigTimeoutValue" SG_ 529 SGU16_LifeCycles_OBJ 0;
BA_ "EventCommandSignal" SG_ 529 SGU16_Msg_AliveCounter 0;
BA_ "GatewayedSignals" SG_ 529 SGU16_Msg_AliveCounter 0;
BA_ "GenSigInvalidValue" SG_ 529 SGU16_Msg_AliveCounter 0;
BA_ "GenSigTimeoutValue" SG_ 529 SGU16_Msg_AliveCounter 0;
BA_ "EventCommandSignal" SG_ 529 SGU16_Msg_CheckSum 0;
BA_ "GatewayedSignals" SG_ 529 SGU16_Msg_CheckSum 0;
BA_ "GenSigInvalidValue" SG_ 529 SGU16_Msg_CheckSum 0;
BA_ "GenSigTimeoutValue" SG_ 529 SGU16_Msg_CheckSum 0;
BA_ "IsCrcSignal" SG_ 529 SGU16_Msg_CheckSum 1;
BA_ "EventCommandSignal" SG_ 529 SGU16_ObjRCS_16 0;
BA_ "GatewayedSignals" SG_ 529 SGU16_ObjRCS_16 0;
BA_ "GenSigInvalidValue" SG_ 529 SGU16_ObjRCS_16 0;
BA_ "GenSigTimeoutValue" SG_ 529 SGU16_ObjRCS_16 0;
BA_ "EventCommandSignal" SG_ 529 SGU16_Obj_DistLat_rms 0;
BA_ "GatewayedSignals" SG_ 529 SGU16_Obj_DistLat_rms 0;
BA_ "GenSigInvalidValue" SG_ 529 SGU16_Obj_DistLat_rms 0;
BA_ "GenSigTimeoutValue" SG_ 529 SGU16_Obj_DistLat_rms 0;
BA_ "EventCommandSignal" SG_ 529 SGU16_Obj_VrelLong_rms 0;
BA_ "GatewayedSignals" SG_ 529 SGU16_Obj_VrelLong_rms 0;
BA_ "GenSigInvalidValue" SG_ 529 SGU16_Obj_VrelLong_rms 0;
BA_ "GenSigTimeoutValue" SG_ 529 SGU16_Obj_VrelLong_rms 0;
BA_ "EventCommandSignal" SG_ 529 SGU16_Obj_Vrelat_rms 0;
BA_ "GatewayedSignals" SG_ 529 SGU16_Obj_Vrelat_rms 0;
BA_ "GenSigInvalidValue" SG_ 529 SGU16_Obj_Vrelat_rms 0;
BA_ "GenSigTimeoutValue" SG_ 529 SGU16_Obj_Vrelat_rms 0;
BA_ "EventCommandSignal" SG_ 529 SGU16_Object_DetStatus 0;
BA_ "GatewayedSignals" SG_ 529 SGU16_Object_DetStatus 0;
BA_ "GenSigInvalidValue" SG_ 529 SGU16_Object_DetStatus 0;
BA_ "GenSigTimeoutValue" SG_ 529 SGU16_Object_DetStatus 0;
BA_ "EventCommandSignal" SG_ 529 SGU16_Object_DistLong_rms 0;
BA_ "GatewayedSignals" SG_ 529 SGU16_Object_DistLong_rms 0;
BA_ "GenSigInvalidValue" SG_ 529 SGU16_Object_DistLong_rms 0;
BA_ "GenSigTimeoutValue" SG_ 529 SGU16_Object_DistLong_rms 0;
BA_ "EventCommandSignal" SG_ 529 SGU16_Object_ID 0;
BA_ "GatewayedSignals" SG_ 529 SGU16_Object_ID 0;
BA_ "GenSigInvalidValue" SG_ 529 SGU16_Object_ID 0;
BA_ "GenSigTimeoutValue" SG_ 529 SGU16_Object_ID 0;
BA_ "EventCommandSignal" SG_ 529 SGU16_Object_Motion_Pattern 0;
BA_ "GatewayedSignals" SG_ 529 SGU16_Object_Motion_Pattern 0;
BA_ "GenSigInvalidValue" SG_ 529 SGU16_Object_Motion_Pattern 0;
BA_ "GenSigTimeoutValue" SG_ 529 SGU16_Object_Motion_Pattern 0;
BA_ "EventCommandSignal" SG_ 529 SGU16_Object_Type 0;
BA_ "GatewayedSignals" SG_ 529 SGU16_Object_Type 0;
BA_ "GenSigInvalidValue" SG_ 529 SGU16_Object_Type 0;
BA_ "GenSigTimeoutValue" SG_ 529 SGU16_Object_Type 0;
BA_ "EventCommandSignal" SG_ 529 SGU16_Object_ax 0;
BA_ "GatewayedSignals" SG_ 529 SGU16_Object_ax 0;
BA_ "GenSigInvalidValue" SG_ 529 SGU16_Object_ax 0;
BA_ "GenSigTimeoutValue" SG_ 529 SGU16_Object_ax 0;
BA_ "EventCommandSignal" SG_ 529 SGU16_Object_ay 0;
BA_ "GatewayedSignals" SG_ 529 SGU16_Object_ay 0;
BA_ "GenSigInvalidValue" SG_ 529 SGU16_Object_ay 0;
BA_ "GenSigTimeoutValue" SG_ 529 SGU16_Object_ay 0;
BA_ "EventCommandSignal" SG_ 529 SGU16_Object_dx 0;
BA_ "GatewayedSignals" SG_ 529 SGU16_Object_dx 0;
BA_ "GenSigInvalidValue" SG_ 529 SGU16_Object_dx 0;
BA_ "GenSigTimeoutValue" SG_ 529 SGU16_Object_dx 0;
BA_ "EventCommandSignal" SG_ 529 SGU16_Object_dx_Rear 0;
BA_ "GatewayedSignals" SG_ 529 SGU16_Object_dx_Rear 0;
BA_ "GenSigInvalidValue" SG_ 529 SGU16_Object_dx_Rear 0;
BA_ "GenSigTimeoutValue" SG_ 529 SGU16_Object_dx_Rear 0;
BA_ "EventCommandSignal" SG_ 529 SGU16_Object_dy 0;
BA_ "GatewayedSignals" SG_ 529 SGU16_Object_dy 0;
BA_ "GenSigInvalidValue" SG_ 529 SGU16_Object_dy 0;
BA_ "GenSigTimeoutValue" SG_ 529 SGU16_Object_dy 0;
BA_ "EventCommandSignal" SG_ 529 SGU16_Object_dy_Rear 0;
BA_ "GatewayedSignals" SG_ 529 SGU16_Object_dy_Rear 0;
BA_ "GenSigInvalidValue" SG_ 529 SGU16_Object_dy_Rear 0;
BA_ "GenSigTimeoutValue" SG_ 529 SGU16_Object_dy_Rear 0;
BA_ "EventCommandSignal" SG_ 529 SGU16_Object_vx 0;
BA_ "GatewayedSignals" SG_ 529 SGU16_Object_vx 0;
BA_ "GenSigInvalidValue" SG_ 529 SGU16_Object_vx 0;
BA_ "GenSigTimeoutValue" SG_ 529 SGU16_Object_vx 0;
BA_ "EventCommandSignal" SG_ 529 SGU16_Object_vy 0;
BA_ "GatewayedSignals" SG_ 529 SGU16_Object_vy 0;
BA_ "GenSigInvalidValue" SG_ 529 SGU16_Object_vy 0;
BA_ "GenSigTimeoutValue" SG_ 529 SGU16_Object_vy 0;
BA_ "EventCommandSignal" SG_ 529 SGU16_Object_wExist 0;
BA_ "GatewayedSignals" SG_ 529 SGU16_Object_wExist 0;
BA_ "GenSigInvalidValue" SG_ 529 SGU16_Object_wExist 0;
BA_ "GenSigTimeoutValue" SG_ 529 SGU16_Object_wExist 0;
BA_ "EventCommandSignal" SG_ 529 SGU16_Object_wObstacle 0;
BA_ "GatewayedSignals" SG_ 529 SGU16_Object_wObstacle 0;
BA_ "GenSigInvalidValue" SG_ 529 SGU16_Object_wObstacle 0;
BA_ "GenSigTimeoutValue" SG_ 529 SGU16_Object_wObstacle 0;
BA_ "VFrameFormat" BO_ 352 14;
BA_ "VFrameFormat" BO_ 353 14;
BA_ "VFrameFormat" BO_ 363 14;
BA_ "VFrameFormat" BO_ 38 14;
BA_ "VFrameFormat" BO_ 394 14;
BA_ "VFrameFormat" BO_ 513 14;
BA_ "VFrameFormat" BO_ 514 14;
BA_ "VFrameFormat" BO_ 515 14;
BA_ "VFrameFormat" BO_ 516 14;
BA_ "VFrameFormat" BO_ 517 14;
BA_ "VFrameFormat" BO_ 518 14;
BA_ "VFrameFormat" BO_ 519 14;
BA_ "VFrameFormat" BO_ 520 14;
BA_ "VFrameFormat" BO_ 521 14;
BA_ "VFrameFormat" BO_ 522 14;
BA_ "VFrameFormat" BO_ 523 14;
BA_ "VFrameFormat" BO_ 524 14;
BA_ "VFrameFormat" BO_ 525 14;
BA_ "VFrameFormat" BO_ 526 14;
BA_ "VFrameFormat" BO_ 527 14;
BA_ "VFrameFormat" BO_ 528 14;
BA_ "VFrameFormat" BO_ 529 14;

VAL_ 352 BCS_ABSActiveSt 0 "Not valid" 1 "Valid"  ;
VAL_ 352 BCS_ABSFaultSt 0 "Not fault" 1 "Fault"  ;
VAL_ 352 BCS_TCSActiveSt 0 "Not active" 1 "Active"  ;
VAL_ 352 BCS_TCSFaultSt 0 "Not fault" 1 "Fault"  ;
VAL_ 352 BCS_VDCActiveSt 0 "Not active" 1 "Active"  ;
VAL_ 352 BCS_VDCFaultSt 0 "Not fault" 1 "Fault"  ;
VAL_ 352 SOC_VehSpdVD 0 "Not Valid" 1 "Valid"  ;
VAL_ 353 BCS_VehicleStandStillSt 0 "Not standstill" 1 "standstill" 2 "Invalid (short unavailability, max 3s)" 3 "Not used"  ;
VAL_ 363 EPS_FunctionStyleSt 0 "Unknow" 1 "Standard" 2 "Comfort" 3 "Sport"  ;
VAL_ 363 EPS_SteeringAngleSpdVD 0 "Not valid" 1 "Valid"  ;
VAL_ 363 EPS_SteeringAngleVD 0 "Not valid" 1 "Valid"  ;
VAL_ 363 EPS_SteeringModeSt 0 "Not ready" 1 "Ready" 2 "In transition" 3 "Reserved"  ;
VAL_ 394 BCS_ActVehLaltrlAccelVD 0 "Not valid" 1 "Valid"  ;
VAL_ 394 BCS_ActVehLongAccelVD 0 "Not valid" 1 "Valid"  ;
VAL_ 394 BCS_FLWheelRotatedDirection 0 "Forward" 1 "Backward"  ;
VAL_ 394 BCS_FLWheelRotatedDirectionVD 0 "Not valid" 1 "Valid"  ;
VAL_ 394 BCS_FLWheelSpdVD 0 "Not valid" 1 "Valid"  ;
VAL_ 394 BCS_FRWheelRotatedDirection 0 "Forward" 1 "Backward"  ;
VAL_ 394 BCS_FRWheelRotatedDirectionVD 0 "Not valid" 1 "Valid"  ;
VAL_ 394 BCS_FRWheelSpdVD 0 "Not valid" 1 "Valid"  ;
VAL_ 394 BCS_RLWheelRotatedDirection 0 "Forward" 1 "Backward"  ;
VAL_ 394 BCS_RLWheelRotatedDirectionVD 0 "Not valid" 1 "Valid"  ;
VAL_ 394 BCS_RLWheelSpdVD 0 "Not valid" 1 "Valid"  ;
VAL_ 394 BCS_RRWheelRotatedDirection 0 "Forward" 1 "Backward"  ;
VAL_ 394 BCS_RRWheelRotatedDirectionVD 0 "Not valid" 1 "Valid"  ;
VAL_ 394 BCS_RRWheelSpdVD 0 "Not valid" 1 "Valid"  ;
VAL_ 394 BCS_YawRateSt 0 "Not valid" 1 "Valid"  ;
VAL_ 513 RRR_Moudulation_State 0 "ON" 1 "OFF"  ;
VAL_ 513 RRR_OperationMode 0 "ON" 1 "Sensor covered"  ;
VAL_ 513 RRR_SGUFail 0 "No fail" 1 "SGU failed"  ;
VAL_ 513 RRR_SensorType 0 "Unknown" 1 "Front Radar" 2 "Rear Radar" 3 "Front Left Radar (Corner)" 4 "Front Right Radar (Corner)" 5 "Rear Left Radar (Corner)" 6 "Rear Right Radar (Corner)" 7 "Reserve"  ;
VAL_ 513 RRR_Signal_Operatation_Channel 0 "no operation" 1 "SOC channel" 2 "MCU channel" 3 "IFC channel"  ;
VAL_ 513 RRR_Signal_Operation_State 0 "Initial State" 1 "Main State" 2 "Redundance State" 3 "Failed State"  ;
VAL_ 513 RRR_TimeSync_Operatation_Channel 0 "no operation" 1 "SOC channel" 2 "MCU channel" 3 "reserved"  ;
VAL_ 513 RRR_TimeSync_Operation_State 0 "Initial State" 1 "Main State" 2 "Redundance State" 3 "Failed State"  ;
VAL_ 514 SGU1_Object_DetStatus 0 "deleted" 1 "new" 2 "measured" 3 "predicted" 4 "deleted for merge" 5 "new from  merge"  ;
VAL_ 514 SGU1_Object_Motion_Pattern 0 "Unknown" 1 "Stationary" 2 "Stopped" 3 "Moving"  ;
VAL_ 514 SGU1_Object_Type 0 "Unknown" 1 "4 wheeler" 2 "2 wheeler" 3 "Pedestrian"  ;
VAL_ 515 SGU2_Object_DetStatus 0 "deleted" 1 "new" 2 "measured" 3 "predicted" 4 "deleted for merge" 5 "new from  merge"  ;
VAL_ 515 SGU2_Object_Motion_Pattern 0 "Unknown" 1 "Stationary" 2 "Stopped" 3 "Moving"  ;
VAL_ 515 SGU2_Object_Type 0 "Unknown" 1 "4 wheeler" 2 "2 wheeler" 3 "Pedestrian"  ;
VAL_ 516 SGU3_Object_DetStatus 0 "deleted" 1 "new" 2 "measured" 3 "predicted" 4 "deleted for merge" 5 "new from  merge"  ;
VAL_ 516 SGU3_Object_Motion_Pattern 0 "Unknown" 1 "Stationary" 2 "Stopped" 3 "Moving"  ;
VAL_ 516 SGU3_Object_Type 0 "Unknown" 1 "4 wheeler" 2 "2 wheeler" 3 "Pedestrian"  ;
VAL_ 517 SGU4_Object_DetStatus 0 "deleted" 1 "new" 2 "measured" 3 "predicted" 4 "deleted for merge" 5 "new from  merge"  ;
VAL_ 517 SGU4_Object_Motion_Pattern 0 "Unknown" 1 "Stationary" 2 "Stopped" 3 "Moving"  ;
VAL_ 517 SGU4_Object_Type 0 "Unknown" 1 "4 wheeler" 2 "2 wheeler" 3 "Pedestrian"  ;
VAL_ 518 SGU5_Object_DetStatus 0 "deleted" 1 "new" 2 "measured" 3 "predicted" 4 "deleted for merge" 5 "new from  merge"  ;
VAL_ 518 SGU5_Object_Motion_Pattern 0 "Unknown" 1 "Stationary" 2 "Stopped" 3 "Moving"  ;
VAL_ 518 SGU5_Object_Type 0 "Unknown" 1 "4 wheeler" 2 "2 wheeler" 3 "Pedestrian"  ;
VAL_ 519 SGU6_Object_DetStatus 0 "deleted" 1 "new" 2 "measured" 3 "predicted" 4 "deleted for merge" 5 "new from  merge"  ;
VAL_ 519 SGU6_Object_Motion_Pattern 0 "Unknown" 1 "Stationary" 2 "Stopped" 3 "Moving"  ;
VAL_ 519 SGU6_Object_Type 0 "Unknown" 1 "4 wheeler" 2 "2 wheeler" 3 "Pedestrian"  ;
VAL_ 520 SGU7_Object_DetStatus 0 "deleted" 1 "new" 2 "measured" 3 "predicted" 4 "deleted for merge" 5 "new from  merge"  ;
VAL_ 520 SGU7_Object_Motion_Pattern 0 "Unknown" 1 "Stationary" 2 "Stopped" 3 "Moving"  ;
VAL_ 520 SGU7_Object_Type 0 "Unknown" 1 "4 wheeler" 2 "2 wheeler" 3 "Pedestrian"  ;
VAL_ 521 SGU8_Object_DetStatus 0 "deleted" 1 "new" 2 "measured" 3 "predicted" 4 "deleted for merge" 5 "new from  merge"  ;
VAL_ 521 SGU8_Object_Motion_Pattern 0 "Unknown" 1 "Stationary" 2 "Stopped" 3 "Moving"  ;
VAL_ 521 SGU8_Object_Type 0 "Unknown" 1 "4 wheeler" 2 "2 wheeler" 3 "Pedestrian"  ;
VAL_ 522 SGU9_Object_DetStatus 0 "deleted" 1 "new" 2 "measured" 3 "predicted" 4 "deleted for merge" 5 "new from  merge"  ;
VAL_ 522 SGU9_Object_Motion_Pattern 0 "Unknown" 1 "Stationary" 2 "Stopped" 3 "Moving"  ;
VAL_ 522 SGU9_Object_Type 0 "Unknown" 1 "4 wheeler" 2 "2 wheeler" 3 "Pedestrian"  ;
VAL_ 523 SGU10_Object_DetStatus 0 "deleted" 1 "new" 2 "measured" 3 "predicted" 4 "deleted for merge" 5 "new from  merge"  ;
VAL_ 523 SGU10_Object_Motion_Pattern 0 "Unknown" 1 "Stationary" 2 "Stopped" 3 "Moving"  ;
VAL_ 523 SGU10_Object_Type 0 "Unknown" 1 "4 wheeler" 2 "2 wheeler" 3 "Pedestrian"  ;
VAL_ 524 SGU11_Object_DetStatus 0 "deleted" 1 "new" 2 "measured" 3 "predicted" 4 "deleted for merge" 5 "new from  merge"  ;
VAL_ 524 SGU11_Object_Motion_Pattern 0 "Unknown" 1 "Stationary" 2 "Stopped" 3 "Moving"  ;
VAL_ 524 SGU11_Object_Type 0 "Unknown" 1 "4 wheeler" 2 "2 wheeler" 3 "Pedestrian"  ;
VAL_ 525 SGU12_Object_DetStatus 0 "deleted" 1 "new" 2 "measured" 3 "predicted" 4 "deleted for merge" 5 "new from  merge"  ;
VAL_ 525 SGU12_Object_Motion_Pattern 0 "Unknown" 1 "Stationary" 2 "Stopped" 3 "Moving"  ;
VAL_ 525 SGU12_Object_Type 0 "Unknown" 1 "4 wheeler" 2 "2 wheeler" 3 "Pedestrian"  ;
VAL_ 526 SGU13_Object_DetStatus 0 "deleted" 1 "new" 2 "measured" 3 "predicted" 4 "deleted for merge" 5 "new from  merge"  ;
VAL_ 526 SGU13_Object_Motion_Pattern 0 "Unknown" 1 "Stationary" 2 "Stopped" 3 "Moving"  ;
VAL_ 526 SGU13_Object_Type 0 "Unknown" 1 "4 wheeler" 2 "2 wheeler" 3 "Pedestrian"  ;
VAL_ 527 SGU14_Object_DetStatus 0 "deleted" 1 "new" 2 "measured" 3 "predicted" 4 "deleted for merge" 5 "new from  merge"  ;
VAL_ 527 SGU14_Object_Motion_Pattern 0 "Unknown" 1 "Stationary" 2 "Stopped" 3 "Moving"  ;
VAL_ 527 SGU14_Object_Type 0 "Unknown" 1 "4 wheeler" 2 "2 wheeler" 3 "Pedestrian"  ;
VAL_ 528 SGU15_Object_DetStatus 0 "deleted" 1 "new" 2 "measured" 3 "predicted" 4 "deleted for merge" 5 "new from  merge"  ;
VAL_ 528 SGU15_Object_Motion_Pattern 0 "Unknown" 1 "Stationary" 2 "Stopped" 3 "Moving"  ;
VAL_ 528 SGU15_Object_Type 0 "Unknown" 1 "4 wheeler" 2 "2 wheeler" 3 "Pedestrian"  ;
VAL_ 529 SGU16_Object_DetStatus 0 "deleted" 1 "new" 2 "measured" 3 "predicted" 4 "deleted for merge" 5 "new from  merge"  ;
VAL_ 529 SGU16_Object_Motion_Pattern 0 "Unknown" 1 "Stationary" 2 "Stopped" 3 "Moving"  ;
VAL_ 529 SGU16_Object_Type 0 "Unknown" 1 "4 wheeler" 2 "2 wheeler" 3 "Pedestrian"  ;
