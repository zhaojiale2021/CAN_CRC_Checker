VERSION "Version"

NS_ :

BS_:

BU_: Tester CCU INU ADC RRR RLR CCURT1 CCURT2 ZCUF ZCUL ZCUR ZCUT EMS IDM DCDC DCDCI IPS NIDU DCU2 OBC OPC LPC CPC EMCM GCU DCU IPU BMS EOP EVCC DCDC2 EDL SRS ECS EPS EPB RBM IBCS ICM IID IDC AMP WHUD ARHUD IMR FIMR CD IFC FAPA PAS PCS SCMF SCMR SCMRL SCMRR MFS DRM FCP RCP LBMSAD AVAS DLPFL FBLCM FLISD FLLCM FRLCM RLLCMA RLLCMB RRLCMA RRLCMB RLISD DLPML DLPMR TRM PSDL PSDR FLDCM FRDCM HVSPRL HVSPRR RFR SBM WCM ETC TBOX2 TBOX RLBMS EBU FLPDM RLPDM FRPDM RRPDM FLOAR FROAR RLOAR RROAR EOSL EOSR EOST PRBU RT1_C0 OTAWL RT2_C3 IDUR PHUDD RAS CBM PLGM TMC LPC2 SAS RCICP SCMRM SCMT SLMRL SLMRR IDU RRISD DSASBM LBMS RT1_C1

BO_ 549 ADC_12: 64 ADC
 SG_ ADC_12_CRC : 7|16@0+ (1,0) [0|65535] ""  CCU
 SG_ ADC_12_Counter : 23|8@0+ (1,0) [0|255] ""  CCU
 SG_ ADC_APAst : 31|4@0+ (1,0) [0|15] ""  CCU,CCURT1,RT1_C1
 SG_ ADC_AVPst : 27|4@0+ (1,0) [0|15] ""  CCU,CCURT1,RT1_C1
 SG_ ADC_PAAFuncSt : 39|4@0+ (1,0) [0|15] ""  CCU,CCURT1,RT1_C0,RT1_C1
 SG_ ADC_PAAVoiceReminder : 35|12@0+ (1,0) [0|4095] ""  CCU
 SG_ ADC_PAAVRSwitchFailSt : 55|1@0+ (1,0) [0|1] ""  CCU
 SG_ ADC_APKDisplayReq : 54|1@0+ (1,0) [0|1] ""  CCU
 SG_ ADC_APAActFuncInd : 53|4@0+ (1,0) [0|15] ""  CCU
 SG_ ADC_APABackParkDisplayReq : 49|2@0+ (1,0) [0|3] ""  CCU
 SG_ ADC_VCU_Gearshiftprompt : 56|1@0+ (1,0) [0|1] ""  CCU,CCURT1,RT1_C1
 SG_ ADC_AVPActFuncind : 63|5@0+ (1,0) [0|31] ""  CCU
 SG_ ADC_APAMessagePushSt : 58|2@0+ (1,0) [0|3] ""  CCU
 SG_ ADC_PedWarnToneCtrl : 67|2@0+ (1,0) [0|3] ""  CCU
 SG_ ADC_HPAMessagePushSt : 71|2@0+ (1,0) [0|3] ""  CCU
 SG_ ADC_AVPMessagePushSt : 69|2@0+ (1,0) [0|3] ""  CCU
 SG_ ADC_PAADrvInteraction : 64|9@0+ (1,0) [0|511] ""  CCU
 SG_ ADC_PAAToNDAReq : 89|2@0+ (1,0) [0|3] ""  CCU,ZCUF,ZCUT,IBCS,SBM
 SG_ ADC_PAARemoteParkingMode : 87|2@0+ (1,0) [0|3] ""  CCU
 SG_ ADC_PAARemoteParkingEnable : 85|1@0+ (1,0) [0|1] ""  CCU
 SG_ ADC_LocalToBeDRVReq : 83|1@0+ (1,0) [0|1] ""  CCU,CCURT1
 SG_ ADC_UsageModeStAscendReq : 82|1@0+ (1,0) [0|1] ""  CCU,CCURT1,RT1_C0
 SG_ ADC_UsageModeStDescendReq : 81|1@0+ (1,0) [0|1] ""  CCU,CCURT1,RT1_C0
 SG_ ADC_PAAIGCInhibitSt : 80|1@0+ (1,0) [0|1] ""  CCU,CCURT1
 SG_ ADC_UsageModeStHold : 90|1@0+ (1,0) [0|1] ""  CCU,CCURT1,RT1_C0
 SG_ ADC_PAARespondMode : 94|4@0+ (1,0) [0|15] ""  CCU
 SG_ ADC_PAAEDKFunInhibitReq : 95|1@0+ (1,0) [0|1] ""  CCU
 SG_ ADC_DriverPresentSt : 103|2@0+ (1,0) [0|3] ""  CCU,ZCUF,ZCUR,ZCUT,IBCS
 SG_ ADC_RAEBWorkSts : 101|2@0+ (1,0) [0|3] ""  CCU
 SG_ ADC_UsageModeStHoldVD : 99|1@0+ (1,0) [0|1] ""  CCU,CCURT1,RT1_C0
 SG_ ADC_RAEBEmgyBrkReq : 111|1@0+ (1,0) [0|1] ""  CCU
 SG_ ADC_RAEBTarAccel : 110|7@0+ (0.1,-10) [-10|0] "m/s"  CCU
 SG_ ADC_PAADrvReq : 119|8@0+ (1,0) [0|255] ""  CCU,ZCUR,IDC
 SG_ ADC_PAAQuitInd : 127|8@0+ (1,0) [0|255] ""  CCU,ZCUR,IDC,SBM
 SG_ ADC_PAARecInd : 135|6@0+ (1,0) [0|63] ""  CCU,CCURT1,ZCUR,IDC,SBM
 SG_ ADC_RA_RemainDist : 139|12@0+ (1,0) [0|4000] "m"  CCU
 SG_ ADC_RAButtonPress : 156|1@0+ (1,0) [0|1] ""  CCU
 SG_ ADC_Rast : 159|3@0+ (1,0) [0|7] ""  CCU
 SG_ ADC_SBMAuthst : 163|2@0+ (1,0) [0|3] ""  CCU
 SG_ ADC_AuthPassSt : 165|2@0+ (1,0) [0|3] ""  CCU
 SG_ ADC_RPADirectionSel : 155|4@0+ (1,0) [0|15] ""  CCU
 SG_ ADC_VehPoscoord : 167|1@0+ (1,0) [0|1] ""  CCU
 SG_ ADC_VehDynamicPosX : 161|13@0+ (1,-4000) [-4000|4000] "cm"  CCU
 SG_ ADC_VehDynamicPosY : 180|13@0+ (1,-4000) [-4000|4000] "cm"  CCU
 SG_ ADC_VehCurv : 206|10@0+ (1,-500) [-500|500] "m^-1"  CCU
 SG_ ADC_SlotPosX : 212|13@0+ (1,-4000) [-4000|4000] "cm"  CCU
 SG_ ADC_SlotPosY : 231|13@0+ (1,-4000) [-4000|4000] "cm"  CCU
 SG_ ADC_SlotCurv : 241|10@0+ (1,-500) [-500|500] "m^-1"  CCU
 SG_ ADC_HPAst : 245|4@0+ (1,0) [0|15] ""  CCU
 SG_ ADC_parkInOutDirection : 299|4@0+ (1,0) [0|15] ""  CCU
 SG_ ADC_RPAStMessagePush : 98|3@0+ (1,0) [0|7] ""  CCU
 SG_ ADC_RPAtype : 383|2@0+ (1,0) [0|3] ""  CCU
 SG_ ADC_VehPosYawrate : 343|16@0+ (0.01,-180) [-180|180] "degree"  CCU
 SG_ ADC_SlotAngle : 359|16@0+ (0.01,-180) [-180|180] "degree"  CCU
 SG_ ADC_DskScreenOperationReq : 368|1@0+ (1,0) [0|1] ""  CCU
 SG_ ADC_SenslesEtyParkingSt : 369|1@0+ (1,0) [0|1] ""  CCU
 SG_ ADC_PAALimitToast : 372|3@0+ (1,0) [0|7] ""  CCU
 SG_ ADC_PAALimitReminder : 375|3@0+ (1,0) [0|7] ""  CCU
 SG_ ADC_ParkOutMode : 381|3@0+ (1,0) [0|7] ""  CCU
 SG_ ADAS_ParkStats : 391|8@0+ (1,0) [0|255] ""  CCU
 SG_ ADC_RPABlechnReq : 399|1@0+ (1,0) [0|1] ""  CCU
 SG_ ADC_RPABlePushSt : 398|5@0+ (1,0) [0|31] ""  CCU
 SG_ Reserved1 : 440|1@0+ (1,0) [0|0] ""  CCU

BO_ 1806 ADC_Phys_Diag_Rx: 64 Tester
 SG_ ADC_Diag_Request : 7|512@0+ (1,0) [0|0] ""  ADC

BO_ 1269 FL_DiagCode: 64 ADC
 SG_ FL_DTCCode : 7|512@0+ (1,0) [0|0] ""  CCU

BO_ 1174 ADC_BigData: 64 ADC
 SG_ ADC_BigData : 7|512@0+ (1,0) [0|1] ""  CCU

CM_ SG_ 549 ADC_12_CRC "E2E Profile 5 CRC";
CM_ SG_ 549 ADC_12_Counter "E2E Profile 5 Counter";
CM_ SG_ 549 ADC_APAst "APA and FAPA status";
CM_ SG_ 549 ADC_AVPst "HPA and AVP status";
CM_ SG_ 549 ADC_PAAFuncSt "PAA working functions inaication signal";
CM_ SG_ 549 ADC_PAAVoiceReminder "PAA Voice Reminder";
CM_ SG_ 549 ADC_PAAVRSwitchFailSt "PAA VR Switch Fail State";
CM_ SG_ 549 ADC_APKDisplayReq "APK display request";
CM_ SG_ 549 ADC_APAActFuncInd "Auto_parking Active Function Indication";
CM_ SG_ 549 ADC_APABackParkDisplayReq "APA Background Parking For AVNT Display";
CM_ SG_ 549 ADC_VCU_Gearshiftprompt "The signal prohibiting gear shifting prompt sent from the ADC to the VCU";
CM_ SG_ 549 ADC_AVPActFuncind "AVP Active Function Indication";
CM_ SG_ 549 ADC_APAMessagePushSt "APA Message Push Staus";
CM_ SG_ 549 ADC_PedWarnToneCtrl "Parking cost pedestrian warning sound";
CM_ SG_ 549 ADC_HPAMessagePushSt "HPA Message  Push Staus";
CM_ SG_ 549 ADC_AVPMessagePushSt "AVP Message  Push Staus";
CM_ SG_ 549 ADC_PAADrvInteraction "PAA Driver Interaction signal";
CM_ SG_ 549 ADC_PAAToNDAReq "PAA  to NDA status requested, or NDA to PAA  status requested";
CM_ SG_ 549 ADC_PAARemoteParkingMode "PAA Remote parking Mode";
CM_ SG_ 549 ADC_PAARemoteParkingEnable "PAA Remote Parking Enable";
CM_ SG_ 549 ADC_LocalToBeDRVReq "Request IPDS  PW KL15";
CM_ SG_ 549 ADC_UsageModeStAscendReq "Request UMM to Comfort";
CM_ SG_ 549 ADC_UsageModeStDescendReq "Request UMM to Standby";
CM_ SG_ 549 ADC_PAAIGCInhibitSt "The inhibit state of IGC function";
CM_ SG_ 549 ADC_UsageModeStHold "ADC UsageMode State Hold";
CM_ SG_ 549 ADC_PAARespondMode "PAA? Respond Mode";
CM_ SG_ 549 ADC_PAAEDKFunInhibitReq "PAA send key function inhibit request to EDK";
CM_ SG_ 549 ADC_DriverPresentSt "The Status of Driver on/off the Front Left seat.";
CM_ SG_ 549 ADC_RAEBWorkSts "RAEB Work status ";
CM_ SG_ 549 ADC_UsageModeStHoldVD "ADC UsageMode State Hold Valid";
CM_ SG_ 549 ADC_RAEBEmgyBrkReq "RAEB Emergency brake requested";
CM_ SG_ 549 ADC_RAEBTarAccel "RAEB target acceleration";
CM_ SG_ 549 ADC_PAADrvReq "Parking Driver Request";
CM_ SG_ 549 ADC_PAAQuitInd "Parking Quit indication";
CM_ SG_ 549 ADC_PAARecInd "Parking Recover indication";
CM_ SG_ 549 ADC_RA_RemainDist "RA the remainin distance";
CM_ SG_ 549 ADC_RAButtonPress "PCS RA button press status";
CM_ SG_ 549 ADC_Rast "RA state";
CM_ SG_ 549 ADC_SBMAuthst "PAA Authst with SBM";
CM_ SG_ 549 ADC_AuthPassSt "PAA Authst Pass Status";
CM_ SG_ 549 ADC_RPADirectionSel "ADC select park out direction for RPA";
CM_ SG_ 549 ADC_VehPoscoord "Vehicle coordinate system type";
CM_ SG_ 549 ADC_VehDynamicPosX "Vehicle dynamic postion in X axis";
CM_ SG_ 549 ADC_VehDynamicPosY "Vehicle dynamic postion in Y axis";
CM_ SG_ 549 ADC_VehCurv "Vehicle dynamic curve";
CM_ SG_ 549 ADC_SlotPosX "Current choosed slot postion in X axis";
CM_ SG_ 549 ADC_SlotPosY "Current choosed slot postion in Y axis";
CM_ SG_ 549 ADC_SlotCurv "Current choosed slot curve";
CM_ SG_ 549 ADC_HPAst "HPA status";
CM_ SG_ 549 ADC_parkInOutDirection "ADC Park in/out Direction";
CM_ SG_ 549 ADC_RPAStMessagePush "indicate the LRPA push message to APP";
CM_ SG_ 549 ADC_RPAtype "Indicate the RPA type";
CM_ SG_ 549 ADC_VehPosYawrate "Vehicle dynamic postion yawrate";
CM_ SG_ 549 ADC_SlotAngle "Current choosed slot angle";
CM_ SG_ 549 ADC_DskScreenOperationReq "Desktop Screen Operation State Request";
CM_ SG_ 549 ADC_SenslesEtyParkingSt "Senseless entry parking switch state";
CM_ SG_ 549 ADC_PAALimitToast "PAA not available toast";
CM_ SG_ 549 ADC_PAALimitReminder "PAA not available voice reminder";
CM_ SG_ 549 ADC_ParkOutMode "ADC Park out Mode";
CM_ SG_ 549 ADAS_ParkStats "HW ADS Parking status signal";
CM_ SG_ 549 ADC_RPABlechnReq "RPA Ble channel Request";
CM_ SG_ 549 ADC_RPABlePushSt "RPA push state";
CM_ SG_ 1806 ADC_Diag_Request "Diagnostic physical request";
CM_ SG_ 1269 FL_DTCCode "FL DTC and status Sent To CCU";

BA_DEF_ BO_  "GenMsgCycleTime" INT 0 0;
BA_DEF_ BO_  "GenMsgCycleTimeFast" INT 0 0;
BA_DEF_ BO_  "GenMsgSendType" ENUM  "Periodic","Event","IfActive","POE","PA","FixedPeriodic","Event","EnabledPeriodic","NotUsed","NotUsed","EventPeriodic","NotUsed","NotUsed","NoMsgSendType";
BA_DEF_ BO_  "VFrameFormat" ENUM  "StandardCAN","ExtendedCAN","reserved","reserved","reserved","reserved","reserved","reserved","reserved","reserved","reserved","reserved","reserved","reserved","StandardCAN_FD","ExtendedCAN_FD";
BA_DEF_ BO_  "CANFD_BRS" ENUM  "0","1";
BA_DEF_ SG_  "EventCommandSignal" ENUM  "No","Yes";
BA_DEF_ SG_  "GatewayedSignals" ENUM  "No","Yes";
BA_DEF_ SG_  "GenSigInactiveValue" HEX 0 0;
BA_DEF_ SG_  "GenSigInvalidValue" HEX 0 0;
BA_DEF_ SG_  "GenSigSendType" ENUM  "Trigger","Passive","Cyclic","OnWrite","OnWriteWithRepetition","OnChange","OnChangeWithRepetition","IfActive","IfActiveWithRepetition","NoSigSendType";
BA_DEF_ SG_  "GenSigStartValue" HEX 0 0;
BA_DEF_ SG_  "GenSigTimeoutValue" HEX 0 0;
BA_DEF_ SG_  "Remark" STRING ;
BA_ "GenMsgCycleTime" BO_ 549 20;
BA_ "GenMsgCycleTimeFast" BO_ 549 0;
BA_ "GenMsgSendType" BO_ 549 0;
BA_ "VFrameFormat" BO_ 549 14;
BA_ "CANFD_BRS" BO_ 549 1;
BA_ "GenMsgCycleTime" BO_ 549 20;
BA_ "GenMsgCycleTimeFast" BO_ 549 0;
BA_ "GenMsgSendType" BO_ 549 0;
BA_ "VFrameFormat" BO_ 549 14;
BA_ "CANFD_BRS" BO_ 549 1;
BA_ "GenMsgCycleTime" BO_ 549 20;
BA_ "GenMsgCycleTimeFast" BO_ 549 0;
BA_ "GenMsgSendType" BO_ 549 0;
BA_ "VFrameFormat" BO_ 549 14;
BA_ "CANFD_BRS" BO_ 549 1;
BA_ "GenMsgCycleTime" BO_ 549 20;
BA_ "GenMsgCycleTimeFast" BO_ 549 0;
BA_ "GenMsgSendType" BO_ 549 0;
BA_ "VFrameFormat" BO_ 549 14;
BA_ "CANFD_BRS" BO_ 549 1;
BA_ "GenMsgCycleTime" BO_ 549 20;
BA_ "GenMsgCycleTimeFast" BO_ 549 0;
BA_ "GenMsgSendType" BO_ 549 0;
BA_ "VFrameFormat" BO_ 549 14;
BA_ "CANFD_BRS" BO_ 549 1;
BA_ "GenMsgCycleTime" BO_ 549 20;
BA_ "GenMsgCycleTimeFast" BO_ 549 0;
BA_ "GenMsgSendType" BO_ 549 0;
BA_ "VFrameFormat" BO_ 549 14;
BA_ "CANFD_BRS" BO_ 549 1;
BA_ "GenMsgCycleTime" BO_ 549 20;
BA_ "GenMsgCycleTimeFast" BO_ 549 0;
BA_ "GenMsgSendType" BO_ 549 0;
BA_ "VFrameFormat" BO_ 549 14;
BA_ "CANFD_BRS" BO_ 549 1;
BA_ "GenMsgCycleTime" BO_ 549 20;
BA_ "GenMsgCycleTimeFast" BO_ 549 0;
BA_ "GenMsgSendType" BO_ 549 0;
BA_ "VFrameFormat" BO_ 549 14;
BA_ "CANFD_BRS" BO_ 549 1;
BA_ "GenMsgCycleTime" BO_ 549 20;
BA_ "GenMsgCycleTimeFast" BO_ 549 0;
BA_ "GenMsgSendType" BO_ 549 0;
BA_ "VFrameFormat" BO_ 549 14;
BA_ "CANFD_BRS" BO_ 549 1;
BA_ "GenMsgCycleTime" BO_ 549 20;
BA_ "GenMsgCycleTimeFast" BO_ 549 0;
BA_ "GenMsgSendType" BO_ 549 0;
BA_ "VFrameFormat" BO_ 549 14;
BA_ "CANFD_BRS" BO_ 549 1;
BA_ "GenMsgCycleTime" BO_ 549 20;
BA_ "GenMsgCycleTimeFast" BO_ 549 0;
BA_ "GenMsgSendType" BO_ 549 0;
BA_ "VFrameFormat" BO_ 549 14;
BA_ "CANFD_BRS" BO_ 549 1;
BA_ "GenMsgCycleTime" BO_ 549 20;
BA_ "GenMsgCycleTimeFast" BO_ 549 0;
BA_ "GenMsgSendType" BO_ 549 0;
BA_ "VFrameFormat" BO_ 549 14;
BA_ "CANFD_BRS" BO_ 549 1;
BA_ "GenMsgCycleTime" BO_ 549 20;
BA_ "GenMsgCycleTimeFast" BO_ 549 0;
BA_ "GenMsgSendType" BO_ 549 0;
BA_ "VFrameFormat" BO_ 549 14;
BA_ "CANFD_BRS" BO_ 549 1;
BA_ "GenMsgCycleTime" BO_ 549 20;
BA_ "GenMsgCycleTimeFast" BO_ 549 0;
BA_ "GenMsgSendType" BO_ 549 0;
BA_ "VFrameFormat" BO_ 549 14;
BA_ "CANFD_BRS" BO_ 549 1;
BA_ "GenMsgCycleTime" BO_ 549 20;
BA_ "GenMsgCycleTimeFast" BO_ 549 0;
BA_ "GenMsgSendType" BO_ 549 0;
BA_ "VFrameFormat" BO_ 549 14;
BA_ "CANFD_BRS" BO_ 549 1;
BA_ "GenMsgCycleTime" BO_ 549 20;
BA_ "GenMsgCycleTimeFast" BO_ 549 0;
BA_ "GenMsgSendType" BO_ 549 0;
BA_ "VFrameFormat" BO_ 549 14;
BA_ "CANFD_BRS" BO_ 549 1;
BA_ "GenMsgCycleTime" BO_ 549 20;
BA_ "GenMsgCycleTimeFast" BO_ 549 0;
BA_ "GenMsgSendType" BO_ 549 0;
BA_ "VFrameFormat" BO_ 549 14;
BA_ "CANFD_BRS" BO_ 549 1;
BA_ "GenMsgCycleTime" BO_ 549 20;
BA_ "GenMsgCycleTimeFast" BO_ 549 0;
BA_ "GenMsgSendType" BO_ 549 0;
BA_ "VFrameFormat" BO_ 549 14;
BA_ "CANFD_BRS" BO_ 549 1;
BA_ "GenMsgCycleTime" BO_ 549 20;
BA_ "GenMsgCycleTimeFast" BO_ 549 0;
BA_ "GenMsgSendType" BO_ 549 0;
BA_ "VFrameFormat" BO_ 549 14;
BA_ "CANFD_BRS" BO_ 549 1;
BA_ "GenMsgCycleTime" BO_ 549 20;
BA_ "GenMsgCycleTimeFast" BO_ 549 0;
BA_ "GenMsgSendType" BO_ 549 0;
BA_ "VFrameFormat" BO_ 549 14;
BA_ "CANFD_BRS" BO_ 549 1;
BA_ "GenMsgCycleTime" BO_ 549 20;
BA_ "GenMsgCycleTimeFast" BO_ 549 0;
BA_ "GenMsgSendType" BO_ 549 0;
BA_ "VFrameFormat" BO_ 549 14;
BA_ "CANFD_BRS" BO_ 549 1;
BA_ "GenMsgCycleTime" BO_ 549 20;
BA_ "GenMsgCycleTimeFast" BO_ 549 0;
BA_ "GenMsgSendType" BO_ 549 0;
BA_ "VFrameFormat" BO_ 549 14;
BA_ "CANFD_BRS" BO_ 549 1;
BA_ "GenMsgCycleTime" BO_ 549 20;
BA_ "GenMsgCycleTimeFast" BO_ 549 0;
BA_ "GenMsgSendType" BO_ 549 0;
BA_ "VFrameFormat" BO_ 549 14;
BA_ "CANFD_BRS" BO_ 549 1;
BA_ "GenMsgCycleTime" BO_ 549 20;
BA_ "GenMsgCycleTimeFast" BO_ 549 0;
BA_ "GenMsgSendType" BO_ 549 0;
BA_ "VFrameFormat" BO_ 549 14;
BA_ "CANFD_BRS" BO_ 549 1;
BA_ "GenMsgCycleTime" BO_ 549 20;
BA_ "GenMsgCycleTimeFast" BO_ 549 0;
BA_ "GenMsgSendType" BO_ 549 0;
BA_ "VFrameFormat" BO_ 549 14;
BA_ "CANFD_BRS" BO_ 549 1;
BA_ "GenMsgCycleTime" BO_ 549 20;
BA_ "GenMsgCycleTimeFast" BO_ 549 0;
BA_ "GenMsgSendType" BO_ 549 0;
BA_ "VFrameFormat" BO_ 549 14;
BA_ "CANFD_BRS" BO_ 549 1;
BA_ "GenMsgCycleTime" BO_ 549 20;
BA_ "GenMsgCycleTimeFast" BO_ 549 0;
BA_ "GenMsgSendType" BO_ 549 0;
BA_ "VFrameFormat" BO_ 549 14;
BA_ "CANFD_BRS" BO_ 549 1;
BA_ "GenMsgCycleTime" BO_ 549 20;
BA_ "GenMsgCycleTimeFast" BO_ 549 0;
BA_ "GenMsgSendType" BO_ 549 0;
BA_ "VFrameFormat" BO_ 549 14;
BA_ "CANFD_BRS" BO_ 549 1;
BA_ "GenMsgCycleTime" BO_ 549 20;
BA_ "GenMsgCycleTimeFast" BO_ 549 0;
BA_ "GenMsgSendType" BO_ 549 0;
BA_ "VFrameFormat" BO_ 549 14;
BA_ "CANFD_BRS" BO_ 549 1;
BA_ "GenMsgCycleTime" BO_ 549 20;
BA_ "GenMsgCycleTimeFast" BO_ 549 0;
BA_ "GenMsgSendType" BO_ 549 0;
BA_ "VFrameFormat" BO_ 549 14;
BA_ "CANFD_BRS" BO_ 549 1;
BA_ "GenMsgCycleTime" BO_ 549 20;
BA_ "GenMsgCycleTimeFast" BO_ 549 0;
BA_ "GenMsgSendType" BO_ 549 0;
BA_ "VFrameFormat" BO_ 549 14;
BA_ "CANFD_BRS" BO_ 549 1;
BA_ "GenMsgCycleTime" BO_ 549 20;
BA_ "GenMsgCycleTimeFast" BO_ 549 0;
BA_ "GenMsgSendType" BO_ 549 0;
BA_ "VFrameFormat" BO_ 549 14;
BA_ "CANFD_BRS" BO_ 549 1;
BA_ "GenMsgCycleTime" BO_ 549 20;
BA_ "GenMsgCycleTimeFast" BO_ 549 0;
BA_ "GenMsgSendType" BO_ 549 0;
BA_ "VFrameFormat" BO_ 549 14;
BA_ "CANFD_BRS" BO_ 549 1;
BA_ "GenMsgCycleTime" BO_ 549 20;
BA_ "GenMsgCycleTimeFast" BO_ 549 0;
BA_ "GenMsgSendType" BO_ 549 0;
BA_ "VFrameFormat" BO_ 549 14;
BA_ "CANFD_BRS" BO_ 549 1;
BA_ "GenMsgCycleTime" BO_ 549 20;
BA_ "GenMsgCycleTimeFast" BO_ 549 0;
BA_ "GenMsgSendType" BO_ 549 0;
BA_ "VFrameFormat" BO_ 549 14;
BA_ "CANFD_BRS" BO_ 549 1;
BA_ "GenMsgCycleTime" BO_ 549 20;
BA_ "GenMsgCycleTimeFast" BO_ 549 0;
BA_ "GenMsgSendType" BO_ 549 0;
BA_ "VFrameFormat" BO_ 549 14;
BA_ "CANFD_BRS" BO_ 549 1;
BA_ "GenMsgCycleTime" BO_ 549 20;
BA_ "GenMsgCycleTimeFast" BO_ 549 0;
BA_ "GenMsgSendType" BO_ 549 0;
BA_ "VFrameFormat" BO_ 549 14;
BA_ "CANFD_BRS" BO_ 549 1;
BA_ "GenMsgCycleTime" BO_ 549 20;
BA_ "GenMsgCycleTimeFast" BO_ 549 0;
BA_ "GenMsgSendType" BO_ 549 0;
BA_ "VFrameFormat" BO_ 549 14;
BA_ "CANFD_BRS" BO_ 549 1;
BA_ "GenMsgCycleTime" BO_ 549 20;
BA_ "GenMsgCycleTimeFast" BO_ 549 0;
BA_ "GenMsgSendType" BO_ 549 0;
BA_ "VFrameFormat" BO_ 549 14;
BA_ "CANFD_BRS" BO_ 549 1;
BA_ "GenMsgCycleTime" BO_ 549 20;
BA_ "GenMsgCycleTimeFast" BO_ 549 0;
BA_ "GenMsgSendType" BO_ 549 0;
BA_ "VFrameFormat" BO_ 549 14;
BA_ "CANFD_BRS" BO_ 549 1;
BA_ "GenMsgCycleTime" BO_ 549 20;
BA_ "GenMsgCycleTimeFast" BO_ 549 0;
BA_ "GenMsgSendType" BO_ 549 0;
BA_ "VFrameFormat" BO_ 549 14;
BA_ "CANFD_BRS" BO_ 549 1;
BA_ "GenMsgCycleTime" BO_ 549 20;
BA_ "GenMsgCycleTimeFast" BO_ 549 0;
BA_ "GenMsgSendType" BO_ 549 0;
BA_ "VFrameFormat" BO_ 549 14;
BA_ "CANFD_BRS" BO_ 549 1;
BA_ "GenMsgCycleTime" BO_ 549 20;
BA_ "GenMsgCycleTimeFast" BO_ 549 0;
BA_ "GenMsgSendType" BO_ 549 0;
BA_ "VFrameFormat" BO_ 549 14;
BA_ "CANFD_BRS" BO_ 549 1;
BA_ "GenMsgCycleTime" BO_ 549 20;
BA_ "GenMsgCycleTimeFast" BO_ 549 0;
BA_ "GenMsgSendType" BO_ 549 0;
BA_ "VFrameFormat" BO_ 549 14;
BA_ "CANFD_BRS" BO_ 549 1;
BA_ "GenMsgCycleTime" BO_ 549 20;
BA_ "GenMsgCycleTimeFast" BO_ 549 0;
BA_ "GenMsgSendType" BO_ 549 0;
BA_ "VFrameFormat" BO_ 549 14;
BA_ "CANFD_BRS" BO_ 549 1;
BA_ "GenMsgCycleTime" BO_ 549 20;
BA_ "GenMsgCycleTimeFast" BO_ 549 0;
BA_ "GenMsgSendType" BO_ 549 0;
BA_ "VFrameFormat" BO_ 549 14;
BA_ "CANFD_BRS" BO_ 549 1;
BA_ "GenMsgCycleTime" BO_ 549 20;
BA_ "GenMsgCycleTimeFast" BO_ 549 0;
BA_ "GenMsgSendType" BO_ 549 0;
BA_ "VFrameFormat" BO_ 549 14;
BA_ "CANFD_BRS" BO_ 549 1;
BA_ "GenMsgCycleTime" BO_ 549 20;
BA_ "GenMsgCycleTimeFast" BO_ 549 0;
BA_ "GenMsgSendType" BO_ 549 0;
BA_ "VFrameFormat" BO_ 549 14;
BA_ "CANFD_BRS" BO_ 549 1;
BA_ "GenMsgCycleTime" BO_ 549 20;
BA_ "GenMsgCycleTimeFast" BO_ 549 0;
BA_ "GenMsgSendType" BO_ 549 0;
BA_ "VFrameFormat" BO_ 549 14;
BA_ "CANFD_BRS" BO_ 549 1;
BA_ "GenMsgCycleTime" BO_ 549 20;
BA_ "GenMsgCycleTimeFast" BO_ 549 0;
BA_ "GenMsgSendType" BO_ 549 0;
BA_ "VFrameFormat" BO_ 549 14;
BA_ "CANFD_BRS" BO_ 549 1;
BA_ "GenMsgCycleTime" BO_ 549 20;
BA_ "GenMsgCycleTimeFast" BO_ 549 0;
BA_ "GenMsgSendType" BO_ 549 0;
BA_ "VFrameFormat" BO_ 549 14;
BA_ "CANFD_BRS" BO_ 549 1;
BA_ "GenMsgCycleTime" BO_ 549 20;
BA_ "GenMsgCycleTimeFast" BO_ 549 0;
BA_ "GenMsgSendType" BO_ 549 0;
BA_ "VFrameFormat" BO_ 549 14;
BA_ "CANFD_BRS" BO_ 549 1;
BA_ "GenMsgCycleTime" BO_ 549 20;
BA_ "GenMsgCycleTimeFast" BO_ 549 0;
BA_ "GenMsgSendType" BO_ 549 0;
BA_ "VFrameFormat" BO_ 549 14;
BA_ "CANFD_BRS" BO_ 549 1;
BA_ "GenMsgCycleTime" BO_ 549 20;
BA_ "GenMsgCycleTimeFast" BO_ 549 0;
BA_ "GenMsgSendType" BO_ 549 0;
BA_ "VFrameFormat" BO_ 549 14;
BA_ "CANFD_BRS" BO_ 549 1;
BA_ "GenMsgCycleTime" BO_ 549 20;
BA_ "GenMsgCycleTimeFast" BO_ 549 0;
BA_ "GenMsgSendType" BO_ 549 0;
BA_ "VFrameFormat" BO_ 549 14;
BA_ "CANFD_BRS" BO_ 549 1;
BA_ "GenMsgCycleTime" BO_ 549 20;
BA_ "GenMsgCycleTimeFast" BO_ 549 0;
BA_ "GenMsgSendType" BO_ 549 0;
BA_ "VFrameFormat" BO_ 549 14;
BA_ "CANFD_BRS" BO_ 549 1;
BA_ "GenMsgCycleTime" BO_ 549 20;
BA_ "GenMsgCycleTimeFast" BO_ 549 0;
BA_ "GenMsgSendType" BO_ 549 0;
BA_ "VFrameFormat" BO_ 549 14;
BA_ "CANFD_BRS" BO_ 549 1;
BA_ "GenMsgCycleTime" BO_ 549 20;
BA_ "GenMsgCycleTimeFast" BO_ 549 0;
BA_ "GenMsgSendType" BO_ 549 0;
BA_ "VFrameFormat" BO_ 549 14;
BA_ "CANFD_BRS" BO_ 549 1;
BA_ "GenMsgCycleTime" BO_ 549 20;
BA_ "GenMsgCycleTimeFast" BO_ 549 0;
BA_ "GenMsgSendType" BO_ 549 0;
BA_ "VFrameFormat" BO_ 549 14;
BA_ "CANFD_BRS" BO_ 549 1;
BA_ "GenMsgCycleTime" BO_ 549 20;
BA_ "GenMsgCycleTimeFast" BO_ 549 0;
BA_ "GenMsgSendType" BO_ 549 0;
BA_ "VFrameFormat" BO_ 549 14;
BA_ "CANFD_BRS" BO_ 549 1;
BA_ "GenMsgCycleTime" BO_ 549 20;
BA_ "GenMsgCycleTimeFast" BO_ 549 0;
BA_ "GenMsgSendType" BO_ 549 0;
BA_ "VFrameFormat" BO_ 549 14;
BA_ "CANFD_BRS" BO_ 549 1;
BA_ "GenMsgCycleTime" BO_ 549 20;
BA_ "GenMsgCycleTimeFast" BO_ 549 0;
BA_ "GenMsgSendType" BO_ 549 0;
BA_ "VFrameFormat" BO_ 549 14;
BA_ "CANFD_BRS" BO_ 549 1;
BA_ "GenMsgCycleTime" BO_ 549 20;
BA_ "GenMsgCycleTimeFast" BO_ 549 0;
BA_ "GenMsgSendType" BO_ 549 0;
BA_ "VFrameFormat" BO_ 549 14;
BA_ "CANFD_BRS" BO_ 549 1;
BA_ "GenMsgCycleTime" BO_ 1806 0;
BA_ "GenMsgCycleTimeFast" BO_ 1806 0;
BA_ "GenMsgSendType" BO_ 1806 1;
BA_ "VFrameFormat" BO_ 1806 14;
BA_ "CANFD_BRS" BO_ 1806 1;
BA_ "GenMsgCycleTime" BO_ 1269 0;
BA_ "GenMsgCycleTimeFast" BO_ 1269 0;
BA_ "GenMsgSendType" BO_ 1269 1;
BA_ "VFrameFormat" BO_ 1269 14;
BA_ "CANFD_BRS" BO_ 1269 1;
BA_ "GenMsgCycleTime" BO_ 1174 1000;
BA_ "GenMsgCycleTimeFast" BO_ 1174 0;
BA_ "GenMsgSendType" BO_ 1174 0;
BA_ "VFrameFormat" BO_ 1174 14;
BA_ "CANFD_BRS" BO_ 1174 1;
BA_ "EventCommandSignal" SG_ 549 ADC_12_CRC 0;
BA_ "GatewayedSignals" SG_ 549 ADC_12_CRC 0;
BA_ "GenSigInactiveValue" SG_ 549 ADC_12_CRC 0;
BA_ "GenSigInvalidValue" SG_ 549 ADC_12_CRC 0;
BA_ "GenSigSendType" SG_ 549 ADC_12_CRC 1;
BA_ "GenSigStartValue" SG_ 549 ADC_12_CRC 0;
BA_ "GenSigTimeoutValue" SG_ 549 ADC_12_CRC 0;
BA_ "Remark" SG_ 549 ADC_12_CRC "";
BA_ "EventCommandSignal" SG_ 549 ADC_12_Counter 0;
BA_ "GatewayedSignals" SG_ 549 ADC_12_Counter 0;
BA_ "GenSigInactiveValue" SG_ 549 ADC_12_Counter 0;
BA_ "GenSigInvalidValue" SG_ 549 ADC_12_Counter 0;
BA_ "GenSigSendType" SG_ 549 ADC_12_Counter 1;
BA_ "GenSigStartValue" SG_ 549 ADC_12_Counter 0;
BA_ "GenSigTimeoutValue" SG_ 549 ADC_12_Counter 0;
BA_ "Remark" SG_ 549 ADC_12_Counter "";
BA_ "EventCommandSignal" SG_ 549 ADC_APAst 0;
BA_ "GatewayedSignals" SG_ 549 ADC_APAst 0;
BA_ "GenSigInactiveValue" SG_ 549 ADC_APAst 0;
BA_ "GenSigInvalidValue" SG_ 549 ADC_APAst 0;
BA_ "GenSigSendType" SG_ 549 ADC_APAst 1;
BA_ "GenSigStartValue" SG_ 549 ADC_APAst 0;
BA_ "GenSigTimeoutValue" SG_ 549 ADC_APAst 0;
BA_ "Remark" SG_ 549 ADC_APAst "";
BA_ "EventCommandSignal" SG_ 549 ADC_AVPst 0;
BA_ "GatewayedSignals" SG_ 549 ADC_AVPst 0;
BA_ "GenSigInactiveValue" SG_ 549 ADC_AVPst 0;
BA_ "GenSigInvalidValue" SG_ 549 ADC_AVPst 0;
BA_ "GenSigSendType" SG_ 549 ADC_AVPst 1;
BA_ "GenSigStartValue" SG_ 549 ADC_AVPst 0;
BA_ "GenSigTimeoutValue" SG_ 549 ADC_AVPst 0;
BA_ "Remark" SG_ 549 ADC_AVPst "";
BA_ "EventCommandSignal" SG_ 549 ADC_PAAFuncSt 0;
BA_ "GatewayedSignals" SG_ 549 ADC_PAAFuncSt 0;
BA_ "GenSigInactiveValue" SG_ 549 ADC_PAAFuncSt 0;
BA_ "GenSigInvalidValue" SG_ 549 ADC_PAAFuncSt 0;
BA_ "GenSigSendType" SG_ 549 ADC_PAAFuncSt 1;
BA_ "GenSigStartValue" SG_ 549 ADC_PAAFuncSt 0;
BA_ "GenSigTimeoutValue" SG_ 549 ADC_PAAFuncSt 0;
BA_ "Remark" SG_ 549 ADC_PAAFuncSt "";
BA_ "EventCommandSignal" SG_ 549 ADC_PAAVoiceReminder 0;
BA_ "GatewayedSignals" SG_ 549 ADC_PAAVoiceReminder 0;
BA_ "GenSigInactiveValue" SG_ 549 ADC_PAAVoiceReminder 0;
BA_ "GenSigInvalidValue" SG_ 549 ADC_PAAVoiceReminder 0;
BA_ "GenSigSendType" SG_ 549 ADC_PAAVoiceReminder 1;
BA_ "GenSigStartValue" SG_ 549 ADC_PAAVoiceReminder 0;
BA_ "GenSigTimeoutValue" SG_ 549 ADC_PAAVoiceReminder 0;
BA_ "Remark" SG_ 549 ADC_PAAVoiceReminder "";
BA_ "EventCommandSignal" SG_ 549 ADC_PAAVRSwitchFailSt 0;
BA_ "GatewayedSignals" SG_ 549 ADC_PAAVRSwitchFailSt 0;
BA_ "GenSigInactiveValue" SG_ 549 ADC_PAAVRSwitchFailSt 0;
BA_ "GenSigInvalidValue" SG_ 549 ADC_PAAVRSwitchFailSt 0;
BA_ "GenSigSendType" SG_ 549 ADC_PAAVRSwitchFailSt 1;
BA_ "GenSigStartValue" SG_ 549 ADC_PAAVRSwitchFailSt 0;
BA_ "GenSigTimeoutValue" SG_ 549 ADC_PAAVRSwitchFailSt 0;
BA_ "Remark" SG_ 549 ADC_PAAVRSwitchFailSt "";
BA_ "EventCommandSignal" SG_ 549 ADC_APKDisplayReq 0;
BA_ "GatewayedSignals" SG_ 549 ADC_APKDisplayReq 0;
BA_ "GenSigInactiveValue" SG_ 549 ADC_APKDisplayReq 0;
BA_ "GenSigInvalidValue" SG_ 549 ADC_APKDisplayReq 0;
BA_ "GenSigSendType" SG_ 549 ADC_APKDisplayReq 1;
BA_ "GenSigStartValue" SG_ 549 ADC_APKDisplayReq 0;
BA_ "GenSigTimeoutValue" SG_ 549 ADC_APKDisplayReq 0;
BA_ "Remark" SG_ 549 ADC_APKDisplayReq "";
BA_ "EventCommandSignal" SG_ 549 ADC_APAActFuncInd 0;
BA_ "GatewayedSignals" SG_ 549 ADC_APAActFuncInd 0;
BA_ "GenSigInactiveValue" SG_ 549 ADC_APAActFuncInd 0;
BA_ "GenSigInvalidValue" SG_ 549 ADC_APAActFuncInd 0;
BA_ "GenSigSendType" SG_ 549 ADC_APAActFuncInd 1;
BA_ "GenSigStartValue" SG_ 549 ADC_APAActFuncInd 0;
BA_ "GenSigTimeoutValue" SG_ 549 ADC_APAActFuncInd 0;
BA_ "Remark" SG_ 549 ADC_APAActFuncInd "";
BA_ "EventCommandSignal" SG_ 549 ADC_APABackParkDisplayReq 0;
BA_ "GatewayedSignals" SG_ 549 ADC_APABackParkDisplayReq 0;
BA_ "GenSigInactiveValue" SG_ 549 ADC_APABackParkDisplayReq 0;
BA_ "GenSigInvalidValue" SG_ 549 ADC_APABackParkDisplayReq 0;
BA_ "GenSigSendType" SG_ 549 ADC_APABackParkDisplayReq 1;
BA_ "GenSigStartValue" SG_ 549 ADC_APABackParkDisplayReq 0;
BA_ "GenSigTimeoutValue" SG_ 549 ADC_APABackParkDisplayReq 0;
BA_ "Remark" SG_ 549 ADC_APABackParkDisplayReq "";
BA_ "EventCommandSignal" SG_ 549 ADC_VCU_Gearshiftprompt 0;
BA_ "GatewayedSignals" SG_ 549 ADC_VCU_Gearshiftprompt 0;
BA_ "GenSigInactiveValue" SG_ 549 ADC_VCU_Gearshiftprompt 0;
BA_ "GenSigInvalidValue" SG_ 549 ADC_VCU_Gearshiftprompt 0;
BA_ "GenSigSendType" SG_ 549 ADC_VCU_Gearshiftprompt 1;
BA_ "GenSigStartValue" SG_ 549 ADC_VCU_Gearshiftprompt 0;
BA_ "GenSigTimeoutValue" SG_ 549 ADC_VCU_Gearshiftprompt 0;
BA_ "Remark" SG_ 549 ADC_VCU_Gearshiftprompt "";
BA_ "EventCommandSignal" SG_ 549 ADC_AVPActFuncind 0;
BA_ "GatewayedSignals" SG_ 549 ADC_AVPActFuncind 0;
BA_ "GenSigInactiveValue" SG_ 549 ADC_AVPActFuncind 0;
BA_ "GenSigInvalidValue" SG_ 549 ADC_AVPActFuncind 0;
BA_ "GenSigSendType" SG_ 549 ADC_AVPActFuncind 1;
BA_ "GenSigStartValue" SG_ 549 ADC_AVPActFuncind 0;
BA_ "GenSigTimeoutValue" SG_ 549 ADC_AVPActFuncind 0;
BA_ "Remark" SG_ 549 ADC_AVPActFuncind "";
BA_ "EventCommandSignal" SG_ 549 ADC_APAMessagePushSt 0;
BA_ "GatewayedSignals" SG_ 549 ADC_APAMessagePushSt 0;
BA_ "GenSigInactiveValue" SG_ 549 ADC_APAMessagePushSt 0;
BA_ "GenSigInvalidValue" SG_ 549 ADC_APAMessagePushSt 0;
BA_ "GenSigSendType" SG_ 549 ADC_APAMessagePushSt 1;
BA_ "GenSigStartValue" SG_ 549 ADC_APAMessagePushSt 0;
BA_ "GenSigTimeoutValue" SG_ 549 ADC_APAMessagePushSt 0;
BA_ "Remark" SG_ 549 ADC_APAMessagePushSt "";
BA_ "EventCommandSignal" SG_ 549 ADC_PedWarnToneCtrl 0;
BA_ "GatewayedSignals" SG_ 549 ADC_PedWarnToneCtrl 0;
BA_ "GenSigInactiveValue" SG_ 549 ADC_PedWarnToneCtrl 0;
BA_ "GenSigInvalidValue" SG_ 549 ADC_PedWarnToneCtrl 0;
BA_ "GenSigSendType" SG_ 549 ADC_PedWarnToneCtrl 1;
BA_ "GenSigStartValue" SG_ 549 ADC_PedWarnToneCtrl 0;
BA_ "GenSigTimeoutValue" SG_ 549 ADC_PedWarnToneCtrl 0;
BA_ "Remark" SG_ 549 ADC_PedWarnToneCtrl "";
BA_ "EventCommandSignal" SG_ 549 ADC_HPAMessagePushSt 0;
BA_ "GatewayedSignals" SG_ 549 ADC_HPAMessagePushSt 0;
BA_ "GenSigInactiveValue" SG_ 549 ADC_HPAMessagePushSt 0;
BA_ "GenSigInvalidValue" SG_ 549 ADC_HPAMessagePushSt 0;
BA_ "GenSigSendType" SG_ 549 ADC_HPAMessagePushSt 1;
BA_ "GenSigStartValue" SG_ 549 ADC_HPAMessagePushSt 0;
BA_ "GenSigTimeoutValue" SG_ 549 ADC_HPAMessagePushSt 0;
BA_ "Remark" SG_ 549 ADC_HPAMessagePushSt "";
BA_ "EventCommandSignal" SG_ 549 ADC_AVPMessagePushSt 0;
BA_ "GatewayedSignals" SG_ 549 ADC_AVPMessagePushSt 0;
BA_ "GenSigInactiveValue" SG_ 549 ADC_AVPMessagePushSt 0;
BA_ "GenSigInvalidValue" SG_ 549 ADC_AVPMessagePushSt 0;
BA_ "GenSigSendType" SG_ 549 ADC_AVPMessagePushSt 1;
BA_ "GenSigStartValue" SG_ 549 ADC_AVPMessagePushSt 0;
BA_ "GenSigTimeoutValue" SG_ 549 ADC_AVPMessagePushSt 0;
BA_ "Remark" SG_ 549 ADC_AVPMessagePushSt "";
BA_ "EventCommandSignal" SG_ 549 ADC_PAADrvInteraction 0;
BA_ "GatewayedSignals" SG_ 549 ADC_PAADrvInteraction 0;
BA_ "GenSigInactiveValue" SG_ 549 ADC_PAADrvInteraction 0;
BA_ "GenSigInvalidValue" SG_ 549 ADC_PAADrvInteraction 0;
BA_ "GenSigSendType" SG_ 549 ADC_PAADrvInteraction 1;
BA_ "GenSigStartValue" SG_ 549 ADC_PAADrvInteraction 0;
BA_ "GenSigTimeoutValue" SG_ 549 ADC_PAADrvInteraction 0;
BA_ "Remark" SG_ 549 ADC_PAADrvInteraction "";
BA_ "EventCommandSignal" SG_ 549 ADC_PAAToNDAReq 0;
BA_ "GatewayedSignals" SG_ 549 ADC_PAAToNDAReq 0;
BA_ "GenSigInactiveValue" SG_ 549 ADC_PAAToNDAReq 0;
BA_ "GenSigInvalidValue" SG_ 549 ADC_PAAToNDAReq 0;
BA_ "GenSigSendType" SG_ 549 ADC_PAAToNDAReq 1;
BA_ "GenSigStartValue" SG_ 549 ADC_PAAToNDAReq 0;
BA_ "GenSigTimeoutValue" SG_ 549 ADC_PAAToNDAReq 0;
BA_ "Remark" SG_ 549 ADC_PAAToNDAReq "";
BA_ "EventCommandSignal" SG_ 549 ADC_PAARemoteParkingMode 0;
BA_ "GatewayedSignals" SG_ 549 ADC_PAARemoteParkingMode 0;
BA_ "GenSigInactiveValue" SG_ 549 ADC_PAARemoteParkingMode 0;
BA_ "GenSigInvalidValue" SG_ 549 ADC_PAARemoteParkingMode 0;
BA_ "GenSigSendType" SG_ 549 ADC_PAARemoteParkingMode 1;
BA_ "GenSigStartValue" SG_ 549 ADC_PAARemoteParkingMode 0;
BA_ "GenSigTimeoutValue" SG_ 549 ADC_PAARemoteParkingMode 0;
BA_ "Remark" SG_ 549 ADC_PAARemoteParkingMode "";
BA_ "EventCommandSignal" SG_ 549 ADC_PAARemoteParkingEnable 0;
BA_ "GatewayedSignals" SG_ 549 ADC_PAARemoteParkingEnable 0;
BA_ "GenSigInactiveValue" SG_ 549 ADC_PAARemoteParkingEnable 0;
BA_ "GenSigInvalidValue" SG_ 549 ADC_PAARemoteParkingEnable 0;
BA_ "GenSigSendType" SG_ 549 ADC_PAARemoteParkingEnable 1;
BA_ "GenSigStartValue" SG_ 549 ADC_PAARemoteParkingEnable 0;
BA_ "GenSigTimeoutValue" SG_ 549 ADC_PAARemoteParkingEnable 0;
BA_ "Remark" SG_ 549 ADC_PAARemoteParkingEnable "";
BA_ "EventCommandSignal" SG_ 549 ADC_LocalToBeDRVReq 0;
BA_ "GatewayedSignals" SG_ 549 ADC_LocalToBeDRVReq 0;
BA_ "GenSigInactiveValue" SG_ 549 ADC_LocalToBeDRVReq 0;
BA_ "GenSigInvalidValue" SG_ 549 ADC_LocalToBeDRVReq 0;
BA_ "GenSigSendType" SG_ 549 ADC_LocalToBeDRVReq 1;
BA_ "GenSigStartValue" SG_ 549 ADC_LocalToBeDRVReq 0;
BA_ "GenSigTimeoutValue" SG_ 549 ADC_LocalToBeDRVReq 0;
BA_ "Remark" SG_ 549 ADC_LocalToBeDRVReq "";
BA_ "EventCommandSignal" SG_ 549 ADC_UsageModeStAscendReq 0;
BA_ "GatewayedSignals" SG_ 549 ADC_UsageModeStAscendReq 0;
BA_ "GenSigInactiveValue" SG_ 549 ADC_UsageModeStAscendReq 0;
BA_ "GenSigInvalidValue" SG_ 549 ADC_UsageModeStAscendReq 0;
BA_ "GenSigSendType" SG_ 549 ADC_UsageModeStAscendReq 1;
BA_ "GenSigStartValue" SG_ 549 ADC_UsageModeStAscendReq 0;
BA_ "GenSigTimeoutValue" SG_ 549 ADC_UsageModeStAscendReq 0;
BA_ "Remark" SG_ 549 ADC_UsageModeStAscendReq "";
BA_ "EventCommandSignal" SG_ 549 ADC_UsageModeStDescendReq 0;
BA_ "GatewayedSignals" SG_ 549 ADC_UsageModeStDescendReq 0;
BA_ "GenSigInactiveValue" SG_ 549 ADC_UsageModeStDescendReq 0;
BA_ "GenSigInvalidValue" SG_ 549 ADC_UsageModeStDescendReq 0;
BA_ "GenSigSendType" SG_ 549 ADC_UsageModeStDescendReq 1;
BA_ "GenSigStartValue" SG_ 549 ADC_UsageModeStDescendReq 0;
BA_ "GenSigTimeoutValue" SG_ 549 ADC_UsageModeStDescendReq 0;
BA_ "Remark" SG_ 549 ADC_UsageModeStDescendReq "";
BA_ "EventCommandSignal" SG_ 549 ADC_PAAIGCInhibitSt 0;
BA_ "GatewayedSignals" SG_ 549 ADC_PAAIGCInhibitSt 0;
BA_ "GenSigInactiveValue" SG_ 549 ADC_PAAIGCInhibitSt 0;
BA_ "GenSigInvalidValue" SG_ 549 ADC_PAAIGCInhibitSt 0;
BA_ "GenSigSendType" SG_ 549 ADC_PAAIGCInhibitSt 1;
BA_ "GenSigStartValue" SG_ 549 ADC_PAAIGCInhibitSt 0;
BA_ "GenSigTimeoutValue" SG_ 549 ADC_PAAIGCInhibitSt 0;
BA_ "Remark" SG_ 549 ADC_PAAIGCInhibitSt "";
BA_ "EventCommandSignal" SG_ 549 ADC_UsageModeStHold 0;
BA_ "GatewayedSignals" SG_ 549 ADC_UsageModeStHold 0;
BA_ "GenSigInactiveValue" SG_ 549 ADC_UsageModeStHold 0;
BA_ "GenSigInvalidValue" SG_ 549 ADC_UsageModeStHold 0;
BA_ "GenSigSendType" SG_ 549 ADC_UsageModeStHold 1;
BA_ "GenSigStartValue" SG_ 549 ADC_UsageModeStHold 0;
BA_ "GenSigTimeoutValue" SG_ 549 ADC_UsageModeStHold 0;
BA_ "Remark" SG_ 549 ADC_UsageModeStHold "";
BA_ "EventCommandSignal" SG_ 549 ADC_PAARespondMode 0;
BA_ "GatewayedSignals" SG_ 549 ADC_PAARespondMode 0;
BA_ "GenSigInactiveValue" SG_ 549 ADC_PAARespondMode 0;
BA_ "GenSigInvalidValue" SG_ 549 ADC_PAARespondMode 0;
BA_ "GenSigSendType" SG_ 549 ADC_PAARespondMode 1;
BA_ "GenSigStartValue" SG_ 549 ADC_PAARespondMode 0;
BA_ "GenSigTimeoutValue" SG_ 549 ADC_PAARespondMode 0;
BA_ "Remark" SG_ 549 ADC_PAARespondMode "";
BA_ "EventCommandSignal" SG_ 549 ADC_PAAEDKFunInhibitReq 0;
BA_ "GatewayedSignals" SG_ 549 ADC_PAAEDKFunInhibitReq 0;
BA_ "GenSigInactiveValue" SG_ 549 ADC_PAAEDKFunInhibitReq 0;
BA_ "GenSigInvalidValue" SG_ 549 ADC_PAAEDKFunInhibitReq 0;
BA_ "GenSigSendType" SG_ 549 ADC_PAAEDKFunInhibitReq 1;
BA_ "GenSigStartValue" SG_ 549 ADC_PAAEDKFunInhibitReq 0;
BA_ "GenSigTimeoutValue" SG_ 549 ADC_PAAEDKFunInhibitReq 0;
BA_ "Remark" SG_ 549 ADC_PAAEDKFunInhibitReq "";
BA_ "EventCommandSignal" SG_ 549 ADC_DriverPresentSt 0;
BA_ "GatewayedSignals" SG_ 549 ADC_DriverPresentSt 0;
BA_ "GenSigInactiveValue" SG_ 549 ADC_DriverPresentSt 0;
BA_ "GenSigInvalidValue" SG_ 549 ADC_DriverPresentSt 0;
BA_ "GenSigSendType" SG_ 549 ADC_DriverPresentSt 1;
BA_ "GenSigStartValue" SG_ 549 ADC_DriverPresentSt 0;
BA_ "GenSigTimeoutValue" SG_ 549 ADC_DriverPresentSt 0;
BA_ "Remark" SG_ 549 ADC_DriverPresentSt "";
BA_ "EventCommandSignal" SG_ 549 ADC_RAEBWorkSts 0;
BA_ "GatewayedSignals" SG_ 549 ADC_RAEBWorkSts 0;
BA_ "GenSigInactiveValue" SG_ 549 ADC_RAEBWorkSts 0;
BA_ "GenSigInvalidValue" SG_ 549 ADC_RAEBWorkSts 0;
BA_ "GenSigSendType" SG_ 549 ADC_RAEBWorkSts 1;
BA_ "GenSigStartValue" SG_ 549 ADC_RAEBWorkSts 0;
BA_ "GenSigTimeoutValue" SG_ 549 ADC_RAEBWorkSts 0;
BA_ "Remark" SG_ 549 ADC_RAEBWorkSts "";
BA_ "EventCommandSignal" SG_ 549 ADC_UsageModeStHoldVD 0;
BA_ "GatewayedSignals" SG_ 549 ADC_UsageModeStHoldVD 0;
BA_ "GenSigInactiveValue" SG_ 549 ADC_UsageModeStHoldVD 0;
BA_ "GenSigInvalidValue" SG_ 549 ADC_UsageModeStHoldVD 0;
BA_ "GenSigSendType" SG_ 549 ADC_UsageModeStHoldVD 1;
BA_ "GenSigStartValue" SG_ 549 ADC_UsageModeStHoldVD 0;
BA_ "GenSigTimeoutValue" SG_ 549 ADC_UsageModeStHoldVD 0;
BA_ "Remark" SG_ 549 ADC_UsageModeStHoldVD "";
BA_ "EventCommandSignal" SG_ 549 ADC_RAEBEmgyBrkReq 0;
BA_ "GatewayedSignals" SG_ 549 ADC_RAEBEmgyBrkReq 0;
BA_ "GenSigInactiveValue" SG_ 549 ADC_RAEBEmgyBrkReq 0;
BA_ "GenSigInvalidValue" SG_ 549 ADC_RAEBEmgyBrkReq 0;
BA_ "GenSigSendType" SG_ 549 ADC_RAEBEmgyBrkReq 1;
BA_ "GenSigStartValue" SG_ 549 ADC_RAEBEmgyBrkReq 0;
BA_ "GenSigTimeoutValue" SG_ 549 ADC_RAEBEmgyBrkReq 0;
BA_ "Remark" SG_ 549 ADC_RAEBEmgyBrkReq "";
BA_ "EventCommandSignal" SG_ 549 ADC_RAEBTarAccel 0;
BA_ "GatewayedSignals" SG_ 549 ADC_RAEBTarAccel 0;
BA_ "GenSigInactiveValue" SG_ 549 ADC_RAEBTarAccel 0;
BA_ "GenSigInvalidValue" SG_ 549 ADC_RAEBTarAccel 0;
BA_ "GenSigSendType" SG_ 549 ADC_RAEBTarAccel 1;
BA_ "GenSigStartValue" SG_ 549 ADC_RAEBTarAccel 0;
BA_ "GenSigTimeoutValue" SG_ 549 ADC_RAEBTarAccel 0;
BA_ "Remark" SG_ 549 ADC_RAEBTarAccel "";
BA_ "EventCommandSignal" SG_ 549 ADC_PAADrvReq 0;
BA_ "GatewayedSignals" SG_ 549 ADC_PAADrvReq 0;
BA_ "GenSigInactiveValue" SG_ 549 ADC_PAADrvReq 0;
BA_ "GenSigInvalidValue" SG_ 549 ADC_PAADrvReq 0;
BA_ "GenSigSendType" SG_ 549 ADC_PAADrvReq 1;
BA_ "GenSigStartValue" SG_ 549 ADC_PAADrvReq 0;
BA_ "GenSigTimeoutValue" SG_ 549 ADC_PAADrvReq 0;
BA_ "Remark" SG_ 549 ADC_PAADrvReq "";
BA_ "EventCommandSignal" SG_ 549 ADC_PAAQuitInd 0;
BA_ "GatewayedSignals" SG_ 549 ADC_PAAQuitInd 0;
BA_ "GenSigInactiveValue" SG_ 549 ADC_PAAQuitInd 0;
BA_ "GenSigInvalidValue" SG_ 549 ADC_PAAQuitInd 0;
BA_ "GenSigSendType" SG_ 549 ADC_PAAQuitInd 1;
BA_ "GenSigStartValue" SG_ 549 ADC_PAAQuitInd 0;
BA_ "GenSigTimeoutValue" SG_ 549 ADC_PAAQuitInd 0;
BA_ "Remark" SG_ 549 ADC_PAAQuitInd "";
BA_ "EventCommandSignal" SG_ 549 ADC_PAARecInd 0;
BA_ "GatewayedSignals" SG_ 549 ADC_PAARecInd 0;
BA_ "GenSigInactiveValue" SG_ 549 ADC_PAARecInd 0;
BA_ "GenSigInvalidValue" SG_ 549 ADC_PAARecInd 0;
BA_ "GenSigSendType" SG_ 549 ADC_PAARecInd 1;
BA_ "GenSigStartValue" SG_ 549 ADC_PAARecInd 0;
BA_ "GenSigTimeoutValue" SG_ 549 ADC_PAARecInd 0;
BA_ "Remark" SG_ 549 ADC_PAARecInd "";
BA_ "EventCommandSignal" SG_ 549 ADC_RA_RemainDist 0;
BA_ "GatewayedSignals" SG_ 549 ADC_RA_RemainDist 0;
BA_ "GenSigInactiveValue" SG_ 549 ADC_RA_RemainDist 0;
BA_ "GenSigInvalidValue" SG_ 549 ADC_RA_RemainDist 0;
BA_ "GenSigSendType" SG_ 549 ADC_RA_RemainDist 1;
BA_ "GenSigStartValue" SG_ 549 ADC_RA_RemainDist 0;
BA_ "GenSigTimeoutValue" SG_ 549 ADC_RA_RemainDist 0;
BA_ "Remark" SG_ 549 ADC_RA_RemainDist "";
BA_ "EventCommandSignal" SG_ 549 ADC_RAButtonPress 0;
BA_ "GatewayedSignals" SG_ 549 ADC_RAButtonPress 0;
BA_ "GenSigInactiveValue" SG_ 549 ADC_RAButtonPress 0;
BA_ "GenSigInvalidValue" SG_ 549 ADC_RAButtonPress 0;
BA_ "GenSigSendType" SG_ 549 ADC_RAButtonPress 1;
BA_ "GenSigStartValue" SG_ 549 ADC_RAButtonPress 0;
BA_ "GenSigTimeoutValue" SG_ 549 ADC_RAButtonPress 0;
BA_ "Remark" SG_ 549 ADC_RAButtonPress "";
BA_ "EventCommandSignal" SG_ 549 ADC_Rast 0;
BA_ "GatewayedSignals" SG_ 549 ADC_Rast 0;
BA_ "GenSigInactiveValue" SG_ 549 ADC_Rast 0;
BA_ "GenSigInvalidValue" SG_ 549 ADC_Rast 0;
BA_ "GenSigSendType" SG_ 549 ADC_Rast 1;
BA_ "GenSigStartValue" SG_ 549 ADC_Rast 0;
BA_ "GenSigTimeoutValue" SG_ 549 ADC_Rast 0;
BA_ "Remark" SG_ 549 ADC_Rast "";
BA_ "EventCommandSignal" SG_ 549 ADC_SBMAuthst 0;
BA_ "GatewayedSignals" SG_ 549 ADC_SBMAuthst 0;
BA_ "GenSigInactiveValue" SG_ 549 ADC_SBMAuthst 0;
BA_ "GenSigInvalidValue" SG_ 549 ADC_SBMAuthst 0;
BA_ "GenSigSendType" SG_ 549 ADC_SBMAuthst 1;
BA_ "GenSigStartValue" SG_ 549 ADC_SBMAuthst 0;
BA_ "GenSigTimeoutValue" SG_ 549 ADC_SBMAuthst 0;
BA_ "Remark" SG_ 549 ADC_SBMAuthst "";
BA_ "EventCommandSignal" SG_ 549 ADC_AuthPassSt 0;
BA_ "GatewayedSignals" SG_ 549 ADC_AuthPassSt 0;
BA_ "GenSigInactiveValue" SG_ 549 ADC_AuthPassSt 0;
BA_ "GenSigInvalidValue" SG_ 549 ADC_AuthPassSt 0;
BA_ "GenSigSendType" SG_ 549 ADC_AuthPassSt 1;
BA_ "GenSigStartValue" SG_ 549 ADC_AuthPassSt 0;
BA_ "GenSigTimeoutValue" SG_ 549 ADC_AuthPassSt 0;
BA_ "Remark" SG_ 549 ADC_AuthPassSt "";
BA_ "EventCommandSignal" SG_ 549 ADC_RPADirectionSel 0;
BA_ "GatewayedSignals" SG_ 549 ADC_RPADirectionSel 0;
BA_ "GenSigInactiveValue" SG_ 549 ADC_RPADirectionSel 0;
BA_ "GenSigInvalidValue" SG_ 549 ADC_RPADirectionSel 0;
BA_ "GenSigSendType" SG_ 549 ADC_RPADirectionSel 1;
BA_ "GenSigStartValue" SG_ 549 ADC_RPADirectionSel 0;
BA_ "GenSigTimeoutValue" SG_ 549 ADC_RPADirectionSel 0;
BA_ "Remark" SG_ 549 ADC_RPADirectionSel "";
BA_ "EventCommandSignal" SG_ 549 ADC_VehPoscoord 0;
BA_ "GatewayedSignals" SG_ 549 ADC_VehPoscoord 0;
BA_ "GenSigInactiveValue" SG_ 549 ADC_VehPoscoord 0;
BA_ "GenSigInvalidValue" SG_ 549 ADC_VehPoscoord 0;
BA_ "GenSigSendType" SG_ 549 ADC_VehPoscoord 1;
BA_ "GenSigStartValue" SG_ 549 ADC_VehPoscoord 0;
BA_ "GenSigTimeoutValue" SG_ 549 ADC_VehPoscoord 0;
BA_ "Remark" SG_ 549 ADC_VehPoscoord "";
BA_ "EventCommandSignal" SG_ 549 ADC_VehDynamicPosX 0;
BA_ "GatewayedSignals" SG_ 549 ADC_VehDynamicPosX 0;
BA_ "GenSigInactiveValue" SG_ 549 ADC_VehDynamicPosX 0;
BA_ "GenSigInvalidValue" SG_ 549 ADC_VehDynamicPosX 0;
BA_ "GenSigSendType" SG_ 549 ADC_VehDynamicPosX 1;
BA_ "GenSigStartValue" SG_ 549 ADC_VehDynamicPosX 0;
BA_ "GenSigTimeoutValue" SG_ 549 ADC_VehDynamicPosX 0;
BA_ "Remark" SG_ 549 ADC_VehDynamicPosX "";
BA_ "EventCommandSignal" SG_ 549 ADC_VehDynamicPosY 0;
BA_ "GatewayedSignals" SG_ 549 ADC_VehDynamicPosY 0;
BA_ "GenSigInactiveValue" SG_ 549 ADC_VehDynamicPosY 0;
BA_ "GenSigInvalidValue" SG_ 549 ADC_VehDynamicPosY 0;
BA_ "GenSigSendType" SG_ 549 ADC_VehDynamicPosY 1;
BA_ "GenSigStartValue" SG_ 549 ADC_VehDynamicPosY 0;
BA_ "GenSigTimeoutValue" SG_ 549 ADC_VehDynamicPosY 0;
BA_ "Remark" SG_ 549 ADC_VehDynamicPosY "";
BA_ "EventCommandSignal" SG_ 549 ADC_VehCurv 0;
BA_ "GatewayedSignals" SG_ 549 ADC_VehCurv 0;
BA_ "GenSigInactiveValue" SG_ 549 ADC_VehCurv 0;
BA_ "GenSigInvalidValue" SG_ 549 ADC_VehCurv 0;
BA_ "GenSigSendType" SG_ 549 ADC_VehCurv 1;
BA_ "GenSigStartValue" SG_ 549 ADC_VehCurv 0;
BA_ "GenSigTimeoutValue" SG_ 549 ADC_VehCurv 0;
BA_ "Remark" SG_ 549 ADC_VehCurv "";
BA_ "EventCommandSignal" SG_ 549 ADC_SlotPosX 0;
BA_ "GatewayedSignals" SG_ 549 ADC_SlotPosX 0;
BA_ "GenSigInactiveValue" SG_ 549 ADC_SlotPosX 0;
BA_ "GenSigInvalidValue" SG_ 549 ADC_SlotPosX 0;
BA_ "GenSigSendType" SG_ 549 ADC_SlotPosX 1;
BA_ "GenSigStartValue" SG_ 549 ADC_SlotPosX 0;
BA_ "GenSigTimeoutValue" SG_ 549 ADC_SlotPosX 0;
BA_ "Remark" SG_ 549 ADC_SlotPosX "";
BA_ "EventCommandSignal" SG_ 549 ADC_SlotPosY 0;
BA_ "GatewayedSignals" SG_ 549 ADC_SlotPosY 0;
BA_ "GenSigInactiveValue" SG_ 549 ADC_SlotPosY 0;
BA_ "GenSigInvalidValue" SG_ 549 ADC_SlotPosY 0;
BA_ "GenSigSendType" SG_ 549 ADC_SlotPosY 1;
BA_ "GenSigStartValue" SG_ 549 ADC_SlotPosY 0;
BA_ "GenSigTimeoutValue" SG_ 549 ADC_SlotPosY 0;
BA_ "Remark" SG_ 549 ADC_SlotPosY "";
BA_ "EventCommandSignal" SG_ 549 ADC_SlotCurv 0;
BA_ "GatewayedSignals" SG_ 549 ADC_SlotCurv 0;
BA_ "GenSigInactiveValue" SG_ 549 ADC_SlotCurv 0;
BA_ "GenSigInvalidValue" SG_ 549 ADC_SlotCurv 0;
BA_ "GenSigSendType" SG_ 549 ADC_SlotCurv 1;
BA_ "GenSigStartValue" SG_ 549 ADC_SlotCurv 0;
BA_ "GenSigTimeoutValue" SG_ 549 ADC_SlotCurv 0;
BA_ "Remark" SG_ 549 ADC_SlotCurv "";
BA_ "EventCommandSignal" SG_ 549 ADC_HPAst 0;
BA_ "GatewayedSignals" SG_ 549 ADC_HPAst 0;
BA_ "GenSigInactiveValue" SG_ 549 ADC_HPAst 0;
BA_ "GenSigInvalidValue" SG_ 549 ADC_HPAst 0;
BA_ "GenSigSendType" SG_ 549 ADC_HPAst 1;
BA_ "GenSigStartValue" SG_ 549 ADC_HPAst 0;
BA_ "GenSigTimeoutValue" SG_ 549 ADC_HPAst 0;
BA_ "Remark" SG_ 549 ADC_HPAst "";
BA_ "EventCommandSignal" SG_ 549 ADC_parkInOutDirection 0;
BA_ "GatewayedSignals" SG_ 549 ADC_parkInOutDirection 0;
BA_ "GenSigInactiveValue" SG_ 549 ADC_parkInOutDirection 0;
BA_ "GenSigInvalidValue" SG_ 549 ADC_parkInOutDirection 0;
BA_ "GenSigSendType" SG_ 549 ADC_parkInOutDirection 1;
BA_ "GenSigStartValue" SG_ 549 ADC_parkInOutDirection 0;
BA_ "GenSigTimeoutValue" SG_ 549 ADC_parkInOutDirection 0;
BA_ "Remark" SG_ 549 ADC_parkInOutDirection "";
BA_ "EventCommandSignal" SG_ 549 ADC_RPAStMessagePush 0;
BA_ "GatewayedSignals" SG_ 549 ADC_RPAStMessagePush 0;
BA_ "GenSigInactiveValue" SG_ 549 ADC_RPAStMessagePush 0;
BA_ "GenSigInvalidValue" SG_ 549 ADC_RPAStMessagePush 0;
BA_ "GenSigSendType" SG_ 549 ADC_RPAStMessagePush 1;
BA_ "GenSigStartValue" SG_ 549 ADC_RPAStMessagePush 0;
BA_ "GenSigTimeoutValue" SG_ 549 ADC_RPAStMessagePush 0;
BA_ "Remark" SG_ 549 ADC_RPAStMessagePush "";
BA_ "EventCommandSignal" SG_ 549 ADC_RPAtype 0;
BA_ "GatewayedSignals" SG_ 549 ADC_RPAtype 0;
BA_ "GenSigInactiveValue" SG_ 549 ADC_RPAtype 0;
BA_ "GenSigInvalidValue" SG_ 549 ADC_RPAtype 0;
BA_ "GenSigSendType" SG_ 549 ADC_RPAtype 1;
BA_ "GenSigStartValue" SG_ 549 ADC_RPAtype 0;
BA_ "GenSigTimeoutValue" SG_ 549 ADC_RPAtype 0;
BA_ "Remark" SG_ 549 ADC_RPAtype "";
BA_ "EventCommandSignal" SG_ 549 ADC_VehPosYawrate 0;
BA_ "GatewayedSignals" SG_ 549 ADC_VehPosYawrate 0;
BA_ "GenSigInactiveValue" SG_ 549 ADC_VehPosYawrate 0;
BA_ "GenSigInvalidValue" SG_ 549 ADC_VehPosYawrate 0;
BA_ "GenSigSendType" SG_ 549 ADC_VehPosYawrate 1;
BA_ "GenSigStartValue" SG_ 549 ADC_VehPosYawrate 0;
BA_ "GenSigTimeoutValue" SG_ 549 ADC_VehPosYawrate 0;
BA_ "Remark" SG_ 549 ADC_VehPosYawrate "";
BA_ "EventCommandSignal" SG_ 549 ADC_SlotAngle 0;
BA_ "GatewayedSignals" SG_ 549 ADC_SlotAngle 0;
BA_ "GenSigInactiveValue" SG_ 549 ADC_SlotAngle 0;
BA_ "GenSigInvalidValue" SG_ 549 ADC_SlotAngle 0;
BA_ "GenSigSendType" SG_ 549 ADC_SlotAngle 1;
BA_ "GenSigStartValue" SG_ 549 ADC_SlotAngle 0;
BA_ "GenSigTimeoutValue" SG_ 549 ADC_SlotAngle 0;
BA_ "Remark" SG_ 549 ADC_SlotAngle "";
BA_ "EventCommandSignal" SG_ 549 ADC_DskScreenOperationReq 0;
BA_ "GatewayedSignals" SG_ 549 ADC_DskScreenOperationReq 0;
BA_ "GenSigInactiveValue" SG_ 549 ADC_DskScreenOperationReq 0;
BA_ "GenSigInvalidValue" SG_ 549 ADC_DskScreenOperationReq 0;
BA_ "GenSigSendType" SG_ 549 ADC_DskScreenOperationReq 1;
BA_ "GenSigStartValue" SG_ 549 ADC_DskScreenOperationReq 1;
BA_ "GenSigTimeoutValue" SG_ 549 ADC_DskScreenOperationReq 0;
BA_ "Remark" SG_ 549 ADC_DskScreenOperationReq "";
BA_ "EventCommandSignal" SG_ 549 ADC_SenslesEtyParkingSt 0;
BA_ "GatewayedSignals" SG_ 549 ADC_SenslesEtyParkingSt 0;
BA_ "GenSigInactiveValue" SG_ 549 ADC_SenslesEtyParkingSt 0;
BA_ "GenSigInvalidValue" SG_ 549 ADC_SenslesEtyParkingSt 0;
BA_ "GenSigSendType" SG_ 549 ADC_SenslesEtyParkingSt 1;
BA_ "GenSigStartValue" SG_ 549 ADC_SenslesEtyParkingSt 0;
BA_ "GenSigTimeoutValue" SG_ 549 ADC_SenslesEtyParkingSt 0;
BA_ "Remark" SG_ 549 ADC_SenslesEtyParkingSt "";
BA_ "EventCommandSignal" SG_ 549 ADC_PAALimitToast 0;
BA_ "GatewayedSignals" SG_ 549 ADC_PAALimitToast 0;
BA_ "GenSigInactiveValue" SG_ 549 ADC_PAALimitToast 0;
BA_ "GenSigInvalidValue" SG_ 549 ADC_PAALimitToast 0;
BA_ "GenSigSendType" SG_ 549 ADC_PAALimitToast 1;
BA_ "GenSigStartValue" SG_ 549 ADC_PAALimitToast 0;
BA_ "GenSigTimeoutValue" SG_ 549 ADC_PAALimitToast 0;
BA_ "Remark" SG_ 549 ADC_PAALimitToast "";
BA_ "EventCommandSignal" SG_ 549 ADC_PAALimitReminder 0;
BA_ "GatewayedSignals" SG_ 549 ADC_PAALimitReminder 0;
BA_ "GenSigInactiveValue" SG_ 549 ADC_PAALimitReminder 0;
BA_ "GenSigInvalidValue" SG_ 549 ADC_PAALimitReminder 0;
BA_ "GenSigSendType" SG_ 549 ADC_PAALimitReminder 1;
BA_ "GenSigStartValue" SG_ 549 ADC_PAALimitReminder 0;
BA_ "GenSigTimeoutValue" SG_ 549 ADC_PAALimitReminder 0;
BA_ "Remark" SG_ 549 ADC_PAALimitReminder "";
BA_ "EventCommandSignal" SG_ 549 ADC_ParkOutMode 0;
BA_ "GatewayedSignals" SG_ 549 ADC_ParkOutMode 0;
BA_ "GenSigInactiveValue" SG_ 549 ADC_ParkOutMode 0;
BA_ "GenSigInvalidValue" SG_ 549 ADC_ParkOutMode 0;
BA_ "GenSigSendType" SG_ 549 ADC_ParkOutMode 1;
BA_ "GenSigStartValue" SG_ 549 ADC_ParkOutMode 0;
BA_ "GenSigTimeoutValue" SG_ 549 ADC_ParkOutMode 0;
BA_ "Remark" SG_ 549 ADC_ParkOutMode "";
BA_ "EventCommandSignal" SG_ 549 ADAS_ParkStats 0;
BA_ "GatewayedSignals" SG_ 549 ADAS_ParkStats 0;
BA_ "GenSigInactiveValue" SG_ 549 ADAS_ParkStats 0;
BA_ "GenSigInvalidValue" SG_ 549 ADAS_ParkStats 0;
BA_ "GenSigSendType" SG_ 549 ADAS_ParkStats 1;
BA_ "GenSigStartValue" SG_ 549 ADAS_ParkStats 0;
BA_ "GenSigTimeoutValue" SG_ 549 ADAS_ParkStats 0;
BA_ "Remark" SG_ 549 ADAS_ParkStats "";
BA_ "EventCommandSignal" SG_ 549 ADC_RPABlechnReq 0;
BA_ "GatewayedSignals" SG_ 549 ADC_RPABlechnReq 0;
BA_ "GenSigInactiveValue" SG_ 549 ADC_RPABlechnReq 0;
BA_ "GenSigInvalidValue" SG_ 549 ADC_RPABlechnReq 0;
BA_ "GenSigSendType" SG_ 549 ADC_RPABlechnReq 1;
BA_ "GenSigStartValue" SG_ 549 ADC_RPABlechnReq 0;
BA_ "GenSigTimeoutValue" SG_ 549 ADC_RPABlechnReq 0;
BA_ "Remark" SG_ 549 ADC_RPABlechnReq "";
BA_ "EventCommandSignal" SG_ 549 ADC_RPABlePushSt 0;
BA_ "GatewayedSignals" SG_ 549 ADC_RPABlePushSt 0;
BA_ "GenSigInactiveValue" SG_ 549 ADC_RPABlePushSt 0;
BA_ "GenSigInvalidValue" SG_ 549 ADC_RPABlePushSt 0;
BA_ "GenSigSendType" SG_ 549 ADC_RPABlePushSt 1;
BA_ "GenSigStartValue" SG_ 549 ADC_RPABlePushSt 0;
BA_ "GenSigTimeoutValue" SG_ 549 ADC_RPABlePushSt 0;
BA_ "Remark" SG_ 549 ADC_RPABlePushSt "";
BA_ "EventCommandSignal" SG_ 549 Reserved1 0;
BA_ "GatewayedSignals" SG_ 549 Reserved1 0;
BA_ "GenSigInactiveValue" SG_ 549 Reserved1 0;
BA_ "GenSigInvalidValue" SG_ 549 Reserved1 0;
BA_ "GenSigSendType" SG_ 549 Reserved1 1;
BA_ "GenSigStartValue" SG_ 549 Reserved1 0;
BA_ "GenSigTimeoutValue" SG_ 549 Reserved1 0;
BA_ "Remark" SG_ 549 Reserved1 "";
BA_ "EventCommandSignal" SG_ 1806 ADC_Diag_Request 1;
BA_ "GatewayedSignals" SG_ 1806 ADC_Diag_Request 0;
BA_ "GenSigInactiveValue" SG_ 1806 ADC_Diag_Request 0;
BA_ "GenSigInvalidValue" SG_ 1806 ADC_Diag_Request 0;
BA_ "GenSigSendType" SG_ 1806 ADC_Diag_Request 0;
BA_ "GenSigStartValue" SG_ 1806 ADC_Diag_Request 0;
BA_ "GenSigTimeoutValue" SG_ 1806 ADC_Diag_Request 0;
BA_ "Remark" SG_ 1806 ADC_Diag_Request "";
BA_ "EventCommandSignal" SG_ 1269 FL_DTCCode 1;
BA_ "GatewayedSignals" SG_ 1269 FL_DTCCode 0;
BA_ "GenSigInactiveValue" SG_ 1269 FL_DTCCode 0;
BA_ "GenSigInvalidValue" SG_ 1269 FL_DTCCode 0;
BA_ "GenSigSendType" SG_ 1269 FL_DTCCode 0;
BA_ "GenSigStartValue" SG_ 1269 FL_DTCCode 0;
BA_ "GenSigTimeoutValue" SG_ 1269 FL_DTCCode 0;
BA_ "Remark" SG_ 1269 FL_DTCCode "";
BA_ "EventCommandSignal" SG_ 1174 ADC_BigData 0;
BA_ "GatewayedSignals" SG_ 1174 ADC_BigData 0;
BA_ "GenSigInactiveValue" SG_ 1174 ADC_BigData 0;
BA_ "GenSigInvalidValue" SG_ 1174 ADC_BigData 0;
BA_ "GenSigSendType" SG_ 1174 ADC_BigData 1;
BA_ "GenSigStartValue" SG_ 1174 ADC_BigData 0;
BA_ "GenSigTimeoutValue" SG_ 1174 ADC_BigData 0;
BA_ "Remark" SG_ 1174 ADC_BigData "";
VAL_ 549 ADC_APAst 0 "Off" 1 "Standby" 2 "Searching" 3 "Guidance active" 4 "Completed" 5 "Failure" 6 "Terminated" 7 "Pause"  ;
VAL_ 549 ADC_AVPst 0 "None" 1 "standby" 2 "Parked_in_slot" 3 "failure" 4 "Checking_Learning" 5 "Route_learning" 6 "Map_builded_awaiting_confirmation" 7 "Post_processing_after_map_building" 8 "Map_building_completed" 9 "Map_building_terminated" 10 "Checking_Cruising" 11 "Route_matching_successful" 12 "Cruising" 13 "Cruising_paused" 14 "Cruising_terminated" 15 "Cruising_completed"  ;
VAL_ 549 ADC_PAAFuncSt 0 "None" 1 "APA" 2 "RPA" 3 "HPA" 4 "AVP" 5 "RA" 6 "Custom Slot" 7 "PAA" 8 "DPA" 9 "summon" 10 "BSPA" 11 "Voice APA"  ;
VAL_ 549 ADC_PAAVoiceReminder 16 "The parking function is temporarily unavailable due to excessive speed" 17 "Searching for parking space, please proceed" 18 "Found parking space, please stop" 19 "Please hold the brake and click to start parking" 20 "Please release brakes and steering wheel" 21 "Parking completed" 22 "Remote parking is temporarily unavailable because no parking space is found" 23 "Remote parking is temporarily unavailable in automatic parking" 24 "Please close the door and continue" 25 "Please click to continue" 26 "Obstruction detected, please wait" 27 "Search timeout, parking exit" 28 "Please slow down" 29 "Speed is too fast, parking is about to exit" 30 "Please proceed" 31 "Please select the docking direction" 32 "Exit parking" 33 "Limited space, parking exit" 34 "System response timed out, parking exits" 35 "Throttle intervention, parking exit" 36 "Assist driving function starts and parking exits" 37 "Steering wheel interferes, parking exits" 38 "Gear intervention, parking exit" 39 "Sorry, there is a small problem with the system, parking exit" 768 "Please adjust the parking space after parking" 1024 "Reverse tracking is enabled, release brake and steering wheel" 1025 "Be aware of your surroundings and be ready to brake" 1026 "Reverse tracking completed" 1027 "Please switch to R" 1028 "Wait timeout, the function exits" 1029 "Please release the brakes before continuing" 1031 "Sorry, there is a small problem with the system, the reverse tracking is not working" 1031 "Reverse tracking has exited, please take over vehicle" 1032 "Sorry, there is a small problem with the system, reverse tracking has been quitted" 1033 "Caution when reversing" 1536 "Start Setting, please wait" 1537 "Start point set successfully!Please move to the parking space so I can learn the route" 1538 "Start point setting failed" 1539 "Route only 150 meters recorded, please park as soon as possible" 1540 "Please park in the parking space as soon as possible, otherwise this route learning will not be saved" 1541 "Excessive speed, please keep the speed less than 20 km/h" 1542 "Sorry, route learning failed" 1543 "Please click setting end" 1544 "Setting endpoint, please wait" 1545 "Finish setting is successful, click Save" 1546 "Endpoint setting failed" 1547 "Please save the route" 1548 "Saving the route" 1549 "Route saved successfully" 1550 "Sorry, route saving failed" 1551 "The route can only record 150 meters, please park as soon as possible" 1552 "Matching route" 1553 "The route is successfully matched" 1554 "Obstacle removed, parking continues" 1555 "Pay attention to pedestrians ahead" 1556 "Attention traffic ahead" 1557 "Please note the speed bump ahead" 1558 "About to turn left" 1559 "About to turn right" 1560 "Intersection ahead, please pay attention to your surroundings" 1561 "Curve ahead" 1562 "Vehicle deceleration" 1563 "rounding" 1564 "Approaching parking space" 1565 "Near the end" 2816 "Ready to go, now guide you to the designated area for valet parking" 2817 "Please keep straight" 2818 "Center lane, please" 2819 "Please keep to the left" 2820 "Please keep on the right side" 2821 "Please go straight ahead" 2822 "Turn left about 20 meters ahead" 2823 "Turn right about 20 meters ahead" 2824 "turn left" 2825 "turn right" 2826 "Off course, rerouting the course" 2827 "You are going too fast for the system to complete location" 2828 "Boot exit" 2829 "The system fails to locate and exits the boot" 2830 "Boot complete" 2831 "You have reached the valet parking activated area" 2832 "You are not within the valet parking available area" 2833 "Please select valet parking" 2834 "The pickup position has been reached"  ;
VAL_ 549 ADC_PAAVRSwitchFailSt 0 "No Fail" 1 "Fail"  ;
VAL_ 549 ADC_APKDisplayReq 0 "Not request" 1 "Request"  ;
VAL_ 549 ADC_APAActFuncInd 0 "No Active" 1 "Automatic cross park in" 2 "Automatic Parallel Park in" 3 "Automatic crossl park out" 4 "Automatic parallel park out" 5 "Remote cross Parkin" 6 "Remote parallel Parkin" 7 "Remote crossl POC" 8 "Remote parallel POC" 9 "Remote Front out" 10 "Remote Back out" 11 "Reserved" 12 "Reserved" 13 "Reserved" 14 "Reserved" 15 "Reserved"  ;
VAL_ 549 ADC_APABackParkDisplayReq 0 "None" 1 "Image parking" 2 "Space parking" 3 "Reserve"  ;
VAL_ 549 ADC_VCU_Gearshiftprompt 0 "Not request" 1 "Prohibit"  ;
VAL_ 549 ADC_PedWarnToneCtrl 0 "No Request" 1 "On" 2 "Off" 3 "reserve"  ;
VAL_ 549 ADC_PAAToNDAReq 0 "No Request" 1 "PAA to NDA" 2 "NDA to PAA" 3 "Reserved"  ;
VAL_ 549 ADC_PAARemoteParkingMode 0 "Default" 1 "Remote parking" 2 "Automatic parking" 3 "Not used"  ;
VAL_ 549 ADC_PAARemoteParkingEnable 0 "Disable" 1 "Enable"  ;
VAL_ 549 ADC_LocalToBeDRVReq 0 "No request" 1 "Request"  ;
VAL_ 549 ADC_UsageModeStAscendReq 0 "No Request" 1 "Power On Request (PTready)"  ;
VAL_ 549 ADC_UsageModeStDescendReq 0 "No request" 1 "Request"  ;
VAL_ 549 ADC_PAAIGCInhibitSt 0 "Not Inhibit" 1 "Inhibit"  ;
VAL_ 549 ADC_UsageModeStHold 0 "No request" 1 "UsageMode Hold"  ;
VAL_ 549 ADC_PAARespondMode 0 "None"  ;
VAL_ 549 ADC_PAAEDKFunInhibitReq 0 "Not inhibit" 1 "Inhibit"  ;
VAL_ 549 ADC_UsageModeStHoldVD 0 "not valid;" 1 "valid;"  ;
VAL_ 549 ADC_RAEBEmgyBrkReq 0 "Not active" 1 "Active"  ;
VAL_ 549 ADC_PAADrvReq 0 "No_Request" 1 "Req_ClosAllDoors" 2 "Req_PowerReady" 3 "Req_StopCharging" 4 "Req_GearP" 5 "Req_DrivePathScope" 6 "Req_UpdatePath" 7 "Req_PowerOFF" 8 "Req_FasteSaftyBelt" 9 "Req_ConfirmStartButton" 10 "Req_GettingOff" 11 "Req_ConfirmNoPerson_" 12 "Req_ConfirmContinueButton" 13 "Req_DriveActiveScope" 14 "Req_ReleaseBrake" 15 "Req_SlowDwon" 16 "Req_PressBrake" 17 "Req_Stop" 18 "Req_SelectedDirection" 19 "Req_Forward" 20 "Req_EPB" 21 "Req_Close_Trunk" 22 "Req_CloseEngineDoor" 23 "Req_CloseDriverDoor" 24 "Req_ReleaseGasPedal" 25 "Req_GetInTakeOver" 26 "Req_ExpandRearviewMirror" 27 "Req_PayAttentionSurrounding" 28 "Req_SelectFunction" 29 "Req_SelectPickUpPoint" 30 "Req_SetStartPoint" 31 "Req_SetEndPoint" 32 "Req_StartAPAtoParkIntoLearningSlot" 33 "Req_DriverParkIntoLearningSlot" 34 "Req_PressBrakePedalAndContinueButton" 35 "Req_ClosePassengerDoors" 36 "Req_ProperDistance" 37 "Req_GearR" 38 "Req_ConfirmStartButtonByVoice" 39 "Req_SelectSlotByVoice" 40 "Req_ForwardToEndPoint" 41 "Req_ParkingOtherSlot" 42 "Req_ParkingInMobileSlot" 43 "Req_PayAttentionSurroundingsKeepBrakingInTime" 44 "Req_SetParkingSlot" 45 "Info_ApproachingLimitBlockAndParkingToCompleted" 46 "Req_DonotPressTheAcceleratorPedal" 47 "Req_ReleaseTheBrakeAndParkingToCompleted" 48 "Info_DrvingModeToParkingMode" 49 "Req_LeaveTheCarWithYourKeyAndBelongings" 50 "Info_LeaveCarAndClosedDoor" 51 "Req_DoubleShifterLever" 52 "Req_StopVehicleBeforParking" 55 "Req_TabSelfCheck" 56 "Req_TabParking" 57 "Info_SearchingProcess" 58 "Info_CruisingProcess" 59 "Info_PrakingProcess" 60 "Info_FuncitonSuspend" 61 "Info_FuncitonRecover" 62 "Info_FuncitonOff" 63 "Info_FuncitonComplete" 64 "Info_ConditionDetecting" 65 "Info_ConditionDetected" 66 "Info_PathMatching" 67 "Info_PathMatched" 68 "Info_ArrivedEndingPoint" 69 "Info_ArrivedStartingPoint" 70 "Info_CommunicationComplete" 71 "Info_ParkingToCruising" 72 "Info_CruisingToParking" 73 "Info_AlreadyInParkingSpace" 74 "Info_DriverSeatEmpty" 75 "Info_ParkingInFixedLot" 76 "Info_SearchingRandomLot" 77 "Info_NoParkingLot" 78 "Info_UnallowedParkingLot" 79 "Info_SteerByPeople" 80 "Info_SteerByObstacle" 81 "Info_AlreardySearchedLot" 82 "Info_DetectedObstacle" 83 "Info_DetectedPeople" 84 "Info_DetectedCrossing" 85 "Info_DetectedVehicle" 86 "Info_DetectedSpeedBumps" 87 "Info_SteerByVehicle" 88 "Info_TurnLeft" 89 "Info_TurnRight" 90 "Info_RefindParkingSpace" 91 "Info_OutOfAvailableParkingLot" 92 "Info_PathMatchingFailed" 93 "Info_ConditionDetectingFailed" 94 "Info_FoundParkingSpace" 95 "Info_InGuideRegion" 96 "Info_UnactiveRegion" 97 "Info_PowerOffFailed" 98 "Info_ParkingBrakeFailure" 99 "Info_DoorLockFailure" 100 "Info_ShutWindowFailure" 101 "Info_CloseToDestination" 102 "Info_ReachedTheEnd" 103 "Info_FunctionStart" 104 "Info_ParkingRearviewMirrorFolded" 105 "Info_ParkingSenslesEty" 106 "Info_NumberOfLineLearnlimited" 107 "Info_ExceedMaxlearningdistance" 108 "Info_OnlineMappingExceedLimit" 109 "Info_OfflineMappingExceedLimit" 110 "Info_LearningFailed" 111 "Info_SurroundingStaticObstacleTooClose" 112 "Info_SurroundingLightAbnormal" 113 "Info_Info_SurroundingSlopeAbnormal" 114 "Info_SurroundingRainy" 115 "Info_LearningFewerPointFeature" 116 "Info_CameraBlocked" 117 "Info_SurroundingSnowy" 118 "Info_LineSaveFailed" 119 "Info_SpeedExceedWarning" 120 "Info_DistanceExceedLv1Warning" 121 "Info_DistanceExceedLv2Warning" 122 "Info_ReservedDistanceExceed" 123 "Info_StartPointSuccess" 124 "Info_EndPointSuccess" 125 "Info_StartPointFail" 126 "Info_EndPointFail" 127 "Info_DetectedTurbulence" 128 "Info_DetectedSlope" 129 "Info_WaitingCarPullAway" 130 "Info_BrakeOnTime" 131 "Info_RemoteControl" 132 "Info_ArrivalDrop_offPointUseSmartKey" 133 "Info_ArrivalDrop_offPointUseAPP" 134 "Req_TryAgain_BeforeTakeKeyAway" 135 "Info_ParkingMode_CurrentlyUnavailable" 136 "Info_Move_Rotate" 137 "Info_ADASOpening" 138 "Req_Stop_Custom" 139 "Info_NarrowSlot_StopOutward" 140 "Info_Bluetooth_Detection" 141 "Info_PrkgSlotLeftOffsetNoAvailable" 142 "InfoPrkgSlotRightOffsetNoAvailable" 143 "Info_ParkingMode_CurrentlyUnavailable" 144 "ExcessiveVehicleSpeed_ReduceSpeedToInitiateParing" 145 "ReversePathAssistInProgress_PleaseMonitorTheSurroundings" 146 "Req_ConnectBluetooth" 147 "Info_BluetoothSignalWeak" 148 "Info_PrakingOutProcess" 149 "Info_PrakingInProcess" 150 "Info_TurbulencePossibility"  ;
VAL_ 549 ADC_PAAQuitInd 0 "No_Request" 1 "Quit_SysFailure" 2 "Quit_SpeedHigh" 3 "Quit_TimingOverflow" 4 "Quit_ParkingTimingOverflow" 5 "Quit_MoveTimesOverflow" 6 "Quit_WaitTimingOverflow" 7 "Quit_RecoverInterruptTimesOverflow" 8 "Quit_GasPedalIntervention" 9 "Quit_BrakePedalIntervention" 10 "Quit_GearIntervention" 11 "Quit_ExternalECUActive" 12 "Quit_TrajectoryLimit" 13 "Quit_SpaceLimit" 14 "Quit_PhoneDisconnected" 15 "Quit_SeatBeltUnbuckle" 16 "Quit_DoorOpen" 17 "Quit_EPBApply" 18 "Quit_VehicleBlock" 19 "Quit_GearResponseTimeOut" 20 "Quit_LuggageDoorOpen" 21 "Quit_SteeringWheelHandsOn" 22 "Quit_CancelButtonPressed" 23 "Quit_DoorLock" 24 "Quit_SBMFailureReason" 25 "Quit_RemoteDeviceFairlureReason" 26 "Quilt_UnsafeBehavior" 27 "Quit_PhoneLowBattey" 28 "Quit_VCUFailureReason" 29 "Quit_ESPFailureReason" 30 "Quit_EPSFailureReason" 31 "Quit_TBOXFailureReason" 32 "Quit_ExternalECUFailure" 33 "Quit_NoParkingLot" 34 "Quit_UnallowedParkingLot" 35 "Quit_PTReadyFailure" 36 "Quit_AlreadyInParkingSpace" 37 "Quit_PathEndingArrived" 38 "Quit_TaskFailed" 39 "Quit_PathMatchFailed" 40 "Quit_RearviewMirrorFolded" 41 "Quit_PowerOffFailed" 42 "Quit_FuncitonOff" 43 "Quit_EPSHandshakingFailed" 44 "Quit_ESPHandshakingFailed" 45 "Quit_PathMatchingFailed" 46 "Quit_ConditionDetectingFailed" 47 "Quit_PositionUnaviable" 48 "Quit_ObtainPathFailed" 49 "Quit_NoParkingLot2" 50 "Quit_UnallowedParkingLot2" 51 "Quit_OutOfAvailableParkingLot" 52 "Quit_UnactiveRegion" 53 "Quit_DoorLockFailure" 54 "Quit_AbnormalTirePressure" 55 "Quit_GearInterrupt" 56 "Quit_UserCancel" 57 "Quit_DriverDoorOpened" 58 "Quit_HoodOpened" 59 "Quit_CrashedDetected" 60 "Quit_LightAbnormal" 61 "Quit_RainyDay" 62 "Quit_SlopeAbnormal" 63 "Quit_FewPointFeature" 64 "Quit_FrontCameraDirty" 65 "Quit_SurroundCameraDirty" 66 "Quit_No_Valid_Path" 67 "Quit_Charger_connected" 68 "Quit_FunctionButtonPressed" 69 "Quit_OffTrack" 70 "Quit_SystemFailureFunctionUnusable" 71 "Quit_SpeedTooHighPleaseReduce" 72 "Quit_RouteTooShort" 73 "Quit_PleaseCloseADASFuncionAndOpenRA" 74 "Quit_ReachFinishLinePleaseTakeOverTheVehicle" 75 "Quit_FuntionQuitPleaseTakeOverTheVehicle" 76 "Quit_SytemTimeOutFuntionQuit" 77 "Quit_AbnormalGearPositionFuntionQuit" 78 "Quit_ConditionNotMetFuntionQuit" 79 "Quit_DrivingFunctionActive" 80 "Quit_LearnningLineDistanceLimit" 81 "Quit_ObstacleTooClose" 82 "Quit_BackDistanceTooLong" 83 "Quit_VehModeUnavailable" 84 "Quit_MatchTimeout" 85 "Quit_RemoteControlFail" 86 "Quit_LeraningConditionFail" 87 "Quit_NoDriver" 88 "Quit_Re_EnterParking" 89 "Quit_LearnningMapFail"  ;
VAL_ 549 ADC_PAARecInd 0 "No_Request" 1 "Recover_PressInterruptSwitch" 2 "Recover_MobileOutRange" 3 "Recover_DoorOpened" 4 "Recover_FoundObstacleTrajectory" 5 "Recover_MobileCommunicationWeak" 6 "Recover_SeatBeltUnbuckle" 7 "Recover_ParkingTimingOverflow" 8 "Recover_MoveTimesOverflow" 9 "Recover_GasPedalIntervention" 10 "Recover_BrakePedalIntervention" 11 "Recover_SpaceLimit" 12 "Recover_PhoneDisconnected" 13 "Recover_EPBApply" 14 "Recover_VehicleBlock" 15 "Recover_LuggageDoorOpen" 16 "Recover_PhoneLowBattey" 17 "Recover_NoParkingLot" 18 "Recover_UnallowedParkingLot" 19 "Recover_RearviewMirrorFolded" 20 "Recover_SteeringWheelHandsOn" 21 "Recover_GearIntervention" 22 "Recover_FrontCameraDirty" 23 "Recover_SurroundCameraDirty" 24 "Recover_PressContinueSwitch" 25 "Recover_VehicleCrossing" 26 "Recover_PressContinueSwitchBrakePedal" 27 "Recover_ObstacleAvoidancePleaseWait" 28 "Recover_HoodOpen" 29 "Info_DetectedSideObstacle"  ;
VAL_ 549 ADC_RAButtonPress 0 "Not Press" 1 "Press"  ;
VAL_ 549 ADC_Rast 0 "Off" 1 "Standby" 2 "Confirm" 3 "Active" 4 "Completed" 5 "Failure" 6 "Terminated" 7 "Reserved"  ;
VAL_ 549 ADC_SBMAuthst 0 "Default" 1 "Fail" 2 "Pass" 3 "Not used"  ;
VAL_ 549 ADC_AuthPassSt 0 "Default" 1 "Fail" 2 "Pass" 3 "Not used"  ;
VAL_ 549 ADC_VehPoscoord 0 "Veh Coordinate" 1 "Slot Coordinate"  ;
VAL_ 549 ADC_HPAst 0 "Standby" 1 "Parking" 2 "HPA Completed" 3 "HPA Interrupt" 4 "HPA Terminated" 5 "HPA Resume" 6 "HPA Failure" 7 "HPA backend mapping" 8 "HPA parking into slot" 9 "HPA Checking" 10 "HPA Learning"  ;
VAL_ 549 ADC_parkInOutDirection 0 "None" 1 "Right cross or Diagonal rear-end park in右垂直/斜列车尾泊入" 2 "Left cross or Diagonal rear-end park in左垂直/斜列车尾泊入" 3 "Right Parallel  rear-end park in右水平车尾泊入" 4 "Left Parallel  rear-end park in左水平车尾泊入" 5 "Right Diagonal park in右斜列泊入（兼容旧ADC）" 6 "Left Diagonal park in左斜列泊入（兼容旧ADC）" 7 "Right cross or Diagonal front-end park in右垂直/斜列车头泊入" 8 "Left cross or  Diagonal front-end park in左垂直/斜列车头泊入" 9 "Right cross or Diagonal front-end park out右垂直/斜列车头泊出" 10 "Left cross or Diagonal front-end park out左垂直/斜列车头泊出" 11 "Right Parallel front-end park out右水平车头泊出" 12 "Left Parallel front-end park out左水平车头泊出" 13 "Right cross or Diagonal rear-end park out右垂直/斜列车尾泊出" 14 "Left cross or Diagonal rear-end park out左垂直/斜列车尾泊出"  ;
VAL_ 549 ADC_RPAStMessagePush 0 "Not Request" 1 "RPA standby" 2 "LRPA start" 3 "LRPA complete" 4 "LRPA teminal"  ;
VAL_ 549 ADC_RPAtype 0 "invalid" 1 "RPAWithoutConfirmation" 2 "RPAByConfirmationSelected" 3 "RPAParkinByConfirmationSelected"  ;
VAL_ 549 ADC_DskScreenOperationReq 0 "No request" 1 "Request"  ;
VAL_ 549 ADC_SenslesEtyParkingSt 0 "Off" 1 "On"  ;
VAL_ 549 ADC_PAALimitToast 0 "No Request;" 1 "APA OverSpeed;" 2 "Failure Limit;" 3 "Vehicle Mode Limit;" 4 "ADAS Limit;" 5 "Not Ready Limit;" 6 "AVM OverSpeed;" 7 "Not ParkSlot;"  ;
VAL_ 549 ADC_PAALimitReminder 0 "No Request;" 1 "APA OverSpeed;" 2 "Failure Limit;" 3 "Vehicle Mode Limit;" 4 "ADAS Limit;" 5 "Not Ready Limit;" 6 "AVM OverSpeed;" 7 "reserved"  ;
VAL_ 549 ADC_ParkOutMode 0 "None" 1 "Cross or Diagonal   front-end  park out垂直/斜列车头泊出" 2 "Cross or Diagonal  rear-end  park out垂直/斜列车尾泊出" 3 "Parallel front-end park out水平车头泊出" 4 "Reserve" 5 "Reserve" 6 "Reserve" 7 "Reserve"  ;
VAL_ 549 ADAS_ParkStats 0 "OFF" 1 "VPD parkin active" 2 "VPD parkin abort" 3 "VPD parkin finish" 4 "VPD parkout active" 5 "VPD parkout abort" 6 "VPD parkout finish" 7 "EPA active" 8 "EPA abort" 9 "EPA finish" 10 "RPA parkin active" 11 "RPA parkin abort" 12 "RPA parkin finish" 13 "RPA parkout active" 14 "RPA parkout abort" 15 "RPA parkout finish" 16 "RDA forward active" 17 "RDA forward abort" 18 "RDA forward finish" 19 "RDA back active" 20 "RDA back abort" 21 "RDA back finish" 22 "APA parkin active" 23 "APA parkin abort" 24 "APA parkin finish" 25 "APA parkout active" 26 "APA parkout abort" 27 "APA parkout finish"  ;
VAL_ 549 ADC_RPABlechnReq 0 "Close" 1 "Open"  ;
VAL_ 549 ADC_RPABlePushSt 0 "No Request" 1 "RPAin ready" 2 "RPAout ready（预留）" 3 "RSPA ready（预留）" 4 "ADC_RPABlePushSt  离车泊入"  ;
