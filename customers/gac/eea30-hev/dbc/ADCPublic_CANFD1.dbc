VERSION "Version"

NS_ :

BS_:

BU_: Tester CCU INU ADC RRR RLR CCURT1 CCURT2 ZCUF ZCUL ZCUR ZCUT EMS IDM DCDC DCDCI IPS NIDU DCU2 OBC OPC LPC CPC EMCM GCU DCU IPU BMS EOP EVCC DCDC2 EDL SRS ECS EPS EPB RBM IBCS ICM IID IDC AMP WHUD ARHUD IMR FIMR CD IFC FAPA PAS PCS SCMF SCMR SCMRL SCMRR MFS DRM FCP RCP LBMSAD AVAS DLPFL FBLCM FLISD FLLCM FRLCM RLLCMA RLLCMB RRLCMA RRLCMB RLISD DLPML DLPMR TRM PSDL PSDR FLDCM FRDCM HVSPRL HVSPRR RFR SBM WCM ETC TBOX2 TBOX RLBMS EBU FLPDM RLPDM FRPDM RRPDM FLOAR FROAR RLOAR RROAR EOSL EOSR EOST PRBU RT1_C0 OTAWL RT2_C3 IDUR PHUDD RAS CBM PLGM TMC LPC2 SAS RCICP SCMRM SCMT SLMRL SLMRR IDU RRISD DSASBM LBMS RT1_C1

BO_ 780 CCU_IDC_15: 64 CCU
 SG_ ACU_ISACountryID : 7|10@0+ (1,0) [0|1023] ""  ADC,IFC
 SG_ ACU_ISARoadTyp : 13|4@0+ (1,0) [0|15] ""  ADC,IFC
 SG_ ACU_ISARoadSpdLimit : 23|8@0+ (1,0) [0|255] ""  ADC,IFC
 SG_ ACU_ISASpdLimitUnit : 9|2@0+ (1,0) [0|3] ""  ADC,IFC
 SG_ ACU_ISASpdLimitTyp : 49|2@0+ (1,0) [0|3] ""  ADC,IFC
 SG_ ACU_ISARampTyp : 77|2@0+ (1,0) [0|3] ""  ADC,IFC
 SG_ ACU_ISARampDist : 31|10@0+ (1,0) [0|1023] "m"  ADC,IFC
 SG_ ACU_ISAJunctDist : 37|10@0+ (1,0) [0|1023] ""  ADC,IFC
 SG_ ACU_ISARDBDist : 43|10@0+ (1,0) [0|1023] ""  ADC,IFC
 SG_ ACU_ISACondSpdLimit : 63|8@0+ (1,0) [0|255] ""  ADC,IFC
 SG_ ACU_ISACondSpdLimitTyp : 71|4@0+ (1,0) [0|15] ""  ADC,IFC
 SG_ ACU_ISACondSpdLimitVd : 79|2@0+ (1,0) [0|3] ""  ADC,IFC
 SG_ ACU_ISASupplierInfo : 67|4@0+ (1,0) [0|15] ""  ADC,IFC
 SG_ ACU_ISAServiceWorkSt : 75|3@0+ (1,0) [0|7] ""  ADC,IFC

BO_ 163 CCU_IDC_11: 64 CCU
 SG_ ACU_RAEBcfg : 2|2@0+ (1,0) [0|2] ""  ADC,FAPA
 SG_ ACU_PAAMode : 7|4@0+ (1,0) [0|15] ""  ADC,FAPA
 SG_ ACU_SVM_Button : 3|1@0+ (1,0) [0|1] ""  ADC,FAPA,PCS
 SG_ ACU_PCS_MirrorpagedownButtonST : 0|1@0+ (1,0) [0|1] ""  ADC,FAPA,PCS
 SG_ ACU_PCS_ScreenTouchSt : 15|2@0+ (1,0) [0|3] ""  ADC,FAPA,PCS
 SG_ ACU_LanguageTypeSet : 13|6@0+ (1,0) [0|63] ""  ZCUL,ZCUR,ADC,IFC,FAPA,PCS,HVSPRL,HVSPRR
 SG_ ACU_PCS_SVM_FunctionCmd : 23|4@0+ (1,0) [0|15] ""  ADC,FAPA,PCS
 SG_ ACU_PCS_ScreenCoordY : 19|12@0+ (1,0) [0|1439] ""  ADC,FAPA,PCS
 SG_ ACU_PCS_ScreenCoordX : 39|12@0+ (1,0) [0|2559] ""  ADC,FAPA,PCS
 SG_ ACU_APAMessageSt : 43|3@0+ (1,0) [0|7] ""  ADC,FAPA
 SG_ ACU_PAS_ButtonPress : 40|1@0+ (1,0) [0|1] ""  ADC,FAPA,PAS
 SG_ ACU_HPAMessageSt : 55|3@0+ (1,0) [0|7] ""  ADC,FAPA
 SG_ ACU_AVPMessageSt : 52|3@0+ (1,0) [0|7] ""  ADC,FAPA
 SG_ ACU_HPALearningSetParkLot : 49|2@0+ (1,0) [0|3] ""  ADC,FAPA
 SG_ ACU_HPALearningProcessInfo : 63|5@0+ (1,0) [0|31] ""  ADC,FAPA
 SG_ ACU_SDEnterParkingLot : 58|2@0+ (1,0) [0|3] ""  ADC,FAPA
 SG_ ACU_PCS_ER_QuitConfirm : 56|1@0+ (1,0) [0|1] ""  ADC,FAPA,PCS
 SG_ ACU_DisplayReq : 71|2@0+ (1,0) [0|3] ""  ADC,FAPA
 SG_ ACU_ER_FuncCfg : 69|2@0+ (1,0) [0|3] ""  ADC,FAPA
 SG_ ACU_PCS_ER_EnterCmd : 67|1@0+ (1,0) [0|1] ""  ADC,FAPA,PCS
 SG_ ACU_PCS_ScreenTouchSignal : 66|2@0+ (1,0) [0|3] ""  ADC,FAPA,PCS
 SG_ ACU_DPMessageSt : 79|3@0+ (1,0) [0|7] ""  ADC,FAPA
 SG_ ACU_ParkingBoxMidX : 87|12@0+ (1,0) [0|1919] ""  ADC,FAPA
 SG_ ACU_ParkingBoxMidY : 91|12@0+ (1,0) [0|1079] ""  ADC,FAPA
 SG_ ACU_LowPowerConfig : 114|3@0+ (1,0) [0|7] ""  ADC,IFC,FAPA
 SG_ ACU_PCSModeSt : 115|1@0+ (1,0) [0|1] ""  ADC,FAPA,PCS
 SG_ ACU_PCSModeSt_A : 74|2@0+ (1,0) [0|2] ""  ADC,FAPA,PCS
 SG_ ACU_ParkingBoxAngle : 111|12@0+ (0.1,-180) [-180|180] "°"  ADC,FAPA
 SG_ IDC_APAParkingSpdsSfg : 125|2@0+ (1,0) [0|3] ""  ADC,FAPA
 SG_ IDC_DskScreenOperationSt : 123|2@0+ (1,0) [0|3] ""  ADC,FAPA
 SG_ IDC_SenslesEtyParkingSwSt : 121|2@0+ (1,0) [0|3] ""  ADC,FAPA
 SG_ ACU_NDAVoicePromptTypeCfg : 127|2@0+ (1,0) [0|3] ""  ADC,FAPA
 SG_ IDC_SenslesEtyParkingDskScene : 143|3@0+ (1,0) [0|7] ""  ADC,FAPA
 SG_ ACU_VR_APAControl : 131|4@0+ (1,0) [0|15] ""  ADC,FAPA
 SG_ ACU_SteeringPrkgButton : 135|4@0+ (1,0) [0|15] ""  ADC,FAPA
 SG_ ACU_ActiveNDAMessageSt : 162|3@0+ (1,0) [0|4] ""  ADC,IFC,FAPA
 SG_ ACU_ActiveAVPMessageSt : 175|3@0+ (1,0) [0|4] ""  ADC,IFC,FAPA
 SG_ ACU_LeftLaneChangeMessageSt : 169|3@0+ (1,0) [0|4] ""  ADC,IFC,FAPA
 SG_ ACU_RigthLaneChangeMessageSt : 172|3@0+ (1,0) [0|4] ""  ADC,IFC,FAPA
 SG_ ACU_ICANDAIconMessageSt : 182|1@0+ (1,0) [0|1] ""  ADC,IFC,FAPA
 SG_ ACU_SVM_Button_A : 343|3@0+ (1,0) [0|7] ""  ADC

BO_ 475 CCU_IDC_4: 64 CCU
 SG_ ACU_MirrSteeringAdjFlag : 409|2@0+ (1,0) [0|3] ""  ADC,IFC,FAPA

BO_ 879 CCU_IDC_3: 64 CCU
 SG_ ACU_PCS_SVM_MODCmd : 38|1@0+ (1,0) [0|1] ""  ADC,IFC
 SG_ ACU_HeadLightVirtualSwSt : 159|3@0+ (1,0) [0|7] ""  ADC,IFC
 SG_ ACU_FrontFogLightVirtualSwSt : 156|1@0+ (1,0) [0|1] ""  ADC,IFC
 SG_ ACU_RearFogLightVirtualSwSt : 155|1@0+ (1,0) [0|1] ""  ADC,IFC
 SG_ ACU_Account_Uid : 251|4@0+ (1,0) [0|15] ""  ZCUL,ADC
 SG_ ACU_FCWWarnDistanceCfg : 263|2@0+ (1,0) [0|3] ""  ADC,IFC
 SG_ ACU_FCWCfg : 261|2@0+ (1,0) [0|3] ""  ADC,IFC
 SG_ ACU_AEBOff : 259|2@0+ (1,0) [0|3] ""  ADC,IFC
 SG_ ACU_TSR_SwitchReq : 271|2@0+ (1,0) [0|3] ""  ADC,IFC
 SG_ ACU_IHBC_SwitchReq : 269|2@0+ (1,0) [0|3] ""  ADC,IFC
 SG_ ACU_LDS_TypeReq : 267|2@0+ (1,0) [0|3] ""  ADC,IFC
 SG_ ACU_BSDCfg : 265|2@0+ (1,0) [0|3] ""  ADC
 SG_ ACU_RCTACfg : 279|2@0+ (1,0) [0|3] ""  ADC
 SG_ ACU_DOWCfg : 277|2@0+ (1,0) [0|3] ""  ADC
 SG_ ACU_TSR_AudioWarnReq : 273|2@0+ (1,0) [0|3] ""  ADC,IFC
 SG_ ACU_HWAHFCfg : 287|2@0+ (1,0) [0|3] ""  ADC,IFC
 SG_ ACU_HWAHF_AudioWarningTypeCfg : 285|2@0+ (1,0) [0|3] ""  ADC,IFC
 SG_ ACU_HWA_SwitchReq : 283|2@0+ (1,0) [0|3] ""  ADC
 SG_ ACU_ELKCfg : 281|2@0+ (1,0) [0|3] ""  ADC
 SG_ ACU_FCTACfg : 295|2@0+ (1,0) [0|3] ""  ADC
 SG_ ACU_RAWCfg : 293|2@0+ (1,0) [0|3] ""  ADC
 SG_ ACU_RCTA_TypeReqCfg : 291|2@0+ (1,0) [0|3] ""  ADC
 SG_ ACU_FCTA_TypeReqCfg : 289|2@0+ (1,0) [0|3] ""  ADC
 SG_ ACU_NDASwitchReq : 303|2@0+ (1,0) [0|3] ""  ADC
 SG_ ACU_NDALCConSwitchReq : 301|2@0+ (1,0) [0|3] ""  ADC
 SG_ ACU_NDALCStySwitchReq : 299|2@0+ (1,0) [0|3] ""  ADC
 SG_ ACU_ADASWarnTypeSwitch : 297|2@0+ (1,0) [0|3] ""  ADC,IFC
 SG_ ACU_ESACfg : 311|2@0+ (1,0) [0|3] ""  ADC
 SG_ ACU_ILCCfg : 309|2@0+ (1,0) [0|3] ""  ADC
 SG_ ACU_AESCfg : 307|2@0+ (1,0) [0|3] ""  ADC
 SG_ ACU_ILOACfg : 305|2@0+ (1,0) [0|3] ""  ADC
 SG_ ACU_iACC_StyleConfirmSwitchReq : 319|2@0+ (1,0) [0|3] ""  ADC,IFC
 SG_ ACU_IFC_SpeedLimit : 327|8@0+ (1,0) [0|255] "km/h"  ADC,IFC
 SG_ ACU_IFC_ISDRestOfdis : 335|8@0+ (1,0) [0|70] "km"  ADC,IFC
 SG_ ACU_IFC_SpeedLimitUnit : 339|2@0+ (1,0) [0|3] ""  ADC,IFC
 SG_ ACU_ThemeType : 337|1@0+ (1,0) [0|1] ""  ADC,IFC,PCS
 SG_ ACU_IFC_SpeedLimtType : 351|4@0+ (1,0) [0|15] ""  ADC,IFC
 SG_ ACU_IFC_RoadType : 347|4@0+ (1,0) [0|15] ""  ADC,IFC
 SG_ ACU_IFC_ZoneCode : 359|3@0+ (1,0) [0|7] ""  ADC,IFC
 SG_ ACU_IFC_NaviSt : 356|2@0+ (1,0) [0|3] ""  ADC,IFC
 SG_ ACU_IFC_NaviCorp : 354|3@0+ (1,0) [0|7] ""  ADC,IFC
 SG_ ACU_IFC_NaviNewIconDis : 367|5@0+ (0.1,0) [0|2] "km"  ADC,IFC
 SG_ ACU_IFC_OfframpSt : 362|1@0+ (1,0) [0|1] ""  ADC,IFC
 SG_ ACU_IFC_NaviNewIcon : 375|4@0+ (1,0) [0|15] ""  ADC,IFC
 SG_ ACU_IFC_SLCAheadDis : 383|8@0+ (5,0) [0|1250] "m"  ADC,IFC
 SG_ ACU_DVR_Switch : 398|1@0+ (1,0) [0|1] ""  ADC,IFC
 SG_ ACU_IFC_OfframpDis : 455|8@0+ (10,0) [0|2000] "m"  ADC,IFC

BO_ 351 CCU_IDC_2: 64 CCU
 SG_ ACU_VirtualPowerOFFReq : 31|1@0+ (1,0) [0|1] ""  ZCUL,ADC,FAPA
 SG_ ACU_Account_Uld : 171|4@0+ (1,0) [0|15] ""  ADC,IFC,FAPA
 SG_ ACU_FactoryResetReq : 174|1@0+ (1,0) [0|1] ""  ZCUR,ZCUT,ADC,IFC,FAPA,FLISD,RLISD,RRISD,DLPML,DLPMR,TBOX
 SG_ ACU_Account_Delete : 183|8@0+ (1,0) [0|255] ""  ZCUL,ADC,IFC,FAPA
 SG_ ACU_FrontWiperIntCfgVkReq : 191|4@0+ (1,0) [0|15] ""  ZCUL,ADC,IFC,FAPA
 SG_ ACU_FrontWiperAutoCfgVkReq : 187|4@0+ (1,0) [0|15] ""  ZCUL,ADC,IFC,FAPA

BO_ 967 CCU_IDC_DMS_1: 64 CCU
 SG_ DMS_1_CRC : 7|16@0+ (1,0) [0|65535] ""  ADC,IFC,FAPA
 SG_ DMS_1_Counter : 23|8@0+ (1,0) [0|255] ""  ADC,IFC,FAPA
 SG_ DMS_SysErrSt : 31|3@0+ (1,0) [0|7] ""  ADC,IFC,FAPA
 SG_ DMS_DrvrDetSts : 28|3@0+ (1,0) [0|7] ""  ADC,IFC,FAPA
 SG_ DMS_InterestsRegion : 39|5@0+ (1,0) [0|31] ""  ADC,IFC,FAPA
 SG_ DMS_L3DriverDistractionSt : 33|6@0+ (1,0) [0|63] ""  ADC,IFC,FAPA
 SG_ DMS_L3DriverFatigueSt : 43|12@0+ (1,0) [0|4095] ""  ADC,IFC,FAPA
 SG_ DMS_FaceIDStatus : 60|2@0+ (1,0) [0|3] ""  ADC,IFC,FAPA
 SG_ DMS_FaceID : 58|4@0+ (1,0) [0|15] ""  ADC,IFC,FAPA
 SG_ DMS_LeftEyeOpenSt : 64|2@0+ (1,0) [0|3] ""  ADC,IFC,FAPA
 SG_ DMS_RightEyeOpenSt : 78|2@0+ (1,0) [0|3] ""  ADC,IFC,FAPA
 SG_ DMS_DriverSmokeSt : 74|2@0+ (1,0) [0|3] ""  ADC,IFC,FAPA
 SG_ DMS_DriverTelephoneSt : 72|2@0+ (1,0) [0|3] ""  ADC,IFC,FAPA
 SG_ DMS_DriverHealthSt : 86|3@0+ (1,0) [0|7] ""  ADC,IFC,FAPA
 SG_ DMS_FatigWarnSt : 81|3@0+ (1,0) [0|7] ""  ADC,IFC,FAPA
 SG_ DMS_DistrWarnSt : 94|3@0+ (1,0) [0|7] ""  ADC,IFC,FAPA
 SG_ DMS_DriverExpressionSt : 268|4@0+ (1,0) [0|15] ""  ADC,IFC,FAPA
 SG_ DMS_FaceIDVerifyResult : 264|4@0+ (1,0) [0|15] ""  ADC,IFC,FAPA
 SG_ DMS_YawnSt : 276|2@0+ (1,0) [0|3] ""  ADC,IFC,FAPA

BO_ 161 CCU_IDC_1: 64 CCU
 SG_ ACU_FaceID_Delete : 119|4@0+ (1,0) [0|15] ""  ADC,FAPA
 SG_ ACU_RegisterTriger : 115|4@0+ (1,0) [0|15] ""  ADC,FAPA
 SG_ ACU_VerifyTriger : 127|4@0+ (1,0) [0|15] ""  ADC,FAPA
 SG_ ACU_FaceIDQuit : 123|1@0+ (1,0) [0|1] ""  ADC,FAPA
 SG_ ACU_FaceIDSwitch : 122|2@0+ (1,0) [0|3] ""  ADC,FAPA
 SG_ ACU_AVAS_SwitchCfgReq : 273|2@0+ (1,0) [0|3] ""  ZCUF,ZCUL,ADC,FAPA,AVAS

BO_ 1043 CCU_TBOX_GNSS: 64 CCU
 SG_ TEL_Time_Year : 263|8@0+ (1,2000) [2000|2255] "y"  IDC,ADC,FAPA
 SG_ TEL_Time_Month : 251|4@0+ (1,0) [1|12] "m"  IDC,ADC,FAPA
 SG_ TEL_Time_Hour : 271|5@0+ (1,0) [0|23] "h"  IDC,ADC,FAPA
 SG_ TEL_Time_Day : 281|5@0+ (1,0) [1|31] "d"  IDC,ADC,FAPA
 SG_ TEL_Time_Min : 278|6@0+ (1,0) [0|59] "min"  IDC,ADC,FAPA
 SG_ TEL_Time_Sec : 287|6@0+ (1,0) [0|59] "s"  IDC,ADC,FAPA
 SG_ TEL_TimeVD : 272|1@0+ (1,0) [0|1] ""  IDC,ADC,FAPA

BO_ 791 CCU_ZCUF_2: 64 CCU
 SG_ ZCUF_2_CRC : 7|16@0+ (1,0) [0|65535] ""  ADC,IFC,FAPA
 SG_ ZCUF_2_Counter : 23|8@0+ (1,0) [0|255] ""  ADC,IFC,FAPA
 SG_ WW_FWPMotorSt : 27|3@0+ (1,0) [0|7] ""  ADC,IFC,FAPA
 SG_ WW_FWSHMotorSt : 39|2@0+ (1,0) [0|3] ""  ADC,IFC,FAPA
 SG_ HRN_HornRunningSt : 45|2@0+ (1,0) [0|3] ""  ADC,IFC,FAPA
 SG_ HRN_HornWorkingTemplet : 43|4@0+ (1,0) [0|15] ""  ADC,IFC,FAPA
 SG_ EL_FLPositionLightSt : 71|1@0+ (1,0) [0|1] ""  ICM,IDC,ADC,IFC,FAPA
 SG_ EL_FLPositionLightFaultSt : 70|1@0+ (1,0) [0|1] ""  ICM,IDC,ADC,IFC,FAPA
 SG_ EL_FRPositionLightSt : 69|1@0+ (1,0) [0|1] ""  ICM,IDC,ADC,IFC,FAPA
 SG_ EL_FRPositionLightFaultSt : 68|1@0+ (1,0) [0|1] ""  ICM,IDC,ADC,IFC,FAPA
 SG_ EL_LeftLowBeamSt : 67|1@0+ (1,0) [0|1] ""  ICM,IDC,WHUD,ARHUD,ADC,IFC,FAPA
 SG_ EL_LeftLowBeamFaultSt : 66|1@0+ (1,0) [0|1] ""  ICM,IDC,ADC,FAPA
 SG_ EL_RightLowBeamSt : 65|1@0+ (1,0) [0|1] ""  ICM,IDC,ADC,IFC,FAPA
 SG_ EL_RightLowBeamFaultSt : 64|1@0+ (1,0) [0|1] ""  ICM,IDC,ADC,IFC,FAPA
 SG_ EL_LeftHighBeamSt : 79|1@0+ (1,0) [0|1] ""  ICM,IDC,ADC,IFC,FAPA
 SG_ EL_LeftHighBeamFaultSt : 78|1@0+ (1,0) [0|1] ""  ICM,IDC,ADC,IFC,FAPA
 SG_ EL_RightHighBeamSt : 77|1@0+ (1,0) [0|1] ""  ICM,IDC,ADC,IFC,FAPA
 SG_ EL_RightHighBeamFaultSt : 76|1@0+ (1,0) [0|1] ""  ICM,IDC,ADC,IFC,FAPA
 SG_ EL_FLFogLightSt : 75|1@0+ (1,0) [0|1] ""  ICM,IDC,ADC,IFC,FAPA
 SG_ EL_FLFogLightFaultSt : 74|1@0+ (1,0) [0|1] ""  ICM,IDC,ADC,IFC,FAPA
 SG_ EL_FRFogLightSt : 73|1@0+ (1,0) [0|1] ""  ICM,IDC,ADC,IFC,FAPA
 SG_ EL_FRFogLightFaultSt : 72|1@0+ (1,0) [0|1] ""  ICM,IDC,ADC,IFC,FAPA
 SG_ EL_LeftDRLSt : 87|1@0+ (1,0) [0|1] ""  IDC,ADC,IFC,FAPA,PCS
 SG_ EL_LeftDRLFaultSt : 86|1@0+ (1,0) [0|1] ""  ICM,IDC,ADC,IFC,FAPA
 SG_ EL_RightDRLSt : 85|1@0+ (1,0) [0|1] ""  IDC,ADC,IFC,FAPA,PCS
 SG_ EL_RightDRLFaultSt : 84|1@0+ (1,0) [0|1] ""  ICM,IDC,ADC,IFC,FAPA
 SG_ EL_FLTurnLightSt : 95|2@0+ (1,0) [0|3] ""  SRS,ICM,IDC,ADC,IFC,FAPA
 SG_ EL_FLTurnLightFaultSt : 93|1@0+ (1,0) [0|1] ""  SRS,ICM,IDC,ADC,IFC,FAPA
 SG_ EL_FRTurnLightSt : 92|2@0+ (1,0) [0|3] ""  SRS,ICM,IDC,ADC,IFC,FAPA
 SG_ EL_FRTurnLightFaultSt : 90|1@0+ (1,0) [0|1] ""  SRS,ICM,IDC,ADC,IFC,FAPA
 SG_ WW_RWSHMotorSt : 103|2@0+ (1,0) [0|3] ""  ADC,IFC,FAPA
 SG_ EL_FADASLightSt : 127|2@0+ (1,0) [0|3] ""  ADC,IFC
 SG_ EBSF_BattVolt : 199|14@0+ (0.0009765625,3) [3|18] "V"  IDC,ADC,FAPA,RLBMS
 SG_ EBSF_CurrentRange : 201|2@0+ (1,0) [0|3] ""  ADC,FAPA
 SG_ EBSF_BattCurrent : 215|16@0+ (1,0) [-1500|1500] "A"  ADC,FAPA
 SG_ EBSF_SOC : 263|8@0+ (1,0) [0|100] "%"  ZCUR,SRS,ECS,ICM,IDC,ADC,RLBMS
 SG_ EBSF_SOC_STATE : 311|2@0+ (1,0) [0|3] ""  ZCUR,SRS,ICM,IDC,ADC,RLBMS

BO_ 913 CCU_GwMsg_L3: 16 CCU
 SG_ CCU_GwMsg_L3_CRC : 7|16@0+ (1,0) [0|65535] ""  ADC,FAPA
 SG_ CCU_GwMsg_L3_Counter : 23|8@0+ (1,0) [0|255] ""  ADC,FAPA
 SG_ IL_PADS_LightbarSt : 31|4@0+ (1,0) [0|15] "/"  ADC,FAPA
 SG_ IL_PADS_LightbarErrSt : 27|1@0+ (1,0) [0|1] "/"  ADC,FAPA
 SG_ UINM_PADS_L3SWSt : 26|2@0+ (1,0) [0|3] ""  ADC,FAPA
 SG_ UINM_PADS_L3SWStVD : 24|1@0+ (1,0) [0|1] ""  ADC,FAPA
 SG_ UINM_PADS_L3SWStuckSt : 39|1@0+ (1,0) [0|1] ""  ADC,FAPA

CM_ SG_ 780 ACU_ISACountryID "country ID refer to ISO 3166-1";
CM_ SG_ 780 ACU_ISARoadTyp "indicate the road type";
CM_ SG_ 780 ACU_ISARoadSpdLimit "road speed limit value";
CM_ SG_ 780 ACU_ISASpdLimitUnit "road speed limit unit";
CM_ SG_ 780 ACU_ISASpdLimitTyp "speed limit type";
CM_ SG_ 780 ACU_ISARampTyp "indicate the front nearest ramp type within 1km";
CM_ SG_ 780 ACU_ISARampDist "indicate the front nearest ramp distance within 1km";
CM_ SG_ 780 ACU_ISAJunctDist "indicate the front nearest junction distance within 1km";
CM_ SG_ 780 ACU_ISARDBDist "indicate the front nearest roundabout distance within 1km";
CM_ SG_ 780 ACU_ISACondSpdLimit "condition speed limit value";
CM_ SG_ 780 ACU_ISACondSpdLimitTyp "indicate the condition speed limit type";
CM_ SG_ 780 ACU_ISACondSpdLimitVd "condition speed limit validity";
CM_ SG_ 780 ACU_ISASupplierInfo "ISA supplier information";
CM_ SG_ 780 ACU_ISAServiceWorkSt "indicate the work status of the map service";
CM_ SG_ 163 ACU_RAEBcfg "RAEB Configuration";
CM_ SG_ 163 ACU_PAAMode "The Mode of PAA? which ACU request for";
CM_ SG_ 163 ACU_SVM_Button "SVM button press status";
CM_ SG_ 163 ACU_PCS_MirrorpagedownButtonST "Mirror Pagedown Button Status";
CM_ SG_ 163 ACU_PCS_ScreenTouchSt "ACU screen touch status";
CM_ SG_ 163 ACU_LanguageTypeSet "language type set";
CM_ SG_ 163 ACU_PCS_ScreenCoordY "Screen touched in ER coordinate Y";
CM_ SG_ 163 ACU_PCS_ScreenCoordX "Screen touched in ER coordinate X";
CM_ SG_ 163 ACU_APAMessageSt "The State of APA Message";
CM_ SG_ 163 ACU_PAS_ButtonPress "PAS button press state";
CM_ SG_ 163 ACU_HPAMessageSt "The State of HPA Message";
CM_ SG_ 163 ACU_AVPMessageSt "The State of AVP Message";
CM_ SG_ 163 ACU_HPALearningSetParkLot "User set HAVP parkLot type";
CM_ SG_ 163 ACU_HPALearningProcessInfo "AVP controller will send this singnal to show indications through HU to driver during learning process";
CM_ SG_ 163 ACU_SDEnterParkingLot "The vehicle enter parking lot";
CM_ SG_ 163 ACU_PCS_ER_QuitConfirm "Event record quit confirm ";
CM_ SG_ 163 ACU_ER_FuncCfg "Event record funtion configuration";
CM_ SG_ 163 ACU_PCS_ER_EnterCmd "Event record enter command";
CM_ SG_ 163 ACU_PCS_ScreenTouchSignal "ACU screen touch status";
CM_ SG_ 163 ACU_DPMessageSt "The State of DP Message";
CM_ SG_ 163 ACU_ParkingBoxMidX "X coordinate pixel value of  parking space frame handle";
CM_ SG_ 163 ACU_ParkingBoxMidY "Y coordinate pixel value of  parking space frame handle";
CM_ SG_ 163 ACU_LowPowerConfig "ACU_LowPowerMode Config";
CM_ SG_ 163 ACU_PCSModeSt "The mode of the host request panorama display";
CM_ SG_ 163 ACU_PCSModeSt_A "The mode of the host request panorama display";
CM_ SG_ 163 ACU_ParkingBoxAngle "Angle of parking space frame";
CM_ SG_ 163 IDC_APAParkingSpdsSfg "APA Parking speed configuration";
CM_ SG_ 163 IDC_DskScreenOperationSt "Screen Touch status";
CM_ SG_ 163 IDC_SenslesEtyParkingSwSt "Senseless entry parking switch";
CM_ SG_ 163 ACU_NDAVoicePromptTypeCfg "NDA Voice mode switch";
CM_ SG_ 163 IDC_SenslesEtyParkingDskScene "Senseless entry parking desktop  scene";
CM_ SG_ 163 ACU_VR_APAControl "Parking voice wake up";
CM_ SG_ 163 ACU_SteeringPrkgButton "ACU_SteeringPrkgButton";
CM_ SG_ 163 ACU_ActiveNDAMessageSt "“recommend switch to NDA” card state";
CM_ SG_ 163 ACU_ActiveAVPMessageSt "\"recommend switch to AVP\" card state";
CM_ SG_ 163 ACU_LeftLaneChangeMessageSt "\"recommed LeftLane Change\" card state";
CM_ SG_ 163 ACU_RigthLaneChangeMessageSt "\"recommed RighLane Change\" card state";
CM_ SG_ 163 ACU_ICANDAIconMessageSt "driver click ICON button state";
CM_ SG_ 163 ACU_SVM_Button_A "SVM button press status";
CM_ SG_ 475 ACU_MirrSteeringAdjFlag "ACU Mirror Steering wheel adjust active statue";
CM_ SG_ 879 ACU_PCS_SVM_MODCmd "Panorama function setting option MOD function switch";
CM_ SG_ 879 ACU_HeadLightVirtualSwSt "HeadLight virtual switch status";
CM_ SG_ 879 ACU_FrontFogLightVirtualSwSt "Front fog light virtual switch status";
CM_ SG_ 879 ACU_RearFogLightVirtualSwSt "Rear fog light virtual switch status";
CM_ SG_ 879 ACU_Account_Uid "Account_Uid";
CM_ SG_ 879 ACU_FCWWarnDistanceCfg "Configurates FCW(Front Collision Warning) warning distance";
CM_ SG_ 879 ACU_FCWCfg "Configurates FCW (front collision warning assist)";
CM_ SG_ 879 ACU_AEBOff "AEB is turned off";
CM_ SG_ 879 ACU_TSR_SwitchReq "TSR(Traffic Sign Recognition) switch signal";
CM_ SG_ 879 ACU_IHBC_SwitchReq "IHBC(Intelligent High Beam Control) switch signal";
CM_ SG_ 879 ACU_LDS_TypeReq "LDS lane aid type request";
CM_ SG_ 879 ACU_BSDCfg "Configurates BSD Switch Signal";
CM_ SG_ 879 ACU_RCTACfg "Configurates RCTA Switch Signal";
CM_ SG_ 879 ACU_DOWCfg "Configurates DOW Switch Signal";
CM_ SG_ 879 ACU_TSR_AudioWarnReq "TSR(Traffic Sign Recognition) audio warning on off signal";
CM_ SG_ 879 ACU_HWAHFCfg "HWAHF on/off request";
CM_ SG_ 879 ACU_HWAHF_AudioWarningTypeCfg "HWAHF audio warning type request";
CM_ SG_ 879 ACU_HWA_SwitchReq "HWA(High Way Assist)  on/off switch";
CM_ SG_ 879 ACU_ELKCfg "Configurates ELKA function";
CM_ SG_ 879 ACU_FCTACfg "Configurates FCTA function";
CM_ SG_ 879 ACU_RAWCfg "Configurates RAW function";
CM_ SG_ 879 ACU_RCTA_TypeReqCfg "RCTA assist type request";
CM_ SG_ 879 ACU_FCTA_TypeReqCfg "FCTA assist type request";
CM_ SG_ 879 ACU_NDASwitchReq "NDA main switch request";
CM_ SG_ 879 ACU_NDALCConSwitchReq "NDA lane change driver confirm switch request";
CM_ SG_ 879 ACU_NDALCStySwitchReq "NDA lane change style switch request";
CM_ SG_ 879 ACU_ADASWarnTypeSwitch "ADAS warning type switch signal";
CM_ SG_ 879 ACU_ESACfg "Configurates ESA function";
CM_ SG_ 879 ACU_ILCCfg "Configurates ILC function";
CM_ SG_ 879 ACU_AESCfg "Configurates AES function";
CM_ SG_ 879 ACU_ILOACfg "Configurates ILOA function";
CM_ SG_ 879 ACU_iACC_StyleConfirmSwitchReq "iACC Style confirm switch";
CM_ SG_ 879 ACU_IFC_SpeedLimit "Speed limit value from navigation map dataand GPS location.";
CM_ SG_ 879 ACU_IFC_ISDRestOfdis "Interval speed detection rest of distacne.Once navigation jduge vehicle run in aninterval speed detection area of road, thissignal begin to send specific value,otherwise keep sending 0x0.";
CM_ SG_ 879 ACU_IFC_SpeedLimitUnit "Speed limit unit ";
CM_ SG_ 879 ACU_ThemeType "AVNT theme type";
CM_ SG_ 879 ACU_IFC_SpeedLimtType "speed limit type from navigation map dataand GPS location.";
CM_ SG_ 879 ACU_IFC_RoadType "Road type from navigation map data andGPS location.";
CM_ SG_ 879 ACU_IFC_ZoneCode "Zone code ";
CM_ SG_ 879 ACU_IFC_NaviSt "Navigation state ";
CM_ SG_ 879 ACU_IFC_NaviCorp "the working navigation map corporation ";
CM_ SG_ 879 ACU_IFC_NaviNewIconDis "the remain distances of navigation newIcon ";
CM_ SG_ 879 ACU_IFC_OfframpSt "The front is off-ramp or not whennavigation";
CM_ SG_ 879 ACU_IFC_NaviNewIcon "indication the navigation newIcon ";
CM_ SG_ 879 ACU_IFC_SLCAheadDis "speed limit camera ahead distacne. Oncenavigation jduge there is a speed limitcamera ahead that the vehicle will pass by,this signal begin to send specific value,otherwise keep sending 0x0.";
CM_ SG_ 879 ACU_DVR_Switch "DVR Function Switch";
CM_ SG_ 879 ACU_IFC_OfframpDis "The distance to front off-ramp ";
CM_ SG_ 351 ACU_VirtualPowerOFFReq "Virtual Power OFF Request";
CM_ SG_ 351 ACU_Account_Uld "Account_Uid";
CM_ SG_ 351 ACU_FactoryResetReq "CDC Factory Reset Request";
CM_ SG_ 351 ACU_Account_Delete "Account Delete";
CM_ SG_ 351 ACU_FrontWiperIntCfgVkReq "Front wiper interval Softkey status";
CM_ SG_ 351 ACU_FrontWiperAutoCfgVkReq "Front wiper RLS  sensitivity status";
CM_ SG_ 967 DMS_1_CRC "E2E Profile 5 CRC";
CM_ SG_ 967 DMS_1_Counter "E2E Profile 5 Counter";
CM_ SG_ 967 DMS_SysErrSt "DMS system error status and person status";
CM_ SG_ 967 DMS_DrvrDetSts "States whether the driver facing camera has detected the presence of a driver.";
CM_ SG_ 967 DMS_InterestsRegion "region of interests";
CM_ SG_ 967 DMS_L3DriverDistractionSt "driver distraction state for L3";
CM_ SG_ 967 DMS_L3DriverFatigueSt "driver fatigue state for L3";
CM_ SG_ 967 DMS_FaceIDStatus "Indication FaceID Status";
CM_ SG_ 967 DMS_FaceID "FaceID";
CM_ SG_ 967 DMS_LeftEyeOpenSt "Indication Driver's Left Eye Open Status";
CM_ SG_ 967 DMS_RightEyeOpenSt "Indication Driver's Right Eye Open Status";
CM_ SG_ 967 DMS_DriverSmokeSt "Indication_DriverSmokeSt";
CM_ SG_ 967 DMS_DriverTelephoneSt "Indication_DriverTelephoneSt";
CM_ SG_ 967 DMS_DriverHealthSt "Indication_DriverHealthSt";
CM_ SG_ 967 DMS_FatigWarnSt "Indicates the fatigue level of the driver";
CM_ SG_ 967 DMS_DistrWarnSt "Provides the driver distraction determined by thedriver facing camera";
CM_ SG_ 967 DMS_DriverExpressionSt "Driver Expression status";
CM_ SG_ 967 DMS_FaceIDVerifyResult "Indication FaceID_Verify_result";
CM_ SG_ 967 DMS_YawnSt "Indication Driver's mouth Status";
CM_ SG_ 161 ACU_FaceID_Delete "Delete_FaceID";
CM_ SG_ 161 ACU_RegisterTriger "FaceID register triger";
CM_ SG_ 161 ACU_VerifyTriger "FaceID verify triger";
CM_ SG_ 161 ACU_FaceIDQuit "FaceID quit triger";
CM_ SG_ 161 ACU_FaceIDSwitch "FaceID switch triger";
CM_ SG_ 161 ACU_AVAS_SwitchCfgReq "AVAS switch configuration require";
CM_ SG_ 1043 TEL_Time_Year "Year number";
CM_ SG_ 1043 TEL_Time_Month "Month number";
CM_ SG_ 1043 TEL_Time_Hour "Hour number";
CM_ SG_ 1043 TEL_Time_Day "Day number";
CM_ SG_ 1043 TEL_Time_Min "Minute number";
CM_ SG_ 1043 TEL_Time_Sec "Second number";
CM_ SG_ 1043 TEL_TimeVD "TEL time valid value";
CM_ SG_ 791 ZCUF_2_CRC "E2E Profile 5 CRC";
CM_ SG_ 791 ZCUF_2_Counter "E2E Profile 5 Counter";
CM_ SG_ 791 WW_FWPMotorSt "FrontWiper Motor status";
CM_ SG_ 791 WW_FWSHMotorSt "FrontWasher motor status";
CM_ SG_ 791 HRN_HornRunningSt "Horn Running status";
CM_ SG_ 791 HRN_HornWorkingTemplet "Horn Working Templet";
CM_ SG_ 791 EL_FLPositionLightSt "Front left position light status";
CM_ SG_ 791 EL_FLPositionLightFaultSt "Front left position light fault status";
CM_ SG_ 791 EL_FRPositionLightSt "Front Right position light status";
CM_ SG_ 791 EL_FRPositionLightFaultSt "Front Right position light fault status";
CM_ SG_ 791 EL_LeftLowBeamSt "Left low beam status";
CM_ SG_ 791 EL_LeftLowBeamFaultSt "Left low beam fault status";
CM_ SG_ 791 EL_RightLowBeamSt "Right low beam status";
CM_ SG_ 791 EL_RightLowBeamFaultSt "Right low beam fault status";
CM_ SG_ 791 EL_LeftHighBeamSt "Left high beam status";
CM_ SG_ 791 EL_LeftHighBeamFaultSt "Left high beam fault status";
CM_ SG_ 791 EL_RightHighBeamSt "Right high beam status";
CM_ SG_ 791 EL_RightHighBeamFaultSt "Right high beam fault status";
CM_ SG_ 791 EL_FLFogLightSt "Front left fog light status";
CM_ SG_ 791 EL_FLFogLightFaultSt "Front left fog light fault status";
CM_ SG_ 791 EL_FRFogLightSt "Front right fog light status";
CM_ SG_ 791 EL_FRFogLightFaultSt "Front right fog light fault status";
CM_ SG_ 791 EL_LeftDRLSt "Left day time running light status";
CM_ SG_ 791 EL_LeftDRLFaultSt "Left day time running light fault status";
CM_ SG_ 791 EL_RightDRLSt "Right day time running light status";
CM_ SG_ 791 EL_RightDRLFaultSt "Right day time running light fault status";
CM_ SG_ 791 EL_FLTurnLightSt "Front left turn light status";
CM_ SG_ 791 EL_FLTurnLightFaultSt "Front left turn light fault status";
CM_ SG_ 791 EL_FRTurnLightSt "Front right turn light status";
CM_ SG_ 791 EL_FRTurnLightFaultSt "Front right turn light fault status";
CM_ SG_ 791 WW_RWSHMotorSt "Rear washer motor status";
CM_ SG_ 791 EL_FADASLightSt "Front ADAS light status";
CM_ SG_ 791 EBSF_BattVolt "Battery voltage";
CM_ SG_ 791 EBSF_CurrentRange "Battery current range";
CM_ SG_ 791 EBSF_BattCurrent "Battery current ";
CM_ SG_ 791 EBSF_SOC "State of Charge";
CM_ SG_ 791 EBSF_SOC_STATE "SOC Status";
CM_ SG_ 913 CCU_GwMsg_L3_CRC "E2E Profile 5 CRC";
CM_ SG_ 913 CCU_GwMsg_L3_Counter "E2E Profile 5 Counter";
CM_ SG_ 913 IL_PADS_LightbarSt "Steering wheel ambient light bar current status";
CM_ SG_ 913 IL_PADS_LightbarErrSt "Steering wheel ambient light bar error feedback";
CM_ SG_ 913 UINM_PADS_L3SWSt "Indicates PADS's L3 swtich state";
CM_ SG_ 913 UINM_PADS_L3SWStVD "Indicates PADS's L3 swtich state Validity";
CM_ SG_ 913 UINM_PADS_L3SWStuckSt "Indicates PADS's IDC MODE swtich stuck state";

BA_DEF_ BO_  "GenMsgCycleTime" INT 0 0;
BA_DEF_ BO_  "GenMsgCycleTimeFast" INT 0 0;
BA_DEF_ BO_  "GenMsgSendType" ENUM  "Periodic","Event","IfActive","POE","PA","FixedPeriodic","Event","EnabledPeriodic","NotUsed","NotUsed","EventPeriodic","NotUsed","NotUsed","NoMsgSendType";
BA_DEF_ BO_  "VFrameFormat" ENUM  "StandardCAN","ExtendedCAN","reserved","reserved","reserved","reserved","reserved","reserved","reserved","reserved","reserved","reserved","reserved","reserved","StandardCAN_FD","ExtendedCAN_FD";
BA_DEF_ BO_  "CANFD_BRS" ENUM  "0","1";
BA_DEF_ SG_  "EventCommandSignal" ENUM  "No","Yes";
BA_DEF_ SG_  "GatewayedSignals" ENUM  "No","Yes";
BA_DEF_ SG_  "GenSigInactiveValue" HEX 0 0;
BA_DEF_ SG_  "GenSigInvalidValue" HEX 0 0;
BA_DEF_ SG_  "GenSigSendType" ENUM  "Trigger","Passive","Cyclic","OnWrite","OnWriteWithRepetition","OnChange","OnChangeWithRepetition","IfActive","IfActiveWithRepetition","NoSigSendType";
BA_DEF_ SG_  "GenSigStartValue" HEX 0 0;
BA_DEF_ SG_  "GenSigTimeoutValue" HEX 0 0;
BA_DEF_ SG_  "Remark" STRING ;
BA_ "GenMsgCycleTime" BO_ 780 100;
BA_ "GenMsgCycleTimeFast" BO_ 780 0;
BA_ "GenMsgSendType" BO_ 780 0;
BA_ "VFrameFormat" BO_ 780 14;
BA_ "CANFD_BRS" BO_ 780 1;
BA_ "GenMsgCycleTime" BO_ 780 100;
BA_ "GenMsgCycleTimeFast" BO_ 780 0;
BA_ "GenMsgSendType" BO_ 780 0;
BA_ "VFrameFormat" BO_ 780 14;
BA_ "CANFD_BRS" BO_ 780 1;
BA_ "GenMsgCycleTime" BO_ 780 100;
BA_ "GenMsgCycleTimeFast" BO_ 780 0;
BA_ "GenMsgSendType" BO_ 780 0;
BA_ "VFrameFormat" BO_ 780 14;
BA_ "CANFD_BRS" BO_ 780 1;
BA_ "GenMsgCycleTime" BO_ 780 100;
BA_ "GenMsgCycleTimeFast" BO_ 780 0;
BA_ "GenMsgSendType" BO_ 780 0;
BA_ "VFrameFormat" BO_ 780 14;
BA_ "CANFD_BRS" BO_ 780 1;
BA_ "GenMsgCycleTime" BO_ 780 100;
BA_ "GenMsgCycleTimeFast" BO_ 780 0;
BA_ "GenMsgSendType" BO_ 780 0;
BA_ "VFrameFormat" BO_ 780 14;
BA_ "CANFD_BRS" BO_ 780 1;
BA_ "GenMsgCycleTime" BO_ 780 100;
BA_ "GenMsgCycleTimeFast" BO_ 780 0;
BA_ "GenMsgSendType" BO_ 780 0;
BA_ "VFrameFormat" BO_ 780 14;
BA_ "CANFD_BRS" BO_ 780 1;
BA_ "GenMsgCycleTime" BO_ 780 100;
BA_ "GenMsgCycleTimeFast" BO_ 780 0;
BA_ "GenMsgSendType" BO_ 780 0;
BA_ "VFrameFormat" BO_ 780 14;
BA_ "CANFD_BRS" BO_ 780 1;
BA_ "GenMsgCycleTime" BO_ 780 100;
BA_ "GenMsgCycleTimeFast" BO_ 780 0;
BA_ "GenMsgSendType" BO_ 780 0;
BA_ "VFrameFormat" BO_ 780 14;
BA_ "CANFD_BRS" BO_ 780 1;
BA_ "GenMsgCycleTime" BO_ 780 100;
BA_ "GenMsgCycleTimeFast" BO_ 780 0;
BA_ "GenMsgSendType" BO_ 780 0;
BA_ "VFrameFormat" BO_ 780 14;
BA_ "CANFD_BRS" BO_ 780 1;
BA_ "GenMsgCycleTime" BO_ 780 100;
BA_ "GenMsgCycleTimeFast" BO_ 780 0;
BA_ "GenMsgSendType" BO_ 780 0;
BA_ "VFrameFormat" BO_ 780 14;
BA_ "CANFD_BRS" BO_ 780 1;
BA_ "GenMsgCycleTime" BO_ 780 100;
BA_ "GenMsgCycleTimeFast" BO_ 780 0;
BA_ "GenMsgSendType" BO_ 780 0;
BA_ "VFrameFormat" BO_ 780 14;
BA_ "CANFD_BRS" BO_ 780 1;
BA_ "GenMsgCycleTime" BO_ 780 100;
BA_ "GenMsgCycleTimeFast" BO_ 780 0;
BA_ "GenMsgSendType" BO_ 780 0;
BA_ "VFrameFormat" BO_ 780 14;
BA_ "CANFD_BRS" BO_ 780 1;
BA_ "GenMsgCycleTime" BO_ 780 100;
BA_ "GenMsgCycleTimeFast" BO_ 780 0;
BA_ "GenMsgSendType" BO_ 780 0;
BA_ "VFrameFormat" BO_ 780 14;
BA_ "CANFD_BRS" BO_ 780 1;
BA_ "GenMsgCycleTime" BO_ 780 100;
BA_ "GenMsgCycleTimeFast" BO_ 780 0;
BA_ "GenMsgSendType" BO_ 780 0;
BA_ "VFrameFormat" BO_ 780 14;
BA_ "CANFD_BRS" BO_ 780 1;
BA_ "GenMsgCycleTime" BO_ 163 0;
BA_ "GenMsgCycleTimeFast" BO_ 163 0;
BA_ "GenMsgSendType" BO_ 163 1;
BA_ "VFrameFormat" BO_ 163 14;
BA_ "CANFD_BRS" BO_ 163 1;
BA_ "GenMsgCycleTime" BO_ 163 0;
BA_ "GenMsgCycleTimeFast" BO_ 163 0;
BA_ "GenMsgSendType" BO_ 163 1;
BA_ "VFrameFormat" BO_ 163 14;
BA_ "CANFD_BRS" BO_ 163 1;
BA_ "GenMsgCycleTime" BO_ 163 0;
BA_ "GenMsgCycleTimeFast" BO_ 163 0;
BA_ "GenMsgSendType" BO_ 163 1;
BA_ "VFrameFormat" BO_ 163 14;
BA_ "CANFD_BRS" BO_ 163 1;
BA_ "GenMsgCycleTime" BO_ 163 0;
BA_ "GenMsgCycleTimeFast" BO_ 163 0;
BA_ "GenMsgSendType" BO_ 163 1;
BA_ "VFrameFormat" BO_ 163 14;
BA_ "CANFD_BRS" BO_ 163 1;
BA_ "GenMsgCycleTime" BO_ 163 0;
BA_ "GenMsgCycleTimeFast" BO_ 163 0;
BA_ "GenMsgSendType" BO_ 163 1;
BA_ "VFrameFormat" BO_ 163 14;
BA_ "CANFD_BRS" BO_ 163 1;
BA_ "GenMsgCycleTime" BO_ 163 0;
BA_ "GenMsgCycleTimeFast" BO_ 163 0;
BA_ "GenMsgSendType" BO_ 163 1;
BA_ "VFrameFormat" BO_ 163 14;
BA_ "CANFD_BRS" BO_ 163 1;
BA_ "GenMsgCycleTime" BO_ 163 0;
BA_ "GenMsgCycleTimeFast" BO_ 163 0;
BA_ "GenMsgSendType" BO_ 163 1;
BA_ "VFrameFormat" BO_ 163 14;
BA_ "CANFD_BRS" BO_ 163 1;
BA_ "GenMsgCycleTime" BO_ 163 0;
BA_ "GenMsgCycleTimeFast" BO_ 163 0;
BA_ "GenMsgSendType" BO_ 163 1;
BA_ "VFrameFormat" BO_ 163 14;
BA_ "CANFD_BRS" BO_ 163 1;
BA_ "GenMsgCycleTime" BO_ 163 0;
BA_ "GenMsgCycleTimeFast" BO_ 163 0;
BA_ "GenMsgSendType" BO_ 163 1;
BA_ "VFrameFormat" BO_ 163 14;
BA_ "CANFD_BRS" BO_ 163 1;
BA_ "GenMsgCycleTime" BO_ 163 0;
BA_ "GenMsgCycleTimeFast" BO_ 163 0;
BA_ "GenMsgSendType" BO_ 163 1;
BA_ "VFrameFormat" BO_ 163 14;
BA_ "CANFD_BRS" BO_ 163 1;
BA_ "GenMsgCycleTime" BO_ 163 0;
BA_ "GenMsgCycleTimeFast" BO_ 163 0;
BA_ "GenMsgSendType" BO_ 163 1;
BA_ "VFrameFormat" BO_ 163 14;
BA_ "CANFD_BRS" BO_ 163 1;
BA_ "GenMsgCycleTime" BO_ 163 0;
BA_ "GenMsgCycleTimeFast" BO_ 163 0;
BA_ "GenMsgSendType" BO_ 163 1;
BA_ "VFrameFormat" BO_ 163 14;
BA_ "CANFD_BRS" BO_ 163 1;
BA_ "GenMsgCycleTime" BO_ 163 0;
BA_ "GenMsgCycleTimeFast" BO_ 163 0;
BA_ "GenMsgSendType" BO_ 163 1;
BA_ "VFrameFormat" BO_ 163 14;
BA_ "CANFD_BRS" BO_ 163 1;
BA_ "GenMsgCycleTime" BO_ 163 0;
BA_ "GenMsgCycleTimeFast" BO_ 163 0;
BA_ "GenMsgSendType" BO_ 163 1;
BA_ "VFrameFormat" BO_ 163 14;
BA_ "CANFD_BRS" BO_ 163 1;
BA_ "GenMsgCycleTime" BO_ 163 0;
BA_ "GenMsgCycleTimeFast" BO_ 163 0;
BA_ "GenMsgSendType" BO_ 163 1;
BA_ "VFrameFormat" BO_ 163 14;
BA_ "CANFD_BRS" BO_ 163 1;
BA_ "GenMsgCycleTime" BO_ 163 0;
BA_ "GenMsgCycleTimeFast" BO_ 163 0;
BA_ "GenMsgSendType" BO_ 163 1;
BA_ "VFrameFormat" BO_ 163 14;
BA_ "CANFD_BRS" BO_ 163 1;
BA_ "GenMsgCycleTime" BO_ 163 0;
BA_ "GenMsgCycleTimeFast" BO_ 163 0;
BA_ "GenMsgSendType" BO_ 163 1;
BA_ "VFrameFormat" BO_ 163 14;
BA_ "CANFD_BRS" BO_ 163 1;
BA_ "GenMsgCycleTime" BO_ 163 0;
BA_ "GenMsgCycleTimeFast" BO_ 163 0;
BA_ "GenMsgSendType" BO_ 163 1;
BA_ "VFrameFormat" BO_ 163 14;
BA_ "CANFD_BRS" BO_ 163 1;
BA_ "GenMsgCycleTime" BO_ 163 0;
BA_ "GenMsgCycleTimeFast" BO_ 163 0;
BA_ "GenMsgSendType" BO_ 163 1;
BA_ "VFrameFormat" BO_ 163 14;
BA_ "CANFD_BRS" BO_ 163 1;
BA_ "GenMsgCycleTime" BO_ 163 0;
BA_ "GenMsgCycleTimeFast" BO_ 163 0;
BA_ "GenMsgSendType" BO_ 163 1;
BA_ "VFrameFormat" BO_ 163 14;
BA_ "CANFD_BRS" BO_ 163 1;
BA_ "GenMsgCycleTime" BO_ 163 0;
BA_ "GenMsgCycleTimeFast" BO_ 163 0;
BA_ "GenMsgSendType" BO_ 163 1;
BA_ "VFrameFormat" BO_ 163 14;
BA_ "CANFD_BRS" BO_ 163 1;
BA_ "GenMsgCycleTime" BO_ 163 0;
BA_ "GenMsgCycleTimeFast" BO_ 163 0;
BA_ "GenMsgSendType" BO_ 163 1;
BA_ "VFrameFormat" BO_ 163 14;
BA_ "CANFD_BRS" BO_ 163 1;
BA_ "GenMsgCycleTime" BO_ 163 0;
BA_ "GenMsgCycleTimeFast" BO_ 163 0;
BA_ "GenMsgSendType" BO_ 163 1;
BA_ "VFrameFormat" BO_ 163 14;
BA_ "CANFD_BRS" BO_ 163 1;
BA_ "GenMsgCycleTime" BO_ 163 0;
BA_ "GenMsgCycleTimeFast" BO_ 163 0;
BA_ "GenMsgSendType" BO_ 163 1;
BA_ "VFrameFormat" BO_ 163 14;
BA_ "CANFD_BRS" BO_ 163 1;
BA_ "GenMsgCycleTime" BO_ 163 0;
BA_ "GenMsgCycleTimeFast" BO_ 163 0;
BA_ "GenMsgSendType" BO_ 163 1;
BA_ "VFrameFormat" BO_ 163 14;
BA_ "CANFD_BRS" BO_ 163 1;
BA_ "GenMsgCycleTime" BO_ 163 0;
BA_ "GenMsgCycleTimeFast" BO_ 163 0;
BA_ "GenMsgSendType" BO_ 163 1;
BA_ "VFrameFormat" BO_ 163 14;
BA_ "CANFD_BRS" BO_ 163 1;
BA_ "GenMsgCycleTime" BO_ 163 0;
BA_ "GenMsgCycleTimeFast" BO_ 163 0;
BA_ "GenMsgSendType" BO_ 163 1;
BA_ "VFrameFormat" BO_ 163 14;
BA_ "CANFD_BRS" BO_ 163 1;
BA_ "GenMsgCycleTime" BO_ 163 0;
BA_ "GenMsgCycleTimeFast" BO_ 163 0;
BA_ "GenMsgSendType" BO_ 163 1;
BA_ "VFrameFormat" BO_ 163 14;
BA_ "CANFD_BRS" BO_ 163 1;
BA_ "GenMsgCycleTime" BO_ 163 0;
BA_ "GenMsgCycleTimeFast" BO_ 163 0;
BA_ "GenMsgSendType" BO_ 163 1;
BA_ "VFrameFormat" BO_ 163 14;
BA_ "CANFD_BRS" BO_ 163 1;
BA_ "GenMsgCycleTime" BO_ 163 0;
BA_ "GenMsgCycleTimeFast" BO_ 163 0;
BA_ "GenMsgSendType" BO_ 163 1;
BA_ "VFrameFormat" BO_ 163 14;
BA_ "CANFD_BRS" BO_ 163 1;
BA_ "GenMsgCycleTime" BO_ 163 0;
BA_ "GenMsgCycleTimeFast" BO_ 163 0;
BA_ "GenMsgSendType" BO_ 163 1;
BA_ "VFrameFormat" BO_ 163 14;
BA_ "CANFD_BRS" BO_ 163 1;
BA_ "GenMsgCycleTime" BO_ 163 0;
BA_ "GenMsgCycleTimeFast" BO_ 163 0;
BA_ "GenMsgSendType" BO_ 163 1;
BA_ "VFrameFormat" BO_ 163 14;
BA_ "CANFD_BRS" BO_ 163 1;
BA_ "GenMsgCycleTime" BO_ 163 0;
BA_ "GenMsgCycleTimeFast" BO_ 163 0;
BA_ "GenMsgSendType" BO_ 163 1;
BA_ "VFrameFormat" BO_ 163 14;
BA_ "CANFD_BRS" BO_ 163 1;
BA_ "GenMsgCycleTime" BO_ 163 0;
BA_ "GenMsgCycleTimeFast" BO_ 163 0;
BA_ "GenMsgSendType" BO_ 163 1;
BA_ "VFrameFormat" BO_ 163 14;
BA_ "CANFD_BRS" BO_ 163 1;
BA_ "GenMsgCycleTime" BO_ 163 0;
BA_ "GenMsgCycleTimeFast" BO_ 163 0;
BA_ "GenMsgSendType" BO_ 163 1;
BA_ "VFrameFormat" BO_ 163 14;
BA_ "CANFD_BRS" BO_ 163 1;
BA_ "GenMsgCycleTime" BO_ 163 0;
BA_ "GenMsgCycleTimeFast" BO_ 163 0;
BA_ "GenMsgSendType" BO_ 163 1;
BA_ "VFrameFormat" BO_ 163 14;
BA_ "CANFD_BRS" BO_ 163 1;
BA_ "GenMsgCycleTime" BO_ 163 0;
BA_ "GenMsgCycleTimeFast" BO_ 163 0;
BA_ "GenMsgSendType" BO_ 163 1;
BA_ "VFrameFormat" BO_ 163 14;
BA_ "CANFD_BRS" BO_ 163 1;
BA_ "GenMsgCycleTime" BO_ 163 0;
BA_ "GenMsgCycleTimeFast" BO_ 163 0;
BA_ "GenMsgSendType" BO_ 163 1;
BA_ "VFrameFormat" BO_ 163 14;
BA_ "CANFD_BRS" BO_ 163 1;
BA_ "GenMsgCycleTime" BO_ 163 0;
BA_ "GenMsgCycleTimeFast" BO_ 163 0;
BA_ "GenMsgSendType" BO_ 163 1;
BA_ "VFrameFormat" BO_ 163 14;
BA_ "CANFD_BRS" BO_ 163 1;
BA_ "GenMsgCycleTime" BO_ 163 0;
BA_ "GenMsgCycleTimeFast" BO_ 163 0;
BA_ "GenMsgSendType" BO_ 163 1;
BA_ "VFrameFormat" BO_ 163 14;
BA_ "CANFD_BRS" BO_ 163 1;
BA_ "GenMsgCycleTime" BO_ 163 0;
BA_ "GenMsgCycleTimeFast" BO_ 163 0;
BA_ "GenMsgSendType" BO_ 163 1;
BA_ "VFrameFormat" BO_ 163 14;
BA_ "CANFD_BRS" BO_ 163 1;
BA_ "GenMsgCycleTime" BO_ 475 1000;
BA_ "GenMsgCycleTimeFast" BO_ 475 40;
BA_ "GenMsgSendType" BO_ 475 4;
BA_ "VFrameFormat" BO_ 475 14;
BA_ "CANFD_BRS" BO_ 475 1;
BA_ "GenMsgCycleTime" BO_ 879 50;
BA_ "GenMsgCycleTimeFast" BO_ 879 0;
BA_ "GenMsgSendType" BO_ 879 0;
BA_ "VFrameFormat" BO_ 879 14;
BA_ "CANFD_BRS" BO_ 879 1;
BA_ "GenMsgCycleTime" BO_ 879 50;
BA_ "GenMsgCycleTimeFast" BO_ 879 0;
BA_ "GenMsgSendType" BO_ 879 0;
BA_ "VFrameFormat" BO_ 879 14;
BA_ "CANFD_BRS" BO_ 879 1;
BA_ "GenMsgCycleTime" BO_ 879 50;
BA_ "GenMsgCycleTimeFast" BO_ 879 0;
BA_ "GenMsgSendType" BO_ 879 0;
BA_ "VFrameFormat" BO_ 879 14;
BA_ "CANFD_BRS" BO_ 879 1;
BA_ "GenMsgCycleTime" BO_ 879 50;
BA_ "GenMsgCycleTimeFast" BO_ 879 0;
BA_ "GenMsgSendType" BO_ 879 0;
BA_ "VFrameFormat" BO_ 879 14;
BA_ "CANFD_BRS" BO_ 879 1;
BA_ "GenMsgCycleTime" BO_ 879 50;
BA_ "GenMsgCycleTimeFast" BO_ 879 0;
BA_ "GenMsgSendType" BO_ 879 0;
BA_ "VFrameFormat" BO_ 879 14;
BA_ "CANFD_BRS" BO_ 879 1;
BA_ "GenMsgCycleTime" BO_ 879 50;
BA_ "GenMsgCycleTimeFast" BO_ 879 0;
BA_ "GenMsgSendType" BO_ 879 0;
BA_ "VFrameFormat" BO_ 879 14;
BA_ "CANFD_BRS" BO_ 879 1;
BA_ "GenMsgCycleTime" BO_ 879 50;
BA_ "GenMsgCycleTimeFast" BO_ 879 0;
BA_ "GenMsgSendType" BO_ 879 0;
BA_ "VFrameFormat" BO_ 879 14;
BA_ "CANFD_BRS" BO_ 879 1;
BA_ "GenMsgCycleTime" BO_ 879 50;
BA_ "GenMsgCycleTimeFast" BO_ 879 0;
BA_ "GenMsgSendType" BO_ 879 0;
BA_ "VFrameFormat" BO_ 879 14;
BA_ "CANFD_BRS" BO_ 879 1;
BA_ "GenMsgCycleTime" BO_ 879 50;
BA_ "GenMsgCycleTimeFast" BO_ 879 0;
BA_ "GenMsgSendType" BO_ 879 0;
BA_ "VFrameFormat" BO_ 879 14;
BA_ "CANFD_BRS" BO_ 879 1;
BA_ "GenMsgCycleTime" BO_ 879 50;
BA_ "GenMsgCycleTimeFast" BO_ 879 0;
BA_ "GenMsgSendType" BO_ 879 0;
BA_ "VFrameFormat" BO_ 879 14;
BA_ "CANFD_BRS" BO_ 879 1;
BA_ "GenMsgCycleTime" BO_ 879 50;
BA_ "GenMsgCycleTimeFast" BO_ 879 0;
BA_ "GenMsgSendType" BO_ 879 0;
BA_ "VFrameFormat" BO_ 879 14;
BA_ "CANFD_BRS" BO_ 879 1;
BA_ "GenMsgCycleTime" BO_ 879 50;
BA_ "GenMsgCycleTimeFast" BO_ 879 0;
BA_ "GenMsgSendType" BO_ 879 0;
BA_ "VFrameFormat" BO_ 879 14;
BA_ "CANFD_BRS" BO_ 879 1;
BA_ "GenMsgCycleTime" BO_ 879 50;
BA_ "GenMsgCycleTimeFast" BO_ 879 0;
BA_ "GenMsgSendType" BO_ 879 0;
BA_ "VFrameFormat" BO_ 879 14;
BA_ "CANFD_BRS" BO_ 879 1;
BA_ "GenMsgCycleTime" BO_ 879 50;
BA_ "GenMsgCycleTimeFast" BO_ 879 0;
BA_ "GenMsgSendType" BO_ 879 0;
BA_ "VFrameFormat" BO_ 879 14;
BA_ "CANFD_BRS" BO_ 879 1;
BA_ "GenMsgCycleTime" BO_ 879 50;
BA_ "GenMsgCycleTimeFast" BO_ 879 0;
BA_ "GenMsgSendType" BO_ 879 0;
BA_ "VFrameFormat" BO_ 879 14;
BA_ "CANFD_BRS" BO_ 879 1;
BA_ "GenMsgCycleTime" BO_ 879 50;
BA_ "GenMsgCycleTimeFast" BO_ 879 0;
BA_ "GenMsgSendType" BO_ 879 0;
BA_ "VFrameFormat" BO_ 879 14;
BA_ "CANFD_BRS" BO_ 879 1;
BA_ "GenMsgCycleTime" BO_ 879 50;
BA_ "GenMsgCycleTimeFast" BO_ 879 0;
BA_ "GenMsgSendType" BO_ 879 0;
BA_ "VFrameFormat" BO_ 879 14;
BA_ "CANFD_BRS" BO_ 879 1;
BA_ "GenMsgCycleTime" BO_ 879 50;
BA_ "GenMsgCycleTimeFast" BO_ 879 0;
BA_ "GenMsgSendType" BO_ 879 0;
BA_ "VFrameFormat" BO_ 879 14;
BA_ "CANFD_BRS" BO_ 879 1;
BA_ "GenMsgCycleTime" BO_ 879 50;
BA_ "GenMsgCycleTimeFast" BO_ 879 0;
BA_ "GenMsgSendType" BO_ 879 0;
BA_ "VFrameFormat" BO_ 879 14;
BA_ "CANFD_BRS" BO_ 879 1;
BA_ "GenMsgCycleTime" BO_ 879 50;
BA_ "GenMsgCycleTimeFast" BO_ 879 0;
BA_ "GenMsgSendType" BO_ 879 0;
BA_ "VFrameFormat" BO_ 879 14;
BA_ "CANFD_BRS" BO_ 879 1;
BA_ "GenMsgCycleTime" BO_ 879 50;
BA_ "GenMsgCycleTimeFast" BO_ 879 0;
BA_ "GenMsgSendType" BO_ 879 0;
BA_ "VFrameFormat" BO_ 879 14;
BA_ "CANFD_BRS" BO_ 879 1;
BA_ "GenMsgCycleTime" BO_ 879 50;
BA_ "GenMsgCycleTimeFast" BO_ 879 0;
BA_ "GenMsgSendType" BO_ 879 0;
BA_ "VFrameFormat" BO_ 879 14;
BA_ "CANFD_BRS" BO_ 879 1;
BA_ "GenMsgCycleTime" BO_ 879 50;
BA_ "GenMsgCycleTimeFast" BO_ 879 0;
BA_ "GenMsgSendType" BO_ 879 0;
BA_ "VFrameFormat" BO_ 879 14;
BA_ "CANFD_BRS" BO_ 879 1;
BA_ "GenMsgCycleTime" BO_ 879 50;
BA_ "GenMsgCycleTimeFast" BO_ 879 0;
BA_ "GenMsgSendType" BO_ 879 0;
BA_ "VFrameFormat" BO_ 879 14;
BA_ "CANFD_BRS" BO_ 879 1;
BA_ "GenMsgCycleTime" BO_ 879 50;
BA_ "GenMsgCycleTimeFast" BO_ 879 0;
BA_ "GenMsgSendType" BO_ 879 0;
BA_ "VFrameFormat" BO_ 879 14;
BA_ "CANFD_BRS" BO_ 879 1;
BA_ "GenMsgCycleTime" BO_ 879 50;
BA_ "GenMsgCycleTimeFast" BO_ 879 0;
BA_ "GenMsgSendType" BO_ 879 0;
BA_ "VFrameFormat" BO_ 879 14;
BA_ "CANFD_BRS" BO_ 879 1;
BA_ "GenMsgCycleTime" BO_ 879 50;
BA_ "GenMsgCycleTimeFast" BO_ 879 0;
BA_ "GenMsgSendType" BO_ 879 0;
BA_ "VFrameFormat" BO_ 879 14;
BA_ "CANFD_BRS" BO_ 879 1;
BA_ "GenMsgCycleTime" BO_ 879 50;
BA_ "GenMsgCycleTimeFast" BO_ 879 0;
BA_ "GenMsgSendType" BO_ 879 0;
BA_ "VFrameFormat" BO_ 879 14;
BA_ "CANFD_BRS" BO_ 879 1;
BA_ "GenMsgCycleTime" BO_ 879 50;
BA_ "GenMsgCycleTimeFast" BO_ 879 0;
BA_ "GenMsgSendType" BO_ 879 0;
BA_ "VFrameFormat" BO_ 879 14;
BA_ "CANFD_BRS" BO_ 879 1;
BA_ "GenMsgCycleTime" BO_ 879 50;
BA_ "GenMsgCycleTimeFast" BO_ 879 0;
BA_ "GenMsgSendType" BO_ 879 0;
BA_ "VFrameFormat" BO_ 879 14;
BA_ "CANFD_BRS" BO_ 879 1;
BA_ "GenMsgCycleTime" BO_ 879 50;
BA_ "GenMsgCycleTimeFast" BO_ 879 0;
BA_ "GenMsgSendType" BO_ 879 0;
BA_ "VFrameFormat" BO_ 879 14;
BA_ "CANFD_BRS" BO_ 879 1;
BA_ "GenMsgCycleTime" BO_ 879 50;
BA_ "GenMsgCycleTimeFast" BO_ 879 0;
BA_ "GenMsgSendType" BO_ 879 0;
BA_ "VFrameFormat" BO_ 879 14;
BA_ "CANFD_BRS" BO_ 879 1;
BA_ "GenMsgCycleTime" BO_ 879 50;
BA_ "GenMsgCycleTimeFast" BO_ 879 0;
BA_ "GenMsgSendType" BO_ 879 0;
BA_ "VFrameFormat" BO_ 879 14;
BA_ "CANFD_BRS" BO_ 879 1;
BA_ "GenMsgCycleTime" BO_ 879 50;
BA_ "GenMsgCycleTimeFast" BO_ 879 0;
BA_ "GenMsgSendType" BO_ 879 0;
BA_ "VFrameFormat" BO_ 879 14;
BA_ "CANFD_BRS" BO_ 879 1;
BA_ "GenMsgCycleTime" BO_ 879 50;
BA_ "GenMsgCycleTimeFast" BO_ 879 0;
BA_ "GenMsgSendType" BO_ 879 0;
BA_ "VFrameFormat" BO_ 879 14;
BA_ "CANFD_BRS" BO_ 879 1;
BA_ "GenMsgCycleTime" BO_ 879 50;
BA_ "GenMsgCycleTimeFast" BO_ 879 0;
BA_ "GenMsgSendType" BO_ 879 0;
BA_ "VFrameFormat" BO_ 879 14;
BA_ "CANFD_BRS" BO_ 879 1;
BA_ "GenMsgCycleTime" BO_ 879 50;
BA_ "GenMsgCycleTimeFast" BO_ 879 0;
BA_ "GenMsgSendType" BO_ 879 0;
BA_ "VFrameFormat" BO_ 879 14;
BA_ "CANFD_BRS" BO_ 879 1;
BA_ "GenMsgCycleTime" BO_ 879 50;
BA_ "GenMsgCycleTimeFast" BO_ 879 0;
BA_ "GenMsgSendType" BO_ 879 0;
BA_ "VFrameFormat" BO_ 879 14;
BA_ "CANFD_BRS" BO_ 879 1;
BA_ "GenMsgCycleTime" BO_ 879 50;
BA_ "GenMsgCycleTimeFast" BO_ 879 0;
BA_ "GenMsgSendType" BO_ 879 0;
BA_ "VFrameFormat" BO_ 879 14;
BA_ "CANFD_BRS" BO_ 879 1;
BA_ "GenMsgCycleTime" BO_ 879 50;
BA_ "GenMsgCycleTimeFast" BO_ 879 0;
BA_ "GenMsgSendType" BO_ 879 0;
BA_ "VFrameFormat" BO_ 879 14;
BA_ "CANFD_BRS" BO_ 879 1;
BA_ "GenMsgCycleTime" BO_ 879 50;
BA_ "GenMsgCycleTimeFast" BO_ 879 0;
BA_ "GenMsgSendType" BO_ 879 0;
BA_ "VFrameFormat" BO_ 879 14;
BA_ "CANFD_BRS" BO_ 879 1;
BA_ "GenMsgCycleTime" BO_ 879 50;
BA_ "GenMsgCycleTimeFast" BO_ 879 0;
BA_ "GenMsgSendType" BO_ 879 0;
BA_ "VFrameFormat" BO_ 879 14;
BA_ "CANFD_BRS" BO_ 879 1;
BA_ "GenMsgCycleTime" BO_ 879 50;
BA_ "GenMsgCycleTimeFast" BO_ 879 0;
BA_ "GenMsgSendType" BO_ 879 0;
BA_ "VFrameFormat" BO_ 879 14;
BA_ "CANFD_BRS" BO_ 879 1;
BA_ "GenMsgCycleTime" BO_ 879 50;
BA_ "GenMsgCycleTimeFast" BO_ 879 0;
BA_ "GenMsgSendType" BO_ 879 0;
BA_ "VFrameFormat" BO_ 879 14;
BA_ "CANFD_BRS" BO_ 879 1;
BA_ "GenMsgCycleTime" BO_ 879 50;
BA_ "GenMsgCycleTimeFast" BO_ 879 0;
BA_ "GenMsgSendType" BO_ 879 0;
BA_ "VFrameFormat" BO_ 879 14;
BA_ "CANFD_BRS" BO_ 879 1;
BA_ "GenMsgCycleTime" BO_ 879 50;
BA_ "GenMsgCycleTimeFast" BO_ 879 0;
BA_ "GenMsgSendType" BO_ 879 0;
BA_ "VFrameFormat" BO_ 879 14;
BA_ "CANFD_BRS" BO_ 879 1;
BA_ "GenMsgCycleTime" BO_ 879 50;
BA_ "GenMsgCycleTimeFast" BO_ 879 0;
BA_ "GenMsgSendType" BO_ 879 0;
BA_ "VFrameFormat" BO_ 879 14;
BA_ "CANFD_BRS" BO_ 879 1;
BA_ "GenMsgCycleTime" BO_ 351 200;
BA_ "GenMsgCycleTimeFast" BO_ 351 40;
BA_ "GenMsgSendType" BO_ 351 3;
BA_ "VFrameFormat" BO_ 351 14;
BA_ "CANFD_BRS" BO_ 351 1;
BA_ "GenMsgCycleTime" BO_ 351 200;
BA_ "GenMsgCycleTimeFast" BO_ 351 40;
BA_ "GenMsgSendType" BO_ 351 3;
BA_ "VFrameFormat" BO_ 351 14;
BA_ "CANFD_BRS" BO_ 351 1;
BA_ "GenMsgCycleTime" BO_ 351 200;
BA_ "GenMsgCycleTimeFast" BO_ 351 40;
BA_ "GenMsgSendType" BO_ 351 3;
BA_ "VFrameFormat" BO_ 351 14;
BA_ "CANFD_BRS" BO_ 351 1;
BA_ "GenMsgCycleTime" BO_ 351 200;
BA_ "GenMsgCycleTimeFast" BO_ 351 40;
BA_ "GenMsgSendType" BO_ 351 3;
BA_ "VFrameFormat" BO_ 351 14;
BA_ "CANFD_BRS" BO_ 351 1;
BA_ "GenMsgCycleTime" BO_ 351 200;
BA_ "GenMsgCycleTimeFast" BO_ 351 40;
BA_ "GenMsgSendType" BO_ 351 3;
BA_ "VFrameFormat" BO_ 351 14;
BA_ "CANFD_BRS" BO_ 351 1;
BA_ "GenMsgCycleTime" BO_ 351 200;
BA_ "GenMsgCycleTimeFast" BO_ 351 40;
BA_ "GenMsgSendType" BO_ 351 3;
BA_ "VFrameFormat" BO_ 351 14;
BA_ "CANFD_BRS" BO_ 351 1;
BA_ "GenMsgCycleTime" BO_ 967 200;
BA_ "GenMsgCycleTimeFast" BO_ 967 0;
BA_ "GenMsgSendType" BO_ 967 0;
BA_ "VFrameFormat" BO_ 967 14;
BA_ "CANFD_BRS" BO_ 967 1;
BA_ "GenMsgCycleTime" BO_ 967 200;
BA_ "GenMsgCycleTimeFast" BO_ 967 0;
BA_ "GenMsgSendType" BO_ 967 0;
BA_ "VFrameFormat" BO_ 967 14;
BA_ "CANFD_BRS" BO_ 967 1;
BA_ "GenMsgCycleTime" BO_ 967 200;
BA_ "GenMsgCycleTimeFast" BO_ 967 0;
BA_ "GenMsgSendType" BO_ 967 0;
BA_ "VFrameFormat" BO_ 967 14;
BA_ "CANFD_BRS" BO_ 967 1;
BA_ "GenMsgCycleTime" BO_ 967 200;
BA_ "GenMsgCycleTimeFast" BO_ 967 0;
BA_ "GenMsgSendType" BO_ 967 0;
BA_ "VFrameFormat" BO_ 967 14;
BA_ "CANFD_BRS" BO_ 967 1;
BA_ "GenMsgCycleTime" BO_ 967 200;
BA_ "GenMsgCycleTimeFast" BO_ 967 0;
BA_ "GenMsgSendType" BO_ 967 0;
BA_ "VFrameFormat" BO_ 967 14;
BA_ "CANFD_BRS" BO_ 967 1;
BA_ "GenMsgCycleTime" BO_ 967 200;
BA_ "GenMsgCycleTimeFast" BO_ 967 0;
BA_ "GenMsgSendType" BO_ 967 0;
BA_ "VFrameFormat" BO_ 967 14;
BA_ "CANFD_BRS" BO_ 967 1;
BA_ "GenMsgCycleTime" BO_ 967 200;
BA_ "GenMsgCycleTimeFast" BO_ 967 0;
BA_ "GenMsgSendType" BO_ 967 0;
BA_ "VFrameFormat" BO_ 967 14;
BA_ "CANFD_BRS" BO_ 967 1;
BA_ "GenMsgCycleTime" BO_ 967 200;
BA_ "GenMsgCycleTimeFast" BO_ 967 0;
BA_ "GenMsgSendType" BO_ 967 0;
BA_ "VFrameFormat" BO_ 967 14;
BA_ "CANFD_BRS" BO_ 967 1;
BA_ "GenMsgCycleTime" BO_ 967 200;
BA_ "GenMsgCycleTimeFast" BO_ 967 0;
BA_ "GenMsgSendType" BO_ 967 0;
BA_ "VFrameFormat" BO_ 967 14;
BA_ "CANFD_BRS" BO_ 967 1;
BA_ "GenMsgCycleTime" BO_ 967 200;
BA_ "GenMsgCycleTimeFast" BO_ 967 0;
BA_ "GenMsgSendType" BO_ 967 0;
BA_ "VFrameFormat" BO_ 967 14;
BA_ "CANFD_BRS" BO_ 967 1;
BA_ "GenMsgCycleTime" BO_ 967 200;
BA_ "GenMsgCycleTimeFast" BO_ 967 0;
BA_ "GenMsgSendType" BO_ 967 0;
BA_ "VFrameFormat" BO_ 967 14;
BA_ "CANFD_BRS" BO_ 967 1;
BA_ "GenMsgCycleTime" BO_ 967 200;
BA_ "GenMsgCycleTimeFast" BO_ 967 0;
BA_ "GenMsgSendType" BO_ 967 0;
BA_ "VFrameFormat" BO_ 967 14;
BA_ "CANFD_BRS" BO_ 967 1;
BA_ "GenMsgCycleTime" BO_ 967 200;
BA_ "GenMsgCycleTimeFast" BO_ 967 0;
BA_ "GenMsgSendType" BO_ 967 0;
BA_ "VFrameFormat" BO_ 967 14;
BA_ "CANFD_BRS" BO_ 967 1;
BA_ "GenMsgCycleTime" BO_ 967 200;
BA_ "GenMsgCycleTimeFast" BO_ 967 0;
BA_ "GenMsgSendType" BO_ 967 0;
BA_ "VFrameFormat" BO_ 967 14;
BA_ "CANFD_BRS" BO_ 967 1;
BA_ "GenMsgCycleTime" BO_ 967 200;
BA_ "GenMsgCycleTimeFast" BO_ 967 0;
BA_ "GenMsgSendType" BO_ 967 0;
BA_ "VFrameFormat" BO_ 967 14;
BA_ "CANFD_BRS" BO_ 967 1;
BA_ "GenMsgCycleTime" BO_ 967 200;
BA_ "GenMsgCycleTimeFast" BO_ 967 0;
BA_ "GenMsgSendType" BO_ 967 0;
BA_ "VFrameFormat" BO_ 967 14;
BA_ "CANFD_BRS" BO_ 967 1;
BA_ "GenMsgCycleTime" BO_ 967 200;
BA_ "GenMsgCycleTimeFast" BO_ 967 0;
BA_ "GenMsgSendType" BO_ 967 0;
BA_ "VFrameFormat" BO_ 967 14;
BA_ "CANFD_BRS" BO_ 967 1;
BA_ "GenMsgCycleTime" BO_ 967 200;
BA_ "GenMsgCycleTimeFast" BO_ 967 0;
BA_ "GenMsgSendType" BO_ 967 0;
BA_ "VFrameFormat" BO_ 967 14;
BA_ "CANFD_BRS" BO_ 967 1;
BA_ "GenMsgCycleTime" BO_ 967 200;
BA_ "GenMsgCycleTimeFast" BO_ 967 0;
BA_ "GenMsgSendType" BO_ 967 0;
BA_ "VFrameFormat" BO_ 967 14;
BA_ "CANFD_BRS" BO_ 967 1;
BA_ "GenMsgCycleTime" BO_ 161 0;
BA_ "GenMsgCycleTimeFast" BO_ 161 0;
BA_ "GenMsgSendType" BO_ 161 1;
BA_ "VFrameFormat" BO_ 161 14;
BA_ "CANFD_BRS" BO_ 161 1;
BA_ "GenMsgCycleTime" BO_ 161 0;
BA_ "GenMsgCycleTimeFast" BO_ 161 0;
BA_ "GenMsgSendType" BO_ 161 1;
BA_ "VFrameFormat" BO_ 161 14;
BA_ "CANFD_BRS" BO_ 161 1;
BA_ "GenMsgCycleTime" BO_ 161 0;
BA_ "GenMsgCycleTimeFast" BO_ 161 0;
BA_ "GenMsgSendType" BO_ 161 1;
BA_ "VFrameFormat" BO_ 161 14;
BA_ "CANFD_BRS" BO_ 161 1;
BA_ "GenMsgCycleTime" BO_ 161 0;
BA_ "GenMsgCycleTimeFast" BO_ 161 0;
BA_ "GenMsgSendType" BO_ 161 1;
BA_ "VFrameFormat" BO_ 161 14;
BA_ "CANFD_BRS" BO_ 161 1;
BA_ "GenMsgCycleTime" BO_ 161 0;
BA_ "GenMsgCycleTimeFast" BO_ 161 0;
BA_ "GenMsgSendType" BO_ 161 1;
BA_ "VFrameFormat" BO_ 161 14;
BA_ "CANFD_BRS" BO_ 161 1;
BA_ "GenMsgCycleTime" BO_ 161 0;
BA_ "GenMsgCycleTimeFast" BO_ 161 0;
BA_ "GenMsgSendType" BO_ 161 1;
BA_ "VFrameFormat" BO_ 161 14;
BA_ "CANFD_BRS" BO_ 161 1;
BA_ "GenMsgCycleTime" BO_ 1043 1000;
BA_ "GenMsgCycleTimeFast" BO_ 1043 0;
BA_ "GenMsgSendType" BO_ 1043 0;
BA_ "VFrameFormat" BO_ 1043 14;
BA_ "CANFD_BRS" BO_ 1043 1;
BA_ "GenMsgCycleTime" BO_ 1043 1000;
BA_ "GenMsgCycleTimeFast" BO_ 1043 0;
BA_ "GenMsgSendType" BO_ 1043 0;
BA_ "VFrameFormat" BO_ 1043 14;
BA_ "CANFD_BRS" BO_ 1043 1;
BA_ "GenMsgCycleTime" BO_ 1043 1000;
BA_ "GenMsgCycleTimeFast" BO_ 1043 0;
BA_ "GenMsgSendType" BO_ 1043 0;
BA_ "VFrameFormat" BO_ 1043 14;
BA_ "CANFD_BRS" BO_ 1043 1;
BA_ "GenMsgCycleTime" BO_ 1043 1000;
BA_ "GenMsgCycleTimeFast" BO_ 1043 0;
BA_ "GenMsgSendType" BO_ 1043 0;
BA_ "VFrameFormat" BO_ 1043 14;
BA_ "CANFD_BRS" BO_ 1043 1;
BA_ "GenMsgCycleTime" BO_ 1043 1000;
BA_ "GenMsgCycleTimeFast" BO_ 1043 0;
BA_ "GenMsgSendType" BO_ 1043 0;
BA_ "VFrameFormat" BO_ 1043 14;
BA_ "CANFD_BRS" BO_ 1043 1;
BA_ "GenMsgCycleTime" BO_ 1043 1000;
BA_ "GenMsgCycleTimeFast" BO_ 1043 0;
BA_ "GenMsgSendType" BO_ 1043 0;
BA_ "VFrameFormat" BO_ 1043 14;
BA_ "CANFD_BRS" BO_ 1043 1;
BA_ "GenMsgCycleTime" BO_ 1043 1000;
BA_ "GenMsgCycleTimeFast" BO_ 1043 0;
BA_ "GenMsgSendType" BO_ 1043 0;
BA_ "VFrameFormat" BO_ 1043 14;
BA_ "CANFD_BRS" BO_ 1043 1;
BA_ "GenMsgCycleTime" BO_ 791 100;
BA_ "GenMsgCycleTimeFast" BO_ 791 0;
BA_ "GenMsgSendType" BO_ 791 0;
BA_ "VFrameFormat" BO_ 791 14;
BA_ "CANFD_BRS" BO_ 791 1;
BA_ "GenMsgCycleTime" BO_ 791 100;
BA_ "GenMsgCycleTimeFast" BO_ 791 0;
BA_ "GenMsgSendType" BO_ 791 0;
BA_ "VFrameFormat" BO_ 791 14;
BA_ "CANFD_BRS" BO_ 791 1;
BA_ "GenMsgCycleTime" BO_ 791 100;
BA_ "GenMsgCycleTimeFast" BO_ 791 0;
BA_ "GenMsgSendType" BO_ 791 0;
BA_ "VFrameFormat" BO_ 791 14;
BA_ "CANFD_BRS" BO_ 791 1;
BA_ "GenMsgCycleTime" BO_ 791 100;
BA_ "GenMsgCycleTimeFast" BO_ 791 0;
BA_ "GenMsgSendType" BO_ 791 0;
BA_ "VFrameFormat" BO_ 791 14;
BA_ "CANFD_BRS" BO_ 791 1;
BA_ "GenMsgCycleTime" BO_ 791 100;
BA_ "GenMsgCycleTimeFast" BO_ 791 0;
BA_ "GenMsgSendType" BO_ 791 0;
BA_ "VFrameFormat" BO_ 791 14;
BA_ "CANFD_BRS" BO_ 791 1;
BA_ "GenMsgCycleTime" BO_ 791 100;
BA_ "GenMsgCycleTimeFast" BO_ 791 0;
BA_ "GenMsgSendType" BO_ 791 0;
BA_ "VFrameFormat" BO_ 791 14;
BA_ "CANFD_BRS" BO_ 791 1;
BA_ "GenMsgCycleTime" BO_ 791 100;
BA_ "GenMsgCycleTimeFast" BO_ 791 0;
BA_ "GenMsgSendType" BO_ 791 0;
BA_ "VFrameFormat" BO_ 791 14;
BA_ "CANFD_BRS" BO_ 791 1;
BA_ "GenMsgCycleTime" BO_ 791 100;
BA_ "GenMsgCycleTimeFast" BO_ 791 0;
BA_ "GenMsgSendType" BO_ 791 0;
BA_ "VFrameFormat" BO_ 791 14;
BA_ "CANFD_BRS" BO_ 791 1;
BA_ "GenMsgCycleTime" BO_ 791 100;
BA_ "GenMsgCycleTimeFast" BO_ 791 0;
BA_ "GenMsgSendType" BO_ 791 0;
BA_ "VFrameFormat" BO_ 791 14;
BA_ "CANFD_BRS" BO_ 791 1;
BA_ "GenMsgCycleTime" BO_ 791 100;
BA_ "GenMsgCycleTimeFast" BO_ 791 0;
BA_ "GenMsgSendType" BO_ 791 0;
BA_ "VFrameFormat" BO_ 791 14;
BA_ "CANFD_BRS" BO_ 791 1;
BA_ "GenMsgCycleTime" BO_ 791 100;
BA_ "GenMsgCycleTimeFast" BO_ 791 0;
BA_ "GenMsgSendType" BO_ 791 0;
BA_ "VFrameFormat" BO_ 791 14;
BA_ "CANFD_BRS" BO_ 791 1;
BA_ "GenMsgCycleTime" BO_ 791 100;
BA_ "GenMsgCycleTimeFast" BO_ 791 0;
BA_ "GenMsgSendType" BO_ 791 0;
BA_ "VFrameFormat" BO_ 791 14;
BA_ "CANFD_BRS" BO_ 791 1;
BA_ "GenMsgCycleTime" BO_ 791 100;
BA_ "GenMsgCycleTimeFast" BO_ 791 0;
BA_ "GenMsgSendType" BO_ 791 0;
BA_ "VFrameFormat" BO_ 791 14;
BA_ "CANFD_BRS" BO_ 791 1;
BA_ "GenMsgCycleTime" BO_ 791 100;
BA_ "GenMsgCycleTimeFast" BO_ 791 0;
BA_ "GenMsgSendType" BO_ 791 0;
BA_ "VFrameFormat" BO_ 791 14;
BA_ "CANFD_BRS" BO_ 791 1;
BA_ "GenMsgCycleTime" BO_ 791 100;
BA_ "GenMsgCycleTimeFast" BO_ 791 0;
BA_ "GenMsgSendType" BO_ 791 0;
BA_ "VFrameFormat" BO_ 791 14;
BA_ "CANFD_BRS" BO_ 791 1;
BA_ "GenMsgCycleTime" BO_ 791 100;
BA_ "GenMsgCycleTimeFast" BO_ 791 0;
BA_ "GenMsgSendType" BO_ 791 0;
BA_ "VFrameFormat" BO_ 791 14;
BA_ "CANFD_BRS" BO_ 791 1;
BA_ "GenMsgCycleTime" BO_ 791 100;
BA_ "GenMsgCycleTimeFast" BO_ 791 0;
BA_ "GenMsgSendType" BO_ 791 0;
BA_ "VFrameFormat" BO_ 791 14;
BA_ "CANFD_BRS" BO_ 791 1;
BA_ "GenMsgCycleTime" BO_ 791 100;
BA_ "GenMsgCycleTimeFast" BO_ 791 0;
BA_ "GenMsgSendType" BO_ 791 0;
BA_ "VFrameFormat" BO_ 791 14;
BA_ "CANFD_BRS" BO_ 791 1;
BA_ "GenMsgCycleTime" BO_ 791 100;
BA_ "GenMsgCycleTimeFast" BO_ 791 0;
BA_ "GenMsgSendType" BO_ 791 0;
BA_ "VFrameFormat" BO_ 791 14;
BA_ "CANFD_BRS" BO_ 791 1;
BA_ "GenMsgCycleTime" BO_ 791 100;
BA_ "GenMsgCycleTimeFast" BO_ 791 0;
BA_ "GenMsgSendType" BO_ 791 0;
BA_ "VFrameFormat" BO_ 791 14;
BA_ "CANFD_BRS" BO_ 791 1;
BA_ "GenMsgCycleTime" BO_ 791 100;
BA_ "GenMsgCycleTimeFast" BO_ 791 0;
BA_ "GenMsgSendType" BO_ 791 0;
BA_ "VFrameFormat" BO_ 791 14;
BA_ "CANFD_BRS" BO_ 791 1;
BA_ "GenMsgCycleTime" BO_ 791 100;
BA_ "GenMsgCycleTimeFast" BO_ 791 0;
BA_ "GenMsgSendType" BO_ 791 0;
BA_ "VFrameFormat" BO_ 791 14;
BA_ "CANFD_BRS" BO_ 791 1;
BA_ "GenMsgCycleTime" BO_ 791 100;
BA_ "GenMsgCycleTimeFast" BO_ 791 0;
BA_ "GenMsgSendType" BO_ 791 0;
BA_ "VFrameFormat" BO_ 791 14;
BA_ "CANFD_BRS" BO_ 791 1;
BA_ "GenMsgCycleTime" BO_ 791 100;
BA_ "GenMsgCycleTimeFast" BO_ 791 0;
BA_ "GenMsgSendType" BO_ 791 0;
BA_ "VFrameFormat" BO_ 791 14;
BA_ "CANFD_BRS" BO_ 791 1;
BA_ "GenMsgCycleTime" BO_ 791 100;
BA_ "GenMsgCycleTimeFast" BO_ 791 0;
BA_ "GenMsgSendType" BO_ 791 0;
BA_ "VFrameFormat" BO_ 791 14;
BA_ "CANFD_BRS" BO_ 791 1;
BA_ "GenMsgCycleTime" BO_ 791 100;
BA_ "GenMsgCycleTimeFast" BO_ 791 0;
BA_ "GenMsgSendType" BO_ 791 0;
BA_ "VFrameFormat" BO_ 791 14;
BA_ "CANFD_BRS" BO_ 791 1;
BA_ "GenMsgCycleTime" BO_ 791 100;
BA_ "GenMsgCycleTimeFast" BO_ 791 0;
BA_ "GenMsgSendType" BO_ 791 0;
BA_ "VFrameFormat" BO_ 791 14;
BA_ "CANFD_BRS" BO_ 791 1;
BA_ "GenMsgCycleTime" BO_ 791 100;
BA_ "GenMsgCycleTimeFast" BO_ 791 0;
BA_ "GenMsgSendType" BO_ 791 0;
BA_ "VFrameFormat" BO_ 791 14;
BA_ "CANFD_BRS" BO_ 791 1;
BA_ "GenMsgCycleTime" BO_ 791 100;
BA_ "GenMsgCycleTimeFast" BO_ 791 0;
BA_ "GenMsgSendType" BO_ 791 0;
BA_ "VFrameFormat" BO_ 791 14;
BA_ "CANFD_BRS" BO_ 791 1;
BA_ "GenMsgCycleTime" BO_ 791 100;
BA_ "GenMsgCycleTimeFast" BO_ 791 0;
BA_ "GenMsgSendType" BO_ 791 0;
BA_ "VFrameFormat" BO_ 791 14;
BA_ "CANFD_BRS" BO_ 791 1;
BA_ "GenMsgCycleTime" BO_ 791 100;
BA_ "GenMsgCycleTimeFast" BO_ 791 0;
BA_ "GenMsgSendType" BO_ 791 0;
BA_ "VFrameFormat" BO_ 791 14;
BA_ "CANFD_BRS" BO_ 791 1;
BA_ "GenMsgCycleTime" BO_ 791 100;
BA_ "GenMsgCycleTimeFast" BO_ 791 0;
BA_ "GenMsgSendType" BO_ 791 0;
BA_ "VFrameFormat" BO_ 791 14;
BA_ "CANFD_BRS" BO_ 791 1;
BA_ "GenMsgCycleTime" BO_ 791 100;
BA_ "GenMsgCycleTimeFast" BO_ 791 0;
BA_ "GenMsgSendType" BO_ 791 0;
BA_ "VFrameFormat" BO_ 791 14;
BA_ "CANFD_BRS" BO_ 791 1;
BA_ "GenMsgCycleTime" BO_ 791 100;
BA_ "GenMsgCycleTimeFast" BO_ 791 0;
BA_ "GenMsgSendType" BO_ 791 0;
BA_ "VFrameFormat" BO_ 791 14;
BA_ "CANFD_BRS" BO_ 791 1;
BA_ "GenMsgCycleTime" BO_ 791 100;
BA_ "GenMsgCycleTimeFast" BO_ 791 0;
BA_ "GenMsgSendType" BO_ 791 0;
BA_ "VFrameFormat" BO_ 791 14;
BA_ "CANFD_BRS" BO_ 791 1;
BA_ "GenMsgCycleTime" BO_ 791 100;
BA_ "GenMsgCycleTimeFast" BO_ 791 0;
BA_ "GenMsgSendType" BO_ 791 0;
BA_ "VFrameFormat" BO_ 791 14;
BA_ "CANFD_BRS" BO_ 791 1;
BA_ "GenMsgCycleTime" BO_ 791 100;
BA_ "GenMsgCycleTimeFast" BO_ 791 0;
BA_ "GenMsgSendType" BO_ 791 0;
BA_ "VFrameFormat" BO_ 791 14;
BA_ "CANFD_BRS" BO_ 791 1;
BA_ "GenMsgCycleTime" BO_ 913 60;
BA_ "GenMsgCycleTimeFast" BO_ 913 0;
BA_ "GenMsgSendType" BO_ 913 0;
BA_ "VFrameFormat" BO_ 913 14;
BA_ "CANFD_BRS" BO_ 913 1;
BA_ "GenMsgCycleTime" BO_ 913 60;
BA_ "GenMsgCycleTimeFast" BO_ 913 0;
BA_ "GenMsgSendType" BO_ 913 0;
BA_ "VFrameFormat" BO_ 913 14;
BA_ "CANFD_BRS" BO_ 913 1;
BA_ "GenMsgCycleTime" BO_ 913 60;
BA_ "GenMsgCycleTimeFast" BO_ 913 0;
BA_ "GenMsgSendType" BO_ 913 0;
BA_ "VFrameFormat" BO_ 913 14;
BA_ "CANFD_BRS" BO_ 913 1;
BA_ "GenMsgCycleTime" BO_ 913 60;
BA_ "GenMsgCycleTimeFast" BO_ 913 0;
BA_ "GenMsgSendType" BO_ 913 0;
BA_ "VFrameFormat" BO_ 913 14;
BA_ "CANFD_BRS" BO_ 913 1;
BA_ "GenMsgCycleTime" BO_ 913 60;
BA_ "GenMsgCycleTimeFast" BO_ 913 0;
BA_ "GenMsgSendType" BO_ 913 0;
BA_ "VFrameFormat" BO_ 913 14;
BA_ "CANFD_BRS" BO_ 913 1;
BA_ "GenMsgCycleTime" BO_ 913 60;
BA_ "GenMsgCycleTimeFast" BO_ 913 0;
BA_ "GenMsgSendType" BO_ 913 0;
BA_ "VFrameFormat" BO_ 913 14;
BA_ "CANFD_BRS" BO_ 913 1;
BA_ "GenMsgCycleTime" BO_ 913 60;
BA_ "GenMsgCycleTimeFast" BO_ 913 0;
BA_ "GenMsgSendType" BO_ 913 0;
BA_ "VFrameFormat" BO_ 913 14;
BA_ "CANFD_BRS" BO_ 913 1;
BA_ "EventCommandSignal" SG_ 780 ACU_ISACountryID 0;
BA_ "GatewayedSignals" SG_ 780 ACU_ISACountryID 0;
BA_ "GenSigInactiveValue" SG_ 780 ACU_ISACountryID 0;
BA_ "GenSigInvalidValue" SG_ 780 ACU_ISACountryID 0;
BA_ "GenSigSendType" SG_ 780 ACU_ISACountryID 1;
BA_ "GenSigStartValue" SG_ 780 ACU_ISACountryID 0;
BA_ "GenSigTimeoutValue" SG_ 780 ACU_ISACountryID 0;
BA_ "Remark" SG_ 780 ACU_ISACountryID "";
BA_ "EventCommandSignal" SG_ 780 ACU_ISARoadTyp 0;
BA_ "GatewayedSignals" SG_ 780 ACU_ISARoadTyp 0;
BA_ "GenSigInactiveValue" SG_ 780 ACU_ISARoadTyp 0;
BA_ "GenSigInvalidValue" SG_ 780 ACU_ISARoadTyp 0;
BA_ "GenSigSendType" SG_ 780 ACU_ISARoadTyp 1;
BA_ "GenSigStartValue" SG_ 780 ACU_ISARoadTyp 0;
BA_ "GenSigTimeoutValue" SG_ 780 ACU_ISARoadTyp 0;
BA_ "Remark" SG_ 780 ACU_ISARoadTyp "";
BA_ "EventCommandSignal" SG_ 780 ACU_ISARoadSpdLimit 0;
BA_ "GatewayedSignals" SG_ 780 ACU_ISARoadSpdLimit 0;
BA_ "GenSigInactiveValue" SG_ 780 ACU_ISARoadSpdLimit 0;
BA_ "GenSigInvalidValue" SG_ 780 ACU_ISARoadSpdLimit 0;
BA_ "GenSigSendType" SG_ 780 ACU_ISARoadSpdLimit 1;
BA_ "GenSigStartValue" SG_ 780 ACU_ISARoadSpdLimit 0;
BA_ "GenSigTimeoutValue" SG_ 780 ACU_ISARoadSpdLimit 0;
BA_ "Remark" SG_ 780 ACU_ISARoadSpdLimit "";
BA_ "EventCommandSignal" SG_ 780 ACU_ISASpdLimitUnit 0;
BA_ "GatewayedSignals" SG_ 780 ACU_ISASpdLimitUnit 0;
BA_ "GenSigInactiveValue" SG_ 780 ACU_ISASpdLimitUnit 0;
BA_ "GenSigInvalidValue" SG_ 780 ACU_ISASpdLimitUnit 0;
BA_ "GenSigSendType" SG_ 780 ACU_ISASpdLimitUnit 1;
BA_ "GenSigStartValue" SG_ 780 ACU_ISASpdLimitUnit 0;
BA_ "GenSigTimeoutValue" SG_ 780 ACU_ISASpdLimitUnit 0;
BA_ "Remark" SG_ 780 ACU_ISASpdLimitUnit "";
BA_ "EventCommandSignal" SG_ 780 ACU_ISASpdLimitTyp 0;
BA_ "GatewayedSignals" SG_ 780 ACU_ISASpdLimitTyp 0;
BA_ "GenSigInactiveValue" SG_ 780 ACU_ISASpdLimitTyp 0;
BA_ "GenSigInvalidValue" SG_ 780 ACU_ISASpdLimitTyp 0;
BA_ "GenSigSendType" SG_ 780 ACU_ISASpdLimitTyp 1;
BA_ "GenSigStartValue" SG_ 780 ACU_ISASpdLimitTyp 0;
BA_ "GenSigTimeoutValue" SG_ 780 ACU_ISASpdLimitTyp 0;
BA_ "Remark" SG_ 780 ACU_ISASpdLimitTyp "";
BA_ "EventCommandSignal" SG_ 780 ACU_ISARampTyp 0;
BA_ "GatewayedSignals" SG_ 780 ACU_ISARampTyp 0;
BA_ "GenSigInactiveValue" SG_ 780 ACU_ISARampTyp 0;
BA_ "GenSigInvalidValue" SG_ 780 ACU_ISARampTyp 0;
BA_ "GenSigSendType" SG_ 780 ACU_ISARampTyp 1;
BA_ "GenSigStartValue" SG_ 780 ACU_ISARampTyp 0;
BA_ "GenSigTimeoutValue" SG_ 780 ACU_ISARampTyp 0;
BA_ "Remark" SG_ 780 ACU_ISARampTyp "";
BA_ "EventCommandSignal" SG_ 780 ACU_ISARampDist 0;
BA_ "GatewayedSignals" SG_ 780 ACU_ISARampDist 0;
BA_ "GenSigInactiveValue" SG_ 780 ACU_ISARampDist 0;
BA_ "GenSigInvalidValue" SG_ 780 ACU_ISARampDist 0;
BA_ "GenSigSendType" SG_ 780 ACU_ISARampDist 1;
BA_ "GenSigStartValue" SG_ 780 ACU_ISARampDist 0;
BA_ "GenSigTimeoutValue" SG_ 780 ACU_ISARampDist 0;
BA_ "Remark" SG_ 780 ACU_ISARampDist "";
BA_ "EventCommandSignal" SG_ 780 ACU_ISAJunctDist 0;
BA_ "GatewayedSignals" SG_ 780 ACU_ISAJunctDist 0;
BA_ "GenSigInactiveValue" SG_ 780 ACU_ISAJunctDist 0;
BA_ "GenSigInvalidValue" SG_ 780 ACU_ISAJunctDist 0;
BA_ "GenSigSendType" SG_ 780 ACU_ISAJunctDist 1;
BA_ "GenSigStartValue" SG_ 780 ACU_ISAJunctDist 0;
BA_ "GenSigTimeoutValue" SG_ 780 ACU_ISAJunctDist 0;
BA_ "Remark" SG_ 780 ACU_ISAJunctDist "";
BA_ "EventCommandSignal" SG_ 780 ACU_ISARDBDist 0;
BA_ "GatewayedSignals" SG_ 780 ACU_ISARDBDist 0;
BA_ "GenSigInactiveValue" SG_ 780 ACU_ISARDBDist 0;
BA_ "GenSigInvalidValue" SG_ 780 ACU_ISARDBDist 0;
BA_ "GenSigSendType" SG_ 780 ACU_ISARDBDist 1;
BA_ "GenSigStartValue" SG_ 780 ACU_ISARDBDist 0;
BA_ "GenSigTimeoutValue" SG_ 780 ACU_ISARDBDist 0;
BA_ "Remark" SG_ 780 ACU_ISARDBDist "";
BA_ "EventCommandSignal" SG_ 780 ACU_ISACondSpdLimit 0;
BA_ "GatewayedSignals" SG_ 780 ACU_ISACondSpdLimit 0;
BA_ "GenSigInactiveValue" SG_ 780 ACU_ISACondSpdLimit 0;
BA_ "GenSigInvalidValue" SG_ 780 ACU_ISACondSpdLimit 0;
BA_ "GenSigSendType" SG_ 780 ACU_ISACondSpdLimit 1;
BA_ "GenSigStartValue" SG_ 780 ACU_ISACondSpdLimit 0;
BA_ "GenSigTimeoutValue" SG_ 780 ACU_ISACondSpdLimit 0;
BA_ "Remark" SG_ 780 ACU_ISACondSpdLimit "";
BA_ "EventCommandSignal" SG_ 780 ACU_ISACondSpdLimitTyp 0;
BA_ "GatewayedSignals" SG_ 780 ACU_ISACondSpdLimitTyp 0;
BA_ "GenSigInactiveValue" SG_ 780 ACU_ISACondSpdLimitTyp 0;
BA_ "GenSigInvalidValue" SG_ 780 ACU_ISACondSpdLimitTyp 0;
BA_ "GenSigSendType" SG_ 780 ACU_ISACondSpdLimitTyp 1;
BA_ "GenSigStartValue" SG_ 780 ACU_ISACondSpdLimitTyp 0;
BA_ "GenSigTimeoutValue" SG_ 780 ACU_ISACondSpdLimitTyp 0;
BA_ "Remark" SG_ 780 ACU_ISACondSpdLimitTyp "";
BA_ "EventCommandSignal" SG_ 780 ACU_ISACondSpdLimitVd 0;
BA_ "GatewayedSignals" SG_ 780 ACU_ISACondSpdLimitVd 0;
BA_ "GenSigInactiveValue" SG_ 780 ACU_ISACondSpdLimitVd 0;
BA_ "GenSigInvalidValue" SG_ 780 ACU_ISACondSpdLimitVd 0;
BA_ "GenSigSendType" SG_ 780 ACU_ISACondSpdLimitVd 1;
BA_ "GenSigStartValue" SG_ 780 ACU_ISACondSpdLimitVd 0;
BA_ "GenSigTimeoutValue" SG_ 780 ACU_ISACondSpdLimitVd 0;
BA_ "Remark" SG_ 780 ACU_ISACondSpdLimitVd "";
BA_ "EventCommandSignal" SG_ 780 ACU_ISASupplierInfo 0;
BA_ "GatewayedSignals" SG_ 780 ACU_ISASupplierInfo 0;
BA_ "GenSigInactiveValue" SG_ 780 ACU_ISASupplierInfo 0;
BA_ "GenSigInvalidValue" SG_ 780 ACU_ISASupplierInfo 0;
BA_ "GenSigSendType" SG_ 780 ACU_ISASupplierInfo 1;
BA_ "GenSigStartValue" SG_ 780 ACU_ISASupplierInfo 0;
BA_ "GenSigTimeoutValue" SG_ 780 ACU_ISASupplierInfo 0;
BA_ "Remark" SG_ 780 ACU_ISASupplierInfo "";
BA_ "EventCommandSignal" SG_ 780 ACU_ISAServiceWorkSt 0;
BA_ "GatewayedSignals" SG_ 780 ACU_ISAServiceWorkSt 0;
BA_ "GenSigInactiveValue" SG_ 780 ACU_ISAServiceWorkSt 0;
BA_ "GenSigInvalidValue" SG_ 780 ACU_ISAServiceWorkSt 0;
BA_ "GenSigSendType" SG_ 780 ACU_ISAServiceWorkSt 1;
BA_ "GenSigStartValue" SG_ 780 ACU_ISAServiceWorkSt 0;
BA_ "GenSigTimeoutValue" SG_ 780 ACU_ISAServiceWorkSt 0;
BA_ "Remark" SG_ 780 ACU_ISAServiceWorkSt "";
BA_ "EventCommandSignal" SG_ 163 ACU_RAEBcfg 1;
BA_ "GatewayedSignals" SG_ 163 ACU_RAEBcfg 0;
BA_ "GenSigInactiveValue" SG_ 163 ACU_RAEBcfg 0;
BA_ "GenSigInvalidValue" SG_ 163 ACU_RAEBcfg 0;
BA_ "GenSigSendType" SG_ 163 ACU_RAEBcfg 0;
BA_ "GenSigStartValue" SG_ 163 ACU_RAEBcfg 0;
BA_ "GenSigTimeoutValue" SG_ 163 ACU_RAEBcfg 0;
BA_ "Remark" SG_ 163 ACU_RAEBcfg "";
BA_ "EventCommandSignal" SG_ 163 ACU_PAAMode 1;
BA_ "GatewayedSignals" SG_ 163 ACU_PAAMode 0;
BA_ "GenSigInactiveValue" SG_ 163 ACU_PAAMode 0;
BA_ "GenSigInvalidValue" SG_ 163 ACU_PAAMode 0;
BA_ "GenSigSendType" SG_ 163 ACU_PAAMode 0;
BA_ "GenSigStartValue" SG_ 163 ACU_PAAMode 0;
BA_ "GenSigTimeoutValue" SG_ 163 ACU_PAAMode 0;
BA_ "Remark" SG_ 163 ACU_PAAMode "";
BA_ "EventCommandSignal" SG_ 163 ACU_SVM_Button 1;
BA_ "GatewayedSignals" SG_ 163 ACU_SVM_Button 0;
BA_ "GenSigInactiveValue" SG_ 163 ACU_SVM_Button 0;
BA_ "GenSigInvalidValue" SG_ 163 ACU_SVM_Button 0;
BA_ "GenSigSendType" SG_ 163 ACU_SVM_Button 0;
BA_ "GenSigStartValue" SG_ 163 ACU_SVM_Button 0;
BA_ "GenSigTimeoutValue" SG_ 163 ACU_SVM_Button 0;
BA_ "Remark" SG_ 163 ACU_SVM_Button "";
BA_ "EventCommandSignal" SG_ 163 ACU_PCS_MirrorpagedownButtonST 1;
BA_ "GatewayedSignals" SG_ 163 ACU_PCS_MirrorpagedownButtonST 0;
BA_ "GenSigInactiveValue" SG_ 163 ACU_PCS_MirrorpagedownButtonST 0;
BA_ "GenSigInvalidValue" SG_ 163 ACU_PCS_MirrorpagedownButtonST 0;
BA_ "GenSigSendType" SG_ 163 ACU_PCS_MirrorpagedownButtonST 0;
BA_ "GenSigStartValue" SG_ 163 ACU_PCS_MirrorpagedownButtonST 0;
BA_ "GenSigTimeoutValue" SG_ 163 ACU_PCS_MirrorpagedownButtonST 0;
BA_ "Remark" SG_ 163 ACU_PCS_MirrorpagedownButtonST "";
BA_ "EventCommandSignal" SG_ 163 ACU_PCS_ScreenTouchSt 1;
BA_ "GatewayedSignals" SG_ 163 ACU_PCS_ScreenTouchSt 0;
BA_ "GenSigInactiveValue" SG_ 163 ACU_PCS_ScreenTouchSt 0;
BA_ "GenSigInvalidValue" SG_ 163 ACU_PCS_ScreenTouchSt 0;
BA_ "GenSigSendType" SG_ 163 ACU_PCS_ScreenTouchSt 0;
BA_ "GenSigStartValue" SG_ 163 ACU_PCS_ScreenTouchSt 0;
BA_ "GenSigTimeoutValue" SG_ 163 ACU_PCS_ScreenTouchSt 0;
BA_ "Remark" SG_ 163 ACU_PCS_ScreenTouchSt "";
BA_ "EventCommandSignal" SG_ 163 ACU_LanguageTypeSet 1;
BA_ "GatewayedSignals" SG_ 163 ACU_LanguageTypeSet 0;
BA_ "GenSigInactiveValue" SG_ 163 ACU_LanguageTypeSet 0;
BA_ "GenSigInvalidValue" SG_ 163 ACU_LanguageTypeSet 0;
BA_ "GenSigSendType" SG_ 163 ACU_LanguageTypeSet 0;
BA_ "GenSigStartValue" SG_ 163 ACU_LanguageTypeSet 0;
BA_ "GenSigTimeoutValue" SG_ 163 ACU_LanguageTypeSet 0;
BA_ "Remark" SG_ 163 ACU_LanguageTypeSet "";
BA_ "EventCommandSignal" SG_ 163 ACU_PCS_SVM_FunctionCmd 1;
BA_ "GatewayedSignals" SG_ 163 ACU_PCS_SVM_FunctionCmd 0;
BA_ "GenSigInactiveValue" SG_ 163 ACU_PCS_SVM_FunctionCmd 0;
BA_ "GenSigInvalidValue" SG_ 163 ACU_PCS_SVM_FunctionCmd 0;
BA_ "GenSigSendType" SG_ 163 ACU_PCS_SVM_FunctionCmd 0;
BA_ "GenSigStartValue" SG_ 163 ACU_PCS_SVM_FunctionCmd 0;
BA_ "GenSigTimeoutValue" SG_ 163 ACU_PCS_SVM_FunctionCmd 0;
BA_ "Remark" SG_ 163 ACU_PCS_SVM_FunctionCmd "";
BA_ "EventCommandSignal" SG_ 163 ACU_PCS_ScreenCoordY 1;
BA_ "GatewayedSignals" SG_ 163 ACU_PCS_ScreenCoordY 0;
BA_ "GenSigInactiveValue" SG_ 163 ACU_PCS_ScreenCoordY 0;
BA_ "GenSigInvalidValue" SG_ 163 ACU_PCS_ScreenCoordY 0;
BA_ "GenSigSendType" SG_ 163 ACU_PCS_ScreenCoordY 0;
BA_ "GenSigStartValue" SG_ 163 ACU_PCS_ScreenCoordY 0;
BA_ "GenSigTimeoutValue" SG_ 163 ACU_PCS_ScreenCoordY 0;
BA_ "Remark" SG_ 163 ACU_PCS_ScreenCoordY "";
BA_ "EventCommandSignal" SG_ 163 ACU_PCS_ScreenCoordX 1;
BA_ "GatewayedSignals" SG_ 163 ACU_PCS_ScreenCoordX 0;
BA_ "GenSigInactiveValue" SG_ 163 ACU_PCS_ScreenCoordX 0;
BA_ "GenSigInvalidValue" SG_ 163 ACU_PCS_ScreenCoordX 0;
BA_ "GenSigSendType" SG_ 163 ACU_PCS_ScreenCoordX 0;
BA_ "GenSigStartValue" SG_ 163 ACU_PCS_ScreenCoordX 0;
BA_ "GenSigTimeoutValue" SG_ 163 ACU_PCS_ScreenCoordX 0;
BA_ "Remark" SG_ 163 ACU_PCS_ScreenCoordX "";
BA_ "EventCommandSignal" SG_ 163 ACU_APAMessageSt 1;
BA_ "GatewayedSignals" SG_ 163 ACU_APAMessageSt 0;
BA_ "GenSigInactiveValue" SG_ 163 ACU_APAMessageSt 0;
BA_ "GenSigInvalidValue" SG_ 163 ACU_APAMessageSt 0;
BA_ "GenSigSendType" SG_ 163 ACU_APAMessageSt 0;
BA_ "GenSigStartValue" SG_ 163 ACU_APAMessageSt 0;
BA_ "GenSigTimeoutValue" SG_ 163 ACU_APAMessageSt 0;
BA_ "Remark" SG_ 163 ACU_APAMessageSt "";
BA_ "EventCommandSignal" SG_ 163 ACU_PAS_ButtonPress 1;
BA_ "GatewayedSignals" SG_ 163 ACU_PAS_ButtonPress 0;
BA_ "GenSigInactiveValue" SG_ 163 ACU_PAS_ButtonPress 0;
BA_ "GenSigInvalidValue" SG_ 163 ACU_PAS_ButtonPress 0;
BA_ "GenSigSendType" SG_ 163 ACU_PAS_ButtonPress 0;
BA_ "GenSigStartValue" SG_ 163 ACU_PAS_ButtonPress 0;
BA_ "GenSigTimeoutValue" SG_ 163 ACU_PAS_ButtonPress 0;
BA_ "Remark" SG_ 163 ACU_PAS_ButtonPress "";
BA_ "EventCommandSignal" SG_ 163 ACU_HPAMessageSt 1;
BA_ "GatewayedSignals" SG_ 163 ACU_HPAMessageSt 0;
BA_ "GenSigInactiveValue" SG_ 163 ACU_HPAMessageSt 0;
BA_ "GenSigInvalidValue" SG_ 163 ACU_HPAMessageSt 0;
BA_ "GenSigSendType" SG_ 163 ACU_HPAMessageSt 0;
BA_ "GenSigStartValue" SG_ 163 ACU_HPAMessageSt 0;
BA_ "GenSigTimeoutValue" SG_ 163 ACU_HPAMessageSt 0;
BA_ "Remark" SG_ 163 ACU_HPAMessageSt "";
BA_ "EventCommandSignal" SG_ 163 ACU_AVPMessageSt 1;
BA_ "GatewayedSignals" SG_ 163 ACU_AVPMessageSt 0;
BA_ "GenSigInactiveValue" SG_ 163 ACU_AVPMessageSt 0;
BA_ "GenSigInvalidValue" SG_ 163 ACU_AVPMessageSt 0;
BA_ "GenSigSendType" SG_ 163 ACU_AVPMessageSt 0;
BA_ "GenSigStartValue" SG_ 163 ACU_AVPMessageSt 0;
BA_ "GenSigTimeoutValue" SG_ 163 ACU_AVPMessageSt 0;
BA_ "Remark" SG_ 163 ACU_AVPMessageSt "";
BA_ "EventCommandSignal" SG_ 163 ACU_HPALearningSetParkLot 1;
BA_ "GatewayedSignals" SG_ 163 ACU_HPALearningSetParkLot 0;
BA_ "GenSigInactiveValue" SG_ 163 ACU_HPALearningSetParkLot 0;
BA_ "GenSigInvalidValue" SG_ 163 ACU_HPALearningSetParkLot 0;
BA_ "GenSigSendType" SG_ 163 ACU_HPALearningSetParkLot 0;
BA_ "GenSigStartValue" SG_ 163 ACU_HPALearningSetParkLot 0;
BA_ "GenSigTimeoutValue" SG_ 163 ACU_HPALearningSetParkLot 0;
BA_ "Remark" SG_ 163 ACU_HPALearningSetParkLot "";
BA_ "EventCommandSignal" SG_ 163 ACU_HPALearningProcessInfo 1;
BA_ "GatewayedSignals" SG_ 163 ACU_HPALearningProcessInfo 0;
BA_ "GenSigInactiveValue" SG_ 163 ACU_HPALearningProcessInfo 0;
BA_ "GenSigInvalidValue" SG_ 163 ACU_HPALearningProcessInfo 0;
BA_ "GenSigSendType" SG_ 163 ACU_HPALearningProcessInfo 0;
BA_ "GenSigStartValue" SG_ 163 ACU_HPALearningProcessInfo 0;
BA_ "GenSigTimeoutValue" SG_ 163 ACU_HPALearningProcessInfo 0;
BA_ "Remark" SG_ 163 ACU_HPALearningProcessInfo "";
BA_ "EventCommandSignal" SG_ 163 ACU_SDEnterParkingLot 1;
BA_ "GatewayedSignals" SG_ 163 ACU_SDEnterParkingLot 0;
BA_ "GenSigInactiveValue" SG_ 163 ACU_SDEnterParkingLot 0;
BA_ "GenSigInvalidValue" SG_ 163 ACU_SDEnterParkingLot 0;
BA_ "GenSigSendType" SG_ 163 ACU_SDEnterParkingLot 0;
BA_ "GenSigStartValue" SG_ 163 ACU_SDEnterParkingLot 0;
BA_ "GenSigTimeoutValue" SG_ 163 ACU_SDEnterParkingLot 0;
BA_ "Remark" SG_ 163 ACU_SDEnterParkingLot "";
BA_ "EventCommandSignal" SG_ 163 ACU_PCS_ER_QuitConfirm 1;
BA_ "GatewayedSignals" SG_ 163 ACU_PCS_ER_QuitConfirm 0;
BA_ "GenSigInactiveValue" SG_ 163 ACU_PCS_ER_QuitConfirm 0;
BA_ "GenSigInvalidValue" SG_ 163 ACU_PCS_ER_QuitConfirm 0;
BA_ "GenSigSendType" SG_ 163 ACU_PCS_ER_QuitConfirm 0;
BA_ "GenSigStartValue" SG_ 163 ACU_PCS_ER_QuitConfirm 0;
BA_ "GenSigTimeoutValue" SG_ 163 ACU_PCS_ER_QuitConfirm 0;
BA_ "Remark" SG_ 163 ACU_PCS_ER_QuitConfirm "";
BA_ "EventCommandSignal" SG_ 163 ACU_DisplayReq 1;
BA_ "GatewayedSignals" SG_ 163 ACU_DisplayReq 0;
BA_ "GenSigInactiveValue" SG_ 163 ACU_DisplayReq 0;
BA_ "GenSigInvalidValue" SG_ 163 ACU_DisplayReq 0;
BA_ "GenSigSendType" SG_ 163 ACU_DisplayReq 0;
BA_ "GenSigStartValue" SG_ 163 ACU_DisplayReq 0;
BA_ "GenSigTimeoutValue" SG_ 163 ACU_DisplayReq 0;
BA_ "Remark" SG_ 163 ACU_DisplayReq "";
BA_ "EventCommandSignal" SG_ 163 ACU_ER_FuncCfg 1;
BA_ "GatewayedSignals" SG_ 163 ACU_ER_FuncCfg 0;
BA_ "GenSigInactiveValue" SG_ 163 ACU_ER_FuncCfg 0;
BA_ "GenSigInvalidValue" SG_ 163 ACU_ER_FuncCfg 0;
BA_ "GenSigSendType" SG_ 163 ACU_ER_FuncCfg 0;
BA_ "GenSigStartValue" SG_ 163 ACU_ER_FuncCfg 0;
BA_ "GenSigTimeoutValue" SG_ 163 ACU_ER_FuncCfg 0;
BA_ "Remark" SG_ 163 ACU_ER_FuncCfg "";
BA_ "EventCommandSignal" SG_ 163 ACU_PCS_ER_EnterCmd 1;
BA_ "GatewayedSignals" SG_ 163 ACU_PCS_ER_EnterCmd 0;
BA_ "GenSigInactiveValue" SG_ 163 ACU_PCS_ER_EnterCmd 0;
BA_ "GenSigInvalidValue" SG_ 163 ACU_PCS_ER_EnterCmd 0;
BA_ "GenSigSendType" SG_ 163 ACU_PCS_ER_EnterCmd 0;
BA_ "GenSigStartValue" SG_ 163 ACU_PCS_ER_EnterCmd 0;
BA_ "GenSigTimeoutValue" SG_ 163 ACU_PCS_ER_EnterCmd 0;
BA_ "Remark" SG_ 163 ACU_PCS_ER_EnterCmd "";
BA_ "EventCommandSignal" SG_ 163 ACU_PCS_ScreenTouchSignal 1;
BA_ "GatewayedSignals" SG_ 163 ACU_PCS_ScreenTouchSignal 0;
BA_ "GenSigInactiveValue" SG_ 163 ACU_PCS_ScreenTouchSignal 0;
BA_ "GenSigInvalidValue" SG_ 163 ACU_PCS_ScreenTouchSignal 0;
BA_ "GenSigSendType" SG_ 163 ACU_PCS_ScreenTouchSignal 0;
BA_ "GenSigStartValue" SG_ 163 ACU_PCS_ScreenTouchSignal 0;
BA_ "GenSigTimeoutValue" SG_ 163 ACU_PCS_ScreenTouchSignal 0;
BA_ "Remark" SG_ 163 ACU_PCS_ScreenTouchSignal "";
BA_ "EventCommandSignal" SG_ 163 ACU_DPMessageSt 1;
BA_ "GatewayedSignals" SG_ 163 ACU_DPMessageSt 0;
BA_ "GenSigInactiveValue" SG_ 163 ACU_DPMessageSt 0;
BA_ "GenSigInvalidValue" SG_ 163 ACU_DPMessageSt 0;
BA_ "GenSigSendType" SG_ 163 ACU_DPMessageSt 0;
BA_ "GenSigStartValue" SG_ 163 ACU_DPMessageSt 0;
BA_ "GenSigTimeoutValue" SG_ 163 ACU_DPMessageSt 0;
BA_ "Remark" SG_ 163 ACU_DPMessageSt "";
BA_ "EventCommandSignal" SG_ 163 ACU_ParkingBoxMidX 1;
BA_ "GatewayedSignals" SG_ 163 ACU_ParkingBoxMidX 0;
BA_ "GenSigInactiveValue" SG_ 163 ACU_ParkingBoxMidX 0;
BA_ "GenSigInvalidValue" SG_ 163 ACU_ParkingBoxMidX 0;
BA_ "GenSigSendType" SG_ 163 ACU_ParkingBoxMidX 0;
BA_ "GenSigStartValue" SG_ 163 ACU_ParkingBoxMidX 0;
BA_ "GenSigTimeoutValue" SG_ 163 ACU_ParkingBoxMidX 0;
BA_ "Remark" SG_ 163 ACU_ParkingBoxMidX "";
BA_ "EventCommandSignal" SG_ 163 ACU_ParkingBoxMidY 1;
BA_ "GatewayedSignals" SG_ 163 ACU_ParkingBoxMidY 0;
BA_ "GenSigInactiveValue" SG_ 163 ACU_ParkingBoxMidY 0;
BA_ "GenSigInvalidValue" SG_ 163 ACU_ParkingBoxMidY 0;
BA_ "GenSigSendType" SG_ 163 ACU_ParkingBoxMidY 0;
BA_ "GenSigStartValue" SG_ 163 ACU_ParkingBoxMidY 0;
BA_ "GenSigTimeoutValue" SG_ 163 ACU_ParkingBoxMidY 0;
BA_ "Remark" SG_ 163 ACU_ParkingBoxMidY "";
BA_ "EventCommandSignal" SG_ 163 ACU_LowPowerConfig 1;
BA_ "GatewayedSignals" SG_ 163 ACU_LowPowerConfig 0;
BA_ "GenSigInactiveValue" SG_ 163 ACU_LowPowerConfig 0;
BA_ "GenSigInvalidValue" SG_ 163 ACU_LowPowerConfig 0;
BA_ "GenSigSendType" SG_ 163 ACU_LowPowerConfig 0;
BA_ "GenSigStartValue" SG_ 163 ACU_LowPowerConfig 0;
BA_ "GenSigTimeoutValue" SG_ 163 ACU_LowPowerConfig 0;
BA_ "Remark" SG_ 163 ACU_LowPowerConfig "";
BA_ "EventCommandSignal" SG_ 163 ACU_PCSModeSt 1;
BA_ "GatewayedSignals" SG_ 163 ACU_PCSModeSt 0;
BA_ "GenSigInactiveValue" SG_ 163 ACU_PCSModeSt 0;
BA_ "GenSigInvalidValue" SG_ 163 ACU_PCSModeSt 0;
BA_ "GenSigSendType" SG_ 163 ACU_PCSModeSt 0;
BA_ "GenSigStartValue" SG_ 163 ACU_PCSModeSt 0;
BA_ "GenSigTimeoutValue" SG_ 163 ACU_PCSModeSt 0;
BA_ "Remark" SG_ 163 ACU_PCSModeSt "";
BA_ "EventCommandSignal" SG_ 163 ACU_PCSModeSt_A 1;
BA_ "GatewayedSignals" SG_ 163 ACU_PCSModeSt_A 0;
BA_ "GenSigInactiveValue" SG_ 163 ACU_PCSModeSt_A 0;
BA_ "GenSigInvalidValue" SG_ 163 ACU_PCSModeSt_A 0;
BA_ "GenSigSendType" SG_ 163 ACU_PCSModeSt_A 0;
BA_ "GenSigStartValue" SG_ 163 ACU_PCSModeSt_A 0;
BA_ "GenSigTimeoutValue" SG_ 163 ACU_PCSModeSt_A 0;
BA_ "Remark" SG_ 163 ACU_PCSModeSt_A "";
BA_ "EventCommandSignal" SG_ 163 ACU_ParkingBoxAngle 1;
BA_ "GatewayedSignals" SG_ 163 ACU_ParkingBoxAngle 0;
BA_ "GenSigInactiveValue" SG_ 163 ACU_ParkingBoxAngle 0;
BA_ "GenSigInvalidValue" SG_ 163 ACU_ParkingBoxAngle 0;
BA_ "GenSigSendType" SG_ 163 ACU_ParkingBoxAngle 0;
BA_ "GenSigStartValue" SG_ 163 ACU_ParkingBoxAngle 0;
BA_ "GenSigTimeoutValue" SG_ 163 ACU_ParkingBoxAngle 0;
BA_ "Remark" SG_ 163 ACU_ParkingBoxAngle "";
BA_ "EventCommandSignal" SG_ 163 IDC_APAParkingSpdsSfg 1;
BA_ "GatewayedSignals" SG_ 163 IDC_APAParkingSpdsSfg 0;
BA_ "GenSigInactiveValue" SG_ 163 IDC_APAParkingSpdsSfg 0;
BA_ "GenSigInvalidValue" SG_ 163 IDC_APAParkingSpdsSfg 0;
BA_ "GenSigSendType" SG_ 163 IDC_APAParkingSpdsSfg 0;
BA_ "GenSigStartValue" SG_ 163 IDC_APAParkingSpdsSfg 0;
BA_ "GenSigTimeoutValue" SG_ 163 IDC_APAParkingSpdsSfg 0;
BA_ "Remark" SG_ 163 IDC_APAParkingSpdsSfg "";
BA_ "EventCommandSignal" SG_ 163 IDC_DskScreenOperationSt 1;
BA_ "GatewayedSignals" SG_ 163 IDC_DskScreenOperationSt 0;
BA_ "GenSigInactiveValue" SG_ 163 IDC_DskScreenOperationSt 0;
BA_ "GenSigInvalidValue" SG_ 163 IDC_DskScreenOperationSt 0;
BA_ "GenSigSendType" SG_ 163 IDC_DskScreenOperationSt 0;
BA_ "GenSigStartValue" SG_ 163 IDC_DskScreenOperationSt 0;
BA_ "GenSigTimeoutValue" SG_ 163 IDC_DskScreenOperationSt 0;
BA_ "Remark" SG_ 163 IDC_DskScreenOperationSt "";
BA_ "EventCommandSignal" SG_ 163 IDC_SenslesEtyParkingSwSt 1;
BA_ "GatewayedSignals" SG_ 163 IDC_SenslesEtyParkingSwSt 0;
BA_ "GenSigInactiveValue" SG_ 163 IDC_SenslesEtyParkingSwSt 0;
BA_ "GenSigInvalidValue" SG_ 163 IDC_SenslesEtyParkingSwSt 0;
BA_ "GenSigSendType" SG_ 163 IDC_SenslesEtyParkingSwSt 0;
BA_ "GenSigStartValue" SG_ 163 IDC_SenslesEtyParkingSwSt 0;
BA_ "GenSigTimeoutValue" SG_ 163 IDC_SenslesEtyParkingSwSt 0;
BA_ "Remark" SG_ 163 IDC_SenslesEtyParkingSwSt "";
BA_ "EventCommandSignal" SG_ 163 ACU_NDAVoicePromptTypeCfg 1;
BA_ "GatewayedSignals" SG_ 163 ACU_NDAVoicePromptTypeCfg 0;
BA_ "GenSigInactiveValue" SG_ 163 ACU_NDAVoicePromptTypeCfg 0;
BA_ "GenSigInvalidValue" SG_ 163 ACU_NDAVoicePromptTypeCfg 0;
BA_ "GenSigSendType" SG_ 163 ACU_NDAVoicePromptTypeCfg 0;
BA_ "GenSigStartValue" SG_ 163 ACU_NDAVoicePromptTypeCfg 0;
BA_ "GenSigTimeoutValue" SG_ 163 ACU_NDAVoicePromptTypeCfg 0;
BA_ "Remark" SG_ 163 ACU_NDAVoicePromptTypeCfg "";
BA_ "EventCommandSignal" SG_ 163 IDC_SenslesEtyParkingDskScene 1;
BA_ "GatewayedSignals" SG_ 163 IDC_SenslesEtyParkingDskScene 0;
BA_ "GenSigInactiveValue" SG_ 163 IDC_SenslesEtyParkingDskScene 0;
BA_ "GenSigInvalidValue" SG_ 163 IDC_SenslesEtyParkingDskScene 0;
BA_ "GenSigSendType" SG_ 163 IDC_SenslesEtyParkingDskScene 0;
BA_ "GenSigStartValue" SG_ 163 IDC_SenslesEtyParkingDskScene 0;
BA_ "GenSigTimeoutValue" SG_ 163 IDC_SenslesEtyParkingDskScene 0;
BA_ "Remark" SG_ 163 IDC_SenslesEtyParkingDskScene "";
BA_ "EventCommandSignal" SG_ 163 ACU_VR_APAControl 1;
BA_ "GatewayedSignals" SG_ 163 ACU_VR_APAControl 0;
BA_ "GenSigInactiveValue" SG_ 163 ACU_VR_APAControl 0;
BA_ "GenSigInvalidValue" SG_ 163 ACU_VR_APAControl 0;
BA_ "GenSigSendType" SG_ 163 ACU_VR_APAControl 0;
BA_ "GenSigStartValue" SG_ 163 ACU_VR_APAControl 0;
BA_ "GenSigTimeoutValue" SG_ 163 ACU_VR_APAControl 0;
BA_ "Remark" SG_ 163 ACU_VR_APAControl "";
BA_ "EventCommandSignal" SG_ 163 ACU_SteeringPrkgButton 1;
BA_ "GatewayedSignals" SG_ 163 ACU_SteeringPrkgButton 0;
BA_ "GenSigInactiveValue" SG_ 163 ACU_SteeringPrkgButton 0;
BA_ "GenSigInvalidValue" SG_ 163 ACU_SteeringPrkgButton 0;
BA_ "GenSigSendType" SG_ 163 ACU_SteeringPrkgButton 0;
BA_ "GenSigStartValue" SG_ 163 ACU_SteeringPrkgButton 0;
BA_ "GenSigTimeoutValue" SG_ 163 ACU_SteeringPrkgButton 0;
BA_ "Remark" SG_ 163 ACU_SteeringPrkgButton "";
BA_ "EventCommandSignal" SG_ 163 ACU_ActiveNDAMessageSt 1;
BA_ "GatewayedSignals" SG_ 163 ACU_ActiveNDAMessageSt 0;
BA_ "GenSigInactiveValue" SG_ 163 ACU_ActiveNDAMessageSt 0;
BA_ "GenSigInvalidValue" SG_ 163 ACU_ActiveNDAMessageSt 0;
BA_ "GenSigSendType" SG_ 163 ACU_ActiveNDAMessageSt 0;
BA_ "GenSigStartValue" SG_ 163 ACU_ActiveNDAMessageSt 0;
BA_ "GenSigTimeoutValue" SG_ 163 ACU_ActiveNDAMessageSt 0;
BA_ "Remark" SG_ 163 ACU_ActiveNDAMessageSt "";
BA_ "EventCommandSignal" SG_ 163 ACU_ActiveAVPMessageSt 1;
BA_ "GatewayedSignals" SG_ 163 ACU_ActiveAVPMessageSt 0;
BA_ "GenSigInactiveValue" SG_ 163 ACU_ActiveAVPMessageSt 0;
BA_ "GenSigInvalidValue" SG_ 163 ACU_ActiveAVPMessageSt 0;
BA_ "GenSigSendType" SG_ 163 ACU_ActiveAVPMessageSt 0;
BA_ "GenSigStartValue" SG_ 163 ACU_ActiveAVPMessageSt 0;
BA_ "GenSigTimeoutValue" SG_ 163 ACU_ActiveAVPMessageSt 0;
BA_ "Remark" SG_ 163 ACU_ActiveAVPMessageSt "";
BA_ "EventCommandSignal" SG_ 163 ACU_LeftLaneChangeMessageSt 1;
BA_ "GatewayedSignals" SG_ 163 ACU_LeftLaneChangeMessageSt 0;
BA_ "GenSigInactiveValue" SG_ 163 ACU_LeftLaneChangeMessageSt 0;
BA_ "GenSigInvalidValue" SG_ 163 ACU_LeftLaneChangeMessageSt 0;
BA_ "GenSigSendType" SG_ 163 ACU_LeftLaneChangeMessageSt 0;
BA_ "GenSigStartValue" SG_ 163 ACU_LeftLaneChangeMessageSt 0;
BA_ "GenSigTimeoutValue" SG_ 163 ACU_LeftLaneChangeMessageSt 0;
BA_ "Remark" SG_ 163 ACU_LeftLaneChangeMessageSt "";
BA_ "EventCommandSignal" SG_ 163 ACU_RigthLaneChangeMessageSt 1;
BA_ "GatewayedSignals" SG_ 163 ACU_RigthLaneChangeMessageSt 0;
BA_ "GenSigInactiveValue" SG_ 163 ACU_RigthLaneChangeMessageSt 0;
BA_ "GenSigInvalidValue" SG_ 163 ACU_RigthLaneChangeMessageSt 0;
BA_ "GenSigSendType" SG_ 163 ACU_RigthLaneChangeMessageSt 0;
BA_ "GenSigStartValue" SG_ 163 ACU_RigthLaneChangeMessageSt 0;
BA_ "GenSigTimeoutValue" SG_ 163 ACU_RigthLaneChangeMessageSt 0;
BA_ "Remark" SG_ 163 ACU_RigthLaneChangeMessageSt "";
BA_ "EventCommandSignal" SG_ 163 ACU_ICANDAIconMessageSt 1;
BA_ "GatewayedSignals" SG_ 163 ACU_ICANDAIconMessageSt 0;
BA_ "GenSigInactiveValue" SG_ 163 ACU_ICANDAIconMessageSt 0;
BA_ "GenSigInvalidValue" SG_ 163 ACU_ICANDAIconMessageSt 0;
BA_ "GenSigSendType" SG_ 163 ACU_ICANDAIconMessageSt 0;
BA_ "GenSigStartValue" SG_ 163 ACU_ICANDAIconMessageSt 0;
BA_ "GenSigTimeoutValue" SG_ 163 ACU_ICANDAIconMessageSt 0;
BA_ "Remark" SG_ 163 ACU_ICANDAIconMessageSt "";
BA_ "EventCommandSignal" SG_ 163 ACU_SVM_Button_A 1;
BA_ "GatewayedSignals" SG_ 163 ACU_SVM_Button_A 0;
BA_ "GenSigInactiveValue" SG_ 163 ACU_SVM_Button_A 0;
BA_ "GenSigInvalidValue" SG_ 163 ACU_SVM_Button_A 0;
BA_ "GenSigSendType" SG_ 163 ACU_SVM_Button_A 0;
BA_ "GenSigStartValue" SG_ 163 ACU_SVM_Button_A 0;
BA_ "GenSigTimeoutValue" SG_ 163 ACU_SVM_Button_A 0;
BA_ "Remark" SG_ 163 ACU_SVM_Button_A "";
BA_ "EventCommandSignal" SG_ 475 ACU_MirrSteeringAdjFlag 1;
BA_ "GatewayedSignals" SG_ 475 ACU_MirrSteeringAdjFlag 0;
BA_ "GenSigInactiveValue" SG_ 475 ACU_MirrSteeringAdjFlag 0;
BA_ "GenSigInvalidValue" SG_ 475 ACU_MirrSteeringAdjFlag 0;
BA_ "GenSigSendType" SG_ 475 ACU_MirrSteeringAdjFlag 0;
BA_ "GenSigStartValue" SG_ 475 ACU_MirrSteeringAdjFlag 0;
BA_ "GenSigTimeoutValue" SG_ 475 ACU_MirrSteeringAdjFlag 0;
BA_ "Remark" SG_ 475 ACU_MirrSteeringAdjFlag "华为IDC控制器根据交互规范按照POE逻辑发送此报文";
BA_ "EventCommandSignal" SG_ 879 ACU_PCS_SVM_MODCmd 0;
BA_ "GatewayedSignals" SG_ 879 ACU_PCS_SVM_MODCmd 0;
BA_ "GenSigInactiveValue" SG_ 879 ACU_PCS_SVM_MODCmd 0;
BA_ "GenSigInvalidValue" SG_ 879 ACU_PCS_SVM_MODCmd 0;
BA_ "GenSigSendType" SG_ 879 ACU_PCS_SVM_MODCmd 1;
BA_ "GenSigStartValue" SG_ 879 ACU_PCS_SVM_MODCmd 0;
BA_ "GenSigTimeoutValue" SG_ 879 ACU_PCS_SVM_MODCmd 0;
BA_ "Remark" SG_ 879 ACU_PCS_SVM_MODCmd "";
BA_ "EventCommandSignal" SG_ 879 ACU_HeadLightVirtualSwSt 0;
BA_ "GatewayedSignals" SG_ 879 ACU_HeadLightVirtualSwSt 0;
BA_ "GenSigInactiveValue" SG_ 879 ACU_HeadLightVirtualSwSt 0;
BA_ "GenSigInvalidValue" SG_ 879 ACU_HeadLightVirtualSwSt 0;
BA_ "GenSigSendType" SG_ 879 ACU_HeadLightVirtualSwSt 1;
BA_ "GenSigStartValue" SG_ 879 ACU_HeadLightVirtualSwSt 0;
BA_ "GenSigTimeoutValue" SG_ 879 ACU_HeadLightVirtualSwSt 0;
BA_ "Remark" SG_ 879 ACU_HeadLightVirtualSwSt "";
BA_ "EventCommandSignal" SG_ 879 ACU_FrontFogLightVirtualSwSt 0;
BA_ "GatewayedSignals" SG_ 879 ACU_FrontFogLightVirtualSwSt 0;
BA_ "GenSigInactiveValue" SG_ 879 ACU_FrontFogLightVirtualSwSt 0;
BA_ "GenSigInvalidValue" SG_ 879 ACU_FrontFogLightVirtualSwSt 0;
BA_ "GenSigSendType" SG_ 879 ACU_FrontFogLightVirtualSwSt 1;
BA_ "GenSigStartValue" SG_ 879 ACU_FrontFogLightVirtualSwSt 0;
BA_ "GenSigTimeoutValue" SG_ 879 ACU_FrontFogLightVirtualSwSt 0;
BA_ "Remark" SG_ 879 ACU_FrontFogLightVirtualSwSt "";
BA_ "EventCommandSignal" SG_ 879 ACU_RearFogLightVirtualSwSt 0;
BA_ "GatewayedSignals" SG_ 879 ACU_RearFogLightVirtualSwSt 0;
BA_ "GenSigInactiveValue" SG_ 879 ACU_RearFogLightVirtualSwSt 0;
BA_ "GenSigInvalidValue" SG_ 879 ACU_RearFogLightVirtualSwSt 0;
BA_ "GenSigSendType" SG_ 879 ACU_RearFogLightVirtualSwSt 1;
BA_ "GenSigStartValue" SG_ 879 ACU_RearFogLightVirtualSwSt 0;
BA_ "GenSigTimeoutValue" SG_ 879 ACU_RearFogLightVirtualSwSt 0;
BA_ "Remark" SG_ 879 ACU_RearFogLightVirtualSwSt "";
BA_ "EventCommandSignal" SG_ 879 ACU_Account_Uid 0;
BA_ "GatewayedSignals" SG_ 879 ACU_Account_Uid 0;
BA_ "GenSigInactiveValue" SG_ 879 ACU_Account_Uid 0;
BA_ "GenSigInvalidValue" SG_ 879 ACU_Account_Uid 0;
BA_ "GenSigSendType" SG_ 879 ACU_Account_Uid 1;
BA_ "GenSigStartValue" SG_ 879 ACU_Account_Uid 0;
BA_ "GenSigTimeoutValue" SG_ 879 ACU_Account_Uid 0;
BA_ "Remark" SG_ 879 ACU_Account_Uid "";
BA_ "EventCommandSignal" SG_ 879 ACU_FCWWarnDistanceCfg 0;
BA_ "GatewayedSignals" SG_ 879 ACU_FCWWarnDistanceCfg 0;
BA_ "GenSigInactiveValue" SG_ 879 ACU_FCWWarnDistanceCfg 0;
BA_ "GenSigInvalidValue" SG_ 879 ACU_FCWWarnDistanceCfg 0;
BA_ "GenSigSendType" SG_ 879 ACU_FCWWarnDistanceCfg 1;
BA_ "GenSigStartValue" SG_ 879 ACU_FCWWarnDistanceCfg 0;
BA_ "GenSigTimeoutValue" SG_ 879 ACU_FCWWarnDistanceCfg 0;
BA_ "Remark" SG_ 879 ACU_FCWWarnDistanceCfg "";
BA_ "EventCommandSignal" SG_ 879 ACU_FCWCfg 0;
BA_ "GatewayedSignals" SG_ 879 ACU_FCWCfg 0;
BA_ "GenSigInactiveValue" SG_ 879 ACU_FCWCfg 0;
BA_ "GenSigInvalidValue" SG_ 879 ACU_FCWCfg 0;
BA_ "GenSigSendType" SG_ 879 ACU_FCWCfg 1;
BA_ "GenSigStartValue" SG_ 879 ACU_FCWCfg 0;
BA_ "GenSigTimeoutValue" SG_ 879 ACU_FCWCfg 0;
BA_ "Remark" SG_ 879 ACU_FCWCfg "";
BA_ "EventCommandSignal" SG_ 879 ACU_AEBOff 0;
BA_ "GatewayedSignals" SG_ 879 ACU_AEBOff 0;
BA_ "GenSigInactiveValue" SG_ 879 ACU_AEBOff 0;
BA_ "GenSigInvalidValue" SG_ 879 ACU_AEBOff 0;
BA_ "GenSigSendType" SG_ 879 ACU_AEBOff 1;
BA_ "GenSigStartValue" SG_ 879 ACU_AEBOff 0;
BA_ "GenSigTimeoutValue" SG_ 879 ACU_AEBOff 0;
BA_ "Remark" SG_ 879 ACU_AEBOff "";
BA_ "EventCommandSignal" SG_ 879 ACU_TSR_SwitchReq 0;
BA_ "GatewayedSignals" SG_ 879 ACU_TSR_SwitchReq 0;
BA_ "GenSigInactiveValue" SG_ 879 ACU_TSR_SwitchReq 0;
BA_ "GenSigInvalidValue" SG_ 879 ACU_TSR_SwitchReq 0;
BA_ "GenSigSendType" SG_ 879 ACU_TSR_SwitchReq 1;
BA_ "GenSigStartValue" SG_ 879 ACU_TSR_SwitchReq 0;
BA_ "GenSigTimeoutValue" SG_ 879 ACU_TSR_SwitchReq 0;
BA_ "Remark" SG_ 879 ACU_TSR_SwitchReq "";
BA_ "EventCommandSignal" SG_ 879 ACU_IHBC_SwitchReq 0;
BA_ "GatewayedSignals" SG_ 879 ACU_IHBC_SwitchReq 0;
BA_ "GenSigInactiveValue" SG_ 879 ACU_IHBC_SwitchReq 0;
BA_ "GenSigInvalidValue" SG_ 879 ACU_IHBC_SwitchReq 0;
BA_ "GenSigSendType" SG_ 879 ACU_IHBC_SwitchReq 1;
BA_ "GenSigStartValue" SG_ 879 ACU_IHBC_SwitchReq 0;
BA_ "GenSigTimeoutValue" SG_ 879 ACU_IHBC_SwitchReq 0;
BA_ "Remark" SG_ 879 ACU_IHBC_SwitchReq "";
BA_ "EventCommandSignal" SG_ 879 ACU_LDS_TypeReq 0;
BA_ "GatewayedSignals" SG_ 879 ACU_LDS_TypeReq 0;
BA_ "GenSigInactiveValue" SG_ 879 ACU_LDS_TypeReq 0;
BA_ "GenSigInvalidValue" SG_ 879 ACU_LDS_TypeReq 0;
BA_ "GenSigSendType" SG_ 879 ACU_LDS_TypeReq 1;
BA_ "GenSigStartValue" SG_ 879 ACU_LDS_TypeReq 0;
BA_ "GenSigTimeoutValue" SG_ 879 ACU_LDS_TypeReq 0;
BA_ "Remark" SG_ 879 ACU_LDS_TypeReq "";
BA_ "EventCommandSignal" SG_ 879 ACU_BSDCfg 0;
BA_ "GatewayedSignals" SG_ 879 ACU_BSDCfg 0;
BA_ "GenSigInactiveValue" SG_ 879 ACU_BSDCfg 0;
BA_ "GenSigInvalidValue" SG_ 879 ACU_BSDCfg 0;
BA_ "GenSigSendType" SG_ 879 ACU_BSDCfg 1;
BA_ "GenSigStartValue" SG_ 879 ACU_BSDCfg 0;
BA_ "GenSigTimeoutValue" SG_ 879 ACU_BSDCfg 0;
BA_ "Remark" SG_ 879 ACU_BSDCfg "";
BA_ "EventCommandSignal" SG_ 879 ACU_RCTACfg 0;
BA_ "GatewayedSignals" SG_ 879 ACU_RCTACfg 0;
BA_ "GenSigInactiveValue" SG_ 879 ACU_RCTACfg 0;
BA_ "GenSigInvalidValue" SG_ 879 ACU_RCTACfg 0;
BA_ "GenSigSendType" SG_ 879 ACU_RCTACfg 1;
BA_ "GenSigStartValue" SG_ 879 ACU_RCTACfg 0;
BA_ "GenSigTimeoutValue" SG_ 879 ACU_RCTACfg 0;
BA_ "Remark" SG_ 879 ACU_RCTACfg "";
BA_ "EventCommandSignal" SG_ 879 ACU_DOWCfg 0;
BA_ "GatewayedSignals" SG_ 879 ACU_DOWCfg 0;
BA_ "GenSigInactiveValue" SG_ 879 ACU_DOWCfg 0;
BA_ "GenSigInvalidValue" SG_ 879 ACU_DOWCfg 0;
BA_ "GenSigSendType" SG_ 879 ACU_DOWCfg 1;
BA_ "GenSigStartValue" SG_ 879 ACU_DOWCfg 0;
BA_ "GenSigTimeoutValue" SG_ 879 ACU_DOWCfg 0;
BA_ "Remark" SG_ 879 ACU_DOWCfg "";
BA_ "EventCommandSignal" SG_ 879 ACU_TSR_AudioWarnReq 0;
BA_ "GatewayedSignals" SG_ 879 ACU_TSR_AudioWarnReq 0;
BA_ "GenSigInactiveValue" SG_ 879 ACU_TSR_AudioWarnReq 0;
BA_ "GenSigInvalidValue" SG_ 879 ACU_TSR_AudioWarnReq 0;
BA_ "GenSigSendType" SG_ 879 ACU_TSR_AudioWarnReq 1;
BA_ "GenSigStartValue" SG_ 879 ACU_TSR_AudioWarnReq 0;
BA_ "GenSigTimeoutValue" SG_ 879 ACU_TSR_AudioWarnReq 0;
BA_ "Remark" SG_ 879 ACU_TSR_AudioWarnReq "";
BA_ "EventCommandSignal" SG_ 879 ACU_HWAHFCfg 0;
BA_ "GatewayedSignals" SG_ 879 ACU_HWAHFCfg 0;
BA_ "GenSigInactiveValue" SG_ 879 ACU_HWAHFCfg 0;
BA_ "GenSigInvalidValue" SG_ 879 ACU_HWAHFCfg 0;
BA_ "GenSigSendType" SG_ 879 ACU_HWAHFCfg 1;
BA_ "GenSigStartValue" SG_ 879 ACU_HWAHFCfg 0;
BA_ "GenSigTimeoutValue" SG_ 879 ACU_HWAHFCfg 0;
BA_ "Remark" SG_ 879 ACU_HWAHFCfg "";
BA_ "EventCommandSignal" SG_ 879 ACU_HWAHF_AudioWarningTypeCfg 0;
BA_ "GatewayedSignals" SG_ 879 ACU_HWAHF_AudioWarningTypeCfg 0;
BA_ "GenSigInactiveValue" SG_ 879 ACU_HWAHF_AudioWarningTypeCfg 0;
BA_ "GenSigInvalidValue" SG_ 879 ACU_HWAHF_AudioWarningTypeCfg 0;
BA_ "GenSigSendType" SG_ 879 ACU_HWAHF_AudioWarningTypeCfg 1;
BA_ "GenSigStartValue" SG_ 879 ACU_HWAHF_AudioWarningTypeCfg 0;
BA_ "GenSigTimeoutValue" SG_ 879 ACU_HWAHF_AudioWarningTypeCfg 0;
BA_ "Remark" SG_ 879 ACU_HWAHF_AudioWarningTypeCfg "";
BA_ "EventCommandSignal" SG_ 879 ACU_HWA_SwitchReq 0;
BA_ "GatewayedSignals" SG_ 879 ACU_HWA_SwitchReq 0;
BA_ "GenSigInactiveValue" SG_ 879 ACU_HWA_SwitchReq 0;
BA_ "GenSigInvalidValue" SG_ 879 ACU_HWA_SwitchReq 0;
BA_ "GenSigSendType" SG_ 879 ACU_HWA_SwitchReq 1;
BA_ "GenSigStartValue" SG_ 879 ACU_HWA_SwitchReq 0;
BA_ "GenSigTimeoutValue" SG_ 879 ACU_HWA_SwitchReq 0;
BA_ "Remark" SG_ 879 ACU_HWA_SwitchReq "";
BA_ "EventCommandSignal" SG_ 879 ACU_ELKCfg 0;
BA_ "GatewayedSignals" SG_ 879 ACU_ELKCfg 0;
BA_ "GenSigInactiveValue" SG_ 879 ACU_ELKCfg 0;
BA_ "GenSigInvalidValue" SG_ 879 ACU_ELKCfg 0;
BA_ "GenSigSendType" SG_ 879 ACU_ELKCfg 1;
BA_ "GenSigStartValue" SG_ 879 ACU_ELKCfg 0;
BA_ "GenSigTimeoutValue" SG_ 879 ACU_ELKCfg 0;
BA_ "Remark" SG_ 879 ACU_ELKCfg "";
BA_ "EventCommandSignal" SG_ 879 ACU_FCTACfg 0;
BA_ "GatewayedSignals" SG_ 879 ACU_FCTACfg 0;
BA_ "GenSigInactiveValue" SG_ 879 ACU_FCTACfg 0;
BA_ "GenSigInvalidValue" SG_ 879 ACU_FCTACfg 0;
BA_ "GenSigSendType" SG_ 879 ACU_FCTACfg 1;
BA_ "GenSigStartValue" SG_ 879 ACU_FCTACfg 0;
BA_ "GenSigTimeoutValue" SG_ 879 ACU_FCTACfg 0;
BA_ "Remark" SG_ 879 ACU_FCTACfg "";
BA_ "EventCommandSignal" SG_ 879 ACU_RAWCfg 0;
BA_ "GatewayedSignals" SG_ 879 ACU_RAWCfg 0;
BA_ "GenSigInactiveValue" SG_ 879 ACU_RAWCfg 0;
BA_ "GenSigInvalidValue" SG_ 879 ACU_RAWCfg 0;
BA_ "GenSigSendType" SG_ 879 ACU_RAWCfg 1;
BA_ "GenSigStartValue" SG_ 879 ACU_RAWCfg 0;
BA_ "GenSigTimeoutValue" SG_ 879 ACU_RAWCfg 0;
BA_ "Remark" SG_ 879 ACU_RAWCfg "";
BA_ "EventCommandSignal" SG_ 879 ACU_RCTA_TypeReqCfg 0;
BA_ "GatewayedSignals" SG_ 879 ACU_RCTA_TypeReqCfg 0;
BA_ "GenSigInactiveValue" SG_ 879 ACU_RCTA_TypeReqCfg 0;
BA_ "GenSigInvalidValue" SG_ 879 ACU_RCTA_TypeReqCfg 0;
BA_ "GenSigSendType" SG_ 879 ACU_RCTA_TypeReqCfg 1;
BA_ "GenSigStartValue" SG_ 879 ACU_RCTA_TypeReqCfg 0;
BA_ "GenSigTimeoutValue" SG_ 879 ACU_RCTA_TypeReqCfg 0;
BA_ "Remark" SG_ 879 ACU_RCTA_TypeReqCfg "";
BA_ "EventCommandSignal" SG_ 879 ACU_FCTA_TypeReqCfg 0;
BA_ "GatewayedSignals" SG_ 879 ACU_FCTA_TypeReqCfg 0;
BA_ "GenSigInactiveValue" SG_ 879 ACU_FCTA_TypeReqCfg 0;
BA_ "GenSigInvalidValue" SG_ 879 ACU_FCTA_TypeReqCfg 0;
BA_ "GenSigSendType" SG_ 879 ACU_FCTA_TypeReqCfg 1;
BA_ "GenSigStartValue" SG_ 879 ACU_FCTA_TypeReqCfg 0;
BA_ "GenSigTimeoutValue" SG_ 879 ACU_FCTA_TypeReqCfg 0;
BA_ "Remark" SG_ 879 ACU_FCTA_TypeReqCfg "";
BA_ "EventCommandSignal" SG_ 879 ACU_NDASwitchReq 0;
BA_ "GatewayedSignals" SG_ 879 ACU_NDASwitchReq 0;
BA_ "GenSigInactiveValue" SG_ 879 ACU_NDASwitchReq 0;
BA_ "GenSigInvalidValue" SG_ 879 ACU_NDASwitchReq 0;
BA_ "GenSigSendType" SG_ 879 ACU_NDASwitchReq 1;
BA_ "GenSigStartValue" SG_ 879 ACU_NDASwitchReq 0;
BA_ "GenSigTimeoutValue" SG_ 879 ACU_NDASwitchReq 0;
BA_ "Remark" SG_ 879 ACU_NDASwitchReq "";
BA_ "EventCommandSignal" SG_ 879 ACU_NDALCConSwitchReq 0;
BA_ "GatewayedSignals" SG_ 879 ACU_NDALCConSwitchReq 0;
BA_ "GenSigInactiveValue" SG_ 879 ACU_NDALCConSwitchReq 0;
BA_ "GenSigInvalidValue" SG_ 879 ACU_NDALCConSwitchReq 0;
BA_ "GenSigSendType" SG_ 879 ACU_NDALCConSwitchReq 1;
BA_ "GenSigStartValue" SG_ 879 ACU_NDALCConSwitchReq 0;
BA_ "GenSigTimeoutValue" SG_ 879 ACU_NDALCConSwitchReq 0;
BA_ "Remark" SG_ 879 ACU_NDALCConSwitchReq "";
BA_ "EventCommandSignal" SG_ 879 ACU_NDALCStySwitchReq 0;
BA_ "GatewayedSignals" SG_ 879 ACU_NDALCStySwitchReq 0;
BA_ "GenSigInactiveValue" SG_ 879 ACU_NDALCStySwitchReq 0;
BA_ "GenSigInvalidValue" SG_ 879 ACU_NDALCStySwitchReq 0;
BA_ "GenSigSendType" SG_ 879 ACU_NDALCStySwitchReq 1;
BA_ "GenSigStartValue" SG_ 879 ACU_NDALCStySwitchReq 0;
BA_ "GenSigTimeoutValue" SG_ 879 ACU_NDALCStySwitchReq 0;
BA_ "Remark" SG_ 879 ACU_NDALCStySwitchReq "";
BA_ "EventCommandSignal" SG_ 879 ACU_ADASWarnTypeSwitch 0;
BA_ "GatewayedSignals" SG_ 879 ACU_ADASWarnTypeSwitch 0;
BA_ "GenSigInactiveValue" SG_ 879 ACU_ADASWarnTypeSwitch 0;
BA_ "GenSigInvalidValue" SG_ 879 ACU_ADASWarnTypeSwitch 0;
BA_ "GenSigSendType" SG_ 879 ACU_ADASWarnTypeSwitch 1;
BA_ "GenSigStartValue" SG_ 879 ACU_ADASWarnTypeSwitch 0;
BA_ "GenSigTimeoutValue" SG_ 879 ACU_ADASWarnTypeSwitch 0;
BA_ "Remark" SG_ 879 ACU_ADASWarnTypeSwitch "";
BA_ "EventCommandSignal" SG_ 879 ACU_ESACfg 0;
BA_ "GatewayedSignals" SG_ 879 ACU_ESACfg 0;
BA_ "GenSigInactiveValue" SG_ 879 ACU_ESACfg 0;
BA_ "GenSigInvalidValue" SG_ 879 ACU_ESACfg 0;
BA_ "GenSigSendType" SG_ 879 ACU_ESACfg 1;
BA_ "GenSigStartValue" SG_ 879 ACU_ESACfg 1;
BA_ "GenSigTimeoutValue" SG_ 879 ACU_ESACfg 0;
BA_ "Remark" SG_ 879 ACU_ESACfg "";
BA_ "EventCommandSignal" SG_ 879 ACU_ILCCfg 0;
BA_ "GatewayedSignals" SG_ 879 ACU_ILCCfg 0;
BA_ "GenSigInactiveValue" SG_ 879 ACU_ILCCfg 0;
BA_ "GenSigInvalidValue" SG_ 879 ACU_ILCCfg 0;
BA_ "GenSigSendType" SG_ 879 ACU_ILCCfg 1;
BA_ "GenSigStartValue" SG_ 879 ACU_ILCCfg 2;
BA_ "GenSigTimeoutValue" SG_ 879 ACU_ILCCfg 0;
BA_ "Remark" SG_ 879 ACU_ILCCfg "";
BA_ "EventCommandSignal" SG_ 879 ACU_AESCfg 0;
BA_ "GatewayedSignals" SG_ 879 ACU_AESCfg 0;
BA_ "GenSigInactiveValue" SG_ 879 ACU_AESCfg 0;
BA_ "GenSigInvalidValue" SG_ 879 ACU_AESCfg 0;
BA_ "GenSigSendType" SG_ 879 ACU_AESCfg 1;
BA_ "GenSigStartValue" SG_ 879 ACU_AESCfg 3;
BA_ "GenSigTimeoutValue" SG_ 879 ACU_AESCfg 0;
BA_ "Remark" SG_ 879 ACU_AESCfg "";
BA_ "EventCommandSignal" SG_ 879 ACU_ILOACfg 0;
BA_ "GatewayedSignals" SG_ 879 ACU_ILOACfg 0;
BA_ "GenSigInactiveValue" SG_ 879 ACU_ILOACfg 0;
BA_ "GenSigInvalidValue" SG_ 879 ACU_ILOACfg 0;
BA_ "GenSigSendType" SG_ 879 ACU_ILOACfg 1;
BA_ "GenSigStartValue" SG_ 879 ACU_ILOACfg 3;
BA_ "GenSigTimeoutValue" SG_ 879 ACU_ILOACfg 0;
BA_ "Remark" SG_ 879 ACU_ILOACfg "";
BA_ "EventCommandSignal" SG_ 879 ACU_iACC_StyleConfirmSwitchReq 0;
BA_ "GatewayedSignals" SG_ 879 ACU_iACC_StyleConfirmSwitchReq 0;
BA_ "GenSigInactiveValue" SG_ 879 ACU_iACC_StyleConfirmSwitchReq 0;
BA_ "GenSigInvalidValue" SG_ 879 ACU_iACC_StyleConfirmSwitchReq 0;
BA_ "GenSigSendType" SG_ 879 ACU_iACC_StyleConfirmSwitchReq 1;
BA_ "GenSigStartValue" SG_ 879 ACU_iACC_StyleConfirmSwitchReq 3;
BA_ "GenSigTimeoutValue" SG_ 879 ACU_iACC_StyleConfirmSwitchReq 0;
BA_ "Remark" SG_ 879 ACU_iACC_StyleConfirmSwitchReq "";
BA_ "EventCommandSignal" SG_ 879 ACU_IFC_SpeedLimit 0;
BA_ "GatewayedSignals" SG_ 879 ACU_IFC_SpeedLimit 0;
BA_ "GenSigInactiveValue" SG_ 879 ACU_IFC_SpeedLimit 0;
BA_ "GenSigInvalidValue" SG_ 879 ACU_IFC_SpeedLimit 0;
BA_ "GenSigSendType" SG_ 879 ACU_IFC_SpeedLimit 1;
BA_ "GenSigStartValue" SG_ 879 ACU_IFC_SpeedLimit 0;
BA_ "GenSigTimeoutValue" SG_ 879 ACU_IFC_SpeedLimit 0;
BA_ "Remark" SG_ 879 ACU_IFC_SpeedLimit "";
BA_ "EventCommandSignal" SG_ 879 ACU_IFC_ISDRestOfdis 0;
BA_ "GatewayedSignals" SG_ 879 ACU_IFC_ISDRestOfdis 0;
BA_ "GenSigInactiveValue" SG_ 879 ACU_IFC_ISDRestOfdis 0;
BA_ "GenSigInvalidValue" SG_ 879 ACU_IFC_ISDRestOfdis 0;
BA_ "GenSigSendType" SG_ 879 ACU_IFC_ISDRestOfdis 1;
BA_ "GenSigStartValue" SG_ 879 ACU_IFC_ISDRestOfdis 0;
BA_ "GenSigTimeoutValue" SG_ 879 ACU_IFC_ISDRestOfdis 0;
BA_ "Remark" SG_ 879 ACU_IFC_ISDRestOfdis "";
BA_ "EventCommandSignal" SG_ 879 ACU_IFC_SpeedLimitUnit 0;
BA_ "GatewayedSignals" SG_ 879 ACU_IFC_SpeedLimitUnit 0;
BA_ "GenSigInactiveValue" SG_ 879 ACU_IFC_SpeedLimitUnit 0;
BA_ "GenSigInvalidValue" SG_ 879 ACU_IFC_SpeedLimitUnit 0;
BA_ "GenSigSendType" SG_ 879 ACU_IFC_SpeedLimitUnit 1;
BA_ "GenSigStartValue" SG_ 879 ACU_IFC_SpeedLimitUnit 0;
BA_ "GenSigTimeoutValue" SG_ 879 ACU_IFC_SpeedLimitUnit 1;
BA_ "Remark" SG_ 879 ACU_IFC_SpeedLimitUnit "";
BA_ "EventCommandSignal" SG_ 879 ACU_ThemeType 0;
BA_ "GatewayedSignals" SG_ 879 ACU_ThemeType 0;
BA_ "GenSigInactiveValue" SG_ 879 ACU_ThemeType 0;
BA_ "GenSigInvalidValue" SG_ 879 ACU_ThemeType 0;
BA_ "GenSigSendType" SG_ 879 ACU_ThemeType 1;
BA_ "GenSigStartValue" SG_ 879 ACU_ThemeType 0;
BA_ "GenSigTimeoutValue" SG_ 879 ACU_ThemeType 0;
BA_ "Remark" SG_ 879 ACU_ThemeType "";
BA_ "EventCommandSignal" SG_ 879 ACU_IFC_SpeedLimtType 0;
BA_ "GatewayedSignals" SG_ 879 ACU_IFC_SpeedLimtType 0;
BA_ "GenSigInactiveValue" SG_ 879 ACU_IFC_SpeedLimtType 0;
BA_ "GenSigInvalidValue" SG_ 879 ACU_IFC_SpeedLimtType 0;
BA_ "GenSigSendType" SG_ 879 ACU_IFC_SpeedLimtType 1;
BA_ "GenSigStartValue" SG_ 879 ACU_IFC_SpeedLimtType 0;
BA_ "GenSigTimeoutValue" SG_ 879 ACU_IFC_SpeedLimtType 0;
BA_ "Remark" SG_ 879 ACU_IFC_SpeedLimtType "";
BA_ "EventCommandSignal" SG_ 879 ACU_IFC_RoadType 0;
BA_ "GatewayedSignals" SG_ 879 ACU_IFC_RoadType 0;
BA_ "GenSigInactiveValue" SG_ 879 ACU_IFC_RoadType 0;
BA_ "GenSigInvalidValue" SG_ 879 ACU_IFC_RoadType 0;
BA_ "GenSigSendType" SG_ 879 ACU_IFC_RoadType 1;
BA_ "GenSigStartValue" SG_ 879 ACU_IFC_RoadType 0;
BA_ "GenSigTimeoutValue" SG_ 879 ACU_IFC_RoadType 0;
BA_ "Remark" SG_ 879 ACU_IFC_RoadType "";
BA_ "EventCommandSignal" SG_ 879 ACU_IFC_ZoneCode 0;
BA_ "GatewayedSignals" SG_ 879 ACU_IFC_ZoneCode 0;
BA_ "GenSigInactiveValue" SG_ 879 ACU_IFC_ZoneCode 0;
BA_ "GenSigInvalidValue" SG_ 879 ACU_IFC_ZoneCode 0;
BA_ "GenSigSendType" SG_ 879 ACU_IFC_ZoneCode 1;
BA_ "GenSigStartValue" SG_ 879 ACU_IFC_ZoneCode 0;
BA_ "GenSigTimeoutValue" SG_ 879 ACU_IFC_ZoneCode 1;
BA_ "Remark" SG_ 879 ACU_IFC_ZoneCode "";
BA_ "EventCommandSignal" SG_ 879 ACU_IFC_NaviSt 0;
BA_ "GatewayedSignals" SG_ 879 ACU_IFC_NaviSt 0;
BA_ "GenSigInactiveValue" SG_ 879 ACU_IFC_NaviSt 0;
BA_ "GenSigInvalidValue" SG_ 879 ACU_IFC_NaviSt 0;
BA_ "GenSigSendType" SG_ 879 ACU_IFC_NaviSt 1;
BA_ "GenSigStartValue" SG_ 879 ACU_IFC_NaviSt 0;
BA_ "GenSigTimeoutValue" SG_ 879 ACU_IFC_NaviSt 0;
BA_ "Remark" SG_ 879 ACU_IFC_NaviSt "";
BA_ "EventCommandSignal" SG_ 879 ACU_IFC_NaviCorp 0;
BA_ "GatewayedSignals" SG_ 879 ACU_IFC_NaviCorp 0;
BA_ "GenSigInactiveValue" SG_ 879 ACU_IFC_NaviCorp 0;
BA_ "GenSigInvalidValue" SG_ 879 ACU_IFC_NaviCorp 0;
BA_ "GenSigSendType" SG_ 879 ACU_IFC_NaviCorp 1;
BA_ "GenSigStartValue" SG_ 879 ACU_IFC_NaviCorp 0;
BA_ "GenSigTimeoutValue" SG_ 879 ACU_IFC_NaviCorp 0;
BA_ "Remark" SG_ 879 ACU_IFC_NaviCorp "";
BA_ "EventCommandSignal" SG_ 879 ACU_IFC_NaviNewIconDis 0;
BA_ "GatewayedSignals" SG_ 879 ACU_IFC_NaviNewIconDis 0;
BA_ "GenSigInactiveValue" SG_ 879 ACU_IFC_NaviNewIconDis 0;
BA_ "GenSigInvalidValue" SG_ 879 ACU_IFC_NaviNewIconDis 0;
BA_ "GenSigSendType" SG_ 879 ACU_IFC_NaviNewIconDis 1;
BA_ "GenSigStartValue" SG_ 879 ACU_IFC_NaviNewIconDis 0;
BA_ "GenSigTimeoutValue" SG_ 879 ACU_IFC_NaviNewIconDis 0;
BA_ "Remark" SG_ 879 ACU_IFC_NaviNewIconDis "";
BA_ "EventCommandSignal" SG_ 879 ACU_IFC_OfframpSt 0;
BA_ "GatewayedSignals" SG_ 879 ACU_IFC_OfframpSt 0;
BA_ "GenSigInactiveValue" SG_ 879 ACU_IFC_OfframpSt 0;
BA_ "GenSigInvalidValue" SG_ 879 ACU_IFC_OfframpSt 0;
BA_ "GenSigSendType" SG_ 879 ACU_IFC_OfframpSt 1;
BA_ "GenSigStartValue" SG_ 879 ACU_IFC_OfframpSt 0;
BA_ "GenSigTimeoutValue" SG_ 879 ACU_IFC_OfframpSt 0;
BA_ "Remark" SG_ 879 ACU_IFC_OfframpSt "";
BA_ "EventCommandSignal" SG_ 879 ACU_IFC_NaviNewIcon 0;
BA_ "GatewayedSignals" SG_ 879 ACU_IFC_NaviNewIcon 0;
BA_ "GenSigInactiveValue" SG_ 879 ACU_IFC_NaviNewIcon 0;
BA_ "GenSigInvalidValue" SG_ 879 ACU_IFC_NaviNewIcon 0;
BA_ "GenSigSendType" SG_ 879 ACU_IFC_NaviNewIcon 1;
BA_ "GenSigStartValue" SG_ 879 ACU_IFC_NaviNewIcon 0;
BA_ "GenSigTimeoutValue" SG_ 879 ACU_IFC_NaviNewIcon 0;
BA_ "Remark" SG_ 879 ACU_IFC_NaviNewIcon "";
BA_ "EventCommandSignal" SG_ 879 ACU_IFC_SLCAheadDis 0;
BA_ "GatewayedSignals" SG_ 879 ACU_IFC_SLCAheadDis 0;
BA_ "GenSigInactiveValue" SG_ 879 ACU_IFC_SLCAheadDis 0;
BA_ "GenSigInvalidValue" SG_ 879 ACU_IFC_SLCAheadDis 0;
BA_ "GenSigSendType" SG_ 879 ACU_IFC_SLCAheadDis 1;
BA_ "GenSigStartValue" SG_ 879 ACU_IFC_SLCAheadDis 0;
BA_ "GenSigTimeoutValue" SG_ 879 ACU_IFC_SLCAheadDis 0;
BA_ "Remark" SG_ 879 ACU_IFC_SLCAheadDis "";
BA_ "EventCommandSignal" SG_ 879 ACU_DVR_Switch 0;
BA_ "GatewayedSignals" SG_ 879 ACU_DVR_Switch 0;
BA_ "GenSigInactiveValue" SG_ 879 ACU_DVR_Switch 0;
BA_ "GenSigInvalidValue" SG_ 879 ACU_DVR_Switch 0;
BA_ "GenSigSendType" SG_ 879 ACU_DVR_Switch 1;
BA_ "GenSigStartValue" SG_ 879 ACU_DVR_Switch 0;
BA_ "GenSigTimeoutValue" SG_ 879 ACU_DVR_Switch 0;
BA_ "Remark" SG_ 879 ACU_DVR_Switch "";
BA_ "EventCommandSignal" SG_ 879 ACU_IFC_OfframpDis 0;
BA_ "GatewayedSignals" SG_ 879 ACU_IFC_OfframpDis 0;
BA_ "GenSigInactiveValue" SG_ 879 ACU_IFC_OfframpDis 0;
BA_ "GenSigInvalidValue" SG_ 879 ACU_IFC_OfframpDis 0;
BA_ "GenSigSendType" SG_ 879 ACU_IFC_OfframpDis 1;
BA_ "GenSigStartValue" SG_ 879 ACU_IFC_OfframpDis 254;
BA_ "GenSigTimeoutValue" SG_ 879 ACU_IFC_OfframpDis 254;
BA_ "Remark" SG_ 879 ACU_IFC_OfframpDis "";
BA_ "EventCommandSignal" SG_ 351 ACU_VirtualPowerOFFReq 1;
BA_ "GatewayedSignals" SG_ 351 ACU_VirtualPowerOFFReq 0;
BA_ "GenSigInactiveValue" SG_ 351 ACU_VirtualPowerOFFReq 0;
BA_ "GenSigInvalidValue" SG_ 351 ACU_VirtualPowerOFFReq 0;
BA_ "GenSigSendType" SG_ 351 ACU_VirtualPowerOFFReq 0;
BA_ "GenSigStartValue" SG_ 351 ACU_VirtualPowerOFFReq 0;
BA_ "GenSigTimeoutValue" SG_ 351 ACU_VirtualPowerOFFReq 0;
BA_ "Remark" SG_ 351 ACU_VirtualPowerOFFReq "";
BA_ "EventCommandSignal" SG_ 351 ACU_Account_Uld 1;
BA_ "GatewayedSignals" SG_ 351 ACU_Account_Uld 0;
BA_ "GenSigInactiveValue" SG_ 351 ACU_Account_Uld 0;
BA_ "GenSigInvalidValue" SG_ 351 ACU_Account_Uld 0;
BA_ "GenSigSendType" SG_ 351 ACU_Account_Uld 0;
BA_ "GenSigStartValue" SG_ 351 ACU_Account_Uld 0;
BA_ "GenSigTimeoutValue" SG_ 351 ACU_Account_Uld 0;
BA_ "Remark" SG_ 351 ACU_Account_Uld "";
BA_ "EventCommandSignal" SG_ 351 ACU_FactoryResetReq 1;
BA_ "GatewayedSignals" SG_ 351 ACU_FactoryResetReq 0;
BA_ "GenSigInactiveValue" SG_ 351 ACU_FactoryResetReq 0;
BA_ "GenSigInvalidValue" SG_ 351 ACU_FactoryResetReq 0;
BA_ "GenSigSendType" SG_ 351 ACU_FactoryResetReq 0;
BA_ "GenSigStartValue" SG_ 351 ACU_FactoryResetReq 0;
BA_ "GenSigTimeoutValue" SG_ 351 ACU_FactoryResetReq 0;
BA_ "Remark" SG_ 351 ACU_FactoryResetReq "";
BA_ "EventCommandSignal" SG_ 351 ACU_Account_Delete 1;
BA_ "GatewayedSignals" SG_ 351 ACU_Account_Delete 0;
BA_ "GenSigInactiveValue" SG_ 351 ACU_Account_Delete 0;
BA_ "GenSigInvalidValue" SG_ 351 ACU_Account_Delete 0;
BA_ "GenSigSendType" SG_ 351 ACU_Account_Delete 0;
BA_ "GenSigStartValue" SG_ 351 ACU_Account_Delete 0;
BA_ "GenSigTimeoutValue" SG_ 351 ACU_Account_Delete 0;
BA_ "Remark" SG_ 351 ACU_Account_Delete "";
BA_ "EventCommandSignal" SG_ 351 ACU_FrontWiperIntCfgVkReq 1;
BA_ "GatewayedSignals" SG_ 351 ACU_FrontWiperIntCfgVkReq 0;
BA_ "GenSigInactiveValue" SG_ 351 ACU_FrontWiperIntCfgVkReq 0;
BA_ "GenSigInvalidValue" SG_ 351 ACU_FrontWiperIntCfgVkReq 0;
BA_ "GenSigSendType" SG_ 351 ACU_FrontWiperIntCfgVkReq 0;
BA_ "GenSigStartValue" SG_ 351 ACU_FrontWiperIntCfgVkReq 0;
BA_ "GenSigTimeoutValue" SG_ 351 ACU_FrontWiperIntCfgVkReq 0;
BA_ "Remark" SG_ 351 ACU_FrontWiperIntCfgVkReq "";
BA_ "EventCommandSignal" SG_ 351 ACU_FrontWiperAutoCfgVkReq 1;
BA_ "GatewayedSignals" SG_ 351 ACU_FrontWiperAutoCfgVkReq 0;
BA_ "GenSigInactiveValue" SG_ 351 ACU_FrontWiperAutoCfgVkReq 0;
BA_ "GenSigInvalidValue" SG_ 351 ACU_FrontWiperAutoCfgVkReq 0;
BA_ "GenSigSendType" SG_ 351 ACU_FrontWiperAutoCfgVkReq 0;
BA_ "GenSigStartValue" SG_ 351 ACU_FrontWiperAutoCfgVkReq 0;
BA_ "GenSigTimeoutValue" SG_ 351 ACU_FrontWiperAutoCfgVkReq 0;
BA_ "Remark" SG_ 351 ACU_FrontWiperAutoCfgVkReq "";
BA_ "EventCommandSignal" SG_ 967 DMS_1_CRC 0;
BA_ "GatewayedSignals" SG_ 967 DMS_1_CRC 0;
BA_ "GenSigInactiveValue" SG_ 967 DMS_1_CRC 0;
BA_ "GenSigInvalidValue" SG_ 967 DMS_1_CRC 0;
BA_ "GenSigSendType" SG_ 967 DMS_1_CRC 1;
BA_ "GenSigStartValue" SG_ 967 DMS_1_CRC 0;
BA_ "GenSigTimeoutValue" SG_ 967 DMS_1_CRC 0;
BA_ "Remark" SG_ 967 DMS_1_CRC "";
BA_ "EventCommandSignal" SG_ 967 DMS_1_Counter 0;
BA_ "GatewayedSignals" SG_ 967 DMS_1_Counter 0;
BA_ "GenSigInactiveValue" SG_ 967 DMS_1_Counter 0;
BA_ "GenSigInvalidValue" SG_ 967 DMS_1_Counter 0;
BA_ "GenSigSendType" SG_ 967 DMS_1_Counter 1;
BA_ "GenSigStartValue" SG_ 967 DMS_1_Counter 0;
BA_ "GenSigTimeoutValue" SG_ 967 DMS_1_Counter 0;
BA_ "Remark" SG_ 967 DMS_1_Counter "";
BA_ "EventCommandSignal" SG_ 967 DMS_SysErrSt 0;
BA_ "GatewayedSignals" SG_ 967 DMS_SysErrSt 0;
BA_ "GenSigInactiveValue" SG_ 967 DMS_SysErrSt 0;
BA_ "GenSigInvalidValue" SG_ 967 DMS_SysErrSt 0;
BA_ "GenSigSendType" SG_ 967 DMS_SysErrSt 1;
BA_ "GenSigStartValue" SG_ 967 DMS_SysErrSt 0;
BA_ "GenSigTimeoutValue" SG_ 967 DMS_SysErrSt 0;
BA_ "Remark" SG_ 967 DMS_SysErrSt "";
BA_ "EventCommandSignal" SG_ 967 DMS_DrvrDetSts 0;
BA_ "GatewayedSignals" SG_ 967 DMS_DrvrDetSts 0;
BA_ "GenSigInactiveValue" SG_ 967 DMS_DrvrDetSts 0;
BA_ "GenSigInvalidValue" SG_ 967 DMS_DrvrDetSts 0;
BA_ "GenSigSendType" SG_ 967 DMS_DrvrDetSts 1;
BA_ "GenSigStartValue" SG_ 967 DMS_DrvrDetSts 0;
BA_ "GenSigTimeoutValue" SG_ 967 DMS_DrvrDetSts 0;
BA_ "Remark" SG_ 967 DMS_DrvrDetSts "";
BA_ "EventCommandSignal" SG_ 967 DMS_InterestsRegion 0;
BA_ "GatewayedSignals" SG_ 967 DMS_InterestsRegion 0;
BA_ "GenSigInactiveValue" SG_ 967 DMS_InterestsRegion 0;
BA_ "GenSigInvalidValue" SG_ 967 DMS_InterestsRegion 0;
BA_ "GenSigSendType" SG_ 967 DMS_InterestsRegion 1;
BA_ "GenSigStartValue" SG_ 967 DMS_InterestsRegion 0;
BA_ "GenSigTimeoutValue" SG_ 967 DMS_InterestsRegion 0;
BA_ "Remark" SG_ 967 DMS_InterestsRegion "";
BA_ "EventCommandSignal" SG_ 967 DMS_L3DriverDistractionSt 0;
BA_ "GatewayedSignals" SG_ 967 DMS_L3DriverDistractionSt 0;
BA_ "GenSigInactiveValue" SG_ 967 DMS_L3DriverDistractionSt 0;
BA_ "GenSigInvalidValue" SG_ 967 DMS_L3DriverDistractionSt 0;
BA_ "GenSigSendType" SG_ 967 DMS_L3DriverDistractionSt 1;
BA_ "GenSigStartValue" SG_ 967 DMS_L3DriverDistractionSt 0;
BA_ "GenSigTimeoutValue" SG_ 967 DMS_L3DriverDistractionSt 0;
BA_ "Remark" SG_ 967 DMS_L3DriverDistractionSt "";
BA_ "EventCommandSignal" SG_ 967 DMS_L3DriverFatigueSt 0;
BA_ "GatewayedSignals" SG_ 967 DMS_L3DriverFatigueSt 0;
BA_ "GenSigInactiveValue" SG_ 967 DMS_L3DriverFatigueSt 0;
BA_ "GenSigInvalidValue" SG_ 967 DMS_L3DriverFatigueSt 0;
BA_ "GenSigSendType" SG_ 967 DMS_L3DriverFatigueSt 1;
BA_ "GenSigStartValue" SG_ 967 DMS_L3DriverFatigueSt 0;
BA_ "GenSigTimeoutValue" SG_ 967 DMS_L3DriverFatigueSt 0;
BA_ "Remark" SG_ 967 DMS_L3DriverFatigueSt "";
BA_ "EventCommandSignal" SG_ 967 DMS_FaceIDStatus 0;
BA_ "GatewayedSignals" SG_ 967 DMS_FaceIDStatus 0;
BA_ "GenSigInactiveValue" SG_ 967 DMS_FaceIDStatus 0;
BA_ "GenSigInvalidValue" SG_ 967 DMS_FaceIDStatus 0;
BA_ "GenSigSendType" SG_ 967 DMS_FaceIDStatus 1;
BA_ "GenSigStartValue" SG_ 967 DMS_FaceIDStatus 0;
BA_ "GenSigTimeoutValue" SG_ 967 DMS_FaceIDStatus 0;
BA_ "Remark" SG_ 967 DMS_FaceIDStatus "";
BA_ "EventCommandSignal" SG_ 967 DMS_FaceID 0;
BA_ "GatewayedSignals" SG_ 967 DMS_FaceID 0;
BA_ "GenSigInactiveValue" SG_ 967 DMS_FaceID 0;
BA_ "GenSigInvalidValue" SG_ 967 DMS_FaceID 0;
BA_ "GenSigSendType" SG_ 967 DMS_FaceID 1;
BA_ "GenSigStartValue" SG_ 967 DMS_FaceID 0;
BA_ "GenSigTimeoutValue" SG_ 967 DMS_FaceID 0;
BA_ "Remark" SG_ 967 DMS_FaceID "";
BA_ "EventCommandSignal" SG_ 967 DMS_LeftEyeOpenSt 0;
BA_ "GatewayedSignals" SG_ 967 DMS_LeftEyeOpenSt 0;
BA_ "GenSigInactiveValue" SG_ 967 DMS_LeftEyeOpenSt 0;
BA_ "GenSigInvalidValue" SG_ 967 DMS_LeftEyeOpenSt 0;
BA_ "GenSigSendType" SG_ 967 DMS_LeftEyeOpenSt 1;
BA_ "GenSigStartValue" SG_ 967 DMS_LeftEyeOpenSt 0;
BA_ "GenSigTimeoutValue" SG_ 967 DMS_LeftEyeOpenSt 0;
BA_ "Remark" SG_ 967 DMS_LeftEyeOpenSt "";
BA_ "EventCommandSignal" SG_ 967 DMS_RightEyeOpenSt 0;
BA_ "GatewayedSignals" SG_ 967 DMS_RightEyeOpenSt 0;
BA_ "GenSigInactiveValue" SG_ 967 DMS_RightEyeOpenSt 0;
BA_ "GenSigInvalidValue" SG_ 967 DMS_RightEyeOpenSt 0;
BA_ "GenSigSendType" SG_ 967 DMS_RightEyeOpenSt 1;
BA_ "GenSigStartValue" SG_ 967 DMS_RightEyeOpenSt 0;
BA_ "GenSigTimeoutValue" SG_ 967 DMS_RightEyeOpenSt 0;
BA_ "Remark" SG_ 967 DMS_RightEyeOpenSt "";
BA_ "EventCommandSignal" SG_ 967 DMS_DriverSmokeSt 0;
BA_ "GatewayedSignals" SG_ 967 DMS_DriverSmokeSt 0;
BA_ "GenSigInactiveValue" SG_ 967 DMS_DriverSmokeSt 0;
BA_ "GenSigInvalidValue" SG_ 967 DMS_DriverSmokeSt 0;
BA_ "GenSigSendType" SG_ 967 DMS_DriverSmokeSt 1;
BA_ "GenSigStartValue" SG_ 967 DMS_DriverSmokeSt 0;
BA_ "GenSigTimeoutValue" SG_ 967 DMS_DriverSmokeSt 0;
BA_ "Remark" SG_ 967 DMS_DriverSmokeSt "";
BA_ "EventCommandSignal" SG_ 967 DMS_DriverTelephoneSt 0;
BA_ "GatewayedSignals" SG_ 967 DMS_DriverTelephoneSt 0;
BA_ "GenSigInactiveValue" SG_ 967 DMS_DriverTelephoneSt 0;
BA_ "GenSigInvalidValue" SG_ 967 DMS_DriverTelephoneSt 0;
BA_ "GenSigSendType" SG_ 967 DMS_DriverTelephoneSt 1;
BA_ "GenSigStartValue" SG_ 967 DMS_DriverTelephoneSt 0;
BA_ "GenSigTimeoutValue" SG_ 967 DMS_DriverTelephoneSt 0;
BA_ "Remark" SG_ 967 DMS_DriverTelephoneSt "";
BA_ "EventCommandSignal" SG_ 967 DMS_DriverHealthSt 0;
BA_ "GatewayedSignals" SG_ 967 DMS_DriverHealthSt 0;
BA_ "GenSigInactiveValue" SG_ 967 DMS_DriverHealthSt 0;
BA_ "GenSigInvalidValue" SG_ 967 DMS_DriverHealthSt 0;
BA_ "GenSigSendType" SG_ 967 DMS_DriverHealthSt 1;
BA_ "GenSigStartValue" SG_ 967 DMS_DriverHealthSt 0;
BA_ "GenSigTimeoutValue" SG_ 967 DMS_DriverHealthSt 0;
BA_ "Remark" SG_ 967 DMS_DriverHealthSt "";
BA_ "EventCommandSignal" SG_ 967 DMS_FatigWarnSt 0;
BA_ "GatewayedSignals" SG_ 967 DMS_FatigWarnSt 0;
BA_ "GenSigInactiveValue" SG_ 967 DMS_FatigWarnSt 0;
BA_ "GenSigInvalidValue" SG_ 967 DMS_FatigWarnSt 0;
BA_ "GenSigSendType" SG_ 967 DMS_FatigWarnSt 1;
BA_ "GenSigStartValue" SG_ 967 DMS_FatigWarnSt 0;
BA_ "GenSigTimeoutValue" SG_ 967 DMS_FatigWarnSt 0;
BA_ "Remark" SG_ 967 DMS_FatigWarnSt "";
BA_ "EventCommandSignal" SG_ 967 DMS_DistrWarnSt 0;
BA_ "GatewayedSignals" SG_ 967 DMS_DistrWarnSt 0;
BA_ "GenSigInactiveValue" SG_ 967 DMS_DistrWarnSt 0;
BA_ "GenSigInvalidValue" SG_ 967 DMS_DistrWarnSt 0;
BA_ "GenSigSendType" SG_ 967 DMS_DistrWarnSt 1;
BA_ "GenSigStartValue" SG_ 967 DMS_DistrWarnSt 0;
BA_ "GenSigTimeoutValue" SG_ 967 DMS_DistrWarnSt 0;
BA_ "Remark" SG_ 967 DMS_DistrWarnSt "";
BA_ "EventCommandSignal" SG_ 967 DMS_DriverExpressionSt 0;
BA_ "GatewayedSignals" SG_ 967 DMS_DriverExpressionSt 0;
BA_ "GenSigInactiveValue" SG_ 967 DMS_DriverExpressionSt 0;
BA_ "GenSigInvalidValue" SG_ 967 DMS_DriverExpressionSt 0;
BA_ "GenSigSendType" SG_ 967 DMS_DriverExpressionSt 1;
BA_ "GenSigStartValue" SG_ 967 DMS_DriverExpressionSt 0;
BA_ "GenSigTimeoutValue" SG_ 967 DMS_DriverExpressionSt 0;
BA_ "Remark" SG_ 967 DMS_DriverExpressionSt "";
BA_ "EventCommandSignal" SG_ 967 DMS_FaceIDVerifyResult 0;
BA_ "GatewayedSignals" SG_ 967 DMS_FaceIDVerifyResult 0;
BA_ "GenSigInactiveValue" SG_ 967 DMS_FaceIDVerifyResult 0;
BA_ "GenSigInvalidValue" SG_ 967 DMS_FaceIDVerifyResult 0;
BA_ "GenSigSendType" SG_ 967 DMS_FaceIDVerifyResult 1;
BA_ "GenSigStartValue" SG_ 967 DMS_FaceIDVerifyResult 0;
BA_ "GenSigTimeoutValue" SG_ 967 DMS_FaceIDVerifyResult 0;
BA_ "Remark" SG_ 967 DMS_FaceIDVerifyResult "";
BA_ "EventCommandSignal" SG_ 967 DMS_YawnSt 0;
BA_ "GatewayedSignals" SG_ 967 DMS_YawnSt 0;
BA_ "GenSigInactiveValue" SG_ 967 DMS_YawnSt 0;
BA_ "GenSigInvalidValue" SG_ 967 DMS_YawnSt 0;
BA_ "GenSigSendType" SG_ 967 DMS_YawnSt 1;
BA_ "GenSigStartValue" SG_ 967 DMS_YawnSt 0;
BA_ "GenSigTimeoutValue" SG_ 967 DMS_YawnSt 0;
BA_ "Remark" SG_ 967 DMS_YawnSt "";
BA_ "EventCommandSignal" SG_ 161 ACU_FaceID_Delete 1;
BA_ "GatewayedSignals" SG_ 161 ACU_FaceID_Delete 0;
BA_ "GenSigInactiveValue" SG_ 161 ACU_FaceID_Delete 0;
BA_ "GenSigInvalidValue" SG_ 161 ACU_FaceID_Delete 0;
BA_ "GenSigSendType" SG_ 161 ACU_FaceID_Delete 0;
BA_ "GenSigStartValue" SG_ 161 ACU_FaceID_Delete 0;
BA_ "GenSigTimeoutValue" SG_ 161 ACU_FaceID_Delete 0;
BA_ "Remark" SG_ 161 ACU_FaceID_Delete "";
BA_ "EventCommandSignal" SG_ 161 ACU_RegisterTriger 1;
BA_ "GatewayedSignals" SG_ 161 ACU_RegisterTriger 0;
BA_ "GenSigInactiveValue" SG_ 161 ACU_RegisterTriger 0;
BA_ "GenSigInvalidValue" SG_ 161 ACU_RegisterTriger 0;
BA_ "GenSigSendType" SG_ 161 ACU_RegisterTriger 0;
BA_ "GenSigStartValue" SG_ 161 ACU_RegisterTriger 0;
BA_ "GenSigTimeoutValue" SG_ 161 ACU_RegisterTriger 0;
BA_ "Remark" SG_ 161 ACU_RegisterTriger "";
BA_ "EventCommandSignal" SG_ 161 ACU_VerifyTriger 1;
BA_ "GatewayedSignals" SG_ 161 ACU_VerifyTriger 0;
BA_ "GenSigInactiveValue" SG_ 161 ACU_VerifyTriger 0;
BA_ "GenSigInvalidValue" SG_ 161 ACU_VerifyTriger 0;
BA_ "GenSigSendType" SG_ 161 ACU_VerifyTriger 0;
BA_ "GenSigStartValue" SG_ 161 ACU_VerifyTriger 0;
BA_ "GenSigTimeoutValue" SG_ 161 ACU_VerifyTriger 0;
BA_ "Remark" SG_ 161 ACU_VerifyTriger "";
BA_ "EventCommandSignal" SG_ 161 ACU_FaceIDQuit 1;
BA_ "GatewayedSignals" SG_ 161 ACU_FaceIDQuit 0;
BA_ "GenSigInactiveValue" SG_ 161 ACU_FaceIDQuit 0;
BA_ "GenSigInvalidValue" SG_ 161 ACU_FaceIDQuit 0;
BA_ "GenSigSendType" SG_ 161 ACU_FaceIDQuit 0;
BA_ "GenSigStartValue" SG_ 161 ACU_FaceIDQuit 0;
BA_ "GenSigTimeoutValue" SG_ 161 ACU_FaceIDQuit 0;
BA_ "Remark" SG_ 161 ACU_FaceIDQuit "";
BA_ "EventCommandSignal" SG_ 161 ACU_FaceIDSwitch 1;
BA_ "GatewayedSignals" SG_ 161 ACU_FaceIDSwitch 0;
BA_ "GenSigInactiveValue" SG_ 161 ACU_FaceIDSwitch 0;
BA_ "GenSigInvalidValue" SG_ 161 ACU_FaceIDSwitch 0;
BA_ "GenSigSendType" SG_ 161 ACU_FaceIDSwitch 0;
BA_ "GenSigStartValue" SG_ 161 ACU_FaceIDSwitch 0;
BA_ "GenSigTimeoutValue" SG_ 161 ACU_FaceIDSwitch 0;
BA_ "Remark" SG_ 161 ACU_FaceIDSwitch "";
BA_ "EventCommandSignal" SG_ 161 ACU_AVAS_SwitchCfgReq 1;
BA_ "GatewayedSignals" SG_ 161 ACU_AVAS_SwitchCfgReq 0;
BA_ "GenSigInactiveValue" SG_ 161 ACU_AVAS_SwitchCfgReq 0;
BA_ "GenSigInvalidValue" SG_ 161 ACU_AVAS_SwitchCfgReq 0;
BA_ "GenSigSendType" SG_ 161 ACU_AVAS_SwitchCfgReq 0;
BA_ "GenSigStartValue" SG_ 161 ACU_AVAS_SwitchCfgReq 0;
BA_ "GenSigTimeoutValue" SG_ 161 ACU_AVAS_SwitchCfgReq 0;
BA_ "Remark" SG_ 161 ACU_AVAS_SwitchCfgReq "";
BA_ "EventCommandSignal" SG_ 1043 TEL_Time_Year 0;
BA_ "GatewayedSignals" SG_ 1043 TEL_Time_Year 0;
BA_ "GenSigInactiveValue" SG_ 1043 TEL_Time_Year 0;
BA_ "GenSigInvalidValue" SG_ 1043 TEL_Time_Year 0;
BA_ "GenSigSendType" SG_ 1043 TEL_Time_Year 1;
BA_ "GenSigStartValue" SG_ 1043 TEL_Time_Year 15;
BA_ "GenSigTimeoutValue" SG_ 1043 TEL_Time_Year 0;
BA_ "Remark" SG_ 1043 TEL_Time_Year "";
BA_ "EventCommandSignal" SG_ 1043 TEL_Time_Month 0;
BA_ "GatewayedSignals" SG_ 1043 TEL_Time_Month 0;
BA_ "GenSigInactiveValue" SG_ 1043 TEL_Time_Month 0;
BA_ "GenSigInvalidValue" SG_ 1043 TEL_Time_Month 0;
BA_ "GenSigSendType" SG_ 1043 TEL_Time_Month 1;
BA_ "GenSigStartValue" SG_ 1043 TEL_Time_Month 1;
BA_ "GenSigTimeoutValue" SG_ 1043 TEL_Time_Month 0;
BA_ "Remark" SG_ 1043 TEL_Time_Month "";
BA_ "EventCommandSignal" SG_ 1043 TEL_Time_Hour 0;
BA_ "GatewayedSignals" SG_ 1043 TEL_Time_Hour 0;
BA_ "GenSigInactiveValue" SG_ 1043 TEL_Time_Hour 0;
BA_ "GenSigInvalidValue" SG_ 1043 TEL_Time_Hour 0;
BA_ "GenSigSendType" SG_ 1043 TEL_Time_Hour 1;
BA_ "GenSigStartValue" SG_ 1043 TEL_Time_Hour 1;
BA_ "GenSigTimeoutValue" SG_ 1043 TEL_Time_Hour 0;
BA_ "Remark" SG_ 1043 TEL_Time_Hour "";
BA_ "EventCommandSignal" SG_ 1043 TEL_Time_Day 0;
BA_ "GatewayedSignals" SG_ 1043 TEL_Time_Day 0;
BA_ "GenSigInactiveValue" SG_ 1043 TEL_Time_Day 0;
BA_ "GenSigInvalidValue" SG_ 1043 TEL_Time_Day 0;
BA_ "GenSigSendType" SG_ 1043 TEL_Time_Day 1;
BA_ "GenSigStartValue" SG_ 1043 TEL_Time_Day 1;
BA_ "GenSigTimeoutValue" SG_ 1043 TEL_Time_Day 0;
BA_ "Remark" SG_ 1043 TEL_Time_Day "";
BA_ "EventCommandSignal" SG_ 1043 TEL_Time_Min 0;
BA_ "GatewayedSignals" SG_ 1043 TEL_Time_Min 0;
BA_ "GenSigInactiveValue" SG_ 1043 TEL_Time_Min 0;
BA_ "GenSigInvalidValue" SG_ 1043 TEL_Time_Min 0;
BA_ "GenSigSendType" SG_ 1043 TEL_Time_Min 1;
BA_ "GenSigStartValue" SG_ 1043 TEL_Time_Min 1;
BA_ "GenSigTimeoutValue" SG_ 1043 TEL_Time_Min 0;
BA_ "Remark" SG_ 1043 TEL_Time_Min "";
BA_ "EventCommandSignal" SG_ 1043 TEL_Time_Sec 0;
BA_ "GatewayedSignals" SG_ 1043 TEL_Time_Sec 0;
BA_ "GenSigInactiveValue" SG_ 1043 TEL_Time_Sec 0;
BA_ "GenSigInvalidValue" SG_ 1043 TEL_Time_Sec 0;
BA_ "GenSigSendType" SG_ 1043 TEL_Time_Sec 1;
BA_ "GenSigStartValue" SG_ 1043 TEL_Time_Sec 1;
BA_ "GenSigTimeoutValue" SG_ 1043 TEL_Time_Sec 0;
BA_ "Remark" SG_ 1043 TEL_Time_Sec "";
BA_ "EventCommandSignal" SG_ 1043 TEL_TimeVD 0;
BA_ "GatewayedSignals" SG_ 1043 TEL_TimeVD 0;
BA_ "GenSigInactiveValue" SG_ 1043 TEL_TimeVD 0;
BA_ "GenSigInvalidValue" SG_ 1043 TEL_TimeVD 0;
BA_ "GenSigSendType" SG_ 1043 TEL_TimeVD 1;
BA_ "GenSigStartValue" SG_ 1043 TEL_TimeVD 0;
BA_ "GenSigTimeoutValue" SG_ 1043 TEL_TimeVD 0;
BA_ "Remark" SG_ 1043 TEL_TimeVD "";
BA_ "EventCommandSignal" SG_ 791 ZCUF_2_CRC 0;
BA_ "GatewayedSignals" SG_ 791 ZCUF_2_CRC 0;
BA_ "GenSigInactiveValue" SG_ 791 ZCUF_2_CRC 0;
BA_ "GenSigInvalidValue" SG_ 791 ZCUF_2_CRC 0;
BA_ "GenSigSendType" SG_ 791 ZCUF_2_CRC 1;
BA_ "GenSigStartValue" SG_ 791 ZCUF_2_CRC 0;
BA_ "GenSigTimeoutValue" SG_ 791 ZCUF_2_CRC 0;
BA_ "Remark" SG_ 791 ZCUF_2_CRC "";
BA_ "EventCommandSignal" SG_ 791 ZCUF_2_Counter 0;
BA_ "GatewayedSignals" SG_ 791 ZCUF_2_Counter 0;
BA_ "GenSigInactiveValue" SG_ 791 ZCUF_2_Counter 0;
BA_ "GenSigInvalidValue" SG_ 791 ZCUF_2_Counter 0;
BA_ "GenSigSendType" SG_ 791 ZCUF_2_Counter 1;
BA_ "GenSigStartValue" SG_ 791 ZCUF_2_Counter 0;
BA_ "GenSigTimeoutValue" SG_ 791 ZCUF_2_Counter 0;
BA_ "Remark" SG_ 791 ZCUF_2_Counter "";
BA_ "EventCommandSignal" SG_ 791 WW_FWPMotorSt 0;
BA_ "GatewayedSignals" SG_ 791 WW_FWPMotorSt 0;
BA_ "GenSigInactiveValue" SG_ 791 WW_FWPMotorSt 0;
BA_ "GenSigInvalidValue" SG_ 791 WW_FWPMotorSt 0;
BA_ "GenSigSendType" SG_ 791 WW_FWPMotorSt 1;
BA_ "GenSigStartValue" SG_ 791 WW_FWPMotorSt 0;
BA_ "GenSigTimeoutValue" SG_ 791 WW_FWPMotorSt 0;
BA_ "Remark" SG_ 791 WW_FWPMotorSt "";
BA_ "EventCommandSignal" SG_ 791 WW_FWSHMotorSt 0;
BA_ "GatewayedSignals" SG_ 791 WW_FWSHMotorSt 0;
BA_ "GenSigInactiveValue" SG_ 791 WW_FWSHMotorSt 0;
BA_ "GenSigInvalidValue" SG_ 791 WW_FWSHMotorSt 0;
BA_ "GenSigSendType" SG_ 791 WW_FWSHMotorSt 1;
BA_ "GenSigStartValue" SG_ 791 WW_FWSHMotorSt 0;
BA_ "GenSigTimeoutValue" SG_ 791 WW_FWSHMotorSt 0;
BA_ "Remark" SG_ 791 WW_FWSHMotorSt "";
BA_ "EventCommandSignal" SG_ 791 HRN_HornRunningSt 0;
BA_ "GatewayedSignals" SG_ 791 HRN_HornRunningSt 0;
BA_ "GenSigInactiveValue" SG_ 791 HRN_HornRunningSt 0;
BA_ "GenSigInvalidValue" SG_ 791 HRN_HornRunningSt 0;
BA_ "GenSigSendType" SG_ 791 HRN_HornRunningSt 1;
BA_ "GenSigStartValue" SG_ 791 HRN_HornRunningSt 0;
BA_ "GenSigTimeoutValue" SG_ 791 HRN_HornRunningSt 0;
BA_ "Remark" SG_ 791 HRN_HornRunningSt "";
BA_ "EventCommandSignal" SG_ 791 HRN_HornWorkingTemplet 0;
BA_ "GatewayedSignals" SG_ 791 HRN_HornWorkingTemplet 0;
BA_ "GenSigInactiveValue" SG_ 791 HRN_HornWorkingTemplet 0;
BA_ "GenSigInvalidValue" SG_ 791 HRN_HornWorkingTemplet 0;
BA_ "GenSigSendType" SG_ 791 HRN_HornWorkingTemplet 1;
BA_ "GenSigStartValue" SG_ 791 HRN_HornWorkingTemplet 0;
BA_ "GenSigTimeoutValue" SG_ 791 HRN_HornWorkingTemplet 0;
BA_ "Remark" SG_ 791 HRN_HornWorkingTemplet "";
BA_ "EventCommandSignal" SG_ 791 EL_FLPositionLightSt 0;
BA_ "GatewayedSignals" SG_ 791 EL_FLPositionLightSt 0;
BA_ "GenSigInactiveValue" SG_ 791 EL_FLPositionLightSt 0;
BA_ "GenSigInvalidValue" SG_ 791 EL_FLPositionLightSt 0;
BA_ "GenSigSendType" SG_ 791 EL_FLPositionLightSt 1;
BA_ "GenSigStartValue" SG_ 791 EL_FLPositionLightSt 0;
BA_ "GenSigTimeoutValue" SG_ 791 EL_FLPositionLightSt 0;
BA_ "Remark" SG_ 791 EL_FLPositionLightSt "";
BA_ "EventCommandSignal" SG_ 791 EL_FLPositionLightFaultSt 0;
BA_ "GatewayedSignals" SG_ 791 EL_FLPositionLightFaultSt 0;
BA_ "GenSigInactiveValue" SG_ 791 EL_FLPositionLightFaultSt 0;
BA_ "GenSigInvalidValue" SG_ 791 EL_FLPositionLightFaultSt 0;
BA_ "GenSigSendType" SG_ 791 EL_FLPositionLightFaultSt 1;
BA_ "GenSigStartValue" SG_ 791 EL_FLPositionLightFaultSt 0;
BA_ "GenSigTimeoutValue" SG_ 791 EL_FLPositionLightFaultSt 0;
BA_ "Remark" SG_ 791 EL_FLPositionLightFaultSt "";
BA_ "EventCommandSignal" SG_ 791 EL_FRPositionLightSt 0;
BA_ "GatewayedSignals" SG_ 791 EL_FRPositionLightSt 0;
BA_ "GenSigInactiveValue" SG_ 791 EL_FRPositionLightSt 0;
BA_ "GenSigInvalidValue" SG_ 791 EL_FRPositionLightSt 0;
BA_ "GenSigSendType" SG_ 791 EL_FRPositionLightSt 1;
BA_ "GenSigStartValue" SG_ 791 EL_FRPositionLightSt 0;
BA_ "GenSigTimeoutValue" SG_ 791 EL_FRPositionLightSt 0;
BA_ "Remark" SG_ 791 EL_FRPositionLightSt "";
BA_ "EventCommandSignal" SG_ 791 EL_FRPositionLightFaultSt 0;
BA_ "GatewayedSignals" SG_ 791 EL_FRPositionLightFaultSt 0;
BA_ "GenSigInactiveValue" SG_ 791 EL_FRPositionLightFaultSt 0;
BA_ "GenSigInvalidValue" SG_ 791 EL_FRPositionLightFaultSt 0;
BA_ "GenSigSendType" SG_ 791 EL_FRPositionLightFaultSt 1;
BA_ "GenSigStartValue" SG_ 791 EL_FRPositionLightFaultSt 0;
BA_ "GenSigTimeoutValue" SG_ 791 EL_FRPositionLightFaultSt 0;
BA_ "Remark" SG_ 791 EL_FRPositionLightFaultSt "";
BA_ "EventCommandSignal" SG_ 791 EL_LeftLowBeamSt 0;
BA_ "GatewayedSignals" SG_ 791 EL_LeftLowBeamSt 0;
BA_ "GenSigInactiveValue" SG_ 791 EL_LeftLowBeamSt 0;
BA_ "GenSigInvalidValue" SG_ 791 EL_LeftLowBeamSt 0;
BA_ "GenSigSendType" SG_ 791 EL_LeftLowBeamSt 1;
BA_ "GenSigStartValue" SG_ 791 EL_LeftLowBeamSt 0;
BA_ "GenSigTimeoutValue" SG_ 791 EL_LeftLowBeamSt 0;
BA_ "Remark" SG_ 791 EL_LeftLowBeamSt "";
BA_ "EventCommandSignal" SG_ 791 EL_LeftLowBeamFaultSt 0;
BA_ "GatewayedSignals" SG_ 791 EL_LeftLowBeamFaultSt 0;
BA_ "GenSigInactiveValue" SG_ 791 EL_LeftLowBeamFaultSt 0;
BA_ "GenSigInvalidValue" SG_ 791 EL_LeftLowBeamFaultSt 0;
BA_ "GenSigSendType" SG_ 791 EL_LeftLowBeamFaultSt 1;
BA_ "GenSigStartValue" SG_ 791 EL_LeftLowBeamFaultSt 0;
BA_ "GenSigTimeoutValue" SG_ 791 EL_LeftLowBeamFaultSt 0;
BA_ "Remark" SG_ 791 EL_LeftLowBeamFaultSt "";
BA_ "EventCommandSignal" SG_ 791 EL_RightLowBeamSt 0;
BA_ "GatewayedSignals" SG_ 791 EL_RightLowBeamSt 0;
BA_ "GenSigInactiveValue" SG_ 791 EL_RightLowBeamSt 0;
BA_ "GenSigInvalidValue" SG_ 791 EL_RightLowBeamSt 0;
BA_ "GenSigSendType" SG_ 791 EL_RightLowBeamSt 1;
BA_ "GenSigStartValue" SG_ 791 EL_RightLowBeamSt 0;
BA_ "GenSigTimeoutValue" SG_ 791 EL_RightLowBeamSt 0;
BA_ "Remark" SG_ 791 EL_RightLowBeamSt "";
BA_ "EventCommandSignal" SG_ 791 EL_RightLowBeamFaultSt 0;
BA_ "GatewayedSignals" SG_ 791 EL_RightLowBeamFaultSt 0;
BA_ "GenSigInactiveValue" SG_ 791 EL_RightLowBeamFaultSt 0;
BA_ "GenSigInvalidValue" SG_ 791 EL_RightLowBeamFaultSt 0;
BA_ "GenSigSendType" SG_ 791 EL_RightLowBeamFaultSt 1;
BA_ "GenSigStartValue" SG_ 791 EL_RightLowBeamFaultSt 0;
BA_ "GenSigTimeoutValue" SG_ 791 EL_RightLowBeamFaultSt 0;
BA_ "Remark" SG_ 791 EL_RightLowBeamFaultSt "";
BA_ "EventCommandSignal" SG_ 791 EL_LeftHighBeamSt 0;
BA_ "GatewayedSignals" SG_ 791 EL_LeftHighBeamSt 0;
BA_ "GenSigInactiveValue" SG_ 791 EL_LeftHighBeamSt 0;
BA_ "GenSigInvalidValue" SG_ 791 EL_LeftHighBeamSt 0;
BA_ "GenSigSendType" SG_ 791 EL_LeftHighBeamSt 1;
BA_ "GenSigStartValue" SG_ 791 EL_LeftHighBeamSt 0;
BA_ "GenSigTimeoutValue" SG_ 791 EL_LeftHighBeamSt 0;
BA_ "Remark" SG_ 791 EL_LeftHighBeamSt "";
BA_ "EventCommandSignal" SG_ 791 EL_LeftHighBeamFaultSt 0;
BA_ "GatewayedSignals" SG_ 791 EL_LeftHighBeamFaultSt 0;
BA_ "GenSigInactiveValue" SG_ 791 EL_LeftHighBeamFaultSt 0;
BA_ "GenSigInvalidValue" SG_ 791 EL_LeftHighBeamFaultSt 0;
BA_ "GenSigSendType" SG_ 791 EL_LeftHighBeamFaultSt 1;
BA_ "GenSigStartValue" SG_ 791 EL_LeftHighBeamFaultSt 0;
BA_ "GenSigTimeoutValue" SG_ 791 EL_LeftHighBeamFaultSt 0;
BA_ "Remark" SG_ 791 EL_LeftHighBeamFaultSt "";
BA_ "EventCommandSignal" SG_ 791 EL_RightHighBeamSt 0;
BA_ "GatewayedSignals" SG_ 791 EL_RightHighBeamSt 0;
BA_ "GenSigInactiveValue" SG_ 791 EL_RightHighBeamSt 0;
BA_ "GenSigInvalidValue" SG_ 791 EL_RightHighBeamSt 0;
BA_ "GenSigSendType" SG_ 791 EL_RightHighBeamSt 1;
BA_ "GenSigStartValue" SG_ 791 EL_RightHighBeamSt 0;
BA_ "GenSigTimeoutValue" SG_ 791 EL_RightHighBeamSt 0;
BA_ "Remark" SG_ 791 EL_RightHighBeamSt "";
BA_ "EventCommandSignal" SG_ 791 EL_RightHighBeamFaultSt 0;
BA_ "GatewayedSignals" SG_ 791 EL_RightHighBeamFaultSt 0;
BA_ "GenSigInactiveValue" SG_ 791 EL_RightHighBeamFaultSt 0;
BA_ "GenSigInvalidValue" SG_ 791 EL_RightHighBeamFaultSt 0;
BA_ "GenSigSendType" SG_ 791 EL_RightHighBeamFaultSt 1;
BA_ "GenSigStartValue" SG_ 791 EL_RightHighBeamFaultSt 0;
BA_ "GenSigTimeoutValue" SG_ 791 EL_RightHighBeamFaultSt 0;
BA_ "Remark" SG_ 791 EL_RightHighBeamFaultSt "";
BA_ "EventCommandSignal" SG_ 791 EL_FLFogLightSt 0;
BA_ "GatewayedSignals" SG_ 791 EL_FLFogLightSt 0;
BA_ "GenSigInactiveValue" SG_ 791 EL_FLFogLightSt 0;
BA_ "GenSigInvalidValue" SG_ 791 EL_FLFogLightSt 0;
BA_ "GenSigSendType" SG_ 791 EL_FLFogLightSt 1;
BA_ "GenSigStartValue" SG_ 791 EL_FLFogLightSt 0;
BA_ "GenSigTimeoutValue" SG_ 791 EL_FLFogLightSt 0;
BA_ "Remark" SG_ 791 EL_FLFogLightSt "";
BA_ "EventCommandSignal" SG_ 791 EL_FLFogLightFaultSt 0;
BA_ "GatewayedSignals" SG_ 791 EL_FLFogLightFaultSt 0;
BA_ "GenSigInactiveValue" SG_ 791 EL_FLFogLightFaultSt 0;
BA_ "GenSigInvalidValue" SG_ 791 EL_FLFogLightFaultSt 0;
BA_ "GenSigSendType" SG_ 791 EL_FLFogLightFaultSt 1;
BA_ "GenSigStartValue" SG_ 791 EL_FLFogLightFaultSt 0;
BA_ "GenSigTimeoutValue" SG_ 791 EL_FLFogLightFaultSt 0;
BA_ "Remark" SG_ 791 EL_FLFogLightFaultSt "";
BA_ "EventCommandSignal" SG_ 791 EL_FRFogLightSt 0;
BA_ "GatewayedSignals" SG_ 791 EL_FRFogLightSt 0;
BA_ "GenSigInactiveValue" SG_ 791 EL_FRFogLightSt 0;
BA_ "GenSigInvalidValue" SG_ 791 EL_FRFogLightSt 0;
BA_ "GenSigSendType" SG_ 791 EL_FRFogLightSt 1;
BA_ "GenSigStartValue" SG_ 791 EL_FRFogLightSt 0;
BA_ "GenSigTimeoutValue" SG_ 791 EL_FRFogLightSt 0;
BA_ "Remark" SG_ 791 EL_FRFogLightSt "";
BA_ "EventCommandSignal" SG_ 791 EL_FRFogLightFaultSt 0;
BA_ "GatewayedSignals" SG_ 791 EL_FRFogLightFaultSt 0;
BA_ "GenSigInactiveValue" SG_ 791 EL_FRFogLightFaultSt 0;
BA_ "GenSigInvalidValue" SG_ 791 EL_FRFogLightFaultSt 0;
BA_ "GenSigSendType" SG_ 791 EL_FRFogLightFaultSt 1;
BA_ "GenSigStartValue" SG_ 791 EL_FRFogLightFaultSt 0;
BA_ "GenSigTimeoutValue" SG_ 791 EL_FRFogLightFaultSt 0;
BA_ "Remark" SG_ 791 EL_FRFogLightFaultSt "";
BA_ "EventCommandSignal" SG_ 791 EL_LeftDRLSt 0;
BA_ "GatewayedSignals" SG_ 791 EL_LeftDRLSt 0;
BA_ "GenSigInactiveValue" SG_ 791 EL_LeftDRLSt 0;
BA_ "GenSigInvalidValue" SG_ 791 EL_LeftDRLSt 0;
BA_ "GenSigSendType" SG_ 791 EL_LeftDRLSt 1;
BA_ "GenSigStartValue" SG_ 791 EL_LeftDRLSt 0;
BA_ "GenSigTimeoutValue" SG_ 791 EL_LeftDRLSt 0;
BA_ "Remark" SG_ 791 EL_LeftDRLSt "";
BA_ "EventCommandSignal" SG_ 791 EL_LeftDRLFaultSt 0;
BA_ "GatewayedSignals" SG_ 791 EL_LeftDRLFaultSt 0;
BA_ "GenSigInactiveValue" SG_ 791 EL_LeftDRLFaultSt 0;
BA_ "GenSigInvalidValue" SG_ 791 EL_LeftDRLFaultSt 0;
BA_ "GenSigSendType" SG_ 791 EL_LeftDRLFaultSt 1;
BA_ "GenSigStartValue" SG_ 791 EL_LeftDRLFaultSt 0;
BA_ "GenSigTimeoutValue" SG_ 791 EL_LeftDRLFaultSt 0;
BA_ "Remark" SG_ 791 EL_LeftDRLFaultSt "";
BA_ "EventCommandSignal" SG_ 791 EL_RightDRLSt 0;
BA_ "GatewayedSignals" SG_ 791 EL_RightDRLSt 0;
BA_ "GenSigInactiveValue" SG_ 791 EL_RightDRLSt 0;
BA_ "GenSigInvalidValue" SG_ 791 EL_RightDRLSt 0;
BA_ "GenSigSendType" SG_ 791 EL_RightDRLSt 1;
BA_ "GenSigStartValue" SG_ 791 EL_RightDRLSt 0;
BA_ "GenSigTimeoutValue" SG_ 791 EL_RightDRLSt 0;
BA_ "Remark" SG_ 791 EL_RightDRLSt "";
BA_ "EventCommandSignal" SG_ 791 EL_RightDRLFaultSt 0;
BA_ "GatewayedSignals" SG_ 791 EL_RightDRLFaultSt 0;
BA_ "GenSigInactiveValue" SG_ 791 EL_RightDRLFaultSt 0;
BA_ "GenSigInvalidValue" SG_ 791 EL_RightDRLFaultSt 0;
BA_ "GenSigSendType" SG_ 791 EL_RightDRLFaultSt 1;
BA_ "GenSigStartValue" SG_ 791 EL_RightDRLFaultSt 0;
BA_ "GenSigTimeoutValue" SG_ 791 EL_RightDRLFaultSt 0;
BA_ "Remark" SG_ 791 EL_RightDRLFaultSt "";
BA_ "EventCommandSignal" SG_ 791 EL_FLTurnLightSt 0;
BA_ "GatewayedSignals" SG_ 791 EL_FLTurnLightSt 0;
BA_ "GenSigInactiveValue" SG_ 791 EL_FLTurnLightSt 0;
BA_ "GenSigInvalidValue" SG_ 791 EL_FLTurnLightSt 0;
BA_ "GenSigSendType" SG_ 791 EL_FLTurnLightSt 1;
BA_ "GenSigStartValue" SG_ 791 EL_FLTurnLightSt 0;
BA_ "GenSigTimeoutValue" SG_ 791 EL_FLTurnLightSt 0;
BA_ "Remark" SG_ 791 EL_FLTurnLightSt "";
BA_ "EventCommandSignal" SG_ 791 EL_FLTurnLightFaultSt 0;
BA_ "GatewayedSignals" SG_ 791 EL_FLTurnLightFaultSt 0;
BA_ "GenSigInactiveValue" SG_ 791 EL_FLTurnLightFaultSt 0;
BA_ "GenSigInvalidValue" SG_ 791 EL_FLTurnLightFaultSt 0;
BA_ "GenSigSendType" SG_ 791 EL_FLTurnLightFaultSt 1;
BA_ "GenSigStartValue" SG_ 791 EL_FLTurnLightFaultSt 0;
BA_ "GenSigTimeoutValue" SG_ 791 EL_FLTurnLightFaultSt 0;
BA_ "Remark" SG_ 791 EL_FLTurnLightFaultSt "";
BA_ "EventCommandSignal" SG_ 791 EL_FRTurnLightSt 0;
BA_ "GatewayedSignals" SG_ 791 EL_FRTurnLightSt 0;
BA_ "GenSigInactiveValue" SG_ 791 EL_FRTurnLightSt 0;
BA_ "GenSigInvalidValue" SG_ 791 EL_FRTurnLightSt 0;
BA_ "GenSigSendType" SG_ 791 EL_FRTurnLightSt 1;
BA_ "GenSigStartValue" SG_ 791 EL_FRTurnLightSt 0;
BA_ "GenSigTimeoutValue" SG_ 791 EL_FRTurnLightSt 0;
BA_ "Remark" SG_ 791 EL_FRTurnLightSt "";
BA_ "EventCommandSignal" SG_ 791 EL_FRTurnLightFaultSt 0;
BA_ "GatewayedSignals" SG_ 791 EL_FRTurnLightFaultSt 0;
BA_ "GenSigInactiveValue" SG_ 791 EL_FRTurnLightFaultSt 0;
BA_ "GenSigInvalidValue" SG_ 791 EL_FRTurnLightFaultSt 0;
BA_ "GenSigSendType" SG_ 791 EL_FRTurnLightFaultSt 1;
BA_ "GenSigStartValue" SG_ 791 EL_FRTurnLightFaultSt 0;
BA_ "GenSigTimeoutValue" SG_ 791 EL_FRTurnLightFaultSt 0;
BA_ "Remark" SG_ 791 EL_FRTurnLightFaultSt "";
BA_ "EventCommandSignal" SG_ 791 WW_RWSHMotorSt 0;
BA_ "GatewayedSignals" SG_ 791 WW_RWSHMotorSt 0;
BA_ "GenSigInactiveValue" SG_ 791 WW_RWSHMotorSt 0;
BA_ "GenSigInvalidValue" SG_ 791 WW_RWSHMotorSt 0;
BA_ "GenSigSendType" SG_ 791 WW_RWSHMotorSt 1;
BA_ "GenSigStartValue" SG_ 791 WW_RWSHMotorSt 0;
BA_ "GenSigTimeoutValue" SG_ 791 WW_RWSHMotorSt 0;
BA_ "Remark" SG_ 791 WW_RWSHMotorSt "";
BA_ "EventCommandSignal" SG_ 791 EL_FADASLightSt 0;
BA_ "GatewayedSignals" SG_ 791 EL_FADASLightSt 0;
BA_ "GenSigInactiveValue" SG_ 791 EL_FADASLightSt 0;
BA_ "GenSigInvalidValue" SG_ 791 EL_FADASLightSt 0;
BA_ "GenSigSendType" SG_ 791 EL_FADASLightSt 1;
BA_ "GenSigStartValue" SG_ 791 EL_FADASLightSt 0;
BA_ "GenSigTimeoutValue" SG_ 791 EL_FADASLightSt 0;
BA_ "Remark" SG_ 791 EL_FADASLightSt "";
BA_ "EventCommandSignal" SG_ 791 EBSF_BattVolt 0;
BA_ "GatewayedSignals" SG_ 791 EBSF_BattVolt 0;
BA_ "GenSigInactiveValue" SG_ 791 EBSF_BattVolt 0;
BA_ "GenSigInvalidValue" SG_ 791 EBSF_BattVolt 0;
BA_ "GenSigSendType" SG_ 791 EBSF_BattVolt 1;
BA_ "GenSigStartValue" SG_ 791 EBSF_BattVolt 16383;
BA_ "GenSigTimeoutValue" SG_ 791 EBSF_BattVolt 0;
BA_ "Remark" SG_ 791 EBSF_BattVolt "";
BA_ "EventCommandSignal" SG_ 791 EBSF_CurrentRange 0;
BA_ "GatewayedSignals" SG_ 791 EBSF_CurrentRange 0;
BA_ "GenSigInactiveValue" SG_ 791 EBSF_CurrentRange 0;
BA_ "GenSigInvalidValue" SG_ 791 EBSF_CurrentRange 0;
BA_ "GenSigSendType" SG_ 791 EBSF_CurrentRange 1;
BA_ "GenSigStartValue" SG_ 791 EBSF_CurrentRange 3;
BA_ "GenSigTimeoutValue" SG_ 791 EBSF_CurrentRange 0;
BA_ "Remark" SG_ 791 EBSF_CurrentRange "";
BA_ "EventCommandSignal" SG_ 791 EBSF_BattCurrent 0;
BA_ "GatewayedSignals" SG_ 791 EBSF_BattCurrent 0;
BA_ "GenSigInactiveValue" SG_ 791 EBSF_BattCurrent 0;
BA_ "GenSigInvalidValue" SG_ 791 EBSF_BattCurrent 0;
BA_ "GenSigSendType" SG_ 791 EBSF_BattCurrent 1;
BA_ "GenSigStartValue" SG_ 791 EBSF_BattCurrent 65535;
BA_ "GenSigTimeoutValue" SG_ 791 EBSF_BattCurrent 0;
BA_ "Remark" SG_ 791 EBSF_BattCurrent "";
BA_ "EventCommandSignal" SG_ 791 EBSF_SOC 0;
BA_ "GatewayedSignals" SG_ 791 EBSF_SOC 0;
BA_ "GenSigInactiveValue" SG_ 791 EBSF_SOC 0;
BA_ "GenSigInvalidValue" SG_ 791 EBSF_SOC 0;
BA_ "GenSigSendType" SG_ 791 EBSF_SOC 1;
BA_ "GenSigStartValue" SG_ 791 EBSF_SOC 255;
BA_ "GenSigTimeoutValue" SG_ 791 EBSF_SOC 0;
BA_ "Remark" SG_ 791 EBSF_SOC "";
BA_ "EventCommandSignal" SG_ 791 EBSF_SOC_STATE 0;
BA_ "GatewayedSignals" SG_ 791 EBSF_SOC_STATE 0;
BA_ "GenSigInactiveValue" SG_ 791 EBSF_SOC_STATE 0;
BA_ "GenSigInvalidValue" SG_ 791 EBSF_SOC_STATE 0;
BA_ "GenSigSendType" SG_ 791 EBSF_SOC_STATE 1;
BA_ "GenSigStartValue" SG_ 791 EBSF_SOC_STATE 3;
BA_ "GenSigTimeoutValue" SG_ 791 EBSF_SOC_STATE 0;
BA_ "Remark" SG_ 791 EBSF_SOC_STATE "";
BA_ "EventCommandSignal" SG_ 913 CCU_GwMsg_L3_CRC 0;
BA_ "GatewayedSignals" SG_ 913 CCU_GwMsg_L3_CRC 0;
BA_ "GenSigInactiveValue" SG_ 913 CCU_GwMsg_L3_CRC 0;
BA_ "GenSigInvalidValue" SG_ 913 CCU_GwMsg_L3_CRC 0;
BA_ "GenSigSendType" SG_ 913 CCU_GwMsg_L3_CRC 1;
BA_ "GenSigStartValue" SG_ 913 CCU_GwMsg_L3_CRC 0;
BA_ "GenSigTimeoutValue" SG_ 913 CCU_GwMsg_L3_CRC 0;
BA_ "Remark" SG_ 913 CCU_GwMsg_L3_CRC "";
BA_ "EventCommandSignal" SG_ 913 CCU_GwMsg_L3_Counter 0;
BA_ "GatewayedSignals" SG_ 913 CCU_GwMsg_L3_Counter 0;
BA_ "GenSigInactiveValue" SG_ 913 CCU_GwMsg_L3_Counter 0;
BA_ "GenSigInvalidValue" SG_ 913 CCU_GwMsg_L3_Counter 0;
BA_ "GenSigSendType" SG_ 913 CCU_GwMsg_L3_Counter 1;
BA_ "GenSigStartValue" SG_ 913 CCU_GwMsg_L3_Counter 0;
BA_ "GenSigTimeoutValue" SG_ 913 CCU_GwMsg_L3_Counter 0;
BA_ "Remark" SG_ 913 CCU_GwMsg_L3_Counter "";
BA_ "EventCommandSignal" SG_ 913 IL_PADS_LightbarSt 0;
BA_ "GatewayedSignals" SG_ 913 IL_PADS_LightbarSt 0;
BA_ "GenSigInactiveValue" SG_ 913 IL_PADS_LightbarSt 0;
BA_ "GenSigInvalidValue" SG_ 913 IL_PADS_LightbarSt 0;
BA_ "GenSigSendType" SG_ 913 IL_PADS_LightbarSt 1;
BA_ "GenSigStartValue" SG_ 913 IL_PADS_LightbarSt 0;
BA_ "GenSigTimeoutValue" SG_ 913 IL_PADS_LightbarSt 15;
BA_ "Remark" SG_ 913 IL_PADS_LightbarSt "";
BA_ "EventCommandSignal" SG_ 913 IL_PADS_LightbarErrSt 0;
BA_ "GatewayedSignals" SG_ 913 IL_PADS_LightbarErrSt 0;
BA_ "GenSigInactiveValue" SG_ 913 IL_PADS_LightbarErrSt 0;
BA_ "GenSigInvalidValue" SG_ 913 IL_PADS_LightbarErrSt 0;
BA_ "GenSigSendType" SG_ 913 IL_PADS_LightbarErrSt 1;
BA_ "GenSigStartValue" SG_ 913 IL_PADS_LightbarErrSt 0;
BA_ "GenSigTimeoutValue" SG_ 913 IL_PADS_LightbarErrSt 0;
BA_ "Remark" SG_ 913 IL_PADS_LightbarErrSt "";
BA_ "EventCommandSignal" SG_ 913 UINM_PADS_L3SWSt 0;
BA_ "GatewayedSignals" SG_ 913 UINM_PADS_L3SWSt 0;
BA_ "GenSigInactiveValue" SG_ 913 UINM_PADS_L3SWSt 0;
BA_ "GenSigInvalidValue" SG_ 913 UINM_PADS_L3SWSt 0;
BA_ "GenSigSendType" SG_ 913 UINM_PADS_L3SWSt 1;
BA_ "GenSigStartValue" SG_ 913 UINM_PADS_L3SWSt 0;
BA_ "GenSigTimeoutValue" SG_ 913 UINM_PADS_L3SWSt 0;
BA_ "Remark" SG_ 913 UINM_PADS_L3SWSt "";
BA_ "EventCommandSignal" SG_ 913 UINM_PADS_L3SWStVD 0;
BA_ "GatewayedSignals" SG_ 913 UINM_PADS_L3SWStVD 0;
BA_ "GenSigInactiveValue" SG_ 913 UINM_PADS_L3SWStVD 0;
BA_ "GenSigInvalidValue" SG_ 913 UINM_PADS_L3SWStVD 0;
BA_ "GenSigSendType" SG_ 913 UINM_PADS_L3SWStVD 1;
BA_ "GenSigStartValue" SG_ 913 UINM_PADS_L3SWStVD 0;
BA_ "GenSigTimeoutValue" SG_ 913 UINM_PADS_L3SWStVD 0;
BA_ "Remark" SG_ 913 UINM_PADS_L3SWStVD "";
BA_ "EventCommandSignal" SG_ 913 UINM_PADS_L3SWStuckSt 0;
BA_ "GatewayedSignals" SG_ 913 UINM_PADS_L3SWStuckSt 0;
BA_ "GenSigInactiveValue" SG_ 913 UINM_PADS_L3SWStuckSt 0;
BA_ "GenSigInvalidValue" SG_ 913 UINM_PADS_L3SWStuckSt 0;
BA_ "GenSigSendType" SG_ 913 UINM_PADS_L3SWStuckSt 1;
BA_ "GenSigStartValue" SG_ 913 UINM_PADS_L3SWStuckSt 0;
BA_ "GenSigTimeoutValue" SG_ 913 UINM_PADS_L3SWStuckSt 0;
BA_ "Remark" SG_ 913 UINM_PADS_L3SWStuckSt "";
VAL_ 780 ACU_ISARoadTyp 0 "unknown" 1 "High way" 2 "National road" 3 "Provincial road" 4 "County road" 5 "Village road" 6 "City express way" 7 "Major urban road" 8 "Secondary urban road" 9 "Normal urban road" 10 "Non-Navigation Road" 11 "Ramp" 12 "Residential" 13 "Inter-Urban" 14 "Reserved" 15 "Reserved"  ;
VAL_ 780 ACU_ISARoadSpdLimit 0 "UnknownSPL" 1 "SPL5" 2 "SPL10" 3 "SPL15" 4 "SPL20" 29 "SPL145" 30 "SPL150" 255 "UnLimited"  ;
VAL_ 780 ACU_ISASpdLimitUnit 0 "Invalid" 1 "KPH" 2 "MPH" 3 "Reserved"  ;
VAL_ 780 ACU_ISASpdLimitTyp 0 "Invalid" 1 "Explicit" 2 "Implicit" 3 "Reserved"  ;
VAL_ 780 ACU_ISARampTyp 0 "Invalid" 1 "HW to HW" 2 "HW to NonHW" 3 "HW to ServiceArea"  ;
VAL_ 780 ACU_ISACondSpdLimit 0 "UnknownSPL" 1 "SPL5" 2 "SPL10" 3 "SPL15" 4 "SPL20" 29 "SPL145" 30 "SPL150" 255 "UnLimited"  ;
VAL_ 780 ACU_ISACondSpdLimitTyp 0 "Default" 1 "TIME" 2 "DISTANCE" 3 "RAIN" 4 "SNOW" 5 "FOG" 6 "VEHICLE" 7 "TRAILER" 8 "ARROW"  ;
VAL_ 780 ACU_ISACondSpdLimitVd 0 "Default" 1 "YES" 2 "NO" 3 "Reserved"  ;
VAL_ 780 ACU_ISASupplierInfo 0 "Default" 1 "高德" 2 "百度" 3 "腾讯" 4 "四维" 5 "Neusoft" 6 "泰为" 7 "梦擎" 8 "Here" 9 "Tomtom" 10 "Reserved" 11 "Reserved" 12 "Reserved" 13 "Reserved" 14 "Reserved" 15 "Reserved"  ;
VAL_ 780 ACU_ISAServiceWorkSt 0 "Not available" 1 "Normal" 2 "GPS week" 3 "No map data" 4 "ISA-APK Fault" 5 "Reserved" 6 "Reserved" 7 "Reserved"  ;
VAL_ 163 ACU_RAEBcfg 0 "No request" 1 "Off" 2 "On"  ;
VAL_ 163 ACU_PAAMode 0 "No Request；" 1 "APA" 2 "RPA" 3 "HPA" 4 "AVP" 5 "RA" 6 "Customer Slot" 7 "PAA" 8 "APA OFF；" 9 "PAA OFF；" 10 "RA OFF；" 11 "DP" 12 "SteeringParkingButton"  ;
VAL_ 163 ACU_SVM_Button 0 "No request" 1 "Request"  ;
VAL_ 163 ACU_PCS_MirrorpagedownButtonST 0 "Off" 1 "On"  ;
VAL_ 163 ACU_PCS_ScreenTouchSt 0 "No command" 1 "Press" 2 "Release" 3 "Slither"  ;
VAL_ 163 ACU_LanguageTypeSet 0 "Not used" 1 "Chinese" 2 "English" 3 "Russian" 4 "Arabic" 5 "Latin Spanish" 6 "Thai" 7 "Norwegian" 8 "HK" 9 "Indonesian" 10 "Melayu" 11 "Vietnamese" 12 "Deutsch" 13 "French" 14 "Italian" 15 "Spanish" 16 "Dutch" 17 "Swedish" 18 "Portuguese" 19 "Brazilian Portuguese"  ;
VAL_ 163 ACU_PCS_SVM_FunctionCmd 0 "No command" 1 "HMI in transition(SVM)" 2 "Surround view and Front view(SVM)" 3 "Enlarge front view(SVM)" 4 "Surround view and Rear view(SVM)" 5 "Enlarge rear view(SVM)" 6 "Left blind spot view (SVM)" 7 "Right blind spot view(SVM)" 8 "Parking guidance view(SVM)" 9 "Parallel parking view(SVM)" 10 "Vertical parking view(SVM)" 11 "Rear view(RVM)" 12 "Parallel parking view(RVM)" 13 "Vertical parking view(RVM)" 14 "Not used" 15 "Request to cancel"  ;
VAL_ 163 ACU_PCS_ScreenCoordY 0 "No command"  ;
VAL_ 163 ACU_PCS_ScreenCoordX 0 "No command"  ;
VAL_ 163 ACU_APAMessageSt 0 "No Command" 1 "Show" 2 "Auto close" 3 "Maual close" 4 "Manual active"  ;
VAL_ 163 ACU_PAS_ButtonPress 0 "Not press" 1 "Press"  ;
VAL_ 163 ACU_HPAMessageSt 0 "None" 1 "Show" 2 "Auto close" 3 "Maual close" 4 "Maual Active"  ;
VAL_ 163 ACU_AVPMessageSt 0 "None" 1 "Show" 2 "Auto close" 3 "Maual close" 4 "Maual Active"  ;
VAL_ 163 ACU_HPALearningSetParkLot 0 "Invalid" 1 "Fixed parking lot" 2 "Random parking lot" 3 "Reserved"  ;
VAL_ 163 ACU_HPALearningProcessInfo 0 "No text" 1 "Set path starting point" 2 "Speed high" 3 "Starting point invalid" 4 "Continue driving" 5 "Distance limit" 6 "Exceed learning distance limit" 7 "Automatic parking in" 8 "Saving path" 9 "Learning path invalid_Reserved" 10 "Setting path name" 11 "Learning path valid_Reserved" 12 "Fixed or random parking lot" 13 "Learning finished" 14 "Keep drving to ending" 15 "Setting path ending" 15 "Setting path ending" 17 "Learning path failed" 18 "Speed higher than 15km/h" 19 "Speed higher than 20km/h and quit" 20 "Reserved" 21 "Reserved" 22 "Reserved" 23 "Reserved" 24 "Reserved" 25 "Reserved" 26 "Reserved" 27 "Reserved" 28 "Reserved" 29 "Reserved" 30 "Reserved" 31 "Reserved"  ;
VAL_ 163 ACU_SDEnterParkingLot 0 "No Request" 1 "Not enter" 2 "Entered" 3 "Unknown"  ;
VAL_ 163 ACU_PCS_ER_QuitConfirm 0 "No command" 1 "Command"  ;
VAL_ 163 ACU_DisplayReq 0 "No command" 1 "On" 2 "Off"  ;
VAL_ 163 ACU_ER_FuncCfg 0 "No command" 1 "On" 2 "Off"  ;
VAL_ 163 ACU_PCS_ER_EnterCmd 0 "No command" 1 "Command"  ;
VAL_ 163 ACU_PCS_ScreenTouchSignal 0 "No command" 1 "press" 2 "Release" 3 "Slither"  ;
VAL_ 163 ACU_DPMessageSt 0 "No Command" 1 "Show" 2 "Auto close" 3 "Maual close" 4 "Manual active"  ;
VAL_ 163 ACU_ParkingBoxMidX 0 "No command"  ;
VAL_ 163 ACU_ParkingBoxMidY 0 "No command"  ;
VAL_ 163 ACU_LowPowerConfig 0 "No command" 1 "LowPower Mode Requst" 2 "Normal Mode Request" 3 "ModeChaging"  ;
VAL_ 163 ACU_PCSModeSt 0 "Normal mode" 1 "Quick start mode;"  ;
VAL_ 163 ACU_PCSModeSt_A 0 "No command;" 1 "Quick start mode;" 2 "Normal mode"  ;
VAL_ 163 ACU_ParkingBoxAngle 0 "No command"  ;
VAL_ 163 IDC_APAParkingSpdsSfg 0 "No Request;" 1 "SlowReq" 2 "MiddleReq" 3 "HighReq"  ;
VAL_ 163 IDC_DskScreenOperationSt 0 "Not Operating" 1 "Operating"  ;
VAL_ 163 IDC_SenslesEtyParkingSwSt 0 "Not request" 1 "OFF" 2 "ON"  ;
VAL_ 163 ACU_NDAVoicePromptTypeCfg 0 "Not selected" 1 "simple" 2 "full" 3 "Not used"  ;
VAL_ 163 IDC_SenslesEtyParkingDskScene 0 "None;" 1 "VehicleModeScene" 2 "NaviScene" 3 "WallpaperScene" 7 "OthersScene"  ;
VAL_ 163 ACU_VR_APAControl 0 "No Request；" 1 "APA自动泊车功能；" 2 "RPA遥控泊车功能；" 3 "HPA记忆泊车功能；" 4 "AVP代客泊车功能；" 5 "RA倒车寻迹功能；" 6 "Customer Slot 自选车位功能；" 7 "AVM 全景影像；" 8 "OFF泊车关闭/退出；" 9 "StartParking开始/继续泊车；" 10 "Pause泊车暂停；"  ;
VAL_ 163 ACU_SteeringPrkgButton 0 "No Request；" 1 "APA自动泊车功能；" 2 "RPA遥控泊车功能；" 3 "HPA记忆泊车功能；" 4 "AVP代客泊车功能；" 5 "RA倒车寻迹功能；" 6 "Customer Slot 自选车位功能；" 7 "AVM 全景影像；"  ;
VAL_ 163 ACU_ActiveNDAMessageSt 0 "No command" 1 "Active" 2 "Auto close" 3 "Manuel close" 4 "Manuel confirm"  ;
VAL_ 163 ACU_ActiveAVPMessageSt 0 "No command" 1 "Active" 2 "Auto close" 3 "Manuel close" 4 "Manuel confirm"  ;
VAL_ 163 ACU_LeftLaneChangeMessageSt 0 "No command" 1 "Active" 2 "Auto close" 3 "Manuel close" 4 "Manuel confirm"  ;
VAL_ 163 ACU_RigthLaneChangeMessageSt 0 "No command" 1 "Active" 2 "Auto close" 3 "Manuel close" 4 "Manuel confirm"  ;
VAL_ 163 ACU_ICANDAIconMessageSt 0 "No command" 1 "press"  ;
VAL_ 163 ACU_SVM_Button_A 0 "No request" 1 "Open SVM" 2 "Close SVM" 3 "Not used" 4 "Not used" 5 "Not used" 6 "Not used" 7 "Not used"  ;
VAL_ 475 ACU_MirrSteeringAdjFlag 0 "Not active" 1 "Mirror adjust active" 2 "Steering adjust active" 3 "Steering learning guidance"  ;
VAL_ 879 ACU_PCS_SVM_MODCmd 0 "Disable" 1 "Enalbe"  ;
VAL_ 879 ACU_HeadLightVirtualSwSt 0 "NotActive" 1 "PositionLight" 2 "LowBeam" 3 "AutoLight"  ;
VAL_ 879 ACU_FrontFogLightVirtualSwSt 0 "Not Active" 1 "Active"  ;
VAL_ 879 ACU_RearFogLightVirtualSwSt 0 "Not Active" 1 "Active"  ;
VAL_ 879 ACU_Account_Uid 0 "No command" 1 "account 0" 2 "account 1" 3 "account 2" 4 "account 3" 5 "account 4" 6 "account 5" 7 "account 6" 8 "account 7" 9 "account 8" 10 "Not used" 11 "Not used" 12 "Not used" 13 "Not used" 14 "Not used" 15 "Not used"  ;
VAL_ 879 ACU_FCWWarnDistanceCfg 0 "No command" 1 "Normal" 2 "Close" 3 "Far"  ;
VAL_ 879 ACU_FCWCfg 0 "No command" 1 "Warning and brake" 2 "Warning only" 3 "Off"  ;
VAL_ 879 ACU_AEBOff 0 "No command" 1 "On" 2 "Off"  ;
VAL_ 879 ACU_TSR_SwitchReq 0 "No command" 1 "Not active" 2 "Active" 3 "Not used"  ;
VAL_ 879 ACU_IHBC_SwitchReq 0 "No command" 1 "Not active" 2 "Active" 3 "Not used"  ;
VAL_ 879 ACU_LDS_TypeReq 0 "No command" 1 "Disable" 2 "Warning" 3 "Steering and Warning"  ;
VAL_ 879 ACU_BSDCfg 0 "No Action" 1 "OFF Request" 2 "ON Request" 3 "Reserved"  ;
VAL_ 879 ACU_RCTACfg 0 "No Action" 1 "OFF Request" 2 "ON Request" 3 "Reserved"  ;
VAL_ 879 ACU_DOWCfg 0 "No Action" 1 "OFF Request" 2 "ON Request" 3 "Reserved"  ;
VAL_ 879 ACU_TSR_AudioWarnReq 0 "No command" 1 "Off" 2 "On" 3 "Not used"  ;
VAL_ 879 ACU_HWAHFCfg 0 "No command" 1 "Not active" 2 "Active" 3 "Not used"  ;
VAL_ 879 ACU_HWAHF_AudioWarningTypeCfg 0 "No command" 1 "Warning tone" 2 "Voice" 3 "Not used"  ;
VAL_ 879 ACU_HWA_SwitchReq 0 "No command" 1 "Off" 2 "On" 3 "Not used"  ;
VAL_ 879 ACU_ELKCfg 0 "No command" 1 "Not active" 2 "Active" 3 "Not used"  ;
VAL_ 879 ACU_FCTACfg 0 "No command" 1 "Not active" 2 "Active" 3 "Not used"  ;
VAL_ 879 ACU_RAWCfg 0 "No command" 1 "Not active" 2 "Active" 3 "Not used"  ;
VAL_ 879 ACU_RCTA_TypeReqCfg 0 "No command" 1 "brake" 2 "Warning" 3 "brake and Warning"  ;
VAL_ 879 ACU_FCTA_TypeReqCfg 0 "No command" 1 "brake" 2 "Warning" 3 "brake and Warning"  ;
VAL_ 879 ACU_NDASwitchReq 0 "No command" 1 "Not active" 2 "Active" 3 "Not used"  ;
VAL_ 879 ACU_NDALCConSwitchReq 0 "No command" 1 "Need confirm" 2 "No need confirm" 3 "Not used"  ;
VAL_ 879 ACU_NDALCStySwitchReq 0 "No command" 1 "Standard" 2 "Radical" 3 "Not used"  ;
VAL_ 879 ACU_ADASWarnTypeSwitch 0 "No command" 1 "Sound" 2 "Voice" 3 "Seat vibration"  ;
VAL_ 879 ACU_ESACfg 0 "No command" 1 "Not active" 2 "Active" 3 "Not used"  ;
VAL_ 879 ACU_ILCCfg 0 "No command" 1 "Not active" 2 "Active" 4 "Not used"  ;
VAL_ 879 ACU_AESCfg 0 "No command" 1 "Not active" 2 "Active" 5 "Not used"  ;
VAL_ 879 ACU_ILOACfg 0 "No command" 1 "Not active" 2 "Active" 6 "Not used"  ;
VAL_ 879 ACU_iACC_StyleConfirmSwitchReq 0 "No Command" 1 "Need confirm" 2 "No need confirm" 3 "OFF"  ;
VAL_ 879 ACU_IFC_ISDRestOfdis 0 "not in ISD" 251 "over 70km"  ;
VAL_ 879 ACU_IFC_SpeedLimitUnit 0 "Not used" 1 "Km/h" 2 "Miles/h" 3 "Not used"  ;
VAL_ 879 ACU_ThemeType 0 "Day mode" 1 "Night mode"  ;
VAL_ 879 ACU_IFC_SpeedLimtType 0 "Not specific" 1 "Speed limit camera detection" 2 "Interval speed detectionlimit"  ;
VAL_ 879 ACU_IFC_RoadType 0 "unknown" 1 "High way" 2 "National road" 3 "Provincial road" 4 "County road" 5 "Village road" 6 "City express way" 7 "Major urban road" 8 "Secondary urban road" 9 "Normal urban road" 10 "Non-Navigation Road" 11 "Ramp" 12 "Reserve" 13 "Reserve" 14 "Reserve" 15 "Reserve"  ;
VAL_ 879 ACU_IFC_ZoneCode 0 "Not used" 1 "China"  ;
VAL_ 879 ACU_IFC_NaviSt 0 "Unknown" 1 "Cruise" 2 "Navigate" 3 "Failure"  ;
VAL_ 879 ACU_IFC_NaviCorp 0 "unknown" 1 "Gaode Map" 2 "Tescent Map" 3 "Baidu Map" 4 "Ruitu Map"  ;
VAL_ 879 ACU_IFC_NaviNewIconDis 0 "no newIcon ahead" 21 "over 2.0km"  ;
VAL_ 879 ACU_IFC_OfframpSt 0 "Not off-ramp" 1 "Off-ramp"  ;
VAL_ 879 ACU_IFC_NaviNewIcon 0 "unknown" 1 "left" 2 "right" 3 "left front" 4 "right front" 5 "left rear" 6 "right rear" 7 "left u-turn" 8 "right u-turn" 9 "go straight" 10 "roundabout entrance" 11 "roundabout exit" 12 "service area" 13 "toll station" 14 "tunnel" 15 "not used"  ;
VAL_ 879 ACU_IFC_SLCAheadDis 251 "over 1.25km"  ;
VAL_ 879 ACU_DVR_Switch 0 "Off" 1 "On"  ;
VAL_ 879 ACU_IFC_OfframpDis 254 "over 2km"  ;
VAL_ 351 ACU_VirtualPowerOFFReq 0 "No request" 1 "Request"  ;
VAL_ 351 ACU_Account_Uld 0 "No command" 1 "account 0" 2 "account 1" 3 "account 2" 4 "account 3" 5 "account 4" 6 "account 5" 7 "account 6" 8 "account 7" 9 "account 8" 10 "Not used" 11 "Not used" 12 "Not used" 13 "Not used" 14 "Not used" 15 "Not used"  ;
VAL_ 351 ACU_FactoryResetReq 0 "No request" 1 "Request"  ;
VAL_ 351 ACU_FrontWiperIntCfgVkReq 0 "No command"  ;
VAL_ 351 ACU_FrontWiperAutoCfgVkReq 0 "No command"  ;
VAL_ 967 DMS_SysErrSt 0 "Unavailable_Default value" 1 "DMS blocked by steeringwheel" 2 "DMS blocked" 3 "FF lose templates" 4 "IR-proof sunglass detected" 5 "DMS system error" 6 "Normal Running" 7 "reserved"  ;
VAL_ 967 DMS_DrvrDetSts 1 "Not detected--driver is not detected" 2 "Eye detected--driver's eye can be detected" 3 "Head detected--driver's head can be detected" 4 "Reserved" 5 "Reserved" 6 "Reserved" 7 "Reserved"  ;
VAL_ 967 DMS_InterestsRegion 0 "Unavailable-default value" 1 "Driver side window" 2 "Rear view mirror" 3 "Driver side windshield" 4 "Codriver side windshield" 5 "Instrument cluster" 6 "Infotaiment display" 7 "Driver side door panel" 8 "Driver side footwell" 9 "Codriver side footwell" 10 "Codriver side window" 11 "Left outer mirror" 12 "Right outer mirror" 13 "Gear" 14 "Driver side windshield  top" 15 "Codriver side windshield top" 16 "Other Area" 17 "Reserved" 18 "Reserved" 19 "Reserved" 20 "Reserved" 21 "Reserved" 22 "Reserved" 23 "Reserved" 24 "Reserved" 25 "Reserved" 26 "Reserved" 27 "Reserved" 28 "Reserved" 29 "Reserved" 30 "Reserved" 31 "Reserved"  ;
VAL_ 967 DMS_L3DriverDistractionSt 0 "Unavailable--default value" 21 "Unknown--can not determine the distraction level" 42 "Distractive--Looking at red area or yellow area and over the limit condition" 63 "Non-Distractive--Looking at green area or yellow area with limit condition"  ;
VAL_ 967 DMS_L3DriverFatigueSt 0 "unavailable" 585 "unknown" 1170 "alert" 1755 "fatigue" 2340 "highly fatigue" 2925 "suspected unresponsive" 3510 "confirmed unresponsive" 4095 "not used"  ;
VAL_ 967 DMS_FaceIDStatus 0 "Default" 1 "Registering" 2 "Recognizing" 3 "Erorr"  ;
VAL_ 967 DMS_FaceID 0 "Default" 1 "AUID 1" 2 "AUID 2" 3 "AUID 3" 4 "AUID 4" 5 "AUID 5" 6 "AUID 6" 7 "AUID 7" 8 "AUID 8" 9 "Other" 10 "Other" 11 "Other" 12 "Other" 13 "Other" 14 "Other" 15 "Other"  ;
VAL_ 967 DMS_LeftEyeOpenSt 0 "Unavailable-default value" 1 "open" 2 "closed" 3 "can not detected"  ;
VAL_ 967 DMS_RightEyeOpenSt 0 "Unavailable-default value" 1 "open" 2 "closed" 3 "can not detected"  ;
VAL_ 967 DMS_DriverSmokeSt 0 "Unavailable-default value" 1 "smoking" 2 "non-smoking" 3 "reserved"  ;
VAL_ 967 DMS_DriverTelephoneSt 0 "Unavailable-default value" 1 "phoning" 2 "non-phoning" 3 "reserved"  ;
VAL_ 967 DMS_DriverHealthSt 0 "Unavailable-default value" 1 "Heart rate" 2 "Heart rate variability" 3 "Blood oxygen saturation" 4 "Blood pressure" 5 "Respiratory rate"  ;
VAL_ 967 DMS_FatigWarnSt 0 "Unavailable--driver not detected or default value or Deactivated" 1 "Unknown--driver detected, but can't determine the" 2 "alert" 3 "Drowsiness" 4 "Mircosleep" 5 "Sleep" 6 "Unresponsive driver" 7 "Reserved"  ;
VAL_ 967 DMS_DistrWarnSt 0 "Unavailable--driver not detected or default value or Deactivated" 1 "Unknown--driver detected, but can't determine the" 2 "Long Distraction--During the driving,the driver is looking at the incorrect zones for 3s." 3 "Short Distraction--During the driving,the driver is repeated glances away from the forward road view" 4 "Special Long Distractive--During the driving,the driver is looking at the incorrect zones for 1s." 5 "Non-Distractive--During the driving,the driver is looking" 6 "Reserved" 7 "Reserved"  ;
VAL_ 967 DMS_DriverExpressionSt 0 "Default" 1 "Angry" 2 "Calm" 3 "Disgust" 4 "Happy" 5 "Sad" 6 "Scared" 7 "Supprise" 8 "Positive" 9 "Negative" 10 "Unclear"  ;
VAL_ 967 DMS_FaceIDVerifyResult 0 "Default" 1 "Face_ID_1_Verify_success" 2 "Face_ID_2_Verify_success" 3 "Face_ID_3_Verify_success" 4 "Face_ID_4_Verify_success" 5 "Face_ID_5_Verify_success" 6 "Face_ID_6_Verify_success" 7 "Face_ID_7_Verify_success" 8 "Face_ID_8_Verify_success" 9 "Fail" 10 "Timeout（10S）—other reasons" 11 "Verify Canceled" 12 "OtherReqWorking" 13 "Error_ServiceUnavailable" 14 "Error_CurrentAbnormal" 15 "Error_VoltageAbnormal" 16 "Error_DeviceAbnormal" 17 "Timeout_Can't detect faces （无法检测人脸）" 18 "Timeout_Angle is too large（人脸角度过大）" 19 "Timeout_The face is too close to the camera（距摄像头过近）" 20 "Timeout_The face is too far from the camera（距摄像头过远）" 21 "reserved"  ;
VAL_ 967 DMS_YawnSt 0 "Unavailable-default value" 1 "True" 2 "False" 3 "can not detected"  ;
VAL_ 161 ACU_FaceID_Delete 0 "Default" 1 "Delete AUID1" 2 "Delete AUID2" 3 "Delete AUID3" 4 "Delete AUID4" 5 "Delete AUID5" 6 "Delete AUID6" 7 "Delete AUID7" 8 "Delete AUID8" 9 "Reserved" 10 "Reserved" 11 "Reserved" 12 "Reserved" 13 "Reserved" 14 "Reserved" 15 "Reserved"  ;
VAL_ 161 ACU_RegisterTriger 0 "Default" 1 "Register AUID1" 2 "Register AUID2" 3 "Register AUID3" 4 "Register AUID4" 5 "Register AUID5" 6 "Register AUID6" 7 "Register AUID7" 8 "Register AUID8" 9 "Reserved" 10 "Reserved" 11 "Reserved" 12 "Reserved" 13 "Reserved" 14 "Reserved" 15 "Reserved"  ;
VAL_ 161 ACU_VerifyTriger 0 "Default" 1 "Verify AUID1" 2 "Verify AUID2" 3 "Verify AUID3" 4 "Verify AUID4" 5 "Verify AUID5" 6 "Verify AUID6" 7 "Verify AUID7" 8 "Verify AUID8" 9 "Reserved" 10 "Reserved" 11 "Reserved" 12 "Reserved" 13 "Reserved" 14 "Reserved" 15 "Reserved"  ;
VAL_ 161 ACU_FaceIDQuit 0 "No command" 1 "Quit request"  ;
VAL_ 161 ACU_FaceIDSwitch 0 "No command" 1 "Off" 2 "On" 3 "Not used"  ;
VAL_ 161 ACU_AVAS_SwitchCfgReq 0 "No command" 1 "OFF" 2 "ON" 3 "Not used"  ;
VAL_ 1043 TEL_TimeVD 0 "Not valid" 1 "Valid"  ;
VAL_ 791 WW_FWPMotorSt 0 "Off" 1 "Reserve" 2 "Stall protection" 3 "Failure" 4 "Low speed" 5 "High speed" 6 "Hard stopped" 7 "Interval delaying"  ;
VAL_ 791 WW_FWSHMotorSt 0 "OFF" 1 "ON" 2 "Failure"  ;
VAL_ 791 HRN_HornRunningSt 0 "Off" 1 "On" 2 "Failure"  ;
VAL_ 791 HRN_HornWorkingTemplet 0 "No Action"  ;
VAL_ 791 EL_FLPositionLightSt 0 "OFF" 1 "ON"  ;
VAL_ 791 EL_FLPositionLightFaultSt 0 "Not fault" 1 "Fault"  ;
VAL_ 791 EL_FRPositionLightSt 0 "OFF" 1 "ON"  ;
VAL_ 791 EL_FRPositionLightFaultSt 0 "Not fault" 1 "Fault"  ;
VAL_ 791 EL_LeftLowBeamSt 0 "OFF" 1 "ON"  ;
VAL_ 791 EL_LeftLowBeamFaultSt 0 "Not fault" 1 "Fault"  ;
VAL_ 791 EL_RightLowBeamSt 0 "OFF" 1 "ON"  ;
VAL_ 791 EL_RightLowBeamFaultSt 0 "Not fault" 1 "Fault"  ;
VAL_ 791 EL_LeftHighBeamSt 0 "OFF" 1 "ON"  ;
VAL_ 791 EL_LeftHighBeamFaultSt 0 "Not fault" 1 "Fault"  ;
VAL_ 791 EL_RightHighBeamSt 0 "OFF" 1 "ON"  ;
VAL_ 791 EL_RightHighBeamFaultSt 0 "Not fault" 1 "Fault"  ;
VAL_ 791 EL_FLFogLightSt 0 "OFF" 1 "ON"  ;
VAL_ 791 EL_FLFogLightFaultSt 0 "Not fault" 1 "Fault"  ;
VAL_ 791 EL_FRFogLightSt 0 "OFF" 1 "ON"  ;
VAL_ 791 EL_FRFogLightFaultSt 0 "Not fault" 1 "Fault"  ;
VAL_ 791 EL_LeftDRLSt 0 "OFF" 1 "ON"  ;
VAL_ 791 EL_LeftDRLFaultSt 0 "Not fault" 1 "Fault"  ;
VAL_ 791 EL_RightDRLSt 0 "OFF" 1 "ON"  ;
VAL_ 791 EL_RightDRLFaultSt 0 "Not fault" 1 "Fault"  ;
VAL_ 791 EL_FLTurnLightSt 0 "Not active" 1 "OFF" 2 "ON" 3 "Not used"  ;
VAL_ 791 EL_FLTurnLightFaultSt 0 "Not fault" 1 "Fault"  ;
VAL_ 791 EL_FRTurnLightSt 0 "Not active" 1 "OFF" 2 "ON" 3 "Not used"  ;
VAL_ 791 EL_FRTurnLightFaultSt 0 "Not fault" 1 "Fault"  ;
VAL_ 791 WW_RWSHMotorSt 0 "OFF" 1 "ON" 2 "Failure"  ;
VAL_ 791 EL_FADASLightSt 0 "Off" 1 "On" 2 "Fault" 3 "Not used"  ;
VAL_ 791 EBSF_SOC_STATE 0 "deviation > 15%" 1 "deviation <15%" 2 "deviation < 10%" 3 "invalid"  ;
VAL_ 913 IL_PADS_LightbarSt 0 "Off;" 1 "White;" 2 "Blue;" 3 "Orange;" 4 "Red;" 5 "Reserved;" 6 "Reserved;" 7 "Reserved;" 8 "Reserved;" 9 "Reserved;" 10 "Reserved;" 11 "Reserved;" 12 "Reserved;" 13 "Reserved;" 14 "Reserved;" 15 "Invalid;"  ;
VAL_ 913 IL_PADS_LightbarErrSt 0 "No Error;" 1 "Error;"  ;
VAL_ 913 UINM_PADS_L3SWSt 0 "Not Perssed;" 1 "Short Pressed;" 2 "Long Pressed;" 3 "Reserved;"  ;
VAL_ 913 UINM_PADS_L3SWStVD 0 "Not Valid;" 1 "Valid;"  ;
VAL_ 913 UINM_PADS_L3SWStuckSt 0 "Normal ;" 1 "Stuck;"  ;
