VERSION "Version"

NS_ :

BS_:

BU_: Tester CCU INU ADC RRR RLR CCURT1 CCURT2 ZCUF ZCUL ZCUR ZCUT EMS IDM DCDC DCDCI IPS NIDU DCU2 OBC OPC LPC CPC EMCM GCU DCU IPU BMS EOP EVCC DCDC2 EDL SRS ECS EPS EPB RBM IBCS ICM IID IDC AMP WHUD ARHUD IMR FIMR CD IFC FAPA PAS PCS SCMF SCMR SCMRL SCMRR MFS DRM FCP RCP LBMSAD AVAS DLPFL FBLCM FLISD FLLCM FRLCM RLLCMA RLLCMB RRLCMA RRLCMB RLISD DLPML DLPMR TRM PSDL PSDR FLDCM FRDCM HVSPRL HVSPRR RFR SBM WCM ETC TBOX2 TBOX RLBMS EBU FLPDM RLPDM FRPDM RRPDM FLOAR FROAR RLOAR RROAR EOSL EOSR EOST PRBU RT1_C0 OTAWL RT2_C3 IDUR PHUDD RAS CBM PLGM TMC LPC2 SAS RCICP SCMRM SCMT SLMRL SLMRR IDU RRISD DSASBM LBMS RT1_C1

BO_ 611 CCU_BCS_3_C: 64 CCU
 SG_ BCS_3_CRC : 7|16@0+ (1,0) [0|65535] ""  ICM,IID,IDC,ADC,FAPA
 SG_ BCS_3_Counter : 23|8@0+ (1,0) [0|255] ""  ICM,IID,IDC,ADC,FAPA
 SG_ BCS_DycESCActTq_1 : 31|16@0+ (1,-32768) [-32768|32767] "Nm"  ADC,FAPA
 SG_ BCS_BrkTqCtrlAvlDriving_1 : 42|3@0+ (1,0) [0|7] ""  ADC,FAPA
 SG_ BCS_BrkTqCtrlAvlParking_1 : 44|2@0+ (1,0) [0|3] ""  ADC,FAPA
 SG_ BCS_BrkTqCtrlActv_1 : 46|2@0+ (1,0) [0|3] ""  ADC,FAPA
 SG_ BCS_DycEscTarTqCtrlAvl_1 : 47|1@0+ (1,0) [0|1] ""  ADC,FAPA
 SG_ BCS_DTCActvSts_1 : 49|2@0+ (1,0) [0|3] ""  ADC,FAPA
 SG_ BCS_DrvrBrkOvrd_1 : 50|1@0+ (1,0) [0|1] ""  ADC,FAPA
 SG_ BCS_DrvrBrkOvrdVld_1 : 51|1@0+ (1,0) [0|1] ""  ADC,FAPA
 SG_ BCS_DycEscTarTqActv_1 : 52|1@0+ (1,0) [0|1] ""  ADC,FAPA
 SG_ BCS_BrkTqCtrlAvlParkingRdn_1 : 55|3@0+ (1,0) [0|7] ""  ADC,FAPA
 SG_ BCS_HydBrkActvTq_1 : 63|16@0+ (1,-32768) [-32768|32767] "Nm"  ADC,FAPA
 SG_ BCS_ERV_VehSpd_1 : 359|13@0+ (0.05625,0) [0|240] "km/h"  ADC,FAPA
 SG_ BCS_ERV_VehSpdVld_1 : 74|1@0+ (1,0) [0|1] ""  ADC,FAPA
 SG_ BCS_HydBrkActvTq_FL_1 : 103|16@0+ (1,-32768) [-32768|32767] "Nm"  ADC,FAPA
 SG_ BCS_HydBrkActvTq_FR_1 : 119|16@0+ (1,-32768) [-32768|32767] "Nm"  ADC,FAPA
 SG_ BCS_HydBrkActvTq_RL_1 : 135|16@0+ (1,-32768) [-32768|32767] "Nm"  ADC,FAPA
 SG_ BCS_HydBrkActvTq_RR_1 : 151|16@0+ (1,-32768) [-32768|32767] "Nm"  ADC,FAPA
 SG_ IPB_SimulatorPressure : 199|12@0+ (0.3,-5) [-5|301.9] "bar"  EMS,ADC,IFC,FAPA
 SG_ IPB_SimulatorPressureSt : 223|1@0+ (1,0) [0|1] ""  EMS,ADC,IFC,FAPA
 SG_ IBCS_SystemSt : 226|3@0+ (1,0) [0|7] ""  ICM,IID,IDC,PHUDD,ADC,IFC,FAPA
 SG_ IBCS_FWAWarning : 239|2@0+ (1,0) [0|3] ""  ICM,IID,IDC,PHUDD,ADC,IFC,FAPA
 SG_ IPB_CSTSt : 233|2@0+ (1,0) [0|3] ""  ICM,IDC,ADC,IFC,FAPA
 SG_ BCS_AVDCActive : 240|1@0+ (1,0) [0|1] ""  ADC,IFC,FAPA
 SG_ BCS_AVDCAvailable : 241|1@0+ (1,0) [0|1] ""  ADC,IFC,FAPA
 SG_ BCS_BrkActvTq_1 : 455|16@0+ (1,-32768) [-32768|32767] "Nm"  ADC,FAPA
 SG_ BCS_DrvrTqDes_1 : 471|16@0+ (1,-32768) [-32768|32767] "Nm"  ADC,FAPA

BO_ 360 CCU_BCS_6_C: 64 CCU
 SG_ BCS_6_CRC : 7|16@0+ (1,0) [0|65535] ""  ADC,IFC,FAPA
 SG_ BCS_6_Counter : 23|8@0+ (1,0) [0|255] ""  ADC,IFC,FAPA
 SG_ BCS_HydBrkActvTq_FL : 31|16@0+ (1,-32768) [-32768|32767] "Nm"  ADC,IFC,FAPA
 SG_ BCS_HydBrkActvTq_FR : 47|16@0+ (1,-32768) [-32768|32767] "Nm"  ADC,IFC,FAPA
 SG_ BCS_HydBrkActvTq_RL : 63|16@0+ (1,-32768) [-32768|32767] "Nm"  ADC,IFC,FAPA
 SG_ BCS_HydBrkActvTq_RR : 79|16@0+ (1,-32768) [-32768|32767] "Nm"  ADC,IFC,FAPA
 SG_ BCS_HydBrkReqTq : 95|16@0+ (1,-32768) [-32768|32767] "Nm"  ADC,IFC,FAPA
 SG_ BCS_BrkActvTq : 111|16@0+ (1,-32768) [-32768|32767] "Nm"  ADC,IFC,FAPA
 SG_ BCS_HydBrkActvTq : 127|16@0+ (1,-32768) [-32768|32767] "Nm"  ADC,IFC,FAPA
 SG_ BCS_DycESCActTq : 143|16@0+ (1,-32768) [-32768|32767] "Nm"  ADC,IFC,FAPA
 SG_ BCS_ERV_VehSpd : 156|13@0+ (0.05625,0) [0|240] "km/h"  ADC,IFC,FAPA
 SG_ BCS_BrkTqCtrlAvlDriving : 159|3@0+ (1,0) [0|7] ""  ADC,IFC,FAPA
 SG_ BCS_BrkTqCtrlAvlParking : 173|2@0+ (1,0) [0|3] ""  ADC,IFC,FAPA
 SG_ BCS_BrkTqCtrlActv : 175|2@0+ (1,0) [0|3] ""  ADC,IFC,FAPA
 SG_ BCS_ERV_VehSpdVld : 188|1@0+ (1,0) [0|1] ""  ADC,IFC,FAPA
 SG_ BCS_EspFailrSts : 189|1@0+ (1,0) [0|1] ""  ADC,IFC,FAPA
 SG_ BCS_ActvSts : 190|1@0+ (1,0) [0|1] ""  ADC,IFC,FAPA
 SG_ BCS_DycEscTarTqCtrlAvl : 191|1@0+ (1,0) [0|1] ""  ADC,IFC,FAPA
 SG_ BCS_BDCActive : 209|2@0+ (1,0) [0|3] ""  ADC,IFC,FAPA
 SG_ BCS_DTCActvSts : 211|2@0+ (1,0) [0|3] ""  ADC,IFC,FAPA
 SG_ BCS_errorFb : 215|4@0+ (1,0) [0|15] ""  ADC,IFC,FAPA
 SG_ BCS_DrvrBrkOvrd : 217|1@0+ (1,0) [0|1] ""  ADC,IFC,FAPA
 SG_ BCS_DrvrBrkOvrdVld : 218|1@0+ (1,0) [0|1] ""  ADC,IFC,FAPA
 SG_ BCS_DycEscTarTqActv : 219|1@0+ (1,0) [0|1] ""  ADC,IFC,FAPA
 SG_ BCS_WheelSlipFLValid : 220|1@0+ (1,0) [0|1] ""  ADC,IFC,FAPA
 SG_ BCS_WheelSlipFRValid : 221|1@0+ (1,0) [0|1] ""  ADC,IFC,FAPA
 SG_ BCS_WheelSlipRLValid : 222|1@0+ (1,0) [0|1] ""  ADC,IFC,FAPA
 SG_ BCS_WheelSlipRRValid : 223|1@0+ (1,0) [0|1] ""  ADC,IFC,FAPA
 SG_ BCS_DrvrTqDes : 231|16@0+ (1,-32768) [-32768|32767] "Nm"  ADC,IFC,FAPA
 SG_ BCS_CrbsTarRecpTorqRqFA : 247|14@0+ (1,-6000) [-6000|10380] "Nm"  ADC,IFC,FAPA
 SG_ BCS_CrbsTarRecpTorqRqFASt : 249|2@0+ (1,0) [0|3] ""  ADC,IFC,FAPA
 SG_ BCS_CrbsTarRecpTorqRqRA : 263|14@0+ (1,-6000) [-6000|10380] "Nm"  ADC,IFC,FAPA
 SG_ BCS_CrbsTarRecpTorqRqRASt : 265|2@0+ (1,0) [0|3] ""  ADC,IFC,FAPA
 SG_ BCS_CrbsTarRecpTorqRqSum : 279|14@0+ (1,-6000) [-6000|10380] "Nm"  ADC,IFC,FAPA
 SG_ BCS_CrbsTarRecpTorqRqSumSt : 281|2@0+ (1,0) [0|3] ""  ADC,IFC,FAPA
 SG_ BCS_BrkTqCtrlAvlParkingRdn : 187|3@0+ (1,0) [0|7] ""  ADC,IFC,FAPA
 SG_ BCS_WheelSlipFL : 199|8@0+ (0.004,0) [0|1.002] ""  ADC,IFC,FAPA
 SG_ BCS_WheelSlipFR : 207|8@0+ (0.004,0) [0|1.002] ""  ADC,IFC,FAPA
 SG_ BCS_WheelSlipRL : 343|8@0+ (0.004,0) [0|1.002] ""  ADC,IFC,FAPA
 SG_ BCS_WheelSlipRR : 351|8@0+ (0.004,0) [0|1.002] ""  ADC,IFC,FAPA

BO_ 618 CCU_EPB_1: 32 CCU
 SG_ EPB_1_CRC : 7|16@0+ (1,0) [0|65535] ""  ZCUF,ZCUL,ZCUR,IBCS,ICM,IID,IDC,ADC,IFC,FAPA,RRR,RLR,PAS,EBU
 SG_ EPB_1_Counter : 23|8@0+ (1,0) [0|255] ""  ZCUF,ZCUL,ZCUR,IBCS,ICM,IID,IDC,ADC,IFC,FAPA,RRR,RLR,PAS,EBU
 SG_ EPB_SwitchSt : 31|2@0+ (1,0) [0|3] ""  ZCUF,ZCUL,ZCUR,SRS,IBCS,IDC,ADC,IFC,FAPA,RRR,RLR,PAS
 SG_ EPB_SwitchStVD : 29|1@0+ (1,0) [0|1] ""  ZCUF,ZCUL,ZCUR,SRS,IBCS,ADC,IFC,FAPA,RRR,RLR,PAS,EBU
 SG_ EPB_SysSt : 28|3@0+ (1,0) [0|7] ""  ZCUF,ZCUL,ZCUR,SRS,IBCS,ICM,IDC,ADC,IFC,FAPA,RRR,RLR,PAS,EBU
 SG_ EPB_FailSt : 39|1@0+ (1,0) [0|1] ""  ZCUF,ZCUL,SRS,IBCS,ICM,IID,IDC,PHUDD,ADC,IFC,FAPA,RRR,RLR,PAS
 SG_ EPB_ExtAvailable : 47|2@0+ (1,0) [0|3] ""  ZCUF,ZCUL,IBCS,ADC,IFC,FAPA,RRR,RLR
 SG_ EPB_DynamicApplySt : 82|3@0+ (1,0) [0|7] ""  ZCUF,ZCUL,IBCS,ADC,IFC,FAPA
 SG_ EPB_ActuatorSt_R : 107|4@0+ (1,0) [0|15] ""  ZCUF,ZCUL,IBCS,ADC,IFC,FAPA,RRR,RLR
 SG_ EPB_RWUActvSts : 109|2@0+ (1,0) [0|3] ""  ADC,FAPA
 SG_ EPB_RWUAvl : 111|2@0+ (1,0) [0|3] ""  ADC,IFC,FAPA
 SG_ EPB_RPAAVPAvailability : 129|2@0+ (1,0) [0|3] ""  ADC,FAPA
 SG_ EPB_APAAvailability : 143|1@0+ (1,0) [0|1] ""  ADC,FAPA
 SG_ EPB_ADCNetErrorFb : 135|3@0+ (1,0) [0|7] ""  ADC
 SG_ EPB_NetModeResp : 117|2@0+ (1,0) [0|3] ""  ADC

BO_ 433 CCU_GVS_3: 64 CCU
 SG_ CCU_GVS_3_CRC : 7|16@0+ (1,0) [0|65535] ""  ZCUF,ZCUL,ZCUR,ZCUT,IBCS,ADC,IFC,FAPA,EBU
 SG_ CCU_GVS_3_Counter : 23|8@0+ (1,0) [0|255] ""  ZCUF,ZCUL,ZCUR,ZCUT,IBCS,ADC,IFC,FAPA,EBU
 SG_ AccPedalPstForMRR : 239|8@0+ (0.392,0) [0|99.96] "%"  ZCUF,ZCUL,ZCUR,ZCUT,SRS,EPB,IBCS,IDC,ADC,IFC,FAPA,EBU
 SG_ AccPedalPstForMRRVD : 209|1@0+ (1,0) [0|1] ""  ZCUF,ZCUL,ZCUR,ZCUT,SRS,EPB,IBCS,IDC,ADC,IFC,FAPA,EBU
 SG_ VCU_VehActDrvTorqRR : 33|14@0+ (1,0) [0|16000] "Nm"  IBCS,ADC,FAPA
 SG_ VCU_VehActDrvTorqRRVD : 189|1@0+ (1,0) [0|1] ""  IBCS,ADC,FAPA
 SG_ VCU_FrntWhlReqTq : 247|16@0+ (1,-32768) [-32768|32767] "Nm"  ADC,FAPA
 SG_ VCU_FrntWhlReqTqVld : 80|1@0+ (1,0) [0|1] ""  ADC,FAPA
 SG_ VCU_ReWhlReqTqRR : 263|16@0+ (1,-32768) [-32768|32767] "Nm"  ADC,FAPA
 SG_ VCU_ReWhlReqTqRRVld : 81|1@0+ (1,0) [0|1] ""  ADC,FAPA
 SG_ VCU_ReWhlReqTqRL : 279|16@0+ (1,-32768) [-32768|32767] "Nm"  ADC,FAPA
 SG_ VCU_ReWhlReqTqRLVld : 207|1@0+ (1,0) [0|1] ""  ADC,FAPA
 SG_ VCU_DrvYawMomAvl : 206|2@0+ (1,0) [0|3] ""  ADC,FAPA
 SG_ VCU_DrvYawMomRespSts : 204|2@0+ (1,0) [0|3] ""  ADC,FAPA
 SG_ VCU_MotorDrvCaplTqWhlFA : 295|16@0+ (1,-32768) [-32768|32767] "Nm"  ADC,FAPA
 SG_ VCU_MotorRgnCaplTqWhlFA : 311|16@0+ (1,-32768) [-32768|32767] "Nm"  ADC,FAPA
 SG_ VCU_MotorDrvCaplTqWhlRL : 327|16@0+ (1,-32768) [-32768|32767] "Nm"  ADC,FAPA
 SG_ VCU_MotorRgnCaplTqWhlRL : 343|16@0+ (1,-32768) [-32768|32767] "Nm"  ADC,FAPA
 SG_ VCU_MotorDrvCaplTqWhlRR : 359|16@0+ (1,-32768) [-32768|32767] "Nm"  ADC,FAPA
 SG_ VCU_MotorRgnCaplTqWhlRR : 375|16@0+ (1,-32768) [-32768|32767] "Nm"  ADC,FAPA
 SG_ VCU_PreStableFlg : 202|1@0+ (1,0) [0|1] ""  ADC,FAPA
 SG_ VCU_ErrorFb : 399|4@0+ (1,0) [0|15] ""  ADC,IFC,FAPA
 SG_ VCU_DrvrAccrPedlOvrdVld : 395|1@0+ (1,0) [0|1] ""  ADC,IFC,FAPA
 SG_ VCU_VehWhlReqTqVld : 394|1@0+ (1,0) [0|1] ""  ADC,IFC,FAPA
 SG_ VCU_MotorRegenTrqLmtlnDVaild : 393|1@0+ (1,0) [0|1] ""  ADC,IFC,FAPA
 SG_ VCU_GearShiftAvl : 392|1@0+ (1,0) [0|1] ""  ADC,IFC,FAPA
 SG_ VCU_PtTqAvl : 407|2@0+ (1,0) [0|3] ""  ADC,IFC,FAPA
 SG_ VCU_PtTqActvSts : 405|1@0+ (1,0) [0|1] ""  ADC,IFC,FAPA
 SG_ VCU_MotorRegenTorqueLmtlnD : 404|13@0+ (1,-8191) [-8191|0] "Nm"  ADC,IFC,FAPA
 SG_ VCU_DriverTorqueDesired : 423|16@0+ (1,-32768) [-32768|32767] "Nm"  ADC,IFC,FAPA
 SG_ VCU_VehWhlReqTq : 439|16@0+ (1,-32768) [-32768|32767] "Nm"  ADC,IFC,FAPA

BO_ 363 CCU_EPS_1_C: 64 CCU
 SG_ EPS_1_CRC : 7|16@0+ (1,0) [0|65535] ""  ECS,IBCS,ADC,IFC,FAPA,RRR,RLR
 SG_ EPS_1_Counter : 23|8@0+ (1,0) [0|255] ""  ECS,IBCS,ADC,IFC,FAPA,RRR,RLR
 SG_ EPS_StrngWhlTorqVD : 31|1@0+ (1,0) [0|1] ""  ADC,IFC,FAPA,RRR,RLR
 SG_ EPS_StrngWhlTorq : 30|12@0+ (0.01,-15) [-15|15] "Nm"  ADC,IFC,FAPA,RRR,RLR
 SG_ TAS_CalibratedSt : 34|1@0+ (1,0) [0|1] ""  SRS,ECS,IBCS,ADC,IFC,FAPA,RRR,RLR
 SG_ EPS_SteeringAngleSpdVD : 32|1@0+ (1,0) [0|1] ""  SRS,ECS,IBCS,ADC,IFC,FAPA,RRR,RLR
 SG_ EPS_SteeringAngleSpd : 47|8@0+ (4,0) [0|1016] "deg/sec"  SRS,ECS,IBCS,ADC,IFC,FAPA,RRR,RLR,PCS
 SG_ EPS_SteeringAngle : 55|16@0+ (0.1,-780) [-780|780] "deg"  ZCUR,SRS,ECS,IBCS,ADC,IFC,FAPA,RRR,RLR,PCS
 SG_ EPS_SteeringAngleVD : 71|1@0+ (1,0) [0|1] ""  ZCUR,SRS,ECS,IBCS,ADC,IFC,FAPA,RRR,RLR
 SG_ EPS_ThermalSt : 69|2@0+ (1,0) [0|3] ""  RAS,ADC,IFC,FAPA
 SG_ EPS_VMCErrFeedback : 84|4@0+ (1,0) [0|15] ""  RAS,ADC,IFC,FAPA
 SG_ EPS_PstOverlaySt : 103|3@0+ (1,0) [0|7] ""  RAS,ADC,IFC,FAPA
 SG_ EPS_HealthySt_DualSide : 100|2@0+ (1,0) [0|3] ""  RAS,ADC,IFC,FAPA
 SG_ EPS_VibrationWarnSt_A : 97|2@0+ (1,0) [0|3] ""  RAS,ADC,IFC,FAPA
 SG_ SAC_ErrFeedback_SideA : 111|4@0+ (1,0) [0|15] ""  RAS,ADC,IFC,FAPA
 SG_ EPS_ADASTargetAngle : 119|16@0+ (0.1,-780) [-780|780] "deg"  RAS,ADC,IFC,FAPA
 SG_ EPS_FunctionStyleSt : 135|2@0+ (1,0) [0|3] ""  RAS,ADC,IFC,FAPA
 SG_ EPS_SteeringModeSt : 133|2@0+ (1,0) [0|3] ""  RAS,ADC,IFC,FAPA
 SG_ EPS_ReqAngOverRange : 140|1@0+ (1,0) [0|1] ""  RAS,ADC,IFC,FAPA
 SG_ EPS_SACMotorTorAct : 139|12@0+ (0.01,-6) [-6|6] "Nm"  RAS,ADC,IFC,FAPA
 SG_ EPS_SACMotorTorLimInt : 159|11@0+ (0.01,0) [0|6] "Nm"  RAS,ADC,IFC,FAPA
 SG_ EPS_ReqAngSpdOverRange : 164|1@0+ (1,0) [0|1] ""  RAS,ADC,IFC,FAPA
 SG_ EPS_AssistPraSwitchToLKA : 163|1@0+ (1,0) [0|1] ""  RAS,ADC,IFC,FAPA
 SG_ EPS_SteerGainEnable : 162|1@0+ (1,0) [0|1] ""  RAS,ADC,IFC,FAPA
 SG_ EPS_EmSteerEnbale : 161|1@0+ (1,0) [0|1] ""  RAS,ADC,IFC,FAPA
 SG_ EPS_EM_ErrFeedback : 171|4@0+ (1,0) [0|15] ""  RAS,ADC,IFC,FAPA
 SG_ EPS_VW_ErrFeedback : 183|4@0+ (1,0) [0|15] ""  RAS,ADC,IFC,FAPA
 SG_ EPS_SG_ErrFeedback : 175|4@0+ (1,0) [0|15] ""  RAS,ADC,IFC,FAPA
 SG_ EPS_SACMotorTorActMot : 191|12@0+ (0.01,-6) [-6|6] "Nm"  RAS,ADC,IFC,FAPA
 SG_ EPS_SACMotorTorLimIntMot : 194|11@0+ (0.01,0) [0|6] "Nm"  RAS,ADC,IFC,FAPA
 SG_ EPS_SG_ActualLevel : 215|8@0+ (1,0) [0|254] "%"  RAS,ADC,IFC,FAPA
 SG_ EPS_MotorTorSum : 219|12@0+ (0.01,-6) [-6|6] "Nm"  RAS,ADC,IFC,FAPA
 SG_ EPS_WarnLamp : 242|2@0+ (1,0) [0|3] ""  RAS,ADC,IFC,FAPA
 SG_ EPS_AssistRatio : 263|8@0+ (1,0) [0|255] ""  RAS,ADC,IFC,FAPA
 SG_ EPS_SteeringWhlTorFlt : 271|12@0+ (0.01,-15) [-15|15] "Nm"  RAS,ADC,IFC,FAPA
 SG_ EPS_SteeringWhlTorFltVD : 275|2@0+ (1,0) [0|3] ""  RAS,ADC,IFC,FAPA
 SG_ EPS_SteeringAngleRate : 273|14@0+ (0.2,-1600) [-1600|1600] "deg/s"  RAS,ADC,IFC,FAPA
 SG_ EPS_TqCtrlSt : 291|2@0+ (1,0) [0|3] ""  RAS,ADC,IFC,FAPA
 SG_ EPS_MotorTorForDrv : 239|12@0+ (0.01,-20) [-20|20] "Nm"  RAS,ADC,IFC,FAPA
 SG_ EPS_TqCtrlAvl : 221|2@0+ (1,0) [0|3] ""  RAS,ADC,IFC,FAPA
 SG_ EPS_AgCtrlAvl : 223|2@0+ (1,0) [0|3] ""  RAS,ADC,IFC,FAPA
 SG_ EPS_MotorTorSumVD : 243|1@0+ (1,0) [0|1] ""  RAS,ADC,IFC,FAPA
 SG_ EPS_DrvOveRideSt : 160|1@0+ (1,0) [0|1] ""  RAS,ADC,IFC,FAPA
 SG_ EPS_DrvOveRideVD : 176|1@0+ (1,0) [0|1] ""  RAS,ADC,IFC,FAPA
 SG_ EPS_SteerVibrlAvl : 195|1@0+ (1,0) [0|1] ""  RAS,ADC,IFC,FAPA
 SG_ EPS_HandsOffDetStVD : 240|1@0+ (1,0) [0|1] ""  RAS,ADC,IFC,FAPA
 SG_ EPS_HandsOffDetSt : 289|2@0+ (1,0) [0|3] ""  RAS,ADC,IFC,FAPA
 SG_ EPS_SteerMod : 303|3@0+ (1,0) [0|7] ""  RAS,ADC,IFC,FAPA
 SG_ EPS_ADCNetErrorFb : 359|3@0+ (1,0) [0|7] ""  RAS,ADC,IFC,FAPA
 SG_ EPS_NetModeResp : 356|2@0+ (1,0) [0|3] ""  RAS,ADC,FAPA

BO_ 362 CCU_EPS_1_B: 64 CCU
 SG_ EPSB_1_CRC : 7|16@0+ (1,0) [0|65535] ""  ADC
 SG_ EPSB_1_Counter : 23|8@0+ (1,0) [0|255] ""  ADC
 SG_ EPSB_StrngWhlTorqVD : 31|1@0+ (1,0) [0|1] ""  ADC
 SG_ EPSB_StrngWhlTorq : 30|12@0+ (0.01,-15) [-15|15] "Nm"  ADC
 SG_ EPSB_TAS_CalibratedSt : 34|1@0+ (1,0) [0|1] ""  ADC
 SG_ EPSB_SteeringAngleSpdVD : 32|1@0+ (1,0) [0|1] ""  ADC
 SG_ EPSB_SteeringAngleSpd : 47|8@0+ (4,0) [0|1016] "deg/sec"  ADC
 SG_ EPSB_SteeringAngle : 55|16@0+ (0.1,-780) [-780|780] "deg"  ADC
 SG_ EPSB_SteeringAngleVD : 71|1@0+ (1,0) [0|1] ""  ADC
 SG_ EPSB_ThermalSt : 69|2@0+ (1,0) [0|3] ""  ADC
 SG_ EPSB_VMCErrFeedback : 84|4@0+ (1,0) [0|15] ""  ADC
 SG_ EPSB_PstOverlaySt : 103|3@0+ (1,0) [0|7] ""  ADC
 SG_ EPSB_HealthySt_DualSide : 100|2@0+ (1,0) [0|3] ""  ADC
 SG_ EPSB_VibrationWarnSt : 97|2@0+ (1,0) [0|3] ""  ADC
 SG_ EPSB_SAC_ErrFeedback_SideA : 111|4@0+ (1,0) [0|15] ""  ADC
 SG_ EPSB_ADASTargetAngle : 119|16@0+ (0.1,-780) [-780|780] "deg"  ADC
 SG_ EPSB_FunctionStyleSt : 135|2@0+ (1,0) [0|3] ""  ADC
 SG_ EPSB_SteeringModeSt : 133|2@0+ (1,0) [0|3] ""  ADC
 SG_ EPSB_ReqAngOverRange : 140|1@0+ (1,0) [0|1] ""  ADC
 SG_ EPSB_SACMotorTorAct : 139|12@0+ (0.01,-6) [-6|6] "Nm"  ADC
 SG_ EPSB_SACMotorTorLimInt : 159|11@0+ (0.01,0) [0|6] "Nm"  ADC
 SG_ EPSB_ReqAngSpdOverRange : 164|1@0+ (1,0) [0|1] ""  ADC
 SG_ EPSB_AssistPraSwitchToLKA : 163|1@0+ (1,0) [0|1] ""  ADC
 SG_ EPSB_SteerGainEnable : 162|1@0+ (1,0) [0|1] ""  ADC
 SG_ EPSB_EmSteerEnbale : 161|1@0+ (1,0) [0|1] ""  ADC
 SG_ EPSB_EM_ErrFeedback : 171|4@0+ (1,0) [0|15] ""  ADC
 SG_ EPSB_VW_ErrFeedback : 183|4@0+ (1,0) [0|15] ""  ADC
 SG_ EPSB_SG_ErrFeedback : 175|4@0+ (1,0) [0|15] ""  ADC
 SG_ EPSB_SACMotorTorActMot : 191|12@0+ (0.01,-6) [-6|6] "Nm"  ADC
 SG_ EPSB_SACMotorTorLimIntMot : 194|11@0+ (0.01,0) [0|6] "Nm"  ADC
 SG_ EPSB_SG_ActualLevel : 215|8@0+ (1,0) [0|254] "%"  ADC
 SG_ EPSB_MotorTorSum : 219|12@0+ (0.01,-6) [-6|6] "Nm"  ADC
 SG_ EPSB_WarnLamp : 242|2@0+ (1,0) [0|3] ""  ADC
 SG_ EPSB_AssistPercentage : 255|8@0+ (1,0) [0|255] "%"  ADC
 SG_ EPSB_AssistRatio : 263|8@0+ (1,0) [0|255] ""  ADC
 SG_ EPSB_StrngWhlTorqFlt : 271|12@0+ (0.01,-15) [-15|15] "Nm"  ADC
 SG_ EPSB_SteeringWhlTorFltVD : 275|2@0+ (1,0) [0|3] ""  ADC
 SG_ EPSB_SteeringAngleRate : 273|14@0+ (0.2,-1600) [-1600|1600] "deg/s"  ADC
 SG_ EPSB_TqCtrlSt : 291|2@0+ (1,0) [0|3] ""  ADC
 SG_ EPSB_MotorTorForDrv : 239|12@0+ (0.01,-20) [-20|20] "Nm"  ADC
 SG_ EPSB_TqCtrlAvl : 221|2@0+ (1,0) [0|3] ""  ADC
 SG_ EPSB_AgCtrlAvl : 223|2@0+ (1,0) [0|3] ""  ADC
 SG_ EPSB_MotorTorSumVD : 243|1@0+ (1,0) [0|1] ""  ADC
 SG_ EPSB_DrvOveRideSt : 160|1@0+ (1,0) [0|1] ""  ADC
 SG_ EPSB_DrvOveRideVD : 176|1@0+ (1,0) [0|1] ""  ADC
 SG_ EPSB_SteerVibrlAvl : 195|1@0+ (1,0) [0|1] ""  ADC
 SG_ EPSB_HandsOffDetStVD : 240|1@0+ (1,0) [0|1] ""  ADC
 SG_ EPSB_HandsOffDetSt : 289|2@0+ (1,0) [0|3] ""  ADC
 SG_ EPSB_SteerMod : 303|3@0+ (1,0) [0|7] ""  ADC
 SG_ EPSB_ADCNetErrorFb : 359|3@0+ (1,0) [0|7] ""  ADC
 SG_ EPSB_NetModeResp : 356|2@0+ (1,0) [0|3] ""  ADC

BO_ 905 CCU_IDC_ICM_1: 64 CCU
 SG_ ICM_SetIACCSt : 27|1@0+ (1,0) [0|1] ""  ADC,IFC,FAPA
 SG_ ICM_TotalOdometer : 35|20@0+ (1,0) [0|999999] "km"  ZCUF,ZCUL,ZCUR,ZCUT,EMS,NIDU,DCU2,IDUR,GCU,DCU,IPU,ECS,EPS,EPB,IBCS,ADC,IFC,FAPA,RRR,RLR,PCS,EBU
 SG_ ICM_VehInsSpd : 103|8@0+ (1,0) [0|254] "km/h"  ADC,IFC,FAPA,RRR,RLR
 SG_ ICM_TotalOdometer_accurate : 151|24@0+ (0.1,0) [0|999999.9] "km"  EMS,BMS,SRS,ADC,DSASBM,TBOX
 SG_ ICM_VehInsSpd_accurate : 272|11@0+ (0.1,0) [0|204.6] "km/h"  ECS,ADC,IFC,FAPA,RRR,RLR
 SG_ ICM_FuelAvaibleDriveDistance : 311|11@0+ (1,0) [0|2046] "km"  ADC,FAPA
 SG_ ICM_TotalAvaibleDriveDistance : 316|11@0+ (1,0) [0|2046] "km"  ADC,FAPA

BO_ 1045 CCU_IDC_6: 64 CCU
 SG_ ACU_Longitude : 31|28@0+ (0.000001,0) [0|180] "℃"  ADC,IFC,FAPA,TBOX
 SG_ ACU_Latitude : 51|28@0+ (0.000001,0) [0|90] "℃"  ADC,IFC,FAPA,TBOX
 SG_ ACU_CampingModeSt : 350|2@0+ (1,0) [0|3] ""  ZCUR,ADC

CM_ SG_ 611 BCS_3_CRC "E2E Profile 5 CRC";
CM_ SG_ 611 BCS_3_Counter "E2E Profile 5 Counter";
CM_ SG_ 611 BCS_DycESCActTq_1 "The real  DYC(Direct  yaw moment control)  of the ESP/IPB";
CM_ SG_ 611 BCS_BrkTqCtrlAvlDriving_1 "It indicates  whether  ESP/IPB is available for cruise function.";
CM_ SG_ 611 BCS_BrkTqCtrlAvlParking_1 "It indicates  whether  ESP/IPB is available for parking function.";
CM_ SG_ 611 BCS_BrkTqCtrlActv_1 "It indicates  whether  ESP/IPB is  responsed for the brake request of ADAS.";
CM_ SG_ 611 BCS_DycEscTarTqCtrlAvl_1 "The validity  of the DYC(Direct  yaw moment control)  of the ESP/IPB";
CM_ SG_ 611 BCS_DTCActvSts_1 "Dragging Torque Control activation status";
CM_ SG_ 611 BCS_DrvrBrkOvrd_1 "Indicate driver brakes torque more than the ADAS/ADS. ";
CM_ SG_ 611 BCS_DrvrBrkOvrdVld_1 "The validity  of  BCS_DrvrBrkOvrd";
CM_ SG_ 611 BCS_DycEscTarTqActv_1 "Indicates the DYC of the ESP/IPB in active or not";
CM_ SG_ 611 BCS_BrkTqCtrlAvlParkingRdn_1 "It indicates  whether  ESP/IPB is available for parking function,in redunant mode,including L3/L4/L5.";
CM_ SG_ 611 BCS_HydBrkActvTq_1 "It is the real hydraulic brake  torque carried out by ESP/IPB.";
CM_ SG_ 611 BCS_ERV_VehSpd_1 "Vehicle reference speed ";
CM_ SG_ 611 BCS_ERV_VehSpdVld_1 "Quality/fault information to vehicle  reference speed ";
CM_ SG_ 611 BCS_HydBrkActvTq_FL_1 "Hydraulic brake torque of the  front left wheel";
CM_ SG_ 611 BCS_HydBrkActvTq_FR_1 "Hydraulic brake torque of the  front right wheel";
CM_ SG_ 611 BCS_HydBrkActvTq_RL_1 "Hydraulic brake torque of the  rear left wheel";
CM_ SG_ 611 BCS_HydBrkActvTq_RR_1 "Hydraulic brake torque of the  rear right wheel";
CM_ SG_ 611 IPB_SimulatorPressure "Indicate simulator pressure value";
CM_ SG_ 611 IPB_SimulatorPressureSt "Indicate simulator pressure status";
CM_ SG_ 611 IBCS_SystemSt "IBCS system state";
CM_ SG_ 611 IBCS_FWAWarning "Indicate FWA state, dashboard need warn driver";
CM_ SG_ 611 IPB_CSTSt "indicates CST status. Only valid for project with CST function.";
CM_ SG_ 611 BCS_AVDCActive "Indicate AVDC deceleration active or not";
CM_ SG_ 611 BCS_AVDCAvailable "Indicate AVDC deceleration available ornot";
CM_ SG_ 611 BCS_BrkActvTq_1 "It is the real total brake  torque carried out by electric motor（ recuperation torque or electric brake torque）and ESP/IPB（hydraulic braketorque）.";
CM_ SG_ 611 BCS_DrvrTqDes_1 "When driver prsees brake pedal，It is the brake torque calculated by ESP/IPB corresponding to  inputRod stroke.";
CM_ SG_ 360 BCS_6_CRC "E2E Profile 5 CRC";
CM_ SG_ 360 BCS_6_Counter "E2E Profile 5 Counter";
CM_ SG_ 360 BCS_HydBrkActvTq_FL "Hydraulic brake torque of the  front left wheel";
CM_ SG_ 360 BCS_HydBrkActvTq_FR "Hydraulic brake torque of the  front right wheel";
CM_ SG_ 360 BCS_HydBrkActvTq_RL "Hydraulic brake torque of the  rear left wheel";
CM_ SG_ 360 BCS_HydBrkActvTq_RR "Hydraulic brake torque of the  rear right wheel";
CM_ SG_ 360 BCS_HydBrkReqTq "It is the target brake torque to hydraulic brake";
CM_ SG_ 360 BCS_BrkActvTq "It is the real total brake  torque carried out by electric motor（ recuperation torque or electric brake torque）and ESP/IPB（hydraulic braketorque）.";
CM_ SG_ 360 BCS_HydBrkActvTq "It is the real hydraulic brake  torque carried out by ESP/IPB.";
CM_ SG_ 360 BCS_DycESCActTq "The real  DYC(Direct  yaw moment control)  of the ESP/IPB";
CM_ SG_ 360 BCS_ERV_VehSpd "Vehicle reference speed ";
CM_ SG_ 360 BCS_BrkTqCtrlAvlDriving "It indicates  whether  ESP/IPB is available for cruise function.";
CM_ SG_ 360 BCS_BrkTqCtrlAvlParking "It indicates  whether  ESP/IPB is available for parking function.";
CM_ SG_ 360 BCS_BrkTqCtrlActv "It indicates  whether  ESP/IPB is  responsed for the brake request of ADAS.";
CM_ SG_ 360 BCS_ERV_VehSpdVld "Quality/fault information to vehicle  reference speed ";
CM_ SG_ 360 BCS_EspFailrSts "It indicates whether ESP/IPB is error.When any function of ESP/IPB is error ，it will be error。";
CM_ SG_ 360 BCS_ActvSts "It indicates whether ESP/IPB is active. When any function of ESP/IPB is active ，it will be active。";
CM_ SG_ 360 BCS_DycEscTarTqCtrlAvl "The validity  of the DYC(Direct  yaw moment control)  of the ESP/IPB";
CM_ SG_ 360 BCS_BDCActive "Indicates Brake Disc Cleaning in active or not";
CM_ SG_ 360 BCS_DTCActvSts "Dragging Torque Control activation status";
CM_ SG_ 360 BCS_errorFb "Errors related to the braking system(ESP/IPB).It indicates the braking system can not respond to the deceleration request（brake torque） of the ADAS。";
CM_ SG_ 360 BCS_DrvrBrkOvrd "Indicate driver brakes torque more than the ADAS/ADS. ";
CM_ SG_ 360 BCS_DrvrBrkOvrdVld "The validity  of  BCS_DrvrBrkOvrd";
CM_ SG_ 360 BCS_DycEscTarTqActv "Indicates the DYC of the ESP/IPB in active or not";
CM_ SG_ 360 BCS_WheelSlipFLValid "The validity  of slip ratio of the  front left wheel";
CM_ SG_ 360 BCS_WheelSlipFRValid "The validity of slip ratio of the  front right wheel";
CM_ SG_ 360 BCS_WheelSlipRLValid "The validity of slip ratio of the  rear left wheel";
CM_ SG_ 360 BCS_WheelSlipRRValid "The validity of slip ratio of the  rear right wheel";
CM_ SG_ 360 BCS_DrvrTqDes "When driver prsees brake pedal，It is the brake torque calculated by ESP/IPB corresponding to  inputRod stroke.";
CM_ SG_ 360 BCS_CrbsTarRecpTorqRqFA "CRBS target recuperation torque requested by BCS to generator,applies to  front wheel drive ";
CM_ SG_ 360 BCS_CrbsTarRecpTorqRqFASt "Status of  BCS_CrbsTarRecpTorqRqFA";
CM_ SG_ 360 BCS_CrbsTarRecpTorqRqRA "CRBS target recuperation torque requested by BCS to generator,applies to  rear wheel drive ";
CM_ SG_ 360 BCS_CrbsTarRecpTorqRqRASt "Status of  BCS_CrbsTarRecpTorqRqRA";
CM_ SG_ 360 BCS_CrbsTarRecpTorqRqSum "CRBS target recuperation torque requested by BCS to generator,applies to 4WD and front wheel drive /rear wheel drive";
CM_ SG_ 360 BCS_CrbsTarRecpTorqRqSumSt "CRBS target recuperation torque requested by BCS to generator,applies to 4WD and front wheel drive /rear wheel drive";
CM_ SG_ 360 BCS_BrkTqCtrlAvlParkingRdn "It indicates  whether  ESP/IPB is available for parking function,in redunant mode,including L3/L4/L5.";
CM_ SG_ 360 BCS_WheelSlipFL "Slip ratio of the  front left wheel";
CM_ SG_ 360 BCS_WheelSlipFR "Slip ratio of the  front right wheel";
CM_ SG_ 360 BCS_WheelSlipRL "Slip ratio of the  rear left wheel";
CM_ SG_ 360 BCS_WheelSlipRR "Slip ratio of the  rear right wheel";
CM_ SG_ 618 EPB_1_CRC "E2E Profile 5 CRC";
CM_ SG_ 618 EPB_1_Counter "E2E Profile 5 Counter";
CM_ SG_ 618 EPB_SwitchSt "EPB switch status ";
CM_ SG_ 618 EPB_SwitchStVD "EPB switch status validity";
CM_ SG_ 618 EPB_SysSt "EPB system status";
CM_ SG_ 618 EPB_FailSt "EPB fail status,to indicate wether EPB can response to external apply  request or not";
CM_ SG_ 618 EPB_ExtAvailable "EPB  status,to indicate wetherEPB can response to externalapply request or not";
CM_ SG_ 618 EPB_DynamicApplySt "EPB dynamic apply status";
CM_ SG_ 618 EPB_ActuatorSt_R "EPB right  actuator status";
CM_ SG_ 618 EPB_RWUActvSts "It indicates whether the RWU  of the ESP/IPB is active";
CM_ SG_ 618 EPB_RWUAvl "It indicates whether the RWU  of the EPB  is available";
CM_ SG_ 618 EPB_RPAAVPAvailability "Flag indicate  RPA AVP availability for EPB control";
CM_ SG_ 618 EPB_APAAvailability "Flag indicate  APA availability for EPB control";
CM_ SG_ 618 EPB_ADCNetErrorFb "ADC Network Fault Feedback";
CM_ SG_ 618 EPB_NetModeResp "EPB Net Mode Response";
CM_ SG_ 433 CCU_GVS_3_CRC "E2E Profile 5 CRC";
CM_ SG_ 433 CCU_GVS_3_Counter "E2E Profile 5 Counter";
CM_ SG_ 433 AccPedalPstForMRR "Current accelerate pedal actual position for MRR";
CM_ SG_ 433 AccPedalPstForMRRVD "Current accelerate pedal actual position validity for MRR";
CM_ SG_ 433 VCU_VehActDrvTorqRR "Vehicle actual drive torque for right rear wheel hub motor";
CM_ SG_ 433 VCU_VehActDrvTorqRRVD "Vehicle actual drive torque valid data for right rear wheel hub motor";
CM_ SG_ 433 VCU_FrntWhlReqTq "Required Torque for Front Axle Motor(or Front Left )";
CM_ SG_ 433 VCU_FrntWhlReqTqVld "Required Torque for Front Axle or Front Left Motor Valid Bit";
CM_ SG_ 433 VCU_ReWhlReqTqRR "Required Torque for Rear Right Motor";
CM_ SG_ 433 VCU_ReWhlReqTqRRVld "Required Torque for Rear Right Motor Valid Bit";
CM_ SG_ 433 VCU_ReWhlReqTqRL "Required Torque for Rear Left(or Rear) motor";
CM_ SG_ 433 VCU_ReWhlReqTqRLVld "Required Torque for Rear Left(or Rear) Motor Valid Bit";
CM_ SG_ 433 VCU_DrvYawMomAvl "The Available Status of the Yaw Moment Interface";
CM_ SG_ 433 VCU_DrvYawMomRespSts "The Response Status of the Yaw Moment  Interface";
CM_ SG_ 433 VCU_MotorDrvCaplTqWhlFA "Front Motor Wheel End Driving Torque Capability (or Front Left)";
CM_ SG_ 433 VCU_MotorRgnCaplTqWhlFA "Left Rear Motor Wheel End Negative Torque Capability(or Front Left)";
CM_ SG_ 433 VCU_MotorDrvCaplTqWhlRL "Left Rear(or Rear) Motor Wheel End Driving Torque Capability";
CM_ SG_ 433 VCU_MotorRgnCaplTqWhlRL "Left Rear(or Rear) Motor Wheel End Negative Torque Capability";
CM_ SG_ 433 VCU_MotorDrvCaplTqWhlRR "Right Rear Motor Wheel End Driving Torque Capability";
CM_ SG_ 433 VCU_MotorRgnCaplTqWhlRR "Right Rear Motor Wheel End Negative Torque Capability";
CM_ SG_ 433 VCU_PreStableFlg "VCU Pre Stable Flag";
CM_ SG_ 433 VCU_ErrorFb "VCU上报故障原因";
CM_ SG_ 433 VCU_DrvrAccrPedlOvrdVld "驾驶员加速踏板干预状态有效位";
CM_ SG_ 433 VCU_VehWhlReqTqVld "整车需求轮端扭矩有效";
CM_ SG_ 433 VCU_MotorRegenTrqLmtlnDVaild "整车最大允许制动能量回收扭矩轮端扭矩有效位";
CM_ SG_ 433 VCU_GearShiftAvl "档位切换可用状态";
CM_ SG_ 433 VCU_PtTqAvl "动力系统扭矩可用状态";
CM_ SG_ 433 VCU_PtTqActvSts "VCU扭矩响应状态";
CM_ SG_ 433 VCU_MotorRegenTorqueLmtlnD "整车最大允许制动能量回收扭矩轮端扭矩（扣滑行）";
CM_ SG_ 433 VCU_DriverTorqueDesired "驾驶员需求力矩（驾驶员油门对应的驱动力矩）";
CM_ SG_ 433 VCU_VehWhlReqTq "整车需求轮端扭矩（仲裁滤波后）";
CM_ SG_ 363 EPS_1_CRC "E2E Profile 5 CRC";
CM_ SG_ 363 EPS_1_Counter "E2E Profile 5 Counter";
CM_ SG_ 363 EPS_StrngWhlTorqVD "Steering Wheel Torque valid value";
CM_ SG_ 363 EPS_StrngWhlTorq "Steering wheel Torque ";
CM_ SG_ 363 TAS_CalibratedSt "The calibration information of steering angle sensor";
CM_ SG_ 363 EPS_SteeringAngleSpd "steering wheel angle speed";
CM_ SG_ 363 EPS_SteeringAngle "steering wheel angle";
CM_ SG_ 363 EPS_SteeringAngleVD "indicate that Angle VD";
CM_ SG_ 363 EPS_ThermalSt "EPS over thermal limit state";
CM_ SG_ 363 EPS_VMCErrFeedback "EPS Error reason feedback to VMC";
CM_ SG_ 363 EPS_PstOverlaySt "Overall EPS Position Overlay Control State";
CM_ SG_ 363 EPS_HealthySt_DualSide "Overall EPS Healthy States";
CM_ SG_ 363 EPS_VibrationWarnSt_A "Vibration Warn State";
CM_ SG_ 363 SAC_ErrFeedback_SideA "EPS_A Errer Feedback";
CM_ SG_ 363 EPS_ADASTargetAngle "EPS's target Angle after the safety limit";
CM_ SG_ 363 EPS_FunctionStyleSt "EPS function style state";
CM_ SG_ 363 EPS_SteeringModeSt "EPS steering mode status";
CM_ SG_ 363 EPS_ReqAngOverRange "target angle received from ADAS/IFC over the safety range";
CM_ SG_ 363 EPS_SACMotorTorAct "SAC Actural motor torque";
CM_ SG_ 363 EPS_SACMotorTorLimInt "EPS’s internal safety limit of SAC motor torque";
CM_ SG_ 363 EPS_ReqAngSpdOverRange "Angular speed of target angle received from ADAS/IFC over the safety range";
CM_ SG_ 363 EPS_AssistPraSwitchToLKA "Indicate EPS Swithinto fixed steering parameters";
CM_ SG_ 363 EPS_SteerGainEnable "Steering Gain Enable";
CM_ SG_ 363 EPS_EmSteerEnbale "Emergency Steering Enable";
CM_ SG_ 363 EPS_EM_ErrFeedback "Emergency Steering Enable Feedback";
CM_ SG_ 363 EPS_VW_ErrFeedback "Vibration Warn Enable Feedback";
CM_ SG_ 363 EPS_SG_ErrFeedback "Steering Gain Enable Error Feedback";
CM_ SG_ 363 EPS_SACMotorTorActMot "SAC Actural motor torque";
CM_ SG_ 363 EPS_MotorTorSum "EPS Motor output Torque  (including SAC and driver steering) ";
CM_ SG_ 363 EPS_WarnLamp "Streering Warning Lamp";
CM_ SG_ 363 EPS_AssistRatio "feedback to IDC the assist ratio ";
CM_ SG_ 363 EPS_SteeringWhlTorFlt "Steering wheel torque after Elfa filtering";
CM_ SG_ 363 EPS_SteeringWhlTorFltVD "indicate that EPS_SteeringWhlTorFlt Valid or not";
CM_ SG_ 363 EPS_SteeringAngleRate "steering wheel angle rate";
CM_ SG_ 363 EPS_TqCtrlSt "ESP response state for ADAS moter torque request";
CM_ SG_ 363 EPS_MotorTorForDrv "EPS motor Torque value for driver steering";
CM_ SG_ 363 EPS_TqCtrlAvl "EPS moter torque control available state for ADAS";
CM_ SG_ 363 EPS_AgCtrlAvl "EPS steer angle control available state for ADAS";
CM_ SG_ 363 EPS_MotorTorSumVD "EPS motor torque valid state of driver steering";
CM_ SG_ 363 EPS_DrvOveRideSt "Driver override detection state";
CM_ SG_ 363 EPS_DrvOveRideVD "Driver override detection valid state";
CM_ SG_ 363 EPS_SteerVibrlAvl "EPS steer vibration control available state for ADAS";
CM_ SG_ 363 EPS_HandsOffDetStVD "Hands Off Detected States valid value";
CM_ SG_ 363 EPS_HandsOffDetSt "Hands Off Detected States";
CM_ SG_ 363 EPS_SteerMod "EPS working mode";
CM_ SG_ 363 EPS_ADCNetErrorFb "ADC Network Fault Feedback";
CM_ SG_ 363 EPS_NetModeResp "EPS Net Mode Response";
CM_ SG_ 362 EPSB_1_CRC "E2E Profile 5 CRC";
CM_ SG_ 362 EPSB_1_Counter "E2E Profile 5 Counter";
CM_ SG_ 362 EPSB_StrngWhlTorqVD "Steering Wheel Torque valid value";
CM_ SG_ 362 EPSB_StrngWhlTorq "Steering wheel Torque ";
CM_ SG_ 362 EPSB_TAS_CalibratedSt "The calibration information of steering angle sensor";
CM_ SG_ 362 EPSB_SteeringAngleSpd "steering wheel angle speed";
CM_ SG_ 362 EPSB_SteeringAngle "steering wheel angle";
CM_ SG_ 362 EPSB_SteeringAngleVD "indicate that Angle VD";
CM_ SG_ 362 EPSB_ThermalSt "EPS over thermal limit state";
CM_ SG_ 362 EPSB_VMCErrFeedback "EPS Error reason feedback to VMC";
CM_ SG_ 362 EPSB_PstOverlaySt "Overall EPS Position Overlay Control State";
CM_ SG_ 362 EPSB_HealthySt_DualSide "Overall EPS Healthy States";
CM_ SG_ 362 EPSB_VibrationWarnSt "Vibration Warn State";
CM_ SG_ 362 EPSB_SAC_ErrFeedback_SideA "EPS_A Errer Feedback";
CM_ SG_ 362 EPSB_ADASTargetAngle "EPS's target Angle after the safety limit";
CM_ SG_ 362 EPSB_FunctionStyleSt "EPS function style state";
CM_ SG_ 362 EPSB_SteeringModeSt "EPS steering mode status";
CM_ SG_ 362 EPSB_ReqAngOverRange "target angle received from ADAS/IFC over the safety range";
CM_ SG_ 362 EPSB_SACMotorTorAct "SAC Actural motor torque";
CM_ SG_ 362 EPSB_SACMotorTorLimInt "EPS’s internal safety limit of SAC motor torque";
CM_ SG_ 362 EPSB_ReqAngSpdOverRange "Angular speed of target angle received from ADAS/IFC over the safety range";
CM_ SG_ 362 EPSB_AssistPraSwitchToLKA "Indicate EPS Swithinto fixed steering parameters";
CM_ SG_ 362 EPSB_SteerGainEnable "Steering Gain Enable";
CM_ SG_ 362 EPSB_EmSteerEnbale "Emergency Steering Enable";
CM_ SG_ 362 EPSB_EM_ErrFeedback "Emergency Steering Enable Feedback";
CM_ SG_ 362 EPSB_VW_ErrFeedback "Vibration Warn Enable Feedback";
CM_ SG_ 362 EPSB_SG_ErrFeedback "Steering Gain Enable Error Feedback";
CM_ SG_ 362 EPSB_SACMotorTorActMot "SAC Actural motor torque";
CM_ SG_ 362 EPSB_MotorTorSum "EPS Motor output Torque  (including SAC and driver steering) ";
CM_ SG_ 362 EPSB_WarnLamp "Streering Warning Lamp";
CM_ SG_ 362 EPSB_AssistPercentage "Indicate EPS actual work output";
CM_ SG_ 362 EPSB_AssistRatio "feedback to IDC the assist ratio ";
CM_ SG_ 362 EPSB_StrngWhlTorqFlt "Steering wheel torque after Elfa filtering";
CM_ SG_ 362 EPSB_SteeringWhlTorFltVD "indicate that EPS_SteeringWhlTorFlt Valid or not";
CM_ SG_ 362 EPSB_SteeringAngleRate "steering wheel angle rate";
CM_ SG_ 362 EPSB_TqCtrlSt "ESP response state for ADAS moter torque request";
CM_ SG_ 362 EPSB_MotorTorForDrv "EPS motor Torque value for driver steering";
CM_ SG_ 362 EPSB_TqCtrlAvl "EPS moter torque control available state for ADAS";
CM_ SG_ 362 EPSB_AgCtrlAvl "EPS steer angle control available state for ADAS";
CM_ SG_ 362 EPSB_MotorTorSumVD "EPS motor torque valid state of driver steering";
CM_ SG_ 362 EPSB_DrvOveRideSt "Driver override detection state";
CM_ SG_ 362 EPSB_DrvOveRideVD "Driver override detection valid state";
CM_ SG_ 362 EPSB_SteerVibrlAvl "EPS steer vibration control available state for ADAS";
CM_ SG_ 362 EPSB_HandsOffDetStVD "Hands Off Detected States valid value";
CM_ SG_ 362 EPSB_HandsOffDetSt "Hands Off Detected States";
CM_ SG_ 362 EPSB_SteerMod "EPS working mode";
CM_ SG_ 362 EPSB_ADCNetErrorFb "ADC Network Fault Feedback";
CM_ SG_ 362 EPSB_NetModeResp "EPS Net Mode Response";
CM_ SG_ 905 ICM_SetIACCSt "ICM set IACC status";
CM_ SG_ 905 ICM_TotalOdometer "Total odometer";
CM_ SG_ 905 ICM_VehInsSpd "Vehicle instantaneous speed";
CM_ SG_ 905 ICM_TotalOdometer_accurate "ODO value as accuracy of 0.1 km";
CM_ SG_ 905 ICM_VehInsSpd_accurate "Vehicle instantaneous speed";
CM_ SG_ 905 ICM_FuelAvaibleDriveDistance "The available driving distance according to the fuel";
CM_ SG_ 905 ICM_TotalAvaibleDriveDistance "The available driving distance according to the total";
CM_ SG_ 1045 ACU_Longitude "Longitude";
CM_ SG_ 1045 ACU_Latitude "Latitude";
CM_ SG_ 1045 ACU_CampingModeSt "The state of camping mode";

BA_DEF_ BO_  "GenMsgCycleTime" INT 0 0;
BA_DEF_ BO_  "GenMsgCycleTimeFast" INT 0 0;
BA_DEF_ BO_  "GenMsgSendType" ENUM  "Periodic","Event","IfActive","POE","PA","FixedPeriodic","Event","EnabledPeriodic","NotUsed","NotUsed","EventPeriodic","NotUsed","NotUsed","NoMsgSendType";
BA_DEF_ BO_  "VFrameFormat" ENUM  "StandardCAN","ExtendedCAN","reserved","reserved","reserved","reserved","reserved","reserved","reserved","reserved","reserved","reserved","reserved","reserved","StandardCAN_FD","ExtendedCAN_FD";
BA_DEF_ BO_  "CANFD_BRS" ENUM  "0","1";
BA_DEF_ SG_  "EventCommandSignal" ENUM  "No","Yes";
BA_DEF_ SG_  "GatewayedSignals" ENUM  "No","Yes";
BA_DEF_ SG_  "GenSigInactiveValue" HEX 0 0;
BA_DEF_ SG_  "GenSigInvalidValue" HEX 0 0;
BA_DEF_ SG_  "GenSigSendType" ENUM  "Trigger","Passive","Cyclic","OnWrite","OnWriteWithRepetition","OnChange","OnChangeWithRepetition","IfActive","IfActiveWithRepetition","NoSigSendType";
BA_DEF_ SG_  "GenSigStartValue" HEX 0 0;
BA_DEF_ SG_  "GenSigTimeoutValue" HEX 0 0;
BA_DEF_ SG_  "Remark" STRING ;
BA_ "GenMsgCycleTime" BO_ 611 20;
BA_ "GenMsgCycleTimeFast" BO_ 611 0;
BA_ "GenMsgSendType" BO_ 611 0;
BA_ "VFrameFormat" BO_ 611 14;
BA_ "CANFD_BRS" BO_ 611 1;
BA_ "GenMsgCycleTime" BO_ 611 20;
BA_ "GenMsgCycleTimeFast" BO_ 611 0;
BA_ "GenMsgSendType" BO_ 611 0;
BA_ "VFrameFormat" BO_ 611 14;
BA_ "CANFD_BRS" BO_ 611 1;
BA_ "GenMsgCycleTime" BO_ 611 20;
BA_ "GenMsgCycleTimeFast" BO_ 611 0;
BA_ "GenMsgSendType" BO_ 611 0;
BA_ "VFrameFormat" BO_ 611 14;
BA_ "CANFD_BRS" BO_ 611 1;
BA_ "GenMsgCycleTime" BO_ 611 20;
BA_ "GenMsgCycleTimeFast" BO_ 611 0;
BA_ "GenMsgSendType" BO_ 611 0;
BA_ "VFrameFormat" BO_ 611 14;
BA_ "CANFD_BRS" BO_ 611 1;
BA_ "GenMsgCycleTime" BO_ 611 20;
BA_ "GenMsgCycleTimeFast" BO_ 611 0;
BA_ "GenMsgSendType" BO_ 611 0;
BA_ "VFrameFormat" BO_ 611 14;
BA_ "CANFD_BRS" BO_ 611 1;
BA_ "GenMsgCycleTime" BO_ 611 20;
BA_ "GenMsgCycleTimeFast" BO_ 611 0;
BA_ "GenMsgSendType" BO_ 611 0;
BA_ "VFrameFormat" BO_ 611 14;
BA_ "CANFD_BRS" BO_ 611 1;
BA_ "GenMsgCycleTime" BO_ 611 20;
BA_ "GenMsgCycleTimeFast" BO_ 611 0;
BA_ "GenMsgSendType" BO_ 611 0;
BA_ "VFrameFormat" BO_ 611 14;
BA_ "CANFD_BRS" BO_ 611 1;
BA_ "GenMsgCycleTime" BO_ 611 20;
BA_ "GenMsgCycleTimeFast" BO_ 611 0;
BA_ "GenMsgSendType" BO_ 611 0;
BA_ "VFrameFormat" BO_ 611 14;
BA_ "CANFD_BRS" BO_ 611 1;
BA_ "GenMsgCycleTime" BO_ 611 20;
BA_ "GenMsgCycleTimeFast" BO_ 611 0;
BA_ "GenMsgSendType" BO_ 611 0;
BA_ "VFrameFormat" BO_ 611 14;
BA_ "CANFD_BRS" BO_ 611 1;
BA_ "GenMsgCycleTime" BO_ 611 20;
BA_ "GenMsgCycleTimeFast" BO_ 611 0;
BA_ "GenMsgSendType" BO_ 611 0;
BA_ "VFrameFormat" BO_ 611 14;
BA_ "CANFD_BRS" BO_ 611 1;
BA_ "GenMsgCycleTime" BO_ 611 20;
BA_ "GenMsgCycleTimeFast" BO_ 611 0;
BA_ "GenMsgSendType" BO_ 611 0;
BA_ "VFrameFormat" BO_ 611 14;
BA_ "CANFD_BRS" BO_ 611 1;
BA_ "GenMsgCycleTime" BO_ 611 20;
BA_ "GenMsgCycleTimeFast" BO_ 611 0;
BA_ "GenMsgSendType" BO_ 611 0;
BA_ "VFrameFormat" BO_ 611 14;
BA_ "CANFD_BRS" BO_ 611 1;
BA_ "GenMsgCycleTime" BO_ 611 20;
BA_ "GenMsgCycleTimeFast" BO_ 611 0;
BA_ "GenMsgSendType" BO_ 611 0;
BA_ "VFrameFormat" BO_ 611 14;
BA_ "CANFD_BRS" BO_ 611 1;
BA_ "GenMsgCycleTime" BO_ 611 20;
BA_ "GenMsgCycleTimeFast" BO_ 611 0;
BA_ "GenMsgSendType" BO_ 611 0;
BA_ "VFrameFormat" BO_ 611 14;
BA_ "CANFD_BRS" BO_ 611 1;
BA_ "GenMsgCycleTime" BO_ 611 20;
BA_ "GenMsgCycleTimeFast" BO_ 611 0;
BA_ "GenMsgSendType" BO_ 611 0;
BA_ "VFrameFormat" BO_ 611 14;
BA_ "CANFD_BRS" BO_ 611 1;
BA_ "GenMsgCycleTime" BO_ 611 20;
BA_ "GenMsgCycleTimeFast" BO_ 611 0;
BA_ "GenMsgSendType" BO_ 611 0;
BA_ "VFrameFormat" BO_ 611 14;
BA_ "CANFD_BRS" BO_ 611 1;
BA_ "GenMsgCycleTime" BO_ 611 20;
BA_ "GenMsgCycleTimeFast" BO_ 611 0;
BA_ "GenMsgSendType" BO_ 611 0;
BA_ "VFrameFormat" BO_ 611 14;
BA_ "CANFD_BRS" BO_ 611 1;
BA_ "GenMsgCycleTime" BO_ 611 20;
BA_ "GenMsgCycleTimeFast" BO_ 611 0;
BA_ "GenMsgSendType" BO_ 611 0;
BA_ "VFrameFormat" BO_ 611 14;
BA_ "CANFD_BRS" BO_ 611 1;
BA_ "GenMsgCycleTime" BO_ 611 20;
BA_ "GenMsgCycleTimeFast" BO_ 611 0;
BA_ "GenMsgSendType" BO_ 611 0;
BA_ "VFrameFormat" BO_ 611 14;
BA_ "CANFD_BRS" BO_ 611 1;
BA_ "GenMsgCycleTime" BO_ 611 20;
BA_ "GenMsgCycleTimeFast" BO_ 611 0;
BA_ "GenMsgSendType" BO_ 611 0;
BA_ "VFrameFormat" BO_ 611 14;
BA_ "CANFD_BRS" BO_ 611 1;
BA_ "GenMsgCycleTime" BO_ 611 20;
BA_ "GenMsgCycleTimeFast" BO_ 611 0;
BA_ "GenMsgSendType" BO_ 611 0;
BA_ "VFrameFormat" BO_ 611 14;
BA_ "CANFD_BRS" BO_ 611 1;
BA_ "GenMsgCycleTime" BO_ 611 20;
BA_ "GenMsgCycleTimeFast" BO_ 611 0;
BA_ "GenMsgSendType" BO_ 611 0;
BA_ "VFrameFormat" BO_ 611 14;
BA_ "CANFD_BRS" BO_ 611 1;
BA_ "GenMsgCycleTime" BO_ 611 20;
BA_ "GenMsgCycleTimeFast" BO_ 611 0;
BA_ "GenMsgSendType" BO_ 611 0;
BA_ "VFrameFormat" BO_ 611 14;
BA_ "CANFD_BRS" BO_ 611 1;
BA_ "GenMsgCycleTime" BO_ 611 20;
BA_ "GenMsgCycleTimeFast" BO_ 611 0;
BA_ "GenMsgSendType" BO_ 611 0;
BA_ "VFrameFormat" BO_ 611 14;
BA_ "CANFD_BRS" BO_ 611 1;
BA_ "GenMsgCycleTime" BO_ 611 20;
BA_ "GenMsgCycleTimeFast" BO_ 611 0;
BA_ "GenMsgSendType" BO_ 611 0;
BA_ "VFrameFormat" BO_ 611 14;
BA_ "CANFD_BRS" BO_ 611 1;
BA_ "GenMsgCycleTime" BO_ 611 20;
BA_ "GenMsgCycleTimeFast" BO_ 611 0;
BA_ "GenMsgSendType" BO_ 611 0;
BA_ "VFrameFormat" BO_ 611 14;
BA_ "CANFD_BRS" BO_ 611 1;
BA_ "GenMsgCycleTime" BO_ 611 20;
BA_ "GenMsgCycleTimeFast" BO_ 611 0;
BA_ "GenMsgSendType" BO_ 611 0;
BA_ "VFrameFormat" BO_ 611 14;
BA_ "CANFD_BRS" BO_ 611 1;
BA_ "GenMsgCycleTime" BO_ 611 20;
BA_ "GenMsgCycleTimeFast" BO_ 611 0;
BA_ "GenMsgSendType" BO_ 611 0;
BA_ "VFrameFormat" BO_ 611 14;
BA_ "CANFD_BRS" BO_ 611 1;
BA_ "GenMsgCycleTime" BO_ 360 10;
BA_ "GenMsgCycleTimeFast" BO_ 360 0;
BA_ "GenMsgSendType" BO_ 360 0;
BA_ "VFrameFormat" BO_ 360 14;
BA_ "CANFD_BRS" BO_ 360 1;
BA_ "GenMsgCycleTime" BO_ 360 10;
BA_ "GenMsgCycleTimeFast" BO_ 360 0;
BA_ "GenMsgSendType" BO_ 360 0;
BA_ "VFrameFormat" BO_ 360 14;
BA_ "CANFD_BRS" BO_ 360 1;
BA_ "GenMsgCycleTime" BO_ 360 10;
BA_ "GenMsgCycleTimeFast" BO_ 360 0;
BA_ "GenMsgSendType" BO_ 360 0;
BA_ "VFrameFormat" BO_ 360 14;
BA_ "CANFD_BRS" BO_ 360 1;
BA_ "GenMsgCycleTime" BO_ 360 10;
BA_ "GenMsgCycleTimeFast" BO_ 360 0;
BA_ "GenMsgSendType" BO_ 360 0;
BA_ "VFrameFormat" BO_ 360 14;
BA_ "CANFD_BRS" BO_ 360 1;
BA_ "GenMsgCycleTime" BO_ 360 10;
BA_ "GenMsgCycleTimeFast" BO_ 360 0;
BA_ "GenMsgSendType" BO_ 360 0;
BA_ "VFrameFormat" BO_ 360 14;
BA_ "CANFD_BRS" BO_ 360 1;
BA_ "GenMsgCycleTime" BO_ 360 10;
BA_ "GenMsgCycleTimeFast" BO_ 360 0;
BA_ "GenMsgSendType" BO_ 360 0;
BA_ "VFrameFormat" BO_ 360 14;
BA_ "CANFD_BRS" BO_ 360 1;
BA_ "GenMsgCycleTime" BO_ 360 10;
BA_ "GenMsgCycleTimeFast" BO_ 360 0;
BA_ "GenMsgSendType" BO_ 360 0;
BA_ "VFrameFormat" BO_ 360 14;
BA_ "CANFD_BRS" BO_ 360 1;
BA_ "GenMsgCycleTime" BO_ 360 10;
BA_ "GenMsgCycleTimeFast" BO_ 360 0;
BA_ "GenMsgSendType" BO_ 360 0;
BA_ "VFrameFormat" BO_ 360 14;
BA_ "CANFD_BRS" BO_ 360 1;
BA_ "GenMsgCycleTime" BO_ 360 10;
BA_ "GenMsgCycleTimeFast" BO_ 360 0;
BA_ "GenMsgSendType" BO_ 360 0;
BA_ "VFrameFormat" BO_ 360 14;
BA_ "CANFD_BRS" BO_ 360 1;
BA_ "GenMsgCycleTime" BO_ 360 10;
BA_ "GenMsgCycleTimeFast" BO_ 360 0;
BA_ "GenMsgSendType" BO_ 360 0;
BA_ "VFrameFormat" BO_ 360 14;
BA_ "CANFD_BRS" BO_ 360 1;
BA_ "GenMsgCycleTime" BO_ 360 10;
BA_ "GenMsgCycleTimeFast" BO_ 360 0;
BA_ "GenMsgSendType" BO_ 360 0;
BA_ "VFrameFormat" BO_ 360 14;
BA_ "CANFD_BRS" BO_ 360 1;
BA_ "GenMsgCycleTime" BO_ 360 10;
BA_ "GenMsgCycleTimeFast" BO_ 360 0;
BA_ "GenMsgSendType" BO_ 360 0;
BA_ "VFrameFormat" BO_ 360 14;
BA_ "CANFD_BRS" BO_ 360 1;
BA_ "GenMsgCycleTime" BO_ 360 10;
BA_ "GenMsgCycleTimeFast" BO_ 360 0;
BA_ "GenMsgSendType" BO_ 360 0;
BA_ "VFrameFormat" BO_ 360 14;
BA_ "CANFD_BRS" BO_ 360 1;
BA_ "GenMsgCycleTime" BO_ 360 10;
BA_ "GenMsgCycleTimeFast" BO_ 360 0;
BA_ "GenMsgSendType" BO_ 360 0;
BA_ "VFrameFormat" BO_ 360 14;
BA_ "CANFD_BRS" BO_ 360 1;
BA_ "GenMsgCycleTime" BO_ 360 10;
BA_ "GenMsgCycleTimeFast" BO_ 360 0;
BA_ "GenMsgSendType" BO_ 360 0;
BA_ "VFrameFormat" BO_ 360 14;
BA_ "CANFD_BRS" BO_ 360 1;
BA_ "GenMsgCycleTime" BO_ 360 10;
BA_ "GenMsgCycleTimeFast" BO_ 360 0;
BA_ "GenMsgSendType" BO_ 360 0;
BA_ "VFrameFormat" BO_ 360 14;
BA_ "CANFD_BRS" BO_ 360 1;
BA_ "GenMsgCycleTime" BO_ 360 10;
BA_ "GenMsgCycleTimeFast" BO_ 360 0;
BA_ "GenMsgSendType" BO_ 360 0;
BA_ "VFrameFormat" BO_ 360 14;
BA_ "CANFD_BRS" BO_ 360 1;
BA_ "GenMsgCycleTime" BO_ 360 10;
BA_ "GenMsgCycleTimeFast" BO_ 360 0;
BA_ "GenMsgSendType" BO_ 360 0;
BA_ "VFrameFormat" BO_ 360 14;
BA_ "CANFD_BRS" BO_ 360 1;
BA_ "GenMsgCycleTime" BO_ 360 10;
BA_ "GenMsgCycleTimeFast" BO_ 360 0;
BA_ "GenMsgSendType" BO_ 360 0;
BA_ "VFrameFormat" BO_ 360 14;
BA_ "CANFD_BRS" BO_ 360 1;
BA_ "GenMsgCycleTime" BO_ 360 10;
BA_ "GenMsgCycleTimeFast" BO_ 360 0;
BA_ "GenMsgSendType" BO_ 360 0;
BA_ "VFrameFormat" BO_ 360 14;
BA_ "CANFD_BRS" BO_ 360 1;
BA_ "GenMsgCycleTime" BO_ 360 10;
BA_ "GenMsgCycleTimeFast" BO_ 360 0;
BA_ "GenMsgSendType" BO_ 360 0;
BA_ "VFrameFormat" BO_ 360 14;
BA_ "CANFD_BRS" BO_ 360 1;
BA_ "GenMsgCycleTime" BO_ 360 10;
BA_ "GenMsgCycleTimeFast" BO_ 360 0;
BA_ "GenMsgSendType" BO_ 360 0;
BA_ "VFrameFormat" BO_ 360 14;
BA_ "CANFD_BRS" BO_ 360 1;
BA_ "GenMsgCycleTime" BO_ 360 10;
BA_ "GenMsgCycleTimeFast" BO_ 360 0;
BA_ "GenMsgSendType" BO_ 360 0;
BA_ "VFrameFormat" BO_ 360 14;
BA_ "CANFD_BRS" BO_ 360 1;
BA_ "GenMsgCycleTime" BO_ 360 10;
BA_ "GenMsgCycleTimeFast" BO_ 360 0;
BA_ "GenMsgSendType" BO_ 360 0;
BA_ "VFrameFormat" BO_ 360 14;
BA_ "CANFD_BRS" BO_ 360 1;
BA_ "GenMsgCycleTime" BO_ 360 10;
BA_ "GenMsgCycleTimeFast" BO_ 360 0;
BA_ "GenMsgSendType" BO_ 360 0;
BA_ "VFrameFormat" BO_ 360 14;
BA_ "CANFD_BRS" BO_ 360 1;
BA_ "GenMsgCycleTime" BO_ 360 10;
BA_ "GenMsgCycleTimeFast" BO_ 360 0;
BA_ "GenMsgSendType" BO_ 360 0;
BA_ "VFrameFormat" BO_ 360 14;
BA_ "CANFD_BRS" BO_ 360 1;
BA_ "GenMsgCycleTime" BO_ 360 10;
BA_ "GenMsgCycleTimeFast" BO_ 360 0;
BA_ "GenMsgSendType" BO_ 360 0;
BA_ "VFrameFormat" BO_ 360 14;
BA_ "CANFD_BRS" BO_ 360 1;
BA_ "GenMsgCycleTime" BO_ 360 10;
BA_ "GenMsgCycleTimeFast" BO_ 360 0;
BA_ "GenMsgSendType" BO_ 360 0;
BA_ "VFrameFormat" BO_ 360 14;
BA_ "CANFD_BRS" BO_ 360 1;
BA_ "GenMsgCycleTime" BO_ 360 10;
BA_ "GenMsgCycleTimeFast" BO_ 360 0;
BA_ "GenMsgSendType" BO_ 360 0;
BA_ "VFrameFormat" BO_ 360 14;
BA_ "CANFD_BRS" BO_ 360 1;
BA_ "GenMsgCycleTime" BO_ 360 10;
BA_ "GenMsgCycleTimeFast" BO_ 360 0;
BA_ "GenMsgSendType" BO_ 360 0;
BA_ "VFrameFormat" BO_ 360 14;
BA_ "CANFD_BRS" BO_ 360 1;
BA_ "GenMsgCycleTime" BO_ 360 10;
BA_ "GenMsgCycleTimeFast" BO_ 360 0;
BA_ "GenMsgSendType" BO_ 360 0;
BA_ "VFrameFormat" BO_ 360 14;
BA_ "CANFD_BRS" BO_ 360 1;
BA_ "GenMsgCycleTime" BO_ 360 10;
BA_ "GenMsgCycleTimeFast" BO_ 360 0;
BA_ "GenMsgSendType" BO_ 360 0;
BA_ "VFrameFormat" BO_ 360 14;
BA_ "CANFD_BRS" BO_ 360 1;
BA_ "GenMsgCycleTime" BO_ 360 10;
BA_ "GenMsgCycleTimeFast" BO_ 360 0;
BA_ "GenMsgSendType" BO_ 360 0;
BA_ "VFrameFormat" BO_ 360 14;
BA_ "CANFD_BRS" BO_ 360 1;
BA_ "GenMsgCycleTime" BO_ 360 10;
BA_ "GenMsgCycleTimeFast" BO_ 360 0;
BA_ "GenMsgSendType" BO_ 360 0;
BA_ "VFrameFormat" BO_ 360 14;
BA_ "CANFD_BRS" BO_ 360 1;
BA_ "GenMsgCycleTime" BO_ 360 10;
BA_ "GenMsgCycleTimeFast" BO_ 360 0;
BA_ "GenMsgSendType" BO_ 360 0;
BA_ "VFrameFormat" BO_ 360 14;
BA_ "CANFD_BRS" BO_ 360 1;
BA_ "GenMsgCycleTime" BO_ 360 10;
BA_ "GenMsgCycleTimeFast" BO_ 360 0;
BA_ "GenMsgSendType" BO_ 360 0;
BA_ "VFrameFormat" BO_ 360 14;
BA_ "CANFD_BRS" BO_ 360 1;
BA_ "GenMsgCycleTime" BO_ 360 10;
BA_ "GenMsgCycleTimeFast" BO_ 360 0;
BA_ "GenMsgSendType" BO_ 360 0;
BA_ "VFrameFormat" BO_ 360 14;
BA_ "CANFD_BRS" BO_ 360 1;
BA_ "GenMsgCycleTime" BO_ 360 10;
BA_ "GenMsgCycleTimeFast" BO_ 360 0;
BA_ "GenMsgSendType" BO_ 360 0;
BA_ "VFrameFormat" BO_ 360 14;
BA_ "CANFD_BRS" BO_ 360 1;
BA_ "GenMsgCycleTime" BO_ 360 10;
BA_ "GenMsgCycleTimeFast" BO_ 360 0;
BA_ "GenMsgSendType" BO_ 360 0;
BA_ "VFrameFormat" BO_ 360 14;
BA_ "CANFD_BRS" BO_ 360 1;
BA_ "GenMsgCycleTime" BO_ 360 10;
BA_ "GenMsgCycleTimeFast" BO_ 360 0;
BA_ "GenMsgSendType" BO_ 360 0;
BA_ "VFrameFormat" BO_ 360 14;
BA_ "CANFD_BRS" BO_ 360 1;
BA_ "GenMsgCycleTime" BO_ 618 20;
BA_ "GenMsgCycleTimeFast" BO_ 618 0;
BA_ "GenMsgSendType" BO_ 618 0;
BA_ "VFrameFormat" BO_ 618 14;
BA_ "CANFD_BRS" BO_ 618 1;
BA_ "GenMsgCycleTime" BO_ 618 20;
BA_ "GenMsgCycleTimeFast" BO_ 618 0;
BA_ "GenMsgSendType" BO_ 618 0;
BA_ "VFrameFormat" BO_ 618 14;
BA_ "CANFD_BRS" BO_ 618 1;
BA_ "GenMsgCycleTime" BO_ 618 20;
BA_ "GenMsgCycleTimeFast" BO_ 618 0;
BA_ "GenMsgSendType" BO_ 618 0;
BA_ "VFrameFormat" BO_ 618 14;
BA_ "CANFD_BRS" BO_ 618 1;
BA_ "GenMsgCycleTime" BO_ 618 20;
BA_ "GenMsgCycleTimeFast" BO_ 618 0;
BA_ "GenMsgSendType" BO_ 618 0;
BA_ "VFrameFormat" BO_ 618 14;
BA_ "CANFD_BRS" BO_ 618 1;
BA_ "GenMsgCycleTime" BO_ 618 20;
BA_ "GenMsgCycleTimeFast" BO_ 618 0;
BA_ "GenMsgSendType" BO_ 618 0;
BA_ "VFrameFormat" BO_ 618 14;
BA_ "CANFD_BRS" BO_ 618 1;
BA_ "GenMsgCycleTime" BO_ 618 20;
BA_ "GenMsgCycleTimeFast" BO_ 618 0;
BA_ "GenMsgSendType" BO_ 618 0;
BA_ "VFrameFormat" BO_ 618 14;
BA_ "CANFD_BRS" BO_ 618 1;
BA_ "GenMsgCycleTime" BO_ 618 20;
BA_ "GenMsgCycleTimeFast" BO_ 618 0;
BA_ "GenMsgSendType" BO_ 618 0;
BA_ "VFrameFormat" BO_ 618 14;
BA_ "CANFD_BRS" BO_ 618 1;
BA_ "GenMsgCycleTime" BO_ 618 20;
BA_ "GenMsgCycleTimeFast" BO_ 618 0;
BA_ "GenMsgSendType" BO_ 618 0;
BA_ "VFrameFormat" BO_ 618 14;
BA_ "CANFD_BRS" BO_ 618 1;
BA_ "GenMsgCycleTime" BO_ 618 20;
BA_ "GenMsgCycleTimeFast" BO_ 618 0;
BA_ "GenMsgSendType" BO_ 618 0;
BA_ "VFrameFormat" BO_ 618 14;
BA_ "CANFD_BRS" BO_ 618 1;
BA_ "GenMsgCycleTime" BO_ 618 20;
BA_ "GenMsgCycleTimeFast" BO_ 618 0;
BA_ "GenMsgSendType" BO_ 618 0;
BA_ "VFrameFormat" BO_ 618 14;
BA_ "CANFD_BRS" BO_ 618 1;
BA_ "GenMsgCycleTime" BO_ 618 20;
BA_ "GenMsgCycleTimeFast" BO_ 618 0;
BA_ "GenMsgSendType" BO_ 618 0;
BA_ "VFrameFormat" BO_ 618 14;
BA_ "CANFD_BRS" BO_ 618 1;
BA_ "GenMsgCycleTime" BO_ 618 20;
BA_ "GenMsgCycleTimeFast" BO_ 618 0;
BA_ "GenMsgSendType" BO_ 618 0;
BA_ "VFrameFormat" BO_ 618 14;
BA_ "CANFD_BRS" BO_ 618 1;
BA_ "GenMsgCycleTime" BO_ 618 20;
BA_ "GenMsgCycleTimeFast" BO_ 618 0;
BA_ "GenMsgSendType" BO_ 618 0;
BA_ "VFrameFormat" BO_ 618 14;
BA_ "CANFD_BRS" BO_ 618 1;
BA_ "GenMsgCycleTime" BO_ 618 20;
BA_ "GenMsgCycleTimeFast" BO_ 618 0;
BA_ "GenMsgSendType" BO_ 618 0;
BA_ "VFrameFormat" BO_ 618 14;
BA_ "CANFD_BRS" BO_ 618 1;
BA_ "GenMsgCycleTime" BO_ 618 20;
BA_ "GenMsgCycleTimeFast" BO_ 618 0;
BA_ "GenMsgSendType" BO_ 618 0;
BA_ "VFrameFormat" BO_ 618 14;
BA_ "CANFD_BRS" BO_ 618 1;
BA_ "GenMsgCycleTime" BO_ 433 10;
BA_ "GenMsgCycleTimeFast" BO_ 433 0;
BA_ "GenMsgSendType" BO_ 433 0;
BA_ "VFrameFormat" BO_ 433 14;
BA_ "CANFD_BRS" BO_ 433 1;
BA_ "GenMsgCycleTime" BO_ 433 10;
BA_ "GenMsgCycleTimeFast" BO_ 433 0;
BA_ "GenMsgSendType" BO_ 433 0;
BA_ "VFrameFormat" BO_ 433 14;
BA_ "CANFD_BRS" BO_ 433 1;
BA_ "GenMsgCycleTime" BO_ 433 10;
BA_ "GenMsgCycleTimeFast" BO_ 433 0;
BA_ "GenMsgSendType" BO_ 433 0;
BA_ "VFrameFormat" BO_ 433 14;
BA_ "CANFD_BRS" BO_ 433 1;
BA_ "GenMsgCycleTime" BO_ 433 10;
BA_ "GenMsgCycleTimeFast" BO_ 433 0;
BA_ "GenMsgSendType" BO_ 433 0;
BA_ "VFrameFormat" BO_ 433 14;
BA_ "CANFD_BRS" BO_ 433 1;
BA_ "GenMsgCycleTime" BO_ 433 10;
BA_ "GenMsgCycleTimeFast" BO_ 433 0;
BA_ "GenMsgSendType" BO_ 433 0;
BA_ "VFrameFormat" BO_ 433 14;
BA_ "CANFD_BRS" BO_ 433 1;
BA_ "GenMsgCycleTime" BO_ 433 10;
BA_ "GenMsgCycleTimeFast" BO_ 433 0;
BA_ "GenMsgSendType" BO_ 433 0;
BA_ "VFrameFormat" BO_ 433 14;
BA_ "CANFD_BRS" BO_ 433 1;
BA_ "GenMsgCycleTime" BO_ 433 10;
BA_ "GenMsgCycleTimeFast" BO_ 433 0;
BA_ "GenMsgSendType" BO_ 433 0;
BA_ "VFrameFormat" BO_ 433 14;
BA_ "CANFD_BRS" BO_ 433 1;
BA_ "GenMsgCycleTime" BO_ 433 10;
BA_ "GenMsgCycleTimeFast" BO_ 433 0;
BA_ "GenMsgSendType" BO_ 433 0;
BA_ "VFrameFormat" BO_ 433 14;
BA_ "CANFD_BRS" BO_ 433 1;
BA_ "GenMsgCycleTime" BO_ 433 10;
BA_ "GenMsgCycleTimeFast" BO_ 433 0;
BA_ "GenMsgSendType" BO_ 433 0;
BA_ "VFrameFormat" BO_ 433 14;
BA_ "CANFD_BRS" BO_ 433 1;
BA_ "GenMsgCycleTime" BO_ 433 10;
BA_ "GenMsgCycleTimeFast" BO_ 433 0;
BA_ "GenMsgSendType" BO_ 433 0;
BA_ "VFrameFormat" BO_ 433 14;
BA_ "CANFD_BRS" BO_ 433 1;
BA_ "GenMsgCycleTime" BO_ 433 10;
BA_ "GenMsgCycleTimeFast" BO_ 433 0;
BA_ "GenMsgSendType" BO_ 433 0;
BA_ "VFrameFormat" BO_ 433 14;
BA_ "CANFD_BRS" BO_ 433 1;
BA_ "GenMsgCycleTime" BO_ 433 10;
BA_ "GenMsgCycleTimeFast" BO_ 433 0;
BA_ "GenMsgSendType" BO_ 433 0;
BA_ "VFrameFormat" BO_ 433 14;
BA_ "CANFD_BRS" BO_ 433 1;
BA_ "GenMsgCycleTime" BO_ 433 10;
BA_ "GenMsgCycleTimeFast" BO_ 433 0;
BA_ "GenMsgSendType" BO_ 433 0;
BA_ "VFrameFormat" BO_ 433 14;
BA_ "CANFD_BRS" BO_ 433 1;
BA_ "GenMsgCycleTime" BO_ 433 10;
BA_ "GenMsgCycleTimeFast" BO_ 433 0;
BA_ "GenMsgSendType" BO_ 433 0;
BA_ "VFrameFormat" BO_ 433 14;
BA_ "CANFD_BRS" BO_ 433 1;
BA_ "GenMsgCycleTime" BO_ 433 10;
BA_ "GenMsgCycleTimeFast" BO_ 433 0;
BA_ "GenMsgSendType" BO_ 433 0;
BA_ "VFrameFormat" BO_ 433 14;
BA_ "CANFD_BRS" BO_ 433 1;
BA_ "GenMsgCycleTime" BO_ 433 10;
BA_ "GenMsgCycleTimeFast" BO_ 433 0;
BA_ "GenMsgSendType" BO_ 433 0;
BA_ "VFrameFormat" BO_ 433 14;
BA_ "CANFD_BRS" BO_ 433 1;
BA_ "GenMsgCycleTime" BO_ 433 10;
BA_ "GenMsgCycleTimeFast" BO_ 433 0;
BA_ "GenMsgSendType" BO_ 433 0;
BA_ "VFrameFormat" BO_ 433 14;
BA_ "CANFD_BRS" BO_ 433 1;
BA_ "GenMsgCycleTime" BO_ 433 10;
BA_ "GenMsgCycleTimeFast" BO_ 433 0;
BA_ "GenMsgSendType" BO_ 433 0;
BA_ "VFrameFormat" BO_ 433 14;
BA_ "CANFD_BRS" BO_ 433 1;
BA_ "GenMsgCycleTime" BO_ 433 10;
BA_ "GenMsgCycleTimeFast" BO_ 433 0;
BA_ "GenMsgSendType" BO_ 433 0;
BA_ "VFrameFormat" BO_ 433 14;
BA_ "CANFD_BRS" BO_ 433 1;
BA_ "GenMsgCycleTime" BO_ 433 10;
BA_ "GenMsgCycleTimeFast" BO_ 433 0;
BA_ "GenMsgSendType" BO_ 433 0;
BA_ "VFrameFormat" BO_ 433 14;
BA_ "CANFD_BRS" BO_ 433 1;
BA_ "GenMsgCycleTime" BO_ 433 10;
BA_ "GenMsgCycleTimeFast" BO_ 433 0;
BA_ "GenMsgSendType" BO_ 433 0;
BA_ "VFrameFormat" BO_ 433 14;
BA_ "CANFD_BRS" BO_ 433 1;
BA_ "GenMsgCycleTime" BO_ 433 10;
BA_ "GenMsgCycleTimeFast" BO_ 433 0;
BA_ "GenMsgSendType" BO_ 433 0;
BA_ "VFrameFormat" BO_ 433 14;
BA_ "CANFD_BRS" BO_ 433 1;
BA_ "GenMsgCycleTime" BO_ 433 10;
BA_ "GenMsgCycleTimeFast" BO_ 433 0;
BA_ "GenMsgSendType" BO_ 433 0;
BA_ "VFrameFormat" BO_ 433 14;
BA_ "CANFD_BRS" BO_ 433 1;
BA_ "GenMsgCycleTime" BO_ 433 10;
BA_ "GenMsgCycleTimeFast" BO_ 433 0;
BA_ "GenMsgSendType" BO_ 433 0;
BA_ "VFrameFormat" BO_ 433 14;
BA_ "CANFD_BRS" BO_ 433 1;
BA_ "GenMsgCycleTime" BO_ 433 10;
BA_ "GenMsgCycleTimeFast" BO_ 433 0;
BA_ "GenMsgSendType" BO_ 433 0;
BA_ "VFrameFormat" BO_ 433 14;
BA_ "CANFD_BRS" BO_ 433 1;
BA_ "GenMsgCycleTime" BO_ 433 10;
BA_ "GenMsgCycleTimeFast" BO_ 433 0;
BA_ "GenMsgSendType" BO_ 433 0;
BA_ "VFrameFormat" BO_ 433 14;
BA_ "CANFD_BRS" BO_ 433 1;
BA_ "GenMsgCycleTime" BO_ 433 10;
BA_ "GenMsgCycleTimeFast" BO_ 433 0;
BA_ "GenMsgSendType" BO_ 433 0;
BA_ "VFrameFormat" BO_ 433 14;
BA_ "CANFD_BRS" BO_ 433 1;
BA_ "GenMsgCycleTime" BO_ 433 10;
BA_ "GenMsgCycleTimeFast" BO_ 433 0;
BA_ "GenMsgSendType" BO_ 433 0;
BA_ "VFrameFormat" BO_ 433 14;
BA_ "CANFD_BRS" BO_ 433 1;
BA_ "GenMsgCycleTime" BO_ 433 10;
BA_ "GenMsgCycleTimeFast" BO_ 433 0;
BA_ "GenMsgSendType" BO_ 433 0;
BA_ "VFrameFormat" BO_ 433 14;
BA_ "CANFD_BRS" BO_ 433 1;
BA_ "GenMsgCycleTime" BO_ 433 10;
BA_ "GenMsgCycleTimeFast" BO_ 433 0;
BA_ "GenMsgSendType" BO_ 433 0;
BA_ "VFrameFormat" BO_ 433 14;
BA_ "CANFD_BRS" BO_ 433 1;
BA_ "GenMsgCycleTime" BO_ 433 10;
BA_ "GenMsgCycleTimeFast" BO_ 433 0;
BA_ "GenMsgSendType" BO_ 433 0;
BA_ "VFrameFormat" BO_ 433 14;
BA_ "CANFD_BRS" BO_ 433 1;
BA_ "GenMsgCycleTime" BO_ 363 10;
BA_ "GenMsgCycleTimeFast" BO_ 363 0;
BA_ "GenMsgSendType" BO_ 363 0;
BA_ "VFrameFormat" BO_ 363 14;
BA_ "CANFD_BRS" BO_ 363 1;
BA_ "GenMsgCycleTime" BO_ 363 10;
BA_ "GenMsgCycleTimeFast" BO_ 363 0;
BA_ "GenMsgSendType" BO_ 363 0;
BA_ "VFrameFormat" BO_ 363 14;
BA_ "CANFD_BRS" BO_ 363 1;
BA_ "GenMsgCycleTime" BO_ 363 10;
BA_ "GenMsgCycleTimeFast" BO_ 363 0;
BA_ "GenMsgSendType" BO_ 363 0;
BA_ "VFrameFormat" BO_ 363 14;
BA_ "CANFD_BRS" BO_ 363 1;
BA_ "GenMsgCycleTime" BO_ 363 10;
BA_ "GenMsgCycleTimeFast" BO_ 363 0;
BA_ "GenMsgSendType" BO_ 363 0;
BA_ "VFrameFormat" BO_ 363 14;
BA_ "CANFD_BRS" BO_ 363 1;
BA_ "GenMsgCycleTime" BO_ 363 10;
BA_ "GenMsgCycleTimeFast" BO_ 363 0;
BA_ "GenMsgSendType" BO_ 363 0;
BA_ "VFrameFormat" BO_ 363 14;
BA_ "CANFD_BRS" BO_ 363 1;
BA_ "GenMsgCycleTime" BO_ 363 10;
BA_ "GenMsgCycleTimeFast" BO_ 363 0;
BA_ "GenMsgSendType" BO_ 363 0;
BA_ "VFrameFormat" BO_ 363 14;
BA_ "CANFD_BRS" BO_ 363 1;
BA_ "GenMsgCycleTime" BO_ 363 10;
BA_ "GenMsgCycleTimeFast" BO_ 363 0;
BA_ "GenMsgSendType" BO_ 363 0;
BA_ "VFrameFormat" BO_ 363 14;
BA_ "CANFD_BRS" BO_ 363 1;
BA_ "GenMsgCycleTime" BO_ 363 10;
BA_ "GenMsgCycleTimeFast" BO_ 363 0;
BA_ "GenMsgSendType" BO_ 363 0;
BA_ "VFrameFormat" BO_ 363 14;
BA_ "CANFD_BRS" BO_ 363 1;
BA_ "GenMsgCycleTime" BO_ 363 10;
BA_ "GenMsgCycleTimeFast" BO_ 363 0;
BA_ "GenMsgSendType" BO_ 363 0;
BA_ "VFrameFormat" BO_ 363 14;
BA_ "CANFD_BRS" BO_ 363 1;
BA_ "GenMsgCycleTime" BO_ 363 10;
BA_ "GenMsgCycleTimeFast" BO_ 363 0;
BA_ "GenMsgSendType" BO_ 363 0;
BA_ "VFrameFormat" BO_ 363 14;
BA_ "CANFD_BRS" BO_ 363 1;
BA_ "GenMsgCycleTime" BO_ 363 10;
BA_ "GenMsgCycleTimeFast" BO_ 363 0;
BA_ "GenMsgSendType" BO_ 363 0;
BA_ "VFrameFormat" BO_ 363 14;
BA_ "CANFD_BRS" BO_ 363 1;
BA_ "GenMsgCycleTime" BO_ 363 10;
BA_ "GenMsgCycleTimeFast" BO_ 363 0;
BA_ "GenMsgSendType" BO_ 363 0;
BA_ "VFrameFormat" BO_ 363 14;
BA_ "CANFD_BRS" BO_ 363 1;
BA_ "GenMsgCycleTime" BO_ 363 10;
BA_ "GenMsgCycleTimeFast" BO_ 363 0;
BA_ "GenMsgSendType" BO_ 363 0;
BA_ "VFrameFormat" BO_ 363 14;
BA_ "CANFD_BRS" BO_ 363 1;
BA_ "GenMsgCycleTime" BO_ 363 10;
BA_ "GenMsgCycleTimeFast" BO_ 363 0;
BA_ "GenMsgSendType" BO_ 363 0;
BA_ "VFrameFormat" BO_ 363 14;
BA_ "CANFD_BRS" BO_ 363 1;
BA_ "GenMsgCycleTime" BO_ 363 10;
BA_ "GenMsgCycleTimeFast" BO_ 363 0;
BA_ "GenMsgSendType" BO_ 363 0;
BA_ "VFrameFormat" BO_ 363 14;
BA_ "CANFD_BRS" BO_ 363 1;
BA_ "GenMsgCycleTime" BO_ 363 10;
BA_ "GenMsgCycleTimeFast" BO_ 363 0;
BA_ "GenMsgSendType" BO_ 363 0;
BA_ "VFrameFormat" BO_ 363 14;
BA_ "CANFD_BRS" BO_ 363 1;
BA_ "GenMsgCycleTime" BO_ 363 10;
BA_ "GenMsgCycleTimeFast" BO_ 363 0;
BA_ "GenMsgSendType" BO_ 363 0;
BA_ "VFrameFormat" BO_ 363 14;
BA_ "CANFD_BRS" BO_ 363 1;
BA_ "GenMsgCycleTime" BO_ 363 10;
BA_ "GenMsgCycleTimeFast" BO_ 363 0;
BA_ "GenMsgSendType" BO_ 363 0;
BA_ "VFrameFormat" BO_ 363 14;
BA_ "CANFD_BRS" BO_ 363 1;
BA_ "GenMsgCycleTime" BO_ 363 10;
BA_ "GenMsgCycleTimeFast" BO_ 363 0;
BA_ "GenMsgSendType" BO_ 363 0;
BA_ "VFrameFormat" BO_ 363 14;
BA_ "CANFD_BRS" BO_ 363 1;
BA_ "GenMsgCycleTime" BO_ 363 10;
BA_ "GenMsgCycleTimeFast" BO_ 363 0;
BA_ "GenMsgSendType" BO_ 363 0;
BA_ "VFrameFormat" BO_ 363 14;
BA_ "CANFD_BRS" BO_ 363 1;
BA_ "GenMsgCycleTime" BO_ 363 10;
BA_ "GenMsgCycleTimeFast" BO_ 363 0;
BA_ "GenMsgSendType" BO_ 363 0;
BA_ "VFrameFormat" BO_ 363 14;
BA_ "CANFD_BRS" BO_ 363 1;
BA_ "GenMsgCycleTime" BO_ 363 10;
BA_ "GenMsgCycleTimeFast" BO_ 363 0;
BA_ "GenMsgSendType" BO_ 363 0;
BA_ "VFrameFormat" BO_ 363 14;
BA_ "CANFD_BRS" BO_ 363 1;
BA_ "GenMsgCycleTime" BO_ 363 10;
BA_ "GenMsgCycleTimeFast" BO_ 363 0;
BA_ "GenMsgSendType" BO_ 363 0;
BA_ "VFrameFormat" BO_ 363 14;
BA_ "CANFD_BRS" BO_ 363 1;
BA_ "GenMsgCycleTime" BO_ 363 10;
BA_ "GenMsgCycleTimeFast" BO_ 363 0;
BA_ "GenMsgSendType" BO_ 363 0;
BA_ "VFrameFormat" BO_ 363 14;
BA_ "CANFD_BRS" BO_ 363 1;
BA_ "GenMsgCycleTime" BO_ 363 10;
BA_ "GenMsgCycleTimeFast" BO_ 363 0;
BA_ "GenMsgSendType" BO_ 363 0;
BA_ "VFrameFormat" BO_ 363 14;
BA_ "CANFD_BRS" BO_ 363 1;
BA_ "GenMsgCycleTime" BO_ 363 10;
BA_ "GenMsgCycleTimeFast" BO_ 363 0;
BA_ "GenMsgSendType" BO_ 363 0;
BA_ "VFrameFormat" BO_ 363 14;
BA_ "CANFD_BRS" BO_ 363 1;
BA_ "GenMsgCycleTime" BO_ 363 10;
BA_ "GenMsgCycleTimeFast" BO_ 363 0;
BA_ "GenMsgSendType" BO_ 363 0;
BA_ "VFrameFormat" BO_ 363 14;
BA_ "CANFD_BRS" BO_ 363 1;
BA_ "GenMsgCycleTime" BO_ 363 10;
BA_ "GenMsgCycleTimeFast" BO_ 363 0;
BA_ "GenMsgSendType" BO_ 363 0;
BA_ "VFrameFormat" BO_ 363 14;
BA_ "CANFD_BRS" BO_ 363 1;
BA_ "GenMsgCycleTime" BO_ 363 10;
BA_ "GenMsgCycleTimeFast" BO_ 363 0;
BA_ "GenMsgSendType" BO_ 363 0;
BA_ "VFrameFormat" BO_ 363 14;
BA_ "CANFD_BRS" BO_ 363 1;
BA_ "GenMsgCycleTime" BO_ 363 10;
BA_ "GenMsgCycleTimeFast" BO_ 363 0;
BA_ "GenMsgSendType" BO_ 363 0;
BA_ "VFrameFormat" BO_ 363 14;
BA_ "CANFD_BRS" BO_ 363 1;
BA_ "GenMsgCycleTime" BO_ 363 10;
BA_ "GenMsgCycleTimeFast" BO_ 363 0;
BA_ "GenMsgSendType" BO_ 363 0;
BA_ "VFrameFormat" BO_ 363 14;
BA_ "CANFD_BRS" BO_ 363 1;
BA_ "GenMsgCycleTime" BO_ 363 10;
BA_ "GenMsgCycleTimeFast" BO_ 363 0;
BA_ "GenMsgSendType" BO_ 363 0;
BA_ "VFrameFormat" BO_ 363 14;
BA_ "CANFD_BRS" BO_ 363 1;
BA_ "GenMsgCycleTime" BO_ 363 10;
BA_ "GenMsgCycleTimeFast" BO_ 363 0;
BA_ "GenMsgSendType" BO_ 363 0;
BA_ "VFrameFormat" BO_ 363 14;
BA_ "CANFD_BRS" BO_ 363 1;
BA_ "GenMsgCycleTime" BO_ 363 10;
BA_ "GenMsgCycleTimeFast" BO_ 363 0;
BA_ "GenMsgSendType" BO_ 363 0;
BA_ "VFrameFormat" BO_ 363 14;
BA_ "CANFD_BRS" BO_ 363 1;
BA_ "GenMsgCycleTime" BO_ 363 10;
BA_ "GenMsgCycleTimeFast" BO_ 363 0;
BA_ "GenMsgSendType" BO_ 363 0;
BA_ "VFrameFormat" BO_ 363 14;
BA_ "CANFD_BRS" BO_ 363 1;
BA_ "GenMsgCycleTime" BO_ 363 10;
BA_ "GenMsgCycleTimeFast" BO_ 363 0;
BA_ "GenMsgSendType" BO_ 363 0;
BA_ "VFrameFormat" BO_ 363 14;
BA_ "CANFD_BRS" BO_ 363 1;
BA_ "GenMsgCycleTime" BO_ 363 10;
BA_ "GenMsgCycleTimeFast" BO_ 363 0;
BA_ "GenMsgSendType" BO_ 363 0;
BA_ "VFrameFormat" BO_ 363 14;
BA_ "CANFD_BRS" BO_ 363 1;
BA_ "GenMsgCycleTime" BO_ 363 10;
BA_ "GenMsgCycleTimeFast" BO_ 363 0;
BA_ "GenMsgSendType" BO_ 363 0;
BA_ "VFrameFormat" BO_ 363 14;
BA_ "CANFD_BRS" BO_ 363 1;
BA_ "GenMsgCycleTime" BO_ 363 10;
BA_ "GenMsgCycleTimeFast" BO_ 363 0;
BA_ "GenMsgSendType" BO_ 363 0;
BA_ "VFrameFormat" BO_ 363 14;
BA_ "CANFD_BRS" BO_ 363 1;
BA_ "GenMsgCycleTime" BO_ 363 10;
BA_ "GenMsgCycleTimeFast" BO_ 363 0;
BA_ "GenMsgSendType" BO_ 363 0;
BA_ "VFrameFormat" BO_ 363 14;
BA_ "CANFD_BRS" BO_ 363 1;
BA_ "GenMsgCycleTime" BO_ 363 10;
BA_ "GenMsgCycleTimeFast" BO_ 363 0;
BA_ "GenMsgSendType" BO_ 363 0;
BA_ "VFrameFormat" BO_ 363 14;
BA_ "CANFD_BRS" BO_ 363 1;
BA_ "GenMsgCycleTime" BO_ 363 10;
BA_ "GenMsgCycleTimeFast" BO_ 363 0;
BA_ "GenMsgSendType" BO_ 363 0;
BA_ "VFrameFormat" BO_ 363 14;
BA_ "CANFD_BRS" BO_ 363 1;
BA_ "GenMsgCycleTime" BO_ 363 10;
BA_ "GenMsgCycleTimeFast" BO_ 363 0;
BA_ "GenMsgSendType" BO_ 363 0;
BA_ "VFrameFormat" BO_ 363 14;
BA_ "CANFD_BRS" BO_ 363 1;
BA_ "GenMsgCycleTime" BO_ 363 10;
BA_ "GenMsgCycleTimeFast" BO_ 363 0;
BA_ "GenMsgSendType" BO_ 363 0;
BA_ "VFrameFormat" BO_ 363 14;
BA_ "CANFD_BRS" BO_ 363 1;
BA_ "GenMsgCycleTime" BO_ 363 10;
BA_ "GenMsgCycleTimeFast" BO_ 363 0;
BA_ "GenMsgSendType" BO_ 363 0;
BA_ "VFrameFormat" BO_ 363 14;
BA_ "CANFD_BRS" BO_ 363 1;
BA_ "GenMsgCycleTime" BO_ 363 10;
BA_ "GenMsgCycleTimeFast" BO_ 363 0;
BA_ "GenMsgSendType" BO_ 363 0;
BA_ "VFrameFormat" BO_ 363 14;
BA_ "CANFD_BRS" BO_ 363 1;
BA_ "GenMsgCycleTime" BO_ 363 10;
BA_ "GenMsgCycleTimeFast" BO_ 363 0;
BA_ "GenMsgSendType" BO_ 363 0;
BA_ "VFrameFormat" BO_ 363 14;
BA_ "CANFD_BRS" BO_ 363 1;
BA_ "GenMsgCycleTime" BO_ 363 10;
BA_ "GenMsgCycleTimeFast" BO_ 363 0;
BA_ "GenMsgSendType" BO_ 363 0;
BA_ "VFrameFormat" BO_ 363 14;
BA_ "CANFD_BRS" BO_ 363 1;
BA_ "GenMsgCycleTime" BO_ 363 10;
BA_ "GenMsgCycleTimeFast" BO_ 363 0;
BA_ "GenMsgSendType" BO_ 363 0;
BA_ "VFrameFormat" BO_ 363 14;
BA_ "CANFD_BRS" BO_ 363 1;
BA_ "GenMsgCycleTime" BO_ 363 10;
BA_ "GenMsgCycleTimeFast" BO_ 363 0;
BA_ "GenMsgSendType" BO_ 363 0;
BA_ "VFrameFormat" BO_ 363 14;
BA_ "CANFD_BRS" BO_ 363 1;
BA_ "GenMsgCycleTime" BO_ 362 10;
BA_ "GenMsgCycleTimeFast" BO_ 362 0;
BA_ "GenMsgSendType" BO_ 362 0;
BA_ "VFrameFormat" BO_ 362 14;
BA_ "CANFD_BRS" BO_ 362 1;
BA_ "GenMsgCycleTime" BO_ 362 10;
BA_ "GenMsgCycleTimeFast" BO_ 362 0;
BA_ "GenMsgSendType" BO_ 362 0;
BA_ "VFrameFormat" BO_ 362 14;
BA_ "CANFD_BRS" BO_ 362 1;
BA_ "GenMsgCycleTime" BO_ 362 10;
BA_ "GenMsgCycleTimeFast" BO_ 362 0;
BA_ "GenMsgSendType" BO_ 362 0;
BA_ "VFrameFormat" BO_ 362 14;
BA_ "CANFD_BRS" BO_ 362 1;
BA_ "GenMsgCycleTime" BO_ 362 10;
BA_ "GenMsgCycleTimeFast" BO_ 362 0;
BA_ "GenMsgSendType" BO_ 362 0;
BA_ "VFrameFormat" BO_ 362 14;
BA_ "CANFD_BRS" BO_ 362 1;
BA_ "GenMsgCycleTime" BO_ 362 10;
BA_ "GenMsgCycleTimeFast" BO_ 362 0;
BA_ "GenMsgSendType" BO_ 362 0;
BA_ "VFrameFormat" BO_ 362 14;
BA_ "CANFD_BRS" BO_ 362 1;
BA_ "GenMsgCycleTime" BO_ 362 10;
BA_ "GenMsgCycleTimeFast" BO_ 362 0;
BA_ "GenMsgSendType" BO_ 362 0;
BA_ "VFrameFormat" BO_ 362 14;
BA_ "CANFD_BRS" BO_ 362 1;
BA_ "GenMsgCycleTime" BO_ 362 10;
BA_ "GenMsgCycleTimeFast" BO_ 362 0;
BA_ "GenMsgSendType" BO_ 362 0;
BA_ "VFrameFormat" BO_ 362 14;
BA_ "CANFD_BRS" BO_ 362 1;
BA_ "GenMsgCycleTime" BO_ 362 10;
BA_ "GenMsgCycleTimeFast" BO_ 362 0;
BA_ "GenMsgSendType" BO_ 362 0;
BA_ "VFrameFormat" BO_ 362 14;
BA_ "CANFD_BRS" BO_ 362 1;
BA_ "GenMsgCycleTime" BO_ 362 10;
BA_ "GenMsgCycleTimeFast" BO_ 362 0;
BA_ "GenMsgSendType" BO_ 362 0;
BA_ "VFrameFormat" BO_ 362 14;
BA_ "CANFD_BRS" BO_ 362 1;
BA_ "GenMsgCycleTime" BO_ 362 10;
BA_ "GenMsgCycleTimeFast" BO_ 362 0;
BA_ "GenMsgSendType" BO_ 362 0;
BA_ "VFrameFormat" BO_ 362 14;
BA_ "CANFD_BRS" BO_ 362 1;
BA_ "GenMsgCycleTime" BO_ 362 10;
BA_ "GenMsgCycleTimeFast" BO_ 362 0;
BA_ "GenMsgSendType" BO_ 362 0;
BA_ "VFrameFormat" BO_ 362 14;
BA_ "CANFD_BRS" BO_ 362 1;
BA_ "GenMsgCycleTime" BO_ 362 10;
BA_ "GenMsgCycleTimeFast" BO_ 362 0;
BA_ "GenMsgSendType" BO_ 362 0;
BA_ "VFrameFormat" BO_ 362 14;
BA_ "CANFD_BRS" BO_ 362 1;
BA_ "GenMsgCycleTime" BO_ 362 10;
BA_ "GenMsgCycleTimeFast" BO_ 362 0;
BA_ "GenMsgSendType" BO_ 362 0;
BA_ "VFrameFormat" BO_ 362 14;
BA_ "CANFD_BRS" BO_ 362 1;
BA_ "GenMsgCycleTime" BO_ 362 10;
BA_ "GenMsgCycleTimeFast" BO_ 362 0;
BA_ "GenMsgSendType" BO_ 362 0;
BA_ "VFrameFormat" BO_ 362 14;
BA_ "CANFD_BRS" BO_ 362 1;
BA_ "GenMsgCycleTime" BO_ 362 10;
BA_ "GenMsgCycleTimeFast" BO_ 362 0;
BA_ "GenMsgSendType" BO_ 362 0;
BA_ "VFrameFormat" BO_ 362 14;
BA_ "CANFD_BRS" BO_ 362 1;
BA_ "GenMsgCycleTime" BO_ 362 10;
BA_ "GenMsgCycleTimeFast" BO_ 362 0;
BA_ "GenMsgSendType" BO_ 362 0;
BA_ "VFrameFormat" BO_ 362 14;
BA_ "CANFD_BRS" BO_ 362 1;
BA_ "GenMsgCycleTime" BO_ 362 10;
BA_ "GenMsgCycleTimeFast" BO_ 362 0;
BA_ "GenMsgSendType" BO_ 362 0;
BA_ "VFrameFormat" BO_ 362 14;
BA_ "CANFD_BRS" BO_ 362 1;
BA_ "GenMsgCycleTime" BO_ 362 10;
BA_ "GenMsgCycleTimeFast" BO_ 362 0;
BA_ "GenMsgSendType" BO_ 362 0;
BA_ "VFrameFormat" BO_ 362 14;
BA_ "CANFD_BRS" BO_ 362 1;
BA_ "GenMsgCycleTime" BO_ 362 10;
BA_ "GenMsgCycleTimeFast" BO_ 362 0;
BA_ "GenMsgSendType" BO_ 362 0;
BA_ "VFrameFormat" BO_ 362 14;
BA_ "CANFD_BRS" BO_ 362 1;
BA_ "GenMsgCycleTime" BO_ 362 10;
BA_ "GenMsgCycleTimeFast" BO_ 362 0;
BA_ "GenMsgSendType" BO_ 362 0;
BA_ "VFrameFormat" BO_ 362 14;
BA_ "CANFD_BRS" BO_ 362 1;
BA_ "GenMsgCycleTime" BO_ 362 10;
BA_ "GenMsgCycleTimeFast" BO_ 362 0;
BA_ "GenMsgSendType" BO_ 362 0;
BA_ "VFrameFormat" BO_ 362 14;
BA_ "CANFD_BRS" BO_ 362 1;
BA_ "GenMsgCycleTime" BO_ 362 10;
BA_ "GenMsgCycleTimeFast" BO_ 362 0;
BA_ "GenMsgSendType" BO_ 362 0;
BA_ "VFrameFormat" BO_ 362 14;
BA_ "CANFD_BRS" BO_ 362 1;
BA_ "GenMsgCycleTime" BO_ 362 10;
BA_ "GenMsgCycleTimeFast" BO_ 362 0;
BA_ "GenMsgSendType" BO_ 362 0;
BA_ "VFrameFormat" BO_ 362 14;
BA_ "CANFD_BRS" BO_ 362 1;
BA_ "GenMsgCycleTime" BO_ 362 10;
BA_ "GenMsgCycleTimeFast" BO_ 362 0;
BA_ "GenMsgSendType" BO_ 362 0;
BA_ "VFrameFormat" BO_ 362 14;
BA_ "CANFD_BRS" BO_ 362 1;
BA_ "GenMsgCycleTime" BO_ 362 10;
BA_ "GenMsgCycleTimeFast" BO_ 362 0;
BA_ "GenMsgSendType" BO_ 362 0;
BA_ "VFrameFormat" BO_ 362 14;
BA_ "CANFD_BRS" BO_ 362 1;
BA_ "GenMsgCycleTime" BO_ 362 10;
BA_ "GenMsgCycleTimeFast" BO_ 362 0;
BA_ "GenMsgSendType" BO_ 362 0;
BA_ "VFrameFormat" BO_ 362 14;
BA_ "CANFD_BRS" BO_ 362 1;
BA_ "GenMsgCycleTime" BO_ 362 10;
BA_ "GenMsgCycleTimeFast" BO_ 362 0;
BA_ "GenMsgSendType" BO_ 362 0;
BA_ "VFrameFormat" BO_ 362 14;
BA_ "CANFD_BRS" BO_ 362 1;
BA_ "GenMsgCycleTime" BO_ 362 10;
BA_ "GenMsgCycleTimeFast" BO_ 362 0;
BA_ "GenMsgSendType" BO_ 362 0;
BA_ "VFrameFormat" BO_ 362 14;
BA_ "CANFD_BRS" BO_ 362 1;
BA_ "GenMsgCycleTime" BO_ 362 10;
BA_ "GenMsgCycleTimeFast" BO_ 362 0;
BA_ "GenMsgSendType" BO_ 362 0;
BA_ "VFrameFormat" BO_ 362 14;
BA_ "CANFD_BRS" BO_ 362 1;
BA_ "GenMsgCycleTime" BO_ 362 10;
BA_ "GenMsgCycleTimeFast" BO_ 362 0;
BA_ "GenMsgSendType" BO_ 362 0;
BA_ "VFrameFormat" BO_ 362 14;
BA_ "CANFD_BRS" BO_ 362 1;
BA_ "GenMsgCycleTime" BO_ 362 10;
BA_ "GenMsgCycleTimeFast" BO_ 362 0;
BA_ "GenMsgSendType" BO_ 362 0;
BA_ "VFrameFormat" BO_ 362 14;
BA_ "CANFD_BRS" BO_ 362 1;
BA_ "GenMsgCycleTime" BO_ 362 10;
BA_ "GenMsgCycleTimeFast" BO_ 362 0;
BA_ "GenMsgSendType" BO_ 362 0;
BA_ "VFrameFormat" BO_ 362 14;
BA_ "CANFD_BRS" BO_ 362 1;
BA_ "GenMsgCycleTime" BO_ 362 10;
BA_ "GenMsgCycleTimeFast" BO_ 362 0;
BA_ "GenMsgSendType" BO_ 362 0;
BA_ "VFrameFormat" BO_ 362 14;
BA_ "CANFD_BRS" BO_ 362 1;
BA_ "GenMsgCycleTime" BO_ 362 10;
BA_ "GenMsgCycleTimeFast" BO_ 362 0;
BA_ "GenMsgSendType" BO_ 362 0;
BA_ "VFrameFormat" BO_ 362 14;
BA_ "CANFD_BRS" BO_ 362 1;
BA_ "GenMsgCycleTime" BO_ 362 10;
BA_ "GenMsgCycleTimeFast" BO_ 362 0;
BA_ "GenMsgSendType" BO_ 362 0;
BA_ "VFrameFormat" BO_ 362 14;
BA_ "CANFD_BRS" BO_ 362 1;
BA_ "GenMsgCycleTime" BO_ 362 10;
BA_ "GenMsgCycleTimeFast" BO_ 362 0;
BA_ "GenMsgSendType" BO_ 362 0;
BA_ "VFrameFormat" BO_ 362 14;
BA_ "CANFD_BRS" BO_ 362 1;
BA_ "GenMsgCycleTime" BO_ 362 10;
BA_ "GenMsgCycleTimeFast" BO_ 362 0;
BA_ "GenMsgSendType" BO_ 362 0;
BA_ "VFrameFormat" BO_ 362 14;
BA_ "CANFD_BRS" BO_ 362 1;
BA_ "GenMsgCycleTime" BO_ 362 10;
BA_ "GenMsgCycleTimeFast" BO_ 362 0;
BA_ "GenMsgSendType" BO_ 362 0;
BA_ "VFrameFormat" BO_ 362 14;
BA_ "CANFD_BRS" BO_ 362 1;
BA_ "GenMsgCycleTime" BO_ 362 10;
BA_ "GenMsgCycleTimeFast" BO_ 362 0;
BA_ "GenMsgSendType" BO_ 362 0;
BA_ "VFrameFormat" BO_ 362 14;
BA_ "CANFD_BRS" BO_ 362 1;
BA_ "GenMsgCycleTime" BO_ 362 10;
BA_ "GenMsgCycleTimeFast" BO_ 362 0;
BA_ "GenMsgSendType" BO_ 362 0;
BA_ "VFrameFormat" BO_ 362 14;
BA_ "CANFD_BRS" BO_ 362 1;
BA_ "GenMsgCycleTime" BO_ 362 10;
BA_ "GenMsgCycleTimeFast" BO_ 362 0;
BA_ "GenMsgSendType" BO_ 362 0;
BA_ "VFrameFormat" BO_ 362 14;
BA_ "CANFD_BRS" BO_ 362 1;
BA_ "GenMsgCycleTime" BO_ 362 10;
BA_ "GenMsgCycleTimeFast" BO_ 362 0;
BA_ "GenMsgSendType" BO_ 362 0;
BA_ "VFrameFormat" BO_ 362 14;
BA_ "CANFD_BRS" BO_ 362 1;
BA_ "GenMsgCycleTime" BO_ 362 10;
BA_ "GenMsgCycleTimeFast" BO_ 362 0;
BA_ "GenMsgSendType" BO_ 362 0;
BA_ "VFrameFormat" BO_ 362 14;
BA_ "CANFD_BRS" BO_ 362 1;
BA_ "GenMsgCycleTime" BO_ 362 10;
BA_ "GenMsgCycleTimeFast" BO_ 362 0;
BA_ "GenMsgSendType" BO_ 362 0;
BA_ "VFrameFormat" BO_ 362 14;
BA_ "CANFD_BRS" BO_ 362 1;
BA_ "GenMsgCycleTime" BO_ 362 10;
BA_ "GenMsgCycleTimeFast" BO_ 362 0;
BA_ "GenMsgSendType" BO_ 362 0;
BA_ "VFrameFormat" BO_ 362 14;
BA_ "CANFD_BRS" BO_ 362 1;
BA_ "GenMsgCycleTime" BO_ 362 10;
BA_ "GenMsgCycleTimeFast" BO_ 362 0;
BA_ "GenMsgSendType" BO_ 362 0;
BA_ "VFrameFormat" BO_ 362 14;
BA_ "CANFD_BRS" BO_ 362 1;
BA_ "GenMsgCycleTime" BO_ 362 10;
BA_ "GenMsgCycleTimeFast" BO_ 362 0;
BA_ "GenMsgSendType" BO_ 362 0;
BA_ "VFrameFormat" BO_ 362 14;
BA_ "CANFD_BRS" BO_ 362 1;
BA_ "GenMsgCycleTime" BO_ 362 10;
BA_ "GenMsgCycleTimeFast" BO_ 362 0;
BA_ "GenMsgSendType" BO_ 362 0;
BA_ "VFrameFormat" BO_ 362 14;
BA_ "CANFD_BRS" BO_ 362 1;
BA_ "GenMsgCycleTime" BO_ 362 10;
BA_ "GenMsgCycleTimeFast" BO_ 362 0;
BA_ "GenMsgSendType" BO_ 362 0;
BA_ "VFrameFormat" BO_ 362 14;
BA_ "CANFD_BRS" BO_ 362 1;
BA_ "GenMsgCycleTime" BO_ 362 10;
BA_ "GenMsgCycleTimeFast" BO_ 362 0;
BA_ "GenMsgSendType" BO_ 362 0;
BA_ "VFrameFormat" BO_ 362 14;
BA_ "CANFD_BRS" BO_ 362 1;
BA_ "GenMsgCycleTime" BO_ 362 10;
BA_ "GenMsgCycleTimeFast" BO_ 362 0;
BA_ "GenMsgSendType" BO_ 362 0;
BA_ "VFrameFormat" BO_ 362 14;
BA_ "CANFD_BRS" BO_ 362 1;
BA_ "GenMsgCycleTime" BO_ 905 100;
BA_ "GenMsgCycleTimeFast" BO_ 905 0;
BA_ "GenMsgSendType" BO_ 905 0;
BA_ "VFrameFormat" BO_ 905 14;
BA_ "CANFD_BRS" BO_ 905 1;
BA_ "GenMsgCycleTime" BO_ 905 100;
BA_ "GenMsgCycleTimeFast" BO_ 905 0;
BA_ "GenMsgSendType" BO_ 905 0;
BA_ "VFrameFormat" BO_ 905 14;
BA_ "CANFD_BRS" BO_ 905 1;
BA_ "GenMsgCycleTime" BO_ 905 100;
BA_ "GenMsgCycleTimeFast" BO_ 905 0;
BA_ "GenMsgSendType" BO_ 905 0;
BA_ "VFrameFormat" BO_ 905 14;
BA_ "CANFD_BRS" BO_ 905 1;
BA_ "GenMsgCycleTime" BO_ 905 100;
BA_ "GenMsgCycleTimeFast" BO_ 905 0;
BA_ "GenMsgSendType" BO_ 905 0;
BA_ "VFrameFormat" BO_ 905 14;
BA_ "CANFD_BRS" BO_ 905 1;
BA_ "GenMsgCycleTime" BO_ 905 100;
BA_ "GenMsgCycleTimeFast" BO_ 905 0;
BA_ "GenMsgSendType" BO_ 905 0;
BA_ "VFrameFormat" BO_ 905 14;
BA_ "CANFD_BRS" BO_ 905 1;
BA_ "GenMsgCycleTime" BO_ 905 100;
BA_ "GenMsgCycleTimeFast" BO_ 905 0;
BA_ "GenMsgSendType" BO_ 905 0;
BA_ "VFrameFormat" BO_ 905 14;
BA_ "CANFD_BRS" BO_ 905 1;
BA_ "GenMsgCycleTime" BO_ 905 100;
BA_ "GenMsgCycleTimeFast" BO_ 905 0;
BA_ "GenMsgSendType" BO_ 905 0;
BA_ "VFrameFormat" BO_ 905 14;
BA_ "CANFD_BRS" BO_ 905 1;
BA_ "GenMsgCycleTime" BO_ 1045 1000;
BA_ "GenMsgCycleTimeFast" BO_ 1045 0;
BA_ "GenMsgSendType" BO_ 1045 0;
BA_ "VFrameFormat" BO_ 1045 14;
BA_ "CANFD_BRS" BO_ 1045 1;
BA_ "GenMsgCycleTime" BO_ 1045 1000;
BA_ "GenMsgCycleTimeFast" BO_ 1045 0;
BA_ "GenMsgSendType" BO_ 1045 0;
BA_ "VFrameFormat" BO_ 1045 14;
BA_ "CANFD_BRS" BO_ 1045 1;
BA_ "GenMsgCycleTime" BO_ 1045 1000;
BA_ "GenMsgCycleTimeFast" BO_ 1045 0;
BA_ "GenMsgSendType" BO_ 1045 0;
BA_ "VFrameFormat" BO_ 1045 14;
BA_ "CANFD_BRS" BO_ 1045 1;
BA_ "EventCommandSignal" SG_ 611 BCS_3_CRC 0;
BA_ "GatewayedSignals" SG_ 611 BCS_3_CRC 0;
BA_ "GenSigInactiveValue" SG_ 611 BCS_3_CRC 0;
BA_ "GenSigInvalidValue" SG_ 611 BCS_3_CRC 0;
BA_ "GenSigSendType" SG_ 611 BCS_3_CRC 1;
BA_ "GenSigStartValue" SG_ 611 BCS_3_CRC 0;
BA_ "GenSigTimeoutValue" SG_ 611 BCS_3_CRC 0;
BA_ "Remark" SG_ 611 BCS_3_CRC "";
BA_ "EventCommandSignal" SG_ 611 BCS_3_Counter 0;
BA_ "GatewayedSignals" SG_ 611 BCS_3_Counter 0;
BA_ "GenSigInactiveValue" SG_ 611 BCS_3_Counter 0;
BA_ "GenSigInvalidValue" SG_ 611 BCS_3_Counter 0;
BA_ "GenSigSendType" SG_ 611 BCS_3_Counter 1;
BA_ "GenSigStartValue" SG_ 611 BCS_3_Counter 0;
BA_ "GenSigTimeoutValue" SG_ 611 BCS_3_Counter 0;
BA_ "Remark" SG_ 611 BCS_3_Counter "";
BA_ "EventCommandSignal" SG_ 611 BCS_DycESCActTq_1 0;
BA_ "GatewayedSignals" SG_ 611 BCS_DycESCActTq_1 0;
BA_ "GenSigInactiveValue" SG_ 611 BCS_DycESCActTq_1 0;
BA_ "GenSigInvalidValue" SG_ 611 BCS_DycESCActTq_1 0;
BA_ "GenSigSendType" SG_ 611 BCS_DycESCActTq_1 1;
BA_ "GenSigStartValue" SG_ 611 BCS_DycESCActTq_1 0;
BA_ "GenSigTimeoutValue" SG_ 611 BCS_DycESCActTq_1 0;
BA_ "Remark" SG_ 611 BCS_DycESCActTq_1 "";
BA_ "EventCommandSignal" SG_ 611 BCS_BrkTqCtrlAvlDriving_1 0;
BA_ "GatewayedSignals" SG_ 611 BCS_BrkTqCtrlAvlDriving_1 0;
BA_ "GenSigInactiveValue" SG_ 611 BCS_BrkTqCtrlAvlDriving_1 0;
BA_ "GenSigInvalidValue" SG_ 611 BCS_BrkTqCtrlAvlDriving_1 0;
BA_ "GenSigSendType" SG_ 611 BCS_BrkTqCtrlAvlDriving_1 1;
BA_ "GenSigStartValue" SG_ 611 BCS_BrkTqCtrlAvlDriving_1 0;
BA_ "GenSigTimeoutValue" SG_ 611 BCS_BrkTqCtrlAvlDriving_1 0;
BA_ "Remark" SG_ 611 BCS_BrkTqCtrlAvlDriving_1 "";
BA_ "EventCommandSignal" SG_ 611 BCS_BrkTqCtrlAvlParking_1 0;
BA_ "GatewayedSignals" SG_ 611 BCS_BrkTqCtrlAvlParking_1 0;
BA_ "GenSigInactiveValue" SG_ 611 BCS_BrkTqCtrlAvlParking_1 0;
BA_ "GenSigInvalidValue" SG_ 611 BCS_BrkTqCtrlAvlParking_1 0;
BA_ "GenSigSendType" SG_ 611 BCS_BrkTqCtrlAvlParking_1 1;
BA_ "GenSigStartValue" SG_ 611 BCS_BrkTqCtrlAvlParking_1 0;
BA_ "GenSigTimeoutValue" SG_ 611 BCS_BrkTqCtrlAvlParking_1 0;
BA_ "Remark" SG_ 611 BCS_BrkTqCtrlAvlParking_1 "";
BA_ "EventCommandSignal" SG_ 611 BCS_BrkTqCtrlActv_1 0;
BA_ "GatewayedSignals" SG_ 611 BCS_BrkTqCtrlActv_1 0;
BA_ "GenSigInactiveValue" SG_ 611 BCS_BrkTqCtrlActv_1 0;
BA_ "GenSigInvalidValue" SG_ 611 BCS_BrkTqCtrlActv_1 0;
BA_ "GenSigSendType" SG_ 611 BCS_BrkTqCtrlActv_1 1;
BA_ "GenSigStartValue" SG_ 611 BCS_BrkTqCtrlActv_1 0;
BA_ "GenSigTimeoutValue" SG_ 611 BCS_BrkTqCtrlActv_1 0;
BA_ "Remark" SG_ 611 BCS_BrkTqCtrlActv_1 "";
BA_ "EventCommandSignal" SG_ 611 BCS_DycEscTarTqCtrlAvl_1 0;
BA_ "GatewayedSignals" SG_ 611 BCS_DycEscTarTqCtrlAvl_1 0;
BA_ "GenSigInactiveValue" SG_ 611 BCS_DycEscTarTqCtrlAvl_1 0;
BA_ "GenSigInvalidValue" SG_ 611 BCS_DycEscTarTqCtrlAvl_1 0;
BA_ "GenSigSendType" SG_ 611 BCS_DycEscTarTqCtrlAvl_1 1;
BA_ "GenSigStartValue" SG_ 611 BCS_DycEscTarTqCtrlAvl_1 0;
BA_ "GenSigTimeoutValue" SG_ 611 BCS_DycEscTarTqCtrlAvl_1 0;
BA_ "Remark" SG_ 611 BCS_DycEscTarTqCtrlAvl_1 "";
BA_ "EventCommandSignal" SG_ 611 BCS_DTCActvSts_1 0;
BA_ "GatewayedSignals" SG_ 611 BCS_DTCActvSts_1 0;
BA_ "GenSigInactiveValue" SG_ 611 BCS_DTCActvSts_1 0;
BA_ "GenSigInvalidValue" SG_ 611 BCS_DTCActvSts_1 0;
BA_ "GenSigSendType" SG_ 611 BCS_DTCActvSts_1 1;
BA_ "GenSigStartValue" SG_ 611 BCS_DTCActvSts_1 0;
BA_ "GenSigTimeoutValue" SG_ 611 BCS_DTCActvSts_1 0;
BA_ "Remark" SG_ 611 BCS_DTCActvSts_1 "";
BA_ "EventCommandSignal" SG_ 611 BCS_DrvrBrkOvrd_1 0;
BA_ "GatewayedSignals" SG_ 611 BCS_DrvrBrkOvrd_1 0;
BA_ "GenSigInactiveValue" SG_ 611 BCS_DrvrBrkOvrd_1 0;
BA_ "GenSigInvalidValue" SG_ 611 BCS_DrvrBrkOvrd_1 0;
BA_ "GenSigSendType" SG_ 611 BCS_DrvrBrkOvrd_1 1;
BA_ "GenSigStartValue" SG_ 611 BCS_DrvrBrkOvrd_1 0;
BA_ "GenSigTimeoutValue" SG_ 611 BCS_DrvrBrkOvrd_1 0;
BA_ "Remark" SG_ 611 BCS_DrvrBrkOvrd_1 "";
BA_ "EventCommandSignal" SG_ 611 BCS_DrvrBrkOvrdVld_1 0;
BA_ "GatewayedSignals" SG_ 611 BCS_DrvrBrkOvrdVld_1 0;
BA_ "GenSigInactiveValue" SG_ 611 BCS_DrvrBrkOvrdVld_1 0;
BA_ "GenSigInvalidValue" SG_ 611 BCS_DrvrBrkOvrdVld_1 0;
BA_ "GenSigSendType" SG_ 611 BCS_DrvrBrkOvrdVld_1 1;
BA_ "GenSigStartValue" SG_ 611 BCS_DrvrBrkOvrdVld_1 0;
BA_ "GenSigTimeoutValue" SG_ 611 BCS_DrvrBrkOvrdVld_1 0;
BA_ "Remark" SG_ 611 BCS_DrvrBrkOvrdVld_1 "";
BA_ "EventCommandSignal" SG_ 611 BCS_DycEscTarTqActv_1 0;
BA_ "GatewayedSignals" SG_ 611 BCS_DycEscTarTqActv_1 0;
BA_ "GenSigInactiveValue" SG_ 611 BCS_DycEscTarTqActv_1 0;
BA_ "GenSigInvalidValue" SG_ 611 BCS_DycEscTarTqActv_1 0;
BA_ "GenSigSendType" SG_ 611 BCS_DycEscTarTqActv_1 1;
BA_ "GenSigStartValue" SG_ 611 BCS_DycEscTarTqActv_1 0;
BA_ "GenSigTimeoutValue" SG_ 611 BCS_DycEscTarTqActv_1 0;
BA_ "Remark" SG_ 611 BCS_DycEscTarTqActv_1 "";
BA_ "EventCommandSignal" SG_ 611 BCS_BrkTqCtrlAvlParkingRdn_1 0;
BA_ "GatewayedSignals" SG_ 611 BCS_BrkTqCtrlAvlParkingRdn_1 0;
BA_ "GenSigInactiveValue" SG_ 611 BCS_BrkTqCtrlAvlParkingRdn_1 0;
BA_ "GenSigInvalidValue" SG_ 611 BCS_BrkTqCtrlAvlParkingRdn_1 0;
BA_ "GenSigSendType" SG_ 611 BCS_BrkTqCtrlAvlParkingRdn_1 1;
BA_ "GenSigStartValue" SG_ 611 BCS_BrkTqCtrlAvlParkingRdn_1 0;
BA_ "GenSigTimeoutValue" SG_ 611 BCS_BrkTqCtrlAvlParkingRdn_1 0;
BA_ "Remark" SG_ 611 BCS_BrkTqCtrlAvlParkingRdn_1 "";
BA_ "EventCommandSignal" SG_ 611 BCS_HydBrkActvTq_1 0;
BA_ "GatewayedSignals" SG_ 611 BCS_HydBrkActvTq_1 0;
BA_ "GenSigInactiveValue" SG_ 611 BCS_HydBrkActvTq_1 0;
BA_ "GenSigInvalidValue" SG_ 611 BCS_HydBrkActvTq_1 0;
BA_ "GenSigSendType" SG_ 611 BCS_HydBrkActvTq_1 1;
BA_ "GenSigStartValue" SG_ 611 BCS_HydBrkActvTq_1 0;
BA_ "GenSigTimeoutValue" SG_ 611 BCS_HydBrkActvTq_1 0;
BA_ "Remark" SG_ 611 BCS_HydBrkActvTq_1 "";
BA_ "EventCommandSignal" SG_ 611 BCS_ERV_VehSpd_1 0;
BA_ "GatewayedSignals" SG_ 611 BCS_ERV_VehSpd_1 0;
BA_ "GenSigInactiveValue" SG_ 611 BCS_ERV_VehSpd_1 0;
BA_ "GenSigInvalidValue" SG_ 611 BCS_ERV_VehSpd_1 0;
BA_ "GenSigSendType" SG_ 611 BCS_ERV_VehSpd_1 1;
BA_ "GenSigStartValue" SG_ 611 BCS_ERV_VehSpd_1 0;
BA_ "GenSigTimeoutValue" SG_ 611 BCS_ERV_VehSpd_1 0;
BA_ "Remark" SG_ 611 BCS_ERV_VehSpd_1 "";
BA_ "EventCommandSignal" SG_ 611 BCS_ERV_VehSpdVld_1 0;
BA_ "GatewayedSignals" SG_ 611 BCS_ERV_VehSpdVld_1 0;
BA_ "GenSigInactiveValue" SG_ 611 BCS_ERV_VehSpdVld_1 0;
BA_ "GenSigInvalidValue" SG_ 611 BCS_ERV_VehSpdVld_1 0;
BA_ "GenSigSendType" SG_ 611 BCS_ERV_VehSpdVld_1 1;
BA_ "GenSigStartValue" SG_ 611 BCS_ERV_VehSpdVld_1 0;
BA_ "GenSigTimeoutValue" SG_ 611 BCS_ERV_VehSpdVld_1 0;
BA_ "Remark" SG_ 611 BCS_ERV_VehSpdVld_1 "";
BA_ "EventCommandSignal" SG_ 611 BCS_HydBrkActvTq_FL_1 0;
BA_ "GatewayedSignals" SG_ 611 BCS_HydBrkActvTq_FL_1 0;
BA_ "GenSigInactiveValue" SG_ 611 BCS_HydBrkActvTq_FL_1 0;
BA_ "GenSigInvalidValue" SG_ 611 BCS_HydBrkActvTq_FL_1 0;
BA_ "GenSigSendType" SG_ 611 BCS_HydBrkActvTq_FL_1 1;
BA_ "GenSigStartValue" SG_ 611 BCS_HydBrkActvTq_FL_1 0;
BA_ "GenSigTimeoutValue" SG_ 611 BCS_HydBrkActvTq_FL_1 0;
BA_ "Remark" SG_ 611 BCS_HydBrkActvTq_FL_1 "";
BA_ "EventCommandSignal" SG_ 611 BCS_HydBrkActvTq_FR_1 0;
BA_ "GatewayedSignals" SG_ 611 BCS_HydBrkActvTq_FR_1 0;
BA_ "GenSigInactiveValue" SG_ 611 BCS_HydBrkActvTq_FR_1 0;
BA_ "GenSigInvalidValue" SG_ 611 BCS_HydBrkActvTq_FR_1 0;
BA_ "GenSigSendType" SG_ 611 BCS_HydBrkActvTq_FR_1 1;
BA_ "GenSigStartValue" SG_ 611 BCS_HydBrkActvTq_FR_1 0;
BA_ "GenSigTimeoutValue" SG_ 611 BCS_HydBrkActvTq_FR_1 0;
BA_ "Remark" SG_ 611 BCS_HydBrkActvTq_FR_1 "";
BA_ "EventCommandSignal" SG_ 611 BCS_HydBrkActvTq_RL_1 0;
BA_ "GatewayedSignals" SG_ 611 BCS_HydBrkActvTq_RL_1 0;
BA_ "GenSigInactiveValue" SG_ 611 BCS_HydBrkActvTq_RL_1 0;
BA_ "GenSigInvalidValue" SG_ 611 BCS_HydBrkActvTq_RL_1 0;
BA_ "GenSigSendType" SG_ 611 BCS_HydBrkActvTq_RL_1 1;
BA_ "GenSigStartValue" SG_ 611 BCS_HydBrkActvTq_RL_1 0;
BA_ "GenSigTimeoutValue" SG_ 611 BCS_HydBrkActvTq_RL_1 0;
BA_ "Remark" SG_ 611 BCS_HydBrkActvTq_RL_1 "";
BA_ "EventCommandSignal" SG_ 611 BCS_HydBrkActvTq_RR_1 0;
BA_ "GatewayedSignals" SG_ 611 BCS_HydBrkActvTq_RR_1 0;
BA_ "GenSigInactiveValue" SG_ 611 BCS_HydBrkActvTq_RR_1 0;
BA_ "GenSigInvalidValue" SG_ 611 BCS_HydBrkActvTq_RR_1 0;
BA_ "GenSigSendType" SG_ 611 BCS_HydBrkActvTq_RR_1 1;
BA_ "GenSigStartValue" SG_ 611 BCS_HydBrkActvTq_RR_1 0;
BA_ "GenSigTimeoutValue" SG_ 611 BCS_HydBrkActvTq_RR_1 0;
BA_ "Remark" SG_ 611 BCS_HydBrkActvTq_RR_1 "";
BA_ "EventCommandSignal" SG_ 611 IPB_SimulatorPressure 0;
BA_ "GatewayedSignals" SG_ 611 IPB_SimulatorPressure 0;
BA_ "GenSigInactiveValue" SG_ 611 IPB_SimulatorPressure 0;
BA_ "GenSigInvalidValue" SG_ 611 IPB_SimulatorPressure 0;
BA_ "GenSigSendType" SG_ 611 IPB_SimulatorPressure 1;
BA_ "GenSigStartValue" SG_ 611 IPB_SimulatorPressure 17;
BA_ "GenSigTimeoutValue" SG_ 611 IPB_SimulatorPressure 0;
BA_ "Remark" SG_ 611 IPB_SimulatorPressure "";
BA_ "EventCommandSignal" SG_ 611 IPB_SimulatorPressureSt 0;
BA_ "GatewayedSignals" SG_ 611 IPB_SimulatorPressureSt 0;
BA_ "GenSigInactiveValue" SG_ 611 IPB_SimulatorPressureSt 0;
BA_ "GenSigInvalidValue" SG_ 611 IPB_SimulatorPressureSt 0;
BA_ "GenSigSendType" SG_ 611 IPB_SimulatorPressureSt 1;
BA_ "GenSigStartValue" SG_ 611 IPB_SimulatorPressureSt 0;
BA_ "GenSigTimeoutValue" SG_ 611 IPB_SimulatorPressureSt 0;
BA_ "Remark" SG_ 611 IPB_SimulatorPressureSt "";
BA_ "EventCommandSignal" SG_ 611 IBCS_SystemSt 0;
BA_ "GatewayedSignals" SG_ 611 IBCS_SystemSt 0;
BA_ "GenSigInactiveValue" SG_ 611 IBCS_SystemSt 0;
BA_ "GenSigInvalidValue" SG_ 611 IBCS_SystemSt 0;
BA_ "GenSigSendType" SG_ 611 IBCS_SystemSt 1;
BA_ "GenSigStartValue" SG_ 611 IBCS_SystemSt 0;
BA_ "GenSigTimeoutValue" SG_ 611 IBCS_SystemSt 0;
BA_ "Remark" SG_ 611 IBCS_SystemSt "";
BA_ "EventCommandSignal" SG_ 611 IBCS_FWAWarning 0;
BA_ "GatewayedSignals" SG_ 611 IBCS_FWAWarning 0;
BA_ "GenSigInactiveValue" SG_ 611 IBCS_FWAWarning 0;
BA_ "GenSigInvalidValue" SG_ 611 IBCS_FWAWarning 0;
BA_ "GenSigSendType" SG_ 611 IBCS_FWAWarning 1;
BA_ "GenSigStartValue" SG_ 611 IBCS_FWAWarning 0;
BA_ "GenSigTimeoutValue" SG_ 611 IBCS_FWAWarning 0;
BA_ "Remark" SG_ 611 IBCS_FWAWarning "";
BA_ "EventCommandSignal" SG_ 611 IPB_CSTSt 0;
BA_ "GatewayedSignals" SG_ 611 IPB_CSTSt 0;
BA_ "GenSigInactiveValue" SG_ 611 IPB_CSTSt 0;
BA_ "GenSigInvalidValue" SG_ 611 IPB_CSTSt 0;
BA_ "GenSigSendType" SG_ 611 IPB_CSTSt 1;
BA_ "GenSigStartValue" SG_ 611 IPB_CSTSt 0;
BA_ "GenSigTimeoutValue" SG_ 611 IPB_CSTSt 0;
BA_ "Remark" SG_ 611 IPB_CSTSt "";
BA_ "EventCommandSignal" SG_ 611 BCS_AVDCActive 0;
BA_ "GatewayedSignals" SG_ 611 BCS_AVDCActive 0;
BA_ "GenSigInactiveValue" SG_ 611 BCS_AVDCActive 0;
BA_ "GenSigInvalidValue" SG_ 611 BCS_AVDCActive 0;
BA_ "GenSigSendType" SG_ 611 BCS_AVDCActive 1;
BA_ "GenSigStartValue" SG_ 611 BCS_AVDCActive 0;
BA_ "GenSigTimeoutValue" SG_ 611 BCS_AVDCActive 0;
BA_ "Remark" SG_ 611 BCS_AVDCActive "";
BA_ "EventCommandSignal" SG_ 611 BCS_AVDCAvailable 0;
BA_ "GatewayedSignals" SG_ 611 BCS_AVDCAvailable 0;
BA_ "GenSigInactiveValue" SG_ 611 BCS_AVDCAvailable 0;
BA_ "GenSigInvalidValue" SG_ 611 BCS_AVDCAvailable 0;
BA_ "GenSigSendType" SG_ 611 BCS_AVDCAvailable 1;
BA_ "GenSigStartValue" SG_ 611 BCS_AVDCAvailable 0;
BA_ "GenSigTimeoutValue" SG_ 611 BCS_AVDCAvailable 0;
BA_ "Remark" SG_ 611 BCS_AVDCAvailable "";
BA_ "EventCommandSignal" SG_ 611 BCS_BrkActvTq_1 0;
BA_ "GatewayedSignals" SG_ 611 BCS_BrkActvTq_1 0;
BA_ "GenSigInactiveValue" SG_ 611 BCS_BrkActvTq_1 0;
BA_ "GenSigInvalidValue" SG_ 611 BCS_BrkActvTq_1 0;
BA_ "GenSigSendType" SG_ 611 BCS_BrkActvTq_1 1;
BA_ "GenSigStartValue" SG_ 611 BCS_BrkActvTq_1 0;
BA_ "GenSigTimeoutValue" SG_ 611 BCS_BrkActvTq_1 0;
BA_ "Remark" SG_ 611 BCS_BrkActvTq_1 "";
BA_ "EventCommandSignal" SG_ 611 BCS_DrvrTqDes_1 0;
BA_ "GatewayedSignals" SG_ 611 BCS_DrvrTqDes_1 0;
BA_ "GenSigInactiveValue" SG_ 611 BCS_DrvrTqDes_1 0;
BA_ "GenSigInvalidValue" SG_ 611 BCS_DrvrTqDes_1 0;
BA_ "GenSigSendType" SG_ 611 BCS_DrvrTqDes_1 1;
BA_ "GenSigStartValue" SG_ 611 BCS_DrvrTqDes_1 0;
BA_ "GenSigTimeoutValue" SG_ 611 BCS_DrvrTqDes_1 0;
BA_ "Remark" SG_ 611 BCS_DrvrTqDes_1 "";
BA_ "EventCommandSignal" SG_ 360 BCS_6_CRC 0;
BA_ "GatewayedSignals" SG_ 360 BCS_6_CRC 0;
BA_ "GenSigInactiveValue" SG_ 360 BCS_6_CRC 0;
BA_ "GenSigInvalidValue" SG_ 360 BCS_6_CRC 0;
BA_ "GenSigSendType" SG_ 360 BCS_6_CRC 1;
BA_ "GenSigStartValue" SG_ 360 BCS_6_CRC 0;
BA_ "GenSigTimeoutValue" SG_ 360 BCS_6_CRC 0;
BA_ "Remark" SG_ 360 BCS_6_CRC "";
BA_ "EventCommandSignal" SG_ 360 BCS_6_Counter 0;
BA_ "GatewayedSignals" SG_ 360 BCS_6_Counter 0;
BA_ "GenSigInactiveValue" SG_ 360 BCS_6_Counter 0;
BA_ "GenSigInvalidValue" SG_ 360 BCS_6_Counter 0;
BA_ "GenSigSendType" SG_ 360 BCS_6_Counter 1;
BA_ "GenSigStartValue" SG_ 360 BCS_6_Counter 0;
BA_ "GenSigTimeoutValue" SG_ 360 BCS_6_Counter 0;
BA_ "Remark" SG_ 360 BCS_6_Counter "";
BA_ "EventCommandSignal" SG_ 360 BCS_HydBrkActvTq_FL 0;
BA_ "GatewayedSignals" SG_ 360 BCS_HydBrkActvTq_FL 0;
BA_ "GenSigInactiveValue" SG_ 360 BCS_HydBrkActvTq_FL 0;
BA_ "GenSigInvalidValue" SG_ 360 BCS_HydBrkActvTq_FL 0;
BA_ "GenSigSendType" SG_ 360 BCS_HydBrkActvTq_FL 1;
BA_ "GenSigStartValue" SG_ 360 BCS_HydBrkActvTq_FL 0;
BA_ "GenSigTimeoutValue" SG_ 360 BCS_HydBrkActvTq_FL 0;
BA_ "Remark" SG_ 360 BCS_HydBrkActvTq_FL "";
BA_ "EventCommandSignal" SG_ 360 BCS_HydBrkActvTq_FR 0;
BA_ "GatewayedSignals" SG_ 360 BCS_HydBrkActvTq_FR 0;
BA_ "GenSigInactiveValue" SG_ 360 BCS_HydBrkActvTq_FR 0;
BA_ "GenSigInvalidValue" SG_ 360 BCS_HydBrkActvTq_FR 0;
BA_ "GenSigSendType" SG_ 360 BCS_HydBrkActvTq_FR 1;
BA_ "GenSigStartValue" SG_ 360 BCS_HydBrkActvTq_FR 0;
BA_ "GenSigTimeoutValue" SG_ 360 BCS_HydBrkActvTq_FR 0;
BA_ "Remark" SG_ 360 BCS_HydBrkActvTq_FR "";
BA_ "EventCommandSignal" SG_ 360 BCS_HydBrkActvTq_RL 0;
BA_ "GatewayedSignals" SG_ 360 BCS_HydBrkActvTq_RL 0;
BA_ "GenSigInactiveValue" SG_ 360 BCS_HydBrkActvTq_RL 0;
BA_ "GenSigInvalidValue" SG_ 360 BCS_HydBrkActvTq_RL 0;
BA_ "GenSigSendType" SG_ 360 BCS_HydBrkActvTq_RL 1;
BA_ "GenSigStartValue" SG_ 360 BCS_HydBrkActvTq_RL 0;
BA_ "GenSigTimeoutValue" SG_ 360 BCS_HydBrkActvTq_RL 0;
BA_ "Remark" SG_ 360 BCS_HydBrkActvTq_RL "";
BA_ "EventCommandSignal" SG_ 360 BCS_HydBrkActvTq_RR 0;
BA_ "GatewayedSignals" SG_ 360 BCS_HydBrkActvTq_RR 0;
BA_ "GenSigInactiveValue" SG_ 360 BCS_HydBrkActvTq_RR 0;
BA_ "GenSigInvalidValue" SG_ 360 BCS_HydBrkActvTq_RR 0;
BA_ "GenSigSendType" SG_ 360 BCS_HydBrkActvTq_RR 1;
BA_ "GenSigStartValue" SG_ 360 BCS_HydBrkActvTq_RR 0;
BA_ "GenSigTimeoutValue" SG_ 360 BCS_HydBrkActvTq_RR 0;
BA_ "Remark" SG_ 360 BCS_HydBrkActvTq_RR "";
BA_ "EventCommandSignal" SG_ 360 BCS_HydBrkReqTq 0;
BA_ "GatewayedSignals" SG_ 360 BCS_HydBrkReqTq 0;
BA_ "GenSigInactiveValue" SG_ 360 BCS_HydBrkReqTq 0;
BA_ "GenSigInvalidValue" SG_ 360 BCS_HydBrkReqTq 0;
BA_ "GenSigSendType" SG_ 360 BCS_HydBrkReqTq 1;
BA_ "GenSigStartValue" SG_ 360 BCS_HydBrkReqTq 0;
BA_ "GenSigTimeoutValue" SG_ 360 BCS_HydBrkReqTq 0;
BA_ "Remark" SG_ 360 BCS_HydBrkReqTq "";
BA_ "EventCommandSignal" SG_ 360 BCS_BrkActvTq 0;
BA_ "GatewayedSignals" SG_ 360 BCS_BrkActvTq 0;
BA_ "GenSigInactiveValue" SG_ 360 BCS_BrkActvTq 0;
BA_ "GenSigInvalidValue" SG_ 360 BCS_BrkActvTq 0;
BA_ "GenSigSendType" SG_ 360 BCS_BrkActvTq 1;
BA_ "GenSigStartValue" SG_ 360 BCS_BrkActvTq 0;
BA_ "GenSigTimeoutValue" SG_ 360 BCS_BrkActvTq 0;
BA_ "Remark" SG_ 360 BCS_BrkActvTq "";
BA_ "EventCommandSignal" SG_ 360 BCS_HydBrkActvTq 0;
BA_ "GatewayedSignals" SG_ 360 BCS_HydBrkActvTq 0;
BA_ "GenSigInactiveValue" SG_ 360 BCS_HydBrkActvTq 0;
BA_ "GenSigInvalidValue" SG_ 360 BCS_HydBrkActvTq 0;
BA_ "GenSigSendType" SG_ 360 BCS_HydBrkActvTq 1;
BA_ "GenSigStartValue" SG_ 360 BCS_HydBrkActvTq 0;
BA_ "GenSigTimeoutValue" SG_ 360 BCS_HydBrkActvTq 0;
BA_ "Remark" SG_ 360 BCS_HydBrkActvTq "";
BA_ "EventCommandSignal" SG_ 360 BCS_DycESCActTq 0;
BA_ "GatewayedSignals" SG_ 360 BCS_DycESCActTq 0;
BA_ "GenSigInactiveValue" SG_ 360 BCS_DycESCActTq 0;
BA_ "GenSigInvalidValue" SG_ 360 BCS_DycESCActTq 0;
BA_ "GenSigSendType" SG_ 360 BCS_DycESCActTq 1;
BA_ "GenSigStartValue" SG_ 360 BCS_DycESCActTq 0;
BA_ "GenSigTimeoutValue" SG_ 360 BCS_DycESCActTq 0;
BA_ "Remark" SG_ 360 BCS_DycESCActTq "";
BA_ "EventCommandSignal" SG_ 360 BCS_ERV_VehSpd 0;
BA_ "GatewayedSignals" SG_ 360 BCS_ERV_VehSpd 0;
BA_ "GenSigInactiveValue" SG_ 360 BCS_ERV_VehSpd 0;
BA_ "GenSigInvalidValue" SG_ 360 BCS_ERV_VehSpd 0;
BA_ "GenSigSendType" SG_ 360 BCS_ERV_VehSpd 1;
BA_ "GenSigStartValue" SG_ 360 BCS_ERV_VehSpd 0;
BA_ "GenSigTimeoutValue" SG_ 360 BCS_ERV_VehSpd 0;
BA_ "Remark" SG_ 360 BCS_ERV_VehSpd "";
BA_ "EventCommandSignal" SG_ 360 BCS_BrkTqCtrlAvlDriving 0;
BA_ "GatewayedSignals" SG_ 360 BCS_BrkTqCtrlAvlDriving 0;
BA_ "GenSigInactiveValue" SG_ 360 BCS_BrkTqCtrlAvlDriving 0;
BA_ "GenSigInvalidValue" SG_ 360 BCS_BrkTqCtrlAvlDriving 0;
BA_ "GenSigSendType" SG_ 360 BCS_BrkTqCtrlAvlDriving 1;
BA_ "GenSigStartValue" SG_ 360 BCS_BrkTqCtrlAvlDriving 0;
BA_ "GenSigTimeoutValue" SG_ 360 BCS_BrkTqCtrlAvlDriving 0;
BA_ "Remark" SG_ 360 BCS_BrkTqCtrlAvlDriving "";
BA_ "EventCommandSignal" SG_ 360 BCS_BrkTqCtrlAvlParking 0;
BA_ "GatewayedSignals" SG_ 360 BCS_BrkTqCtrlAvlParking 0;
BA_ "GenSigInactiveValue" SG_ 360 BCS_BrkTqCtrlAvlParking 0;
BA_ "GenSigInvalidValue" SG_ 360 BCS_BrkTqCtrlAvlParking 0;
BA_ "GenSigSendType" SG_ 360 BCS_BrkTqCtrlAvlParking 1;
BA_ "GenSigStartValue" SG_ 360 BCS_BrkTqCtrlAvlParking 0;
BA_ "GenSigTimeoutValue" SG_ 360 BCS_BrkTqCtrlAvlParking 0;
BA_ "Remark" SG_ 360 BCS_BrkTqCtrlAvlParking "";
BA_ "EventCommandSignal" SG_ 360 BCS_BrkTqCtrlActv 0;
BA_ "GatewayedSignals" SG_ 360 BCS_BrkTqCtrlActv 0;
BA_ "GenSigInactiveValue" SG_ 360 BCS_BrkTqCtrlActv 0;
BA_ "GenSigInvalidValue" SG_ 360 BCS_BrkTqCtrlActv 0;
BA_ "GenSigSendType" SG_ 360 BCS_BrkTqCtrlActv 1;
BA_ "GenSigStartValue" SG_ 360 BCS_BrkTqCtrlActv 0;
BA_ "GenSigTimeoutValue" SG_ 360 BCS_BrkTqCtrlActv 0;
BA_ "Remark" SG_ 360 BCS_BrkTqCtrlActv "";
BA_ "EventCommandSignal" SG_ 360 BCS_ERV_VehSpdVld 0;
BA_ "GatewayedSignals" SG_ 360 BCS_ERV_VehSpdVld 0;
BA_ "GenSigInactiveValue" SG_ 360 BCS_ERV_VehSpdVld 0;
BA_ "GenSigInvalidValue" SG_ 360 BCS_ERV_VehSpdVld 0;
BA_ "GenSigSendType" SG_ 360 BCS_ERV_VehSpdVld 1;
BA_ "GenSigStartValue" SG_ 360 BCS_ERV_VehSpdVld 0;
BA_ "GenSigTimeoutValue" SG_ 360 BCS_ERV_VehSpdVld 0;
BA_ "Remark" SG_ 360 BCS_ERV_VehSpdVld "";
BA_ "EventCommandSignal" SG_ 360 BCS_EspFailrSts 0;
BA_ "GatewayedSignals" SG_ 360 BCS_EspFailrSts 0;
BA_ "GenSigInactiveValue" SG_ 360 BCS_EspFailrSts 0;
BA_ "GenSigInvalidValue" SG_ 360 BCS_EspFailrSts 0;
BA_ "GenSigSendType" SG_ 360 BCS_EspFailrSts 1;
BA_ "GenSigStartValue" SG_ 360 BCS_EspFailrSts 1;
BA_ "GenSigTimeoutValue" SG_ 360 BCS_EspFailrSts 1;
BA_ "Remark" SG_ 360 BCS_EspFailrSts "";
BA_ "EventCommandSignal" SG_ 360 BCS_ActvSts 0;
BA_ "GatewayedSignals" SG_ 360 BCS_ActvSts 0;
BA_ "GenSigInactiveValue" SG_ 360 BCS_ActvSts 0;
BA_ "GenSigInvalidValue" SG_ 360 BCS_ActvSts 0;
BA_ "GenSigSendType" SG_ 360 BCS_ActvSts 1;
BA_ "GenSigStartValue" SG_ 360 BCS_ActvSts 0;
BA_ "GenSigTimeoutValue" SG_ 360 BCS_ActvSts 0;
BA_ "Remark" SG_ 360 BCS_ActvSts "";
BA_ "EventCommandSignal" SG_ 360 BCS_DycEscTarTqCtrlAvl 0;
BA_ "GatewayedSignals" SG_ 360 BCS_DycEscTarTqCtrlAvl 0;
BA_ "GenSigInactiveValue" SG_ 360 BCS_DycEscTarTqCtrlAvl 0;
BA_ "GenSigInvalidValue" SG_ 360 BCS_DycEscTarTqCtrlAvl 0;
BA_ "GenSigSendType" SG_ 360 BCS_DycEscTarTqCtrlAvl 1;
BA_ "GenSigStartValue" SG_ 360 BCS_DycEscTarTqCtrlAvl 0;
BA_ "GenSigTimeoutValue" SG_ 360 BCS_DycEscTarTqCtrlAvl 0;
BA_ "Remark" SG_ 360 BCS_DycEscTarTqCtrlAvl "";
BA_ "EventCommandSignal" SG_ 360 BCS_BDCActive 0;
BA_ "GatewayedSignals" SG_ 360 BCS_BDCActive 0;
BA_ "GenSigInactiveValue" SG_ 360 BCS_BDCActive 0;
BA_ "GenSigInvalidValue" SG_ 360 BCS_BDCActive 0;
BA_ "GenSigSendType" SG_ 360 BCS_BDCActive 1;
BA_ "GenSigStartValue" SG_ 360 BCS_BDCActive 0;
BA_ "GenSigTimeoutValue" SG_ 360 BCS_BDCActive 0;
BA_ "Remark" SG_ 360 BCS_BDCActive "";
BA_ "EventCommandSignal" SG_ 360 BCS_DTCActvSts 0;
BA_ "GatewayedSignals" SG_ 360 BCS_DTCActvSts 0;
BA_ "GenSigInactiveValue" SG_ 360 BCS_DTCActvSts 0;
BA_ "GenSigInvalidValue" SG_ 360 BCS_DTCActvSts 0;
BA_ "GenSigSendType" SG_ 360 BCS_DTCActvSts 1;
BA_ "GenSigStartValue" SG_ 360 BCS_DTCActvSts 0;
BA_ "GenSigTimeoutValue" SG_ 360 BCS_DTCActvSts 0;
BA_ "Remark" SG_ 360 BCS_DTCActvSts "";
BA_ "EventCommandSignal" SG_ 360 BCS_errorFb 0;
BA_ "GatewayedSignals" SG_ 360 BCS_errorFb 0;
BA_ "GenSigInactiveValue" SG_ 360 BCS_errorFb 0;
BA_ "GenSigInvalidValue" SG_ 360 BCS_errorFb 0;
BA_ "GenSigSendType" SG_ 360 BCS_errorFb 1;
BA_ "GenSigStartValue" SG_ 360 BCS_errorFb 0;
BA_ "GenSigTimeoutValue" SG_ 360 BCS_errorFb 0;
BA_ "Remark" SG_ 360 BCS_errorFb "";
BA_ "EventCommandSignal" SG_ 360 BCS_DrvrBrkOvrd 0;
BA_ "GatewayedSignals" SG_ 360 BCS_DrvrBrkOvrd 0;
BA_ "GenSigInactiveValue" SG_ 360 BCS_DrvrBrkOvrd 0;
BA_ "GenSigInvalidValue" SG_ 360 BCS_DrvrBrkOvrd 0;
BA_ "GenSigSendType" SG_ 360 BCS_DrvrBrkOvrd 1;
BA_ "GenSigStartValue" SG_ 360 BCS_DrvrBrkOvrd 0;
BA_ "GenSigTimeoutValue" SG_ 360 BCS_DrvrBrkOvrd 0;
BA_ "Remark" SG_ 360 BCS_DrvrBrkOvrd "";
BA_ "EventCommandSignal" SG_ 360 BCS_DrvrBrkOvrdVld 0;
BA_ "GatewayedSignals" SG_ 360 BCS_DrvrBrkOvrdVld 0;
BA_ "GenSigInactiveValue" SG_ 360 BCS_DrvrBrkOvrdVld 0;
BA_ "GenSigInvalidValue" SG_ 360 BCS_DrvrBrkOvrdVld 0;
BA_ "GenSigSendType" SG_ 360 BCS_DrvrBrkOvrdVld 1;
BA_ "GenSigStartValue" SG_ 360 BCS_DrvrBrkOvrdVld 0;
BA_ "GenSigTimeoutValue" SG_ 360 BCS_DrvrBrkOvrdVld 0;
BA_ "Remark" SG_ 360 BCS_DrvrBrkOvrdVld "";
BA_ "EventCommandSignal" SG_ 360 BCS_DycEscTarTqActv 0;
BA_ "GatewayedSignals" SG_ 360 BCS_DycEscTarTqActv 0;
BA_ "GenSigInactiveValue" SG_ 360 BCS_DycEscTarTqActv 0;
BA_ "GenSigInvalidValue" SG_ 360 BCS_DycEscTarTqActv 0;
BA_ "GenSigSendType" SG_ 360 BCS_DycEscTarTqActv 1;
BA_ "GenSigStartValue" SG_ 360 BCS_DycEscTarTqActv 0;
BA_ "GenSigTimeoutValue" SG_ 360 BCS_DycEscTarTqActv 0;
BA_ "Remark" SG_ 360 BCS_DycEscTarTqActv "";
BA_ "EventCommandSignal" SG_ 360 BCS_WheelSlipFLValid 0;
BA_ "GatewayedSignals" SG_ 360 BCS_WheelSlipFLValid 0;
BA_ "GenSigInactiveValue" SG_ 360 BCS_WheelSlipFLValid 0;
BA_ "GenSigInvalidValue" SG_ 360 BCS_WheelSlipFLValid 0;
BA_ "GenSigSendType" SG_ 360 BCS_WheelSlipFLValid 1;
BA_ "GenSigStartValue" SG_ 360 BCS_WheelSlipFLValid 0;
BA_ "GenSigTimeoutValue" SG_ 360 BCS_WheelSlipFLValid 0;
BA_ "Remark" SG_ 360 BCS_WheelSlipFLValid "";
BA_ "EventCommandSignal" SG_ 360 BCS_WheelSlipFRValid 0;
BA_ "GatewayedSignals" SG_ 360 BCS_WheelSlipFRValid 0;
BA_ "GenSigInactiveValue" SG_ 360 BCS_WheelSlipFRValid 0;
BA_ "GenSigInvalidValue" SG_ 360 BCS_WheelSlipFRValid 0;
BA_ "GenSigSendType" SG_ 360 BCS_WheelSlipFRValid 1;
BA_ "GenSigStartValue" SG_ 360 BCS_WheelSlipFRValid 0;
BA_ "GenSigTimeoutValue" SG_ 360 BCS_WheelSlipFRValid 0;
BA_ "Remark" SG_ 360 BCS_WheelSlipFRValid "";
BA_ "EventCommandSignal" SG_ 360 BCS_WheelSlipRLValid 0;
BA_ "GatewayedSignals" SG_ 360 BCS_WheelSlipRLValid 0;
BA_ "GenSigInactiveValue" SG_ 360 BCS_WheelSlipRLValid 0;
BA_ "GenSigInvalidValue" SG_ 360 BCS_WheelSlipRLValid 0;
BA_ "GenSigSendType" SG_ 360 BCS_WheelSlipRLValid 1;
BA_ "GenSigStartValue" SG_ 360 BCS_WheelSlipRLValid 0;
BA_ "GenSigTimeoutValue" SG_ 360 BCS_WheelSlipRLValid 0;
BA_ "Remark" SG_ 360 BCS_WheelSlipRLValid "";
BA_ "EventCommandSignal" SG_ 360 BCS_WheelSlipRRValid 0;
BA_ "GatewayedSignals" SG_ 360 BCS_WheelSlipRRValid 0;
BA_ "GenSigInactiveValue" SG_ 360 BCS_WheelSlipRRValid 0;
BA_ "GenSigInvalidValue" SG_ 360 BCS_WheelSlipRRValid 0;
BA_ "GenSigSendType" SG_ 360 BCS_WheelSlipRRValid 1;
BA_ "GenSigStartValue" SG_ 360 BCS_WheelSlipRRValid 0;
BA_ "GenSigTimeoutValue" SG_ 360 BCS_WheelSlipRRValid 0;
BA_ "Remark" SG_ 360 BCS_WheelSlipRRValid "";
BA_ "EventCommandSignal" SG_ 360 BCS_DrvrTqDes 0;
BA_ "GatewayedSignals" SG_ 360 BCS_DrvrTqDes 0;
BA_ "GenSigInactiveValue" SG_ 360 BCS_DrvrTqDes 0;
BA_ "GenSigInvalidValue" SG_ 360 BCS_DrvrTqDes 0;
BA_ "GenSigSendType" SG_ 360 BCS_DrvrTqDes 1;
BA_ "GenSigStartValue" SG_ 360 BCS_DrvrTqDes 0;
BA_ "GenSigTimeoutValue" SG_ 360 BCS_DrvrTqDes 0;
BA_ "Remark" SG_ 360 BCS_DrvrTqDes "";
BA_ "EventCommandSignal" SG_ 360 BCS_CrbsTarRecpTorqRqFA 0;
BA_ "GatewayedSignals" SG_ 360 BCS_CrbsTarRecpTorqRqFA 0;
BA_ "GenSigInactiveValue" SG_ 360 BCS_CrbsTarRecpTorqRqFA 0;
BA_ "GenSigInvalidValue" SG_ 360 BCS_CrbsTarRecpTorqRqFA 0;
BA_ "GenSigSendType" SG_ 360 BCS_CrbsTarRecpTorqRqFA 1;
BA_ "GenSigStartValue" SG_ 360 BCS_CrbsTarRecpTorqRqFA 6000;
BA_ "GenSigTimeoutValue" SG_ 360 BCS_CrbsTarRecpTorqRqFA 0;
BA_ "Remark" SG_ 360 BCS_CrbsTarRecpTorqRqFA "";
BA_ "EventCommandSignal" SG_ 360 BCS_CrbsTarRecpTorqRqFASt 0;
BA_ "GatewayedSignals" SG_ 360 BCS_CrbsTarRecpTorqRqFASt 0;
BA_ "GenSigInactiveValue" SG_ 360 BCS_CrbsTarRecpTorqRqFASt 0;
BA_ "GenSigInvalidValue" SG_ 360 BCS_CrbsTarRecpTorqRqFASt 0;
BA_ "GenSigSendType" SG_ 360 BCS_CrbsTarRecpTorqRqFASt 1;
BA_ "GenSigStartValue" SG_ 360 BCS_CrbsTarRecpTorqRqFASt 0;
BA_ "GenSigTimeoutValue" SG_ 360 BCS_CrbsTarRecpTorqRqFASt 0;
BA_ "Remark" SG_ 360 BCS_CrbsTarRecpTorqRqFASt "";
BA_ "EventCommandSignal" SG_ 360 BCS_CrbsTarRecpTorqRqRA 0;
BA_ "GatewayedSignals" SG_ 360 BCS_CrbsTarRecpTorqRqRA 0;
BA_ "GenSigInactiveValue" SG_ 360 BCS_CrbsTarRecpTorqRqRA 0;
BA_ "GenSigInvalidValue" SG_ 360 BCS_CrbsTarRecpTorqRqRA 0;
BA_ "GenSigSendType" SG_ 360 BCS_CrbsTarRecpTorqRqRA 1;
BA_ "GenSigStartValue" SG_ 360 BCS_CrbsTarRecpTorqRqRA 6000;
BA_ "GenSigTimeoutValue" SG_ 360 BCS_CrbsTarRecpTorqRqRA 0;
BA_ "Remark" SG_ 360 BCS_CrbsTarRecpTorqRqRA "";
BA_ "EventCommandSignal" SG_ 360 BCS_CrbsTarRecpTorqRqRASt 0;
BA_ "GatewayedSignals" SG_ 360 BCS_CrbsTarRecpTorqRqRASt 0;
BA_ "GenSigInactiveValue" SG_ 360 BCS_CrbsTarRecpTorqRqRASt 0;
BA_ "GenSigInvalidValue" SG_ 360 BCS_CrbsTarRecpTorqRqRASt 0;
BA_ "GenSigSendType" SG_ 360 BCS_CrbsTarRecpTorqRqRASt 1;
BA_ "GenSigStartValue" SG_ 360 BCS_CrbsTarRecpTorqRqRASt 0;
BA_ "GenSigTimeoutValue" SG_ 360 BCS_CrbsTarRecpTorqRqRASt 0;
BA_ "Remark" SG_ 360 BCS_CrbsTarRecpTorqRqRASt "";
BA_ "EventCommandSignal" SG_ 360 BCS_CrbsTarRecpTorqRqSum 0;
BA_ "GatewayedSignals" SG_ 360 BCS_CrbsTarRecpTorqRqSum 0;
BA_ "GenSigInactiveValue" SG_ 360 BCS_CrbsTarRecpTorqRqSum 0;
BA_ "GenSigInvalidValue" SG_ 360 BCS_CrbsTarRecpTorqRqSum 0;
BA_ "GenSigSendType" SG_ 360 BCS_CrbsTarRecpTorqRqSum 1;
BA_ "GenSigStartValue" SG_ 360 BCS_CrbsTarRecpTorqRqSum 6000;
BA_ "GenSigTimeoutValue" SG_ 360 BCS_CrbsTarRecpTorqRqSum 0;
BA_ "Remark" SG_ 360 BCS_CrbsTarRecpTorqRqSum "";
BA_ "EventCommandSignal" SG_ 360 BCS_CrbsTarRecpTorqRqSumSt 0;
BA_ "GatewayedSignals" SG_ 360 BCS_CrbsTarRecpTorqRqSumSt 0;
BA_ "GenSigInactiveValue" SG_ 360 BCS_CrbsTarRecpTorqRqSumSt 0;
BA_ "GenSigInvalidValue" SG_ 360 BCS_CrbsTarRecpTorqRqSumSt 0;
BA_ "GenSigSendType" SG_ 360 BCS_CrbsTarRecpTorqRqSumSt 1;
BA_ "GenSigStartValue" SG_ 360 BCS_CrbsTarRecpTorqRqSumSt 0;
BA_ "GenSigTimeoutValue" SG_ 360 BCS_CrbsTarRecpTorqRqSumSt 0;
BA_ "Remark" SG_ 360 BCS_CrbsTarRecpTorqRqSumSt "";
BA_ "EventCommandSignal" SG_ 360 BCS_BrkTqCtrlAvlParkingRdn 0;
BA_ "GatewayedSignals" SG_ 360 BCS_BrkTqCtrlAvlParkingRdn 0;
BA_ "GenSigInactiveValue" SG_ 360 BCS_BrkTqCtrlAvlParkingRdn 0;
BA_ "GenSigInvalidValue" SG_ 360 BCS_BrkTqCtrlAvlParkingRdn 0;
BA_ "GenSigSendType" SG_ 360 BCS_BrkTqCtrlAvlParkingRdn 1;
BA_ "GenSigStartValue" SG_ 360 BCS_BrkTqCtrlAvlParkingRdn 0;
BA_ "GenSigTimeoutValue" SG_ 360 BCS_BrkTqCtrlAvlParkingRdn 0;
BA_ "Remark" SG_ 360 BCS_BrkTqCtrlAvlParkingRdn "";
BA_ "EventCommandSignal" SG_ 360 BCS_WheelSlipFL 0;
BA_ "GatewayedSignals" SG_ 360 BCS_WheelSlipFL 0;
BA_ "GenSigInactiveValue" SG_ 360 BCS_WheelSlipFL 0;
BA_ "GenSigInvalidValue" SG_ 360 BCS_WheelSlipFL 0;
BA_ "GenSigSendType" SG_ 360 BCS_WheelSlipFL 1;
BA_ "GenSigStartValue" SG_ 360 BCS_WheelSlipFL 0;
BA_ "GenSigTimeoutValue" SG_ 360 BCS_WheelSlipFL 0;
BA_ "Remark" SG_ 360 BCS_WheelSlipFL "";
BA_ "EventCommandSignal" SG_ 360 BCS_WheelSlipFR 0;
BA_ "GatewayedSignals" SG_ 360 BCS_WheelSlipFR 0;
BA_ "GenSigInactiveValue" SG_ 360 BCS_WheelSlipFR 0;
BA_ "GenSigInvalidValue" SG_ 360 BCS_WheelSlipFR 0;
BA_ "GenSigSendType" SG_ 360 BCS_WheelSlipFR 1;
BA_ "GenSigStartValue" SG_ 360 BCS_WheelSlipFR 0;
BA_ "GenSigTimeoutValue" SG_ 360 BCS_WheelSlipFR 0;
BA_ "Remark" SG_ 360 BCS_WheelSlipFR "";
BA_ "EventCommandSignal" SG_ 360 BCS_WheelSlipRL 0;
BA_ "GatewayedSignals" SG_ 360 BCS_WheelSlipRL 0;
BA_ "GenSigInactiveValue" SG_ 360 BCS_WheelSlipRL 0;
BA_ "GenSigInvalidValue" SG_ 360 BCS_WheelSlipRL 0;
BA_ "GenSigSendType" SG_ 360 BCS_WheelSlipRL 1;
BA_ "GenSigStartValue" SG_ 360 BCS_WheelSlipRL 0;
BA_ "GenSigTimeoutValue" SG_ 360 BCS_WheelSlipRL 0;
BA_ "Remark" SG_ 360 BCS_WheelSlipRL "";
BA_ "EventCommandSignal" SG_ 360 BCS_WheelSlipRR 0;
BA_ "GatewayedSignals" SG_ 360 BCS_WheelSlipRR 0;
BA_ "GenSigInactiveValue" SG_ 360 BCS_WheelSlipRR 0;
BA_ "GenSigInvalidValue" SG_ 360 BCS_WheelSlipRR 0;
BA_ "GenSigSendType" SG_ 360 BCS_WheelSlipRR 1;
BA_ "GenSigStartValue" SG_ 360 BCS_WheelSlipRR 0;
BA_ "GenSigTimeoutValue" SG_ 360 BCS_WheelSlipRR 0;
BA_ "Remark" SG_ 360 BCS_WheelSlipRR "";
BA_ "EventCommandSignal" SG_ 618 EPB_1_CRC 0;
BA_ "GatewayedSignals" SG_ 618 EPB_1_CRC 0;
BA_ "GenSigInactiveValue" SG_ 618 EPB_1_CRC 0;
BA_ "GenSigInvalidValue" SG_ 618 EPB_1_CRC 0;
BA_ "GenSigSendType" SG_ 618 EPB_1_CRC 1;
BA_ "GenSigStartValue" SG_ 618 EPB_1_CRC 0;
BA_ "GenSigTimeoutValue" SG_ 618 EPB_1_CRC 0;
BA_ "Remark" SG_ 618 EPB_1_CRC "";
BA_ "EventCommandSignal" SG_ 618 EPB_1_Counter 0;
BA_ "GatewayedSignals" SG_ 618 EPB_1_Counter 0;
BA_ "GenSigInactiveValue" SG_ 618 EPB_1_Counter 0;
BA_ "GenSigInvalidValue" SG_ 618 EPB_1_Counter 0;
BA_ "GenSigSendType" SG_ 618 EPB_1_Counter 1;
BA_ "GenSigStartValue" SG_ 618 EPB_1_Counter 0;
BA_ "GenSigTimeoutValue" SG_ 618 EPB_1_Counter 0;
BA_ "Remark" SG_ 618 EPB_1_Counter "";
BA_ "EventCommandSignal" SG_ 618 EPB_SwitchSt 0;
BA_ "GatewayedSignals" SG_ 618 EPB_SwitchSt 0;
BA_ "GenSigInactiveValue" SG_ 618 EPB_SwitchSt 0;
BA_ "GenSigInvalidValue" SG_ 618 EPB_SwitchSt 0;
BA_ "GenSigSendType" SG_ 618 EPB_SwitchSt 1;
BA_ "GenSigStartValue" SG_ 618 EPB_SwitchSt 0;
BA_ "GenSigTimeoutValue" SG_ 618 EPB_SwitchSt 0;
BA_ "Remark" SG_ 618 EPB_SwitchSt "";
BA_ "EventCommandSignal" SG_ 618 EPB_SwitchStVD 0;
BA_ "GatewayedSignals" SG_ 618 EPB_SwitchStVD 0;
BA_ "GenSigInactiveValue" SG_ 618 EPB_SwitchStVD 0;
BA_ "GenSigInvalidValue" SG_ 618 EPB_SwitchStVD 0;
BA_ "GenSigSendType" SG_ 618 EPB_SwitchStVD 1;
BA_ "GenSigStartValue" SG_ 618 EPB_SwitchStVD 0;
BA_ "GenSigTimeoutValue" SG_ 618 EPB_SwitchStVD 0;
BA_ "Remark" SG_ 618 EPB_SwitchStVD "";
BA_ "EventCommandSignal" SG_ 618 EPB_SysSt 0;
BA_ "GatewayedSignals" SG_ 618 EPB_SysSt 0;
BA_ "GenSigInactiveValue" SG_ 618 EPB_SysSt 0;
BA_ "GenSigInvalidValue" SG_ 618 EPB_SysSt 0;
BA_ "GenSigSendType" SG_ 618 EPB_SysSt 1;
BA_ "GenSigStartValue" SG_ 618 EPB_SysSt 0;
BA_ "GenSigTimeoutValue" SG_ 618 EPB_SysSt 7;
BA_ "Remark" SG_ 618 EPB_SysSt "";
BA_ "EventCommandSignal" SG_ 618 EPB_FailSt 0;
BA_ "GatewayedSignals" SG_ 618 EPB_FailSt 0;
BA_ "GenSigInactiveValue" SG_ 618 EPB_FailSt 0;
BA_ "GenSigInvalidValue" SG_ 618 EPB_FailSt 0;
BA_ "GenSigSendType" SG_ 618 EPB_FailSt 1;
BA_ "GenSigStartValue" SG_ 618 EPB_FailSt 0;
BA_ "GenSigTimeoutValue" SG_ 618 EPB_FailSt 1;
BA_ "Remark" SG_ 618 EPB_FailSt "";
BA_ "EventCommandSignal" SG_ 618 EPB_ExtAvailable 0;
BA_ "GatewayedSignals" SG_ 618 EPB_ExtAvailable 0;
BA_ "GenSigInactiveValue" SG_ 618 EPB_ExtAvailable 0;
BA_ "GenSigInvalidValue" SG_ 618 EPB_ExtAvailable 0;
BA_ "GenSigSendType" SG_ 618 EPB_ExtAvailable 1;
BA_ "GenSigStartValue" SG_ 618 EPB_ExtAvailable 0;
BA_ "GenSigTimeoutValue" SG_ 618 EPB_ExtAvailable 0;
BA_ "Remark" SG_ 618 EPB_ExtAvailable "";
BA_ "EventCommandSignal" SG_ 618 EPB_DynamicApplySt 0;
BA_ "GatewayedSignals" SG_ 618 EPB_DynamicApplySt 0;
BA_ "GenSigInactiveValue" SG_ 618 EPB_DynamicApplySt 0;
BA_ "GenSigInvalidValue" SG_ 618 EPB_DynamicApplySt 0;
BA_ "GenSigSendType" SG_ 618 EPB_DynamicApplySt 1;
BA_ "GenSigStartValue" SG_ 618 EPB_DynamicApplySt 0;
BA_ "GenSigTimeoutValue" SG_ 618 EPB_DynamicApplySt 0;
BA_ "Remark" SG_ 618 EPB_DynamicApplySt "";
BA_ "EventCommandSignal" SG_ 618 EPB_ActuatorSt_R 0;
BA_ "GatewayedSignals" SG_ 618 EPB_ActuatorSt_R 0;
BA_ "GenSigInactiveValue" SG_ 618 EPB_ActuatorSt_R 0;
BA_ "GenSigInvalidValue" SG_ 618 EPB_ActuatorSt_R 0;
BA_ "GenSigSendType" SG_ 618 EPB_ActuatorSt_R 1;
BA_ "GenSigStartValue" SG_ 618 EPB_ActuatorSt_R 0;
BA_ "GenSigTimeoutValue" SG_ 618 EPB_ActuatorSt_R 0;
BA_ "Remark" SG_ 618 EPB_ActuatorSt_R "";
BA_ "EventCommandSignal" SG_ 618 EPB_RWUActvSts 0;
BA_ "GatewayedSignals" SG_ 618 EPB_RWUActvSts 0;
BA_ "GenSigInactiveValue" SG_ 618 EPB_RWUActvSts 0;
BA_ "GenSigInvalidValue" SG_ 618 EPB_RWUActvSts 0;
BA_ "GenSigSendType" SG_ 618 EPB_RWUActvSts 1;
BA_ "GenSigStartValue" SG_ 618 EPB_RWUActvSts 0;
BA_ "GenSigTimeoutValue" SG_ 618 EPB_RWUActvSts 0;
BA_ "Remark" SG_ 618 EPB_RWUActvSts "";
BA_ "EventCommandSignal" SG_ 618 EPB_RWUAvl 0;
BA_ "GatewayedSignals" SG_ 618 EPB_RWUAvl 0;
BA_ "GenSigInactiveValue" SG_ 618 EPB_RWUAvl 0;
BA_ "GenSigInvalidValue" SG_ 618 EPB_RWUAvl 0;
BA_ "GenSigSendType" SG_ 618 EPB_RWUAvl 1;
BA_ "GenSigStartValue" SG_ 618 EPB_RWUAvl 0;
BA_ "GenSigTimeoutValue" SG_ 618 EPB_RWUAvl 0;
BA_ "Remark" SG_ 618 EPB_RWUAvl "";
BA_ "EventCommandSignal" SG_ 618 EPB_RPAAVPAvailability 0;
BA_ "GatewayedSignals" SG_ 618 EPB_RPAAVPAvailability 0;
BA_ "GenSigInactiveValue" SG_ 618 EPB_RPAAVPAvailability 0;
BA_ "GenSigInvalidValue" SG_ 618 EPB_RPAAVPAvailability 0;
BA_ "GenSigSendType" SG_ 618 EPB_RPAAVPAvailability 1;
BA_ "GenSigStartValue" SG_ 618 EPB_RPAAVPAvailability 0;
BA_ "GenSigTimeoutValue" SG_ 618 EPB_RPAAVPAvailability 0;
BA_ "Remark" SG_ 618 EPB_RPAAVPAvailability "";
BA_ "EventCommandSignal" SG_ 618 EPB_APAAvailability 0;
BA_ "GatewayedSignals" SG_ 618 EPB_APAAvailability 0;
BA_ "GenSigInactiveValue" SG_ 618 EPB_APAAvailability 0;
BA_ "GenSigInvalidValue" SG_ 618 EPB_APAAvailability 0;
BA_ "GenSigSendType" SG_ 618 EPB_APAAvailability 1;
BA_ "GenSigStartValue" SG_ 618 EPB_APAAvailability 0;
BA_ "GenSigTimeoutValue" SG_ 618 EPB_APAAvailability 0;
BA_ "Remark" SG_ 618 EPB_APAAvailability "";
BA_ "EventCommandSignal" SG_ 618 EPB_ADCNetErrorFb 0;
BA_ "GatewayedSignals" SG_ 618 EPB_ADCNetErrorFb 0;
BA_ "GenSigInactiveValue" SG_ 618 EPB_ADCNetErrorFb 0;
BA_ "GenSigInvalidValue" SG_ 618 EPB_ADCNetErrorFb 0;
BA_ "GenSigSendType" SG_ 618 EPB_ADCNetErrorFb 1;
BA_ "GenSigStartValue" SG_ 618 EPB_ADCNetErrorFb 0;
BA_ "GenSigTimeoutValue" SG_ 618 EPB_ADCNetErrorFb 0;
BA_ "Remark" SG_ 618 EPB_ADCNetErrorFb "";
BA_ "EventCommandSignal" SG_ 618 EPB_NetModeResp 0;
BA_ "GatewayedSignals" SG_ 618 EPB_NetModeResp 0;
BA_ "GenSigInactiveValue" SG_ 618 EPB_NetModeResp 0;
BA_ "GenSigInvalidValue" SG_ 618 EPB_NetModeResp 0;
BA_ "GenSigSendType" SG_ 618 EPB_NetModeResp 1;
BA_ "GenSigStartValue" SG_ 618 EPB_NetModeResp 0;
BA_ "GenSigTimeoutValue" SG_ 618 EPB_NetModeResp 0;
BA_ "Remark" SG_ 618 EPB_NetModeResp "";
BA_ "EventCommandSignal" SG_ 433 CCU_GVS_3_CRC 0;
BA_ "GatewayedSignals" SG_ 433 CCU_GVS_3_CRC 0;
BA_ "GenSigInactiveValue" SG_ 433 CCU_GVS_3_CRC 0;
BA_ "GenSigInvalidValue" SG_ 433 CCU_GVS_3_CRC 0;
BA_ "GenSigSendType" SG_ 433 CCU_GVS_3_CRC 1;
BA_ "GenSigStartValue" SG_ 433 CCU_GVS_3_CRC 0;
BA_ "GenSigTimeoutValue" SG_ 433 CCU_GVS_3_CRC 0;
BA_ "Remark" SG_ 433 CCU_GVS_3_CRC "";
BA_ "EventCommandSignal" SG_ 433 CCU_GVS_3_Counter 0;
BA_ "GatewayedSignals" SG_ 433 CCU_GVS_3_Counter 0;
BA_ "GenSigInactiveValue" SG_ 433 CCU_GVS_3_Counter 0;
BA_ "GenSigInvalidValue" SG_ 433 CCU_GVS_3_Counter 0;
BA_ "GenSigSendType" SG_ 433 CCU_GVS_3_Counter 1;
BA_ "GenSigStartValue" SG_ 433 CCU_GVS_3_Counter 0;
BA_ "GenSigTimeoutValue" SG_ 433 CCU_GVS_3_Counter 0;
BA_ "Remark" SG_ 433 CCU_GVS_3_Counter "";
BA_ "EventCommandSignal" SG_ 433 AccPedalPstForMRR 0;
BA_ "GatewayedSignals" SG_ 433 AccPedalPstForMRR 0;
BA_ "GenSigInactiveValue" SG_ 433 AccPedalPstForMRR 0;
BA_ "GenSigInvalidValue" SG_ 433 AccPedalPstForMRR 0;
BA_ "GenSigSendType" SG_ 433 AccPedalPstForMRR 1;
BA_ "GenSigStartValue" SG_ 433 AccPedalPstForMRR 0;
BA_ "GenSigTimeoutValue" SG_ 433 AccPedalPstForMRR 0;
BA_ "Remark" SG_ 433 AccPedalPstForMRR "";
BA_ "EventCommandSignal" SG_ 433 AccPedalPstForMRRVD 0;
BA_ "GatewayedSignals" SG_ 433 AccPedalPstForMRRVD 0;
BA_ "GenSigInactiveValue" SG_ 433 AccPedalPstForMRRVD 0;
BA_ "GenSigInvalidValue" SG_ 433 AccPedalPstForMRRVD 0;
BA_ "GenSigSendType" SG_ 433 AccPedalPstForMRRVD 1;
BA_ "GenSigStartValue" SG_ 433 AccPedalPstForMRRVD 0;
BA_ "GenSigTimeoutValue" SG_ 433 AccPedalPstForMRRVD 0;
BA_ "Remark" SG_ 433 AccPedalPstForMRRVD "";
BA_ "EventCommandSignal" SG_ 433 VCU_VehActDrvTorqRR 0;
BA_ "GatewayedSignals" SG_ 433 VCU_VehActDrvTorqRR 0;
BA_ "GenSigInactiveValue" SG_ 433 VCU_VehActDrvTorqRR 0;
BA_ "GenSigInvalidValue" SG_ 433 VCU_VehActDrvTorqRR 0;
BA_ "GenSigSendType" SG_ 433 VCU_VehActDrvTorqRR 1;
BA_ "GenSigStartValue" SG_ 433 VCU_VehActDrvTorqRR 0;
BA_ "GenSigTimeoutValue" SG_ 433 VCU_VehActDrvTorqRR 0;
BA_ "Remark" SG_ 433 VCU_VehActDrvTorqRR "";
BA_ "EventCommandSignal" SG_ 433 VCU_VehActDrvTorqRRVD 0;
BA_ "GatewayedSignals" SG_ 433 VCU_VehActDrvTorqRRVD 0;
BA_ "GenSigInactiveValue" SG_ 433 VCU_VehActDrvTorqRRVD 0;
BA_ "GenSigInvalidValue" SG_ 433 VCU_VehActDrvTorqRRVD 0;
BA_ "GenSigSendType" SG_ 433 VCU_VehActDrvTorqRRVD 1;
BA_ "GenSigStartValue" SG_ 433 VCU_VehActDrvTorqRRVD 0;
BA_ "GenSigTimeoutValue" SG_ 433 VCU_VehActDrvTorqRRVD 0;
BA_ "Remark" SG_ 433 VCU_VehActDrvTorqRRVD "";
BA_ "EventCommandSignal" SG_ 433 VCU_FrntWhlReqTq 0;
BA_ "GatewayedSignals" SG_ 433 VCU_FrntWhlReqTq 0;
BA_ "GenSigInactiveValue" SG_ 433 VCU_FrntWhlReqTq 0;
BA_ "GenSigInvalidValue" SG_ 433 VCU_FrntWhlReqTq 0;
BA_ "GenSigSendType" SG_ 433 VCU_FrntWhlReqTq 1;
BA_ "GenSigStartValue" SG_ 433 VCU_FrntWhlReqTq 0;
BA_ "GenSigTimeoutValue" SG_ 433 VCU_FrntWhlReqTq 0;
BA_ "Remark" SG_ 433 VCU_FrntWhlReqTq "";
BA_ "EventCommandSignal" SG_ 433 VCU_FrntWhlReqTqVld 0;
BA_ "GatewayedSignals" SG_ 433 VCU_FrntWhlReqTqVld 0;
BA_ "GenSigInactiveValue" SG_ 433 VCU_FrntWhlReqTqVld 0;
BA_ "GenSigInvalidValue" SG_ 433 VCU_FrntWhlReqTqVld 0;
BA_ "GenSigSendType" SG_ 433 VCU_FrntWhlReqTqVld 1;
BA_ "GenSigStartValue" SG_ 433 VCU_FrntWhlReqTqVld 0;
BA_ "GenSigTimeoutValue" SG_ 433 VCU_FrntWhlReqTqVld 0;
BA_ "Remark" SG_ 433 VCU_FrntWhlReqTqVld "";
BA_ "EventCommandSignal" SG_ 433 VCU_ReWhlReqTqRR 0;
BA_ "GatewayedSignals" SG_ 433 VCU_ReWhlReqTqRR 0;
BA_ "GenSigInactiveValue" SG_ 433 VCU_ReWhlReqTqRR 0;
BA_ "GenSigInvalidValue" SG_ 433 VCU_ReWhlReqTqRR 0;
BA_ "GenSigSendType" SG_ 433 VCU_ReWhlReqTqRR 1;
BA_ "GenSigStartValue" SG_ 433 VCU_ReWhlReqTqRR 0;
BA_ "GenSigTimeoutValue" SG_ 433 VCU_ReWhlReqTqRR 0;
BA_ "Remark" SG_ 433 VCU_ReWhlReqTqRR "";
BA_ "EventCommandSignal" SG_ 433 VCU_ReWhlReqTqRRVld 0;
BA_ "GatewayedSignals" SG_ 433 VCU_ReWhlReqTqRRVld 0;
BA_ "GenSigInactiveValue" SG_ 433 VCU_ReWhlReqTqRRVld 0;
BA_ "GenSigInvalidValue" SG_ 433 VCU_ReWhlReqTqRRVld 0;
BA_ "GenSigSendType" SG_ 433 VCU_ReWhlReqTqRRVld 1;
BA_ "GenSigStartValue" SG_ 433 VCU_ReWhlReqTqRRVld 0;
BA_ "GenSigTimeoutValue" SG_ 433 VCU_ReWhlReqTqRRVld 0;
BA_ "Remark" SG_ 433 VCU_ReWhlReqTqRRVld "";
BA_ "EventCommandSignal" SG_ 433 VCU_ReWhlReqTqRL 0;
BA_ "GatewayedSignals" SG_ 433 VCU_ReWhlReqTqRL 0;
BA_ "GenSigInactiveValue" SG_ 433 VCU_ReWhlReqTqRL 0;
BA_ "GenSigInvalidValue" SG_ 433 VCU_ReWhlReqTqRL 0;
BA_ "GenSigSendType" SG_ 433 VCU_ReWhlReqTqRL 1;
BA_ "GenSigStartValue" SG_ 433 VCU_ReWhlReqTqRL 0;
BA_ "GenSigTimeoutValue" SG_ 433 VCU_ReWhlReqTqRL 0;
BA_ "Remark" SG_ 433 VCU_ReWhlReqTqRL "";
BA_ "EventCommandSignal" SG_ 433 VCU_ReWhlReqTqRLVld 0;
BA_ "GatewayedSignals" SG_ 433 VCU_ReWhlReqTqRLVld 0;
BA_ "GenSigInactiveValue" SG_ 433 VCU_ReWhlReqTqRLVld 0;
BA_ "GenSigInvalidValue" SG_ 433 VCU_ReWhlReqTqRLVld 0;
BA_ "GenSigSendType" SG_ 433 VCU_ReWhlReqTqRLVld 1;
BA_ "GenSigStartValue" SG_ 433 VCU_ReWhlReqTqRLVld 0;
BA_ "GenSigTimeoutValue" SG_ 433 VCU_ReWhlReqTqRLVld 0;
BA_ "Remark" SG_ 433 VCU_ReWhlReqTqRLVld "";
BA_ "EventCommandSignal" SG_ 433 VCU_DrvYawMomAvl 0;
BA_ "GatewayedSignals" SG_ 433 VCU_DrvYawMomAvl 0;
BA_ "GenSigInactiveValue" SG_ 433 VCU_DrvYawMomAvl 0;
BA_ "GenSigInvalidValue" SG_ 433 VCU_DrvYawMomAvl 0;
BA_ "GenSigSendType" SG_ 433 VCU_DrvYawMomAvl 1;
BA_ "GenSigStartValue" SG_ 433 VCU_DrvYawMomAvl 0;
BA_ "GenSigTimeoutValue" SG_ 433 VCU_DrvYawMomAvl 0;
BA_ "Remark" SG_ 433 VCU_DrvYawMomAvl "";
BA_ "EventCommandSignal" SG_ 433 VCU_DrvYawMomRespSts 0;
BA_ "GatewayedSignals" SG_ 433 VCU_DrvYawMomRespSts 0;
BA_ "GenSigInactiveValue" SG_ 433 VCU_DrvYawMomRespSts 0;
BA_ "GenSigInvalidValue" SG_ 433 VCU_DrvYawMomRespSts 0;
BA_ "GenSigSendType" SG_ 433 VCU_DrvYawMomRespSts 1;
BA_ "GenSigStartValue" SG_ 433 VCU_DrvYawMomRespSts 0;
BA_ "GenSigTimeoutValue" SG_ 433 VCU_DrvYawMomRespSts 0;
BA_ "Remark" SG_ 433 VCU_DrvYawMomRespSts "";
BA_ "EventCommandSignal" SG_ 433 VCU_MotorDrvCaplTqWhlFA 0;
BA_ "GatewayedSignals" SG_ 433 VCU_MotorDrvCaplTqWhlFA 0;
BA_ "GenSigInactiveValue" SG_ 433 VCU_MotorDrvCaplTqWhlFA 0;
BA_ "GenSigInvalidValue" SG_ 433 VCU_MotorDrvCaplTqWhlFA 0;
BA_ "GenSigSendType" SG_ 433 VCU_MotorDrvCaplTqWhlFA 1;
BA_ "GenSigStartValue" SG_ 433 VCU_MotorDrvCaplTqWhlFA 0;
BA_ "GenSigTimeoutValue" SG_ 433 VCU_MotorDrvCaplTqWhlFA 65535;
BA_ "Remark" SG_ 433 VCU_MotorDrvCaplTqWhlFA "";
BA_ "EventCommandSignal" SG_ 433 VCU_MotorRgnCaplTqWhlFA 0;
BA_ "GatewayedSignals" SG_ 433 VCU_MotorRgnCaplTqWhlFA 0;
BA_ "GenSigInactiveValue" SG_ 433 VCU_MotorRgnCaplTqWhlFA 0;
BA_ "GenSigInvalidValue" SG_ 433 VCU_MotorRgnCaplTqWhlFA 0;
BA_ "GenSigSendType" SG_ 433 VCU_MotorRgnCaplTqWhlFA 1;
BA_ "GenSigStartValue" SG_ 433 VCU_MotorRgnCaplTqWhlFA 0;
BA_ "GenSigTimeoutValue" SG_ 433 VCU_MotorRgnCaplTqWhlFA 65535;
BA_ "Remark" SG_ 433 VCU_MotorRgnCaplTqWhlFA "";
BA_ "EventCommandSignal" SG_ 433 VCU_MotorDrvCaplTqWhlRL 0;
BA_ "GatewayedSignals" SG_ 433 VCU_MotorDrvCaplTqWhlRL 0;
BA_ "GenSigInactiveValue" SG_ 433 VCU_MotorDrvCaplTqWhlRL 0;
BA_ "GenSigInvalidValue" SG_ 433 VCU_MotorDrvCaplTqWhlRL 0;
BA_ "GenSigSendType" SG_ 433 VCU_MotorDrvCaplTqWhlRL 1;
BA_ "GenSigStartValue" SG_ 433 VCU_MotorDrvCaplTqWhlRL 0;
BA_ "GenSigTimeoutValue" SG_ 433 VCU_MotorDrvCaplTqWhlRL 65535;
BA_ "Remark" SG_ 433 VCU_MotorDrvCaplTqWhlRL "";
BA_ "EventCommandSignal" SG_ 433 VCU_MotorRgnCaplTqWhlRL 0;
BA_ "GatewayedSignals" SG_ 433 VCU_MotorRgnCaplTqWhlRL 0;
BA_ "GenSigInactiveValue" SG_ 433 VCU_MotorRgnCaplTqWhlRL 0;
BA_ "GenSigInvalidValue" SG_ 433 VCU_MotorRgnCaplTqWhlRL 0;
BA_ "GenSigSendType" SG_ 433 VCU_MotorRgnCaplTqWhlRL 1;
BA_ "GenSigStartValue" SG_ 433 VCU_MotorRgnCaplTqWhlRL 0;
BA_ "GenSigTimeoutValue" SG_ 433 VCU_MotorRgnCaplTqWhlRL 65535;
BA_ "Remark" SG_ 433 VCU_MotorRgnCaplTqWhlRL "";
BA_ "EventCommandSignal" SG_ 433 VCU_MotorDrvCaplTqWhlRR 0;
BA_ "GatewayedSignals" SG_ 433 VCU_MotorDrvCaplTqWhlRR 0;
BA_ "GenSigInactiveValue" SG_ 433 VCU_MotorDrvCaplTqWhlRR 0;
BA_ "GenSigInvalidValue" SG_ 433 VCU_MotorDrvCaplTqWhlRR 0;
BA_ "GenSigSendType" SG_ 433 VCU_MotorDrvCaplTqWhlRR 1;
BA_ "GenSigStartValue" SG_ 433 VCU_MotorDrvCaplTqWhlRR 0;
BA_ "GenSigTimeoutValue" SG_ 433 VCU_MotorDrvCaplTqWhlRR 65535;
BA_ "Remark" SG_ 433 VCU_MotorDrvCaplTqWhlRR "";
BA_ "EventCommandSignal" SG_ 433 VCU_MotorRgnCaplTqWhlRR 0;
BA_ "GatewayedSignals" SG_ 433 VCU_MotorRgnCaplTqWhlRR 0;
BA_ "GenSigInactiveValue" SG_ 433 VCU_MotorRgnCaplTqWhlRR 0;
BA_ "GenSigInvalidValue" SG_ 433 VCU_MotorRgnCaplTqWhlRR 0;
BA_ "GenSigSendType" SG_ 433 VCU_MotorRgnCaplTqWhlRR 1;
BA_ "GenSigStartValue" SG_ 433 VCU_MotorRgnCaplTqWhlRR 0;
BA_ "GenSigTimeoutValue" SG_ 433 VCU_MotorRgnCaplTqWhlRR 65535;
BA_ "Remark" SG_ 433 VCU_MotorRgnCaplTqWhlRR "";
BA_ "EventCommandSignal" SG_ 433 VCU_PreStableFlg 0;
BA_ "GatewayedSignals" SG_ 433 VCU_PreStableFlg 0;
BA_ "GenSigInactiveValue" SG_ 433 VCU_PreStableFlg 0;
BA_ "GenSigInvalidValue" SG_ 433 VCU_PreStableFlg 0;
BA_ "GenSigSendType" SG_ 433 VCU_PreStableFlg 1;
BA_ "GenSigStartValue" SG_ 433 VCU_PreStableFlg 0;
BA_ "GenSigTimeoutValue" SG_ 433 VCU_PreStableFlg 0;
BA_ "Remark" SG_ 433 VCU_PreStableFlg "";
BA_ "EventCommandSignal" SG_ 433 VCU_ErrorFb 0;
BA_ "GatewayedSignals" SG_ 433 VCU_ErrorFb 0;
BA_ "GenSigInactiveValue" SG_ 433 VCU_ErrorFb 0;
BA_ "GenSigInvalidValue" SG_ 433 VCU_ErrorFb 0;
BA_ "GenSigSendType" SG_ 433 VCU_ErrorFb 1;
BA_ "GenSigStartValue" SG_ 433 VCU_ErrorFb 0;
BA_ "GenSigTimeoutValue" SG_ 433 VCU_ErrorFb 0;
BA_ "Remark" SG_ 433 VCU_ErrorFb "";
BA_ "EventCommandSignal" SG_ 433 VCU_DrvrAccrPedlOvrdVld 0;
BA_ "GatewayedSignals" SG_ 433 VCU_DrvrAccrPedlOvrdVld 0;
BA_ "GenSigInactiveValue" SG_ 433 VCU_DrvrAccrPedlOvrdVld 0;
BA_ "GenSigInvalidValue" SG_ 433 VCU_DrvrAccrPedlOvrdVld 0;
BA_ "GenSigSendType" SG_ 433 VCU_DrvrAccrPedlOvrdVld 1;
BA_ "GenSigStartValue" SG_ 433 VCU_DrvrAccrPedlOvrdVld 0;
BA_ "GenSigTimeoutValue" SG_ 433 VCU_DrvrAccrPedlOvrdVld 0;
BA_ "Remark" SG_ 433 VCU_DrvrAccrPedlOvrdVld "";
BA_ "EventCommandSignal" SG_ 433 VCU_VehWhlReqTqVld 0;
BA_ "GatewayedSignals" SG_ 433 VCU_VehWhlReqTqVld 0;
BA_ "GenSigInactiveValue" SG_ 433 VCU_VehWhlReqTqVld 0;
BA_ "GenSigInvalidValue" SG_ 433 VCU_VehWhlReqTqVld 0;
BA_ "GenSigSendType" SG_ 433 VCU_VehWhlReqTqVld 1;
BA_ "GenSigStartValue" SG_ 433 VCU_VehWhlReqTqVld 0;
BA_ "GenSigTimeoutValue" SG_ 433 VCU_VehWhlReqTqVld 0;
BA_ "Remark" SG_ 433 VCU_VehWhlReqTqVld "";
BA_ "EventCommandSignal" SG_ 433 VCU_MotorRegenTrqLmtlnDVaild 0;
BA_ "GatewayedSignals" SG_ 433 VCU_MotorRegenTrqLmtlnDVaild 0;
BA_ "GenSigInactiveValue" SG_ 433 VCU_MotorRegenTrqLmtlnDVaild 0;
BA_ "GenSigInvalidValue" SG_ 433 VCU_MotorRegenTrqLmtlnDVaild 0;
BA_ "GenSigSendType" SG_ 433 VCU_MotorRegenTrqLmtlnDVaild 1;
BA_ "GenSigStartValue" SG_ 433 VCU_MotorRegenTrqLmtlnDVaild 0;
BA_ "GenSigTimeoutValue" SG_ 433 VCU_MotorRegenTrqLmtlnDVaild 0;
BA_ "Remark" SG_ 433 VCU_MotorRegenTrqLmtlnDVaild "";
BA_ "EventCommandSignal" SG_ 433 VCU_GearShiftAvl 0;
BA_ "GatewayedSignals" SG_ 433 VCU_GearShiftAvl 0;
BA_ "GenSigInactiveValue" SG_ 433 VCU_GearShiftAvl 0;
BA_ "GenSigInvalidValue" SG_ 433 VCU_GearShiftAvl 0;
BA_ "GenSigSendType" SG_ 433 VCU_GearShiftAvl 1;
BA_ "GenSigStartValue" SG_ 433 VCU_GearShiftAvl 0;
BA_ "GenSigTimeoutValue" SG_ 433 VCU_GearShiftAvl 0;
BA_ "Remark" SG_ 433 VCU_GearShiftAvl "";
BA_ "EventCommandSignal" SG_ 433 VCU_PtTqAvl 0;
BA_ "GatewayedSignals" SG_ 433 VCU_PtTqAvl 0;
BA_ "GenSigInactiveValue" SG_ 433 VCU_PtTqAvl 0;
BA_ "GenSigInvalidValue" SG_ 433 VCU_PtTqAvl 0;
BA_ "GenSigSendType" SG_ 433 VCU_PtTqAvl 1;
BA_ "GenSigStartValue" SG_ 433 VCU_PtTqAvl 0;
BA_ "GenSigTimeoutValue" SG_ 433 VCU_PtTqAvl 0;
BA_ "Remark" SG_ 433 VCU_PtTqAvl "";
BA_ "EventCommandSignal" SG_ 433 VCU_PtTqActvSts 0;
BA_ "GatewayedSignals" SG_ 433 VCU_PtTqActvSts 0;
BA_ "GenSigInactiveValue" SG_ 433 VCU_PtTqActvSts 0;
BA_ "GenSigInvalidValue" SG_ 433 VCU_PtTqActvSts 0;
BA_ "GenSigSendType" SG_ 433 VCU_PtTqActvSts 1;
BA_ "GenSigStartValue" SG_ 433 VCU_PtTqActvSts 0;
BA_ "GenSigTimeoutValue" SG_ 433 VCU_PtTqActvSts 0;
BA_ "Remark" SG_ 433 VCU_PtTqActvSts "";
BA_ "EventCommandSignal" SG_ 433 VCU_MotorRegenTorqueLmtlnD 0;
BA_ "GatewayedSignals" SG_ 433 VCU_MotorRegenTorqueLmtlnD 0;
BA_ "GenSigInactiveValue" SG_ 433 VCU_MotorRegenTorqueLmtlnD 0;
BA_ "GenSigInvalidValue" SG_ 433 VCU_MotorRegenTorqueLmtlnD 0;
BA_ "GenSigSendType" SG_ 433 VCU_MotorRegenTorqueLmtlnD 1;
BA_ "GenSigStartValue" SG_ 433 VCU_MotorRegenTorqueLmtlnD 8191;
BA_ "GenSigTimeoutValue" SG_ 433 VCU_MotorRegenTorqueLmtlnD 0;
BA_ "Remark" SG_ 433 VCU_MotorRegenTorqueLmtlnD "";
BA_ "EventCommandSignal" SG_ 433 VCU_DriverTorqueDesired 0;
BA_ "GatewayedSignals" SG_ 433 VCU_DriverTorqueDesired 0;
BA_ "GenSigInactiveValue" SG_ 433 VCU_DriverTorqueDesired 0;
BA_ "GenSigInvalidValue" SG_ 433 VCU_DriverTorqueDesired 0;
BA_ "GenSigSendType" SG_ 433 VCU_DriverTorqueDesired 1;
BA_ "GenSigStartValue" SG_ 433 VCU_DriverTorqueDesired 32768;
BA_ "GenSigTimeoutValue" SG_ 433 VCU_DriverTorqueDesired 0;
BA_ "Remark" SG_ 433 VCU_DriverTorqueDesired "";
BA_ "EventCommandSignal" SG_ 433 VCU_VehWhlReqTq 0;
BA_ "GatewayedSignals" SG_ 433 VCU_VehWhlReqTq 0;
BA_ "GenSigInactiveValue" SG_ 433 VCU_VehWhlReqTq 0;
BA_ "GenSigInvalidValue" SG_ 433 VCU_VehWhlReqTq 0;
BA_ "GenSigSendType" SG_ 433 VCU_VehWhlReqTq 1;
BA_ "GenSigStartValue" SG_ 433 VCU_VehWhlReqTq 32768;
BA_ "GenSigTimeoutValue" SG_ 433 VCU_VehWhlReqTq 0;
BA_ "Remark" SG_ 433 VCU_VehWhlReqTq "";
BA_ "EventCommandSignal" SG_ 363 EPS_1_CRC 0;
BA_ "GatewayedSignals" SG_ 363 EPS_1_CRC 0;
BA_ "GenSigInactiveValue" SG_ 363 EPS_1_CRC 0;
BA_ "GenSigInvalidValue" SG_ 363 EPS_1_CRC 0;
BA_ "GenSigSendType" SG_ 363 EPS_1_CRC 1;
BA_ "GenSigStartValue" SG_ 363 EPS_1_CRC 0;
BA_ "GenSigTimeoutValue" SG_ 363 EPS_1_CRC 0;
BA_ "Remark" SG_ 363 EPS_1_CRC "";
BA_ "EventCommandSignal" SG_ 363 EPS_1_Counter 0;
BA_ "GatewayedSignals" SG_ 363 EPS_1_Counter 0;
BA_ "GenSigInactiveValue" SG_ 363 EPS_1_Counter 0;
BA_ "GenSigInvalidValue" SG_ 363 EPS_1_Counter 0;
BA_ "GenSigSendType" SG_ 363 EPS_1_Counter 1;
BA_ "GenSigStartValue" SG_ 363 EPS_1_Counter 0;
BA_ "GenSigTimeoutValue" SG_ 363 EPS_1_Counter 0;
BA_ "Remark" SG_ 363 EPS_1_Counter "";
BA_ "EventCommandSignal" SG_ 363 EPS_StrngWhlTorqVD 0;
BA_ "GatewayedSignals" SG_ 363 EPS_StrngWhlTorqVD 0;
BA_ "GenSigInactiveValue" SG_ 363 EPS_StrngWhlTorqVD 0;
BA_ "GenSigInvalidValue" SG_ 363 EPS_StrngWhlTorqVD 0;
BA_ "GenSigSendType" SG_ 363 EPS_StrngWhlTorqVD 1;
BA_ "GenSigStartValue" SG_ 363 EPS_StrngWhlTorqVD 0;
BA_ "GenSigTimeoutValue" SG_ 363 EPS_StrngWhlTorqVD 0;
BA_ "Remark" SG_ 363 EPS_StrngWhlTorqVD "";
BA_ "EventCommandSignal" SG_ 363 EPS_StrngWhlTorq 0;
BA_ "GatewayedSignals" SG_ 363 EPS_StrngWhlTorq 0;
BA_ "GenSigInactiveValue" SG_ 363 EPS_StrngWhlTorq 0;
BA_ "GenSigInvalidValue" SG_ 363 EPS_StrngWhlTorq 4095;
BA_ "GenSigSendType" SG_ 363 EPS_StrngWhlTorq 1;
BA_ "GenSigStartValue" SG_ 363 EPS_StrngWhlTorq 1500;
BA_ "GenSigTimeoutValue" SG_ 363 EPS_StrngWhlTorq 4095;
BA_ "Remark" SG_ 363 EPS_StrngWhlTorq "";
BA_ "EventCommandSignal" SG_ 363 TAS_CalibratedSt 0;
BA_ "GatewayedSignals" SG_ 363 TAS_CalibratedSt 0;
BA_ "GenSigInactiveValue" SG_ 363 TAS_CalibratedSt 0;
BA_ "GenSigInvalidValue" SG_ 363 TAS_CalibratedSt 0;
BA_ "GenSigSendType" SG_ 363 TAS_CalibratedSt 1;
BA_ "GenSigStartValue" SG_ 363 TAS_CalibratedSt 0;
BA_ "GenSigTimeoutValue" SG_ 363 TAS_CalibratedSt 0;
BA_ "Remark" SG_ 363 TAS_CalibratedSt "";
BA_ "EventCommandSignal" SG_ 363 EPS_SteeringAngleSpdVD 0;
BA_ "GatewayedSignals" SG_ 363 EPS_SteeringAngleSpdVD 0;
BA_ "GenSigInactiveValue" SG_ 363 EPS_SteeringAngleSpdVD 0;
BA_ "GenSigInvalidValue" SG_ 363 EPS_SteeringAngleSpdVD 0;
BA_ "GenSigSendType" SG_ 363 EPS_SteeringAngleSpdVD 1;
BA_ "GenSigStartValue" SG_ 363 EPS_SteeringAngleSpdVD 0;
BA_ "GenSigTimeoutValue" SG_ 363 EPS_SteeringAngleSpdVD 0;
BA_ "Remark" SG_ 363 EPS_SteeringAngleSpdVD "";
BA_ "EventCommandSignal" SG_ 363 EPS_SteeringAngleSpd 0;
BA_ "GatewayedSignals" SG_ 363 EPS_SteeringAngleSpd 0;
BA_ "GenSigInactiveValue" SG_ 363 EPS_SteeringAngleSpd 0;
BA_ "GenSigInvalidValue" SG_ 363 EPS_SteeringAngleSpd 255;
BA_ "GenSigSendType" SG_ 363 EPS_SteeringAngleSpd 1;
BA_ "GenSigStartValue" SG_ 363 EPS_SteeringAngleSpd 0;
BA_ "GenSigTimeoutValue" SG_ 363 EPS_SteeringAngleSpd 255;
BA_ "Remark" SG_ 363 EPS_SteeringAngleSpd "";
BA_ "EventCommandSignal" SG_ 363 EPS_SteeringAngle 0;
BA_ "GatewayedSignals" SG_ 363 EPS_SteeringAngle 0;
BA_ "GenSigInactiveValue" SG_ 363 EPS_SteeringAngle 0;
BA_ "GenSigInvalidValue" SG_ 363 EPS_SteeringAngle 65535;
BA_ "GenSigSendType" SG_ 363 EPS_SteeringAngle 1;
BA_ "GenSigStartValue" SG_ 363 EPS_SteeringAngle 7800;
BA_ "GenSigTimeoutValue" SG_ 363 EPS_SteeringAngle 65535;
BA_ "Remark" SG_ 363 EPS_SteeringAngle "";
BA_ "EventCommandSignal" SG_ 363 EPS_SteeringAngleVD 0;
BA_ "GatewayedSignals" SG_ 363 EPS_SteeringAngleVD 0;
BA_ "GenSigInactiveValue" SG_ 363 EPS_SteeringAngleVD 0;
BA_ "GenSigInvalidValue" SG_ 363 EPS_SteeringAngleVD 0;
BA_ "GenSigSendType" SG_ 363 EPS_SteeringAngleVD 1;
BA_ "GenSigStartValue" SG_ 363 EPS_SteeringAngleVD 0;
BA_ "GenSigTimeoutValue" SG_ 363 EPS_SteeringAngleVD 0;
BA_ "Remark" SG_ 363 EPS_SteeringAngleVD "";
BA_ "EventCommandSignal" SG_ 363 EPS_ThermalSt 0;
BA_ "GatewayedSignals" SG_ 363 EPS_ThermalSt 0;
BA_ "GenSigInactiveValue" SG_ 363 EPS_ThermalSt 0;
BA_ "GenSigInvalidValue" SG_ 363 EPS_ThermalSt 0;
BA_ "GenSigSendType" SG_ 363 EPS_ThermalSt 1;
BA_ "GenSigStartValue" SG_ 363 EPS_ThermalSt 0;
BA_ "GenSigTimeoutValue" SG_ 363 EPS_ThermalSt 0;
BA_ "Remark" SG_ 363 EPS_ThermalSt "";
BA_ "EventCommandSignal" SG_ 363 EPS_VMCErrFeedback 0;
BA_ "GatewayedSignals" SG_ 363 EPS_VMCErrFeedback 0;
BA_ "GenSigInactiveValue" SG_ 363 EPS_VMCErrFeedback 0;
BA_ "GenSigInvalidValue" SG_ 363 EPS_VMCErrFeedback 0;
BA_ "GenSigSendType" SG_ 363 EPS_VMCErrFeedback 1;
BA_ "GenSigStartValue" SG_ 363 EPS_VMCErrFeedback 0;
BA_ "GenSigTimeoutValue" SG_ 363 EPS_VMCErrFeedback 0;
BA_ "Remark" SG_ 363 EPS_VMCErrFeedback "";
BA_ "EventCommandSignal" SG_ 363 EPS_PstOverlaySt 0;
BA_ "GatewayedSignals" SG_ 363 EPS_PstOverlaySt 0;
BA_ "GenSigInactiveValue" SG_ 363 EPS_PstOverlaySt 0;
BA_ "GenSigInvalidValue" SG_ 363 EPS_PstOverlaySt 0;
BA_ "GenSigSendType" SG_ 363 EPS_PstOverlaySt 1;
BA_ "GenSigStartValue" SG_ 363 EPS_PstOverlaySt 0;
BA_ "GenSigTimeoutValue" SG_ 363 EPS_PstOverlaySt 0;
BA_ "Remark" SG_ 363 EPS_PstOverlaySt "";
BA_ "EventCommandSignal" SG_ 363 EPS_HealthySt_DualSide 0;
BA_ "GatewayedSignals" SG_ 363 EPS_HealthySt_DualSide 0;
BA_ "GenSigInactiveValue" SG_ 363 EPS_HealthySt_DualSide 0;
BA_ "GenSigInvalidValue" SG_ 363 EPS_HealthySt_DualSide 0;
BA_ "GenSigSendType" SG_ 363 EPS_HealthySt_DualSide 1;
BA_ "GenSigStartValue" SG_ 363 EPS_HealthySt_DualSide 0;
BA_ "GenSigTimeoutValue" SG_ 363 EPS_HealthySt_DualSide 0;
BA_ "Remark" SG_ 363 EPS_HealthySt_DualSide "";
BA_ "EventCommandSignal" SG_ 363 EPS_VibrationWarnSt_A 0;
BA_ "GatewayedSignals" SG_ 363 EPS_VibrationWarnSt_A 0;
BA_ "GenSigInactiveValue" SG_ 363 EPS_VibrationWarnSt_A 0;
BA_ "GenSigInvalidValue" SG_ 363 EPS_VibrationWarnSt_A 0;
BA_ "GenSigSendType" SG_ 363 EPS_VibrationWarnSt_A 1;
BA_ "GenSigStartValue" SG_ 363 EPS_VibrationWarnSt_A 0;
BA_ "GenSigTimeoutValue" SG_ 363 EPS_VibrationWarnSt_A 0;
BA_ "Remark" SG_ 363 EPS_VibrationWarnSt_A "";
BA_ "EventCommandSignal" SG_ 363 SAC_ErrFeedback_SideA 0;
BA_ "GatewayedSignals" SG_ 363 SAC_ErrFeedback_SideA 0;
BA_ "GenSigInactiveValue" SG_ 363 SAC_ErrFeedback_SideA 0;
BA_ "GenSigInvalidValue" SG_ 363 SAC_ErrFeedback_SideA 0;
BA_ "GenSigSendType" SG_ 363 SAC_ErrFeedback_SideA 1;
BA_ "GenSigStartValue" SG_ 363 SAC_ErrFeedback_SideA 0;
BA_ "GenSigTimeoutValue" SG_ 363 SAC_ErrFeedback_SideA 0;
BA_ "Remark" SG_ 363 SAC_ErrFeedback_SideA "";
BA_ "EventCommandSignal" SG_ 363 EPS_ADASTargetAngle 0;
BA_ "GatewayedSignals" SG_ 363 EPS_ADASTargetAngle 0;
BA_ "GenSigInactiveValue" SG_ 363 EPS_ADASTargetAngle 0;
BA_ "GenSigInvalidValue" SG_ 363 EPS_ADASTargetAngle 0;
BA_ "GenSigSendType" SG_ 363 EPS_ADASTargetAngle 1;
BA_ "GenSigStartValue" SG_ 363 EPS_ADASTargetAngle 7800;
BA_ "GenSigTimeoutValue" SG_ 363 EPS_ADASTargetAngle 7800;
BA_ "Remark" SG_ 363 EPS_ADASTargetAngle "";
BA_ "EventCommandSignal" SG_ 363 EPS_FunctionStyleSt 0;
BA_ "GatewayedSignals" SG_ 363 EPS_FunctionStyleSt 0;
BA_ "GenSigInactiveValue" SG_ 363 EPS_FunctionStyleSt 0;
BA_ "GenSigInvalidValue" SG_ 363 EPS_FunctionStyleSt 0;
BA_ "GenSigSendType" SG_ 363 EPS_FunctionStyleSt 1;
BA_ "GenSigStartValue" SG_ 363 EPS_FunctionStyleSt 0;
BA_ "GenSigTimeoutValue" SG_ 363 EPS_FunctionStyleSt 0;
BA_ "Remark" SG_ 363 EPS_FunctionStyleSt "";
BA_ "EventCommandSignal" SG_ 363 EPS_SteeringModeSt 0;
BA_ "GatewayedSignals" SG_ 363 EPS_SteeringModeSt 0;
BA_ "GenSigInactiveValue" SG_ 363 EPS_SteeringModeSt 0;
BA_ "GenSigInvalidValue" SG_ 363 EPS_SteeringModeSt 0;
BA_ "GenSigSendType" SG_ 363 EPS_SteeringModeSt 1;
BA_ "GenSigStartValue" SG_ 363 EPS_SteeringModeSt 0;
BA_ "GenSigTimeoutValue" SG_ 363 EPS_SteeringModeSt 0;
BA_ "Remark" SG_ 363 EPS_SteeringModeSt "";
BA_ "EventCommandSignal" SG_ 363 EPS_ReqAngOverRange 0;
BA_ "GatewayedSignals" SG_ 363 EPS_ReqAngOverRange 0;
BA_ "GenSigInactiveValue" SG_ 363 EPS_ReqAngOverRange 0;
BA_ "GenSigInvalidValue" SG_ 363 EPS_ReqAngOverRange 0;
BA_ "GenSigSendType" SG_ 363 EPS_ReqAngOverRange 1;
BA_ "GenSigStartValue" SG_ 363 EPS_ReqAngOverRange 0;
BA_ "GenSigTimeoutValue" SG_ 363 EPS_ReqAngOverRange 0;
BA_ "Remark" SG_ 363 EPS_ReqAngOverRange "";
BA_ "EventCommandSignal" SG_ 363 EPS_SACMotorTorAct 0;
BA_ "GatewayedSignals" SG_ 363 EPS_SACMotorTorAct 0;
BA_ "GenSigInactiveValue" SG_ 363 EPS_SACMotorTorAct 0;
BA_ "GenSigInvalidValue" SG_ 363 EPS_SACMotorTorAct 0;
BA_ "GenSigSendType" SG_ 363 EPS_SACMotorTorAct 1;
BA_ "GenSigStartValue" SG_ 363 EPS_SACMotorTorAct 600;
BA_ "GenSigTimeoutValue" SG_ 363 EPS_SACMotorTorAct 600;
BA_ "Remark" SG_ 363 EPS_SACMotorTorAct "";
BA_ "EventCommandSignal" SG_ 363 EPS_SACMotorTorLimInt 0;
BA_ "GatewayedSignals" SG_ 363 EPS_SACMotorTorLimInt 0;
BA_ "GenSigInactiveValue" SG_ 363 EPS_SACMotorTorLimInt 0;
BA_ "GenSigInvalidValue" SG_ 363 EPS_SACMotorTorLimInt 2047;
BA_ "GenSigSendType" SG_ 363 EPS_SACMotorTorLimInt 1;
BA_ "GenSigStartValue" SG_ 363 EPS_SACMotorTorLimInt 0;
BA_ "GenSigTimeoutValue" SG_ 363 EPS_SACMotorTorLimInt 2047;
BA_ "Remark" SG_ 363 EPS_SACMotorTorLimInt "";
BA_ "EventCommandSignal" SG_ 363 EPS_ReqAngSpdOverRange 0;
BA_ "GatewayedSignals" SG_ 363 EPS_ReqAngSpdOverRange 0;
BA_ "GenSigInactiveValue" SG_ 363 EPS_ReqAngSpdOverRange 0;
BA_ "GenSigInvalidValue" SG_ 363 EPS_ReqAngSpdOverRange 0;
BA_ "GenSigSendType" SG_ 363 EPS_ReqAngSpdOverRange 1;
BA_ "GenSigStartValue" SG_ 363 EPS_ReqAngSpdOverRange 0;
BA_ "GenSigTimeoutValue" SG_ 363 EPS_ReqAngSpdOverRange 0;
BA_ "Remark" SG_ 363 EPS_ReqAngSpdOverRange "";
BA_ "EventCommandSignal" SG_ 363 EPS_AssistPraSwitchToLKA 0;
BA_ "GatewayedSignals" SG_ 363 EPS_AssistPraSwitchToLKA 0;
BA_ "GenSigInactiveValue" SG_ 363 EPS_AssistPraSwitchToLKA 0;
BA_ "GenSigInvalidValue" SG_ 363 EPS_AssistPraSwitchToLKA 0;
BA_ "GenSigSendType" SG_ 363 EPS_AssistPraSwitchToLKA 1;
BA_ "GenSigStartValue" SG_ 363 EPS_AssistPraSwitchToLKA 0;
BA_ "GenSigTimeoutValue" SG_ 363 EPS_AssistPraSwitchToLKA 0;
BA_ "Remark" SG_ 363 EPS_AssistPraSwitchToLKA "";
BA_ "EventCommandSignal" SG_ 363 EPS_SteerGainEnable 0;
BA_ "GatewayedSignals" SG_ 363 EPS_SteerGainEnable 0;
BA_ "GenSigInactiveValue" SG_ 363 EPS_SteerGainEnable 0;
BA_ "GenSigInvalidValue" SG_ 363 EPS_SteerGainEnable 0;
BA_ "GenSigSendType" SG_ 363 EPS_SteerGainEnable 1;
BA_ "GenSigStartValue" SG_ 363 EPS_SteerGainEnable 0;
BA_ "GenSigTimeoutValue" SG_ 363 EPS_SteerGainEnable 0;
BA_ "Remark" SG_ 363 EPS_SteerGainEnable "";
BA_ "EventCommandSignal" SG_ 363 EPS_EmSteerEnbale 0;
BA_ "GatewayedSignals" SG_ 363 EPS_EmSteerEnbale 0;
BA_ "GenSigInactiveValue" SG_ 363 EPS_EmSteerEnbale 0;
BA_ "GenSigInvalidValue" SG_ 363 EPS_EmSteerEnbale 0;
BA_ "GenSigSendType" SG_ 363 EPS_EmSteerEnbale 1;
BA_ "GenSigStartValue" SG_ 363 EPS_EmSteerEnbale 0;
BA_ "GenSigTimeoutValue" SG_ 363 EPS_EmSteerEnbale 0;
BA_ "Remark" SG_ 363 EPS_EmSteerEnbale "";
BA_ "EventCommandSignal" SG_ 363 EPS_EM_ErrFeedback 0;
BA_ "GatewayedSignals" SG_ 363 EPS_EM_ErrFeedback 0;
BA_ "GenSigInactiveValue" SG_ 363 EPS_EM_ErrFeedback 0;
BA_ "GenSigInvalidValue" SG_ 363 EPS_EM_ErrFeedback 0;
BA_ "GenSigSendType" SG_ 363 EPS_EM_ErrFeedback 1;
BA_ "GenSigStartValue" SG_ 363 EPS_EM_ErrFeedback 0;
BA_ "GenSigTimeoutValue" SG_ 363 EPS_EM_ErrFeedback 0;
BA_ "Remark" SG_ 363 EPS_EM_ErrFeedback "";
BA_ "EventCommandSignal" SG_ 363 EPS_VW_ErrFeedback 0;
BA_ "GatewayedSignals" SG_ 363 EPS_VW_ErrFeedback 0;
BA_ "GenSigInactiveValue" SG_ 363 EPS_VW_ErrFeedback 0;
BA_ "GenSigInvalidValue" SG_ 363 EPS_VW_ErrFeedback 0;
BA_ "GenSigSendType" SG_ 363 EPS_VW_ErrFeedback 1;
BA_ "GenSigStartValue" SG_ 363 EPS_VW_ErrFeedback 0;
BA_ "GenSigTimeoutValue" SG_ 363 EPS_VW_ErrFeedback 0;
BA_ "Remark" SG_ 363 EPS_VW_ErrFeedback "";
BA_ "EventCommandSignal" SG_ 363 EPS_SG_ErrFeedback 0;
BA_ "GatewayedSignals" SG_ 363 EPS_SG_ErrFeedback 0;
BA_ "GenSigInactiveValue" SG_ 363 EPS_SG_ErrFeedback 0;
BA_ "GenSigInvalidValue" SG_ 363 EPS_SG_ErrFeedback 0;
BA_ "GenSigSendType" SG_ 363 EPS_SG_ErrFeedback 1;
BA_ "GenSigStartValue" SG_ 363 EPS_SG_ErrFeedback 0;
BA_ "GenSigTimeoutValue" SG_ 363 EPS_SG_ErrFeedback 0;
BA_ "Remark" SG_ 363 EPS_SG_ErrFeedback "";
BA_ "EventCommandSignal" SG_ 363 EPS_SACMotorTorActMot 0;
BA_ "GatewayedSignals" SG_ 363 EPS_SACMotorTorActMot 0;
BA_ "GenSigInactiveValue" SG_ 363 EPS_SACMotorTorActMot 0;
BA_ "GenSigInvalidValue" SG_ 363 EPS_SACMotorTorActMot 0;
BA_ "GenSigSendType" SG_ 363 EPS_SACMotorTorActMot 1;
BA_ "GenSigStartValue" SG_ 363 EPS_SACMotorTorActMot 600;
BA_ "GenSigTimeoutValue" SG_ 363 EPS_SACMotorTorActMot 600;
BA_ "Remark" SG_ 363 EPS_SACMotorTorActMot "";
BA_ "EventCommandSignal" SG_ 363 EPS_SACMotorTorLimIntMot 0;
BA_ "GatewayedSignals" SG_ 363 EPS_SACMotorTorLimIntMot 0;
BA_ "GenSigInactiveValue" SG_ 363 EPS_SACMotorTorLimIntMot 0;
BA_ "GenSigInvalidValue" SG_ 363 EPS_SACMotorTorLimIntMot 2047;
BA_ "GenSigSendType" SG_ 363 EPS_SACMotorTorLimIntMot 1;
BA_ "GenSigStartValue" SG_ 363 EPS_SACMotorTorLimIntMot 0;
BA_ "GenSigTimeoutValue" SG_ 363 EPS_SACMotorTorLimIntMot 2047;
BA_ "Remark" SG_ 363 EPS_SACMotorTorLimIntMot "";
BA_ "EventCommandSignal" SG_ 363 EPS_SG_ActualLevel 0;
BA_ "GatewayedSignals" SG_ 363 EPS_SG_ActualLevel 0;
BA_ "GenSigInactiveValue" SG_ 363 EPS_SG_ActualLevel 0;
BA_ "GenSigInvalidValue" SG_ 363 EPS_SG_ActualLevel 255;
BA_ "GenSigSendType" SG_ 363 EPS_SG_ActualLevel 1;
BA_ "GenSigStartValue" SG_ 363 EPS_SG_ActualLevel 100;
BA_ "GenSigTimeoutValue" SG_ 363 EPS_SG_ActualLevel 0;
BA_ "Remark" SG_ 363 EPS_SG_ActualLevel "";
BA_ "EventCommandSignal" SG_ 363 EPS_MotorTorSum 0;
BA_ "GatewayedSignals" SG_ 363 EPS_MotorTorSum 0;
BA_ "GenSigInactiveValue" SG_ 363 EPS_MotorTorSum 0;
BA_ "GenSigInvalidValue" SG_ 363 EPS_MotorTorSum 0;
BA_ "GenSigSendType" SG_ 363 EPS_MotorTorSum 1;
BA_ "GenSigStartValue" SG_ 363 EPS_MotorTorSum 600;
BA_ "GenSigTimeoutValue" SG_ 363 EPS_MotorTorSum 600;
BA_ "Remark" SG_ 363 EPS_MotorTorSum "";
BA_ "EventCommandSignal" SG_ 363 EPS_WarnLamp 0;
BA_ "GatewayedSignals" SG_ 363 EPS_WarnLamp 0;
BA_ "GenSigInactiveValue" SG_ 363 EPS_WarnLamp 0;
BA_ "GenSigInvalidValue" SG_ 363 EPS_WarnLamp 0;
BA_ "GenSigSendType" SG_ 363 EPS_WarnLamp 1;
BA_ "GenSigStartValue" SG_ 363 EPS_WarnLamp 0;
BA_ "GenSigTimeoutValue" SG_ 363 EPS_WarnLamp 2;
BA_ "Remark" SG_ 363 EPS_WarnLamp "";
BA_ "EventCommandSignal" SG_ 363 EPS_AssistRatio 0;
BA_ "GatewayedSignals" SG_ 363 EPS_AssistRatio 0;
BA_ "GenSigInactiveValue" SG_ 363 EPS_AssistRatio 0;
BA_ "GenSigInvalidValue" SG_ 363 EPS_AssistRatio 0;
BA_ "GenSigSendType" SG_ 363 EPS_AssistRatio 1;
BA_ "GenSigStartValue" SG_ 363 EPS_AssistRatio 50;
BA_ "GenSigTimeoutValue" SG_ 363 EPS_AssistRatio 0;
BA_ "Remark" SG_ 363 EPS_AssistRatio "";
BA_ "EventCommandSignal" SG_ 363 EPS_SteeringWhlTorFlt 0;
BA_ "GatewayedSignals" SG_ 363 EPS_SteeringWhlTorFlt 0;
BA_ "GenSigInactiveValue" SG_ 363 EPS_SteeringWhlTorFlt 0;
BA_ "GenSigInvalidValue" SG_ 363 EPS_SteeringWhlTorFlt 4095;
BA_ "GenSigSendType" SG_ 363 EPS_SteeringWhlTorFlt 1;
BA_ "GenSigStartValue" SG_ 363 EPS_SteeringWhlTorFlt 1500;
BA_ "GenSigTimeoutValue" SG_ 363 EPS_SteeringWhlTorFlt 4095;
BA_ "Remark" SG_ 363 EPS_SteeringWhlTorFlt "";
BA_ "EventCommandSignal" SG_ 363 EPS_SteeringWhlTorFltVD 0;
BA_ "GatewayedSignals" SG_ 363 EPS_SteeringWhlTorFltVD 0;
BA_ "GenSigInactiveValue" SG_ 363 EPS_SteeringWhlTorFltVD 0;
BA_ "GenSigInvalidValue" SG_ 363 EPS_SteeringWhlTorFltVD 0;
BA_ "GenSigSendType" SG_ 363 EPS_SteeringWhlTorFltVD 1;
BA_ "GenSigStartValue" SG_ 363 EPS_SteeringWhlTorFltVD 0;
BA_ "GenSigTimeoutValue" SG_ 363 EPS_SteeringWhlTorFltVD 0;
BA_ "Remark" SG_ 363 EPS_SteeringWhlTorFltVD "";
BA_ "EventCommandSignal" SG_ 363 EPS_SteeringAngleRate 0;
BA_ "GatewayedSignals" SG_ 363 EPS_SteeringAngleRate 0;
BA_ "GenSigInactiveValue" SG_ 363 EPS_SteeringAngleRate 0;
BA_ "GenSigInvalidValue" SG_ 363 EPS_SteeringAngleRate 0;
BA_ "GenSigSendType" SG_ 363 EPS_SteeringAngleRate 1;
BA_ "GenSigStartValue" SG_ 363 EPS_SteeringAngleRate 0;
BA_ "GenSigTimeoutValue" SG_ 363 EPS_SteeringAngleRate 0;
BA_ "Remark" SG_ 363 EPS_SteeringAngleRate "";
BA_ "EventCommandSignal" SG_ 363 EPS_TqCtrlSt 0;
BA_ "GatewayedSignals" SG_ 363 EPS_TqCtrlSt 0;
BA_ "GenSigInactiveValue" SG_ 363 EPS_TqCtrlSt 0;
BA_ "GenSigInvalidValue" SG_ 363 EPS_TqCtrlSt 0;
BA_ "GenSigSendType" SG_ 363 EPS_TqCtrlSt 1;
BA_ "GenSigStartValue" SG_ 363 EPS_TqCtrlSt 0;
BA_ "GenSigTimeoutValue" SG_ 363 EPS_TqCtrlSt 0;
BA_ "Remark" SG_ 363 EPS_TqCtrlSt "";
BA_ "EventCommandSignal" SG_ 363 EPS_MotorTorForDrv 0;
BA_ "GatewayedSignals" SG_ 363 EPS_MotorTorForDrv 0;
BA_ "GenSigInactiveValue" SG_ 363 EPS_MotorTorForDrv 0;
BA_ "GenSigInvalidValue" SG_ 363 EPS_MotorTorForDrv 4095;
BA_ "GenSigSendType" SG_ 363 EPS_MotorTorForDrv 1;
BA_ "GenSigStartValue" SG_ 363 EPS_MotorTorForDrv 2000;
BA_ "GenSigTimeoutValue" SG_ 363 EPS_MotorTorForDrv 4095;
BA_ "Remark" SG_ 363 EPS_MotorTorForDrv "";
BA_ "EventCommandSignal" SG_ 363 EPS_TqCtrlAvl 0;
BA_ "GatewayedSignals" SG_ 363 EPS_TqCtrlAvl 0;
BA_ "GenSigInactiveValue" SG_ 363 EPS_TqCtrlAvl 0;
BA_ "GenSigInvalidValue" SG_ 363 EPS_TqCtrlAvl 0;
BA_ "GenSigSendType" SG_ 363 EPS_TqCtrlAvl 1;
BA_ "GenSigStartValue" SG_ 363 EPS_TqCtrlAvl 0;
BA_ "GenSigTimeoutValue" SG_ 363 EPS_TqCtrlAvl 0;
BA_ "Remark" SG_ 363 EPS_TqCtrlAvl "";
BA_ "EventCommandSignal" SG_ 363 EPS_AgCtrlAvl 0;
BA_ "GatewayedSignals" SG_ 363 EPS_AgCtrlAvl 0;
BA_ "GenSigInactiveValue" SG_ 363 EPS_AgCtrlAvl 0;
BA_ "GenSigInvalidValue" SG_ 363 EPS_AgCtrlAvl 0;
BA_ "GenSigSendType" SG_ 363 EPS_AgCtrlAvl 1;
BA_ "GenSigStartValue" SG_ 363 EPS_AgCtrlAvl 0;
BA_ "GenSigTimeoutValue" SG_ 363 EPS_AgCtrlAvl 0;
BA_ "Remark" SG_ 363 EPS_AgCtrlAvl "";
BA_ "EventCommandSignal" SG_ 363 EPS_MotorTorSumVD 0;
BA_ "GatewayedSignals" SG_ 363 EPS_MotorTorSumVD 0;
BA_ "GenSigInactiveValue" SG_ 363 EPS_MotorTorSumVD 0;
BA_ "GenSigInvalidValue" SG_ 363 EPS_MotorTorSumVD 0;
BA_ "GenSigSendType" SG_ 363 EPS_MotorTorSumVD 1;
BA_ "GenSigStartValue" SG_ 363 EPS_MotorTorSumVD 0;
BA_ "GenSigTimeoutValue" SG_ 363 EPS_MotorTorSumVD 0;
BA_ "Remark" SG_ 363 EPS_MotorTorSumVD "";
BA_ "EventCommandSignal" SG_ 363 EPS_DrvOveRideSt 0;
BA_ "GatewayedSignals" SG_ 363 EPS_DrvOveRideSt 0;
BA_ "GenSigInactiveValue" SG_ 363 EPS_DrvOveRideSt 0;
BA_ "GenSigInvalidValue" SG_ 363 EPS_DrvOveRideSt 0;
BA_ "GenSigSendType" SG_ 363 EPS_DrvOveRideSt 1;
BA_ "GenSigStartValue" SG_ 363 EPS_DrvOveRideSt 0;
BA_ "GenSigTimeoutValue" SG_ 363 EPS_DrvOveRideSt 0;
BA_ "Remark" SG_ 363 EPS_DrvOveRideSt "";
BA_ "EventCommandSignal" SG_ 363 EPS_DrvOveRideVD 0;
BA_ "GatewayedSignals" SG_ 363 EPS_DrvOveRideVD 0;
BA_ "GenSigInactiveValue" SG_ 363 EPS_DrvOveRideVD 0;
BA_ "GenSigInvalidValue" SG_ 363 EPS_DrvOveRideVD 0;
BA_ "GenSigSendType" SG_ 363 EPS_DrvOveRideVD 1;
BA_ "GenSigStartValue" SG_ 363 EPS_DrvOveRideVD 0;
BA_ "GenSigTimeoutValue" SG_ 363 EPS_DrvOveRideVD 0;
BA_ "Remark" SG_ 363 EPS_DrvOveRideVD "";
BA_ "EventCommandSignal" SG_ 363 EPS_SteerVibrlAvl 0;
BA_ "GatewayedSignals" SG_ 363 EPS_SteerVibrlAvl 0;
BA_ "GenSigInactiveValue" SG_ 363 EPS_SteerVibrlAvl 0;
BA_ "GenSigInvalidValue" SG_ 363 EPS_SteerVibrlAvl 0;
BA_ "GenSigSendType" SG_ 363 EPS_SteerVibrlAvl 1;
BA_ "GenSigStartValue" SG_ 363 EPS_SteerVibrlAvl 0;
BA_ "GenSigTimeoutValue" SG_ 363 EPS_SteerVibrlAvl 0;
BA_ "Remark" SG_ 363 EPS_SteerVibrlAvl "";
BA_ "EventCommandSignal" SG_ 363 EPS_HandsOffDetStVD 0;
BA_ "GatewayedSignals" SG_ 363 EPS_HandsOffDetStVD 0;
BA_ "GenSigInactiveValue" SG_ 363 EPS_HandsOffDetStVD 0;
BA_ "GenSigInvalidValue" SG_ 363 EPS_HandsOffDetStVD 0;
BA_ "GenSigSendType" SG_ 363 EPS_HandsOffDetStVD 1;
BA_ "GenSigStartValue" SG_ 363 EPS_HandsOffDetStVD 0;
BA_ "GenSigTimeoutValue" SG_ 363 EPS_HandsOffDetStVD 0;
BA_ "Remark" SG_ 363 EPS_HandsOffDetStVD "";
BA_ "EventCommandSignal" SG_ 363 EPS_HandsOffDetSt 0;
BA_ "GatewayedSignals" SG_ 363 EPS_HandsOffDetSt 0;
BA_ "GenSigInactiveValue" SG_ 363 EPS_HandsOffDetSt 0;
BA_ "GenSigInvalidValue" SG_ 363 EPS_HandsOffDetSt 0;
BA_ "GenSigSendType" SG_ 363 EPS_HandsOffDetSt 1;
BA_ "GenSigStartValue" SG_ 363 EPS_HandsOffDetSt 0;
BA_ "GenSigTimeoutValue" SG_ 363 EPS_HandsOffDetSt 0;
BA_ "Remark" SG_ 363 EPS_HandsOffDetSt "";
BA_ "EventCommandSignal" SG_ 363 EPS_SteerMod 0;
BA_ "GatewayedSignals" SG_ 363 EPS_SteerMod 0;
BA_ "GenSigInactiveValue" SG_ 363 EPS_SteerMod 0;
BA_ "GenSigInvalidValue" SG_ 363 EPS_SteerMod 0;
BA_ "GenSigSendType" SG_ 363 EPS_SteerMod 1;
BA_ "GenSigStartValue" SG_ 363 EPS_SteerMod 0;
BA_ "GenSigTimeoutValue" SG_ 363 EPS_SteerMod 0;
BA_ "Remark" SG_ 363 EPS_SteerMod "";
BA_ "EventCommandSignal" SG_ 363 EPS_ADCNetErrorFb 0;
BA_ "GatewayedSignals" SG_ 363 EPS_ADCNetErrorFb 0;
BA_ "GenSigInactiveValue" SG_ 363 EPS_ADCNetErrorFb 0;
BA_ "GenSigInvalidValue" SG_ 363 EPS_ADCNetErrorFb 0;
BA_ "GenSigSendType" SG_ 363 EPS_ADCNetErrorFb 1;
BA_ "GenSigStartValue" SG_ 363 EPS_ADCNetErrorFb 0;
BA_ "GenSigTimeoutValue" SG_ 363 EPS_ADCNetErrorFb 0;
BA_ "Remark" SG_ 363 EPS_ADCNetErrorFb "";
BA_ "EventCommandSignal" SG_ 363 EPS_NetModeResp 0;
BA_ "GatewayedSignals" SG_ 363 EPS_NetModeResp 0;
BA_ "GenSigInactiveValue" SG_ 363 EPS_NetModeResp 0;
BA_ "GenSigInvalidValue" SG_ 363 EPS_NetModeResp 0;
BA_ "GenSigSendType" SG_ 363 EPS_NetModeResp 1;
BA_ "GenSigStartValue" SG_ 363 EPS_NetModeResp 0;
BA_ "GenSigTimeoutValue" SG_ 363 EPS_NetModeResp 0;
BA_ "Remark" SG_ 363 EPS_NetModeResp "";
BA_ "EventCommandSignal" SG_ 362 EPSB_1_CRC 0;
BA_ "GatewayedSignals" SG_ 362 EPSB_1_CRC 0;
BA_ "GenSigInactiveValue" SG_ 362 EPSB_1_CRC 0;
BA_ "GenSigInvalidValue" SG_ 362 EPSB_1_CRC 0;
BA_ "GenSigSendType" SG_ 362 EPSB_1_CRC 1;
BA_ "GenSigStartValue" SG_ 362 EPSB_1_CRC 0;
BA_ "GenSigTimeoutValue" SG_ 362 EPSB_1_CRC 0;
BA_ "Remark" SG_ 362 EPSB_1_CRC "";
BA_ "EventCommandSignal" SG_ 362 EPSB_1_Counter 0;
BA_ "GatewayedSignals" SG_ 362 EPSB_1_Counter 0;
BA_ "GenSigInactiveValue" SG_ 362 EPSB_1_Counter 0;
BA_ "GenSigInvalidValue" SG_ 362 EPSB_1_Counter 0;
BA_ "GenSigSendType" SG_ 362 EPSB_1_Counter 1;
BA_ "GenSigStartValue" SG_ 362 EPSB_1_Counter 0;
BA_ "GenSigTimeoutValue" SG_ 362 EPSB_1_Counter 0;
BA_ "Remark" SG_ 362 EPSB_1_Counter "";
BA_ "EventCommandSignal" SG_ 362 EPSB_StrngWhlTorqVD 0;
BA_ "GatewayedSignals" SG_ 362 EPSB_StrngWhlTorqVD 0;
BA_ "GenSigInactiveValue" SG_ 362 EPSB_StrngWhlTorqVD 0;
BA_ "GenSigInvalidValue" SG_ 362 EPSB_StrngWhlTorqVD 0;
BA_ "GenSigSendType" SG_ 362 EPSB_StrngWhlTorqVD 1;
BA_ "GenSigStartValue" SG_ 362 EPSB_StrngWhlTorqVD 0;
BA_ "GenSigTimeoutValue" SG_ 362 EPSB_StrngWhlTorqVD 0;
BA_ "Remark" SG_ 362 EPSB_StrngWhlTorqVD "";
BA_ "EventCommandSignal" SG_ 362 EPSB_StrngWhlTorq 0;
BA_ "GatewayedSignals" SG_ 362 EPSB_StrngWhlTorq 0;
BA_ "GenSigInactiveValue" SG_ 362 EPSB_StrngWhlTorq 0;
BA_ "GenSigInvalidValue" SG_ 362 EPSB_StrngWhlTorq 4095;
BA_ "GenSigSendType" SG_ 362 EPSB_StrngWhlTorq 1;
BA_ "GenSigStartValue" SG_ 362 EPSB_StrngWhlTorq 1500;
BA_ "GenSigTimeoutValue" SG_ 362 EPSB_StrngWhlTorq 4095;
BA_ "Remark" SG_ 362 EPSB_StrngWhlTorq "";
BA_ "EventCommandSignal" SG_ 362 EPSB_TAS_CalibratedSt 0;
BA_ "GatewayedSignals" SG_ 362 EPSB_TAS_CalibratedSt 0;
BA_ "GenSigInactiveValue" SG_ 362 EPSB_TAS_CalibratedSt 0;
BA_ "GenSigInvalidValue" SG_ 362 EPSB_TAS_CalibratedSt 0;
BA_ "GenSigSendType" SG_ 362 EPSB_TAS_CalibratedSt 1;
BA_ "GenSigStartValue" SG_ 362 EPSB_TAS_CalibratedSt 0;
BA_ "GenSigTimeoutValue" SG_ 362 EPSB_TAS_CalibratedSt 0;
BA_ "Remark" SG_ 362 EPSB_TAS_CalibratedSt "";
BA_ "EventCommandSignal" SG_ 362 EPSB_SteeringAngleSpdVD 0;
BA_ "GatewayedSignals" SG_ 362 EPSB_SteeringAngleSpdVD 0;
BA_ "GenSigInactiveValue" SG_ 362 EPSB_SteeringAngleSpdVD 0;
BA_ "GenSigInvalidValue" SG_ 362 EPSB_SteeringAngleSpdVD 0;
BA_ "GenSigSendType" SG_ 362 EPSB_SteeringAngleSpdVD 1;
BA_ "GenSigStartValue" SG_ 362 EPSB_SteeringAngleSpdVD 0;
BA_ "GenSigTimeoutValue" SG_ 362 EPSB_SteeringAngleSpdVD 0;
BA_ "Remark" SG_ 362 EPSB_SteeringAngleSpdVD "";
BA_ "EventCommandSignal" SG_ 362 EPSB_SteeringAngleSpd 0;
BA_ "GatewayedSignals" SG_ 362 EPSB_SteeringAngleSpd 0;
BA_ "GenSigInactiveValue" SG_ 362 EPSB_SteeringAngleSpd 0;
BA_ "GenSigInvalidValue" SG_ 362 EPSB_SteeringAngleSpd 255;
BA_ "GenSigSendType" SG_ 362 EPSB_SteeringAngleSpd 1;
BA_ "GenSigStartValue" SG_ 362 EPSB_SteeringAngleSpd 0;
BA_ "GenSigTimeoutValue" SG_ 362 EPSB_SteeringAngleSpd 255;
BA_ "Remark" SG_ 362 EPSB_SteeringAngleSpd "";
BA_ "EventCommandSignal" SG_ 362 EPSB_SteeringAngle 0;
BA_ "GatewayedSignals" SG_ 362 EPSB_SteeringAngle 0;
BA_ "GenSigInactiveValue" SG_ 362 EPSB_SteeringAngle 0;
BA_ "GenSigInvalidValue" SG_ 362 EPSB_SteeringAngle 65535;
BA_ "GenSigSendType" SG_ 362 EPSB_SteeringAngle 1;
BA_ "GenSigStartValue" SG_ 362 EPSB_SteeringAngle 7800;
BA_ "GenSigTimeoutValue" SG_ 362 EPSB_SteeringAngle 65535;
BA_ "Remark" SG_ 362 EPSB_SteeringAngle "";
BA_ "EventCommandSignal" SG_ 362 EPSB_SteeringAngleVD 0;
BA_ "GatewayedSignals" SG_ 362 EPSB_SteeringAngleVD 0;
BA_ "GenSigInactiveValue" SG_ 362 EPSB_SteeringAngleVD 0;
BA_ "GenSigInvalidValue" SG_ 362 EPSB_SteeringAngleVD 0;
BA_ "GenSigSendType" SG_ 362 EPSB_SteeringAngleVD 1;
BA_ "GenSigStartValue" SG_ 362 EPSB_SteeringAngleVD 0;
BA_ "GenSigTimeoutValue" SG_ 362 EPSB_SteeringAngleVD 0;
BA_ "Remark" SG_ 362 EPSB_SteeringAngleVD "";
BA_ "EventCommandSignal" SG_ 362 EPSB_ThermalSt 0;
BA_ "GatewayedSignals" SG_ 362 EPSB_ThermalSt 0;
BA_ "GenSigInactiveValue" SG_ 362 EPSB_ThermalSt 0;
BA_ "GenSigInvalidValue" SG_ 362 EPSB_ThermalSt 0;
BA_ "GenSigSendType" SG_ 362 EPSB_ThermalSt 1;
BA_ "GenSigStartValue" SG_ 362 EPSB_ThermalSt 0;
BA_ "GenSigTimeoutValue" SG_ 362 EPSB_ThermalSt 0;
BA_ "Remark" SG_ 362 EPSB_ThermalSt "";
BA_ "EventCommandSignal" SG_ 362 EPSB_VMCErrFeedback 0;
BA_ "GatewayedSignals" SG_ 362 EPSB_VMCErrFeedback 0;
BA_ "GenSigInactiveValue" SG_ 362 EPSB_VMCErrFeedback 0;
BA_ "GenSigInvalidValue" SG_ 362 EPSB_VMCErrFeedback 0;
BA_ "GenSigSendType" SG_ 362 EPSB_VMCErrFeedback 1;
BA_ "GenSigStartValue" SG_ 362 EPSB_VMCErrFeedback 0;
BA_ "GenSigTimeoutValue" SG_ 362 EPSB_VMCErrFeedback 0;
BA_ "Remark" SG_ 362 EPSB_VMCErrFeedback "";
BA_ "EventCommandSignal" SG_ 362 EPSB_PstOverlaySt 0;
BA_ "GatewayedSignals" SG_ 362 EPSB_PstOverlaySt 0;
BA_ "GenSigInactiveValue" SG_ 362 EPSB_PstOverlaySt 0;
BA_ "GenSigInvalidValue" SG_ 362 EPSB_PstOverlaySt 0;
BA_ "GenSigSendType" SG_ 362 EPSB_PstOverlaySt 1;
BA_ "GenSigStartValue" SG_ 362 EPSB_PstOverlaySt 0;
BA_ "GenSigTimeoutValue" SG_ 362 EPSB_PstOverlaySt 0;
BA_ "Remark" SG_ 362 EPSB_PstOverlaySt "";
BA_ "EventCommandSignal" SG_ 362 EPSB_HealthySt_DualSide 0;
BA_ "GatewayedSignals" SG_ 362 EPSB_HealthySt_DualSide 0;
BA_ "GenSigInactiveValue" SG_ 362 EPSB_HealthySt_DualSide 0;
BA_ "GenSigInvalidValue" SG_ 362 EPSB_HealthySt_DualSide 0;
BA_ "GenSigSendType" SG_ 362 EPSB_HealthySt_DualSide 1;
BA_ "GenSigStartValue" SG_ 362 EPSB_HealthySt_DualSide 0;
BA_ "GenSigTimeoutValue" SG_ 362 EPSB_HealthySt_DualSide 0;
BA_ "Remark" SG_ 362 EPSB_HealthySt_DualSide "";
BA_ "EventCommandSignal" SG_ 362 EPSB_VibrationWarnSt 0;
BA_ "GatewayedSignals" SG_ 362 EPSB_VibrationWarnSt 0;
BA_ "GenSigInactiveValue" SG_ 362 EPSB_VibrationWarnSt 0;
BA_ "GenSigInvalidValue" SG_ 362 EPSB_VibrationWarnSt 0;
BA_ "GenSigSendType" SG_ 362 EPSB_VibrationWarnSt 1;
BA_ "GenSigStartValue" SG_ 362 EPSB_VibrationWarnSt 0;
BA_ "GenSigTimeoutValue" SG_ 362 EPSB_VibrationWarnSt 0;
BA_ "Remark" SG_ 362 EPSB_VibrationWarnSt "";
BA_ "EventCommandSignal" SG_ 362 EPSB_SAC_ErrFeedback_SideA 0;
BA_ "GatewayedSignals" SG_ 362 EPSB_SAC_ErrFeedback_SideA 0;
BA_ "GenSigInactiveValue" SG_ 362 EPSB_SAC_ErrFeedback_SideA 0;
BA_ "GenSigInvalidValue" SG_ 362 EPSB_SAC_ErrFeedback_SideA 0;
BA_ "GenSigSendType" SG_ 362 EPSB_SAC_ErrFeedback_SideA 1;
BA_ "GenSigStartValue" SG_ 362 EPSB_SAC_ErrFeedback_SideA 0;
BA_ "GenSigTimeoutValue" SG_ 362 EPSB_SAC_ErrFeedback_SideA 0;
BA_ "Remark" SG_ 362 EPSB_SAC_ErrFeedback_SideA "";
BA_ "EventCommandSignal" SG_ 362 EPSB_ADASTargetAngle 0;
BA_ "GatewayedSignals" SG_ 362 EPSB_ADASTargetAngle 0;
BA_ "GenSigInactiveValue" SG_ 362 EPSB_ADASTargetAngle 0;
BA_ "GenSigInvalidValue" SG_ 362 EPSB_ADASTargetAngle 0;
BA_ "GenSigSendType" SG_ 362 EPSB_ADASTargetAngle 1;
BA_ "GenSigStartValue" SG_ 362 EPSB_ADASTargetAngle 7800;
BA_ "GenSigTimeoutValue" SG_ 362 EPSB_ADASTargetAngle 7800;
BA_ "Remark" SG_ 362 EPSB_ADASTargetAngle "";
BA_ "EventCommandSignal" SG_ 362 EPSB_FunctionStyleSt 0;
BA_ "GatewayedSignals" SG_ 362 EPSB_FunctionStyleSt 0;
BA_ "GenSigInactiveValue" SG_ 362 EPSB_FunctionStyleSt 0;
BA_ "GenSigInvalidValue" SG_ 362 EPSB_FunctionStyleSt 0;
BA_ "GenSigSendType" SG_ 362 EPSB_FunctionStyleSt 1;
BA_ "GenSigStartValue" SG_ 362 EPSB_FunctionStyleSt 0;
BA_ "GenSigTimeoutValue" SG_ 362 EPSB_FunctionStyleSt 0;
BA_ "Remark" SG_ 362 EPSB_FunctionStyleSt "";
BA_ "EventCommandSignal" SG_ 362 EPSB_SteeringModeSt 0;
BA_ "GatewayedSignals" SG_ 362 EPSB_SteeringModeSt 0;
BA_ "GenSigInactiveValue" SG_ 362 EPSB_SteeringModeSt 0;
BA_ "GenSigInvalidValue" SG_ 362 EPSB_SteeringModeSt 0;
BA_ "GenSigSendType" SG_ 362 EPSB_SteeringModeSt 1;
BA_ "GenSigStartValue" SG_ 362 EPSB_SteeringModeSt 0;
BA_ "GenSigTimeoutValue" SG_ 362 EPSB_SteeringModeSt 0;
BA_ "Remark" SG_ 362 EPSB_SteeringModeSt "";
BA_ "EventCommandSignal" SG_ 362 EPSB_ReqAngOverRange 0;
BA_ "GatewayedSignals" SG_ 362 EPSB_ReqAngOverRange 0;
BA_ "GenSigInactiveValue" SG_ 362 EPSB_ReqAngOverRange 0;
BA_ "GenSigInvalidValue" SG_ 362 EPSB_ReqAngOverRange 0;
BA_ "GenSigSendType" SG_ 362 EPSB_ReqAngOverRange 1;
BA_ "GenSigStartValue" SG_ 362 EPSB_ReqAngOverRange 0;
BA_ "GenSigTimeoutValue" SG_ 362 EPSB_ReqAngOverRange 0;
BA_ "Remark" SG_ 362 EPSB_ReqAngOverRange "";
BA_ "EventCommandSignal" SG_ 362 EPSB_SACMotorTorAct 0;
BA_ "GatewayedSignals" SG_ 362 EPSB_SACMotorTorAct 0;
BA_ "GenSigInactiveValue" SG_ 362 EPSB_SACMotorTorAct 0;
BA_ "GenSigInvalidValue" SG_ 362 EPSB_SACMotorTorAct 0;
BA_ "GenSigSendType" SG_ 362 EPSB_SACMotorTorAct 1;
BA_ "GenSigStartValue" SG_ 362 EPSB_SACMotorTorAct 600;
BA_ "GenSigTimeoutValue" SG_ 362 EPSB_SACMotorTorAct 600;
BA_ "Remark" SG_ 362 EPSB_SACMotorTorAct "";
BA_ "EventCommandSignal" SG_ 362 EPSB_SACMotorTorLimInt 0;
BA_ "GatewayedSignals" SG_ 362 EPSB_SACMotorTorLimInt 0;
BA_ "GenSigInactiveValue" SG_ 362 EPSB_SACMotorTorLimInt 0;
BA_ "GenSigInvalidValue" SG_ 362 EPSB_SACMotorTorLimInt 2047;
BA_ "GenSigSendType" SG_ 362 EPSB_SACMotorTorLimInt 1;
BA_ "GenSigStartValue" SG_ 362 EPSB_SACMotorTorLimInt 0;
BA_ "GenSigTimeoutValue" SG_ 362 EPSB_SACMotorTorLimInt 2047;
BA_ "Remark" SG_ 362 EPSB_SACMotorTorLimInt "";
BA_ "EventCommandSignal" SG_ 362 EPSB_ReqAngSpdOverRange 0;
BA_ "GatewayedSignals" SG_ 362 EPSB_ReqAngSpdOverRange 0;
BA_ "GenSigInactiveValue" SG_ 362 EPSB_ReqAngSpdOverRange 0;
BA_ "GenSigInvalidValue" SG_ 362 EPSB_ReqAngSpdOverRange 0;
BA_ "GenSigSendType" SG_ 362 EPSB_ReqAngSpdOverRange 1;
BA_ "GenSigStartValue" SG_ 362 EPSB_ReqAngSpdOverRange 0;
BA_ "GenSigTimeoutValue" SG_ 362 EPSB_ReqAngSpdOverRange 0;
BA_ "Remark" SG_ 362 EPSB_ReqAngSpdOverRange "";
BA_ "EventCommandSignal" SG_ 362 EPSB_AssistPraSwitchToLKA 0;
BA_ "GatewayedSignals" SG_ 362 EPSB_AssistPraSwitchToLKA 0;
BA_ "GenSigInactiveValue" SG_ 362 EPSB_AssistPraSwitchToLKA 0;
BA_ "GenSigInvalidValue" SG_ 362 EPSB_AssistPraSwitchToLKA 0;
BA_ "GenSigSendType" SG_ 362 EPSB_AssistPraSwitchToLKA 1;
BA_ "GenSigStartValue" SG_ 362 EPSB_AssistPraSwitchToLKA 0;
BA_ "GenSigTimeoutValue" SG_ 362 EPSB_AssistPraSwitchToLKA 0;
BA_ "Remark" SG_ 362 EPSB_AssistPraSwitchToLKA "";
BA_ "EventCommandSignal" SG_ 362 EPSB_SteerGainEnable 0;
BA_ "GatewayedSignals" SG_ 362 EPSB_SteerGainEnable 0;
BA_ "GenSigInactiveValue" SG_ 362 EPSB_SteerGainEnable 0;
BA_ "GenSigInvalidValue" SG_ 362 EPSB_SteerGainEnable 0;
BA_ "GenSigSendType" SG_ 362 EPSB_SteerGainEnable 1;
BA_ "GenSigStartValue" SG_ 362 EPSB_SteerGainEnable 0;
BA_ "GenSigTimeoutValue" SG_ 362 EPSB_SteerGainEnable 0;
BA_ "Remark" SG_ 362 EPSB_SteerGainEnable "";
BA_ "EventCommandSignal" SG_ 362 EPSB_EmSteerEnbale 0;
BA_ "GatewayedSignals" SG_ 362 EPSB_EmSteerEnbale 0;
BA_ "GenSigInactiveValue" SG_ 362 EPSB_EmSteerEnbale 0;
BA_ "GenSigInvalidValue" SG_ 362 EPSB_EmSteerEnbale 0;
BA_ "GenSigSendType" SG_ 362 EPSB_EmSteerEnbale 1;
BA_ "GenSigStartValue" SG_ 362 EPSB_EmSteerEnbale 0;
BA_ "GenSigTimeoutValue" SG_ 362 EPSB_EmSteerEnbale 0;
BA_ "Remark" SG_ 362 EPSB_EmSteerEnbale "";
BA_ "EventCommandSignal" SG_ 362 EPSB_EM_ErrFeedback 0;
BA_ "GatewayedSignals" SG_ 362 EPSB_EM_ErrFeedback 0;
BA_ "GenSigInactiveValue" SG_ 362 EPSB_EM_ErrFeedback 0;
BA_ "GenSigInvalidValue" SG_ 362 EPSB_EM_ErrFeedback 0;
BA_ "GenSigSendType" SG_ 362 EPSB_EM_ErrFeedback 1;
BA_ "GenSigStartValue" SG_ 362 EPSB_EM_ErrFeedback 0;
BA_ "GenSigTimeoutValue" SG_ 362 EPSB_EM_ErrFeedback 0;
BA_ "Remark" SG_ 362 EPSB_EM_ErrFeedback "";
BA_ "EventCommandSignal" SG_ 362 EPSB_VW_ErrFeedback 0;
BA_ "GatewayedSignals" SG_ 362 EPSB_VW_ErrFeedback 0;
BA_ "GenSigInactiveValue" SG_ 362 EPSB_VW_ErrFeedback 0;
BA_ "GenSigInvalidValue" SG_ 362 EPSB_VW_ErrFeedback 0;
BA_ "GenSigSendType" SG_ 362 EPSB_VW_ErrFeedback 1;
BA_ "GenSigStartValue" SG_ 362 EPSB_VW_ErrFeedback 0;
BA_ "GenSigTimeoutValue" SG_ 362 EPSB_VW_ErrFeedback 0;
BA_ "Remark" SG_ 362 EPSB_VW_ErrFeedback "";
BA_ "EventCommandSignal" SG_ 362 EPSB_SG_ErrFeedback 0;
BA_ "GatewayedSignals" SG_ 362 EPSB_SG_ErrFeedback 0;
BA_ "GenSigInactiveValue" SG_ 362 EPSB_SG_ErrFeedback 0;
BA_ "GenSigInvalidValue" SG_ 362 EPSB_SG_ErrFeedback 0;
BA_ "GenSigSendType" SG_ 362 EPSB_SG_ErrFeedback 1;
BA_ "GenSigStartValue" SG_ 362 EPSB_SG_ErrFeedback 0;
BA_ "GenSigTimeoutValue" SG_ 362 EPSB_SG_ErrFeedback 0;
BA_ "Remark" SG_ 362 EPSB_SG_ErrFeedback "";
BA_ "EventCommandSignal" SG_ 362 EPSB_SACMotorTorActMot 0;
BA_ "GatewayedSignals" SG_ 362 EPSB_SACMotorTorActMot 0;
BA_ "GenSigInactiveValue" SG_ 362 EPSB_SACMotorTorActMot 0;
BA_ "GenSigInvalidValue" SG_ 362 EPSB_SACMotorTorActMot 0;
BA_ "GenSigSendType" SG_ 362 EPSB_SACMotorTorActMot 1;
BA_ "GenSigStartValue" SG_ 362 EPSB_SACMotorTorActMot 600;
BA_ "GenSigTimeoutValue" SG_ 362 EPSB_SACMotorTorActMot 600;
BA_ "Remark" SG_ 362 EPSB_SACMotorTorActMot "";
BA_ "EventCommandSignal" SG_ 362 EPSB_SACMotorTorLimIntMot 0;
BA_ "GatewayedSignals" SG_ 362 EPSB_SACMotorTorLimIntMot 0;
BA_ "GenSigInactiveValue" SG_ 362 EPSB_SACMotorTorLimIntMot 0;
BA_ "GenSigInvalidValue" SG_ 362 EPSB_SACMotorTorLimIntMot 2047;
BA_ "GenSigSendType" SG_ 362 EPSB_SACMotorTorLimIntMot 1;
BA_ "GenSigStartValue" SG_ 362 EPSB_SACMotorTorLimIntMot 0;
BA_ "GenSigTimeoutValue" SG_ 362 EPSB_SACMotorTorLimIntMot 2047;
BA_ "Remark" SG_ 362 EPSB_SACMotorTorLimIntMot "";
BA_ "EventCommandSignal" SG_ 362 EPSB_SG_ActualLevel 0;
BA_ "GatewayedSignals" SG_ 362 EPSB_SG_ActualLevel 0;
BA_ "GenSigInactiveValue" SG_ 362 EPSB_SG_ActualLevel 0;
BA_ "GenSigInvalidValue" SG_ 362 EPSB_SG_ActualLevel 255;
BA_ "GenSigSendType" SG_ 362 EPSB_SG_ActualLevel 1;
BA_ "GenSigStartValue" SG_ 362 EPSB_SG_ActualLevel 100;
BA_ "GenSigTimeoutValue" SG_ 362 EPSB_SG_ActualLevel 0;
BA_ "Remark" SG_ 362 EPSB_SG_ActualLevel "";
BA_ "EventCommandSignal" SG_ 362 EPSB_MotorTorSum 0;
BA_ "GatewayedSignals" SG_ 362 EPSB_MotorTorSum 0;
BA_ "GenSigInactiveValue" SG_ 362 EPSB_MotorTorSum 0;
BA_ "GenSigInvalidValue" SG_ 362 EPSB_MotorTorSum 0;
BA_ "GenSigSendType" SG_ 362 EPSB_MotorTorSum 1;
BA_ "GenSigStartValue" SG_ 362 EPSB_MotorTorSum 600;
BA_ "GenSigTimeoutValue" SG_ 362 EPSB_MotorTorSum 600;
BA_ "Remark" SG_ 362 EPSB_MotorTorSum "";
BA_ "EventCommandSignal" SG_ 362 EPSB_WarnLamp 0;
BA_ "GatewayedSignals" SG_ 362 EPSB_WarnLamp 0;
BA_ "GenSigInactiveValue" SG_ 362 EPSB_WarnLamp 0;
BA_ "GenSigInvalidValue" SG_ 362 EPSB_WarnLamp 0;
BA_ "GenSigSendType" SG_ 362 EPSB_WarnLamp 1;
BA_ "GenSigStartValue" SG_ 362 EPSB_WarnLamp 0;
BA_ "GenSigTimeoutValue" SG_ 362 EPSB_WarnLamp 2;
BA_ "Remark" SG_ 362 EPSB_WarnLamp "";
BA_ "EventCommandSignal" SG_ 362 EPSB_AssistPercentage 0;
BA_ "GatewayedSignals" SG_ 362 EPSB_AssistPercentage 0;
BA_ "GenSigInactiveValue" SG_ 362 EPSB_AssistPercentage 0;
BA_ "GenSigInvalidValue" SG_ 362 EPSB_AssistPercentage 0;
BA_ "GenSigSendType" SG_ 362 EPSB_AssistPercentage 1;
BA_ "GenSigStartValue" SG_ 362 EPSB_AssistPercentage 0;
BA_ "GenSigTimeoutValue" SG_ 362 EPSB_AssistPercentage 0;
BA_ "Remark" SG_ 362 EPSB_AssistPercentage "";
BA_ "EventCommandSignal" SG_ 362 EPSB_AssistRatio 0;
BA_ "GatewayedSignals" SG_ 362 EPSB_AssistRatio 0;
BA_ "GenSigInactiveValue" SG_ 362 EPSB_AssistRatio 0;
BA_ "GenSigInvalidValue" SG_ 362 EPSB_AssistRatio 0;
BA_ "GenSigSendType" SG_ 362 EPSB_AssistRatio 1;
BA_ "GenSigStartValue" SG_ 362 EPSB_AssistRatio 50;
BA_ "GenSigTimeoutValue" SG_ 362 EPSB_AssistRatio 0;
BA_ "Remark" SG_ 362 EPSB_AssistRatio "";
BA_ "EventCommandSignal" SG_ 362 EPSB_StrngWhlTorqFlt 0;
BA_ "GatewayedSignals" SG_ 362 EPSB_StrngWhlTorqFlt 0;
BA_ "GenSigInactiveValue" SG_ 362 EPSB_StrngWhlTorqFlt 0;
BA_ "GenSigInvalidValue" SG_ 362 EPSB_StrngWhlTorqFlt 4095;
BA_ "GenSigSendType" SG_ 362 EPSB_StrngWhlTorqFlt 1;
BA_ "GenSigStartValue" SG_ 362 EPSB_StrngWhlTorqFlt 1500;
BA_ "GenSigTimeoutValue" SG_ 362 EPSB_StrngWhlTorqFlt 4095;
BA_ "Remark" SG_ 362 EPSB_StrngWhlTorqFlt "";
BA_ "EventCommandSignal" SG_ 362 EPSB_SteeringWhlTorFltVD 0;
BA_ "GatewayedSignals" SG_ 362 EPSB_SteeringWhlTorFltVD 0;
BA_ "GenSigInactiveValue" SG_ 362 EPSB_SteeringWhlTorFltVD 0;
BA_ "GenSigInvalidValue" SG_ 362 EPSB_SteeringWhlTorFltVD 0;
BA_ "GenSigSendType" SG_ 362 EPSB_SteeringWhlTorFltVD 1;
BA_ "GenSigStartValue" SG_ 362 EPSB_SteeringWhlTorFltVD 0;
BA_ "GenSigTimeoutValue" SG_ 362 EPSB_SteeringWhlTorFltVD 0;
BA_ "Remark" SG_ 362 EPSB_SteeringWhlTorFltVD "";
BA_ "EventCommandSignal" SG_ 362 EPSB_SteeringAngleRate 0;
BA_ "GatewayedSignals" SG_ 362 EPSB_SteeringAngleRate 0;
BA_ "GenSigInactiveValue" SG_ 362 EPSB_SteeringAngleRate 0;
BA_ "GenSigInvalidValue" SG_ 362 EPSB_SteeringAngleRate 0;
BA_ "GenSigSendType" SG_ 362 EPSB_SteeringAngleRate 1;
BA_ "GenSigStartValue" SG_ 362 EPSB_SteeringAngleRate 0;
BA_ "GenSigTimeoutValue" SG_ 362 EPSB_SteeringAngleRate 0;
BA_ "Remark" SG_ 362 EPSB_SteeringAngleRate "";
BA_ "EventCommandSignal" SG_ 362 EPSB_TqCtrlSt 0;
BA_ "GatewayedSignals" SG_ 362 EPSB_TqCtrlSt 0;
BA_ "GenSigInactiveValue" SG_ 362 EPSB_TqCtrlSt 0;
BA_ "GenSigInvalidValue" SG_ 362 EPSB_TqCtrlSt 0;
BA_ "GenSigSendType" SG_ 362 EPSB_TqCtrlSt 1;
BA_ "GenSigStartValue" SG_ 362 EPSB_TqCtrlSt 0;
BA_ "GenSigTimeoutValue" SG_ 362 EPSB_TqCtrlSt 0;
BA_ "Remark" SG_ 362 EPSB_TqCtrlSt "";
BA_ "EventCommandSignal" SG_ 362 EPSB_MotorTorForDrv 0;
BA_ "GatewayedSignals" SG_ 362 EPSB_MotorTorForDrv 0;
BA_ "GenSigInactiveValue" SG_ 362 EPSB_MotorTorForDrv 0;
BA_ "GenSigInvalidValue" SG_ 362 EPSB_MotorTorForDrv 4095;
BA_ "GenSigSendType" SG_ 362 EPSB_MotorTorForDrv 1;
BA_ "GenSigStartValue" SG_ 362 EPSB_MotorTorForDrv 2000;
BA_ "GenSigTimeoutValue" SG_ 362 EPSB_MotorTorForDrv 4095;
BA_ "Remark" SG_ 362 EPSB_MotorTorForDrv "";
BA_ "EventCommandSignal" SG_ 362 EPSB_TqCtrlAvl 0;
BA_ "GatewayedSignals" SG_ 362 EPSB_TqCtrlAvl 0;
BA_ "GenSigInactiveValue" SG_ 362 EPSB_TqCtrlAvl 0;
BA_ "GenSigInvalidValue" SG_ 362 EPSB_TqCtrlAvl 0;
BA_ "GenSigSendType" SG_ 362 EPSB_TqCtrlAvl 1;
BA_ "GenSigStartValue" SG_ 362 EPSB_TqCtrlAvl 0;
BA_ "GenSigTimeoutValue" SG_ 362 EPSB_TqCtrlAvl 0;
BA_ "Remark" SG_ 362 EPSB_TqCtrlAvl "";
BA_ "EventCommandSignal" SG_ 362 EPSB_AgCtrlAvl 0;
BA_ "GatewayedSignals" SG_ 362 EPSB_AgCtrlAvl 0;
BA_ "GenSigInactiveValue" SG_ 362 EPSB_AgCtrlAvl 0;
BA_ "GenSigInvalidValue" SG_ 362 EPSB_AgCtrlAvl 0;
BA_ "GenSigSendType" SG_ 362 EPSB_AgCtrlAvl 1;
BA_ "GenSigStartValue" SG_ 362 EPSB_AgCtrlAvl 0;
BA_ "GenSigTimeoutValue" SG_ 362 EPSB_AgCtrlAvl 0;
BA_ "Remark" SG_ 362 EPSB_AgCtrlAvl "";
BA_ "EventCommandSignal" SG_ 362 EPSB_MotorTorSumVD 0;
BA_ "GatewayedSignals" SG_ 362 EPSB_MotorTorSumVD 0;
BA_ "GenSigInactiveValue" SG_ 362 EPSB_MotorTorSumVD 0;
BA_ "GenSigInvalidValue" SG_ 362 EPSB_MotorTorSumVD 0;
BA_ "GenSigSendType" SG_ 362 EPSB_MotorTorSumVD 1;
BA_ "GenSigStartValue" SG_ 362 EPSB_MotorTorSumVD 0;
BA_ "GenSigTimeoutValue" SG_ 362 EPSB_MotorTorSumVD 0;
BA_ "Remark" SG_ 362 EPSB_MotorTorSumVD "";
BA_ "EventCommandSignal" SG_ 362 EPSB_DrvOveRideSt 0;
BA_ "GatewayedSignals" SG_ 362 EPSB_DrvOveRideSt 0;
BA_ "GenSigInactiveValue" SG_ 362 EPSB_DrvOveRideSt 0;
BA_ "GenSigInvalidValue" SG_ 362 EPSB_DrvOveRideSt 0;
BA_ "GenSigSendType" SG_ 362 EPSB_DrvOveRideSt 1;
BA_ "GenSigStartValue" SG_ 362 EPSB_DrvOveRideSt 0;
BA_ "GenSigTimeoutValue" SG_ 362 EPSB_DrvOveRideSt 0;
BA_ "Remark" SG_ 362 EPSB_DrvOveRideSt "";
BA_ "EventCommandSignal" SG_ 362 EPSB_DrvOveRideVD 0;
BA_ "GatewayedSignals" SG_ 362 EPSB_DrvOveRideVD 0;
BA_ "GenSigInactiveValue" SG_ 362 EPSB_DrvOveRideVD 0;
BA_ "GenSigInvalidValue" SG_ 362 EPSB_DrvOveRideVD 0;
BA_ "GenSigSendType" SG_ 362 EPSB_DrvOveRideVD 1;
BA_ "GenSigStartValue" SG_ 362 EPSB_DrvOveRideVD 0;
BA_ "GenSigTimeoutValue" SG_ 362 EPSB_DrvOveRideVD 0;
BA_ "Remark" SG_ 362 EPSB_DrvOveRideVD "";
BA_ "EventCommandSignal" SG_ 362 EPSB_SteerVibrlAvl 0;
BA_ "GatewayedSignals" SG_ 362 EPSB_SteerVibrlAvl 0;
BA_ "GenSigInactiveValue" SG_ 362 EPSB_SteerVibrlAvl 0;
BA_ "GenSigInvalidValue" SG_ 362 EPSB_SteerVibrlAvl 0;
BA_ "GenSigSendType" SG_ 362 EPSB_SteerVibrlAvl 1;
BA_ "GenSigStartValue" SG_ 362 EPSB_SteerVibrlAvl 0;
BA_ "GenSigTimeoutValue" SG_ 362 EPSB_SteerVibrlAvl 0;
BA_ "Remark" SG_ 362 EPSB_SteerVibrlAvl "";
BA_ "EventCommandSignal" SG_ 362 EPSB_HandsOffDetStVD 0;
BA_ "GatewayedSignals" SG_ 362 EPSB_HandsOffDetStVD 0;
BA_ "GenSigInactiveValue" SG_ 362 EPSB_HandsOffDetStVD 0;
BA_ "GenSigInvalidValue" SG_ 362 EPSB_HandsOffDetStVD 0;
BA_ "GenSigSendType" SG_ 362 EPSB_HandsOffDetStVD 1;
BA_ "GenSigStartValue" SG_ 362 EPSB_HandsOffDetStVD 0;
BA_ "GenSigTimeoutValue" SG_ 362 EPSB_HandsOffDetStVD 0;
BA_ "Remark" SG_ 362 EPSB_HandsOffDetStVD "";
BA_ "EventCommandSignal" SG_ 362 EPSB_HandsOffDetSt 0;
BA_ "GatewayedSignals" SG_ 362 EPSB_HandsOffDetSt 0;
BA_ "GenSigInactiveValue" SG_ 362 EPSB_HandsOffDetSt 0;
BA_ "GenSigInvalidValue" SG_ 362 EPSB_HandsOffDetSt 0;
BA_ "GenSigSendType" SG_ 362 EPSB_HandsOffDetSt 1;
BA_ "GenSigStartValue" SG_ 362 EPSB_HandsOffDetSt 0;
BA_ "GenSigTimeoutValue" SG_ 362 EPSB_HandsOffDetSt 0;
BA_ "Remark" SG_ 362 EPSB_HandsOffDetSt "";
BA_ "EventCommandSignal" SG_ 362 EPSB_SteerMod 0;
BA_ "GatewayedSignals" SG_ 362 EPSB_SteerMod 0;
BA_ "GenSigInactiveValue" SG_ 362 EPSB_SteerMod 0;
BA_ "GenSigInvalidValue" SG_ 362 EPSB_SteerMod 0;
BA_ "GenSigSendType" SG_ 362 EPSB_SteerMod 1;
BA_ "GenSigStartValue" SG_ 362 EPSB_SteerMod 0;
BA_ "GenSigTimeoutValue" SG_ 362 EPSB_SteerMod 0;
BA_ "Remark" SG_ 362 EPSB_SteerMod "";
BA_ "EventCommandSignal" SG_ 362 EPSB_ADCNetErrorFb 0;
BA_ "GatewayedSignals" SG_ 362 EPSB_ADCNetErrorFb 0;
BA_ "GenSigInactiveValue" SG_ 362 EPSB_ADCNetErrorFb 0;
BA_ "GenSigInvalidValue" SG_ 362 EPSB_ADCNetErrorFb 0;
BA_ "GenSigSendType" SG_ 362 EPSB_ADCNetErrorFb 1;
BA_ "GenSigStartValue" SG_ 362 EPSB_ADCNetErrorFb 0;
BA_ "GenSigTimeoutValue" SG_ 362 EPSB_ADCNetErrorFb 0;
BA_ "Remark" SG_ 362 EPSB_ADCNetErrorFb "";
BA_ "EventCommandSignal" SG_ 362 EPSB_NetModeResp 0;
BA_ "GatewayedSignals" SG_ 362 EPSB_NetModeResp 0;
BA_ "GenSigInactiveValue" SG_ 362 EPSB_NetModeResp 0;
BA_ "GenSigInvalidValue" SG_ 362 EPSB_NetModeResp 0;
BA_ "GenSigSendType" SG_ 362 EPSB_NetModeResp 1;
BA_ "GenSigStartValue" SG_ 362 EPSB_NetModeResp 0;
BA_ "GenSigTimeoutValue" SG_ 362 EPSB_NetModeResp 0;
BA_ "Remark" SG_ 362 EPSB_NetModeResp "";
BA_ "EventCommandSignal" SG_ 905 ICM_SetIACCSt 0;
BA_ "GatewayedSignals" SG_ 905 ICM_SetIACCSt 0;
BA_ "GenSigInactiveValue" SG_ 905 ICM_SetIACCSt 0;
BA_ "GenSigInvalidValue" SG_ 905 ICM_SetIACCSt 0;
BA_ "GenSigSendType" SG_ 905 ICM_SetIACCSt 1;
BA_ "GenSigStartValue" SG_ 905 ICM_SetIACCSt 0;
BA_ "GenSigTimeoutValue" SG_ 905 ICM_SetIACCSt 0;
BA_ "Remark" SG_ 905 ICM_SetIACCSt "";
BA_ "EventCommandSignal" SG_ 905 ICM_TotalOdometer 0;
BA_ "GatewayedSignals" SG_ 905 ICM_TotalOdometer 0;
BA_ "GenSigInactiveValue" SG_ 905 ICM_TotalOdometer 0;
BA_ "GenSigInvalidValue" SG_ 905 ICM_TotalOdometer 0;
BA_ "GenSigSendType" SG_ 905 ICM_TotalOdometer 1;
BA_ "GenSigStartValue" SG_ 905 ICM_TotalOdometer 0;
BA_ "EventCommandSignal" SG_ 905 ICM_VehInsSpd 0;
BA_ "GatewayedSignals" SG_ 905 ICM_VehInsSpd 0;
BA_ "GenSigInactiveValue" SG_ 905 ICM_VehInsSpd 0;
BA_ "GenSigInvalidValue" SG_ 905 ICM_VehInsSpd 255;
BA_ "GenSigSendType" SG_ 905 ICM_VehInsSpd 1;
BA_ "GenSigStartValue" SG_ 905 ICM_VehInsSpd 0;
BA_ "GenSigTimeoutValue" SG_ 905 ICM_VehInsSpd 0;
BA_ "Remark" SG_ 905 ICM_VehInsSpd "";
BA_ "EventCommandSignal" SG_ 905 ICM_TotalOdometer_accurate 0;
BA_ "GatewayedSignals" SG_ 905 ICM_TotalOdometer_accurate 0;
BA_ "GenSigInactiveValue" SG_ 905 ICM_TotalOdometer_accurate 0;
BA_ "GenSigInvalidValue" SG_ 905 ICM_TotalOdometer_accurate 0;
BA_ "GenSigSendType" SG_ 905 ICM_TotalOdometer_accurate 1;
BA_ "GenSigStartValue" SG_ 905 ICM_TotalOdometer_accurate 0;
BA_ "EventCommandSignal" SG_ 905 ICM_VehInsSpd_accurate 0;
BA_ "GatewayedSignals" SG_ 905 ICM_VehInsSpd_accurate 0;
BA_ "GenSigInactiveValue" SG_ 905 ICM_VehInsSpd_accurate 0;
BA_ "GenSigInvalidValue" SG_ 905 ICM_VehInsSpd_accurate 2047;
BA_ "GenSigSendType" SG_ 905 ICM_VehInsSpd_accurate 1;
BA_ "GenSigStartValue" SG_ 905 ICM_VehInsSpd_accurate 0;
BA_ "GenSigTimeoutValue" SG_ 905 ICM_VehInsSpd_accurate 0;
BA_ "Remark" SG_ 905 ICM_VehInsSpd_accurate "";
BA_ "EventCommandSignal" SG_ 905 ICM_FuelAvaibleDriveDistance 0;
BA_ "GatewayedSignals" SG_ 905 ICM_FuelAvaibleDriveDistance 0;
BA_ "GenSigInactiveValue" SG_ 905 ICM_FuelAvaibleDriveDistance 0;
BA_ "GenSigInvalidValue" SG_ 905 ICM_FuelAvaibleDriveDistance 2047;
BA_ "GenSigSendType" SG_ 905 ICM_FuelAvaibleDriveDistance 1;
BA_ "GenSigStartValue" SG_ 905 ICM_FuelAvaibleDriveDistance 0;
BA_ "GenSigTimeoutValue" SG_ 905 ICM_FuelAvaibleDriveDistance 0;
BA_ "Remark" SG_ 905 ICM_FuelAvaibleDriveDistance "";
BA_ "EventCommandSignal" SG_ 905 ICM_TotalAvaibleDriveDistance 0;
BA_ "GatewayedSignals" SG_ 905 ICM_TotalAvaibleDriveDistance 0;
BA_ "GenSigInactiveValue" SG_ 905 ICM_TotalAvaibleDriveDistance 0;
BA_ "GenSigInvalidValue" SG_ 905 ICM_TotalAvaibleDriveDistance 2047;
BA_ "GenSigSendType" SG_ 905 ICM_TotalAvaibleDriveDistance 1;
BA_ "GenSigStartValue" SG_ 905 ICM_TotalAvaibleDriveDistance 0;
BA_ "GenSigTimeoutValue" SG_ 905 ICM_TotalAvaibleDriveDistance 0;
BA_ "Remark" SG_ 905 ICM_TotalAvaibleDriveDistance "";
BA_ "EventCommandSignal" SG_ 1045 ACU_Longitude 0;
BA_ "GatewayedSignals" SG_ 1045 ACU_Longitude 0;
BA_ "GenSigInactiveValue" SG_ 1045 ACU_Longitude 0;
BA_ "GenSigInvalidValue" SG_ 1045 ACU_Longitude 0;
BA_ "GenSigSendType" SG_ 1045 ACU_Longitude 1;
BA_ "GenSigStartValue" SG_ 1045 ACU_Longitude 0;
BA_ "GenSigTimeoutValue" SG_ 1045 ACU_Longitude 0;
BA_ "Remark" SG_ 1045 ACU_Longitude "";
BA_ "EventCommandSignal" SG_ 1045 ACU_Latitude 0;
BA_ "GatewayedSignals" SG_ 1045 ACU_Latitude 0;
BA_ "GenSigInactiveValue" SG_ 1045 ACU_Latitude 0;
BA_ "GenSigInvalidValue" SG_ 1045 ACU_Latitude 0;
BA_ "GenSigSendType" SG_ 1045 ACU_Latitude 1;
BA_ "GenSigStartValue" SG_ 1045 ACU_Latitude 0;
BA_ "GenSigTimeoutValue" SG_ 1045 ACU_Latitude 0;
BA_ "Remark" SG_ 1045 ACU_Latitude "";
BA_ "EventCommandSignal" SG_ 1045 ACU_CampingModeSt 0;
BA_ "GatewayedSignals" SG_ 1045 ACU_CampingModeSt 0;
BA_ "GenSigInactiveValue" SG_ 1045 ACU_CampingModeSt 0;
BA_ "GenSigInvalidValue" SG_ 1045 ACU_CampingModeSt 0;
BA_ "GenSigSendType" SG_ 1045 ACU_CampingModeSt 1;
BA_ "GenSigStartValue" SG_ 1045 ACU_CampingModeSt 0;
BA_ "GenSigTimeoutValue" SG_ 1045 ACU_CampingModeSt 0;
BA_ "Remark" SG_ 1045 ACU_CampingModeSt "";
VAL_ 611 BCS_BrkTqCtrlAvlDriving_1 0 "Not available" 1 "Available" 2 "Available degraded1（Redundant Project）" 3 "Available degraded2 （Redundant Project）" 4 "Reserved" 5 "Reserved" 6 "Reserved" 7 "Reserved"  ;
VAL_ 611 BCS_BrkTqCtrlAvlParking_1 0 "Not available" 1 "available" 2 "parking overspeed--for BOSCH ADAS" 3 "Reserved"  ;
VAL_ 611 BCS_BrkTqCtrlActv_1 0 "NotActive" 1 "APA Active" 2 "ACC Active" 3 "BCS Active"  ;
VAL_ 611 BCS_DycEscTarTqCtrlAvl_1 0 "Not available" 1 "Available"  ;
VAL_ 611 BCS_DTCActvSts_1 0 "Not active" 1 "Active"  ;
VAL_ 611 BCS_DrvrBrkOvrd_1 0 "Not override" 1 "Override"  ;
VAL_ 611 BCS_DrvrBrkOvrdVld_1 0 "Invalid" 1 "Valid"  ;
VAL_ 611 BCS_DycEscTarTqActv_1 0 "NotActive" 1 "Active"  ;
VAL_ 611 BCS_BrkTqCtrlAvlParkingRdn_1 0 "BrakeBackupStrategyAvailability_None" 1 "BrakeBackupStrategyAvailability_Full" 2 "BrakeBackupStrategyAvailability_Fault" 3 "BrakeBackupStrategyAvailability_TestPending" 4 "BrakeBackupStrategyAvailability_NotInitialized" 5 "Parking_Overspeed" 6 "Reserved" 7 "Reserved"  ;
VAL_ 611 BCS_ERV_VehSpdVld_1 0 "Invalid" 1 "Valid"  ;
VAL_ 611 IPB_SimulatorPressureSt 0 "Valid/Init" 1 "Invalid/Default"  ;
VAL_ 611 IBCS_SystemSt 0 "BBF_FullSys/Init/Default" 1 "BBF_DegradedPedalFeel" 2 "BBF_CircuitSperation" 3 "BBF_C1/2BoostOnly" 4 "HydBack w/ act / HydBack w/o act"  ;
VAL_ 611 IBCS_FWAWarning 0 "no failure/Init/Default" 1 "Warnig level 1 for high Temp. of Brake system" 2 "Warnig level 2 for high Temp. of Brake system" 3 "reserved"  ;
VAL_ 611 IPB_CSTSt 0 "CST is disabled/Init/Default" 1 "CST is Standby" 2 "CST is Active" 3 "CST is Failure"  ;
VAL_ 611 BCS_AVDCActive 0 "Not active" 1 "Active"  ;
VAL_ 611 BCS_AVDCAvailable 0 "Not active" 1 "Active"  ;
VAL_ 360 BCS_BrkTqCtrlAvlDriving 0 "Not available" 1 "Available" 2 "Available degraded1（Redundant Project）" 3 "Available degraded2 （Redundant Project）" 4 "Reserved" 5 "Reserved" 6 "Reserved" 7 "Reserved"  ;
VAL_ 360 BCS_BrkTqCtrlAvlParking 0 "Not available" 1 "available" 2 "parking overspeed--for BOSCH ADAS" 3 "Reserved"  ;
VAL_ 360 BCS_BrkTqCtrlActv 0 "NotActive" 1 "APA Active" 2 "ACC Active" 3 "BCS Active"  ;
VAL_ 360 BCS_ERV_VehSpdVld 0 "Invalid" 1 "Valid"  ;
VAL_ 360 BCS_EspFailrSts 0 "No error" 1 "Error"  ;
VAL_ 360 BCS_ActvSts 0 "Not active" 1 "Active"  ;
VAL_ 360 BCS_DycEscTarTqCtrlAvl 0 "Not available" 1 "Available"  ;
VAL_ 360 BCS_BDCActive 0 "Not active" 1 "Active"  ;
VAL_ 360 BCS_DTCActvSts 0 "Not active" 1 "Active"  ;
VAL_ 360 BCS_errorFb 0 "No error" 1 "Invalid Request of ADAS" 2 "Fault related to wheelspd" 2 "Fault related to steeringangel" 3 "Fault related to powertrain" 4 "Fault related to EPB" 7 "ADAS E2E fault or timeoutt"  ;
VAL_ 360 BCS_DrvrBrkOvrd 0 "Not override" 1 "Override"  ;
VAL_ 360 BCS_DrvrBrkOvrdVld 0 "Invalid" 1 "Valid"  ;
VAL_ 360 BCS_DycEscTarTqActv 0 "NotActive" 1 "Active"  ;
VAL_ 360 BCS_WheelSlipFLValid 0 "Invalid" 1 "Valid"  ;
VAL_ 360 BCS_WheelSlipFRValid 0 "Invalid" 1 "Valid"  ;
VAL_ 360 BCS_WheelSlipRLValid 0 "Invalid" 1 "Valid"  ;
VAL_ 360 BCS_WheelSlipRRValid 0 "Invalid" 1 "Valid"  ;
VAL_ 360 BCS_CrbsTarRecpTorqRqFASt 0 "NotIntialized" 1 "Normal（valid）" 2 "Faulty（invalid）" 3 "Reserved"  ;
VAL_ 360 BCS_CrbsTarRecpTorqRqRASt 0 "NotIntialized" 1 "Normal（valid）" 2 "Faulty（invalid）" 3 "Reserved"  ;
VAL_ 360 BCS_CrbsTarRecpTorqRqSumSt 0 "NotIntialized" 1 "Normal（valid）" 2 "Faulty（invalid）" 3 "Reserved"  ;
VAL_ 360 BCS_BrkTqCtrlAvlParkingRdn 0 "BrakeBackupStrategyAvailability_None" 1 "BrakeBackupStrategyAvailability_Full" 2 "BrakeBackupStrategyAvailability_Fault" 3 "BrakeBackupStrategyAvailability_TestPending" 4 "BrakeBackupStrategyAvailability_NotInitialized" 5 "Parking_Overspeed" 6 "Reserved" 7 "Reserved"  ;
VAL_ 618 EPB_SwitchSt 0 "Not active" 1 "Released" 2 "Applied" 3 "Not used"  ;
VAL_ 618 EPB_SwitchStVD 0 "Not valid" 1 "Valid"  ;
VAL_ 618 EPB_SysSt 0 "Release (fully released)" 1 "Apply (fully applied)" 2 "Releasing" 3 "Applying" 4 "Disengaged" 5 "Not used" 6 "Not used" 7 "Fault(not sure position)"  ;
VAL_ 618 EPB_FailSt 0 "No error" 1 "Error"  ;
VAL_ 618 EPB_ExtAvailable 0 "Apply and release" 1 "Only apply" 2 "Only release" 3 "None"  ;
VAL_ 618 EPB_DynamicApplySt 0 "Not active" 1 "BCS dynamic apply" 2 "Anti-Lock Apply" 3 "EPB degraded apply" 4 "Not used" 5 "Not used" 6 "Not used" 7 "Not used"  ;
VAL_ 618 EPB_ActuatorSt_R 0 "PbcActuatorState_Applied" 1 "PbcActuatorState_Released" 2 "PbcActuatorState_Applying" 3 "PbcActuatorState_Releasing" 4 "PbcActuatorState_Unknown" 5 "PbcActuatorState_HoldApplied" 6 "PbcActuatorState_CompletelyReleased" 7 "Not used" 8 "Not used" 9 "Not used" 10 "Not used" 11 "Not used" 12 "Not used" 13 "Not used" 14 "Not used" 15 "Not used"  ;
VAL_ 618 EPB_RWUActvSts 0 "Not active" 1 "CDP active" 2 "RWU active" 3 "Limp home"  ;
VAL_ 618 EPB_RWUAvl 0 "Not available" 1 "Reserved" 2 "RWU available" 3 "Limp home available"  ;
VAL_ 618 EPB_RPAAVPAvailability 0 "NotAvailable" 1 "Available" 2 "TestPending"  ;
VAL_ 618 EPB_APAAvailability 0 "NotAvailable" 1 "Available"  ;
VAL_ 618 EPB_ADCNetErrorFb 0 "No Error" 1 "Main Net E2E Error" 2 "Sub Net E2E Error" 3 "Both Net E2E Error" 4 "Reserved" 5 "Reserved" 6 "Reserved" 7 "Reserved"  ;
VAL_ 618 EPB_NetModeResp 0 "None" 1 "Main/sub Net active" 2 "Main/sub Net active with error" 3 "Reserved"  ;
VAL_ 433 AccPedalPstForMRRVD 0 "Invalid" 1 "Valid"  ;
VAL_ 433 VCU_VehActDrvTorqRRVD 1 "Valid;" 0 "Invalid;"  ;
VAL_ 433 VCU_FrntWhlReqTqVld 0 "Invalid" 1 "Valid"  ;
VAL_ 433 VCU_ReWhlReqTqRRVld 0 "Invalid" 1 "Valid"  ;
VAL_ 433 VCU_ReWhlReqTqRLVld 0 "Invalid" 1 "Valid"  ;
VAL_ 433 VCU_PreStableFlg 0 "Not Active" 1 "Active"  ;
VAL_ 433 VCU_ErrorFb 0 "No error" 1 "ADS请求有效位无效" 2 "高压故障" 3 "MCU故障" 4 "BMS故障" 7 "ADS E2E故障或者time out"  ;
VAL_ 433 VCU_DrvrAccrPedlOvrdVld 0 "Invalid" 1 "Valid"  ;
VAL_ 433 VCU_VehWhlReqTqVld 0 "Invalid" 1 "Valid"  ;
VAL_ 433 VCU_MotorRegenTrqLmtlnDVaild 0 "Invalid" 1 "Valid"  ;
VAL_ 433 VCU_GearShiftAvl 0 "not available" 1 "available"  ;
VAL_ 433 VCU_PtTqAvl 0 "not available" 1 "available" 2 "available degraded"  ;
VAL_ 433 VCU_PtTqActvSts 0 "Not response" 1 "Response"  ;
VAL_ 363 EPS_StrngWhlTorqVD 0 "Not valid" 1 "Valid"  ;
VAL_ 363 TAS_CalibratedSt 0 "Not calibrated" 1 "Calibrated"  ;
VAL_ 363 EPS_SteeringAngleSpdVD 0 "Not valid" 1 "Valid"  ;
VAL_ 363 EPS_SteeringAngleVD 0 "Not valid" 1 "Valid"  ;
VAL_ 363 EPS_VMCErrFeedback 0 "No interruption" 1 "LKA Interruption" 2 "APA Interruption" 3 "Vehicle Speed Invalid" 4 "VMC Activation request error" 5 "VMC ECU Signal error" 6 "EPS Temp error" 7 "Request Torque Slope over limit" 8 "Request Torque Value over limit" 9 "Failed Temp Time Over Limit" 10 "EPS Permanently error" 11 "VMC Triggered safety monitor module" 12 "Drive Override" 13 "Reserved" 14 "Reserved" 15 "Reserved"  ;
VAL_ 363 EPS_PstOverlaySt 0 "Not Ready;" 1 "Ready;" 2 "100% Active;" 3 "50% Active;" 4 "Failed;" 5 "Reserved" 6 "Reserved" 7 "Reserved"  ;
VAL_ 363 EPS_HealthySt_DualSide 0 "Healthy;" 1 "Slightly failure;" 2 "Abnormal;" 3 "Shut off;"  ;
VAL_ 363 EPS_VibrationWarnSt_A 0 "Not Acitve" 1 "Active level 1" 2 "Active level 2" 3 "Active level 3"  ;
VAL_ 363 SAC_ErrFeedback_SideA 0 "No  interruption；" 1 "ADAS TqRateReq Over rangenge" 2 "Driver Override" 3 "Vehicle Speed Invalid" 4 "Activation Requestrian Error" 5 "ADC Channel A signal Error" 6 "EPS Error" 7 "IFC Signal Error" 8 "ADAS AngleReq Over range" 9 "ADAS AngleSpdReq Over range" 10 "ADAS TqReq Over range" 11 "Both ADAS Channel Error" 12 "ADC Channel B signal Error；" 13 "Reserved；" 14 "Reserved；" 15 "Reserved；"  ;
VAL_ 363 EPS_FunctionStyleSt 0 "Unknow" 1 "light" 2 "Comfort" 3 "Sport"  ;
VAL_ 363 EPS_SteeringModeSt 0 "Not ready" 1 "Ready" 2 "In transition" 3 "Fault"  ;
VAL_ 363 EPS_ReqAngOverRange 0 "Not Over Range；" 1 "Over range"  ;
VAL_ 363 EPS_ReqAngSpdOverRange 0 "Not Over Range；" 1 "Over range"  ;
VAL_ 363 EPS_AssistPraSwitchToLKA 0 "Not in LAK mode；" 1 "In LKA Mode；"  ;
VAL_ 363 EPS_SteerGainEnable 0 "Disable；" 1 "Enable；"  ;
VAL_ 363 EPS_EmSteerEnbale 0 "Disable；" 1 "Enable；"  ;
VAL_ 363 EPS_EM_ErrFeedback 0 "No interruption" 1 "Reserved" 2 "Reserved" 3 "Reserved" 4 "Reserved" 5 "ADAS Signal err" 6 "EPS error" 7 "Duration time over"  ;
VAL_ 363 EPS_VW_ErrFeedback 0 "No interruption" 1 "Reserved" 2 "Reserved" 3 "Reserved" 4 "Invalid request" 5 "ADC Signal err" 6 "EPS error"  ;
VAL_ 363 EPS_SG_ErrFeedback 0 "No  interruption；" 1 "Premise fun abort" 2 "Invalid request" 3 "Reserved" 4 "Reserved" 5 "Reserved" 6 "Reserved" 7 "Reserved" 8 "Reserved" 9 "Reserved" 10 "Reserved" 11 "Reserved" 12 "Reserved" 13 "Reserved" 14 "Reserved" 15 "Reserved"  ;
VAL_ 363 EPS_WarnLamp 0 "No Fault" 1 "Slight Fault" 2 "Urgency Fault" 3 "Severity Urgency Fault"  ;
VAL_ 363 EPS_SteeringWhlTorFltVD 0 "No Valid" 1 "Valid with fault detected" 2 "Valid and healthy" 3 "Unkown"  ;
VAL_ 363 EPS_TqCtrlSt 0 "No active" 1 "Ready" 2 "Active" 3 "Failed"  ;
VAL_ 363 EPS_TqCtrlAvl 0 "Not available" 1 "Available" 2 "Available degraded" 3 "Reseved"  ;
VAL_ 363 EPS_AgCtrlAvl 0 "Not available" 1 "Available" 2 "Available degraded" 3 "Reseved"  ;
VAL_ 363 EPS_MotorTorSumVD 0 "Invalid" 1 "Valid"  ;
VAL_ 363 EPS_DrvOveRideSt 0 "Not override" 1 "Override"  ;
VAL_ 363 EPS_DrvOveRideVD 0 "Invalid" 1 "Valid"  ;
VAL_ 363 EPS_SteerVibrlAvl 0 "Not available" 1 "Available"  ;
VAL_ 363 EPS_HandsOffDetStVD 0 "Invalid" 1 "Valid"  ;
VAL_ 363 EPS_HandsOffDetSt 0 "Not detected" 1 "Hands off" 2 "Hands on" 3 "Reserved"  ;
VAL_ 363 EPS_SteerMod 0 "Initial" 1 "Power steer" 2 "Angle control(Normal）" 3 "Angle control(Emergency)" 4 "Torque control(Normal）" 5 "Torque control(Emergency)" 6 "Failure" 7 "Reserved"  ;
VAL_ 363 EPS_ADCNetErrorFb 0 "No Error" 1 "Main Net E2E Error" 2 "Sub Net E2E Error" 3 "Both Net E2E Error" 4 "Reserved" 5 "Reserved" 6 "Reserved" 7 "Reserved"  ;
VAL_ 363 EPS_NetModeResp 0 "None" 1 "Main/sub Net active" 2 "Main/sub Net active with error" 3 "Reserved"  ;
VAL_ 362 EPSB_StrngWhlTorqVD 0 "Not valid" 1 "Valid"  ;
VAL_ 362 EPSB_TAS_CalibratedSt 0 "Not calibrated" 1 "Calibrated"  ;
VAL_ 362 EPSB_SteeringAngleSpdVD 0 "Not valid" 1 "Valid"  ;
VAL_ 362 EPSB_SteeringAngleVD 0 "Not valid" 1 "Valid"  ;
VAL_ 362 EPSB_VMCErrFeedback 0 "No interruption" 1 "LKA Interruption" 2 "APA Interruption" 3 "Vehicle Speed Invalid" 4 "VMC Activation request error" 5 "VMC ECU Signal error" 6 "EPS Temp error" 7 "Request Torque Slope over limit" 8 "Request Torque Value over limit" 9 "Failed Temp Time Over Limit" 10 "EPS Permanently error" 11 "VMC Triggered safety monitor module" 12 "Drive Override" 13 "Reserved" 14 "Reserved" 15 "Reserved"  ;
VAL_ 362 EPSB_PstOverlaySt 0 "Not Ready;" 1 "Ready;" 2 "100% Active;" 3 "50% Active;" 4 "Failed;" 5 "Reserved" 6 "Reserved" 7 "Reserved"  ;
VAL_ 362 EPSB_HealthySt_DualSide 0 "Healthy;" 1 "Slightly failure;" 2 "Abnormal;" 3 "Shut off;"  ;
VAL_ 362 EPSB_VibrationWarnSt 0 "Not Acitve" 1 "Active level 1" 2 "Active level 2" 3 "Active level 3"  ;
VAL_ 362 EPSB_SAC_ErrFeedback_SideA 0 "No  interruption；" 1 "ADAS TqRateReq Over rangenge" 2 "Driver Override" 3 "Vehicle Speed Invalid" 4 "Activation Requestrian Error" 5 "ADC Channel A signal Error" 6 "EPS Error" 7 "IFC Signal Error" 8 "ADAS AngleReq Over range" 9 "ADAS AngleSpdReq Over range" 10 "ADAS TqReq Over range" 11 "Both ADAS Channel Error" 12 "ADC Channel B signal Error；" 13 "Reserved；" 14 "Reserved；" 15 "Reserved；"  ;
VAL_ 362 EPSB_FunctionStyleSt 0 "Unknow" 1 "light" 2 "Comfort" 3 "Sport"  ;
VAL_ 362 EPSB_SteeringModeSt 0 "Not ready" 1 "Ready" 2 "In transition" 3 "Fault"  ;
VAL_ 362 EPSB_ReqAngOverRange 0 "Not Over Range；" 1 "Over range"  ;
VAL_ 362 EPSB_ReqAngSpdOverRange 0 "Not Over Range；" 1 "Over range"  ;
VAL_ 362 EPSB_AssistPraSwitchToLKA 0 "Not in LAK mode；" 1 "In LKA Mode；"  ;
VAL_ 362 EPSB_SteerGainEnable 0 "Disable；" 1 "Enable；"  ;
VAL_ 362 EPSB_EmSteerEnbale 0 "Disable；" 1 "Enable；"  ;
VAL_ 362 EPSB_EM_ErrFeedback 0 "No interruption" 1 "Reserved" 2 "Reserved" 3 "Reserved" 4 "Reserved" 5 "ADAS Signal err" 6 "EPS error" 7 "Duration time over"  ;
VAL_ 362 EPSB_VW_ErrFeedback 0 "No interruption" 1 "Reserved" 2 "Reserved" 3 "Reserved" 4 "Invalid request" 5 "ADC Signal err" 6 "EPS error"  ;
VAL_ 362 EPSB_SG_ErrFeedback 0 "No  interruption；" 1 "Premise fun abort" 2 "Invalid request" 3 "Reserved" 4 "Reserved" 5 "Reserved" 6 "Reserved" 7 "Reserved" 8 "Reserved" 9 "Reserved" 10 "Reserved" 11 "Reserved" 12 "Reserved" 13 "Reserved" 14 "Reserved" 15 "Reserved"  ;
VAL_ 362 EPSB_WarnLamp 0 "No Fault" 1 "Slight Fault" 2 "Urgency Fault" 3 "Severity Urgency Fault"  ;
VAL_ 362 EPSB_SteeringWhlTorFltVD 0 "No Valid" 1 "Valid with fault detected" 2 "Valid and healthy" 3 "Unkown"  ;
VAL_ 362 EPSB_TqCtrlSt 0 "No active" 1 "Ready" 2 "Active" 3 "Failed"  ;
VAL_ 362 EPSB_TqCtrlAvl 0 "Not available" 1 "Available" 2 "Available degraded" 3 "Reseved"  ;
VAL_ 362 EPSB_AgCtrlAvl 0 "Not available" 1 "Available" 2 "Available degraded" 3 "Reseved"  ;
VAL_ 362 EPSB_MotorTorSumVD 0 "Invalid" 1 "Valid"  ;
VAL_ 362 EPSB_DrvOveRideSt 0 "Not override" 1 "Override"  ;
VAL_ 362 EPSB_DrvOveRideVD 0 "Invalid" 1 "Valid"  ;
VAL_ 362 EPSB_SteerVibrlAvl 0 "Not available" 1 "Available"  ;
VAL_ 362 EPSB_HandsOffDetStVD 0 "Invalid" 1 "Valid"  ;
VAL_ 362 EPSB_HandsOffDetSt 0 "Not detected" 1 "Hands off" 2 "Hands on" 3 "Reserved"  ;
VAL_ 362 EPSB_SteerMod 0 "Initial" 1 "Power steer" 2 "Angle control(Normal）" 3 "Angle control(Emergency)" 4 "Torque control(Normal）" 5 "Torque control(Emergency)" 6 "Failure" 7 "Reserved"  ;
VAL_ 362 EPSB_ADCNetErrorFb 0 "No Error" 1 "Main Net E2E Error" 2 "Sub Net E2E Error" 3 "Both Net E2E Error" 4 "Reserved" 5 "Reserved" 6 "Reserved" 7 "Reserved"  ;
VAL_ 362 EPSB_NetModeResp 0 "None" 1 "Main/sub Net active" 2 "Main/sub Net active with error" 3 "Reserved"  ;
VAL_ 905 ICM_SetIACCSt 0 "Not active" 1 "Active"  ;
VAL_ 1045 ACU_CampingModeSt 0 "inactive" 1 "off" 2 "CampingMode" 3 "Sleep mode of CampingMode"  ;
