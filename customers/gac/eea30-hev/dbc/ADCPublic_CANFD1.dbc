VERSION "Version"

NS_ :

BS_:

BU_: Tester CCU INU ADC RRR RLR CCURT1 CCURT2 ZCUF ZCUL ZCUR ZCUT EMS IDM DCDC DCDCI IPS NIDU DCU2 OBC OPC LPC CPC EMCM GCU DCU IPU BMS EOP EVCC DCDC2 EDL SRS ECS EPS EPB RBM IBCS ICM IID IDC AMP WHUD ARHUD IMR FIMR CD IFC FAPA PAS PCS SCMF SCMR SCMRL SCMRR MFS DRM FCP RCP LBMSAD AVAS DLPFL FBLCM FLISD FLLCM FRLCM RLLCMA RLLCMB RRLCMA RRLCMB RLISD DLPML DLPMR TRM PSDL PSDR FLDCM FRDCM HVSPRL HVSPRR RFR SBM WCM ETC TBOX2 TBOX RLBMS EBU FLPDM RLPDM FRPDM RRPDM FLOAR FROAR RLOAR RROAR EOSL EOSR EOST PRBU RT1_C0 OTAWL RT2_C3 IDUR PHUDD RAS CBM PLGM TMC LPC2 SAS RCICP SCMRM SCMT SLMRL SLMRR IDU RRISD DSASBM LBMS RT1_C1

BO_ 659 ADC_5: 64 ADC
 SG_ ADC_5_CRC : 7|16@0+ (1,0) [0|65535] ""  CCU,CCURT1,RT1_C1
 SG_ ADC_5_Counter : 23|8@0+ (1,0) [0|255] ""  CCU,CCURT1,RT1_C1
 SG_ ADC_NDASt : 31|6@0+ (1,0) [0|63] ""  CCU,CCURT1,RT1_C1,TBOX
 SG_ ADC_NDATORType : 39|4@0+ (1,0) [0|15] ""  CCU
 SG_ ADC_NDADecideResult : 35|5@0+ (1,0) [0|31] ""  CCU,TBOX
 SG_ ADC_NDATargetLane : 46|3@0+ (1,0) [0|7] ""  CCU
 SG_ ADC_NDASplitSt : 43|3@0+ (1,0) [0|7] ""  CCU
 SG_ ADC_NDALaneChangeOverlineTOR : 40|1@0+ (1,0) [0|1] ""  CCU
 SG_ ADC_ALCSuspendReason : 55|4@0+ (1,0) [0|15] ""  CCU
 SG_ ADC_SplitSuspendReason : 51|4@0+ (1,0) [0|15] ""  CCU
 SG_ ADC_NDAEnableSt : 63|1@0+ (1,0) [0|1] ""  CCU
 SG_ ADC_NDAFailureReason : 62|6@0+ (1,0) [0|63] ""  CCU
 SG_ ADC_NDANotactivereason : 56|5@0+ (1,0) [0|31] ""  CCU
 SG_ ADC_NDAGeoFence : 67|2@0+ (1,0) [0|3] ""  CCU
 SG_ ADC_NDAODDnotMeetreason : 79|5@0+ (1,0) [0|31] ""  CCU
 SG_ ADC_ICAAvailableState : 199|1@0+ (1,0) [0|1] ""  CCU
 SG_ ADC_ACCAvailableState : 198|1@0+ (1,0) [0|1] ""  CCU
 SG_ ADC_NDARouteReplanning : 197|1@0+ (1,0) [0|1] ""  CCU
 SG_ ADC_SpeedLimitConfirmRequest : 211|1@0+ (1,0) [0|1] ""  CCU
 SG_ ADC_LaneChangeType : 335|5@0+ (1,0) [0|31] ""  CCU
 SG_ ADC_LC_ZoneMatching : 330|2@0+ (1,0) [0|3] ""  CCU
 SG_ ADC_RoadMergeSplitType : 328|5@0+ (1,0) [0|31] ""  CCU
 SG_ ADC_LaneMergeSplitType : 339|4@0+ (1,0) [0|15] ""  CCU
 SG_ ADC_EyesOn_Warning : 367|3@0+ (1,0) [0|7] ""  CCU
 SG_ ADC_TakeOverType : 364|3@0+ (1,0) [0|7] ""  CCU
 SG_ ADC_TakeOverWarningLevel : 375|3@0+ (1,0) [0|7] ""  CCU
 SG_ ADC_NDAMRMWarningLevel : 372|3@0+ (1,0) [0|7] ""  CCU
 SG_ ADC_ADASTransitionType : 389|4@0+ (1,0) [0|15] ""  CCU
 SG_ ADC_FuncReq_SentryModWarn : 379|1@0+ (1,0) [0|1] ""  CCU
 SG_ ADC_TlaWarning : 232|3@0+ (1,0) [0|7] ""  CCU
 SG_ ADC_TlaFault : 25|2@0+ (1,0) [0|3] ""  CCU
 SG_ ADC_FcwWaning : 255|3@0+ (1,0) [0|7] ""  CCU
 SG_ ADC_AebFault : 74|2@0+ (1,0) [0|3] ""  CCU
 SG_ ADC_RaebWarning : 92|3@0+ (1,0) [0|7] ""  CCU
 SG_ ADC_RaebFault : 83|2@0+ (1,0) [0|3] ""  CCU
 SG_ ADC_RcwFault : 85|2@0+ (1,0) [0|3] ""  CCU
 SG_ ADC_FctbLeftWarning : 89|3@0+ (1,0) [0|7] ""  CCU
 SG_ ADC_FctbRightWarning : 106|3@0+ (1,0) [0|7] ""  CCU
 SG_ ADC_RctaFault : 87|2@0+ (1,0) [0|3] ""  CCU
 SG_ ADC_RctbLeftWarning : 116|3@0+ (1,0) [0|7] ""  CCU
 SG_ ADC_RctbRightWarning : 119|3@0+ (1,0) [0|7] ""  CCU
 SG_ ADC_LdwFault : 361|2@0+ (1,0) [0|3] ""  CCU
 SG_ ADC_LkaFault : 369|2@0+ (1,0) [0|3] ""  CCU
 SG_ ADC_BsdFault : 381|2@0+ (1,0) [0|3] ""  CCU
 SG_ ADC_DowFault : 391|2@0+ (1,0) [0|3] ""  CCU
 SG_ ADC_TsrFault : 81|2@0+ (1,0) [0|3] ""  CCU
 SG_ ADC_ElkaWarning : 143|3@0+ (1,0) [0|7] ""  CCU
 SG_ ADC_ElkaFault : 383|2@0+ (1,0) [0|3] ""  CCU
 SG_ ADC_TotalRefTorque_A : 423|16@0+ (1,-32768) [-32768|32767] "Nm"  CCU,CCURT1,RT1_C1
 SG_ ADC_IMURollingCounter : 263|8@0+ (1,0) [0|255] ""  CCU
 SG_ ADC_IMUAccX : 151|16@0+ (0.002,-65.536) [-65.536|65.534] "m/s2"  CCU,CCURT1,RT1_C0,RT1_C1
 SG_ ADC_IMUAccY : 167|16@0+ (0.002,-65.536) [-65.536|65.534] "m/s2"  CCU,CCURT1,RT1_C0,RT1_C1
 SG_ ADC_IMUAccZ : 183|16@0+ (0.002,-65.536) [-65.536|65.534] "m/s2"  CCU
 SG_ ADC_IMUGyroX : 195|16@0+ (0.01,-327.68) [-327.68|327.67] "dps"  CCU
 SG_ ADC_IMUGyroY : 223|16@0+ (0.01,-327.68) [-327.68|327.67] "dps"  CCU
 SG_ ADC_IMUGyroZ : 351|16@0+ (0.01,-327.68) [-327.68|327.67] "dps"  CCU,CCURT1,RT1_C0,RT1_C1
 SG_ ADC_IMURoll : 407|16@0+ (0.01,-180) [-180|180] "degree"  CCU
 SG_ ADC_IMUPitch : 271|16@0+ (0.01,-180) [-180|180] "degree"  CCU
 SG_ ADC_IMUYaw : 287|16@0+ (0.01,0) [0|360] "degree"  CCU
 SG_ ADC_IMUTimestampVld : 136|1@0+ (1,0) [0|1] ""  CCU
 SG_ ADC_IMUAccVld : 137|1@0+ (1,0) [0|1] ""  CCU,CCURT1,RT1_C0,RT1_C1
 SG_ ADC_IMUGyroVld : 196|1@0+ (1,0) [0|1] ""  CCU,CCURT1,RT1_C0,RT1_C1
 SG_ ADC_IMUAttitudeVld : 235|1@0+ (1,0) [0|1] ""  CCU
 SG_ ADC_IMUPositionType : 239|4@0+ (1,0) [0|15] ""  CCU
 SG_ ADC_IMUTimestamp : 303|32@0+ (1,0) [0|4294967295] ""  CCU
 SG_ ADC_AbsoultwSpeedLimit : 439|16@0+ (1,0) [0|65535] "km/h"  CCU,CCURT1,CCURT2,RT1_C0,RT2_C3

BO_ 923 ADC_6: 64 ADC
 SG_ ADC_6_CRC : 7|16@0+ (1,0) [0|65535] ""  Vector__XXX
 SG_ ADC_6_Counter : 23|8@0+ (1,0) [0|255] ""  Vector__XXX
 SG_ ADC_FrontWideCameraSt : 31|3@0+ (1,0) [0|7] ""  Vector__XXX
 SG_ ADC_FrontNarrowCameraSt : 28|3@0+ (1,0) [0|7] ""  Vector__XXX
 SG_ ADC_LeftFrontCameraSt : 39|3@0+ (1,0) [0|7] ""  Vector__XXX
 SG_ ADC_LeftRearCameraSt : 36|3@0+ (1,0) [0|7] ""  Vector__XXX
 SG_ ADC_RightFrontCameraSt : 47|3@0+ (1,0) [0|7] ""  Vector__XXX
 SG_ ADC_RightRearCameraSt : 44|3@0+ (1,0) [0|7] ""  Vector__XXX
 SG_ ADC_RearCameraSt : 55|3@0+ (1,0) [0|7] ""  Vector__XXX
 SG_ ADC_FrontRadarSt : 52|3@0+ (1,0) [0|7] ""  Vector__XXX
 SG_ ADC_LeftFrontRadarSt : 63|3@0+ (1,0) [0|7] ""  Vector__XXX
 SG_ ADC_LeftRearRadarSt : 60|3@0+ (1,0) [0|7] ""  Vector__XXX
 SG_ ADC_RightFrontRadarSt : 71|3@0+ (1,0) [0|7] ""  Vector__XXX
 SG_ ADC_RightRearRadarSt : 68|3@0+ (1,0) [0|7] ""  Vector__XXX
 SG_ ADC_RearRadarSt : 79|3@0+ (1,0) [0|7] ""  Vector__XXX
 SG_ ADC_FrontLidarSt : 76|3@0+ (1,0) [0|7] ""  Vector__XXX
 SG_ ADC_LeftLidarSt : 87|3@0+ (1,0) [0|7] ""  Vector__XXX
 SG_ ADC_RightLidarSt : 84|3@0+ (1,0) [0|7] ""  Vector__XXX
 SG_ ADC_SunroofOpenCloseReq : 25|2@0+ (1,0) [0|3] ""  CCU,CCURT1,CCURT2
 SG_ ADC_SentryStatus : 57|2@0+ (1,0) [0|3] ""  CCU,CCURT1,CCURT2
 SG_ ADC_SOCWakeupHVReq : 65|1@0+ (1,0) [0|1] ""  CCU,CCURT1,CCURT2,RT1_C1
 SG_ ADC_SystemState : 236|4@0+ (1,0) [0|14] ""  CCU,CCURT1,CCURT2
 SG_ ADC_HWFailureReason : 199|3@0+ (1,0) [0|7] ""  CCU
 SG_ ADC_SWFailureReason : 196|5@0+ (1,0) [0|31] ""  CCU
 SG_ mountAngleIndicator_az : 101|9@0+ (0.05,-12.8) [-12.8|12.75] "degree"  CCU
 SG_ mountAngleCurrent_az : 108|9@0+ (0.05,-12.8) [-12.8|12.75] "degree"  CCU
 SG_ mountAngleIndicator_el : 115|9@0+ (0.05,-12.8) [-12.8|12.75] "degree"  CCU
 SG_ mountAngleCurrent_el : 122|9@0+ (0.05,-12.8) [-12.8|12.75] "degree"  CCU
 SG_ malStablePosEl : 129|9@0+ (0.05,-12.8) [-12.8|12.75] "degree"  CCU
 SG_ malStablePosAz : 136|9@0+ (0.05,-12.8) [-12.8|12.75] "degree"  CCU
 SG_ AngleEMEIndicatorEl : 159|9@0+ (0.05,-12.8) [-12.8|12.75] "degree"  CCU
 SG_ AngleEMEIndicatorAz : 166|9@0+ (0.05,-12.8) [-12.8|12.75] "degree"  CCU
 SG_ highSpreadIndicator_el : 171|9@0+ (0.05,-12.8) [-12.8|12.75] "degree"  CCU
 SG_ highSpreadIndicator_az : 176|9@0+ (0.05,-12.8) [-12.8|12.75] "degree"  CCU
 SG_ Fault_MAL_HOR_ABS_EVENT : 204|1@0+ (1,0) [0|1] ""  CCU
 SG_ Fault_MAL_HOR_REL_EVENT : 205|1@0+ (1,0) [0|1] ""  CCU
 SG_ Fault_MAL_VER_ABS_EVENT : 206|1@0+ (1,0) [0|1] ""  CCU
 SG_ Fault_MAL_VER_REL_EVENT : 207|1@0+ (1,0) [0|1] ""  CCU
 SG_ FilteredPhiSpread : 231|11@0+ (0.1,-102.4) [-102.4|102.3] "Meter"  CCU
 SG_ elOutOfSpecCause : 201|2@0+ (1,0) [0|3] ""  CCU
 SG_ azOutOfSpecCause : 203|2@0+ (1,0) [0|3] ""  CCU
 SG_ azOutOfProfileCause : 215|8@0+ (1,0) [0|255] ""  CCU
 SG_ elOutOfProfileCause : 223|8@0+ (1,0) [0|255] ""  CCU
 SG_ ADC_FuncReq_SentryModDetec : 232|1@0+ (1,0) [0|1] ""  CCU,CCURT1,CCURT2,RT1_C1,RT2_C3

BO_ 667 ADC_7: 64 ADC
 SG_ ADC_7_CRC : 7|16@0+ (1,0) [0|65535] ""  Vector__XXX
 SG_ ADC_7_Counter : 23|8@0+ (1,0) [0|255] ""  Vector__XXX
 SG_ ADC_LatVMC_A0 : 31|11@0+ (0.01,-10.23) [-10.23|10.23] "m"  CCU,CCURT1,RT1_C1,TBOX
 SG_ ADC_LatVMC_A1 : 36|11@0+ (0.001,-1.023) [-1.023|1.023] "rad"  CCU,CCURT1,RT1_C1,TBOX
 SG_ ADC_LatVMC_A2 : 41|11@0+ (0.00001,-0.01023) [-0.01023|0.01023] "1/m"  CCU,CCURT1,RT1_C1,TBOX
 SG_ ADC_LatVMC_A3 : 62|11@0+ (0.0000001,-0.0001023) [-0.0001023|0.0001023] "1/(m^2)"  CCU,CCURT1,RT1_C1,TBOX
 SG_ ADC_LatVMC_conf : 78|7@0+ (1,0) [0|100] "%"  CCU,CCURT1,RT1_C1,TBOX
 SG_ ADC_LatVMC_Range : 87|8@0+ (1,0) [0|255] "m"  CCU,TBOX
 SG_ ADC_LLnMrking_A0 : 95|11@0+ (0.01,-10.23) [-10.23|10.23] "m"  CCU,CCURT1,RT1_C1,TBOX
 SG_ ADC_LLnMrking_A1 : 100|11@0+ (0.001,-1.023) [-1.023|1.023] "rad"  CCU,CCURT1,RT1_C1,TBOX
 SG_ ADC_LLnMrking_A2 : 105|11@0+ (0.00001,-0.01023) [-0.01023|0.01023] "1/m"  CCU,CCURT1,RT1_C1,TBOX
 SG_ ADC_LLnMrking_conf : 126|6@0+ (2,0) [0|100] "%"  CCU,CCURT1,RT1_C1,TBOX
 SG_ ADC_LlnMrkingDispSt : 132|2@0+ (1,0) [0|3] ""  CCU,CCURT1,RT1_C1,TBOX
 SG_ ADC_LLnMrking_Range : 130|11@0+ (0.1,0) [0|204.7] "m"  CCU,CCURT1,RT1_C1,TBOX
 SG_ ADC_LLnMrking_Type : 150|4@0+ (1,0) [0|15] ""  CCU,CCURT1,RT1_C1,TBOX
 SG_ ADC_RLnMrking_A0 : 146|11@0+ (0.01,-10.23) [-10.23|10.23] "m"  CCU,CCURT1,RT1_C1,TBOX
 SG_ ADC_RLnMrking_A1 : 167|11@0+ (0.001,-1.023) [-1.023|1.023] "rad"  CCU,CCURT1,RT1_C1,TBOX
 SG_ ADC_RLnMrking_A2 : 172|11@0+ (0.00001,-0.01023) [-0.01023|0.01023] "1/m"  CCU,CCURT1,RT1_C1,TBOX
 SG_ ADC_RlnMrkingDispSt : 177|2@0+ (1,0) [0|3] ""  CCU,CCURT1,RT1_C1,TBOX
 SG_ ADC_RLnMrking_conf : 191|6@0+ (2,0) [0|100] "%"  CCU,CCURT1,RT1_C1,TBOX
 SG_ ADC_RLnMrking_Range : 185|11@0+ (0.1,0) [0|204.7] "m"  CCU,CCURT1,RT1_C1,TBOX
 SG_ ADC_RLnMrking_Type : 206|4@0+ (1,0) [0|15] ""  CCU,CCURT1,RT1_C1,TBOX
 SG_ ADC_AdjLLnMrking_A0 : 202|11@0+ (0.01,-10.23) [-10.23|10.23] "m"  CCU,TBOX
 SG_ ADC_AdjLLnMrking_A1 : 223|11@0+ (0.001,-1.023) [-1.023|1.023] "rad"  CCU,TBOX
 SG_ ADC_AdjLLnMrking_A2 : 228|11@0+ (0.00001,-0.01023) [-0.01023|0.01023] "1/m"  CCU,TBOX
 SG_ ADC_AdjLLnMrking_conf : 233|6@0+ (2,0) [0|100] "%"  CCU,TBOX
 SG_ ADC_AdjLLnMrking_Range : 243|11@0+ (0.1,0) [0|204.7] "m"  CCU,TBOX
 SG_ ADC_AdjLlnMrkingDispSt : 248|1@0+ (1,0) [0|1] ""  CCU,TBOX
 SG_ ADC_AdjLLnMrking_Type : 263|4@0+ (1,0) [0|15] ""  CCU,TBOX
 SG_ ADC_AdjRLnMrking_A0 : 259|11@0+ (0.01,-10.23) [-10.23|10.23] "m"  CCU,TBOX
 SG_ ADC_AdjRLnMrking_A1 : 264|11@0+ (0.001,-1.023) [-1.023|1.023] "rad"  CCU,TBOX
 SG_ ADC_AdjRLnMrking_A2 : 285|11@0+ (0.00001,-0.01023) [-0.01023|0.01023] "1/m"  CCU,TBOX
 SG_ ADC_AdjRLnMrking_Range : 290|11@0+ (0.1,0) [0|204.7] "m"  CCU,TBOX
 SG_ ADC_AdjRLnMrking_conf : 311|6@0+ (2,0) [0|100] "%"  CCU,TBOX
 SG_ ADC_AdjRlnMrkingDispSt : 305|1@0+ (1,0) [0|1] ""  CCU,TBOX
 SG_ ADC_AdjRLnMrking_Type : 319|4@0+ (1,0) [0|15] ""  CCU,TBOX

BO_ 947 ADC_8: 64 ADC
 SG_ ADC_8_CRC : 7|16@0+ (1,0) [0|65535] ""  CCU,CCURT1,CCURT2,RT1_C1,RT2_C3,FAPA
 SG_ ADC_8_Counter : 23|8@0+ (1,0) [0|255] ""  CCU,CCURT1,CCURT2,RT1_C1,RT2_C3,FAPA
 SG_ ADC_LowBeamReq : 31|2@0+ (1,0) [0|3] ""  CCU,CCURT2,RT2_C3,FAPA
 SG_ ADC_IHBC_HighBeamReq : 29|1@0+ (1,0) [0|1] ""  CCU,CCURT2,RT2_C3,FAPA
 SG_ ADC_FlashReq : 28|2@0+ (1,0) [0|3] ""  CCU,CCURT2,RT2_C3,FAPA
 SG_ ADC_PositionLampReq : 26|2@0+ (1,0) [0|3] ""  CCU,CCURT2,RT2_C3,FAPA
 SG_ ADC_HVACCtrlReq : 39|1@0+ (1,0) [0|1] ""  CCU,CCURT1,CCURT2,RT1_C1,FAPA
 SG_ ADC_FFogLightReq : 38|2@0+ (1,0) [0|3] ""  CCU,CCURT2,RT2_C3,FAPA
 SG_ ADC_RFogLightReq : 36|2@0+ (1,0) [0|3] ""  CCU,CCURT2,RT2_C3,FAPA
 SG_ ADC_HornReq : 34|3@0+ (1,0) [0|7] ""  CCU,CCURT2,RT2_C3,FAPA
 SG_ ADC_FWiperReq : 47|3@0+ (1,0) [0|7] ""  CCU,CCURT1,CCURT2,RT1_C0,RT2_C3,FAPA
 SG_ ADC_RWiperReq : 44|3@0+ (1,0) [0|7] ""  CCU,CCURT1,CCURT2,RT1_C0,RT2_C3,FAPA
 SG_ ADC_FWaterSprayReq : 41|2@0+ (1,0) [0|3] ""  CCU,CCURT1,CCURT2,RT1_C0,RT2_C3,FAPA
 SG_ ADC_RWaterSprayReq : 55|2@0+ (1,0) [0|3] ""  CCU,CCURT1,CCURT2,RT1_C0,RT2_C3,FAPA
 SG_ ADC_CCUReqVD : 53|1@0+ (1,0) [0|1] ""  CCU,CCURT2,RT2_C3,FAPA
 SG_ ADC_WindowOpenReq : 50|1@0+ (1,0) [0|1] ""  CCU,CCURT1,CCURT2,RT2_C3,FAPA
 SG_ ADC_WindowCloseReq : 49|1@0+ (1,0) [0|1] ""  CCU,CCURT1,CCURT2,RT2_C3,FAPA
 SG_ ADC_PLGMOpenReq : 48|1@0+ (1,0) [0|1] ""  CCU,CCURT2,FAPA
 SG_ ADC_PLGMCloseReq : 63|1@0+ (1,0) [0|1] ""  CCU,CCURT2,FAPA
 SG_ ADC_FDemistReq : 60|2@0+ (1,0) [0|3] ""  CCU,CCURT2,FAPA
 SG_ ADC_RDemistReq : 58|2@0+ (1,0) [0|3] ""  CCU,CCURT2,FAPA
 SG_ ADC_ThmPostRun : 56|1@0+ (1,0) [0|1] ""  CCU,CCURT1,RT1_C1,FAPA
 SG_ ADC_DriverFaceWindReq : 71|2@0+ (1,0) [0|3] ""  CCU,FAPA
 SG_ ADC_EcallReq : 69|1@0+ (1,0) [0|1] ""  CCU,FAPA,TBOX
 SG_ ADC_FlowReq : 68|5@0+ (0.25,0) [0|7.75] "L/min"  CCU,CCURT1,RT1_C1,FAPA
 SG_ ADC_DriverSeatBeltPretightenReq : 79|1@0+ (1,0) [0|1] ""  CCU,CCURT1,RT1_C1,FAPA
 SG_ ADC_LockReq : 78|3@0+ (1,0) [0|7] ""  CCU,CCURT1,CCURT2,RT2_C3,FAPA
 SG_ ADC_HoldLockReq : 75|2@0+ (1,0) [0|3] ""  CCU,CCURT1,CCURT2,RT2_C3,FAPA
 SG_ ADC_RearMirrorReq : 73|2@0+ (1,0) [0|3] ""  CCU,CCURT1,CCURT2,RT2_C3,FAPA
 SG_ ADC_HoldRearMirrorReq : 87|2@0+ (1,0) [0|3] ""  CCU,CCURT1,CCURT2,RT2_C3,FAPA
 SG_ ADC_ADSLightReq : 90|3@0+ (1,0) [0|7] ""  CCU,CCURT1,CCURT2,RT2_C3,FAPA
 SG_ ADC_DriverSeatBeltVibrWarnReq : 83|3@0+ (1,0) [0|7] ""  CCU,CCURT1,RT1_C1,FAPA
 SG_ ADC_FrtWindshildHeatReq : 92|2@0+ (1,0) [0|3] ""  CCU,FAPA
 SG_ ADC_BeamSwReq : 94|2@0+ (1,0) [0|3] ""  CCU,CCURT1,CCURT2,RT2_C3,FAPA
 SG_ IFC_SysCalibrationSt : 80|2@0+ (1,0) [0|3] ""  CCU,FAPA
 SG_ ADC_ADBIHBCEnableReq : 99|2@0+ (1,0) [0|3] ""  CCU,CCURT1,CCURT2,RT2_C3,FAPA
 SG_ ADC_LowPowerReqVD_A : 107|1@0+ (1,0) [0|1] ""  CCU,CCURT1,CCURT2,INU,FAPA
 SG_ ADC_LowPowerReq_A : 106|2@0+ (1,0) [0|3] ""  CCU,CCURT1,CCURT2,INU,FAPA
 SG_ ADC_MachineStatus : 124|3@0+ (1,0) [0|7] ""  CCU,CCURT1,CCURT2,RT1_C1,FAPA
 SG_ ADC_LowPowerFailReason : 127|3@0+ (1,0) [0|7] ""  CCU,CCURT1,CCURT2,RT1_C1,FAPA
 SG_ ADC_LightbarReq : 135|4@0+ (1,0) [0|15] "/"  CCU,CCURT1,CCURT2,FAPA
 SG_ ADC_ChgPortControlReq : 129|2@0+ (1,0) [0|3] ""  CCU,CCURT1,CCURT2,FAPA
 SG_ ADC_ChgPortHoldControlReq : 131|2@0+ (1,0) [0|3] ""  CCU,CCURT1,CCURT2,FAPA
 SG_ ADC_ChargHoldReq : 137|2@0+ (1,0) [0|3] ""  CCU,CCURT1,CCURT2,RT1_C1,FAPA
 SG_ ADC_ChargReq : 139|2@0+ (1,0) [0|3] ""  CCU,CCURT1,CCURT2,RT1_C1,FAPA
 SG_ ADC_ChargGunHoldReq : 141|2@0+ (1,0) [0|3] ""  CCU,CCURT1,CCURT2,RT1_C1,FAPA
 SG_ ADC_ChargGunReq : 143|2@0+ (1,0) [0|3] ""  CCU,CCURT1,CCURT2,RT1_C1,FAPA
 SG_ ADC_MCURTTemp : 151|8@0+ (1,-40) [-40|215] "℃"  CCU,CCURT1,RT1_C1,FAPA
 SG_ ADC_SOCRTtemp : 159|8@0+ (1,-40) [-40|215] "℃"  CCU,CCURT1,RT1_C1,FAPA
 SG_ ADC_InteractLightReq : 167|5@0+ (1,0) [0|31] ""  CCU,CCURT1,CCURT2,FAPA
 SG_ Reserved1 : 440|1@0+ (1,0) [0|0] ""  CCU

BO_ 170 ADC_SecReq: 16 ADC
 SG_ ADC_SecReq : 7|128@0+ (1,0) [0|255] ""  CCU,CCURT1

BO_ 121 ADC_SECKEY: 1 ADC
 SG_ ADC_SEC_KEY_Defaultencoding : 7|8@0+ (1,0) [0|255] ""  CCU,CCURT1,RT1_C0

BO_ 175 ADC_9: 64 ADC
 SG_ ADC_9_CRC : 7|16@0+ (1,0) [0|65535] ""  CCU
 SG_ ADC_9_Counter : 23|8@0+ (1,0) [0|255] ""  CCU
 SG_ ADC_PAAChallengeReceive : 29|1@0+ (1,0) [0|1] ""  CCU
 SG_ PAA_TimeStampYear : 28|5@0+ (1,2020) [2020|2051] "y"  CCU
 SG_ ADC_PAAChallenge1SBM : 39|8@0+ (1,0) [0|255] ""  CCU
 SG_ ADC_PAAChallenge2SBM : 47|8@0+ (1,0) [0|255] ""  CCU
 SG_ ADC_PAAChallenge1TEL : 55|8@0+ (1,0) [0|255] ""  CCU
 SG_ ADC_PAAChallenge2TEL : 63|8@0+ (1,0) [0|255] ""  CCU
 SG_ PAA_TimeStampMonth : 71|4@0+ (1,0) [1|12] "m"  CCU
 SG_ PAA_TimeStampDay : 67|5@0+ (1,0) [1|31] "h"  CCU
 SG_ PAA_TimeStampHour : 78|5@0+ (1,0) [0|23] "d"  CCU
 SG_ PAA_TimeStampMin : 73|6@0+ (1,0) [0|59] "min"  CCU
 SG_ PAA_TimeStampSec : 83|6@0+ (1,0) [0|59] "s"  CCU
 SG_ PAA_TimeStampMilliSec : 93|4@0+ (100,0) [0|900] "ms"  CCU
 SG_ ADC_APAActPushSt : 97|2@0+ (1,0) [0|3] ""  CCU
 SG_ PAA_DVRTriggerId : 89|5@0+ (1,0) [0|31] ""  CCU
 SG_ PAA_DVRTrigger : 100|1@0+ (1,0) [0|1] ""  CCU
 SG_ ADC_LCAEnableSt : 99|2@0+ (1,0) [0|3] ""  CCU
 SG_ ADC_HPALearningPathUniqueID : 111|64@0+ (1,0) [0|0] ""  CCU
 SG_ Reserved1 : 440|1@0+ (1,0) [0|0] ""  CCU

CM_ SG_ 659 ADC_5_CRC "E2E Profile 5 CRC";
CM_ SG_ 659 ADC_5_Counter "E2E Profile 5 Counter";
CM_ SG_ 659 ADC_NDASt "NDA state information";
CM_ SG_ 659 ADC_NDATORType "NDA/Autonomous Driving System Driver TakeOver Type";
CM_ SG_ 659 ADC_NDADecideResult "ADC_NDA Decide Result";
CM_ SG_ 659 ADC_NDATargetLane "NDA Target Lane";
CM_ SG_ 659 ADC_NDASplitSt "NDA Split state";
CM_ SG_ 659 ADC_NDALaneChangeOverlineTOR "NDA Lane Change Overline TOR ";
CM_ SG_ 659 ADC_ALCSuspendReason "ADC_Lane Change suspend reason";
CM_ SG_ 659 ADC_SplitSuspendReason "ADC_Split suspend reason";
CM_ SG_ 659 ADC_NDAEnableSt "NDA Enable State";
CM_ SG_ 659 ADC_NDAFailureReason "NDA System Failure Reason";
CM_ SG_ 659 ADC_NDANotactivereason "NDA not active or degrade reason";
CM_ SG_ 659 ADC_NDAGeoFence "NDA Geo-fence";
CM_ SG_ 659 ADC_NDAODDnotMeetreason "NDA ODD not Meet reason";
CM_ SG_ 659 ADC_ICAAvailableState "ICA Available State for NDA degrade";
CM_ SG_ 659 ADC_ACCAvailableState "ACC Available State  for NDA degrade";
CM_ SG_ 659 ADC_NDARouteReplanning "ADC_NDA Route Replanning";
CM_ SG_ 659 ADC_SpeedLimitConfirmRequest "Automatic Speed Limit Confirm Request";
CM_ SG_ 659 ADC_LaneChangeType "Lane Change Type";
CM_ SG_ 659 ADC_LC_ZoneMatching "Lane change Left Zone Matching";
CM_ SG_ 659 ADC_RoadMergeSplitType "ADC_Road Merge Split Type";
CM_ SG_ 659 ADC_LaneMergeSplitType "ADC_Lane Merge Split Type";
CM_ SG_ 659 ADC_EyesOn_Warning "ADAS_Eyes On_Warning";
CM_ SG_ 659 ADC_TakeOverType "ADAS_Take Over Type";
CM_ SG_ 659 ADC_TakeOverWarningLevel "ADAS_Take Over Warning Level";
CM_ SG_ 659 ADC_NDAMRMWarningLevel "NDA Minimum Risk Manuvel Warning Level";
CM_ SG_ 659 ADC_ADASTransitionType "ADAS Function Transition Type";
CM_ SG_ 659 ADC_FuncReq_SentryModWarn "Sentry Mode Warn";
CM_ SG_ 659 ADC_TlaWarning "TLA Warning State for ICM";
CM_ SG_ 659 ADC_TlaFault "TLA Failure State";
CM_ SG_ 659 ADC_FcwWaning "FCW Warning State Effects";
CM_ SG_ 659 ADC_AebFault "AEB Fault State";
CM_ SG_ 659 ADC_RaebWarning "RAEB Warning State Effects";
CM_ SG_ 659 ADC_RaebFault "RAEB Fault State";
CM_ SG_ 659 ADC_RcwFault "RCW Fault State";
CM_ SG_ 659 ADC_FctbLeftWarning "FCTB Left Warning State Effects";
CM_ SG_ 659 ADC_FctbRightWarning "FCTB Right Warning State Effects";
CM_ SG_ 659 ADC_RctaFault "RCTA Fault State";
CM_ SG_ 659 ADC_RctbLeftWarning "RCTB Left Warning State Effects";
CM_ SG_ 659 ADC_RctbRightWarning "RCTB Right Warning State Effects";
CM_ SG_ 659 ADC_LdwFault "LDW Fault State";
CM_ SG_ 659 ADC_LkaFault "LKA Fault State";
CM_ SG_ 659 ADC_BsdFault "BSD Fault State";
CM_ SG_ 659 ADC_DowFault "DOW Fault State";
CM_ SG_ 659 ADC_TsrFault "TSR Fault State";
CM_ SG_ 659 ADC_ElkaWarning "ELKA Warning State Effects";
CM_ SG_ 659 ADC_ElkaFault "ELKA Fault State";
CM_ SG_ 659 ADC_TotalRefTorque_A "ADAS total  torque request";
CM_ SG_ 659 ADC_IMURollingCounter "IMU?Counter";
CM_ SG_ 659 ADC_IMUAccX "IMU?X-Axis?Acceleration?(Rear)";
CM_ SG_ 659 ADC_IMUAccY "IMU?Y-Axis?Acceleration?(Right)";
CM_ SG_ 659 ADC_IMUAccZ "IMU?Z-Axis?Acceleration?(Upper)";
CM_ SG_ 659 ADC_IMUGyroX "IMU?X-Axis?AngularVelocity?(Rear)";
CM_ SG_ 659 ADC_IMUGyroY "IMU?Y-Axis?AngularVelocity?(Right)";
CM_ SG_ 659 ADC_IMUGyroZ "IMU?Z-Axis?AngularVelocity?(Upper)";
CM_ SG_ 659 ADC_IMURoll "IMU?RollAngle";
CM_ SG_ 659 ADC_IMUPitch "IMU?PitchAngle";
CM_ SG_ 659 ADC_IMUYaw "IMU?YawAngle";
CM_ SG_ 659 ADC_IMUTimestampVld "IMU?TimeStamp?Valid";
CM_ SG_ 659 ADC_IMUAccVld "IMU?Acceleration?Valid";
CM_ SG_ 659 ADC_IMUGyroVld "IMU?AngularVelocity?Valid";
CM_ SG_ 659 ADC_IMUAttitudeVld "IMU?Attitude?Valid";
CM_ SG_ 659 ADC_IMUPositionType "IMU?Localization?State";
CM_ SG_ 659 ADC_IMUTimestamp "IMU?TimeStamp";
CM_ SG_ 659 ADC_AbsoultwSpeedLimit "Absolute Speed Limit Value set by Driver";
CM_ SG_ 923 ADC_6_CRC "E2E Profile 5 CRC";
CM_ SG_ 923 ADC_6_Counter "E2E Profile 5 Counter";
CM_ SG_ 923 ADC_FrontWideCameraSt "Front Wide Camera State ";
CM_ SG_ 923 ADC_FrontNarrowCameraSt "Front Narrow Camera State ";
CM_ SG_ 923 ADC_LeftFrontCameraSt "Left Front Camera State ";
CM_ SG_ 923 ADC_LeftRearCameraSt "Left Rear Camera State ";
CM_ SG_ 923 ADC_RightFrontCameraSt "Right Front Camera State ";
CM_ SG_ 923 ADC_RightRearCameraSt "Right Rear Camera State ";
CM_ SG_ 923 ADC_RearCameraSt "Rear Camera Failure ";
CM_ SG_ 923 ADC_FrontRadarSt "Front Radar State ";
CM_ SG_ 923 ADC_LeftFrontRadarSt "Left Front Radar State ";
CM_ SG_ 923 ADC_LeftRearRadarSt "Left Rear Radar State ";
CM_ SG_ 923 ADC_RightFrontRadarSt "Right Front Radar State ";
CM_ SG_ 923 ADC_RightRearRadarSt "Right Rear Radar State ";
CM_ SG_ 923 ADC_RearRadarSt "Rear Radar State ";
CM_ SG_ 923 ADC_FrontLidarSt "Front Lidar State";
CM_ SG_ 923 ADC_LeftLidarSt "Left Lidar State";
CM_ SG_ 923 ADC_RightLidarSt "Right Lidar State";
CM_ SG_ 923 ADC_SunroofOpenCloseReq "Sunroof control";
CM_ SG_ 923 ADC_SentryStatus "Sentinel mode state machine";
CM_ SG_ 923 ADC_SOCWakeupHVReq "ADC sends the signal to VCU when IGN is off, in order to request VCU to provide the DCDC for pre-start and post-run of ADC.";
CM_ SG_ 923 ADC_SystemState "The system status of ADS";
CM_ SG_ 923 ADC_HWFailureReason "NDA_ADC HW Failure Reason";
CM_ SG_ 923 ADC_SWFailureReason "NDA_ADC SW Failure Reason";
CM_ SG_ 923 mountAngleIndicator_az "Horizontal fast Angle";
CM_ SG_ 923 mountAngleCurrent_az "Horizontal slow Angle";
CM_ SG_ 923 mountAngleIndicator_el "Vertical fast Angle";
CM_ SG_ 923 mountAngleCurrent_el "Vertical slow Angle";
CM_ SG_ 923 malStablePosEl "Vertical stable point";
CM_ SG_ 923 malStablePosAz "Horizontal stable point";
CM_ SG_ 923 AngleEMEIndicatorEl "Vertical EME fast Angle";
CM_ SG_ 923 AngleEMEIndicatorAz "Horizontal EME fast Angle";
CM_ SG_ 923 highSpreadIndicator_el "Vertical filterPhiSpread";
CM_ SG_ 923 highSpreadIndicator_az "Horizontal filterPhiSpread";
CM_ SG_ 923 Fault_MAL_HOR_ABS_EVENT "Horizontal Angle absolute overshoot ITC";
CM_ SG_ 923 Fault_MAL_HOR_REL_EVENT "Horizontal relative Angle overshoot ITC";
CM_ SG_ 923 Fault_MAL_VER_ABS_EVENT "Vertical Angle absolute overshoot ITC";
CM_ SG_ 923 Fault_MAL_VER_REL_EVENT "Vertical relative overshoot ITC";
CM_ SG_ 923 FilteredPhiSpread "FR_MAL_FilteredPhiSpread";
CM_ SG_ 923 elOutOfSpecCause "FR_MAL_elOutOfSpecCause";
CM_ SG_ 923 azOutOfSpecCause "FR_MAL_azOutOfSpecCause";
CM_ SG_ 923 azOutOfProfileCause "FR_MAL_azOutOfProfileCause";
CM_ SG_ 923 elOutOfProfileCause "FR_MAL_elOutOfProfileCause";
CM_ SG_ 923 ADC_FuncReq_SentryModDetec "Sentry Mode Keep HV";
CM_ SG_ 667 ADC_7_CRC "E2E Profile 5 CRC";
CM_ SG_ 667 ADC_7_Counter "E2E Profile 5 Counter";
CM_ SG_ 667 ADC_LatVMC_A0 "Lane Marking Polynomial Coefficient A0 used by VMC";
CM_ SG_ 667 ADC_LatVMC_A1 "Lane Marking Polynomial Coefficient A1 used by VMC";
CM_ SG_ 667 ADC_LatVMC_A2 "Lane Marking Polynomial Coefficient A2 used by VMC";
CM_ SG_ 667 ADC_LatVMC_A3 "Lane Marking Polynomial Coefficient A3 used by VMC";
CM_ SG_ 667 ADC_LatVMC_conf "comprehensive confidence used by VMC";
CM_ SG_ 667 ADC_LatVMC_Range "comprehensive confidence used by VMC";
CM_ SG_ 667 ADC_LLnMrking_A0 "Left Lane Marking Polynomial Coefficient A0, which stands for the lateral distance between lane marking and the middle of the eog vehicle.";
CM_ SG_ 667 ADC_LLnMrking_A1 "Left Lane Marking Polynomial Coefficient A1, which stands for the heading angle between the lane marking and the ego vehicle.";
CM_ SG_ 667 ADC_LLnMrking_A2 "Left Lane Marking Polynomial Coefficient A2, which stands for the curvature of the lane marking.";
CM_ SG_ 667 ADC_LLnMrking_conf "Left Lane Marking confidence";
CM_ SG_ 667 ADC_LlnMrkingDispSt "Display state of the left lane marking";
CM_ SG_ 667 ADC_LLnMrking_Range "Left Lane Marking range";
CM_ SG_ 667 ADC_LLnMrking_Type "Left side of lane marking indication type";
CM_ SG_ 667 ADC_RLnMrking_A0 "right Lane Marking Polynomial Coefficient A0, which stands for the lateral distance between lane marking and the middle of the eog vehicle.";
CM_ SG_ 667 ADC_RLnMrking_A1 "right Lane Marking Polynomial Coefficient A1, which stands for the heading angle between the lane marking and the ego vehicle.";
CM_ SG_ 667 ADC_RLnMrking_A2 "right Lane Marking Polynomial Coefficient A2, which stands for the curvature of the lane marking.";
CM_ SG_ 667 ADC_RlnMrkingDispSt "Display state of the right lane marking";
CM_ SG_ 667 ADC_RLnMrking_conf "right Lane Marking confidence";
CM_ SG_ 667 ADC_RLnMrking_Range "right Lane Marking range";
CM_ SG_ 667 ADC_RLnMrking_Type "right side of lane marking indication type";
CM_ SG_ 667 ADC_AdjLLnMrking_A0 "adjacent Left Lane Marking Polynomial Coefficient A0, which stands for the lateral distance between lane marking and the middle of the eog vehicle.";
CM_ SG_ 667 ADC_AdjLLnMrking_A1 "adjacent Left Lane Marking Polynomial Coefficient A1, which stands for the heading angle between the lane marking and the ego vehicle.";
CM_ SG_ 667 ADC_AdjLLnMrking_A2 "adjacent Left Lane Marking Polynomial Coefficient A2, which stands for the curvature of the lane marking.";
CM_ SG_ 667 ADC_AdjLLnMrking_conf "adjacent Left Lane Marking confidence";
CM_ SG_ 667 ADC_AdjLLnMrking_Range "adjacent Left Lane Marking range";
CM_ SG_ 667 ADC_AdjLlnMrkingDispSt "Display state of the adjacent left lane marking";
CM_ SG_ 667 ADC_AdjLLnMrking_Type "adjacent Left side of lane marking indication type";
CM_ SG_ 667 ADC_AdjRLnMrking_A0 "adjacent right Lane Marking Polynomial Coefficient A0, which stands for the lateral distance between lane marking and the middle of the eog vehicle.";
CM_ SG_ 667 ADC_AdjRLnMrking_A1 "adjacent right Lane Marking Polynomial Coefficient A1, which stands for the heading angle between the lane marking and the ego vehicle.";
CM_ SG_ 667 ADC_AdjRLnMrking_A2 "adjacent right Lane Marking Polynomial Coefficient A2, which stands for the curvature of the lane marking.";
CM_ SG_ 667 ADC_AdjRLnMrking_Range "adjacent right Lane Marking range";
CM_ SG_ 667 ADC_AdjRLnMrking_conf "adjacent right Lane Marking confidence";
CM_ SG_ 667 ADC_AdjRlnMrkingDispSt "Display state of the adjacent right lane marking";
CM_ SG_ 667 ADC_AdjRLnMrking_Type "adjacent right side of lane marking indication type";
CM_ SG_ 947 ADC_8_CRC "E2E Profile 5 CRC";
CM_ SG_ 947 ADC_8_Counter "E2E Profile 5 Counter";
CM_ SG_ 947 ADC_LowBeamReq "Low Beam Request?";
CM_ SG_ 947 ADC_IHBC_HighBeamReq "IHBC High Beam Request?";
CM_ SG_ 947 ADC_FlashReq "Flash High Beam Request?";
CM_ SG_ 947 ADC_PositionLampReq "Position Lamp Request?";
CM_ SG_ 947 ADC_HVACCtrlReq "Air conditioner request";
CM_ SG_ 947 ADC_FFogLightReq "Front Fog Light Request?";
CM_ SG_ 947 ADC_RFogLightReq "Rear Fog Light Request?";
CM_ SG_ 947 ADC_HornReq "Horn Request";
CM_ SG_ 947 ADC_FWiperReq "Front Wiper Request";
CM_ SG_ 947 ADC_RWiperReq "Rear Wiper Request";
CM_ SG_ 947 ADC_FWaterSprayReq "Front Water Spray Request";
CM_ SG_ 947 ADC_RWaterSprayReq "Rear Water Spray Request";
CM_ SG_ 947 ADC_CCUReqVD "CCU Request valid";
CM_ SG_ 947 ADC_WindowOpenReq "Window Open Request";
CM_ SG_ 947 ADC_WindowCloseReq "Window Close Request";
CM_ SG_ 947 ADC_PLGMOpenReq "PLGM Open Request";
CM_ SG_ 947 ADC_PLGMCloseReq "PLGM Close Request";
CM_ SG_ 947 ADC_FDemistReq "Front window Demist Active Request";
CM_ SG_ 947 ADC_RDemistReq "Rear window Demist Active Request";
CM_ SG_ 947 ADC_ThmPostRun "ADC cooling demand flag request";
CM_ SG_ 947 ADC_DriverFaceWindReq "Driver Face Wind Request";
CM_ SG_ 947 ADC_EcallReq "ADAS E-call Request";
CM_ SG_ 947 ADC_FlowReq "ADC cooling liquid flow rate request";
CM_ SG_ 947 ADC_DriverSeatBeltPretightenReq "Driver Seat Belt Pretighten Request";
CM_ SG_ 947 ADC_LockReq "Doors Lock/Unlock Request";
CM_ SG_ 947 ADC_HoldLockReq "Hold Doors Lock/Unlock Request";
CM_ SG_ 947 ADC_RearMirrorReq "Rear Mirror Fold/Unfold Request";
CM_ SG_ 947 ADC_HoldRearMirrorReq "Hold Rear Mirror Fold/Unfold Request";
CM_ SG_ 947 ADC_ADSLightReq "ADS light request";
CM_ SG_ 947 ADC_DriverSeatBeltVibrWarnReq "ADAS active driver seat belt vibration warning request";
CM_ SG_ 947 ADC_FrtWindshildHeatReq "Front windshield heating wire control request";
CM_ SG_ 947 ADC_BeamSwReq "Head light switch control request（turn on automatic light）";
CM_ SG_ 947 IFC_SysCalibrationSt "IFC(Intelligent Front Camera) system calibration ststus";
CM_ SG_ 947 ADC_ADBIHBCEnableReq "ADB and IHBC enable request";
CM_ SG_ 947 ADC_MachineStatus "ADC Machine Status";
CM_ SG_ 947 ADC_LowPowerFailReason "The Reason why ADC  cannot change to LowPowerMode";
CM_ SG_ 947 ADC_LightbarReq "ADC’s Light bar request";
CM_ SG_ 947 ADC_ChgPortControlReq "Charging Port Close/Open Request";
CM_ SG_ 947 ADC_ChgPortHoldControlReq "Hold Charging Port Close/Open Request";
CM_ SG_ 947 ADC_ChargHoldReq "Hold Charging  Start/Stop Request";
CM_ SG_ 947 ADC_ChargReq "Charging  Start/Stop Request";
CM_ SG_ 947 ADC_ChargGunHoldReq "Hold Charging  Gun Close/Open Request";
CM_ SG_ 947 ADC_ChargGunReq "Charging  Gun Close/Open Request";
CM_ SG_ 947 ADC_MCURTTemp "Real-time Temperature of ADC MCU";
CM_ SG_ 947 ADC_SOCRTtemp "Real-time Temperature of ADC SOC";
CM_ SG_ 947 ADC_InteractLightReq "Interact light request";
CM_ SG_ 170 ADC_SecReq "ADC SecOC freshness value synchronisation request message ";
CM_ SG_ 121 ADC_SEC_KEY_Defaultencoding "ADC feedback SecOC key and default_encoding results";
CM_ SG_ 175 ADC_9_CRC "E2E Profile 5 CRC";
CM_ SG_ 175 ADC_9_Counter "E2E Profile 5 Counter";
CM_ SG_ 175 ADC_PAAChallengeReceive "PAA Receive Challenge Singal";
CM_ SG_ 175 PAA_TimeStampYear "Time Stamp Year number";
CM_ SG_ 175 ADC_PAAChallenge1SBM "RPA Challenge SBM Singal1";
CM_ SG_ 175 ADC_PAAChallenge2SBM "RPA Challenge SBM Singal2";
CM_ SG_ 175 ADC_PAAChallenge1TEL "Challenge SBM Singal1";
CM_ SG_ 175 ADC_PAAChallenge2TEL "Challenge SBM Singal2";
CM_ SG_ 175 PAA_TimeStampMonth "Time Stamp Month number";
CM_ SG_ 175 PAA_TimeStampDay "Time Stamp Day number";
CM_ SG_ 175 PAA_TimeStampHour "Time Stamp Hour number";
CM_ SG_ 175 PAA_TimeStampMin "Time Stamp Minute number";
CM_ SG_ 175 PAA_TimeStampSec "Time Stamp Second number";
CM_ SG_ 175 PAA_TimeStampMilliSec "Time Stamp Millisecond number";
CM_ SG_ 175 ADC_APAActPushSt "Push APA sensless entry parking";
CM_ SG_ 175 PAA_DVRTriggerId "Indicate PAA DVR  event type";
CM_ SG_ 175 PAA_DVRTrigger "PAA DVR Trigger Status";
CM_ SG_ 175 ADC_LCAEnableSt "LCA button Status";
CM_ SG_ 175 ADC_HPALearningPathUniqueID "The unique ID of the learning path";

BA_DEF_ BO_  "GenMsgCycleTime" INT 0 0;
BA_DEF_ BO_  "GenMsgCycleTimeFast" INT 0 0;
BA_DEF_ BO_  "GenMsgSendType" ENUM  "Periodic","Event","IfActive","POE","PA","FixedPeriodic","Event","EnabledPeriodic","NotUsed","NotUsed","EventPeriodic","NotUsed","NotUsed","NoMsgSendType";
BA_DEF_ BO_  "VFrameFormat" ENUM  "StandardCAN","ExtendedCAN","reserved","reserved","reserved","reserved","reserved","reserved","reserved","reserved","reserved","reserved","reserved","reserved","StandardCAN_FD","ExtendedCAN_FD";
BA_DEF_ BO_  "CANFD_BRS" ENUM  "0","1";
BA_DEF_ SG_  "EventCommandSignal" ENUM  "No","Yes";
BA_DEF_ SG_  "GatewayedSignals" ENUM  "No","Yes";
BA_DEF_ SG_  "GenSigInactiveValue" HEX 0 0;
BA_DEF_ SG_  "GenSigInvalidValue" HEX 0 0;
BA_DEF_ SG_  "GenSigSendType" ENUM  "Trigger","Passive","Cyclic","OnWrite","OnWriteWithRepetition","OnChange","OnChangeWithRepetition","IfActive","IfActiveWithRepetition","NoSigSendType";
BA_DEF_ SG_  "GenSigStartValue" HEX 0 0;
BA_DEF_ SG_  "GenSigTimeoutValue" HEX 0 0;
BA_DEF_ SG_  "Remark" STRING ;
BA_ "GenMsgCycleTime" BO_ 659 20;
BA_ "GenMsgCycleTimeFast" BO_ 659 0;
BA_ "GenMsgSendType" BO_ 659 0;
BA_ "VFrameFormat" BO_ 659 14;
BA_ "CANFD_BRS" BO_ 659 1;
BA_ "GenMsgCycleTime" BO_ 659 20;
BA_ "GenMsgCycleTimeFast" BO_ 659 0;
BA_ "GenMsgSendType" BO_ 659 0;
BA_ "VFrameFormat" BO_ 659 14;
BA_ "CANFD_BRS" BO_ 659 1;
BA_ "GenMsgCycleTime" BO_ 659 20;
BA_ "GenMsgCycleTimeFast" BO_ 659 0;
BA_ "GenMsgSendType" BO_ 659 0;
BA_ "VFrameFormat" BO_ 659 14;
BA_ "CANFD_BRS" BO_ 659 1;
BA_ "GenMsgCycleTime" BO_ 659 20;
BA_ "GenMsgCycleTimeFast" BO_ 659 0;
BA_ "GenMsgSendType" BO_ 659 0;
BA_ "VFrameFormat" BO_ 659 14;
BA_ "CANFD_BRS" BO_ 659 1;
BA_ "GenMsgCycleTime" BO_ 659 20;
BA_ "GenMsgCycleTimeFast" BO_ 659 0;
BA_ "GenMsgSendType" BO_ 659 0;
BA_ "VFrameFormat" BO_ 659 14;
BA_ "CANFD_BRS" BO_ 659 1;
BA_ "GenMsgCycleTime" BO_ 659 20;
BA_ "GenMsgCycleTimeFast" BO_ 659 0;
BA_ "GenMsgSendType" BO_ 659 0;
BA_ "VFrameFormat" BO_ 659 14;
BA_ "CANFD_BRS" BO_ 659 1;
BA_ "GenMsgCycleTime" BO_ 659 20;
BA_ "GenMsgCycleTimeFast" BO_ 659 0;
BA_ "GenMsgSendType" BO_ 659 0;
BA_ "VFrameFormat" BO_ 659 14;
BA_ "CANFD_BRS" BO_ 659 1;
BA_ "GenMsgCycleTime" BO_ 659 20;
BA_ "GenMsgCycleTimeFast" BO_ 659 0;
BA_ "GenMsgSendType" BO_ 659 0;
BA_ "VFrameFormat" BO_ 659 14;
BA_ "CANFD_BRS" BO_ 659 1;
BA_ "GenMsgCycleTime" BO_ 659 20;
BA_ "GenMsgCycleTimeFast" BO_ 659 0;
BA_ "GenMsgSendType" BO_ 659 0;
BA_ "VFrameFormat" BO_ 659 14;
BA_ "CANFD_BRS" BO_ 659 1;
BA_ "GenMsgCycleTime" BO_ 659 20;
BA_ "GenMsgCycleTimeFast" BO_ 659 0;
BA_ "GenMsgSendType" BO_ 659 0;
BA_ "VFrameFormat" BO_ 659 14;
BA_ "CANFD_BRS" BO_ 659 1;
BA_ "GenMsgCycleTime" BO_ 659 20;
BA_ "GenMsgCycleTimeFast" BO_ 659 0;
BA_ "GenMsgSendType" BO_ 659 0;
BA_ "VFrameFormat" BO_ 659 14;
BA_ "CANFD_BRS" BO_ 659 1;
BA_ "GenMsgCycleTime" BO_ 659 20;
BA_ "GenMsgCycleTimeFast" BO_ 659 0;
BA_ "GenMsgSendType" BO_ 659 0;
BA_ "VFrameFormat" BO_ 659 14;
BA_ "CANFD_BRS" BO_ 659 1;
BA_ "GenMsgCycleTime" BO_ 659 20;
BA_ "GenMsgCycleTimeFast" BO_ 659 0;
BA_ "GenMsgSendType" BO_ 659 0;
BA_ "VFrameFormat" BO_ 659 14;
BA_ "CANFD_BRS" BO_ 659 1;
BA_ "GenMsgCycleTime" BO_ 659 20;
BA_ "GenMsgCycleTimeFast" BO_ 659 0;
BA_ "GenMsgSendType" BO_ 659 0;
BA_ "VFrameFormat" BO_ 659 14;
BA_ "CANFD_BRS" BO_ 659 1;
BA_ "GenMsgCycleTime" BO_ 659 20;
BA_ "GenMsgCycleTimeFast" BO_ 659 0;
BA_ "GenMsgSendType" BO_ 659 0;
BA_ "VFrameFormat" BO_ 659 14;
BA_ "CANFD_BRS" BO_ 659 1;
BA_ "GenMsgCycleTime" BO_ 659 20;
BA_ "GenMsgCycleTimeFast" BO_ 659 0;
BA_ "GenMsgSendType" BO_ 659 0;
BA_ "VFrameFormat" BO_ 659 14;
BA_ "CANFD_BRS" BO_ 659 1;
BA_ "GenMsgCycleTime" BO_ 659 20;
BA_ "GenMsgCycleTimeFast" BO_ 659 0;
BA_ "GenMsgSendType" BO_ 659 0;
BA_ "VFrameFormat" BO_ 659 14;
BA_ "CANFD_BRS" BO_ 659 1;
BA_ "GenMsgCycleTime" BO_ 659 20;
BA_ "GenMsgCycleTimeFast" BO_ 659 0;
BA_ "GenMsgSendType" BO_ 659 0;
BA_ "VFrameFormat" BO_ 659 14;
BA_ "CANFD_BRS" BO_ 659 1;
BA_ "GenMsgCycleTime" BO_ 659 20;
BA_ "GenMsgCycleTimeFast" BO_ 659 0;
BA_ "GenMsgSendType" BO_ 659 0;
BA_ "VFrameFormat" BO_ 659 14;
BA_ "CANFD_BRS" BO_ 659 1;
BA_ "GenMsgCycleTime" BO_ 659 20;
BA_ "GenMsgCycleTimeFast" BO_ 659 0;
BA_ "GenMsgSendType" BO_ 659 0;
BA_ "VFrameFormat" BO_ 659 14;
BA_ "CANFD_BRS" BO_ 659 1;
BA_ "GenMsgCycleTime" BO_ 659 20;
BA_ "GenMsgCycleTimeFast" BO_ 659 0;
BA_ "GenMsgSendType" BO_ 659 0;
BA_ "VFrameFormat" BO_ 659 14;
BA_ "CANFD_BRS" BO_ 659 1;
BA_ "GenMsgCycleTime" BO_ 659 20;
BA_ "GenMsgCycleTimeFast" BO_ 659 0;
BA_ "GenMsgSendType" BO_ 659 0;
BA_ "VFrameFormat" BO_ 659 14;
BA_ "CANFD_BRS" BO_ 659 1;
BA_ "GenMsgCycleTime" BO_ 659 20;
BA_ "GenMsgCycleTimeFast" BO_ 659 0;
BA_ "GenMsgSendType" BO_ 659 0;
BA_ "VFrameFormat" BO_ 659 14;
BA_ "CANFD_BRS" BO_ 659 1;
BA_ "GenMsgCycleTime" BO_ 659 20;
BA_ "GenMsgCycleTimeFast" BO_ 659 0;
BA_ "GenMsgSendType" BO_ 659 0;
BA_ "VFrameFormat" BO_ 659 14;
BA_ "CANFD_BRS" BO_ 659 1;
BA_ "GenMsgCycleTime" BO_ 659 20;
BA_ "GenMsgCycleTimeFast" BO_ 659 0;
BA_ "GenMsgSendType" BO_ 659 0;
BA_ "VFrameFormat" BO_ 659 14;
BA_ "CANFD_BRS" BO_ 659 1;
BA_ "GenMsgCycleTime" BO_ 659 20;
BA_ "GenMsgCycleTimeFast" BO_ 659 0;
BA_ "GenMsgSendType" BO_ 659 0;
BA_ "VFrameFormat" BO_ 659 14;
BA_ "CANFD_BRS" BO_ 659 1;
BA_ "GenMsgCycleTime" BO_ 659 20;
BA_ "GenMsgCycleTimeFast" BO_ 659 0;
BA_ "GenMsgSendType" BO_ 659 0;
BA_ "VFrameFormat" BO_ 659 14;
BA_ "CANFD_BRS" BO_ 659 1;
BA_ "GenMsgCycleTime" BO_ 659 20;
BA_ "GenMsgCycleTimeFast" BO_ 659 0;
BA_ "GenMsgSendType" BO_ 659 0;
BA_ "VFrameFormat" BO_ 659 14;
BA_ "CANFD_BRS" BO_ 659 1;
BA_ "GenMsgCycleTime" BO_ 659 20;
BA_ "GenMsgCycleTimeFast" BO_ 659 0;
BA_ "GenMsgSendType" BO_ 659 0;
BA_ "VFrameFormat" BO_ 659 14;
BA_ "CANFD_BRS" BO_ 659 1;
BA_ "GenMsgCycleTime" BO_ 659 20;
BA_ "GenMsgCycleTimeFast" BO_ 659 0;
BA_ "GenMsgSendType" BO_ 659 0;
BA_ "VFrameFormat" BO_ 659 14;
BA_ "CANFD_BRS" BO_ 659 1;
BA_ "GenMsgCycleTime" BO_ 659 20;
BA_ "GenMsgCycleTimeFast" BO_ 659 0;
BA_ "GenMsgSendType" BO_ 659 0;
BA_ "VFrameFormat" BO_ 659 14;
BA_ "CANFD_BRS" BO_ 659 1;
BA_ "GenMsgCycleTime" BO_ 659 20;
BA_ "GenMsgCycleTimeFast" BO_ 659 0;
BA_ "GenMsgSendType" BO_ 659 0;
BA_ "VFrameFormat" BO_ 659 14;
BA_ "CANFD_BRS" BO_ 659 1;
BA_ "GenMsgCycleTime" BO_ 659 20;
BA_ "GenMsgCycleTimeFast" BO_ 659 0;
BA_ "GenMsgSendType" BO_ 659 0;
BA_ "VFrameFormat" BO_ 659 14;
BA_ "CANFD_BRS" BO_ 659 1;
BA_ "GenMsgCycleTime" BO_ 659 20;
BA_ "GenMsgCycleTimeFast" BO_ 659 0;
BA_ "GenMsgSendType" BO_ 659 0;
BA_ "VFrameFormat" BO_ 659 14;
BA_ "CANFD_BRS" BO_ 659 1;
BA_ "GenMsgCycleTime" BO_ 659 20;
BA_ "GenMsgCycleTimeFast" BO_ 659 0;
BA_ "GenMsgSendType" BO_ 659 0;
BA_ "VFrameFormat" BO_ 659 14;
BA_ "CANFD_BRS" BO_ 659 1;
BA_ "GenMsgCycleTime" BO_ 659 20;
BA_ "GenMsgCycleTimeFast" BO_ 659 0;
BA_ "GenMsgSendType" BO_ 659 0;
BA_ "VFrameFormat" BO_ 659 14;
BA_ "CANFD_BRS" BO_ 659 1;
BA_ "GenMsgCycleTime" BO_ 659 20;
BA_ "GenMsgCycleTimeFast" BO_ 659 0;
BA_ "GenMsgSendType" BO_ 659 0;
BA_ "VFrameFormat" BO_ 659 14;
BA_ "CANFD_BRS" BO_ 659 1;
BA_ "GenMsgCycleTime" BO_ 659 20;
BA_ "GenMsgCycleTimeFast" BO_ 659 0;
BA_ "GenMsgSendType" BO_ 659 0;
BA_ "VFrameFormat" BO_ 659 14;
BA_ "CANFD_BRS" BO_ 659 1;
BA_ "GenMsgCycleTime" BO_ 659 20;
BA_ "GenMsgCycleTimeFast" BO_ 659 0;
BA_ "GenMsgSendType" BO_ 659 0;
BA_ "VFrameFormat" BO_ 659 14;
BA_ "CANFD_BRS" BO_ 659 1;
BA_ "GenMsgCycleTime" BO_ 659 20;
BA_ "GenMsgCycleTimeFast" BO_ 659 0;
BA_ "GenMsgSendType" BO_ 659 0;
BA_ "VFrameFormat" BO_ 659 14;
BA_ "CANFD_BRS" BO_ 659 1;
BA_ "GenMsgCycleTime" BO_ 659 20;
BA_ "GenMsgCycleTimeFast" BO_ 659 0;
BA_ "GenMsgSendType" BO_ 659 0;
BA_ "VFrameFormat" BO_ 659 14;
BA_ "CANFD_BRS" BO_ 659 1;
BA_ "GenMsgCycleTime" BO_ 659 20;
BA_ "GenMsgCycleTimeFast" BO_ 659 0;
BA_ "GenMsgSendType" BO_ 659 0;
BA_ "VFrameFormat" BO_ 659 14;
BA_ "CANFD_BRS" BO_ 659 1;
BA_ "GenMsgCycleTime" BO_ 659 20;
BA_ "GenMsgCycleTimeFast" BO_ 659 0;
BA_ "GenMsgSendType" BO_ 659 0;
BA_ "VFrameFormat" BO_ 659 14;
BA_ "CANFD_BRS" BO_ 659 1;
BA_ "GenMsgCycleTime" BO_ 659 20;
BA_ "GenMsgCycleTimeFast" BO_ 659 0;
BA_ "GenMsgSendType" BO_ 659 0;
BA_ "VFrameFormat" BO_ 659 14;
BA_ "CANFD_BRS" BO_ 659 1;
BA_ "GenMsgCycleTime" BO_ 659 20;
BA_ "GenMsgCycleTimeFast" BO_ 659 0;
BA_ "GenMsgSendType" BO_ 659 0;
BA_ "VFrameFormat" BO_ 659 14;
BA_ "CANFD_BRS" BO_ 659 1;
BA_ "GenMsgCycleTime" BO_ 659 20;
BA_ "GenMsgCycleTimeFast" BO_ 659 0;
BA_ "GenMsgSendType" BO_ 659 0;
BA_ "VFrameFormat" BO_ 659 14;
BA_ "CANFD_BRS" BO_ 659 1;
BA_ "GenMsgCycleTime" BO_ 659 20;
BA_ "GenMsgCycleTimeFast" BO_ 659 0;
BA_ "GenMsgSendType" BO_ 659 0;
BA_ "VFrameFormat" BO_ 659 14;
BA_ "CANFD_BRS" BO_ 659 1;
BA_ "GenMsgCycleTime" BO_ 659 20;
BA_ "GenMsgCycleTimeFast" BO_ 659 0;
BA_ "GenMsgSendType" BO_ 659 0;
BA_ "VFrameFormat" BO_ 659 14;
BA_ "CANFD_BRS" BO_ 659 1;
BA_ "GenMsgCycleTime" BO_ 659 20;
BA_ "GenMsgCycleTimeFast" BO_ 659 0;
BA_ "GenMsgSendType" BO_ 659 0;
BA_ "VFrameFormat" BO_ 659 14;
BA_ "CANFD_BRS" BO_ 659 1;
BA_ "GenMsgCycleTime" BO_ 659 20;
BA_ "GenMsgCycleTimeFast" BO_ 659 0;
BA_ "GenMsgSendType" BO_ 659 0;
BA_ "VFrameFormat" BO_ 659 14;
BA_ "CANFD_BRS" BO_ 659 1;
BA_ "GenMsgCycleTime" BO_ 659 20;
BA_ "GenMsgCycleTimeFast" BO_ 659 0;
BA_ "GenMsgSendType" BO_ 659 0;
BA_ "VFrameFormat" BO_ 659 14;
BA_ "CANFD_BRS" BO_ 659 1;
BA_ "GenMsgCycleTime" BO_ 659 20;
BA_ "GenMsgCycleTimeFast" BO_ 659 0;
BA_ "GenMsgSendType" BO_ 659 0;
BA_ "VFrameFormat" BO_ 659 14;
BA_ "CANFD_BRS" BO_ 659 1;
BA_ "GenMsgCycleTime" BO_ 659 20;
BA_ "GenMsgCycleTimeFast" BO_ 659 0;
BA_ "GenMsgSendType" BO_ 659 0;
BA_ "VFrameFormat" BO_ 659 14;
BA_ "CANFD_BRS" BO_ 659 1;
BA_ "GenMsgCycleTime" BO_ 659 20;
BA_ "GenMsgCycleTimeFast" BO_ 659 0;
BA_ "GenMsgSendType" BO_ 659 0;
BA_ "VFrameFormat" BO_ 659 14;
BA_ "CANFD_BRS" BO_ 659 1;
BA_ "GenMsgCycleTime" BO_ 659 20;
BA_ "GenMsgCycleTimeFast" BO_ 659 0;
BA_ "GenMsgSendType" BO_ 659 0;
BA_ "VFrameFormat" BO_ 659 14;
BA_ "CANFD_BRS" BO_ 659 1;
BA_ "GenMsgCycleTime" BO_ 659 20;
BA_ "GenMsgCycleTimeFast" BO_ 659 0;
BA_ "GenMsgSendType" BO_ 659 0;
BA_ "VFrameFormat" BO_ 659 14;
BA_ "CANFD_BRS" BO_ 659 1;
BA_ "GenMsgCycleTime" BO_ 659 20;
BA_ "GenMsgCycleTimeFast" BO_ 659 0;
BA_ "GenMsgSendType" BO_ 659 0;
BA_ "VFrameFormat" BO_ 659 14;
BA_ "CANFD_BRS" BO_ 659 1;
BA_ "GenMsgCycleTime" BO_ 659 20;
BA_ "GenMsgCycleTimeFast" BO_ 659 0;
BA_ "GenMsgSendType" BO_ 659 0;
BA_ "VFrameFormat" BO_ 659 14;
BA_ "CANFD_BRS" BO_ 659 1;
BA_ "GenMsgCycleTime" BO_ 659 20;
BA_ "GenMsgCycleTimeFast" BO_ 659 0;
BA_ "GenMsgSendType" BO_ 659 0;
BA_ "VFrameFormat" BO_ 659 14;
BA_ "CANFD_BRS" BO_ 659 1;
BA_ "GenMsgCycleTime" BO_ 659 20;
BA_ "GenMsgCycleTimeFast" BO_ 659 0;
BA_ "GenMsgSendType" BO_ 659 0;
BA_ "VFrameFormat" BO_ 659 14;
BA_ "CANFD_BRS" BO_ 659 1;
BA_ "GenMsgCycleTime" BO_ 659 20;
BA_ "GenMsgCycleTimeFast" BO_ 659 0;
BA_ "GenMsgSendType" BO_ 659 0;
BA_ "VFrameFormat" BO_ 659 14;
BA_ "CANFD_BRS" BO_ 659 1;
BA_ "GenMsgCycleTime" BO_ 659 20;
BA_ "GenMsgCycleTimeFast" BO_ 659 0;
BA_ "GenMsgSendType" BO_ 659 0;
BA_ "VFrameFormat" BO_ 659 14;
BA_ "CANFD_BRS" BO_ 659 1;
BA_ "GenMsgCycleTime" BO_ 659 20;
BA_ "GenMsgCycleTimeFast" BO_ 659 0;
BA_ "GenMsgSendType" BO_ 659 0;
BA_ "VFrameFormat" BO_ 659 14;
BA_ "CANFD_BRS" BO_ 659 1;
BA_ "GenMsgCycleTime" BO_ 659 20;
BA_ "GenMsgCycleTimeFast" BO_ 659 0;
BA_ "GenMsgSendType" BO_ 659 0;
BA_ "VFrameFormat" BO_ 659 14;
BA_ "CANFD_BRS" BO_ 659 1;
BA_ "GenMsgCycleTime" BO_ 659 20;
BA_ "GenMsgCycleTimeFast" BO_ 659 0;
BA_ "GenMsgSendType" BO_ 659 0;
BA_ "VFrameFormat" BO_ 659 14;
BA_ "CANFD_BRS" BO_ 659 1;
BA_ "GenMsgCycleTime" BO_ 659 20;
BA_ "GenMsgCycleTimeFast" BO_ 659 0;
BA_ "GenMsgSendType" BO_ 659 0;
BA_ "VFrameFormat" BO_ 659 14;
BA_ "CANFD_BRS" BO_ 659 1;
BA_ "GenMsgCycleTime" BO_ 923 100;
BA_ "GenMsgCycleTimeFast" BO_ 923 0;
BA_ "GenMsgSendType" BO_ 923 0;
BA_ "VFrameFormat" BO_ 923 14;
BA_ "CANFD_BRS" BO_ 923 1;
BA_ "GenMsgCycleTime" BO_ 923 100;
BA_ "GenMsgCycleTimeFast" BO_ 923 0;
BA_ "GenMsgSendType" BO_ 923 0;
BA_ "VFrameFormat" BO_ 923 14;
BA_ "CANFD_BRS" BO_ 923 1;
BA_ "GenMsgCycleTime" BO_ 923 100;
BA_ "GenMsgCycleTimeFast" BO_ 923 0;
BA_ "GenMsgSendType" BO_ 923 0;
BA_ "VFrameFormat" BO_ 923 14;
BA_ "CANFD_BRS" BO_ 923 1;
BA_ "GenMsgCycleTime" BO_ 923 100;
BA_ "GenMsgCycleTimeFast" BO_ 923 0;
BA_ "GenMsgSendType" BO_ 923 0;
BA_ "VFrameFormat" BO_ 923 14;
BA_ "CANFD_BRS" BO_ 923 1;
BA_ "GenMsgCycleTime" BO_ 923 100;
BA_ "GenMsgCycleTimeFast" BO_ 923 0;
BA_ "GenMsgSendType" BO_ 923 0;
BA_ "VFrameFormat" BO_ 923 14;
BA_ "CANFD_BRS" BO_ 923 1;
BA_ "GenMsgCycleTime" BO_ 923 100;
BA_ "GenMsgCycleTimeFast" BO_ 923 0;
BA_ "GenMsgSendType" BO_ 923 0;
BA_ "VFrameFormat" BO_ 923 14;
BA_ "CANFD_BRS" BO_ 923 1;
BA_ "GenMsgCycleTime" BO_ 923 100;
BA_ "GenMsgCycleTimeFast" BO_ 923 0;
BA_ "GenMsgSendType" BO_ 923 0;
BA_ "VFrameFormat" BO_ 923 14;
BA_ "CANFD_BRS" BO_ 923 1;
BA_ "GenMsgCycleTime" BO_ 923 100;
BA_ "GenMsgCycleTimeFast" BO_ 923 0;
BA_ "GenMsgSendType" BO_ 923 0;
BA_ "VFrameFormat" BO_ 923 14;
BA_ "CANFD_BRS" BO_ 923 1;
BA_ "GenMsgCycleTime" BO_ 923 100;
BA_ "GenMsgCycleTimeFast" BO_ 923 0;
BA_ "GenMsgSendType" BO_ 923 0;
BA_ "VFrameFormat" BO_ 923 14;
BA_ "CANFD_BRS" BO_ 923 1;
BA_ "GenMsgCycleTime" BO_ 923 100;
BA_ "GenMsgCycleTimeFast" BO_ 923 0;
BA_ "GenMsgSendType" BO_ 923 0;
BA_ "VFrameFormat" BO_ 923 14;
BA_ "CANFD_BRS" BO_ 923 1;
BA_ "GenMsgCycleTime" BO_ 923 100;
BA_ "GenMsgCycleTimeFast" BO_ 923 0;
BA_ "GenMsgSendType" BO_ 923 0;
BA_ "VFrameFormat" BO_ 923 14;
BA_ "CANFD_BRS" BO_ 923 1;
BA_ "GenMsgCycleTime" BO_ 923 100;
BA_ "GenMsgCycleTimeFast" BO_ 923 0;
BA_ "GenMsgSendType" BO_ 923 0;
BA_ "VFrameFormat" BO_ 923 14;
BA_ "CANFD_BRS" BO_ 923 1;
BA_ "GenMsgCycleTime" BO_ 923 100;
BA_ "GenMsgCycleTimeFast" BO_ 923 0;
BA_ "GenMsgSendType" BO_ 923 0;
BA_ "VFrameFormat" BO_ 923 14;
BA_ "CANFD_BRS" BO_ 923 1;
BA_ "GenMsgCycleTime" BO_ 923 100;
BA_ "GenMsgCycleTimeFast" BO_ 923 0;
BA_ "GenMsgSendType" BO_ 923 0;
BA_ "VFrameFormat" BO_ 923 14;
BA_ "CANFD_BRS" BO_ 923 1;
BA_ "GenMsgCycleTime" BO_ 923 100;
BA_ "GenMsgCycleTimeFast" BO_ 923 0;
BA_ "GenMsgSendType" BO_ 923 0;
BA_ "VFrameFormat" BO_ 923 14;
BA_ "CANFD_BRS" BO_ 923 1;
BA_ "GenMsgCycleTime" BO_ 923 100;
BA_ "GenMsgCycleTimeFast" BO_ 923 0;
BA_ "GenMsgSendType" BO_ 923 0;
BA_ "VFrameFormat" BO_ 923 14;
BA_ "CANFD_BRS" BO_ 923 1;
BA_ "GenMsgCycleTime" BO_ 923 100;
BA_ "GenMsgCycleTimeFast" BO_ 923 0;
BA_ "GenMsgSendType" BO_ 923 0;
BA_ "VFrameFormat" BO_ 923 14;
BA_ "CANFD_BRS" BO_ 923 1;
BA_ "GenMsgCycleTime" BO_ 923 100;
BA_ "GenMsgCycleTimeFast" BO_ 923 0;
BA_ "GenMsgSendType" BO_ 923 0;
BA_ "VFrameFormat" BO_ 923 14;
BA_ "CANFD_BRS" BO_ 923 1;
BA_ "GenMsgCycleTime" BO_ 923 100;
BA_ "GenMsgCycleTimeFast" BO_ 923 0;
BA_ "GenMsgSendType" BO_ 923 0;
BA_ "VFrameFormat" BO_ 923 14;
BA_ "CANFD_BRS" BO_ 923 1;
BA_ "GenMsgCycleTime" BO_ 923 100;
BA_ "GenMsgCycleTimeFast" BO_ 923 0;
BA_ "GenMsgSendType" BO_ 923 0;
BA_ "VFrameFormat" BO_ 923 14;
BA_ "CANFD_BRS" BO_ 923 1;
BA_ "GenMsgCycleTime" BO_ 923 100;
BA_ "GenMsgCycleTimeFast" BO_ 923 0;
BA_ "GenMsgSendType" BO_ 923 0;
BA_ "VFrameFormat" BO_ 923 14;
BA_ "CANFD_BRS" BO_ 923 1;
BA_ "GenMsgCycleTime" BO_ 923 100;
BA_ "GenMsgCycleTimeFast" BO_ 923 0;
BA_ "GenMsgSendType" BO_ 923 0;
BA_ "VFrameFormat" BO_ 923 14;
BA_ "CANFD_BRS" BO_ 923 1;
BA_ "GenMsgCycleTime" BO_ 923 100;
BA_ "GenMsgCycleTimeFast" BO_ 923 0;
BA_ "GenMsgSendType" BO_ 923 0;
BA_ "VFrameFormat" BO_ 923 14;
BA_ "CANFD_BRS" BO_ 923 1;
BA_ "GenMsgCycleTime" BO_ 923 100;
BA_ "GenMsgCycleTimeFast" BO_ 923 0;
BA_ "GenMsgSendType" BO_ 923 0;
BA_ "VFrameFormat" BO_ 923 14;
BA_ "CANFD_BRS" BO_ 923 1;
BA_ "GenMsgCycleTime" BO_ 923 100;
BA_ "GenMsgCycleTimeFast" BO_ 923 0;
BA_ "GenMsgSendType" BO_ 923 0;
BA_ "VFrameFormat" BO_ 923 14;
BA_ "CANFD_BRS" BO_ 923 1;
BA_ "GenMsgCycleTime" BO_ 923 100;
BA_ "GenMsgCycleTimeFast" BO_ 923 0;
BA_ "GenMsgSendType" BO_ 923 0;
BA_ "VFrameFormat" BO_ 923 14;
BA_ "CANFD_BRS" BO_ 923 1;
BA_ "GenMsgCycleTime" BO_ 923 100;
BA_ "GenMsgCycleTimeFast" BO_ 923 0;
BA_ "GenMsgSendType" BO_ 923 0;
BA_ "VFrameFormat" BO_ 923 14;
BA_ "CANFD_BRS" BO_ 923 1;
BA_ "GenMsgCycleTime" BO_ 923 100;
BA_ "GenMsgCycleTimeFast" BO_ 923 0;
BA_ "GenMsgSendType" BO_ 923 0;
BA_ "VFrameFormat" BO_ 923 14;
BA_ "CANFD_BRS" BO_ 923 1;
BA_ "GenMsgCycleTime" BO_ 923 100;
BA_ "GenMsgCycleTimeFast" BO_ 923 0;
BA_ "GenMsgSendType" BO_ 923 0;
BA_ "VFrameFormat" BO_ 923 14;
BA_ "CANFD_BRS" BO_ 923 1;
BA_ "GenMsgCycleTime" BO_ 923 100;
BA_ "GenMsgCycleTimeFast" BO_ 923 0;
BA_ "GenMsgSendType" BO_ 923 0;
BA_ "VFrameFormat" BO_ 923 14;
BA_ "CANFD_BRS" BO_ 923 1;
BA_ "GenMsgCycleTime" BO_ 923 100;
BA_ "GenMsgCycleTimeFast" BO_ 923 0;
BA_ "GenMsgSendType" BO_ 923 0;
BA_ "VFrameFormat" BO_ 923 14;
BA_ "CANFD_BRS" BO_ 923 1;
BA_ "GenMsgCycleTime" BO_ 923 100;
BA_ "GenMsgCycleTimeFast" BO_ 923 0;
BA_ "GenMsgSendType" BO_ 923 0;
BA_ "VFrameFormat" BO_ 923 14;
BA_ "CANFD_BRS" BO_ 923 1;
BA_ "GenMsgCycleTime" BO_ 923 100;
BA_ "GenMsgCycleTimeFast" BO_ 923 0;
BA_ "GenMsgSendType" BO_ 923 0;
BA_ "VFrameFormat" BO_ 923 14;
BA_ "CANFD_BRS" BO_ 923 1;
BA_ "GenMsgCycleTime" BO_ 923 100;
BA_ "GenMsgCycleTimeFast" BO_ 923 0;
BA_ "GenMsgSendType" BO_ 923 0;
BA_ "VFrameFormat" BO_ 923 14;
BA_ "CANFD_BRS" BO_ 923 1;
BA_ "GenMsgCycleTime" BO_ 923 100;
BA_ "GenMsgCycleTimeFast" BO_ 923 0;
BA_ "GenMsgSendType" BO_ 923 0;
BA_ "VFrameFormat" BO_ 923 14;
BA_ "CANFD_BRS" BO_ 923 1;
BA_ "GenMsgCycleTime" BO_ 923 100;
BA_ "GenMsgCycleTimeFast" BO_ 923 0;
BA_ "GenMsgSendType" BO_ 923 0;
BA_ "VFrameFormat" BO_ 923 14;
BA_ "CANFD_BRS" BO_ 923 1;
BA_ "GenMsgCycleTime" BO_ 923 100;
BA_ "GenMsgCycleTimeFast" BO_ 923 0;
BA_ "GenMsgSendType" BO_ 923 0;
BA_ "VFrameFormat" BO_ 923 14;
BA_ "CANFD_BRS" BO_ 923 1;
BA_ "GenMsgCycleTime" BO_ 923 100;
BA_ "GenMsgCycleTimeFast" BO_ 923 0;
BA_ "GenMsgSendType" BO_ 923 0;
BA_ "VFrameFormat" BO_ 923 14;
BA_ "CANFD_BRS" BO_ 923 1;
BA_ "GenMsgCycleTime" BO_ 923 100;
BA_ "GenMsgCycleTimeFast" BO_ 923 0;
BA_ "GenMsgSendType" BO_ 923 0;
BA_ "VFrameFormat" BO_ 923 14;
BA_ "CANFD_BRS" BO_ 923 1;
BA_ "GenMsgCycleTime" BO_ 923 100;
BA_ "GenMsgCycleTimeFast" BO_ 923 0;
BA_ "GenMsgSendType" BO_ 923 0;
BA_ "VFrameFormat" BO_ 923 14;
BA_ "CANFD_BRS" BO_ 923 1;
BA_ "GenMsgCycleTime" BO_ 923 100;
BA_ "GenMsgCycleTimeFast" BO_ 923 0;
BA_ "GenMsgSendType" BO_ 923 0;
BA_ "VFrameFormat" BO_ 923 14;
BA_ "CANFD_BRS" BO_ 923 1;
BA_ "GenMsgCycleTime" BO_ 923 100;
BA_ "GenMsgCycleTimeFast" BO_ 923 0;
BA_ "GenMsgSendType" BO_ 923 0;
BA_ "VFrameFormat" BO_ 923 14;
BA_ "CANFD_BRS" BO_ 923 1;
BA_ "GenMsgCycleTime" BO_ 923 100;
BA_ "GenMsgCycleTimeFast" BO_ 923 0;
BA_ "GenMsgSendType" BO_ 923 0;
BA_ "VFrameFormat" BO_ 923 14;
BA_ "CANFD_BRS" BO_ 923 1;
BA_ "GenMsgCycleTime" BO_ 923 100;
BA_ "GenMsgCycleTimeFast" BO_ 923 0;
BA_ "GenMsgSendType" BO_ 923 0;
BA_ "VFrameFormat" BO_ 923 14;
BA_ "CANFD_BRS" BO_ 923 1;
BA_ "GenMsgCycleTime" BO_ 667 50;
BA_ "GenMsgCycleTimeFast" BO_ 667 0;
BA_ "GenMsgSendType" BO_ 667 0;
BA_ "VFrameFormat" BO_ 667 14;
BA_ "CANFD_BRS" BO_ 667 1;
BA_ "GenMsgCycleTime" BO_ 667 50;
BA_ "GenMsgCycleTimeFast" BO_ 667 0;
BA_ "GenMsgSendType" BO_ 667 0;
BA_ "VFrameFormat" BO_ 667 14;
BA_ "CANFD_BRS" BO_ 667 1;
BA_ "GenMsgCycleTime" BO_ 667 50;
BA_ "GenMsgCycleTimeFast" BO_ 667 0;
BA_ "GenMsgSendType" BO_ 667 0;
BA_ "VFrameFormat" BO_ 667 14;
BA_ "CANFD_BRS" BO_ 667 1;
BA_ "GenMsgCycleTime" BO_ 667 50;
BA_ "GenMsgCycleTimeFast" BO_ 667 0;
BA_ "GenMsgSendType" BO_ 667 0;
BA_ "VFrameFormat" BO_ 667 14;
BA_ "CANFD_BRS" BO_ 667 1;
BA_ "GenMsgCycleTime" BO_ 667 50;
BA_ "GenMsgCycleTimeFast" BO_ 667 0;
BA_ "GenMsgSendType" BO_ 667 0;
BA_ "VFrameFormat" BO_ 667 14;
BA_ "CANFD_BRS" BO_ 667 1;
BA_ "GenMsgCycleTime" BO_ 667 50;
BA_ "GenMsgCycleTimeFast" BO_ 667 0;
BA_ "GenMsgSendType" BO_ 667 0;
BA_ "VFrameFormat" BO_ 667 14;
BA_ "CANFD_BRS" BO_ 667 1;
BA_ "GenMsgCycleTime" BO_ 667 50;
BA_ "GenMsgCycleTimeFast" BO_ 667 0;
BA_ "GenMsgSendType" BO_ 667 0;
BA_ "VFrameFormat" BO_ 667 14;
BA_ "CANFD_BRS" BO_ 667 1;
BA_ "GenMsgCycleTime" BO_ 667 50;
BA_ "GenMsgCycleTimeFast" BO_ 667 0;
BA_ "GenMsgSendType" BO_ 667 0;
BA_ "VFrameFormat" BO_ 667 14;
BA_ "CANFD_BRS" BO_ 667 1;
BA_ "GenMsgCycleTime" BO_ 667 50;
BA_ "GenMsgCycleTimeFast" BO_ 667 0;
BA_ "GenMsgSendType" BO_ 667 0;
BA_ "VFrameFormat" BO_ 667 14;
BA_ "CANFD_BRS" BO_ 667 1;
BA_ "GenMsgCycleTime" BO_ 667 50;
BA_ "GenMsgCycleTimeFast" BO_ 667 0;
BA_ "GenMsgSendType" BO_ 667 0;
BA_ "VFrameFormat" BO_ 667 14;
BA_ "CANFD_BRS" BO_ 667 1;
BA_ "GenMsgCycleTime" BO_ 667 50;
BA_ "GenMsgCycleTimeFast" BO_ 667 0;
BA_ "GenMsgSendType" BO_ 667 0;
BA_ "VFrameFormat" BO_ 667 14;
BA_ "CANFD_BRS" BO_ 667 1;
BA_ "GenMsgCycleTime" BO_ 667 50;
BA_ "GenMsgCycleTimeFast" BO_ 667 0;
BA_ "GenMsgSendType" BO_ 667 0;
BA_ "VFrameFormat" BO_ 667 14;
BA_ "CANFD_BRS" BO_ 667 1;
BA_ "GenMsgCycleTime" BO_ 667 50;
BA_ "GenMsgCycleTimeFast" BO_ 667 0;
BA_ "GenMsgSendType" BO_ 667 0;
BA_ "VFrameFormat" BO_ 667 14;
BA_ "CANFD_BRS" BO_ 667 1;
BA_ "GenMsgCycleTime" BO_ 667 50;
BA_ "GenMsgCycleTimeFast" BO_ 667 0;
BA_ "GenMsgSendType" BO_ 667 0;
BA_ "VFrameFormat" BO_ 667 14;
BA_ "CANFD_BRS" BO_ 667 1;
BA_ "GenMsgCycleTime" BO_ 667 50;
BA_ "GenMsgCycleTimeFast" BO_ 667 0;
BA_ "GenMsgSendType" BO_ 667 0;
BA_ "VFrameFormat" BO_ 667 14;
BA_ "CANFD_BRS" BO_ 667 1;
BA_ "GenMsgCycleTime" BO_ 667 50;
BA_ "GenMsgCycleTimeFast" BO_ 667 0;
BA_ "GenMsgSendType" BO_ 667 0;
BA_ "VFrameFormat" BO_ 667 14;
BA_ "CANFD_BRS" BO_ 667 1;
BA_ "GenMsgCycleTime" BO_ 667 50;
BA_ "GenMsgCycleTimeFast" BO_ 667 0;
BA_ "GenMsgSendType" BO_ 667 0;
BA_ "VFrameFormat" BO_ 667 14;
BA_ "CANFD_BRS" BO_ 667 1;
BA_ "GenMsgCycleTime" BO_ 667 50;
BA_ "GenMsgCycleTimeFast" BO_ 667 0;
BA_ "GenMsgSendType" BO_ 667 0;
BA_ "VFrameFormat" BO_ 667 14;
BA_ "CANFD_BRS" BO_ 667 1;
BA_ "GenMsgCycleTime" BO_ 667 50;
BA_ "GenMsgCycleTimeFast" BO_ 667 0;
BA_ "GenMsgSendType" BO_ 667 0;
BA_ "VFrameFormat" BO_ 667 14;
BA_ "CANFD_BRS" BO_ 667 1;
BA_ "GenMsgCycleTime" BO_ 667 50;
BA_ "GenMsgCycleTimeFast" BO_ 667 0;
BA_ "GenMsgSendType" BO_ 667 0;
BA_ "VFrameFormat" BO_ 667 14;
BA_ "CANFD_BRS" BO_ 667 1;
BA_ "GenMsgCycleTime" BO_ 667 50;
BA_ "GenMsgCycleTimeFast" BO_ 667 0;
BA_ "GenMsgSendType" BO_ 667 0;
BA_ "VFrameFormat" BO_ 667 14;
BA_ "CANFD_BRS" BO_ 667 1;
BA_ "GenMsgCycleTime" BO_ 667 50;
BA_ "GenMsgCycleTimeFast" BO_ 667 0;
BA_ "GenMsgSendType" BO_ 667 0;
BA_ "VFrameFormat" BO_ 667 14;
BA_ "CANFD_BRS" BO_ 667 1;
BA_ "GenMsgCycleTime" BO_ 667 50;
BA_ "GenMsgCycleTimeFast" BO_ 667 0;
BA_ "GenMsgSendType" BO_ 667 0;
BA_ "VFrameFormat" BO_ 667 14;
BA_ "CANFD_BRS" BO_ 667 1;
BA_ "GenMsgCycleTime" BO_ 667 50;
BA_ "GenMsgCycleTimeFast" BO_ 667 0;
BA_ "GenMsgSendType" BO_ 667 0;
BA_ "VFrameFormat" BO_ 667 14;
BA_ "CANFD_BRS" BO_ 667 1;
BA_ "GenMsgCycleTime" BO_ 667 50;
BA_ "GenMsgCycleTimeFast" BO_ 667 0;
BA_ "GenMsgSendType" BO_ 667 0;
BA_ "VFrameFormat" BO_ 667 14;
BA_ "CANFD_BRS" BO_ 667 1;
BA_ "GenMsgCycleTime" BO_ 667 50;
BA_ "GenMsgCycleTimeFast" BO_ 667 0;
BA_ "GenMsgSendType" BO_ 667 0;
BA_ "VFrameFormat" BO_ 667 14;
BA_ "CANFD_BRS" BO_ 667 1;
BA_ "GenMsgCycleTime" BO_ 667 50;
BA_ "GenMsgCycleTimeFast" BO_ 667 0;
BA_ "GenMsgSendType" BO_ 667 0;
BA_ "VFrameFormat" BO_ 667 14;
BA_ "CANFD_BRS" BO_ 667 1;
BA_ "GenMsgCycleTime" BO_ 667 50;
BA_ "GenMsgCycleTimeFast" BO_ 667 0;
BA_ "GenMsgSendType" BO_ 667 0;
BA_ "VFrameFormat" BO_ 667 14;
BA_ "CANFD_BRS" BO_ 667 1;
BA_ "GenMsgCycleTime" BO_ 667 50;
BA_ "GenMsgCycleTimeFast" BO_ 667 0;
BA_ "GenMsgSendType" BO_ 667 0;
BA_ "VFrameFormat" BO_ 667 14;
BA_ "CANFD_BRS" BO_ 667 1;
BA_ "GenMsgCycleTime" BO_ 667 50;
BA_ "GenMsgCycleTimeFast" BO_ 667 0;
BA_ "GenMsgSendType" BO_ 667 0;
BA_ "VFrameFormat" BO_ 667 14;
BA_ "CANFD_BRS" BO_ 667 1;
BA_ "GenMsgCycleTime" BO_ 667 50;
BA_ "GenMsgCycleTimeFast" BO_ 667 0;
BA_ "GenMsgSendType" BO_ 667 0;
BA_ "VFrameFormat" BO_ 667 14;
BA_ "CANFD_BRS" BO_ 667 1;
BA_ "GenMsgCycleTime" BO_ 667 50;
BA_ "GenMsgCycleTimeFast" BO_ 667 0;
BA_ "GenMsgSendType" BO_ 667 0;
BA_ "VFrameFormat" BO_ 667 14;
BA_ "CANFD_BRS" BO_ 667 1;
BA_ "GenMsgCycleTime" BO_ 667 50;
BA_ "GenMsgCycleTimeFast" BO_ 667 0;
BA_ "GenMsgSendType" BO_ 667 0;
BA_ "VFrameFormat" BO_ 667 14;
BA_ "CANFD_BRS" BO_ 667 1;
BA_ "GenMsgCycleTime" BO_ 667 50;
BA_ "GenMsgCycleTimeFast" BO_ 667 0;
BA_ "GenMsgSendType" BO_ 667 0;
BA_ "VFrameFormat" BO_ 667 14;
BA_ "CANFD_BRS" BO_ 667 1;
BA_ "GenMsgCycleTime" BO_ 667 50;
BA_ "GenMsgCycleTimeFast" BO_ 667 0;
BA_ "GenMsgSendType" BO_ 667 0;
BA_ "VFrameFormat" BO_ 667 14;
BA_ "CANFD_BRS" BO_ 667 1;
BA_ "GenMsgCycleTime" BO_ 667 50;
BA_ "GenMsgCycleTimeFast" BO_ 667 0;
BA_ "GenMsgSendType" BO_ 667 0;
BA_ "VFrameFormat" BO_ 667 14;
BA_ "CANFD_BRS" BO_ 667 1;
BA_ "GenMsgCycleTime" BO_ 947 100;
BA_ "GenMsgCycleTimeFast" BO_ 947 0;
BA_ "GenMsgSendType" BO_ 947 0;
BA_ "VFrameFormat" BO_ 947 14;
BA_ "CANFD_BRS" BO_ 947 1;
BA_ "GenMsgCycleTime" BO_ 947 100;
BA_ "GenMsgCycleTimeFast" BO_ 947 0;
BA_ "GenMsgSendType" BO_ 947 0;
BA_ "VFrameFormat" BO_ 947 14;
BA_ "CANFD_BRS" BO_ 947 1;
BA_ "GenMsgCycleTime" BO_ 947 100;
BA_ "GenMsgCycleTimeFast" BO_ 947 0;
BA_ "GenMsgSendType" BO_ 947 0;
BA_ "VFrameFormat" BO_ 947 14;
BA_ "CANFD_BRS" BO_ 947 1;
BA_ "GenMsgCycleTime" BO_ 947 100;
BA_ "GenMsgCycleTimeFast" BO_ 947 0;
BA_ "GenMsgSendType" BO_ 947 0;
BA_ "VFrameFormat" BO_ 947 14;
BA_ "CANFD_BRS" BO_ 947 1;
BA_ "GenMsgCycleTime" BO_ 947 100;
BA_ "GenMsgCycleTimeFast" BO_ 947 0;
BA_ "GenMsgSendType" BO_ 947 0;
BA_ "VFrameFormat" BO_ 947 14;
BA_ "CANFD_BRS" BO_ 947 1;
BA_ "GenMsgCycleTime" BO_ 947 100;
BA_ "GenMsgCycleTimeFast" BO_ 947 0;
BA_ "GenMsgSendType" BO_ 947 0;
BA_ "VFrameFormat" BO_ 947 14;
BA_ "CANFD_BRS" BO_ 947 1;
BA_ "GenMsgCycleTime" BO_ 947 100;
BA_ "GenMsgCycleTimeFast" BO_ 947 0;
BA_ "GenMsgSendType" BO_ 947 0;
BA_ "VFrameFormat" BO_ 947 14;
BA_ "CANFD_BRS" BO_ 947 1;
BA_ "GenMsgCycleTime" BO_ 947 100;
BA_ "GenMsgCycleTimeFast" BO_ 947 0;
BA_ "GenMsgSendType" BO_ 947 0;
BA_ "VFrameFormat" BO_ 947 14;
BA_ "CANFD_BRS" BO_ 947 1;
BA_ "GenMsgCycleTime" BO_ 947 100;
BA_ "GenMsgCycleTimeFast" BO_ 947 0;
BA_ "GenMsgSendType" BO_ 947 0;
BA_ "VFrameFormat" BO_ 947 14;
BA_ "CANFD_BRS" BO_ 947 1;
BA_ "GenMsgCycleTime" BO_ 947 100;
BA_ "GenMsgCycleTimeFast" BO_ 947 0;
BA_ "GenMsgSendType" BO_ 947 0;
BA_ "VFrameFormat" BO_ 947 14;
BA_ "CANFD_BRS" BO_ 947 1;
BA_ "GenMsgCycleTime" BO_ 947 100;
BA_ "GenMsgCycleTimeFast" BO_ 947 0;
BA_ "GenMsgSendType" BO_ 947 0;
BA_ "VFrameFormat" BO_ 947 14;
BA_ "CANFD_BRS" BO_ 947 1;
BA_ "GenMsgCycleTime" BO_ 947 100;
BA_ "GenMsgCycleTimeFast" BO_ 947 0;
BA_ "GenMsgSendType" BO_ 947 0;
BA_ "VFrameFormat" BO_ 947 14;
BA_ "CANFD_BRS" BO_ 947 1;
BA_ "GenMsgCycleTime" BO_ 947 100;
BA_ "GenMsgCycleTimeFast" BO_ 947 0;
BA_ "GenMsgSendType" BO_ 947 0;
BA_ "VFrameFormat" BO_ 947 14;
BA_ "CANFD_BRS" BO_ 947 1;
BA_ "GenMsgCycleTime" BO_ 947 100;
BA_ "GenMsgCycleTimeFast" BO_ 947 0;
BA_ "GenMsgSendType" BO_ 947 0;
BA_ "VFrameFormat" BO_ 947 14;
BA_ "CANFD_BRS" BO_ 947 1;
BA_ "GenMsgCycleTime" BO_ 947 100;
BA_ "GenMsgCycleTimeFast" BO_ 947 0;
BA_ "GenMsgSendType" BO_ 947 0;
BA_ "VFrameFormat" BO_ 947 14;
BA_ "CANFD_BRS" BO_ 947 1;
BA_ "GenMsgCycleTime" BO_ 947 100;
BA_ "GenMsgCycleTimeFast" BO_ 947 0;
BA_ "GenMsgSendType" BO_ 947 0;
BA_ "VFrameFormat" BO_ 947 14;
BA_ "CANFD_BRS" BO_ 947 1;
BA_ "GenMsgCycleTime" BO_ 947 100;
BA_ "GenMsgCycleTimeFast" BO_ 947 0;
BA_ "GenMsgSendType" BO_ 947 0;
BA_ "VFrameFormat" BO_ 947 14;
BA_ "CANFD_BRS" BO_ 947 1;
BA_ "GenMsgCycleTime" BO_ 947 100;
BA_ "GenMsgCycleTimeFast" BO_ 947 0;
BA_ "GenMsgSendType" BO_ 947 0;
BA_ "VFrameFormat" BO_ 947 14;
BA_ "CANFD_BRS" BO_ 947 1;
BA_ "GenMsgCycleTime" BO_ 947 100;
BA_ "GenMsgCycleTimeFast" BO_ 947 0;
BA_ "GenMsgSendType" BO_ 947 0;
BA_ "VFrameFormat" BO_ 947 14;
BA_ "CANFD_BRS" BO_ 947 1;
BA_ "GenMsgCycleTime" BO_ 947 100;
BA_ "GenMsgCycleTimeFast" BO_ 947 0;
BA_ "GenMsgSendType" BO_ 947 0;
BA_ "VFrameFormat" BO_ 947 14;
BA_ "CANFD_BRS" BO_ 947 1;
BA_ "GenMsgCycleTime" BO_ 947 100;
BA_ "GenMsgCycleTimeFast" BO_ 947 0;
BA_ "GenMsgSendType" BO_ 947 0;
BA_ "VFrameFormat" BO_ 947 14;
BA_ "CANFD_BRS" BO_ 947 1;
BA_ "GenMsgCycleTime" BO_ 947 100;
BA_ "GenMsgCycleTimeFast" BO_ 947 0;
BA_ "GenMsgSendType" BO_ 947 0;
BA_ "VFrameFormat" BO_ 947 14;
BA_ "CANFD_BRS" BO_ 947 1;
BA_ "GenMsgCycleTime" BO_ 947 100;
BA_ "GenMsgCycleTimeFast" BO_ 947 0;
BA_ "GenMsgSendType" BO_ 947 0;
BA_ "VFrameFormat" BO_ 947 14;
BA_ "CANFD_BRS" BO_ 947 1;
BA_ "GenMsgCycleTime" BO_ 947 100;
BA_ "GenMsgCycleTimeFast" BO_ 947 0;
BA_ "GenMsgSendType" BO_ 947 0;
BA_ "VFrameFormat" BO_ 947 14;
BA_ "CANFD_BRS" BO_ 947 1;
BA_ "GenMsgCycleTime" BO_ 947 100;
BA_ "GenMsgCycleTimeFast" BO_ 947 0;
BA_ "GenMsgSendType" BO_ 947 0;
BA_ "VFrameFormat" BO_ 947 14;
BA_ "CANFD_BRS" BO_ 947 1;
BA_ "GenMsgCycleTime" BO_ 947 100;
BA_ "GenMsgCycleTimeFast" BO_ 947 0;
BA_ "GenMsgSendType" BO_ 947 0;
BA_ "VFrameFormat" BO_ 947 14;
BA_ "CANFD_BRS" BO_ 947 1;
BA_ "GenMsgCycleTime" BO_ 947 100;
BA_ "GenMsgCycleTimeFast" BO_ 947 0;
BA_ "GenMsgSendType" BO_ 947 0;
BA_ "VFrameFormat" BO_ 947 14;
BA_ "CANFD_BRS" BO_ 947 1;
BA_ "GenMsgCycleTime" BO_ 947 100;
BA_ "GenMsgCycleTimeFast" BO_ 947 0;
BA_ "GenMsgSendType" BO_ 947 0;
BA_ "VFrameFormat" BO_ 947 14;
BA_ "CANFD_BRS" BO_ 947 1;
BA_ "GenMsgCycleTime" BO_ 947 100;
BA_ "GenMsgCycleTimeFast" BO_ 947 0;
BA_ "GenMsgSendType" BO_ 947 0;
BA_ "VFrameFormat" BO_ 947 14;
BA_ "CANFD_BRS" BO_ 947 1;
BA_ "GenMsgCycleTime" BO_ 947 100;
BA_ "GenMsgCycleTimeFast" BO_ 947 0;
BA_ "GenMsgSendType" BO_ 947 0;
BA_ "VFrameFormat" BO_ 947 14;
BA_ "CANFD_BRS" BO_ 947 1;
BA_ "GenMsgCycleTime" BO_ 947 100;
BA_ "GenMsgCycleTimeFast" BO_ 947 0;
BA_ "GenMsgSendType" BO_ 947 0;
BA_ "VFrameFormat" BO_ 947 14;
BA_ "CANFD_BRS" BO_ 947 1;
BA_ "GenMsgCycleTime" BO_ 947 100;
BA_ "GenMsgCycleTimeFast" BO_ 947 0;
BA_ "GenMsgSendType" BO_ 947 0;
BA_ "VFrameFormat" BO_ 947 14;
BA_ "CANFD_BRS" BO_ 947 1;
BA_ "GenMsgCycleTime" BO_ 947 100;
BA_ "GenMsgCycleTimeFast" BO_ 947 0;
BA_ "GenMsgSendType" BO_ 947 0;
BA_ "VFrameFormat" BO_ 947 14;
BA_ "CANFD_BRS" BO_ 947 1;
BA_ "GenMsgCycleTime" BO_ 947 100;
BA_ "GenMsgCycleTimeFast" BO_ 947 0;
BA_ "GenMsgSendType" BO_ 947 0;
BA_ "VFrameFormat" BO_ 947 14;
BA_ "CANFD_BRS" BO_ 947 1;
BA_ "GenMsgCycleTime" BO_ 947 100;
BA_ "GenMsgCycleTimeFast" BO_ 947 0;
BA_ "GenMsgSendType" BO_ 947 0;
BA_ "VFrameFormat" BO_ 947 14;
BA_ "CANFD_BRS" BO_ 947 1;
BA_ "GenMsgCycleTime" BO_ 947 100;
BA_ "GenMsgCycleTimeFast" BO_ 947 0;
BA_ "GenMsgSendType" BO_ 947 0;
BA_ "VFrameFormat" BO_ 947 14;
BA_ "CANFD_BRS" BO_ 947 1;
BA_ "GenMsgCycleTime" BO_ 947 100;
BA_ "GenMsgCycleTimeFast" BO_ 947 0;
BA_ "GenMsgSendType" BO_ 947 0;
BA_ "VFrameFormat" BO_ 947 14;
BA_ "CANFD_BRS" BO_ 947 1;
BA_ "GenMsgCycleTime" BO_ 947 100;
BA_ "GenMsgCycleTimeFast" BO_ 947 0;
BA_ "GenMsgSendType" BO_ 947 0;
BA_ "VFrameFormat" BO_ 947 14;
BA_ "CANFD_BRS" BO_ 947 1;
BA_ "GenMsgCycleTime" BO_ 947 100;
BA_ "GenMsgCycleTimeFast" BO_ 947 0;
BA_ "GenMsgSendType" BO_ 947 0;
BA_ "VFrameFormat" BO_ 947 14;
BA_ "CANFD_BRS" BO_ 947 1;
BA_ "GenMsgCycleTime" BO_ 947 100;
BA_ "GenMsgCycleTimeFast" BO_ 947 0;
BA_ "GenMsgSendType" BO_ 947 0;
BA_ "VFrameFormat" BO_ 947 14;
BA_ "CANFD_BRS" BO_ 947 1;
BA_ "GenMsgCycleTime" BO_ 947 100;
BA_ "GenMsgCycleTimeFast" BO_ 947 0;
BA_ "GenMsgSendType" BO_ 947 0;
BA_ "VFrameFormat" BO_ 947 14;
BA_ "CANFD_BRS" BO_ 947 1;
BA_ "GenMsgCycleTime" BO_ 947 100;
BA_ "GenMsgCycleTimeFast" BO_ 947 0;
BA_ "GenMsgSendType" BO_ 947 0;
BA_ "VFrameFormat" BO_ 947 14;
BA_ "CANFD_BRS" BO_ 947 1;
BA_ "GenMsgCycleTime" BO_ 947 100;
BA_ "GenMsgCycleTimeFast" BO_ 947 0;
BA_ "GenMsgSendType" BO_ 947 0;
BA_ "VFrameFormat" BO_ 947 14;
BA_ "CANFD_BRS" BO_ 947 1;
BA_ "GenMsgCycleTime" BO_ 947 100;
BA_ "GenMsgCycleTimeFast" BO_ 947 0;
BA_ "GenMsgSendType" BO_ 947 0;
BA_ "VFrameFormat" BO_ 947 14;
BA_ "CANFD_BRS" BO_ 947 1;
BA_ "GenMsgCycleTime" BO_ 947 100;
BA_ "GenMsgCycleTimeFast" BO_ 947 0;
BA_ "GenMsgSendType" BO_ 947 0;
BA_ "VFrameFormat" BO_ 947 14;
BA_ "CANFD_BRS" BO_ 947 1;
BA_ "GenMsgCycleTime" BO_ 947 100;
BA_ "GenMsgCycleTimeFast" BO_ 947 0;
BA_ "GenMsgSendType" BO_ 947 0;
BA_ "VFrameFormat" BO_ 947 14;
BA_ "CANFD_BRS" BO_ 947 1;
BA_ "GenMsgCycleTime" BO_ 947 100;
BA_ "GenMsgCycleTimeFast" BO_ 947 0;
BA_ "GenMsgSendType" BO_ 947 0;
BA_ "VFrameFormat" BO_ 947 14;
BA_ "CANFD_BRS" BO_ 947 1;
BA_ "GenMsgCycleTime" BO_ 947 100;
BA_ "GenMsgCycleTimeFast" BO_ 947 0;
BA_ "GenMsgSendType" BO_ 947 0;
BA_ "VFrameFormat" BO_ 947 14;
BA_ "CANFD_BRS" BO_ 947 1;
BA_ "GenMsgCycleTime" BO_ 947 100;
BA_ "GenMsgCycleTimeFast" BO_ 947 0;
BA_ "GenMsgSendType" BO_ 947 0;
BA_ "VFrameFormat" BO_ 947 14;
BA_ "CANFD_BRS" BO_ 947 1;
BA_ "GenMsgCycleTime" BO_ 947 100;
BA_ "GenMsgCycleTimeFast" BO_ 947 0;
BA_ "GenMsgSendType" BO_ 947 0;
BA_ "VFrameFormat" BO_ 947 14;
BA_ "CANFD_BRS" BO_ 947 1;
BA_ "GenMsgCycleTime" BO_ 947 100;
BA_ "GenMsgCycleTimeFast" BO_ 947 0;
BA_ "GenMsgSendType" BO_ 947 0;
BA_ "VFrameFormat" BO_ 947 14;
BA_ "CANFD_BRS" BO_ 947 1;
BA_ "GenMsgCycleTime" BO_ 170 0;
BA_ "GenMsgCycleTimeFast" BO_ 170 0;
BA_ "GenMsgSendType" BO_ 170 1;
BA_ "VFrameFormat" BO_ 170 14;
BA_ "CANFD_BRS" BO_ 170 1;
BA_ "GenMsgCycleTime" BO_ 121 0;
BA_ "GenMsgCycleTimeFast" BO_ 121 0;
BA_ "GenMsgSendType" BO_ 121 1;
BA_ "VFrameFormat" BO_ 121 14;
BA_ "CANFD_BRS" BO_ 121 1;
BA_ "GenMsgCycleTime" BO_ 175 0;
BA_ "GenMsgCycleTimeFast" BO_ 175 0;
BA_ "GenMsgSendType" BO_ 175 1;
BA_ "VFrameFormat" BO_ 175 14;
BA_ "CANFD_BRS" BO_ 175 1;
BA_ "GenMsgCycleTime" BO_ 175 0;
BA_ "GenMsgCycleTimeFast" BO_ 175 0;
BA_ "GenMsgSendType" BO_ 175 1;
BA_ "VFrameFormat" BO_ 175 14;
BA_ "CANFD_BRS" BO_ 175 1;
BA_ "GenMsgCycleTime" BO_ 175 0;
BA_ "GenMsgCycleTimeFast" BO_ 175 0;
BA_ "GenMsgSendType" BO_ 175 1;
BA_ "VFrameFormat" BO_ 175 14;
BA_ "CANFD_BRS" BO_ 175 1;
BA_ "GenMsgCycleTime" BO_ 175 0;
BA_ "GenMsgCycleTimeFast" BO_ 175 0;
BA_ "GenMsgSendType" BO_ 175 1;
BA_ "VFrameFormat" BO_ 175 14;
BA_ "CANFD_BRS" BO_ 175 1;
BA_ "GenMsgCycleTime" BO_ 175 0;
BA_ "GenMsgCycleTimeFast" BO_ 175 0;
BA_ "GenMsgSendType" BO_ 175 1;
BA_ "VFrameFormat" BO_ 175 14;
BA_ "CANFD_BRS" BO_ 175 1;
BA_ "GenMsgCycleTime" BO_ 175 0;
BA_ "GenMsgCycleTimeFast" BO_ 175 0;
BA_ "GenMsgSendType" BO_ 175 1;
BA_ "VFrameFormat" BO_ 175 14;
BA_ "CANFD_BRS" BO_ 175 1;
BA_ "GenMsgCycleTime" BO_ 175 0;
BA_ "GenMsgCycleTimeFast" BO_ 175 0;
BA_ "GenMsgSendType" BO_ 175 1;
BA_ "VFrameFormat" BO_ 175 14;
BA_ "CANFD_BRS" BO_ 175 1;
BA_ "GenMsgCycleTime" BO_ 175 0;
BA_ "GenMsgCycleTimeFast" BO_ 175 0;
BA_ "GenMsgSendType" BO_ 175 1;
BA_ "VFrameFormat" BO_ 175 14;
BA_ "CANFD_BRS" BO_ 175 1;
BA_ "GenMsgCycleTime" BO_ 175 0;
BA_ "GenMsgCycleTimeFast" BO_ 175 0;
BA_ "GenMsgSendType" BO_ 175 1;
BA_ "VFrameFormat" BO_ 175 14;
BA_ "CANFD_BRS" BO_ 175 1;
BA_ "GenMsgCycleTime" BO_ 175 0;
BA_ "GenMsgCycleTimeFast" BO_ 175 0;
BA_ "GenMsgSendType" BO_ 175 1;
BA_ "VFrameFormat" BO_ 175 14;
BA_ "CANFD_BRS" BO_ 175 1;
BA_ "GenMsgCycleTime" BO_ 175 0;
BA_ "GenMsgCycleTimeFast" BO_ 175 0;
BA_ "GenMsgSendType" BO_ 175 1;
BA_ "VFrameFormat" BO_ 175 14;
BA_ "CANFD_BRS" BO_ 175 1;
BA_ "GenMsgCycleTime" BO_ 175 0;
BA_ "GenMsgCycleTimeFast" BO_ 175 0;
BA_ "GenMsgSendType" BO_ 175 1;
BA_ "VFrameFormat" BO_ 175 14;
BA_ "CANFD_BRS" BO_ 175 1;
BA_ "GenMsgCycleTime" BO_ 175 0;
BA_ "GenMsgCycleTimeFast" BO_ 175 0;
BA_ "GenMsgSendType" BO_ 175 1;
BA_ "VFrameFormat" BO_ 175 14;
BA_ "CANFD_BRS" BO_ 175 1;
BA_ "GenMsgCycleTime" BO_ 175 0;
BA_ "GenMsgCycleTimeFast" BO_ 175 0;
BA_ "GenMsgSendType" BO_ 175 1;
BA_ "VFrameFormat" BO_ 175 14;
BA_ "CANFD_BRS" BO_ 175 1;
BA_ "GenMsgCycleTime" BO_ 175 0;
BA_ "GenMsgCycleTimeFast" BO_ 175 0;
BA_ "GenMsgSendType" BO_ 175 1;
BA_ "VFrameFormat" BO_ 175 14;
BA_ "CANFD_BRS" BO_ 175 1;
BA_ "GenMsgCycleTime" BO_ 175 0;
BA_ "GenMsgCycleTimeFast" BO_ 175 0;
BA_ "GenMsgSendType" BO_ 175 1;
BA_ "VFrameFormat" BO_ 175 14;
BA_ "CANFD_BRS" BO_ 175 1;
BA_ "GenMsgCycleTime" BO_ 175 0;
BA_ "GenMsgCycleTimeFast" BO_ 175 0;
BA_ "GenMsgSendType" BO_ 175 1;
BA_ "VFrameFormat" BO_ 175 14;
BA_ "CANFD_BRS" BO_ 175 1;
BA_ "GenMsgCycleTime" BO_ 175 0;
BA_ "GenMsgCycleTimeFast" BO_ 175 0;
BA_ "GenMsgSendType" BO_ 175 1;
BA_ "VFrameFormat" BO_ 175 14;
BA_ "CANFD_BRS" BO_ 175 1;
BA_ "GenMsgCycleTime" BO_ 175 0;
BA_ "GenMsgCycleTimeFast" BO_ 175 0;
BA_ "GenMsgSendType" BO_ 175 1;
BA_ "VFrameFormat" BO_ 175 14;
BA_ "CANFD_BRS" BO_ 175 1;
BA_ "GenMsgCycleTime" BO_ 175 0;
BA_ "GenMsgCycleTimeFast" BO_ 175 0;
BA_ "GenMsgSendType" BO_ 175 1;
BA_ "VFrameFormat" BO_ 175 14;
BA_ "CANFD_BRS" BO_ 175 1;
BA_ "EventCommandSignal" SG_ 659 ADC_5_CRC 0;
BA_ "GatewayedSignals" SG_ 659 ADC_5_CRC 0;
BA_ "GenSigInactiveValue" SG_ 659 ADC_5_CRC 0;
BA_ "GenSigInvalidValue" SG_ 659 ADC_5_CRC 0;
BA_ "GenSigSendType" SG_ 659 ADC_5_CRC 1;
BA_ "GenSigStartValue" SG_ 659 ADC_5_CRC 0;
BA_ "GenSigTimeoutValue" SG_ 659 ADC_5_CRC 0;
BA_ "Remark" SG_ 659 ADC_5_CRC "";
BA_ "EventCommandSignal" SG_ 659 ADC_5_Counter 0;
BA_ "GatewayedSignals" SG_ 659 ADC_5_Counter 0;
BA_ "GenSigInactiveValue" SG_ 659 ADC_5_Counter 0;
BA_ "GenSigInvalidValue" SG_ 659 ADC_5_Counter 0;
BA_ "GenSigSendType" SG_ 659 ADC_5_Counter 1;
BA_ "GenSigStartValue" SG_ 659 ADC_5_Counter 0;
BA_ "GenSigTimeoutValue" SG_ 659 ADC_5_Counter 0;
BA_ "Remark" SG_ 659 ADC_5_Counter "";
BA_ "EventCommandSignal" SG_ 659 ADC_NDASt 0;
BA_ "GatewayedSignals" SG_ 659 ADC_NDASt 0;
BA_ "GenSigInactiveValue" SG_ 659 ADC_NDASt 0;
BA_ "GenSigInvalidValue" SG_ 659 ADC_NDASt 0;
BA_ "GenSigSendType" SG_ 659 ADC_NDASt 1;
BA_ "GenSigStartValue" SG_ 659 ADC_NDASt 0;
BA_ "GenSigTimeoutValue" SG_ 659 ADC_NDASt 0;
BA_ "Remark" SG_ 659 ADC_NDASt "";
BA_ "EventCommandSignal" SG_ 659 ADC_NDATORType 0;
BA_ "GatewayedSignals" SG_ 659 ADC_NDATORType 0;
BA_ "GenSigInactiveValue" SG_ 659 ADC_NDATORType 0;
BA_ "GenSigInvalidValue" SG_ 659 ADC_NDATORType 0;
BA_ "GenSigSendType" SG_ 659 ADC_NDATORType 1;
BA_ "GenSigStartValue" SG_ 659 ADC_NDATORType 0;
BA_ "GenSigTimeoutValue" SG_ 659 ADC_NDATORType 0;
BA_ "Remark" SG_ 659 ADC_NDATORType "";
BA_ "EventCommandSignal" SG_ 659 ADC_NDADecideResult 0;
BA_ "GatewayedSignals" SG_ 659 ADC_NDADecideResult 0;
BA_ "GenSigInactiveValue" SG_ 659 ADC_NDADecideResult 0;
BA_ "GenSigInvalidValue" SG_ 659 ADC_NDADecideResult 0;
BA_ "GenSigSendType" SG_ 659 ADC_NDADecideResult 1;
BA_ "GenSigStartValue" SG_ 659 ADC_NDADecideResult 0;
BA_ "GenSigTimeoutValue" SG_ 659 ADC_NDADecideResult 0;
BA_ "Remark" SG_ 659 ADC_NDADecideResult "";
BA_ "EventCommandSignal" SG_ 659 ADC_NDATargetLane 0;
BA_ "GatewayedSignals" SG_ 659 ADC_NDATargetLane 0;
BA_ "GenSigInactiveValue" SG_ 659 ADC_NDATargetLane 0;
BA_ "GenSigInvalidValue" SG_ 659 ADC_NDATargetLane 0;
BA_ "GenSigSendType" SG_ 659 ADC_NDATargetLane 1;
BA_ "GenSigStartValue" SG_ 659 ADC_NDATargetLane 0;
BA_ "GenSigTimeoutValue" SG_ 659 ADC_NDATargetLane 0;
BA_ "Remark" SG_ 659 ADC_NDATargetLane "";
BA_ "EventCommandSignal" SG_ 659 ADC_NDASplitSt 0;
BA_ "GatewayedSignals" SG_ 659 ADC_NDASplitSt 0;
BA_ "GenSigInactiveValue" SG_ 659 ADC_NDASplitSt 0;
BA_ "GenSigInvalidValue" SG_ 659 ADC_NDASplitSt 0;
BA_ "GenSigSendType" SG_ 659 ADC_NDASplitSt 1;
BA_ "GenSigStartValue" SG_ 659 ADC_NDASplitSt 0;
BA_ "GenSigTimeoutValue" SG_ 659 ADC_NDASplitSt 0;
BA_ "Remark" SG_ 659 ADC_NDASplitSt "";
BA_ "EventCommandSignal" SG_ 659 ADC_NDALaneChangeOverlineTOR 0;
BA_ "GatewayedSignals" SG_ 659 ADC_NDALaneChangeOverlineTOR 0;
BA_ "GenSigInactiveValue" SG_ 659 ADC_NDALaneChangeOverlineTOR 0;
BA_ "GenSigInvalidValue" SG_ 659 ADC_NDALaneChangeOverlineTOR 0;
BA_ "GenSigSendType" SG_ 659 ADC_NDALaneChangeOverlineTOR 1;
BA_ "GenSigStartValue" SG_ 659 ADC_NDALaneChangeOverlineTOR 0;
BA_ "GenSigTimeoutValue" SG_ 659 ADC_NDALaneChangeOverlineTOR 0;
BA_ "Remark" SG_ 659 ADC_NDALaneChangeOverlineTOR "";
BA_ "EventCommandSignal" SG_ 659 ADC_ALCSuspendReason 0;
BA_ "GatewayedSignals" SG_ 659 ADC_ALCSuspendReason 0;
BA_ "GenSigInactiveValue" SG_ 659 ADC_ALCSuspendReason 0;
BA_ "GenSigInvalidValue" SG_ 659 ADC_ALCSuspendReason 0;
BA_ "GenSigSendType" SG_ 659 ADC_ALCSuspendReason 1;
BA_ "GenSigStartValue" SG_ 659 ADC_ALCSuspendReason 0;
BA_ "GenSigTimeoutValue" SG_ 659 ADC_ALCSuspendReason 0;
BA_ "Remark" SG_ 659 ADC_ALCSuspendReason "";
BA_ "EventCommandSignal" SG_ 659 ADC_SplitSuspendReason 0;
BA_ "GatewayedSignals" SG_ 659 ADC_SplitSuspendReason 0;
BA_ "GenSigInactiveValue" SG_ 659 ADC_SplitSuspendReason 0;
BA_ "GenSigInvalidValue" SG_ 659 ADC_SplitSuspendReason 0;
BA_ "GenSigSendType" SG_ 659 ADC_SplitSuspendReason 1;
BA_ "GenSigStartValue" SG_ 659 ADC_SplitSuspendReason 0;
BA_ "GenSigTimeoutValue" SG_ 659 ADC_SplitSuspendReason 0;
BA_ "Remark" SG_ 659 ADC_SplitSuspendReason "";
BA_ "EventCommandSignal" SG_ 659 ADC_NDAEnableSt 0;
BA_ "GatewayedSignals" SG_ 659 ADC_NDAEnableSt 0;
BA_ "GenSigInactiveValue" SG_ 659 ADC_NDAEnableSt 0;
BA_ "GenSigInvalidValue" SG_ 659 ADC_NDAEnableSt 0;
BA_ "GenSigSendType" SG_ 659 ADC_NDAEnableSt 1;
BA_ "GenSigStartValue" SG_ 659 ADC_NDAEnableSt 0;
BA_ "GenSigTimeoutValue" SG_ 659 ADC_NDAEnableSt 0;
BA_ "Remark" SG_ 659 ADC_NDAEnableSt "";
BA_ "EventCommandSignal" SG_ 659 ADC_NDAFailureReason 0;
BA_ "GatewayedSignals" SG_ 659 ADC_NDAFailureReason 0;
BA_ "GenSigInactiveValue" SG_ 659 ADC_NDAFailureReason 0;
BA_ "GenSigInvalidValue" SG_ 659 ADC_NDAFailureReason 0;
BA_ "GenSigSendType" SG_ 659 ADC_NDAFailureReason 1;
BA_ "GenSigStartValue" SG_ 659 ADC_NDAFailureReason 0;
BA_ "GenSigTimeoutValue" SG_ 659 ADC_NDAFailureReason 0;
BA_ "Remark" SG_ 659 ADC_NDAFailureReason "";
BA_ "EventCommandSignal" SG_ 659 ADC_NDANotactivereason 0;
BA_ "GatewayedSignals" SG_ 659 ADC_NDANotactivereason 0;
BA_ "GenSigInactiveValue" SG_ 659 ADC_NDANotactivereason 0;
BA_ "GenSigInvalidValue" SG_ 659 ADC_NDANotactivereason 0;
BA_ "GenSigSendType" SG_ 659 ADC_NDANotactivereason 1;
BA_ "GenSigStartValue" SG_ 659 ADC_NDANotactivereason 0;
BA_ "GenSigTimeoutValue" SG_ 659 ADC_NDANotactivereason 0;
BA_ "Remark" SG_ 659 ADC_NDANotactivereason "";
BA_ "EventCommandSignal" SG_ 659 ADC_NDAGeoFence 0;
BA_ "GatewayedSignals" SG_ 659 ADC_NDAGeoFence 0;
BA_ "GenSigInactiveValue" SG_ 659 ADC_NDAGeoFence 0;
BA_ "GenSigInvalidValue" SG_ 659 ADC_NDAGeoFence 0;
BA_ "GenSigSendType" SG_ 659 ADC_NDAGeoFence 1;
BA_ "GenSigStartValue" SG_ 659 ADC_NDAGeoFence 0;
BA_ "GenSigTimeoutValue" SG_ 659 ADC_NDAGeoFence 0;
BA_ "Remark" SG_ 659 ADC_NDAGeoFence "";
BA_ "EventCommandSignal" SG_ 659 ADC_NDAODDnotMeetreason 0;
BA_ "GatewayedSignals" SG_ 659 ADC_NDAODDnotMeetreason 0;
BA_ "GenSigInactiveValue" SG_ 659 ADC_NDAODDnotMeetreason 0;
BA_ "GenSigInvalidValue" SG_ 659 ADC_NDAODDnotMeetreason 0;
BA_ "GenSigSendType" SG_ 659 ADC_NDAODDnotMeetreason 1;
BA_ "GenSigStartValue" SG_ 659 ADC_NDAODDnotMeetreason 0;
BA_ "GenSigTimeoutValue" SG_ 659 ADC_NDAODDnotMeetreason 0;
BA_ "Remark" SG_ 659 ADC_NDAODDnotMeetreason "";
BA_ "EventCommandSignal" SG_ 659 ADC_ICAAvailableState 0;
BA_ "GatewayedSignals" SG_ 659 ADC_ICAAvailableState 0;
BA_ "GenSigInactiveValue" SG_ 659 ADC_ICAAvailableState 0;
BA_ "GenSigInvalidValue" SG_ 659 ADC_ICAAvailableState 0;
BA_ "GenSigSendType" SG_ 659 ADC_ICAAvailableState 1;
BA_ "GenSigStartValue" SG_ 659 ADC_ICAAvailableState 0;
BA_ "GenSigTimeoutValue" SG_ 659 ADC_ICAAvailableState 0;
BA_ "Remark" SG_ 659 ADC_ICAAvailableState "";
BA_ "EventCommandSignal" SG_ 659 ADC_ACCAvailableState 0;
BA_ "GatewayedSignals" SG_ 659 ADC_ACCAvailableState 0;
BA_ "GenSigInactiveValue" SG_ 659 ADC_ACCAvailableState 0;
BA_ "GenSigInvalidValue" SG_ 659 ADC_ACCAvailableState 0;
BA_ "GenSigSendType" SG_ 659 ADC_ACCAvailableState 1;
BA_ "GenSigStartValue" SG_ 659 ADC_ACCAvailableState 0;
BA_ "GenSigTimeoutValue" SG_ 659 ADC_ACCAvailableState 0;
BA_ "Remark" SG_ 659 ADC_ACCAvailableState "";
BA_ "EventCommandSignal" SG_ 659 ADC_NDARouteReplanning 0;
BA_ "GatewayedSignals" SG_ 659 ADC_NDARouteReplanning 0;
BA_ "GenSigInactiveValue" SG_ 659 ADC_NDARouteReplanning 0;
BA_ "GenSigInvalidValue" SG_ 659 ADC_NDARouteReplanning 0;
BA_ "GenSigSendType" SG_ 659 ADC_NDARouteReplanning 1;
BA_ "GenSigStartValue" SG_ 659 ADC_NDARouteReplanning 0;
BA_ "GenSigTimeoutValue" SG_ 659 ADC_NDARouteReplanning 0;
BA_ "Remark" SG_ 659 ADC_NDARouteReplanning "";
BA_ "EventCommandSignal" SG_ 659 ADC_SpeedLimitConfirmRequest 0;
BA_ "GatewayedSignals" SG_ 659 ADC_SpeedLimitConfirmRequest 0;
BA_ "GenSigInactiveValue" SG_ 659 ADC_SpeedLimitConfirmRequest 0;
BA_ "GenSigInvalidValue" SG_ 659 ADC_SpeedLimitConfirmRequest 0;
BA_ "GenSigSendType" SG_ 659 ADC_SpeedLimitConfirmRequest 1;
BA_ "GenSigStartValue" SG_ 659 ADC_SpeedLimitConfirmRequest 0;
BA_ "GenSigTimeoutValue" SG_ 659 ADC_SpeedLimitConfirmRequest 0;
BA_ "Remark" SG_ 659 ADC_SpeedLimitConfirmRequest "";
BA_ "EventCommandSignal" SG_ 659 ADC_LaneChangeType 0;
BA_ "GatewayedSignals" SG_ 659 ADC_LaneChangeType 0;
BA_ "GenSigInactiveValue" SG_ 659 ADC_LaneChangeType 0;
BA_ "GenSigInvalidValue" SG_ 659 ADC_LaneChangeType 0;
BA_ "GenSigSendType" SG_ 659 ADC_LaneChangeType 1;
BA_ "GenSigStartValue" SG_ 659 ADC_LaneChangeType 0;
BA_ "GenSigTimeoutValue" SG_ 659 ADC_LaneChangeType 0;
BA_ "Remark" SG_ 659 ADC_LaneChangeType "";
BA_ "EventCommandSignal" SG_ 659 ADC_LC_ZoneMatching 0;
BA_ "GatewayedSignals" SG_ 659 ADC_LC_ZoneMatching 0;
BA_ "GenSigInactiveValue" SG_ 659 ADC_LC_ZoneMatching 0;
BA_ "GenSigInvalidValue" SG_ 659 ADC_LC_ZoneMatching 0;
BA_ "GenSigSendType" SG_ 659 ADC_LC_ZoneMatching 1;
BA_ "GenSigStartValue" SG_ 659 ADC_LC_ZoneMatching 0;
BA_ "GenSigTimeoutValue" SG_ 659 ADC_LC_ZoneMatching 0;
BA_ "Remark" SG_ 659 ADC_LC_ZoneMatching "";
BA_ "EventCommandSignal" SG_ 659 ADC_RoadMergeSplitType 0;
BA_ "GatewayedSignals" SG_ 659 ADC_RoadMergeSplitType 0;
BA_ "GenSigInactiveValue" SG_ 659 ADC_RoadMergeSplitType 0;
BA_ "GenSigInvalidValue" SG_ 659 ADC_RoadMergeSplitType 0;
BA_ "GenSigSendType" SG_ 659 ADC_RoadMergeSplitType 1;
BA_ "GenSigStartValue" SG_ 659 ADC_RoadMergeSplitType 0;
BA_ "GenSigTimeoutValue" SG_ 659 ADC_RoadMergeSplitType 0;
BA_ "Remark" SG_ 659 ADC_RoadMergeSplitType "";
BA_ "EventCommandSignal" SG_ 659 ADC_LaneMergeSplitType 0;
BA_ "GatewayedSignals" SG_ 659 ADC_LaneMergeSplitType 0;
BA_ "GenSigInactiveValue" SG_ 659 ADC_LaneMergeSplitType 0;
BA_ "GenSigInvalidValue" SG_ 659 ADC_LaneMergeSplitType 0;
BA_ "GenSigSendType" SG_ 659 ADC_LaneMergeSplitType 1;
BA_ "GenSigStartValue" SG_ 659 ADC_LaneMergeSplitType 0;
BA_ "GenSigTimeoutValue" SG_ 659 ADC_LaneMergeSplitType 0;
BA_ "Remark" SG_ 659 ADC_LaneMergeSplitType "";
BA_ "EventCommandSignal" SG_ 659 ADC_EyesOn_Warning 0;
BA_ "GatewayedSignals" SG_ 659 ADC_EyesOn_Warning 0;
BA_ "GenSigInactiveValue" SG_ 659 ADC_EyesOn_Warning 0;
BA_ "GenSigInvalidValue" SG_ 659 ADC_EyesOn_Warning 0;
BA_ "GenSigSendType" SG_ 659 ADC_EyesOn_Warning 1;
BA_ "GenSigStartValue" SG_ 659 ADC_EyesOn_Warning 0;
BA_ "GenSigTimeoutValue" SG_ 659 ADC_EyesOn_Warning 0;
BA_ "Remark" SG_ 659 ADC_EyesOn_Warning "";
BA_ "EventCommandSignal" SG_ 659 ADC_TakeOverType 0;
BA_ "GatewayedSignals" SG_ 659 ADC_TakeOverType 0;
BA_ "GenSigInactiveValue" SG_ 659 ADC_TakeOverType 0;
BA_ "GenSigInvalidValue" SG_ 659 ADC_TakeOverType 0;
BA_ "GenSigSendType" SG_ 659 ADC_TakeOverType 1;
BA_ "GenSigStartValue" SG_ 659 ADC_TakeOverType 0;
BA_ "GenSigTimeoutValue" SG_ 659 ADC_TakeOverType 0;
BA_ "Remark" SG_ 659 ADC_TakeOverType "";
BA_ "EventCommandSignal" SG_ 659 ADC_TakeOverWarningLevel 0;
BA_ "GatewayedSignals" SG_ 659 ADC_TakeOverWarningLevel 0;
BA_ "GenSigInactiveValue" SG_ 659 ADC_TakeOverWarningLevel 0;
BA_ "GenSigInvalidValue" SG_ 659 ADC_TakeOverWarningLevel 0;
BA_ "GenSigSendType" SG_ 659 ADC_TakeOverWarningLevel 1;
BA_ "GenSigStartValue" SG_ 659 ADC_TakeOverWarningLevel 0;
BA_ "GenSigTimeoutValue" SG_ 659 ADC_TakeOverWarningLevel 0;
BA_ "Remark" SG_ 659 ADC_TakeOverWarningLevel "";
BA_ "EventCommandSignal" SG_ 659 ADC_NDAMRMWarningLevel 0;
BA_ "GatewayedSignals" SG_ 659 ADC_NDAMRMWarningLevel 0;
BA_ "GenSigInactiveValue" SG_ 659 ADC_NDAMRMWarningLevel 0;
BA_ "GenSigInvalidValue" SG_ 659 ADC_NDAMRMWarningLevel 0;
BA_ "GenSigSendType" SG_ 659 ADC_NDAMRMWarningLevel 1;
BA_ "GenSigStartValue" SG_ 659 ADC_NDAMRMWarningLevel 0;
BA_ "GenSigTimeoutValue" SG_ 659 ADC_NDAMRMWarningLevel 0;
BA_ "Remark" SG_ 659 ADC_NDAMRMWarningLevel "";
BA_ "EventCommandSignal" SG_ 659 ADC_ADASTransitionType 0;
BA_ "GatewayedSignals" SG_ 659 ADC_ADASTransitionType 0;
BA_ "GenSigInactiveValue" SG_ 659 ADC_ADASTransitionType 0;
BA_ "GenSigInvalidValue" SG_ 659 ADC_ADASTransitionType 0;
BA_ "GenSigSendType" SG_ 659 ADC_ADASTransitionType 1;
BA_ "GenSigStartValue" SG_ 659 ADC_ADASTransitionType 0;
BA_ "GenSigTimeoutValue" SG_ 659 ADC_ADASTransitionType 0;
BA_ "Remark" SG_ 659 ADC_ADASTransitionType "";
BA_ "EventCommandSignal" SG_ 659 ADC_FuncReq_SentryModWarn 0;
BA_ "GatewayedSignals" SG_ 659 ADC_FuncReq_SentryModWarn 0;
BA_ "GenSigInactiveValue" SG_ 659 ADC_FuncReq_SentryModWarn 0;
BA_ "GenSigInvalidValue" SG_ 659 ADC_FuncReq_SentryModWarn 0;
BA_ "GenSigSendType" SG_ 659 ADC_FuncReq_SentryModWarn 1;
BA_ "GenSigStartValue" SG_ 659 ADC_FuncReq_SentryModWarn 0;
BA_ "GenSigTimeoutValue" SG_ 659 ADC_FuncReq_SentryModWarn 0;
BA_ "Remark" SG_ 659 ADC_FuncReq_SentryModWarn "";
BA_ "EventCommandSignal" SG_ 659 ADC_TlaWarning 0;
BA_ "GatewayedSignals" SG_ 659 ADC_TlaWarning 0;
BA_ "GenSigInactiveValue" SG_ 659 ADC_TlaWarning 0;
BA_ "GenSigInvalidValue" SG_ 659 ADC_TlaWarning 0;
BA_ "GenSigSendType" SG_ 659 ADC_TlaWarning 1;
BA_ "GenSigStartValue" SG_ 659 ADC_TlaWarning 0;
BA_ "GenSigTimeoutValue" SG_ 659 ADC_TlaWarning 0;
BA_ "Remark" SG_ 659 ADC_TlaWarning "";
BA_ "EventCommandSignal" SG_ 659 ADC_TlaFault 0;
BA_ "GatewayedSignals" SG_ 659 ADC_TlaFault 0;
BA_ "GenSigInactiveValue" SG_ 659 ADC_TlaFault 0;
BA_ "GenSigInvalidValue" SG_ 659 ADC_TlaFault 0;
BA_ "GenSigSendType" SG_ 659 ADC_TlaFault 1;
BA_ "GenSigStartValue" SG_ 659 ADC_TlaFault 0;
BA_ "GenSigTimeoutValue" SG_ 659 ADC_TlaFault 0;
BA_ "Remark" SG_ 659 ADC_TlaFault "";
BA_ "EventCommandSignal" SG_ 659 ADC_FcwWaning 0;
BA_ "GatewayedSignals" SG_ 659 ADC_FcwWaning 0;
BA_ "GenSigInactiveValue" SG_ 659 ADC_FcwWaning 0;
BA_ "GenSigInvalidValue" SG_ 659 ADC_FcwWaning 0;
BA_ "GenSigSendType" SG_ 659 ADC_FcwWaning 1;
BA_ "GenSigStartValue" SG_ 659 ADC_FcwWaning 0;
BA_ "GenSigTimeoutValue" SG_ 659 ADC_FcwWaning 0;
BA_ "Remark" SG_ 659 ADC_FcwWaning "";
BA_ "EventCommandSignal" SG_ 659 ADC_AebFault 0;
BA_ "GatewayedSignals" SG_ 659 ADC_AebFault 0;
BA_ "GenSigInactiveValue" SG_ 659 ADC_AebFault 0;
BA_ "GenSigInvalidValue" SG_ 659 ADC_AebFault 0;
BA_ "GenSigSendType" SG_ 659 ADC_AebFault 1;
BA_ "GenSigStartValue" SG_ 659 ADC_AebFault 0;
BA_ "GenSigTimeoutValue" SG_ 659 ADC_AebFault 0;
BA_ "Remark" SG_ 659 ADC_AebFault "";
BA_ "EventCommandSignal" SG_ 659 ADC_RaebWarning 0;
BA_ "GatewayedSignals" SG_ 659 ADC_RaebWarning 0;
BA_ "GenSigInactiveValue" SG_ 659 ADC_RaebWarning 0;
BA_ "GenSigInvalidValue" SG_ 659 ADC_RaebWarning 0;
BA_ "GenSigSendType" SG_ 659 ADC_RaebWarning 1;
BA_ "GenSigStartValue" SG_ 659 ADC_RaebWarning 0;
BA_ "GenSigTimeoutValue" SG_ 659 ADC_RaebWarning 0;
BA_ "Remark" SG_ 659 ADC_RaebWarning "";
BA_ "EventCommandSignal" SG_ 659 ADC_RaebFault 0;
BA_ "GatewayedSignals" SG_ 659 ADC_RaebFault 0;
BA_ "GenSigInactiveValue" SG_ 659 ADC_RaebFault 0;
BA_ "GenSigInvalidValue" SG_ 659 ADC_RaebFault 0;
BA_ "GenSigSendType" SG_ 659 ADC_RaebFault 1;
BA_ "GenSigStartValue" SG_ 659 ADC_RaebFault 0;
BA_ "GenSigTimeoutValue" SG_ 659 ADC_RaebFault 0;
BA_ "Remark" SG_ 659 ADC_RaebFault "";
BA_ "EventCommandSignal" SG_ 659 ADC_RcwFault 0;
BA_ "GatewayedSignals" SG_ 659 ADC_RcwFault 0;
BA_ "GenSigInactiveValue" SG_ 659 ADC_RcwFault 0;
BA_ "GenSigInvalidValue" SG_ 659 ADC_RcwFault 0;
BA_ "GenSigSendType" SG_ 659 ADC_RcwFault 1;
BA_ "GenSigStartValue" SG_ 659 ADC_RcwFault 0;
BA_ "GenSigTimeoutValue" SG_ 659 ADC_RcwFault 0;
BA_ "Remark" SG_ 659 ADC_RcwFault "";
BA_ "EventCommandSignal" SG_ 659 ADC_FctbLeftWarning 0;
BA_ "GatewayedSignals" SG_ 659 ADC_FctbLeftWarning 0;
BA_ "GenSigInactiveValue" SG_ 659 ADC_FctbLeftWarning 0;
BA_ "GenSigInvalidValue" SG_ 659 ADC_FctbLeftWarning 0;
BA_ "GenSigSendType" SG_ 659 ADC_FctbLeftWarning 1;
BA_ "GenSigStartValue" SG_ 659 ADC_FctbLeftWarning 0;
BA_ "GenSigTimeoutValue" SG_ 659 ADC_FctbLeftWarning 0;
BA_ "Remark" SG_ 659 ADC_FctbLeftWarning "";
BA_ "EventCommandSignal" SG_ 659 ADC_FctbRightWarning 0;
BA_ "GatewayedSignals" SG_ 659 ADC_FctbRightWarning 0;
BA_ "GenSigInactiveValue" SG_ 659 ADC_FctbRightWarning 0;
BA_ "GenSigInvalidValue" SG_ 659 ADC_FctbRightWarning 0;
BA_ "GenSigSendType" SG_ 659 ADC_FctbRightWarning 1;
BA_ "GenSigStartValue" SG_ 659 ADC_FctbRightWarning 0;
BA_ "GenSigTimeoutValue" SG_ 659 ADC_FctbRightWarning 0;
BA_ "Remark" SG_ 659 ADC_FctbRightWarning "";
BA_ "EventCommandSignal" SG_ 659 ADC_RctaFault 0;
BA_ "GatewayedSignals" SG_ 659 ADC_RctaFault 0;
BA_ "GenSigInactiveValue" SG_ 659 ADC_RctaFault 0;
BA_ "GenSigInvalidValue" SG_ 659 ADC_RctaFault 0;
BA_ "GenSigSendType" SG_ 659 ADC_RctaFault 1;
BA_ "GenSigStartValue" SG_ 659 ADC_RctaFault 0;
BA_ "GenSigTimeoutValue" SG_ 659 ADC_RctaFault 0;
BA_ "Remark" SG_ 659 ADC_RctaFault "";
BA_ "EventCommandSignal" SG_ 659 ADC_RctbLeftWarning 0;
BA_ "GatewayedSignals" SG_ 659 ADC_RctbLeftWarning 0;
BA_ "GenSigInactiveValue" SG_ 659 ADC_RctbLeftWarning 0;
BA_ "GenSigInvalidValue" SG_ 659 ADC_RctbLeftWarning 0;
BA_ "GenSigSendType" SG_ 659 ADC_RctbLeftWarning 1;
BA_ "GenSigStartValue" SG_ 659 ADC_RctbLeftWarning 0;
BA_ "GenSigTimeoutValue" SG_ 659 ADC_RctbLeftWarning 0;
BA_ "Remark" SG_ 659 ADC_RctbLeftWarning "";
BA_ "EventCommandSignal" SG_ 659 ADC_RctbRightWarning 0;
BA_ "GatewayedSignals" SG_ 659 ADC_RctbRightWarning 0;
BA_ "GenSigInactiveValue" SG_ 659 ADC_RctbRightWarning 0;
BA_ "GenSigInvalidValue" SG_ 659 ADC_RctbRightWarning 0;
BA_ "GenSigSendType" SG_ 659 ADC_RctbRightWarning 1;
BA_ "GenSigStartValue" SG_ 659 ADC_RctbRightWarning 0;
BA_ "GenSigTimeoutValue" SG_ 659 ADC_RctbRightWarning 0;
BA_ "Remark" SG_ 659 ADC_RctbRightWarning "";
BA_ "EventCommandSignal" SG_ 659 ADC_LdwFault 0;
BA_ "GatewayedSignals" SG_ 659 ADC_LdwFault 0;
BA_ "GenSigInactiveValue" SG_ 659 ADC_LdwFault 0;
BA_ "GenSigInvalidValue" SG_ 659 ADC_LdwFault 0;
BA_ "GenSigSendType" SG_ 659 ADC_LdwFault 1;
BA_ "GenSigStartValue" SG_ 659 ADC_LdwFault 0;
BA_ "GenSigTimeoutValue" SG_ 659 ADC_LdwFault 0;
BA_ "Remark" SG_ 659 ADC_LdwFault "";
BA_ "EventCommandSignal" SG_ 659 ADC_LkaFault 0;
BA_ "GatewayedSignals" SG_ 659 ADC_LkaFault 0;
BA_ "GenSigInactiveValue" SG_ 659 ADC_LkaFault 0;
BA_ "GenSigInvalidValue" SG_ 659 ADC_LkaFault 0;
BA_ "GenSigSendType" SG_ 659 ADC_LkaFault 1;
BA_ "GenSigStartValue" SG_ 659 ADC_LkaFault 0;
BA_ "GenSigTimeoutValue" SG_ 659 ADC_LkaFault 0;
BA_ "Remark" SG_ 659 ADC_LkaFault "";
BA_ "EventCommandSignal" SG_ 659 ADC_BsdFault 0;
BA_ "GatewayedSignals" SG_ 659 ADC_BsdFault 0;
BA_ "GenSigInactiveValue" SG_ 659 ADC_BsdFault 0;
BA_ "GenSigInvalidValue" SG_ 659 ADC_BsdFault 0;
BA_ "GenSigSendType" SG_ 659 ADC_BsdFault 1;
BA_ "GenSigStartValue" SG_ 659 ADC_BsdFault 0;
BA_ "GenSigTimeoutValue" SG_ 659 ADC_BsdFault 0;
BA_ "Remark" SG_ 659 ADC_BsdFault "";
BA_ "EventCommandSignal" SG_ 659 ADC_DowFault 0;
BA_ "GatewayedSignals" SG_ 659 ADC_DowFault 0;
BA_ "GenSigInactiveValue" SG_ 659 ADC_DowFault 0;
BA_ "GenSigInvalidValue" SG_ 659 ADC_DowFault 0;
BA_ "GenSigSendType" SG_ 659 ADC_DowFault 1;
BA_ "GenSigStartValue" SG_ 659 ADC_DowFault 0;
BA_ "GenSigTimeoutValue" SG_ 659 ADC_DowFault 0;
BA_ "Remark" SG_ 659 ADC_DowFault "";
BA_ "EventCommandSignal" SG_ 659 ADC_TsrFault 0;
BA_ "GatewayedSignals" SG_ 659 ADC_TsrFault 0;
BA_ "GenSigInactiveValue" SG_ 659 ADC_TsrFault 0;
BA_ "GenSigInvalidValue" SG_ 659 ADC_TsrFault 0;
BA_ "GenSigSendType" SG_ 659 ADC_TsrFault 1;
BA_ "GenSigStartValue" SG_ 659 ADC_TsrFault 0;
BA_ "GenSigTimeoutValue" SG_ 659 ADC_TsrFault 0;
BA_ "Remark" SG_ 659 ADC_TsrFault "";
BA_ "EventCommandSignal" SG_ 659 ADC_ElkaWarning 0;
BA_ "GatewayedSignals" SG_ 659 ADC_ElkaWarning 0;
BA_ "GenSigInactiveValue" SG_ 659 ADC_ElkaWarning 0;
BA_ "GenSigInvalidValue" SG_ 659 ADC_ElkaWarning 0;
BA_ "GenSigSendType" SG_ 659 ADC_ElkaWarning 1;
BA_ "GenSigStartValue" SG_ 659 ADC_ElkaWarning 0;
BA_ "GenSigTimeoutValue" SG_ 659 ADC_ElkaWarning 0;
BA_ "Remark" SG_ 659 ADC_ElkaWarning "";
BA_ "EventCommandSignal" SG_ 659 ADC_ElkaFault 0;
BA_ "GatewayedSignals" SG_ 659 ADC_ElkaFault 0;
BA_ "GenSigInactiveValue" SG_ 659 ADC_ElkaFault 0;
BA_ "GenSigInvalidValue" SG_ 659 ADC_ElkaFault 0;
BA_ "GenSigSendType" SG_ 659 ADC_ElkaFault 1;
BA_ "GenSigStartValue" SG_ 659 ADC_ElkaFault 0;
BA_ "GenSigTimeoutValue" SG_ 659 ADC_ElkaFault 0;
BA_ "Remark" SG_ 659 ADC_ElkaFault "";
BA_ "EventCommandSignal" SG_ 659 ADC_TotalRefTorque_A 0;
BA_ "GatewayedSignals" SG_ 659 ADC_TotalRefTorque_A 0;
BA_ "GenSigInactiveValue" SG_ 659 ADC_TotalRefTorque_A 0;
BA_ "GenSigInvalidValue" SG_ 659 ADC_TotalRefTorque_A 0;
BA_ "GenSigSendType" SG_ 659 ADC_TotalRefTorque_A 1;
BA_ "GenSigStartValue" SG_ 659 ADC_TotalRefTorque_A 0;
BA_ "GenSigTimeoutValue" SG_ 659 ADC_TotalRefTorque_A 0;
BA_ "Remark" SG_ 659 ADC_TotalRefTorque_A "";
BA_ "EventCommandSignal" SG_ 659 ADC_IMURollingCounter 0;
BA_ "GatewayedSignals" SG_ 659 ADC_IMURollingCounter 0;
BA_ "GenSigInactiveValue" SG_ 659 ADC_IMURollingCounter 0;
BA_ "GenSigInvalidValue" SG_ 659 ADC_IMURollingCounter 0;
BA_ "GenSigSendType" SG_ 659 ADC_IMURollingCounter 1;
BA_ "GenSigStartValue" SG_ 659 ADC_IMURollingCounter 0;
BA_ "GenSigTimeoutValue" SG_ 659 ADC_IMURollingCounter 255;
BA_ "Remark" SG_ 659 ADC_IMURollingCounter "";
BA_ "EventCommandSignal" SG_ 659 ADC_IMUAccX 0;
BA_ "GatewayedSignals" SG_ 659 ADC_IMUAccX 0;
BA_ "GenSigInactiveValue" SG_ 659 ADC_IMUAccX 0;
BA_ "GenSigInvalidValue" SG_ 659 ADC_IMUAccX 0;
BA_ "GenSigSendType" SG_ 659 ADC_IMUAccX 1;
BA_ "GenSigStartValue" SG_ 659 ADC_IMUAccX 32768;
BA_ "GenSigTimeoutValue" SG_ 659 ADC_IMUAccX 65535;
BA_ "Remark" SG_ 659 ADC_IMUAccX "";
BA_ "EventCommandSignal" SG_ 659 ADC_IMUAccY 0;
BA_ "GatewayedSignals" SG_ 659 ADC_IMUAccY 0;
BA_ "GenSigInactiveValue" SG_ 659 ADC_IMUAccY 0;
BA_ "GenSigInvalidValue" SG_ 659 ADC_IMUAccY 0;
BA_ "GenSigSendType" SG_ 659 ADC_IMUAccY 1;
BA_ "GenSigStartValue" SG_ 659 ADC_IMUAccY 32768;
BA_ "GenSigTimeoutValue" SG_ 659 ADC_IMUAccY 65535;
BA_ "Remark" SG_ 659 ADC_IMUAccY "";
BA_ "EventCommandSignal" SG_ 659 ADC_IMUAccZ 0;
BA_ "GatewayedSignals" SG_ 659 ADC_IMUAccZ 0;
BA_ "GenSigInactiveValue" SG_ 659 ADC_IMUAccZ 0;
BA_ "GenSigInvalidValue" SG_ 659 ADC_IMUAccZ 0;
BA_ "GenSigSendType" SG_ 659 ADC_IMUAccZ 1;
BA_ "GenSigStartValue" SG_ 659 ADC_IMUAccZ 32768;
BA_ "GenSigTimeoutValue" SG_ 659 ADC_IMUAccZ 65535;
BA_ "Remark" SG_ 659 ADC_IMUAccZ "";
BA_ "EventCommandSignal" SG_ 659 ADC_IMUGyroX 0;
BA_ "GatewayedSignals" SG_ 659 ADC_IMUGyroX 0;
BA_ "GenSigInactiveValue" SG_ 659 ADC_IMUGyroX 0;
BA_ "GenSigInvalidValue" SG_ 659 ADC_IMUGyroX 0;
BA_ "GenSigSendType" SG_ 659 ADC_IMUGyroX 1;
BA_ "GenSigStartValue" SG_ 659 ADC_IMUGyroX 32768;
BA_ "GenSigTimeoutValue" SG_ 659 ADC_IMUGyroX 65535;
BA_ "Remark" SG_ 659 ADC_IMUGyroX "";
BA_ "EventCommandSignal" SG_ 659 ADC_IMUGyroY 0;
BA_ "GatewayedSignals" SG_ 659 ADC_IMUGyroY 0;
BA_ "GenSigInactiveValue" SG_ 659 ADC_IMUGyroY 0;
BA_ "GenSigInvalidValue" SG_ 659 ADC_IMUGyroY 0;
BA_ "GenSigSendType" SG_ 659 ADC_IMUGyroY 1;
BA_ "GenSigStartValue" SG_ 659 ADC_IMUGyroY 32768;
BA_ "GenSigTimeoutValue" SG_ 659 ADC_IMUGyroY 65535;
BA_ "Remark" SG_ 659 ADC_IMUGyroY "";
BA_ "EventCommandSignal" SG_ 659 ADC_IMUGyroZ 0;
BA_ "GatewayedSignals" SG_ 659 ADC_IMUGyroZ 0;
BA_ "GenSigInactiveValue" SG_ 659 ADC_IMUGyroZ 0;
BA_ "GenSigInvalidValue" SG_ 659 ADC_IMUGyroZ 0;
BA_ "GenSigSendType" SG_ 659 ADC_IMUGyroZ 1;
BA_ "GenSigStartValue" SG_ 659 ADC_IMUGyroZ 32768;
BA_ "GenSigTimeoutValue" SG_ 659 ADC_IMUGyroZ 65535;
BA_ "Remark" SG_ 659 ADC_IMUGyroZ "";
BA_ "EventCommandSignal" SG_ 659 ADC_IMURoll 0;
BA_ "GatewayedSignals" SG_ 659 ADC_IMURoll 0;
BA_ "GenSigInactiveValue" SG_ 659 ADC_IMURoll 0;
BA_ "GenSigInvalidValue" SG_ 659 ADC_IMURoll 0;
BA_ "GenSigSendType" SG_ 659 ADC_IMURoll 1;
BA_ "GenSigStartValue" SG_ 659 ADC_IMURoll 18000;
BA_ "GenSigTimeoutValue" SG_ 659 ADC_IMURoll 65535;
BA_ "Remark" SG_ 659 ADC_IMURoll "";
BA_ "EventCommandSignal" SG_ 659 ADC_IMUPitch 0;
BA_ "GatewayedSignals" SG_ 659 ADC_IMUPitch 0;
BA_ "GenSigInactiveValue" SG_ 659 ADC_IMUPitch 0;
BA_ "GenSigInvalidValue" SG_ 659 ADC_IMUPitch 0;
BA_ "GenSigSendType" SG_ 659 ADC_IMUPitch 1;
BA_ "GenSigStartValue" SG_ 659 ADC_IMUPitch 18000;
BA_ "GenSigTimeoutValue" SG_ 659 ADC_IMUPitch 65535;
BA_ "Remark" SG_ 659 ADC_IMUPitch "";
BA_ "EventCommandSignal" SG_ 659 ADC_IMUYaw 0;
BA_ "GatewayedSignals" SG_ 659 ADC_IMUYaw 0;
BA_ "GenSigInactiveValue" SG_ 659 ADC_IMUYaw 0;
BA_ "GenSigInvalidValue" SG_ 659 ADC_IMUYaw 0;
BA_ "GenSigSendType" SG_ 659 ADC_IMUYaw 1;
BA_ "GenSigStartValue" SG_ 659 ADC_IMUYaw 0;
BA_ "GenSigTimeoutValue" SG_ 659 ADC_IMUYaw 65535;
BA_ "Remark" SG_ 659 ADC_IMUYaw "";
BA_ "EventCommandSignal" SG_ 659 ADC_IMUTimestampVld 0;
BA_ "GatewayedSignals" SG_ 659 ADC_IMUTimestampVld 0;
BA_ "GenSigInactiveValue" SG_ 659 ADC_IMUTimestampVld 0;
BA_ "GenSigInvalidValue" SG_ 659 ADC_IMUTimestampVld 0;
BA_ "GenSigSendType" SG_ 659 ADC_IMUTimestampVld 1;
BA_ "GenSigStartValue" SG_ 659 ADC_IMUTimestampVld 0;
BA_ "GenSigTimeoutValue" SG_ 659 ADC_IMUTimestampVld 0;
BA_ "Remark" SG_ 659 ADC_IMUTimestampVld "";
BA_ "EventCommandSignal" SG_ 659 ADC_IMUAccVld 0;
BA_ "GatewayedSignals" SG_ 659 ADC_IMUAccVld 0;
BA_ "GenSigInactiveValue" SG_ 659 ADC_IMUAccVld 0;
BA_ "GenSigInvalidValue" SG_ 659 ADC_IMUAccVld 0;
BA_ "GenSigSendType" SG_ 659 ADC_IMUAccVld 1;
BA_ "GenSigStartValue" SG_ 659 ADC_IMUAccVld 0;
BA_ "GenSigTimeoutValue" SG_ 659 ADC_IMUAccVld 0;
BA_ "Remark" SG_ 659 ADC_IMUAccVld "";
BA_ "EventCommandSignal" SG_ 659 ADC_IMUGyroVld 0;
BA_ "GatewayedSignals" SG_ 659 ADC_IMUGyroVld 0;
BA_ "GenSigInactiveValue" SG_ 659 ADC_IMUGyroVld 0;
BA_ "GenSigInvalidValue" SG_ 659 ADC_IMUGyroVld 0;
BA_ "GenSigSendType" SG_ 659 ADC_IMUGyroVld 1;
BA_ "GenSigStartValue" SG_ 659 ADC_IMUGyroVld 0;
BA_ "GenSigTimeoutValue" SG_ 659 ADC_IMUGyroVld 0;
BA_ "Remark" SG_ 659 ADC_IMUGyroVld "";
BA_ "EventCommandSignal" SG_ 659 ADC_IMUAttitudeVld 0;
BA_ "GatewayedSignals" SG_ 659 ADC_IMUAttitudeVld 0;
BA_ "GenSigInactiveValue" SG_ 659 ADC_IMUAttitudeVld 0;
BA_ "GenSigInvalidValue" SG_ 659 ADC_IMUAttitudeVld 0;
BA_ "GenSigSendType" SG_ 659 ADC_IMUAttitudeVld 1;
BA_ "GenSigStartValue" SG_ 659 ADC_IMUAttitudeVld 0;
BA_ "GenSigTimeoutValue" SG_ 659 ADC_IMUAttitudeVld 0;
BA_ "Remark" SG_ 659 ADC_IMUAttitudeVld "";
BA_ "EventCommandSignal" SG_ 659 ADC_IMUPositionType 0;
BA_ "GatewayedSignals" SG_ 659 ADC_IMUPositionType 0;
BA_ "GenSigInactiveValue" SG_ 659 ADC_IMUPositionType 0;
BA_ "GenSigInvalidValue" SG_ 659 ADC_IMUPositionType 0;
BA_ "GenSigSendType" SG_ 659 ADC_IMUPositionType 1;
BA_ "GenSigStartValue" SG_ 659 ADC_IMUPositionType 0;
BA_ "GenSigTimeoutValue" SG_ 659 ADC_IMUPositionType 0;
BA_ "Remark" SG_ 659 ADC_IMUPositionType "";
BA_ "EventCommandSignal" SG_ 659 ADC_IMUTimestamp 0;
BA_ "GatewayedSignals" SG_ 659 ADC_IMUTimestamp 0;
BA_ "GenSigInactiveValue" SG_ 659 ADC_IMUTimestamp 0;
BA_ "GenSigInvalidValue" SG_ 659 ADC_IMUTimestamp 0;
BA_ "GenSigSendType" SG_ 659 ADC_IMUTimestamp 1;
BA_ "GenSigStartValue" SG_ 659 ADC_IMUTimestamp 0;
BA_ "GenSigTimeoutValue" SG_ 659 ADC_IMUTimestamp 4294967295;
BA_ "Remark" SG_ 659 ADC_IMUTimestamp "";
BA_ "EventCommandSignal" SG_ 659 ADC_AbsoultwSpeedLimit 0;
BA_ "GatewayedSignals" SG_ 659 ADC_AbsoultwSpeedLimit 0;
BA_ "GenSigInactiveValue" SG_ 659 ADC_AbsoultwSpeedLimit 0;
BA_ "GenSigInvalidValue" SG_ 659 ADC_AbsoultwSpeedLimit 0;
BA_ "GenSigSendType" SG_ 659 ADC_AbsoultwSpeedLimit 1;
BA_ "GenSigStartValue" SG_ 659 ADC_AbsoultwSpeedLimit 0;
BA_ "GenSigTimeoutValue" SG_ 659 ADC_AbsoultwSpeedLimit 0;
BA_ "Remark" SG_ 659 ADC_AbsoultwSpeedLimit "";
BA_ "EventCommandSignal" SG_ 923 ADC_6_CRC 0;
BA_ "GatewayedSignals" SG_ 923 ADC_6_CRC 0;
BA_ "GenSigInactiveValue" SG_ 923 ADC_6_CRC 0;
BA_ "GenSigInvalidValue" SG_ 923 ADC_6_CRC 0;
BA_ "GenSigSendType" SG_ 923 ADC_6_CRC 1;
BA_ "GenSigStartValue" SG_ 923 ADC_6_CRC 0;
BA_ "GenSigTimeoutValue" SG_ 923 ADC_6_CRC 0;
BA_ "Remark" SG_ 923 ADC_6_CRC "";
BA_ "EventCommandSignal" SG_ 923 ADC_6_Counter 0;
BA_ "GatewayedSignals" SG_ 923 ADC_6_Counter 0;
BA_ "GenSigInactiveValue" SG_ 923 ADC_6_Counter 0;
BA_ "GenSigInvalidValue" SG_ 923 ADC_6_Counter 0;
BA_ "GenSigSendType" SG_ 923 ADC_6_Counter 1;
BA_ "GenSigStartValue" SG_ 923 ADC_6_Counter 0;
BA_ "GenSigTimeoutValue" SG_ 923 ADC_6_Counter 0;
BA_ "Remark" SG_ 923 ADC_6_Counter "";
BA_ "EventCommandSignal" SG_ 923 ADC_FrontWideCameraSt 0;
BA_ "GatewayedSignals" SG_ 923 ADC_FrontWideCameraSt 0;
BA_ "GenSigInactiveValue" SG_ 923 ADC_FrontWideCameraSt 0;
BA_ "GenSigInvalidValue" SG_ 923 ADC_FrontWideCameraSt 0;
BA_ "GenSigSendType" SG_ 923 ADC_FrontWideCameraSt 1;
BA_ "GenSigStartValue" SG_ 923 ADC_FrontWideCameraSt 0;
BA_ "GenSigTimeoutValue" SG_ 923 ADC_FrontWideCameraSt 0;
BA_ "Remark" SG_ 923 ADC_FrontWideCameraSt "";
BA_ "EventCommandSignal" SG_ 923 ADC_FrontNarrowCameraSt 0;
BA_ "GatewayedSignals" SG_ 923 ADC_FrontNarrowCameraSt 0;
BA_ "GenSigInactiveValue" SG_ 923 ADC_FrontNarrowCameraSt 0;
BA_ "GenSigInvalidValue" SG_ 923 ADC_FrontNarrowCameraSt 0;
BA_ "GenSigSendType" SG_ 923 ADC_FrontNarrowCameraSt 1;
BA_ "GenSigStartValue" SG_ 923 ADC_FrontNarrowCameraSt 0;
BA_ "GenSigTimeoutValue" SG_ 923 ADC_FrontNarrowCameraSt 0;
BA_ "Remark" SG_ 923 ADC_FrontNarrowCameraSt "";
BA_ "EventCommandSignal" SG_ 923 ADC_LeftFrontCameraSt 0;
BA_ "GatewayedSignals" SG_ 923 ADC_LeftFrontCameraSt 0;
BA_ "GenSigInactiveValue" SG_ 923 ADC_LeftFrontCameraSt 0;
BA_ "GenSigInvalidValue" SG_ 923 ADC_LeftFrontCameraSt 0;
BA_ "GenSigSendType" SG_ 923 ADC_LeftFrontCameraSt 1;
BA_ "GenSigStartValue" SG_ 923 ADC_LeftFrontCameraSt 0;
BA_ "GenSigTimeoutValue" SG_ 923 ADC_LeftFrontCameraSt 0;
BA_ "Remark" SG_ 923 ADC_LeftFrontCameraSt "";
BA_ "EventCommandSignal" SG_ 923 ADC_LeftRearCameraSt 0;
BA_ "GatewayedSignals" SG_ 923 ADC_LeftRearCameraSt 0;
BA_ "GenSigInactiveValue" SG_ 923 ADC_LeftRearCameraSt 0;
BA_ "GenSigInvalidValue" SG_ 923 ADC_LeftRearCameraSt 0;
BA_ "GenSigSendType" SG_ 923 ADC_LeftRearCameraSt 1;
BA_ "GenSigStartValue" SG_ 923 ADC_LeftRearCameraSt 0;
BA_ "GenSigTimeoutValue" SG_ 923 ADC_LeftRearCameraSt 0;
BA_ "Remark" SG_ 923 ADC_LeftRearCameraSt "";
BA_ "EventCommandSignal" SG_ 923 ADC_RightFrontCameraSt 0;
BA_ "GatewayedSignals" SG_ 923 ADC_RightFrontCameraSt 0;
BA_ "GenSigInactiveValue" SG_ 923 ADC_RightFrontCameraSt 0;
BA_ "GenSigInvalidValue" SG_ 923 ADC_RightFrontCameraSt 0;
BA_ "GenSigSendType" SG_ 923 ADC_RightFrontCameraSt 1;
BA_ "GenSigStartValue" SG_ 923 ADC_RightFrontCameraSt 0;
BA_ "GenSigTimeoutValue" SG_ 923 ADC_RightFrontCameraSt 0;
BA_ "Remark" SG_ 923 ADC_RightFrontCameraSt "";
BA_ "EventCommandSignal" SG_ 923 ADC_RightRearCameraSt 0;
BA_ "GatewayedSignals" SG_ 923 ADC_RightRearCameraSt 0;
BA_ "GenSigInactiveValue" SG_ 923 ADC_RightRearCameraSt 0;
BA_ "GenSigInvalidValue" SG_ 923 ADC_RightRearCameraSt 0;
BA_ "GenSigSendType" SG_ 923 ADC_RightRearCameraSt 1;
BA_ "GenSigStartValue" SG_ 923 ADC_RightRearCameraSt 0;
BA_ "GenSigTimeoutValue" SG_ 923 ADC_RightRearCameraSt 0;
BA_ "Remark" SG_ 923 ADC_RightRearCameraSt "";
BA_ "EventCommandSignal" SG_ 923 ADC_RearCameraSt 0;
BA_ "GatewayedSignals" SG_ 923 ADC_RearCameraSt 0;
BA_ "GenSigInactiveValue" SG_ 923 ADC_RearCameraSt 0;
BA_ "GenSigInvalidValue" SG_ 923 ADC_RearCameraSt 0;
BA_ "GenSigSendType" SG_ 923 ADC_RearCameraSt 1;
BA_ "GenSigStartValue" SG_ 923 ADC_RearCameraSt 0;
BA_ "GenSigTimeoutValue" SG_ 923 ADC_RearCameraSt 0;
BA_ "Remark" SG_ 923 ADC_RearCameraSt "";
BA_ "EventCommandSignal" SG_ 923 ADC_FrontRadarSt 0;
BA_ "GatewayedSignals" SG_ 923 ADC_FrontRadarSt 0;
BA_ "GenSigInactiveValue" SG_ 923 ADC_FrontRadarSt 0;
BA_ "GenSigInvalidValue" SG_ 923 ADC_FrontRadarSt 0;
BA_ "GenSigSendType" SG_ 923 ADC_FrontRadarSt 1;
BA_ "GenSigStartValue" SG_ 923 ADC_FrontRadarSt 0;
BA_ "GenSigTimeoutValue" SG_ 923 ADC_FrontRadarSt 0;
BA_ "Remark" SG_ 923 ADC_FrontRadarSt "";
BA_ "EventCommandSignal" SG_ 923 ADC_LeftFrontRadarSt 0;
BA_ "GatewayedSignals" SG_ 923 ADC_LeftFrontRadarSt 0;
BA_ "GenSigInactiveValue" SG_ 923 ADC_LeftFrontRadarSt 0;
BA_ "GenSigInvalidValue" SG_ 923 ADC_LeftFrontRadarSt 0;
BA_ "GenSigSendType" SG_ 923 ADC_LeftFrontRadarSt 1;
BA_ "GenSigStartValue" SG_ 923 ADC_LeftFrontRadarSt 0;
BA_ "GenSigTimeoutValue" SG_ 923 ADC_LeftFrontRadarSt 0;
BA_ "Remark" SG_ 923 ADC_LeftFrontRadarSt "";
BA_ "EventCommandSignal" SG_ 923 ADC_LeftRearRadarSt 0;
BA_ "GatewayedSignals" SG_ 923 ADC_LeftRearRadarSt 0;
BA_ "GenSigInactiveValue" SG_ 923 ADC_LeftRearRadarSt 0;
BA_ "GenSigInvalidValue" SG_ 923 ADC_LeftRearRadarSt 0;
BA_ "GenSigSendType" SG_ 923 ADC_LeftRearRadarSt 1;
BA_ "GenSigStartValue" SG_ 923 ADC_LeftRearRadarSt 0;
BA_ "GenSigTimeoutValue" SG_ 923 ADC_LeftRearRadarSt 0;
BA_ "Remark" SG_ 923 ADC_LeftRearRadarSt "";
BA_ "EventCommandSignal" SG_ 923 ADC_RightFrontRadarSt 0;
BA_ "GatewayedSignals" SG_ 923 ADC_RightFrontRadarSt 0;
BA_ "GenSigInactiveValue" SG_ 923 ADC_RightFrontRadarSt 0;
BA_ "GenSigInvalidValue" SG_ 923 ADC_RightFrontRadarSt 0;
BA_ "GenSigSendType" SG_ 923 ADC_RightFrontRadarSt 1;
BA_ "GenSigStartValue" SG_ 923 ADC_RightFrontRadarSt 0;
BA_ "GenSigTimeoutValue" SG_ 923 ADC_RightFrontRadarSt 0;
BA_ "Remark" SG_ 923 ADC_RightFrontRadarSt "";
BA_ "EventCommandSignal" SG_ 923 ADC_RightRearRadarSt 0;
BA_ "GatewayedSignals" SG_ 923 ADC_RightRearRadarSt 0;
BA_ "GenSigInactiveValue" SG_ 923 ADC_RightRearRadarSt 0;
BA_ "GenSigInvalidValue" SG_ 923 ADC_RightRearRadarSt 0;
BA_ "GenSigSendType" SG_ 923 ADC_RightRearRadarSt 1;
BA_ "GenSigStartValue" SG_ 923 ADC_RightRearRadarSt 0;
BA_ "GenSigTimeoutValue" SG_ 923 ADC_RightRearRadarSt 0;
BA_ "Remark" SG_ 923 ADC_RightRearRadarSt "";
BA_ "EventCommandSignal" SG_ 923 ADC_RearRadarSt 0;
BA_ "GatewayedSignals" SG_ 923 ADC_RearRadarSt 0;
BA_ "GenSigInactiveValue" SG_ 923 ADC_RearRadarSt 0;
BA_ "GenSigInvalidValue" SG_ 923 ADC_RearRadarSt 0;
BA_ "GenSigSendType" SG_ 923 ADC_RearRadarSt 1;
BA_ "GenSigStartValue" SG_ 923 ADC_RearRadarSt 0;
BA_ "GenSigTimeoutValue" SG_ 923 ADC_RearRadarSt 0;
BA_ "Remark" SG_ 923 ADC_RearRadarSt "";
BA_ "EventCommandSignal" SG_ 923 ADC_FrontLidarSt 0;
BA_ "GatewayedSignals" SG_ 923 ADC_FrontLidarSt 0;
BA_ "GenSigInactiveValue" SG_ 923 ADC_FrontLidarSt 0;
BA_ "GenSigInvalidValue" SG_ 923 ADC_FrontLidarSt 0;
BA_ "GenSigSendType" SG_ 923 ADC_FrontLidarSt 1;
BA_ "GenSigStartValue" SG_ 923 ADC_FrontLidarSt 0;
BA_ "GenSigTimeoutValue" SG_ 923 ADC_FrontLidarSt 0;
BA_ "Remark" SG_ 923 ADC_FrontLidarSt "";
BA_ "EventCommandSignal" SG_ 923 ADC_LeftLidarSt 0;
BA_ "GatewayedSignals" SG_ 923 ADC_LeftLidarSt 0;
BA_ "GenSigInactiveValue" SG_ 923 ADC_LeftLidarSt 0;
BA_ "GenSigInvalidValue" SG_ 923 ADC_LeftLidarSt 0;
BA_ "GenSigSendType" SG_ 923 ADC_LeftLidarSt 1;
BA_ "GenSigStartValue" SG_ 923 ADC_LeftLidarSt 0;
BA_ "GenSigTimeoutValue" SG_ 923 ADC_LeftLidarSt 0;
BA_ "Remark" SG_ 923 ADC_LeftLidarSt "";
BA_ "EventCommandSignal" SG_ 923 ADC_RightLidarSt 0;
BA_ "GatewayedSignals" SG_ 923 ADC_RightLidarSt 0;
BA_ "GenSigInactiveValue" SG_ 923 ADC_RightLidarSt 0;
BA_ "GenSigInvalidValue" SG_ 923 ADC_RightLidarSt 0;
BA_ "GenSigSendType" SG_ 923 ADC_RightLidarSt 1;
BA_ "GenSigStartValue" SG_ 923 ADC_RightLidarSt 0;
BA_ "GenSigTimeoutValue" SG_ 923 ADC_RightLidarSt 0;
BA_ "Remark" SG_ 923 ADC_RightLidarSt "";
BA_ "EventCommandSignal" SG_ 923 ADC_SunroofOpenCloseReq 0;
BA_ "GatewayedSignals" SG_ 923 ADC_SunroofOpenCloseReq 0;
BA_ "GenSigInactiveValue" SG_ 923 ADC_SunroofOpenCloseReq 0;
BA_ "GenSigInvalidValue" SG_ 923 ADC_SunroofOpenCloseReq 0;
BA_ "GenSigSendType" SG_ 923 ADC_SunroofOpenCloseReq 1;
BA_ "GenSigStartValue" SG_ 923 ADC_SunroofOpenCloseReq 0;
BA_ "GenSigTimeoutValue" SG_ 923 ADC_SunroofOpenCloseReq 0;
BA_ "Remark" SG_ 923 ADC_SunroofOpenCloseReq "";
BA_ "EventCommandSignal" SG_ 923 ADC_SentryStatus 0;
BA_ "GatewayedSignals" SG_ 923 ADC_SentryStatus 0;
BA_ "GenSigInactiveValue" SG_ 923 ADC_SentryStatus 0;
BA_ "GenSigInvalidValue" SG_ 923 ADC_SentryStatus 0;
BA_ "GenSigSendType" SG_ 923 ADC_SentryStatus 1;
BA_ "GenSigStartValue" SG_ 923 ADC_SentryStatus 0;
BA_ "GenSigTimeoutValue" SG_ 923 ADC_SentryStatus 0;
BA_ "Remark" SG_ 923 ADC_SentryStatus "";
BA_ "EventCommandSignal" SG_ 923 ADC_SOCWakeupHVReq 0;
BA_ "GatewayedSignals" SG_ 923 ADC_SOCWakeupHVReq 0;
BA_ "GenSigInactiveValue" SG_ 923 ADC_SOCWakeupHVReq 0;
BA_ "GenSigInvalidValue" SG_ 923 ADC_SOCWakeupHVReq 0;
BA_ "GenSigSendType" SG_ 923 ADC_SOCWakeupHVReq 1;
BA_ "GenSigStartValue" SG_ 923 ADC_SOCWakeupHVReq 0;
BA_ "GenSigTimeoutValue" SG_ 923 ADC_SOCWakeupHVReq 0;
BA_ "Remark" SG_ 923 ADC_SOCWakeupHVReq "";
BA_ "EventCommandSignal" SG_ 923 ADC_SystemState 0;
BA_ "GatewayedSignals" SG_ 923 ADC_SystemState 0;
BA_ "GenSigInactiveValue" SG_ 923 ADC_SystemState 0;
BA_ "GenSigInvalidValue" SG_ 923 ADC_SystemState 15;
BA_ "GenSigSendType" SG_ 923 ADC_SystemState 1;
BA_ "GenSigStartValue" SG_ 923 ADC_SystemState 0;
BA_ "GenSigTimeoutValue" SG_ 923 ADC_SystemState 0;
BA_ "Remark" SG_ 923 ADC_SystemState "";
BA_ "EventCommandSignal" SG_ 923 ADC_HWFailureReason 0;
BA_ "GatewayedSignals" SG_ 923 ADC_HWFailureReason 0;
BA_ "GenSigInactiveValue" SG_ 923 ADC_HWFailureReason 0;
BA_ "GenSigInvalidValue" SG_ 923 ADC_HWFailureReason 0;
BA_ "GenSigSendType" SG_ 923 ADC_HWFailureReason 1;
BA_ "GenSigStartValue" SG_ 923 ADC_HWFailureReason 0;
BA_ "GenSigTimeoutValue" SG_ 923 ADC_HWFailureReason 0;
BA_ "Remark" SG_ 923 ADC_HWFailureReason "";
BA_ "EventCommandSignal" SG_ 923 ADC_SWFailureReason 0;
BA_ "GatewayedSignals" SG_ 923 ADC_SWFailureReason 0;
BA_ "GenSigInactiveValue" SG_ 923 ADC_SWFailureReason 0;
BA_ "GenSigInvalidValue" SG_ 923 ADC_SWFailureReason 0;
BA_ "GenSigSendType" SG_ 923 ADC_SWFailureReason 1;
BA_ "GenSigStartValue" SG_ 923 ADC_SWFailureReason 0;
BA_ "GenSigTimeoutValue" SG_ 923 ADC_SWFailureReason 0;
BA_ "Remark" SG_ 923 ADC_SWFailureReason "";
BA_ "EventCommandSignal" SG_ 923 mountAngleIndicator_az 0;
BA_ "GatewayedSignals" SG_ 923 mountAngleIndicator_az 0;
BA_ "GenSigInactiveValue" SG_ 923 mountAngleIndicator_az 0;
BA_ "GenSigInvalidValue" SG_ 923 mountAngleIndicator_az 0;
BA_ "GenSigSendType" SG_ 923 mountAngleIndicator_az 1;
BA_ "GenSigStartValue" SG_ 923 mountAngleIndicator_az 0;
BA_ "GenSigTimeoutValue" SG_ 923 mountAngleIndicator_az 0;
BA_ "Remark" SG_ 923 mountAngleIndicator_az "";
BA_ "EventCommandSignal" SG_ 923 mountAngleCurrent_az 0;
BA_ "GatewayedSignals" SG_ 923 mountAngleCurrent_az 0;
BA_ "GenSigInactiveValue" SG_ 923 mountAngleCurrent_az 0;
BA_ "GenSigInvalidValue" SG_ 923 mountAngleCurrent_az 0;
BA_ "GenSigSendType" SG_ 923 mountAngleCurrent_az 1;
BA_ "GenSigStartValue" SG_ 923 mountAngleCurrent_az 0;
BA_ "GenSigTimeoutValue" SG_ 923 mountAngleCurrent_az 0;
BA_ "Remark" SG_ 923 mountAngleCurrent_az "";
BA_ "EventCommandSignal" SG_ 923 mountAngleIndicator_el 0;
BA_ "GatewayedSignals" SG_ 923 mountAngleIndicator_el 0;
BA_ "GenSigInactiveValue" SG_ 923 mountAngleIndicator_el 0;
BA_ "GenSigInvalidValue" SG_ 923 mountAngleIndicator_el 0;
BA_ "GenSigSendType" SG_ 923 mountAngleIndicator_el 1;
BA_ "GenSigStartValue" SG_ 923 mountAngleIndicator_el 0;
BA_ "GenSigTimeoutValue" SG_ 923 mountAngleIndicator_el 0;
BA_ "Remark" SG_ 923 mountAngleIndicator_el "";
BA_ "EventCommandSignal" SG_ 923 mountAngleCurrent_el 0;
BA_ "GatewayedSignals" SG_ 923 mountAngleCurrent_el 0;
BA_ "GenSigInactiveValue" SG_ 923 mountAngleCurrent_el 0;
BA_ "GenSigInvalidValue" SG_ 923 mountAngleCurrent_el 0;
BA_ "GenSigSendType" SG_ 923 mountAngleCurrent_el 1;
BA_ "GenSigStartValue" SG_ 923 mountAngleCurrent_el 0;
BA_ "GenSigTimeoutValue" SG_ 923 mountAngleCurrent_el 0;
BA_ "Remark" SG_ 923 mountAngleCurrent_el "";
BA_ "EventCommandSignal" SG_ 923 malStablePosEl 0;
BA_ "GatewayedSignals" SG_ 923 malStablePosEl 0;
BA_ "GenSigInactiveValue" SG_ 923 malStablePosEl 0;
BA_ "GenSigInvalidValue" SG_ 923 malStablePosEl 0;
BA_ "GenSigSendType" SG_ 923 malStablePosEl 1;
BA_ "GenSigStartValue" SG_ 923 malStablePosEl 0;
BA_ "GenSigTimeoutValue" SG_ 923 malStablePosEl 0;
BA_ "Remark" SG_ 923 malStablePosEl "";
BA_ "EventCommandSignal" SG_ 923 malStablePosAz 0;
BA_ "GatewayedSignals" SG_ 923 malStablePosAz 0;
BA_ "GenSigInactiveValue" SG_ 923 malStablePosAz 0;
BA_ "GenSigInvalidValue" SG_ 923 malStablePosAz 0;
BA_ "GenSigSendType" SG_ 923 malStablePosAz 1;
BA_ "GenSigStartValue" SG_ 923 malStablePosAz 0;
BA_ "GenSigTimeoutValue" SG_ 923 malStablePosAz 0;
BA_ "Remark" SG_ 923 malStablePosAz "";
BA_ "EventCommandSignal" SG_ 923 AngleEMEIndicatorEl 0;
BA_ "GatewayedSignals" SG_ 923 AngleEMEIndicatorEl 0;
BA_ "GenSigInactiveValue" SG_ 923 AngleEMEIndicatorEl 0;
BA_ "GenSigInvalidValue" SG_ 923 AngleEMEIndicatorEl 0;
BA_ "GenSigSendType" SG_ 923 AngleEMEIndicatorEl 1;
BA_ "GenSigStartValue" SG_ 923 AngleEMEIndicatorEl 0;
BA_ "GenSigTimeoutValue" SG_ 923 AngleEMEIndicatorEl 0;
BA_ "Remark" SG_ 923 AngleEMEIndicatorEl "";
BA_ "EventCommandSignal" SG_ 923 AngleEMEIndicatorAz 0;
BA_ "GatewayedSignals" SG_ 923 AngleEMEIndicatorAz 0;
BA_ "GenSigInactiveValue" SG_ 923 AngleEMEIndicatorAz 0;
BA_ "GenSigInvalidValue" SG_ 923 AngleEMEIndicatorAz 0;
BA_ "GenSigSendType" SG_ 923 AngleEMEIndicatorAz 1;
BA_ "GenSigStartValue" SG_ 923 AngleEMEIndicatorAz 0;
BA_ "GenSigTimeoutValue" SG_ 923 AngleEMEIndicatorAz 0;
BA_ "Remark" SG_ 923 AngleEMEIndicatorAz "";
BA_ "EventCommandSignal" SG_ 923 highSpreadIndicator_el 0;
BA_ "GatewayedSignals" SG_ 923 highSpreadIndicator_el 0;
BA_ "GenSigInactiveValue" SG_ 923 highSpreadIndicator_el 0;
BA_ "GenSigInvalidValue" SG_ 923 highSpreadIndicator_el 0;
BA_ "GenSigSendType" SG_ 923 highSpreadIndicator_el 1;
BA_ "GenSigStartValue" SG_ 923 highSpreadIndicator_el 0;
BA_ "GenSigTimeoutValue" SG_ 923 highSpreadIndicator_el 0;
BA_ "Remark" SG_ 923 highSpreadIndicator_el "";
BA_ "EventCommandSignal" SG_ 923 highSpreadIndicator_az 0;
BA_ "GatewayedSignals" SG_ 923 highSpreadIndicator_az 0;
BA_ "GenSigInactiveValue" SG_ 923 highSpreadIndicator_az 0;
BA_ "GenSigInvalidValue" SG_ 923 highSpreadIndicator_az 0;
BA_ "GenSigSendType" SG_ 923 highSpreadIndicator_az 1;
BA_ "GenSigStartValue" SG_ 923 highSpreadIndicator_az 0;
BA_ "GenSigTimeoutValue" SG_ 923 highSpreadIndicator_az 0;
BA_ "Remark" SG_ 923 highSpreadIndicator_az "";
BA_ "EventCommandSignal" SG_ 923 Fault_MAL_HOR_ABS_EVENT 0;
BA_ "GatewayedSignals" SG_ 923 Fault_MAL_HOR_ABS_EVENT 0;
BA_ "GenSigInactiveValue" SG_ 923 Fault_MAL_HOR_ABS_EVENT 0;
BA_ "GenSigInvalidValue" SG_ 923 Fault_MAL_HOR_ABS_EVENT 0;
BA_ "GenSigSendType" SG_ 923 Fault_MAL_HOR_ABS_EVENT 1;
BA_ "GenSigStartValue" SG_ 923 Fault_MAL_HOR_ABS_EVENT 0;
BA_ "GenSigTimeoutValue" SG_ 923 Fault_MAL_HOR_ABS_EVENT 0;
BA_ "Remark" SG_ 923 Fault_MAL_HOR_ABS_EVENT "";
BA_ "EventCommandSignal" SG_ 923 Fault_MAL_HOR_REL_EVENT 0;
BA_ "GatewayedSignals" SG_ 923 Fault_MAL_HOR_REL_EVENT 0;
BA_ "GenSigInactiveValue" SG_ 923 Fault_MAL_HOR_REL_EVENT 0;
BA_ "GenSigInvalidValue" SG_ 923 Fault_MAL_HOR_REL_EVENT 0;
BA_ "GenSigSendType" SG_ 923 Fault_MAL_HOR_REL_EVENT 1;
BA_ "GenSigStartValue" SG_ 923 Fault_MAL_HOR_REL_EVENT 0;
BA_ "GenSigTimeoutValue" SG_ 923 Fault_MAL_HOR_REL_EVENT 0;
BA_ "Remark" SG_ 923 Fault_MAL_HOR_REL_EVENT "";
BA_ "EventCommandSignal" SG_ 923 Fault_MAL_VER_ABS_EVENT 0;
BA_ "GatewayedSignals" SG_ 923 Fault_MAL_VER_ABS_EVENT 0;
BA_ "GenSigInactiveValue" SG_ 923 Fault_MAL_VER_ABS_EVENT 0;
BA_ "GenSigInvalidValue" SG_ 923 Fault_MAL_VER_ABS_EVENT 0;
BA_ "GenSigSendType" SG_ 923 Fault_MAL_VER_ABS_EVENT 1;
BA_ "GenSigStartValue" SG_ 923 Fault_MAL_VER_ABS_EVENT 0;
BA_ "GenSigTimeoutValue" SG_ 923 Fault_MAL_VER_ABS_EVENT 0;
BA_ "Remark" SG_ 923 Fault_MAL_VER_ABS_EVENT "";
BA_ "EventCommandSignal" SG_ 923 Fault_MAL_VER_REL_EVENT 0;
BA_ "GatewayedSignals" SG_ 923 Fault_MAL_VER_REL_EVENT 0;
BA_ "GenSigInactiveValue" SG_ 923 Fault_MAL_VER_REL_EVENT 0;
BA_ "GenSigInvalidValue" SG_ 923 Fault_MAL_VER_REL_EVENT 0;
BA_ "GenSigSendType" SG_ 923 Fault_MAL_VER_REL_EVENT 1;
BA_ "GenSigStartValue" SG_ 923 Fault_MAL_VER_REL_EVENT 0;
BA_ "GenSigTimeoutValue" SG_ 923 Fault_MAL_VER_REL_EVENT 0;
BA_ "Remark" SG_ 923 Fault_MAL_VER_REL_EVENT "";
BA_ "EventCommandSignal" SG_ 923 FilteredPhiSpread 0;
BA_ "GatewayedSignals" SG_ 923 FilteredPhiSpread 0;
BA_ "GenSigInactiveValue" SG_ 923 FilteredPhiSpread 0;
BA_ "GenSigInvalidValue" SG_ 923 FilteredPhiSpread 0;
BA_ "GenSigSendType" SG_ 923 FilteredPhiSpread 1;
BA_ "GenSigStartValue" SG_ 923 FilteredPhiSpread 0;
BA_ "GenSigTimeoutValue" SG_ 923 FilteredPhiSpread 0;
BA_ "Remark" SG_ 923 FilteredPhiSpread "";
BA_ "EventCommandSignal" SG_ 923 elOutOfSpecCause 0;
BA_ "GatewayedSignals" SG_ 923 elOutOfSpecCause 0;
BA_ "GenSigInactiveValue" SG_ 923 elOutOfSpecCause 0;
BA_ "GenSigInvalidValue" SG_ 923 elOutOfSpecCause 0;
BA_ "GenSigSendType" SG_ 923 elOutOfSpecCause 1;
BA_ "GenSigStartValue" SG_ 923 elOutOfSpecCause 0;
BA_ "GenSigTimeoutValue" SG_ 923 elOutOfSpecCause 0;
BA_ "Remark" SG_ 923 elOutOfSpecCause "";
BA_ "EventCommandSignal" SG_ 923 azOutOfSpecCause 0;
BA_ "GatewayedSignals" SG_ 923 azOutOfSpecCause 0;
BA_ "GenSigInactiveValue" SG_ 923 azOutOfSpecCause 0;
BA_ "GenSigInvalidValue" SG_ 923 azOutOfSpecCause 0;
BA_ "GenSigSendType" SG_ 923 azOutOfSpecCause 1;
BA_ "GenSigStartValue" SG_ 923 azOutOfSpecCause 0;
BA_ "GenSigTimeoutValue" SG_ 923 azOutOfSpecCause 0;
BA_ "Remark" SG_ 923 azOutOfSpecCause "";
BA_ "EventCommandSignal" SG_ 923 azOutOfProfileCause 0;
BA_ "GatewayedSignals" SG_ 923 azOutOfProfileCause 0;
BA_ "GenSigInactiveValue" SG_ 923 azOutOfProfileCause 0;
BA_ "GenSigInvalidValue" SG_ 923 azOutOfProfileCause 0;
BA_ "GenSigSendType" SG_ 923 azOutOfProfileCause 1;
BA_ "GenSigStartValue" SG_ 923 azOutOfProfileCause 0;
BA_ "GenSigTimeoutValue" SG_ 923 azOutOfProfileCause 0;
BA_ "Remark" SG_ 923 azOutOfProfileCause "";
BA_ "EventCommandSignal" SG_ 923 elOutOfProfileCause 0;
BA_ "GatewayedSignals" SG_ 923 elOutOfProfileCause 0;
BA_ "GenSigInactiveValue" SG_ 923 elOutOfProfileCause 0;
BA_ "GenSigInvalidValue" SG_ 923 elOutOfProfileCause 0;
BA_ "GenSigSendType" SG_ 923 elOutOfProfileCause 1;
BA_ "GenSigStartValue" SG_ 923 elOutOfProfileCause 0;
BA_ "GenSigTimeoutValue" SG_ 923 elOutOfProfileCause 0;
BA_ "Remark" SG_ 923 elOutOfProfileCause "";
BA_ "EventCommandSignal" SG_ 923 ADC_FuncReq_SentryModDetec 0;
BA_ "GatewayedSignals" SG_ 923 ADC_FuncReq_SentryModDetec 0;
BA_ "GenSigInactiveValue" SG_ 923 ADC_FuncReq_SentryModDetec 0;
BA_ "GenSigInvalidValue" SG_ 923 ADC_FuncReq_SentryModDetec 0;
BA_ "GenSigSendType" SG_ 923 ADC_FuncReq_SentryModDetec 1;
BA_ "GenSigStartValue" SG_ 923 ADC_FuncReq_SentryModDetec 0;
BA_ "GenSigTimeoutValue" SG_ 923 ADC_FuncReq_SentryModDetec 0;
BA_ "Remark" SG_ 923 ADC_FuncReq_SentryModDetec "";
BA_ "EventCommandSignal" SG_ 667 ADC_7_CRC 0;
BA_ "GatewayedSignals" SG_ 667 ADC_7_CRC 0;
BA_ "GenSigInactiveValue" SG_ 667 ADC_7_CRC 0;
BA_ "GenSigInvalidValue" SG_ 667 ADC_7_CRC 0;
BA_ "GenSigSendType" SG_ 667 ADC_7_CRC 1;
BA_ "GenSigStartValue" SG_ 667 ADC_7_CRC 0;
BA_ "GenSigTimeoutValue" SG_ 667 ADC_7_CRC 0;
BA_ "Remark" SG_ 667 ADC_7_CRC "";
BA_ "EventCommandSignal" SG_ 667 ADC_7_Counter 0;
BA_ "GatewayedSignals" SG_ 667 ADC_7_Counter 0;
BA_ "GenSigInactiveValue" SG_ 667 ADC_7_Counter 0;
BA_ "GenSigInvalidValue" SG_ 667 ADC_7_Counter 0;
BA_ "GenSigSendType" SG_ 667 ADC_7_Counter 1;
BA_ "GenSigStartValue" SG_ 667 ADC_7_Counter 0;
BA_ "GenSigTimeoutValue" SG_ 667 ADC_7_Counter 0;
BA_ "Remark" SG_ 667 ADC_7_Counter "";
BA_ "EventCommandSignal" SG_ 667 ADC_LatVMC_A0 0;
BA_ "GatewayedSignals" SG_ 667 ADC_LatVMC_A0 0;
BA_ "GenSigInactiveValue" SG_ 667 ADC_LatVMC_A0 0;
BA_ "GenSigInvalidValue" SG_ 667 ADC_LatVMC_A0 2047;
BA_ "GenSigSendType" SG_ 667 ADC_LatVMC_A0 1;
BA_ "GenSigStartValue" SG_ 667 ADC_LatVMC_A0 1023;
BA_ "GenSigTimeoutValue" SG_ 667 ADC_LatVMC_A0 0;
BA_ "Remark" SG_ 667 ADC_LatVMC_A0 "";
BA_ "EventCommandSignal" SG_ 667 ADC_LatVMC_A1 0;
BA_ "GatewayedSignals" SG_ 667 ADC_LatVMC_A1 0;
BA_ "GenSigInactiveValue" SG_ 667 ADC_LatVMC_A1 0;
BA_ "GenSigInvalidValue" SG_ 667 ADC_LatVMC_A1 2047;
BA_ "GenSigSendType" SG_ 667 ADC_LatVMC_A1 1;
BA_ "GenSigStartValue" SG_ 667 ADC_LatVMC_A1 1023;
BA_ "GenSigTimeoutValue" SG_ 667 ADC_LatVMC_A1 0;
BA_ "Remark" SG_ 667 ADC_LatVMC_A1 "";
BA_ "EventCommandSignal" SG_ 667 ADC_LatVMC_A2 0;
BA_ "GatewayedSignals" SG_ 667 ADC_LatVMC_A2 0;
BA_ "GenSigInactiveValue" SG_ 667 ADC_LatVMC_A2 0;
BA_ "GenSigInvalidValue" SG_ 667 ADC_LatVMC_A2 2047;
BA_ "GenSigSendType" SG_ 667 ADC_LatVMC_A2 1;
BA_ "GenSigStartValue" SG_ 667 ADC_LatVMC_A2 1023;
BA_ "GenSigTimeoutValue" SG_ 667 ADC_LatVMC_A2 0;
BA_ "Remark" SG_ 667 ADC_LatVMC_A2 "";
BA_ "EventCommandSignal" SG_ 667 ADC_LatVMC_A3 0;
BA_ "GatewayedSignals" SG_ 667 ADC_LatVMC_A3 0;
BA_ "GenSigInactiveValue" SG_ 667 ADC_LatVMC_A3 0;
BA_ "GenSigInvalidValue" SG_ 667 ADC_LatVMC_A3 2047;
BA_ "GenSigSendType" SG_ 667 ADC_LatVMC_A3 1;
BA_ "GenSigStartValue" SG_ 667 ADC_LatVMC_A3 1023;
BA_ "GenSigTimeoutValue" SG_ 667 ADC_LatVMC_A3 0;
BA_ "Remark" SG_ 667 ADC_LatVMC_A3 "";
BA_ "EventCommandSignal" SG_ 667 ADC_LatVMC_conf 0;
BA_ "GatewayedSignals" SG_ 667 ADC_LatVMC_conf 0;
BA_ "GenSigInactiveValue" SG_ 667 ADC_LatVMC_conf 0;
BA_ "GenSigInvalidValue" SG_ 667 ADC_LatVMC_conf 0;
BA_ "GenSigSendType" SG_ 667 ADC_LatVMC_conf 1;
BA_ "GenSigStartValue" SG_ 667 ADC_LatVMC_conf 0;
BA_ "GenSigTimeoutValue" SG_ 667 ADC_LatVMC_conf 0;
BA_ "Remark" SG_ 667 ADC_LatVMC_conf "";
BA_ "EventCommandSignal" SG_ 667 ADC_LatVMC_Range 0;
BA_ "GatewayedSignals" SG_ 667 ADC_LatVMC_Range 0;
BA_ "GenSigInactiveValue" SG_ 667 ADC_LatVMC_Range 0;
BA_ "GenSigInvalidValue" SG_ 667 ADC_LatVMC_Range 0;
BA_ "GenSigSendType" SG_ 667 ADC_LatVMC_Range 1;
BA_ "GenSigStartValue" SG_ 667 ADC_LatVMC_Range 0;
BA_ "GenSigTimeoutValue" SG_ 667 ADC_LatVMC_Range 0;
BA_ "Remark" SG_ 667 ADC_LatVMC_Range "";
BA_ "EventCommandSignal" SG_ 667 ADC_LLnMrking_A0 0;
BA_ "GatewayedSignals" SG_ 667 ADC_LLnMrking_A0 0;
BA_ "GenSigInactiveValue" SG_ 667 ADC_LLnMrking_A0 0;
BA_ "GenSigInvalidValue" SG_ 667 ADC_LLnMrking_A0 2047;
BA_ "GenSigSendType" SG_ 667 ADC_LLnMrking_A0 1;
BA_ "GenSigStartValue" SG_ 667 ADC_LLnMrking_A0 1023;
BA_ "GenSigTimeoutValue" SG_ 667 ADC_LLnMrking_A0 0;
BA_ "Remark" SG_ 667 ADC_LLnMrking_A0 "";
BA_ "EventCommandSignal" SG_ 667 ADC_LLnMrking_A1 0;
BA_ "GatewayedSignals" SG_ 667 ADC_LLnMrking_A1 0;
BA_ "GenSigInactiveValue" SG_ 667 ADC_LLnMrking_A1 0;
BA_ "GenSigInvalidValue" SG_ 667 ADC_LLnMrking_A1 2047;
BA_ "GenSigSendType" SG_ 667 ADC_LLnMrking_A1 1;
BA_ "GenSigStartValue" SG_ 667 ADC_LLnMrking_A1 1023;
BA_ "GenSigTimeoutValue" SG_ 667 ADC_LLnMrking_A1 0;
BA_ "Remark" SG_ 667 ADC_LLnMrking_A1 "";
BA_ "EventCommandSignal" SG_ 667 ADC_LLnMrking_A2 0;
BA_ "GatewayedSignals" SG_ 667 ADC_LLnMrking_A2 0;
BA_ "GenSigInactiveValue" SG_ 667 ADC_LLnMrking_A2 0;
BA_ "GenSigInvalidValue" SG_ 667 ADC_LLnMrking_A2 2047;
BA_ "GenSigSendType" SG_ 667 ADC_LLnMrking_A2 1;
BA_ "GenSigStartValue" SG_ 667 ADC_LLnMrking_A2 1023;
BA_ "GenSigTimeoutValue" SG_ 667 ADC_LLnMrking_A2 0;
BA_ "Remark" SG_ 667 ADC_LLnMrking_A2 "";
BA_ "EventCommandSignal" SG_ 667 ADC_LLnMrking_conf 0;
BA_ "GatewayedSignals" SG_ 667 ADC_LLnMrking_conf 0;
BA_ "GenSigInactiveValue" SG_ 667 ADC_LLnMrking_conf 0;
BA_ "GenSigInvalidValue" SG_ 667 ADC_LLnMrking_conf 100;
BA_ "GenSigSendType" SG_ 667 ADC_LLnMrking_conf 1;
BA_ "GenSigStartValue" SG_ 667 ADC_LLnMrking_conf 0;
BA_ "GenSigTimeoutValue" SG_ 667 ADC_LLnMrking_conf 0;
BA_ "Remark" SG_ 667 ADC_LLnMrking_conf "";
BA_ "EventCommandSignal" SG_ 667 ADC_LlnMrkingDispSt 0;
BA_ "GatewayedSignals" SG_ 667 ADC_LlnMrkingDispSt 0;
BA_ "GenSigInactiveValue" SG_ 667 ADC_LlnMrkingDispSt 0;
BA_ "GenSigInvalidValue" SG_ 667 ADC_LlnMrkingDispSt 0;
BA_ "GenSigSendType" SG_ 667 ADC_LlnMrkingDispSt 1;
BA_ "GenSigStartValue" SG_ 667 ADC_LlnMrkingDispSt 0;
BA_ "GenSigTimeoutValue" SG_ 667 ADC_LlnMrkingDispSt 0;
BA_ "Remark" SG_ 667 ADC_LlnMrkingDispSt "";
BA_ "EventCommandSignal" SG_ 667 ADC_LLnMrking_Range 0;
BA_ "GatewayedSignals" SG_ 667 ADC_LLnMrking_Range 0;
BA_ "GenSigInactiveValue" SG_ 667 ADC_LLnMrking_Range 0;
BA_ "GenSigInvalidValue" SG_ 667 ADC_LLnMrking_Range 0;
BA_ "GenSigSendType" SG_ 667 ADC_LLnMrking_Range 1;
BA_ "GenSigStartValue" SG_ 667 ADC_LLnMrking_Range 0;
BA_ "GenSigTimeoutValue" SG_ 667 ADC_LLnMrking_Range 0;
BA_ "Remark" SG_ 667 ADC_LLnMrking_Range "";
BA_ "EventCommandSignal" SG_ 667 ADC_LLnMrking_Type 0;
BA_ "GatewayedSignals" SG_ 667 ADC_LLnMrking_Type 0;
BA_ "GenSigInactiveValue" SG_ 667 ADC_LLnMrking_Type 0;
BA_ "GenSigInvalidValue" SG_ 667 ADC_LLnMrking_Type 0;
BA_ "GenSigSendType" SG_ 667 ADC_LLnMrking_Type 1;
BA_ "GenSigStartValue" SG_ 667 ADC_LLnMrking_Type 0;
BA_ "GenSigTimeoutValue" SG_ 667 ADC_LLnMrking_Type 0;
BA_ "Remark" SG_ 667 ADC_LLnMrking_Type "";
BA_ "EventCommandSignal" SG_ 667 ADC_RLnMrking_A0 0;
BA_ "GatewayedSignals" SG_ 667 ADC_RLnMrking_A0 0;
BA_ "GenSigInactiveValue" SG_ 667 ADC_RLnMrking_A0 0;
BA_ "GenSigInvalidValue" SG_ 667 ADC_RLnMrking_A0 2047;
BA_ "GenSigSendType" SG_ 667 ADC_RLnMrking_A0 1;
BA_ "GenSigStartValue" SG_ 667 ADC_RLnMrking_A0 1023;
BA_ "GenSigTimeoutValue" SG_ 667 ADC_RLnMrking_A0 0;
BA_ "Remark" SG_ 667 ADC_RLnMrking_A0 "";
BA_ "EventCommandSignal" SG_ 667 ADC_RLnMrking_A1 0;
BA_ "GatewayedSignals" SG_ 667 ADC_RLnMrking_A1 0;
BA_ "GenSigInactiveValue" SG_ 667 ADC_RLnMrking_A1 0;
BA_ "GenSigInvalidValue" SG_ 667 ADC_RLnMrking_A1 2047;
BA_ "GenSigSendType" SG_ 667 ADC_RLnMrking_A1 1;
BA_ "GenSigStartValue" SG_ 667 ADC_RLnMrking_A1 1023;
BA_ "GenSigTimeoutValue" SG_ 667 ADC_RLnMrking_A1 0;
BA_ "Remark" SG_ 667 ADC_RLnMrking_A1 "";
BA_ "EventCommandSignal" SG_ 667 ADC_RLnMrking_A2 0;
BA_ "GatewayedSignals" SG_ 667 ADC_RLnMrking_A2 0;
BA_ "GenSigInactiveValue" SG_ 667 ADC_RLnMrking_A2 0;
BA_ "GenSigInvalidValue" SG_ 667 ADC_RLnMrking_A2 2047;
BA_ "GenSigSendType" SG_ 667 ADC_RLnMrking_A2 1;
BA_ "GenSigStartValue" SG_ 667 ADC_RLnMrking_A2 1023;
BA_ "GenSigTimeoutValue" SG_ 667 ADC_RLnMrking_A2 0;
BA_ "Remark" SG_ 667 ADC_RLnMrking_A2 "";
BA_ "EventCommandSignal" SG_ 667 ADC_RlnMrkingDispSt 0;
BA_ "GatewayedSignals" SG_ 667 ADC_RlnMrkingDispSt 0;
BA_ "GenSigInactiveValue" SG_ 667 ADC_RlnMrkingDispSt 0;
BA_ "GenSigInvalidValue" SG_ 667 ADC_RlnMrkingDispSt 0;
BA_ "GenSigSendType" SG_ 667 ADC_RlnMrkingDispSt 1;
BA_ "GenSigStartValue" SG_ 667 ADC_RlnMrkingDispSt 0;
BA_ "GenSigTimeoutValue" SG_ 667 ADC_RlnMrkingDispSt 0;
BA_ "Remark" SG_ 667 ADC_RlnMrkingDispSt "";
BA_ "EventCommandSignal" SG_ 667 ADC_RLnMrking_conf 0;
BA_ "GatewayedSignals" SG_ 667 ADC_RLnMrking_conf 0;
BA_ "GenSigInactiveValue" SG_ 667 ADC_RLnMrking_conf 0;
BA_ "GenSigInvalidValue" SG_ 667 ADC_RLnMrking_conf 100;
BA_ "GenSigSendType" SG_ 667 ADC_RLnMrking_conf 1;
BA_ "GenSigStartValue" SG_ 667 ADC_RLnMrking_conf 0;
BA_ "GenSigTimeoutValue" SG_ 667 ADC_RLnMrking_conf 0;
BA_ "Remark" SG_ 667 ADC_RLnMrking_conf "";
BA_ "EventCommandSignal" SG_ 667 ADC_RLnMrking_Range 0;
BA_ "GatewayedSignals" SG_ 667 ADC_RLnMrking_Range 0;
BA_ "GenSigInactiveValue" SG_ 667 ADC_RLnMrking_Range 0;
BA_ "GenSigInvalidValue" SG_ 667 ADC_RLnMrking_Range 0;
BA_ "GenSigSendType" SG_ 667 ADC_RLnMrking_Range 1;
BA_ "GenSigStartValue" SG_ 667 ADC_RLnMrking_Range 0;
BA_ "GenSigTimeoutValue" SG_ 667 ADC_RLnMrking_Range 0;
BA_ "Remark" SG_ 667 ADC_RLnMrking_Range "";
BA_ "EventCommandSignal" SG_ 667 ADC_RLnMrking_Type 0;
BA_ "GatewayedSignals" SG_ 667 ADC_RLnMrking_Type 0;
BA_ "GenSigInactiveValue" SG_ 667 ADC_RLnMrking_Type 0;
BA_ "GenSigInvalidValue" SG_ 667 ADC_RLnMrking_Type 0;
BA_ "GenSigSendType" SG_ 667 ADC_RLnMrking_Type 1;
BA_ "GenSigStartValue" SG_ 667 ADC_RLnMrking_Type 0;
BA_ "GenSigTimeoutValue" SG_ 667 ADC_RLnMrking_Type 0;
BA_ "Remark" SG_ 667 ADC_RLnMrking_Type "";
BA_ "EventCommandSignal" SG_ 667 ADC_AdjLLnMrking_A0 0;
BA_ "GatewayedSignals" SG_ 667 ADC_AdjLLnMrking_A0 0;
BA_ "GenSigInactiveValue" SG_ 667 ADC_AdjLLnMrking_A0 0;
BA_ "GenSigInvalidValue" SG_ 667 ADC_AdjLLnMrking_A0 2047;
BA_ "GenSigSendType" SG_ 667 ADC_AdjLLnMrking_A0 1;
BA_ "GenSigStartValue" SG_ 667 ADC_AdjLLnMrking_A0 1023;
BA_ "GenSigTimeoutValue" SG_ 667 ADC_AdjLLnMrking_A0 0;
BA_ "Remark" SG_ 667 ADC_AdjLLnMrking_A0 "";
BA_ "EventCommandSignal" SG_ 667 ADC_AdjLLnMrking_A1 0;
BA_ "GatewayedSignals" SG_ 667 ADC_AdjLLnMrking_A1 0;
BA_ "GenSigInactiveValue" SG_ 667 ADC_AdjLLnMrking_A1 0;
BA_ "GenSigInvalidValue" SG_ 667 ADC_AdjLLnMrking_A1 2047;
BA_ "GenSigSendType" SG_ 667 ADC_AdjLLnMrking_A1 1;
BA_ "GenSigStartValue" SG_ 667 ADC_AdjLLnMrking_A1 1023;
BA_ "GenSigTimeoutValue" SG_ 667 ADC_AdjLLnMrking_A1 0;
BA_ "Remark" SG_ 667 ADC_AdjLLnMrking_A1 "";
BA_ "EventCommandSignal" SG_ 667 ADC_AdjLLnMrking_A2 0;
BA_ "GatewayedSignals" SG_ 667 ADC_AdjLLnMrking_A2 0;
BA_ "GenSigInactiveValue" SG_ 667 ADC_AdjLLnMrking_A2 0;
BA_ "GenSigInvalidValue" SG_ 667 ADC_AdjLLnMrking_A2 2047;
BA_ "GenSigSendType" SG_ 667 ADC_AdjLLnMrking_A2 1;
BA_ "GenSigStartValue" SG_ 667 ADC_AdjLLnMrking_A2 1023;
BA_ "GenSigTimeoutValue" SG_ 667 ADC_AdjLLnMrking_A2 0;
BA_ "Remark" SG_ 667 ADC_AdjLLnMrking_A2 "";
BA_ "EventCommandSignal" SG_ 667 ADC_AdjLLnMrking_conf 0;
BA_ "GatewayedSignals" SG_ 667 ADC_AdjLLnMrking_conf 0;
BA_ "GenSigInactiveValue" SG_ 667 ADC_AdjLLnMrking_conf 0;
BA_ "GenSigInvalidValue" SG_ 667 ADC_AdjLLnMrking_conf 100;
BA_ "GenSigSendType" SG_ 667 ADC_AdjLLnMrking_conf 1;
BA_ "GenSigStartValue" SG_ 667 ADC_AdjLLnMrking_conf 0;
BA_ "GenSigTimeoutValue" SG_ 667 ADC_AdjLLnMrking_conf 0;
BA_ "Remark" SG_ 667 ADC_AdjLLnMrking_conf "";
BA_ "EventCommandSignal" SG_ 667 ADC_AdjLLnMrking_Range 0;
BA_ "GatewayedSignals" SG_ 667 ADC_AdjLLnMrking_Range 0;
BA_ "GenSigInactiveValue" SG_ 667 ADC_AdjLLnMrking_Range 0;
BA_ "GenSigInvalidValue" SG_ 667 ADC_AdjLLnMrking_Range 0;
BA_ "GenSigSendType" SG_ 667 ADC_AdjLLnMrking_Range 1;
BA_ "GenSigStartValue" SG_ 667 ADC_AdjLLnMrking_Range 0;
BA_ "GenSigTimeoutValue" SG_ 667 ADC_AdjLLnMrking_Range 0;
BA_ "Remark" SG_ 667 ADC_AdjLLnMrking_Range "";
BA_ "EventCommandSignal" SG_ 667 ADC_AdjLlnMrkingDispSt 0;
BA_ "GatewayedSignals" SG_ 667 ADC_AdjLlnMrkingDispSt 0;
BA_ "GenSigInactiveValue" SG_ 667 ADC_AdjLlnMrkingDispSt 0;
BA_ "GenSigInvalidValue" SG_ 667 ADC_AdjLlnMrkingDispSt 0;
BA_ "GenSigSendType" SG_ 667 ADC_AdjLlnMrkingDispSt 1;
BA_ "GenSigStartValue" SG_ 667 ADC_AdjLlnMrkingDispSt 0;
BA_ "GenSigTimeoutValue" SG_ 667 ADC_AdjLlnMrkingDispSt 0;
BA_ "Remark" SG_ 667 ADC_AdjLlnMrkingDispSt "";
BA_ "EventCommandSignal" SG_ 667 ADC_AdjLLnMrking_Type 0;
BA_ "GatewayedSignals" SG_ 667 ADC_AdjLLnMrking_Type 0;
BA_ "GenSigInactiveValue" SG_ 667 ADC_AdjLLnMrking_Type 0;
BA_ "GenSigInvalidValue" SG_ 667 ADC_AdjLLnMrking_Type 0;
BA_ "GenSigSendType" SG_ 667 ADC_AdjLLnMrking_Type 1;
BA_ "GenSigStartValue" SG_ 667 ADC_AdjLLnMrking_Type 0;
BA_ "GenSigTimeoutValue" SG_ 667 ADC_AdjLLnMrking_Type 0;
BA_ "Remark" SG_ 667 ADC_AdjLLnMrking_Type "";
BA_ "EventCommandSignal" SG_ 667 ADC_AdjRLnMrking_A0 0;
BA_ "GatewayedSignals" SG_ 667 ADC_AdjRLnMrking_A0 0;
BA_ "GenSigInactiveValue" SG_ 667 ADC_AdjRLnMrking_A0 0;
BA_ "GenSigInvalidValue" SG_ 667 ADC_AdjRLnMrking_A0 2047;
BA_ "GenSigSendType" SG_ 667 ADC_AdjRLnMrking_A0 1;
BA_ "GenSigStartValue" SG_ 667 ADC_AdjRLnMrking_A0 1023;
BA_ "GenSigTimeoutValue" SG_ 667 ADC_AdjRLnMrking_A0 0;
BA_ "Remark" SG_ 667 ADC_AdjRLnMrking_A0 "";
BA_ "EventCommandSignal" SG_ 667 ADC_AdjRLnMrking_A1 0;
BA_ "GatewayedSignals" SG_ 667 ADC_AdjRLnMrking_A1 0;
BA_ "GenSigInactiveValue" SG_ 667 ADC_AdjRLnMrking_A1 0;
BA_ "GenSigInvalidValue" SG_ 667 ADC_AdjRLnMrking_A1 2047;
BA_ "GenSigSendType" SG_ 667 ADC_AdjRLnMrking_A1 1;
BA_ "GenSigStartValue" SG_ 667 ADC_AdjRLnMrking_A1 1023;
BA_ "GenSigTimeoutValue" SG_ 667 ADC_AdjRLnMrking_A1 0;
BA_ "Remark" SG_ 667 ADC_AdjRLnMrking_A1 "";
BA_ "EventCommandSignal" SG_ 667 ADC_AdjRLnMrking_A2 0;
BA_ "GatewayedSignals" SG_ 667 ADC_AdjRLnMrking_A2 0;
BA_ "GenSigInactiveValue" SG_ 667 ADC_AdjRLnMrking_A2 0;
BA_ "GenSigInvalidValue" SG_ 667 ADC_AdjRLnMrking_A2 2047;
BA_ "GenSigSendType" SG_ 667 ADC_AdjRLnMrking_A2 1;
BA_ "GenSigStartValue" SG_ 667 ADC_AdjRLnMrking_A2 1023;
BA_ "GenSigTimeoutValue" SG_ 667 ADC_AdjRLnMrking_A2 0;
BA_ "Remark" SG_ 667 ADC_AdjRLnMrking_A2 "";
BA_ "EventCommandSignal" SG_ 667 ADC_AdjRLnMrking_Range 0;
BA_ "GatewayedSignals" SG_ 667 ADC_AdjRLnMrking_Range 0;
BA_ "GenSigInactiveValue" SG_ 667 ADC_AdjRLnMrking_Range 0;
BA_ "GenSigInvalidValue" SG_ 667 ADC_AdjRLnMrking_Range 0;
BA_ "GenSigSendType" SG_ 667 ADC_AdjRLnMrking_Range 1;
BA_ "GenSigStartValue" SG_ 667 ADC_AdjRLnMrking_Range 0;
BA_ "GenSigTimeoutValue" SG_ 667 ADC_AdjRLnMrking_Range 0;
BA_ "Remark" SG_ 667 ADC_AdjRLnMrking_Range "";
BA_ "EventCommandSignal" SG_ 667 ADC_AdjRLnMrking_conf 0;
BA_ "GatewayedSignals" SG_ 667 ADC_AdjRLnMrking_conf 0;
BA_ "GenSigInactiveValue" SG_ 667 ADC_AdjRLnMrking_conf 0;
BA_ "GenSigInvalidValue" SG_ 667 ADC_AdjRLnMrking_conf 100;
BA_ "GenSigSendType" SG_ 667 ADC_AdjRLnMrking_conf 1;
BA_ "GenSigStartValue" SG_ 667 ADC_AdjRLnMrking_conf 0;
BA_ "GenSigTimeoutValue" SG_ 667 ADC_AdjRLnMrking_conf 0;
BA_ "Remark" SG_ 667 ADC_AdjRLnMrking_conf "";
BA_ "EventCommandSignal" SG_ 667 ADC_AdjRlnMrkingDispSt 0;
BA_ "GatewayedSignals" SG_ 667 ADC_AdjRlnMrkingDispSt 0;
BA_ "GenSigInactiveValue" SG_ 667 ADC_AdjRlnMrkingDispSt 0;
BA_ "GenSigInvalidValue" SG_ 667 ADC_AdjRlnMrkingDispSt 0;
BA_ "GenSigSendType" SG_ 667 ADC_AdjRlnMrkingDispSt 1;
BA_ "GenSigStartValue" SG_ 667 ADC_AdjRlnMrkingDispSt 0;
BA_ "GenSigTimeoutValue" SG_ 667 ADC_AdjRlnMrkingDispSt 0;
BA_ "Remark" SG_ 667 ADC_AdjRlnMrkingDispSt "";
BA_ "EventCommandSignal" SG_ 667 ADC_AdjRLnMrking_Type 0;
BA_ "GatewayedSignals" SG_ 667 ADC_AdjRLnMrking_Type 0;
BA_ "GenSigInactiveValue" SG_ 667 ADC_AdjRLnMrking_Type 0;
BA_ "GenSigInvalidValue" SG_ 667 ADC_AdjRLnMrking_Type 0;
BA_ "GenSigSendType" SG_ 667 ADC_AdjRLnMrking_Type 1;
BA_ "GenSigStartValue" SG_ 667 ADC_AdjRLnMrking_Type 0;
BA_ "GenSigTimeoutValue" SG_ 667 ADC_AdjRLnMrking_Type 0;
BA_ "Remark" SG_ 667 ADC_AdjRLnMrking_Type "";
BA_ "EventCommandSignal" SG_ 947 ADC_8_CRC 0;
BA_ "GatewayedSignals" SG_ 947 ADC_8_CRC 0;
BA_ "GenSigInactiveValue" SG_ 947 ADC_8_CRC 0;
BA_ "GenSigInvalidValue" SG_ 947 ADC_8_CRC 0;
BA_ "GenSigSendType" SG_ 947 ADC_8_CRC 1;
BA_ "GenSigStartValue" SG_ 947 ADC_8_CRC 0;
BA_ "GenSigTimeoutValue" SG_ 947 ADC_8_CRC 0;
BA_ "Remark" SG_ 947 ADC_8_CRC "";
BA_ "EventCommandSignal" SG_ 947 ADC_8_Counter 0;
BA_ "GatewayedSignals" SG_ 947 ADC_8_Counter 0;
BA_ "GenSigInactiveValue" SG_ 947 ADC_8_Counter 0;
BA_ "GenSigInvalidValue" SG_ 947 ADC_8_Counter 0;
BA_ "GenSigSendType" SG_ 947 ADC_8_Counter 1;
BA_ "GenSigStartValue" SG_ 947 ADC_8_Counter 0;
BA_ "GenSigTimeoutValue" SG_ 947 ADC_8_Counter 0;
BA_ "Remark" SG_ 947 ADC_8_Counter "";
BA_ "EventCommandSignal" SG_ 947 ADC_LowBeamReq 0;
BA_ "GatewayedSignals" SG_ 947 ADC_LowBeamReq 0;
BA_ "GenSigInactiveValue" SG_ 947 ADC_LowBeamReq 0;
BA_ "GenSigInvalidValue" SG_ 947 ADC_LowBeamReq 0;
BA_ "GenSigSendType" SG_ 947 ADC_LowBeamReq 1;
BA_ "GenSigStartValue" SG_ 947 ADC_LowBeamReq 0;
BA_ "GenSigTimeoutValue" SG_ 947 ADC_LowBeamReq 0;
BA_ "Remark" SG_ 947 ADC_LowBeamReq "";
BA_ "EventCommandSignal" SG_ 947 ADC_IHBC_HighBeamReq 0;
BA_ "GatewayedSignals" SG_ 947 ADC_IHBC_HighBeamReq 0;
BA_ "GenSigInactiveValue" SG_ 947 ADC_IHBC_HighBeamReq 0;
BA_ "GenSigInvalidValue" SG_ 947 ADC_IHBC_HighBeamReq 0;
BA_ "GenSigSendType" SG_ 947 ADC_IHBC_HighBeamReq 1;
BA_ "GenSigStartValue" SG_ 947 ADC_IHBC_HighBeamReq 0;
BA_ "GenSigTimeoutValue" SG_ 947 ADC_IHBC_HighBeamReq 0;
BA_ "Remark" SG_ 947 ADC_IHBC_HighBeamReq "";
BA_ "EventCommandSignal" SG_ 947 ADC_FlashReq 0;
BA_ "GatewayedSignals" SG_ 947 ADC_FlashReq 0;
BA_ "GenSigInactiveValue" SG_ 947 ADC_FlashReq 0;
BA_ "GenSigInvalidValue" SG_ 947 ADC_FlashReq 0;
BA_ "GenSigSendType" SG_ 947 ADC_FlashReq 1;
BA_ "GenSigStartValue" SG_ 947 ADC_FlashReq 0;
BA_ "GenSigTimeoutValue" SG_ 947 ADC_FlashReq 0;
BA_ "Remark" SG_ 947 ADC_FlashReq "";
BA_ "EventCommandSignal" SG_ 947 ADC_PositionLampReq 0;
BA_ "GatewayedSignals" SG_ 947 ADC_PositionLampReq 0;
BA_ "GenSigInactiveValue" SG_ 947 ADC_PositionLampReq 0;
BA_ "GenSigInvalidValue" SG_ 947 ADC_PositionLampReq 0;
BA_ "GenSigSendType" SG_ 947 ADC_PositionLampReq 1;
BA_ "GenSigStartValue" SG_ 947 ADC_PositionLampReq 0;
BA_ "GenSigTimeoutValue" SG_ 947 ADC_PositionLampReq 0;
BA_ "Remark" SG_ 947 ADC_PositionLampReq "";
BA_ "EventCommandSignal" SG_ 947 ADC_HVACCtrlReq 0;
BA_ "GatewayedSignals" SG_ 947 ADC_HVACCtrlReq 0;
BA_ "GenSigInactiveValue" SG_ 947 ADC_HVACCtrlReq 0;
BA_ "GenSigInvalidValue" SG_ 947 ADC_HVACCtrlReq 0;
BA_ "GenSigSendType" SG_ 947 ADC_HVACCtrlReq 1;
BA_ "GenSigStartValue" SG_ 947 ADC_HVACCtrlReq 0;
BA_ "GenSigTimeoutValue" SG_ 947 ADC_HVACCtrlReq 0;
BA_ "Remark" SG_ 947 ADC_HVACCtrlReq "";
BA_ "EventCommandSignal" SG_ 947 ADC_FFogLightReq 0;
BA_ "GatewayedSignals" SG_ 947 ADC_FFogLightReq 0;
BA_ "GenSigInactiveValue" SG_ 947 ADC_FFogLightReq 0;
BA_ "GenSigInvalidValue" SG_ 947 ADC_FFogLightReq 0;
BA_ "GenSigSendType" SG_ 947 ADC_FFogLightReq 1;
BA_ "GenSigStartValue" SG_ 947 ADC_FFogLightReq 0;
BA_ "GenSigTimeoutValue" SG_ 947 ADC_FFogLightReq 0;
BA_ "Remark" SG_ 947 ADC_FFogLightReq "";
BA_ "EventCommandSignal" SG_ 947 ADC_RFogLightReq 0;
BA_ "GatewayedSignals" SG_ 947 ADC_RFogLightReq 0;
BA_ "GenSigInactiveValue" SG_ 947 ADC_RFogLightReq 0;
BA_ "GenSigInvalidValue" SG_ 947 ADC_RFogLightReq 0;
BA_ "GenSigSendType" SG_ 947 ADC_RFogLightReq 1;
BA_ "GenSigStartValue" SG_ 947 ADC_RFogLightReq 0;
BA_ "GenSigTimeoutValue" SG_ 947 ADC_RFogLightReq 0;
BA_ "Remark" SG_ 947 ADC_RFogLightReq "";
BA_ "EventCommandSignal" SG_ 947 ADC_HornReq 0;
BA_ "GatewayedSignals" SG_ 947 ADC_HornReq 0;
BA_ "GenSigInactiveValue" SG_ 947 ADC_HornReq 0;
BA_ "GenSigInvalidValue" SG_ 947 ADC_HornReq 0;
BA_ "GenSigSendType" SG_ 947 ADC_HornReq 1;
BA_ "GenSigStartValue" SG_ 947 ADC_HornReq 0;
BA_ "GenSigTimeoutValue" SG_ 947 ADC_HornReq 0;
BA_ "Remark" SG_ 947 ADC_HornReq "";
BA_ "EventCommandSignal" SG_ 947 ADC_FWiperReq 0;
BA_ "GatewayedSignals" SG_ 947 ADC_FWiperReq 0;
BA_ "GenSigInactiveValue" SG_ 947 ADC_FWiperReq 0;
BA_ "GenSigInvalidValue" SG_ 947 ADC_FWiperReq 0;
BA_ "GenSigSendType" SG_ 947 ADC_FWiperReq 1;
BA_ "GenSigStartValue" SG_ 947 ADC_FWiperReq 0;
BA_ "GenSigTimeoutValue" SG_ 947 ADC_FWiperReq 0;
BA_ "Remark" SG_ 947 ADC_FWiperReq "";
BA_ "EventCommandSignal" SG_ 947 ADC_RWiperReq 0;
BA_ "GatewayedSignals" SG_ 947 ADC_RWiperReq 0;
BA_ "GenSigInactiveValue" SG_ 947 ADC_RWiperReq 0;
BA_ "GenSigInvalidValue" SG_ 947 ADC_RWiperReq 0;
BA_ "GenSigSendType" SG_ 947 ADC_RWiperReq 1;
BA_ "GenSigStartValue" SG_ 947 ADC_RWiperReq 0;
BA_ "GenSigTimeoutValue" SG_ 947 ADC_RWiperReq 0;
BA_ "Remark" SG_ 947 ADC_RWiperReq "";
BA_ "EventCommandSignal" SG_ 947 ADC_FWaterSprayReq 0;
BA_ "GatewayedSignals" SG_ 947 ADC_FWaterSprayReq 0;
BA_ "GenSigInactiveValue" SG_ 947 ADC_FWaterSprayReq 0;
BA_ "GenSigInvalidValue" SG_ 947 ADC_FWaterSprayReq 0;
BA_ "GenSigSendType" SG_ 947 ADC_FWaterSprayReq 1;
BA_ "GenSigStartValue" SG_ 947 ADC_FWaterSprayReq 0;
BA_ "GenSigTimeoutValue" SG_ 947 ADC_FWaterSprayReq 0;
BA_ "Remark" SG_ 947 ADC_FWaterSprayReq "";
BA_ "EventCommandSignal" SG_ 947 ADC_RWaterSprayReq 0;
BA_ "GatewayedSignals" SG_ 947 ADC_RWaterSprayReq 0;
BA_ "GenSigInactiveValue" SG_ 947 ADC_RWaterSprayReq 0;
BA_ "GenSigInvalidValue" SG_ 947 ADC_RWaterSprayReq 0;
BA_ "GenSigSendType" SG_ 947 ADC_RWaterSprayReq 1;
BA_ "GenSigStartValue" SG_ 947 ADC_RWaterSprayReq 0;
BA_ "GenSigTimeoutValue" SG_ 947 ADC_RWaterSprayReq 0;
BA_ "Remark" SG_ 947 ADC_RWaterSprayReq "";
BA_ "EventCommandSignal" SG_ 947 ADC_CCUReqVD 0;
BA_ "GatewayedSignals" SG_ 947 ADC_CCUReqVD 0;
BA_ "GenSigInactiveValue" SG_ 947 ADC_CCUReqVD 0;
BA_ "GenSigInvalidValue" SG_ 947 ADC_CCUReqVD 0;
BA_ "GenSigSendType" SG_ 947 ADC_CCUReqVD 1;
BA_ "GenSigStartValue" SG_ 947 ADC_CCUReqVD 0;
BA_ "GenSigTimeoutValue" SG_ 947 ADC_CCUReqVD 0;
BA_ "Remark" SG_ 947 ADC_CCUReqVD "";
BA_ "EventCommandSignal" SG_ 947 ADC_WindowOpenReq 0;
BA_ "GatewayedSignals" SG_ 947 ADC_WindowOpenReq 0;
BA_ "GenSigInactiveValue" SG_ 947 ADC_WindowOpenReq 0;
BA_ "GenSigInvalidValue" SG_ 947 ADC_WindowOpenReq 0;
BA_ "GenSigSendType" SG_ 947 ADC_WindowOpenReq 1;
BA_ "GenSigStartValue" SG_ 947 ADC_WindowOpenReq 0;
BA_ "GenSigTimeoutValue" SG_ 947 ADC_WindowOpenReq 0;
BA_ "Remark" SG_ 947 ADC_WindowOpenReq "";
BA_ "EventCommandSignal" SG_ 947 ADC_WindowCloseReq 0;
BA_ "GatewayedSignals" SG_ 947 ADC_WindowCloseReq 0;
BA_ "GenSigInactiveValue" SG_ 947 ADC_WindowCloseReq 0;
BA_ "GenSigInvalidValue" SG_ 947 ADC_WindowCloseReq 0;
BA_ "GenSigSendType" SG_ 947 ADC_WindowCloseReq 1;
BA_ "GenSigStartValue" SG_ 947 ADC_WindowCloseReq 0;
BA_ "GenSigTimeoutValue" SG_ 947 ADC_WindowCloseReq 0;
BA_ "Remark" SG_ 947 ADC_WindowCloseReq "";
BA_ "EventCommandSignal" SG_ 947 ADC_PLGMOpenReq 0;
BA_ "GatewayedSignals" SG_ 947 ADC_PLGMOpenReq 0;
BA_ "GenSigInactiveValue" SG_ 947 ADC_PLGMOpenReq 0;
BA_ "GenSigInvalidValue" SG_ 947 ADC_PLGMOpenReq 0;
BA_ "GenSigSendType" SG_ 947 ADC_PLGMOpenReq 1;
BA_ "GenSigStartValue" SG_ 947 ADC_PLGMOpenReq 0;
BA_ "GenSigTimeoutValue" SG_ 947 ADC_PLGMOpenReq 0;
BA_ "Remark" SG_ 947 ADC_PLGMOpenReq "";
BA_ "EventCommandSignal" SG_ 947 ADC_PLGMCloseReq 0;
BA_ "GatewayedSignals" SG_ 947 ADC_PLGMCloseReq 0;
BA_ "GenSigInactiveValue" SG_ 947 ADC_PLGMCloseReq 0;
BA_ "GenSigInvalidValue" SG_ 947 ADC_PLGMCloseReq 0;
BA_ "GenSigSendType" SG_ 947 ADC_PLGMCloseReq 1;
BA_ "GenSigStartValue" SG_ 947 ADC_PLGMCloseReq 0;
BA_ "GenSigTimeoutValue" SG_ 947 ADC_PLGMCloseReq 0;
BA_ "Remark" SG_ 947 ADC_PLGMCloseReq "";
BA_ "EventCommandSignal" SG_ 947 ADC_FDemistReq 0;
BA_ "GatewayedSignals" SG_ 947 ADC_FDemistReq 0;
BA_ "GenSigInactiveValue" SG_ 947 ADC_FDemistReq 0;
BA_ "GenSigInvalidValue" SG_ 947 ADC_FDemistReq 0;
BA_ "GenSigSendType" SG_ 947 ADC_FDemistReq 1;
BA_ "GenSigStartValue" SG_ 947 ADC_FDemistReq 0;
BA_ "GenSigTimeoutValue" SG_ 947 ADC_FDemistReq 0;
BA_ "Remark" SG_ 947 ADC_FDemistReq "";
BA_ "EventCommandSignal" SG_ 947 ADC_RDemistReq 0;
BA_ "GatewayedSignals" SG_ 947 ADC_RDemistReq 0;
BA_ "GenSigInactiveValue" SG_ 947 ADC_RDemistReq 0;
BA_ "GenSigInvalidValue" SG_ 947 ADC_RDemistReq 0;
BA_ "GenSigSendType" SG_ 947 ADC_RDemistReq 1;
BA_ "GenSigStartValue" SG_ 947 ADC_RDemistReq 0;
BA_ "GenSigTimeoutValue" SG_ 947 ADC_RDemistReq 0;
BA_ "Remark" SG_ 947 ADC_RDemistReq "";
BA_ "EventCommandSignal" SG_ 947 ADC_ThmPostRun 0;
BA_ "GatewayedSignals" SG_ 947 ADC_ThmPostRun 0;
BA_ "GenSigInactiveValue" SG_ 947 ADC_ThmPostRun 0;
BA_ "GenSigInvalidValue" SG_ 947 ADC_ThmPostRun 0;
BA_ "GenSigSendType" SG_ 947 ADC_ThmPostRun 1;
BA_ "GenSigStartValue" SG_ 947 ADC_ThmPostRun 0;
BA_ "GenSigTimeoutValue" SG_ 947 ADC_ThmPostRun 1;
BA_ "Remark" SG_ 947 ADC_ThmPostRun "";
BA_ "EventCommandSignal" SG_ 947 ADC_DriverFaceWindReq 0;
BA_ "GatewayedSignals" SG_ 947 ADC_DriverFaceWindReq 0;
BA_ "GenSigInactiveValue" SG_ 947 ADC_DriverFaceWindReq 0;
BA_ "GenSigInvalidValue" SG_ 947 ADC_DriverFaceWindReq 0;
BA_ "GenSigSendType" SG_ 947 ADC_DriverFaceWindReq 1;
BA_ "GenSigStartValue" SG_ 947 ADC_DriverFaceWindReq 0;
BA_ "GenSigTimeoutValue" SG_ 947 ADC_DriverFaceWindReq 0;
BA_ "Remark" SG_ 947 ADC_DriverFaceWindReq "";
BA_ "EventCommandSignal" SG_ 947 ADC_EcallReq 0;
BA_ "GatewayedSignals" SG_ 947 ADC_EcallReq 0;
BA_ "GenSigInactiveValue" SG_ 947 ADC_EcallReq 0;
BA_ "GenSigInvalidValue" SG_ 947 ADC_EcallReq 0;
BA_ "GenSigSendType" SG_ 947 ADC_EcallReq 1;
BA_ "GenSigStartValue" SG_ 947 ADC_EcallReq 0;
BA_ "GenSigTimeoutValue" SG_ 947 ADC_EcallReq 0;
BA_ "Remark" SG_ 947 ADC_EcallReq "";
BA_ "EventCommandSignal" SG_ 947 ADC_FlowReq 0;
BA_ "GatewayedSignals" SG_ 947 ADC_FlowReq 0;
BA_ "GenSigInactiveValue" SG_ 947 ADC_FlowReq 0;
BA_ "GenSigInvalidValue" SG_ 947 ADC_FlowReq 255;
BA_ "GenSigSendType" SG_ 947 ADC_FlowReq 1;
BA_ "GenSigStartValue" SG_ 947 ADC_FlowReq 0;
BA_ "GenSigTimeoutValue" SG_ 947 ADC_FlowReq 12;
BA_ "Remark" SG_ 947 ADC_FlowReq "";
BA_ "EventCommandSignal" SG_ 947 ADC_DriverSeatBeltPretightenReq 0;
BA_ "GatewayedSignals" SG_ 947 ADC_DriverSeatBeltPretightenReq 0;
BA_ "GenSigInactiveValue" SG_ 947 ADC_DriverSeatBeltPretightenReq 0;
BA_ "GenSigInvalidValue" SG_ 947 ADC_DriverSeatBeltPretightenReq 0;
BA_ "GenSigSendType" SG_ 947 ADC_DriverSeatBeltPretightenReq 1;
BA_ "GenSigStartValue" SG_ 947 ADC_DriverSeatBeltPretightenReq 0;
BA_ "GenSigTimeoutValue" SG_ 947 ADC_DriverSeatBeltPretightenReq 0;
BA_ "Remark" SG_ 947 ADC_DriverSeatBeltPretightenReq "";
BA_ "EventCommandSignal" SG_ 947 ADC_LockReq 0;
BA_ "GatewayedSignals" SG_ 947 ADC_LockReq 0;
BA_ "GenSigInactiveValue" SG_ 947 ADC_LockReq 0;
BA_ "GenSigInvalidValue" SG_ 947 ADC_LockReq 0;
BA_ "GenSigSendType" SG_ 947 ADC_LockReq 1;
BA_ "GenSigStartValue" SG_ 947 ADC_LockReq 0;
BA_ "GenSigTimeoutValue" SG_ 947 ADC_LockReq 0;
BA_ "Remark" SG_ 947 ADC_LockReq "";
BA_ "EventCommandSignal" SG_ 947 ADC_HoldLockReq 0;
BA_ "GatewayedSignals" SG_ 947 ADC_HoldLockReq 0;
BA_ "GenSigInactiveValue" SG_ 947 ADC_HoldLockReq 0;
BA_ "GenSigInvalidValue" SG_ 947 ADC_HoldLockReq 0;
BA_ "GenSigSendType" SG_ 947 ADC_HoldLockReq 1;
BA_ "GenSigStartValue" SG_ 947 ADC_HoldLockReq 0;
BA_ "GenSigTimeoutValue" SG_ 947 ADC_HoldLockReq 0;
BA_ "Remark" SG_ 947 ADC_HoldLockReq "";
BA_ "EventCommandSignal" SG_ 947 ADC_RearMirrorReq 0;
BA_ "GatewayedSignals" SG_ 947 ADC_RearMirrorReq 0;
BA_ "GenSigInactiveValue" SG_ 947 ADC_RearMirrorReq 0;
BA_ "GenSigInvalidValue" SG_ 947 ADC_RearMirrorReq 0;
BA_ "GenSigSendType" SG_ 947 ADC_RearMirrorReq 1;
BA_ "GenSigStartValue" SG_ 947 ADC_RearMirrorReq 0;
BA_ "GenSigTimeoutValue" SG_ 947 ADC_RearMirrorReq 0;
BA_ "Remark" SG_ 947 ADC_RearMirrorReq "";
BA_ "EventCommandSignal" SG_ 947 ADC_HoldRearMirrorReq 0;
BA_ "GatewayedSignals" SG_ 947 ADC_HoldRearMirrorReq 0;
BA_ "GenSigInactiveValue" SG_ 947 ADC_HoldRearMirrorReq 0;
BA_ "GenSigInvalidValue" SG_ 947 ADC_HoldRearMirrorReq 0;
BA_ "GenSigSendType" SG_ 947 ADC_HoldRearMirrorReq 1;
BA_ "GenSigStartValue" SG_ 947 ADC_HoldRearMirrorReq 0;
BA_ "GenSigTimeoutValue" SG_ 947 ADC_HoldRearMirrorReq 0;
BA_ "Remark" SG_ 947 ADC_HoldRearMirrorReq "";
BA_ "EventCommandSignal" SG_ 947 ADC_ADSLightReq 0;
BA_ "GatewayedSignals" SG_ 947 ADC_ADSLightReq 0;
BA_ "GenSigInactiveValue" SG_ 947 ADC_ADSLightReq 0;
BA_ "GenSigInvalidValue" SG_ 947 ADC_ADSLightReq 0;
BA_ "GenSigSendType" SG_ 947 ADC_ADSLightReq 1;
BA_ "GenSigStartValue" SG_ 947 ADC_ADSLightReq 0;
BA_ "GenSigTimeoutValue" SG_ 947 ADC_ADSLightReq 0;
BA_ "Remark" SG_ 947 ADC_ADSLightReq "";
BA_ "EventCommandSignal" SG_ 947 ADC_DriverSeatBeltVibrWarnReq 0;
BA_ "GatewayedSignals" SG_ 947 ADC_DriverSeatBeltVibrWarnReq 0;
BA_ "GenSigInactiveValue" SG_ 947 ADC_DriverSeatBeltVibrWarnReq 0;
BA_ "GenSigInvalidValue" SG_ 947 ADC_DriverSeatBeltVibrWarnReq 0;
BA_ "GenSigSendType" SG_ 947 ADC_DriverSeatBeltVibrWarnReq 0;
BA_ "GenSigStartValue" SG_ 947 ADC_DriverSeatBeltVibrWarnReq 0;
BA_ "GenSigTimeoutValue" SG_ 947 ADC_DriverSeatBeltVibrWarnReq 0;
BA_ "Remark" SG_ 947 ADC_DriverSeatBeltVibrWarnReq "";
BA_ "EventCommandSignal" SG_ 947 ADC_FrtWindshildHeatReq 0;
BA_ "GatewayedSignals" SG_ 947 ADC_FrtWindshildHeatReq 0;
BA_ "GenSigInactiveValue" SG_ 947 ADC_FrtWindshildHeatReq 0;
BA_ "GenSigInvalidValue" SG_ 947 ADC_FrtWindshildHeatReq 0;
BA_ "GenSigSendType" SG_ 947 ADC_FrtWindshildHeatReq 1;
BA_ "GenSigStartValue" SG_ 947 ADC_FrtWindshildHeatReq 0;
BA_ "GenSigTimeoutValue" SG_ 947 ADC_FrtWindshildHeatReq 0;
BA_ "Remark" SG_ 947 ADC_FrtWindshildHeatReq "";
BA_ "EventCommandSignal" SG_ 947 ADC_BeamSwReq 0;
BA_ "GatewayedSignals" SG_ 947 ADC_BeamSwReq 0;
BA_ "GenSigInactiveValue" SG_ 947 ADC_BeamSwReq 0;
BA_ "GenSigInvalidValue" SG_ 947 ADC_BeamSwReq 0;
BA_ "GenSigSendType" SG_ 947 ADC_BeamSwReq 0;
BA_ "GenSigStartValue" SG_ 947 ADC_BeamSwReq 0;
BA_ "GenSigTimeoutValue" SG_ 947 ADC_BeamSwReq 0;
BA_ "Remark" SG_ 947 ADC_BeamSwReq "";
BA_ "EventCommandSignal" SG_ 947 IFC_SysCalibrationSt 0;
BA_ "GatewayedSignals" SG_ 947 IFC_SysCalibrationSt 0;
BA_ "GenSigInactiveValue" SG_ 947 IFC_SysCalibrationSt 0;
BA_ "GenSigInvalidValue" SG_ 947 IFC_SysCalibrationSt 0;
BA_ "GenSigSendType" SG_ 947 IFC_SysCalibrationSt 1;
BA_ "GenSigStartValue" SG_ 947 IFC_SysCalibrationSt 0;
BA_ "GenSigTimeoutValue" SG_ 947 IFC_SysCalibrationSt 0;
BA_ "Remark" SG_ 947 IFC_SysCalibrationSt "";
BA_ "EventCommandSignal" SG_ 947 ADC_ADBIHBCEnableReq 0;
BA_ "GatewayedSignals" SG_ 947 ADC_ADBIHBCEnableReq 0;
BA_ "GenSigInactiveValue" SG_ 947 ADC_ADBIHBCEnableReq 0;
BA_ "GenSigInvalidValue" SG_ 947 ADC_ADBIHBCEnableReq 0;
BA_ "GenSigSendType" SG_ 947 ADC_ADBIHBCEnableReq 1;
BA_ "GenSigStartValue" SG_ 947 ADC_ADBIHBCEnableReq 0;
BA_ "GenSigTimeoutValue" SG_ 947 ADC_ADBIHBCEnableReq 0;
BA_ "Remark" SG_ 947 ADC_ADBIHBCEnableReq "";
BA_ "EventCommandSignal" SG_ 947 ADC_LowPowerReqVD_A 0;
BA_ "GatewayedSignals" SG_ 947 ADC_LowPowerReqVD_A 0;
BA_ "GenSigInactiveValue" SG_ 947 ADC_LowPowerReqVD_A 0;
BA_ "GenSigInvalidValue" SG_ 947 ADC_LowPowerReqVD_A 0;
BA_ "GenSigSendType" SG_ 947 ADC_LowPowerReqVD_A 1;
BA_ "GenSigStartValue" SG_ 947 ADC_LowPowerReqVD_A 0;
BA_ "GenSigTimeoutValue" SG_ 947 ADC_LowPowerReqVD_A 0;
BA_ "Remark" SG_ 947 ADC_LowPowerReqVD_A "";
BA_ "EventCommandSignal" SG_ 947 ADC_LowPowerReq_A 0;
BA_ "GatewayedSignals" SG_ 947 ADC_LowPowerReq_A 0;
BA_ "GenSigInactiveValue" SG_ 947 ADC_LowPowerReq_A 0;
BA_ "GenSigInvalidValue" SG_ 947 ADC_LowPowerReq_A 0;
BA_ "GenSigSendType" SG_ 947 ADC_LowPowerReq_A 1;
BA_ "GenSigStartValue" SG_ 947 ADC_LowPowerReq_A 0;
BA_ "GenSigTimeoutValue" SG_ 947 ADC_LowPowerReq_A 0;
BA_ "Remark" SG_ 947 ADC_LowPowerReq_A "";
BA_ "EventCommandSignal" SG_ 947 ADC_MachineStatus 0;
BA_ "GatewayedSignals" SG_ 947 ADC_MachineStatus 0;
BA_ "GenSigInactiveValue" SG_ 947 ADC_MachineStatus 0;
BA_ "GenSigInvalidValue" SG_ 947 ADC_MachineStatus 0;
BA_ "GenSigSendType" SG_ 947 ADC_MachineStatus 1;
BA_ "GenSigStartValue" SG_ 947 ADC_MachineStatus 0;
BA_ "GenSigTimeoutValue" SG_ 947 ADC_MachineStatus 0;
BA_ "Remark" SG_ 947 ADC_MachineStatus "";
BA_ "EventCommandSignal" SG_ 947 ADC_LowPowerFailReason 0;
BA_ "GatewayedSignals" SG_ 947 ADC_LowPowerFailReason 0;
BA_ "GenSigInactiveValue" SG_ 947 ADC_LowPowerFailReason 0;
BA_ "GenSigInvalidValue" SG_ 947 ADC_LowPowerFailReason 0;
BA_ "GenSigSendType" SG_ 947 ADC_LowPowerFailReason 1;
BA_ "GenSigStartValue" SG_ 947 ADC_LowPowerFailReason 0;
BA_ "GenSigTimeoutValue" SG_ 947 ADC_LowPowerFailReason 0;
BA_ "Remark" SG_ 947 ADC_LowPowerFailReason "";
BA_ "EventCommandSignal" SG_ 947 ADC_LightbarReq 0;
BA_ "GatewayedSignals" SG_ 947 ADC_LightbarReq 0;
BA_ "GenSigInactiveValue" SG_ 947 ADC_LightbarReq 0;
BA_ "GenSigInvalidValue" SG_ 947 ADC_LightbarReq 0;
BA_ "GenSigSendType" SG_ 947 ADC_LightbarReq 1;
BA_ "GenSigStartValue" SG_ 947 ADC_LightbarReq 0;
BA_ "GenSigTimeoutValue" SG_ 947 ADC_LightbarReq 15;
BA_ "Remark" SG_ 947 ADC_LightbarReq "";
BA_ "EventCommandSignal" SG_ 947 ADC_ChgPortControlReq 0;
BA_ "GatewayedSignals" SG_ 947 ADC_ChgPortControlReq 0;
BA_ "GenSigInactiveValue" SG_ 947 ADC_ChgPortControlReq 0;
BA_ "GenSigInvalidValue" SG_ 947 ADC_ChgPortControlReq 0;
BA_ "GenSigSendType" SG_ 947 ADC_ChgPortControlReq 1;
BA_ "GenSigStartValue" SG_ 947 ADC_ChgPortControlReq 0;
BA_ "GenSigTimeoutValue" SG_ 947 ADC_ChgPortControlReq 0;
BA_ "Remark" SG_ 947 ADC_ChgPortControlReq "";
BA_ "EventCommandSignal" SG_ 947 ADC_ChgPortHoldControlReq 0;
BA_ "GatewayedSignals" SG_ 947 ADC_ChgPortHoldControlReq 0;
BA_ "GenSigInactiveValue" SG_ 947 ADC_ChgPortHoldControlReq 0;
BA_ "GenSigInvalidValue" SG_ 947 ADC_ChgPortHoldControlReq 0;
BA_ "GenSigSendType" SG_ 947 ADC_ChgPortHoldControlReq 1;
BA_ "GenSigStartValue" SG_ 947 ADC_ChgPortHoldControlReq 0;
BA_ "GenSigTimeoutValue" SG_ 947 ADC_ChgPortHoldControlReq 0;
BA_ "Remark" SG_ 947 ADC_ChgPortHoldControlReq "";
BA_ "EventCommandSignal" SG_ 947 ADC_ChargHoldReq 0;
BA_ "GatewayedSignals" SG_ 947 ADC_ChargHoldReq 0;
BA_ "GenSigInactiveValue" SG_ 947 ADC_ChargHoldReq 0;
BA_ "GenSigInvalidValue" SG_ 947 ADC_ChargHoldReq 0;
BA_ "GenSigSendType" SG_ 947 ADC_ChargHoldReq 1;
BA_ "GenSigStartValue" SG_ 947 ADC_ChargHoldReq 0;
BA_ "GenSigTimeoutValue" SG_ 947 ADC_ChargHoldReq 0;
BA_ "Remark" SG_ 947 ADC_ChargHoldReq "";
BA_ "EventCommandSignal" SG_ 947 ADC_ChargReq 0;
BA_ "GatewayedSignals" SG_ 947 ADC_ChargReq 0;
BA_ "GenSigInactiveValue" SG_ 947 ADC_ChargReq 0;
BA_ "GenSigInvalidValue" SG_ 947 ADC_ChargReq 0;
BA_ "GenSigSendType" SG_ 947 ADC_ChargReq 1;
BA_ "GenSigStartValue" SG_ 947 ADC_ChargReq 0;
BA_ "GenSigTimeoutValue" SG_ 947 ADC_ChargReq 0;
BA_ "Remark" SG_ 947 ADC_ChargReq "";
BA_ "EventCommandSignal" SG_ 947 ADC_ChargGunHoldReq 0;
BA_ "GatewayedSignals" SG_ 947 ADC_ChargGunHoldReq 0;
BA_ "GenSigInactiveValue" SG_ 947 ADC_ChargGunHoldReq 0;
BA_ "GenSigInvalidValue" SG_ 947 ADC_ChargGunHoldReq 0;
BA_ "GenSigSendType" SG_ 947 ADC_ChargGunHoldReq 1;
BA_ "GenSigStartValue" SG_ 947 ADC_ChargGunHoldReq 0;
BA_ "GenSigTimeoutValue" SG_ 947 ADC_ChargGunHoldReq 0;
BA_ "Remark" SG_ 947 ADC_ChargGunHoldReq "";
BA_ "EventCommandSignal" SG_ 947 ADC_ChargGunReq 0;
BA_ "GatewayedSignals" SG_ 947 ADC_ChargGunReq 0;
BA_ "GenSigInactiveValue" SG_ 947 ADC_ChargGunReq 0;
BA_ "GenSigInvalidValue" SG_ 947 ADC_ChargGunReq 0;
BA_ "GenSigSendType" SG_ 947 ADC_ChargGunReq 1;
BA_ "GenSigStartValue" SG_ 947 ADC_ChargGunReq 0;
BA_ "GenSigTimeoutValue" SG_ 947 ADC_ChargGunReq 0;
BA_ "Remark" SG_ 947 ADC_ChargGunReq "";
BA_ "EventCommandSignal" SG_ 947 ADC_MCURTTemp 0;
BA_ "GatewayedSignals" SG_ 947 ADC_MCURTTemp 0;
BA_ "GenSigInactiveValue" SG_ 947 ADC_MCURTTemp 0;
BA_ "GenSigInvalidValue" SG_ 947 ADC_MCURTTemp 0;
BA_ "GenSigSendType" SG_ 947 ADC_MCURTTemp 1;
BA_ "GenSigStartValue" SG_ 947 ADC_MCURTTemp 0;
BA_ "GenSigTimeoutValue" SG_ 947 ADC_MCURTTemp 0;
BA_ "Remark" SG_ 947 ADC_MCURTTemp "";
BA_ "EventCommandSignal" SG_ 947 ADC_SOCRTtemp 0;
BA_ "GatewayedSignals" SG_ 947 ADC_SOCRTtemp 0;
BA_ "GenSigInactiveValue" SG_ 947 ADC_SOCRTtemp 0;
BA_ "GenSigInvalidValue" SG_ 947 ADC_SOCRTtemp 0;
BA_ "GenSigSendType" SG_ 947 ADC_SOCRTtemp 1;
BA_ "GenSigStartValue" SG_ 947 ADC_SOCRTtemp 0;
BA_ "GenSigTimeoutValue" SG_ 947 ADC_SOCRTtemp 0;
BA_ "Remark" SG_ 947 ADC_SOCRTtemp "";
BA_ "EventCommandSignal" SG_ 947 ADC_InteractLightReq 0;
BA_ "GatewayedSignals" SG_ 947 ADC_InteractLightReq 0;
BA_ "GenSigInactiveValue" SG_ 947 ADC_InteractLightReq 0;
BA_ "GenSigInvalidValue" SG_ 947 ADC_InteractLightReq 0;
BA_ "GenSigSendType" SG_ 947 ADC_InteractLightReq 1;
BA_ "GenSigStartValue" SG_ 947 ADC_InteractLightReq 0;
BA_ "GenSigTimeoutValue" SG_ 947 ADC_InteractLightReq 0;
BA_ "Remark" SG_ 947 ADC_InteractLightReq "";
BA_ "EventCommandSignal" SG_ 947 Reserved1 0;
BA_ "GatewayedSignals" SG_ 947 Reserved1 0;
BA_ "GenSigInactiveValue" SG_ 947 Reserved1 0;
BA_ "GenSigInvalidValue" SG_ 947 Reserved1 0;
BA_ "GenSigSendType" SG_ 947 Reserved1 1;
BA_ "GenSigStartValue" SG_ 947 Reserved1 0;
BA_ "GenSigTimeoutValue" SG_ 947 Reserved1 0;
BA_ "Remark" SG_ 947 Reserved1 "";
BA_ "EventCommandSignal" SG_ 170 ADC_SecReq 1;
BA_ "GatewayedSignals" SG_ 170 ADC_SecReq 0;
BA_ "GenSigInactiveValue" SG_ 170 ADC_SecReq 0;
BA_ "GenSigInvalidValue" SG_ 170 ADC_SecReq 0;
BA_ "GenSigSendType" SG_ 170 ADC_SecReq 0;
BA_ "GenSigStartValue" SG_ 170 ADC_SecReq 17;
BA_ "GenSigTimeoutValue" SG_ 170 ADC_SecReq 0;
BA_ "Remark" SG_ 170 ADC_SecReq "";
BA_ "EventCommandSignal" SG_ 121 ADC_SEC_KEY_Defaultencoding 1;
BA_ "GatewayedSignals" SG_ 121 ADC_SEC_KEY_Defaultencoding 0;
BA_ "GenSigInactiveValue" SG_ 121 ADC_SEC_KEY_Defaultencoding 0;
BA_ "GenSigInvalidValue" SG_ 121 ADC_SEC_KEY_Defaultencoding 0;
BA_ "GenSigSendType" SG_ 121 ADC_SEC_KEY_Defaultencoding 0;
BA_ "GenSigStartValue" SG_ 121 ADC_SEC_KEY_Defaultencoding 0;
BA_ "GenSigTimeoutValue" SG_ 121 ADC_SEC_KEY_Defaultencoding 0;
BA_ "Remark" SG_ 121 ADC_SEC_KEY_Defaultencoding "";
BA_ "EventCommandSignal" SG_ 175 ADC_9_CRC 0;
BA_ "GatewayedSignals" SG_ 175 ADC_9_CRC 0;
BA_ "GenSigInactiveValue" SG_ 175 ADC_9_CRC 0;
BA_ "GenSigInvalidValue" SG_ 175 ADC_9_CRC 0;
BA_ "GenSigSendType" SG_ 175 ADC_9_CRC 1;
BA_ "GenSigStartValue" SG_ 175 ADC_9_CRC 0;
BA_ "GenSigTimeoutValue" SG_ 175 ADC_9_CRC 0;
BA_ "Remark" SG_ 175 ADC_9_CRC "";
BA_ "EventCommandSignal" SG_ 175 ADC_9_Counter 0;
BA_ "GatewayedSignals" SG_ 175 ADC_9_Counter 0;
BA_ "GenSigInactiveValue" SG_ 175 ADC_9_Counter 0;
BA_ "GenSigInvalidValue" SG_ 175 ADC_9_Counter 0;
BA_ "GenSigSendType" SG_ 175 ADC_9_Counter 1;
BA_ "GenSigStartValue" SG_ 175 ADC_9_Counter 0;
BA_ "GenSigTimeoutValue" SG_ 175 ADC_9_Counter 0;
BA_ "Remark" SG_ 175 ADC_9_Counter "";
BA_ "EventCommandSignal" SG_ 175 ADC_PAAChallengeReceive 1;
BA_ "GatewayedSignals" SG_ 175 ADC_PAAChallengeReceive 0;
BA_ "GenSigInactiveValue" SG_ 175 ADC_PAAChallengeReceive 0;
BA_ "GenSigInvalidValue" SG_ 175 ADC_PAAChallengeReceive 0;
BA_ "GenSigSendType" SG_ 175 ADC_PAAChallengeReceive 0;
BA_ "GenSigStartValue" SG_ 175 ADC_PAAChallengeReceive 0;
BA_ "GenSigTimeoutValue" SG_ 175 ADC_PAAChallengeReceive 0;
BA_ "Remark" SG_ 175 ADC_PAAChallengeReceive "";
BA_ "EventCommandSignal" SG_ 175 PAA_TimeStampYear 1;
BA_ "GatewayedSignals" SG_ 175 PAA_TimeStampYear 0;
BA_ "GenSigInactiveValue" SG_ 175 PAA_TimeStampYear 0;
BA_ "GenSigInvalidValue" SG_ 175 PAA_TimeStampYear 0;
BA_ "GenSigSendType" SG_ 175 PAA_TimeStampYear 0;
BA_ "GenSigStartValue" SG_ 175 PAA_TimeStampYear 0;
BA_ "GenSigTimeoutValue" SG_ 175 PAA_TimeStampYear 0;
BA_ "Remark" SG_ 175 PAA_TimeStampYear "";
BA_ "EventCommandSignal" SG_ 175 ADC_PAAChallenge1SBM 1;
BA_ "GatewayedSignals" SG_ 175 ADC_PAAChallenge1SBM 0;
BA_ "GenSigInactiveValue" SG_ 175 ADC_PAAChallenge1SBM 0;
BA_ "GenSigInvalidValue" SG_ 175 ADC_PAAChallenge1SBM 0;
BA_ "GenSigSendType" SG_ 175 ADC_PAAChallenge1SBM 0;
BA_ "GenSigStartValue" SG_ 175 ADC_PAAChallenge1SBM 0;
BA_ "GenSigTimeoutValue" SG_ 175 ADC_PAAChallenge1SBM 0;
BA_ "Remark" SG_ 175 ADC_PAAChallenge1SBM "";
BA_ "EventCommandSignal" SG_ 175 ADC_PAAChallenge2SBM 1;
BA_ "GatewayedSignals" SG_ 175 ADC_PAAChallenge2SBM 0;
BA_ "GenSigInactiveValue" SG_ 175 ADC_PAAChallenge2SBM 0;
BA_ "GenSigInvalidValue" SG_ 175 ADC_PAAChallenge2SBM 0;
BA_ "GenSigSendType" SG_ 175 ADC_PAAChallenge2SBM 0;
BA_ "GenSigStartValue" SG_ 175 ADC_PAAChallenge2SBM 0;
BA_ "GenSigTimeoutValue" SG_ 175 ADC_PAAChallenge2SBM 0;
BA_ "Remark" SG_ 175 ADC_PAAChallenge2SBM "";
BA_ "EventCommandSignal" SG_ 175 ADC_PAAChallenge1TEL 1;
BA_ "GatewayedSignals" SG_ 175 ADC_PAAChallenge1TEL 0;
BA_ "GenSigInactiveValue" SG_ 175 ADC_PAAChallenge1TEL 0;
BA_ "GenSigInvalidValue" SG_ 175 ADC_PAAChallenge1TEL 0;
BA_ "GenSigSendType" SG_ 175 ADC_PAAChallenge1TEL 0;
BA_ "GenSigStartValue" SG_ 175 ADC_PAAChallenge1TEL 0;
BA_ "GenSigTimeoutValue" SG_ 175 ADC_PAAChallenge1TEL 0;
BA_ "Remark" SG_ 175 ADC_PAAChallenge1TEL "";
BA_ "EventCommandSignal" SG_ 175 ADC_PAAChallenge2TEL 1;
BA_ "GatewayedSignals" SG_ 175 ADC_PAAChallenge2TEL 0;
BA_ "GenSigInactiveValue" SG_ 175 ADC_PAAChallenge2TEL 0;
BA_ "GenSigInvalidValue" SG_ 175 ADC_PAAChallenge2TEL 0;
BA_ "GenSigSendType" SG_ 175 ADC_PAAChallenge2TEL 0;
BA_ "GenSigStartValue" SG_ 175 ADC_PAAChallenge2TEL 0;
BA_ "GenSigTimeoutValue" SG_ 175 ADC_PAAChallenge2TEL 0;
BA_ "Remark" SG_ 175 ADC_PAAChallenge2TEL "";
BA_ "EventCommandSignal" SG_ 175 PAA_TimeStampMonth 1;
BA_ "GatewayedSignals" SG_ 175 PAA_TimeStampMonth 0;
BA_ "GenSigInactiveValue" SG_ 175 PAA_TimeStampMonth 0;
BA_ "GenSigInvalidValue" SG_ 175 PAA_TimeStampMonth 0;
BA_ "GenSigSendType" SG_ 175 PAA_TimeStampMonth 0;
BA_ "GenSigStartValue" SG_ 175 PAA_TimeStampMonth 1;
BA_ "GenSigTimeoutValue" SG_ 175 PAA_TimeStampMonth 0;
BA_ "Remark" SG_ 175 PAA_TimeStampMonth "";
BA_ "EventCommandSignal" SG_ 175 PAA_TimeStampDay 1;
BA_ "GatewayedSignals" SG_ 175 PAA_TimeStampDay 0;
BA_ "GenSigInactiveValue" SG_ 175 PAA_TimeStampDay 0;
BA_ "GenSigInvalidValue" SG_ 175 PAA_TimeStampDay 0;
BA_ "GenSigSendType" SG_ 175 PAA_TimeStampDay 0;
BA_ "GenSigStartValue" SG_ 175 PAA_TimeStampDay 1;
BA_ "GenSigTimeoutValue" SG_ 175 PAA_TimeStampDay 0;
BA_ "Remark" SG_ 175 PAA_TimeStampDay "";
BA_ "EventCommandSignal" SG_ 175 PAA_TimeStampHour 1;
BA_ "GatewayedSignals" SG_ 175 PAA_TimeStampHour 0;
BA_ "GenSigInactiveValue" SG_ 175 PAA_TimeStampHour 0;
BA_ "GenSigInvalidValue" SG_ 175 PAA_TimeStampHour 0;
BA_ "GenSigSendType" SG_ 175 PAA_TimeStampHour 0;
BA_ "GenSigStartValue" SG_ 175 PAA_TimeStampHour 0;
BA_ "GenSigTimeoutValue" SG_ 175 PAA_TimeStampHour 0;
BA_ "Remark" SG_ 175 PAA_TimeStampHour "";
BA_ "EventCommandSignal" SG_ 175 PAA_TimeStampMin 1;
BA_ "GatewayedSignals" SG_ 175 PAA_TimeStampMin 0;
BA_ "GenSigInactiveValue" SG_ 175 PAA_TimeStampMin 0;
BA_ "GenSigInvalidValue" SG_ 175 PAA_TimeStampMin 0;
BA_ "GenSigSendType" SG_ 175 PAA_TimeStampMin 0;
BA_ "GenSigStartValue" SG_ 175 PAA_TimeStampMin 0;
BA_ "GenSigTimeoutValue" SG_ 175 PAA_TimeStampMin 0;
BA_ "Remark" SG_ 175 PAA_TimeStampMin "";
BA_ "EventCommandSignal" SG_ 175 PAA_TimeStampSec 1;
BA_ "GatewayedSignals" SG_ 175 PAA_TimeStampSec 0;
BA_ "GenSigInactiveValue" SG_ 175 PAA_TimeStampSec 0;
BA_ "GenSigInvalidValue" SG_ 175 PAA_TimeStampSec 0;
BA_ "GenSigSendType" SG_ 175 PAA_TimeStampSec 0;
BA_ "GenSigStartValue" SG_ 175 PAA_TimeStampSec 0;
BA_ "GenSigTimeoutValue" SG_ 175 PAA_TimeStampSec 0;
BA_ "Remark" SG_ 175 PAA_TimeStampSec "";
BA_ "EventCommandSignal" SG_ 175 PAA_TimeStampMilliSec 1;
BA_ "GatewayedSignals" SG_ 175 PAA_TimeStampMilliSec 0;
BA_ "GenSigInactiveValue" SG_ 175 PAA_TimeStampMilliSec 0;
BA_ "GenSigInvalidValue" SG_ 175 PAA_TimeStampMilliSec 0;
BA_ "GenSigSendType" SG_ 175 PAA_TimeStampMilliSec 0;
BA_ "GenSigStartValue" SG_ 175 PAA_TimeStampMilliSec 0;
BA_ "GenSigTimeoutValue" SG_ 175 PAA_TimeStampMilliSec 0;
BA_ "Remark" SG_ 175 PAA_TimeStampMilliSec "";
BA_ "EventCommandSignal" SG_ 175 ADC_APAActPushSt 1;
BA_ "GatewayedSignals" SG_ 175 ADC_APAActPushSt 0;
BA_ "GenSigInactiveValue" SG_ 175 ADC_APAActPushSt 0;
BA_ "GenSigInvalidValue" SG_ 175 ADC_APAActPushSt 0;
BA_ "GenSigSendType" SG_ 175 ADC_APAActPushSt 0;
BA_ "GenSigStartValue" SG_ 175 ADC_APAActPushSt 0;
BA_ "GenSigTimeoutValue" SG_ 175 ADC_APAActPushSt 0;
BA_ "Remark" SG_ 175 ADC_APAActPushSt "";
BA_ "EventCommandSignal" SG_ 175 PAA_DVRTriggerId 1;
BA_ "GatewayedSignals" SG_ 175 PAA_DVRTriggerId 0;
BA_ "GenSigInactiveValue" SG_ 175 PAA_DVRTriggerId 0;
BA_ "GenSigInvalidValue" SG_ 175 PAA_DVRTriggerId 0;
BA_ "GenSigSendType" SG_ 175 PAA_DVRTriggerId 0;
BA_ "GenSigStartValue" SG_ 175 PAA_DVRTriggerId 0;
BA_ "GenSigTimeoutValue" SG_ 175 PAA_DVRTriggerId 0;
BA_ "Remark" SG_ 175 PAA_DVRTriggerId "";
BA_ "EventCommandSignal" SG_ 175 PAA_DVRTrigger 1;
BA_ "GatewayedSignals" SG_ 175 PAA_DVRTrigger 0;
BA_ "GenSigInactiveValue" SG_ 175 PAA_DVRTrigger 0;
BA_ "GenSigInvalidValue" SG_ 175 PAA_DVRTrigger 0;
BA_ "GenSigSendType" SG_ 175 PAA_DVRTrigger 0;
BA_ "GenSigStartValue" SG_ 175 PAA_DVRTrigger 0;
BA_ "GenSigTimeoutValue" SG_ 175 PAA_DVRTrigger 0;
BA_ "Remark" SG_ 175 PAA_DVRTrigger "";
BA_ "EventCommandSignal" SG_ 175 ADC_LCAEnableSt 0;
BA_ "GatewayedSignals" SG_ 175 ADC_LCAEnableSt 0;
BA_ "GenSigInactiveValue" SG_ 175 ADC_LCAEnableSt 0;
BA_ "GenSigInvalidValue" SG_ 175 ADC_LCAEnableSt 0;
BA_ "GenSigSendType" SG_ 175 ADC_LCAEnableSt 1;
BA_ "GenSigStartValue" SG_ 175 ADC_LCAEnableSt 0;
BA_ "GenSigTimeoutValue" SG_ 175 ADC_LCAEnableSt 3;
BA_ "Remark" SG_ 175 ADC_LCAEnableSt "";
BA_ "EventCommandSignal" SG_ 175 ADC_HPALearningPathUniqueID 1;
BA_ "GatewayedSignals" SG_ 175 ADC_HPALearningPathUniqueID 0;
BA_ "GenSigInactiveValue" SG_ 175 ADC_HPALearningPathUniqueID 0;
BA_ "GenSigInvalidValue" SG_ 175 ADC_HPALearningPathUniqueID 0;
BA_ "GenSigSendType" SG_ 175 ADC_HPALearningPathUniqueID 0;
BA_ "GenSigStartValue" SG_ 175 ADC_HPALearningPathUniqueID 0;
BA_ "GenSigTimeoutValue" SG_ 175 ADC_HPALearningPathUniqueID 0;
BA_ "Remark" SG_ 175 ADC_HPALearningPathUniqueID "";
BA_ "EventCommandSignal" SG_ 175 Reserved1 0;
BA_ "GatewayedSignals" SG_ 175 Reserved1 0;
BA_ "GenSigInactiveValue" SG_ 175 Reserved1 0;
BA_ "GenSigInvalidValue" SG_ 175 Reserved1 0;
BA_ "GenSigSendType" SG_ 175 Reserved1 1;
BA_ "GenSigStartValue" SG_ 175 Reserved1 0;
BA_ "GenSigTimeoutValue" SG_ 175 Reserved1 0;
BA_ "Remark" SG_ 175 Reserved1 "";
VAL_ 659 ADC_NDASt 0 "NDA disable" 1 "NDA passive" 2 "NDA standby normal" 3 "Not used" 4 "NDA active normal" 5 "Not used" 6 "NDA active standwait" 7 "Not used" 8 "NDA active standactive" 9 "BOM" 10 "Not used" 11 "NDA Lat-Override" 12 "NDA Lng-Override" 13 "Not used" 14 "NDA Lat&Lng Override" 15 "Not used" 16 "Not used" 17 "Not used" 18 "NDA MRM Emergency Lane with Lat-control" 19 "NDA MRM Emergency Lane with Lat&Lng-control" 20 "NDA MRM Ego Lane  with Lat-control" 21 "NDA MRM Ego Lane  with Lat&Lng-control" 22 "Not used" 23 "Not used" 24 "NDA MRC" 25 "NDA failure light" 26 "Not used" 27 "Not used" 28 "Not used" 29 "Not used" 30 "Not used" 31 "Not used" 32 "Not used" 33 "Not used" 34 "Not used" 35 "Not used" 36 "Not used" 37 "Not used" 38 "Not used" 39 "Not used" 40 "Not used" 41 "Not used" 42 "Not used" 43 "Not used" 44 "Not used" 45 "Not used" 46 "Not used" 47 "Not used" 48 "Not used" 49 "Not used" 50 "Not used" 51 "Not used" 52 "Not used" 53 "Not used" 54 "Not used" 55 "Not used" 56 "Not used" 57 "Not used" 58 "Not used" 59 "Not used" 60 "Not used" 61 "Not used" 62 "Not used" 63 "Not used"  ;
VAL_ 659 ADC_NDATORType 0 "No TakeOver" 1 "Driver Brake" 2 "Driver Brake for long time" 3 "Driver Override Steering" 4 "Driver Alert and Override Accele" 5 "Driver fatiger hands on and Override Accele" 6 "Driver Alert and Hands On" 7 "Hands On and Override Accele" 8 "Hands On" 9 "Hands On and Brake" 10 "AD Normal Red Hand" 11 "AD Release Acc Pedal" 12 "AD Brake Pedal" 13 "AD MRM Red Hand" 14 "AD MRM Yellow Hand" 15 "Invalid"  ;
VAL_ 659 ADC_NDADecideResult 0 "No" 1 "Current Lane Cruise" 2 "Lane Bias" 3 "Lane End Lane Change" 4 "Static Obstacle Lane Change" 5 "Y Crossing Lane Change" 6 "Navigation LC to best merge lane" 7 "Navigation LC to best lane main road" 8 "Navigation LC to fast lane main road" 9 "Navigation LC to slow lane main road" 10 "Overtaking Lane Change" 11 "Tunnel not pass lane change" 12 "Enter Ramp Prepare Lane Change" 13 "Indicated Lane Change" 14 "Delta under 30 Defensive LC" 15 "Delta exceed 30 Defensive LC" 16 "Parallel Split" 17 "Direct Split" 18 "Parallel Merge" 19 "Direct Merge"  ;
VAL_ 659 ADC_NDATargetLane 0 "Ego Lane" 1 "ChangeLeft" 2 "ChangeRight" 3 "SplitLeft" 4 "SplitRight" 5 "MergeLeft" 6 "MergeRight" 7 "Not Used"  ;
VAL_ 659 ADC_NDASplitSt 0 "No Split/Merge" 1 "Split" 2 "Merge" 3 "Not used" 4 "Not used" 5 "Not used" 6 "Not used" 7 "Not used"  ;
VAL_ 659 ADC_NDALaneChangeOverlineTOR 0 "No request" 1 "Request"  ;
VAL_ 659 ADC_ALCSuspendReason 0 "No" 1 "Lane marking" 2 "Driver cancel by turn lever" 3 "Driver override" 4 "Target lane encounter high priority lane change" 5 "GAP not available" 6 "Safety Check" 7 "Not Used" 8 "Not Used" 9 "Not Used" 10 "Not Used" 11 "Not Used" 12 "Not Used" 13 "Not Used" 14 "Not Used" 15 "Not Used"  ;
VAL_ 659 ADC_SplitSuspendReason 0 "No" 1 "Lane marking" 2 "Driver trigger turn lever opposite" 3 "Driver override" 4 "Target lane encounter high priority lane change" 5 "GAP not available" 6 "Exceed the Terminal point" 7 "Safety Check" 8 "Not Used" 9 "Not Used" 10 "Not Used" 11 "Not Used" 12 "Not Used" 13 "Not Used" 14 "Not Used" 15 "Not Used"  ;
VAL_ 659 ADC_NDAEnableSt 0 "Disable" 1 "Enable"  ;
VAL_ 659 ADC_NDAFailureReason 0 "No Failure" 1 "NDA Sensor Failure" 2 "NDA IFC Failure" 3 "NDA ADC Failure" 4 "Parking Sensor Failure" 5 "CCU failure" 6 "IMU-6D failure" 7 "SRS failure" 8 "Tbox failure" 9 "EPS1 failure" 10 "EPS2 failure" 11 "EBB failure" 12 "ESC failure" 13 "VCU and relevate system failure" 14 "BCM failure" 15 "DMS failure" 16 "HOD failure" 17 "ICM failure" 18 "ACU failure" 19 "A-CAN failure" 20 "I-CAN failure" 21 "IMU-ETH failure" 22 "IHU-ETH failure" 23 "TBOX-ETH failure" 24 "Power Supply failure" 25 "Hard Button failure"  ;
VAL_ 659 ADC_NDANotactivereason 0 "Meet" 1 "NDA _System Failure" 2 "ODD not meet" 3 "Driver condition not meet" 4 "Vehicle condition not meet" 5 "Driver braking" 6 "Driver lng override" 7 "Driver lat override" 8 "Phase-in not meet" 9 "Collosion" 10 "Navigation" 11 "Software Switch" 12 "Hardware Switch" 13 "TSM deactive"  ;
VAL_ 659 ADC_NDAGeoFence 0 "Not in Geo-fence" 1 "Hands On Geo-fence" 2 "Hands Free Geo-fence" 3 "Not Used"  ;
VAL_ 659 ADC_NDAODDnotMeetreason 0 "Meet" 1 "Geo-fence" 2 "Road Condition" 3 "Weather condition" 4 "Light condition"  ;
VAL_ 659 ADC_ICAAvailableState 0 "Not Available" 1 "Available"  ;
VAL_ 659 ADC_ACCAvailableState 0 "Not Available" 1 "Available"  ;
VAL_ 659 ADC_NDARouteReplanning 0 "No" 1 "Replanning"  ;
VAL_ 659 ADC_SpeedLimitConfirmRequest 0 "No Request" 1 "Request"  ;
VAL_ 659 ADC_LaneChangeType 0 "No Lane Change" 1 "Lane_Lost Lane Change" 2 "Avoid Obstacle Lane Change" 3 "Driver_TurnLever Lane Change" 4 "Aviod Merge or Split Zone Lane Change" 5 "Other Lane Change Type" 6 "Not used" 7 "Effective Lane Change" 8 "Not used" 9 "Construction Zone Lane Change" 10 "Fast Lane Lane Change" 11 "Navigation LC" 12 "Not used" 13 "Not used" 14 "Not used" 15 "Not used" 16 "Not used" 17 "Not used" 18 "Not used" 19 "Not used" 20 "Not used" 21 "Not used" 22 "Not used" 23 "Not used" 24 "Not used" 25 "Not used" 26 "Not used" 27 "Not used" 28 "Not used" 29 "Not used" 30 "Not used" 31 "Not used"  ;
VAL_ 659 ADC_LC_ZoneMatching 0 "No display" 1 "Accelerate search" 2 "Decelerate search" 3 "Not used"  ;
VAL_ 659 ADC_RoadMergeSplitType 0 "No" 1 "Direct Spli" 2 "Parallel Split" 3 "Connect Split" 4 "Left Direct and Right Connect Split" 5 "Left Direct and Right Parallel Split" 6 "Left Parallel and Right Direct Split" 7 "Left Connect and Right Direct Split" 8 "Parallel Merge" 9 "Direct Merge" 10 "Connect Merge" 11 "Left and Right Direct Merge" 12 "Left Direct and Right Parallel Merge" 13 "Left Connect and Right Parallel Merge" 14 "Left and Right Connect Merge"  ;
VAL_ 659 ADC_LaneMergeSplitType 0 "No" 1 "Direct Spli" 2 "Parallel Split" 3 "Connect Split" 4 "Parallel Merge" 5 "Direct Merge" 6 "Connect Merge"  ;
VAL_ 659 ADC_EyesOn_Warning 0 "No request" 1 "Level  1" 2 "Level  2" 3 "Level 3" 4 "Not Used" 5 "Not Used" 6 "Not Used" 7 "Not Used"  ;
VAL_ 659 ADC_TakeOverType 0 "No request" 1 "STOR" 2 "LLTOR" 3 "Not Used" 4 "Not Used" 5 "Not Used" 6 "Not Used" 7 "Not Used"  ;
VAL_ 659 ADC_TakeOverWarningLevel 0 "No request" 1 "Level  1" 2 "Level  2" 3 "Level 3" 4 "Not Used" 5 "Not Used" 6 "Not Used" 7 "Not Used"  ;
VAL_ 659 ADC_NDAMRMWarningLevel 0 "No request" 1 "Level  1" 2 "Level  2" 3 "Level 3" 4 "Not Used" 5 "Not Used" 6 "Not Used" 7 "Not Used"  ;
VAL_ 659 ADC_ADASTransitionType 0 "no" 1 "ACC to NDA" 2 "ACC to ICA" 3 "ICA to NDA" 4 "NDA to ACC" 5 "ICA to ACC" 6 "NDA to ICA"  ;
VAL_ 659 ADC_FuncReq_SentryModWarn 0 "OFF" 1 "SentryModeWake"  ;
VAL_ 659 ADC_TlaWarning 0 "no request" 1 "No Warning" 2 "Red Light Warning" 3 "Start Warning" 4 "Reserved" 5 "Reserved" 6 "Reserved" 7 "Invalid"  ;
VAL_ 659 ADC_TlaFault 0 "no request" 1 "No fault" 2 "Fault" 3 "Invalid"  ;
VAL_ 659 ADC_FcwWaning 0 "no request" 1 "Off" 2 "Standby" 3 "Active_level1" 4 "Active_level2" 5 "Nolicense" 6 "Reserved" 7 "Invalid"  ;
VAL_ 659 ADC_AebFault 0 "no request" 1 "no fault" 2 "fault" 3 "Invalid"  ;
VAL_ 659 ADC_RaebWarning 0 "no request" 1 "off" 2 "Active" 3 "Hold" 4 "Inactive (standby)" 5 "Nolicense" 6 "Warning" 7 "Reserved"  ;
VAL_ 659 ADC_RaebFault 0 "no request" 1 "No fault" 2 "Fault" 3 "Invalid"  ;
VAL_ 659 ADC_RcwFault 0 "no request" 1 "No fault" 2 "Fault" 3 "Invalid"  ;
VAL_ 659 ADC_FctbLeftWarning 0 "no request" 1 "Off" 2 "Active_Left" 3 "IBA" 4 "Hold" 5 "inactive (standby)" 6 "Nolicense" 7 "Invalid"  ;
VAL_ 659 ADC_FctbRightWarning 0 "no request" 1 "Off" 2 "Active_Right" 3 "IBA" 4 "Hold" 5 "inactive (standby)" 6 "Nolicense" 7 "Invalid"  ;
VAL_ 659 ADC_RctaFault 0 "no request" 1 "No fault" 2 "Fault" 3 "Invalid"  ;
VAL_ 659 ADC_RctbLeftWarning 0 "no request" 1 "Off" 2 "Active_Left" 3 "Hold" 4 "Inactive (Standby)" 5 "Nolicense" 6 "Reserved" 7 "Invalid"  ;
VAL_ 659 ADC_RctbRightWarning 0 "no request" 1 "Off" 2 "Active_Right" 3 "Hold" 4 "Inactive (Standby)" 5 "Nolicense" 6 "Reserved" 7 "Invalid"  ;
VAL_ 659 ADC_LdwFault 0 "no request" 1 "No fault" 2 "Fault" 3 "Invalid"  ;
VAL_ 659 ADC_LkaFault 0 "no request" 1 "No fault" 2 "Fault" 3 "Invalid"  ;
VAL_ 659 ADC_BsdFault 0 "no request" 1 "No fault" 2 "Fault" 3 "Invalid"  ;
VAL_ 659 ADC_DowFault 0 "no request" 1 "No fault" 2 "Fault" 3 "Invalid"  ;
VAL_ 659 ADC_TsrFault 0 "no request" 1 "No fault" 2 "Fault" 3 "Invalid"  ;
VAL_ 659 ADC_ElkaWarning 0 "no request" 1 "Off" 2 "Standby" 3 "Ready" 4 "Active_Left" 5 "Active_Right" 6 "Switchoff" 7 "Invalid"  ;
VAL_ 659 ADC_ElkaFault 0 "no request" 1 "No fault" 2 "Fault" 3 "Invalid"  ;
VAL_ 659 ADC_IMUTimestampVld 0 "Invalid" 1 "Valid"  ;
VAL_ 659 ADC_IMUAccVld 0 "Invalid" 1 "Valid"  ;
VAL_ 659 ADC_IMUGyroVld 0 "Invalid" 1 "Valid"  ;
VAL_ 659 ADC_IMUAttitudeVld 0 "Invalid" 1 "Valid"  ;
VAL_ 659 ADC_IMUPositionType 0 "No?Solution" 1 "Gnss" 2 "RTK" 3 "Resersed" 4 "Resersed" 5 "Resersed" 6 "Resersed" 7 "Resersed" 8 "Resersed" 9 "Resersed" 10 "Resersed" 11 "Resersed" 12 "Resersed" 13 "Resersed" 14 "Resersed" 15 "Resersed"  ;
VAL_ 923 ADC_FrontWideCameraSt 0 "No Failure" 1 "Failure" 2 "Blockage" 3 "Calibration failed" 4 "Angle not meet"  ;
VAL_ 923 ADC_FrontNarrowCameraSt 0 "No Failure" 1 "Failure" 2 "Blockage" 3 "Calibration failed" 4 "Angle not meet"  ;
VAL_ 923 ADC_LeftFrontCameraSt 0 "No Failure" 1 "Failure" 2 "Blockage" 3 "Calibration failed" 4 "Angle not meet"  ;
VAL_ 923 ADC_LeftRearCameraSt 0 "No Failure" 1 "Failure" 2 "Blockage" 3 "Calibration failed" 4 "Angle not meet"  ;
VAL_ 923 ADC_RightFrontCameraSt 0 "No Failure" 1 "Failure" 2 "Blockage" 3 "Calibration failed" 4 "Angle not meet"  ;
VAL_ 923 ADC_RightRearCameraSt 0 "No Failure" 1 "Failure" 2 "Blockage" 3 "Calibration failed" 4 "Angle not meet"  ;
VAL_ 923 ADC_RearCameraSt 0 "No Failure" 1 "Failure" 2 "Blockage" 3 "Calibration failed" 4 "Angle not meet"  ;
VAL_ 923 ADC_FrontRadarSt 0 "No Failure" 1 "Failure" 2 "Blockage" 3 "Calibration failed" 4 "Angle not meet"  ;
VAL_ 923 ADC_LeftFrontRadarSt 0 "No Failure" 1 "Failure" 2 "Blockage" 3 "Calibration failed" 4 "Angle not meet"  ;
VAL_ 923 ADC_LeftRearRadarSt 0 "No Failure" 1 "Failure" 2 "Blockage" 3 "Calibration failed" 4 "Angle not meet"  ;
VAL_ 923 ADC_RightFrontRadarSt 0 "No Failure" 1 "Failure" 2 "Blockage" 3 "Calibration failed" 4 "Angle not meet"  ;
VAL_ 923 ADC_RightRearRadarSt 0 "No Failure" 1 "Failure" 2 "Blockage" 3 "Calibration failed" 4 "Angle not meet"  ;
VAL_ 923 ADC_RearRadarSt 0 "No Failure" 1 "Failure" 2 "Blockage" 3 "Calibration failed" 4 "Angle not meet"  ;
VAL_ 923 ADC_FrontLidarSt 0 "No Failure" 1 "Failure" 2 "Blockage" 3 "Calibration failed" 4 "Angle not meet"  ;
VAL_ 923 ADC_LeftLidarSt 0 "No Failure" 1 "Failure" 2 "Blockage" 3 "Calibration failed" 4 "Angle not meet"  ;
VAL_ 923 ADC_RightLidarSt 0 "No Failure" 1 "Failure" 2 "Blockage" 3 "Calibration failed" 4 "Angle not meet"  ;
VAL_ 923 ADC_SunroofOpenCloseReq 0 "No request" 1 "Request close sunroof" 2 "Request open sunroof" 3 "Not used"  ;
VAL_ 923 ADC_SentryStatus 0 "OFF" 1 "Standby" 2 "Warn" 3 "Alarm"  ;
VAL_ 923 ADC_SOCWakeupHVReq 0 "No Request" 1 "Request"  ;
VAL_ 923 ADC_SystemState 0 "DeepSleep" 1 "LightSleep" 2 "Active" 3 "PartialActive" 4 "Reserved" 5 "Reserved" 6 "Reserved" 7 "Reserved" 8 "Reserved" 9 "Reserved" 10 "Reserved" 11 "Reserved" 12 "Reserved" 13 "Reserved" 14 "Reserved" 15 "Invalid"  ;
VAL_ 923 ADC_HWFailureReason 0 "No Failure" 1 "SOC Failure" 2 "MCU Failure" 3 "Others Failure" 4 "Not Used" 5 "Not Used" 6 "Not Used" 7 "Not Used"  ;
VAL_ 923 ADC_SWFailureReason 0 "No Failure" 1 "perception failure" 2 "Localization Fusion" 3 "EHP" 4 "Control" 5 "Automation" 6 "OTA" 7 "Calibration module" 8 "Data module" 9 "TSM" 10 "CID" 11 "Not Used" 12 "Not Used" 13 "Not Used" 14 "Not Used" 15 "Not Used" 16 "Not Used" 17 "Not Used" 18 "Not Used" 19 "Not Used" 20 "Not Used" 21 "Not Used" 22 "Not Used" 23 "Not Used" 24 "Not Used" 25 "Not Used" 26 "Not Used" 27 "Not Used" 28 "Not Used" 29 "Not Used" 30 "Not Used" 31 "Not Used"  ;
VAL_ 923 Fault_MAL_HOR_ABS_EVENT 0 "Not Fault" 1 "Fault"  ;
VAL_ 923 Fault_MAL_HOR_REL_EVENT 0 "Not Fault" 1 "Fault"  ;
VAL_ 923 Fault_MAL_VER_ABS_EVENT 0 "Not Fault" 1 "Fault"  ;
VAL_ 923 Fault_MAL_VER_REL_EVENT 0 "Not Fault" 1 "Fault"  ;
VAL_ 923 elOutOfSpecCause 0 "No Out" 1 "Out" 0 "No Out" 1 "Out"  ;
VAL_ 923 azOutOfSpecCause 0 "No Out" 1 "Out" 0 "No Out" 1 "Out"  ;
VAL_ 923 azOutOfProfileCause 0 "No Out" 1 "Out"  ;
VAL_ 923 elOutOfProfileCause 0 "No Out" 1 "Out"  ;
VAL_ 923 ADC_FuncReq_SentryModDetec 0 "OFF" 1 "SentryModeKeep"  ;
VAL_ 667 ADC_LlnMrkingDispSt 0 "No display" 1 "tracking" 2 "intervening" 3 "warning"  ;
VAL_ 667 ADC_LLnMrking_Type 0 "No display" 1 "dashed" 2 "solid" 3 "Fishbone deceleration line（dashed）" 4 "Fishbone deceleration line（solid）" 5 "road edge" 6 "curb" 7 "Cone barrel" 8 "Plastic fence" 9 "barrier" 10 "parking cars" 11 "not used" 12 "not used" 13 "not used" 14 "not used" 15 "not used"  ;
VAL_ 667 ADC_RlnMrkingDispSt 0 "No display" 1 "tracking" 2 "intervening" 3 "warning"  ;
VAL_ 667 ADC_RLnMrking_Type 0 "No display" 1 "dashed" 2 "solid" 3 "Fishbone deceleration line（dashed）" 4 "Fishbone deceleration line（solid）" 5 "road edge" 6 "curb" 7 "Cone barrel" 8 "Plastic fence" 9 "barrier" 10 "parking cars" 11 "not used" 12 "not used" 13 "not used" 14 "not used" 15 "not used"  ;
VAL_ 667 ADC_AdjLlnMrkingDispSt 0 "No display" 1 "display"  ;
VAL_ 667 ADC_AdjLLnMrking_Type 0 "No display" 1 "dashed" 2 "solid" 3 "Fishbone deceleration line（dashed）" 4 "Fishbone deceleration line（solid）" 5 "road edge" 6 "curb" 7 "Cone barrel" 8 "Plastic fence" 9 "barrier" 10 "parking cars" 11 "not used" 12 "not used" 13 "not used" 14 "not used" 15 "not used"  ;
VAL_ 667 ADC_AdjRlnMrkingDispSt 0 "No display" 1 "display"  ;
VAL_ 667 ADC_AdjRLnMrking_Type 0 "No display" 1 "dashed" 2 "solid" 3 "Fishbone deceleration line（dashed）" 4 "Fishbone deceleration line（solid）" 5 "road edge" 6 "curb" 7 "Cone barrel" 8 "Plastic fence" 9 "barrier" 10 "parking cars" 11 "not used" 12 "not used" 13 "not used" 14 "not used" 15 "not used"  ;
VAL_ 947 ADC_LowBeamReq 0 "No Request" 1 "turn on" 2 "turn off"  ;
VAL_ 947 ADC_IHBC_HighBeamReq 0 "No Request" 1 "Request"  ;
VAL_ 947 ADC_FlashReq 0 "No Request" 1 "turn on" 2 "turn off"  ;
VAL_ 947 ADC_PositionLampReq 0 "No Request" 1 "turn on" 2 "turn off"  ;
VAL_ 947 ADC_HVACCtrlReq 0 "No Requset" 1 "Requset Open"  ;
VAL_ 947 ADC_FFogLightReq 0 "No Request" 1 "turn on" 2 "turn off"  ;
VAL_ 947 ADC_RFogLightReq 0 "No Request" 1 "turn on" 2 "turn off"  ;
VAL_ 947 ADC_HornReq 0 "No Request" 1 "Continuous On 1" 2 "Continuous On 2" 3 "Off" 4 "Remind" 5 "Alarm"  ;
VAL_ 947 ADC_FWiperReq 0 "No Request" 1 "MIST" 2 "Continuous slow" 3 "Continuous fast" 4 "turn off Wiper" 5 "Auto Control"  ;
VAL_ 947 ADC_RWiperReq 0 "No Request" 1 "MIST" 2 "Continuous slow" 3 "Continuous fast" 4 "turn off Wiper"  ;
VAL_ 947 ADC_FWaterSprayReq 0 "No Request" 1 "On" 2 "Off"  ;
VAL_ 947 ADC_RWaterSprayReq 0 "No Request" 1 "On" 2 "Off"  ;
VAL_ 947 ADC_CCUReqVD 0 "not valid" 1 "valid"  ;
VAL_ 947 ADC_WindowOpenReq 0 "No request" 1 "Request open all windows"  ;
VAL_ 947 ADC_WindowCloseReq 0 "No request" 1 "Request Close all windows"  ;
VAL_ 947 ADC_PLGMOpenReq 0 "No request" 1 "Request"  ;
VAL_ 947 ADC_PLGMCloseReq 0 "No request" 1 "Request"  ;
VAL_ 947 ADC_FDemistReq 0 "No Request" 1 "On" 2 "Off"  ;
VAL_ 947 ADC_RDemistReq 0 "No Request" 1 "On" 2 "Off"  ;
VAL_ 947 ADC_ThmPostRun 0 "TMS is not required to respond to ADC cooling flow request" 1 "TMS is required to respind to ADC cooling flow request"  ;
VAL_ 947 ADC_DriverFaceWindReq 0 "No Request" 1 "On" 2 "Off"  ;
VAL_ 947 ADC_EcallReq 0 "Not Request" 1 "Request"  ;
VAL_ 947 ADC_DriverSeatBeltPretightenReq 0 "Not Request" 1 "Request"  ;
VAL_ 947 ADC_LockReq 0 "No Request" 1 "Lock" 2 "Unlock" 3 "LockandArm" 4 "UnlockandDisarm" 5 "Reserved" 6 "Reserved" 7 "Reserved"  ;
VAL_ 947 ADC_HoldLockReq 0 "No Request" 1 "HoldLock" 2 "HoldUnlock" 3 "HoldShield"  ;
VAL_ 947 ADC_RearMirrorReq 0 "No?Request" 1 "Unfold" 2 "Fold" 3 "Reserved"  ;
VAL_ 947 ADC_HoldRearMirrorReq 0 "No?Request" 1 "Hold Unfold" 2 "Hold Fold" 3 "Reserved"  ;
VAL_ 947 ADC_ADSLightReq 0 "No request" 1 "Blue continue" 2 "Off" 3 "Reserved" 4 "Reserved" 5 "Reserved" 6 "Reserved" 7 "Reserved"  ;
VAL_ 947 ADC_DriverSeatBeltVibrWarnReq 0 "No Request" 1 "Mode 1" 2 "Mode 2" 3 "Mode 3" 4 "Reserved" 5 "Reserved" 6 "Reserved" 7 "Reserved"  ;
VAL_ 947 ADC_FrtWindshildHeatReq 0 "No Request" 1 "On" 2 "Off" 3 "reserve"  ;
VAL_ 947 ADC_BeamSwReq 0 "No request" 1 "Auto_mode" 2 "Position_light (reserve)" 3 "Low_beam (reserve)"  ;
VAL_ 947 IFC_SysCalibrationSt 0 "Calibration Success" 1 "Calibration In Process" 2 "Calibration Failed" 3 "Not used"  ;
VAL_ 947 ADC_ADBIHBCEnableReq 0 "No Request" 1 "Turn on" 2 "Reserved" 3 "Reserved"  ;
VAL_ 947 ADC_LowPowerReqVD_A 0 "Not valid" 1 "Valid"  ;
VAL_ 947 ADC_LowPowerReq_A 0 "Not Request" 1 "Low Power"  ;
VAL_ 947 ADC_MachineStatus 0 "default" 1 "Modechanging" 2 "Active Mode" 3 "PartialActive Mode"  ;
VAL_ 947 ADC_LowPowerFailReason 0 "Default" 1 "ADS Function Active" 2 "Machine is not available" 3 "OTA"  ;
VAL_ 947 ADC_LightbarReq 0 "No request;" 1 "White;" 2 "Blue;" 3 "Orange;" 4 "Red;" 5 "Reserved;" 6 "Reserved;" 7 "Reserved;" 8 "Reserved;" 9 "Reserved;" 10 "Reserved;" 11 "Reserved;" 12 "Reserved;" 13 "Reserved;" 14 "Reserved;" 15 "Invalid;"  ;
VAL_ 947 ADC_ChgPortControlReq 0 "No Request" 1 "Close" 2 "Open" 3 "Reserved"  ;
VAL_ 947 ADC_ChgPortHoldControlReq 0 "No Request" 1 "HoldClose" 2 "HoldOpen" 3 "HoldShield"  ;
VAL_ 947 ADC_ChargHoldReq 0 "No Request" 1 "HoldStart" 2 "HoldStop" 3 "HoldShield"  ;
VAL_ 947 ADC_ChargReq 0 "No Request" 1 "Start" 2 "Stop" 3 "Reserved"  ;
VAL_ 947 ADC_ChargGunHoldReq 0 "No Request" 1 "HoldClose" 2 "HoldOpen" 3 "HoldShield"  ;
VAL_ 947 ADC_ChargGunReq 0 "No Request" 1 "Close" 2 "Open" 3 "Reserved"  ;
VAL_ 947 ADC_InteractLightReq 0 "norequest" 1 "Mode1" 2 "Mode2" 3 "Mode3" 4 "Mode4" 5 "Mode5" 6 "Mode6" 7 "Mode7" 8 "Mode8" 9 "Mode9" 10 "Mode10" 11 "Mode11" 12 "Mode12" 13 "Mode13" 14 "Mode14" 15 "Mode15" 16 "Mode16" 17 "Mode17" 18 "Mode18" 19 "Mode19" 20 "Mode20" 21 "Mode21" 22 "reserved" 23 "reserved" 24 "reserved" 25 "reserved" 26 "reserved" 27 "reserved" 28 "reserved" 29 "reserved" 30 "reserved" 31 "reserved"  ;
VAL_ 121 ADC_SEC_KEY_Defaultencoding 0 "Matching succeeded (saving key and default_encoding succeeded)" 1 "key save succeeded, default_encoding  save failed" 2 "key save failed, default_encoding  save succeeded" 3 "Matching failed（saving key and default_encoding failed）" 4 "reserved" 5 "reserved" 6 "reserved" 7 "reserved"  ;
VAL_ 175 ADC_PAAChallengeReceive 0 "No Receive" 1 "Receive"  ;
VAL_ 175 ADC_APAActPushSt 0 "Not Push" 1 "SenslesEtyParkingPush"  ;
VAL_ 175 PAA_DVRTriggerId 0 "Real time Video Request" 1 "AEB Trigger" 2 "FCW Trigger" 3 "ABP Request" 4 "Crash happen" 5 "LongAccel Over limit" 6 "APA Terminated" 7 "HWA ILCLeft Trigger" 8 "HWA ILCRight Trigger" 9 "HWA TakeOver Trigger" 10 "HWA SafeStop" 11 "RAEB Active" 12 "Parking Real time Video Request" 13 "Reserve" 14 "Reserve" 15 "Reserve" 16 "Reserve" 17 "Reserve" 18 "Reserve" 19 "Reserve" 20 "Reserve" 21 "Reserve" 22 "Reserve" 23 "Reserve" 24 "Reserve" 25 "Reserve" 26 "Reserve" 27 "Reserve" 28 "Reserve" 29 "Reserve" 30 "Reserve" 31 "Reserve"  ;
VAL_ 175 PAA_DVRTrigger 0 "No trigger" 1 "Trigger"  ;
VAL_ 175 ADC_LCAEnableSt 0 "Off" 1 "On" 2 "Failure" 3 "reserved"  ;
