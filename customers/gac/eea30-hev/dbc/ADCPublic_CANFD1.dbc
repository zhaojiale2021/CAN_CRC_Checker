VERSION "Version"

NS_ :

BS_:

BU_: Tester CCU INU ADC RRR RLR CCURT1 CCURT2 ZCUF ZCUL ZCUR ZCUT EMS IDM DCDC DCDCI IPS NIDU DCU2 OBC OPC LPC CPC EMCM GCU DCU IPU BMS EOP EVCC DCDC2 EDL SRS ECS EPS EPB RBM IBCS ICM IID IDC AMP WHUD ARHUD IMR FIMR CD IFC FAPA PAS PCS SCMF SCMR SCMRL SCMRR MFS DRM FCP RCP LBMSAD AVAS DLPFL FBLCM FLISD FLLCM FRLCM RLLCMA RLLCMB RRLCMA RRLCMB RLISD DLPML DLPMR TRM PSDL PSDR FLDCM FRDCM HVSPRL HVSPRR RFR SBM WCM ETC TBOX2 TBOX RLBMS EBU FLPDM RLPDM FRPDM RRPDM FLOAR FROAR RLOAR RROAR EOSL EOSR EOST PRBU RT1_C0 OTAWL RT2_C3 IDUR PHUDD RAS CBM PLGM TMC LPC2 SAS RCICP SCMRM SCMT SLMRL SLMRR IDU RRISD DSASBM LBMS RT1_C1

BO_ 915 ADC_3: 64 ADC
 SG_ ADC_3_CRC : 7|16@0+ (1,0) [0|65535] ""  CCU,CCURT1,RT1_C1,INU
 SG_ ADC_3_Counter : 23|8@0+ (1,0) [0|255] ""  CCU,CCURT1,RT1_C1,INU
 SG_ ADC_FroTrkTargt0ObjClass : 31|4@0+ (1,0) [0|15] ""  CCU,CCURT1,RT1_C1
 SG_ ADC_FroTrkTargt0St : 27|1@0+ (1,0) [0|1] ""  CCU,CCURT1,RT1_C1
 SG_ ADC_FroTrkTargt0longPos : 25|10@0+ (0.2,0) [0|204.4] "m"  CCU,CCURT1,RT1_C1
 SG_ ADC_FroTrkTargt0latPos : 47|10@0+ (0.1,-51.2) [-51.2|51.1] "m"  CCU,CCURT1,RT1_C1
 SG_ ADC_FroTrkTargt0LatRelSpd : 53|9@0+ (0.1,-25.5) [-25.5|25.5] "m/s"  CCU,CCURT1,RT1_C1
 SG_ ADC_FroTrkTargt0LongRelSpd : 60|10@0+ (0.1,-51.2) [-51.2|51.1] "m/s"  CCU,CCURT1,RT1_C1
 SG_ ADC_FroTrkTargt0DetSensor : 79|4@0+ (1,0) [0|15] ""  CCU,CCURT1
 SG_ ADC_FroTrkTargt1ObjClass : 75|4@0+ (1,0) [0|15] ""  CCU,CCURT1,RT1_C1
 SG_ ADC_FroTrkTargt1St : 87|1@0+ (1,0) [0|1] ""  CCU,CCURT1,RT1_C1
 SG_ ADC_FroTrkTargt1longPos : 86|10@0+ (0.2,0) [0|204.4] "m"  CCU,CCURT1,RT1_C1
 SG_ ADC_FroTrkTargt1latPos : 92|10@0+ (0.1,-51.2) [-51.2|51.1] "m"  CCU,CCURT1,RT1_C1
 SG_ ADC_FroTrkTargt1LatRelSpd : 98|9@0+ (0.1,-25.5) [-25.5|25.5] "m/s"  CCU,CCURT1,RT1_C1
 SG_ ADC_FroTrkTargt1LongRelSpd : 105|10@0+ (0.1,-51.2) [-51.2|51.1] "m/s"  CCU,CCURT1,RT1_C1
 SG_ ADC_FroTrkTargt1DetSensor : 127|4@0+ (1,0) [0|15] ""  CCU,CCURT1
 SG_ ADC_FroTrkTargt2ObjClass : 123|4@0+ (1,0) [0|15] ""  CCU,CCURT1,RT1_C1
 SG_ ADC_FroTrkTargt2St : 135|1@0+ (1,0) [0|1] ""  CCU,CCURT1,RT1_C1
 SG_ ADC_FroTrkTargt2longPos : 134|10@0+ (0.2,0) [0|204.4] "m"  CCU,CCURT1,RT1_C1
 SG_ ADC_FroTrkTargt2latPos : 140|10@0+ (0.1,-51.2) [-51.2|51.1] "m"  CCU,CCURT1,RT1_C1
 SG_ ADC_FroTrkTargt2LatRelSpd : 146|9@0+ (0.1,-25.5) [-25.5|25.5] "m/s"  CCU,CCURT1,RT1_C1
 SG_ ADC_FroTrkTargt2LongRelSpd : 167|10@0+ (0.1,-51.2) [-51.2|51.1] "m/s"  CCU,CCURT1,RT1_C1
 SG_ ADC_FroTrkTargt2DetSensor : 183|4@0+ (1,0) [0|15] ""  CCU,CCURT1
 SG_ ADC_FroTrkTargt3ObjClass : 179|4@0+ (1,0) [0|15] ""  CCU,CCURT1,RT1_C1
 SG_ ADC_FroTrkTargt3St : 191|1@0+ (1,0) [0|1] ""  CCU,CCURT1,RT1_C1
 SG_ ADC_FroTrkTargt3longPos : 190|10@0+ (0.2,0) [0|204.4] "m"  CCU,CCURT1,RT1_C1
 SG_ ADC_FroTrkTargt3latPos : 196|10@0+ (0.1,-51.2) [-51.2|51.1] "m"  CCU,CCURT1,RT1_C1
 SG_ ADC_FroTrkTargt3LatRelSpd : 202|9@0+ (0.1,-25.5) [-25.5|25.5] "m/s"  CCU,CCURT1,RT1_C1
 SG_ ADC_FroTrkTargt3LongRelSpd : 209|10@0+ (0.1,-51.2) [-51.2|51.1] "m/s"  CCU,CCURT1,RT1_C1
 SG_ ADC_FroTrkTargt3DetSensor : 231|4@0+ (1,0) [0|15] ""  CCU,CCURT1
 SG_ ADC_ReaTrkTargt4ObjClass : 227|4@0+ (1,0) [0|15] ""  CCU,CCURT1
 SG_ ADC_ReaTrkTargt4St : 239|1@0+ (1,0) [0|1] ""  CCU,CCURT1
 SG_ ADC_ReaTrkTargt4longPos : 238|9@0+ (0.2,0) [0|102] "m"  CCU,CCURT1
 SG_ ADC_ReaTrkTargt4latPos : 245|10@0+ (0.1,-51.2) [-51.2|51.1] "m"  CCU,CCURT1
 SG_ ADC_ReaTrkTargt4LatRelSpd : 251|9@0+ (0.1,-25.5) [-25.5|25.5] "m/s"  CCU,CCURT1
 SG_ ADC_ReaTrkTargt4LongRelSpd : 257|10@0+ (0.1,-51.2) [-51.2|51.1] "m/s"  CCU,CCURT1
 SG_ ADC_ReaTrkTargt4DetSensor : 279|4@0+ (1,0) [0|15] ""  CCU,CCURT1
 SG_ ADC_ReaTrkTargt5ObjClass : 275|4@0+ (1,0) [0|15] ""  CCU,CCURT1
 SG_ ADC_ReaTrkTargt5St : 287|1@0+ (1,0) [0|1] ""  CCU,CCURT1
 SG_ ADC_ReaTrkTargt5longPos : 286|9@0+ (0.2,0) [0|102] "m"  CCU,CCURT1
 SG_ ADC_ReaTrkTargt5latPos : 293|10@0+ (0.1,-51.2) [-51.2|51.1] "m"  CCU,CCURT1
 SG_ ADC_ReaTrkTargt5LatRelSpd : 299|9@0+ (0.1,-25.5) [-25.5|25.5] "m/s"  CCU,CCURT1
 SG_ ADC_ReaTrkTargt5LongRelSpd : 305|10@0+ (0.1,-51.2) [-51.2|51.1] "m/s"  CCU,CCURT1
 SG_ ADC_ReaTrkTargt5DetSensor : 327|4@0+ (1,0) [0|15] ""  CCU,CCURT1
 SG_ ADC_ReaTrkTargt6ObjClass : 323|4@0+ (1,0) [0|15] ""  CCU,CCURT1
 SG_ ADC_ReaTrkTargt6St : 335|1@0+ (1,0) [0|1] ""  CCU,CCURT1
 SG_ ADC_ReaTrkTargt6longPos : 334|9@0+ (0.2,0) [0|102] "m"  CCU,CCURT1
 SG_ ADC_ReaTrkTargt6latPos : 341|10@0+ (0.1,-51.2) [-51.2|51.1] "m"  CCU,CCURT1
 SG_ ADC_ReaTrkTargt6LatRelSpd : 347|9@0+ (0.1,-25.5) [-25.5|25.5] "m/s"  CCU,CCURT1
 SG_ ADC_ReaTrkTargt6LongRelSpd : 353|10@0+ (0.1,-51.2) [-51.2|51.1] "m/s"  CCU,CCURT1
 SG_ ADC_ReaTrkTargt6DetSensor : 375|4@0+ (1,0) [0|15] ""  CCU,CCURT1
 SG_ ADC_RadarPowerDownReq : 371|2@0+ (1,0) [0|3] ""  CCU,CCURT1,RT1_C0
 SG_ ADC_RadarPowerDownReqVD : 369|1@0+ (1,0) [0|1] ""  CCU,CCURT1,RT1_C0
 SG_ ADC_UPSPowerDownReq : 383|2@0+ (1,0) [0|3] ""  CCU,CCURT1,RT1_C0
 SG_ ADC_UPSPowerDownReqVD : 368|1@0+ (1,0) [0|1] ""  CCU,CCURT1,RT1_C0
 SG_ ADC_LidarPowerDownReq : 381|2@0+ (1,0) [0|3] ""  CCU,CCURT1,RT1_C0
 SG_ ADC_LidarPowerDownReqVD : 379|1@0+ (1,0) [0|1] ""  CCU,CCURT1,RT1_C0
 SG_ ADC_IFCPowerDownReq : 378|2@0+ (1,0) [0|3] ""  CCU,CCURT1,RT1_C0,IFC
 SG_ ADC_IFCPowerDownReqVD : 376|1@0+ (1,0) [0|1] ""  CCU,CCURT1,RT1_C0,IFC
 SG_ ADC_LowPowerReqVD : 389|1@0+ (1,0) [0|1] ""  CCU,CCURT1,INU,IFC
 SG_ ADC_LowPowerReq : 391|2@0+ (1,0) [0|3] ""  CCU,CCURT1,INU,IFC
 SG_ Reserved1 : 440|1@0+ (1,0) [0|0] ""  CCU,CCURT1

BO_ 1188 ADC_BigDataDTC: 64 ADC
 SG_ ADC_DTC : 7|512@0+ (1,0) [0|0] ""  CCU

BO_ 387 ADC_4_New: 64 ADC
 SG_ ADC_4_New_CRC : 7|16@0+ (1,0) [0|65535] ""  CCU,CCURT1,CCURT2,RT1_C1,RT2_C3
 SG_ ADC_4_New_Counter : 23|8@0+ (1,0) [0|255] ""  CCU,CCURT1,CCURT2,RT1_C0,RT1_C1,RT2_C3
 SG_ ADC_AngReqSt_A : 31|2@0+ (1,0) [0|3] ""  CCU,CCURT1,CCURT2
 SG_ ADC_AngReqFunction : 29|2@0+ (1,0) [0|3] ""  CCU,CCURT1,CCURT2
 SG_ ADC_BrakeLightReq : 27|2@0+ (1,0) [0|3] ""  CCU,CCURT1,CCURT2,RT2_C3
 SG_ ADC_StrAngleReq_A : 39|16@0+ (0.1,-780) [-780|780] "deg"  CCU,CCURT1,CCURT2
 SG_ ADC_SACMotorTorLimExtMax_A : 55|8@0+ (0.02,0) [0|5.08] "Nm"  CCU,CCURT1,CCURT2
 SG_ ADC_SACMotorTorLimExtMin_A : 63|8@0+ (0.02,-5.08) [-5.08|0] "Nm"  CCU,CCURT1,CCURT2
 SG_ ADC_AssistParaSwitchReq : 71|1@0+ (1,0) [0|1] ""  CCU,CCURT1,CCURT2
 SG_ ADC_SteerGainReq : 69|1@0+ (1,0) [0|1] ""  CCU,CCURT1,CCURT2
 SG_ ADC_StrgWhlVibrWarnLevel : 68|2@0+ (1,0) [0|3] ""  CCU,CCURT1,CCURT2
 SG_ ADC_ActTrqReqEnable : 66|1@0+ (1,0) [0|1] ""  CCU,CCURT1,CCURT2,RT1_C1
 SG_ ADC_SteerGainLevel : 79|8@0+ (1,0) [0|254] "%"  CCU,CCURT1,CCURT2
 SG_ ADC_EvsSteerReq : 87|1@0+ (1,0) [0|1] ""  CCU,CCURT1,CCURT2
 SG_ ADC_StrgWhlVibrWarnReq : 86|1@0+ (1,0) [0|1] ""  CCU,CCURT1,CCURT2
 SG_ ADC_ActTrqReq : 85|14@0+ (1,-5000) [-5000|5000] "Nm"  CCU,CCURT1,CCURT2,RT1_C1
 SG_ ADC_DrvTarTqMod2EPB : 124|2@0+ (1,0) [0|3] ""  CCU,CCURT1,CCURT2
 SG_ ADC_LongCtrlTypReq : 143|1@0+ (1,0) [0|1] ""  CCU,CCURT1,CCURT2
 SG_ ADC_AEBFaultSt : 263|1@0+ (1,0) [0|1] ""  CCU,CCURT1,CCURT2,RT1_C1
 SG_ ADC_AEBOffSt : 262|1@0+ (1,0) [0|1] ""  CCU,CCURT1,CCURT2,RT1_C1
 SG_ ADC_AEBInterventionSt : 261|1@0+ (1,0) [0|1] ""  CCU,CCURT1,CCURT2,RT1_C1
 SG_ ADC_AEBDecelCtrlReq : 260|1@0+ (1,0) [0|1] ""  CCU,CCURT1,CCURT2,RT1_C1
 SG_ ADC_AEBLVehHoldReq : 259|1@0+ (1,0) [0|1] ""  CCU,CCURT1,CCURT2
 SG_ ADC_ABAReq : 258|1@0+ (1,0) [0|1] ""  CCU,CCURT1,CCURT2
 SG_ ADC_ABALevel : 257|2@0+ (1,0) [0|3] ""  CCU,CCURT1,CCURT2
 SG_ ADC_AWBReq : 271|1@0+ (1,0) [0|1] ""  CCU,CCURT1,CCURT2
 SG_ ADC_ABPReq : 270|1@0+ (1,0) [0|1] ""  CCU,CCURT1,CCURT2
 SG_ ADC_AWBLevel : 269|3@0+ (1,0) [0|7] ""  CCU,CCURT1,CCURT2
 SG_ ADC_AEBTarCalss : 266|3@0+ (1,0) [0|7] ""  CCU,CCURT1,CCURT2,RT1_C1
 SG_ ADC_AEBTarDetSensor : 277|2@0+ (1,0) [0|3] ""  CCU,CCURT1,CCURT2,RT1_C1
 SG_ ADC_TurnLightReq : 275|3@0+ (1,0) [0|7] ""  CCU,CCURT1,CCURT2,RT2_C3
 SG_ ADC_PAA2EPBEpbReq : 281|2@0+ (1,0) [0|2] ""  CCU,CCURT1,CCURT2
 SG_ ADC_PAA2EPBEpbReqSt : 294|1@0+ (1,0) [0|1] ""  CCU,CCURT1,CCURT2
 SG_ ADC_AEBObjectTTC : 288|9@0+ (0.01,0) [0|5] "s"  CCU,CCURT1,CCURT2,RT1_C1
 SG_ ADC_AEBObjRelativeSpd : 304|9@0+ (0.1,0) [0|50] "m/s"  CCU,CCURT1,CCURT2,RT1_C1
 SG_ ADC_PAAPwrModeReq : 405|1@0+ (1,0) [0|1] ""  CCU,CCURT1,CCURT2,RT1_C1
 SG_ ADC_PAAGrarLvlReq : 404|3@0+ (1,0) [0|7] ""  CCU,CCURT1,CCURT2,RT1_C1
 SG_ ADC_PAAGrarLvlReqEnable : 401|1@0+ (1,0) [0|1] ""  CCU,CCURT1,CCURT2,RT1_C1
 SG_ ADC_ACCMode_C : 415|4@0+ (1,0) [0|15] ""  CCU,CCURT1,CCURT2
 SG_ ADC_ActTrqReqVD : 341|1@0+ (1,0) [0|1] ""  CCU,CCURT1,CCURT2,RT1_C1
 SG_ ADC_BrkTarTqEna : 125|1@0+ (1,0) [0|1] ""  CCU,CCURT1,CCURT2
 SG_ ADC_BrkTarTqMod : 25|2@0+ (1,0) [0|3] ""  CCU,CCURT1,CCURT2
 SG_ ADC_AebBrkTarTq : 111|16@0+ (1,0) [0|65535] "Nm"  CCU,CCURT1,CCURT2
 SG_ ADC_EpbModReqVld : 126|1@0+ (1,0) [0|1] ""  CCU,CCURT1,CCURT2
 SG_ ADC_RWUEna : 127|1@0+ (1,0) [0|1] ""  CCU,CCURT1,CCURT2
 SG_ ADC_BrkHoldReq : 279|2@0+ (1,0) [0|3] ""  CCU,CCURT1,CCURT2
 SG_ ADC_AngReqAvl : 340|1@0+ (1,0) [0|1] ""  CCU,CCURT1,CCURT2
 SG_ ADC_TarGearReqVld : 342|1@0+ (1,0) [0|1] ""  CCU,CCURT1,CCURT2,RT1_C1
 SG_ ADC_FctSts : 343|1@0+ (1,0) [0|1] ""  CCU,CCURT1,CCURT2,RT1_C0,RT1_C1
 SG_ ADC_BrkTarTqVld : 328|1@0+ (1,0) [0|1] ""  CCU,CCURT1,CCURT2
 SG_ ADC_AebBrkTarTqVld : 305|1@0+ (1,0) [0|1] ""  CCU,CCURT1,CCURT2
 SG_ ADC_AebBrkTarTqEna : 306|1@0+ (1,0) [0|1] ""  CCU,CCURT1,CCURT2
 SG_ ADC_ElecBrkFnSwitch : 307|1@0+ (1,0) [0|1] ""  CCU,CCURT1,CCURT2,RT1_C1
 SG_ ADC_RWUVld : 400|1@0+ (1,0) [0|1] ""  CCU,CCURT1,CCURT2
 SG_ ADC_DriverPresent : 309|2@0+ (1,0) [0|3] ""  CCU,CCURT1,CCURT2
 SG_ ADC_AD_NetMode : 65|2@0+ (1,0) [0|3] "/"  CCU,CCURT1,CCURT2,RT1_C1,RT2_C3
 SG_ ADC_ChrgPwrMode : 70|1@0+ (1,0) [0|1] ""  CCU,CCURT1,CCURT2
 SG_ ADC_LimTqEnable_A : 120|1@0+ (1,0) [0|1] ""  CCU,CCURT1,CCURT2,RT1_C1
 SG_ ADC_LimTqFactorK_A : 137|10@0+ (0.001,0) [0|1] ""  CCU,CCURT1,CCURT2,RT1_C1
 SG_ ADC_RapidRespEna_A : 135|1@0+ (1,0) [0|1] ""  CCU,CCURT1,CCURT2,RT1_C1
 SG_ ADC_DrvTarTqMod_A : 134|2@0+ (1,0) [0|3] ""  CCU,CCURT1,CCURT2,RT1_C1
 SG_ ADC_FcsActiveStatus : 122|1@0+ (1,0) [0|1] ""  CCU,CCURT1,CCURT2,RT1_C1
 SG_ ADC_DycEscTarTq_A : 159|16@0+ (1,-32768) [-32768|32767] "Nm"  CCU,CCURT1,CCURT2
 SG_ ADC_DycEscTarTqfactor_A : 103|8@0+ (0.01,0) [0|1] ""  CCU,CCURT1,CCURT2
 SG_ ADC_DycEscTarTqVld_A : 132|1@0+ (1,0) [0|1] ""  CCU,CCURT1,CCURT2
 SG_ ADC_DycEscTarTqEna_A : 131|1@0+ (1,0) [0|1] ""  CCU,CCURT1,CCURT2
 SG_ ADC_RedundantSwt : 121|1@0+ (1,0) [0|1] ""  CCU,CCURT1
 SG_ ADC_ImmediateStopEna : 295|1@0+ (1,0) [0|1] ""  CCU,CCURT1
 SG_ ADC_VehSpd : 175|13@0+ (0.05625,0) [0|240] "km/h"  CCU,CCURT1
 SG_ ADC_VehSpdVD : 178|1@0+ (1,0) [0|1] ""  CCU,CCURT1
 SG_ ADC_BrkOffEnable : 203|1@0+ (1,0) [0|1] ""  CCU
 SG_ ADC_SteerTqReq_A : 199|12@0+ (0.01,-20) [-20|20] "Nm"  CCU,CCURT1
 SG_ ADC_SteerTqSt_A : 130|2@0+ (1,0) [0|3] ""  CCU,CCURT1
 SG_ ADC_TqEvsSteerReq_A : 128|1@0+ (1,0) [0|1] ""  CCU,CCURT1
 SG_ ADC_SteerTqAvl_A : 142|1@0+ (1,0) [0|1] ""  CCU,CCURT1
 SG_ ADC_SteerGainLevelTqCtrl_A : 191|8@0+ (1,0) [0|254] "%"  CCU,CCURT1
 SG_ ADC_BrkTarTq : 439|16@0+ (1,0) [0|65535] "Nm"  CCU,CCURT1,CCURT2

BO_ 783 ADC_3_New: 64 ADC
 SG_ ADC_3_New_CRC : 7|16@0+ (1,0) [0|65535] ""  CCU,CCURT1,CCURT2,RT1_C1
 SG_ ADC_3_New_Counter : 23|8@0+ (1,0) [0|255] ""  CCU,CCURT1,CCURT2,RT1_C1
 SG_ ADC_FroTrkTargt0ObjClass : 31|4@0+ (1,0) [0|15] ""  CCU,CCURT1,CCURT2,RT1_C1
 SG_ ADC_FroTrkTargt0St : 27|1@0+ (1,0) [0|1] ""  CCU,CCURT1,CCURT2,RT1_C1
 SG_ ADC_FroTrkTargt0longPos : 25|10@0+ (0.2,0) [0|204.4] "m"  CCU,CCURT1,CCURT2,RT1_C1
 SG_ ADC_FroTrkTargt0latPos : 47|10@0+ (0.1,-51.2) [-51.2|51.1] "m"  CCU,CCURT1,CCURT2,RT1_C1
 SG_ ADC_FroTrkTargt0LatRelSpd : 48|9@0+ (0.1,-25.5) [-25.5|25.5] "m/s"  CCU,CCURT1,CCURT2,RT1_C1
 SG_ ADC_FroTrkTargt0LongRelSpd : 71|10@0+ (0.1,-51.2) [-51.2|51.1] "m/s"  CCU,CCURT1,CCURT2,RT1_C1
 SG_ ADC_FroTrkTargt0DetSensor : 53|4@0+ (1,0) [0|15] ""  CCU,CCURT1,CCURT2
 SG_ ADC_FroTrkTargt1ObjClass : 77|4@0+ (1,0) [0|15] ""  CCU,CCURT1,CCURT2,RT1_C1
 SG_ ADC_FroTrkTargt1St : 26|1@0+ (1,0) [0|1] ""  CCU,CCURT1,CCURT2,RT1_C1
 SG_ ADC_FroTrkTargt1longPos : 73|10@0+ (0.2,0) [0|204.4] "m"  CCU,CCURT1,CCURT2,RT1_C1
 SG_ ADC_FroTrkTargt1latPos : 95|10@0+ (0.1,-51.2) [-51.2|51.1] "m"  CCU,CCURT1,CCURT2,RT1_C1
 SG_ ADC_FroTrkTargt1LatRelSpd : 96|9@0+ (0.1,-25.5) [-25.5|25.5] "m/s"  CCU,CCURT1,CCURT2,RT1_C1
 SG_ ADC_FroTrkTargt1LongRelSpd : 119|10@0+ (0.1,-51.2) [-51.2|51.1] "m/s"  CCU,CCURT1,CCURT2,RT1_C1
 SG_ ADC_FroTrkTargt1DetSensor : 100|4@0+ (1,0) [0|15] ""  CCU,CCURT1,CCURT2
 SG_ ADC_FroTrkTargt2ObjClass : 125|4@0+ (1,0) [0|15] ""  CCU,CCURT1,CCURT2,RT1_C1
 SG_ ADC_FroTrkTargt2St : 49|1@0+ (1,0) [0|1] ""  CCU,CCURT1,CCURT2,RT1_C1
 SG_ ADC_FroTrkTargt2longPos : 121|10@0+ (0.2,0) [0|204.4] "m"  CCU,CCURT1,CCURT2,RT1_C1
 SG_ ADC_FroTrkTargt2latPos : 143|10@0+ (0.1,-51.2) [-51.2|51.1] "m"  CCU,CCURT1,CCURT2,RT1_C1
 SG_ ADC_FroTrkTargt2LatRelSpd : 149|9@0+ (0.1,-25.5) [-25.5|25.5] "m/s"  CCU,CCURT1,CCURT2,RT1_C1
 SG_ ADC_FroTrkTargt2LongRelSpd : 156|10@0+ (0.1,-51.2) [-51.2|51.1] "m/s"  CCU,CCURT1,CCURT2,RT1_C1
 SG_ ADC_FroTrkTargt2DetSensor : 175|4@0+ (1,0) [0|15] ""  CCU,CCURT1,CCURT2
 SG_ ADC_FroTrkTargt3ObjClass : 171|4@0+ (1,0) [0|15] ""  CCU,CCURT1,CCURT2,RT1_C1
 SG_ ADC_FroTrkTargt3St : 101|1@0+ (1,0) [0|1] ""  CCU,CCURT1,CCURT2,RT1_C1
 SG_ ADC_FroTrkTargt3longPos : 183|10@0+ (0.2,0) [0|204.4] "m"  CCU,CCURT1,CCURT2,RT1_C1
 SG_ ADC_FroTrkTargt3latPos : 185|10@0+ (0.1,-51.2) [-51.2|51.1] "m"  CCU,CCURT1,CCURT2,RT1_C1
 SG_ ADC_FroTrkTargt3LatRelSpd : 207|9@0+ (0.1,-25.5) [-25.5|25.5] "m/s"  CCU,CCURT1,CCURT2,RT1_C1
 SG_ ADC_FroTrkTargt3LongRelSpd : 209|10@0+ (0.1,-51.2) [-51.2|51.1] "m/s"  CCU,CCURT1,CCURT2,RT1_C1
 SG_ ADC_FroTrkTargt3DetSensor : 189|4@0+ (1,0) [0|15] ""  CCU,CCURT1,CCURT2
 SG_ ADC_LLnMrking_A0 : 231|11@0+ (0.01,-10.23) [-10.23|10.23] "m"  CCU,CCURT1,CCURT2,RT1_C1
 SG_ ADC_LLnMrking_A1 : 234|11@0+ (0.001,-1.023) [-1.023|1.023] "rad"  CCU,CCURT1,CCURT2,RT1_C1
 SG_ ADC_LLnMrking_A2 : 250|11@0+ (0.00001,-0.01023) [-0.01023|0.01023] "1/m"  CCU,CCURT1,CCURT2,RT1_C1
 SG_ ADC_LLnMrking_conf : 271|6@0+ (2,0) [0|100] "%"  CCU,CCURT1,CCURT2,RT1_C1
 SG_ ADC_LlnMrkingDispSt : 236|2@0+ (1,0) [0|3] ""  CCU,CCURT1,CCURT2,RT1_C1
 SG_ ADC_LLnMrking_Range : 279|11@0+ (0.1,0) [0|204.7] "m"  CCU,CCURT1,CCURT2,RT1_C1
 SG_ ADC_LLnMrking_Type : 284|4@0+ (1,0) [0|15] ""  CCU,CCURT1,CCURT2,RT1_C1
 SG_ ADC_RLnMrking_A0 : 295|11@0+ (0.01,-10.23) [-10.23|10.23] "m"  CCU,CCURT1,CCURT2,RT1_C1
 SG_ ADC_RLnMrking_A1 : 300|11@0+ (0.001,-1.023) [-1.023|1.023] "rad"  CCU,CCURT1,CCURT2,RT1_C1
 SG_ ADC_RLnMrking_A2 : 319|11@0+ (0.00001,-0.01023) [-0.01023|0.01023] "1/m"  CCU,CCURT1,CCURT2,RT1_C1
 SG_ ADC_RlnMrkingDispSt : 265|2@0+ (1,0) [0|3] ""  CCU,CCURT1,CCURT2,RT1_C1
 SG_ ADC_RLnMrking_conf : 349|6@0+ (2,0) [0|100] "%"  CCU,CCURT1,CCURT2,RT1_C1
 SG_ ADC_RLnMrking_Range : 322|11@0+ (0.1,0) [0|204.7] "m"  CCU,CCURT1,CCURT2,RT1_C1
 SG_ ADC_RLnMrking_Type : 343|4@0+ (1,0) [0|15] ""  CCU,CCURT1,CCURT2,RT1_C1
 SG_ Reserved1 : 440|1@0+ (1,0) [0|0] ""  CCU

CM_ SG_ 915 ADC_3_CRC "E2E Profile 5 CRC";
CM_ SG_ 915 ADC_3_Counter "E2E Profile 5 Counter";
CM_ SG_ 915 ADC_FroTrkTargt0ObjClass "Front Track Target 0（Closest Same Lane）Object class";
CM_ SG_ 915 ADC_FroTrkTargt0St "Front Track Target 0（Closest Same Lane）detection state";
CM_ SG_ 915 ADC_FroTrkTargt0longPos "Front Track Target 0（Closest Same Lane）Longitudinal Position";
CM_ SG_ 915 ADC_FroTrkTargt0latPos "Front Track Target 0（Closest Same Lane）Lateral Position";
CM_ SG_ 915 ADC_FroTrkTargt0LatRelSpd "Front Track Target 0（Closest Same Lane）Lateral Relative Speed";
CM_ SG_ 915 ADC_FroTrkTargt0LongRelSpd "Front Track Target 0（Closest Same Lane）Longitudinal Relative Speed";
CM_ SG_ 915 ADC_FroTrkTargt0DetSensor "Front Track Target 0（Closest Same Lane）Property Detected by Sensor";
CM_ SG_ 915 ADC_FroTrkTargt1ObjClass "Front Track Target 1（Before Target 0, TheSecond Closest Same Lane）Objectclass";
CM_ SG_ 915 ADC_FroTrkTargt1St "Front Track Target 1（Before Target 0, TheSecond Closest Same Lane）detection state";
CM_ SG_ 915 ADC_FroTrkTargt1longPos "Front Track Target 1（Before Target 0, TheSecond Closest Same Lane）Longitudinal Position";
CM_ SG_ 915 ADC_FroTrkTargt1latPos "Front Track Target 1（Before Target 0, TheSecond Closest Same Lane）Lateral Position";
CM_ SG_ 915 ADC_FroTrkTargt1LatRelSpd "Front Track Target 1（Before Target 0, TheSecond Closest Same Lane）Lateral Relative Speed";
CM_ SG_ 915 ADC_FroTrkTargt1LongRelSpd "Front Track Target 1（Before Target 0, TheSecond Closest Same Lane）Longitudinal Relative Speed";
CM_ SG_ 915 ADC_FroTrkTargt1DetSensor "Front Track Target 1（Before Target 0, TheSecond Closest Same Lane）Property Detected by Sensor";
CM_ SG_ 915 ADC_FroTrkTargt2ObjClass "Front Track Target 2（Closest Left Lane）Object class";
CM_ SG_ 915 ADC_FroTrkTargt2St "Front Track Target 2（Closest Left Lane）detection state";
CM_ SG_ 915 ADC_FroTrkTargt2longPos "Front Track Target 2（Closest Left Lane） Longitudinal Position";
CM_ SG_ 915 ADC_FroTrkTargt2latPos "Front Track Target 2（Closest Left Lane） Lateral Position";
CM_ SG_ 915 ADC_FroTrkTargt2LatRelSpd "Front Track Target 2（Closest Left Lane）Lateral Relative Speed";
CM_ SG_ 915 ADC_FroTrkTargt2LongRelSpd "Front Track Target 2（Closest Left Lane）Longitudinal Relative Speed";
CM_ SG_ 915 ADC_FroTrkTargt2DetSensor "Front Track Target 2（Closest Left Lane）Property Detected by Sensor";
CM_ SG_ 915 ADC_FroTrkTargt3ObjClass "Front Track Target 3（Closest Right Lane）Objectclass";
CM_ SG_ 915 ADC_FroTrkTargt3St "Front Track Target 2（Closest Right Lane）detection state";
CM_ SG_ 915 ADC_FroTrkTargt3longPos "Front Track Target 3（Closest Right Lane）Longitudinal Position";
CM_ SG_ 915 ADC_FroTrkTargt3latPos "Front Track Target 3（Closest Right Lane）Lateral Position";
CM_ SG_ 915 ADC_FroTrkTargt3LatRelSpd "Front Track Target 3（Closest Right Lane）Lateral Relative Speed";
CM_ SG_ 915 ADC_FroTrkTargt3LongRelSpd "Front Track Target 3（Closest Right Lane）Longitudinal Relative Speed";
CM_ SG_ 915 ADC_FroTrkTargt3DetSensor "Front Track Target 3（Closest Right Lane）Property Detected by Sensor";
CM_ SG_ 915 ADC_ReaTrkTargt4ObjClass "Rear Track Target 4（After Target 2, TheSecond Closest Left Lane）Object class";
CM_ SG_ 915 ADC_ReaTrkTargt4St "Rear Track Target 4（After Target 2, TheSecond Closest Left Lane）detection state";
CM_ SG_ 915 ADC_ReaTrkTargt4longPos "Rear Track Target 4（AfterAfter Target 2, TheSecond Closest Left Lane）Longitudinal Position";
CM_ SG_ 915 ADC_ReaTrkTargt4latPos "Rear Track Target 4（After Target 2, TheSecond Closest Left Lane）Lateral Position";
CM_ SG_ 915 ADC_ReaTrkTargt4LatRelSpd "Rear Track Target 4（After Target 2, TheSecond Closest Left Lane）Lateral Relative Speed";
CM_ SG_ 915 ADC_ReaTrkTargt4LongRelSpd "Rear Track Target 4（After Target 2, TheSecond Closest Left Lane）Longitudinal Relative Speed";
CM_ SG_ 915 ADC_ReaTrkTargt4DetSensor "Rear Track Target 4（After Target 2, TheSecond Closest Left Lane）Property Detected by Sensor";
CM_ SG_ 915 ADC_ReaTrkTargt5ObjClass "Rear Track Target 5（After Target 3, TheSecond Closest Right Lane）Objectclass";
CM_ SG_ 915 ADC_ReaTrkTargt5St "Rear Track Target 5（After Target 3, TheSecond Closest Right Lane）detection state";
CM_ SG_ 915 ADC_ReaTrkTargt5longPos "Rear Track Target 5（After Target 3, TheSecond Closest Right Lane）Longitudinal Position";
CM_ SG_ 915 ADC_ReaTrkTargt5latPos "Rear Track Target 5（After Target 3, TheSecond Closest Right Lane）Lateral Position";
CM_ SG_ 915 ADC_ReaTrkTargt5LatRelSpd "Rear Track Target 5（After Target 3, TheSecond Closest Right Lane）Lateral Relative Speed";
CM_ SG_ 915 ADC_ReaTrkTargt5LongRelSpd "Rear Track Target 5（After Target 3, TheSecond Closest Right Lane）Longitudinal Relative Speed";
CM_ SG_ 915 ADC_ReaTrkTargt5DetSensor "Rear Track Target 5（After Tarcet 3, TheSecond Closest Right Lane）Property Detected by Sensor";
CM_ SG_ 915 ADC_ReaTrkTargt6ObjClass "Rear Track Target 6（behind ego car,  On the Same Lane）Objectclass";
CM_ SG_ 915 ADC_ReaTrkTargt6St "Rear Track Target 6（behind ego car,  On the Same Lane）detection state";
CM_ SG_ 915 ADC_ReaTrkTargt6longPos "Rear Track Target 6（behind ego car,  On the Same Lane）Longitudinal Position";
CM_ SG_ 915 ADC_ReaTrkTargt6latPos "Rear Track Target 6（behind ego car,  On the Same Lane）Lateral Position";
CM_ SG_ 915 ADC_ReaTrkTargt6LatRelSpd "Rear Track Target 6（behind ego car,  On the Same Lane）Lateral Relative Speed";
CM_ SG_ 915 ADC_ReaTrkTargt6LongRelSpd "Rear Track Target 6（behind ego car,  On the Same Lane）Longitudinal Relative Speed";
CM_ SG_ 915 ADC_ReaTrkTargt6DetSensor "Rear Track Target 6（behind ego car,  On the Same Lane）Property Detected by Sensor";
CM_ SG_ 915 ADC_RadarPowerDownReq "ADC request CCU to power down radars";
CM_ SG_ 915 ADC_UPSPowerDownReq "ADC request CCU to power down UPS";
CM_ SG_ 915 ADC_LidarPowerDownReq "ADC request CCU to power down Lidar";
CM_ SG_ 915 ADC_IFCPowerDownReq "ADC request CCU to power down IFC";
CM_ SG_ 915 ADC_LowPowerReq "indicate ADC lowpower Mode state";
CM_ SG_ 1188 ADC_DTC "信号用于上报ADC的故障信息，信号长度64个字节，存储16个故障码?每个故障码由4个字节构成：DTCHighByte(Hex)DTCMiddleByte(Hex)DTCLowByte(Hex)StatusOfDTC";
CM_ SG_ 387 ADC_4_New_CRC "E2E Profile 5 CRC";
CM_ SG_ 387 ADC_4_New_Counter "E2E Profile 5 Counter";
CM_ SG_ 387 ADC_AngReqSt_A "Lateral control Function Request State";
CM_ SG_ 387 ADC_AngReqFunction "Indicates which function request angle control";
CM_ SG_ 387 ADC_BrakeLightReq "Brake Light Request?";
CM_ SG_ 387 ADC_StrAngleReq_A "Steering Angle Request Value";
CM_ SG_ 387 ADC_SACMotorTorLimExtMax_A "Maximum Motor External Torque Limitation of Angle Following";
CM_ SG_ 387 ADC_SACMotorTorLimExtMin_A "Minimum Motor External Torque Limitation of Angle Following";
CM_ SG_ 387 ADC_AssistParaSwitchReq "Request EPS Switch Assist Parameter to LKAmode";
CM_ SG_ 387 ADC_SteerGainReq "Driver steering  gain request signal";
CM_ SG_ 387 ADC_StrgWhlVibrWarnLevel "Steering wheel vibratio Warn Frequency";
CM_ SG_ 387 ADC_ActTrqReqEnable "Enable flag for VCU for realization of target torque ActTrqReq";
CM_ SG_ 387 ADC_SteerGainLevel "Driver steering gain request value";
CM_ SG_ 387 ADC_EvsSteerReq "Emergency Collision avoidance steering mode request";
CM_ SG_ 387 ADC_StrgWhlVibrWarnReq "Steering wheel vibration Warn request";
CM_ SG_ 387 ADC_ActTrqReq "VLC Request Effective target torque on wheel level to VCU";
CM_ SG_ 387 ADC_DrvTarTqMod2EPB "Drive torque mode to EPB";
CM_ SG_ 387 ADC_LongCtrlTypReq "Main ADC  Longitudinal Control Brake type.Comfort Mode : The controller and brake system will consider NVH limitations, carefully reaction for good driving feeling, etc.Emergency Mode: the controller react fast and the brake system will achieve maximum performance (No limitations, eg. NVH limitations, HW protection).";
CM_ SG_ 387 ADC_AEBFaultSt "This signal indicates the AEB(Auto Emerrgency Braking) fault status";
CM_ SG_ 387 ADC_AEBOffSt "This signal indicates if the AEB(Auto Emerrgency Braking) is deactivated";
CM_ SG_ 387 ADC_AEBInterventionSt "This signal indicates if the AEB(Auto Emerrgency Braking) intervents";
CM_ SG_ 387 ADC_AEBDecelCtrlReq "Request of the AEB/EBA/FCTB/RCTB deceleration control";
CM_ SG_ 387 ADC_AEBLVehHoldReq "Request ESP to hold vehilce if AEB active and vehilce stopped";
CM_ SG_ 387 ADC_ABAReq "Request of the ABA support from ESP";
CM_ SG_ 387 ADC_ABALevel "ABA(Adaptive Brake Assistance) level to the ESP HBA";
CM_ SG_ 387 ADC_AWBReq "Request of the brake jerk warning to ESP";
CM_ SG_ 387 ADC_ABPReq "Request of the Prefill to ESP";
CM_ SG_ 387 ADC_AWBLevel "Different level request of the brake jerk";
CM_ SG_ 387 ADC_AEBTarCalss "AEB Target Object Class";
CM_ SG_ 387 ADC_AEBTarDetSensor "AEB Target Property Detected by Sensor with Fusion or not.";
CM_ SG_ 387 ADC_TurnLightReq "Turn Lamp and Hazard Lamp Request?";
CM_ SG_ 387 ADC_PAA2EPBEpbReq "ADAS to EPB request  ";
CM_ SG_ 387 ADC_PAA2EPBEpbReqSt "ADAS to EPB Request  Status";
CM_ SG_ 387 ADC_AEBObjectTTC "Time-to-collision between ego vehicle and collision object, and the relative acceleration should be considered";
CM_ SG_ 387 ADC_AEBObjRelativeSpd "Relative Speed between ego vehicle and collision object. Means Ego speed > collision object speed situation";
CM_ SG_ 387 ADC_PAAPwrModeReq "PAA Powertrain Request";
CM_ SG_ 387 ADC_PAAGrarLvlReq "Gear lever position request for the vehicle mo-tion control";
CM_ SG_ 387 ADC_PAAGrarLvlReqEnable "enable flag to control the gear box";
CM_ SG_ 387 ADC_ACCMode_C "This signal indicates ACC(Adaptive cruise control)status";
CM_ SG_ 387 ADC_ActTrqReqVD "The validity of ADC torque request to VCU";
CM_ SG_ 387 ADC_BrkTarTqEna "The enable status  of total target brake torque";
CM_ SG_ 387 ADC_BrkTarTqMod "This signal indicates which function the total target brake torque is used for，cruise or parking function.";
CM_ SG_ 387 ADC_AebBrkTarTq "Total taget brake torque of the AEB";
CM_ SG_ 387 ADC_EpbModReqVld "The validity of the  request from the ADAS/ADS to the  EPB";
CM_ SG_ 387 ADC_RWUEna "The enable status of the  RWU";
CM_ SG_ 387 ADC_BrkHoldReq "The AVH request from the ADAS/ADS to the ESP/IPB.Not active：AVH no activeActive：AVH active";
CM_ SG_ 387 ADC_AngReqAvl "Steering angle request avaliable state";
CM_ SG_ 387 ADC_TarGearReqVld "Gear lever request validity";
CM_ SG_ 387 ADC_FctSts "ADAS active status";
CM_ SG_ 387 ADC_BrkTarTqVld "The validity of total  target brake torque";
CM_ SG_ 387 ADC_AebBrkTarTqVld "The validity of total target brake torque of the AEB";
CM_ SG_ 387 ADC_AebBrkTarTqEna "The enable status  of total  target brake torque of the AEB";
CM_ SG_ 387 ADC_ElecBrkFnSwitch "The switch for regenerative brake and hydraulic brake。Off：The ESP/IPB can not assign regenerative brake torque to the VCU/DCU。On：The ESP/IPB can assign regenerative brake torque to the VCUDCU。";
CM_ SG_ 387 ADC_RWUVld "The validity  of the RWU";
CM_ SG_ 387 ADC_DriverPresent "It indicates whether someone is in the driver's seat.";
CM_ SG_ 387 ADC_AD_NetMode "Autonomous_Driving Request Net Mode";
CM_ SG_ 387 ADC_ChrgPwrMode "ADC VCU Torque Control Mode";
CM_ SG_ 387 ADC_LimTqEnable_A "Limit torque request enable flag";
CM_ SG_ 387 ADC_LimTqFactorK_A "Limit torque request factor";
CM_ SG_ 387 ADC_RapidRespEna_A "Rapid response mode enable flag";
CM_ SG_ 387 ADC_DrvTarTqMod_A "Drive torque mode";
CM_ SG_ 387 ADC_FcsActiveStatus "indicate ADS Fuction is Active for energe save mode";
CM_ SG_ 387 ADC_DycEscTarTq_A "The total target torque of the DYC(Direct  yaw moment control).";
CM_ SG_ 387 ADC_DycEscTarTqfactor_A "Partition coefficient of  total target torque of the DYC:front axle/total";
CM_ SG_ 387 ADC_DycEscTarTqVld_A "The validity of total target torque of the DYC.";
CM_ SG_ 387 ADC_DycEscTarTqEna_A "The enable status  of total target torque of the DYC.";
CM_ SG_ 387 ADC_RedundantSwt "It is the switch for the redundancy mode.";
CM_ SG_ 387 ADC_ImmediateStopEna "It indicates whether ESP is permitted to perform blind braking.（It indicates whether the ESP is permitted to immediately brake the vehicle to a stop.）";
CM_ SG_ 387 ADC_VehSpd "ADC Vehicle speed";
CM_ SG_ 387 ADC_VehSpdVD "ADC Quality/fault information to vehicle speed";
CM_ SG_ 387 ADC_BrkOffEnable "Allow the brake to actively retract the hand grip";
CM_ SG_ 387 ADC_SteerTqReq_A "Steering torque request value";
CM_ SG_ 387 ADC_SteerTqSt_A "Steering torque request  enable state";
CM_ SG_ 387 ADC_TqEvsSteerReq_A "Emergency Collision avoidance steering mode request";
CM_ SG_ 387 ADC_SteerTqAvl_A "Steering torque request avaliable state";
CM_ SG_ 387 ADC_SteerGainLevelTqCtrl_A "Driver steering torque gain request value";
CM_ SG_ 387 ADC_BrkTarTq "Total target brake torque for cruise and parking function ";
CM_ SG_ 783 ADC_3_New_CRC "E2E Profile 5 CRC";
CM_ SG_ 783 ADC_3_New_Counter "E2E Profile 5 Counter";
CM_ SG_ 783 ADC_FroTrkTargt0ObjClass "Front Track Target 0（Closest Same Lane）Object class";
CM_ SG_ 783 ADC_FroTrkTargt0St "Front Track Target 0（Closest Same Lane）detection state";
CM_ SG_ 783 ADC_FroTrkTargt0longPos "Front Track Target 0（Closest Same Lane）Longitudinal Position";
CM_ SG_ 783 ADC_FroTrkTargt0latPos "Front Track Target 0（Closest Same Lane）Lateral Position";
CM_ SG_ 783 ADC_FroTrkTargt0LatRelSpd "Front Track Target 0（Closest Same Lane）Lateral Relative Speed";
CM_ SG_ 783 ADC_FroTrkTargt0LongRelSpd "Front Track Target 0（Closest Same Lane）Longitudinal Relative Speed";
CM_ SG_ 783 ADC_FroTrkTargt0DetSensor "Front Track Target 0（Closest Same Lane）Property Detected by Sensor";
CM_ SG_ 783 ADC_FroTrkTargt1ObjClass "Front Track Target 1（Before Target 0, TheSecond Closest Same Lane）Objectclass";
CM_ SG_ 783 ADC_FroTrkTargt1St "Front Track Target 1（Before Target 0, TheSecond Closest Same Lane）detection state";
CM_ SG_ 783 ADC_FroTrkTargt1longPos "Front Track Target 1（Before Target 0, TheSecond Closest Same Lane）Longitudinal Position";
CM_ SG_ 783 ADC_FroTrkTargt1latPos "Front Track Target 1（Before Target 0, TheSecond Closest Same Lane）Lateral Position";
CM_ SG_ 783 ADC_FroTrkTargt1LatRelSpd "Front Track Target 1（Before Target 0, TheSecond Closest Same Lane）Lateral Relative Speed";
CM_ SG_ 783 ADC_FroTrkTargt1LongRelSpd "Front Track Target 1（Before Target 0, TheSecond Closest Same Lane）Longitudinal Relative Speed";
CM_ SG_ 783 ADC_FroTrkTargt1DetSensor "Front Track Target 1（Before Target 0, TheSecond Closest Same Lane）Property Detected by Sensor";
CM_ SG_ 783 ADC_FroTrkTargt2ObjClass "Front Track Target 2（Closest Left Lane）Object class";
CM_ SG_ 783 ADC_FroTrkTargt2St "Front Track Target 2（Closest Left Lane）detection state";
CM_ SG_ 783 ADC_FroTrkTargt2longPos "Front Track Target 2（Closest Left Lane） Longitudinal Position";
CM_ SG_ 783 ADC_FroTrkTargt2latPos "Front Track Target 2（Closest Left Lane） Lateral Position";
CM_ SG_ 783 ADC_FroTrkTargt2LatRelSpd "Front Track Target 2（Closest Left Lane）Lateral Relative Speed";
CM_ SG_ 783 ADC_FroTrkTargt2LongRelSpd "Front Track Target 2（Closest Left Lane）Longitudinal Relative Speed";
CM_ SG_ 783 ADC_FroTrkTargt2DetSensor "Front Track Target 2（Closest Left Lane）Property Detected by Sensor";
CM_ SG_ 783 ADC_FroTrkTargt3ObjClass "Front Track Target 3（Closest Right Lane）Objectclass";
CM_ SG_ 783 ADC_FroTrkTargt3St "Front Track Target 2（Closest Right Lane）detection state";
CM_ SG_ 783 ADC_FroTrkTargt3longPos "Front Track Target 3（Closest Right Lane）Longitudinal Position";
CM_ SG_ 783 ADC_FroTrkTargt3latPos "Front Track Target 3（Closest Right Lane）Lateral Position";
CM_ SG_ 783 ADC_FroTrkTargt3LatRelSpd "Front Track Target 3（Closest Right Lane）Lateral Relative Speed";
CM_ SG_ 783 ADC_FroTrkTargt3LongRelSpd "Front Track Target 3（Closest Right Lane）Longitudinal Relative Speed";
CM_ SG_ 783 ADC_FroTrkTargt3DetSensor "Front Track Target 3（Closest Right Lane）Property Detected by Sensor";
CM_ SG_ 783 ADC_LLnMrking_A0 "Left Lane Marking Polynomial Coefficient A0, which stands for the lateral distance between lane marking and the middle of the eog vehicle.";
CM_ SG_ 783 ADC_LLnMrking_A1 "Left Lane Marking Polynomial Coefficient A1, which stands for the heading angle between the lane marking and the ego vehicle.";
CM_ SG_ 783 ADC_LLnMrking_A2 "Left Lane Marking Polynomial Coefficient A2, which stands for the curvature of the lane marking.";
CM_ SG_ 783 ADC_LLnMrking_conf "Left Lane Marking confidence";
CM_ SG_ 783 ADC_LlnMrkingDispSt "Display state of the left lane marking";
CM_ SG_ 783 ADC_LLnMrking_Range "Left Lane Marking range";
CM_ SG_ 783 ADC_LLnMrking_Type "Left side of lane marking indication type";
CM_ SG_ 783 ADC_RLnMrking_A0 "right Lane Marking Polynomial Coefficient A0, which stands for the lateral distance between lane marking and the middle of the eog vehicle.";
CM_ SG_ 783 ADC_RLnMrking_A1 "right Lane Marking Polynomial Coefficient A1, which stands for the heading angle between the lane marking and the ego vehicle.";
CM_ SG_ 783 ADC_RLnMrking_A2 "right Lane Marking Polynomial Coefficient A2, which stands for the curvature of the lane marking.";
CM_ SG_ 783 ADC_RlnMrkingDispSt "Display state of the right lane marking";
CM_ SG_ 783 ADC_RLnMrking_conf "right Lane Marking confidence";
CM_ SG_ 783 ADC_RLnMrking_Range "right Lane Marking range";
CM_ SG_ 783 ADC_RLnMrking_Type "right side of lane marking indication type";

BA_DEF_ BO_  "GenMsgCycleTime" INT 0 0;
BA_DEF_ BO_  "GenMsgCycleTimeFast" INT 0 0;
BA_DEF_ BO_  "GenMsgSendType" ENUM  "Periodic","Event","IfActive","POE","PA","FixedPeriodic","Event","EnabledPeriodic","NotUsed","NotUsed","EventPeriodic","NotUsed","NotUsed","NoMsgSendType";
BA_DEF_ BO_  "VFrameFormat" ENUM  "StandardCAN","ExtendedCAN","reserved","reserved","reserved","reserved","reserved","reserved","reserved","reserved","reserved","reserved","reserved","reserved","StandardCAN_FD","ExtendedCAN_FD";
BA_DEF_ BO_  "CANFD_BRS" ENUM  "0","1";
BA_DEF_ SG_  "EventCommandSignal" ENUM  "No","Yes";
BA_DEF_ SG_  "GatewayedSignals" ENUM  "No","Yes";
BA_DEF_ SG_  "GenSigInactiveValue" HEX 0 0;
BA_DEF_ SG_  "GenSigInvalidValue" HEX 0 0;
BA_DEF_ SG_  "GenSigSendType" ENUM  "Trigger","Passive","Cyclic","OnWrite","OnWriteWithRepetition","OnChange","OnChangeWithRepetition","IfActive","IfActiveWithRepetition","NoSigSendType";
BA_DEF_ SG_  "GenSigStartValue" HEX 0 0;
BA_DEF_ SG_  "GenSigTimeoutValue" HEX 0 0;
BA_DEF_ SG_  "Remark" STRING ;
BA_ "GenMsgCycleTime" BO_ 915 50;
BA_ "GenMsgCycleTimeFast" BO_ 915 0;
BA_ "GenMsgSendType" BO_ 915 0;
BA_ "VFrameFormat" BO_ 915 14;
BA_ "CANFD_BRS" BO_ 915 1;
BA_ "GenMsgCycleTime" BO_ 915 50;
BA_ "GenMsgCycleTimeFast" BO_ 915 0;
BA_ "GenMsgSendType" BO_ 915 0;
BA_ "VFrameFormat" BO_ 915 14;
BA_ "CANFD_BRS" BO_ 915 1;
BA_ "GenMsgCycleTime" BO_ 915 50;
BA_ "GenMsgCycleTimeFast" BO_ 915 0;
BA_ "GenMsgSendType" BO_ 915 0;
BA_ "VFrameFormat" BO_ 915 14;
BA_ "CANFD_BRS" BO_ 915 1;
BA_ "GenMsgCycleTime" BO_ 915 50;
BA_ "GenMsgCycleTimeFast" BO_ 915 0;
BA_ "GenMsgSendType" BO_ 915 0;
BA_ "VFrameFormat" BO_ 915 14;
BA_ "CANFD_BRS" BO_ 915 1;
BA_ "GenMsgCycleTime" BO_ 915 50;
BA_ "GenMsgCycleTimeFast" BO_ 915 0;
BA_ "GenMsgSendType" BO_ 915 0;
BA_ "VFrameFormat" BO_ 915 14;
BA_ "CANFD_BRS" BO_ 915 1;
BA_ "GenMsgCycleTime" BO_ 915 50;
BA_ "GenMsgCycleTimeFast" BO_ 915 0;
BA_ "GenMsgSendType" BO_ 915 0;
BA_ "VFrameFormat" BO_ 915 14;
BA_ "CANFD_BRS" BO_ 915 1;
BA_ "GenMsgCycleTime" BO_ 915 50;
BA_ "GenMsgCycleTimeFast" BO_ 915 0;
BA_ "GenMsgSendType" BO_ 915 0;
BA_ "VFrameFormat" BO_ 915 14;
BA_ "CANFD_BRS" BO_ 915 1;
BA_ "GenMsgCycleTime" BO_ 915 50;
BA_ "GenMsgCycleTimeFast" BO_ 915 0;
BA_ "GenMsgSendType" BO_ 915 0;
BA_ "VFrameFormat" BO_ 915 14;
BA_ "CANFD_BRS" BO_ 915 1;
BA_ "GenMsgCycleTime" BO_ 915 50;
BA_ "GenMsgCycleTimeFast" BO_ 915 0;
BA_ "GenMsgSendType" BO_ 915 0;
BA_ "VFrameFormat" BO_ 915 14;
BA_ "CANFD_BRS" BO_ 915 1;
BA_ "GenMsgCycleTime" BO_ 915 50;
BA_ "GenMsgCycleTimeFast" BO_ 915 0;
BA_ "GenMsgSendType" BO_ 915 0;
BA_ "VFrameFormat" BO_ 915 14;
BA_ "CANFD_BRS" BO_ 915 1;
BA_ "GenMsgCycleTime" BO_ 915 50;
BA_ "GenMsgCycleTimeFast" BO_ 915 0;
BA_ "GenMsgSendType" BO_ 915 0;
BA_ "VFrameFormat" BO_ 915 14;
BA_ "CANFD_BRS" BO_ 915 1;
BA_ "GenMsgCycleTime" BO_ 915 50;
BA_ "GenMsgCycleTimeFast" BO_ 915 0;
BA_ "GenMsgSendType" BO_ 915 0;
BA_ "VFrameFormat" BO_ 915 14;
BA_ "CANFD_BRS" BO_ 915 1;
BA_ "GenMsgCycleTime" BO_ 915 50;
BA_ "GenMsgCycleTimeFast" BO_ 915 0;
BA_ "GenMsgSendType" BO_ 915 0;
BA_ "VFrameFormat" BO_ 915 14;
BA_ "CANFD_BRS" BO_ 915 1;
BA_ "GenMsgCycleTime" BO_ 915 50;
BA_ "GenMsgCycleTimeFast" BO_ 915 0;
BA_ "GenMsgSendType" BO_ 915 0;
BA_ "VFrameFormat" BO_ 915 14;
BA_ "CANFD_BRS" BO_ 915 1;
BA_ "GenMsgCycleTime" BO_ 915 50;
BA_ "GenMsgCycleTimeFast" BO_ 915 0;
BA_ "GenMsgSendType" BO_ 915 0;
BA_ "VFrameFormat" BO_ 915 14;
BA_ "CANFD_BRS" BO_ 915 1;
BA_ "GenMsgCycleTime" BO_ 915 50;
BA_ "GenMsgCycleTimeFast" BO_ 915 0;
BA_ "GenMsgSendType" BO_ 915 0;
BA_ "VFrameFormat" BO_ 915 14;
BA_ "CANFD_BRS" BO_ 915 1;
BA_ "GenMsgCycleTime" BO_ 915 50;
BA_ "GenMsgCycleTimeFast" BO_ 915 0;
BA_ "GenMsgSendType" BO_ 915 0;
BA_ "VFrameFormat" BO_ 915 14;
BA_ "CANFD_BRS" BO_ 915 1;
BA_ "GenMsgCycleTime" BO_ 915 50;
BA_ "GenMsgCycleTimeFast" BO_ 915 0;
BA_ "GenMsgSendType" BO_ 915 0;
BA_ "VFrameFormat" BO_ 915 14;
BA_ "CANFD_BRS" BO_ 915 1;
BA_ "GenMsgCycleTime" BO_ 915 50;
BA_ "GenMsgCycleTimeFast" BO_ 915 0;
BA_ "GenMsgSendType" BO_ 915 0;
BA_ "VFrameFormat" BO_ 915 14;
BA_ "CANFD_BRS" BO_ 915 1;
BA_ "GenMsgCycleTime" BO_ 915 50;
BA_ "GenMsgCycleTimeFast" BO_ 915 0;
BA_ "GenMsgSendType" BO_ 915 0;
BA_ "VFrameFormat" BO_ 915 14;
BA_ "CANFD_BRS" BO_ 915 1;
BA_ "GenMsgCycleTime" BO_ 915 50;
BA_ "GenMsgCycleTimeFast" BO_ 915 0;
BA_ "GenMsgSendType" BO_ 915 0;
BA_ "VFrameFormat" BO_ 915 14;
BA_ "CANFD_BRS" BO_ 915 1;
BA_ "GenMsgCycleTime" BO_ 915 50;
BA_ "GenMsgCycleTimeFast" BO_ 915 0;
BA_ "GenMsgSendType" BO_ 915 0;
BA_ "VFrameFormat" BO_ 915 14;
BA_ "CANFD_BRS" BO_ 915 1;
BA_ "GenMsgCycleTime" BO_ 915 50;
BA_ "GenMsgCycleTimeFast" BO_ 915 0;
BA_ "GenMsgSendType" BO_ 915 0;
BA_ "VFrameFormat" BO_ 915 14;
BA_ "CANFD_BRS" BO_ 915 1;
BA_ "GenMsgCycleTime" BO_ 915 50;
BA_ "GenMsgCycleTimeFast" BO_ 915 0;
BA_ "GenMsgSendType" BO_ 915 0;
BA_ "VFrameFormat" BO_ 915 14;
BA_ "CANFD_BRS" BO_ 915 1;
BA_ "GenMsgCycleTime" BO_ 915 50;
BA_ "GenMsgCycleTimeFast" BO_ 915 0;
BA_ "GenMsgSendType" BO_ 915 0;
BA_ "VFrameFormat" BO_ 915 14;
BA_ "CANFD_BRS" BO_ 915 1;
BA_ "GenMsgCycleTime" BO_ 915 50;
BA_ "GenMsgCycleTimeFast" BO_ 915 0;
BA_ "GenMsgSendType" BO_ 915 0;
BA_ "VFrameFormat" BO_ 915 14;
BA_ "CANFD_BRS" BO_ 915 1;
BA_ "GenMsgCycleTime" BO_ 915 50;
BA_ "GenMsgCycleTimeFast" BO_ 915 0;
BA_ "GenMsgSendType" BO_ 915 0;
BA_ "VFrameFormat" BO_ 915 14;
BA_ "CANFD_BRS" BO_ 915 1;
BA_ "GenMsgCycleTime" BO_ 915 50;
BA_ "GenMsgCycleTimeFast" BO_ 915 0;
BA_ "GenMsgSendType" BO_ 915 0;
BA_ "VFrameFormat" BO_ 915 14;
BA_ "CANFD_BRS" BO_ 915 1;
BA_ "GenMsgCycleTime" BO_ 915 50;
BA_ "GenMsgCycleTimeFast" BO_ 915 0;
BA_ "GenMsgSendType" BO_ 915 0;
BA_ "VFrameFormat" BO_ 915 14;
BA_ "CANFD_BRS" BO_ 915 1;
BA_ "GenMsgCycleTime" BO_ 915 50;
BA_ "GenMsgCycleTimeFast" BO_ 915 0;
BA_ "GenMsgSendType" BO_ 915 0;
BA_ "VFrameFormat" BO_ 915 14;
BA_ "CANFD_BRS" BO_ 915 1;
BA_ "GenMsgCycleTime" BO_ 915 50;
BA_ "GenMsgCycleTimeFast" BO_ 915 0;
BA_ "GenMsgSendType" BO_ 915 0;
BA_ "VFrameFormat" BO_ 915 14;
BA_ "CANFD_BRS" BO_ 915 1;
BA_ "GenMsgCycleTime" BO_ 915 50;
BA_ "GenMsgCycleTimeFast" BO_ 915 0;
BA_ "GenMsgSendType" BO_ 915 0;
BA_ "VFrameFormat" BO_ 915 14;
BA_ "CANFD_BRS" BO_ 915 1;
BA_ "GenMsgCycleTime" BO_ 915 50;
BA_ "GenMsgCycleTimeFast" BO_ 915 0;
BA_ "GenMsgSendType" BO_ 915 0;
BA_ "VFrameFormat" BO_ 915 14;
BA_ "CANFD_BRS" BO_ 915 1;
BA_ "GenMsgCycleTime" BO_ 915 50;
BA_ "GenMsgCycleTimeFast" BO_ 915 0;
BA_ "GenMsgSendType" BO_ 915 0;
BA_ "VFrameFormat" BO_ 915 14;
BA_ "CANFD_BRS" BO_ 915 1;
BA_ "GenMsgCycleTime" BO_ 915 50;
BA_ "GenMsgCycleTimeFast" BO_ 915 0;
BA_ "GenMsgSendType" BO_ 915 0;
BA_ "VFrameFormat" BO_ 915 14;
BA_ "CANFD_BRS" BO_ 915 1;
BA_ "GenMsgCycleTime" BO_ 915 50;
BA_ "GenMsgCycleTimeFast" BO_ 915 0;
BA_ "GenMsgSendType" BO_ 915 0;
BA_ "VFrameFormat" BO_ 915 14;
BA_ "CANFD_BRS" BO_ 915 1;
BA_ "GenMsgCycleTime" BO_ 915 50;
BA_ "GenMsgCycleTimeFast" BO_ 915 0;
BA_ "GenMsgSendType" BO_ 915 0;
BA_ "VFrameFormat" BO_ 915 14;
BA_ "CANFD_BRS" BO_ 915 1;
BA_ "GenMsgCycleTime" BO_ 915 50;
BA_ "GenMsgCycleTimeFast" BO_ 915 0;
BA_ "GenMsgSendType" BO_ 915 0;
BA_ "VFrameFormat" BO_ 915 14;
BA_ "CANFD_BRS" BO_ 915 1;
BA_ "GenMsgCycleTime" BO_ 915 50;
BA_ "GenMsgCycleTimeFast" BO_ 915 0;
BA_ "GenMsgSendType" BO_ 915 0;
BA_ "VFrameFormat" BO_ 915 14;
BA_ "CANFD_BRS" BO_ 915 1;
BA_ "GenMsgCycleTime" BO_ 915 50;
BA_ "GenMsgCycleTimeFast" BO_ 915 0;
BA_ "GenMsgSendType" BO_ 915 0;
BA_ "VFrameFormat" BO_ 915 14;
BA_ "CANFD_BRS" BO_ 915 1;
BA_ "GenMsgCycleTime" BO_ 915 50;
BA_ "GenMsgCycleTimeFast" BO_ 915 0;
BA_ "GenMsgSendType" BO_ 915 0;
BA_ "VFrameFormat" BO_ 915 14;
BA_ "CANFD_BRS" BO_ 915 1;
BA_ "GenMsgCycleTime" BO_ 915 50;
BA_ "GenMsgCycleTimeFast" BO_ 915 0;
BA_ "GenMsgSendType" BO_ 915 0;
BA_ "VFrameFormat" BO_ 915 14;
BA_ "CANFD_BRS" BO_ 915 1;
BA_ "GenMsgCycleTime" BO_ 915 50;
BA_ "GenMsgCycleTimeFast" BO_ 915 0;
BA_ "GenMsgSendType" BO_ 915 0;
BA_ "VFrameFormat" BO_ 915 14;
BA_ "CANFD_BRS" BO_ 915 1;
BA_ "GenMsgCycleTime" BO_ 915 50;
BA_ "GenMsgCycleTimeFast" BO_ 915 0;
BA_ "GenMsgSendType" BO_ 915 0;
BA_ "VFrameFormat" BO_ 915 14;
BA_ "CANFD_BRS" BO_ 915 1;
BA_ "GenMsgCycleTime" BO_ 915 50;
BA_ "GenMsgCycleTimeFast" BO_ 915 0;
BA_ "GenMsgSendType" BO_ 915 0;
BA_ "VFrameFormat" BO_ 915 14;
BA_ "CANFD_BRS" BO_ 915 1;
BA_ "GenMsgCycleTime" BO_ 915 50;
BA_ "GenMsgCycleTimeFast" BO_ 915 0;
BA_ "GenMsgSendType" BO_ 915 0;
BA_ "VFrameFormat" BO_ 915 14;
BA_ "CANFD_BRS" BO_ 915 1;
BA_ "GenMsgCycleTime" BO_ 915 50;
BA_ "GenMsgCycleTimeFast" BO_ 915 0;
BA_ "GenMsgSendType" BO_ 915 0;
BA_ "VFrameFormat" BO_ 915 14;
BA_ "CANFD_BRS" BO_ 915 1;
BA_ "GenMsgCycleTime" BO_ 915 50;
BA_ "GenMsgCycleTimeFast" BO_ 915 0;
BA_ "GenMsgSendType" BO_ 915 0;
BA_ "VFrameFormat" BO_ 915 14;
BA_ "CANFD_BRS" BO_ 915 1;
BA_ "GenMsgCycleTime" BO_ 915 50;
BA_ "GenMsgCycleTimeFast" BO_ 915 0;
BA_ "GenMsgSendType" BO_ 915 0;
BA_ "VFrameFormat" BO_ 915 14;
BA_ "CANFD_BRS" BO_ 915 1;
BA_ "GenMsgCycleTime" BO_ 915 50;
BA_ "GenMsgCycleTimeFast" BO_ 915 0;
BA_ "GenMsgSendType" BO_ 915 0;
BA_ "VFrameFormat" BO_ 915 14;
BA_ "CANFD_BRS" BO_ 915 1;
BA_ "GenMsgCycleTime" BO_ 915 50;
BA_ "GenMsgCycleTimeFast" BO_ 915 0;
BA_ "GenMsgSendType" BO_ 915 0;
BA_ "VFrameFormat" BO_ 915 14;
BA_ "CANFD_BRS" BO_ 915 1;
BA_ "GenMsgCycleTime" BO_ 915 50;
BA_ "GenMsgCycleTimeFast" BO_ 915 0;
BA_ "GenMsgSendType" BO_ 915 0;
BA_ "VFrameFormat" BO_ 915 14;
BA_ "CANFD_BRS" BO_ 915 1;
BA_ "GenMsgCycleTime" BO_ 915 50;
BA_ "GenMsgCycleTimeFast" BO_ 915 0;
BA_ "GenMsgSendType" BO_ 915 0;
BA_ "VFrameFormat" BO_ 915 14;
BA_ "CANFD_BRS" BO_ 915 1;
BA_ "GenMsgCycleTime" BO_ 915 50;
BA_ "GenMsgCycleTimeFast" BO_ 915 0;
BA_ "GenMsgSendType" BO_ 915 0;
BA_ "VFrameFormat" BO_ 915 14;
BA_ "CANFD_BRS" BO_ 915 1;
BA_ "GenMsgCycleTime" BO_ 915 50;
BA_ "GenMsgCycleTimeFast" BO_ 915 0;
BA_ "GenMsgSendType" BO_ 915 0;
BA_ "VFrameFormat" BO_ 915 14;
BA_ "CANFD_BRS" BO_ 915 1;
BA_ "GenMsgCycleTime" BO_ 915 50;
BA_ "GenMsgCycleTimeFast" BO_ 915 0;
BA_ "GenMsgSendType" BO_ 915 0;
BA_ "VFrameFormat" BO_ 915 14;
BA_ "CANFD_BRS" BO_ 915 1;
BA_ "GenMsgCycleTime" BO_ 915 50;
BA_ "GenMsgCycleTimeFast" BO_ 915 0;
BA_ "GenMsgSendType" BO_ 915 0;
BA_ "VFrameFormat" BO_ 915 14;
BA_ "CANFD_BRS" BO_ 915 1;
BA_ "GenMsgCycleTime" BO_ 915 50;
BA_ "GenMsgCycleTimeFast" BO_ 915 0;
BA_ "GenMsgSendType" BO_ 915 0;
BA_ "VFrameFormat" BO_ 915 14;
BA_ "CANFD_BRS" BO_ 915 1;
BA_ "GenMsgCycleTime" BO_ 915 50;
BA_ "GenMsgCycleTimeFast" BO_ 915 0;
BA_ "GenMsgSendType" BO_ 915 0;
BA_ "VFrameFormat" BO_ 915 14;
BA_ "CANFD_BRS" BO_ 915 1;
BA_ "GenMsgCycleTime" BO_ 915 50;
BA_ "GenMsgCycleTimeFast" BO_ 915 0;
BA_ "GenMsgSendType" BO_ 915 0;
BA_ "VFrameFormat" BO_ 915 14;
BA_ "CANFD_BRS" BO_ 915 1;
BA_ "GenMsgCycleTime" BO_ 915 50;
BA_ "GenMsgCycleTimeFast" BO_ 915 0;
BA_ "GenMsgSendType" BO_ 915 0;
BA_ "VFrameFormat" BO_ 915 14;
BA_ "CANFD_BRS" BO_ 915 1;
BA_ "GenMsgCycleTime" BO_ 915 50;
BA_ "GenMsgCycleTimeFast" BO_ 915 0;
BA_ "GenMsgSendType" BO_ 915 0;
BA_ "VFrameFormat" BO_ 915 14;
BA_ "CANFD_BRS" BO_ 915 1;
BA_ "GenMsgCycleTime" BO_ 1188 0;
BA_ "GenMsgCycleTimeFast" BO_ 1188 0;
BA_ "GenMsgSendType" BO_ 1188 1;
BA_ "VFrameFormat" BO_ 1188 14;
BA_ "CANFD_BRS" BO_ 1188 1;
BA_ "GenMsgCycleTime" BO_ 387 10;
BA_ "GenMsgCycleTimeFast" BO_ 387 0;
BA_ "GenMsgSendType" BO_ 387 0;
BA_ "VFrameFormat" BO_ 387 14;
BA_ "CANFD_BRS" BO_ 387 1;
BA_ "GenMsgCycleTime" BO_ 387 10;
BA_ "GenMsgCycleTimeFast" BO_ 387 0;
BA_ "GenMsgSendType" BO_ 387 0;
BA_ "VFrameFormat" BO_ 387 14;
BA_ "CANFD_BRS" BO_ 387 1;
BA_ "GenMsgCycleTime" BO_ 387 10;
BA_ "GenMsgCycleTimeFast" BO_ 387 0;
BA_ "GenMsgSendType" BO_ 387 0;
BA_ "VFrameFormat" BO_ 387 14;
BA_ "CANFD_BRS" BO_ 387 1;
BA_ "GenMsgCycleTime" BO_ 387 10;
BA_ "GenMsgCycleTimeFast" BO_ 387 0;
BA_ "GenMsgSendType" BO_ 387 0;
BA_ "VFrameFormat" BO_ 387 14;
BA_ "CANFD_BRS" BO_ 387 1;
BA_ "GenMsgCycleTime" BO_ 387 10;
BA_ "GenMsgCycleTimeFast" BO_ 387 0;
BA_ "GenMsgSendType" BO_ 387 0;
BA_ "VFrameFormat" BO_ 387 14;
BA_ "CANFD_BRS" BO_ 387 1;
BA_ "GenMsgCycleTime" BO_ 387 10;
BA_ "GenMsgCycleTimeFast" BO_ 387 0;
BA_ "GenMsgSendType" BO_ 387 0;
BA_ "VFrameFormat" BO_ 387 14;
BA_ "CANFD_BRS" BO_ 387 1;
BA_ "GenMsgCycleTime" BO_ 387 10;
BA_ "GenMsgCycleTimeFast" BO_ 387 0;
BA_ "GenMsgSendType" BO_ 387 0;
BA_ "VFrameFormat" BO_ 387 14;
BA_ "CANFD_BRS" BO_ 387 1;
BA_ "GenMsgCycleTime" BO_ 387 10;
BA_ "GenMsgCycleTimeFast" BO_ 387 0;
BA_ "GenMsgSendType" BO_ 387 0;
BA_ "VFrameFormat" BO_ 387 14;
BA_ "CANFD_BRS" BO_ 387 1;
BA_ "GenMsgCycleTime" BO_ 387 10;
BA_ "GenMsgCycleTimeFast" BO_ 387 0;
BA_ "GenMsgSendType" BO_ 387 0;
BA_ "VFrameFormat" BO_ 387 14;
BA_ "CANFD_BRS" BO_ 387 1;
BA_ "GenMsgCycleTime" BO_ 387 10;
BA_ "GenMsgCycleTimeFast" BO_ 387 0;
BA_ "GenMsgSendType" BO_ 387 0;
BA_ "VFrameFormat" BO_ 387 14;
BA_ "CANFD_BRS" BO_ 387 1;
BA_ "GenMsgCycleTime" BO_ 387 10;
BA_ "GenMsgCycleTimeFast" BO_ 387 0;
BA_ "GenMsgSendType" BO_ 387 0;
BA_ "VFrameFormat" BO_ 387 14;
BA_ "CANFD_BRS" BO_ 387 1;
BA_ "GenMsgCycleTime" BO_ 387 10;
BA_ "GenMsgCycleTimeFast" BO_ 387 0;
BA_ "GenMsgSendType" BO_ 387 0;
BA_ "VFrameFormat" BO_ 387 14;
BA_ "CANFD_BRS" BO_ 387 1;
BA_ "GenMsgCycleTime" BO_ 387 10;
BA_ "GenMsgCycleTimeFast" BO_ 387 0;
BA_ "GenMsgSendType" BO_ 387 0;
BA_ "VFrameFormat" BO_ 387 14;
BA_ "CANFD_BRS" BO_ 387 1;
BA_ "GenMsgCycleTime" BO_ 387 10;
BA_ "GenMsgCycleTimeFast" BO_ 387 0;
BA_ "GenMsgSendType" BO_ 387 0;
BA_ "VFrameFormat" BO_ 387 14;
BA_ "CANFD_BRS" BO_ 387 1;
BA_ "GenMsgCycleTime" BO_ 387 10;
BA_ "GenMsgCycleTimeFast" BO_ 387 0;
BA_ "GenMsgSendType" BO_ 387 0;
BA_ "VFrameFormat" BO_ 387 14;
BA_ "CANFD_BRS" BO_ 387 1;
BA_ "GenMsgCycleTime" BO_ 387 10;
BA_ "GenMsgCycleTimeFast" BO_ 387 0;
BA_ "GenMsgSendType" BO_ 387 0;
BA_ "VFrameFormat" BO_ 387 14;
BA_ "CANFD_BRS" BO_ 387 1;
BA_ "GenMsgCycleTime" BO_ 387 10;
BA_ "GenMsgCycleTimeFast" BO_ 387 0;
BA_ "GenMsgSendType" BO_ 387 0;
BA_ "VFrameFormat" BO_ 387 14;
BA_ "CANFD_BRS" BO_ 387 1;
BA_ "GenMsgCycleTime" BO_ 387 10;
BA_ "GenMsgCycleTimeFast" BO_ 387 0;
BA_ "GenMsgSendType" BO_ 387 0;
BA_ "VFrameFormat" BO_ 387 14;
BA_ "CANFD_BRS" BO_ 387 1;
BA_ "GenMsgCycleTime" BO_ 387 10;
BA_ "GenMsgCycleTimeFast" BO_ 387 0;
BA_ "GenMsgSendType" BO_ 387 0;
BA_ "VFrameFormat" BO_ 387 14;
BA_ "CANFD_BRS" BO_ 387 1;
BA_ "GenMsgCycleTime" BO_ 387 10;
BA_ "GenMsgCycleTimeFast" BO_ 387 0;
BA_ "GenMsgSendType" BO_ 387 0;
BA_ "VFrameFormat" BO_ 387 14;
BA_ "CANFD_BRS" BO_ 387 1;
BA_ "GenMsgCycleTime" BO_ 387 10;
BA_ "GenMsgCycleTimeFast" BO_ 387 0;
BA_ "GenMsgSendType" BO_ 387 0;
BA_ "VFrameFormat" BO_ 387 14;
BA_ "CANFD_BRS" BO_ 387 1;
BA_ "GenMsgCycleTime" BO_ 387 10;
BA_ "GenMsgCycleTimeFast" BO_ 387 0;
BA_ "GenMsgSendType" BO_ 387 0;
BA_ "VFrameFormat" BO_ 387 14;
BA_ "CANFD_BRS" BO_ 387 1;
BA_ "GenMsgCycleTime" BO_ 387 10;
BA_ "GenMsgCycleTimeFast" BO_ 387 0;
BA_ "GenMsgSendType" BO_ 387 0;
BA_ "VFrameFormat" BO_ 387 14;
BA_ "CANFD_BRS" BO_ 387 1;
BA_ "GenMsgCycleTime" BO_ 387 10;
BA_ "GenMsgCycleTimeFast" BO_ 387 0;
BA_ "GenMsgSendType" BO_ 387 0;
BA_ "VFrameFormat" BO_ 387 14;
BA_ "CANFD_BRS" BO_ 387 1;
BA_ "GenMsgCycleTime" BO_ 387 10;
BA_ "GenMsgCycleTimeFast" BO_ 387 0;
BA_ "GenMsgSendType" BO_ 387 0;
BA_ "VFrameFormat" BO_ 387 14;
BA_ "CANFD_BRS" BO_ 387 1;
BA_ "GenMsgCycleTime" BO_ 387 10;
BA_ "GenMsgCycleTimeFast" BO_ 387 0;
BA_ "GenMsgSendType" BO_ 387 0;
BA_ "VFrameFormat" BO_ 387 14;
BA_ "CANFD_BRS" BO_ 387 1;
BA_ "GenMsgCycleTime" BO_ 387 10;
BA_ "GenMsgCycleTimeFast" BO_ 387 0;
BA_ "GenMsgSendType" BO_ 387 0;
BA_ "VFrameFormat" BO_ 387 14;
BA_ "CANFD_BRS" BO_ 387 1;
BA_ "GenMsgCycleTime" BO_ 387 10;
BA_ "GenMsgCycleTimeFast" BO_ 387 0;
BA_ "GenMsgSendType" BO_ 387 0;
BA_ "VFrameFormat" BO_ 387 14;
BA_ "CANFD_BRS" BO_ 387 1;
BA_ "GenMsgCycleTime" BO_ 387 10;
BA_ "GenMsgCycleTimeFast" BO_ 387 0;
BA_ "GenMsgSendType" BO_ 387 0;
BA_ "VFrameFormat" BO_ 387 14;
BA_ "CANFD_BRS" BO_ 387 1;
BA_ "GenMsgCycleTime" BO_ 387 10;
BA_ "GenMsgCycleTimeFast" BO_ 387 0;
BA_ "GenMsgSendType" BO_ 387 0;
BA_ "VFrameFormat" BO_ 387 14;
BA_ "CANFD_BRS" BO_ 387 1;
BA_ "GenMsgCycleTime" BO_ 387 10;
BA_ "GenMsgCycleTimeFast" BO_ 387 0;
BA_ "GenMsgSendType" BO_ 387 0;
BA_ "VFrameFormat" BO_ 387 14;
BA_ "CANFD_BRS" BO_ 387 1;
BA_ "GenMsgCycleTime" BO_ 387 10;
BA_ "GenMsgCycleTimeFast" BO_ 387 0;
BA_ "GenMsgSendType" BO_ 387 0;
BA_ "VFrameFormat" BO_ 387 14;
BA_ "CANFD_BRS" BO_ 387 1;
BA_ "GenMsgCycleTime" BO_ 387 10;
BA_ "GenMsgCycleTimeFast" BO_ 387 0;
BA_ "GenMsgSendType" BO_ 387 0;
BA_ "VFrameFormat" BO_ 387 14;
BA_ "CANFD_BRS" BO_ 387 1;
BA_ "GenMsgCycleTime" BO_ 387 10;
BA_ "GenMsgCycleTimeFast" BO_ 387 0;
BA_ "GenMsgSendType" BO_ 387 0;
BA_ "VFrameFormat" BO_ 387 14;
BA_ "CANFD_BRS" BO_ 387 1;
BA_ "GenMsgCycleTime" BO_ 387 10;
BA_ "GenMsgCycleTimeFast" BO_ 387 0;
BA_ "GenMsgSendType" BO_ 387 0;
BA_ "VFrameFormat" BO_ 387 14;
BA_ "CANFD_BRS" BO_ 387 1;
BA_ "GenMsgCycleTime" BO_ 387 10;
BA_ "GenMsgCycleTimeFast" BO_ 387 0;
BA_ "GenMsgSendType" BO_ 387 0;
BA_ "VFrameFormat" BO_ 387 14;
BA_ "CANFD_BRS" BO_ 387 1;
BA_ "GenMsgCycleTime" BO_ 387 10;
BA_ "GenMsgCycleTimeFast" BO_ 387 0;
BA_ "GenMsgSendType" BO_ 387 0;
BA_ "VFrameFormat" BO_ 387 14;
BA_ "CANFD_BRS" BO_ 387 1;
BA_ "GenMsgCycleTime" BO_ 387 10;
BA_ "GenMsgCycleTimeFast" BO_ 387 0;
BA_ "GenMsgSendType" BO_ 387 0;
BA_ "VFrameFormat" BO_ 387 14;
BA_ "CANFD_BRS" BO_ 387 1;
BA_ "GenMsgCycleTime" BO_ 387 10;
BA_ "GenMsgCycleTimeFast" BO_ 387 0;
BA_ "GenMsgSendType" BO_ 387 0;
BA_ "VFrameFormat" BO_ 387 14;
BA_ "CANFD_BRS" BO_ 387 1;
BA_ "GenMsgCycleTime" BO_ 387 10;
BA_ "GenMsgCycleTimeFast" BO_ 387 0;
BA_ "GenMsgSendType" BO_ 387 0;
BA_ "VFrameFormat" BO_ 387 14;
BA_ "CANFD_BRS" BO_ 387 1;
BA_ "GenMsgCycleTime" BO_ 387 10;
BA_ "GenMsgCycleTimeFast" BO_ 387 0;
BA_ "GenMsgSendType" BO_ 387 0;
BA_ "VFrameFormat" BO_ 387 14;
BA_ "CANFD_BRS" BO_ 387 1;
BA_ "GenMsgCycleTime" BO_ 387 10;
BA_ "GenMsgCycleTimeFast" BO_ 387 0;
BA_ "GenMsgSendType" BO_ 387 0;
BA_ "VFrameFormat" BO_ 387 14;
BA_ "CANFD_BRS" BO_ 387 1;
BA_ "GenMsgCycleTime" BO_ 387 10;
BA_ "GenMsgCycleTimeFast" BO_ 387 0;
BA_ "GenMsgSendType" BO_ 387 0;
BA_ "VFrameFormat" BO_ 387 14;
BA_ "CANFD_BRS" BO_ 387 1;
BA_ "GenMsgCycleTime" BO_ 387 10;
BA_ "GenMsgCycleTimeFast" BO_ 387 0;
BA_ "GenMsgSendType" BO_ 387 0;
BA_ "VFrameFormat" BO_ 387 14;
BA_ "CANFD_BRS" BO_ 387 1;
BA_ "GenMsgCycleTime" BO_ 387 10;
BA_ "GenMsgCycleTimeFast" BO_ 387 0;
BA_ "GenMsgSendType" BO_ 387 0;
BA_ "VFrameFormat" BO_ 387 14;
BA_ "CANFD_BRS" BO_ 387 1;
BA_ "GenMsgCycleTime" BO_ 387 10;
BA_ "GenMsgCycleTimeFast" BO_ 387 0;
BA_ "GenMsgSendType" BO_ 387 0;
BA_ "VFrameFormat" BO_ 387 14;
BA_ "CANFD_BRS" BO_ 387 1;
BA_ "GenMsgCycleTime" BO_ 387 10;
BA_ "GenMsgCycleTimeFast" BO_ 387 0;
BA_ "GenMsgSendType" BO_ 387 0;
BA_ "VFrameFormat" BO_ 387 14;
BA_ "CANFD_BRS" BO_ 387 1;
BA_ "GenMsgCycleTime" BO_ 387 10;
BA_ "GenMsgCycleTimeFast" BO_ 387 0;
BA_ "GenMsgSendType" BO_ 387 0;
BA_ "VFrameFormat" BO_ 387 14;
BA_ "CANFD_BRS" BO_ 387 1;
BA_ "GenMsgCycleTime" BO_ 387 10;
BA_ "GenMsgCycleTimeFast" BO_ 387 0;
BA_ "GenMsgSendType" BO_ 387 0;
BA_ "VFrameFormat" BO_ 387 14;
BA_ "CANFD_BRS" BO_ 387 1;
BA_ "GenMsgCycleTime" BO_ 387 10;
BA_ "GenMsgCycleTimeFast" BO_ 387 0;
BA_ "GenMsgSendType" BO_ 387 0;
BA_ "VFrameFormat" BO_ 387 14;
BA_ "CANFD_BRS" BO_ 387 1;
BA_ "GenMsgCycleTime" BO_ 387 10;
BA_ "GenMsgCycleTimeFast" BO_ 387 0;
BA_ "GenMsgSendType" BO_ 387 0;
BA_ "VFrameFormat" BO_ 387 14;
BA_ "CANFD_BRS" BO_ 387 1;
BA_ "GenMsgCycleTime" BO_ 387 10;
BA_ "GenMsgCycleTimeFast" BO_ 387 0;
BA_ "GenMsgSendType" BO_ 387 0;
BA_ "VFrameFormat" BO_ 387 14;
BA_ "CANFD_BRS" BO_ 387 1;
BA_ "GenMsgCycleTime" BO_ 387 10;
BA_ "GenMsgCycleTimeFast" BO_ 387 0;
BA_ "GenMsgSendType" BO_ 387 0;
BA_ "VFrameFormat" BO_ 387 14;
BA_ "CANFD_BRS" BO_ 387 1;
BA_ "GenMsgCycleTime" BO_ 387 10;
BA_ "GenMsgCycleTimeFast" BO_ 387 0;
BA_ "GenMsgSendType" BO_ 387 0;
BA_ "VFrameFormat" BO_ 387 14;
BA_ "CANFD_BRS" BO_ 387 1;
BA_ "GenMsgCycleTime" BO_ 387 10;
BA_ "GenMsgCycleTimeFast" BO_ 387 0;
BA_ "GenMsgSendType" BO_ 387 0;
BA_ "VFrameFormat" BO_ 387 14;
BA_ "CANFD_BRS" BO_ 387 1;
BA_ "GenMsgCycleTime" BO_ 387 10;
BA_ "GenMsgCycleTimeFast" BO_ 387 0;
BA_ "GenMsgSendType" BO_ 387 0;
BA_ "VFrameFormat" BO_ 387 14;
BA_ "CANFD_BRS" BO_ 387 1;
BA_ "GenMsgCycleTime" BO_ 387 10;
BA_ "GenMsgCycleTimeFast" BO_ 387 0;
BA_ "GenMsgSendType" BO_ 387 0;
BA_ "VFrameFormat" BO_ 387 14;
BA_ "CANFD_BRS" BO_ 387 1;
BA_ "GenMsgCycleTime" BO_ 387 10;
BA_ "GenMsgCycleTimeFast" BO_ 387 0;
BA_ "GenMsgSendType" BO_ 387 0;
BA_ "VFrameFormat" BO_ 387 14;
BA_ "CANFD_BRS" BO_ 387 1;
BA_ "GenMsgCycleTime" BO_ 387 10;
BA_ "GenMsgCycleTimeFast" BO_ 387 0;
BA_ "GenMsgSendType" BO_ 387 0;
BA_ "VFrameFormat" BO_ 387 14;
BA_ "CANFD_BRS" BO_ 387 1;
BA_ "GenMsgCycleTime" BO_ 387 10;
BA_ "GenMsgCycleTimeFast" BO_ 387 0;
BA_ "GenMsgSendType" BO_ 387 0;
BA_ "VFrameFormat" BO_ 387 14;
BA_ "CANFD_BRS" BO_ 387 1;
BA_ "GenMsgCycleTime" BO_ 387 10;
BA_ "GenMsgCycleTimeFast" BO_ 387 0;
BA_ "GenMsgSendType" BO_ 387 0;
BA_ "VFrameFormat" BO_ 387 14;
BA_ "CANFD_BRS" BO_ 387 1;
BA_ "GenMsgCycleTime" BO_ 387 10;
BA_ "GenMsgCycleTimeFast" BO_ 387 0;
BA_ "GenMsgSendType" BO_ 387 0;
BA_ "VFrameFormat" BO_ 387 14;
BA_ "CANFD_BRS" BO_ 387 1;
BA_ "GenMsgCycleTime" BO_ 387 10;
BA_ "GenMsgCycleTimeFast" BO_ 387 0;
BA_ "GenMsgSendType" BO_ 387 0;
BA_ "VFrameFormat" BO_ 387 14;
BA_ "CANFD_BRS" BO_ 387 1;
BA_ "GenMsgCycleTime" BO_ 387 10;
BA_ "GenMsgCycleTimeFast" BO_ 387 0;
BA_ "GenMsgSendType" BO_ 387 0;
BA_ "VFrameFormat" BO_ 387 14;
BA_ "CANFD_BRS" BO_ 387 1;
BA_ "GenMsgCycleTime" BO_ 387 10;
BA_ "GenMsgCycleTimeFast" BO_ 387 0;
BA_ "GenMsgSendType" BO_ 387 0;
BA_ "VFrameFormat" BO_ 387 14;
BA_ "CANFD_BRS" BO_ 387 1;
BA_ "GenMsgCycleTime" BO_ 387 10;
BA_ "GenMsgCycleTimeFast" BO_ 387 0;
BA_ "GenMsgSendType" BO_ 387 0;
BA_ "VFrameFormat" BO_ 387 14;
BA_ "CANFD_BRS" BO_ 387 1;
BA_ "GenMsgCycleTime" BO_ 387 10;
BA_ "GenMsgCycleTimeFast" BO_ 387 0;
BA_ "GenMsgSendType" BO_ 387 0;
BA_ "VFrameFormat" BO_ 387 14;
BA_ "CANFD_BRS" BO_ 387 1;
BA_ "GenMsgCycleTime" BO_ 387 10;
BA_ "GenMsgCycleTimeFast" BO_ 387 0;
BA_ "GenMsgSendType" BO_ 387 0;
BA_ "VFrameFormat" BO_ 387 14;
BA_ "CANFD_BRS" BO_ 387 1;
BA_ "GenMsgCycleTime" BO_ 387 10;
BA_ "GenMsgCycleTimeFast" BO_ 387 0;
BA_ "GenMsgSendType" BO_ 387 0;
BA_ "VFrameFormat" BO_ 387 14;
BA_ "CANFD_BRS" BO_ 387 1;
BA_ "GenMsgCycleTime" BO_ 387 10;
BA_ "GenMsgCycleTimeFast" BO_ 387 0;
BA_ "GenMsgSendType" BO_ 387 0;
BA_ "VFrameFormat" BO_ 387 14;
BA_ "CANFD_BRS" BO_ 387 1;
BA_ "GenMsgCycleTime" BO_ 387 10;
BA_ "GenMsgCycleTimeFast" BO_ 387 0;
BA_ "GenMsgSendType" BO_ 387 0;
BA_ "VFrameFormat" BO_ 387 14;
BA_ "CANFD_BRS" BO_ 387 1;
BA_ "GenMsgCycleTime" BO_ 387 10;
BA_ "GenMsgCycleTimeFast" BO_ 387 0;
BA_ "GenMsgSendType" BO_ 387 0;
BA_ "VFrameFormat" BO_ 387 14;
BA_ "CANFD_BRS" BO_ 387 1;
BA_ "GenMsgCycleTime" BO_ 387 10;
BA_ "GenMsgCycleTimeFast" BO_ 387 0;
BA_ "GenMsgSendType" BO_ 387 0;
BA_ "VFrameFormat" BO_ 387 14;
BA_ "CANFD_BRS" BO_ 387 1;
BA_ "GenMsgCycleTime" BO_ 387 10;
BA_ "GenMsgCycleTimeFast" BO_ 387 0;
BA_ "GenMsgSendType" BO_ 387 0;
BA_ "VFrameFormat" BO_ 387 14;
BA_ "CANFD_BRS" BO_ 387 1;
BA_ "GenMsgCycleTime" BO_ 387 10;
BA_ "GenMsgCycleTimeFast" BO_ 387 0;
BA_ "GenMsgSendType" BO_ 387 0;
BA_ "VFrameFormat" BO_ 387 14;
BA_ "CANFD_BRS" BO_ 387 1;
BA_ "GenMsgCycleTime" BO_ 387 10;
BA_ "GenMsgCycleTimeFast" BO_ 387 0;
BA_ "GenMsgSendType" BO_ 387 0;
BA_ "VFrameFormat" BO_ 387 14;
BA_ "CANFD_BRS" BO_ 387 1;
BA_ "GenMsgCycleTime" BO_ 387 10;
BA_ "GenMsgCycleTimeFast" BO_ 387 0;
BA_ "GenMsgSendType" BO_ 387 0;
BA_ "VFrameFormat" BO_ 387 14;
BA_ "CANFD_BRS" BO_ 387 1;
BA_ "GenMsgCycleTime" BO_ 783 50;
BA_ "GenMsgCycleTimeFast" BO_ 783 0;
BA_ "GenMsgSendType" BO_ 783 0;
BA_ "VFrameFormat" BO_ 783 14;
BA_ "CANFD_BRS" BO_ 783 1;
BA_ "GenMsgCycleTime" BO_ 783 50;
BA_ "GenMsgCycleTimeFast" BO_ 783 0;
BA_ "GenMsgSendType" BO_ 783 0;
BA_ "VFrameFormat" BO_ 783 14;
BA_ "CANFD_BRS" BO_ 783 1;
BA_ "GenMsgCycleTime" BO_ 783 50;
BA_ "GenMsgCycleTimeFast" BO_ 783 0;
BA_ "GenMsgSendType" BO_ 783 0;
BA_ "VFrameFormat" BO_ 783 14;
BA_ "CANFD_BRS" BO_ 783 1;
BA_ "GenMsgCycleTime" BO_ 783 50;
BA_ "GenMsgCycleTimeFast" BO_ 783 0;
BA_ "GenMsgSendType" BO_ 783 0;
BA_ "VFrameFormat" BO_ 783 14;
BA_ "CANFD_BRS" BO_ 783 1;
BA_ "GenMsgCycleTime" BO_ 783 50;
BA_ "GenMsgCycleTimeFast" BO_ 783 0;
BA_ "GenMsgSendType" BO_ 783 0;
BA_ "VFrameFormat" BO_ 783 14;
BA_ "CANFD_BRS" BO_ 783 1;
BA_ "GenMsgCycleTime" BO_ 783 50;
BA_ "GenMsgCycleTimeFast" BO_ 783 0;
BA_ "GenMsgSendType" BO_ 783 0;
BA_ "VFrameFormat" BO_ 783 14;
BA_ "CANFD_BRS" BO_ 783 1;
BA_ "GenMsgCycleTime" BO_ 783 50;
BA_ "GenMsgCycleTimeFast" BO_ 783 0;
BA_ "GenMsgSendType" BO_ 783 0;
BA_ "VFrameFormat" BO_ 783 14;
BA_ "CANFD_BRS" BO_ 783 1;
BA_ "GenMsgCycleTime" BO_ 783 50;
BA_ "GenMsgCycleTimeFast" BO_ 783 0;
BA_ "GenMsgSendType" BO_ 783 0;
BA_ "VFrameFormat" BO_ 783 14;
BA_ "CANFD_BRS" BO_ 783 1;
BA_ "GenMsgCycleTime" BO_ 783 50;
BA_ "GenMsgCycleTimeFast" BO_ 783 0;
BA_ "GenMsgSendType" BO_ 783 0;
BA_ "VFrameFormat" BO_ 783 14;
BA_ "CANFD_BRS" BO_ 783 1;
BA_ "GenMsgCycleTime" BO_ 783 50;
BA_ "GenMsgCycleTimeFast" BO_ 783 0;
BA_ "GenMsgSendType" BO_ 783 0;
BA_ "VFrameFormat" BO_ 783 14;
BA_ "CANFD_BRS" BO_ 783 1;
BA_ "GenMsgCycleTime" BO_ 783 50;
BA_ "GenMsgCycleTimeFast" BO_ 783 0;
BA_ "GenMsgSendType" BO_ 783 0;
BA_ "VFrameFormat" BO_ 783 14;
BA_ "CANFD_BRS" BO_ 783 1;
BA_ "GenMsgCycleTime" BO_ 783 50;
BA_ "GenMsgCycleTimeFast" BO_ 783 0;
BA_ "GenMsgSendType" BO_ 783 0;
BA_ "VFrameFormat" BO_ 783 14;
BA_ "CANFD_BRS" BO_ 783 1;
BA_ "GenMsgCycleTime" BO_ 783 50;
BA_ "GenMsgCycleTimeFast" BO_ 783 0;
BA_ "GenMsgSendType" BO_ 783 0;
BA_ "VFrameFormat" BO_ 783 14;
BA_ "CANFD_BRS" BO_ 783 1;
BA_ "GenMsgCycleTime" BO_ 783 50;
BA_ "GenMsgCycleTimeFast" BO_ 783 0;
BA_ "GenMsgSendType" BO_ 783 0;
BA_ "VFrameFormat" BO_ 783 14;
BA_ "CANFD_BRS" BO_ 783 1;
BA_ "GenMsgCycleTime" BO_ 783 50;
BA_ "GenMsgCycleTimeFast" BO_ 783 0;
BA_ "GenMsgSendType" BO_ 783 0;
BA_ "VFrameFormat" BO_ 783 14;
BA_ "CANFD_BRS" BO_ 783 1;
BA_ "GenMsgCycleTime" BO_ 783 50;
BA_ "GenMsgCycleTimeFast" BO_ 783 0;
BA_ "GenMsgSendType" BO_ 783 0;
BA_ "VFrameFormat" BO_ 783 14;
BA_ "CANFD_BRS" BO_ 783 1;
BA_ "GenMsgCycleTime" BO_ 783 50;
BA_ "GenMsgCycleTimeFast" BO_ 783 0;
BA_ "GenMsgSendType" BO_ 783 0;
BA_ "VFrameFormat" BO_ 783 14;
BA_ "CANFD_BRS" BO_ 783 1;
BA_ "GenMsgCycleTime" BO_ 783 50;
BA_ "GenMsgCycleTimeFast" BO_ 783 0;
BA_ "GenMsgSendType" BO_ 783 0;
BA_ "VFrameFormat" BO_ 783 14;
BA_ "CANFD_BRS" BO_ 783 1;
BA_ "GenMsgCycleTime" BO_ 783 50;
BA_ "GenMsgCycleTimeFast" BO_ 783 0;
BA_ "GenMsgSendType" BO_ 783 0;
BA_ "VFrameFormat" BO_ 783 14;
BA_ "CANFD_BRS" BO_ 783 1;
BA_ "GenMsgCycleTime" BO_ 783 50;
BA_ "GenMsgCycleTimeFast" BO_ 783 0;
BA_ "GenMsgSendType" BO_ 783 0;
BA_ "VFrameFormat" BO_ 783 14;
BA_ "CANFD_BRS" BO_ 783 1;
BA_ "GenMsgCycleTime" BO_ 783 50;
BA_ "GenMsgCycleTimeFast" BO_ 783 0;
BA_ "GenMsgSendType" BO_ 783 0;
BA_ "VFrameFormat" BO_ 783 14;
BA_ "CANFD_BRS" BO_ 783 1;
BA_ "GenMsgCycleTime" BO_ 783 50;
BA_ "GenMsgCycleTimeFast" BO_ 783 0;
BA_ "GenMsgSendType" BO_ 783 0;
BA_ "VFrameFormat" BO_ 783 14;
BA_ "CANFD_BRS" BO_ 783 1;
BA_ "GenMsgCycleTime" BO_ 783 50;
BA_ "GenMsgCycleTimeFast" BO_ 783 0;
BA_ "GenMsgSendType" BO_ 783 0;
BA_ "VFrameFormat" BO_ 783 14;
BA_ "CANFD_BRS" BO_ 783 1;
BA_ "GenMsgCycleTime" BO_ 783 50;
BA_ "GenMsgCycleTimeFast" BO_ 783 0;
BA_ "GenMsgSendType" BO_ 783 0;
BA_ "VFrameFormat" BO_ 783 14;
BA_ "CANFD_BRS" BO_ 783 1;
BA_ "GenMsgCycleTime" BO_ 783 50;
BA_ "GenMsgCycleTimeFast" BO_ 783 0;
BA_ "GenMsgSendType" BO_ 783 0;
BA_ "VFrameFormat" BO_ 783 14;
BA_ "CANFD_BRS" BO_ 783 1;
BA_ "GenMsgCycleTime" BO_ 783 50;
BA_ "GenMsgCycleTimeFast" BO_ 783 0;
BA_ "GenMsgSendType" BO_ 783 0;
BA_ "VFrameFormat" BO_ 783 14;
BA_ "CANFD_BRS" BO_ 783 1;
BA_ "GenMsgCycleTime" BO_ 783 50;
BA_ "GenMsgCycleTimeFast" BO_ 783 0;
BA_ "GenMsgSendType" BO_ 783 0;
BA_ "VFrameFormat" BO_ 783 14;
BA_ "CANFD_BRS" BO_ 783 1;
BA_ "GenMsgCycleTime" BO_ 783 50;
BA_ "GenMsgCycleTimeFast" BO_ 783 0;
BA_ "GenMsgSendType" BO_ 783 0;
BA_ "VFrameFormat" BO_ 783 14;
BA_ "CANFD_BRS" BO_ 783 1;
BA_ "GenMsgCycleTime" BO_ 783 50;
BA_ "GenMsgCycleTimeFast" BO_ 783 0;
BA_ "GenMsgSendType" BO_ 783 0;
BA_ "VFrameFormat" BO_ 783 14;
BA_ "CANFD_BRS" BO_ 783 1;
BA_ "GenMsgCycleTime" BO_ 783 50;
BA_ "GenMsgCycleTimeFast" BO_ 783 0;
BA_ "GenMsgSendType" BO_ 783 0;
BA_ "VFrameFormat" BO_ 783 14;
BA_ "CANFD_BRS" BO_ 783 1;
BA_ "GenMsgCycleTime" BO_ 783 50;
BA_ "GenMsgCycleTimeFast" BO_ 783 0;
BA_ "GenMsgSendType" BO_ 783 0;
BA_ "VFrameFormat" BO_ 783 14;
BA_ "CANFD_BRS" BO_ 783 1;
BA_ "GenMsgCycleTime" BO_ 783 50;
BA_ "GenMsgCycleTimeFast" BO_ 783 0;
BA_ "GenMsgSendType" BO_ 783 0;
BA_ "VFrameFormat" BO_ 783 14;
BA_ "CANFD_BRS" BO_ 783 1;
BA_ "GenMsgCycleTime" BO_ 783 50;
BA_ "GenMsgCycleTimeFast" BO_ 783 0;
BA_ "GenMsgSendType" BO_ 783 0;
BA_ "VFrameFormat" BO_ 783 14;
BA_ "CANFD_BRS" BO_ 783 1;
BA_ "GenMsgCycleTime" BO_ 783 50;
BA_ "GenMsgCycleTimeFast" BO_ 783 0;
BA_ "GenMsgSendType" BO_ 783 0;
BA_ "VFrameFormat" BO_ 783 14;
BA_ "CANFD_BRS" BO_ 783 1;
BA_ "GenMsgCycleTime" BO_ 783 50;
BA_ "GenMsgCycleTimeFast" BO_ 783 0;
BA_ "GenMsgSendType" BO_ 783 0;
BA_ "VFrameFormat" BO_ 783 14;
BA_ "CANFD_BRS" BO_ 783 1;
BA_ "GenMsgCycleTime" BO_ 783 50;
BA_ "GenMsgCycleTimeFast" BO_ 783 0;
BA_ "GenMsgSendType" BO_ 783 0;
BA_ "VFrameFormat" BO_ 783 14;
BA_ "CANFD_BRS" BO_ 783 1;
BA_ "GenMsgCycleTime" BO_ 783 50;
BA_ "GenMsgCycleTimeFast" BO_ 783 0;
BA_ "GenMsgSendType" BO_ 783 0;
BA_ "VFrameFormat" BO_ 783 14;
BA_ "CANFD_BRS" BO_ 783 1;
BA_ "GenMsgCycleTime" BO_ 783 50;
BA_ "GenMsgCycleTimeFast" BO_ 783 0;
BA_ "GenMsgSendType" BO_ 783 0;
BA_ "VFrameFormat" BO_ 783 14;
BA_ "CANFD_BRS" BO_ 783 1;
BA_ "GenMsgCycleTime" BO_ 783 50;
BA_ "GenMsgCycleTimeFast" BO_ 783 0;
BA_ "GenMsgSendType" BO_ 783 0;
BA_ "VFrameFormat" BO_ 783 14;
BA_ "CANFD_BRS" BO_ 783 1;
BA_ "GenMsgCycleTime" BO_ 783 50;
BA_ "GenMsgCycleTimeFast" BO_ 783 0;
BA_ "GenMsgSendType" BO_ 783 0;
BA_ "VFrameFormat" BO_ 783 14;
BA_ "CANFD_BRS" BO_ 783 1;
BA_ "GenMsgCycleTime" BO_ 783 50;
BA_ "GenMsgCycleTimeFast" BO_ 783 0;
BA_ "GenMsgSendType" BO_ 783 0;
BA_ "VFrameFormat" BO_ 783 14;
BA_ "CANFD_BRS" BO_ 783 1;
BA_ "GenMsgCycleTime" BO_ 783 50;
BA_ "GenMsgCycleTimeFast" BO_ 783 0;
BA_ "GenMsgSendType" BO_ 783 0;
BA_ "VFrameFormat" BO_ 783 14;
BA_ "CANFD_BRS" BO_ 783 1;
BA_ "GenMsgCycleTime" BO_ 783 50;
BA_ "GenMsgCycleTimeFast" BO_ 783 0;
BA_ "GenMsgSendType" BO_ 783 0;
BA_ "VFrameFormat" BO_ 783 14;
BA_ "CANFD_BRS" BO_ 783 1;
BA_ "GenMsgCycleTime" BO_ 783 50;
BA_ "GenMsgCycleTimeFast" BO_ 783 0;
BA_ "GenMsgSendType" BO_ 783 0;
BA_ "VFrameFormat" BO_ 783 14;
BA_ "CANFD_BRS" BO_ 783 1;
BA_ "GenMsgCycleTime" BO_ 783 50;
BA_ "GenMsgCycleTimeFast" BO_ 783 0;
BA_ "GenMsgSendType" BO_ 783 0;
BA_ "VFrameFormat" BO_ 783 14;
BA_ "CANFD_BRS" BO_ 783 1;
BA_ "EventCommandSignal" SG_ 915 ADC_3_CRC 0;
BA_ "GatewayedSignals" SG_ 915 ADC_3_CRC 0;
BA_ "GenSigInactiveValue" SG_ 915 ADC_3_CRC 0;
BA_ "GenSigInvalidValue" SG_ 915 ADC_3_CRC 0;
BA_ "GenSigSendType" SG_ 915 ADC_3_CRC 1;
BA_ "GenSigStartValue" SG_ 915 ADC_3_CRC 0;
BA_ "GenSigTimeoutValue" SG_ 915 ADC_3_CRC 0;
BA_ "Remark" SG_ 915 ADC_3_CRC "";
BA_ "EventCommandSignal" SG_ 915 ADC_3_Counter 0;
BA_ "GatewayedSignals" SG_ 915 ADC_3_Counter 0;
BA_ "GenSigInactiveValue" SG_ 915 ADC_3_Counter 0;
BA_ "GenSigInvalidValue" SG_ 915 ADC_3_Counter 0;
BA_ "GenSigSendType" SG_ 915 ADC_3_Counter 1;
BA_ "GenSigStartValue" SG_ 915 ADC_3_Counter 0;
BA_ "GenSigTimeoutValue" SG_ 915 ADC_3_Counter 0;
BA_ "Remark" SG_ 915 ADC_3_Counter "";
BA_ "EventCommandSignal" SG_ 915 ADC_FroTrkTargt0ObjClass 0;
BA_ "GatewayedSignals" SG_ 915 ADC_FroTrkTargt0ObjClass 0;
BA_ "GenSigInactiveValue" SG_ 915 ADC_FroTrkTargt0ObjClass 0;
BA_ "GenSigInvalidValue" SG_ 915 ADC_FroTrkTargt0ObjClass 0;
BA_ "GenSigSendType" SG_ 915 ADC_FroTrkTargt0ObjClass 1;
BA_ "GenSigStartValue" SG_ 915 ADC_FroTrkTargt0ObjClass 0;
BA_ "GenSigTimeoutValue" SG_ 915 ADC_FroTrkTargt0ObjClass 0;
BA_ "Remark" SG_ 915 ADC_FroTrkTargt0ObjClass "";
BA_ "EventCommandSignal" SG_ 915 ADC_FroTrkTargt0St 0;
BA_ "GatewayedSignals" SG_ 915 ADC_FroTrkTargt0St 0;
BA_ "GenSigInactiveValue" SG_ 915 ADC_FroTrkTargt0St 0;
BA_ "GenSigInvalidValue" SG_ 915 ADC_FroTrkTargt0St 0;
BA_ "GenSigSendType" SG_ 915 ADC_FroTrkTargt0St 1;
BA_ "GenSigStartValue" SG_ 915 ADC_FroTrkTargt0St 0;
BA_ "GenSigTimeoutValue" SG_ 915 ADC_FroTrkTargt0St 0;
BA_ "Remark" SG_ 915 ADC_FroTrkTargt0St "";
BA_ "EventCommandSignal" SG_ 915 ADC_FroTrkTargt0longPos 0;
BA_ "GatewayedSignals" SG_ 915 ADC_FroTrkTargt0longPos 0;
BA_ "GenSigInactiveValue" SG_ 915 ADC_FroTrkTargt0longPos 0;
BA_ "GenSigInvalidValue" SG_ 915 ADC_FroTrkTargt0longPos 1023;
BA_ "GenSigSendType" SG_ 915 ADC_FroTrkTargt0longPos 1;
BA_ "GenSigStartValue" SG_ 915 ADC_FroTrkTargt0longPos 0;
BA_ "GenSigTimeoutValue" SG_ 915 ADC_FroTrkTargt0longPos 0;
BA_ "Remark" SG_ 915 ADC_FroTrkTargt0longPos "";
BA_ "EventCommandSignal" SG_ 915 ADC_FroTrkTargt0latPos 0;
BA_ "GatewayedSignals" SG_ 915 ADC_FroTrkTargt0latPos 0;
BA_ "GenSigInactiveValue" SG_ 915 ADC_FroTrkTargt0latPos 0;
BA_ "GenSigInvalidValue" SG_ 915 ADC_FroTrkTargt0latPos 0;
BA_ "GenSigSendType" SG_ 915 ADC_FroTrkTargt0latPos 1;
BA_ "GenSigStartValue" SG_ 915 ADC_FroTrkTargt0latPos 512;
BA_ "GenSigTimeoutValue" SG_ 915 ADC_FroTrkTargt0latPos 0;
BA_ "Remark" SG_ 915 ADC_FroTrkTargt0latPos "";
BA_ "EventCommandSignal" SG_ 915 ADC_FroTrkTargt0LatRelSpd 0;
BA_ "GatewayedSignals" SG_ 915 ADC_FroTrkTargt0LatRelSpd 0;
BA_ "GenSigInactiveValue" SG_ 915 ADC_FroTrkTargt0LatRelSpd 0;
BA_ "GenSigInvalidValue" SG_ 915 ADC_FroTrkTargt0LatRelSpd 511;
BA_ "GenSigSendType" SG_ 915 ADC_FroTrkTargt0LatRelSpd 1;
BA_ "GenSigStartValue" SG_ 915 ADC_FroTrkTargt0LatRelSpd 0;
BA_ "GenSigTimeoutValue" SG_ 915 ADC_FroTrkTargt0LatRelSpd 0;
BA_ "Remark" SG_ 915 ADC_FroTrkTargt0LatRelSpd "";
BA_ "EventCommandSignal" SG_ 915 ADC_FroTrkTargt0LongRelSpd 0;
BA_ "GatewayedSignals" SG_ 915 ADC_FroTrkTargt0LongRelSpd 0;
BA_ "GenSigInactiveValue" SG_ 915 ADC_FroTrkTargt0LongRelSpd 0;
BA_ "GenSigInvalidValue" SG_ 915 ADC_FroTrkTargt0LongRelSpd 0;
BA_ "GenSigSendType" SG_ 915 ADC_FroTrkTargt0LongRelSpd 1;
BA_ "GenSigStartValue" SG_ 915 ADC_FroTrkTargt0LongRelSpd 0;
BA_ "GenSigTimeoutValue" SG_ 915 ADC_FroTrkTargt0LongRelSpd 0;
BA_ "Remark" SG_ 915 ADC_FroTrkTargt0LongRelSpd "";
BA_ "EventCommandSignal" SG_ 915 ADC_FroTrkTargt0DetSensor 0;
BA_ "GatewayedSignals" SG_ 915 ADC_FroTrkTargt0DetSensor 0;
BA_ "GenSigInactiveValue" SG_ 915 ADC_FroTrkTargt0DetSensor 0;
BA_ "GenSigInvalidValue" SG_ 915 ADC_FroTrkTargt0DetSensor 0;
BA_ "GenSigSendType" SG_ 915 ADC_FroTrkTargt0DetSensor 1;
BA_ "GenSigStartValue" SG_ 915 ADC_FroTrkTargt0DetSensor 0;
BA_ "GenSigTimeoutValue" SG_ 915 ADC_FroTrkTargt0DetSensor 0;
BA_ "Remark" SG_ 915 ADC_FroTrkTargt0DetSensor "";
BA_ "EventCommandSignal" SG_ 915 ADC_FroTrkTargt1ObjClass 0;
BA_ "GatewayedSignals" SG_ 915 ADC_FroTrkTargt1ObjClass 0;
BA_ "GenSigInactiveValue" SG_ 915 ADC_FroTrkTargt1ObjClass 0;
BA_ "GenSigInvalidValue" SG_ 915 ADC_FroTrkTargt1ObjClass 0;
BA_ "GenSigSendType" SG_ 915 ADC_FroTrkTargt1ObjClass 1;
BA_ "GenSigStartValue" SG_ 915 ADC_FroTrkTargt1ObjClass 0;
BA_ "GenSigTimeoutValue" SG_ 915 ADC_FroTrkTargt1ObjClass 0;
BA_ "Remark" SG_ 915 ADC_FroTrkTargt1ObjClass "";
BA_ "EventCommandSignal" SG_ 915 ADC_FroTrkTargt1St 0;
BA_ "GatewayedSignals" SG_ 915 ADC_FroTrkTargt1St 0;
BA_ "GenSigInactiveValue" SG_ 915 ADC_FroTrkTargt1St 0;
BA_ "GenSigInvalidValue" SG_ 915 ADC_FroTrkTargt1St 0;
BA_ "GenSigSendType" SG_ 915 ADC_FroTrkTargt1St 1;
BA_ "GenSigStartValue" SG_ 915 ADC_FroTrkTargt1St 0;
BA_ "GenSigTimeoutValue" SG_ 915 ADC_FroTrkTargt1St 0;
BA_ "Remark" SG_ 915 ADC_FroTrkTargt1St "";
BA_ "EventCommandSignal" SG_ 915 ADC_FroTrkTargt1longPos 0;
BA_ "GatewayedSignals" SG_ 915 ADC_FroTrkTargt1longPos 0;
BA_ "GenSigInactiveValue" SG_ 915 ADC_FroTrkTargt1longPos 0;
BA_ "GenSigInvalidValue" SG_ 915 ADC_FroTrkTargt1longPos 1023;
BA_ "GenSigSendType" SG_ 915 ADC_FroTrkTargt1longPos 1;
BA_ "GenSigStartValue" SG_ 915 ADC_FroTrkTargt1longPos 0;
BA_ "GenSigTimeoutValue" SG_ 915 ADC_FroTrkTargt1longPos 0;
BA_ "Remark" SG_ 915 ADC_FroTrkTargt1longPos "";
BA_ "EventCommandSignal" SG_ 915 ADC_FroTrkTargt1latPos 0;
BA_ "GatewayedSignals" SG_ 915 ADC_FroTrkTargt1latPos 0;
BA_ "GenSigInactiveValue" SG_ 915 ADC_FroTrkTargt1latPos 0;
BA_ "GenSigInvalidValue" SG_ 915 ADC_FroTrkTargt1latPos 0;
BA_ "GenSigSendType" SG_ 915 ADC_FroTrkTargt1latPos 1;
BA_ "GenSigStartValue" SG_ 915 ADC_FroTrkTargt1latPos 512;
BA_ "GenSigTimeoutValue" SG_ 915 ADC_FroTrkTargt1latPos 0;
BA_ "Remark" SG_ 915 ADC_FroTrkTargt1latPos "";
BA_ "EventCommandSignal" SG_ 915 ADC_FroTrkTargt1LatRelSpd 0;
BA_ "GatewayedSignals" SG_ 915 ADC_FroTrkTargt1LatRelSpd 0;
BA_ "GenSigInactiveValue" SG_ 915 ADC_FroTrkTargt1LatRelSpd 0;
BA_ "GenSigInvalidValue" SG_ 915 ADC_FroTrkTargt1LatRelSpd 511;
BA_ "GenSigSendType" SG_ 915 ADC_FroTrkTargt1LatRelSpd 1;
BA_ "GenSigStartValue" SG_ 915 ADC_FroTrkTargt1LatRelSpd 0;
BA_ "GenSigTimeoutValue" SG_ 915 ADC_FroTrkTargt1LatRelSpd 0;
BA_ "Remark" SG_ 915 ADC_FroTrkTargt1LatRelSpd "";
BA_ "EventCommandSignal" SG_ 915 ADC_FroTrkTargt1LongRelSpd 0;
BA_ "GatewayedSignals" SG_ 915 ADC_FroTrkTargt1LongRelSpd 0;
BA_ "GenSigInactiveValue" SG_ 915 ADC_FroTrkTargt1LongRelSpd 0;
BA_ "GenSigInvalidValue" SG_ 915 ADC_FroTrkTargt1LongRelSpd 0;
BA_ "GenSigSendType" SG_ 915 ADC_FroTrkTargt1LongRelSpd 1;
BA_ "GenSigStartValue" SG_ 915 ADC_FroTrkTargt1LongRelSpd 0;
BA_ "GenSigTimeoutValue" SG_ 915 ADC_FroTrkTargt1LongRelSpd 0;
BA_ "Remark" SG_ 915 ADC_FroTrkTargt1LongRelSpd "";
BA_ "EventCommandSignal" SG_ 915 ADC_FroTrkTargt1DetSensor 0;
BA_ "GatewayedSignals" SG_ 915 ADC_FroTrkTargt1DetSensor 0;
BA_ "GenSigInactiveValue" SG_ 915 ADC_FroTrkTargt1DetSensor 0;
BA_ "GenSigInvalidValue" SG_ 915 ADC_FroTrkTargt1DetSensor 0;
BA_ "GenSigSendType" SG_ 915 ADC_FroTrkTargt1DetSensor 1;
BA_ "GenSigStartValue" SG_ 915 ADC_FroTrkTargt1DetSensor 0;
BA_ "GenSigTimeoutValue" SG_ 915 ADC_FroTrkTargt1DetSensor 0;
BA_ "Remark" SG_ 915 ADC_FroTrkTargt1DetSensor "";
BA_ "EventCommandSignal" SG_ 915 ADC_FroTrkTargt2ObjClass 0;
BA_ "GatewayedSignals" SG_ 915 ADC_FroTrkTargt2ObjClass 0;
BA_ "GenSigInactiveValue" SG_ 915 ADC_FroTrkTargt2ObjClass 0;
BA_ "GenSigInvalidValue" SG_ 915 ADC_FroTrkTargt2ObjClass 0;
BA_ "GenSigSendType" SG_ 915 ADC_FroTrkTargt2ObjClass 1;
BA_ "GenSigStartValue" SG_ 915 ADC_FroTrkTargt2ObjClass 0;
BA_ "GenSigTimeoutValue" SG_ 915 ADC_FroTrkTargt2ObjClass 0;
BA_ "Remark" SG_ 915 ADC_FroTrkTargt2ObjClass "";
BA_ "EventCommandSignal" SG_ 915 ADC_FroTrkTargt2St 0;
BA_ "GatewayedSignals" SG_ 915 ADC_FroTrkTargt2St 0;
BA_ "GenSigInactiveValue" SG_ 915 ADC_FroTrkTargt2St 0;
BA_ "GenSigInvalidValue" SG_ 915 ADC_FroTrkTargt2St 0;
BA_ "GenSigSendType" SG_ 915 ADC_FroTrkTargt2St 1;
BA_ "GenSigStartValue" SG_ 915 ADC_FroTrkTargt2St 0;
BA_ "GenSigTimeoutValue" SG_ 915 ADC_FroTrkTargt2St 0;
BA_ "Remark" SG_ 915 ADC_FroTrkTargt2St "";
BA_ "EventCommandSignal" SG_ 915 ADC_FroTrkTargt2longPos 0;
BA_ "GatewayedSignals" SG_ 915 ADC_FroTrkTargt2longPos 0;
BA_ "GenSigInactiveValue" SG_ 915 ADC_FroTrkTargt2longPos 0;
BA_ "GenSigInvalidValue" SG_ 915 ADC_FroTrkTargt2longPos 1023;
BA_ "GenSigSendType" SG_ 915 ADC_FroTrkTargt2longPos 1;
BA_ "GenSigStartValue" SG_ 915 ADC_FroTrkTargt2longPos 0;
BA_ "GenSigTimeoutValue" SG_ 915 ADC_FroTrkTargt2longPos 0;
BA_ "Remark" SG_ 915 ADC_FroTrkTargt2longPos "";
BA_ "EventCommandSignal" SG_ 915 ADC_FroTrkTargt2latPos 0;
BA_ "GatewayedSignals" SG_ 915 ADC_FroTrkTargt2latPos 0;
BA_ "GenSigInactiveValue" SG_ 915 ADC_FroTrkTargt2latPos 0;
BA_ "GenSigInvalidValue" SG_ 915 ADC_FroTrkTargt2latPos 0;
BA_ "GenSigSendType" SG_ 915 ADC_FroTrkTargt2latPos 1;
BA_ "GenSigStartValue" SG_ 915 ADC_FroTrkTargt2latPos 512;
BA_ "GenSigTimeoutValue" SG_ 915 ADC_FroTrkTargt2latPos 0;
BA_ "Remark" SG_ 915 ADC_FroTrkTargt2latPos "";
BA_ "EventCommandSignal" SG_ 915 ADC_FroTrkTargt2LatRelSpd 0;
BA_ "GatewayedSignals" SG_ 915 ADC_FroTrkTargt2LatRelSpd 0;
BA_ "GenSigInactiveValue" SG_ 915 ADC_FroTrkTargt2LatRelSpd 0;
BA_ "GenSigInvalidValue" SG_ 915 ADC_FroTrkTargt2LatRelSpd 511;
BA_ "GenSigSendType" SG_ 915 ADC_FroTrkTargt2LatRelSpd 1;
BA_ "GenSigStartValue" SG_ 915 ADC_FroTrkTargt2LatRelSpd 0;
BA_ "GenSigTimeoutValue" SG_ 915 ADC_FroTrkTargt2LatRelSpd 0;
BA_ "Remark" SG_ 915 ADC_FroTrkTargt2LatRelSpd "";
BA_ "EventCommandSignal" SG_ 915 ADC_FroTrkTargt2LongRelSpd 0;
BA_ "GatewayedSignals" SG_ 915 ADC_FroTrkTargt2LongRelSpd 0;
BA_ "GenSigInactiveValue" SG_ 915 ADC_FroTrkTargt2LongRelSpd 0;
BA_ "GenSigInvalidValue" SG_ 915 ADC_FroTrkTargt2LongRelSpd 0;
BA_ "GenSigSendType" SG_ 915 ADC_FroTrkTargt2LongRelSpd 1;
BA_ "GenSigStartValue" SG_ 915 ADC_FroTrkTargt2LongRelSpd 0;
BA_ "GenSigTimeoutValue" SG_ 915 ADC_FroTrkTargt2LongRelSpd 0;
BA_ "Remark" SG_ 915 ADC_FroTrkTargt2LongRelSpd "";
BA_ "EventCommandSignal" SG_ 915 ADC_FroTrkTargt2DetSensor 0;
BA_ "GatewayedSignals" SG_ 915 ADC_FroTrkTargt2DetSensor 0;
BA_ "GenSigInactiveValue" SG_ 915 ADC_FroTrkTargt2DetSensor 0;
BA_ "GenSigInvalidValue" SG_ 915 ADC_FroTrkTargt2DetSensor 0;
BA_ "GenSigSendType" SG_ 915 ADC_FroTrkTargt2DetSensor 1;
BA_ "GenSigStartValue" SG_ 915 ADC_FroTrkTargt2DetSensor 0;
BA_ "GenSigTimeoutValue" SG_ 915 ADC_FroTrkTargt2DetSensor 0;
BA_ "Remark" SG_ 915 ADC_FroTrkTargt2DetSensor "";
BA_ "EventCommandSignal" SG_ 915 ADC_FroTrkTargt3ObjClass 0;
BA_ "GatewayedSignals" SG_ 915 ADC_FroTrkTargt3ObjClass 0;
BA_ "GenSigInactiveValue" SG_ 915 ADC_FroTrkTargt3ObjClass 0;
BA_ "GenSigInvalidValue" SG_ 915 ADC_FroTrkTargt3ObjClass 0;
BA_ "GenSigSendType" SG_ 915 ADC_FroTrkTargt3ObjClass 1;
BA_ "GenSigStartValue" SG_ 915 ADC_FroTrkTargt3ObjClass 0;
BA_ "GenSigTimeoutValue" SG_ 915 ADC_FroTrkTargt3ObjClass 0;
BA_ "Remark" SG_ 915 ADC_FroTrkTargt3ObjClass "";
BA_ "EventCommandSignal" SG_ 915 ADC_FroTrkTargt3St 0;
BA_ "GatewayedSignals" SG_ 915 ADC_FroTrkTargt3St 0;
BA_ "GenSigInactiveValue" SG_ 915 ADC_FroTrkTargt3St 0;
BA_ "GenSigInvalidValue" SG_ 915 ADC_FroTrkTargt3St 0;
BA_ "GenSigSendType" SG_ 915 ADC_FroTrkTargt3St 1;
BA_ "GenSigStartValue" SG_ 915 ADC_FroTrkTargt3St 0;
BA_ "GenSigTimeoutValue" SG_ 915 ADC_FroTrkTargt3St 0;
BA_ "Remark" SG_ 915 ADC_FroTrkTargt3St "";
BA_ "EventCommandSignal" SG_ 915 ADC_FroTrkTargt3longPos 0;
BA_ "GatewayedSignals" SG_ 915 ADC_FroTrkTargt3longPos 0;
BA_ "GenSigInactiveValue" SG_ 915 ADC_FroTrkTargt3longPos 0;
BA_ "GenSigInvalidValue" SG_ 915 ADC_FroTrkTargt3longPos 1023;
BA_ "GenSigSendType" SG_ 915 ADC_FroTrkTargt3longPos 1;
BA_ "GenSigStartValue" SG_ 915 ADC_FroTrkTargt3longPos 0;
BA_ "GenSigTimeoutValue" SG_ 915 ADC_FroTrkTargt3longPos 0;
BA_ "Remark" SG_ 915 ADC_FroTrkTargt3longPos "";
BA_ "EventCommandSignal" SG_ 915 ADC_FroTrkTargt3latPos 0;
BA_ "GatewayedSignals" SG_ 915 ADC_FroTrkTargt3latPos 0;
BA_ "GenSigInactiveValue" SG_ 915 ADC_FroTrkTargt3latPos 0;
BA_ "GenSigInvalidValue" SG_ 915 ADC_FroTrkTargt3latPos 0;
BA_ "GenSigSendType" SG_ 915 ADC_FroTrkTargt3latPos 1;
BA_ "GenSigStartValue" SG_ 915 ADC_FroTrkTargt3latPos 512;
BA_ "GenSigTimeoutValue" SG_ 915 ADC_FroTrkTargt3latPos 0;
BA_ "Remark" SG_ 915 ADC_FroTrkTargt3latPos "";
BA_ "EventCommandSignal" SG_ 915 ADC_FroTrkTargt3LatRelSpd 0;
BA_ "GatewayedSignals" SG_ 915 ADC_FroTrkTargt3LatRelSpd 0;
BA_ "GenSigInactiveValue" SG_ 915 ADC_FroTrkTargt3LatRelSpd 0;
BA_ "GenSigInvalidValue" SG_ 915 ADC_FroTrkTargt3LatRelSpd 511;
BA_ "GenSigSendType" SG_ 915 ADC_FroTrkTargt3LatRelSpd 1;
BA_ "GenSigStartValue" SG_ 915 ADC_FroTrkTargt3LatRelSpd 0;
BA_ "GenSigTimeoutValue" SG_ 915 ADC_FroTrkTargt3LatRelSpd 0;
BA_ "Remark" SG_ 915 ADC_FroTrkTargt3LatRelSpd "";
BA_ "EventCommandSignal" SG_ 915 ADC_FroTrkTargt3LongRelSpd 0;
BA_ "GatewayedSignals" SG_ 915 ADC_FroTrkTargt3LongRelSpd 0;
BA_ "GenSigInactiveValue" SG_ 915 ADC_FroTrkTargt3LongRelSpd 0;
BA_ "GenSigInvalidValue" SG_ 915 ADC_FroTrkTargt3LongRelSpd 0;
BA_ "GenSigSendType" SG_ 915 ADC_FroTrkTargt3LongRelSpd 1;
BA_ "GenSigStartValue" SG_ 915 ADC_FroTrkTargt3LongRelSpd 0;
BA_ "GenSigTimeoutValue" SG_ 915 ADC_FroTrkTargt3LongRelSpd 0;
BA_ "Remark" SG_ 915 ADC_FroTrkTargt3LongRelSpd "";
BA_ "EventCommandSignal" SG_ 915 ADC_FroTrkTargt3DetSensor 0;
BA_ "GatewayedSignals" SG_ 915 ADC_FroTrkTargt3DetSensor 0;
BA_ "GenSigInactiveValue" SG_ 915 ADC_FroTrkTargt3DetSensor 0;
BA_ "GenSigInvalidValue" SG_ 915 ADC_FroTrkTargt3DetSensor 0;
BA_ "GenSigSendType" SG_ 915 ADC_FroTrkTargt3DetSensor 1;
BA_ "GenSigStartValue" SG_ 915 ADC_FroTrkTargt3DetSensor 0;
BA_ "GenSigTimeoutValue" SG_ 915 ADC_FroTrkTargt3DetSensor 0;
BA_ "Remark" SG_ 915 ADC_FroTrkTargt3DetSensor "";
BA_ "EventCommandSignal" SG_ 915 ADC_ReaTrkTargt4ObjClass 0;
BA_ "GatewayedSignals" SG_ 915 ADC_ReaTrkTargt4ObjClass 0;
BA_ "GenSigInactiveValue" SG_ 915 ADC_ReaTrkTargt4ObjClass 0;
BA_ "GenSigInvalidValue" SG_ 915 ADC_ReaTrkTargt4ObjClass 0;
BA_ "GenSigSendType" SG_ 915 ADC_ReaTrkTargt4ObjClass 1;
BA_ "GenSigStartValue" SG_ 915 ADC_ReaTrkTargt4ObjClass 0;
BA_ "GenSigTimeoutValue" SG_ 915 ADC_ReaTrkTargt4ObjClass 0;
BA_ "Remark" SG_ 915 ADC_ReaTrkTargt4ObjClass "";
BA_ "EventCommandSignal" SG_ 915 ADC_ReaTrkTargt4St 0;
BA_ "GatewayedSignals" SG_ 915 ADC_ReaTrkTargt4St 0;
BA_ "GenSigInactiveValue" SG_ 915 ADC_ReaTrkTargt4St 0;
BA_ "GenSigInvalidValue" SG_ 915 ADC_ReaTrkTargt4St 0;
BA_ "GenSigSendType" SG_ 915 ADC_ReaTrkTargt4St 1;
BA_ "GenSigStartValue" SG_ 915 ADC_ReaTrkTargt4St 0;
BA_ "GenSigTimeoutValue" SG_ 915 ADC_ReaTrkTargt4St 0;
BA_ "Remark" SG_ 915 ADC_ReaTrkTargt4St "";
BA_ "EventCommandSignal" SG_ 915 ADC_ReaTrkTargt4longPos 0;
BA_ "GatewayedSignals" SG_ 915 ADC_ReaTrkTargt4longPos 0;
BA_ "GenSigInactiveValue" SG_ 915 ADC_ReaTrkTargt4longPos 0;
BA_ "GenSigInvalidValue" SG_ 915 ADC_ReaTrkTargt4longPos 511;
BA_ "GenSigSendType" SG_ 915 ADC_ReaTrkTargt4longPos 1;
BA_ "GenSigStartValue" SG_ 915 ADC_ReaTrkTargt4longPos 0;
BA_ "GenSigTimeoutValue" SG_ 915 ADC_ReaTrkTargt4longPos 0;
BA_ "Remark" SG_ 915 ADC_ReaTrkTargt4longPos "";
BA_ "EventCommandSignal" SG_ 915 ADC_ReaTrkTargt4latPos 0;
BA_ "GatewayedSignals" SG_ 915 ADC_ReaTrkTargt4latPos 0;
BA_ "GenSigInactiveValue" SG_ 915 ADC_ReaTrkTargt4latPos 0;
BA_ "GenSigInvalidValue" SG_ 915 ADC_ReaTrkTargt4latPos 0;
BA_ "GenSigSendType" SG_ 915 ADC_ReaTrkTargt4latPos 1;
BA_ "GenSigStartValue" SG_ 915 ADC_ReaTrkTargt4latPos 512;
BA_ "GenSigTimeoutValue" SG_ 915 ADC_ReaTrkTargt4latPos 0;
BA_ "Remark" SG_ 915 ADC_ReaTrkTargt4latPos "";
BA_ "EventCommandSignal" SG_ 915 ADC_ReaTrkTargt4LatRelSpd 0;
BA_ "GatewayedSignals" SG_ 915 ADC_ReaTrkTargt4LatRelSpd 0;
BA_ "GenSigInactiveValue" SG_ 915 ADC_ReaTrkTargt4LatRelSpd 0;
BA_ "GenSigInvalidValue" SG_ 915 ADC_ReaTrkTargt4LatRelSpd 511;
BA_ "GenSigSendType" SG_ 915 ADC_ReaTrkTargt4LatRelSpd 1;
BA_ "GenSigStartValue" SG_ 915 ADC_ReaTrkTargt4LatRelSpd 0;
BA_ "GenSigTimeoutValue" SG_ 915 ADC_ReaTrkTargt4LatRelSpd 0;
BA_ "Remark" SG_ 915 ADC_ReaTrkTargt4LatRelSpd "";
BA_ "EventCommandSignal" SG_ 915 ADC_ReaTrkTargt4LongRelSpd 0;
BA_ "GatewayedSignals" SG_ 915 ADC_ReaTrkTargt4LongRelSpd 0;
BA_ "GenSigInactiveValue" SG_ 915 ADC_ReaTrkTargt4LongRelSpd 0;
BA_ "GenSigInvalidValue" SG_ 915 ADC_ReaTrkTargt4LongRelSpd 0;
BA_ "GenSigSendType" SG_ 915 ADC_ReaTrkTargt4LongRelSpd 1;
BA_ "GenSigStartValue" SG_ 915 ADC_ReaTrkTargt4LongRelSpd 0;
BA_ "GenSigTimeoutValue" SG_ 915 ADC_ReaTrkTargt4LongRelSpd 0;
BA_ "Remark" SG_ 915 ADC_ReaTrkTargt4LongRelSpd "";
BA_ "EventCommandSignal" SG_ 915 ADC_ReaTrkTargt4DetSensor 0;
BA_ "GatewayedSignals" SG_ 915 ADC_ReaTrkTargt4DetSensor 0;
BA_ "GenSigInactiveValue" SG_ 915 ADC_ReaTrkTargt4DetSensor 0;
BA_ "GenSigInvalidValue" SG_ 915 ADC_ReaTrkTargt4DetSensor 0;
BA_ "GenSigSendType" SG_ 915 ADC_ReaTrkTargt4DetSensor 1;
BA_ "GenSigStartValue" SG_ 915 ADC_ReaTrkTargt4DetSensor 0;
BA_ "GenSigTimeoutValue" SG_ 915 ADC_ReaTrkTargt4DetSensor 0;
BA_ "Remark" SG_ 915 ADC_ReaTrkTargt4DetSensor "";
BA_ "EventCommandSignal" SG_ 915 ADC_ReaTrkTargt5ObjClass 0;
BA_ "GatewayedSignals" SG_ 915 ADC_ReaTrkTargt5ObjClass 0;
BA_ "GenSigInactiveValue" SG_ 915 ADC_ReaTrkTargt5ObjClass 0;
BA_ "GenSigInvalidValue" SG_ 915 ADC_ReaTrkTargt5ObjClass 0;
BA_ "GenSigSendType" SG_ 915 ADC_ReaTrkTargt5ObjClass 1;
BA_ "GenSigStartValue" SG_ 915 ADC_ReaTrkTargt5ObjClass 0;
BA_ "GenSigTimeoutValue" SG_ 915 ADC_ReaTrkTargt5ObjClass 0;
BA_ "Remark" SG_ 915 ADC_ReaTrkTargt5ObjClass "";
BA_ "EventCommandSignal" SG_ 915 ADC_ReaTrkTargt5St 0;
BA_ "GatewayedSignals" SG_ 915 ADC_ReaTrkTargt5St 0;
BA_ "GenSigInactiveValue" SG_ 915 ADC_ReaTrkTargt5St 0;
BA_ "GenSigInvalidValue" SG_ 915 ADC_ReaTrkTargt5St 0;
BA_ "GenSigSendType" SG_ 915 ADC_ReaTrkTargt5St 1;
BA_ "GenSigStartValue" SG_ 915 ADC_ReaTrkTargt5St 0;
BA_ "GenSigTimeoutValue" SG_ 915 ADC_ReaTrkTargt5St 0;
BA_ "Remark" SG_ 915 ADC_ReaTrkTargt5St "";
BA_ "EventCommandSignal" SG_ 915 ADC_ReaTrkTargt5longPos 0;
BA_ "GatewayedSignals" SG_ 915 ADC_ReaTrkTargt5longPos 0;
BA_ "GenSigInactiveValue" SG_ 915 ADC_ReaTrkTargt5longPos 0;
BA_ "GenSigInvalidValue" SG_ 915 ADC_ReaTrkTargt5longPos 511;
BA_ "GenSigSendType" SG_ 915 ADC_ReaTrkTargt5longPos 1;
BA_ "GenSigStartValue" SG_ 915 ADC_ReaTrkTargt5longPos 0;
BA_ "GenSigTimeoutValue" SG_ 915 ADC_ReaTrkTargt5longPos 0;
BA_ "Remark" SG_ 915 ADC_ReaTrkTargt5longPos "";
BA_ "EventCommandSignal" SG_ 915 ADC_ReaTrkTargt5latPos 0;
BA_ "GatewayedSignals" SG_ 915 ADC_ReaTrkTargt5latPos 0;
BA_ "GenSigInactiveValue" SG_ 915 ADC_ReaTrkTargt5latPos 0;
BA_ "GenSigInvalidValue" SG_ 915 ADC_ReaTrkTargt5latPos 0;
BA_ "GenSigSendType" SG_ 915 ADC_ReaTrkTargt5latPos 1;
BA_ "GenSigStartValue" SG_ 915 ADC_ReaTrkTargt5latPos 512;
BA_ "GenSigTimeoutValue" SG_ 915 ADC_ReaTrkTargt5latPos 0;
BA_ "Remark" SG_ 915 ADC_ReaTrkTargt5latPos "";
BA_ "EventCommandSignal" SG_ 915 ADC_ReaTrkTargt5LatRelSpd 0;
BA_ "GatewayedSignals" SG_ 915 ADC_ReaTrkTargt5LatRelSpd 0;
BA_ "GenSigInactiveValue" SG_ 915 ADC_ReaTrkTargt5LatRelSpd 0;
BA_ "GenSigInvalidValue" SG_ 915 ADC_ReaTrkTargt5LatRelSpd 511;
BA_ "GenSigSendType" SG_ 915 ADC_ReaTrkTargt5LatRelSpd 1;
BA_ "GenSigStartValue" SG_ 915 ADC_ReaTrkTargt5LatRelSpd 0;
BA_ "GenSigTimeoutValue" SG_ 915 ADC_ReaTrkTargt5LatRelSpd 0;
BA_ "Remark" SG_ 915 ADC_ReaTrkTargt5LatRelSpd "";
BA_ "EventCommandSignal" SG_ 915 ADC_ReaTrkTargt5LongRelSpd 0;
BA_ "GatewayedSignals" SG_ 915 ADC_ReaTrkTargt5LongRelSpd 0;
BA_ "GenSigInactiveValue" SG_ 915 ADC_ReaTrkTargt5LongRelSpd 0;
BA_ "GenSigInvalidValue" SG_ 915 ADC_ReaTrkTargt5LongRelSpd 0;
BA_ "GenSigSendType" SG_ 915 ADC_ReaTrkTargt5LongRelSpd 1;
BA_ "GenSigStartValue" SG_ 915 ADC_ReaTrkTargt5LongRelSpd 0;
BA_ "GenSigTimeoutValue" SG_ 915 ADC_ReaTrkTargt5LongRelSpd 0;
BA_ "Remark" SG_ 915 ADC_ReaTrkTargt5LongRelSpd "";
BA_ "EventCommandSignal" SG_ 915 ADC_ReaTrkTargt5DetSensor 0;
BA_ "GatewayedSignals" SG_ 915 ADC_ReaTrkTargt5DetSensor 0;
BA_ "GenSigInactiveValue" SG_ 915 ADC_ReaTrkTargt5DetSensor 0;
BA_ "GenSigInvalidValue" SG_ 915 ADC_ReaTrkTargt5DetSensor 0;
BA_ "GenSigSendType" SG_ 915 ADC_ReaTrkTargt5DetSensor 1;
BA_ "GenSigStartValue" SG_ 915 ADC_ReaTrkTargt5DetSensor 0;
BA_ "GenSigTimeoutValue" SG_ 915 ADC_ReaTrkTargt5DetSensor 0;
BA_ "Remark" SG_ 915 ADC_ReaTrkTargt5DetSensor "";
BA_ "EventCommandSignal" SG_ 915 ADC_ReaTrkTargt6ObjClass 0;
BA_ "GatewayedSignals" SG_ 915 ADC_ReaTrkTargt6ObjClass 0;
BA_ "GenSigInactiveValue" SG_ 915 ADC_ReaTrkTargt6ObjClass 0;
BA_ "GenSigInvalidValue" SG_ 915 ADC_ReaTrkTargt6ObjClass 0;
BA_ "GenSigSendType" SG_ 915 ADC_ReaTrkTargt6ObjClass 1;
BA_ "GenSigStartValue" SG_ 915 ADC_ReaTrkTargt6ObjClass 0;
BA_ "GenSigTimeoutValue" SG_ 915 ADC_ReaTrkTargt6ObjClass 0;
BA_ "Remark" SG_ 915 ADC_ReaTrkTargt6ObjClass "";
BA_ "EventCommandSignal" SG_ 915 ADC_ReaTrkTargt6St 0;
BA_ "GatewayedSignals" SG_ 915 ADC_ReaTrkTargt6St 0;
BA_ "GenSigInactiveValue" SG_ 915 ADC_ReaTrkTargt6St 0;
BA_ "GenSigInvalidValue" SG_ 915 ADC_ReaTrkTargt6St 0;
BA_ "GenSigSendType" SG_ 915 ADC_ReaTrkTargt6St 1;
BA_ "GenSigStartValue" SG_ 915 ADC_ReaTrkTargt6St 0;
BA_ "GenSigTimeoutValue" SG_ 915 ADC_ReaTrkTargt6St 0;
BA_ "Remark" SG_ 915 ADC_ReaTrkTargt6St "";
BA_ "EventCommandSignal" SG_ 915 ADC_ReaTrkTargt6longPos 0;
BA_ "GatewayedSignals" SG_ 915 ADC_ReaTrkTargt6longPos 0;
BA_ "GenSigInactiveValue" SG_ 915 ADC_ReaTrkTargt6longPos 0;
BA_ "GenSigInvalidValue" SG_ 915 ADC_ReaTrkTargt6longPos 511;
BA_ "GenSigSendType" SG_ 915 ADC_ReaTrkTargt6longPos 1;
BA_ "GenSigStartValue" SG_ 915 ADC_ReaTrkTargt6longPos 0;
BA_ "GenSigTimeoutValue" SG_ 915 ADC_ReaTrkTargt6longPos 0;
BA_ "Remark" SG_ 915 ADC_ReaTrkTargt6longPos "";
BA_ "EventCommandSignal" SG_ 915 ADC_ReaTrkTargt6latPos 0;
BA_ "GatewayedSignals" SG_ 915 ADC_ReaTrkTargt6latPos 0;
BA_ "GenSigInactiveValue" SG_ 915 ADC_ReaTrkTargt6latPos 0;
BA_ "GenSigInvalidValue" SG_ 915 ADC_ReaTrkTargt6latPos 0;
BA_ "GenSigSendType" SG_ 915 ADC_ReaTrkTargt6latPos 1;
BA_ "GenSigStartValue" SG_ 915 ADC_ReaTrkTargt6latPos 512;
BA_ "GenSigTimeoutValue" SG_ 915 ADC_ReaTrkTargt6latPos 0;
BA_ "Remark" SG_ 915 ADC_ReaTrkTargt6latPos "";
BA_ "EventCommandSignal" SG_ 915 ADC_ReaTrkTargt6LatRelSpd 0;
BA_ "GatewayedSignals" SG_ 915 ADC_ReaTrkTargt6LatRelSpd 0;
BA_ "GenSigInactiveValue" SG_ 915 ADC_ReaTrkTargt6LatRelSpd 0;
BA_ "GenSigInvalidValue" SG_ 915 ADC_ReaTrkTargt6LatRelSpd 511;
BA_ "GenSigSendType" SG_ 915 ADC_ReaTrkTargt6LatRelSpd 1;
BA_ "GenSigStartValue" SG_ 915 ADC_ReaTrkTargt6LatRelSpd 0;
BA_ "GenSigTimeoutValue" SG_ 915 ADC_ReaTrkTargt6LatRelSpd 0;
BA_ "Remark" SG_ 915 ADC_ReaTrkTargt6LatRelSpd "";
BA_ "EventCommandSignal" SG_ 915 ADC_ReaTrkTargt6LongRelSpd 0;
BA_ "GatewayedSignals" SG_ 915 ADC_ReaTrkTargt6LongRelSpd 0;
BA_ "GenSigInactiveValue" SG_ 915 ADC_ReaTrkTargt6LongRelSpd 0;
BA_ "GenSigInvalidValue" SG_ 915 ADC_ReaTrkTargt6LongRelSpd 0;
BA_ "GenSigSendType" SG_ 915 ADC_ReaTrkTargt6LongRelSpd 1;
BA_ "GenSigStartValue" SG_ 915 ADC_ReaTrkTargt6LongRelSpd 0;
BA_ "GenSigTimeoutValue" SG_ 915 ADC_ReaTrkTargt6LongRelSpd 0;
BA_ "Remark" SG_ 915 ADC_ReaTrkTargt6LongRelSpd "";
BA_ "EventCommandSignal" SG_ 915 ADC_ReaTrkTargt6DetSensor 0;
BA_ "GatewayedSignals" SG_ 915 ADC_ReaTrkTargt6DetSensor 0;
BA_ "GenSigInactiveValue" SG_ 915 ADC_ReaTrkTargt6DetSensor 0;
BA_ "GenSigInvalidValue" SG_ 915 ADC_ReaTrkTargt6DetSensor 0;
BA_ "GenSigSendType" SG_ 915 ADC_ReaTrkTargt6DetSensor 1;
BA_ "GenSigStartValue" SG_ 915 ADC_ReaTrkTargt6DetSensor 0;
BA_ "GenSigTimeoutValue" SG_ 915 ADC_ReaTrkTargt6DetSensor 0;
BA_ "Remark" SG_ 915 ADC_ReaTrkTargt6DetSensor "";
BA_ "EventCommandSignal" SG_ 915 ADC_RadarPowerDownReq 0;
BA_ "GatewayedSignals" SG_ 915 ADC_RadarPowerDownReq 0;
BA_ "GenSigInactiveValue" SG_ 915 ADC_RadarPowerDownReq 0;
BA_ "GenSigInvalidValue" SG_ 915 ADC_RadarPowerDownReq 0;
BA_ "GenSigSendType" SG_ 915 ADC_RadarPowerDownReq 1;
BA_ "GenSigStartValue" SG_ 915 ADC_RadarPowerDownReq 0;
BA_ "GenSigTimeoutValue" SG_ 915 ADC_RadarPowerDownReq 0;
BA_ "Remark" SG_ 915 ADC_RadarPowerDownReq "";
BA_ "EventCommandSignal" SG_ 915 ADC_RadarPowerDownReqVD 0;
BA_ "GatewayedSignals" SG_ 915 ADC_RadarPowerDownReqVD 0;
BA_ "GenSigInactiveValue" SG_ 915 ADC_RadarPowerDownReqVD 0;
BA_ "GenSigInvalidValue" SG_ 915 ADC_RadarPowerDownReqVD 0;
BA_ "GenSigSendType" SG_ 915 ADC_RadarPowerDownReqVD 1;
BA_ "GenSigStartValue" SG_ 915 ADC_RadarPowerDownReqVD 0;
BA_ "GenSigTimeoutValue" SG_ 915 ADC_RadarPowerDownReqVD 0;
BA_ "Remark" SG_ 915 ADC_RadarPowerDownReqVD "";
BA_ "EventCommandSignal" SG_ 915 ADC_UPSPowerDownReq 0;
BA_ "GatewayedSignals" SG_ 915 ADC_UPSPowerDownReq 0;
BA_ "GenSigInactiveValue" SG_ 915 ADC_UPSPowerDownReq 0;
BA_ "GenSigInvalidValue" SG_ 915 ADC_UPSPowerDownReq 0;
BA_ "GenSigSendType" SG_ 915 ADC_UPSPowerDownReq 1;
BA_ "GenSigStartValue" SG_ 915 ADC_UPSPowerDownReq 0;
BA_ "GenSigTimeoutValue" SG_ 915 ADC_UPSPowerDownReq 0;
BA_ "Remark" SG_ 915 ADC_UPSPowerDownReq "";
BA_ "EventCommandSignal" SG_ 915 ADC_UPSPowerDownReqVD 0;
BA_ "GatewayedSignals" SG_ 915 ADC_UPSPowerDownReqVD 0;
BA_ "GenSigInactiveValue" SG_ 915 ADC_UPSPowerDownReqVD 0;
BA_ "GenSigInvalidValue" SG_ 915 ADC_UPSPowerDownReqVD 0;
BA_ "GenSigSendType" SG_ 915 ADC_UPSPowerDownReqVD 1;
BA_ "GenSigStartValue" SG_ 915 ADC_UPSPowerDownReqVD 0;
BA_ "GenSigTimeoutValue" SG_ 915 ADC_UPSPowerDownReqVD 0;
BA_ "Remark" SG_ 915 ADC_UPSPowerDownReqVD "";
BA_ "EventCommandSignal" SG_ 915 ADC_LidarPowerDownReq 0;
BA_ "GatewayedSignals" SG_ 915 ADC_LidarPowerDownReq 0;
BA_ "GenSigInactiveValue" SG_ 915 ADC_LidarPowerDownReq 0;
BA_ "GenSigInvalidValue" SG_ 915 ADC_LidarPowerDownReq 0;
BA_ "GenSigSendType" SG_ 915 ADC_LidarPowerDownReq 1;
BA_ "GenSigStartValue" SG_ 915 ADC_LidarPowerDownReq 0;
BA_ "GenSigTimeoutValue" SG_ 915 ADC_LidarPowerDownReq 0;
BA_ "Remark" SG_ 915 ADC_LidarPowerDownReq "";
BA_ "EventCommandSignal" SG_ 915 ADC_LidarPowerDownReqVD 0;
BA_ "GatewayedSignals" SG_ 915 ADC_LidarPowerDownReqVD 0;
BA_ "GenSigInactiveValue" SG_ 915 ADC_LidarPowerDownReqVD 0;
BA_ "GenSigInvalidValue" SG_ 915 ADC_LidarPowerDownReqVD 0;
BA_ "GenSigSendType" SG_ 915 ADC_LidarPowerDownReqVD 1;
BA_ "GenSigStartValue" SG_ 915 ADC_LidarPowerDownReqVD 0;
BA_ "GenSigTimeoutValue" SG_ 915 ADC_LidarPowerDownReqVD 0;
BA_ "Remark" SG_ 915 ADC_LidarPowerDownReqVD "";
BA_ "EventCommandSignal" SG_ 915 ADC_IFCPowerDownReq 0;
BA_ "GatewayedSignals" SG_ 915 ADC_IFCPowerDownReq 0;
BA_ "GenSigInactiveValue" SG_ 915 ADC_IFCPowerDownReq 0;
BA_ "GenSigInvalidValue" SG_ 915 ADC_IFCPowerDownReq 0;
BA_ "GenSigSendType" SG_ 915 ADC_IFCPowerDownReq 1;
BA_ "GenSigStartValue" SG_ 915 ADC_IFCPowerDownReq 0;
BA_ "GenSigTimeoutValue" SG_ 915 ADC_IFCPowerDownReq 0;
BA_ "Remark" SG_ 915 ADC_IFCPowerDownReq "";
BA_ "EventCommandSignal" SG_ 915 ADC_IFCPowerDownReqVD 0;
BA_ "GatewayedSignals" SG_ 915 ADC_IFCPowerDownReqVD 0;
BA_ "GenSigInactiveValue" SG_ 915 ADC_IFCPowerDownReqVD 0;
BA_ "GenSigInvalidValue" SG_ 915 ADC_IFCPowerDownReqVD 0;
BA_ "GenSigSendType" SG_ 915 ADC_IFCPowerDownReqVD 1;
BA_ "GenSigStartValue" SG_ 915 ADC_IFCPowerDownReqVD 0;
BA_ "GenSigTimeoutValue" SG_ 915 ADC_IFCPowerDownReqVD 0;
BA_ "Remark" SG_ 915 ADC_IFCPowerDownReqVD "";
BA_ "EventCommandSignal" SG_ 915 ADC_LowPowerReqVD 0;
BA_ "GatewayedSignals" SG_ 915 ADC_LowPowerReqVD 0;
BA_ "GenSigInactiveValue" SG_ 915 ADC_LowPowerReqVD 0;
BA_ "GenSigInvalidValue" SG_ 915 ADC_LowPowerReqVD 0;
BA_ "GenSigSendType" SG_ 915 ADC_LowPowerReqVD 1;
BA_ "GenSigStartValue" SG_ 915 ADC_LowPowerReqVD 0;
BA_ "GenSigTimeoutValue" SG_ 915 ADC_LowPowerReqVD 0;
BA_ "Remark" SG_ 915 ADC_LowPowerReqVD "";
BA_ "EventCommandSignal" SG_ 915 ADC_LowPowerReq 0;
BA_ "GatewayedSignals" SG_ 915 ADC_LowPowerReq 0;
BA_ "GenSigInactiveValue" SG_ 915 ADC_LowPowerReq 0;
BA_ "GenSigInvalidValue" SG_ 915 ADC_LowPowerReq 0;
BA_ "GenSigSendType" SG_ 915 ADC_LowPowerReq 1;
BA_ "GenSigStartValue" SG_ 915 ADC_LowPowerReq 0;
BA_ "GenSigTimeoutValue" SG_ 915 ADC_LowPowerReq 0;
BA_ "Remark" SG_ 915 ADC_LowPowerReq "";
BA_ "EventCommandSignal" SG_ 915 Reserved1 0;
BA_ "GatewayedSignals" SG_ 915 Reserved1 0;
BA_ "GenSigInactiveValue" SG_ 915 Reserved1 0;
BA_ "GenSigInvalidValue" SG_ 915 Reserved1 0;
BA_ "GenSigSendType" SG_ 915 Reserved1 1;
BA_ "GenSigStartValue" SG_ 915 Reserved1 0;
BA_ "GenSigTimeoutValue" SG_ 915 Reserved1 0;
BA_ "Remark" SG_ 915 Reserved1 "";
BA_ "EventCommandSignal" SG_ 1188 ADC_DTC 1;
BA_ "GatewayedSignals" SG_ 1188 ADC_DTC 0;
BA_ "GenSigInactiveValue" SG_ 1188 ADC_DTC 0;
BA_ "GenSigInvalidValue" SG_ 1188 ADC_DTC 0;
BA_ "GenSigSendType" SG_ 1188 ADC_DTC 0;
BA_ "GenSigStartValue" SG_ 1188 ADC_DTC 0;
BA_ "GenSigTimeoutValue" SG_ 1188 ADC_DTC 0;
BA_ "Remark" SG_ 1188 ADC_DTC "";
BA_ "EventCommandSignal" SG_ 387 ADC_4_New_CRC 0;
BA_ "GatewayedSignals" SG_ 387 ADC_4_New_CRC 0;
BA_ "GenSigInactiveValue" SG_ 387 ADC_4_New_CRC 0;
BA_ "GenSigInvalidValue" SG_ 387 ADC_4_New_CRC 0;
BA_ "GenSigSendType" SG_ 387 ADC_4_New_CRC 1;
BA_ "GenSigStartValue" SG_ 387 ADC_4_New_CRC 0;
BA_ "GenSigTimeoutValue" SG_ 387 ADC_4_New_CRC 0;
BA_ "Remark" SG_ 387 ADC_4_New_CRC "";
BA_ "EventCommandSignal" SG_ 387 ADC_4_New_Counter 0;
BA_ "GatewayedSignals" SG_ 387 ADC_4_New_Counter 0;
BA_ "GenSigInactiveValue" SG_ 387 ADC_4_New_Counter 0;
BA_ "GenSigInvalidValue" SG_ 387 ADC_4_New_Counter 0;
BA_ "GenSigSendType" SG_ 387 ADC_4_New_Counter 1;
BA_ "GenSigStartValue" SG_ 387 ADC_4_New_Counter 0;
BA_ "GenSigTimeoutValue" SG_ 387 ADC_4_New_Counter 0;
BA_ "Remark" SG_ 387 ADC_4_New_Counter "";
BA_ "EventCommandSignal" SG_ 387 ADC_AngReqSt_A 0;
BA_ "GatewayedSignals" SG_ 387 ADC_AngReqSt_A 0;
BA_ "GenSigInactiveValue" SG_ 387 ADC_AngReqSt_A 0;
BA_ "GenSigInvalidValue" SG_ 387 ADC_AngReqSt_A 0;
BA_ "GenSigSendType" SG_ 387 ADC_AngReqSt_A 1;
BA_ "GenSigStartValue" SG_ 387 ADC_AngReqSt_A 0;
BA_ "GenSigTimeoutValue" SG_ 387 ADC_AngReqSt_A 0;
BA_ "Remark" SG_ 387 ADC_AngReqSt_A "";
BA_ "EventCommandSignal" SG_ 387 ADC_AngReqFunction 0;
BA_ "GatewayedSignals" SG_ 387 ADC_AngReqFunction 0;
BA_ "GenSigInactiveValue" SG_ 387 ADC_AngReqFunction 0;
BA_ "GenSigInvalidValue" SG_ 387 ADC_AngReqFunction 0;
BA_ "GenSigSendType" SG_ 387 ADC_AngReqFunction 1;
BA_ "GenSigStartValue" SG_ 387 ADC_AngReqFunction 0;
BA_ "GenSigTimeoutValue" SG_ 387 ADC_AngReqFunction 0;
BA_ "Remark" SG_ 387 ADC_AngReqFunction "";
BA_ "EventCommandSignal" SG_ 387 ADC_BrakeLightReq 0;
BA_ "GatewayedSignals" SG_ 387 ADC_BrakeLightReq 0;
BA_ "GenSigInactiveValue" SG_ 387 ADC_BrakeLightReq 0;
BA_ "GenSigInvalidValue" SG_ 387 ADC_BrakeLightReq 0;
BA_ "GenSigSendType" SG_ 387 ADC_BrakeLightReq 1;
BA_ "GenSigStartValue" SG_ 387 ADC_BrakeLightReq 0;
BA_ "GenSigTimeoutValue" SG_ 387 ADC_BrakeLightReq 0;
BA_ "Remark" SG_ 387 ADC_BrakeLightReq "";
BA_ "EventCommandSignal" SG_ 387 ADC_StrAngleReq_A 0;
BA_ "GatewayedSignals" SG_ 387 ADC_StrAngleReq_A 0;
BA_ "GenSigInactiveValue" SG_ 387 ADC_StrAngleReq_A 0;
BA_ "GenSigInvalidValue" SG_ 387 ADC_StrAngleReq_A 65535;
BA_ "GenSigSendType" SG_ 387 ADC_StrAngleReq_A 1;
BA_ "GenSigStartValue" SG_ 387 ADC_StrAngleReq_A 7800;
BA_ "GenSigTimeoutValue" SG_ 387 ADC_StrAngleReq_A 65535;
BA_ "Remark" SG_ 387 ADC_StrAngleReq_A "";
BA_ "EventCommandSignal" SG_ 387 ADC_SACMotorTorLimExtMax_A 0;
BA_ "GatewayedSignals" SG_ 387 ADC_SACMotorTorLimExtMax_A 0;
BA_ "GenSigInactiveValue" SG_ 387 ADC_SACMotorTorLimExtMax_A 0;
BA_ "GenSigInvalidValue" SG_ 387 ADC_SACMotorTorLimExtMax_A 255;
BA_ "GenSigSendType" SG_ 387 ADC_SACMotorTorLimExtMax_A 1;
BA_ "GenSigStartValue" SG_ 387 ADC_SACMotorTorLimExtMax_A 254;
BA_ "GenSigTimeoutValue" SG_ 387 ADC_SACMotorTorLimExtMax_A 255;
BA_ "Remark" SG_ 387 ADC_SACMotorTorLimExtMax_A "";
BA_ "EventCommandSignal" SG_ 387 ADC_SACMotorTorLimExtMin_A 0;
BA_ "GatewayedSignals" SG_ 387 ADC_SACMotorTorLimExtMin_A 0;
BA_ "GenSigInactiveValue" SG_ 387 ADC_SACMotorTorLimExtMin_A 0;
BA_ "GenSigInvalidValue" SG_ 387 ADC_SACMotorTorLimExtMin_A 0;
BA_ "GenSigSendType" SG_ 387 ADC_SACMotorTorLimExtMin_A 1;
BA_ "GenSigStartValue" SG_ 387 ADC_SACMotorTorLimExtMin_A 0;
BA_ "GenSigTimeoutValue" SG_ 387 ADC_SACMotorTorLimExtMin_A 255;
BA_ "Remark" SG_ 387 ADC_SACMotorTorLimExtMin_A "";
BA_ "EventCommandSignal" SG_ 387 ADC_AssistParaSwitchReq 0;
BA_ "GatewayedSignals" SG_ 387 ADC_AssistParaSwitchReq 0;
BA_ "GenSigInactiveValue" SG_ 387 ADC_AssistParaSwitchReq 0;
BA_ "GenSigInvalidValue" SG_ 387 ADC_AssistParaSwitchReq 0;
BA_ "GenSigSendType" SG_ 387 ADC_AssistParaSwitchReq 1;
BA_ "GenSigStartValue" SG_ 387 ADC_AssistParaSwitchReq 0;
BA_ "GenSigTimeoutValue" SG_ 387 ADC_AssistParaSwitchReq 0;
BA_ "Remark" SG_ 387 ADC_AssistParaSwitchReq "";
BA_ "EventCommandSignal" SG_ 387 ADC_SteerGainReq 0;
BA_ "GatewayedSignals" SG_ 387 ADC_SteerGainReq 0;
BA_ "GenSigInactiveValue" SG_ 387 ADC_SteerGainReq 0;
BA_ "GenSigInvalidValue" SG_ 387 ADC_SteerGainReq 0;
BA_ "GenSigSendType" SG_ 387 ADC_SteerGainReq 1;
BA_ "GenSigStartValue" SG_ 387 ADC_SteerGainReq 0;
BA_ "GenSigTimeoutValue" SG_ 387 ADC_SteerGainReq 0;
BA_ "Remark" SG_ 387 ADC_SteerGainReq "";
BA_ "EventCommandSignal" SG_ 387 ADC_StrgWhlVibrWarnLevel 0;
BA_ "GatewayedSignals" SG_ 387 ADC_StrgWhlVibrWarnLevel 0;
BA_ "GenSigInactiveValue" SG_ 387 ADC_StrgWhlVibrWarnLevel 0;
BA_ "GenSigInvalidValue" SG_ 387 ADC_StrgWhlVibrWarnLevel 0;
BA_ "GenSigSendType" SG_ 387 ADC_StrgWhlVibrWarnLevel 1;
BA_ "GenSigStartValue" SG_ 387 ADC_StrgWhlVibrWarnLevel 0;
BA_ "GenSigTimeoutValue" SG_ 387 ADC_StrgWhlVibrWarnLevel 0;
BA_ "Remark" SG_ 387 ADC_StrgWhlVibrWarnLevel "";
BA_ "EventCommandSignal" SG_ 387 ADC_ActTrqReqEnable 0;
BA_ "GatewayedSignals" SG_ 387 ADC_ActTrqReqEnable 0;
BA_ "GenSigInactiveValue" SG_ 387 ADC_ActTrqReqEnable 0;
BA_ "GenSigInvalidValue" SG_ 387 ADC_ActTrqReqEnable 0;
BA_ "GenSigSendType" SG_ 387 ADC_ActTrqReqEnable 1;
BA_ "GenSigStartValue" SG_ 387 ADC_ActTrqReqEnable 0;
BA_ "GenSigTimeoutValue" SG_ 387 ADC_ActTrqReqEnable 0;
BA_ "Remark" SG_ 387 ADC_ActTrqReqEnable "";
BA_ "EventCommandSignal" SG_ 387 ADC_SteerGainLevel 0;
BA_ "GatewayedSignals" SG_ 387 ADC_SteerGainLevel 0;
BA_ "GenSigInactiveValue" SG_ 387 ADC_SteerGainLevel 0;
BA_ "GenSigInvalidValue" SG_ 387 ADC_SteerGainLevel 0;
BA_ "GenSigSendType" SG_ 387 ADC_SteerGainLevel 1;
BA_ "GenSigStartValue" SG_ 387 ADC_SteerGainLevel 0;
BA_ "GenSigTimeoutValue" SG_ 387 ADC_SteerGainLevel 100;
BA_ "Remark" SG_ 387 ADC_SteerGainLevel "";
BA_ "EventCommandSignal" SG_ 387 ADC_EvsSteerReq 0;
BA_ "GatewayedSignals" SG_ 387 ADC_EvsSteerReq 0;
BA_ "GenSigInactiveValue" SG_ 387 ADC_EvsSteerReq 0;
BA_ "GenSigInvalidValue" SG_ 387 ADC_EvsSteerReq 0;
BA_ "GenSigSendType" SG_ 387 ADC_EvsSteerReq 1;
BA_ "GenSigStartValue" SG_ 387 ADC_EvsSteerReq 0;
BA_ "GenSigTimeoutValue" SG_ 387 ADC_EvsSteerReq 0;
BA_ "Remark" SG_ 387 ADC_EvsSteerReq "";
BA_ "EventCommandSignal" SG_ 387 ADC_StrgWhlVibrWarnReq 0;
BA_ "GatewayedSignals" SG_ 387 ADC_StrgWhlVibrWarnReq 0;
BA_ "GenSigInactiveValue" SG_ 387 ADC_StrgWhlVibrWarnReq 0;
BA_ "GenSigInvalidValue" SG_ 387 ADC_StrgWhlVibrWarnReq 0;
BA_ "GenSigSendType" SG_ 387 ADC_StrgWhlVibrWarnReq 1;
BA_ "GenSigStartValue" SG_ 387 ADC_StrgWhlVibrWarnReq 0;
BA_ "GenSigTimeoutValue" SG_ 387 ADC_StrgWhlVibrWarnReq 0;
BA_ "Remark" SG_ 387 ADC_StrgWhlVibrWarnReq "";
BA_ "EventCommandSignal" SG_ 387 ADC_ActTrqReq 0;
BA_ "GatewayedSignals" SG_ 387 ADC_ActTrqReq 0;
BA_ "GenSigInactiveValue" SG_ 387 ADC_ActTrqReq 0;
BA_ "GenSigInvalidValue" SG_ 387 ADC_ActTrqReq 0;
BA_ "GenSigSendType" SG_ 387 ADC_ActTrqReq 1;
BA_ "GenSigStartValue" SG_ 387 ADC_ActTrqReq 0;
BA_ "GenSigTimeoutValue" SG_ 387 ADC_ActTrqReq 0;
BA_ "Remark" SG_ 387 ADC_ActTrqReq "";
BA_ "EventCommandSignal" SG_ 387 ADC_DrvTarTqMod2EPB 0;
BA_ "GatewayedSignals" SG_ 387 ADC_DrvTarTqMod2EPB 0;
BA_ "GenSigInactiveValue" SG_ 387 ADC_DrvTarTqMod2EPB 0;
BA_ "GenSigInvalidValue" SG_ 387 ADC_DrvTarTqMod2EPB 0;
BA_ "GenSigSendType" SG_ 387 ADC_DrvTarTqMod2EPB 1;
BA_ "GenSigStartValue" SG_ 387 ADC_DrvTarTqMod2EPB 0;
BA_ "GenSigTimeoutValue" SG_ 387 ADC_DrvTarTqMod2EPB 0;
BA_ "Remark" SG_ 387 ADC_DrvTarTqMod2EPB "";
BA_ "EventCommandSignal" SG_ 387 ADC_LongCtrlTypReq 0;
BA_ "GatewayedSignals" SG_ 387 ADC_LongCtrlTypReq 0;
BA_ "GenSigInactiveValue" SG_ 387 ADC_LongCtrlTypReq 0;
BA_ "GenSigInvalidValue" SG_ 387 ADC_LongCtrlTypReq 0;
BA_ "GenSigSendType" SG_ 387 ADC_LongCtrlTypReq 1;
BA_ "GenSigStartValue" SG_ 387 ADC_LongCtrlTypReq 0;
BA_ "GenSigTimeoutValue" SG_ 387 ADC_LongCtrlTypReq 0;
BA_ "Remark" SG_ 387 ADC_LongCtrlTypReq "";
BA_ "EventCommandSignal" SG_ 387 ADC_AEBFaultSt 0;
BA_ "GatewayedSignals" SG_ 387 ADC_AEBFaultSt 0;
BA_ "GenSigInactiveValue" SG_ 387 ADC_AEBFaultSt 0;
BA_ "GenSigInvalidValue" SG_ 387 ADC_AEBFaultSt 0;
BA_ "GenSigSendType" SG_ 387 ADC_AEBFaultSt 1;
BA_ "GenSigStartValue" SG_ 387 ADC_AEBFaultSt 0;
BA_ "GenSigTimeoutValue" SG_ 387 ADC_AEBFaultSt 1;
BA_ "Remark" SG_ 387 ADC_AEBFaultSt "";
BA_ "EventCommandSignal" SG_ 387 ADC_AEBOffSt 0;
BA_ "GatewayedSignals" SG_ 387 ADC_AEBOffSt 0;
BA_ "GenSigInactiveValue" SG_ 387 ADC_AEBOffSt 0;
BA_ "GenSigInvalidValue" SG_ 387 ADC_AEBOffSt 0;
BA_ "GenSigSendType" SG_ 387 ADC_AEBOffSt 1;
BA_ "GenSigStartValue" SG_ 387 ADC_AEBOffSt 0;
BA_ "GenSigTimeoutValue" SG_ 387 ADC_AEBOffSt 1;
BA_ "Remark" SG_ 387 ADC_AEBOffSt "";
BA_ "EventCommandSignal" SG_ 387 ADC_AEBInterventionSt 0;
BA_ "GatewayedSignals" SG_ 387 ADC_AEBInterventionSt 0;
BA_ "GenSigInactiveValue" SG_ 387 ADC_AEBInterventionSt 0;
BA_ "GenSigInvalidValue" SG_ 387 ADC_AEBInterventionSt 0;
BA_ "GenSigSendType" SG_ 387 ADC_AEBInterventionSt 1;
BA_ "GenSigStartValue" SG_ 387 ADC_AEBInterventionSt 0;
BA_ "GenSigTimeoutValue" SG_ 387 ADC_AEBInterventionSt 0;
BA_ "Remark" SG_ 387 ADC_AEBInterventionSt "";
BA_ "EventCommandSignal" SG_ 387 ADC_AEBDecelCtrlReq 0;
BA_ "GatewayedSignals" SG_ 387 ADC_AEBDecelCtrlReq 0;
BA_ "GenSigInactiveValue" SG_ 387 ADC_AEBDecelCtrlReq 0;
BA_ "GenSigInvalidValue" SG_ 387 ADC_AEBDecelCtrlReq 0;
BA_ "GenSigSendType" SG_ 387 ADC_AEBDecelCtrlReq 1;
BA_ "GenSigStartValue" SG_ 387 ADC_AEBDecelCtrlReq 0;
BA_ "GenSigTimeoutValue" SG_ 387 ADC_AEBDecelCtrlReq 0;
BA_ "Remark" SG_ 387 ADC_AEBDecelCtrlReq "";
BA_ "EventCommandSignal" SG_ 387 ADC_AEBLVehHoldReq 0;
BA_ "GatewayedSignals" SG_ 387 ADC_AEBLVehHoldReq 0;
BA_ "GenSigInactiveValue" SG_ 387 ADC_AEBLVehHoldReq 0;
BA_ "GenSigInvalidValue" SG_ 387 ADC_AEBLVehHoldReq 0;
BA_ "GenSigSendType" SG_ 387 ADC_AEBLVehHoldReq 1;
BA_ "GenSigStartValue" SG_ 387 ADC_AEBLVehHoldReq 0;
BA_ "GenSigTimeoutValue" SG_ 387 ADC_AEBLVehHoldReq 0;
BA_ "Remark" SG_ 387 ADC_AEBLVehHoldReq "";
BA_ "EventCommandSignal" SG_ 387 ADC_ABAReq 0;
BA_ "GatewayedSignals" SG_ 387 ADC_ABAReq 0;
BA_ "GenSigInactiveValue" SG_ 387 ADC_ABAReq 0;
BA_ "GenSigInvalidValue" SG_ 387 ADC_ABAReq 0;
BA_ "GenSigSendType" SG_ 387 ADC_ABAReq 1;
BA_ "GenSigStartValue" SG_ 387 ADC_ABAReq 0;
BA_ "GenSigTimeoutValue" SG_ 387 ADC_ABAReq 0;
BA_ "Remark" SG_ 387 ADC_ABAReq "";
BA_ "EventCommandSignal" SG_ 387 ADC_ABALevel 0;
BA_ "GatewayedSignals" SG_ 387 ADC_ABALevel 0;
BA_ "GenSigInactiveValue" SG_ 387 ADC_ABALevel 0;
BA_ "GenSigInvalidValue" SG_ 387 ADC_ABALevel 0;
BA_ "GenSigSendType" SG_ 387 ADC_ABALevel 1;
BA_ "GenSigStartValue" SG_ 387 ADC_ABALevel 0;
BA_ "GenSigTimeoutValue" SG_ 387 ADC_ABALevel 0;
BA_ "Remark" SG_ 387 ADC_ABALevel "";
BA_ "EventCommandSignal" SG_ 387 ADC_AWBReq 0;
BA_ "GatewayedSignals" SG_ 387 ADC_AWBReq 0;
BA_ "GenSigInactiveValue" SG_ 387 ADC_AWBReq 0;
BA_ "GenSigInvalidValue" SG_ 387 ADC_AWBReq 0;
BA_ "GenSigSendType" SG_ 387 ADC_AWBReq 1;
BA_ "GenSigStartValue" SG_ 387 ADC_AWBReq 0;
BA_ "GenSigTimeoutValue" SG_ 387 ADC_AWBReq 0;
BA_ "Remark" SG_ 387 ADC_AWBReq "";
BA_ "EventCommandSignal" SG_ 387 ADC_ABPReq 0;
BA_ "GatewayedSignals" SG_ 387 ADC_ABPReq 0;
BA_ "GenSigInactiveValue" SG_ 387 ADC_ABPReq 0;
BA_ "GenSigInvalidValue" SG_ 387 ADC_ABPReq 0;
BA_ "GenSigSendType" SG_ 387 ADC_ABPReq 1;
BA_ "GenSigStartValue" SG_ 387 ADC_ABPReq 0;
BA_ "GenSigTimeoutValue" SG_ 387 ADC_ABPReq 0;
BA_ "Remark" SG_ 387 ADC_ABPReq "";
BA_ "EventCommandSignal" SG_ 387 ADC_AWBLevel 0;
BA_ "GatewayedSignals" SG_ 387 ADC_AWBLevel 0;
BA_ "GenSigInactiveValue" SG_ 387 ADC_AWBLevel 0;
BA_ "GenSigInvalidValue" SG_ 387 ADC_AWBLevel 0;
BA_ "GenSigSendType" SG_ 387 ADC_AWBLevel 1;
BA_ "GenSigStartValue" SG_ 387 ADC_AWBLevel 0;
BA_ "GenSigTimeoutValue" SG_ 387 ADC_AWBLevel 0;
BA_ "Remark" SG_ 387 ADC_AWBLevel "";
BA_ "EventCommandSignal" SG_ 387 ADC_AEBTarCalss 0;
BA_ "GatewayedSignals" SG_ 387 ADC_AEBTarCalss 0;
BA_ "GenSigInactiveValue" SG_ 387 ADC_AEBTarCalss 0;
BA_ "GenSigInvalidValue" SG_ 387 ADC_AEBTarCalss 0;
BA_ "GenSigSendType" SG_ 387 ADC_AEBTarCalss 1;
BA_ "GenSigStartValue" SG_ 387 ADC_AEBTarCalss 0;
BA_ "GenSigTimeoutValue" SG_ 387 ADC_AEBTarCalss 0;
BA_ "Remark" SG_ 387 ADC_AEBTarCalss "";
BA_ "EventCommandSignal" SG_ 387 ADC_AEBTarDetSensor 0;
BA_ "GatewayedSignals" SG_ 387 ADC_AEBTarDetSensor 0;
BA_ "GenSigInactiveValue" SG_ 387 ADC_AEBTarDetSensor 0;
BA_ "GenSigInvalidValue" SG_ 387 ADC_AEBTarDetSensor 0;
BA_ "GenSigSendType" SG_ 387 ADC_AEBTarDetSensor 1;
BA_ "GenSigStartValue" SG_ 387 ADC_AEBTarDetSensor 0;
BA_ "GenSigTimeoutValue" SG_ 387 ADC_AEBTarDetSensor 0;
BA_ "Remark" SG_ 387 ADC_AEBTarDetSensor "";
BA_ "EventCommandSignal" SG_ 387 ADC_TurnLightReq 0;
BA_ "GatewayedSignals" SG_ 387 ADC_TurnLightReq 0;
BA_ "GenSigInactiveValue" SG_ 387 ADC_TurnLightReq 0;
BA_ "GenSigInvalidValue" SG_ 387 ADC_TurnLightReq 0;
BA_ "GenSigSendType" SG_ 387 ADC_TurnLightReq 1;
BA_ "GenSigStartValue" SG_ 387 ADC_TurnLightReq 0;
BA_ "GenSigTimeoutValue" SG_ 387 ADC_TurnLightReq 0;
BA_ "Remark" SG_ 387 ADC_TurnLightReq "";
BA_ "EventCommandSignal" SG_ 387 ADC_PAA2EPBEpbReq 0;
BA_ "GatewayedSignals" SG_ 387 ADC_PAA2EPBEpbReq 0;
BA_ "GenSigInactiveValue" SG_ 387 ADC_PAA2EPBEpbReq 0;
BA_ "GenSigInvalidValue" SG_ 387 ADC_PAA2EPBEpbReq 0;
BA_ "GenSigSendType" SG_ 387 ADC_PAA2EPBEpbReq 1;
BA_ "GenSigStartValue" SG_ 387 ADC_PAA2EPBEpbReq 0;
BA_ "GenSigTimeoutValue" SG_ 387 ADC_PAA2EPBEpbReq 0;
BA_ "Remark" SG_ 387 ADC_PAA2EPBEpbReq "";
BA_ "EventCommandSignal" SG_ 387 ADC_PAA2EPBEpbReqSt 0;
BA_ "GatewayedSignals" SG_ 387 ADC_PAA2EPBEpbReqSt 0;
BA_ "GenSigInactiveValue" SG_ 387 ADC_PAA2EPBEpbReqSt 0;
BA_ "GenSigInvalidValue" SG_ 387 ADC_PAA2EPBEpbReqSt 0;
BA_ "GenSigSendType" SG_ 387 ADC_PAA2EPBEpbReqSt 1;
BA_ "GenSigStartValue" SG_ 387 ADC_PAA2EPBEpbReqSt 0;
BA_ "GenSigTimeoutValue" SG_ 387 ADC_PAA2EPBEpbReqSt 0;
BA_ "Remark" SG_ 387 ADC_PAA2EPBEpbReqSt "";
BA_ "EventCommandSignal" SG_ 387 ADC_AEBObjectTTC 0;
BA_ "GatewayedSignals" SG_ 387 ADC_AEBObjectTTC 0;
BA_ "GenSigInactiveValue" SG_ 387 ADC_AEBObjectTTC 0;
BA_ "GenSigInvalidValue" SG_ 387 ADC_AEBObjectTTC 0;
BA_ "GenSigSendType" SG_ 387 ADC_AEBObjectTTC 1;
BA_ "GenSigStartValue" SG_ 387 ADC_AEBObjectTTC 501;
BA_ "GenSigTimeoutValue" SG_ 387 ADC_AEBObjectTTC 510;
BA_ "Remark" SG_ 387 ADC_AEBObjectTTC "";
BA_ "EventCommandSignal" SG_ 387 ADC_AEBObjRelativeSpd 0;
BA_ "GatewayedSignals" SG_ 387 ADC_AEBObjRelativeSpd 0;
BA_ "GenSigInactiveValue" SG_ 387 ADC_AEBObjRelativeSpd 0;
BA_ "GenSigInvalidValue" SG_ 387 ADC_AEBObjRelativeSpd 0;
BA_ "GenSigSendType" SG_ 387 ADC_AEBObjRelativeSpd 1;
BA_ "GenSigStartValue" SG_ 387 ADC_AEBObjRelativeSpd 0;
BA_ "GenSigTimeoutValue" SG_ 387 ADC_AEBObjRelativeSpd 510;
BA_ "Remark" SG_ 387 ADC_AEBObjRelativeSpd "";
BA_ "EventCommandSignal" SG_ 387 ADC_PAAPwrModeReq 0;
BA_ "GatewayedSignals" SG_ 387 ADC_PAAPwrModeReq 0;
BA_ "GenSigInactiveValue" SG_ 387 ADC_PAAPwrModeReq 0;
BA_ "GenSigInvalidValue" SG_ 387 ADC_PAAPwrModeReq 0;
BA_ "GenSigSendType" SG_ 387 ADC_PAAPwrModeReq 1;
BA_ "GenSigStartValue" SG_ 387 ADC_PAAPwrModeReq 0;
BA_ "GenSigTimeoutValue" SG_ 387 ADC_PAAPwrModeReq 0;
BA_ "Remark" SG_ 387 ADC_PAAPwrModeReq "";
BA_ "EventCommandSignal" SG_ 387 ADC_PAAGrarLvlReq 0;
BA_ "GatewayedSignals" SG_ 387 ADC_PAAGrarLvlReq 0;
BA_ "GenSigInactiveValue" SG_ 387 ADC_PAAGrarLvlReq 0;
BA_ "GenSigInvalidValue" SG_ 387 ADC_PAAGrarLvlReq 0;
BA_ "GenSigSendType" SG_ 387 ADC_PAAGrarLvlReq 1;
BA_ "GenSigStartValue" SG_ 387 ADC_PAAGrarLvlReq 0;
BA_ "GenSigTimeoutValue" SG_ 387 ADC_PAAGrarLvlReq 0;
BA_ "Remark" SG_ 387 ADC_PAAGrarLvlReq "";
BA_ "EventCommandSignal" SG_ 387 ADC_PAAGrarLvlReqEnable 0;
BA_ "GatewayedSignals" SG_ 387 ADC_PAAGrarLvlReqEnable 0;
BA_ "GenSigInactiveValue" SG_ 387 ADC_PAAGrarLvlReqEnable 0;
BA_ "GenSigInvalidValue" SG_ 387 ADC_PAAGrarLvlReqEnable 0;
BA_ "GenSigSendType" SG_ 387 ADC_PAAGrarLvlReqEnable 1;
BA_ "GenSigStartValue" SG_ 387 ADC_PAAGrarLvlReqEnable 0;
BA_ "GenSigTimeoutValue" SG_ 387 ADC_PAAGrarLvlReqEnable 0;
BA_ "Remark" SG_ 387 ADC_PAAGrarLvlReqEnable "";
BA_ "EventCommandSignal" SG_ 387 ADC_ACCMode_C 0;
BA_ "GatewayedSignals" SG_ 387 ADC_ACCMode_C 0;
BA_ "GenSigInactiveValue" SG_ 387 ADC_ACCMode_C 0;
BA_ "GenSigInvalidValue" SG_ 387 ADC_ACCMode_C 0;
BA_ "GenSigSendType" SG_ 387 ADC_ACCMode_C 1;
BA_ "GenSigStartValue" SG_ 387 ADC_ACCMode_C 1;
BA_ "GenSigTimeoutValue" SG_ 387 ADC_ACCMode_C 0;
BA_ "Remark" SG_ 387 ADC_ACCMode_C "";
BA_ "EventCommandSignal" SG_ 387 ADC_ActTrqReqVD 0;
BA_ "GatewayedSignals" SG_ 387 ADC_ActTrqReqVD 0;
BA_ "GenSigInactiveValue" SG_ 387 ADC_ActTrqReqVD 0;
BA_ "GenSigInvalidValue" SG_ 387 ADC_ActTrqReqVD 0;
BA_ "GenSigSendType" SG_ 387 ADC_ActTrqReqVD 1;
BA_ "GenSigStartValue" SG_ 387 ADC_ActTrqReqVD 0;
BA_ "GenSigTimeoutValue" SG_ 387 ADC_ActTrqReqVD 0;
BA_ "Remark" SG_ 387 ADC_ActTrqReqVD "";
BA_ "EventCommandSignal" SG_ 387 ADC_BrkTarTqEna 0;
BA_ "GatewayedSignals" SG_ 387 ADC_BrkTarTqEna 0;
BA_ "GenSigInactiveValue" SG_ 387 ADC_BrkTarTqEna 0;
BA_ "GenSigInvalidValue" SG_ 387 ADC_BrkTarTqEna 0;
BA_ "GenSigSendType" SG_ 387 ADC_BrkTarTqEna 1;
BA_ "GenSigStartValue" SG_ 387 ADC_BrkTarTqEna 0;
BA_ "GenSigTimeoutValue" SG_ 387 ADC_BrkTarTqEna 0;
BA_ "Remark" SG_ 387 ADC_BrkTarTqEna "";
BA_ "EventCommandSignal" SG_ 387 ADC_BrkTarTqMod 0;
BA_ "GatewayedSignals" SG_ 387 ADC_BrkTarTqMod 0;
BA_ "GenSigInactiveValue" SG_ 387 ADC_BrkTarTqMod 0;
BA_ "GenSigInvalidValue" SG_ 387 ADC_BrkTarTqMod 0;
BA_ "GenSigSendType" SG_ 387 ADC_BrkTarTqMod 1;
BA_ "GenSigStartValue" SG_ 387 ADC_BrkTarTqMod 0;
BA_ "GenSigTimeoutValue" SG_ 387 ADC_BrkTarTqMod 0;
BA_ "Remark" SG_ 387 ADC_BrkTarTqMod "";
BA_ "EventCommandSignal" SG_ 387 ADC_AebBrkTarTq 0;
BA_ "GatewayedSignals" SG_ 387 ADC_AebBrkTarTq 0;
BA_ "GenSigInactiveValue" SG_ 387 ADC_AebBrkTarTq 0;
BA_ "GenSigInvalidValue" SG_ 387 ADC_AebBrkTarTq 0;
BA_ "GenSigSendType" SG_ 387 ADC_AebBrkTarTq 1;
BA_ "GenSigStartValue" SG_ 387 ADC_AebBrkTarTq 0;
BA_ "GenSigTimeoutValue" SG_ 387 ADC_AebBrkTarTq 0;
BA_ "Remark" SG_ 387 ADC_AebBrkTarTq "";
BA_ "EventCommandSignal" SG_ 387 ADC_EpbModReqVld 0;
BA_ "GatewayedSignals" SG_ 387 ADC_EpbModReqVld 0;
BA_ "GenSigInactiveValue" SG_ 387 ADC_EpbModReqVld 0;
BA_ "GenSigInvalidValue" SG_ 387 ADC_EpbModReqVld 0;
BA_ "GenSigSendType" SG_ 387 ADC_EpbModReqVld 1;
BA_ "GenSigStartValue" SG_ 387 ADC_EpbModReqVld 0;
BA_ "GenSigTimeoutValue" SG_ 387 ADC_EpbModReqVld 0;
BA_ "Remark" SG_ 387 ADC_EpbModReqVld "";
BA_ "EventCommandSignal" SG_ 387 ADC_RWUEna 0;
BA_ "GatewayedSignals" SG_ 387 ADC_RWUEna 0;
BA_ "GenSigInactiveValue" SG_ 387 ADC_RWUEna 0;
BA_ "GenSigInvalidValue" SG_ 387 ADC_RWUEna 0;
BA_ "GenSigSendType" SG_ 387 ADC_RWUEna 1;
BA_ "GenSigStartValue" SG_ 387 ADC_RWUEna 0;
BA_ "GenSigTimeoutValue" SG_ 387 ADC_RWUEna 0;
BA_ "Remark" SG_ 387 ADC_RWUEna "";
BA_ "EventCommandSignal" SG_ 387 ADC_BrkHoldReq 0;
BA_ "GatewayedSignals" SG_ 387 ADC_BrkHoldReq 0;
BA_ "GenSigInactiveValue" SG_ 387 ADC_BrkHoldReq 0;
BA_ "GenSigInvalidValue" SG_ 387 ADC_BrkHoldReq 0;
BA_ "GenSigSendType" SG_ 387 ADC_BrkHoldReq 1;
BA_ "GenSigStartValue" SG_ 387 ADC_BrkHoldReq 0;
BA_ "GenSigTimeoutValue" SG_ 387 ADC_BrkHoldReq 0;
BA_ "Remark" SG_ 387 ADC_BrkHoldReq "";
BA_ "EventCommandSignal" SG_ 387 ADC_AngReqAvl 0;
BA_ "GatewayedSignals" SG_ 387 ADC_AngReqAvl 0;
BA_ "GenSigInactiveValue" SG_ 387 ADC_AngReqAvl 0;
BA_ "GenSigInvalidValue" SG_ 387 ADC_AngReqAvl 0;
BA_ "GenSigSendType" SG_ 387 ADC_AngReqAvl 1;
BA_ "GenSigStartValue" SG_ 387 ADC_AngReqAvl 0;
BA_ "GenSigTimeoutValue" SG_ 387 ADC_AngReqAvl 0;
BA_ "Remark" SG_ 387 ADC_AngReqAvl "";
BA_ "EventCommandSignal" SG_ 387 ADC_TarGearReqVld 0;
BA_ "GatewayedSignals" SG_ 387 ADC_TarGearReqVld 0;
BA_ "GenSigInactiveValue" SG_ 387 ADC_TarGearReqVld 0;
BA_ "GenSigInvalidValue" SG_ 387 ADC_TarGearReqVld 0;
BA_ "GenSigSendType" SG_ 387 ADC_TarGearReqVld 1;
BA_ "GenSigStartValue" SG_ 387 ADC_TarGearReqVld 0;
BA_ "GenSigTimeoutValue" SG_ 387 ADC_TarGearReqVld 0;
BA_ "Remark" SG_ 387 ADC_TarGearReqVld "";
BA_ "EventCommandSignal" SG_ 387 ADC_FctSts 0;
BA_ "GatewayedSignals" SG_ 387 ADC_FctSts 0;
BA_ "GenSigInactiveValue" SG_ 387 ADC_FctSts 0;
BA_ "GenSigInvalidValue" SG_ 387 ADC_FctSts 0;
BA_ "GenSigSendType" SG_ 387 ADC_FctSts 1;
BA_ "GenSigStartValue" SG_ 387 ADC_FctSts 0;
BA_ "GenSigTimeoutValue" SG_ 387 ADC_FctSts 0;
BA_ "Remark" SG_ 387 ADC_FctSts "";
BA_ "EventCommandSignal" SG_ 387 ADC_BrkTarTqVld 0;
BA_ "GatewayedSignals" SG_ 387 ADC_BrkTarTqVld 0;
BA_ "GenSigInactiveValue" SG_ 387 ADC_BrkTarTqVld 0;
BA_ "GenSigInvalidValue" SG_ 387 ADC_BrkTarTqVld 0;
BA_ "GenSigSendType" SG_ 387 ADC_BrkTarTqVld 1;
BA_ "GenSigStartValue" SG_ 387 ADC_BrkTarTqVld 0;
BA_ "GenSigTimeoutValue" SG_ 387 ADC_BrkTarTqVld 0;
BA_ "Remark" SG_ 387 ADC_BrkTarTqVld "";
BA_ "EventCommandSignal" SG_ 387 ADC_AebBrkTarTqVld 0;
BA_ "GatewayedSignals" SG_ 387 ADC_AebBrkTarTqVld 0;
BA_ "GenSigInactiveValue" SG_ 387 ADC_AebBrkTarTqVld 0;
BA_ "GenSigInvalidValue" SG_ 387 ADC_AebBrkTarTqVld 0;
BA_ "GenSigSendType" SG_ 387 ADC_AebBrkTarTqVld 1;
BA_ "GenSigStartValue" SG_ 387 ADC_AebBrkTarTqVld 0;
BA_ "GenSigTimeoutValue" SG_ 387 ADC_AebBrkTarTqVld 0;
BA_ "Remark" SG_ 387 ADC_AebBrkTarTqVld "";
BA_ "EventCommandSignal" SG_ 387 ADC_AebBrkTarTqEna 0;
BA_ "GatewayedSignals" SG_ 387 ADC_AebBrkTarTqEna 0;
BA_ "GenSigInactiveValue" SG_ 387 ADC_AebBrkTarTqEna 0;
BA_ "GenSigInvalidValue" SG_ 387 ADC_AebBrkTarTqEna 0;
BA_ "GenSigSendType" SG_ 387 ADC_AebBrkTarTqEna 1;
BA_ "GenSigStartValue" SG_ 387 ADC_AebBrkTarTqEna 0;
BA_ "GenSigTimeoutValue" SG_ 387 ADC_AebBrkTarTqEna 0;
BA_ "Remark" SG_ 387 ADC_AebBrkTarTqEna "";
BA_ "EventCommandSignal" SG_ 387 ADC_ElecBrkFnSwitch 0;
BA_ "GatewayedSignals" SG_ 387 ADC_ElecBrkFnSwitch 0;
BA_ "GenSigInactiveValue" SG_ 387 ADC_ElecBrkFnSwitch 0;
BA_ "GenSigInvalidValue" SG_ 387 ADC_ElecBrkFnSwitch 0;
BA_ "GenSigSendType" SG_ 387 ADC_ElecBrkFnSwitch 1;
BA_ "GenSigStartValue" SG_ 387 ADC_ElecBrkFnSwitch 0;
BA_ "GenSigTimeoutValue" SG_ 387 ADC_ElecBrkFnSwitch 0;
BA_ "Remark" SG_ 387 ADC_ElecBrkFnSwitch "";
BA_ "EventCommandSignal" SG_ 387 ADC_RWUVld 0;
BA_ "GatewayedSignals" SG_ 387 ADC_RWUVld 0;
BA_ "GenSigInactiveValue" SG_ 387 ADC_RWUVld 0;
BA_ "GenSigInvalidValue" SG_ 387 ADC_RWUVld 0;
BA_ "GenSigSendType" SG_ 387 ADC_RWUVld 1;
BA_ "GenSigStartValue" SG_ 387 ADC_RWUVld 0;
BA_ "GenSigTimeoutValue" SG_ 387 ADC_RWUVld 0;
BA_ "Remark" SG_ 387 ADC_RWUVld "";
BA_ "EventCommandSignal" SG_ 387 ADC_DriverPresent 0;
BA_ "GatewayedSignals" SG_ 387 ADC_DriverPresent 0;
BA_ "GenSigInactiveValue" SG_ 387 ADC_DriverPresent 0;
BA_ "GenSigInvalidValue" SG_ 387 ADC_DriverPresent 0;
BA_ "GenSigSendType" SG_ 387 ADC_DriverPresent 1;
BA_ "GenSigStartValue" SG_ 387 ADC_DriverPresent 0;
BA_ "GenSigTimeoutValue" SG_ 387 ADC_DriverPresent 0;
BA_ "Remark" SG_ 387 ADC_DriverPresent "";
BA_ "EventCommandSignal" SG_ 387 ADC_AD_NetMode 0;
BA_ "GatewayedSignals" SG_ 387 ADC_AD_NetMode 0;
BA_ "GenSigInactiveValue" SG_ 387 ADC_AD_NetMode 0;
BA_ "GenSigInvalidValue" SG_ 387 ADC_AD_NetMode 0;
BA_ "GenSigSendType" SG_ 387 ADC_AD_NetMode 1;
BA_ "GenSigStartValue" SG_ 387 ADC_AD_NetMode 0;
BA_ "GenSigTimeoutValue" SG_ 387 ADC_AD_NetMode 0;
BA_ "Remark" SG_ 387 ADC_AD_NetMode "";
BA_ "EventCommandSignal" SG_ 387 ADC_ChrgPwrMode 0;
BA_ "GatewayedSignals" SG_ 387 ADC_ChrgPwrMode 0;
BA_ "GenSigInactiveValue" SG_ 387 ADC_ChrgPwrMode 0;
BA_ "GenSigInvalidValue" SG_ 387 ADC_ChrgPwrMode 0;
BA_ "GenSigSendType" SG_ 387 ADC_ChrgPwrMode 1;
BA_ "GenSigStartValue" SG_ 387 ADC_ChrgPwrMode 0;
BA_ "GenSigTimeoutValue" SG_ 387 ADC_ChrgPwrMode 0;
BA_ "Remark" SG_ 387 ADC_ChrgPwrMode "";
BA_ "EventCommandSignal" SG_ 387 ADC_LimTqEnable_A 0;
BA_ "GatewayedSignals" SG_ 387 ADC_LimTqEnable_A 0;
BA_ "GenSigInactiveValue" SG_ 387 ADC_LimTqEnable_A 0;
BA_ "GenSigInvalidValue" SG_ 387 ADC_LimTqEnable_A 0;
BA_ "GenSigSendType" SG_ 387 ADC_LimTqEnable_A 1;
BA_ "GenSigStartValue" SG_ 387 ADC_LimTqEnable_A 0;
BA_ "GenSigTimeoutValue" SG_ 387 ADC_LimTqEnable_A 0;
BA_ "Remark" SG_ 387 ADC_LimTqEnable_A "";
BA_ "EventCommandSignal" SG_ 387 ADC_LimTqFactorK_A 0;
BA_ "GatewayedSignals" SG_ 387 ADC_LimTqFactorK_A 0;
BA_ "GenSigInactiveValue" SG_ 387 ADC_LimTqFactorK_A 0;
BA_ "GenSigInvalidValue" SG_ 387 ADC_LimTqFactorK_A 0;
BA_ "GenSigSendType" SG_ 387 ADC_LimTqFactorK_A 1;
BA_ "GenSigStartValue" SG_ 387 ADC_LimTqFactorK_A 0;
BA_ "GenSigTimeoutValue" SG_ 387 ADC_LimTqFactorK_A 0;
BA_ "Remark" SG_ 387 ADC_LimTqFactorK_A "";
BA_ "EventCommandSignal" SG_ 387 ADC_RapidRespEna_A 0;
BA_ "GatewayedSignals" SG_ 387 ADC_RapidRespEna_A 0;
BA_ "GenSigInactiveValue" SG_ 387 ADC_RapidRespEna_A 0;
BA_ "GenSigInvalidValue" SG_ 387 ADC_RapidRespEna_A 0;
BA_ "GenSigSendType" SG_ 387 ADC_RapidRespEna_A 1;
BA_ "GenSigStartValue" SG_ 387 ADC_RapidRespEna_A 0;
BA_ "GenSigTimeoutValue" SG_ 387 ADC_RapidRespEna_A 0;
BA_ "Remark" SG_ 387 ADC_RapidRespEna_A "";
BA_ "EventCommandSignal" SG_ 387 ADC_DrvTarTqMod_A 0;
BA_ "GatewayedSignals" SG_ 387 ADC_DrvTarTqMod_A 0;
BA_ "GenSigInactiveValue" SG_ 387 ADC_DrvTarTqMod_A 0;
BA_ "GenSigInvalidValue" SG_ 387 ADC_DrvTarTqMod_A 0;
BA_ "GenSigSendType" SG_ 387 ADC_DrvTarTqMod_A 1;
BA_ "GenSigStartValue" SG_ 387 ADC_DrvTarTqMod_A 0;
BA_ "GenSigTimeoutValue" SG_ 387 ADC_DrvTarTqMod_A 0;
BA_ "Remark" SG_ 387 ADC_DrvTarTqMod_A "";
BA_ "EventCommandSignal" SG_ 387 ADC_FcsActiveStatus 0;
BA_ "GatewayedSignals" SG_ 387 ADC_FcsActiveStatus 0;
BA_ "GenSigInactiveValue" SG_ 387 ADC_FcsActiveStatus 0;
BA_ "GenSigInvalidValue" SG_ 387 ADC_FcsActiveStatus 0;
BA_ "GenSigSendType" SG_ 387 ADC_FcsActiveStatus 1;
BA_ "GenSigStartValue" SG_ 387 ADC_FcsActiveStatus 0;
BA_ "GenSigTimeoutValue" SG_ 387 ADC_FcsActiveStatus 0;
BA_ "Remark" SG_ 387 ADC_FcsActiveStatus "";
BA_ "EventCommandSignal" SG_ 387 ADC_DycEscTarTq_A 0;
BA_ "GatewayedSignals" SG_ 387 ADC_DycEscTarTq_A 0;
BA_ "GenSigInactiveValue" SG_ 387 ADC_DycEscTarTq_A 0;
BA_ "GenSigInvalidValue" SG_ 387 ADC_DycEscTarTq_A 0;
BA_ "GenSigSendType" SG_ 387 ADC_DycEscTarTq_A 1;
BA_ "GenSigStartValue" SG_ 387 ADC_DycEscTarTq_A 0;
BA_ "GenSigTimeoutValue" SG_ 387 ADC_DycEscTarTq_A 0;
BA_ "Remark" SG_ 387 ADC_DycEscTarTq_A "";
BA_ "EventCommandSignal" SG_ 387 ADC_DycEscTarTqfactor_A 0;
BA_ "GatewayedSignals" SG_ 387 ADC_DycEscTarTqfactor_A 0;
BA_ "GenSigInactiveValue" SG_ 387 ADC_DycEscTarTqfactor_A 0;
BA_ "GenSigInvalidValue" SG_ 387 ADC_DycEscTarTqfactor_A 0;
BA_ "GenSigSendType" SG_ 387 ADC_DycEscTarTqfactor_A 1;
BA_ "GenSigStartValue" SG_ 387 ADC_DycEscTarTqfactor_A 0;
BA_ "GenSigTimeoutValue" SG_ 387 ADC_DycEscTarTqfactor_A 0;
BA_ "Remark" SG_ 387 ADC_DycEscTarTqfactor_A "";
BA_ "EventCommandSignal" SG_ 387 ADC_DycEscTarTqVld_A 0;
BA_ "GatewayedSignals" SG_ 387 ADC_DycEscTarTqVld_A 0;
BA_ "GenSigInactiveValue" SG_ 387 ADC_DycEscTarTqVld_A 0;
BA_ "GenSigInvalidValue" SG_ 387 ADC_DycEscTarTqVld_A 0;
BA_ "GenSigSendType" SG_ 387 ADC_DycEscTarTqVld_A 1;
BA_ "GenSigStartValue" SG_ 387 ADC_DycEscTarTqVld_A 0;
BA_ "GenSigTimeoutValue" SG_ 387 ADC_DycEscTarTqVld_A 0;
BA_ "Remark" SG_ 387 ADC_DycEscTarTqVld_A "";
BA_ "EventCommandSignal" SG_ 387 ADC_DycEscTarTqEna_A 0;
BA_ "GatewayedSignals" SG_ 387 ADC_DycEscTarTqEna_A 0;
BA_ "GenSigInactiveValue" SG_ 387 ADC_DycEscTarTqEna_A 0;
BA_ "GenSigInvalidValue" SG_ 387 ADC_DycEscTarTqEna_A 0;
BA_ "GenSigSendType" SG_ 387 ADC_DycEscTarTqEna_A 1;
BA_ "GenSigStartValue" SG_ 387 ADC_DycEscTarTqEna_A 0;
BA_ "GenSigTimeoutValue" SG_ 387 ADC_DycEscTarTqEna_A 0;
BA_ "Remark" SG_ 387 ADC_DycEscTarTqEna_A "";
BA_ "EventCommandSignal" SG_ 387 ADC_RedundantSwt 0;
BA_ "GatewayedSignals" SG_ 387 ADC_RedundantSwt 0;
BA_ "GenSigInactiveValue" SG_ 387 ADC_RedundantSwt 0;
BA_ "GenSigInvalidValue" SG_ 387 ADC_RedundantSwt 0;
BA_ "GenSigSendType" SG_ 387 ADC_RedundantSwt 1;
BA_ "GenSigStartValue" SG_ 387 ADC_RedundantSwt 0;
BA_ "GenSigTimeoutValue" SG_ 387 ADC_RedundantSwt 0;
BA_ "Remark" SG_ 387 ADC_RedundantSwt "";
BA_ "EventCommandSignal" SG_ 387 ADC_ImmediateStopEna 0;
BA_ "GatewayedSignals" SG_ 387 ADC_ImmediateStopEna 0;
BA_ "GenSigInactiveValue" SG_ 387 ADC_ImmediateStopEna 0;
BA_ "GenSigInvalidValue" SG_ 387 ADC_ImmediateStopEna 0;
BA_ "GenSigSendType" SG_ 387 ADC_ImmediateStopEna 1;
BA_ "GenSigStartValue" SG_ 387 ADC_ImmediateStopEna 0;
BA_ "GenSigTimeoutValue" SG_ 387 ADC_ImmediateStopEna 0;
BA_ "Remark" SG_ 387 ADC_ImmediateStopEna "";
BA_ "EventCommandSignal" SG_ 387 ADC_VehSpd 0;
BA_ "GatewayedSignals" SG_ 387 ADC_VehSpd 0;
BA_ "GenSigInactiveValue" SG_ 387 ADC_VehSpd 0;
BA_ "GenSigInvalidValue" SG_ 387 ADC_VehSpd 0;
BA_ "GenSigSendType" SG_ 387 ADC_VehSpd 1;
BA_ "GenSigStartValue" SG_ 387 ADC_VehSpd 0;
BA_ "GenSigTimeoutValue" SG_ 387 ADC_VehSpd 0;
BA_ "Remark" SG_ 387 ADC_VehSpd "";
BA_ "EventCommandSignal" SG_ 387 ADC_VehSpdVD 0;
BA_ "GatewayedSignals" SG_ 387 ADC_VehSpdVD 0;
BA_ "GenSigInactiveValue" SG_ 387 ADC_VehSpdVD 0;
BA_ "GenSigInvalidValue" SG_ 387 ADC_VehSpdVD 0;
BA_ "GenSigSendType" SG_ 387 ADC_VehSpdVD 1;
BA_ "GenSigStartValue" SG_ 387 ADC_VehSpdVD 0;
BA_ "GenSigTimeoutValue" SG_ 387 ADC_VehSpdVD 0;
BA_ "Remark" SG_ 387 ADC_VehSpdVD "";
BA_ "EventCommandSignal" SG_ 387 ADC_BrkOffEnable 0;
BA_ "GatewayedSignals" SG_ 387 ADC_BrkOffEnable 0;
BA_ "GenSigInactiveValue" SG_ 387 ADC_BrkOffEnable 0;
BA_ "GenSigInvalidValue" SG_ 387 ADC_BrkOffEnable 0;
BA_ "GenSigSendType" SG_ 387 ADC_BrkOffEnable 1;
BA_ "GenSigStartValue" SG_ 387 ADC_BrkOffEnable 0;
BA_ "GenSigTimeoutValue" SG_ 387 ADC_BrkOffEnable 0;
BA_ "Remark" SG_ 387 ADC_BrkOffEnable "";
BA_ "EventCommandSignal" SG_ 387 ADC_SteerTqReq_A 0;
BA_ "GatewayedSignals" SG_ 387 ADC_SteerTqReq_A 0;
BA_ "GenSigInactiveValue" SG_ 387 ADC_SteerTqReq_A 0;
BA_ "GenSigInvalidValue" SG_ 387 ADC_SteerTqReq_A 4095;
BA_ "GenSigSendType" SG_ 387 ADC_SteerTqReq_A 1;
BA_ "GenSigStartValue" SG_ 387 ADC_SteerTqReq_A 2000;
BA_ "GenSigTimeoutValue" SG_ 387 ADC_SteerTqReq_A 4095;
BA_ "Remark" SG_ 387 ADC_SteerTqReq_A "";
BA_ "EventCommandSignal" SG_ 387 ADC_SteerTqSt_A 0;
BA_ "GatewayedSignals" SG_ 387 ADC_SteerTqSt_A 0;
BA_ "GenSigInactiveValue" SG_ 387 ADC_SteerTqSt_A 0;
BA_ "GenSigInvalidValue" SG_ 387 ADC_SteerTqSt_A 0;
BA_ "GenSigSendType" SG_ 387 ADC_SteerTqSt_A 1;
BA_ "GenSigStartValue" SG_ 387 ADC_SteerTqSt_A 0;
BA_ "GenSigTimeoutValue" SG_ 387 ADC_SteerTqSt_A 0;
BA_ "Remark" SG_ 387 ADC_SteerTqSt_A "";
BA_ "EventCommandSignal" SG_ 387 ADC_TqEvsSteerReq_A 0;
BA_ "GatewayedSignals" SG_ 387 ADC_TqEvsSteerReq_A 0;
BA_ "GenSigInactiveValue" SG_ 387 ADC_TqEvsSteerReq_A 0;
BA_ "GenSigInvalidValue" SG_ 387 ADC_TqEvsSteerReq_A 0;
BA_ "GenSigSendType" SG_ 387 ADC_TqEvsSteerReq_A 1;
BA_ "GenSigStartValue" SG_ 387 ADC_TqEvsSteerReq_A 0;
BA_ "GenSigTimeoutValue" SG_ 387 ADC_TqEvsSteerReq_A 0;
BA_ "Remark" SG_ 387 ADC_TqEvsSteerReq_A "";
BA_ "EventCommandSignal" SG_ 387 ADC_SteerTqAvl_A 0;
BA_ "GatewayedSignals" SG_ 387 ADC_SteerTqAvl_A 0;
BA_ "GenSigInactiveValue" SG_ 387 ADC_SteerTqAvl_A 0;
BA_ "GenSigInvalidValue" SG_ 387 ADC_SteerTqAvl_A 0;
BA_ "GenSigSendType" SG_ 387 ADC_SteerTqAvl_A 1;
BA_ "GenSigStartValue" SG_ 387 ADC_SteerTqAvl_A 0;
BA_ "GenSigTimeoutValue" SG_ 387 ADC_SteerTqAvl_A 0;
BA_ "Remark" SG_ 387 ADC_SteerTqAvl_A "";
BA_ "EventCommandSignal" SG_ 387 ADC_SteerGainLevelTqCtrl_A 0;
BA_ "GatewayedSignals" SG_ 387 ADC_SteerGainLevelTqCtrl_A 0;
BA_ "GenSigInactiveValue" SG_ 387 ADC_SteerGainLevelTqCtrl_A 0;
BA_ "GenSigInvalidValue" SG_ 387 ADC_SteerGainLevelTqCtrl_A 0;
BA_ "GenSigSendType" SG_ 387 ADC_SteerGainLevelTqCtrl_A 1;
BA_ "GenSigStartValue" SG_ 387 ADC_SteerGainLevelTqCtrl_A 0;
BA_ "GenSigTimeoutValue" SG_ 387 ADC_SteerGainLevelTqCtrl_A 100;
BA_ "Remark" SG_ 387 ADC_SteerGainLevelTqCtrl_A "";
BA_ "EventCommandSignal" SG_ 387 ADC_BrkTarTq 0;
BA_ "GatewayedSignals" SG_ 387 ADC_BrkTarTq 0;
BA_ "GenSigInactiveValue" SG_ 387 ADC_BrkTarTq 0;
BA_ "GenSigInvalidValue" SG_ 387 ADC_BrkTarTq 0;
BA_ "GenSigSendType" SG_ 387 ADC_BrkTarTq 1;
BA_ "GenSigStartValue" SG_ 387 ADC_BrkTarTq 0;
BA_ "GenSigTimeoutValue" SG_ 387 ADC_BrkTarTq 0;
BA_ "Remark" SG_ 387 ADC_BrkTarTq "";
BA_ "EventCommandSignal" SG_ 783 ADC_3_New_CRC 0;
BA_ "GatewayedSignals" SG_ 783 ADC_3_New_CRC 0;
BA_ "GenSigInactiveValue" SG_ 783 ADC_3_New_CRC 0;
BA_ "GenSigInvalidValue" SG_ 783 ADC_3_New_CRC 0;
BA_ "GenSigSendType" SG_ 783 ADC_3_New_CRC 1;
BA_ "GenSigStartValue" SG_ 783 ADC_3_New_CRC 0;
BA_ "GenSigTimeoutValue" SG_ 783 ADC_3_New_CRC 0;
BA_ "Remark" SG_ 783 ADC_3_New_CRC "";
BA_ "EventCommandSignal" SG_ 783 ADC_3_New_Counter 0;
BA_ "GatewayedSignals" SG_ 783 ADC_3_New_Counter 0;
BA_ "GenSigInactiveValue" SG_ 783 ADC_3_New_Counter 0;
BA_ "GenSigInvalidValue" SG_ 783 ADC_3_New_Counter 0;
BA_ "GenSigSendType" SG_ 783 ADC_3_New_Counter 1;
BA_ "GenSigStartValue" SG_ 783 ADC_3_New_Counter 0;
BA_ "GenSigTimeoutValue" SG_ 783 ADC_3_New_Counter 0;
BA_ "Remark" SG_ 783 ADC_3_New_Counter "";
BA_ "EventCommandSignal" SG_ 783 ADC_FroTrkTargt0ObjClass 0;
BA_ "GatewayedSignals" SG_ 783 ADC_FroTrkTargt0ObjClass 0;
BA_ "GenSigInactiveValue" SG_ 783 ADC_FroTrkTargt0ObjClass 0;
BA_ "GenSigInvalidValue" SG_ 783 ADC_FroTrkTargt0ObjClass 0;
BA_ "GenSigSendType" SG_ 783 ADC_FroTrkTargt0ObjClass 1;
BA_ "GenSigStartValue" SG_ 783 ADC_FroTrkTargt0ObjClass 0;
BA_ "GenSigTimeoutValue" SG_ 783 ADC_FroTrkTargt0ObjClass 0;
BA_ "Remark" SG_ 783 ADC_FroTrkTargt0ObjClass "";
BA_ "EventCommandSignal" SG_ 783 ADC_FroTrkTargt0St 0;
BA_ "GatewayedSignals" SG_ 783 ADC_FroTrkTargt0St 0;
BA_ "GenSigInactiveValue" SG_ 783 ADC_FroTrkTargt0St 0;
BA_ "GenSigInvalidValue" SG_ 783 ADC_FroTrkTargt0St 0;
BA_ "GenSigSendType" SG_ 783 ADC_FroTrkTargt0St 1;
BA_ "GenSigStartValue" SG_ 783 ADC_FroTrkTargt0St 0;
BA_ "GenSigTimeoutValue" SG_ 783 ADC_FroTrkTargt0St 0;
BA_ "Remark" SG_ 783 ADC_FroTrkTargt0St "";
BA_ "EventCommandSignal" SG_ 783 ADC_FroTrkTargt0longPos 0;
BA_ "GatewayedSignals" SG_ 783 ADC_FroTrkTargt0longPos 0;
BA_ "GenSigInactiveValue" SG_ 783 ADC_FroTrkTargt0longPos 0;
BA_ "GenSigInvalidValue" SG_ 783 ADC_FroTrkTargt0longPos 0;
BA_ "GenSigSendType" SG_ 783 ADC_FroTrkTargt0longPos 1;
BA_ "GenSigStartValue" SG_ 783 ADC_FroTrkTargt0longPos 0;
BA_ "GenSigTimeoutValue" SG_ 783 ADC_FroTrkTargt0longPos 0;
BA_ "Remark" SG_ 783 ADC_FroTrkTargt0longPos "";
BA_ "EventCommandSignal" SG_ 783 ADC_FroTrkTargt0latPos 0;
BA_ "GatewayedSignals" SG_ 783 ADC_FroTrkTargt0latPos 0;
BA_ "GenSigInactiveValue" SG_ 783 ADC_FroTrkTargt0latPos 0;
BA_ "GenSigInvalidValue" SG_ 783 ADC_FroTrkTargt0latPos 0;
BA_ "GenSigSendType" SG_ 783 ADC_FroTrkTargt0latPos 1;
BA_ "GenSigStartValue" SG_ 783 ADC_FroTrkTargt0latPos 512;
BA_ "GenSigTimeoutValue" SG_ 783 ADC_FroTrkTargt0latPos 0;
BA_ "Remark" SG_ 783 ADC_FroTrkTargt0latPos "";
BA_ "EventCommandSignal" SG_ 783 ADC_FroTrkTargt0LatRelSpd 0;
BA_ "GatewayedSignals" SG_ 783 ADC_FroTrkTargt0LatRelSpd 0;
BA_ "GenSigInactiveValue" SG_ 783 ADC_FroTrkTargt0LatRelSpd 0;
BA_ "GenSigInvalidValue" SG_ 783 ADC_FroTrkTargt0LatRelSpd 0;
BA_ "GenSigSendType" SG_ 783 ADC_FroTrkTargt0LatRelSpd 1;
BA_ "GenSigStartValue" SG_ 783 ADC_FroTrkTargt0LatRelSpd 0;
BA_ "GenSigTimeoutValue" SG_ 783 ADC_FroTrkTargt0LatRelSpd 0;
BA_ "Remark" SG_ 783 ADC_FroTrkTargt0LatRelSpd "";
BA_ "EventCommandSignal" SG_ 783 ADC_FroTrkTargt0LongRelSpd 0;
BA_ "GatewayedSignals" SG_ 783 ADC_FroTrkTargt0LongRelSpd 0;
BA_ "GenSigInactiveValue" SG_ 783 ADC_FroTrkTargt0LongRelSpd 0;
BA_ "GenSigInvalidValue" SG_ 783 ADC_FroTrkTargt0LongRelSpd 0;
BA_ "GenSigSendType" SG_ 783 ADC_FroTrkTargt0LongRelSpd 1;
BA_ "GenSigStartValue" SG_ 783 ADC_FroTrkTargt0LongRelSpd 0;
BA_ "GenSigTimeoutValue" SG_ 783 ADC_FroTrkTargt0LongRelSpd 0;
BA_ "Remark" SG_ 783 ADC_FroTrkTargt0LongRelSpd "";
BA_ "EventCommandSignal" SG_ 783 ADC_FroTrkTargt0DetSensor 0;
BA_ "GatewayedSignals" SG_ 783 ADC_FroTrkTargt0DetSensor 0;
BA_ "GenSigInactiveValue" SG_ 783 ADC_FroTrkTargt0DetSensor 0;
BA_ "GenSigInvalidValue" SG_ 783 ADC_FroTrkTargt0DetSensor 0;
BA_ "GenSigSendType" SG_ 783 ADC_FroTrkTargt0DetSensor 1;
BA_ "GenSigStartValue" SG_ 783 ADC_FroTrkTargt0DetSensor 0;
BA_ "GenSigTimeoutValue" SG_ 783 ADC_FroTrkTargt0DetSensor 0;
BA_ "Remark" SG_ 783 ADC_FroTrkTargt0DetSensor "";
BA_ "EventCommandSignal" SG_ 783 ADC_FroTrkTargt1ObjClass 0;
BA_ "GatewayedSignals" SG_ 783 ADC_FroTrkTargt1ObjClass 0;
BA_ "GenSigInactiveValue" SG_ 783 ADC_FroTrkTargt1ObjClass 0;
BA_ "GenSigInvalidValue" SG_ 783 ADC_FroTrkTargt1ObjClass 0;
BA_ "GenSigSendType" SG_ 783 ADC_FroTrkTargt1ObjClass 1;
BA_ "GenSigStartValue" SG_ 783 ADC_FroTrkTargt1ObjClass 0;
BA_ "GenSigTimeoutValue" SG_ 783 ADC_FroTrkTargt1ObjClass 0;
BA_ "Remark" SG_ 783 ADC_FroTrkTargt1ObjClass "";
BA_ "EventCommandSignal" SG_ 783 ADC_FroTrkTargt1St 0;
BA_ "GatewayedSignals" SG_ 783 ADC_FroTrkTargt1St 0;
BA_ "GenSigInactiveValue" SG_ 783 ADC_FroTrkTargt1St 0;
BA_ "GenSigInvalidValue" SG_ 783 ADC_FroTrkTargt1St 0;
BA_ "GenSigSendType" SG_ 783 ADC_FroTrkTargt1St 1;
BA_ "GenSigStartValue" SG_ 783 ADC_FroTrkTargt1St 0;
BA_ "GenSigTimeoutValue" SG_ 783 ADC_FroTrkTargt1St 0;
BA_ "Remark" SG_ 783 ADC_FroTrkTargt1St "";
BA_ "EventCommandSignal" SG_ 783 ADC_FroTrkTargt1longPos 0;
BA_ "GatewayedSignals" SG_ 783 ADC_FroTrkTargt1longPos 0;
BA_ "GenSigInactiveValue" SG_ 783 ADC_FroTrkTargt1longPos 0;
BA_ "GenSigInvalidValue" SG_ 783 ADC_FroTrkTargt1longPos 0;
BA_ "GenSigSendType" SG_ 783 ADC_FroTrkTargt1longPos 1;
BA_ "GenSigStartValue" SG_ 783 ADC_FroTrkTargt1longPos 0;
BA_ "GenSigTimeoutValue" SG_ 783 ADC_FroTrkTargt1longPos 0;
BA_ "Remark" SG_ 783 ADC_FroTrkTargt1longPos "";
BA_ "EventCommandSignal" SG_ 783 ADC_FroTrkTargt1latPos 0;
BA_ "GatewayedSignals" SG_ 783 ADC_FroTrkTargt1latPos 0;
BA_ "GenSigInactiveValue" SG_ 783 ADC_FroTrkTargt1latPos 0;
BA_ "GenSigInvalidValue" SG_ 783 ADC_FroTrkTargt1latPos 0;
BA_ "GenSigSendType" SG_ 783 ADC_FroTrkTargt1latPos 1;
BA_ "GenSigStartValue" SG_ 783 ADC_FroTrkTargt1latPos 512;
BA_ "GenSigTimeoutValue" SG_ 783 ADC_FroTrkTargt1latPos 0;
BA_ "Remark" SG_ 783 ADC_FroTrkTargt1latPos "";
BA_ "EventCommandSignal" SG_ 783 ADC_FroTrkTargt1LatRelSpd 0;
BA_ "GatewayedSignals" SG_ 783 ADC_FroTrkTargt1LatRelSpd 0;
BA_ "GenSigInactiveValue" SG_ 783 ADC_FroTrkTargt1LatRelSpd 0;
BA_ "GenSigInvalidValue" SG_ 783 ADC_FroTrkTargt1LatRelSpd 0;
BA_ "GenSigSendType" SG_ 783 ADC_FroTrkTargt1LatRelSpd 1;
BA_ "GenSigStartValue" SG_ 783 ADC_FroTrkTargt1LatRelSpd 0;
BA_ "GenSigTimeoutValue" SG_ 783 ADC_FroTrkTargt1LatRelSpd 0;
BA_ "Remark" SG_ 783 ADC_FroTrkTargt1LatRelSpd "";
BA_ "EventCommandSignal" SG_ 783 ADC_FroTrkTargt1LongRelSpd 0;
BA_ "GatewayedSignals" SG_ 783 ADC_FroTrkTargt1LongRelSpd 0;
BA_ "GenSigInactiveValue" SG_ 783 ADC_FroTrkTargt1LongRelSpd 0;
BA_ "GenSigInvalidValue" SG_ 783 ADC_FroTrkTargt1LongRelSpd 0;
BA_ "GenSigSendType" SG_ 783 ADC_FroTrkTargt1LongRelSpd 1;
BA_ "GenSigStartValue" SG_ 783 ADC_FroTrkTargt1LongRelSpd 0;
BA_ "GenSigTimeoutValue" SG_ 783 ADC_FroTrkTargt1LongRelSpd 0;
BA_ "Remark" SG_ 783 ADC_FroTrkTargt1LongRelSpd "";
BA_ "EventCommandSignal" SG_ 783 ADC_FroTrkTargt1DetSensor 0;
BA_ "GatewayedSignals" SG_ 783 ADC_FroTrkTargt1DetSensor 0;
BA_ "GenSigInactiveValue" SG_ 783 ADC_FroTrkTargt1DetSensor 0;
BA_ "GenSigInvalidValue" SG_ 783 ADC_FroTrkTargt1DetSensor 0;
BA_ "GenSigSendType" SG_ 783 ADC_FroTrkTargt1DetSensor 1;
BA_ "GenSigStartValue" SG_ 783 ADC_FroTrkTargt1DetSensor 0;
BA_ "GenSigTimeoutValue" SG_ 783 ADC_FroTrkTargt1DetSensor 0;
BA_ "Remark" SG_ 783 ADC_FroTrkTargt1DetSensor "";
BA_ "EventCommandSignal" SG_ 783 ADC_FroTrkTargt2ObjClass 0;
BA_ "GatewayedSignals" SG_ 783 ADC_FroTrkTargt2ObjClass 0;
BA_ "GenSigInactiveValue" SG_ 783 ADC_FroTrkTargt2ObjClass 0;
BA_ "GenSigInvalidValue" SG_ 783 ADC_FroTrkTargt2ObjClass 0;
BA_ "GenSigSendType" SG_ 783 ADC_FroTrkTargt2ObjClass 1;
BA_ "GenSigStartValue" SG_ 783 ADC_FroTrkTargt2ObjClass 0;
BA_ "GenSigTimeoutValue" SG_ 783 ADC_FroTrkTargt2ObjClass 0;
BA_ "Remark" SG_ 783 ADC_FroTrkTargt2ObjClass "";
BA_ "EventCommandSignal" SG_ 783 ADC_FroTrkTargt2St 0;
BA_ "GatewayedSignals" SG_ 783 ADC_FroTrkTargt2St 0;
BA_ "GenSigInactiveValue" SG_ 783 ADC_FroTrkTargt2St 0;
BA_ "GenSigInvalidValue" SG_ 783 ADC_FroTrkTargt2St 0;
BA_ "GenSigSendType" SG_ 783 ADC_FroTrkTargt2St 1;
BA_ "GenSigStartValue" SG_ 783 ADC_FroTrkTargt2St 0;
BA_ "GenSigTimeoutValue" SG_ 783 ADC_FroTrkTargt2St 0;
BA_ "Remark" SG_ 783 ADC_FroTrkTargt2St "";
BA_ "EventCommandSignal" SG_ 783 ADC_FroTrkTargt2longPos 0;
BA_ "GatewayedSignals" SG_ 783 ADC_FroTrkTargt2longPos 0;
BA_ "GenSigInactiveValue" SG_ 783 ADC_FroTrkTargt2longPos 0;
BA_ "GenSigInvalidValue" SG_ 783 ADC_FroTrkTargt2longPos 0;
BA_ "GenSigSendType" SG_ 783 ADC_FroTrkTargt2longPos 1;
BA_ "GenSigStartValue" SG_ 783 ADC_FroTrkTargt2longPos 0;
BA_ "GenSigTimeoutValue" SG_ 783 ADC_FroTrkTargt2longPos 0;
BA_ "Remark" SG_ 783 ADC_FroTrkTargt2longPos "";
BA_ "EventCommandSignal" SG_ 783 ADC_FroTrkTargt2latPos 0;
BA_ "GatewayedSignals" SG_ 783 ADC_FroTrkTargt2latPos 0;
BA_ "GenSigInactiveValue" SG_ 783 ADC_FroTrkTargt2latPos 0;
BA_ "GenSigInvalidValue" SG_ 783 ADC_FroTrkTargt2latPos 0;
BA_ "GenSigSendType" SG_ 783 ADC_FroTrkTargt2latPos 1;
BA_ "GenSigStartValue" SG_ 783 ADC_FroTrkTargt2latPos 512;
BA_ "GenSigTimeoutValue" SG_ 783 ADC_FroTrkTargt2latPos 0;
BA_ "Remark" SG_ 783 ADC_FroTrkTargt2latPos "";
BA_ "EventCommandSignal" SG_ 783 ADC_FroTrkTargt2LatRelSpd 0;
BA_ "GatewayedSignals" SG_ 783 ADC_FroTrkTargt2LatRelSpd 0;
BA_ "GenSigInactiveValue" SG_ 783 ADC_FroTrkTargt2LatRelSpd 0;
BA_ "GenSigInvalidValue" SG_ 783 ADC_FroTrkTargt2LatRelSpd 0;
BA_ "GenSigSendType" SG_ 783 ADC_FroTrkTargt2LatRelSpd 1;
BA_ "GenSigStartValue" SG_ 783 ADC_FroTrkTargt2LatRelSpd 0;
BA_ "GenSigTimeoutValue" SG_ 783 ADC_FroTrkTargt2LatRelSpd 0;
BA_ "Remark" SG_ 783 ADC_FroTrkTargt2LatRelSpd "";
BA_ "EventCommandSignal" SG_ 783 ADC_FroTrkTargt2LongRelSpd 0;
BA_ "GatewayedSignals" SG_ 783 ADC_FroTrkTargt2LongRelSpd 0;
BA_ "GenSigInactiveValue" SG_ 783 ADC_FroTrkTargt2LongRelSpd 0;
BA_ "GenSigInvalidValue" SG_ 783 ADC_FroTrkTargt2LongRelSpd 0;
BA_ "GenSigSendType" SG_ 783 ADC_FroTrkTargt2LongRelSpd 1;
BA_ "GenSigStartValue" SG_ 783 ADC_FroTrkTargt2LongRelSpd 0;
BA_ "GenSigTimeoutValue" SG_ 783 ADC_FroTrkTargt2LongRelSpd 0;
BA_ "Remark" SG_ 783 ADC_FroTrkTargt2LongRelSpd "";
BA_ "EventCommandSignal" SG_ 783 ADC_FroTrkTargt2DetSensor 0;
BA_ "GatewayedSignals" SG_ 783 ADC_FroTrkTargt2DetSensor 0;
BA_ "GenSigInactiveValue" SG_ 783 ADC_FroTrkTargt2DetSensor 0;
BA_ "GenSigInvalidValue" SG_ 783 ADC_FroTrkTargt2DetSensor 0;
BA_ "GenSigSendType" SG_ 783 ADC_FroTrkTargt2DetSensor 1;
BA_ "GenSigStartValue" SG_ 783 ADC_FroTrkTargt2DetSensor 0;
BA_ "GenSigTimeoutValue" SG_ 783 ADC_FroTrkTargt2DetSensor 0;
BA_ "Remark" SG_ 783 ADC_FroTrkTargt2DetSensor "";
BA_ "EventCommandSignal" SG_ 783 ADC_FroTrkTargt3ObjClass 0;
BA_ "GatewayedSignals" SG_ 783 ADC_FroTrkTargt3ObjClass 0;
BA_ "GenSigInactiveValue" SG_ 783 ADC_FroTrkTargt3ObjClass 0;
BA_ "GenSigInvalidValue" SG_ 783 ADC_FroTrkTargt3ObjClass 0;
BA_ "GenSigSendType" SG_ 783 ADC_FroTrkTargt3ObjClass 1;
BA_ "GenSigStartValue" SG_ 783 ADC_FroTrkTargt3ObjClass 0;
BA_ "GenSigTimeoutValue" SG_ 783 ADC_FroTrkTargt3ObjClass 0;
BA_ "Remark" SG_ 783 ADC_FroTrkTargt3ObjClass "";
BA_ "EventCommandSignal" SG_ 783 ADC_FroTrkTargt3St 0;
BA_ "GatewayedSignals" SG_ 783 ADC_FroTrkTargt3St 0;
BA_ "GenSigInactiveValue" SG_ 783 ADC_FroTrkTargt3St 0;
BA_ "GenSigInvalidValue" SG_ 783 ADC_FroTrkTargt3St 0;
BA_ "GenSigSendType" SG_ 783 ADC_FroTrkTargt3St 1;
BA_ "GenSigStartValue" SG_ 783 ADC_FroTrkTargt3St 0;
BA_ "GenSigTimeoutValue" SG_ 783 ADC_FroTrkTargt3St 0;
BA_ "Remark" SG_ 783 ADC_FroTrkTargt3St "";
BA_ "EventCommandSignal" SG_ 783 ADC_FroTrkTargt3longPos 0;
BA_ "GatewayedSignals" SG_ 783 ADC_FroTrkTargt3longPos 0;
BA_ "GenSigInactiveValue" SG_ 783 ADC_FroTrkTargt3longPos 0;
BA_ "GenSigInvalidValue" SG_ 783 ADC_FroTrkTargt3longPos 0;
BA_ "GenSigSendType" SG_ 783 ADC_FroTrkTargt3longPos 1;
BA_ "GenSigStartValue" SG_ 783 ADC_FroTrkTargt3longPos 0;
BA_ "GenSigTimeoutValue" SG_ 783 ADC_FroTrkTargt3longPos 0;
BA_ "Remark" SG_ 783 ADC_FroTrkTargt3longPos "";
BA_ "EventCommandSignal" SG_ 783 ADC_FroTrkTargt3latPos 0;
BA_ "GatewayedSignals" SG_ 783 ADC_FroTrkTargt3latPos 0;
BA_ "GenSigInactiveValue" SG_ 783 ADC_FroTrkTargt3latPos 0;
BA_ "GenSigInvalidValue" SG_ 783 ADC_FroTrkTargt3latPos 0;
BA_ "GenSigSendType" SG_ 783 ADC_FroTrkTargt3latPos 1;
BA_ "GenSigStartValue" SG_ 783 ADC_FroTrkTargt3latPos 512;
BA_ "GenSigTimeoutValue" SG_ 783 ADC_FroTrkTargt3latPos 0;
BA_ "Remark" SG_ 783 ADC_FroTrkTargt3latPos "";
BA_ "EventCommandSignal" SG_ 783 ADC_FroTrkTargt3LatRelSpd 0;
BA_ "GatewayedSignals" SG_ 783 ADC_FroTrkTargt3LatRelSpd 0;
BA_ "GenSigInactiveValue" SG_ 783 ADC_FroTrkTargt3LatRelSpd 0;
BA_ "GenSigInvalidValue" SG_ 783 ADC_FroTrkTargt3LatRelSpd 0;
BA_ "GenSigSendType" SG_ 783 ADC_FroTrkTargt3LatRelSpd 1;
BA_ "GenSigStartValue" SG_ 783 ADC_FroTrkTargt3LatRelSpd 0;
BA_ "GenSigTimeoutValue" SG_ 783 ADC_FroTrkTargt3LatRelSpd 0;
BA_ "Remark" SG_ 783 ADC_FroTrkTargt3LatRelSpd "";
BA_ "EventCommandSignal" SG_ 783 ADC_FroTrkTargt3LongRelSpd 0;
BA_ "GatewayedSignals" SG_ 783 ADC_FroTrkTargt3LongRelSpd 0;
BA_ "GenSigInactiveValue" SG_ 783 ADC_FroTrkTargt3LongRelSpd 0;
BA_ "GenSigInvalidValue" SG_ 783 ADC_FroTrkTargt3LongRelSpd 0;
BA_ "GenSigSendType" SG_ 783 ADC_FroTrkTargt3LongRelSpd 1;
BA_ "GenSigStartValue" SG_ 783 ADC_FroTrkTargt3LongRelSpd 0;
BA_ "GenSigTimeoutValue" SG_ 783 ADC_FroTrkTargt3LongRelSpd 0;
BA_ "Remark" SG_ 783 ADC_FroTrkTargt3LongRelSpd "";
BA_ "EventCommandSignal" SG_ 783 ADC_FroTrkTargt3DetSensor 0;
BA_ "GatewayedSignals" SG_ 783 ADC_FroTrkTargt3DetSensor 0;
BA_ "GenSigInactiveValue" SG_ 783 ADC_FroTrkTargt3DetSensor 0;
BA_ "GenSigInvalidValue" SG_ 783 ADC_FroTrkTargt3DetSensor 0;
BA_ "GenSigSendType" SG_ 783 ADC_FroTrkTargt3DetSensor 1;
BA_ "GenSigStartValue" SG_ 783 ADC_FroTrkTargt3DetSensor 0;
BA_ "GenSigTimeoutValue" SG_ 783 ADC_FroTrkTargt3DetSensor 0;
BA_ "Remark" SG_ 783 ADC_FroTrkTargt3DetSensor "";
BA_ "EventCommandSignal" SG_ 783 ADC_LLnMrking_A0 0;
BA_ "GatewayedSignals" SG_ 783 ADC_LLnMrking_A0 0;
BA_ "GenSigInactiveValue" SG_ 783 ADC_LLnMrking_A0 0;
BA_ "GenSigInvalidValue" SG_ 783 ADC_LLnMrking_A0 0;
BA_ "GenSigSendType" SG_ 783 ADC_LLnMrking_A0 1;
BA_ "GenSigStartValue" SG_ 783 ADC_LLnMrking_A0 1023;
BA_ "GenSigTimeoutValue" SG_ 783 ADC_LLnMrking_A0 0;
BA_ "Remark" SG_ 783 ADC_LLnMrking_A0 "";
BA_ "EventCommandSignal" SG_ 783 ADC_LLnMrking_A1 0;
BA_ "GatewayedSignals" SG_ 783 ADC_LLnMrking_A1 0;
BA_ "GenSigInactiveValue" SG_ 783 ADC_LLnMrking_A1 0;
BA_ "GenSigInvalidValue" SG_ 783 ADC_LLnMrking_A1 0;
BA_ "GenSigSendType" SG_ 783 ADC_LLnMrking_A1 1;
BA_ "GenSigStartValue" SG_ 783 ADC_LLnMrking_A1 1023;
BA_ "GenSigTimeoutValue" SG_ 783 ADC_LLnMrking_A1 0;
BA_ "Remark" SG_ 783 ADC_LLnMrking_A1 "";
BA_ "EventCommandSignal" SG_ 783 ADC_LLnMrking_A2 0;
BA_ "GatewayedSignals" SG_ 783 ADC_LLnMrking_A2 0;
BA_ "GenSigInactiveValue" SG_ 783 ADC_LLnMrking_A2 0;
BA_ "GenSigInvalidValue" SG_ 783 ADC_LLnMrking_A2 0;
BA_ "GenSigSendType" SG_ 783 ADC_LLnMrking_A2 1;
BA_ "GenSigStartValue" SG_ 783 ADC_LLnMrking_A2 1023;
BA_ "GenSigTimeoutValue" SG_ 783 ADC_LLnMrking_A2 0;
BA_ "Remark" SG_ 783 ADC_LLnMrking_A2 "";
BA_ "EventCommandSignal" SG_ 783 ADC_LLnMrking_conf 0;
BA_ "GatewayedSignals" SG_ 783 ADC_LLnMrking_conf 0;
BA_ "GenSigInactiveValue" SG_ 783 ADC_LLnMrking_conf 0;
BA_ "GenSigInvalidValue" SG_ 783 ADC_LLnMrking_conf 0;
BA_ "GenSigSendType" SG_ 783 ADC_LLnMrking_conf 1;
BA_ "GenSigStartValue" SG_ 783 ADC_LLnMrking_conf 0;
BA_ "GenSigTimeoutValue" SG_ 783 ADC_LLnMrking_conf 0;
BA_ "Remark" SG_ 783 ADC_LLnMrking_conf "";
BA_ "EventCommandSignal" SG_ 783 ADC_LlnMrkingDispSt 0;
BA_ "GatewayedSignals" SG_ 783 ADC_LlnMrkingDispSt 0;
BA_ "GenSigInactiveValue" SG_ 783 ADC_LlnMrkingDispSt 0;
BA_ "GenSigInvalidValue" SG_ 783 ADC_LlnMrkingDispSt 0;
BA_ "GenSigSendType" SG_ 783 ADC_LlnMrkingDispSt 1;
BA_ "GenSigStartValue" SG_ 783 ADC_LlnMrkingDispSt 0;
BA_ "GenSigTimeoutValue" SG_ 783 ADC_LlnMrkingDispSt 0;
BA_ "Remark" SG_ 783 ADC_LlnMrkingDispSt "";
BA_ "EventCommandSignal" SG_ 783 ADC_LLnMrking_Range 0;
BA_ "GatewayedSignals" SG_ 783 ADC_LLnMrking_Range 0;
BA_ "GenSigInactiveValue" SG_ 783 ADC_LLnMrking_Range 0;
BA_ "GenSigInvalidValue" SG_ 783 ADC_LLnMrking_Range 0;
BA_ "GenSigSendType" SG_ 783 ADC_LLnMrking_Range 1;
BA_ "GenSigStartValue" SG_ 783 ADC_LLnMrking_Range 0;
BA_ "GenSigTimeoutValue" SG_ 783 ADC_LLnMrking_Range 0;
BA_ "Remark" SG_ 783 ADC_LLnMrking_Range "";
BA_ "EventCommandSignal" SG_ 783 ADC_LLnMrking_Type 0;
BA_ "GatewayedSignals" SG_ 783 ADC_LLnMrking_Type 0;
BA_ "GenSigInactiveValue" SG_ 783 ADC_LLnMrking_Type 0;
BA_ "GenSigInvalidValue" SG_ 783 ADC_LLnMrking_Type 0;
BA_ "GenSigSendType" SG_ 783 ADC_LLnMrking_Type 1;
BA_ "GenSigStartValue" SG_ 783 ADC_LLnMrking_Type 0;
BA_ "GenSigTimeoutValue" SG_ 783 ADC_LLnMrking_Type 0;
BA_ "Remark" SG_ 783 ADC_LLnMrking_Type "";
BA_ "EventCommandSignal" SG_ 783 ADC_RLnMrking_A0 0;
BA_ "GatewayedSignals" SG_ 783 ADC_RLnMrking_A0 0;
BA_ "GenSigInactiveValue" SG_ 783 ADC_RLnMrking_A0 0;
BA_ "GenSigInvalidValue" SG_ 783 ADC_RLnMrking_A0 0;
BA_ "GenSigSendType" SG_ 783 ADC_RLnMrking_A0 1;
BA_ "GenSigStartValue" SG_ 783 ADC_RLnMrking_A0 1023;
BA_ "GenSigTimeoutValue" SG_ 783 ADC_RLnMrking_A0 0;
BA_ "Remark" SG_ 783 ADC_RLnMrking_A0 "";
BA_ "EventCommandSignal" SG_ 783 ADC_RLnMrking_A1 0;
BA_ "GatewayedSignals" SG_ 783 ADC_RLnMrking_A1 0;
BA_ "GenSigInactiveValue" SG_ 783 ADC_RLnMrking_A1 0;
BA_ "GenSigInvalidValue" SG_ 783 ADC_RLnMrking_A1 0;
BA_ "GenSigSendType" SG_ 783 ADC_RLnMrking_A1 1;
BA_ "GenSigStartValue" SG_ 783 ADC_RLnMrking_A1 1023;
BA_ "GenSigTimeoutValue" SG_ 783 ADC_RLnMrking_A1 0;
BA_ "Remark" SG_ 783 ADC_RLnMrking_A1 "";
BA_ "EventCommandSignal" SG_ 783 ADC_RLnMrking_A2 0;
BA_ "GatewayedSignals" SG_ 783 ADC_RLnMrking_A2 0;
BA_ "GenSigInactiveValue" SG_ 783 ADC_RLnMrking_A2 0;
BA_ "GenSigInvalidValue" SG_ 783 ADC_RLnMrking_A2 0;
BA_ "GenSigSendType" SG_ 783 ADC_RLnMrking_A2 1;
BA_ "GenSigStartValue" SG_ 783 ADC_RLnMrking_A2 1023;
BA_ "GenSigTimeoutValue" SG_ 783 ADC_RLnMrking_A2 0;
BA_ "Remark" SG_ 783 ADC_RLnMrking_A2 "";
BA_ "EventCommandSignal" SG_ 783 ADC_RlnMrkingDispSt 0;
BA_ "GatewayedSignals" SG_ 783 ADC_RlnMrkingDispSt 0;
BA_ "GenSigInactiveValue" SG_ 783 ADC_RlnMrkingDispSt 0;
BA_ "GenSigInvalidValue" SG_ 783 ADC_RlnMrkingDispSt 0;
BA_ "GenSigSendType" SG_ 783 ADC_RlnMrkingDispSt 1;
BA_ "GenSigStartValue" SG_ 783 ADC_RlnMrkingDispSt 0;
BA_ "GenSigTimeoutValue" SG_ 783 ADC_RlnMrkingDispSt 0;
BA_ "Remark" SG_ 783 ADC_RlnMrkingDispSt "";
BA_ "EventCommandSignal" SG_ 783 ADC_RLnMrking_conf 0;
BA_ "GatewayedSignals" SG_ 783 ADC_RLnMrking_conf 0;
BA_ "GenSigInactiveValue" SG_ 783 ADC_RLnMrking_conf 0;
BA_ "GenSigInvalidValue" SG_ 783 ADC_RLnMrking_conf 0;
BA_ "GenSigSendType" SG_ 783 ADC_RLnMrking_conf 1;
BA_ "GenSigStartValue" SG_ 783 ADC_RLnMrking_conf 0;
BA_ "GenSigTimeoutValue" SG_ 783 ADC_RLnMrking_conf 0;
BA_ "Remark" SG_ 783 ADC_RLnMrking_conf "";
BA_ "EventCommandSignal" SG_ 783 ADC_RLnMrking_Range 0;
BA_ "GatewayedSignals" SG_ 783 ADC_RLnMrking_Range 0;
BA_ "GenSigInactiveValue" SG_ 783 ADC_RLnMrking_Range 0;
BA_ "GenSigInvalidValue" SG_ 783 ADC_RLnMrking_Range 0;
BA_ "GenSigSendType" SG_ 783 ADC_RLnMrking_Range 1;
BA_ "GenSigStartValue" SG_ 783 ADC_RLnMrking_Range 0;
BA_ "GenSigTimeoutValue" SG_ 783 ADC_RLnMrking_Range 0;
BA_ "Remark" SG_ 783 ADC_RLnMrking_Range "";
BA_ "EventCommandSignal" SG_ 783 ADC_RLnMrking_Type 0;
BA_ "GatewayedSignals" SG_ 783 ADC_RLnMrking_Type 0;
BA_ "GenSigInactiveValue" SG_ 783 ADC_RLnMrking_Type 0;
BA_ "GenSigInvalidValue" SG_ 783 ADC_RLnMrking_Type 0;
BA_ "GenSigSendType" SG_ 783 ADC_RLnMrking_Type 1;
BA_ "GenSigStartValue" SG_ 783 ADC_RLnMrking_Type 0;
BA_ "GenSigTimeoutValue" SG_ 783 ADC_RLnMrking_Type 0;
BA_ "Remark" SG_ 783 ADC_RLnMrking_Type "";
BA_ "EventCommandSignal" SG_ 783 Reserved1 0;
BA_ "GatewayedSignals" SG_ 783 Reserved1 0;
BA_ "GenSigInactiveValue" SG_ 783 Reserved1 0;
BA_ "GenSigInvalidValue" SG_ 783 Reserved1 0;
BA_ "GenSigSendType" SG_ 783 Reserved1 1;
BA_ "GenSigStartValue" SG_ 783 Reserved1 0;
BA_ "GenSigTimeoutValue" SG_ 783 Reserved1 0;
BA_ "Remark" SG_ 783 Reserved1 "";
VAL_ 915 ADC_FroTrkTargt0ObjClass 0 "Underdetemined" 1 "Car" 2 "motorcycle" 3 "truck" 4 "pedestrian" 5 "Pole(TBD)" 6 "tree(TBD)" 7 "animal(TBD)" 8 "General on-borad object(TBD)" 9 "bicycle" 10 "unidentified vehicle(TBD)" 11 "Reserved" 12 "Reserved" 13 "Reserved" 14 "Reserved" 15 "Reserved"  ;
VAL_ 915 ADC_FroTrkTargt0St 0 "not dectected" 1 "dectected"  ;
VAL_ 915 ADC_FroTrkTargt0DetSensor 0 "Invalid" 1 "Radar only" 2 "Vision only" 3 "Radar+Vision" 4 "Lidar only" 5 "Lidar+Radar" 6 "Lidar+Vision" 7 "Lidar+Radar+Vision" 8 "Reserve" 9 "Reserve" 10 "Reserve" 11 "Reserve" 12 "Reserve" 13 "Reserve" 14 "Reserve" 15 "Reserve"  ;
VAL_ 915 ADC_FroTrkTargt1ObjClass 0 "Underdetemined" 1 "Car" 2 "motorcycle" 3 "truck" 4 "pedestrian" 5 "Pole(TBD)" 6 "tree(TBD)" 7 "animal(TBD)" 8 "General on-borad object(TBD)" 9 "bicycle" 10 "unidentified vehicle(TBD)" 11 "Reserved" 12 "Reserved" 13 "Reserved" 14 "Reserved" 15 "Reserved"  ;
VAL_ 915 ADC_FroTrkTargt1St 0 "not dectected" 1 "dectected"  ;
VAL_ 915 ADC_FroTrkTargt1DetSensor 0 "Invalid" 1 "Radar only" 2 "Vision only" 3 "Radar+Vision" 4 "Lidar only" 5 "Lidar+Radar" 6 "Lidar+Vision" 7 "Lidar+Radar+Vision" 8 "Reserve" 9 "Reserve" 10 "Reserve" 11 "Reserve" 12 "Reserve" 13 "Reserve" 14 "Reserve" 15 "Reserve"  ;
VAL_ 915 ADC_FroTrkTargt2ObjClass 0 "Underdetemined" 1 "Car" 2 "motorcycle" 3 "truck" 4 "pedestrian" 5 "Pole(TBD)" 6 "tree(TBD)" 7 "animal(TBD)" 8 "General on-borad object(TBD)" 9 "bicycle" 10 "unidentified vehicle(TBD)" 11 "Reserved" 12 "Reserved" 13 "Reserved" 14 "Reserved" 15 "Reserved"  ;
VAL_ 915 ADC_FroTrkTargt2St 0 "not dectected" 1 "dectected"  ;
VAL_ 915 ADC_FroTrkTargt2DetSensor 0 "Invalid" 1 "Radar only" 2 "Vision only" 3 "Radar+Vision" 4 "Lidar only" 5 "Lidar+Radar" 6 "Lidar+Vision" 7 "Lidar+Radar+Vision" 8 "Reserve" 9 "Reserve" 10 "Reserve" 11 "Reserve" 12 "Reserve" 13 "Reserve" 14 "Reserve" 15 "Reserve"  ;
VAL_ 915 ADC_FroTrkTargt3ObjClass 0 "Underdetemined" 1 "Car" 2 "motorcycle" 3 "truck" 4 "pedestrian" 5 "Pole(TBD)" 6 "tree(TBD)" 7 "animal(TBD)" 8 "General on-borad object(TBD)" 9 "bicycle" 10 "unidentified vehicle(TBD)" 11 "Reserved" 12 "Reserved" 13 "Reserved" 14 "Reserved" 15 "Reserved"  ;
VAL_ 915 ADC_FroTrkTargt3St 0 "not dectected" 1 "dectected"  ;
VAL_ 915 ADC_FroTrkTargt3DetSensor 0 "Invalid" 1 "Radar only" 2 "Vision only" 3 "Radar+Vision" 4 "Lidar only" 5 "Lidar+Radar" 6 "Lidar+Vision" 7 "Lidar+Radar+Vision" 8 "Reserve" 9 "Reserve" 10 "Reserve" 11 "Reserve" 12 "Reserve" 13 "Reserve" 14 "Reserve" 15 "Reserve"  ;
VAL_ 915 ADC_ReaTrkTargt4ObjClass 0 "Underdetemined" 1 "Car" 2 "motorcycle" 3 "truck" 4 "pedestrian" 5 "Pole(TBD)" 6 "tree(TBD)" 7 "animal(TBD)" 8 "General on-borad object(TBD)" 9 "bicycle" 10 "unidentified vehicle(TBD)" 11 "Reserved" 12 "Reserved" 13 "Reserved" 14 "Reserved" 15 "Reserved"  ;
VAL_ 915 ADC_ReaTrkTargt4St 0 "not dectected" 1 "dectected"  ;
VAL_ 915 ADC_ReaTrkTargt4DetSensor 0 "Invalid" 1 "Radar only" 2 "Vision only" 3 "Radar+Vision" 4 "Lidar only" 5 "Lidar+Radar" 6 "Lidar+Vision" 7 "Lidar+Radar+Vision" 8 "Reserve" 9 "Reserve" 10 "Reserve" 11 "Reserve" 12 "Reserve" 13 "Reserve" 14 "Reserve" 15 "Reserve"  ;
VAL_ 915 ADC_ReaTrkTargt5ObjClass 0 "Underdetemined" 1 "Car" 2 "motorcycle" 3 "truck" 4 "pedestrian" 5 "Pole(TBD)" 6 "tree(TBD)" 7 "animal(TBD)" 8 "General on-borad object(TBD)" 9 "bicycle" 10 "unidentified vehicle(TBD)" 11 "Reserved" 12 "Reserved" 13 "Reserved" 14 "Reserved" 15 "Reserved"  ;
VAL_ 915 ADC_ReaTrkTargt5St 0 "not dectected" 1 "dectected"  ;
VAL_ 915 ADC_ReaTrkTargt5DetSensor 0 "Invalid" 1 "Radar only" 2 "Vision only" 3 "Radar+Vision" 4 "Lidar only" 5 "Lidar+Radar" 6 "Lidar+Vision" 7 "Lidar+Radar+Vision" 8 "Reserve" 9 "Reserve" 10 "Reserve" 11 "Reserve" 12 "Reserve" 13 "Reserve" 14 "Reserve" 15 "Reserve"  ;
VAL_ 915 ADC_ReaTrkTargt6ObjClass 0 "Underdetemined" 1 "Car" 2 "motorcycle" 3 "truck" 4 "pedestrian" 5 "Pole(TBD)" 6 "tree(TBD)" 7 "animal(TBD)" 8 "General on-borad object(TBD)" 9 "bicycle" 10 "unidentified vehicle(TBD)" 11 "Reserved" 12 "Reserved" 13 "Reserved" 14 "Reserved" 15 "Reserved"  ;
VAL_ 915 ADC_ReaTrkTargt6St 0 "not dectected" 1 "dectected"  ;
VAL_ 915 ADC_ReaTrkTargt6DetSensor 0 "Invalid" 1 "Radar only" 2 "Vision only" 3 "Radar+Vision" 4 "Lidar only" 5 "Lidar+Radar" 6 "Lidar+Vision" 7 "Lidar+Radar+Vision" 8 "Reserve" 9 "Reserve" 10 "Reserve" 11 "Reserve" 12 "Reserve" 13 "Reserve" 14 "Reserve" 15 "Reserve"  ;
VAL_ 915 ADC_RadarPowerDownReq 0 "Not Request" 1 "Power Down" 2 "Power ON" 3 "reverse"  ;
VAL_ 915 ADC_RadarPowerDownReqVD 0 "Not valid" 1 "Valid"  ;
VAL_ 915 ADC_UPSPowerDownReq 0 "Not Request" 1 "Power Down" 2 "Power ON" 3 "reverse"  ;
VAL_ 915 ADC_UPSPowerDownReqVD 0 "Not valid" 1 "Valid"  ;
VAL_ 915 ADC_LidarPowerDownReq 0 "Not Request" 1 "Power Down" 2 "Power ON" 3 "reverse"  ;
VAL_ 915 ADC_LidarPowerDownReqVD 0 "Not valid" 1 "Valid"  ;
VAL_ 915 ADC_IFCPowerDownReq 0 "Not Request" 1 "Power Down" 2 "Power ON" 3 "reverse"  ;
VAL_ 915 ADC_IFCPowerDownReqVD 0 "Not valid" 1 "Valid"  ;
VAL_ 915 ADC_LowPowerReqVD 0 "Not valid" 1 "Valid"  ;
VAL_ 915 ADC_LowPowerReq 0 "Not Request" 1 "Low Power"  ;
VAL_ 387 ADC_AngReqSt_A 0 "Inhibited" 1 "Ready" 2 "Active" 3 "Failed"  ;
VAL_ 387 ADC_AngReqFunction 0 "No request" 1 "Request by LKAS" 2 "Request by PAS" 3 "Reserved"  ;
VAL_ 387 ADC_BrakeLightReq 0 "No Request" 1 "turn on" 2 "turn off"  ;
VAL_ 387 ADC_AssistParaSwitchReq 0 "No request" 1 "Request"  ;
VAL_ 387 ADC_SteerGainReq 0 "No request" 1 "Request"  ;
VAL_ 387 ADC_StrgWhlVibrWarnLevel 0 "No request" 1 "Request level 1" 2 "Request level 2" 3 "Request level 3"  ;
VAL_ 387 ADC_ActTrqReqEnable 0 "Disable" 1 "Enable"  ;
VAL_ 387 ADC_EvsSteerReq 0 "No request" 1 "Request"  ;
VAL_ 387 ADC_StrgWhlVibrWarnReq 0 "No request" 1 "Request"  ;
VAL_ 387 ADC_DrvTarTqMod2EPB 0 "Override mode" 1 "Inhibit mode" 2 "reserved" 3 "reserved"  ;
VAL_ 387 ADC_LongCtrlTypReq 0 "Comfort Mode" 1 "Emergency Mode"  ;
VAL_ 387 ADC_AEBFaultSt 0 "Not fault" 1 "Fault"  ;
VAL_ 387 ADC_AEBOffSt 0 "On" 1 "Off"  ;
VAL_ 387 ADC_AEBInterventionSt 0 "No intervention" 1 "Intervention"  ;
VAL_ 387 ADC_AEBDecelCtrlReq 0 "No request" 1 "Request"  ;
VAL_ 387 ADC_AEBLVehHoldReq 0 "No request" 1 "Request"  ;
VAL_ 387 ADC_ABAReq 0 "No request" 1 "Request"  ;
VAL_ 387 ADC_ABALevel 0 "Level 0" 1 "Level 1" 2 "Level 2" 3 "Level 3"  ;
VAL_ 387 ADC_AWBReq 0 "No request" 1 "Request"  ;
VAL_ 387 ADC_ABPReq 0 "No request" 1 "Request"  ;
VAL_ 387 ADC_AWBLevel 0 "No level" 1 "Level 1" 2 "Level 2" 3 "Level 3" 4 "Level 4" 5 "Not used" 6 "Not used" 7 "Not used"  ;
VAL_ 387 ADC_AEBTarCalss 0 "Not dectected" 1 "Car" 2 "Pedestrian" 3 "Two wheels" 4 "Motorcycle" 5 "Truck" 6 "Unknown" 7 "Reserve"  ;
VAL_ 387 ADC_AEBTarDetSensor 0 "Invalid" 1 "Not Fusion" 2 "Not used" 3 "Fusion"  ;
VAL_ 387 ADC_TurnLightReq 0 "No Request" 1 "turn off" 2 "turn on left turn lamp" 3 "turn on right turn lamp" 4 "turn on Hazard Lamp" 5 "turn on RCW Hazard Lamp(4HZ)"  ;
VAL_ 387 ADC_PAA2EPBEpbReq 0 "None" 1 "ReleaseReq" 2 "ApplyReq"  ;
VAL_ 387 ADC_PAA2EPBEpbReqSt 0 "No request" 1 "Request"  ;
VAL_ 387 ADC_PAAPwrModeReq 0 "No Request" 1 "Power On Request (PTready)"  ;
VAL_ 387 ADC_PAAGrarLvlReq 0 "No Request" 1 "Park" 2 "Reversed" 3 "Neutral" 4 "Drive" 5 "Reversed" 6 "Reversed" 7 "Reversed"  ;
VAL_ 387 ADC_PAAGrarLvlReqEnable 0 "No request" 1 "Gear shift request"  ;
VAL_ 387 ADC_ACCMode_C 0 "Failure" 1 "Passive mode" 2 "Standby mode" 3 "Active control mode" 4 "Brake only mode" 5 "Override" 6 "Standwait" 7 "Standactive" 8 "Not used" 9 "Not used" 10 "Not used" 11 "Not used" 12 "Not used" 13 "Not used" 14 "Not used" 15 "Not used"  ;
VAL_ 387 ADC_ActTrqReqVD 0 "invalid" 1 "valid"  ;
VAL_ 387 ADC_BrkTarTqEna 0 "disable" 1 "enable"  ;
VAL_ 387 ADC_BrkTarTqMod 0 "no request" 1 "Cruise function" 2 "Parking function" 3 "Reserved"  ;
VAL_ 387 ADC_EpbModReqVld 0 "Invalid" 1 "Valid"  ;
VAL_ 387 ADC_RWUEna 0 "disable" 1 "enable"  ;
VAL_ 387 ADC_BrkHoldReq 0 "No request" 1 "Not active" 2 "Active" 3 "Reserved"  ;
VAL_ 387 ADC_AngReqAvl 0 "Not available" 1 "Available"  ;
VAL_ 387 ADC_TarGearReqVld 0 "Invalid" 1 "Valid"  ;
VAL_ 387 ADC_FctSts 0 "Off" 1 "On"  ;
VAL_ 387 ADC_BrkTarTqVld 0 "Invalid" 1 "Valid"  ;
VAL_ 387 ADC_AebBrkTarTqVld 0 "Invalid" 1 "Valid"  ;
VAL_ 387 ADC_AebBrkTarTqEna 0 "disable" 1 "enable"  ;
VAL_ 387 ADC_ElecBrkFnSwitch 0 "ON" 1 "OFF"  ;
VAL_ 387 ADC_RWUVld 0 "Invalid" 1 "Valid"  ;
VAL_ 387 ADC_DriverPresent 0 "Undefined" 1 "Driver  Not Present" 2 "Driver  Present" 3 "Failure"  ;
VAL_ 387 ADC_AD_NetMode 0 "Main Net" 1 "Main and Sub Net" 2 "Reserved" 3 "Reserved"  ;
VAL_ 387 ADC_ChrgPwrMode 0 "Normal" 1 "Emergent"  ;
VAL_ 387 ADC_LimTqEnable_A 0 "Disable" 1 "Enable"  ;
VAL_ 387 ADC_RapidRespEna_A 0 "Disable" 1 "Enable"  ;
VAL_ 387 ADC_DrvTarTqMod_A 0 "Override mode" 1 "Inhibit mode" 2 "reserved" 3 "reserved"  ;
VAL_ 387 ADC_FcsActiveStatus 0 "No Active" 1 "Active"  ;
VAL_ 387 ADC_DycEscTarTqVld_A 0 "Invalid" 1 "Valid"  ;
VAL_ 387 ADC_DycEscTarTqEna_A 0 "Disable" 1 "Enable"  ;
VAL_ 387 ADC_RedundantSwt 0 "Without Redundant" 1 "With Redundant"  ;
VAL_ 387 ADC_ImmediateStopEna 0 "Not Permitted" 1 "Permitted"  ;
VAL_ 387 ADC_VehSpdVD 0 "Not Valid" 1 "Valid"  ;
VAL_ 387 ADC_BrkOffEnable 0 "Enable" 1 "Disable"  ;
VAL_ 387 ADC_SteerTqSt_A 0 "No request" 1 "Ready" 2 "Active" 3 "Reserved"  ;
VAL_ 387 ADC_TqEvsSteerReq_A 0 "Normal" 1 "Emergency"  ;
VAL_ 387 ADC_SteerTqAvl_A 0 "Not available" 1 "Available"  ;
VAL_ 783 ADC_FroTrkTargt0ObjClass 0 "Underdetemined" 1 "Car" 2 "motorcycle" 3 "truck" 4 "pedestrian" 5 "Pole(TBD)" 6 "tree(TBD)" 7 "animal(TBD)" 8 "General on-borad object(TBD)" 9 "bicycle" 10 "unidentified vehicle(TBD)" 11 "Reserved" 12 "Reserved" 13 "Reserved" 14 "Reserved" 15 "Reserved"  ;
VAL_ 783 ADC_FroTrkTargt0St 0 "not dectected" 1 "dectected"  ;
VAL_ 783 ADC_FroTrkTargt0DetSensor 0 "Invalid" 1 "Radar only" 2 "Vision only" 3 "Radar+Vision" 4 "Lidar only" 5 "Lidar+Radar" 6 "Lidar+Vision" 7 "Lidar+Radar+Vision" 8 "Reserve" 9 "Reserve" 10 "Reserve" 11 "Reserve" 12 "Reserve" 13 "Reserve" 14 "Reserve" 15 "Reserve"  ;
VAL_ 783 ADC_FroTrkTargt1ObjClass 0 "Underdetemined" 1 "Car" 2 "motorcycle" 3 "truck" 4 "pedestrian" 5 "Pole(TBD)" 6 "tree(TBD)" 7 "animal(TBD)" 8 "General on-borad object(TBD)" 9 "bicycle" 10 "unidentified vehicle(TBD)" 11 "Reserved" 12 "Reserved" 13 "Reserved" 14 "Reserved" 15 "Reserved"  ;
VAL_ 783 ADC_FroTrkTargt1St 0 "not dectected" 1 "dectected"  ;
VAL_ 783 ADC_FroTrkTargt1DetSensor 0 "Invalid" 1 "Radar only" 2 "Vision only" 3 "Radar+Vision" 4 "Lidar only" 5 "Lidar+Radar" 6 "Lidar+Vision" 7 "Lidar+Radar+Vision" 8 "Reserve" 9 "Reserve" 10 "Reserve" 11 "Reserve" 12 "Reserve" 13 "Reserve" 14 "Reserve" 15 "Reserve"  ;
VAL_ 783 ADC_FroTrkTargt2ObjClass 0 "Underdetemined" 1 "Car" 2 "motorcycle" 3 "truck" 4 "pedestrian" 5 "Pole(TBD)" 6 "tree(TBD)" 7 "animal(TBD)" 8 "General on-borad object(TBD)" 9 "bicycle" 10 "unidentified vehicle(TBD)" 11 "Reserved" 12 "Reserved" 13 "Reserved" 14 "Reserved" 15 "Reserved"  ;
VAL_ 783 ADC_FroTrkTargt2St 0 "not dectected" 1 "dectected"  ;
VAL_ 783 ADC_FroTrkTargt2DetSensor 0 "Invalid" 1 "Radar only" 2 "Vision only" 3 "Radar+Vision" 4 "Lidar only" 5 "Lidar+Radar" 6 "Lidar+Vision" 7 "Lidar+Radar+Vision" 8 "Reserve" 9 "Reserve" 10 "Reserve" 11 "Reserve" 12 "Reserve" 13 "Reserve" 14 "Reserve" 15 "Reserve"  ;
VAL_ 783 ADC_FroTrkTargt3ObjClass 0 "Underdetemined" 1 "Car" 2 "motorcycle" 3 "truck" 4 "pedestrian" 5 "Pole(TBD)" 6 "tree(TBD)" 7 "animal(TBD)" 8 "General on-borad object(TBD)" 9 "bicycle" 10 "unidentified vehicle(TBD)" 11 "Reserved" 12 "Reserved" 13 "Reserved" 14 "Reserved" 15 "Reserved"  ;
VAL_ 783 ADC_FroTrkTargt3St 0 "not dectected" 1 "dectected"  ;
VAL_ 783 ADC_FroTrkTargt3DetSensor 0 "Invalid" 1 "Radar only" 2 "Vision only" 3 "Radar+Vision" 4 "Lidar only" 5 "Lidar+Radar" 6 "Lidar+Vision" 7 "Lidar+Radar+Vision" 8 "Reserve" 9 "Reserve" 10 "Reserve" 11 "Reserve" 12 "Reserve" 13 "Reserve" 14 "Reserve" 15 "Reserve"  ;
VAL_ 783 ADC_LlnMrkingDispSt 0 "No display" 1 "tracking" 2 "intervening" 3 "warning"  ;
VAL_ 783 ADC_LLnMrking_Type 0 "No display" 1 "dashed" 2 "solid" 3 "Fishbone deceleration line（dashed）" 4 "Fishbone deceleration line（solid）" 5 "road edge" 6 "curb" 7 "Cone barrel" 8 "Plastic fence" 9 "barrier" 10 "parking cars" 11 "not used" 12 "not used" 13 "not used" 14 "not used" 15 "not used"  ;
VAL_ 783 ADC_RlnMrkingDispSt 0 "No display" 1 "tracking" 2 "intervening" 3 "warning"  ;
VAL_ 783 ADC_RLnMrking_Type 0 "No display" 1 "dashed" 2 "solid" 3 "Fishbone deceleration line（dashed）" 4 "Fishbone deceleration line（solid）" 5 "road edge" 6 "curb" 7 "Cone barrel" 8 "Plastic fence" 9 "barrier" 10 "parking cars" 11 "not used" 12 "not used" 13 "not used" 14 "not used" 15 "not used"  ;
