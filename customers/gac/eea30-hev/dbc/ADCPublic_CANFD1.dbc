VERSION "Version"

NS_ :

BS_:

BU_: Tester CCU INU ADC RRR RLR CCURT1 CCURT2 ZCUF ZCUL ZCUR ZCUT EMS IDM DCDC DCDCI IPS NIDU DCU2 OBC OPC LPC CPC EMCM GCU DCU IPU BMS EOP EVCC DCDC2 EDL SRS ECS EPS EPB RBM IBCS ICM IID IDC AMP WHUD ARHUD IMR FIMR CD IFC FAPA PAS PCS SCMF SCMR SCMRL SCMRR MFS DRM FCP RCP LBMSAD AVAS DLPFL FBLCM FLISD FLLCM FRLCM RLLCMA RLLCMB RRLCMA RRLCMB RLISD DLPML DLPMR TRM PSDL PSDR FLDCM FRDCM HVSPRL HVSPRR RFR SBM WCM ETC TBOX2 TBOX RLBMS EBU FLPDM RLPDM FRPDM RRPDM FLOAR FROAR RLOAR RROAR EOSL EOSR EOST PRBU RT1_C0 OTAWL RT2_C3 IDUR PHUDD RAS CBM PLGM TMC LPC2 SAS RCICP SCMRM SCMT SLMRL SLMRR IDU RRISD DSASBM LBMS RT1_C1

BO_ 2015 Fun_Diag_Rx: 64 Tester
 SG_ Fun_Diag_Request : 7|512@0+ (1,0) [0|0] ""  CCURT1,CCURT2,ZCUF,ZCUL,ZCUR,ZCUT,EMS,IDM,DCDC,DCDCI,IPS,NIDU,DCU2,OBC,OPC,LPC,CPC,EMCM,GCU,DCU,IPU,BMS,EOP,EVCC,DCDC2,EDL,SRS,ECS,EPS,EPB,RBM,IBCS,ICM,IID,IDC,AMP,WHUD,ARHUD,IMR,FIMR,CD,INU,ADC,IFC,FAPA,RRR,RLR,PAS,PCS,SCMF,SCMR,SCMRL,SCMRR,MFS,DRM,FCP,RCP,LBMSAD,AVAS,DLPFL,FBLCM,FLISD,FLLCM,FRLCM,RLLCMA,RLLCMB,RRLCMA,RRLCMB,RLISD,DLPML,DLPMR,TRM,PSDL,PSDR,FLDCM,FRDCM,HVSPRL,HVSPRR,RFR,SBM,WCM,ETC,TBOX2,TBOX,RLBMS,EBU,FLPDM,RLPDM,FRPDM,RRPDM,FLOAR,FROAR,RLOAR,RROAR,EOSL,EOSR,EOST,PRBU

BO_ 1854 FR_Phys_Diag_Rx: 64 Tester
 SG_ FR_Diag_Request : 7|512@0+ (1,0) [0|0] ""  ADC,IFC,FAPA

BO_ 93 CCU_17: 8 CCU
 SG_ CCU_ADCSoCWakeupRequest : 7|3@0+ (1,0) [0|7] ""  ADC,FAPA

BO_ 1007 IMU_1: 8 INU
 SG_ INS_Status : 7|16@0+ (1,0) [0|65535] ""  ADC

BO_ 134 CCU_VIM_ADCCode: 16 CCU
 SG_ Theft_Auth_ADCCode : 7|128@0+ (1,0) [0|3.40282366920938E+38] ""  ADC,FAPA

BO_ 135 ADC_VIMCode: 16 ADC
 SG_ ADC_VIMCode : 7|128@0+ (1,0) [0|3.40282366920938E+38] ""  CCU,CCURT1,CCURT2,RT1_C0

BO_ 1233 INU_BigDataDTC: 64 INU
 SG_ INU_DTCCode : 7|512@0+ (1,0) [0|0] ""  CCU,ADC

BO_ 1234 RLR_DiagCode: 64 ADC
 SG_ RLR_DTCCode : 7|512@0+ (1,0) [0|0] ""  CCU

BO_ 1235 RRR_DiagCode: 64 ADC
 SG_ RRR_DTCCode : 7|512@0+ (1,0) [0|0] ""  CCU

BO_ 1657 ADC_MCU_Diag_Request: 64 Tester
 SG_ ADC_MCU_Diag_Request : 7|64@0+ (1,0) [0|0] ""  ADC

BO_ 1785 ADC_MCU_Diag_Response: 64 ADC
 SG_ ADC_MCU_Diag_Response : 7|64@0+ (1,0) [0|0] ""  Tester

BO_ 1238 FR_DiagCode: 64 ADC
 SG_ FR_DTCCode : 7|512@0+ (1,0) [0|0] ""  CCU

BO_ 1024 CCU_TimeSync: 16 CCU
 SG_ SYNC_FC_Type : 7|8@0+ (1,0) [0|255] ""  ZCUF,ZCUL,ZCUR,ZCUT,ADC,FAPA
 SG_ SYNC_FC_CRC : 15|8@0+ (1,0) [0|255] ""  ZCUF,ZCUL,ZCUR,ZCUT,ADC,FAPA
 SG_ SYNC_FC_Sequencecnt : 19|4@0+ (1,0) [0|15] ""  ZCUF,ZCUL,ZCUR,ZCUT,ADC,FAPA
 SG_ SYNC_FC_TimeDomain : 23|4@0+ (1,0) [0|15] ""  ZCUF,ZCUL,ZCUR,ZCUT,ADC,FAPA
 SG_ SYNC_FC_OVS : 25|2@0+ (1,0) [0|3] ""  ZCUF,ZCUL,ZCUR,ZCUT,ADC,FAPA
 SG_ SYNC_FC_SGW : 26|1@0+ (1,0) [0|1] ""  ZCUF,ZCUL,ZCUR,ZCUT,ADC,FAPA
 SG_ SYNC_FC_Reserved : 31|5@0+ (1,0) [0|31] ""  ZCUF,ZCUL,ZCUR,ZCUT,ADC,FAPA
 SG_ SYNC_FC_SyncTime : 39|32@0+ (1,0) [0|4294967295] ""  ZCUF,ZCUL,ZCUR,ZCUT,ADC,FAPA

BO_ 120 CCU_SECKEY: 32 CCU
 SG_ CCU_SEC_KEY_Defaultencoding : 7|256@0+ (1,0) [0|0] ""  ZCUF,ZCUL,ZCUR,ZCUT,IDC,ADC,IFC,FAPA

BO_ 348 CCU_SECSYN: 16 CCU
 SG_ CCU_SecSynCounter : 7|24@0+ (1,0) [0|1] ""  ZCUF,ZCUL,ZCUR,ZCUT,IDC,ADC,IFC,FAPA
 SG_ CCU_SecSynResetCounter : 31|16@0+ (1,0) [0|1] ""  ZCUF,ZCUL,ZCUR,ZCUT,IDC,ADC,IFC,FAPA
 SG_ CCU_SecSynMAC_Check : 47|88@0+ (1,0) [0|1] ""  ZCUF,ZCUL,ZCUR,ZCUT,IDC,ADC,IFC,FAPA

BO_ 127 ADC_IMMO: 1 ADC
 SG_ ADC_IMMO : 7|8@0+ (1,0) [0|255] ""  CCU,CCURT1,RT1_C0

BO_ 154 CCU_IMMO: 32 CCU
 SG_ CCU_IMMO : 7|256@0+ (1,0) [0|0] ""  OTAWL,ZCUR,ICM,IDC,ADC,SBM,TBOX

BO_ 704 CCU_IPS_1: 64 CCU
 SG_ IPS_1_CRC : 7|16@0+ (1,0) [0|65535] ""  ADC,IFC,FAPA
 SG_ IPS_1_Counter : 23|8@0+ (1,0) [0|255] ""  ADC,IFC,FAPA
 SG_ IPS_DCDCModeSt : 39|3@0+ (1,0) [0|7] ""  ADC,IFC,FAPA

BO_ 918 CCU_PADS_1: 32 CCU
 SG_ UINM_PADS_1_CRC : 7|8@0+ (1,0) [0|255] ""  ADC,IFC,FAPA
 SG_ UINM_PADS_1_Counter : 11|4@0+ (1,0) [0|14] ""  ADC,IFC,FAPA
 SG_ UINM_PADS_ResponseErr : 12|1@0+ (1,0) [0|1] ""  ADC,IFC,FAPA
 SG_ UINM_PADS_CustomSWSt : 25|1@0+ (1,0) [0|1] ""  ICM,IDC,ADC,IFC,FAPA
 SG_ UINM_PADS_CustomSWStVD : 26|1@0+ (1,0) [0|1] ""  ICM,IDC,ADC,IFC,FAPA
 SG_ UINM_PADS_CustomSWstuck : 27|1@0+ (1,0) [0|1] ""  ICM,IDC,ADC,IFC,FAPA
 SG_ UINM_PADS_IDC_PlaySWSt : 42|1@0+ (1,0) [0|1] ""  ICM,IDC,ADC,IFC,FAPA
 SG_ UINM_PADS_IDC_PlaySWStVD : 43|1@0+ (1,0) [0|1] ""  ICM,IDC,ADC,IFC,FAPA
 SG_ UINM_PADS_CruSetSpeedRollerRotatedDir : 46|2@0+ (1,0) [0|3] ""  ICM,IDC,ADC,IFC,FAPA
 SG_ UINM_PADS_FolDistIncSWSt : 47|1@0+ (1,0) [0|1] ""  ICM,IDC,ADC,IFC,FAPA
 SG_ UINM_PADS_CruSetSpeedRollerSt : 53|6@0+ (1,0) [0|63] ""  ICM,IDC,ADC,IFC,FAPA
 SG_ UINM_PADS_FolDistIncSWStVD : 54|1@0+ (1,0) [0|1] ""  ICM,IDC,ADC,IFC,FAPA
 SG_ UINM_PADS_FolDistIncSWStuckSt : 55|1@0+ (1,0) [0|1] ""  ICM,IDC,ADC,IFC,FAPA
 SG_ UINM_PADS_FolDistDecSWStVD : 57|1@0+ (1,0) [0|1] ""  ICM,IDC,ADC,IFC,FAPA
 SG_ UINM_PADS_FolDistDecSWStuckSt : 58|1@0+ (1,0) [0|1] ""  ICM,IDC,ADC,IFC,FAPA
 SG_ UINM_PADS_OKSWSt : 59|1@0+ (1,0) [0|1] ""  ICM,IDC,ADC,IFC,FAPA
 SG_ UINM_PADS_OKSWStVD : 60|1@0+ (1,0) [0|1] ""  ICM,IDC,ADC,IFC,FAPA
 SG_ UINM_PADS_OKSWStuckSt : 61|1@0+ (1,0) [0|1] ""  ICM,IDC,ADC,IFC,FAPA
 SG_ UINM_PADS_CruSetSpeedRollerVD : 63|1@0+ (1,0) [0|1] ""  IDC,ADC,IFC,FAPA
 SG_ UINM_PADS_FolDistDecSWSt : 56|1@0+ (1,0) [0|1] ""  ICM,IDC,ADC,IFC,FAPA
 SG_ UINM_PADS_CruSWSt : 91|1@0+ (1,0) [0|1] ""  ADC,IFC,FAPA
 SG_ UINM_PADS_CruSWStVD : 92|1@0+ (1,0) [0|1] ""  ADC,IFC,FAPA
 SG_ UINM_PADS_CruSWStuckSt : 93|1@0+ (1,0) [0|1] ""  ADC,IFC,FAPA
 SG_ UINM_PADS_CruSpeedDecSWSt : 94|1@0+ (1,0) [0|1] ""  ADC,IFC,FAPA
 SG_ UINM_PADS_CruSpeedDecSWStVD : 95|1@0+ (1,0) [0|1] ""  ADC,IFC,FAPA
 SG_ UINM_PADS_CruSpeedDecSWStuckSt : 96|1@0+ (1,0) [0|1] ""  ADC,IFC,FAPA
 SG_ UINM_PADS_CruResumeSpeedIncSWSt : 97|1@0+ (1,0) [0|1] ""  ADC,IFC,FAPA
 SG_ UINM_PADS_CruResumeSpeedIncSWStVD : 98|1@0+ (1,0) [0|1] ""  ADC,IFC,FAPA
 SG_ UINM_PADS_CruResumeSpeedIncSWStuckSt : 99|1@0+ (1,0) [0|1] ""  ADC,IFC,FAPA
 SG_ UINM_PADS_CruTJAICASWSt : 103|1@0+ (1,0) [0|1] ""  ADC,IFC,FAPA
 SG_ UINM_PADS_CruTJAICASWStVD : 104|1@0+ (1,0) [0|1] ""  ADC,IFC,FAPA
 SG_ UINM_PADS_CruTJAICASWStuckSt : 105|1@0+ (1,0) [0|1] ""  ADC,IFC,FAPA
 SG_ UINM_PADS_Custom2SWSt : 109|1@0+ (1,0) [0|1] ""  IDC,ADC,IFC,FAPA
 SG_ UINM_PADS_Custom2SWStVD : 110|1@0+ (1,0) [0|1] ""  IDC,ADC,IFC,FAPA
 SG_ UINM_PADS_Custom2SWStuckSt : 111|1@0+ (1,0) [0|1] ""  IDC,ADC,IFC,FAPA
 SG_ UINM_PADS_ACCSWSt : 113|2@0+ (1,0) [0|3] ""  ADC,IFC,FAPA
 SG_ UINM_PADS_VoltageFaultSt : 115|2@0+ (1,0) [0|3] ""  ADC,IFC,FAPA

BO_ 957 CCU_ZCUL_HOD_1: 8 CCU
 SG_ HOD_1_CRC : 7|8@0+ (1,0) [0|255] ""  ADC,IFC,FAPA
 SG_ HOD_1_Counter : 11|4@0+ (1,0) [0|14] ""  ADC,IFC,FAPA
 SG_ HOD_St : 15|4@0+ (1,0) [0|15] ""  ADC,IFC,FAPA
 SG_ HOD_TouchZone1 : 16|1@0+ (1,0) [0|1] ""  ADC,IFC,FAPA
 SG_ HOD_TouchZone2 : 17|1@0+ (1,0) [0|1] ""  ADC,IFC,FAPA
 SG_ HOD_TouchZone3 : 18|1@0+ (1,0) [0|1] ""  ADC,IFC,FAPA
 SG_ HOD_HeatingSt : 20|2@0+ (1,0) [0|3] ""  ADC,IFC,FAPA
 SG_ HOD_CalibrationSt : 22|1@0+ (1,0) [0|1] ""  ADC,IFC,FAPA
 SG_ HOD_LINComFault : 23|1@0+ (1,0) [0|1] ""  ADC,IFC,FAPA
 SG_ HOD_FaultSt : 24|1@0+ (1,0) [0|1] ""  ADC,IFC,FAPA
 SG_ HOD_VBattOORFault : 25|1@0+ (1,0) [0|1] ""  ADC,IFC,FAPA
 SG_ HOD_HeatingOtherFaultSt : 26|1@0+ (1,0) [0|1] ""  ADC,IFC,FAPA
 SG_ HOD_HeatingOverUnderCurrentSt : 27|1@0+ (1,0) [0|1] ""  ADC,IFC,FAPA
 SG_ HOD_HeatingThermSt : 28|1@0+ (1,0) [0|1] ""  ADC,IFC,FAPA
 SG_ HOD_HeatingTempOutSt : 29|1@0+ (1,0) [0|1] ""  ADC,IFC,FAPA
 SG_ HOD_Typ : 61|3@0+ (1,0) [0|7] ""  ADC,IFC,FAPA
 SG_ HOD_TouchIntensityZone1 : 39|8@0+ (1,0) [0|255] ""  ADC,IFC,FAPA
 SG_ HOD_TouchIntensityZone2 : 47|8@0+ (1,0) [0|255] ""  ADC,IFC,FAPA
 SG_ HOD_TouchIntensityZone3 : 55|8@0+ (1,0) [0|255] ""  ADC,IFC,FAPA
 SG_ HOD_SysErr : 58|2@0+ (1,0) [0|3] ""  ADC,IFC,FAPA

BO_ 860 CCU_VCU_7: 64 CCU
 SG_ VCU_7_CRC : 7|16@0+ (1,0) [0|65535] ""  CCURT2,RT2_C3,ZCUF,ZCUL,ZCUR,ZCUT,EPB,IID,IDC,ADC,IFC,FAPA,RRR,RLR,DRM
 SG_ VCU_7_Counter : 23|8@0+ (1,0) [0|255] ""  CCURT2,RT2_C3,ZCUF,ZCUL,ZCUR,ZCUT,EPB,IID,IDC,ADC,IFC,FAPA,RRR,RLR,DRM
 SG_ VCU_RoadMod : 27|3@0+ (1,0) [0|7] ""  ECS,IBCS,IDC,ADC,FAPA
 SG_ VCU_GearLvl : 31|4@0+ (1,0) [0|15] ""  CCURT2,RT2_C3,ZCUF,ZCUL,ZCUR,ZCUT,EMS,EPB,IBCS,ADC,IFC,FAPA,RRR,RLR,DRM
 SG_ VCU_VehDrvMod : 38|3@0+ (1,0) [0|7] ""  CCURT2,RT2_C3,ZCUL,ZCUR,EMS,ECS,IBCS,ICM,IDC,AMP,ADC,IFC,FAPA
 SG_ VCU_VehRdySt : 39|1@0+ (1,0) [0|1] ""  CCURT2,RT2_C3,OTAWL,ZCUF,ZCUL,ZCUR,ZCUT,EMS,IDM,IPS,NIDU,DCU2,IDUR,OBC,GCU,DCU,IPU,BMS,ECS,EPB,IBCS,ICM,IID,IDC,PHUDD,ADC,IFC,FAPA,RRR,RLR,EBU
 SG_ VCU_ChgActiveSt_toADC : 52|1@0+ (1,0) [0|1] ""  ADC,IFC,FAPA
 SG_ VCU_PlgConnSt : 91|1@0+ (1,0) [0|1] ""  CCURT2,RT2_C3,ZCUR,ZCUT,NIDU,DCU2,IDUR,GCU,DCU,IPU,ECS,ICM,IID,IDC,PHUDD,ADC,IFC,FAPA,FLLCM,FRLCM
 SG_ VCU_EVRng : 143|9@0+ (1,0) [0|511] "km"  CCURT1,CCURT2,ICM,IID,IDC,PHUDD,ADC,IFC,FAPA
 SG_ VCU_GearLvlDisp : 155|4@0+ (1,0) [0|15] ""  ICM,IID,IDC,PHUDD,WHUD,ARHUD,IMR,FIMR,ADC,IFC,FAPA,PCS
 SG_ VCU_BMS_BattSocDisp : 199|8@0+ (0.3937,0) [0|100] "%"  CCURT2,RT2_C3,ZCUF,ZCUL,ZCUR,ZCUT,EMS,BMS,ICM,IID,IDC,PHUDD,ADC,IFC,FAPA,TBOX,RLBMS
 SG_ VCU_SuspModeReq : 257|2@0+ (1,0) [0|3] ""  ECS,ADC,IFC,FAPA
 SG_ VCU_SuspModeReqEnable : 316|1@0+ (1,0) [0|1] ""  ECS,ADC,IFC,FAPA
 SG_ VCU_PivotSteeringStAvailable : 24|1@0+ (1,0) [0|1] ""  IBCS,IDC,ADC,IFC
 SG_ VCU_PivotSteeringSt : 183|3@0+ (1,0) [0|7] ""  IDUR,IPU,IBCS,IDC,ADC,IFC
 SG_ VCU_GearPosition : 315|3@0+ (1,0) [0|7] ""  CCURT2,BMS,ADC,IFC,FAPA
 SG_ VCU_EcoPlusMod : 341|2@0+ (1,0) [0|3] ""  CCURT2,RT2_C3,IDC,WHUD,ARHUD,ADC
 SG_ ICC_RoadMod : 339|4@0+ (1,0) [0|8] ""  ECS,IBCS,IDC,ADC

BO_ 431 CCU_VCU_8: 64 CCU
 SG_ VCU_TargetRecpTorqSt : 133|2@0+ (1,0) [0|3] ""  IBCS,ADC,IFC,FAPA
 SG_ VCU_AccElecECFail : 151|1@0+ (1,0) [0|1] ""  IBCS,ADC,IFC,FAPA
 SG_ VCU_AccDriverOrvd : 150|1@0+ (1,0) [0|1] ""  ADC,IFC,FAPA
 SG_ VCU_AccTMCFail : 149|1@0+ (1,0) [0|1] ""  IBCS,ADC,IFC,FAPA
 SG_ VCU_TargetRecpTorqNm : 423|14@0+ (1,0) [0|16000] "Nm"  IBCS,ADC,IFC,FAPA
 SG_ VCU_TargetRecpTorqFA : 153|14@0+ (1,0) [0|16000] "Nm"  IBCS,ADC,IFC,FAPA,EBU
 SG_ VCU_TargetRecpTorqRA : 171|14@0+ (1,0) [0|16000] "Nm"  IBCS,ADC,IFC,FAPA,EBU
 SG_ VCU_TorqDriverReqFA : 189|14@0+ (1,0) [0|16000] "Nm"  ECS,IBCS,ADC,IFC,FAPA,EBU
 SG_ VCU_TorqDriverReqRA : 207|14@0+ (1,0) [0|16000] "Nm"  ECS,IBCS,ADC,IFC,FAPA,EBU
 SG_ VCU_VehActDrvTorqFA : 209|14@0+ (1,0) [0|16000] "Nm"  ECS,EPS,IBCS,ADC,IFC,FAPA,EBU
 SG_ VCU_VehActDrvTorqRA : 227|14@0+ (1,0) [0|16000] "Nm"  IDM,ECS,EPS,IBCS,ADC,IFC,FAPA,EBU
 SG_ VCU_TargetRecpTorqFAVD : 104|1@0+ (1,0) [0|1] ""  IBCS,ADC,IFC,FAPA,EBU
 SG_ VCU_TargetRecpTorqRAVD : 105|1@0+ (1,0) [0|1] ""  IBCS,ADC,IFC,FAPA,EBU
 SG_ VCU_TorqDriverReqFAVD : 128|1@0+ (1,0) [0|1] ""  ECS,IBCS,ADC,IFC,FAPA,EBU
 SG_ VCU_TorqDriverReqRAVD : 129|1@0+ (1,0) [0|1] ""  ECS,IBCS,ADC,IFC,FAPA,EBU
 SG_ VCU_VehActDrvTorqFAVD : 244|1@0+ (1,0) [0|1] ""  ECS,EPS,IBCS,ADC,IFC,FAPA,EBU
 SG_ VCU_VehActDrvTorqRAVD : 245|1@0+ (1,0) [0|1] ""  IDM,ECS,EPS,IBCS,ADC,IFC,FAPA,EBU
 SG_ VCU_BcsDecelReq : 243|4@0+ (0.066,-0.99) [-0.99|0] "m/s2"  IBCS,ADC,IFC,FAPA
 SG_ VCU_BcsDecelVD : 255|1@0+ (1,0) [0|1] ""  IBCS,ADC,IFC,FAPA
 SG_ VCU_RecpTorqRL : 261|14@0+ (1,0) [0|16000] ""  IBCS,ADC,FAPA
 SG_ VCU_RecpTorqRLVD : 262|1@0+ (1,0) [0|1] ""  IBCS,ADC,FAPA
 SG_ VCU_RecpTorqRR : 277|14@0+ (1,0) [0|16000] ""  IBCS,ADC,FAPA
 SG_ VCU_RecpTorqRRVD : 278|1@0+ (1,0) [0|1] ""  IBCS,ADC,FAPA
 SG_ VCU_ADSNetErrorFb : 159|3@0+ (1,0) [0|7] ""  ADC,IFC,FAPA
 SG_ VCU_NetModeResp : 156|2@0+ (1,0) [0|3] ""  ADC,FAPA

BO_ 516 CCU_VCU_9: 64 CCU
 SG_ VCU_9_CRC : 7|16@0+ (1,0) [0|65535] ""  CCURT2,RT2_C3,ZCUF,ZCUL,ZCUR,ZCUT,EMS,NIDU,DCU2,IDUR,EDL,ECS,EPB,IBCS,ICM,IDC,INU,ADC,IFC,FAPA,RRR,RLR,PAS,EBU
 SG_ VCU_9_Counter : 23|8@0+ (1,0) [0|255] ""  CCURT2,RT2_C3,ZCUF,ZCUL,ZCUR,ZCUT,EMS,NIDU,DCU2,IDUR,EDL,ECS,EPB,IBCS,ICM,IDC,INU,ADC,IFC,FAPA,RRR,RLR,PAS,EBU
 SG_ VCU_VehWheelTorqMaxVD : 25|1@0+ (1,0) [0|1] ""  ADC,IFC,FAPA
 SG_ VCU_RecpTorq : 71|10@0+ (2,0) [0|2000] "Nm"  IBCS,ADC,IFC,FAPA
 SG_ VCU_RecpTorqSt : 75|2@0+ (1,0) [0|3] ""  IBCS,ADC,IFC,FAPA
 SG_ VCU_MaxRecpTorqSt : 73|2@0+ (1,0) [0|3] ""  IBCS,ADC,IFC,FAPA
 SG_ VCU_MaxRecpTorq : 87|10@0+ (2,0) [0|2000] "Nm"  IBCS,ADC,IFC,FAPA
 SG_ VCU_CrntGearLvl : 92|3@0+ (1,0) [0|7] ""  CCURT2,RT2_C3,OTAWL,ZCUF,ZCUL,ZCUR,ZCUT,NIDU,DCU2,IDUR,DCU,IPU,SRS,ECS,RAS,EPS,EPB,IBCS,IDC,AMP,INU,ADC,IFC,FAPA,RRR,RLR,PAS,DLPML,DLPMR,TBOX,EBU
 SG_ VCU_CrntGearLvlVD : 88|1@0+ (1,0) [0|1] ""  ZCUF,ZCUL,ZCUR,ZCUT,SRS,ECS,EPS,IBCS,AMP,INU,ADC,IFC,FAPA,RRR,RLR,PAS
 SG_ VCU_BrkPedPstVD : 89|1@0+ (1,0) [0|1] ""  CCURT2,RT2_C3,NIDU,DCU2,IDUR,SRS,ECS,IBCS,IDC,ADC,IFC,FAPA
 SG_ VCU_BrkPedPst : 103|8@0+ (0.392,0) [0|99.96] "%"  CCURT2,RT2_C3,NIDU,DCU2,IDUR,SRS,ECS,IBCS,IDC,ADC,IFC,FAPA
 SG_ VCU_APAGasPedalIntv : 112|1@0+ (1,0) [0|1] ""  IBCS,ADC,IFC,FAPA
 SG_ VCU_APAAvailable : 113|1@0+ (1,0) [0|1] ""  IBCS,ADC,IFC,FAPA
 SG_ VCU_APAWheelTorqDriverReq : 111|14@0+ (1,-5000) [-5000|5000] "Nm"  ADC,IFC,FAPA
 SG_ VCU_APAGearIntervern : 137|1@0+ (1,0) [0|1] ""  IBCS,ADC,IFC,FAPA
 SG_ VCU_EMS_AccPedalActPst : 127|8@0+ (0.392,0) [0|99.96] "%"  CCURT2,RT2_C3,EMS,NIDU,DCU2,IDUR,SRS,ECS,IBCS,IDC,AMP,ADC,IFC,FAPA,RRR,RLR,EBU
 SG_ VCU_EMS_AccPedalActPstVD : 136|1@0+ (1,0) [0|1] ""  CCURT2,RT2_C3,EMS,NIDU,DCU2,IDUR,SRS,ECS,IBCS,IDC,AMP,ADC,IFC,FAPA,EBU
 SG_ VCU_ActVehWheelTorq : 135|14@0+ (1,-5000) [-5000|5000] "Nm"  IBCS,ADC,IFC,FAPA
 SG_ VCU_VehWheelTorqMax : 167|14@0+ (1,-5000) [-5000|5000] "Nm"  IBCS,ADC,IFC,FAPA
 SG_ VCU_EMS_BrkPedalSt : 189|1@0+ (1,0) [0|1] ""  CCURT2,RT2_C3,EMS,SRS,ECS,IDC,ADC,IFC,FAPA,RRR,RLR,TBOX
 SG_ VCU_EMS_BrkPedalStVD : 188|1@0+ (1,0) [0|1] ""  CCURT2,RT2_C3,EMS,SRS,ECS,IDC,ADC,IFC,FAPA
 SG_ VCU_ACCMaxRecpDecelVD : 187|1@0+ (1,0) [0|1] ""  ADC,IFC,FAPA
 SG_ VCU_ACCLimitOperatingSt : 186|1@0+ (1,0) [0|1] ""  ADC,IFC,FAPA
 SG_ VCU_APAResp : 185|1@0+ (1,0) [0|1] ""  IBCS,ADC,IFC,FAPA
 SG_ VCU_ADSEcoModReq : 184|1@0+ (1,0) [0|1] ""  ADC,IFC,FAPA
 SG_ VCU_AccButtInfo : 199|8@0+ (1,0) [0|255] ""  IDC,ADC,IFC,FAPA
 SG_ VCU_ACCMaxRecpDecel : 207|8@0+ (0.05,-5) [-5|7.75] "m/s2"  ADC,IFC,FAPA
 SG_ VCU_ACCmaxSpdLimit : 215|4@0+ (1,0) [0|15] ""  ADC,IFC,FAPA
 SG_ VCU_APA_Resp : 210|1@0+ (1,0) [0|1] ""  ADC,IFC,FAPA
 SG_ VCU_RecpTorqFAVD : 208|1@0+ (1,0) [0|1] ""  IBCS,ADC,IFC,FAPA,EBU
 SG_ VCU_RecpTorqRAVD : 209|1@0+ (1,0) [0|1] ""  IBCS,ADC,IFC,FAPA,EBU
 SG_ VCU_MaxRecpTorqFAVD : 152|1@0+ (1,0) [0|1] ""  IBCS,ADC,IFC,FAPA,EBU
 SG_ VCU_MaxRecpTorqRAVD : 153|1@0+ (1,0) [0|1] ""  IBCS,ADC,IFC,FAPA,EBU
 SG_ VCU_RecpTorqNm : 359|14@0+ (1,0) [0|16000] "Nm"  IBCS,ADC,IFC,FAPA
 SG_ VCU_APAWheelTorqDriverReqNm : 361|15@0+ (1,-16000) [-16000|16000] "Nm"  ADC,IFC,FAPA
 SG_ VCU_ActVehWheelTorqNm : 378|15@0+ (1,-16000) [-16000|16000] "Nm"  ECS,IBCS,AMP,ADC,IFC,FAPA
 SG_ VCU_VehWheelTorqMinNm : 395|15@0+ (1,-16000) [-16000|16000] "Nm"  ECS,IBCS,ADC,IFC,FAPA
 SG_ VCU_VehWheelTorqMaxNm : 412|15@0+ (1,-16000) [-16000|16000] "Nm"  ECS,IBCS,ADC,IFC,FAPA
 SG_ VCU_RecpTorqFA : 231|14@0+ (1,0) [0|16000] "Nm"  IBCS,ADC,IFC,FAPA,EBU
 SG_ VCU_RecpTorqRA : 233|14@0+ (1,0) [0|16000] "Nm"  IBCS,ADC,IFC,FAPA,EBU
 SG_ VCU_MaxRecpTorqFA : 251|14@0+ (1,0) [0|16000] "Nm"  IBCS,ADC,IFC,FAPA,EBU
 SG_ VCU_MaxRecpTorqRA : 269|14@0+ (1,0) [0|16000] "Nm"  IBCS,ADC,IFC,FAPA,EBU
 SG_ VCU_BcsDecelEnable : 305|1@0+ (1,0) [0|1] ""  IBCS,IDC,ADC,IFC,FAPA
 SG_ VCU_CrntGearNoTrans : 317|3@0+ (1,0) [0|7] ""  ADC,IFC,FAPA
 SG_ VCU_EzTSt : 314|2@0+ (1,0) [0|3] ""  IBCS,IDC,ADC,FAPA
 SG_ VCU_ITASSt : 444|3@0+ (1,0) [0|7] ""  IBCS,IDC,ADC,FAPA

BO_ 616 CCU_1: 64 CCU
 SG_ CCU_1_CRC : 7|16@0+ (1,0) [0|65535] ""  CCURT2,RT2_C3,OTAWL,ZCUF,ZCUL,ZCUR,ZCUT,NIDU,DCU2,BMS,CBM,RBM,ICM,IID,IDC,ADC,IFC,FAPA,DRM,PLGM,TRM,RLBMS
 SG_ CCU_1_Counter : 23|8@0+ (1,0) [0|255] ""  CCURT2,RT2_C3,OTAWL,ZCUF,ZCUL,ZCUR,ZCUT,NIDU,DCU2,BMS,CBM,RBM,ICM,IID,IDC,ADC,IFC,FAPA,DRM,PLGM,TRM,RLBMS
 SG_ UMM_UsageModeSt : 26|3@0+ (1,0) [0|7] ""  CCURT2,RT2_C3,OTAWL,TMC,ZCUF,ZCUL,ZCUR,ZCUT,EMS,DCDC,DCDCI,IPS,NIDU,DCU2,IDUR,OBC,OPC,LPC,LPC2,CPC,EMCM,GCU,DCU,IPU,BMS,EOP,DCDC2,EDL,SRS,ECS,SAS,CBM,RAS,EPS,EPB,RBM,IBCS,ICM,IID,IDC,PHUDD,RCICP,AMP,WHUD,ARHUD,IMR,FIMR,CD,INU,ADC,IFC,FAPA,RRR,RLR,PAS,PCS,SCMR,SCMRL,SCMRR,SCMRM,SCMT,MFS,SLMRL,SLMRR,DRM,IDU,FCP,RCP,LBMSAD,AVAS,DLPFL,FBLCM,FLISD,FLLCM,FRLCM,RLLCMA,RLLCMB,RRLCMA,RRLCMB,RLISD,RRISD,DLPML,DSASBM,DLPMR,PLGM,TRM,PSDL,PSDR,HVSPRL,HVSPRR,LBMS,TBOX2,TBOX,RLBMS,EBU,FLPDM,RLPDM,FRPDM,RRPDM,FLOAR,FROAR
 SG_ OTA_FuncReq_ADCWakeup : 45|3@0+ (1,0) [0|7] ""  ADC,FAPA
 SG_ UMM_FrontPassengerSeatSt : 57|2@0+ (1,0) [0|3] ""  CCURT2,RT2_C3,OTAWL,ZCUR,SRS,IBCS,ICM,IDC,ADC,IFC,FAPA,RRR,RLR,EBU
 SG_ UMM_DriverSeatSt : 59|2@0+ (1,0) [0|3] ""  CCURT1,CCURT2,RT2_C3,OTAWL,ZCUR,SRS,IBCS,ICM,IDC,ADC,IFC,FAPA,RRR,RLR,EBU
 SG_ VMM_VehModeSt : 159|4@0+ (1,0) [0|15] ""  CCURT2,RT2_C3,OTAWL,TMC,ZCUF,ZCUL,ZCUR,ZCUT,EMS,DCDC,DCDCI,IPS,NIDU,DCU2,IDUR,OBC,OPC,LPC,LPC2,CPC,EMCM,GCU,DCU,IPU,BMS,EOP,DCDC2,EDL,SRS,ECS,SAS,EPS,EPB,RBM,IBCS,ICM,IDC,RCICP,AMP,WHUD,ARHUD,IMR,FIMR,ADC,IFC,FAPA,RRR,RLR,PAS,SCMR,SCMRL,SCMRR,SCMRM,SCMT,MFS,SLMRL,SLMRR,IDU,FCP,RCP,LBMSAD,AVAS,DLPFL,FBLCM,FLISD,FLLCM,FRLCM,RLLCMA,RLLCMB,RRLCMA,RRLCMB,RLISD,RRISD,DLPML,DLPMR,PLGM,TRM,PSDL,PSDR,HVSPRL,HVSPRR,LBMS,RFR,SBM,WCM,ETC,TBOX2,TBOX,RLBMS,EBU,FLPDM,RLPDM,FRPDM,RRPDM,FLOAR,FROAR,RLOAR,RROAR
 SG_ VMM_LastVehModeSt : 155|4@0+ (1,0) [0|15] ""  TMC,ZCUF,ZCUL,ZCUR,ZCUT,EMS,DCDC,DCDCI,IPS,NIDU,DCU2,IDUR,OBC,OPC,LPC,LPC2,CPC,EMCM,GCU,DCU,IPU,BMS,DCDC2,EDL,SRS,EPS,EPB,RBM,IBCS,ICM,IDC,AMP,ADC,IFC,FAPA,PAS,SCMR,SCMRL,SCMRR,MFS,SLMRL,SLMRR,FCP,RCP,AVAS,FLLCM,FRLCM,TRM,PSDL,RFR,SBM,WCM,ETC,TBOX,EBU,FLPDM,FLOAR,FROAR,RLOAR,RROAR
 SG_ VMM_OTAModeSt : 167|2@0+ (1,0) [0|3] ""  CCURT2,RT2_C3,OTAWL,ZCUF,ZCUL,ZCUR,ZCUT,EMS,DCDC,DCDCI,IPS,NIDU,DCU2,IDUR,OBC,OPC,LPC,LPC2,CPC,EMCM,GCU,DCU,IPU,BMS,EOP,DCDC2,EDL,SRS,ECS,EPS,EPB,RBM,IBCS,ICM,IID,IDC,RCICP,AMP,WHUD,ARHUD,ADC,IFC,FAPA,RRR,RLR,PAS,SCMR,SCMRL,SCMRR,SCMRM,SCMT,MFS,SLMRL,SLMRR,IDU,FCP,RCP,LBMSAD,AVAS,DLPFL,FBLCM,FLISD,FLLCM,FRLCM,RLLCMA,RLLCMB,RRLCMA,RRLCMB,RLISD,RRISD,DLPML,DLPMR,TRM,PSDL,PSDR,HVSPRL,HVSPRR,LBMS,RFR,SBM,WCM,ETC,TBOX,RLBMS,EBU,FLPDM,RLPDM,FRPDM,RRPDM,FLOAR,FROAR,RLOAR,RROAR
 SG_ CSM_RC_PAARequest : 287|4@0+ (1,0) [0|15] ""  ADC,FAPA
 SG_ CSM_RC_AuthSt : 281|2@0+ (1,0) [0|3] ""  ADC,FAPA
 SG_ IPDS_EnablePowerSup : 327|2@0+ (1,0) [0|3] ""  CCURT2,ZCUF,ZCUL,ZCUR,ZCUT,EMS,IPS,NIDU,DCU2,IDUR,OBC,OPC,LPC,LPC2,CPC,EMCM,GCU,DCU,IPU,BMS,EDL,SRS,ECS,EPB,RBM,IBCS,ICM,IID,IDC,PHUDD,ADC,FAPA,PCS,EBU
 SG_ Time_Year : 343|8@0+ (1,2000) [2000|2255] "y"  CCURT2,RT2_C3,TMC,ZCUF,ZCUL,ZCUR,ZCUT,EMS,DCDC,DCDCI,IPS,NIDU,DCU2,IDUR,OBC,OPC,LPC,LPC2,CPC,EMCM,GCU,DCU,IPU,BMS,EOP,EVCC,DCDC2,EDL,SRS,ECS,CBM,EPS,EPB,RBM,IBCS,RCICP,AMP,WHUD,ARHUD,IMR,FIMR,INU,ADC,IFC,FAPA,RRR,RLR,PAS,PCS,SCMR,SCMRL,SCMRR,SCMT,MFS,SLMRL,SLMRR,DRM,IDU,FCP,RCP,LBMSAD,DLPFL,FBLCM,FLISD,FLLCM,FRLCM,RLLCMA,RLLCMB,RRLCMA,RRLCMB,RLISD,RRISD,DLPML,DSASBM,DLPMR,PLGM,TRM,PSDL,PSDR,HVSPRL,HVSPRR,LBMS,RLBMS,EBU,FLPDM,RLPDM,FRPDM,RRPDM,FLOAR,FROAR,RLOAR,RROAR
 SG_ Time_Month : 351|4@0+ (1,0) [1|12] "m"  CCURT2,RT2_C3,TMC,ZCUF,ZCUL,ZCUR,ZCUT,EMS,DCDC,DCDCI,IPS,NIDU,DCU2,IDUR,OBC,OPC,LPC,LPC2,CPC,EMCM,GCU,DCU,IPU,BMS,EOP,EVCC,DCDC2,EDL,SRS,ECS,CBM,EPS,EPB,RBM,IBCS,RCICP,AMP,WHUD,ARHUD,IMR,FIMR,INU,ADC,IFC,FAPA,RRR,RLR,PAS,PCS,SCMR,SCMRL,SCMRR,SCMT,MFS,SLMRL,SLMRR,DRM,IDU,FCP,RCP,LBMSAD,DLPFL,FBLCM,FLISD,FLLCM,FRLCM,RLLCMA,RLLCMB,RRLCMA,RRLCMB,RLISD,RRISD,DLPML,DSASBM,DLPMR,PLGM,TRM,PSDL,PSDR,HVSPRL,HVSPRR,LBMS,RLBMS,EBU,FLPDM,RLPDM,FRPDM,RRPDM,FLOAR,FROAR,RLOAR,RROAR
 SG_ Time_Day : 347|5@0+ (1,0) [1|31] "d"  CCURT2,RT2_C3,TMC,ZCUF,ZCUL,ZCUR,ZCUT,EMS,DCDC,DCDCI,IPS,NIDU,DCU2,IDUR,OBC,OPC,LPC,LPC2,CPC,EMCM,GCU,DCU,IPU,BMS,EOP,EVCC,DCDC2,EDL,SRS,ECS,CBM,EPS,EPB,RBM,IBCS,RCICP,AMP,WHUD,ARHUD,IMR,FIMR,INU,ADC,IFC,FAPA,RRR,RLR,PAS,PCS,SCMR,SCMRL,SCMRR,SCMT,MFS,SLMRL,SLMRR,DRM,IDU,FCP,RCP,LBMSAD,DLPFL,FBLCM,FLISD,FLLCM,FRLCM,RLLCMA,RLLCMB,RRLCMA,RRLCMB,RLISD,RRISD,DLPML,DSASBM,DLPMR,PLGM,TRM,PSDL,PSDR,HVSPRL,HVSPRR,LBMS,RLBMS,EBU,FLPDM,RLPDM,FRPDM,RRPDM,FLOAR,FROAR,RLOAR,RROAR
 SG_ Time_Hour : 358|5@0+ (1,0) [0|23] "h"  CCURT2,RT2_C3,TMC,ZCUF,ZCUL,ZCUR,ZCUT,EMS,DCDC,DCDCI,IPS,NIDU,DCU2,IDUR,OBC,OPC,LPC,LPC2,CPC,EMCM,GCU,DCU,IPU,BMS,EOP,EVCC,DCDC2,EDL,SRS,ECS,CBM,EPS,EPB,RBM,IBCS,RCICP,AMP,WHUD,ARHUD,IMR,FIMR,INU,ADC,IFC,FAPA,RRR,RLR,PAS,PCS,SCMR,SCMRL,SCMRR,SCMT,MFS,SLMRL,SLMRR,DRM,IDU,FCP,RCP,LBMSAD,DLPFL,FBLCM,FLISD,FLLCM,FRLCM,RLLCMA,RLLCMB,RRLCMA,RRLCMB,RLISD,RRISD,DLPML,DSASBM,DLPMR,PLGM,TRM,PSDL,PSDR,HVSPRL,HVSPRR,LBMS,RLBMS,EBU,FLPDM,RLPDM,FRPDM,RRPDM,FLOAR,FROAR,RLOAR,RROAR
 SG_ Time_Min : 353|6@0+ (1,0) [0|59] "min"  CCURT2,RT2_C3,TMC,ZCUF,ZCUL,ZCUR,ZCUT,EMS,DCDC,DCDCI,IPS,NIDU,DCU2,IDUR,OBC,OPC,LPC,LPC2,CPC,EMCM,GCU,DCU,IPU,BMS,EOP,EVCC,DCDC2,EDL,SRS,ECS,CBM,EPS,EPB,RBM,IBCS,RCICP,AMP,WHUD,ARHUD,IMR,FIMR,INU,ADC,IFC,FAPA,RRR,RLR,PAS,PCS,SCMR,SCMRL,SCMRR,SCMT,MFS,SLMRL,SLMRR,DRM,IDU,FCP,RCP,LBMSAD,DLPFL,FBLCM,FLISD,FLLCM,FRLCM,RLLCMA,RLLCMB,RRLCMA,RRLCMB,RLISD,RRISD,DLPML,DSASBM,DLPMR,PLGM,TRM,PSDL,PSDR,HVSPRL,HVSPRR,LBMS,RLBMS,EBU,FLPDM,RLPDM,FRPDM,RRPDM,FLOAR,FROAR,RLOAR,RROAR
 SG_ Time_Sec : 363|6@0+ (1,0) [0|59] "s"  CCURT2,RT2_C3,TMC,ZCUF,ZCUL,ZCUR,ZCUT,EMS,DCDC,DCDCI,IPS,NIDU,DCU2,IDUR,OBC,OPC,LPC,LPC2,CPC,EMCM,GCU,DCU,IPU,BMS,EOP,EVCC,DCDC2,EDL,SRS,ECS,CBM,EPS,EPB,RBM,IBCS,RCICP,AMP,WHUD,ARHUD,IMR,FIMR,INU,ADC,IFC,FAPA,RRR,RLR,PAS,PCS,SCMR,SCMRL,SCMRR,SCMT,MFS,SLMRL,SLMRR,DRM,IDU,FCP,RCP,LBMSAD,DLPFL,FBLCM,FLISD,FLLCM,FRLCM,RLLCMA,RLLCMB,RRLCMA,RRLCMB,RLISD,RRISD,DLPML,DSASBM,DLPMR,PLGM,TRM,PSDL,PSDR,HVSPRL,HVSPRR,LBMS,RLBMS,EBU,FLPDM,RLPDM,FRPDM,RRPDM,FLOAR,FROAR,RLOAR,RROAR
 SG_ CCU_DstFlag : 272|1@0+ (1,0) [0|1] ""  ZCUF,ZCUL,ZCUR,ZCUT,ADC,FAPA
 SG_ ASB_DriverActiveBeltFaultSt : 420|1@0+ (1,0) [0|1] ""  IDC,ADC,IFC,FAPA

BO_ 816 CCU_2: 64 CCU
 SG_ HVAC_RearDefrostSt : 31|1@0+ (1,0) [0|1] ""  TMC,ZCUL,ZCUR,ZCUT,ICM,IDC,ADC,IFC,FCP
 SG_ HVAC_WindExitMode : 37|3@0+ (1,0) [0|7] ""  TMC,ZCUL,ZCUR,EMS,ICM,IDC,RCICP,ADC,IFC
 SG_ HVAC_CorrectedExterTemp : 135|8@0+ (0.5,-40) [-40|87.5] "°C"  CCURT2,RT2_C3,TMC,ZCUF,ZCUL,ZCUR,ZCUT,EMS,IPS,NIDU,DCU2,IDUR,OBC,GCU,DCU,IPU,BMS,ECS,IBCS,ICM,IDC,AMP,ADC,IFC,PAS,FLOAR,FROAR,RLOAR,RROAR
 SG_ HVAC_CorrectedExterTempVD : 143|1@0+ (1,0) [0|1] ""  CCURT2,RT2_C3,TMC,ZCUF,ZCUL,ZCUR,ZCUT,EMS,IPS,NIDU,DCU2,IDUR,OBC,GCU,DCU,IPU,BMS,IBCS,ICM,IDC,AMP,ADC,IFC,PAS,FLOAR,FROAR,RLOAR,RROAR
 SG_ HVAC_CorrectedCabinTemp : 239|8@0+ (0.5,-40) [-40|87.5] "°C"  CCURT2,RT2_C3,TMC,IDC,ADC
 SG_ HVAC_CorrectedCabinTempVD : 247|1@0+ (1,0) [0|1] ""  CCURT2,RT2_C3,TMC,IDC,ADC

BO_ 960 TMS_4: 64 CCU
 SG_ TMS_4_CRC : 7|16@0+ (1,0) [0|65535] ""  NIDU,DCU2,IDUR,GCU,ADC,IFC,FAPA
 SG_ TMS_4_Counter : 23|8@0+ (1,0) [0|255] ""  NIDU,DCU2,IDUR,GCU,ADC,IFC,FAPA
 SG_ TMS_MotRadrOutCooltT : 200|9@0+ (0.5,-50) [-50|200] "degC"  TMC,ZCUF,EMS,DCDC,DCDCI,IPS,NIDU,DCU2,IDUR,OBC,GCU,IPU,BMS,DCDC2,ADC,FAPA
 SG_ TMS_MotRadrOutCooltTVld : 223|1@0+ (1,0) [0|1] ""  TMC,ZCUF,EMS,DCDC,DCDCI,IPS,NIDU,DCU2,IDUR,OBC,GCU,IPU,BMS,DCDC2,ADC,FAPA
 SG_ TMS_WtrPmp1Fault : 264|1@0+ (1,0) [0|1] ""  TMC,ZCUF,ZCUL,EMS,NIDU,DCU2,IDUR,GCU,IPU,ADC,FAPA
 SG_ HVAC_AutoFogFlt : 298|1@0+ (1,0) [0|1] ""  ADC,IFC,FAPA
 SG_ HVAC_AutoFogSts : 403|1@0+ (1,0) [0|1] ""  ADC,IFC,FAPA
 SG_ TMS_TWVlv1FaultSt : 283|1@0+ (1,0) [0|1] ""  ADC,IFC,FAPA,DLPFL

CM_ SG_ 2015 Fun_Diag_Request "Diagnostic function request";
CM_ SG_ 1854 FR_Diag_Request "Diagnostic physical request";
CM_ SG_ 93 CCU_ADCSoCWakeupRequest "CCU Wakeup ADC_Soc";
CM_ SG_ 1007 INS_Status "The status of INS";
CM_ SG_ 134 Theft_Auth_ADCCode "Remote Control Random Code to ADC";
CM_ SG_ 135 ADC_VIMCode "ADC Code return to VIM";
CM_ SG_ 1233 INU_DTCCode "INU DTC code and status";
CM_ SG_ 1234 RLR_DTCCode "RLR DTC code and status";
CM_ SG_ 1235 RRR_DTCCode "RRR DTC code and status";
CM_ SG_ 1657 ADC_MCU_Diag_Request "Diagnostic function of ADC_MCU request";
CM_ SG_ 1785 ADC_MCU_Diag_Response "Diagnostic physical of ADC_MCU request";
CM_ SG_ 1238 FR_DTCCode "DTC Sent To CCU";
CM_ SG_ 1024 SYNC_FC_Type "Type=0x20:TsyncType=0x28:Tsync FUP";
CM_ SG_ 1024 SYNC_FC_CRC "CRC";
CM_ SG_ 1024 SYNC_FC_Sequencecnt "Sequence counter";
CM_ SG_ 1024 SYNC_FC_TimeDomain "Time Domain";
CM_ SG_ 1024 SYNC_FC_OVS "In FUP PDUOVS=Overflow of seconds";
CM_ SG_ 1024 SYNC_FC_SGW "In FUP PDUSyncToGTM=0SyncToSubDomain=1";
CM_ SG_ 1024 SYNC_FC_Reserved "In FUP PDUReserved default=0";
CM_ SG_ 1024 SYNC_FC_SyncTime "Tsync:SyncTimeSec=32bit LSB of the 48 bits seconds part timeTsync FUP:Sync TimeNSec=32 bit value in nanosconds";
CM_ SG_ 120 CCU_SEC_KEY_Defaultencoding "CCU distribute SecOC key and default_encoding";
CM_ SG_ 348 CCU_SecSynCounter "Sync counter in CCU SecOCsync message";
CM_ SG_ 348 CCU_SecSynResetCounter "Reset counter in CCU  SecOCsync message";
CM_ SG_ 348 CCU_SecSynMAC_Check "MAC value in CCU  SecOCsync message";
CM_ SG_ 127 ADC_IMMO "ADC feedback anti-theft results";
CM_ SG_ 154 CCU_IMMO "CCU distribute anti-theft information";
CM_ SG_ 704 IPS_1_CRC "E2E Profile 5 CRC";
CM_ SG_ 704 IPS_1_Counter "E2E Profile 5 Counter";
CM_ SG_ 704 IPS_DCDCModeSt "mode status of DCDC";
CM_ SG_ 918 UINM_PADS_1_CRC "E2E Profile Variant 1A CRC";
CM_ SG_ 918 UINM_PADS_1_Counter "E2E Profile Variant 1A Counter";
CM_ SG_ 918 UINM_PADS_ResponseErr "LIN response error";
CM_ SG_ 918 UINM_PADS_CustomSWSt "PADS Custom  swtich state";
CM_ SG_ 918 UINM_PADS_CustomSWStVD "PADS_CustomSWSt validity";
CM_ SG_ 918 UINM_PADS_CustomSWstuck "PADS Custom  swtich stuck state";
CM_ SG_ 918 UINM_PADS_IDC_PlaySWSt "Indicates PADS Play swtich state";
CM_ SG_ 918 UINM_PADS_IDC_PlaySWStVD "Indicates PADS_IDC_PlaySWSt validity";
CM_ SG_ 918 UINM_PADS_CruSetSpeedRollerRotatedDir "indicate PADS curise  roller rotating direction";
CM_ SG_ 918 UINM_PADS_FolDistIncSWSt "PADS Following distance level increase  swtich state";
CM_ SG_ 918 UINM_PADS_CruSetSpeedRollerSt "indicate PADS curise  roller rotating steps";
CM_ SG_ 918 UINM_PADS_FolDistIncSWStVD "Indicates PADS_FolDistIncSWSt validity";
CM_ SG_ 918 UINM_PADS_FolDistIncSWStuckSt "Indicates PADS's   distance level increase swtich stuck state";
CM_ SG_ 918 UINM_PADS_FolDistDecSWStVD "Indicates PADS_FolDistDecSWSt validity";
CM_ SG_ 918 UINM_PADS_FolDistDecSWStuckSt "Indicates PADS's   distance level decrease swtich stuck state";
CM_ SG_ 918 UINM_PADS_OKSWSt "PADS OK swtich state";
CM_ SG_ 918 UINM_PADS_OKSWStVD "Indicates PADS_OKSWSt validity";
CM_ SG_ 918 UINM_PADS_OKSWStuckSt "PADS OK swtich Stuck state";
CM_ SG_ 918 UINM_PADS_CruSetSpeedRollerVD "Indicates PADS's CruSetSpeed singal  validity";
CM_ SG_ 918 UINM_PADS_FolDistDecSWSt "PADS Following distance level decrease  swtich state";
CM_ SG_ 918 UINM_PADS_CruSWSt "Indicates PADS's Cruise On or Off swtich state";
CM_ SG_ 918 UINM_PADS_CruSWStVD "Indicates PADS_CruSWSt validity";
CM_ SG_ 918 UINM_PADS_CruSWStuckSt "Indicates PADS's Cruise On or Off swtich  stuck state";
CM_ SG_ 918 UINM_PADS_CruSpeedDecSWSt "Indicates PADS's Cruise Speed decrease swtich state";
CM_ SG_ 918 UINM_PADS_CruSpeedDecSWStVD "Indicates PADS_CruSpeedDecSWSt validity";
CM_ SG_ 918 UINM_PADS_CruSpeedDecSWStuckSt "Indicates PADS's Cruise Speed decrease swtich stcuk state";
CM_ SG_ 918 UINM_PADS_CruResumeSpeedIncSWSt "Indicates PADS's Cruise Resume&Speed increase or resume swtich state";
CM_ SG_ 918 UINM_PADS_CruResumeSpeedIncSWStVD "Indicates PADS_CruResumeSpeedIncSWSt validity";
CM_ SG_ 918 UINM_PADS_CruResumeSpeedIncSWStuckSt "Indicates PADS's Cruise Resume&Speed increase or resume swtich state";
CM_ SG_ 918 UINM_PADS_CruTJAICASWSt "Indicates PADS's Trafiic Jam Assist or Integrated Cruise Assit  swtich state";
CM_ SG_ 918 UINM_PADS_CruTJAICASWStVD "Indicates PADS_CruTJAICASWSt validity";
CM_ SG_ 918 UINM_PADS_CruTJAICASWStuckSt "Indicates PADS's Trafiic Jam Assist or Integrated Cruise Assit  swtich Stuck state";
CM_ SG_ 918 UINM_PADS_Custom2SWSt "PADS Custom2  swtich state";
CM_ SG_ 918 UINM_PADS_Custom2SWStVD "PADS_Custom2SWSt validity";
CM_ SG_ 918 UINM_PADS_Custom2SWStuckSt "PADS Custom2  swtich stuck state";
CM_ SG_ 918 UINM_PADS_ACCSWSt "Indicates PADS's ACC swtich state";
CM_ SG_ 918 UINM_PADS_VoltageFaultSt "Indicates PADS's Supply voltage fault state";
CM_ SG_ 957 HOD_1_CRC "E2E Profile 1 CRC";
CM_ SG_ 957 HOD_1_Counter "E2E Profile 1 Counter";
CM_ SG_ 957 HOD_St "Indicating the working status of HOD function.";
CM_ SG_ 957 HOD_TouchZone1 "Indicating Zone 1 touch status";
CM_ SG_ 957 HOD_TouchZone2 "Indicating Zone 2 touch status";
CM_ SG_ 957 HOD_TouchZone3 "Indicating Zone 3 touch status";
CM_ SG_ 957 HOD_HeatingSt "Indicating the working status of steering heating function.";
CM_ SG_ 957 HOD_CalibrationSt "Open Wheel Recalibration Status";
CM_ SG_ 957 HOD_LINComFault "J2602 LIN Communication Status";
CM_ SG_ 957 HOD_FaultSt "Indicating Capacity sensor Erro ";
CM_ SG_ 957 HOD_VBattOORFault "Indicating Battery Voltage Out of Range Fault";
CM_ SG_ 957 HOD_HeatingOtherFaultSt "Indicating Heating Fault status";
CM_ SG_ 957 HOD_HeatingOverUnderCurrentSt "Indicating Heating over current or under current fault status";
CM_ SG_ 957 HOD_HeatingThermSt "Indicating Heating thermistor fault";
CM_ SG_ 957 HOD_HeatingTempOutSt "indaicating the set temperature is not reached within the specified time";
CM_ SG_ 957 HOD_Typ "Indicating HOD zone type";
CM_ SG_ 957 HOD_TouchIntensityZone1 " intensity of Zone1 ";
CM_ SG_ 957 HOD_TouchIntensityZone2 " intensity of Zone2";
CM_ SG_ 957 HOD_TouchIntensityZone3 " intensity of Zone3";
CM_ SG_ 957 HOD_SysErr "HOD Error information";
CM_ SG_ 860 VCU_7_CRC "E2E Profile 5 CRC";
CM_ SG_ 860 VCU_7_Counter "E2E Profile 5 Counter";
CM_ SG_ 860 VCU_RoadMod "Road mode for display";
CM_ SG_ 860 VCU_GearLvl "Gear lever for PEPS";
CM_ SG_ 860 VCU_VehDrvMod "Drive mode for display";
CM_ SG_ 860 VCU_VehRdySt "HEV system ready status";
CM_ SG_ 860 VCU_ChgActiveSt_toADC "Charge active status";
CM_ SG_ 860 VCU_PlgConnSt "Charge connector  connected Status";
CM_ SG_ 860 VCU_EVRng "EV range for display";
CM_ SG_ 860 VCU_GearLvlDisp "Gear lever for display";
CM_ SG_ 860 VCU_BMS_BattSocDisp "Average SOC of battery pack for display";
CM_ SG_ 860 VCU_SuspModeReq "VCU to SDC  AVDC mode request ";
CM_ SG_ 860 VCU_SuspModeReqEnable "VCU to SDC AVDC  mode request enable status ";
CM_ SG_ 860 VCU_PivotSteeringStAvailable "Whether VCU is available for VCU pivot steering status";
CM_ SG_ 860 VCU_PivotSteeringSt "ITAS working status";
CM_ SG_ 860 VCU_GearPosition "Gear lever for PEPS TCC";
CM_ SG_ 860 VCU_EcoPlusMod "EcoPlus mode is activated";
CM_ SG_ 860 ICC_RoadMod "Cross-Country Road Mode for Display";
CM_ SG_ 431 VCU_TargetRecpTorqSt "Status of  Target cuperation torque of generator";
CM_ SG_ 431 VCU_AccElecECFail "Indicate the error state of electronic engine control";
CM_ SG_ 431 VCU_AccDriverOrvd "Indicating the torque demanded by the driver is higher than the torque demanded by ACC";
CM_ SG_ 431 VCU_AccTMCFail "Indicating VCU in limp-home (error) mode";
CM_ SG_ 431 VCU_TargetRecpTorqNm "Current target recuperation torque of generator";
CM_ SG_ 431 VCU_TargetRecpTorqFA "Target cuperation torque of generator for front axel";
CM_ SG_ 431 VCU_TargetRecpTorqRA "Target cuperation torque of generator for rear axel";
CM_ SG_ 431 VCU_TorqDriverReqFA "the driver torque request for front axel";
CM_ SG_ 431 VCU_TorqDriverReqRA "the driver torque request for rear axel or left rear wheel hub motor";
CM_ SG_ 431 VCU_VehActDrvTorqFA "Vehicle actual drive torque for front axel";
CM_ SG_ 431 VCU_VehActDrvTorqRA "Vehicle actual drive torque for  rear axel or  left rear wheel hub motor";
CM_ SG_ 431 VCU_TargetRecpTorqFAVD "Status of? Target cuperation torque of generator for front axel";
CM_ SG_ 431 VCU_TargetRecpTorqRAVD "Status of? Target cuperation torque of generator for rear axel";
CM_ SG_ 431 VCU_TorqDriverReqFAVD "Status of the driver torque request for front axel";
CM_ SG_ 431 VCU_TorqDriverReqRAVD "Status of the driver torque request for rear axel or  left rear wheel hub motor";
CM_ SG_ 431 VCU_VehActDrvTorqFAVD "Vehicle actual drive torque valid data for front axel";
CM_ SG_ 431 VCU_VehActDrvTorqRAVD "Vehicle actual drive torque valid data for rear axel or  left rear wheel hub motor";
CM_ SG_ 431 VCU_BcsDecelReq "target deceleration to BCS by AVDC";
CM_ SG_ 431 VCU_BcsDecelVD "Quality/Fault of AVDC deceleration to BCS";
CM_ SG_ 431 VCU_RecpTorqRL "Current recuperation torque of left rear wheel hub motor";
CM_ SG_ 431 VCU_RecpTorqRLVD "Status ofCurrent recuperation torque of left rear wheel hub motor";
CM_ SG_ 431 VCU_RecpTorqRR "Current recuperation torque of Right rear wheel hub motor";
CM_ SG_ 431 VCU_RecpTorqRRVD "Status ofCurrent recuperation torque of Right rear wheel hub motor";
CM_ SG_ 431 VCU_ADSNetErrorFb "ADS Net Error Feedback";
CM_ SG_ 431 VCU_NetModeResp "VCU Use Net Feedback";
CM_ SG_ 516 VCU_9_CRC "E2E Profile 5 CRC";
CM_ SG_ 516 VCU_9_Counter "E2E Profile 5 Counter";
CM_ SG_ 516 VCU_VehWheelTorqMaxVD "Actual effective maximum adjustable torque on wheel level validity";
CM_ SG_ 516 VCU_RecpTorq "Current recuperation torque of generator";
CM_ SG_ 516 VCU_RecpTorqSt "Status of recuperation torque of generator";
CM_ SG_ 516 VCU_MaxRecpTorqSt "Status of target recuperation torque request by BCS to generator";
CM_ SG_ 516 VCU_MaxRecpTorq "Current maximum available recuperation torque of generator";
CM_ SG_ 516 VCU_CrntGearLvl "VCU current carry out gear level";
CM_ SG_ 516 VCU_CrntGearLvlVD "Valid bit for ActualGearPosition.";
CM_ SG_ 516 VCU_BrkPedPstVD "Current brake pedal position valid data";
CM_ SG_ 516 VCU_BrkPedPst "Current brake pedal position";
CM_ SG_ 516 VCU_APAGasPedalIntv "VCU judge if  the driver intervened base the accelerator pedal position";
CM_ SG_ 516 VCU_APAAvailable "Whether VCU is available for APA function";
CM_ SG_ 516 VCU_APAWheelTorqDriverReq "The driver torque on wheel request to APA";
CM_ SG_ 516 VCU_APAGearIntervern "During parking, If there is a request from GSM to change the gearlevel, this signal will be set to 1:with intervention (GSM gearlevel invalid will also be regard as a gearlevel request)";
CM_ SG_ 516 VCU_EMS_AccPedalActPst "Current accelerate pedal actual position";
CM_ SG_ 516 VCU_EMS_AccPedalActPstVD "Current accelerate pedal actual position validity";
CM_ SG_ 516 VCU_ActVehWheelTorq "Actual effective engine torque on wheel level";
CM_ SG_ 516 VCU_VehWheelTorqMax "Actual effective maximum adjustable torque on wheel level";
CM_ SG_ 516 VCU_EMS_BrkPedalSt " Brake pedal status";
CM_ SG_ 516 VCU_EMS_BrkPedalStVD "VCU_EMS_BrakePedSt valid data";
CM_ SG_ 516 VCU_ACCMaxRecpDecelVD "VCU_ACCMaxRecpDecel validvalidity";
CM_ SG_ 516 VCU_ACCLimitOperatingSt "Operation status of ACC Limit mode, When VCU Enter the power-saving mode";
CM_ SG_ 516 VCU_APAResp "Indicate whether VCU can response PAA gear and torque request";
CM_ SG_ 516 VCU_ADSEcoModReq "Request ADS to enter ECO mode";
CM_ SG_ 516 VCU_AccButtInfo "ACC Button Information";
CM_ SG_ 516 VCU_ACCMaxRecpDecel "Current maximum recuperationdeceleration of generator";
CM_ SG_ 516 VCU_ACCmaxSpdLimit "When VCU Enter the power-saving mode，the maximum ACC target speed limited by VCU";
CM_ SG_ 516 VCU_APA_Resp "VCU response to APA if VCU is response the gear shif and torque request";
CM_ SG_ 516 VCU_RecpTorqFAVD "Status of front axel maximum recuperation torque of generator";
CM_ SG_ 516 VCU_RecpTorqRAVD "Status of rear axel maximum recuperation torque of generator";
CM_ SG_ 516 VCU_MaxRecpTorqFAVD "Status of front axel maximum recuperation torque of generator";
CM_ SG_ 516 VCU_MaxRecpTorqRAVD "Status of front axel maximum recuperation torque of generator";
CM_ SG_ 516 VCU_RecpTorqNm "Current recuperation torque of generator";
CM_ SG_ 516 VCU_APAWheelTorqDriverReqNm "The driver torque on wheel request to APA";
CM_ SG_ 516 VCU_ActVehWheelTorqNm "Actual effective engine torque on wheel level";
CM_ SG_ 516 VCU_VehWheelTorqMinNm "Actual effective minimum adjustable torque on wheel level";
CM_ SG_ 516 VCU_VehWheelTorqMaxNm "Actual effective maximum adjustable torque on wheel level";
CM_ SG_ 516 VCU_RecpTorqFA "Current recuperation torque of generator FA";
CM_ SG_ 516 VCU_RecpTorqRA "Current recuperation torque of generator RA";
CM_ SG_ 516 VCU_MaxRecpTorqFA "Current maximum available recuperation torque of generator FA";
CM_ SG_ 516 VCU_MaxRecpTorqRA "Current maximum available recuperation torque of generator RA";
CM_ SG_ 516 VCU_BcsDecelEnable "AVDC deceleration to BCS enable";
CM_ SG_ 516 VCU_CrntGearNoTrans "VCU Gear Lever send to ADS without trans";
CM_ SG_ 516 VCU_EzTSt "This signal indicates VCU-Easy turn state";
CM_ SG_ 516 VCU_ITASSt "This signal indicates VCU state that can enter iTAS or not";
CM_ SG_ 616 CCU_1_CRC "E2E Profile 5 CRC";
CM_ SG_ 616 CCU_1_Counter "E2E Profile 5 Counter";
CM_ SG_ 616 UMM_UsageModeSt "Usage mode state";
CM_ SG_ 616 OTA_FuncReq_ADCWakeup "OTA Requset ADC to Wakeup";
CM_ SG_ 616 UMM_FrontPassengerSeatSt "Front Right Seat Sensor Status";
CM_ SG_ 616 UMM_DriverSeatSt "Front Left Seat Sensor Status";
CM_ SG_ 616 VMM_VehModeSt "Vehicle mode state";
CM_ SG_ 616 VMM_LastVehModeSt "Last time vehicle mode";
CM_ SG_ 616 VMM_OTAModeSt "OTA Mode state";
CM_ SG_ 616 CSM_RC_PAARequest "CSM_RC_Park request";
CM_ SG_ 616 CSM_RC_AuthSt "Auth Result with SBM/TBOX/KAE";
CM_ SG_ 616 IPDS_EnablePowerSup "Enable power supply";
CM_ SG_ 616 Time_Year "Year number";
CM_ SG_ 616 Time_Month "Month number";
CM_ SG_ 616 Time_Day "Day number";
CM_ SG_ 616 Time_Hour "Hour number";
CM_ SG_ 616 Time_Min "Minute number";
CM_ SG_ 616 Time_Sec "Second number";
CM_ SG_ 616 CCU_DstFlag "Daylight Saving Time Flag";
CM_ SG_ 616 ASB_DriverActiveBeltFaultSt "Driver Side Active Seat Belt Fault State";
CM_ SG_ 816 HVAC_RearDefrostSt "Rear window and mirror heater activation status";
CM_ SG_ 816 HVAC_WindExitMode "The wind exit mode";
CM_ SG_ 816 HVAC_CorrectedExterTemp "Corrected External temperature";
CM_ SG_ 816 HVAC_CorrectedExterTempVD "External temperature valid data";
CM_ SG_ 816 HVAC_CorrectedCabinTemp "Corrected cabin temperature";
CM_ SG_ 816 HVAC_CorrectedCabinTempVD "Signal CorrectedCabinTemp validity";
CM_ SG_ 960 TMS_4_CRC "E2E Profile 5 CRC";
CM_ SG_ 960 TMS_4_Counter "E2E Profile 5 Counter";
CM_ SG_ 960 TMS_MotRadrOutCooltT " Motor inlet water temperature";
CM_ SG_ 960 TMS_MotRadrOutCooltTVld " Motor inlet water temperature valid flag";
CM_ SG_ 960 TMS_WtrPmp1Fault " WaterPump1 fault";
CM_ SG_ 960 HVAC_AutoFogFlt "Auto Fog Function Fault Flag";
CM_ SG_ 960 HVAC_AutoFogSts "Auto Fog Function Status";
CM_ SG_ 960 TMS_TWVlv1FaultSt "three way valve 1 fault";

BA_DEF_ BO_  "GenMsgCycleTime" INT 0 0;
BA_DEF_ BO_  "GenMsgCycleTimeFast" INT 0 0;
BA_DEF_ BO_  "GenMsgSendType" ENUM  "Periodic","Event","IfActive","POE","PA","FixedPeriodic","Event","EnabledPeriodic","NotUsed","NotUsed","EventPeriodic","NotUsed","NotUsed","NoMsgSendType";
BA_DEF_ BO_  "VFrameFormat" ENUM  "StandardCAN","ExtendedCAN","reserved","reserved","reserved","reserved","reserved","reserved","reserved","reserved","reserved","reserved","reserved","reserved","StandardCAN_FD","ExtendedCAN_FD";
BA_DEF_ BO_  "CANFD_BRS" ENUM  "0","1";
BA_DEF_ SG_  "EventCommandSignal" ENUM  "No","Yes";
BA_DEF_ SG_  "GatewayedSignals" ENUM  "No","Yes";
BA_DEF_ SG_  "GenSigInactiveValue" HEX 0 0;
BA_DEF_ SG_  "GenSigInvalidValue" HEX 0 0;
BA_DEF_ SG_  "GenSigSendType" ENUM  "Trigger","Passive","Cyclic","OnWrite","OnWriteWithRepetition","OnChange","OnChangeWithRepetition","IfActive","IfActiveWithRepetition","NoSigSendType";
BA_DEF_ SG_  "GenSigStartValue" HEX 0 0;
BA_DEF_ SG_  "GenSigTimeoutValue" HEX 0 0;
BA_DEF_ SG_  "Remark" STRING ;
BA_DEF_  "Manufacturer" STRING ;
BA_DEF_  "Project" STRING ;
BA_DEF_  "Version" STRING ;
BA_DEF_  "Date" STRING ;
BA_DEF_  "Author" STRING ;
BA_DEF_  "DBName" STRING ;
BA_DEF_  "BusType" STRING ;
BA_DEF_  "Checker" STRING ;
BA_DEF_  "Approver" STRING ;
BA_ "Manufacturer" "GACRND";
BA_ "Project" "A88";
BA_ "Version" "0.1";
BA_ "Date" "2026/7/27 10:55:44";
BA_ "Author" "LeoFeng";
BA_ "DBName" "ADCPublic_CANFD1";
BA_ "BusType" "CAN FD";
BA_ "Checker" "Miss Fan";
BA_ "Approver" "Mr Hu";

BA_ "GenMsgCycleTime" BO_ 2015 0;
BA_ "GenMsgCycleTimeFast" BO_ 2015 0;
BA_ "GenMsgSendType" BO_ 2015 1;
BA_ "VFrameFormat" BO_ 2015 14;
BA_ "CANFD_BRS" BO_ 2015 1;
BA_ "GenMsgCycleTime" BO_ 1854 0;
BA_ "GenMsgCycleTimeFast" BO_ 1854 0;
BA_ "GenMsgSendType" BO_ 1854 1;
BA_ "VFrameFormat" BO_ 1854 14;
BA_ "CANFD_BRS" BO_ 1854 1;
BA_ "GenMsgCycleTime" BO_ 93 0;
BA_ "GenMsgCycleTimeFast" BO_ 93 0;
BA_ "GenMsgSendType" BO_ 93 1;
BA_ "VFrameFormat" BO_ 93 14;
BA_ "CANFD_BRS" BO_ 93 1;
BA_ "GenMsgCycleTime" BO_ 1007 200;
BA_ "GenMsgCycleTimeFast" BO_ 1007 0;
BA_ "GenMsgSendType" BO_ 1007 0;
BA_ "VFrameFormat" BO_ 1007 14;
BA_ "CANFD_BRS" BO_ 1007 1;
BA_ "GenMsgCycleTime" BO_ 134 0;
BA_ "GenMsgCycleTimeFast" BO_ 134 0;
BA_ "GenMsgSendType" BO_ 134 1;
BA_ "VFrameFormat" BO_ 134 14;
BA_ "CANFD_BRS" BO_ 134 1;
BA_ "GenMsgCycleTime" BO_ 135 0;
BA_ "GenMsgCycleTimeFast" BO_ 135 0;
BA_ "GenMsgSendType" BO_ 135 1;
BA_ "VFrameFormat" BO_ 135 14;
BA_ "CANFD_BRS" BO_ 135 1;
BA_ "GenMsgCycleTime" BO_ 1233 0;
BA_ "GenMsgCycleTimeFast" BO_ 1233 0;
BA_ "GenMsgSendType" BO_ 1233 1;
BA_ "VFrameFormat" BO_ 1233 14;
BA_ "CANFD_BRS" BO_ 1233 1;
BA_ "GenMsgCycleTime" BO_ 1234 0;
BA_ "GenMsgCycleTimeFast" BO_ 1234 0;
BA_ "GenMsgSendType" BO_ 1234 1;
BA_ "VFrameFormat" BO_ 1234 14;
BA_ "CANFD_BRS" BO_ 1234 1;
BA_ "GenMsgCycleTime" BO_ 1235 0;
BA_ "GenMsgCycleTimeFast" BO_ 1235 0;
BA_ "GenMsgSendType" BO_ 1235 1;
BA_ "VFrameFormat" BO_ 1235 14;
BA_ "CANFD_BRS" BO_ 1235 1;
BA_ "GenMsgCycleTime" BO_ 1657 0;
BA_ "GenMsgCycleTimeFast" BO_ 1657 0;
BA_ "GenMsgSendType" BO_ 1657 1;
BA_ "VFrameFormat" BO_ 1657 14;
BA_ "CANFD_BRS" BO_ 1657 1;
BA_ "GenMsgCycleTime" BO_ 1785 0;
BA_ "GenMsgCycleTimeFast" BO_ 1785 0;
BA_ "GenMsgSendType" BO_ 1785 1;
BA_ "VFrameFormat" BO_ 1785 14;
BA_ "CANFD_BRS" BO_ 1785 1;
BA_ "GenMsgCycleTime" BO_ 1238 0;
BA_ "GenMsgCycleTimeFast" BO_ 1238 0;
BA_ "GenMsgSendType" BO_ 1238 1;
BA_ "VFrameFormat" BO_ 1238 14;
BA_ "CANFD_BRS" BO_ 1238 1;
BA_ "GenMsgCycleTime" BO_ 1024 500;
BA_ "GenMsgCycleTimeFast" BO_ 1024 0;
BA_ "GenMsgSendType" BO_ 1024 0;
BA_ "VFrameFormat" BO_ 1024 14;
BA_ "CANFD_BRS" BO_ 1024 1;
BA_ "GenMsgCycleTime" BO_ 1024 500;
BA_ "GenMsgCycleTimeFast" BO_ 1024 0;
BA_ "GenMsgSendType" BO_ 1024 0;
BA_ "VFrameFormat" BO_ 1024 14;
BA_ "CANFD_BRS" BO_ 1024 1;
BA_ "GenMsgCycleTime" BO_ 1024 500;
BA_ "GenMsgCycleTimeFast" BO_ 1024 0;
BA_ "GenMsgSendType" BO_ 1024 0;
BA_ "VFrameFormat" BO_ 1024 14;
BA_ "CANFD_BRS" BO_ 1024 1;
BA_ "GenMsgCycleTime" BO_ 1024 500;
BA_ "GenMsgCycleTimeFast" BO_ 1024 0;
BA_ "GenMsgSendType" BO_ 1024 0;
BA_ "VFrameFormat" BO_ 1024 14;
BA_ "CANFD_BRS" BO_ 1024 1;
BA_ "GenMsgCycleTime" BO_ 1024 500;
BA_ "GenMsgCycleTimeFast" BO_ 1024 0;
BA_ "GenMsgSendType" BO_ 1024 0;
BA_ "VFrameFormat" BO_ 1024 14;
BA_ "CANFD_BRS" BO_ 1024 1;
BA_ "GenMsgCycleTime" BO_ 1024 500;
BA_ "GenMsgCycleTimeFast" BO_ 1024 0;
BA_ "GenMsgSendType" BO_ 1024 0;
BA_ "VFrameFormat" BO_ 1024 14;
BA_ "CANFD_BRS" BO_ 1024 1;
BA_ "GenMsgCycleTime" BO_ 1024 500;
BA_ "GenMsgCycleTimeFast" BO_ 1024 0;
BA_ "GenMsgSendType" BO_ 1024 0;
BA_ "VFrameFormat" BO_ 1024 14;
BA_ "CANFD_BRS" BO_ 1024 1;
BA_ "GenMsgCycleTime" BO_ 1024 500;
BA_ "GenMsgCycleTimeFast" BO_ 1024 0;
BA_ "GenMsgSendType" BO_ 1024 0;
BA_ "VFrameFormat" BO_ 1024 14;
BA_ "CANFD_BRS" BO_ 1024 1;
BA_ "GenMsgCycleTime" BO_ 120 0;
BA_ "GenMsgCycleTimeFast" BO_ 120 0;
BA_ "GenMsgSendType" BO_ 120 1;
BA_ "VFrameFormat" BO_ 120 14;
BA_ "CANFD_BRS" BO_ 120 1;
BA_ "GenMsgCycleTime" BO_ 348 30000;
BA_ "GenMsgCycleTimeFast" BO_ 348 40;
BA_ "GenMsgSendType" BO_ 348 3;
BA_ "VFrameFormat" BO_ 348 14;
BA_ "CANFD_BRS" BO_ 348 1;
BA_ "GenMsgCycleTime" BO_ 348 30000;
BA_ "GenMsgCycleTimeFast" BO_ 348 40;
BA_ "GenMsgSendType" BO_ 348 3;
BA_ "VFrameFormat" BO_ 348 14;
BA_ "CANFD_BRS" BO_ 348 1;
BA_ "GenMsgCycleTime" BO_ 348 30000;
BA_ "GenMsgCycleTimeFast" BO_ 348 40;
BA_ "GenMsgSendType" BO_ 348 3;
BA_ "VFrameFormat" BO_ 348 14;
BA_ "CANFD_BRS" BO_ 348 1;
BA_ "GenMsgCycleTime" BO_ 127 0;
BA_ "GenMsgCycleTimeFast" BO_ 127 0;
BA_ "GenMsgSendType" BO_ 127 1;
BA_ "VFrameFormat" BO_ 127 14;
BA_ "CANFD_BRS" BO_ 127 1;
BA_ "GenMsgCycleTime" BO_ 154 0;
BA_ "GenMsgCycleTimeFast" BO_ 154 0;
BA_ "GenMsgSendType" BO_ 154 1;
BA_ "VFrameFormat" BO_ 154 14;
BA_ "CANFD_BRS" BO_ 154 1;
BA_ "GenMsgCycleTime" BO_ 704 200;
BA_ "GenMsgCycleTimeFast" BO_ 704 0;
BA_ "GenMsgSendType" BO_ 704 0;
BA_ "VFrameFormat" BO_ 704 14;
BA_ "CANFD_BRS" BO_ 704 1;
BA_ "GenMsgCycleTime" BO_ 704 200;
BA_ "GenMsgCycleTimeFast" BO_ 704 0;
BA_ "GenMsgSendType" BO_ 704 0;
BA_ "VFrameFormat" BO_ 704 14;
BA_ "CANFD_BRS" BO_ 704 1;
BA_ "GenMsgCycleTime" BO_ 704 200;
BA_ "GenMsgCycleTimeFast" BO_ 704 0;
BA_ "GenMsgSendType" BO_ 704 0;
BA_ "VFrameFormat" BO_ 704 14;
BA_ "CANFD_BRS" BO_ 704 1;
BA_ "GenMsgCycleTime" BO_ 918 60;
BA_ "GenMsgCycleTimeFast" BO_ 918 0;
BA_ "GenMsgSendType" BO_ 918 0;
BA_ "VFrameFormat" BO_ 918 14;
BA_ "CANFD_BRS" BO_ 918 1;
BA_ "GenMsgCycleTime" BO_ 918 60;
BA_ "GenMsgCycleTimeFast" BO_ 918 0;
BA_ "GenMsgSendType" BO_ 918 0;
BA_ "VFrameFormat" BO_ 918 14;
BA_ "CANFD_BRS" BO_ 918 1;
BA_ "GenMsgCycleTime" BO_ 918 60;
BA_ "GenMsgCycleTimeFast" BO_ 918 0;
BA_ "GenMsgSendType" BO_ 918 0;
BA_ "VFrameFormat" BO_ 918 14;
BA_ "CANFD_BRS" BO_ 918 1;
BA_ "GenMsgCycleTime" BO_ 918 60;
BA_ "GenMsgCycleTimeFast" BO_ 918 0;
BA_ "GenMsgSendType" BO_ 918 0;
BA_ "VFrameFormat" BO_ 918 14;
BA_ "CANFD_BRS" BO_ 918 1;
BA_ "GenMsgCycleTime" BO_ 918 60;
BA_ "GenMsgCycleTimeFast" BO_ 918 0;
BA_ "GenMsgSendType" BO_ 918 0;
BA_ "VFrameFormat" BO_ 918 14;
BA_ "CANFD_BRS" BO_ 918 1;
BA_ "GenMsgCycleTime" BO_ 918 60;
BA_ "GenMsgCycleTimeFast" BO_ 918 0;
BA_ "GenMsgSendType" BO_ 918 0;
BA_ "VFrameFormat" BO_ 918 14;
BA_ "CANFD_BRS" BO_ 918 1;
BA_ "GenMsgCycleTime" BO_ 918 60;
BA_ "GenMsgCycleTimeFast" BO_ 918 0;
BA_ "GenMsgSendType" BO_ 918 0;
BA_ "VFrameFormat" BO_ 918 14;
BA_ "CANFD_BRS" BO_ 918 1;
BA_ "GenMsgCycleTime" BO_ 918 60;
BA_ "GenMsgCycleTimeFast" BO_ 918 0;
BA_ "GenMsgSendType" BO_ 918 0;
BA_ "VFrameFormat" BO_ 918 14;
BA_ "CANFD_BRS" BO_ 918 1;
BA_ "GenMsgCycleTime" BO_ 918 60;
BA_ "GenMsgCycleTimeFast" BO_ 918 0;
BA_ "GenMsgSendType" BO_ 918 0;
BA_ "VFrameFormat" BO_ 918 14;
BA_ "CANFD_BRS" BO_ 918 1;
BA_ "GenMsgCycleTime" BO_ 918 60;
BA_ "GenMsgCycleTimeFast" BO_ 918 0;
BA_ "GenMsgSendType" BO_ 918 0;
BA_ "VFrameFormat" BO_ 918 14;
BA_ "CANFD_BRS" BO_ 918 1;
BA_ "GenMsgCycleTime" BO_ 918 60;
BA_ "GenMsgCycleTimeFast" BO_ 918 0;
BA_ "GenMsgSendType" BO_ 918 0;
BA_ "VFrameFormat" BO_ 918 14;
BA_ "CANFD_BRS" BO_ 918 1;
BA_ "GenMsgCycleTime" BO_ 918 60;
BA_ "GenMsgCycleTimeFast" BO_ 918 0;
BA_ "GenMsgSendType" BO_ 918 0;
BA_ "VFrameFormat" BO_ 918 14;
BA_ "CANFD_BRS" BO_ 918 1;
BA_ "GenMsgCycleTime" BO_ 918 60;
BA_ "GenMsgCycleTimeFast" BO_ 918 0;
BA_ "GenMsgSendType" BO_ 918 0;
BA_ "VFrameFormat" BO_ 918 14;
BA_ "CANFD_BRS" BO_ 918 1;
BA_ "GenMsgCycleTime" BO_ 918 60;
BA_ "GenMsgCycleTimeFast" BO_ 918 0;
BA_ "GenMsgSendType" BO_ 918 0;
BA_ "VFrameFormat" BO_ 918 14;
BA_ "CANFD_BRS" BO_ 918 1;
BA_ "GenMsgCycleTime" BO_ 918 60;
BA_ "GenMsgCycleTimeFast" BO_ 918 0;
BA_ "GenMsgSendType" BO_ 918 0;
BA_ "VFrameFormat" BO_ 918 14;
BA_ "CANFD_BRS" BO_ 918 1;
BA_ "GenMsgCycleTime" BO_ 918 60;
BA_ "GenMsgCycleTimeFast" BO_ 918 0;
BA_ "GenMsgSendType" BO_ 918 0;
BA_ "VFrameFormat" BO_ 918 14;
BA_ "CANFD_BRS" BO_ 918 1;
BA_ "GenMsgCycleTime" BO_ 918 60;
BA_ "GenMsgCycleTimeFast" BO_ 918 0;
BA_ "GenMsgSendType" BO_ 918 0;
BA_ "VFrameFormat" BO_ 918 14;
BA_ "CANFD_BRS" BO_ 918 1;
BA_ "GenMsgCycleTime" BO_ 918 60;
BA_ "GenMsgCycleTimeFast" BO_ 918 0;
BA_ "GenMsgSendType" BO_ 918 0;
BA_ "VFrameFormat" BO_ 918 14;
BA_ "CANFD_BRS" BO_ 918 1;
BA_ "GenMsgCycleTime" BO_ 918 60;
BA_ "GenMsgCycleTimeFast" BO_ 918 0;
BA_ "GenMsgSendType" BO_ 918 0;
BA_ "VFrameFormat" BO_ 918 14;
BA_ "CANFD_BRS" BO_ 918 1;
BA_ "GenMsgCycleTime" BO_ 918 60;
BA_ "GenMsgCycleTimeFast" BO_ 918 0;
BA_ "GenMsgSendType" BO_ 918 0;
BA_ "VFrameFormat" BO_ 918 14;
BA_ "CANFD_BRS" BO_ 918 1;
BA_ "GenMsgCycleTime" BO_ 918 60;
BA_ "GenMsgCycleTimeFast" BO_ 918 0;
BA_ "GenMsgSendType" BO_ 918 0;
BA_ "VFrameFormat" BO_ 918 14;
BA_ "CANFD_BRS" BO_ 918 1;
BA_ "GenMsgCycleTime" BO_ 918 60;
BA_ "GenMsgCycleTimeFast" BO_ 918 0;
BA_ "GenMsgSendType" BO_ 918 0;
BA_ "VFrameFormat" BO_ 918 14;
BA_ "CANFD_BRS" BO_ 918 1;
BA_ "GenMsgCycleTime" BO_ 918 60;
BA_ "GenMsgCycleTimeFast" BO_ 918 0;
BA_ "GenMsgSendType" BO_ 918 0;
BA_ "VFrameFormat" BO_ 918 14;
BA_ "CANFD_BRS" BO_ 918 1;
BA_ "GenMsgCycleTime" BO_ 918 60;
BA_ "GenMsgCycleTimeFast" BO_ 918 0;
BA_ "GenMsgSendType" BO_ 918 0;
BA_ "VFrameFormat" BO_ 918 14;
BA_ "CANFD_BRS" BO_ 918 1;
BA_ "GenMsgCycleTime" BO_ 918 60;
BA_ "GenMsgCycleTimeFast" BO_ 918 0;
BA_ "GenMsgSendType" BO_ 918 0;
BA_ "VFrameFormat" BO_ 918 14;
BA_ "CANFD_BRS" BO_ 918 1;
BA_ "GenMsgCycleTime" BO_ 918 60;
BA_ "GenMsgCycleTimeFast" BO_ 918 0;
BA_ "GenMsgSendType" BO_ 918 0;
BA_ "VFrameFormat" BO_ 918 14;
BA_ "CANFD_BRS" BO_ 918 1;
BA_ "GenMsgCycleTime" BO_ 918 60;
BA_ "GenMsgCycleTimeFast" BO_ 918 0;
BA_ "GenMsgSendType" BO_ 918 0;
BA_ "VFrameFormat" BO_ 918 14;
BA_ "CANFD_BRS" BO_ 918 1;
BA_ "GenMsgCycleTime" BO_ 918 60;
BA_ "GenMsgCycleTimeFast" BO_ 918 0;
BA_ "GenMsgSendType" BO_ 918 0;
BA_ "VFrameFormat" BO_ 918 14;
BA_ "CANFD_BRS" BO_ 918 1;
BA_ "GenMsgCycleTime" BO_ 918 60;
BA_ "GenMsgCycleTimeFast" BO_ 918 0;
BA_ "GenMsgSendType" BO_ 918 0;
BA_ "VFrameFormat" BO_ 918 14;
BA_ "CANFD_BRS" BO_ 918 1;
BA_ "GenMsgCycleTime" BO_ 918 60;
BA_ "GenMsgCycleTimeFast" BO_ 918 0;
BA_ "GenMsgSendType" BO_ 918 0;
BA_ "VFrameFormat" BO_ 918 14;
BA_ "CANFD_BRS" BO_ 918 1;
BA_ "GenMsgCycleTime" BO_ 918 60;
BA_ "GenMsgCycleTimeFast" BO_ 918 0;
BA_ "GenMsgSendType" BO_ 918 0;
BA_ "VFrameFormat" BO_ 918 14;
BA_ "CANFD_BRS" BO_ 918 1;
BA_ "GenMsgCycleTime" BO_ 918 60;
BA_ "GenMsgCycleTimeFast" BO_ 918 0;
BA_ "GenMsgSendType" BO_ 918 0;
BA_ "VFrameFormat" BO_ 918 14;
BA_ "CANFD_BRS" BO_ 918 1;
BA_ "GenMsgCycleTime" BO_ 918 60;
BA_ "GenMsgCycleTimeFast" BO_ 918 0;
BA_ "GenMsgSendType" BO_ 918 0;
BA_ "VFrameFormat" BO_ 918 14;
BA_ "CANFD_BRS" BO_ 918 1;
BA_ "GenMsgCycleTime" BO_ 918 60;
BA_ "GenMsgCycleTimeFast" BO_ 918 0;
BA_ "GenMsgSendType" BO_ 918 0;
BA_ "VFrameFormat" BO_ 918 14;
BA_ "CANFD_BRS" BO_ 918 1;
BA_ "GenMsgCycleTime" BO_ 918 60;
BA_ "GenMsgCycleTimeFast" BO_ 918 0;
BA_ "GenMsgSendType" BO_ 918 0;
BA_ "VFrameFormat" BO_ 918 14;
BA_ "CANFD_BRS" BO_ 918 1;
BA_ "GenMsgCycleTime" BO_ 918 60;
BA_ "GenMsgCycleTimeFast" BO_ 918 0;
BA_ "GenMsgSendType" BO_ 918 0;
BA_ "VFrameFormat" BO_ 918 14;
BA_ "CANFD_BRS" BO_ 918 1;
BA_ "GenMsgCycleTime" BO_ 918 60;
BA_ "GenMsgCycleTimeFast" BO_ 918 0;
BA_ "GenMsgSendType" BO_ 918 0;
BA_ "VFrameFormat" BO_ 918 14;
BA_ "CANFD_BRS" BO_ 918 1;
BA_ "GenMsgCycleTime" BO_ 957 90;
BA_ "GenMsgCycleTimeFast" BO_ 957 0;
BA_ "GenMsgSendType" BO_ 957 0;
BA_ "VFrameFormat" BO_ 957 14;
BA_ "CANFD_BRS" BO_ 957 1;
BA_ "GenMsgCycleTime" BO_ 957 90;
BA_ "GenMsgCycleTimeFast" BO_ 957 0;
BA_ "GenMsgSendType" BO_ 957 0;
BA_ "VFrameFormat" BO_ 957 14;
BA_ "CANFD_BRS" BO_ 957 1;
BA_ "GenMsgCycleTime" BO_ 957 90;
BA_ "GenMsgCycleTimeFast" BO_ 957 0;
BA_ "GenMsgSendType" BO_ 957 0;
BA_ "VFrameFormat" BO_ 957 14;
BA_ "CANFD_BRS" BO_ 957 1;
BA_ "GenMsgCycleTime" BO_ 957 90;
BA_ "GenMsgCycleTimeFast" BO_ 957 0;
BA_ "GenMsgSendType" BO_ 957 0;
BA_ "VFrameFormat" BO_ 957 14;
BA_ "CANFD_BRS" BO_ 957 1;
BA_ "GenMsgCycleTime" BO_ 957 90;
BA_ "GenMsgCycleTimeFast" BO_ 957 0;
BA_ "GenMsgSendType" BO_ 957 0;
BA_ "VFrameFormat" BO_ 957 14;
BA_ "CANFD_BRS" BO_ 957 1;
BA_ "GenMsgCycleTime" BO_ 957 90;
BA_ "GenMsgCycleTimeFast" BO_ 957 0;
BA_ "GenMsgSendType" BO_ 957 0;
BA_ "VFrameFormat" BO_ 957 14;
BA_ "CANFD_BRS" BO_ 957 1;
BA_ "GenMsgCycleTime" BO_ 957 90;
BA_ "GenMsgCycleTimeFast" BO_ 957 0;
BA_ "GenMsgSendType" BO_ 957 0;
BA_ "VFrameFormat" BO_ 957 14;
BA_ "CANFD_BRS" BO_ 957 1;
BA_ "GenMsgCycleTime" BO_ 957 90;
BA_ "GenMsgCycleTimeFast" BO_ 957 0;
BA_ "GenMsgSendType" BO_ 957 0;
BA_ "VFrameFormat" BO_ 957 14;
BA_ "CANFD_BRS" BO_ 957 1;
BA_ "GenMsgCycleTime" BO_ 957 90;
BA_ "GenMsgCycleTimeFast" BO_ 957 0;
BA_ "GenMsgSendType" BO_ 957 0;
BA_ "VFrameFormat" BO_ 957 14;
BA_ "CANFD_BRS" BO_ 957 1;
BA_ "GenMsgCycleTime" BO_ 957 90;
BA_ "GenMsgCycleTimeFast" BO_ 957 0;
BA_ "GenMsgSendType" BO_ 957 0;
BA_ "VFrameFormat" BO_ 957 14;
BA_ "CANFD_BRS" BO_ 957 1;
BA_ "GenMsgCycleTime" BO_ 957 90;
BA_ "GenMsgCycleTimeFast" BO_ 957 0;
BA_ "GenMsgSendType" BO_ 957 0;
BA_ "VFrameFormat" BO_ 957 14;
BA_ "CANFD_BRS" BO_ 957 1;
BA_ "GenMsgCycleTime" BO_ 957 90;
BA_ "GenMsgCycleTimeFast" BO_ 957 0;
BA_ "GenMsgSendType" BO_ 957 0;
BA_ "VFrameFormat" BO_ 957 14;
BA_ "CANFD_BRS" BO_ 957 1;
BA_ "GenMsgCycleTime" BO_ 957 90;
BA_ "GenMsgCycleTimeFast" BO_ 957 0;
BA_ "GenMsgSendType" BO_ 957 0;
BA_ "VFrameFormat" BO_ 957 14;
BA_ "CANFD_BRS" BO_ 957 1;
BA_ "GenMsgCycleTime" BO_ 957 90;
BA_ "GenMsgCycleTimeFast" BO_ 957 0;
BA_ "GenMsgSendType" BO_ 957 0;
BA_ "VFrameFormat" BO_ 957 14;
BA_ "CANFD_BRS" BO_ 957 1;
BA_ "GenMsgCycleTime" BO_ 957 90;
BA_ "GenMsgCycleTimeFast" BO_ 957 0;
BA_ "GenMsgSendType" BO_ 957 0;
BA_ "VFrameFormat" BO_ 957 14;
BA_ "CANFD_BRS" BO_ 957 1;
BA_ "GenMsgCycleTime" BO_ 957 90;
BA_ "GenMsgCycleTimeFast" BO_ 957 0;
BA_ "GenMsgSendType" BO_ 957 0;
BA_ "VFrameFormat" BO_ 957 14;
BA_ "CANFD_BRS" BO_ 957 1;
BA_ "GenMsgCycleTime" BO_ 957 90;
BA_ "GenMsgCycleTimeFast" BO_ 957 0;
BA_ "GenMsgSendType" BO_ 957 0;
BA_ "VFrameFormat" BO_ 957 14;
BA_ "CANFD_BRS" BO_ 957 1;
BA_ "GenMsgCycleTime" BO_ 957 90;
BA_ "GenMsgCycleTimeFast" BO_ 957 0;
BA_ "GenMsgSendType" BO_ 957 0;
BA_ "VFrameFormat" BO_ 957 14;
BA_ "CANFD_BRS" BO_ 957 1;
BA_ "GenMsgCycleTime" BO_ 957 90;
BA_ "GenMsgCycleTimeFast" BO_ 957 0;
BA_ "GenMsgSendType" BO_ 957 0;
BA_ "VFrameFormat" BO_ 957 14;
BA_ "CANFD_BRS" BO_ 957 1;
BA_ "GenMsgCycleTime" BO_ 957 90;
BA_ "GenMsgCycleTimeFast" BO_ 957 0;
BA_ "GenMsgSendType" BO_ 957 0;
BA_ "VFrameFormat" BO_ 957 14;
BA_ "CANFD_BRS" BO_ 957 1;
BA_ "GenMsgCycleTime" BO_ 860 100;
BA_ "GenMsgCycleTimeFast" BO_ 860 0;
BA_ "GenMsgSendType" BO_ 860 0;
BA_ "VFrameFormat" BO_ 860 14;
BA_ "CANFD_BRS" BO_ 860 1;
BA_ "GenMsgCycleTime" BO_ 860 100;
BA_ "GenMsgCycleTimeFast" BO_ 860 0;
BA_ "GenMsgSendType" BO_ 860 0;
BA_ "VFrameFormat" BO_ 860 14;
BA_ "CANFD_BRS" BO_ 860 1;
BA_ "GenMsgCycleTime" BO_ 860 100;
BA_ "GenMsgCycleTimeFast" BO_ 860 0;
BA_ "GenMsgSendType" BO_ 860 0;
BA_ "VFrameFormat" BO_ 860 14;
BA_ "CANFD_BRS" BO_ 860 1;
BA_ "GenMsgCycleTime" BO_ 860 100;
BA_ "GenMsgCycleTimeFast" BO_ 860 0;
BA_ "GenMsgSendType" BO_ 860 0;
BA_ "VFrameFormat" BO_ 860 14;
BA_ "CANFD_BRS" BO_ 860 1;
BA_ "GenMsgCycleTime" BO_ 860 100;
BA_ "GenMsgCycleTimeFast" BO_ 860 0;
BA_ "GenMsgSendType" BO_ 860 0;
BA_ "VFrameFormat" BO_ 860 14;
BA_ "CANFD_BRS" BO_ 860 1;
BA_ "GenMsgCycleTime" BO_ 860 100;
BA_ "GenMsgCycleTimeFast" BO_ 860 0;
BA_ "GenMsgSendType" BO_ 860 0;
BA_ "VFrameFormat" BO_ 860 14;
BA_ "CANFD_BRS" BO_ 860 1;
BA_ "GenMsgCycleTime" BO_ 860 100;
BA_ "GenMsgCycleTimeFast" BO_ 860 0;
BA_ "GenMsgSendType" BO_ 860 0;
BA_ "VFrameFormat" BO_ 860 14;
BA_ "CANFD_BRS" BO_ 860 1;
BA_ "GenMsgCycleTime" BO_ 860 100;
BA_ "GenMsgCycleTimeFast" BO_ 860 0;
BA_ "GenMsgSendType" BO_ 860 0;
BA_ "VFrameFormat" BO_ 860 14;
BA_ "CANFD_BRS" BO_ 860 1;
BA_ "GenMsgCycleTime" BO_ 860 100;
BA_ "GenMsgCycleTimeFast" BO_ 860 0;
BA_ "GenMsgSendType" BO_ 860 0;
BA_ "VFrameFormat" BO_ 860 14;
BA_ "CANFD_BRS" BO_ 860 1;
BA_ "GenMsgCycleTime" BO_ 860 100;
BA_ "GenMsgCycleTimeFast" BO_ 860 0;
BA_ "GenMsgSendType" BO_ 860 0;
BA_ "VFrameFormat" BO_ 860 14;
BA_ "CANFD_BRS" BO_ 860 1;
BA_ "GenMsgCycleTime" BO_ 860 100;
BA_ "GenMsgCycleTimeFast" BO_ 860 0;
BA_ "GenMsgSendType" BO_ 860 0;
BA_ "VFrameFormat" BO_ 860 14;
BA_ "CANFD_BRS" BO_ 860 1;
BA_ "GenMsgCycleTime" BO_ 860 100;
BA_ "GenMsgCycleTimeFast" BO_ 860 0;
BA_ "GenMsgSendType" BO_ 860 0;
BA_ "VFrameFormat" BO_ 860 14;
BA_ "CANFD_BRS" BO_ 860 1;
BA_ "GenMsgCycleTime" BO_ 860 100;
BA_ "GenMsgCycleTimeFast" BO_ 860 0;
BA_ "GenMsgSendType" BO_ 860 0;
BA_ "VFrameFormat" BO_ 860 14;
BA_ "CANFD_BRS" BO_ 860 1;
BA_ "GenMsgCycleTime" BO_ 860 100;
BA_ "GenMsgCycleTimeFast" BO_ 860 0;
BA_ "GenMsgSendType" BO_ 860 0;
BA_ "VFrameFormat" BO_ 860 14;
BA_ "CANFD_BRS" BO_ 860 1;
BA_ "GenMsgCycleTime" BO_ 860 100;
BA_ "GenMsgCycleTimeFast" BO_ 860 0;
BA_ "GenMsgSendType" BO_ 860 0;
BA_ "VFrameFormat" BO_ 860 14;
BA_ "CANFD_BRS" BO_ 860 1;
BA_ "GenMsgCycleTime" BO_ 860 100;
BA_ "GenMsgCycleTimeFast" BO_ 860 0;
BA_ "GenMsgSendType" BO_ 860 0;
BA_ "VFrameFormat" BO_ 860 14;
BA_ "CANFD_BRS" BO_ 860 1;
BA_ "GenMsgCycleTime" BO_ 860 100;
BA_ "GenMsgCycleTimeFast" BO_ 860 0;
BA_ "GenMsgSendType" BO_ 860 0;
BA_ "VFrameFormat" BO_ 860 14;
BA_ "CANFD_BRS" BO_ 860 1;
BA_ "GenMsgCycleTime" BO_ 860 100;
BA_ "GenMsgCycleTimeFast" BO_ 860 0;
BA_ "GenMsgSendType" BO_ 860 0;
BA_ "VFrameFormat" BO_ 860 14;
BA_ "CANFD_BRS" BO_ 860 1;
BA_ "GenMsgCycleTime" BO_ 431 10;
BA_ "GenMsgCycleTimeFast" BO_ 431 0;
BA_ "GenMsgSendType" BO_ 431 0;
BA_ "VFrameFormat" BO_ 431 14;
BA_ "CANFD_BRS" BO_ 431 1;
BA_ "GenMsgCycleTime" BO_ 431 10;
BA_ "GenMsgCycleTimeFast" BO_ 431 0;
BA_ "GenMsgSendType" BO_ 431 0;
BA_ "VFrameFormat" BO_ 431 14;
BA_ "CANFD_BRS" BO_ 431 1;
BA_ "GenMsgCycleTime" BO_ 431 10;
BA_ "GenMsgCycleTimeFast" BO_ 431 0;
BA_ "GenMsgSendType" BO_ 431 0;
BA_ "VFrameFormat" BO_ 431 14;
BA_ "CANFD_BRS" BO_ 431 1;
BA_ "GenMsgCycleTime" BO_ 431 10;
BA_ "GenMsgCycleTimeFast" BO_ 431 0;
BA_ "GenMsgSendType" BO_ 431 0;
BA_ "VFrameFormat" BO_ 431 14;
BA_ "CANFD_BRS" BO_ 431 1;
BA_ "GenMsgCycleTime" BO_ 431 10;
BA_ "GenMsgCycleTimeFast" BO_ 431 0;
BA_ "GenMsgSendType" BO_ 431 0;
BA_ "VFrameFormat" BO_ 431 14;
BA_ "CANFD_BRS" BO_ 431 1;
BA_ "GenMsgCycleTime" BO_ 431 10;
BA_ "GenMsgCycleTimeFast" BO_ 431 0;
BA_ "GenMsgSendType" BO_ 431 0;
BA_ "VFrameFormat" BO_ 431 14;
BA_ "CANFD_BRS" BO_ 431 1;
BA_ "GenMsgCycleTime" BO_ 431 10;
BA_ "GenMsgCycleTimeFast" BO_ 431 0;
BA_ "GenMsgSendType" BO_ 431 0;
BA_ "VFrameFormat" BO_ 431 14;
BA_ "CANFD_BRS" BO_ 431 1;
BA_ "GenMsgCycleTime" BO_ 431 10;
BA_ "GenMsgCycleTimeFast" BO_ 431 0;
BA_ "GenMsgSendType" BO_ 431 0;
BA_ "VFrameFormat" BO_ 431 14;
BA_ "CANFD_BRS" BO_ 431 1;
BA_ "GenMsgCycleTime" BO_ 431 10;
BA_ "GenMsgCycleTimeFast" BO_ 431 0;
BA_ "GenMsgSendType" BO_ 431 0;
BA_ "VFrameFormat" BO_ 431 14;
BA_ "CANFD_BRS" BO_ 431 1;
BA_ "GenMsgCycleTime" BO_ 431 10;
BA_ "GenMsgCycleTimeFast" BO_ 431 0;
BA_ "GenMsgSendType" BO_ 431 0;
BA_ "VFrameFormat" BO_ 431 14;
BA_ "CANFD_BRS" BO_ 431 1;
BA_ "GenMsgCycleTime" BO_ 431 10;
BA_ "GenMsgCycleTimeFast" BO_ 431 0;
BA_ "GenMsgSendType" BO_ 431 0;
BA_ "VFrameFormat" BO_ 431 14;
BA_ "CANFD_BRS" BO_ 431 1;
BA_ "GenMsgCycleTime" BO_ 431 10;
BA_ "GenMsgCycleTimeFast" BO_ 431 0;
BA_ "GenMsgSendType" BO_ 431 0;
BA_ "VFrameFormat" BO_ 431 14;
BA_ "CANFD_BRS" BO_ 431 1;
BA_ "GenMsgCycleTime" BO_ 431 10;
BA_ "GenMsgCycleTimeFast" BO_ 431 0;
BA_ "GenMsgSendType" BO_ 431 0;
BA_ "VFrameFormat" BO_ 431 14;
BA_ "CANFD_BRS" BO_ 431 1;
BA_ "GenMsgCycleTime" BO_ 431 10;
BA_ "GenMsgCycleTimeFast" BO_ 431 0;
BA_ "GenMsgSendType" BO_ 431 0;
BA_ "VFrameFormat" BO_ 431 14;
BA_ "CANFD_BRS" BO_ 431 1;
BA_ "GenMsgCycleTime" BO_ 431 10;
BA_ "GenMsgCycleTimeFast" BO_ 431 0;
BA_ "GenMsgSendType" BO_ 431 0;
BA_ "VFrameFormat" BO_ 431 14;
BA_ "CANFD_BRS" BO_ 431 1;
BA_ "GenMsgCycleTime" BO_ 431 10;
BA_ "GenMsgCycleTimeFast" BO_ 431 0;
BA_ "GenMsgSendType" BO_ 431 0;
BA_ "VFrameFormat" BO_ 431 14;
BA_ "CANFD_BRS" BO_ 431 1;
BA_ "GenMsgCycleTime" BO_ 431 10;
BA_ "GenMsgCycleTimeFast" BO_ 431 0;
BA_ "GenMsgSendType" BO_ 431 0;
BA_ "VFrameFormat" BO_ 431 14;
BA_ "CANFD_BRS" BO_ 431 1;
BA_ "GenMsgCycleTime" BO_ 431 10;
BA_ "GenMsgCycleTimeFast" BO_ 431 0;
BA_ "GenMsgSendType" BO_ 431 0;
BA_ "VFrameFormat" BO_ 431 14;
BA_ "CANFD_BRS" BO_ 431 1;
BA_ "GenMsgCycleTime" BO_ 431 10;
BA_ "GenMsgCycleTimeFast" BO_ 431 0;
BA_ "GenMsgSendType" BO_ 431 0;
BA_ "VFrameFormat" BO_ 431 14;
BA_ "CANFD_BRS" BO_ 431 1;
BA_ "GenMsgCycleTime" BO_ 431 10;
BA_ "GenMsgCycleTimeFast" BO_ 431 0;
BA_ "GenMsgSendType" BO_ 431 0;
BA_ "VFrameFormat" BO_ 431 14;
BA_ "CANFD_BRS" BO_ 431 1;
BA_ "GenMsgCycleTime" BO_ 431 10;
BA_ "GenMsgCycleTimeFast" BO_ 431 0;
BA_ "GenMsgSendType" BO_ 431 0;
BA_ "VFrameFormat" BO_ 431 14;
BA_ "CANFD_BRS" BO_ 431 1;
BA_ "GenMsgCycleTime" BO_ 431 10;
BA_ "GenMsgCycleTimeFast" BO_ 431 0;
BA_ "GenMsgSendType" BO_ 431 0;
BA_ "VFrameFormat" BO_ 431 14;
BA_ "CANFD_BRS" BO_ 431 1;
BA_ "GenMsgCycleTime" BO_ 431 10;
BA_ "GenMsgCycleTimeFast" BO_ 431 0;
BA_ "GenMsgSendType" BO_ 431 0;
BA_ "VFrameFormat" BO_ 431 14;
BA_ "CANFD_BRS" BO_ 431 1;
BA_ "GenMsgCycleTime" BO_ 431 10;
BA_ "GenMsgCycleTimeFast" BO_ 431 0;
BA_ "GenMsgSendType" BO_ 431 0;
BA_ "VFrameFormat" BO_ 431 14;
BA_ "CANFD_BRS" BO_ 431 1;
BA_ "GenMsgCycleTime" BO_ 431 10;
BA_ "GenMsgCycleTimeFast" BO_ 431 0;
BA_ "GenMsgSendType" BO_ 431 0;
BA_ "VFrameFormat" BO_ 431 14;
BA_ "CANFD_BRS" BO_ 431 1;
BA_ "GenMsgCycleTime" BO_ 516 20;
BA_ "GenMsgCycleTimeFast" BO_ 516 0;
BA_ "GenMsgSendType" BO_ 516 0;
BA_ "VFrameFormat" BO_ 516 14;
BA_ "CANFD_BRS" BO_ 516 1;
BA_ "GenMsgCycleTime" BO_ 516 20;
BA_ "GenMsgCycleTimeFast" BO_ 516 0;
BA_ "GenMsgSendType" BO_ 516 0;
BA_ "VFrameFormat" BO_ 516 14;
BA_ "CANFD_BRS" BO_ 516 1;
BA_ "GenMsgCycleTime" BO_ 516 20;
BA_ "GenMsgCycleTimeFast" BO_ 516 0;
BA_ "GenMsgSendType" BO_ 516 0;
BA_ "VFrameFormat" BO_ 516 14;
BA_ "CANFD_BRS" BO_ 516 1;
BA_ "GenMsgCycleTime" BO_ 516 20;
BA_ "GenMsgCycleTimeFast" BO_ 516 0;
BA_ "GenMsgSendType" BO_ 516 0;
BA_ "VFrameFormat" BO_ 516 14;
BA_ "CANFD_BRS" BO_ 516 1;
BA_ "GenMsgCycleTime" BO_ 516 20;
BA_ "GenMsgCycleTimeFast" BO_ 516 0;
BA_ "GenMsgSendType" BO_ 516 0;
BA_ "VFrameFormat" BO_ 516 14;
BA_ "CANFD_BRS" BO_ 516 1;
BA_ "GenMsgCycleTime" BO_ 516 20;
BA_ "GenMsgCycleTimeFast" BO_ 516 0;
BA_ "GenMsgSendType" BO_ 516 0;
BA_ "VFrameFormat" BO_ 516 14;
BA_ "CANFD_BRS" BO_ 516 1;
BA_ "GenMsgCycleTime" BO_ 516 20;
BA_ "GenMsgCycleTimeFast" BO_ 516 0;
BA_ "GenMsgSendType" BO_ 516 0;
BA_ "VFrameFormat" BO_ 516 14;
BA_ "CANFD_BRS" BO_ 516 1;
BA_ "GenMsgCycleTime" BO_ 516 20;
BA_ "GenMsgCycleTimeFast" BO_ 516 0;
BA_ "GenMsgSendType" BO_ 516 0;
BA_ "VFrameFormat" BO_ 516 14;
BA_ "CANFD_BRS" BO_ 516 1;
BA_ "GenMsgCycleTime" BO_ 516 20;
BA_ "GenMsgCycleTimeFast" BO_ 516 0;
BA_ "GenMsgSendType" BO_ 516 0;
BA_ "VFrameFormat" BO_ 516 14;
BA_ "CANFD_BRS" BO_ 516 1;
BA_ "GenMsgCycleTime" BO_ 516 20;
BA_ "GenMsgCycleTimeFast" BO_ 516 0;
BA_ "GenMsgSendType" BO_ 516 0;
BA_ "VFrameFormat" BO_ 516 14;
BA_ "CANFD_BRS" BO_ 516 1;
BA_ "GenMsgCycleTime" BO_ 516 20;
BA_ "GenMsgCycleTimeFast" BO_ 516 0;
BA_ "GenMsgSendType" BO_ 516 0;
BA_ "VFrameFormat" BO_ 516 14;
BA_ "CANFD_BRS" BO_ 516 1;
BA_ "GenMsgCycleTime" BO_ 516 20;
BA_ "GenMsgCycleTimeFast" BO_ 516 0;
BA_ "GenMsgSendType" BO_ 516 0;
BA_ "VFrameFormat" BO_ 516 14;
BA_ "CANFD_BRS" BO_ 516 1;
BA_ "GenMsgCycleTime" BO_ 516 20;
BA_ "GenMsgCycleTimeFast" BO_ 516 0;
BA_ "GenMsgSendType" BO_ 516 0;
BA_ "VFrameFormat" BO_ 516 14;
BA_ "CANFD_BRS" BO_ 516 1;
BA_ "GenMsgCycleTime" BO_ 516 20;
BA_ "GenMsgCycleTimeFast" BO_ 516 0;
BA_ "GenMsgSendType" BO_ 516 0;
BA_ "VFrameFormat" BO_ 516 14;
BA_ "CANFD_BRS" BO_ 516 1;
BA_ "GenMsgCycleTime" BO_ 516 20;
BA_ "GenMsgCycleTimeFast" BO_ 516 0;
BA_ "GenMsgSendType" BO_ 516 0;
BA_ "VFrameFormat" BO_ 516 14;
BA_ "CANFD_BRS" BO_ 516 1;
BA_ "GenMsgCycleTime" BO_ 516 20;
BA_ "GenMsgCycleTimeFast" BO_ 516 0;
BA_ "GenMsgSendType" BO_ 516 0;
BA_ "VFrameFormat" BO_ 516 14;
BA_ "CANFD_BRS" BO_ 516 1;
BA_ "GenMsgCycleTime" BO_ 516 20;
BA_ "GenMsgCycleTimeFast" BO_ 516 0;
BA_ "GenMsgSendType" BO_ 516 0;
BA_ "VFrameFormat" BO_ 516 14;
BA_ "CANFD_BRS" BO_ 516 1;
BA_ "GenMsgCycleTime" BO_ 516 20;
BA_ "GenMsgCycleTimeFast" BO_ 516 0;
BA_ "GenMsgSendType" BO_ 516 0;
BA_ "VFrameFormat" BO_ 516 14;
BA_ "CANFD_BRS" BO_ 516 1;
BA_ "GenMsgCycleTime" BO_ 516 20;
BA_ "GenMsgCycleTimeFast" BO_ 516 0;
BA_ "GenMsgSendType" BO_ 516 0;
BA_ "VFrameFormat" BO_ 516 14;
BA_ "CANFD_BRS" BO_ 516 1;
BA_ "GenMsgCycleTime" BO_ 516 20;
BA_ "GenMsgCycleTimeFast" BO_ 516 0;
BA_ "GenMsgSendType" BO_ 516 0;
BA_ "VFrameFormat" BO_ 516 14;
BA_ "CANFD_BRS" BO_ 516 1;
BA_ "GenMsgCycleTime" BO_ 516 20;
BA_ "GenMsgCycleTimeFast" BO_ 516 0;
BA_ "GenMsgSendType" BO_ 516 0;
BA_ "VFrameFormat" BO_ 516 14;
BA_ "CANFD_BRS" BO_ 516 1;
BA_ "GenMsgCycleTime" BO_ 516 20;
BA_ "GenMsgCycleTimeFast" BO_ 516 0;
BA_ "GenMsgSendType" BO_ 516 0;
BA_ "VFrameFormat" BO_ 516 14;
BA_ "CANFD_BRS" BO_ 516 1;
BA_ "GenMsgCycleTime" BO_ 516 20;
BA_ "GenMsgCycleTimeFast" BO_ 516 0;
BA_ "GenMsgSendType" BO_ 516 0;
BA_ "VFrameFormat" BO_ 516 14;
BA_ "CANFD_BRS" BO_ 516 1;
BA_ "GenMsgCycleTime" BO_ 516 20;
BA_ "GenMsgCycleTimeFast" BO_ 516 0;
BA_ "GenMsgSendType" BO_ 516 0;
BA_ "VFrameFormat" BO_ 516 14;
BA_ "CANFD_BRS" BO_ 516 1;
BA_ "GenMsgCycleTime" BO_ 516 20;
BA_ "GenMsgCycleTimeFast" BO_ 516 0;
BA_ "GenMsgSendType" BO_ 516 0;
BA_ "VFrameFormat" BO_ 516 14;
BA_ "CANFD_BRS" BO_ 516 1;
BA_ "GenMsgCycleTime" BO_ 516 20;
BA_ "GenMsgCycleTimeFast" BO_ 516 0;
BA_ "GenMsgSendType" BO_ 516 0;
BA_ "VFrameFormat" BO_ 516 14;
BA_ "CANFD_BRS" BO_ 516 1;
BA_ "GenMsgCycleTime" BO_ 516 20;
BA_ "GenMsgCycleTimeFast" BO_ 516 0;
BA_ "GenMsgSendType" BO_ 516 0;
BA_ "VFrameFormat" BO_ 516 14;
BA_ "CANFD_BRS" BO_ 516 1;
BA_ "GenMsgCycleTime" BO_ 516 20;
BA_ "GenMsgCycleTimeFast" BO_ 516 0;
BA_ "GenMsgSendType" BO_ 516 0;
BA_ "VFrameFormat" BO_ 516 14;
BA_ "CANFD_BRS" BO_ 516 1;
BA_ "GenMsgCycleTime" BO_ 516 20;
BA_ "GenMsgCycleTimeFast" BO_ 516 0;
BA_ "GenMsgSendType" BO_ 516 0;
BA_ "VFrameFormat" BO_ 516 14;
BA_ "CANFD_BRS" BO_ 516 1;
BA_ "GenMsgCycleTime" BO_ 516 20;
BA_ "GenMsgCycleTimeFast" BO_ 516 0;
BA_ "GenMsgSendType" BO_ 516 0;
BA_ "VFrameFormat" BO_ 516 14;
BA_ "CANFD_BRS" BO_ 516 1;
BA_ "GenMsgCycleTime" BO_ 516 20;
BA_ "GenMsgCycleTimeFast" BO_ 516 0;
BA_ "GenMsgSendType" BO_ 516 0;
BA_ "VFrameFormat" BO_ 516 14;
BA_ "CANFD_BRS" BO_ 516 1;
BA_ "GenMsgCycleTime" BO_ 516 20;
BA_ "GenMsgCycleTimeFast" BO_ 516 0;
BA_ "GenMsgSendType" BO_ 516 0;
BA_ "VFrameFormat" BO_ 516 14;
BA_ "CANFD_BRS" BO_ 516 1;
BA_ "GenMsgCycleTime" BO_ 516 20;
BA_ "GenMsgCycleTimeFast" BO_ 516 0;
BA_ "GenMsgSendType" BO_ 516 0;
BA_ "VFrameFormat" BO_ 516 14;
BA_ "CANFD_BRS" BO_ 516 1;
BA_ "GenMsgCycleTime" BO_ 516 20;
BA_ "GenMsgCycleTimeFast" BO_ 516 0;
BA_ "GenMsgSendType" BO_ 516 0;
BA_ "VFrameFormat" BO_ 516 14;
BA_ "CANFD_BRS" BO_ 516 1;
BA_ "GenMsgCycleTime" BO_ 516 20;
BA_ "GenMsgCycleTimeFast" BO_ 516 0;
BA_ "GenMsgSendType" BO_ 516 0;
BA_ "VFrameFormat" BO_ 516 14;
BA_ "CANFD_BRS" BO_ 516 1;
BA_ "GenMsgCycleTime" BO_ 516 20;
BA_ "GenMsgCycleTimeFast" BO_ 516 0;
BA_ "GenMsgSendType" BO_ 516 0;
BA_ "VFrameFormat" BO_ 516 14;
BA_ "CANFD_BRS" BO_ 516 1;
BA_ "GenMsgCycleTime" BO_ 516 20;
BA_ "GenMsgCycleTimeFast" BO_ 516 0;
BA_ "GenMsgSendType" BO_ 516 0;
BA_ "VFrameFormat" BO_ 516 14;
BA_ "CANFD_BRS" BO_ 516 1;
BA_ "GenMsgCycleTime" BO_ 516 20;
BA_ "GenMsgCycleTimeFast" BO_ 516 0;
BA_ "GenMsgSendType" BO_ 516 0;
BA_ "VFrameFormat" BO_ 516 14;
BA_ "CANFD_BRS" BO_ 516 1;
BA_ "GenMsgCycleTime" BO_ 516 20;
BA_ "GenMsgCycleTimeFast" BO_ 516 0;
BA_ "GenMsgSendType" BO_ 516 0;
BA_ "VFrameFormat" BO_ 516 14;
BA_ "CANFD_BRS" BO_ 516 1;
BA_ "GenMsgCycleTime" BO_ 516 20;
BA_ "GenMsgCycleTimeFast" BO_ 516 0;
BA_ "GenMsgSendType" BO_ 516 0;
BA_ "VFrameFormat" BO_ 516 14;
BA_ "CANFD_BRS" BO_ 516 1;
BA_ "GenMsgCycleTime" BO_ 516 20;
BA_ "GenMsgCycleTimeFast" BO_ 516 0;
BA_ "GenMsgSendType" BO_ 516 0;
BA_ "VFrameFormat" BO_ 516 14;
BA_ "CANFD_BRS" BO_ 516 1;
BA_ "GenMsgCycleTime" BO_ 516 20;
BA_ "GenMsgCycleTimeFast" BO_ 516 0;
BA_ "GenMsgSendType" BO_ 516 0;
BA_ "VFrameFormat" BO_ 516 14;
BA_ "CANFD_BRS" BO_ 516 1;
BA_ "GenMsgCycleTime" BO_ 516 20;
BA_ "GenMsgCycleTimeFast" BO_ 516 0;
BA_ "GenMsgSendType" BO_ 516 0;
BA_ "VFrameFormat" BO_ 516 14;
BA_ "CANFD_BRS" BO_ 516 1;
BA_ "GenMsgCycleTime" BO_ 516 20;
BA_ "GenMsgCycleTimeFast" BO_ 516 0;
BA_ "GenMsgSendType" BO_ 516 0;
BA_ "VFrameFormat" BO_ 516 14;
BA_ "CANFD_BRS" BO_ 516 1;
BA_ "GenMsgCycleTime" BO_ 516 20;
BA_ "GenMsgCycleTimeFast" BO_ 516 0;
BA_ "GenMsgSendType" BO_ 516 0;
BA_ "VFrameFormat" BO_ 516 14;
BA_ "CANFD_BRS" BO_ 516 1;
BA_ "GenMsgCycleTime" BO_ 516 20;
BA_ "GenMsgCycleTimeFast" BO_ 516 0;
BA_ "GenMsgSendType" BO_ 516 0;
BA_ "VFrameFormat" BO_ 516 14;
BA_ "CANFD_BRS" BO_ 516 1;
BA_ "GenMsgCycleTime" BO_ 616 20;
BA_ "GenMsgCycleTimeFast" BO_ 616 0;
BA_ "GenMsgSendType" BO_ 616 0;
BA_ "VFrameFormat" BO_ 616 14;
BA_ "CANFD_BRS" BO_ 616 1;
BA_ "GenMsgCycleTime" BO_ 616 20;
BA_ "GenMsgCycleTimeFast" BO_ 616 0;
BA_ "GenMsgSendType" BO_ 616 0;
BA_ "VFrameFormat" BO_ 616 14;
BA_ "CANFD_BRS" BO_ 616 1;
BA_ "GenMsgCycleTime" BO_ 616 20;
BA_ "GenMsgCycleTimeFast" BO_ 616 0;
BA_ "GenMsgSendType" BO_ 616 0;
BA_ "VFrameFormat" BO_ 616 14;
BA_ "CANFD_BRS" BO_ 616 1;
BA_ "GenMsgCycleTime" BO_ 616 20;
BA_ "GenMsgCycleTimeFast" BO_ 616 0;
BA_ "GenMsgSendType" BO_ 616 0;
BA_ "VFrameFormat" BO_ 616 14;
BA_ "CANFD_BRS" BO_ 616 1;
BA_ "GenMsgCycleTime" BO_ 616 20;
BA_ "GenMsgCycleTimeFast" BO_ 616 0;
BA_ "GenMsgSendType" BO_ 616 0;
BA_ "VFrameFormat" BO_ 616 14;
BA_ "CANFD_BRS" BO_ 616 1;
BA_ "GenMsgCycleTime" BO_ 616 20;
BA_ "GenMsgCycleTimeFast" BO_ 616 0;
BA_ "GenMsgSendType" BO_ 616 0;
BA_ "VFrameFormat" BO_ 616 14;
BA_ "CANFD_BRS" BO_ 616 1;
BA_ "GenMsgCycleTime" BO_ 616 20;
BA_ "GenMsgCycleTimeFast" BO_ 616 0;
BA_ "GenMsgSendType" BO_ 616 0;
BA_ "VFrameFormat" BO_ 616 14;
BA_ "CANFD_BRS" BO_ 616 1;
BA_ "GenMsgCycleTime" BO_ 616 20;
BA_ "GenMsgCycleTimeFast" BO_ 616 0;
BA_ "GenMsgSendType" BO_ 616 0;
BA_ "VFrameFormat" BO_ 616 14;
BA_ "CANFD_BRS" BO_ 616 1;
BA_ "GenMsgCycleTime" BO_ 616 20;
BA_ "GenMsgCycleTimeFast" BO_ 616 0;
BA_ "GenMsgSendType" BO_ 616 0;
BA_ "VFrameFormat" BO_ 616 14;
BA_ "CANFD_BRS" BO_ 616 1;
BA_ "GenMsgCycleTime" BO_ 616 20;
BA_ "GenMsgCycleTimeFast" BO_ 616 0;
BA_ "GenMsgSendType" BO_ 616 0;
BA_ "VFrameFormat" BO_ 616 14;
BA_ "CANFD_BRS" BO_ 616 1;
BA_ "GenMsgCycleTime" BO_ 616 20;
BA_ "GenMsgCycleTimeFast" BO_ 616 0;
BA_ "GenMsgSendType" BO_ 616 0;
BA_ "VFrameFormat" BO_ 616 14;
BA_ "CANFD_BRS" BO_ 616 1;
BA_ "GenMsgCycleTime" BO_ 616 20;
BA_ "GenMsgCycleTimeFast" BO_ 616 0;
BA_ "GenMsgSendType" BO_ 616 0;
BA_ "VFrameFormat" BO_ 616 14;
BA_ "CANFD_BRS" BO_ 616 1;
BA_ "GenMsgCycleTime" BO_ 616 20;
BA_ "GenMsgCycleTimeFast" BO_ 616 0;
BA_ "GenMsgSendType" BO_ 616 0;
BA_ "VFrameFormat" BO_ 616 14;
BA_ "CANFD_BRS" BO_ 616 1;
BA_ "GenMsgCycleTime" BO_ 616 20;
BA_ "GenMsgCycleTimeFast" BO_ 616 0;
BA_ "GenMsgSendType" BO_ 616 0;
BA_ "VFrameFormat" BO_ 616 14;
BA_ "CANFD_BRS" BO_ 616 1;
BA_ "GenMsgCycleTime" BO_ 616 20;
BA_ "GenMsgCycleTimeFast" BO_ 616 0;
BA_ "GenMsgSendType" BO_ 616 0;
BA_ "VFrameFormat" BO_ 616 14;
BA_ "CANFD_BRS" BO_ 616 1;
BA_ "GenMsgCycleTime" BO_ 616 20;
BA_ "GenMsgCycleTimeFast" BO_ 616 0;
BA_ "GenMsgSendType" BO_ 616 0;
BA_ "VFrameFormat" BO_ 616 14;
BA_ "CANFD_BRS" BO_ 616 1;
BA_ "GenMsgCycleTime" BO_ 616 20;
BA_ "GenMsgCycleTimeFast" BO_ 616 0;
BA_ "GenMsgSendType" BO_ 616 0;
BA_ "VFrameFormat" BO_ 616 14;
BA_ "CANFD_BRS" BO_ 616 1;
BA_ "GenMsgCycleTime" BO_ 616 20;
BA_ "GenMsgCycleTimeFast" BO_ 616 0;
BA_ "GenMsgSendType" BO_ 616 0;
BA_ "VFrameFormat" BO_ 616 14;
BA_ "CANFD_BRS" BO_ 616 1;
BA_ "GenMsgCycleTime" BO_ 616 20;
BA_ "GenMsgCycleTimeFast" BO_ 616 0;
BA_ "GenMsgSendType" BO_ 616 0;
BA_ "VFrameFormat" BO_ 616 14;
BA_ "CANFD_BRS" BO_ 616 1;
BA_ "GenMsgCycleTime" BO_ 616 20;
BA_ "GenMsgCycleTimeFast" BO_ 616 0;
BA_ "GenMsgSendType" BO_ 616 0;
BA_ "VFrameFormat" BO_ 616 14;
BA_ "CANFD_BRS" BO_ 616 1;
BA_ "GenMsgCycleTime" BO_ 816 100;
BA_ "GenMsgCycleTimeFast" BO_ 816 0;
BA_ "GenMsgSendType" BO_ 816 0;
BA_ "VFrameFormat" BO_ 816 14;
BA_ "CANFD_BRS" BO_ 816 1;
BA_ "GenMsgCycleTime" BO_ 816 100;
BA_ "GenMsgCycleTimeFast" BO_ 816 0;
BA_ "GenMsgSendType" BO_ 816 0;
BA_ "VFrameFormat" BO_ 816 14;
BA_ "CANFD_BRS" BO_ 816 1;
BA_ "GenMsgCycleTime" BO_ 816 100;
BA_ "GenMsgCycleTimeFast" BO_ 816 0;
BA_ "GenMsgSendType" BO_ 816 0;
BA_ "VFrameFormat" BO_ 816 14;
BA_ "CANFD_BRS" BO_ 816 1;
BA_ "GenMsgCycleTime" BO_ 816 100;
BA_ "GenMsgCycleTimeFast" BO_ 816 0;
BA_ "GenMsgSendType" BO_ 816 0;
BA_ "VFrameFormat" BO_ 816 14;
BA_ "CANFD_BRS" BO_ 816 1;
BA_ "GenMsgCycleTime" BO_ 816 100;
BA_ "GenMsgCycleTimeFast" BO_ 816 0;
BA_ "GenMsgSendType" BO_ 816 0;
BA_ "VFrameFormat" BO_ 816 14;
BA_ "CANFD_BRS" BO_ 816 1;
BA_ "GenMsgCycleTime" BO_ 816 100;
BA_ "GenMsgCycleTimeFast" BO_ 816 0;
BA_ "GenMsgSendType" BO_ 816 0;
BA_ "VFrameFormat" BO_ 816 14;
BA_ "CANFD_BRS" BO_ 816 1;
BA_ "GenMsgCycleTime" BO_ 960 400;
BA_ "GenMsgCycleTimeFast" BO_ 960 0;
BA_ "GenMsgSendType" BO_ 960 0;
BA_ "VFrameFormat" BO_ 960 14;
BA_ "CANFD_BRS" BO_ 960 1;
BA_ "GenMsgCycleTime" BO_ 960 400;
BA_ "GenMsgCycleTimeFast" BO_ 960 0;
BA_ "GenMsgSendType" BO_ 960 0;
BA_ "VFrameFormat" BO_ 960 14;
BA_ "CANFD_BRS" BO_ 960 1;
BA_ "GenMsgCycleTime" BO_ 960 400;
BA_ "GenMsgCycleTimeFast" BO_ 960 0;
BA_ "GenMsgSendType" BO_ 960 0;
BA_ "VFrameFormat" BO_ 960 14;
BA_ "CANFD_BRS" BO_ 960 1;
BA_ "GenMsgCycleTime" BO_ 960 400;
BA_ "GenMsgCycleTimeFast" BO_ 960 0;
BA_ "GenMsgSendType" BO_ 960 0;
BA_ "VFrameFormat" BO_ 960 14;
BA_ "CANFD_BRS" BO_ 960 1;
BA_ "GenMsgCycleTime" BO_ 960 400;
BA_ "GenMsgCycleTimeFast" BO_ 960 0;
BA_ "GenMsgSendType" BO_ 960 0;
BA_ "VFrameFormat" BO_ 960 14;
BA_ "CANFD_BRS" BO_ 960 1;
BA_ "GenMsgCycleTime" BO_ 960 400;
BA_ "GenMsgCycleTimeFast" BO_ 960 0;
BA_ "GenMsgSendType" BO_ 960 0;
BA_ "VFrameFormat" BO_ 960 14;
BA_ "CANFD_BRS" BO_ 960 1;
BA_ "GenMsgCycleTime" BO_ 960 400;
BA_ "GenMsgCycleTimeFast" BO_ 960 0;
BA_ "GenMsgSendType" BO_ 960 0;
BA_ "VFrameFormat" BO_ 960 14;
BA_ "CANFD_BRS" BO_ 960 1;
BA_ "GenMsgCycleTime" BO_ 960 400;
BA_ "GenMsgCycleTimeFast" BO_ 960 0;
BA_ "GenMsgSendType" BO_ 960 0;
BA_ "VFrameFormat" BO_ 960 14;
BA_ "CANFD_BRS" BO_ 960 1;

BA_ "EventCommandSignal" SG_ 2015 Fun_Diag_Request 0;
BA_ "GatewayedSignals" SG_ 2015 Fun_Diag_Request 0;
BA_ "GenSigInactiveValue" SG_ 2015 Fun_Diag_Request 0;
BA_ "GenSigInvalidValue" SG_ 2015 Fun_Diag_Request 0;
BA_ "GenSigSendType" SG_ 2015 Fun_Diag_Request 1;
BA_ "GenSigStartValue" SG_ 2015 Fun_Diag_Request 0;
BA_ "GenSigTimeoutValue" SG_ 2015 Fun_Diag_Request 0;
BA_ "Remark" SG_ 2015 Fun_Diag_Request "";
BA_ "EventCommandSignal" SG_ 1854 FR_Diag_Request 0;
BA_ "GatewayedSignals" SG_ 1854 FR_Diag_Request 0;
BA_ "GenSigInactiveValue" SG_ 1854 FR_Diag_Request 0;
BA_ "GenSigInvalidValue" SG_ 1854 FR_Diag_Request 0;
BA_ "GenSigSendType" SG_ 1854 FR_Diag_Request 1;
BA_ "GenSigStartValue" SG_ 1854 FR_Diag_Request 0;
BA_ "GenSigTimeoutValue" SG_ 1854 FR_Diag_Request 0;
BA_ "Remark" SG_ 1854 FR_Diag_Request "";
BA_ "EventCommandSignal" SG_ 93 CCU_ADCSoCWakeupRequest 1;
BA_ "GatewayedSignals" SG_ 93 CCU_ADCSoCWakeupRequest 0;
BA_ "GenSigInactiveValue" SG_ 93 CCU_ADCSoCWakeupRequest 0;
BA_ "GenSigInvalidValue" SG_ 93 CCU_ADCSoCWakeupRequest 0;
BA_ "GenSigSendType" SG_ 93 CCU_ADCSoCWakeupRequest 0;
BA_ "GenSigStartValue" SG_ 93 CCU_ADCSoCWakeupRequest 0;
BA_ "GenSigTimeoutValue" SG_ 93 CCU_ADCSoCWakeupRequest 0;
BA_ "Remark" SG_ 93 CCU_ADCSoCWakeupRequest "";
BA_ "EventCommandSignal" SG_ 1007 INS_Status 0;
BA_ "GatewayedSignals" SG_ 1007 INS_Status 0;
BA_ "GenSigInactiveValue" SG_ 1007 INS_Status 0;
BA_ "GenSigInvalidValue" SG_ 1007 INS_Status 0;
BA_ "GenSigSendType" SG_ 1007 INS_Status 1;
BA_ "GenSigStartValue" SG_ 1007 INS_Status 0;
BA_ "GenSigTimeoutValue" SG_ 1007 INS_Status 0;
BA_ "Remark" SG_ 1007 INS_Status "";
BA_ "EventCommandSignal" SG_ 134 Theft_Auth_ADCCode 1;
BA_ "GatewayedSignals" SG_ 134 Theft_Auth_ADCCode 0;
BA_ "GenSigInactiveValue" SG_ 134 Theft_Auth_ADCCode 0;
BA_ "GenSigInvalidValue" SG_ 134 Theft_Auth_ADCCode 0;
BA_ "GenSigSendType" SG_ 134 Theft_Auth_ADCCode 0;
BA_ "GenSigStartValue" SG_ 134 Theft_Auth_ADCCode 0;
BA_ "GenSigTimeoutValue" SG_ 134 Theft_Auth_ADCCode 0;
BA_ "Remark" SG_ 134 Theft_Auth_ADCCode "";
BA_ "EventCommandSignal" SG_ 135 ADC_VIMCode 1;
BA_ "GatewayedSignals" SG_ 135 ADC_VIMCode 0;
BA_ "GenSigInactiveValue" SG_ 135 ADC_VIMCode 0;
BA_ "GenSigInvalidValue" SG_ 135 ADC_VIMCode 0;
BA_ "GenSigSendType" SG_ 135 ADC_VIMCode 0;
BA_ "GenSigStartValue" SG_ 135 ADC_VIMCode 0;
BA_ "GenSigTimeoutValue" SG_ 135 ADC_VIMCode 0;
BA_ "Remark" SG_ 135 ADC_VIMCode "";
BA_ "EventCommandSignal" SG_ 1233 INU_DTCCode 1;
BA_ "GatewayedSignals" SG_ 1233 INU_DTCCode 0;
BA_ "GenSigInactiveValue" SG_ 1233 INU_DTCCode 0;
BA_ "GenSigInvalidValue" SG_ 1233 INU_DTCCode 0;
BA_ "GenSigSendType" SG_ 1233 INU_DTCCode 0;
BA_ "GenSigStartValue" SG_ 1233 INU_DTCCode 0;
BA_ "GenSigTimeoutValue" SG_ 1233 INU_DTCCode 0;
BA_ "Remark" SG_ 1233 INU_DTCCode "";
BA_ "EventCommandSignal" SG_ 1234 RLR_DTCCode 1;
BA_ "GatewayedSignals" SG_ 1234 RLR_DTCCode 0;
BA_ "GenSigInactiveValue" SG_ 1234 RLR_DTCCode 0;
BA_ "GenSigInvalidValue" SG_ 1234 RLR_DTCCode 0;
BA_ "GenSigSendType" SG_ 1234 RLR_DTCCode 0;
BA_ "GenSigStartValue" SG_ 1234 RLR_DTCCode 0;
BA_ "GenSigTimeoutValue" SG_ 1234 RLR_DTCCode 0;
BA_ "Remark" SG_ 1234 RLR_DTCCode "";
BA_ "EventCommandSignal" SG_ 1235 RRR_DTCCode 1;
BA_ "GatewayedSignals" SG_ 1235 RRR_DTCCode 0;
BA_ "GenSigInactiveValue" SG_ 1235 RRR_DTCCode 0;
BA_ "GenSigInvalidValue" SG_ 1235 RRR_DTCCode 0;
BA_ "GenSigSendType" SG_ 1235 RRR_DTCCode 0;
BA_ "GenSigStartValue" SG_ 1235 RRR_DTCCode 0;
BA_ "GenSigTimeoutValue" SG_ 1235 RRR_DTCCode 0;
BA_ "Remark" SG_ 1235 RRR_DTCCode "";
BA_ "EventCommandSignal" SG_ 1657 ADC_MCU_Diag_Request 0;
BA_ "GatewayedSignals" SG_ 1657 ADC_MCU_Diag_Request 0;
BA_ "GenSigInactiveValue" SG_ 1657 ADC_MCU_Diag_Request 0;
BA_ "GenSigInvalidValue" SG_ 1657 ADC_MCU_Diag_Request 0;
BA_ "GenSigSendType" SG_ 1657 ADC_MCU_Diag_Request 1;
BA_ "GenSigStartValue" SG_ 1657 ADC_MCU_Diag_Request 0;
BA_ "GenSigTimeoutValue" SG_ 1657 ADC_MCU_Diag_Request 0;
BA_ "Remark" SG_ 1657 ADC_MCU_Diag_Request "";
BA_ "EventCommandSignal" SG_ 1785 ADC_MCU_Diag_Response 0;
BA_ "GatewayedSignals" SG_ 1785 ADC_MCU_Diag_Response 0;
BA_ "GenSigInactiveValue" SG_ 1785 ADC_MCU_Diag_Response 0;
BA_ "GenSigInvalidValue" SG_ 1785 ADC_MCU_Diag_Response 0;
BA_ "GenSigSendType" SG_ 1785 ADC_MCU_Diag_Response 1;
BA_ "GenSigStartValue" SG_ 1785 ADC_MCU_Diag_Response 0;
BA_ "GenSigTimeoutValue" SG_ 1785 ADC_MCU_Diag_Response 0;
BA_ "Remark" SG_ 1785 ADC_MCU_Diag_Response "";
BA_ "EventCommandSignal" SG_ 1238 FR_DTCCode 1;
BA_ "GatewayedSignals" SG_ 1238 FR_DTCCode 0;
BA_ "GenSigInactiveValue" SG_ 1238 FR_DTCCode 0;
BA_ "GenSigInvalidValue" SG_ 1238 FR_DTCCode 0;
BA_ "GenSigSendType" SG_ 1238 FR_DTCCode 0;
BA_ "GenSigStartValue" SG_ 1238 FR_DTCCode 0;
BA_ "GenSigTimeoutValue" SG_ 1238 FR_DTCCode 0;
BA_ "Remark" SG_ 1238 FR_DTCCode "";
BA_ "EventCommandSignal" SG_ 1024 SYNC_FC_Type 0;
BA_ "GatewayedSignals" SG_ 1024 SYNC_FC_Type 0;
BA_ "GenSigInactiveValue" SG_ 1024 SYNC_FC_Type 0;
BA_ "GenSigInvalidValue" SG_ 1024 SYNC_FC_Type 0;
BA_ "GenSigSendType" SG_ 1024 SYNC_FC_Type 1;
BA_ "GenSigStartValue" SG_ 1024 SYNC_FC_Type 0;
BA_ "GenSigTimeoutValue" SG_ 1024 SYNC_FC_Type 0;
BA_ "Remark" SG_ 1024 SYNC_FC_Type "";
BA_ "EventCommandSignal" SG_ 1024 SYNC_FC_CRC 0;
BA_ "GatewayedSignals" SG_ 1024 SYNC_FC_CRC 0;
BA_ "GenSigInactiveValue" SG_ 1024 SYNC_FC_CRC 0;
BA_ "GenSigInvalidValue" SG_ 1024 SYNC_FC_CRC 0;
BA_ "GenSigSendType" SG_ 1024 SYNC_FC_CRC 1;
BA_ "GenSigStartValue" SG_ 1024 SYNC_FC_CRC 0;
BA_ "GenSigTimeoutValue" SG_ 1024 SYNC_FC_CRC 0;
BA_ "Remark" SG_ 1024 SYNC_FC_CRC "";
BA_ "EventCommandSignal" SG_ 1024 SYNC_FC_Sequencecnt 0;
BA_ "GatewayedSignals" SG_ 1024 SYNC_FC_Sequencecnt 0;
BA_ "GenSigInactiveValue" SG_ 1024 SYNC_FC_Sequencecnt 0;
BA_ "GenSigInvalidValue" SG_ 1024 SYNC_FC_Sequencecnt 0;
BA_ "GenSigSendType" SG_ 1024 SYNC_FC_Sequencecnt 1;
BA_ "GenSigStartValue" SG_ 1024 SYNC_FC_Sequencecnt 0;
BA_ "GenSigTimeoutValue" SG_ 1024 SYNC_FC_Sequencecnt 0;
BA_ "Remark" SG_ 1024 SYNC_FC_Sequencecnt "";
BA_ "EventCommandSignal" SG_ 1024 SYNC_FC_TimeDomain 0;
BA_ "GatewayedSignals" SG_ 1024 SYNC_FC_TimeDomain 0;
BA_ "GenSigInactiveValue" SG_ 1024 SYNC_FC_TimeDomain 0;
BA_ "GenSigInvalidValue" SG_ 1024 SYNC_FC_TimeDomain 0;
BA_ "GenSigSendType" SG_ 1024 SYNC_FC_TimeDomain 1;
BA_ "GenSigStartValue" SG_ 1024 SYNC_FC_TimeDomain 0;
BA_ "GenSigTimeoutValue" SG_ 1024 SYNC_FC_TimeDomain 0;
BA_ "Remark" SG_ 1024 SYNC_FC_TimeDomain "";
BA_ "EventCommandSignal" SG_ 1024 SYNC_FC_OVS 0;
BA_ "GatewayedSignals" SG_ 1024 SYNC_FC_OVS 0;
BA_ "GenSigInactiveValue" SG_ 1024 SYNC_FC_OVS 0;
BA_ "GenSigInvalidValue" SG_ 1024 SYNC_FC_OVS 0;
BA_ "GenSigSendType" SG_ 1024 SYNC_FC_OVS 1;
BA_ "GenSigStartValue" SG_ 1024 SYNC_FC_OVS 0;
BA_ "GenSigTimeoutValue" SG_ 1024 SYNC_FC_OVS 0;
BA_ "Remark" SG_ 1024 SYNC_FC_OVS "";
BA_ "EventCommandSignal" SG_ 1024 SYNC_FC_SGW 0;
BA_ "GatewayedSignals" SG_ 1024 SYNC_FC_SGW 0;
BA_ "GenSigInactiveValue" SG_ 1024 SYNC_FC_SGW 0;
BA_ "GenSigInvalidValue" SG_ 1024 SYNC_FC_SGW 0;
BA_ "GenSigSendType" SG_ 1024 SYNC_FC_SGW 1;
BA_ "GenSigStartValue" SG_ 1024 SYNC_FC_SGW 0;
BA_ "GenSigTimeoutValue" SG_ 1024 SYNC_FC_SGW 0;
BA_ "Remark" SG_ 1024 SYNC_FC_SGW "";
BA_ "EventCommandSignal" SG_ 1024 SYNC_FC_Reserved 0;
BA_ "GatewayedSignals" SG_ 1024 SYNC_FC_Reserved 0;
BA_ "GenSigInactiveValue" SG_ 1024 SYNC_FC_Reserved 0;
BA_ "GenSigInvalidValue" SG_ 1024 SYNC_FC_Reserved 0;
BA_ "GenSigSendType" SG_ 1024 SYNC_FC_Reserved 1;
BA_ "GenSigStartValue" SG_ 1024 SYNC_FC_Reserved 0;
BA_ "GenSigTimeoutValue" SG_ 1024 SYNC_FC_Reserved 0;
BA_ "Remark" SG_ 1024 SYNC_FC_Reserved "";
BA_ "EventCommandSignal" SG_ 1024 SYNC_FC_SyncTime 0;
BA_ "GatewayedSignals" SG_ 1024 SYNC_FC_SyncTime 0;
BA_ "GenSigInactiveValue" SG_ 1024 SYNC_FC_SyncTime 0;
BA_ "GenSigInvalidValue" SG_ 1024 SYNC_FC_SyncTime 0;
BA_ "GenSigSendType" SG_ 1024 SYNC_FC_SyncTime 1;
BA_ "GenSigStartValue" SG_ 1024 SYNC_FC_SyncTime 0;
BA_ "GenSigTimeoutValue" SG_ 1024 SYNC_FC_SyncTime 0;
BA_ "Remark" SG_ 1024 SYNC_FC_SyncTime "";
BA_ "EventCommandSignal" SG_ 120 CCU_SEC_KEY_Defaultencoding 1;
BA_ "GatewayedSignals" SG_ 120 CCU_SEC_KEY_Defaultencoding 0;
BA_ "GenSigInactiveValue" SG_ 120 CCU_SEC_KEY_Defaultencoding 0;
BA_ "GenSigInvalidValue" SG_ 120 CCU_SEC_KEY_Defaultencoding 0;
BA_ "GenSigSendType" SG_ 120 CCU_SEC_KEY_Defaultencoding 0;
BA_ "GenSigStartValue" SG_ 120 CCU_SEC_KEY_Defaultencoding 0;
BA_ "GenSigTimeoutValue" SG_ 120 CCU_SEC_KEY_Defaultencoding 0;
BA_ "Remark" SG_ 120 CCU_SEC_KEY_Defaultencoding "";
BA_ "EventCommandSignal" SG_ 348 CCU_SecSynCounter 1;
BA_ "GatewayedSignals" SG_ 348 CCU_SecSynCounter 0;
BA_ "GenSigInactiveValue" SG_ 348 CCU_SecSynCounter 0;
BA_ "GenSigInvalidValue" SG_ 348 CCU_SecSynCounter 0;
BA_ "GenSigSendType" SG_ 348 CCU_SecSynCounter 0;
BA_ "GenSigStartValue" SG_ 348 CCU_SecSynCounter 0;
BA_ "GenSigTimeoutValue" SG_ 348 CCU_SecSynCounter 0;
BA_ "Remark" SG_ 348 CCU_SecSynCounter "";
BA_ "EventCommandSignal" SG_ 348 CCU_SecSynResetCounter 1;
BA_ "GatewayedSignals" SG_ 348 CCU_SecSynResetCounter 0;
BA_ "GenSigInactiveValue" SG_ 348 CCU_SecSynResetCounter 0;
BA_ "GenSigInvalidValue" SG_ 348 CCU_SecSynResetCounter 0;
BA_ "GenSigSendType" SG_ 348 CCU_SecSynResetCounter 0;
BA_ "GenSigStartValue" SG_ 348 CCU_SecSynResetCounter 0;
BA_ "GenSigTimeoutValue" SG_ 348 CCU_SecSynResetCounter 0;
BA_ "Remark" SG_ 348 CCU_SecSynResetCounter "";
BA_ "EventCommandSignal" SG_ 348 CCU_SecSynMAC_Check 1;
BA_ "GatewayedSignals" SG_ 348 CCU_SecSynMAC_Check 0;
BA_ "GenSigInactiveValue" SG_ 348 CCU_SecSynMAC_Check 0;
BA_ "GenSigInvalidValue" SG_ 348 CCU_SecSynMAC_Check 0;
BA_ "GenSigSendType" SG_ 348 CCU_SecSynMAC_Check 0;
BA_ "GenSigStartValue" SG_ 348 CCU_SecSynMAC_Check 0;
BA_ "GenSigTimeoutValue" SG_ 348 CCU_SecSynMAC_Check 0;
BA_ "Remark" SG_ 348 CCU_SecSynMAC_Check "";
BA_ "EventCommandSignal" SG_ 127 ADC_IMMO 1;
BA_ "GatewayedSignals" SG_ 127 ADC_IMMO 0;
BA_ "GenSigInactiveValue" SG_ 127 ADC_IMMO 0;
BA_ "GenSigInvalidValue" SG_ 127 ADC_IMMO 0;
BA_ "GenSigSendType" SG_ 127 ADC_IMMO 0;
BA_ "GenSigStartValue" SG_ 127 ADC_IMMO 0;
BA_ "GenSigTimeoutValue" SG_ 127 ADC_IMMO 0;
BA_ "Remark" SG_ 127 ADC_IMMO "";
BA_ "EventCommandSignal" SG_ 154 CCU_IMMO 1;
BA_ "GatewayedSignals" SG_ 154 CCU_IMMO 0;
BA_ "GenSigInactiveValue" SG_ 154 CCU_IMMO 0;
BA_ "GenSigInvalidValue" SG_ 154 CCU_IMMO 0;
BA_ "GenSigSendType" SG_ 154 CCU_IMMO 0;
BA_ "GenSigStartValue" SG_ 154 CCU_IMMO 0;
BA_ "GenSigTimeoutValue" SG_ 154 CCU_IMMO 0;
BA_ "Remark" SG_ 154 CCU_IMMO "";
BA_ "EventCommandSignal" SG_ 704 IPS_1_CRC 0;
BA_ "GatewayedSignals" SG_ 704 IPS_1_CRC 0;
BA_ "GenSigInactiveValue" SG_ 704 IPS_1_CRC 0;
BA_ "GenSigInvalidValue" SG_ 704 IPS_1_CRC 0;
BA_ "GenSigSendType" SG_ 704 IPS_1_CRC 1;
BA_ "GenSigStartValue" SG_ 704 IPS_1_CRC 0;
BA_ "GenSigTimeoutValue" SG_ 704 IPS_1_CRC 0;
BA_ "Remark" SG_ 704 IPS_1_CRC "源报文周期20ms，转发后报文周期200ms，转发后的counter值发送会不连续";
BA_ "EventCommandSignal" SG_ 704 IPS_1_Counter 0;
BA_ "GatewayedSignals" SG_ 704 IPS_1_Counter 0;
BA_ "GenSigInactiveValue" SG_ 704 IPS_1_Counter 0;
BA_ "GenSigInvalidValue" SG_ 704 IPS_1_Counter 0;
BA_ "GenSigSendType" SG_ 704 IPS_1_Counter 1;
BA_ "GenSigStartValue" SG_ 704 IPS_1_Counter 0;
BA_ "GenSigTimeoutValue" SG_ 704 IPS_1_Counter 0;
BA_ "Remark" SG_ 704 IPS_1_Counter "源报文周期20ms，转发后报文周期200ms，转发后的counter值发送会不连续";
BA_ "EventCommandSignal" SG_ 704 IPS_DCDCModeSt 0;
BA_ "GatewayedSignals" SG_ 704 IPS_DCDCModeSt 0;
BA_ "GenSigInactiveValue" SG_ 704 IPS_DCDCModeSt 0;
BA_ "GenSigInvalidValue" SG_ 704 IPS_DCDCModeSt 0;
BA_ "GenSigSendType" SG_ 704 IPS_DCDCModeSt 1;
BA_ "GenSigStartValue" SG_ 704 IPS_DCDCModeSt 0;
BA_ "GenSigTimeoutValue" SG_ 704 IPS_DCDCModeSt 0;
BA_ "Remark" SG_ 704 IPS_DCDCModeSt "源报文周期20ms，转发后报文周期200ms，转发后的counter值发送会不连续";
BA_ "EventCommandSignal" SG_ 918 UINM_PADS_1_CRC 0;
BA_ "GatewayedSignals" SG_ 918 UINM_PADS_1_CRC 0;
BA_ "GenSigInactiveValue" SG_ 918 UINM_PADS_1_CRC 0;
BA_ "GenSigInvalidValue" SG_ 918 UINM_PADS_1_CRC 0;
BA_ "GenSigSendType" SG_ 918 UINM_PADS_1_CRC 1;
BA_ "GenSigStartValue" SG_ 918 UINM_PADS_1_CRC 0;
BA_ "GenSigTimeoutValue" SG_ 918 UINM_PADS_1_CRC 0;
BA_ "Remark" SG_ 918 UINM_PADS_1_CRC "";
BA_ "EventCommandSignal" SG_ 918 UINM_PADS_1_Counter 0;
BA_ "GatewayedSignals" SG_ 918 UINM_PADS_1_Counter 0;
BA_ "GenSigInactiveValue" SG_ 918 UINM_PADS_1_Counter 0;
BA_ "GenSigInvalidValue" SG_ 918 UINM_PADS_1_Counter 0;
BA_ "GenSigSendType" SG_ 918 UINM_PADS_1_Counter 1;
BA_ "GenSigStartValue" SG_ 918 UINM_PADS_1_Counter 0;
BA_ "GenSigTimeoutValue" SG_ 918 UINM_PADS_1_Counter 0;
BA_ "Remark" SG_ 918 UINM_PADS_1_Counter "";
BA_ "EventCommandSignal" SG_ 918 UINM_PADS_ResponseErr 0;
BA_ "GatewayedSignals" SG_ 918 UINM_PADS_ResponseErr 0;
BA_ "GenSigInactiveValue" SG_ 918 UINM_PADS_ResponseErr 0;
BA_ "GenSigInvalidValue" SG_ 918 UINM_PADS_ResponseErr 0;
BA_ "GenSigSendType" SG_ 918 UINM_PADS_ResponseErr 1;
BA_ "GenSigStartValue" SG_ 918 UINM_PADS_ResponseErr 0;
BA_ "GenSigTimeoutValue" SG_ 918 UINM_PADS_ResponseErr 0;
BA_ "Remark" SG_ 918 UINM_PADS_ResponseErr "";
BA_ "EventCommandSignal" SG_ 918 UINM_PADS_CustomSWSt 0;
BA_ "GatewayedSignals" SG_ 918 UINM_PADS_CustomSWSt 0;
BA_ "GenSigInactiveValue" SG_ 918 UINM_PADS_CustomSWSt 0;
BA_ "GenSigInvalidValue" SG_ 918 UINM_PADS_CustomSWSt 0;
BA_ "GenSigSendType" SG_ 918 UINM_PADS_CustomSWSt 1;
BA_ "GenSigStartValue" SG_ 918 UINM_PADS_CustomSWSt 0;
BA_ "GenSigTimeoutValue" SG_ 918 UINM_PADS_CustomSWSt 0;
BA_ "Remark" SG_ 918 UINM_PADS_CustomSWSt "";
BA_ "EventCommandSignal" SG_ 918 UINM_PADS_CustomSWStVD 0;
BA_ "GatewayedSignals" SG_ 918 UINM_PADS_CustomSWStVD 0;
BA_ "GenSigInactiveValue" SG_ 918 UINM_PADS_CustomSWStVD 0;
BA_ "GenSigInvalidValue" SG_ 918 UINM_PADS_CustomSWStVD 0;
BA_ "GenSigSendType" SG_ 918 UINM_PADS_CustomSWStVD 1;
BA_ "GenSigStartValue" SG_ 918 UINM_PADS_CustomSWStVD 0;
BA_ "GenSigTimeoutValue" SG_ 918 UINM_PADS_CustomSWStVD 0;
BA_ "Remark" SG_ 918 UINM_PADS_CustomSWStVD "";
BA_ "EventCommandSignal" SG_ 918 UINM_PADS_CustomSWstuck 0;
BA_ "GatewayedSignals" SG_ 918 UINM_PADS_CustomSWstuck 0;
BA_ "GenSigInactiveValue" SG_ 918 UINM_PADS_CustomSWstuck 0;
BA_ "GenSigInvalidValue" SG_ 918 UINM_PADS_CustomSWstuck 0;
BA_ "GenSigSendType" SG_ 918 UINM_PADS_CustomSWstuck 1;
BA_ "GenSigStartValue" SG_ 918 UINM_PADS_CustomSWstuck 0;
BA_ "GenSigTimeoutValue" SG_ 918 UINM_PADS_CustomSWstuck 0;
BA_ "Remark" SG_ 918 UINM_PADS_CustomSWstuck "";
BA_ "EventCommandSignal" SG_ 918 UINM_PADS_IDC_PlaySWSt 0;
BA_ "GatewayedSignals" SG_ 918 UINM_PADS_IDC_PlaySWSt 0;
BA_ "GenSigInactiveValue" SG_ 918 UINM_PADS_IDC_PlaySWSt 0;
BA_ "GenSigInvalidValue" SG_ 918 UINM_PADS_IDC_PlaySWSt 0;
BA_ "GenSigSendType" SG_ 918 UINM_PADS_IDC_PlaySWSt 1;
BA_ "GenSigStartValue" SG_ 918 UINM_PADS_IDC_PlaySWSt 0;
BA_ "GenSigTimeoutValue" SG_ 918 UINM_PADS_IDC_PlaySWSt 0;
BA_ "Remark" SG_ 918 UINM_PADS_IDC_PlaySWSt "";
BA_ "EventCommandSignal" SG_ 918 UINM_PADS_IDC_PlaySWStVD 0;
BA_ "GatewayedSignals" SG_ 918 UINM_PADS_IDC_PlaySWStVD 0;
BA_ "GenSigInactiveValue" SG_ 918 UINM_PADS_IDC_PlaySWStVD 0;
BA_ "GenSigInvalidValue" SG_ 918 UINM_PADS_IDC_PlaySWStVD 0;
BA_ "GenSigSendType" SG_ 918 UINM_PADS_IDC_PlaySWStVD 1;
BA_ "GenSigStartValue" SG_ 918 UINM_PADS_IDC_PlaySWStVD 0;
BA_ "GenSigTimeoutValue" SG_ 918 UINM_PADS_IDC_PlaySWStVD 0;
BA_ "Remark" SG_ 918 UINM_PADS_IDC_PlaySWStVD "";
BA_ "EventCommandSignal" SG_ 918 UINM_PADS_CruSetSpeedRollerRotatedDir 0;
BA_ "GatewayedSignals" SG_ 918 UINM_PADS_CruSetSpeedRollerRotatedDir 0;
BA_ "GenSigInactiveValue" SG_ 918 UINM_PADS_CruSetSpeedRollerRotatedDir 0;
BA_ "GenSigInvalidValue" SG_ 918 UINM_PADS_CruSetSpeedRollerRotatedDir 0;
BA_ "GenSigSendType" SG_ 918 UINM_PADS_CruSetSpeedRollerRotatedDir 1;
BA_ "GenSigStartValue" SG_ 918 UINM_PADS_CruSetSpeedRollerRotatedDir 0;
BA_ "GenSigTimeoutValue" SG_ 918 UINM_PADS_CruSetSpeedRollerRotatedDir 0;
BA_ "Remark" SG_ 918 UINM_PADS_CruSetSpeedRollerRotatedDir "";
BA_ "EventCommandSignal" SG_ 918 UINM_PADS_FolDistIncSWSt 0;
BA_ "GatewayedSignals" SG_ 918 UINM_PADS_FolDistIncSWSt 0;
BA_ "GenSigInactiveValue" SG_ 918 UINM_PADS_FolDistIncSWSt 0;
BA_ "GenSigInvalidValue" SG_ 918 UINM_PADS_FolDistIncSWSt 0;
BA_ "GenSigSendType" SG_ 918 UINM_PADS_FolDistIncSWSt 1;
BA_ "GenSigStartValue" SG_ 918 UINM_PADS_FolDistIncSWSt 0;
BA_ "GenSigTimeoutValue" SG_ 918 UINM_PADS_FolDistIncSWSt 0;
BA_ "Remark" SG_ 918 UINM_PADS_FolDistIncSWSt "";
BA_ "EventCommandSignal" SG_ 918 UINM_PADS_CruSetSpeedRollerSt 0;
BA_ "GatewayedSignals" SG_ 918 UINM_PADS_CruSetSpeedRollerSt 0;
BA_ "GenSigInactiveValue" SG_ 918 UINM_PADS_CruSetSpeedRollerSt 0;
BA_ "GenSigInvalidValue" SG_ 918 UINM_PADS_CruSetSpeedRollerSt 0;
BA_ "GenSigSendType" SG_ 918 UINM_PADS_CruSetSpeedRollerSt 1;
BA_ "GenSigStartValue" SG_ 918 UINM_PADS_CruSetSpeedRollerSt 0;
BA_ "GenSigTimeoutValue" SG_ 918 UINM_PADS_CruSetSpeedRollerSt 0;
BA_ "Remark" SG_ 918 UINM_PADS_CruSetSpeedRollerSt "";
BA_ "EventCommandSignal" SG_ 918 UINM_PADS_FolDistIncSWStVD 0;
BA_ "GatewayedSignals" SG_ 918 UINM_PADS_FolDistIncSWStVD 0;
BA_ "GenSigInactiveValue" SG_ 918 UINM_PADS_FolDistIncSWStVD 0;
BA_ "GenSigInvalidValue" SG_ 918 UINM_PADS_FolDistIncSWStVD 0;
BA_ "GenSigSendType" SG_ 918 UINM_PADS_FolDistIncSWStVD 1;
BA_ "GenSigStartValue" SG_ 918 UINM_PADS_FolDistIncSWStVD 0;
BA_ "GenSigTimeoutValue" SG_ 918 UINM_PADS_FolDistIncSWStVD 0;
BA_ "Remark" SG_ 918 UINM_PADS_FolDistIncSWStVD "";
BA_ "EventCommandSignal" SG_ 918 UINM_PADS_FolDistIncSWStuckSt 0;
BA_ "GatewayedSignals" SG_ 918 UINM_PADS_FolDistIncSWStuckSt 0;
BA_ "GenSigInactiveValue" SG_ 918 UINM_PADS_FolDistIncSWStuckSt 0;
BA_ "GenSigInvalidValue" SG_ 918 UINM_PADS_FolDistIncSWStuckSt 0;
BA_ "GenSigSendType" SG_ 918 UINM_PADS_FolDistIncSWStuckSt 1;
BA_ "GenSigStartValue" SG_ 918 UINM_PADS_FolDistIncSWStuckSt 0;
BA_ "GenSigTimeoutValue" SG_ 918 UINM_PADS_FolDistIncSWStuckSt 0;
BA_ "Remark" SG_ 918 UINM_PADS_FolDistIncSWStuckSt "";
BA_ "EventCommandSignal" SG_ 918 UINM_PADS_FolDistDecSWStVD 0;
BA_ "GatewayedSignals" SG_ 918 UINM_PADS_FolDistDecSWStVD 0;
BA_ "GenSigInactiveValue" SG_ 918 UINM_PADS_FolDistDecSWStVD 0;
BA_ "GenSigInvalidValue" SG_ 918 UINM_PADS_FolDistDecSWStVD 0;
BA_ "GenSigSendType" SG_ 918 UINM_PADS_FolDistDecSWStVD 1;
BA_ "GenSigStartValue" SG_ 918 UINM_PADS_FolDistDecSWStVD 0;
BA_ "GenSigTimeoutValue" SG_ 918 UINM_PADS_FolDistDecSWStVD 0;
BA_ "Remark" SG_ 918 UINM_PADS_FolDistDecSWStVD "";
BA_ "EventCommandSignal" SG_ 918 UINM_PADS_FolDistDecSWStuckSt 0;
BA_ "GatewayedSignals" SG_ 918 UINM_PADS_FolDistDecSWStuckSt 0;
BA_ "GenSigInactiveValue" SG_ 918 UINM_PADS_FolDistDecSWStuckSt 0;
BA_ "GenSigInvalidValue" SG_ 918 UINM_PADS_FolDistDecSWStuckSt 0;
BA_ "GenSigSendType" SG_ 918 UINM_PADS_FolDistDecSWStuckSt 1;
BA_ "GenSigStartValue" SG_ 918 UINM_PADS_FolDistDecSWStuckSt 0;
BA_ "GenSigTimeoutValue" SG_ 918 UINM_PADS_FolDistDecSWStuckSt 0;
BA_ "Remark" SG_ 918 UINM_PADS_FolDistDecSWStuckSt "";
BA_ "EventCommandSignal" SG_ 918 UINM_PADS_OKSWSt 0;
BA_ "GatewayedSignals" SG_ 918 UINM_PADS_OKSWSt 0;
BA_ "GenSigInactiveValue" SG_ 918 UINM_PADS_OKSWSt 0;
BA_ "GenSigInvalidValue" SG_ 918 UINM_PADS_OKSWSt 0;
BA_ "GenSigSendType" SG_ 918 UINM_PADS_OKSWSt 1;
BA_ "GenSigStartValue" SG_ 918 UINM_PADS_OKSWSt 0;
BA_ "GenSigTimeoutValue" SG_ 918 UINM_PADS_OKSWSt 0;
BA_ "Remark" SG_ 918 UINM_PADS_OKSWSt "";
BA_ "EventCommandSignal" SG_ 918 UINM_PADS_OKSWStVD 0;
BA_ "GatewayedSignals" SG_ 918 UINM_PADS_OKSWStVD 0;
BA_ "GenSigInactiveValue" SG_ 918 UINM_PADS_OKSWStVD 0;
BA_ "GenSigInvalidValue" SG_ 918 UINM_PADS_OKSWStVD 0;
BA_ "GenSigSendType" SG_ 918 UINM_PADS_OKSWStVD 1;
BA_ "GenSigStartValue" SG_ 918 UINM_PADS_OKSWStVD 0;
BA_ "GenSigTimeoutValue" SG_ 918 UINM_PADS_OKSWStVD 0;
BA_ "Remark" SG_ 918 UINM_PADS_OKSWStVD "";
BA_ "EventCommandSignal" SG_ 918 UINM_PADS_OKSWStuckSt 0;
BA_ "GatewayedSignals" SG_ 918 UINM_PADS_OKSWStuckSt 0;
BA_ "GenSigInactiveValue" SG_ 918 UINM_PADS_OKSWStuckSt 0;
BA_ "GenSigInvalidValue" SG_ 918 UINM_PADS_OKSWStuckSt 0;
BA_ "GenSigSendType" SG_ 918 UINM_PADS_OKSWStuckSt 1;
BA_ "GenSigStartValue" SG_ 918 UINM_PADS_OKSWStuckSt 0;
BA_ "GenSigTimeoutValue" SG_ 918 UINM_PADS_OKSWStuckSt 0;
BA_ "Remark" SG_ 918 UINM_PADS_OKSWStuckSt "";
BA_ "EventCommandSignal" SG_ 918 UINM_PADS_CruSetSpeedRollerVD 0;
BA_ "GatewayedSignals" SG_ 918 UINM_PADS_CruSetSpeedRollerVD 0;
BA_ "GenSigInactiveValue" SG_ 918 UINM_PADS_CruSetSpeedRollerVD 0;
BA_ "GenSigInvalidValue" SG_ 918 UINM_PADS_CruSetSpeedRollerVD 0;
BA_ "GenSigSendType" SG_ 918 UINM_PADS_CruSetSpeedRollerVD 1;
BA_ "GenSigStartValue" SG_ 918 UINM_PADS_CruSetSpeedRollerVD 0;
BA_ "GenSigTimeoutValue" SG_ 918 UINM_PADS_CruSetSpeedRollerVD 0;
BA_ "Remark" SG_ 918 UINM_PADS_CruSetSpeedRollerVD "";
BA_ "EventCommandSignal" SG_ 918 UINM_PADS_FolDistDecSWSt 0;
BA_ "GatewayedSignals" SG_ 918 UINM_PADS_FolDistDecSWSt 0;
BA_ "GenSigInactiveValue" SG_ 918 UINM_PADS_FolDistDecSWSt 0;
BA_ "GenSigInvalidValue" SG_ 918 UINM_PADS_FolDistDecSWSt 0;
BA_ "GenSigSendType" SG_ 918 UINM_PADS_FolDistDecSWSt 1;
BA_ "GenSigStartValue" SG_ 918 UINM_PADS_FolDistDecSWSt 0;
BA_ "GenSigTimeoutValue" SG_ 918 UINM_PADS_FolDistDecSWSt 0;
BA_ "Remark" SG_ 918 UINM_PADS_FolDistDecSWSt "";
BA_ "EventCommandSignal" SG_ 918 UINM_PADS_CruSWSt 0;
BA_ "GatewayedSignals" SG_ 918 UINM_PADS_CruSWSt 0;
BA_ "GenSigInactiveValue" SG_ 918 UINM_PADS_CruSWSt 0;
BA_ "GenSigInvalidValue" SG_ 918 UINM_PADS_CruSWSt 0;
BA_ "GenSigSendType" SG_ 918 UINM_PADS_CruSWSt 1;
BA_ "GenSigStartValue" SG_ 918 UINM_PADS_CruSWSt 0;
BA_ "GenSigTimeoutValue" SG_ 918 UINM_PADS_CruSWSt 0;
BA_ "Remark" SG_ 918 UINM_PADS_CruSWSt "";
BA_ "EventCommandSignal" SG_ 918 UINM_PADS_CruSWStVD 0;
BA_ "GatewayedSignals" SG_ 918 UINM_PADS_CruSWStVD 0;
BA_ "GenSigInactiveValue" SG_ 918 UINM_PADS_CruSWStVD 0;
BA_ "GenSigInvalidValue" SG_ 918 UINM_PADS_CruSWStVD 0;
BA_ "GenSigSendType" SG_ 918 UINM_PADS_CruSWStVD 1;
BA_ "GenSigStartValue" SG_ 918 UINM_PADS_CruSWStVD 0;
BA_ "GenSigTimeoutValue" SG_ 918 UINM_PADS_CruSWStVD 0;
BA_ "Remark" SG_ 918 UINM_PADS_CruSWStVD "";
BA_ "EventCommandSignal" SG_ 918 UINM_PADS_CruSWStuckSt 0;
BA_ "GatewayedSignals" SG_ 918 UINM_PADS_CruSWStuckSt 0;
BA_ "GenSigInactiveValue" SG_ 918 UINM_PADS_CruSWStuckSt 0;
BA_ "GenSigInvalidValue" SG_ 918 UINM_PADS_CruSWStuckSt 0;
BA_ "GenSigSendType" SG_ 918 UINM_PADS_CruSWStuckSt 1;
BA_ "GenSigStartValue" SG_ 918 UINM_PADS_CruSWStuckSt 0;
BA_ "GenSigTimeoutValue" SG_ 918 UINM_PADS_CruSWStuckSt 0;
BA_ "Remark" SG_ 918 UINM_PADS_CruSWStuckSt "";
BA_ "EventCommandSignal" SG_ 918 UINM_PADS_CruSpeedDecSWSt 0;
BA_ "GatewayedSignals" SG_ 918 UINM_PADS_CruSpeedDecSWSt 0;
BA_ "GenSigInactiveValue" SG_ 918 UINM_PADS_CruSpeedDecSWSt 0;
BA_ "GenSigInvalidValue" SG_ 918 UINM_PADS_CruSpeedDecSWSt 0;
BA_ "GenSigSendType" SG_ 918 UINM_PADS_CruSpeedDecSWSt 1;
BA_ "GenSigStartValue" SG_ 918 UINM_PADS_CruSpeedDecSWSt 0;
BA_ "GenSigTimeoutValue" SG_ 918 UINM_PADS_CruSpeedDecSWSt 0;
BA_ "Remark" SG_ 918 UINM_PADS_CruSpeedDecSWSt "";
BA_ "EventCommandSignal" SG_ 918 UINM_PADS_CruSpeedDecSWStVD 0;
BA_ "GatewayedSignals" SG_ 918 UINM_PADS_CruSpeedDecSWStVD 0;
BA_ "GenSigInactiveValue" SG_ 918 UINM_PADS_CruSpeedDecSWStVD 0;
BA_ "GenSigInvalidValue" SG_ 918 UINM_PADS_CruSpeedDecSWStVD 0;
BA_ "GenSigSendType" SG_ 918 UINM_PADS_CruSpeedDecSWStVD 1;
BA_ "GenSigStartValue" SG_ 918 UINM_PADS_CruSpeedDecSWStVD 0;
BA_ "GenSigTimeoutValue" SG_ 918 UINM_PADS_CruSpeedDecSWStVD 0;
BA_ "Remark" SG_ 918 UINM_PADS_CruSpeedDecSWStVD "";
BA_ "EventCommandSignal" SG_ 918 UINM_PADS_CruSpeedDecSWStuckSt 0;
BA_ "GatewayedSignals" SG_ 918 UINM_PADS_CruSpeedDecSWStuckSt 0;
BA_ "GenSigInactiveValue" SG_ 918 UINM_PADS_CruSpeedDecSWStuckSt 0;
BA_ "GenSigInvalidValue" SG_ 918 UINM_PADS_CruSpeedDecSWStuckSt 0;
BA_ "GenSigSendType" SG_ 918 UINM_PADS_CruSpeedDecSWStuckSt 1;
BA_ "GenSigStartValue" SG_ 918 UINM_PADS_CruSpeedDecSWStuckSt 0;
BA_ "GenSigTimeoutValue" SG_ 918 UINM_PADS_CruSpeedDecSWStuckSt 0;
BA_ "Remark" SG_ 918 UINM_PADS_CruSpeedDecSWStuckSt "";
BA_ "EventCommandSignal" SG_ 918 UINM_PADS_CruResumeSpeedIncSWSt 0;
BA_ "GatewayedSignals" SG_ 918 UINM_PADS_CruResumeSpeedIncSWSt 0;
BA_ "GenSigInactiveValue" SG_ 918 UINM_PADS_CruResumeSpeedIncSWSt 0;
BA_ "GenSigInvalidValue" SG_ 918 UINM_PADS_CruResumeSpeedIncSWSt 0;
BA_ "GenSigSendType" SG_ 918 UINM_PADS_CruResumeSpeedIncSWSt 1;
BA_ "GenSigStartValue" SG_ 918 UINM_PADS_CruResumeSpeedIncSWSt 0;
BA_ "GenSigTimeoutValue" SG_ 918 UINM_PADS_CruResumeSpeedIncSWSt 0;
BA_ "Remark" SG_ 918 UINM_PADS_CruResumeSpeedIncSWSt "";
BA_ "EventCommandSignal" SG_ 918 UINM_PADS_CruResumeSpeedIncSWStVD 0;
BA_ "GatewayedSignals" SG_ 918 UINM_PADS_CruResumeSpeedIncSWStVD 0;
BA_ "GenSigInactiveValue" SG_ 918 UINM_PADS_CruResumeSpeedIncSWStVD 0;
BA_ "GenSigInvalidValue" SG_ 918 UINM_PADS_CruResumeSpeedIncSWStVD 0;
BA_ "GenSigSendType" SG_ 918 UINM_PADS_CruResumeSpeedIncSWStVD 1;
BA_ "GenSigStartValue" SG_ 918 UINM_PADS_CruResumeSpeedIncSWStVD 0;
BA_ "GenSigTimeoutValue" SG_ 918 UINM_PADS_CruResumeSpeedIncSWStVD 0;
BA_ "Remark" SG_ 918 UINM_PADS_CruResumeSpeedIncSWStVD "";
BA_ "EventCommandSignal" SG_ 918 UINM_PADS_CruResumeSpeedIncSWStuckSt 0;
BA_ "GatewayedSignals" SG_ 918 UINM_PADS_CruResumeSpeedIncSWStuckSt 0;
BA_ "GenSigInactiveValue" SG_ 918 UINM_PADS_CruResumeSpeedIncSWStuckSt 0;
BA_ "GenSigInvalidValue" SG_ 918 UINM_PADS_CruResumeSpeedIncSWStuckSt 0;
BA_ "GenSigSendType" SG_ 918 UINM_PADS_CruResumeSpeedIncSWStuckSt 1;
BA_ "GenSigStartValue" SG_ 918 UINM_PADS_CruResumeSpeedIncSWStuckSt 0;
BA_ "GenSigTimeoutValue" SG_ 918 UINM_PADS_CruResumeSpeedIncSWStuckSt 0;
BA_ "Remark" SG_ 918 UINM_PADS_CruResumeSpeedIncSWStuckSt "";
BA_ "EventCommandSignal" SG_ 918 UINM_PADS_CruTJAICASWSt 0;
BA_ "GatewayedSignals" SG_ 918 UINM_PADS_CruTJAICASWSt 0;
BA_ "GenSigInactiveValue" SG_ 918 UINM_PADS_CruTJAICASWSt 0;
BA_ "GenSigInvalidValue" SG_ 918 UINM_PADS_CruTJAICASWSt 0;
BA_ "GenSigSendType" SG_ 918 UINM_PADS_CruTJAICASWSt 1;
BA_ "GenSigStartValue" SG_ 918 UINM_PADS_CruTJAICASWSt 0;
BA_ "GenSigTimeoutValue" SG_ 918 UINM_PADS_CruTJAICASWSt 0;
BA_ "Remark" SG_ 918 UINM_PADS_CruTJAICASWSt "";
BA_ "EventCommandSignal" SG_ 918 UINM_PADS_CruTJAICASWStVD 0;
BA_ "GatewayedSignals" SG_ 918 UINM_PADS_CruTJAICASWStVD 0;
BA_ "GenSigInactiveValue" SG_ 918 UINM_PADS_CruTJAICASWStVD 0;
BA_ "GenSigInvalidValue" SG_ 918 UINM_PADS_CruTJAICASWStVD 0;
BA_ "GenSigSendType" SG_ 918 UINM_PADS_CruTJAICASWStVD 1;
BA_ "GenSigStartValue" SG_ 918 UINM_PADS_CruTJAICASWStVD 0;
BA_ "GenSigTimeoutValue" SG_ 918 UINM_PADS_CruTJAICASWStVD 0;
BA_ "Remark" SG_ 918 UINM_PADS_CruTJAICASWStVD "";
BA_ "EventCommandSignal" SG_ 918 UINM_PADS_CruTJAICASWStuckSt 0;
BA_ "GatewayedSignals" SG_ 918 UINM_PADS_CruTJAICASWStuckSt 0;
BA_ "GenSigInactiveValue" SG_ 918 UINM_PADS_CruTJAICASWStuckSt 0;
BA_ "GenSigInvalidValue" SG_ 918 UINM_PADS_CruTJAICASWStuckSt 0;
BA_ "GenSigSendType" SG_ 918 UINM_PADS_CruTJAICASWStuckSt 1;
BA_ "GenSigStartValue" SG_ 918 UINM_PADS_CruTJAICASWStuckSt 0;
BA_ "GenSigTimeoutValue" SG_ 918 UINM_PADS_CruTJAICASWStuckSt 0;
BA_ "Remark" SG_ 918 UINM_PADS_CruTJAICASWStuckSt "";
BA_ "EventCommandSignal" SG_ 918 UINM_PADS_Custom2SWSt 0;
BA_ "GatewayedSignals" SG_ 918 UINM_PADS_Custom2SWSt 0;
BA_ "GenSigInactiveValue" SG_ 918 UINM_PADS_Custom2SWSt 0;
BA_ "GenSigInvalidValue" SG_ 918 UINM_PADS_Custom2SWSt 0;
BA_ "GenSigSendType" SG_ 918 UINM_PADS_Custom2SWSt 1;
BA_ "GenSigStartValue" SG_ 918 UINM_PADS_Custom2SWSt 0;
BA_ "GenSigTimeoutValue" SG_ 918 UINM_PADS_Custom2SWSt 0;
BA_ "Remark" SG_ 918 UINM_PADS_Custom2SWSt "";
BA_ "EventCommandSignal" SG_ 918 UINM_PADS_Custom2SWStVD 0;
BA_ "GatewayedSignals" SG_ 918 UINM_PADS_Custom2SWStVD 0;
BA_ "GenSigInactiveValue" SG_ 918 UINM_PADS_Custom2SWStVD 0;
BA_ "GenSigInvalidValue" SG_ 918 UINM_PADS_Custom2SWStVD 0;
BA_ "GenSigSendType" SG_ 918 UINM_PADS_Custom2SWStVD 1;
BA_ "GenSigStartValue" SG_ 918 UINM_PADS_Custom2SWStVD 0;
BA_ "GenSigTimeoutValue" SG_ 918 UINM_PADS_Custom2SWStVD 0;
BA_ "Remark" SG_ 918 UINM_PADS_Custom2SWStVD "";
BA_ "EventCommandSignal" SG_ 918 UINM_PADS_Custom2SWStuckSt 0;
BA_ "GatewayedSignals" SG_ 918 UINM_PADS_Custom2SWStuckSt 0;
BA_ "GenSigInactiveValue" SG_ 918 UINM_PADS_Custom2SWStuckSt 0;
BA_ "GenSigInvalidValue" SG_ 918 UINM_PADS_Custom2SWStuckSt 0;
BA_ "GenSigSendType" SG_ 918 UINM_PADS_Custom2SWStuckSt 1;
BA_ "GenSigStartValue" SG_ 918 UINM_PADS_Custom2SWStuckSt 0;
BA_ "GenSigTimeoutValue" SG_ 918 UINM_PADS_Custom2SWStuckSt 0;
BA_ "Remark" SG_ 918 UINM_PADS_Custom2SWStuckSt "";
BA_ "EventCommandSignal" SG_ 918 UINM_PADS_ACCSWSt 0;
BA_ "GatewayedSignals" SG_ 918 UINM_PADS_ACCSWSt 0;
BA_ "GenSigInactiveValue" SG_ 918 UINM_PADS_ACCSWSt 0;
BA_ "GenSigInvalidValue" SG_ 918 UINM_PADS_ACCSWSt 0;
BA_ "GenSigSendType" SG_ 918 UINM_PADS_ACCSWSt 1;
BA_ "GenSigStartValue" SG_ 918 UINM_PADS_ACCSWSt 0;
BA_ "GenSigTimeoutValue" SG_ 918 UINM_PADS_ACCSWSt 0;
BA_ "Remark" SG_ 918 UINM_PADS_ACCSWSt "";
BA_ "EventCommandSignal" SG_ 918 UINM_PADS_VoltageFaultSt 0;
BA_ "GatewayedSignals" SG_ 918 UINM_PADS_VoltageFaultSt 0;
BA_ "GenSigInactiveValue" SG_ 918 UINM_PADS_VoltageFaultSt 0;
BA_ "GenSigInvalidValue" SG_ 918 UINM_PADS_VoltageFaultSt 0;
BA_ "GenSigSendType" SG_ 918 UINM_PADS_VoltageFaultSt 1;
BA_ "GenSigStartValue" SG_ 918 UINM_PADS_VoltageFaultSt 0;
BA_ "GenSigTimeoutValue" SG_ 918 UINM_PADS_VoltageFaultSt 0;
BA_ "Remark" SG_ 918 UINM_PADS_VoltageFaultSt "";
BA_ "EventCommandSignal" SG_ 957 HOD_1_CRC 0;
BA_ "GatewayedSignals" SG_ 957 HOD_1_CRC 0;
BA_ "GenSigInactiveValue" SG_ 957 HOD_1_CRC 0;
BA_ "GenSigInvalidValue" SG_ 957 HOD_1_CRC 0;
BA_ "GenSigSendType" SG_ 957 HOD_1_CRC 1;
BA_ "GenSigStartValue" SG_ 957 HOD_1_CRC 0;
BA_ "GenSigTimeoutValue" SG_ 957 HOD_1_CRC 0;
BA_ "Remark" SG_ 957 HOD_1_CRC "";
BA_ "EventCommandSignal" SG_ 957 HOD_1_Counter 0;
BA_ "GatewayedSignals" SG_ 957 HOD_1_Counter 0;
BA_ "GenSigInactiveValue" SG_ 957 HOD_1_Counter 0;
BA_ "GenSigInvalidValue" SG_ 957 HOD_1_Counter 0;
BA_ "GenSigSendType" SG_ 957 HOD_1_Counter 1;
BA_ "GenSigStartValue" SG_ 957 HOD_1_Counter 0;
BA_ "GenSigTimeoutValue" SG_ 957 HOD_1_Counter 0;
BA_ "Remark" SG_ 957 HOD_1_Counter "";
BA_ "EventCommandSignal" SG_ 957 HOD_St 0;
BA_ "GatewayedSignals" SG_ 957 HOD_St 0;
BA_ "GenSigInactiveValue" SG_ 957 HOD_St 0;
BA_ "GenSigInvalidValue" SG_ 957 HOD_St 0;
BA_ "GenSigSendType" SG_ 957 HOD_St 1;
BA_ "GenSigStartValue" SG_ 957 HOD_St 0;
BA_ "GenSigTimeoutValue" SG_ 957 HOD_St 0;
BA_ "Remark" SG_ 957 HOD_St "";
BA_ "EventCommandSignal" SG_ 957 HOD_TouchZone1 0;
BA_ "GatewayedSignals" SG_ 957 HOD_TouchZone1 0;
BA_ "GenSigInactiveValue" SG_ 957 HOD_TouchZone1 0;
BA_ "GenSigInvalidValue" SG_ 957 HOD_TouchZone1 0;
BA_ "GenSigSendType" SG_ 957 HOD_TouchZone1 1;
BA_ "GenSigStartValue" SG_ 957 HOD_TouchZone1 0;
BA_ "GenSigTimeoutValue" SG_ 957 HOD_TouchZone1 0;
BA_ "Remark" SG_ 957 HOD_TouchZone1 "";
BA_ "EventCommandSignal" SG_ 957 HOD_TouchZone2 0;
BA_ "GatewayedSignals" SG_ 957 HOD_TouchZone2 0;
BA_ "GenSigInactiveValue" SG_ 957 HOD_TouchZone2 0;
BA_ "GenSigInvalidValue" SG_ 957 HOD_TouchZone2 0;
BA_ "GenSigSendType" SG_ 957 HOD_TouchZone2 1;
BA_ "GenSigStartValue" SG_ 957 HOD_TouchZone2 0;
BA_ "GenSigTimeoutValue" SG_ 957 HOD_TouchZone2 0;
BA_ "Remark" SG_ 957 HOD_TouchZone2 "";
BA_ "EventCommandSignal" SG_ 957 HOD_TouchZone3 0;
BA_ "GatewayedSignals" SG_ 957 HOD_TouchZone3 0;
BA_ "GenSigInactiveValue" SG_ 957 HOD_TouchZone3 0;
BA_ "GenSigInvalidValue" SG_ 957 HOD_TouchZone3 0;
BA_ "GenSigSendType" SG_ 957 HOD_TouchZone3 1;
BA_ "GenSigStartValue" SG_ 957 HOD_TouchZone3 0;
BA_ "GenSigTimeoutValue" SG_ 957 HOD_TouchZone3 0;
BA_ "Remark" SG_ 957 HOD_TouchZone3 "";
BA_ "EventCommandSignal" SG_ 957 HOD_HeatingSt 0;
BA_ "GatewayedSignals" SG_ 957 HOD_HeatingSt 0;
BA_ "GenSigInactiveValue" SG_ 957 HOD_HeatingSt 0;
BA_ "GenSigInvalidValue" SG_ 957 HOD_HeatingSt 0;
BA_ "GenSigSendType" SG_ 957 HOD_HeatingSt 1;
BA_ "GenSigStartValue" SG_ 957 HOD_HeatingSt 0;
BA_ "GenSigTimeoutValue" SG_ 957 HOD_HeatingSt 0;
BA_ "Remark" SG_ 957 HOD_HeatingSt "";
BA_ "EventCommandSignal" SG_ 957 HOD_CalibrationSt 0;
BA_ "GatewayedSignals" SG_ 957 HOD_CalibrationSt 0;
BA_ "GenSigInactiveValue" SG_ 957 HOD_CalibrationSt 0;
BA_ "GenSigInvalidValue" SG_ 957 HOD_CalibrationSt 0;
BA_ "GenSigSendType" SG_ 957 HOD_CalibrationSt 1;
BA_ "GenSigStartValue" SG_ 957 HOD_CalibrationSt 0;
BA_ "GenSigTimeoutValue" SG_ 957 HOD_CalibrationSt 0;
BA_ "Remark" SG_ 957 HOD_CalibrationSt "";
BA_ "EventCommandSignal" SG_ 957 HOD_LINComFault 0;
BA_ "GatewayedSignals" SG_ 957 HOD_LINComFault 0;
BA_ "GenSigInactiveValue" SG_ 957 HOD_LINComFault 0;
BA_ "GenSigInvalidValue" SG_ 957 HOD_LINComFault 0;
BA_ "GenSigSendType" SG_ 957 HOD_LINComFault 1;
BA_ "GenSigStartValue" SG_ 957 HOD_LINComFault 0;
BA_ "GenSigTimeoutValue" SG_ 957 HOD_LINComFault 0;
BA_ "Remark" SG_ 957 HOD_LINComFault "";
BA_ "EventCommandSignal" SG_ 957 HOD_FaultSt 0;
BA_ "GatewayedSignals" SG_ 957 HOD_FaultSt 0;
BA_ "GenSigInactiveValue" SG_ 957 HOD_FaultSt 0;
BA_ "GenSigInvalidValue" SG_ 957 HOD_FaultSt 0;
BA_ "GenSigSendType" SG_ 957 HOD_FaultSt 1;
BA_ "GenSigStartValue" SG_ 957 HOD_FaultSt 0;
BA_ "GenSigTimeoutValue" SG_ 957 HOD_FaultSt 0;
BA_ "Remark" SG_ 957 HOD_FaultSt "";
BA_ "EventCommandSignal" SG_ 957 HOD_VBattOORFault 0;
BA_ "GatewayedSignals" SG_ 957 HOD_VBattOORFault 0;
BA_ "GenSigInactiveValue" SG_ 957 HOD_VBattOORFault 0;
BA_ "GenSigInvalidValue" SG_ 957 HOD_VBattOORFault 0;
BA_ "GenSigSendType" SG_ 957 HOD_VBattOORFault 1;
BA_ "GenSigStartValue" SG_ 957 HOD_VBattOORFault 0;
BA_ "GenSigTimeoutValue" SG_ 957 HOD_VBattOORFault 0;
BA_ "Remark" SG_ 957 HOD_VBattOORFault "";
BA_ "EventCommandSignal" SG_ 957 HOD_HeatingOtherFaultSt 0;
BA_ "GatewayedSignals" SG_ 957 HOD_HeatingOtherFaultSt 0;
BA_ "GenSigInactiveValue" SG_ 957 HOD_HeatingOtherFaultSt 0;
BA_ "GenSigInvalidValue" SG_ 957 HOD_HeatingOtherFaultSt 0;
BA_ "GenSigSendType" SG_ 957 HOD_HeatingOtherFaultSt 1;
BA_ "GenSigStartValue" SG_ 957 HOD_HeatingOtherFaultSt 0;
BA_ "GenSigTimeoutValue" SG_ 957 HOD_HeatingOtherFaultSt 0;
BA_ "Remark" SG_ 957 HOD_HeatingOtherFaultSt "";
BA_ "EventCommandSignal" SG_ 957 HOD_HeatingOverUnderCurrentSt 0;
BA_ "GatewayedSignals" SG_ 957 HOD_HeatingOverUnderCurrentSt 0;
BA_ "GenSigInactiveValue" SG_ 957 HOD_HeatingOverUnderCurrentSt 0;
BA_ "GenSigInvalidValue" SG_ 957 HOD_HeatingOverUnderCurrentSt 0;
BA_ "GenSigSendType" SG_ 957 HOD_HeatingOverUnderCurrentSt 1;
BA_ "GenSigStartValue" SG_ 957 HOD_HeatingOverUnderCurrentSt 0;
BA_ "GenSigTimeoutValue" SG_ 957 HOD_HeatingOverUnderCurrentSt 0;
BA_ "Remark" SG_ 957 HOD_HeatingOverUnderCurrentSt "";
BA_ "EventCommandSignal" SG_ 957 HOD_HeatingThermSt 0;
BA_ "GatewayedSignals" SG_ 957 HOD_HeatingThermSt 0;
BA_ "GenSigInactiveValue" SG_ 957 HOD_HeatingThermSt 0;
BA_ "GenSigInvalidValue" SG_ 957 HOD_HeatingThermSt 0;
BA_ "GenSigSendType" SG_ 957 HOD_HeatingThermSt 1;
BA_ "GenSigStartValue" SG_ 957 HOD_HeatingThermSt 0;
BA_ "GenSigTimeoutValue" SG_ 957 HOD_HeatingThermSt 0;
BA_ "Remark" SG_ 957 HOD_HeatingThermSt "";
BA_ "EventCommandSignal" SG_ 957 HOD_HeatingTempOutSt 0;
BA_ "GatewayedSignals" SG_ 957 HOD_HeatingTempOutSt 0;
BA_ "GenSigInactiveValue" SG_ 957 HOD_HeatingTempOutSt 0;
BA_ "GenSigInvalidValue" SG_ 957 HOD_HeatingTempOutSt 0;
BA_ "GenSigSendType" SG_ 957 HOD_HeatingTempOutSt 1;
BA_ "GenSigStartValue" SG_ 957 HOD_HeatingTempOutSt 0;
BA_ "GenSigTimeoutValue" SG_ 957 HOD_HeatingTempOutSt 0;
BA_ "Remark" SG_ 957 HOD_HeatingTempOutSt "";
BA_ "EventCommandSignal" SG_ 957 HOD_Typ 0;
BA_ "GatewayedSignals" SG_ 957 HOD_Typ 0;
BA_ "GenSigInactiveValue" SG_ 957 HOD_Typ 0;
BA_ "GenSigInvalidValue" SG_ 957 HOD_Typ 0;
BA_ "GenSigSendType" SG_ 957 HOD_Typ 1;
BA_ "GenSigStartValue" SG_ 957 HOD_Typ 0;
BA_ "GenSigTimeoutValue" SG_ 957 HOD_Typ 0;
BA_ "Remark" SG_ 957 HOD_Typ "";
BA_ "EventCommandSignal" SG_ 957 HOD_TouchIntensityZone1 0;
BA_ "GatewayedSignals" SG_ 957 HOD_TouchIntensityZone1 0;
BA_ "GenSigInactiveValue" SG_ 957 HOD_TouchIntensityZone1 0;
BA_ "GenSigInvalidValue" SG_ 957 HOD_TouchIntensityZone1 0;
BA_ "GenSigSendType" SG_ 957 HOD_TouchIntensityZone1 1;
BA_ "GenSigStartValue" SG_ 957 HOD_TouchIntensityZone1 0;
BA_ "GenSigTimeoutValue" SG_ 957 HOD_TouchIntensityZone1 0;
BA_ "Remark" SG_ 957 HOD_TouchIntensityZone1 "";
BA_ "EventCommandSignal" SG_ 957 HOD_TouchIntensityZone2 0;
BA_ "GatewayedSignals" SG_ 957 HOD_TouchIntensityZone2 0;
BA_ "GenSigInactiveValue" SG_ 957 HOD_TouchIntensityZone2 0;
BA_ "GenSigInvalidValue" SG_ 957 HOD_TouchIntensityZone2 0;
BA_ "GenSigSendType" SG_ 957 HOD_TouchIntensityZone2 1;
BA_ "GenSigStartValue" SG_ 957 HOD_TouchIntensityZone2 0;
BA_ "GenSigTimeoutValue" SG_ 957 HOD_TouchIntensityZone2 0;
BA_ "Remark" SG_ 957 HOD_TouchIntensityZone2 "";
BA_ "EventCommandSignal" SG_ 957 HOD_TouchIntensityZone3 0;
BA_ "GatewayedSignals" SG_ 957 HOD_TouchIntensityZone3 0;
BA_ "GenSigInactiveValue" SG_ 957 HOD_TouchIntensityZone3 0;
BA_ "GenSigInvalidValue" SG_ 957 HOD_TouchIntensityZone3 0;
BA_ "GenSigSendType" SG_ 957 HOD_TouchIntensityZone3 1;
BA_ "GenSigStartValue" SG_ 957 HOD_TouchIntensityZone3 0;
BA_ "GenSigTimeoutValue" SG_ 957 HOD_TouchIntensityZone3 0;
BA_ "Remark" SG_ 957 HOD_TouchIntensityZone3 "";
BA_ "EventCommandSignal" SG_ 957 HOD_SysErr 0;
BA_ "GatewayedSignals" SG_ 957 HOD_SysErr 0;
BA_ "GenSigInactiveValue" SG_ 957 HOD_SysErr 0;
BA_ "GenSigInvalidValue" SG_ 957 HOD_SysErr 0;
BA_ "GenSigSendType" SG_ 957 HOD_SysErr 1;
BA_ "GenSigStartValue" SG_ 957 HOD_SysErr 0;
BA_ "GenSigTimeoutValue" SG_ 957 HOD_SysErr 0;
BA_ "Remark" SG_ 957 HOD_SysErr "";
BA_ "EventCommandSignal" SG_ 860 VCU_7_CRC 0;
BA_ "GatewayedSignals" SG_ 860 VCU_7_CRC 0;
BA_ "GenSigInactiveValue" SG_ 860 VCU_7_CRC 0;
BA_ "GenSigInvalidValue" SG_ 860 VCU_7_CRC 0;
BA_ "GenSigSendType" SG_ 860 VCU_7_CRC 1;
BA_ "GenSigStartValue" SG_ 860 VCU_7_CRC 0;
BA_ "GenSigTimeoutValue" SG_ 860 VCU_7_CRC 0;
BA_ "Remark" SG_ 860 VCU_7_CRC "";
BA_ "EventCommandSignal" SG_ 860 VCU_7_Counter 0;
BA_ "GatewayedSignals" SG_ 860 VCU_7_Counter 0;
BA_ "GenSigInactiveValue" SG_ 860 VCU_7_Counter 0;
BA_ "GenSigInvalidValue" SG_ 860 VCU_7_Counter 0;
BA_ "GenSigSendType" SG_ 860 VCU_7_Counter 1;
BA_ "GenSigStartValue" SG_ 860 VCU_7_Counter 0;
BA_ "GenSigTimeoutValue" SG_ 860 VCU_7_Counter 0;
BA_ "Remark" SG_ 860 VCU_7_Counter "";
BA_ "EventCommandSignal" SG_ 860 VCU_RoadMod 0;
BA_ "GatewayedSignals" SG_ 860 VCU_RoadMod 0;
BA_ "GenSigInactiveValue" SG_ 860 VCU_RoadMod 0;
BA_ "GenSigInvalidValue" SG_ 860 VCU_RoadMod 0;
BA_ "GenSigSendType" SG_ 860 VCU_RoadMod 1;
BA_ "GenSigStartValue" SG_ 860 VCU_RoadMod 0;
BA_ "GenSigTimeoutValue" SG_ 860 VCU_RoadMod 0;
BA_ "Remark" SG_ 860 VCU_RoadMod "";
BA_ "EventCommandSignal" SG_ 860 VCU_GearLvl 0;
BA_ "GatewayedSignals" SG_ 860 VCU_GearLvl 0;
BA_ "GenSigInactiveValue" SG_ 860 VCU_GearLvl 0;
BA_ "GenSigInvalidValue" SG_ 860 VCU_GearLvl 0;
BA_ "GenSigSendType" SG_ 860 VCU_GearLvl 1;
BA_ "GenSigStartValue" SG_ 860 VCU_GearLvl 0;
BA_ "GenSigTimeoutValue" SG_ 860 VCU_GearLvl 0;
BA_ "Remark" SG_ 860 VCU_GearLvl "";
BA_ "EventCommandSignal" SG_ 860 VCU_VehDrvMod 0;
BA_ "GatewayedSignals" SG_ 860 VCU_VehDrvMod 0;
BA_ "GenSigInactiveValue" SG_ 860 VCU_VehDrvMod 0;
BA_ "GenSigInvalidValue" SG_ 860 VCU_VehDrvMod 0;
BA_ "GenSigSendType" SG_ 860 VCU_VehDrvMod 1;
BA_ "GenSigStartValue" SG_ 860 VCU_VehDrvMod 0;
BA_ "GenSigTimeoutValue" SG_ 860 VCU_VehDrvMod 0;
BA_ "Remark" SG_ 860 VCU_VehDrvMod "";
BA_ "EventCommandSignal" SG_ 860 VCU_VehRdySt 0;
BA_ "GatewayedSignals" SG_ 860 VCU_VehRdySt 0;
BA_ "GenSigInactiveValue" SG_ 860 VCU_VehRdySt 0;
BA_ "GenSigInvalidValue" SG_ 860 VCU_VehRdySt 0;
BA_ "GenSigSendType" SG_ 860 VCU_VehRdySt 1;
BA_ "GenSigStartValue" SG_ 860 VCU_VehRdySt 0;
BA_ "GenSigTimeoutValue" SG_ 860 VCU_VehRdySt 0;
BA_ "Remark" SG_ 860 VCU_VehRdySt "";
BA_ "EventCommandSignal" SG_ 860 VCU_ChgActiveSt_toADC 0;
BA_ "GatewayedSignals" SG_ 860 VCU_ChgActiveSt_toADC 0;
BA_ "GenSigInactiveValue" SG_ 860 VCU_ChgActiveSt_toADC 0;
BA_ "GenSigInvalidValue" SG_ 860 VCU_ChgActiveSt_toADC 0;
BA_ "GenSigSendType" SG_ 860 VCU_ChgActiveSt_toADC 1;
BA_ "GenSigStartValue" SG_ 860 VCU_ChgActiveSt_toADC 0;
BA_ "GenSigTimeoutValue" SG_ 860 VCU_ChgActiveSt_toADC 0;
BA_ "Remark" SG_ 860 VCU_ChgActiveSt_toADC "";
BA_ "EventCommandSignal" SG_ 860 VCU_PlgConnSt 0;
BA_ "GatewayedSignals" SG_ 860 VCU_PlgConnSt 0;
BA_ "GenSigInactiveValue" SG_ 860 VCU_PlgConnSt 0;
BA_ "GenSigInvalidValue" SG_ 860 VCU_PlgConnSt 0;
BA_ "GenSigSendType" SG_ 860 VCU_PlgConnSt 1;
BA_ "GenSigStartValue" SG_ 860 VCU_PlgConnSt 0;
BA_ "GenSigTimeoutValue" SG_ 860 VCU_PlgConnSt 0;
BA_ "Remark" SG_ 860 VCU_PlgConnSt "";
BA_ "EventCommandSignal" SG_ 860 VCU_EVRng 0;
BA_ "GatewayedSignals" SG_ 860 VCU_EVRng 0;
BA_ "GenSigInactiveValue" SG_ 860 VCU_EVRng 0;
BA_ "GenSigInvalidValue" SG_ 860 VCU_EVRng 0;
BA_ "GenSigSendType" SG_ 860 VCU_EVRng 1;
BA_ "GenSigStartValue" SG_ 860 VCU_EVRng 510;
BA_ "GenSigTimeoutValue" SG_ 860 VCU_EVRng 0;
BA_ "Remark" SG_ 860 VCU_EVRng "";
BA_ "EventCommandSignal" SG_ 860 VCU_GearLvlDisp 0;
BA_ "GatewayedSignals" SG_ 860 VCU_GearLvlDisp 0;
BA_ "GenSigInactiveValue" SG_ 860 VCU_GearLvlDisp 0;
BA_ "GenSigInvalidValue" SG_ 860 VCU_GearLvlDisp 0;
BA_ "GenSigSendType" SG_ 860 VCU_GearLvlDisp 1;
BA_ "GenSigStartValue" SG_ 860 VCU_GearLvlDisp 0;
BA_ "GenSigTimeoutValue" SG_ 860 VCU_GearLvlDisp 0;
BA_ "Remark" SG_ 860 VCU_GearLvlDisp "";
BA_ "EventCommandSignal" SG_ 860 VCU_BMS_BattSocDisp 0;
BA_ "GatewayedSignals" SG_ 860 VCU_BMS_BattSocDisp 0;
BA_ "GenSigInactiveValue" SG_ 860 VCU_BMS_BattSocDisp 0;
BA_ "GenSigInvalidValue" SG_ 860 VCU_BMS_BattSocDisp 255;
BA_ "GenSigSendType" SG_ 860 VCU_BMS_BattSocDisp 1;
BA_ "GenSigStartValue" SG_ 860 VCU_BMS_BattSocDisp 0;
BA_ "GenSigTimeoutValue" SG_ 860 VCU_BMS_BattSocDisp 0;
BA_ "Remark" SG_ 860 VCU_BMS_BattSocDisp "";
BA_ "EventCommandSignal" SG_ 860 VCU_SuspModeReq 0;
BA_ "GatewayedSignals" SG_ 860 VCU_SuspModeReq 0;
BA_ "GenSigInactiveValue" SG_ 860 VCU_SuspModeReq 0;
BA_ "GenSigInvalidValue" SG_ 860 VCU_SuspModeReq 0;
BA_ "GenSigSendType" SG_ 860 VCU_SuspModeReq 1;
BA_ "GenSigStartValue" SG_ 860 VCU_SuspModeReq 0;
BA_ "GenSigTimeoutValue" SG_ 860 VCU_SuspModeReq 0;
BA_ "Remark" SG_ 860 VCU_SuspModeReq "";
BA_ "EventCommandSignal" SG_ 860 VCU_SuspModeReqEnable 0;
BA_ "GatewayedSignals" SG_ 860 VCU_SuspModeReqEnable 0;
BA_ "GenSigInactiveValue" SG_ 860 VCU_SuspModeReqEnable 0;
BA_ "GenSigInvalidValue" SG_ 860 VCU_SuspModeReqEnable 0;
BA_ "GenSigSendType" SG_ 860 VCU_SuspModeReqEnable 1;
BA_ "GenSigStartValue" SG_ 860 VCU_SuspModeReqEnable 0;
BA_ "GenSigTimeoutValue" SG_ 860 VCU_SuspModeReqEnable 0;
BA_ "Remark" SG_ 860 VCU_SuspModeReqEnable "";
BA_ "EventCommandSignal" SG_ 860 VCU_PivotSteeringStAvailable 0;
BA_ "GatewayedSignals" SG_ 860 VCU_PivotSteeringStAvailable 0;
BA_ "GenSigInactiveValue" SG_ 860 VCU_PivotSteeringStAvailable 0;
BA_ "GenSigInvalidValue" SG_ 860 VCU_PivotSteeringStAvailable 0;
BA_ "GenSigSendType" SG_ 860 VCU_PivotSteeringStAvailable 1;
BA_ "GenSigStartValue" SG_ 860 VCU_PivotSteeringStAvailable 0;
BA_ "GenSigTimeoutValue" SG_ 860 VCU_PivotSteeringStAvailable 0;
BA_ "Remark" SG_ 860 VCU_PivotSteeringStAvailable "";
BA_ "EventCommandSignal" SG_ 860 VCU_PivotSteeringSt 0;
BA_ "GatewayedSignals" SG_ 860 VCU_PivotSteeringSt 0;
BA_ "GenSigInactiveValue" SG_ 860 VCU_PivotSteeringSt 0;
BA_ "GenSigInvalidValue" SG_ 860 VCU_PivotSteeringSt 0;
BA_ "GenSigSendType" SG_ 860 VCU_PivotSteeringSt 1;
BA_ "GenSigStartValue" SG_ 860 VCU_PivotSteeringSt 0;
BA_ "GenSigTimeoutValue" SG_ 860 VCU_PivotSteeringSt 0;
BA_ "Remark" SG_ 860 VCU_PivotSteeringSt "";
BA_ "EventCommandSignal" SG_ 860 VCU_GearPosition 0;
BA_ "GatewayedSignals" SG_ 860 VCU_GearPosition 0;
BA_ "GenSigInactiveValue" SG_ 860 VCU_GearPosition 0;
BA_ "GenSigInvalidValue" SG_ 860 VCU_GearPosition 0;
BA_ "GenSigSendType" SG_ 860 VCU_GearPosition 1;
BA_ "GenSigStartValue" SG_ 860 VCU_GearPosition 0;
BA_ "GenSigTimeoutValue" SG_ 860 VCU_GearPosition 0;
BA_ "Remark" SG_ 860 VCU_GearPosition "";
BA_ "EventCommandSignal" SG_ 860 VCU_EcoPlusMod 0;
BA_ "GatewayedSignals" SG_ 860 VCU_EcoPlusMod 0;
BA_ "GenSigInactiveValue" SG_ 860 VCU_EcoPlusMod 0;
BA_ "GenSigInvalidValue" SG_ 860 VCU_EcoPlusMod 0;
BA_ "GenSigSendType" SG_ 860 VCU_EcoPlusMod 1;
BA_ "GenSigStartValue" SG_ 860 VCU_EcoPlusMod 0;
BA_ "GenSigTimeoutValue" SG_ 860 VCU_EcoPlusMod 0;
BA_ "Remark" SG_ 860 VCU_EcoPlusMod "";
BA_ "EventCommandSignal" SG_ 860 ICC_RoadMod 0;
BA_ "GatewayedSignals" SG_ 860 ICC_RoadMod 0;
BA_ "GenSigInactiveValue" SG_ 860 ICC_RoadMod 0;
BA_ "GenSigInvalidValue" SG_ 860 ICC_RoadMod 0;
BA_ "GenSigSendType" SG_ 860 ICC_RoadMod 1;
BA_ "GenSigStartValue" SG_ 860 ICC_RoadMod 0;
BA_ "GenSigTimeoutValue" SG_ 860 ICC_RoadMod 0;
BA_ "Remark" SG_ 860 ICC_RoadMod "";
BA_ "EventCommandSignal" SG_ 431 VCU_TargetRecpTorqSt 0;
BA_ "GatewayedSignals" SG_ 431 VCU_TargetRecpTorqSt 0;
BA_ "GenSigInactiveValue" SG_ 431 VCU_TargetRecpTorqSt 0;
BA_ "GenSigInvalidValue" SG_ 431 VCU_TargetRecpTorqSt 0;
BA_ "GenSigSendType" SG_ 431 VCU_TargetRecpTorqSt 1;
BA_ "GenSigStartValue" SG_ 431 VCU_TargetRecpTorqSt 0;
BA_ "GenSigTimeoutValue" SG_ 431 VCU_TargetRecpTorqSt 0;
BA_ "Remark" SG_ 431 VCU_TargetRecpTorqSt "";
BA_ "EventCommandSignal" SG_ 431 VCU_AccElecECFail 0;
BA_ "GatewayedSignals" SG_ 431 VCU_AccElecECFail 0;
BA_ "GenSigInactiveValue" SG_ 431 VCU_AccElecECFail 0;
BA_ "GenSigInvalidValue" SG_ 431 VCU_AccElecECFail 0;
BA_ "GenSigSendType" SG_ 431 VCU_AccElecECFail 1;
BA_ "GenSigStartValue" SG_ 431 VCU_AccElecECFail 0;
BA_ "GenSigTimeoutValue" SG_ 431 VCU_AccElecECFail 0;
BA_ "Remark" SG_ 431 VCU_AccElecECFail "";
BA_ "EventCommandSignal" SG_ 431 VCU_AccDriverOrvd 0;
BA_ "GatewayedSignals" SG_ 431 VCU_AccDriverOrvd 0;
BA_ "GenSigInactiveValue" SG_ 431 VCU_AccDriverOrvd 0;
BA_ "GenSigInvalidValue" SG_ 431 VCU_AccDriverOrvd 0;
BA_ "GenSigSendType" SG_ 431 VCU_AccDriverOrvd 1;
BA_ "GenSigStartValue" SG_ 431 VCU_AccDriverOrvd 0;
BA_ "GenSigTimeoutValue" SG_ 431 VCU_AccDriverOrvd 0;
BA_ "Remark" SG_ 431 VCU_AccDriverOrvd "";
BA_ "EventCommandSignal" SG_ 431 VCU_AccTMCFail 0;
BA_ "GatewayedSignals" SG_ 431 VCU_AccTMCFail 0;
BA_ "GenSigInactiveValue" SG_ 431 VCU_AccTMCFail 0;
BA_ "GenSigInvalidValue" SG_ 431 VCU_AccTMCFail 0;
BA_ "GenSigSendType" SG_ 431 VCU_AccTMCFail 1;
BA_ "GenSigStartValue" SG_ 431 VCU_AccTMCFail 0;
BA_ "GenSigTimeoutValue" SG_ 431 VCU_AccTMCFail 0;
BA_ "Remark" SG_ 431 VCU_AccTMCFail "";
BA_ "EventCommandSignal" SG_ 431 VCU_TargetRecpTorqNm 0;
BA_ "GatewayedSignals" SG_ 431 VCU_TargetRecpTorqNm 0;
BA_ "GenSigInactiveValue" SG_ 431 VCU_TargetRecpTorqNm 0;
BA_ "GenSigInvalidValue" SG_ 431 VCU_TargetRecpTorqNm 0;
BA_ "GenSigSendType" SG_ 431 VCU_TargetRecpTorqNm 1;
BA_ "GenSigStartValue" SG_ 431 VCU_TargetRecpTorqNm 0;
BA_ "GenSigTimeoutValue" SG_ 431 VCU_TargetRecpTorqNm 0;
BA_ "Remark" SG_ 431 VCU_TargetRecpTorqNm "";
BA_ "EventCommandSignal" SG_ 431 VCU_TargetRecpTorqFA 0;
BA_ "GatewayedSignals" SG_ 431 VCU_TargetRecpTorqFA 0;
BA_ "GenSigInactiveValue" SG_ 431 VCU_TargetRecpTorqFA 0;
BA_ "GenSigInvalidValue" SG_ 431 VCU_TargetRecpTorqFA 0;
BA_ "GenSigSendType" SG_ 431 VCU_TargetRecpTorqFA 1;
BA_ "GenSigStartValue" SG_ 431 VCU_TargetRecpTorqFA 0;
BA_ "GenSigTimeoutValue" SG_ 431 VCU_TargetRecpTorqFA 0;
BA_ "Remark" SG_ 431 VCU_TargetRecpTorqFA "";
BA_ "EventCommandSignal" SG_ 431 VCU_TargetRecpTorqRA 0;
BA_ "GatewayedSignals" SG_ 431 VCU_TargetRecpTorqRA 0;
BA_ "GenSigInactiveValue" SG_ 431 VCU_TargetRecpTorqRA 0;
BA_ "GenSigInvalidValue" SG_ 431 VCU_TargetRecpTorqRA 0;
BA_ "GenSigSendType" SG_ 431 VCU_TargetRecpTorqRA 1;
BA_ "GenSigStartValue" SG_ 431 VCU_TargetRecpTorqRA 0;
BA_ "GenSigTimeoutValue" SG_ 431 VCU_TargetRecpTorqRA 0;
BA_ "Remark" SG_ 431 VCU_TargetRecpTorqRA "";
BA_ "EventCommandSignal" SG_ 431 VCU_TorqDriverReqFA 0;
BA_ "GatewayedSignals" SG_ 431 VCU_TorqDriverReqFA 0;
BA_ "GenSigInactiveValue" SG_ 431 VCU_TorqDriverReqFA 0;
BA_ "GenSigInvalidValue" SG_ 431 VCU_TorqDriverReqFA 0;
BA_ "GenSigSendType" SG_ 431 VCU_TorqDriverReqFA 1;
BA_ "GenSigStartValue" SG_ 431 VCU_TorqDriverReqFA 0;
BA_ "GenSigTimeoutValue" SG_ 431 VCU_TorqDriverReqFA 0;
BA_ "Remark" SG_ 431 VCU_TorqDriverReqFA "";
BA_ "EventCommandSignal" SG_ 431 VCU_TorqDriverReqRA 0;
BA_ "GatewayedSignals" SG_ 431 VCU_TorqDriverReqRA 0;
BA_ "GenSigInactiveValue" SG_ 431 VCU_TorqDriverReqRA 0;
BA_ "GenSigInvalidValue" SG_ 431 VCU_TorqDriverReqRA 0;
BA_ "GenSigSendType" SG_ 431 VCU_TorqDriverReqRA 1;
BA_ "GenSigStartValue" SG_ 431 VCU_TorqDriverReqRA 0;
BA_ "GenSigTimeoutValue" SG_ 431 VCU_TorqDriverReqRA 0;
BA_ "Remark" SG_ 431 VCU_TorqDriverReqRA "";
BA_ "EventCommandSignal" SG_ 431 VCU_VehActDrvTorqFA 0;
BA_ "GatewayedSignals" SG_ 431 VCU_VehActDrvTorqFA 0;
BA_ "GenSigInactiveValue" SG_ 431 VCU_VehActDrvTorqFA 0;
BA_ "GenSigInvalidValue" SG_ 431 VCU_VehActDrvTorqFA 0;
BA_ "GenSigSendType" SG_ 431 VCU_VehActDrvTorqFA 1;
BA_ "GenSigStartValue" SG_ 431 VCU_VehActDrvTorqFA 0;
BA_ "GenSigTimeoutValue" SG_ 431 VCU_VehActDrvTorqFA 0;
BA_ "Remark" SG_ 431 VCU_VehActDrvTorqFA "";
BA_ "EventCommandSignal" SG_ 431 VCU_VehActDrvTorqRA 0;
BA_ "GatewayedSignals" SG_ 431 VCU_VehActDrvTorqRA 0;
BA_ "GenSigInactiveValue" SG_ 431 VCU_VehActDrvTorqRA 0;
BA_ "GenSigInvalidValue" SG_ 431 VCU_VehActDrvTorqRA 0;
BA_ "GenSigSendType" SG_ 431 VCU_VehActDrvTorqRA 1;
BA_ "GenSigStartValue" SG_ 431 VCU_VehActDrvTorqRA 0;
BA_ "GenSigTimeoutValue" SG_ 431 VCU_VehActDrvTorqRA 0;
BA_ "Remark" SG_ 431 VCU_VehActDrvTorqRA "";
BA_ "EventCommandSignal" SG_ 431 VCU_TargetRecpTorqFAVD 0;
BA_ "GatewayedSignals" SG_ 431 VCU_TargetRecpTorqFAVD 0;
BA_ "GenSigInactiveValue" SG_ 431 VCU_TargetRecpTorqFAVD 0;
BA_ "GenSigInvalidValue" SG_ 431 VCU_TargetRecpTorqFAVD 0;
BA_ "GenSigSendType" SG_ 431 VCU_TargetRecpTorqFAVD 1;
BA_ "GenSigStartValue" SG_ 431 VCU_TargetRecpTorqFAVD 0;
BA_ "GenSigTimeoutValue" SG_ 431 VCU_TargetRecpTorqFAVD 0;
BA_ "Remark" SG_ 431 VCU_TargetRecpTorqFAVD "";
BA_ "EventCommandSignal" SG_ 431 VCU_TargetRecpTorqRAVD 0;
BA_ "GatewayedSignals" SG_ 431 VCU_TargetRecpTorqRAVD 0;
BA_ "GenSigInactiveValue" SG_ 431 VCU_TargetRecpTorqRAVD 0;
BA_ "GenSigInvalidValue" SG_ 431 VCU_TargetRecpTorqRAVD 0;
BA_ "GenSigSendType" SG_ 431 VCU_TargetRecpTorqRAVD 1;
BA_ "GenSigStartValue" SG_ 431 VCU_TargetRecpTorqRAVD 0;
BA_ "GenSigTimeoutValue" SG_ 431 VCU_TargetRecpTorqRAVD 0;
BA_ "Remark" SG_ 431 VCU_TargetRecpTorqRAVD "";
BA_ "EventCommandSignal" SG_ 431 VCU_TorqDriverReqFAVD 0;
BA_ "GatewayedSignals" SG_ 431 VCU_TorqDriverReqFAVD 0;
BA_ "GenSigInactiveValue" SG_ 431 VCU_TorqDriverReqFAVD 0;
BA_ "GenSigInvalidValue" SG_ 431 VCU_TorqDriverReqFAVD 0;
BA_ "GenSigSendType" SG_ 431 VCU_TorqDriverReqFAVD 1;
BA_ "GenSigStartValue" SG_ 431 VCU_TorqDriverReqFAVD 0;
BA_ "GenSigTimeoutValue" SG_ 431 VCU_TorqDriverReqFAVD 0;
BA_ "Remark" SG_ 431 VCU_TorqDriverReqFAVD "";
BA_ "EventCommandSignal" SG_ 431 VCU_TorqDriverReqRAVD 0;
BA_ "GatewayedSignals" SG_ 431 VCU_TorqDriverReqRAVD 0;
BA_ "GenSigInactiveValue" SG_ 431 VCU_TorqDriverReqRAVD 0;
BA_ "GenSigInvalidValue" SG_ 431 VCU_TorqDriverReqRAVD 0;
BA_ "GenSigSendType" SG_ 431 VCU_TorqDriverReqRAVD 1;
BA_ "GenSigStartValue" SG_ 431 VCU_TorqDriverReqRAVD 0;
BA_ "GenSigTimeoutValue" SG_ 431 VCU_TorqDriverReqRAVD 0;
BA_ "Remark" SG_ 431 VCU_TorqDriverReqRAVD "";
BA_ "EventCommandSignal" SG_ 431 VCU_VehActDrvTorqFAVD 0;
BA_ "GatewayedSignals" SG_ 431 VCU_VehActDrvTorqFAVD 0;
BA_ "GenSigInactiveValue" SG_ 431 VCU_VehActDrvTorqFAVD 0;
BA_ "GenSigInvalidValue" SG_ 431 VCU_VehActDrvTorqFAVD 0;
BA_ "GenSigSendType" SG_ 431 VCU_VehActDrvTorqFAVD 1;
BA_ "GenSigStartValue" SG_ 431 VCU_VehActDrvTorqFAVD 0;
BA_ "GenSigTimeoutValue" SG_ 431 VCU_VehActDrvTorqFAVD 0;
BA_ "Remark" SG_ 431 VCU_VehActDrvTorqFAVD "";
BA_ "EventCommandSignal" SG_ 431 VCU_VehActDrvTorqRAVD 0;
BA_ "GatewayedSignals" SG_ 431 VCU_VehActDrvTorqRAVD 0;
BA_ "GenSigInactiveValue" SG_ 431 VCU_VehActDrvTorqRAVD 0;
BA_ "GenSigInvalidValue" SG_ 431 VCU_VehActDrvTorqRAVD 0;
BA_ "GenSigSendType" SG_ 431 VCU_VehActDrvTorqRAVD 1;
BA_ "GenSigStartValue" SG_ 431 VCU_VehActDrvTorqRAVD 0;
BA_ "GenSigTimeoutValue" SG_ 431 VCU_VehActDrvTorqRAVD 0;
BA_ "Remark" SG_ 431 VCU_VehActDrvTorqRAVD "";
BA_ "EventCommandSignal" SG_ 431 VCU_BcsDecelReq 0;
BA_ "GatewayedSignals" SG_ 431 VCU_BcsDecelReq 0;
BA_ "GenSigInactiveValue" SG_ 431 VCU_BcsDecelReq 0;
BA_ "GenSigInvalidValue" SG_ 431 VCU_BcsDecelReq 0;
BA_ "GenSigSendType" SG_ 431 VCU_BcsDecelReq 1;
BA_ "GenSigStartValue" SG_ 431 VCU_BcsDecelReq 15;
BA_ "GenSigTimeoutValue" SG_ 431 VCU_BcsDecelReq 0;
BA_ "Remark" SG_ 431 VCU_BcsDecelReq "";
BA_ "EventCommandSignal" SG_ 431 VCU_BcsDecelVD 0;
BA_ "GatewayedSignals" SG_ 431 VCU_BcsDecelVD 0;
BA_ "GenSigInactiveValue" SG_ 431 VCU_BcsDecelVD 0;
BA_ "GenSigInvalidValue" SG_ 431 VCU_BcsDecelVD 0;
BA_ "GenSigSendType" SG_ 431 VCU_BcsDecelVD 1;
BA_ "GenSigStartValue" SG_ 431 VCU_BcsDecelVD 0;
BA_ "GenSigTimeoutValue" SG_ 431 VCU_BcsDecelVD 0;
BA_ "Remark" SG_ 431 VCU_BcsDecelVD "";
BA_ "EventCommandSignal" SG_ 431 VCU_RecpTorqRL 0;
BA_ "GatewayedSignals" SG_ 431 VCU_RecpTorqRL 0;
BA_ "GenSigInactiveValue" SG_ 431 VCU_RecpTorqRL 0;
BA_ "GenSigInvalidValue" SG_ 431 VCU_RecpTorqRL 0;
BA_ "GenSigSendType" SG_ 431 VCU_RecpTorqRL 1;
BA_ "GenSigStartValue" SG_ 431 VCU_RecpTorqRL 0;
BA_ "GenSigTimeoutValue" SG_ 431 VCU_RecpTorqRL 0;
BA_ "Remark" SG_ 431 VCU_RecpTorqRL "";
BA_ "EventCommandSignal" SG_ 431 VCU_RecpTorqRLVD 0;
BA_ "GatewayedSignals" SG_ 431 VCU_RecpTorqRLVD 0;
BA_ "GenSigInactiveValue" SG_ 431 VCU_RecpTorqRLVD 0;
BA_ "GenSigInvalidValue" SG_ 431 VCU_RecpTorqRLVD 0;
BA_ "GenSigSendType" SG_ 431 VCU_RecpTorqRLVD 1;
BA_ "GenSigStartValue" SG_ 431 VCU_RecpTorqRLVD 0;
BA_ "GenSigTimeoutValue" SG_ 431 VCU_RecpTorqRLVD 0;
BA_ "Remark" SG_ 431 VCU_RecpTorqRLVD "";
BA_ "EventCommandSignal" SG_ 431 VCU_RecpTorqRR 0;
BA_ "GatewayedSignals" SG_ 431 VCU_RecpTorqRR 0;
BA_ "GenSigInactiveValue" SG_ 431 VCU_RecpTorqRR 0;
BA_ "GenSigInvalidValue" SG_ 431 VCU_RecpTorqRR 0;
BA_ "GenSigSendType" SG_ 431 VCU_RecpTorqRR 1;
BA_ "GenSigStartValue" SG_ 431 VCU_RecpTorqRR 0;
BA_ "GenSigTimeoutValue" SG_ 431 VCU_RecpTorqRR 0;
BA_ "Remark" SG_ 431 VCU_RecpTorqRR "";
BA_ "EventCommandSignal" SG_ 431 VCU_RecpTorqRRVD 0;
BA_ "GatewayedSignals" SG_ 431 VCU_RecpTorqRRVD 0;
BA_ "GenSigInactiveValue" SG_ 431 VCU_RecpTorqRRVD 0;
BA_ "GenSigInvalidValue" SG_ 431 VCU_RecpTorqRRVD 0;
BA_ "GenSigSendType" SG_ 431 VCU_RecpTorqRRVD 1;
BA_ "GenSigStartValue" SG_ 431 VCU_RecpTorqRRVD 0;
BA_ "GenSigTimeoutValue" SG_ 431 VCU_RecpTorqRRVD 0;
BA_ "Remark" SG_ 431 VCU_RecpTorqRRVD "";
BA_ "EventCommandSignal" SG_ 431 VCU_ADSNetErrorFb 0;
BA_ "GatewayedSignals" SG_ 431 VCU_ADSNetErrorFb 0;
BA_ "GenSigInactiveValue" SG_ 431 VCU_ADSNetErrorFb 0;
BA_ "GenSigInvalidValue" SG_ 431 VCU_ADSNetErrorFb 0;
BA_ "GenSigSendType" SG_ 431 VCU_ADSNetErrorFb 1;
BA_ "GenSigStartValue" SG_ 431 VCU_ADSNetErrorFb 0;
BA_ "GenSigTimeoutValue" SG_ 431 VCU_ADSNetErrorFb 0;
BA_ "Remark" SG_ 431 VCU_ADSNetErrorFb "";
BA_ "EventCommandSignal" SG_ 431 VCU_NetModeResp 0;
BA_ "GatewayedSignals" SG_ 431 VCU_NetModeResp 0;
BA_ "GenSigInactiveValue" SG_ 431 VCU_NetModeResp 0;
BA_ "GenSigInvalidValue" SG_ 431 VCU_NetModeResp 0;
BA_ "GenSigSendType" SG_ 431 VCU_NetModeResp 1;
BA_ "GenSigStartValue" SG_ 431 VCU_NetModeResp 0;
BA_ "GenSigTimeoutValue" SG_ 431 VCU_NetModeResp 0;
BA_ "Remark" SG_ 431 VCU_NetModeResp "";
BA_ "EventCommandSignal" SG_ 516 VCU_9_CRC 0;
BA_ "GatewayedSignals" SG_ 516 VCU_9_CRC 0;
BA_ "GenSigInactiveValue" SG_ 516 VCU_9_CRC 0;
BA_ "GenSigInvalidValue" SG_ 516 VCU_9_CRC 0;
BA_ "GenSigSendType" SG_ 516 VCU_9_CRC 1;
BA_ "GenSigStartValue" SG_ 516 VCU_9_CRC 0;
BA_ "GenSigTimeoutValue" SG_ 516 VCU_9_CRC 0;
BA_ "Remark" SG_ 516 VCU_9_CRC "";
BA_ "EventCommandSignal" SG_ 516 VCU_9_Counter 0;
BA_ "GatewayedSignals" SG_ 516 VCU_9_Counter 0;
BA_ "GenSigInactiveValue" SG_ 516 VCU_9_Counter 0;
BA_ "GenSigInvalidValue" SG_ 516 VCU_9_Counter 0;
BA_ "GenSigSendType" SG_ 516 VCU_9_Counter 1;
BA_ "GenSigStartValue" SG_ 516 VCU_9_Counter 0;
BA_ "GenSigTimeoutValue" SG_ 516 VCU_9_Counter 0;
BA_ "Remark" SG_ 516 VCU_9_Counter "";
BA_ "EventCommandSignal" SG_ 516 VCU_VehWheelTorqMaxVD 0;
BA_ "GatewayedSignals" SG_ 516 VCU_VehWheelTorqMaxVD 0;
BA_ "GenSigInactiveValue" SG_ 516 VCU_VehWheelTorqMaxVD 0;
BA_ "GenSigInvalidValue" SG_ 516 VCU_VehWheelTorqMaxVD 0;
BA_ "GenSigSendType" SG_ 516 VCU_VehWheelTorqMaxVD 1;
BA_ "GenSigStartValue" SG_ 516 VCU_VehWheelTorqMaxVD 0;
BA_ "GenSigTimeoutValue" SG_ 516 VCU_VehWheelTorqMaxVD 0;
BA_ "Remark" SG_ 516 VCU_VehWheelTorqMaxVD "";
BA_ "EventCommandSignal" SG_ 516 VCU_RecpTorq 0;
BA_ "GatewayedSignals" SG_ 516 VCU_RecpTorq 0;
BA_ "GenSigInactiveValue" SG_ 516 VCU_RecpTorq 0;
BA_ "GenSigInvalidValue" SG_ 516 VCU_RecpTorq 0;
BA_ "GenSigSendType" SG_ 516 VCU_RecpTorq 1;
BA_ "GenSigStartValue" SG_ 516 VCU_RecpTorq 0;
BA_ "GenSigTimeoutValue" SG_ 516 VCU_RecpTorq 0;
BA_ "Remark" SG_ 516 VCU_RecpTorq "";
BA_ "EventCommandSignal" SG_ 516 VCU_RecpTorqSt 0;
BA_ "GatewayedSignals" SG_ 516 VCU_RecpTorqSt 0;
BA_ "GenSigInactiveValue" SG_ 516 VCU_RecpTorqSt 0;
BA_ "GenSigInvalidValue" SG_ 516 VCU_RecpTorqSt 0;
BA_ "GenSigSendType" SG_ 516 VCU_RecpTorqSt 1;
BA_ "GenSigStartValue" SG_ 516 VCU_RecpTorqSt 0;
BA_ "GenSigTimeoutValue" SG_ 516 VCU_RecpTorqSt 0;
BA_ "Remark" SG_ 516 VCU_RecpTorqSt "";
BA_ "EventCommandSignal" SG_ 516 VCU_MaxRecpTorqSt 0;
BA_ "GatewayedSignals" SG_ 516 VCU_MaxRecpTorqSt 0;
BA_ "GenSigInactiveValue" SG_ 516 VCU_MaxRecpTorqSt 0;
BA_ "GenSigInvalidValue" SG_ 516 VCU_MaxRecpTorqSt 0;
BA_ "GenSigSendType" SG_ 516 VCU_MaxRecpTorqSt 1;
BA_ "GenSigStartValue" SG_ 516 VCU_MaxRecpTorqSt 0;
BA_ "GenSigTimeoutValue" SG_ 516 VCU_MaxRecpTorqSt 0;
BA_ "Remark" SG_ 516 VCU_MaxRecpTorqSt "";
BA_ "EventCommandSignal" SG_ 516 VCU_MaxRecpTorq 0;
BA_ "GatewayedSignals" SG_ 516 VCU_MaxRecpTorq 0;
BA_ "GenSigInactiveValue" SG_ 516 VCU_MaxRecpTorq 0;
BA_ "GenSigInvalidValue" SG_ 516 VCU_MaxRecpTorq 0;
BA_ "GenSigSendType" SG_ 516 VCU_MaxRecpTorq 1;
BA_ "GenSigStartValue" SG_ 516 VCU_MaxRecpTorq 0;
BA_ "GenSigTimeoutValue" SG_ 516 VCU_MaxRecpTorq 0;
BA_ "Remark" SG_ 516 VCU_MaxRecpTorq "";
BA_ "EventCommandSignal" SG_ 516 VCU_CrntGearLvl 0;
BA_ "GatewayedSignals" SG_ 516 VCU_CrntGearLvl 0;
BA_ "GenSigInactiveValue" SG_ 516 VCU_CrntGearLvl 0;
BA_ "GenSigInvalidValue" SG_ 516 VCU_CrntGearLvl 0;
BA_ "GenSigSendType" SG_ 516 VCU_CrntGearLvl 1;
BA_ "GenSigStartValue" SG_ 516 VCU_CrntGearLvl 0;
BA_ "GenSigTimeoutValue" SG_ 516 VCU_CrntGearLvl 0;
BA_ "Remark" SG_ 516 VCU_CrntGearLvl "";
BA_ "EventCommandSignal" SG_ 516 VCU_CrntGearLvlVD 0;
BA_ "GatewayedSignals" SG_ 516 VCU_CrntGearLvlVD 0;
BA_ "GenSigInactiveValue" SG_ 516 VCU_CrntGearLvlVD 0;
BA_ "GenSigInvalidValue" SG_ 516 VCU_CrntGearLvlVD 0;
BA_ "GenSigSendType" SG_ 516 VCU_CrntGearLvlVD 1;
BA_ "GenSigStartValue" SG_ 516 VCU_CrntGearLvlVD 0;
BA_ "GenSigTimeoutValue" SG_ 516 VCU_CrntGearLvlVD 0;
BA_ "Remark" SG_ 516 VCU_CrntGearLvlVD "";
BA_ "EventCommandSignal" SG_ 516 VCU_BrkPedPstVD 0;
BA_ "GatewayedSignals" SG_ 516 VCU_BrkPedPstVD 0;
BA_ "GenSigInactiveValue" SG_ 516 VCU_BrkPedPstVD 0;
BA_ "GenSigInvalidValue" SG_ 516 VCU_BrkPedPstVD 0;
BA_ "GenSigSendType" SG_ 516 VCU_BrkPedPstVD 1;
BA_ "GenSigStartValue" SG_ 516 VCU_BrkPedPstVD 0;
BA_ "GenSigTimeoutValue" SG_ 516 VCU_BrkPedPstVD 0;
BA_ "Remark" SG_ 516 VCU_BrkPedPstVD "";
BA_ "EventCommandSignal" SG_ 516 VCU_BrkPedPst 0;
BA_ "GatewayedSignals" SG_ 516 VCU_BrkPedPst 0;
BA_ "GenSigInactiveValue" SG_ 516 VCU_BrkPedPst 0;
BA_ "GenSigInvalidValue" SG_ 516 VCU_BrkPedPst 0;
BA_ "GenSigSendType" SG_ 516 VCU_BrkPedPst 1;
BA_ "GenSigStartValue" SG_ 516 VCU_BrkPedPst 0;
BA_ "GenSigTimeoutValue" SG_ 516 VCU_BrkPedPst 0;
BA_ "Remark" SG_ 516 VCU_BrkPedPst "";
BA_ "EventCommandSignal" SG_ 516 VCU_APAGasPedalIntv 0;
BA_ "GatewayedSignals" SG_ 516 VCU_APAGasPedalIntv 0;
BA_ "GenSigInactiveValue" SG_ 516 VCU_APAGasPedalIntv 0;
BA_ "GenSigInvalidValue" SG_ 516 VCU_APAGasPedalIntv 0;
BA_ "GenSigSendType" SG_ 516 VCU_APAGasPedalIntv 1;
BA_ "GenSigStartValue" SG_ 516 VCU_APAGasPedalIntv 0;
BA_ "GenSigTimeoutValue" SG_ 516 VCU_APAGasPedalIntv 0;
BA_ "Remark" SG_ 516 VCU_APAGasPedalIntv "";
BA_ "EventCommandSignal" SG_ 516 VCU_APAAvailable 0;
BA_ "GatewayedSignals" SG_ 516 VCU_APAAvailable 0;
BA_ "GenSigInactiveValue" SG_ 516 VCU_APAAvailable 0;
BA_ "GenSigInvalidValue" SG_ 516 VCU_APAAvailable 0;
BA_ "GenSigSendType" SG_ 516 VCU_APAAvailable 1;
BA_ "GenSigStartValue" SG_ 516 VCU_APAAvailable 0;
BA_ "GenSigTimeoutValue" SG_ 516 VCU_APAAvailable 0;
BA_ "Remark" SG_ 516 VCU_APAAvailable "";
BA_ "EventCommandSignal" SG_ 516 VCU_APAWheelTorqDriverReq 0;
BA_ "GatewayedSignals" SG_ 516 VCU_APAWheelTorqDriverReq 0;
BA_ "GenSigInactiveValue" SG_ 516 VCU_APAWheelTorqDriverReq 0;
BA_ "GenSigInvalidValue" SG_ 516 VCU_APAWheelTorqDriverReq 16383;
BA_ "GenSigSendType" SG_ 516 VCU_APAWheelTorqDriverReq 1;
BA_ "GenSigStartValue" SG_ 516 VCU_APAWheelTorqDriverReq 16382;
BA_ "GenSigTimeoutValue" SG_ 516 VCU_APAWheelTorqDriverReq 0;
BA_ "Remark" SG_ 516 VCU_APAWheelTorqDriverReq "";
BA_ "EventCommandSignal" SG_ 516 VCU_APAGearIntervern 0;
BA_ "GatewayedSignals" SG_ 516 VCU_APAGearIntervern 0;
BA_ "GenSigInactiveValue" SG_ 516 VCU_APAGearIntervern 0;
BA_ "GenSigInvalidValue" SG_ 516 VCU_APAGearIntervern 0;
BA_ "GenSigSendType" SG_ 516 VCU_APAGearIntervern 1;
BA_ "GenSigStartValue" SG_ 516 VCU_APAGearIntervern 0;
BA_ "GenSigTimeoutValue" SG_ 516 VCU_APAGearIntervern 0;
BA_ "Remark" SG_ 516 VCU_APAGearIntervern "";
BA_ "EventCommandSignal" SG_ 516 VCU_EMS_AccPedalActPst 0;
BA_ "GatewayedSignals" SG_ 516 VCU_EMS_AccPedalActPst 0;
BA_ "GenSigInactiveValue" SG_ 516 VCU_EMS_AccPedalActPst 0;
BA_ "GenSigInvalidValue" SG_ 516 VCU_EMS_AccPedalActPst 0;
BA_ "GenSigSendType" SG_ 516 VCU_EMS_AccPedalActPst 1;
BA_ "GenSigStartValue" SG_ 516 VCU_EMS_AccPedalActPst 0;
BA_ "GenSigTimeoutValue" SG_ 516 VCU_EMS_AccPedalActPst 0;
BA_ "Remark" SG_ 516 VCU_EMS_AccPedalActPst "";
BA_ "EventCommandSignal" SG_ 516 VCU_EMS_AccPedalActPstVD 0;
BA_ "GatewayedSignals" SG_ 516 VCU_EMS_AccPedalActPstVD 0;
BA_ "GenSigInactiveValue" SG_ 516 VCU_EMS_AccPedalActPstVD 0;
BA_ "GenSigInvalidValue" SG_ 516 VCU_EMS_AccPedalActPstVD 0;
BA_ "GenSigSendType" SG_ 516 VCU_EMS_AccPedalActPstVD 1;
BA_ "GenSigStartValue" SG_ 516 VCU_EMS_AccPedalActPstVD 0;
BA_ "GenSigTimeoutValue" SG_ 516 VCU_EMS_AccPedalActPstVD 0;
BA_ "Remark" SG_ 516 VCU_EMS_AccPedalActPstVD "";
BA_ "EventCommandSignal" SG_ 516 VCU_ActVehWheelTorq 0;
BA_ "GatewayedSignals" SG_ 516 VCU_ActVehWheelTorq 0;
BA_ "GenSigInactiveValue" SG_ 516 VCU_ActVehWheelTorq 0;
BA_ "GenSigInvalidValue" SG_ 516 VCU_ActVehWheelTorq 0;
BA_ "GenSigSendType" SG_ 516 VCU_ActVehWheelTorq 1;
BA_ "GenSigStartValue" SG_ 516 VCU_ActVehWheelTorq 16382;
BA_ "GenSigTimeoutValue" SG_ 516 VCU_ActVehWheelTorq 0;
BA_ "Remark" SG_ 516 VCU_ActVehWheelTorq "";
BA_ "EventCommandSignal" SG_ 516 VCU_VehWheelTorqMax 0;
BA_ "GatewayedSignals" SG_ 516 VCU_VehWheelTorqMax 0;
BA_ "GenSigInactiveValue" SG_ 516 VCU_VehWheelTorqMax 0;
BA_ "GenSigInvalidValue" SG_ 516 VCU_VehWheelTorqMax 0;
BA_ "GenSigSendType" SG_ 516 VCU_VehWheelTorqMax 1;
BA_ "GenSigStartValue" SG_ 516 VCU_VehWheelTorqMax 16382;
BA_ "GenSigTimeoutValue" SG_ 516 VCU_VehWheelTorqMax 0;
BA_ "Remark" SG_ 516 VCU_VehWheelTorqMax "";
BA_ "EventCommandSignal" SG_ 516 VCU_EMS_BrkPedalSt 0;
BA_ "GatewayedSignals" SG_ 516 VCU_EMS_BrkPedalSt 0;
BA_ "GenSigInactiveValue" SG_ 516 VCU_EMS_BrkPedalSt 0;
BA_ "GenSigInvalidValue" SG_ 516 VCU_EMS_BrkPedalSt 0;
BA_ "GenSigSendType" SG_ 516 VCU_EMS_BrkPedalSt 1;
BA_ "GenSigStartValue" SG_ 516 VCU_EMS_BrkPedalSt 0;
BA_ "GenSigTimeoutValue" SG_ 516 VCU_EMS_BrkPedalSt 0;
BA_ "Remark" SG_ 516 VCU_EMS_BrkPedalSt "";
BA_ "EventCommandSignal" SG_ 516 VCU_EMS_BrkPedalStVD 0;
BA_ "GatewayedSignals" SG_ 516 VCU_EMS_BrkPedalStVD 0;
BA_ "GenSigInactiveValue" SG_ 516 VCU_EMS_BrkPedalStVD 0;
BA_ "GenSigInvalidValue" SG_ 516 VCU_EMS_BrkPedalStVD 0;
BA_ "GenSigSendType" SG_ 516 VCU_EMS_BrkPedalStVD 1;
BA_ "GenSigStartValue" SG_ 516 VCU_EMS_BrkPedalStVD 0;
BA_ "GenSigTimeoutValue" SG_ 516 VCU_EMS_BrkPedalStVD 0;
BA_ "Remark" SG_ 516 VCU_EMS_BrkPedalStVD "";
BA_ "EventCommandSignal" SG_ 516 VCU_ACCMaxRecpDecelVD 0;
BA_ "GatewayedSignals" SG_ 516 VCU_ACCMaxRecpDecelVD 0;
BA_ "GenSigInactiveValue" SG_ 516 VCU_ACCMaxRecpDecelVD 0;
BA_ "GenSigInvalidValue" SG_ 516 VCU_ACCMaxRecpDecelVD 0;
BA_ "GenSigSendType" SG_ 516 VCU_ACCMaxRecpDecelVD 1;
BA_ "GenSigStartValue" SG_ 516 VCU_ACCMaxRecpDecelVD 0;
BA_ "GenSigTimeoutValue" SG_ 516 VCU_ACCMaxRecpDecelVD 0;
BA_ "Remark" SG_ 516 VCU_ACCMaxRecpDecelVD "";
BA_ "EventCommandSignal" SG_ 516 VCU_ACCLimitOperatingSt 0;
BA_ "GatewayedSignals" SG_ 516 VCU_ACCLimitOperatingSt 0;
BA_ "GenSigInactiveValue" SG_ 516 VCU_ACCLimitOperatingSt 0;
BA_ "GenSigInvalidValue" SG_ 516 VCU_ACCLimitOperatingSt 0;
BA_ "GenSigSendType" SG_ 516 VCU_ACCLimitOperatingSt 1;
BA_ "GenSigStartValue" SG_ 516 VCU_ACCLimitOperatingSt 0;
BA_ "GenSigTimeoutValue" SG_ 516 VCU_ACCLimitOperatingSt 0;
BA_ "Remark" SG_ 516 VCU_ACCLimitOperatingSt "";
BA_ "EventCommandSignal" SG_ 516 VCU_APAResp 0;
BA_ "GatewayedSignals" SG_ 516 VCU_APAResp 0;
BA_ "GenSigInactiveValue" SG_ 516 VCU_APAResp 0;
BA_ "GenSigInvalidValue" SG_ 516 VCU_APAResp 0;
BA_ "GenSigSendType" SG_ 516 VCU_APAResp 1;
BA_ "GenSigStartValue" SG_ 516 VCU_APAResp 0;
BA_ "GenSigTimeoutValue" SG_ 516 VCU_APAResp 0;
BA_ "Remark" SG_ 516 VCU_APAResp "";
BA_ "EventCommandSignal" SG_ 516 VCU_ADSEcoModReq 0;
BA_ "GatewayedSignals" SG_ 516 VCU_ADSEcoModReq 0;
BA_ "GenSigInactiveValue" SG_ 516 VCU_ADSEcoModReq 0;
BA_ "GenSigInvalidValue" SG_ 516 VCU_ADSEcoModReq 0;
BA_ "GenSigSendType" SG_ 516 VCU_ADSEcoModReq 1;
BA_ "GenSigStartValue" SG_ 516 VCU_ADSEcoModReq 0;
BA_ "GenSigTimeoutValue" SG_ 516 VCU_ADSEcoModReq 0;
BA_ "Remark" SG_ 516 VCU_ADSEcoModReq "";
BA_ "EventCommandSignal" SG_ 516 VCU_AccButtInfo 0;
BA_ "GatewayedSignals" SG_ 516 VCU_AccButtInfo 0;
BA_ "GenSigInactiveValue" SG_ 516 VCU_AccButtInfo 0;
BA_ "GenSigInvalidValue" SG_ 516 VCU_AccButtInfo 0;
BA_ "GenSigSendType" SG_ 516 VCU_AccButtInfo 1;
BA_ "GenSigStartValue" SG_ 516 VCU_AccButtInfo 0;
BA_ "GenSigTimeoutValue" SG_ 516 VCU_AccButtInfo 0;
BA_ "Remark" SG_ 516 VCU_AccButtInfo "";
BA_ "EventCommandSignal" SG_ 516 VCU_ACCMaxRecpDecel 0;
BA_ "GatewayedSignals" SG_ 516 VCU_ACCMaxRecpDecel 0;
BA_ "GenSigInactiveValue" SG_ 516 VCU_ACCMaxRecpDecel 0;
BA_ "GenSigInvalidValue" SG_ 516 VCU_ACCMaxRecpDecel 0;
BA_ "GenSigSendType" SG_ 516 VCU_ACCMaxRecpDecel 1;
BA_ "GenSigStartValue" SG_ 516 VCU_ACCMaxRecpDecel 0;
BA_ "GenSigTimeoutValue" SG_ 516 VCU_ACCMaxRecpDecel 0;
BA_ "Remark" SG_ 516 VCU_ACCMaxRecpDecel "";
BA_ "EventCommandSignal" SG_ 516 VCU_ACCmaxSpdLimit 0;
BA_ "GatewayedSignals" SG_ 516 VCU_ACCmaxSpdLimit 0;
BA_ "GenSigInactiveValue" SG_ 516 VCU_ACCmaxSpdLimit 0;
BA_ "GenSigInvalidValue" SG_ 516 VCU_ACCmaxSpdLimit 0;
BA_ "GenSigSendType" SG_ 516 VCU_ACCmaxSpdLimit 1;
BA_ "GenSigStartValue" SG_ 516 VCU_ACCmaxSpdLimit 0;
BA_ "GenSigTimeoutValue" SG_ 516 VCU_ACCmaxSpdLimit 0;
BA_ "Remark" SG_ 516 VCU_ACCmaxSpdLimit "";
BA_ "EventCommandSignal" SG_ 516 VCU_APA_Resp 0;
BA_ "GatewayedSignals" SG_ 516 VCU_APA_Resp 0;
BA_ "GenSigInactiveValue" SG_ 516 VCU_APA_Resp 0;
BA_ "GenSigInvalidValue" SG_ 516 VCU_APA_Resp 0;
BA_ "GenSigSendType" SG_ 516 VCU_APA_Resp 1;
BA_ "GenSigStartValue" SG_ 516 VCU_APA_Resp 0;
BA_ "GenSigTimeoutValue" SG_ 516 VCU_APA_Resp 0;
BA_ "Remark" SG_ 516 VCU_APA_Resp "";
BA_ "EventCommandSignal" SG_ 516 VCU_RecpTorqFAVD 0;
BA_ "GatewayedSignals" SG_ 516 VCU_RecpTorqFAVD 0;
BA_ "GenSigInactiveValue" SG_ 516 VCU_RecpTorqFAVD 0;
BA_ "GenSigInvalidValue" SG_ 516 VCU_RecpTorqFAVD 0;
BA_ "GenSigSendType" SG_ 516 VCU_RecpTorqFAVD 1;
BA_ "GenSigStartValue" SG_ 516 VCU_RecpTorqFAVD 0;
BA_ "GenSigTimeoutValue" SG_ 516 VCU_RecpTorqFAVD 0;
BA_ "Remark" SG_ 516 VCU_RecpTorqFAVD "";
BA_ "EventCommandSignal" SG_ 516 VCU_RecpTorqRAVD 0;
BA_ "GatewayedSignals" SG_ 516 VCU_RecpTorqRAVD 0;
BA_ "GenSigInactiveValue" SG_ 516 VCU_RecpTorqRAVD 0;
BA_ "GenSigInvalidValue" SG_ 516 VCU_RecpTorqRAVD 0;
BA_ "GenSigSendType" SG_ 516 VCU_RecpTorqRAVD 1;
BA_ "GenSigStartValue" SG_ 516 VCU_RecpTorqRAVD 0;
BA_ "GenSigTimeoutValue" SG_ 516 VCU_RecpTorqRAVD 0;
BA_ "Remark" SG_ 516 VCU_RecpTorqRAVD "";
BA_ "EventCommandSignal" SG_ 516 VCU_MaxRecpTorqFAVD 0;
BA_ "GatewayedSignals" SG_ 516 VCU_MaxRecpTorqFAVD 0;
BA_ "GenSigInactiveValue" SG_ 516 VCU_MaxRecpTorqFAVD 0;
BA_ "GenSigInvalidValue" SG_ 516 VCU_MaxRecpTorqFAVD 0;
BA_ "GenSigSendType" SG_ 516 VCU_MaxRecpTorqFAVD 1;
BA_ "GenSigStartValue" SG_ 516 VCU_MaxRecpTorqFAVD 0;
BA_ "GenSigTimeoutValue" SG_ 516 VCU_MaxRecpTorqFAVD 0;
BA_ "Remark" SG_ 516 VCU_MaxRecpTorqFAVD "";
BA_ "EventCommandSignal" SG_ 516 VCU_MaxRecpTorqRAVD 0;
BA_ "GatewayedSignals" SG_ 516 VCU_MaxRecpTorqRAVD 0;
BA_ "GenSigInactiveValue" SG_ 516 VCU_MaxRecpTorqRAVD 0;
BA_ "GenSigInvalidValue" SG_ 516 VCU_MaxRecpTorqRAVD 0;
BA_ "GenSigSendType" SG_ 516 VCU_MaxRecpTorqRAVD 1;
BA_ "GenSigStartValue" SG_ 516 VCU_MaxRecpTorqRAVD 0;
BA_ "GenSigTimeoutValue" SG_ 516 VCU_MaxRecpTorqRAVD 0;
BA_ "Remark" SG_ 516 VCU_MaxRecpTorqRAVD "";
BA_ "EventCommandSignal" SG_ 516 VCU_RecpTorqNm 0;
BA_ "GatewayedSignals" SG_ 516 VCU_RecpTorqNm 0;
BA_ "GenSigInactiveValue" SG_ 516 VCU_RecpTorqNm 0;
BA_ "GenSigInvalidValue" SG_ 516 VCU_RecpTorqNm 0;
BA_ "GenSigSendType" SG_ 516 VCU_RecpTorqNm 1;
BA_ "GenSigStartValue" SG_ 516 VCU_RecpTorqNm 0;
BA_ "GenSigTimeoutValue" SG_ 516 VCU_RecpTorqNm 0;
BA_ "Remark" SG_ 516 VCU_RecpTorqNm "";
BA_ "EventCommandSignal" SG_ 516 VCU_APAWheelTorqDriverReqNm 0;
BA_ "GatewayedSignals" SG_ 516 VCU_APAWheelTorqDriverReqNm 0;
BA_ "GenSigInactiveValue" SG_ 516 VCU_APAWheelTorqDriverReqNm 0;
BA_ "GenSigInvalidValue" SG_ 516 VCU_APAWheelTorqDriverReqNm 32767;
BA_ "GenSigSendType" SG_ 516 VCU_APAWheelTorqDriverReqNm 1;
BA_ "GenSigStartValue" SG_ 516 VCU_APAWheelTorqDriverReqNm 32766;
BA_ "GenSigTimeoutValue" SG_ 516 VCU_APAWheelTorqDriverReqNm 0;
BA_ "Remark" SG_ 516 VCU_APAWheelTorqDriverReqNm "";
BA_ "EventCommandSignal" SG_ 516 VCU_ActVehWheelTorqNm 0;
BA_ "GatewayedSignals" SG_ 516 VCU_ActVehWheelTorqNm 0;
BA_ "GenSigInactiveValue" SG_ 516 VCU_ActVehWheelTorqNm 0;
BA_ "GenSigInvalidValue" SG_ 516 VCU_ActVehWheelTorqNm 32767;
BA_ "GenSigSendType" SG_ 516 VCU_ActVehWheelTorqNm 1;
BA_ "GenSigStartValue" SG_ 516 VCU_ActVehWheelTorqNm 32766;
BA_ "GenSigTimeoutValue" SG_ 516 VCU_ActVehWheelTorqNm 0;
BA_ "Remark" SG_ 516 VCU_ActVehWheelTorqNm "";
BA_ "EventCommandSignal" SG_ 516 VCU_VehWheelTorqMinNm 0;
BA_ "GatewayedSignals" SG_ 516 VCU_VehWheelTorqMinNm 0;
BA_ "GenSigInactiveValue" SG_ 516 VCU_VehWheelTorqMinNm 0;
BA_ "GenSigInvalidValue" SG_ 516 VCU_VehWheelTorqMinNm 32767;
BA_ "GenSigSendType" SG_ 516 VCU_VehWheelTorqMinNm 1;
BA_ "GenSigStartValue" SG_ 516 VCU_VehWheelTorqMinNm 32766;
BA_ "GenSigTimeoutValue" SG_ 516 VCU_VehWheelTorqMinNm 0;
BA_ "Remark" SG_ 516 VCU_VehWheelTorqMinNm "";
BA_ "EventCommandSignal" SG_ 516 VCU_VehWheelTorqMaxNm 0;
BA_ "GatewayedSignals" SG_ 516 VCU_VehWheelTorqMaxNm 0;
BA_ "GenSigInactiveValue" SG_ 516 VCU_VehWheelTorqMaxNm 0;
BA_ "GenSigInvalidValue" SG_ 516 VCU_VehWheelTorqMaxNm 32767;
BA_ "GenSigSendType" SG_ 516 VCU_VehWheelTorqMaxNm 1;
BA_ "GenSigStartValue" SG_ 516 VCU_VehWheelTorqMaxNm 32766;
BA_ "GenSigTimeoutValue" SG_ 516 VCU_VehWheelTorqMaxNm 0;
BA_ "Remark" SG_ 516 VCU_VehWheelTorqMaxNm "";
BA_ "EventCommandSignal" SG_ 516 VCU_RecpTorqFA 0;
BA_ "GatewayedSignals" SG_ 516 VCU_RecpTorqFA 0;
BA_ "GenSigInactiveValue" SG_ 516 VCU_RecpTorqFA 0;
BA_ "GenSigInvalidValue" SG_ 516 VCU_RecpTorqFA 0;
BA_ "GenSigSendType" SG_ 516 VCU_RecpTorqFA 1;
BA_ "GenSigStartValue" SG_ 516 VCU_RecpTorqFA 0;
BA_ "GenSigTimeoutValue" SG_ 516 VCU_RecpTorqFA 0;
BA_ "Remark" SG_ 516 VCU_RecpTorqFA "";
BA_ "EventCommandSignal" SG_ 516 VCU_RecpTorqRA 0;
BA_ "GatewayedSignals" SG_ 516 VCU_RecpTorqRA 0;
BA_ "GenSigInactiveValue" SG_ 516 VCU_RecpTorqRA 0;
BA_ "GenSigInvalidValue" SG_ 516 VCU_RecpTorqRA 0;
BA_ "GenSigSendType" SG_ 516 VCU_RecpTorqRA 1;
BA_ "GenSigStartValue" SG_ 516 VCU_RecpTorqRA 0;
BA_ "GenSigTimeoutValue" SG_ 516 VCU_RecpTorqRA 0;
BA_ "Remark" SG_ 516 VCU_RecpTorqRA "";
BA_ "EventCommandSignal" SG_ 516 VCU_MaxRecpTorqFA 0;
BA_ "GatewayedSignals" SG_ 516 VCU_MaxRecpTorqFA 0;
BA_ "GenSigInactiveValue" SG_ 516 VCU_MaxRecpTorqFA 0;
BA_ "GenSigInvalidValue" SG_ 516 VCU_MaxRecpTorqFA 0;
BA_ "GenSigSendType" SG_ 516 VCU_MaxRecpTorqFA 1;
BA_ "GenSigStartValue" SG_ 516 VCU_MaxRecpTorqFA 0;
BA_ "GenSigTimeoutValue" SG_ 516 VCU_MaxRecpTorqFA 0;
BA_ "Remark" SG_ 516 VCU_MaxRecpTorqFA "";
BA_ "EventCommandSignal" SG_ 516 VCU_MaxRecpTorqRA 0;
BA_ "GatewayedSignals" SG_ 516 VCU_MaxRecpTorqRA 0;
BA_ "GenSigInactiveValue" SG_ 516 VCU_MaxRecpTorqRA 0;
BA_ "GenSigInvalidValue" SG_ 516 VCU_MaxRecpTorqRA 0;
BA_ "GenSigSendType" SG_ 516 VCU_MaxRecpTorqRA 1;
BA_ "GenSigStartValue" SG_ 516 VCU_MaxRecpTorqRA 0;
BA_ "GenSigTimeoutValue" SG_ 516 VCU_MaxRecpTorqRA 0;
BA_ "Remark" SG_ 516 VCU_MaxRecpTorqRA "";
BA_ "EventCommandSignal" SG_ 516 VCU_BcsDecelEnable 0;
BA_ "GatewayedSignals" SG_ 516 VCU_BcsDecelEnable 0;
BA_ "GenSigInactiveValue" SG_ 516 VCU_BcsDecelEnable 0;
BA_ "GenSigInvalidValue" SG_ 516 VCU_BcsDecelEnable 0;
BA_ "GenSigSendType" SG_ 516 VCU_BcsDecelEnable 1;
BA_ "GenSigStartValue" SG_ 516 VCU_BcsDecelEnable 0;
BA_ "GenSigTimeoutValue" SG_ 516 VCU_BcsDecelEnable 0;
BA_ "Remark" SG_ 516 VCU_BcsDecelEnable "";
BA_ "EventCommandSignal" SG_ 516 VCU_CrntGearNoTrans 0;
BA_ "GatewayedSignals" SG_ 516 VCU_CrntGearNoTrans 0;
BA_ "GenSigInactiveValue" SG_ 516 VCU_CrntGearNoTrans 0;
BA_ "GenSigInvalidValue" SG_ 516 VCU_CrntGearNoTrans 0;
BA_ "GenSigSendType" SG_ 516 VCU_CrntGearNoTrans 1;
BA_ "GenSigStartValue" SG_ 516 VCU_CrntGearNoTrans 0;
BA_ "GenSigTimeoutValue" SG_ 516 VCU_CrntGearNoTrans 0;
BA_ "Remark" SG_ 516 VCU_CrntGearNoTrans "";
BA_ "EventCommandSignal" SG_ 516 VCU_EzTSt 0;
BA_ "GatewayedSignals" SG_ 516 VCU_EzTSt 0;
BA_ "GenSigInactiveValue" SG_ 516 VCU_EzTSt 0;
BA_ "GenSigInvalidValue" SG_ 516 VCU_EzTSt 0;
BA_ "GenSigSendType" SG_ 516 VCU_EzTSt 1;
BA_ "GenSigStartValue" SG_ 516 VCU_EzTSt 0;
BA_ "GenSigTimeoutValue" SG_ 516 VCU_EzTSt 0;
BA_ "Remark" SG_ 516 VCU_EzTSt "";
BA_ "EventCommandSignal" SG_ 516 VCU_ITASSt 0;
BA_ "GatewayedSignals" SG_ 516 VCU_ITASSt 0;
BA_ "GenSigInactiveValue" SG_ 516 VCU_ITASSt 0;
BA_ "GenSigInvalidValue" SG_ 516 VCU_ITASSt 0;
BA_ "GenSigSendType" SG_ 516 VCU_ITASSt 1;
BA_ "GenSigStartValue" SG_ 516 VCU_ITASSt 0;
BA_ "GenSigTimeoutValue" SG_ 516 VCU_ITASSt 0;
BA_ "Remark" SG_ 516 VCU_ITASSt "";
BA_ "EventCommandSignal" SG_ 616 CCU_1_CRC 0;
BA_ "GatewayedSignals" SG_ 616 CCU_1_CRC 0;
BA_ "GenSigInactiveValue" SG_ 616 CCU_1_CRC 0;
BA_ "GenSigInvalidValue" SG_ 616 CCU_1_CRC 0;
BA_ "GenSigSendType" SG_ 616 CCU_1_CRC 1;
BA_ "GenSigStartValue" SG_ 616 CCU_1_CRC 0;
BA_ "GenSigTimeoutValue" SG_ 616 CCU_1_CRC 0;
BA_ "Remark" SG_ 616 CCU_1_CRC "";
BA_ "EventCommandSignal" SG_ 616 CCU_1_Counter 0;
BA_ "GatewayedSignals" SG_ 616 CCU_1_Counter 0;
BA_ "GenSigInactiveValue" SG_ 616 CCU_1_Counter 0;
BA_ "GenSigInvalidValue" SG_ 616 CCU_1_Counter 0;
BA_ "GenSigSendType" SG_ 616 CCU_1_Counter 1;
BA_ "GenSigStartValue" SG_ 616 CCU_1_Counter 0;
BA_ "GenSigTimeoutValue" SG_ 616 CCU_1_Counter 0;
BA_ "Remark" SG_ 616 CCU_1_Counter "";
BA_ "EventCommandSignal" SG_ 616 UMM_UsageModeSt 0;
BA_ "GatewayedSignals" SG_ 616 UMM_UsageModeSt 0;
BA_ "GenSigInactiveValue" SG_ 616 UMM_UsageModeSt 0;
BA_ "GenSigInvalidValue" SG_ 616 UMM_UsageModeSt 0;
BA_ "GenSigSendType" SG_ 616 UMM_UsageModeSt 1;
BA_ "GenSigStartValue" SG_ 616 UMM_UsageModeSt 7;
BA_ "GenSigTimeoutValue" SG_ 616 UMM_UsageModeSt 0;
BA_ "Remark" SG_ 616 UMM_UsageModeSt "";
BA_ "EventCommandSignal" SG_ 616 OTA_FuncReq_ADCWakeup 0;
BA_ "GatewayedSignals" SG_ 616 OTA_FuncReq_ADCWakeup 0;
BA_ "GenSigInactiveValue" SG_ 616 OTA_FuncReq_ADCWakeup 0;
BA_ "GenSigInvalidValue" SG_ 616 OTA_FuncReq_ADCWakeup 0;
BA_ "GenSigSendType" SG_ 616 OTA_FuncReq_ADCWakeup 1;
BA_ "GenSigStartValue" SG_ 616 OTA_FuncReq_ADCWakeup 0;
BA_ "GenSigTimeoutValue" SG_ 616 OTA_FuncReq_ADCWakeup 0;
BA_ "Remark" SG_ 616 OTA_FuncReq_ADCWakeup "";
BA_ "EventCommandSignal" SG_ 616 UMM_FrontPassengerSeatSt 0;
BA_ "GatewayedSignals" SG_ 616 UMM_FrontPassengerSeatSt 0;
BA_ "GenSigInactiveValue" SG_ 616 UMM_FrontPassengerSeatSt 0;
BA_ "GenSigInvalidValue" SG_ 616 UMM_FrontPassengerSeatSt 0;
BA_ "GenSigSendType" SG_ 616 UMM_FrontPassengerSeatSt 1;
BA_ "GenSigStartValue" SG_ 616 UMM_FrontPassengerSeatSt 0;
BA_ "GenSigTimeoutValue" SG_ 616 UMM_FrontPassengerSeatSt 0;
BA_ "Remark" SG_ 616 UMM_FrontPassengerSeatSt "";
BA_ "EventCommandSignal" SG_ 616 UMM_DriverSeatSt 0;
BA_ "GatewayedSignals" SG_ 616 UMM_DriverSeatSt 0;
BA_ "GenSigInactiveValue" SG_ 616 UMM_DriverSeatSt 0;
BA_ "GenSigInvalidValue" SG_ 616 UMM_DriverSeatSt 0;
BA_ "GenSigSendType" SG_ 616 UMM_DriverSeatSt 1;
BA_ "GenSigStartValue" SG_ 616 UMM_DriverSeatSt 0;
BA_ "GenSigTimeoutValue" SG_ 616 UMM_DriverSeatSt 0;
BA_ "Remark" SG_ 616 UMM_DriverSeatSt "";
BA_ "EventCommandSignal" SG_ 616 VMM_VehModeSt 0;
BA_ "GatewayedSignals" SG_ 616 VMM_VehModeSt 0;
BA_ "GenSigInactiveValue" SG_ 616 VMM_VehModeSt 0;
BA_ "GenSigInvalidValue" SG_ 616 VMM_VehModeSt 15;
BA_ "GenSigSendType" SG_ 616 VMM_VehModeSt 1;
BA_ "GenSigStartValue" SG_ 616 VMM_VehModeSt 15;
BA_ "GenSigTimeoutValue" SG_ 616 VMM_VehModeSt 15;
BA_ "Remark" SG_ 616 VMM_VehModeSt "";
BA_ "EventCommandSignal" SG_ 616 VMM_LastVehModeSt 0;
BA_ "GatewayedSignals" SG_ 616 VMM_LastVehModeSt 0;
BA_ "GenSigInactiveValue" SG_ 616 VMM_LastVehModeSt 0;
BA_ "GenSigInvalidValue" SG_ 616 VMM_LastVehModeSt 15;
BA_ "GenSigSendType" SG_ 616 VMM_LastVehModeSt 1;
BA_ "GenSigStartValue" SG_ 616 VMM_LastVehModeSt 15;
BA_ "GenSigTimeoutValue" SG_ 616 VMM_LastVehModeSt 15;
BA_ "Remark" SG_ 616 VMM_LastVehModeSt "";
BA_ "EventCommandSignal" SG_ 616 VMM_OTAModeSt 0;
BA_ "GatewayedSignals" SG_ 616 VMM_OTAModeSt 0;
BA_ "GenSigInactiveValue" SG_ 616 VMM_OTAModeSt 0;
BA_ "GenSigInvalidValue" SG_ 616 VMM_OTAModeSt 2;
BA_ "GenSigSendType" SG_ 616 VMM_OTAModeSt 1;
BA_ "GenSigStartValue" SG_ 616 VMM_OTAModeSt 0;
BA_ "GenSigTimeoutValue" SG_ 616 VMM_OTAModeSt 0;
BA_ "Remark" SG_ 616 VMM_OTAModeSt "";
BA_ "EventCommandSignal" SG_ 616 CSM_RC_PAARequest 0;
BA_ "GatewayedSignals" SG_ 616 CSM_RC_PAARequest 0;
BA_ "GenSigInactiveValue" SG_ 616 CSM_RC_PAARequest 0;
BA_ "GenSigInvalidValue" SG_ 616 CSM_RC_PAARequest 0;
BA_ "GenSigSendType" SG_ 616 CSM_RC_PAARequest 1;
BA_ "GenSigStartValue" SG_ 616 CSM_RC_PAARequest 0;
BA_ "GenSigTimeoutValue" SG_ 616 CSM_RC_PAARequest 0;
BA_ "Remark" SG_ 616 CSM_RC_PAARequest "";
BA_ "EventCommandSignal" SG_ 616 CSM_RC_AuthSt 0;
BA_ "GatewayedSignals" SG_ 616 CSM_RC_AuthSt 0;
BA_ "GenSigInactiveValue" SG_ 616 CSM_RC_AuthSt 0;
BA_ "GenSigInvalidValue" SG_ 616 CSM_RC_AuthSt 0;
BA_ "GenSigSendType" SG_ 616 CSM_RC_AuthSt 1;
BA_ "GenSigStartValue" SG_ 616 CSM_RC_AuthSt 0;
BA_ "GenSigTimeoutValue" SG_ 616 CSM_RC_AuthSt 0;
BA_ "Remark" SG_ 616 CSM_RC_AuthSt "";
BA_ "EventCommandSignal" SG_ 616 IPDS_EnablePowerSup 0;
BA_ "GatewayedSignals" SG_ 616 IPDS_EnablePowerSup 0;
BA_ "GenSigInactiveValue" SG_ 616 IPDS_EnablePowerSup 0;
BA_ "GenSigInvalidValue" SG_ 616 IPDS_EnablePowerSup 0;
BA_ "GenSigSendType" SG_ 616 IPDS_EnablePowerSup 1;
BA_ "GenSigStartValue" SG_ 616 IPDS_EnablePowerSup 0;
BA_ "GenSigTimeoutValue" SG_ 616 IPDS_EnablePowerSup 0;
BA_ "Remark" SG_ 616 IPDS_EnablePowerSup "";
BA_ "EventCommandSignal" SG_ 616 Time_Year 0;
BA_ "GatewayedSignals" SG_ 616 Time_Year 0;
BA_ "GenSigInactiveValue" SG_ 616 Time_Year 0;
BA_ "GenSigInvalidValue" SG_ 616 Time_Year 0;
BA_ "GenSigSendType" SG_ 616 Time_Year 1;
BA_ "GenSigStartValue" SG_ 616 Time_Year 0;
BA_ "GenSigTimeoutValue" SG_ 616 Time_Year 0;
BA_ "Remark" SG_ 616 Time_Year "";
BA_ "EventCommandSignal" SG_ 616 Time_Month 0;
BA_ "GatewayedSignals" SG_ 616 Time_Month 0;
BA_ "GenSigInactiveValue" SG_ 616 Time_Month 0;
BA_ "GenSigInvalidValue" SG_ 616 Time_Month 0;
BA_ "GenSigSendType" SG_ 616 Time_Month 1;
BA_ "GenSigStartValue" SG_ 616 Time_Month 0;
BA_ "GenSigTimeoutValue" SG_ 616 Time_Month 0;
BA_ "Remark" SG_ 616 Time_Month "";
BA_ "EventCommandSignal" SG_ 616 Time_Day 0;
BA_ "GatewayedSignals" SG_ 616 Time_Day 0;
BA_ "GenSigInactiveValue" SG_ 616 Time_Day 0;
BA_ "GenSigInvalidValue" SG_ 616 Time_Day 0;
BA_ "GenSigSendType" SG_ 616 Time_Day 1;
BA_ "GenSigStartValue" SG_ 616 Time_Day 1;
BA_ "GenSigTimeoutValue" SG_ 616 Time_Day 0;
BA_ "Remark" SG_ 616 Time_Day "";
BA_ "EventCommandSignal" SG_ 616 Time_Hour 0;
BA_ "GatewayedSignals" SG_ 616 Time_Hour 0;
BA_ "GenSigInactiveValue" SG_ 616 Time_Hour 0;
BA_ "GenSigInvalidValue" SG_ 616 Time_Hour 0;
BA_ "GenSigSendType" SG_ 616 Time_Hour 1;
BA_ "GenSigStartValue" SG_ 616 Time_Hour 1;
BA_ "GenSigTimeoutValue" SG_ 616 Time_Hour 0;
BA_ "Remark" SG_ 616 Time_Hour "";
BA_ "EventCommandSignal" SG_ 616 Time_Min 0;
BA_ "GatewayedSignals" SG_ 616 Time_Min 0;
BA_ "GenSigInactiveValue" SG_ 616 Time_Min 0;
BA_ "GenSigInvalidValue" SG_ 616 Time_Min 0;
BA_ "GenSigSendType" SG_ 616 Time_Min 1;
BA_ "GenSigStartValue" SG_ 616 Time_Min 1;
BA_ "GenSigTimeoutValue" SG_ 616 Time_Min 0;
BA_ "Remark" SG_ 616 Time_Min "";
BA_ "EventCommandSignal" SG_ 616 Time_Sec 0;
BA_ "GatewayedSignals" SG_ 616 Time_Sec 0;
BA_ "GenSigInactiveValue" SG_ 616 Time_Sec 0;
BA_ "GenSigInvalidValue" SG_ 616 Time_Sec 0;
BA_ "GenSigSendType" SG_ 616 Time_Sec 1;
BA_ "GenSigStartValue" SG_ 616 Time_Sec 1;
BA_ "GenSigTimeoutValue" SG_ 616 Time_Sec 0;
BA_ "Remark" SG_ 616 Time_Sec "";
BA_ "EventCommandSignal" SG_ 616 CCU_DstFlag 0;
BA_ "GatewayedSignals" SG_ 616 CCU_DstFlag 0;
BA_ "GenSigInactiveValue" SG_ 616 CCU_DstFlag 0;
BA_ "GenSigInvalidValue" SG_ 616 CCU_DstFlag 0;
BA_ "GenSigSendType" SG_ 616 CCU_DstFlag 1;
BA_ "GenSigStartValue" SG_ 616 CCU_DstFlag 0;
BA_ "GenSigTimeoutValue" SG_ 616 CCU_DstFlag 0;
BA_ "Remark" SG_ 616 CCU_DstFlag "";
BA_ "EventCommandSignal" SG_ 616 ASB_DriverActiveBeltFaultSt 0;
BA_ "GatewayedSignals" SG_ 616 ASB_DriverActiveBeltFaultSt 0;
BA_ "GenSigInactiveValue" SG_ 616 ASB_DriverActiveBeltFaultSt 0;
BA_ "GenSigInvalidValue" SG_ 616 ASB_DriverActiveBeltFaultSt 0;
BA_ "GenSigSendType" SG_ 616 ASB_DriverActiveBeltFaultSt 0;
BA_ "GenSigStartValue" SG_ 616 ASB_DriverActiveBeltFaultSt 0;
BA_ "GenSigTimeoutValue" SG_ 616 ASB_DriverActiveBeltFaultSt 1;
BA_ "Remark" SG_ 616 ASB_DriverActiveBeltFaultSt "";
BA_ "EventCommandSignal" SG_ 816 HVAC_RearDefrostSt 0;
BA_ "GatewayedSignals" SG_ 816 HVAC_RearDefrostSt 0;
BA_ "GenSigInactiveValue" SG_ 816 HVAC_RearDefrostSt 0;
BA_ "GenSigInvalidValue" SG_ 816 HVAC_RearDefrostSt 0;
BA_ "GenSigSendType" SG_ 816 HVAC_RearDefrostSt 1;
BA_ "GenSigStartValue" SG_ 816 HVAC_RearDefrostSt 0;
BA_ "GenSigTimeoutValue" SG_ 816 HVAC_RearDefrostSt 0;
BA_ "Remark" SG_ 816 HVAC_RearDefrostSt "";
BA_ "EventCommandSignal" SG_ 816 HVAC_WindExitMode 0;
BA_ "GatewayedSignals" SG_ 816 HVAC_WindExitMode 0;
BA_ "GenSigInactiveValue" SG_ 816 HVAC_WindExitMode 0;
BA_ "GenSigInvalidValue" SG_ 816 HVAC_WindExitMode 0;
BA_ "GenSigSendType" SG_ 816 HVAC_WindExitMode 1;
BA_ "GenSigStartValue" SG_ 816 HVAC_WindExitMode 0;
BA_ "GenSigTimeoutValue" SG_ 816 HVAC_WindExitMode 0;
BA_ "Remark" SG_ 816 HVAC_WindExitMode "";
BA_ "EventCommandSignal" SG_ 816 HVAC_CorrectedExterTemp 0;
BA_ "GatewayedSignals" SG_ 816 HVAC_CorrectedExterTemp 0;
BA_ "GenSigInactiveValue" SG_ 816 HVAC_CorrectedExterTemp 0;
BA_ "GenSigInvalidValue" SG_ 816 HVAC_CorrectedExterTemp 0;
BA_ "GenSigSendType" SG_ 816 HVAC_CorrectedExterTemp 1;
BA_ "GenSigStartValue" SG_ 816 HVAC_CorrectedExterTemp 120;
BA_ "GenSigTimeoutValue" SG_ 816 HVAC_CorrectedExterTemp 120;
BA_ "Remark" SG_ 816 HVAC_CorrectedExterTemp "";
BA_ "EventCommandSignal" SG_ 816 HVAC_CorrectedExterTempVD 0;
BA_ "GatewayedSignals" SG_ 816 HVAC_CorrectedExterTempVD 0;
BA_ "GenSigInactiveValue" SG_ 816 HVAC_CorrectedExterTempVD 0;
BA_ "GenSigInvalidValue" SG_ 816 HVAC_CorrectedExterTempVD 0;
BA_ "GenSigSendType" SG_ 816 HVAC_CorrectedExterTempVD 1;
BA_ "GenSigStartValue" SG_ 816 HVAC_CorrectedExterTempVD 0;
BA_ "GenSigTimeoutValue" SG_ 816 HVAC_CorrectedExterTempVD 0;
BA_ "Remark" SG_ 816 HVAC_CorrectedExterTempVD "";
BA_ "EventCommandSignal" SG_ 816 HVAC_CorrectedCabinTemp 0;
BA_ "GatewayedSignals" SG_ 816 HVAC_CorrectedCabinTemp 0;
BA_ "GenSigInactiveValue" SG_ 816 HVAC_CorrectedCabinTemp 0;
BA_ "GenSigInvalidValue" SG_ 816 HVAC_CorrectedCabinTemp 0;
BA_ "GenSigSendType" SG_ 816 HVAC_CorrectedCabinTemp 1;
BA_ "GenSigStartValue" SG_ 816 HVAC_CorrectedCabinTemp 120;
BA_ "GenSigTimeoutValue" SG_ 816 HVAC_CorrectedCabinTemp 120;
BA_ "Remark" SG_ 816 HVAC_CorrectedCabinTemp "";
BA_ "EventCommandSignal" SG_ 816 HVAC_CorrectedCabinTempVD 0;
BA_ "GatewayedSignals" SG_ 816 HVAC_CorrectedCabinTempVD 0;
BA_ "GenSigInactiveValue" SG_ 816 HVAC_CorrectedCabinTempVD 0;
BA_ "GenSigInvalidValue" SG_ 816 HVAC_CorrectedCabinTempVD 0;
BA_ "GenSigSendType" SG_ 816 HVAC_CorrectedCabinTempVD 1;
BA_ "GenSigStartValue" SG_ 816 HVAC_CorrectedCabinTempVD 0;
BA_ "GenSigTimeoutValue" SG_ 816 HVAC_CorrectedCabinTempVD 0;
BA_ "Remark" SG_ 816 HVAC_CorrectedCabinTempVD "";
BA_ "EventCommandSignal" SG_ 960 TMS_4_CRC 0;
BA_ "GatewayedSignals" SG_ 960 TMS_4_CRC 0;
BA_ "GenSigInactiveValue" SG_ 960 TMS_4_CRC 0;
BA_ "GenSigInvalidValue" SG_ 960 TMS_4_CRC 0;
BA_ "GenSigSendType" SG_ 960 TMS_4_CRC 1;
BA_ "GenSigStartValue" SG_ 960 TMS_4_CRC 0;
BA_ "GenSigTimeoutValue" SG_ 960 TMS_4_CRC 0;
BA_ "Remark" SG_ 960 TMS_4_CRC "";
BA_ "EventCommandSignal" SG_ 960 TMS_4_Counter 0;
BA_ "GatewayedSignals" SG_ 960 TMS_4_Counter 0;
BA_ "GenSigInactiveValue" SG_ 960 TMS_4_Counter 0;
BA_ "GenSigInvalidValue" SG_ 960 TMS_4_Counter 0;
BA_ "GenSigSendType" SG_ 960 TMS_4_Counter 1;
BA_ "GenSigStartValue" SG_ 960 TMS_4_Counter 0;
BA_ "GenSigTimeoutValue" SG_ 960 TMS_4_Counter 0;
BA_ "Remark" SG_ 960 TMS_4_Counter "";
BA_ "EventCommandSignal" SG_ 960 TMS_MotRadrOutCooltT 0;
BA_ "GatewayedSignals" SG_ 960 TMS_MotRadrOutCooltT 0;
BA_ "GenSigInactiveValue" SG_ 960 TMS_MotRadrOutCooltT 0;
BA_ "GenSigInvalidValue" SG_ 960 TMS_MotRadrOutCooltT 0;
BA_ "GenSigSendType" SG_ 960 TMS_MotRadrOutCooltT 1;
BA_ "GenSigStartValue" SG_ 960 TMS_MotRadrOutCooltT 130;
BA_ "GenSigTimeoutValue" SG_ 960 TMS_MotRadrOutCooltT 130;
BA_ "Remark" SG_ 960 TMS_MotRadrOutCooltT "";
BA_ "EventCommandSignal" SG_ 960 TMS_MotRadrOutCooltTVld 0;
BA_ "GatewayedSignals" SG_ 960 TMS_MotRadrOutCooltTVld 0;
BA_ "GenSigInactiveValue" SG_ 960 TMS_MotRadrOutCooltTVld 0;
BA_ "GenSigInvalidValue" SG_ 960 TMS_MotRadrOutCooltTVld 0;
BA_ "GenSigSendType" SG_ 960 TMS_MotRadrOutCooltTVld 1;
BA_ "GenSigStartValue" SG_ 960 TMS_MotRadrOutCooltTVld 0;
BA_ "GenSigTimeoutValue" SG_ 960 TMS_MotRadrOutCooltTVld 0;
BA_ "Remark" SG_ 960 TMS_MotRadrOutCooltTVld "";
BA_ "EventCommandSignal" SG_ 960 TMS_WtrPmp1Fault 0;
BA_ "GatewayedSignals" SG_ 960 TMS_WtrPmp1Fault 0;
BA_ "GenSigInactiveValue" SG_ 960 TMS_WtrPmp1Fault 0;
BA_ "GenSigInvalidValue" SG_ 960 TMS_WtrPmp1Fault 0;
BA_ "GenSigSendType" SG_ 960 TMS_WtrPmp1Fault 1;
BA_ "GenSigStartValue" SG_ 960 TMS_WtrPmp1Fault 0;
BA_ "GenSigTimeoutValue" SG_ 960 TMS_WtrPmp1Fault 1;
BA_ "Remark" SG_ 960 TMS_WtrPmp1Fault "";
BA_ "EventCommandSignal" SG_ 960 HVAC_AutoFogFlt 0;
BA_ "GatewayedSignals" SG_ 960 HVAC_AutoFogFlt 0;
BA_ "GenSigInactiveValue" SG_ 960 HVAC_AutoFogFlt 0;
BA_ "GenSigInvalidValue" SG_ 960 HVAC_AutoFogFlt 0;
BA_ "GenSigSendType" SG_ 960 HVAC_AutoFogFlt 1;
BA_ "GenSigStartValue" SG_ 960 HVAC_AutoFogFlt 0;
BA_ "GenSigTimeoutValue" SG_ 960 HVAC_AutoFogFlt 0;
BA_ "Remark" SG_ 960 HVAC_AutoFogFlt "";
BA_ "EventCommandSignal" SG_ 960 HVAC_AutoFogSts 0;
BA_ "GatewayedSignals" SG_ 960 HVAC_AutoFogSts 0;
BA_ "GenSigInactiveValue" SG_ 960 HVAC_AutoFogSts 0;
BA_ "GenSigInvalidValue" SG_ 960 HVAC_AutoFogSts 0;
BA_ "GenSigSendType" SG_ 960 HVAC_AutoFogSts 1;
BA_ "GenSigStartValue" SG_ 960 HVAC_AutoFogSts 0;
BA_ "GenSigTimeoutValue" SG_ 960 HVAC_AutoFogSts 0;
BA_ "Remark" SG_ 960 HVAC_AutoFogSts "";
BA_ "EventCommandSignal" SG_ 960 TMS_TWVlv1FaultSt 0;
BA_ "GatewayedSignals" SG_ 960 TMS_TWVlv1FaultSt 0;
BA_ "GenSigInactiveValue" SG_ 960 TMS_TWVlv1FaultSt 0;
BA_ "GenSigInvalidValue" SG_ 960 TMS_TWVlv1FaultSt 0;
BA_ "GenSigSendType" SG_ 960 TMS_TWVlv1FaultSt 1;
BA_ "GenSigStartValue" SG_ 960 TMS_TWVlv1FaultSt 0;
BA_ "GenSigTimeoutValue" SG_ 960 TMS_TWVlv1FaultSt 0;
BA_ "Remark" SG_ 960 TMS_TWVlv1FaultSt "";

VAL_ 93 CCU_ADCSoCWakeupRequest 0 "No Request" 1 "Request" 2 "Reserved" 3 "Reserved" 4 "Reserved" 5 "Reserved" 6 "Reserved" 7 "Reserved"  ;
VAL_ 127 ADC_IMMO 0 "Matching succeeded (saving pin and ESK succeeded)" 1 "Matching timeout (timeout for saving pin or ESK)）" 2 "Consistent pin and inconsistent ESK" 3 "Inconsistent pin and consistent ESK" 4 "Inconsistent pin and inconsistent ESK"  ;
VAL_ 704 IPS_DCDCModeSt 7 "Failure;" 3 "Active - Buck Mode;" 2 "Connected (HV is active);" 1 "Disconnected;" 0 "Init;"  ;
VAL_ 918 UINM_PADS_ResponseErr 0 "No Error" 1 "Error"  ;
VAL_ 918 UINM_PADS_CustomSWSt 0 "not active;" 1 "active;"  ;
VAL_ 918 UINM_PADS_CustomSWStVD 0 "Not valid" 1 "Valid"  ;
VAL_ 918 UINM_PADS_CustomSWstuck 0 "Normal" 1 "stuck"  ;
VAL_ 918 UINM_PADS_IDC_PlaySWSt 0 "not active;" 1 "active;"  ;
VAL_ 918 UINM_PADS_IDC_PlaySWStVD 0 "Not valid" 1 "Valid"  ;
VAL_ 918 UINM_PADS_CruSetSpeedRollerRotatedDir 0 "Not rotated" 1 "Forward" 2 "Backward" 3 "Not used"  ;
VAL_ 918 UINM_PADS_FolDistIncSWSt 0 "not active;" 1 "active;"  ;
VAL_ 918 UINM_PADS_FolDistIncSWStVD 0 "Not valid" 1 "Valid"  ;
VAL_ 918 UINM_PADS_FolDistIncSWStuckSt 0 "Normal" 1 "stuck"  ;
VAL_ 918 UINM_PADS_FolDistDecSWStVD 0 "Not valid" 1 "Valid"  ;
VAL_ 918 UINM_PADS_FolDistDecSWStuckSt 0 "Normal" 1 "stuck"  ;
VAL_ 918 UINM_PADS_OKSWSt 0 "not active;" 1 "active;"  ;
VAL_ 918 UINM_PADS_OKSWStVD 0 "Not valid" 1 "Valid"  ;
VAL_ 918 UINM_PADS_OKSWStuckSt 0 "Normal" 1 "stuck"  ;
VAL_ 918 UINM_PADS_CruSetSpeedRollerVD 0 "Not valid" 1 "Valid"  ;
VAL_ 918 UINM_PADS_FolDistDecSWSt 0 "not active;" 1 "active;"  ;
VAL_ 918 UINM_PADS_CruSWSt 0 "not active;" 1 "active;"  ;
VAL_ 918 UINM_PADS_CruSWStVD 0 "Not valid" 1 "Valid"  ;
VAL_ 918 UINM_PADS_CruSWStuckSt 0 "Normal" 1 "stuck"  ;
VAL_ 918 UINM_PADS_CruSpeedDecSWSt 0 "not active;" 1 "active;"  ;
VAL_ 918 UINM_PADS_CruSpeedDecSWStVD 0 "Not valid" 1 "Valid"  ;
VAL_ 918 UINM_PADS_CruSpeedDecSWStuckSt 0 "Normal" 1 "stuck"  ;
VAL_ 918 UINM_PADS_CruResumeSpeedIncSWSt 0 "not active;" 1 "active;"  ;
VAL_ 918 UINM_PADS_CruResumeSpeedIncSWStVD 0 "Not valid" 1 "Valid"  ;
VAL_ 918 UINM_PADS_CruResumeSpeedIncSWStuckSt 0 "Normal" 1 "stuck"  ;
VAL_ 918 UINM_PADS_CruTJAICASWSt 0 "not active;" 1 "active;"  ;
VAL_ 918 UINM_PADS_CruTJAICASWStVD 0 "Not valid" 1 "Valid"  ;
VAL_ 918 UINM_PADS_CruTJAICASWStuckSt 0 "Normal" 1 "stuck"  ;
VAL_ 918 UINM_PADS_Custom2SWSt 0 "not active" 1 "active"  ;
VAL_ 918 UINM_PADS_Custom2SWStVD 0 "Not valid" 1 "Valid"  ;
VAL_ 918 UINM_PADS_Custom2SWStuckSt 0 "Normal" 1 "stuck"  ;
VAL_ 918 UINM_PADS_ACCSWSt 0 "not perssed" 1 "short pressed" 2 "long pressed" 3 "reserved"  ;
VAL_ 918 UINM_PADS_VoltageFaultSt 0 "No error" 1 "Low voltage" 2 "High voltage" 3 "Not used"  ;
VAL_ 957 HOD_St 0 "Hands Off；" 1 "Left Touch；" 2 "Right Touch；" 3 "Inside Touch；" 4 "Outer Touch；" 5 "Front Touch；" 6 "Rear Touch；" 7 "Both side touch；" 8 "Left Grip；" 9 "Right Grip；" 10 "Both side Grip；" 11 "Hands On；" 12 "Reserved" 13 "Temporal Failure" 14 "Permanent Failure" 15 "int"  ;
VAL_ 957 HOD_TouchZone1 0 "False" 1 "True"  ;
VAL_ 957 HOD_TouchZone2 0 "False" 1 "True"  ;
VAL_ 957 HOD_TouchZone3 0 "False" 1 "True"  ;
VAL_ 957 HOD_HeatingSt 0 "off" 1 "heating" 2 "Preservation" 3 "Reserved"  ;
VAL_ 957 HOD_CalibrationSt 0 "Not Calibrated" 1 "Calibrated"  ;
VAL_ 957 HOD_LINComFault 0 "Not Fault" 1 "Fault"  ;
VAL_ 957 HOD_FaultSt 0 "Not Fault" 1 "Fault"  ;
VAL_ 957 HOD_VBattOORFault 0 "Not Fault" 1 "Fault"  ;
VAL_ 957 HOD_HeatingOtherFaultSt 0 "Not Fault" 1 "Fault"  ;
VAL_ 957 HOD_HeatingOverUnderCurrentSt 0 "Not Fault" 1 "Fault"  ;
VAL_ 957 HOD_HeatingThermSt 0 "Not Fault" 1 "Fault"  ;
VAL_ 957 HOD_HeatingTempOutSt 0 "Not Fault" 1 "Fault"  ;
VAL_ 957 HOD_Typ 0 "0" 1 "one zone" 2 "L/R zone" 3 "I/O zone" 4 "L/R/Inner zone" 5 "L/R/Rear zone"  ;
VAL_ 957 HOD_TouchIntensityZone1 0 "Intensity" 1 "Intensity" 2 "Intensity" 3 "Intensity" 4 "Intensity" 5 "Intensity" 6 "Intensity" 7 "Intensity" 8 "Intensity" 9 "Intensity" 10 "Intensity" 11 "Intensity" 12 "Intensity" 13 "Intensity" 14 "Intensity" 15 "Intensity" 16 "Intensity" 17 "Intensity" 18 "Intensity" 19 "Intensity" 20 "Intensity" 21 "Intensity" 22 "Intensity" 23 "Intensity" 24 "Intensity" 25 "Intensity" 26 "Intensity" 27 "Intensity" 28 "Intensity" 29 "Intensity" 30 "Intensity" 31 "Intensity" 32 "Intensity" 33 "Intensity" 34 "Intensity" 35 "Intensity" 36 "Intensity" 37 "Intensity" 38 "Intensity" 39 "Intensity" 40 "Intensity" 41 "Intensity" 42 "Intensity" 43 "Intensity" 44 "Intensity" 45 "Intensity" 46 "Intensity" 47 "Intensity" 48 "Intensity" 49 "Intensity" 50 "Intensity" 51 "Intensity" 52 "Intensity" 53 "Intensity" 54 "Intensity" 55 "Intensity" 56 "Intensity" 57 "Intensity" 58 "Intensity" 59 "Intensity" 60 "Intensity" 61 "Intensity" 62 "Intensity" 63 "Intensity" 64 "Intensity" 65 "Intensity" 66 "Intensity" 67 "Intensity" 68 "Intensity" 69 "Intensity" 70 "Intensity" 71 "Intensity" 72 "Intensity" 73 "Intensity" 74 "Intensity" 75 "Intensity" 76 "Intensity" 77 "Intensity" 78 "Intensity" 79 "Intensity" 80 "Intensity" 81 "Intensity" 82 "Intensity" 83 "Intensity" 84 "Intensity" 85 "Intensity" 86 "Intensity" 87 "Intensity" 88 "Intensity" 89 "Intensity" 90 "Intensity" 91 "Intensity" 92 "Intensity" 93 "Intensity" 94 "Intensity" 95 "Intensity" 96 "Intensity" 97 "Intensity" 98 "Intensity" 99 "Intensity" 100 "Intensity" 101 "Intensity" 102 "Intensity" 103 "Intensity" 104 "Intensity" 105 "Intensity" 106 "Intensity" 107 "Intensity" 108 "Intensity" 109 "Intensity" 110 "Intensity" 111 "Intensity" 112 "Intensity" 113 "Intensity" 114 "Intensity" 115 "Intensity" 116 "Intensity" 117 "Intensity" 118 "Intensity" 119 "Intensity" 120 "Intensity" 121 "Intensity" 122 "Intensity" 123 "Intensity" 124 "Intensity" 125 "Intensity" 126 "Intensity" 127 "Intensity" 128 "Intensity" 129 "Intensity" 130 "Intensity" 131 "Intensity" 132 "Intensity" 133 "Intensity" 134 "Intensity" 135 "Intensity" 136 "Intensity" 137 "Intensity" 138 "Intensity" 139 "Intensity" 140 "Intensity" 141 "Intensity" 142 "Intensity" 143 "Intensity" 144 "Intensity" 145 "Intensity" 146 "Intensity" 147 "Intensity" 148 "Intensity" 149 "Intensity" 150 "Intensity" 151 "Intensity" 152 "Intensity" 153 "Intensity" 154 "Intensity" 155 "Intensity" 156 "Intensity" 157 "Intensity" 158 "Intensity" 159 "Intensity" 160 "Intensity" 161 "Intensity" 162 "Intensity" 163 "Intensity" 164 "Intensity" 165 "Intensity" 166 "Intensity" 167 "Intensity" 168 "Intensity" 169 "Intensity" 170 "Intensity" 171 "Intensity" 172 "Intensity" 173 "Intensity" 174 "Intensity" 175 "Intensity" 176 "Intensity" 177 "Intensity" 178 "Intensity" 179 "Intensity" 180 "Intensity" 181 "Intensity" 182 "Intensity" 183 "Intensity" 184 "Intensity" 185 "Intensity" 186 "Intensity" 187 "Intensity" 188 "Intensity" 189 "Intensity" 190 "Intensity" 191 "Intensity" 192 "Intensity" 193 "Intensity" 194 "Intensity" 195 "Intensity" 196 "Intensity" 197 "Intensity" 198 "Intensity" 199 "Intensity" 200 "Intensity" 201 "Intensity" 202 "Intensity" 203 "Intensity" 204 "Intensity" 205 "Intensity" 206 "Intensity" 207 "Intensity" 208 "Intensity" 209 "Intensity" 210 "Intensity" 211 "Intensity" 212 "Intensity" 213 "Intensity" 214 "Intensity" 215 "Intensity" 216 "Intensity" 217 "Intensity" 218 "Intensity" 219 "Intensity" 220 "Intensity" 221 "Intensity" 222 "Intensity" 223 "Intensity" 224 "Intensity" 225 "Intensity" 226 "Intensity" 227 "Intensity" 228 "Intensity" 229 "Intensity" 230 "Intensity" 231 "Intensity" 232 "Intensity" 233 "Intensity" 234 "Intensity" 235 "Intensity" 236 "Intensity" 237 "Intensity" 238 "Intensity" 239 "Intensity" 240 "Intensity" 241 "Intensity" 242 "Intensity" 243 "Intensity" 244 "Intensity" 245 "Intensity" 246 "Intensity" 247 "Intensity" 248 "Intensity" 249 "Intensity" 250 "Intensity" 251 "Reserved" 252 "Not Available" 253 "Reserved" 254 "Init" 255 "Failure"  ;
VAL_ 957 HOD_TouchIntensityZone2 0 "Intensity" 1 "Intensity" 2 "Intensity" 3 "Intensity" 4 "Intensity" 5 "Intensity" 6 "Intensity" 7 "Intensity" 8 "Intensity" 9 "Intensity" 10 "Intensity" 11 "Intensity" 12 "Intensity" 13 "Intensity" 14 "Intensity" 15 "Intensity" 16 "Intensity" 17 "Intensity" 18 "Intensity" 19 "Intensity" 20 "Intensity" 21 "Intensity" 22 "Intensity" 23 "Intensity" 24 "Intensity" 25 "Intensity" 26 "Intensity" 27 "Intensity" 28 "Intensity" 29 "Intensity" 30 "Intensity" 31 "Intensity" 32 "Intensity" 33 "Intensity" 34 "Intensity" 35 "Intensity" 36 "Intensity" 37 "Intensity" 38 "Intensity" 39 "Intensity" 40 "Intensity" 41 "Intensity" 42 "Intensity" 43 "Intensity" 44 "Intensity" 45 "Intensity" 46 "Intensity" 47 "Intensity" 48 "Intensity" 49 "Intensity" 50 "Intensity" 51 "Intensity" 52 "Intensity" 53 "Intensity" 54 "Intensity" 55 "Intensity" 56 "Intensity" 57 "Intensity" 58 "Intensity" 59 "Intensity" 60 "Intensity" 61 "Intensity" 62 "Intensity" 63 "Intensity" 64 "Intensity" 65 "Intensity" 66 "Intensity" 67 "Intensity" 68 "Intensity" 69 "Intensity" 70 "Intensity" 71 "Intensity" 72 "Intensity" 73 "Intensity" 74 "Intensity" 75 "Intensity" 76 "Intensity" 77 "Intensity" 78 "Intensity" 79 "Intensity" 80 "Intensity" 81 "Intensity" 82 "Intensity" 83 "Intensity" 84 "Intensity" 85 "Intensity" 86 "Intensity" 87 "Intensity" 88 "Intensity" 89 "Intensity" 90 "Intensity" 91 "Intensity" 92 "Intensity" 93 "Intensity" 94 "Intensity" 95 "Intensity" 96 "Intensity" 97 "Intensity" 98 "Intensity" 99 "Intensity" 100 "Intensity" 101 "Intensity" 102 "Intensity" 103 "Intensity" 104 "Intensity" 105 "Intensity" 106 "Intensity" 107 "Intensity" 108 "Intensity" 109 "Intensity" 110 "Intensity" 111 "Intensity" 112 "Intensity" 113 "Intensity" 114 "Intensity" 115 "Intensity" 116 "Intensity" 117 "Intensity" 118 "Intensity" 119 "Intensity" 120 "Intensity" 121 "Intensity" 122 "Intensity" 123 "Intensity" 124 "Intensity" 125 "Intensity" 126 "Intensity" 127 "Intensity" 128 "Intensity" 129 "Intensity" 130 "Intensity" 131 "Intensity" 132 "Intensity" 133 "Intensity" 134 "Intensity" 135 "Intensity" 136 "Intensity" 137 "Intensity" 138 "Intensity" 139 "Intensity" 140 "Intensity" 141 "Intensity" 142 "Intensity" 143 "Intensity" 144 "Intensity" 145 "Intensity" 146 "Intensity" 147 "Intensity" 148 "Intensity" 149 "Intensity" 150 "Intensity" 151 "Intensity" 152 "Intensity" 153 "Intensity" 154 "Intensity" 155 "Intensity" 156 "Intensity" 157 "Intensity" 158 "Intensity" 159 "Intensity" 160 "Intensity" 161 "Intensity" 162 "Intensity" 163 "Intensity" 164 "Intensity" 165 "Intensity" 166 "Intensity" 167 "Intensity" 168 "Intensity" 169 "Intensity" 170 "Intensity" 171 "Intensity" 172 "Intensity" 173 "Intensity" 174 "Intensity" 175 "Intensity" 176 "Intensity" 177 "Intensity" 178 "Intensity" 179 "Intensity" 180 "Intensity" 181 "Intensity" 182 "Intensity" 183 "Intensity" 184 "Intensity" 185 "Intensity" 186 "Intensity" 187 "Intensity" 188 "Intensity" 189 "Intensity" 190 "Intensity" 191 "Intensity" 192 "Intensity" 193 "Intensity" 194 "Intensity" 195 "Intensity" 196 "Intensity" 197 "Intensity" 198 "Intensity" 199 "Intensity" 200 "Intensity" 201 "Intensity" 202 "Intensity" 203 "Intensity" 204 "Intensity" 205 "Intensity" 206 "Intensity" 207 "Intensity" 208 "Intensity" 209 "Intensity" 210 "Intensity" 211 "Intensity" 212 "Intensity" 213 "Intensity" 214 "Intensity" 215 "Intensity" 216 "Intensity" 217 "Intensity" 218 "Intensity" 219 "Intensity" 220 "Intensity" 221 "Intensity" 222 "Intensity" 223 "Intensity" 224 "Intensity" 225 "Intensity" 226 "Intensity" 227 "Intensity" 228 "Intensity" 229 "Intensity" 230 "Intensity" 231 "Intensity" 232 "Intensity" 233 "Intensity" 234 "Intensity" 235 "Intensity" 236 "Intensity" 237 "Intensity" 238 "Intensity" 239 "Intensity" 240 "Intensity" 241 "Intensity" 242 "Intensity" 243 "Intensity" 244 "Intensity" 245 "Intensity" 246 "Intensity" 247 "Intensity" 248 "Intensity" 249 "Intensity" 250 "Intensity" 251 "Reserved" 252 "Not Available" 253 "Reserved" 254 "Init" 255 "Failure"  ;
VAL_ 957 HOD_TouchIntensityZone3 0 "Intensity" 1 "Intensity" 2 "Intensity" 3 "Intensity" 4 "Intensity" 5 "Intensity" 6 "Intensity" 7 "Intensity" 8 "Intensity" 9 "Intensity" 10 "Intensity" 11 "Intensity" 12 "Intensity" 13 "Intensity" 14 "Intensity" 15 "Intensity" 16 "Intensity" 17 "Intensity" 18 "Intensity" 19 "Intensity" 20 "Intensity" 21 "Intensity" 22 "Intensity" 23 "Intensity" 24 "Intensity" 25 "Intensity" 26 "Intensity" 27 "Intensity" 28 "Intensity" 29 "Intensity" 30 "Intensity" 31 "Intensity" 32 "Intensity" 33 "Intensity" 34 "Intensity" 35 "Intensity" 36 "Intensity" 37 "Intensity" 38 "Intensity" 39 "Intensity" 40 "Intensity" 41 "Intensity" 42 "Intensity" 43 "Intensity" 44 "Intensity" 45 "Intensity" 46 "Intensity" 47 "Intensity" 48 "Intensity" 49 "Intensity" 50 "Intensity" 51 "Intensity" 52 "Intensity" 53 "Intensity" 54 "Intensity" 55 "Intensity" 56 "Intensity" 57 "Intensity" 58 "Intensity" 59 "Intensity" 60 "Intensity" 61 "Intensity" 62 "Intensity" 63 "Intensity" 64 "Intensity" 65 "Intensity" 66 "Intensity" 67 "Intensity" 68 "Intensity" 69 "Intensity" 70 "Intensity" 71 "Intensity" 72 "Intensity" 73 "Intensity" 74 "Intensity" 75 "Intensity" 76 "Intensity" 77 "Intensity" 78 "Intensity" 79 "Intensity" 80 "Intensity" 81 "Intensity" 82 "Intensity" 83 "Intensity" 84 "Intensity" 85 "Intensity" 86 "Intensity" 87 "Intensity" 88 "Intensity" 89 "Intensity" 90 "Intensity" 91 "Intensity" 92 "Intensity" 93 "Intensity" 94 "Intensity" 95 "Intensity" 96 "Intensity" 97 "Intensity" 98 "Intensity" 99 "Intensity" 100 "Intensity" 101 "Intensity" 102 "Intensity" 103 "Intensity" 104 "Intensity" 105 "Intensity" 106 "Intensity" 107 "Intensity" 108 "Intensity" 109 "Intensity" 110 "Intensity" 111 "Intensity" 112 "Intensity" 113 "Intensity" 114 "Intensity" 115 "Intensity" 116 "Intensity" 117 "Intensity" 118 "Intensity" 119 "Intensity" 120 "Intensity" 121 "Intensity" 122 "Intensity" 123 "Intensity" 124 "Intensity" 125 "Intensity" 126 "Intensity" 127 "Intensity" 128 "Intensity" 129 "Intensity" 130 "Intensity" 131 "Intensity" 132 "Intensity" 133 "Intensity" 134 "Intensity" 135 "Intensity" 136 "Intensity" 137 "Intensity" 138 "Intensity" 139 "Intensity" 140 "Intensity" 141 "Intensity" 142 "Intensity" 143 "Intensity" 144 "Intensity" 145 "Intensity" 146 "Intensity" 147 "Intensity" 148 "Intensity" 149 "Intensity" 150 "Intensity" 151 "Intensity" 152 "Intensity" 153 "Intensity" 154 "Intensity" 155 "Intensity" 156 "Intensity" 157 "Intensity" 158 "Intensity" 159 "Intensity" 160 "Intensity" 161 "Intensity" 162 "Intensity" 163 "Intensity" 164 "Intensity" 165 "Intensity" 166 "Intensity" 167 "Intensity" 168 "Intensity" 169 "Intensity" 170 "Intensity" 171 "Intensity" 172 "Intensity" 173 "Intensity" 174 "Intensity" 175 "Intensity" 176 "Intensity" 177 "Intensity" 178 "Intensity" 179 "Intensity" 180 "Intensity" 181 "Intensity" 182 "Intensity" 183 "Intensity" 184 "Intensity" 185 "Intensity" 186 "Intensity" 187 "Intensity" 188 "Intensity" 189 "Intensity" 190 "Intensity" 191 "Intensity" 192 "Intensity" 193 "Intensity" 194 "Intensity" 195 "Intensity" 196 "Intensity" 197 "Intensity" 198 "Intensity" 199 "Intensity" 200 "Intensity" 201 "Intensity" 202 "Intensity" 203 "Intensity" 204 "Intensity" 205 "Intensity" 206 "Intensity" 207 "Intensity" 208 "Intensity" 209 "Intensity" 210 "Intensity" 211 "Intensity" 212 "Intensity" 213 "Intensity" 214 "Intensity" 215 "Intensity" 216 "Intensity" 217 "Intensity" 218 "Intensity" 219 "Intensity" 220 "Intensity" 221 "Intensity" 222 "Intensity" 223 "Intensity" 224 "Intensity" 225 "Intensity" 226 "Intensity" 227 "Intensity" 228 "Intensity" 229 "Intensity" 230 "Intensity" 231 "Intensity" 232 "Intensity" 233 "Intensity" 234 "Intensity" 235 "Intensity" 236 "Intensity" 237 "Intensity" 238 "Intensity" 239 "Intensity" 240 "Intensity" 241 "Intensity" 242 "Intensity" 243 "Intensity" 244 "Intensity" 245 "Intensity" 246 "Intensity" 247 "Intensity" 248 "Intensity" 249 "Intensity" 250 "Intensity" 251 "Reserved" 252 "Not Available" 253 "Reserved" 254 "Init" 255 "Failure"  ;
VAL_ 957 HOD_SysErr 0 "no fault" 1 "Temporal fault" 2 "Permanent fault" 3 "Reserved"  ;
VAL_ 860 VCU_RoadMod 0 "Invalid" 1 "Mud Mode" 2 "Snow Mode" 3 "Sand Mode" 4 "Offroad Mode" 5 "Slippery Mode" 7 "Off"  ;
VAL_ 860 VCU_GearLvl 0 "Invalid" 1 "'D' Drive gear" 2 "'N' Neutral gear" 3 "'R' Reverse gear" 4 "'P' Park gear" 5 "Not used" 6 "Not used" 7 "Not used" 8 "Not used" 9 "Not used" 10 "Not used" 11 "Not used" 12 "Not used" 13 "Not used" 14 "Not used" 15 "Not used"  ;
VAL_ 860 VCU_VehDrvMod 7 "Individual" 6 "I-pedal Mode;" 5 "SPORT Mode;" 4 "Driving Mode/Offroad Mode;" 3 "Comfort Mode;" 2 "ECO Mode;" 1 "ECO+ Mode;" 0 "Invalid;"  ;
VAL_ 860 VCU_VehRdySt 0 "Not ready" 1 "Ready"  ;
VAL_ 860 VCU_ChgActiveSt_toADC 0 "Not charging" 1 "charging"  ;
VAL_ 860 VCU_PlgConnSt 0 "Not connected" 1 "Plug connector connected"  ;
VAL_ 860 VCU_GearLvlDisp 0 "Invalid" 1 "'D' Drive gear" 2 "'N' Neutral gear" 3 "'R' Reverse gear" 4 "'P' Park gear" 5 "Reserved" 6 "Reserved" 7 "Reserved" 8 "Reserved" 9 "Reserved" 10 "Reserved" 11 "Reserved" 12 "Reserved" 13 "Reserved" 14 "Reserved" 15 "Reserved"  ;
VAL_ 860 VCU_SuspModeReq 0 "not request" 1 "comfort mode" 2 "normal mode(reserved)" 3 "sport mode"  ;
VAL_ 860 VCU_SuspModeReqEnable 0 "disable" 1 "enable"  ;
VAL_ 860 VCU_PivotSteeringStAvailable 0 "Not Available" 1 "Available"  ;
VAL_ 860 VCU_PivotSteeringSt 0 "Invalid" 1 "OFF" 2 "Standby" 3 "Active" 4 "Closing" 5 "Activing" 6 "Reserved" 7 "Reserved"  ;
VAL_ 860 VCU_GearPosition 0 "Undefined" 1 "P_Pending" 2 "'P' Park gear" 3 "'N' Neutral gear" 4 "'R' Reverse gear" 5 "'D' Drive gear" 6 "EPB Locking failure,return 'N' gear" 7 "Reserved"  ;
VAL_ 860 VCU_EcoPlusMod 0 "No command" 1 "ON" 2 "OFF" 3 "reserved"  ;
VAL_ 860 ICC_RoadMod 0 "Invalid" 1 "Highway" 2 "Auto Mode" 3 "Snow Mode" 4 "Mud Mode" 5 "Sand Mode" 6 "Ruggged Mode" 7 "Wade Mode" 8 "Expert Mode"  ;
VAL_ 431 VCU_TargetRecpTorqSt 0 "NotIntialized" 1 "Normal" 2 "Faulty" 3 "Reserved"  ;
VAL_ 431 VCU_AccElecECFail 0 "No failure" 1 "Failure"  ;
VAL_ 431 VCU_AccDriverOrvd 0 "No override" 1 "Driver override"  ;
VAL_ 431 VCU_AccTMCFail 0 "Normal mode" 1 "In limp-home mode"  ;
VAL_ 431 VCU_TargetRecpTorqFAVD 1 "Valid;" 0 "Invalid;"  ;
VAL_ 431 VCU_TargetRecpTorqRAVD 1 "Valid;" 0 "Invalid;"  ;
VAL_ 431 VCU_TorqDriverReqFAVD 1 "Valid;" 0 "Invalid;"  ;
VAL_ 431 VCU_TorqDriverReqRAVD 1 "Valid;" 0 "Invalid;"  ;
VAL_ 431 VCU_VehActDrvTorqFAVD 1 "Valid;" 0 "Invalid;"  ;
VAL_ 431 VCU_VehActDrvTorqRAVD 1 "Valid;" 0 "Invalid;"  ;
VAL_ 431 VCU_BcsDecelVD 0 "Invalid" 1 "Valid"  ;
VAL_ 431 VCU_RecpTorqRLVD 1 "Valid;" 0 "Invalid;"  ;
VAL_ 431 VCU_RecpTorqRRVD 1 "Valid;" 0 "Invalid;"  ;
VAL_ 431 VCU_ADSNetErrorFb 0 "No Error" 1 "Main Net E2E Error" 2 "Sub Net E2E Error" 3 "Both Net E2E Error" 4 "Reserved" 5 "Reserved" 6 "Reserved" 7 "Reserved"  ;
VAL_ 431 VCU_NetModeResp 0 "None" 1 "Main/sub Net active" 2 "Main/sub Net active with error" 3 "Reserved"  ;
VAL_ 516 VCU_VehWheelTorqMaxVD 0 "Not valid" 1 "Valid"  ;
VAL_ 516 VCU_RecpTorqSt 0 "NotIntialized" 1 "Normal" 2 "Faulty" 3 "Reserved"  ;
VAL_ 516 VCU_MaxRecpTorqSt 0 "NotIntialized" 1 "Normal" 2 "Faulty" 3 "Reserved"  ;
VAL_ 516 VCU_CrntGearLvl 0 "Invalid" 1 "'D' Drive gear" 2 "'N' Neutral gear" 3 "'R' Reverse gear" 4 "'P' Park gear" 5 "Not used" 6 "Not used" 7 "Not used"  ;
VAL_ 516 VCU_CrntGearLvlVD 1 "Valid;" 0 "Not valid.;"  ;
VAL_ 516 VCU_BrkPedPstVD 0 "Not valid" 1 "Valid"  ;
VAL_ 516 VCU_APAGasPedalIntv 0 "With not intervention" 1 "With intervention"  ;
VAL_ 516 VCU_APAAvailable 0 "Not Available" 1 "Available"  ;
VAL_ 516 VCU_APAGearIntervern 0 "with not intervention" 1 "with intervention"  ;
VAL_ 516 VCU_EMS_AccPedalActPstVD 0 "Not valid" 1 "Valid"  ;
VAL_ 516 VCU_EMS_BrkPedalSt 0 "Not pressed                                                                     1"  ;
VAL_ 516 VCU_EMS_BrkPedalStVD 0 "Not Valid                                                                           1"  ;
VAL_ 516 VCU_ACCMaxRecpDecelVD 1 "Valid;" 0 "Invalid;"  ;
VAL_ 516 VCU_ACCLimitOperatingSt 0 "Not active" 1 "active"  ;
VAL_ 516 VCU_APAResp 0 "without response" 1 "with response"  ;
VAL_ 516 VCU_ADSEcoModReq 1 "Active;" 0 "Not Active;"  ;
VAL_ 516 VCU_AccButtInfo 0 "not press" 1 "press" 0 "not press" 1 "press" 0 "not press" 1 "press" 0 "not press" 1 "press" 0 "not press" 1 "press" 0 "Normal" 1 "Abnormal"  ;
VAL_ 516 VCU_ACCmaxSpdLimit 0 "No Limit" 1 "10 Km/h" 2 "20 Km/h" 3 "30 Km/h" 4 "40 Km/h" 5 "50 Km/h" 6 "60 Km/h" 7 "70 Km/h" 8 "80 Km/h" 9 "90 Km/h" 10 "100 Km/h" 11 "110 Km/h" 12 "120 Km/h" 13 "130 Km/h" 14 "140 Km/h" 15 "Reserved"  ;
VAL_ 516 VCU_APA_Resp 1 "Yes;" 0 "No;"  ;
VAL_ 516 VCU_RecpTorqFAVD 1 "Valid;" 0 "Invalid;"  ;
VAL_ 516 VCU_RecpTorqRAVD 1 "Valid;" 0 "Invalid;"  ;
VAL_ 516 VCU_MaxRecpTorqFAVD 1 "Valid;" 0 "Not valid;"  ;
VAL_ 516 VCU_MaxRecpTorqRAVD 1 "Valid;" 0 "Not valid;"  ;
VAL_ 516 VCU_BcsDecelEnable 0 "Not active" 1 "Active"  ;
VAL_ 516 VCU_CrntGearNoTrans 4 "'P' Park gear;" 3 "'R' Reverse gear;" 2 "'N' Neutral gear;" 1 "'D' Drive gear;" 0 "Invalid;"  ;
VAL_ 516 VCU_EzTSt 0 "Invalid" 1 "Off" 2 "Standby" 3 "Active"  ;
VAL_ 516 VCU_ITASSt 0 "invalid" 1 "Off" 2 "Standby" 3 "Active" 4 "Rampoff Request" 5 "Reserved" 6 "Reserved" 7 "Reserved"  ;
VAL_ 616 UMM_UsageModeSt 0 "Standby" 1 "Comfort" 2 "Reserved" 3 "DRV" 4 "Reserved" 5 "Reserved" 6 "Reserved" 7 "Invalid"  ;
VAL_ 616 OTA_FuncReq_ADCWakeup 0 "Inactive" 1 "Active" 2 "Reserved" 3 "Reserved" 4 "Reserved" 5 "Reserved" 6 "Reserved" 7 "Reserved"  ;
VAL_ 616 UMM_FrontPassengerSeatSt 0 "Undefined" 1 "Off" 2 "On" 3 "Failure"  ;
VAL_ 616 UMM_DriverSeatSt 0 "Undefined" 1 "Off" 2 "On" 3 "Failure"  ;
VAL_ 616 VMM_VehModeSt 0 "Normal Mode" 1 "Manufacture Mode" 2 "Transport Mode" 3 "Showroom Mode" 4 "PostCrash Mode" 5 "Maintenance Mode" 6 "Reserved" 7 "Reserved" 8 "Reserved" 9 "Reserved" 10 "Reserved" 11 "Reserved" 12 "Reserved" 13 "Reserved" 14 "Reserved" 15 "Invalid Value"  ;
VAL_ 616 VMM_LastVehModeSt 0 "Normal Mode" 1 "Manufacture Mode" 2 "Transport Mode" 3 "Showroom Mode" 4 "PostCrash Mode" 5 "Maintenance Mode" 6 "Reserved" 7 "Reserved" 8 "Reserved" 9 "Reserved" 10 "Reserved" 11 "Reserved" 12 "Reserved" 13 "Reserved" 14 "Reserved" 15 "Invalid Value"  ;
VAL_ 616 VMM_OTAModeSt 0 "NonOTA Mode" 1 "OTA Mode" 2 "Invalid Value" 3 "reserved"  ;
VAL_ 616 CSM_RC_PAARequest 0 "No request" 1 "SBM RPA request" 2 "SBM HPA request" 3 "EDK request" 4 "TSP HPA request" 5 "TSP AVP request" 6 "check picture" 7 "check video"  ;
VAL_ 616 CSM_RC_AuthSt 0 "Not Used" 1 "Pass" 2 "Failed"  ;
VAL_ 616 IPDS_EnablePowerSup 0 "Not Active" 1 "Active" 2 "PreOFF" 3 "Reserve"  ;
VAL_ 616 CCU_DstFlag 0 "inactive" 1 "active"  ;
VAL_ 616 ASB_DriverActiveBeltFaultSt 0 "Not fault" 1 "Fault"  ;
VAL_ 816 HVAC_RearDefrostSt 0 "Not acitve" 1 "Active"  ;
VAL_ 816 HVAC_WindExitMode 0 "Invalid" 1 "Face" 2 "Face/Foot" 3 "Foot" 4 "Foot/Defrost" 5 "Defrost" 6 "Face/DEF" 7 "Face/Foot/DEF"  ;
VAL_ 816 HVAC_CorrectedExterTempVD 0 "Not valid" 1 "Valid"  ;
VAL_ 816 HVAC_CorrectedCabinTempVD 0 "Not valid" 1 "Valid"  ;
VAL_ 960 TMS_MotRadrOutCooltTVld 0 "Invalid" 1 "Valid"  ;
VAL_ 960 TMS_WtrPmp1Fault 0 "No ERROR" 1 "ERROR"  ;
VAL_ 960 HVAC_AutoFogFlt 0 "No Fault" 1 "Fault"  ;
VAL_ 960 HVAC_AutoFogSts 0 "Not Active" 1 "Active"  ;
VAL_ 960 TMS_TWVlv1FaultSt 0 "No Error" 1 "Error"  ;
