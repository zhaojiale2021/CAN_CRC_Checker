VERSION "Version"

NS_ :

BS_:

BU_: Tester CCU INU ADC RRR RLR CCURT1 CCURT2 ZCUF ZCUL ZCUR ZCUT EMS IDM DCDC DCDCI IPS NIDU DCU2 OBC OPC LPC CPC EMCM GCU DCU IPU BMS EOP EVCC DCDC2 EDL SRS ECS EPS EPB RBM IBCS ICM IID IDC AMP WHUD ARHUD IMR FIMR CD IFC FAPA PAS PCS SCMF SCMR SCMRL SCMRR MFS DRM FCP RCP LBMSAD AVAS DLPFL FBLCM FLISD FLLCM FRLCM RLLCMA RLLCMB RRLCMA RRLCMB RLISD DLPML DLPMR TRM PSDL PSDR FLDCM FRDCM HVSPRL HVSPRR RFR SBM WCM ETC TBOX2 TBOX RLBMS EBU FLPDM RLPDM FRPDM RRPDM FLOAR FROAR RLOAR RROAR EOSL EOSR EOST PRBU RT1_C0 OTAWL RT2_C3 IDUR PHUDD RAS CBM PLGM TMC LPC2 SAS RCICP SCMRM SCMT SLMRL SLMRR IDU RRISD DSASBM LBMS RT1_C1

BO_ 400 CCU_MFS_1: 32 CCU
 SG_ UINM_1_CRC : 7|16@0+ (1,0) [0|65535] ""  ADC,FAPA
 SG_ UINM_1_Counter : 23|8@0+ (1,0) [0|255] ""  ADC,FAPA
 SG_ UINM_DrvReqShft : 31|4@0+ (1,0) [0|15] ""  IDC,ADC,FAPA
 SG_ UINM_DrvReqShftInv : 27|4@0+ (1,0) [0|15] ""  ADC,FAPA
 SG_ UINM_FuSaErrSt : 39|1@0+ (1,0) [0|1] ""  ADC,FAPA
 SG_ UINM_ShftFault : 38|1@0+ (1,0) [0|1] ""  ADC,FAPA
 SG_ UINM_PositionLightSwSt : 37|2@0+ (1,0) [0|3] ""  ADC,IFC,FAPA,RRR,RLR
 SG_ UINM_LowBeamSwSt : 35|2@0+ (1,0) [0|3] ""  ADC,IFC,FAPA,RRR,RLR
 SG_ UINM_AutoLightSwSt : 33|2@0+ (1,0) [0|3] ""  ADC,IFC,FAPA,RRR,RLR
 SG_ UINM_FrontFogLightSwSt : 47|1@0+ (1,0) [0|1] ""  ADC,IFC,FAPA,RRR,RLR
 SG_ UINM_RearFogLightSwSt : 46|1@0+ (1,0) [0|1] ""  ADC,IFC,FAPA,RRR,RLR
 SG_ UINM_HighBeamSwSt : 45|2@0+ (1,0) [0|3] ""  ADC,IFC,FAPA,RRR,RLR
 SG_ UINM_TurnLightSwSt : 43|3@0+ (1,0) [0|7] ""  ADC,IFC,FAPA,RRR,RLR,PCS
 SG_ UINM_FrontWiperSwSt : 55|3@0+ (1,0) [0|7] ""  ADC,IFC,FAPA
 SG_ UINM_FrontWiperIntAdjSwSt : 52|4@0+ (1,0) [0|15] ""  ADC,IFC,FAPA
 SG_ UINM_FrontWasherSwSt : 48|1@0+ (1,0) [0|1] ""  ADC,IFC,FAPA
 SG_ UINM_RearWiperSwSt : 63|3@0+ (1,0) [0|7] ""  ADC,IFC,FAPA
 SG_ UINM_RearWiperIntAdjSwSt : 60|4@0+ (1,0) [0|15] ""  ADC,IFC,FAPA
 SG_ UINM_RearWasherSwSt : 56|1@0+ (1,0) [0|1] ""  ADC,IFC,FAPA
 SG_ UINM_HeadLampWasherSwSt : 71|1@0+ (1,0) [0|1] ""  ADC,IFC,FAPA,RRR,RLR

BO_ 792 CCU_ZCUT_2: 64 CCU
 SG_ ZCUT_2_CRC : 7|16@0+ (1,0) [0|65535] ""  ZCUL,ZCUR,CBM,ADC,IFC,FAPA
 SG_ ZCUT_2_Counter : 23|8@0+ (1,0) [0|255] ""  ZCUL,ZCUR,CBM,ADC,IFC,FAPA
 SG_ UMM_SecondMIDSeatSt : 35|2@0+ (1,0) [0|3] ""  ZCUL,ZCUR,SRS,ICM,IDC,IMR,ADC,IFC
 SG_ UMM_SecondRHSeatSt : 37|2@0+ (1,0) [0|3] ""  SRS,ICM,IDC,IMR,ADC,IFC
 SG_ UMM_SecondLHSeatSt : 39|2@0+ (1,0) [0|3] ""  SRS,ICM,IDC,IMR,ADC,IFC
 SG_ EL_RADASLightSt : 396|2@0+ (1,0) [0|3] ""  ADC,IFC
 SG_ UMM_ThirdLHSeatSt : 55|2@0+ (1,0) [0|3] ""  IID,IDC,FIMR,ADC,IFC
 SG_ UMM_ThirdRHSeatSt : 41|2@0+ (1,0) [0|3] ""  IID,IDC,FIMR,ADC,IFC
 SG_ UMM_ThirdMIDSeatSt : 50|2@0+ (1,0) [0|3] ""  IID,IDC,ADC,IFC
 SG_ LCK_PowerFillerCapAngle : 103|8@0+ (1,0) [0|255] "deg"  OTAWL,ZCUL,ZCUR,ICM,IDC,ADC,FAPA
 SG_ EL_ReverseLightSt : 111|1@0+ (1,0) [0|1] ""  ZCUL,ZCUR,IDC,ADC,IFC,FAPA,PCS
 SG_ EL_ReverseLightFaultSt : 110|1@0+ (1,0) [0|1] ""  ZCUL,ZCUR,ICM,IDC,ADC,IFC,FAPA
 SG_ EL_SideBrkLightSt : 109|1@0+ (1,0) [0|1] ""  ZCUL,ZCUR,SRS,ADC,IFC,FAPA
 SG_ EL_SideBrkLightFaultSt : 108|1@0+ (1,0) [0|1] ""  ZCUL,ZCUR,ICM,IDC,ADC,IFC,FAPA
 SG_ EL_CHMSLSt : 107|1@0+ (1,0) [0|1] ""  ZCUL,ZCUR,SRS,ADC,IFC,FAPA
 SG_ EL_CHMSLFaultSt : 106|1@0+ (1,0) [0|1] ""  ZCUL,ZCUR,ICM,IDC,ADC,IFC,FAPA
 SG_ EL_RLPositionLightSt : 105|1@0+ (1,0) [0|1] ""  ZCUL,ZCUR,ICM,IDC,ADC,IFC,FAPA
 SG_ EL_RLPositionLightFaultSt : 104|1@0+ (1,0) [0|1] ""  ZCUL,ZCUR,ICM,IDC,ADC,IFC,FAPA
 SG_ EL_RRPositionLightSt : 119|1@0+ (1,0) [0|1] ""  ZCUL,ZCUR,ICM,IDC,ADC,IFC,FAPA
 SG_ EL_RRPositionLightFaultSt : 118|1@0+ (1,0) [0|1] ""  ZCUL,ZCUR,ICM,IDC,ADC,IFC,FAPA
 SG_ EL_RearFogLightSt : 117|1@0+ (1,0) [0|1] ""  ZCUL,ZCUR,ICM,IDC,ADC,IFC,FAPA
 SG_ EL_RearFogLightFaultSt : 116|1@0+ (1,0) [0|1] ""  ZCUL,ZCUR,ICM,IDC,ADC,IFC,FAPA
 SG_ EL_RLTurnLightSt : 113|2@0+ (1,0) [0|3] ""  ZCUL,ZCUR,SRS,ICM,IDC,ADC,IFC,FAPA
 SG_ EL_RLTurnLightFaultSt : 127|1@0+ (1,0) [0|1] ""  ZCUL,ZCUR,SRS,ICM,IDC,ADC,IFC,FAPA,PCS
 SG_ EL_RRTurnLightSt : 126|2@0+ (1,0) [0|3] ""  ZCUL,ZCUR,SRS,ICM,IDC,ADC,IFC,FAPA
 SG_ EL_RRTurnLightFaultSt : 124|1@0+ (1,0) [0|1] ""  ZCUL,ZCUR,SRS,ICM,IDC,ADC,IFC,FAPA,PCS

BO_ 446 CCU_RBM_1_C: 64 CCU
 SG_ RBU_VehSpd : 135|13@0+ (0.05625,0) [0|240] "km/h"  ADC
 SG_ RBU_VehSpdVD : 138|1@0+ (1,0) [0|1] ""  ADC
 SG_ RBU_FLWheelSpdEdgesSum : 175|12@0+ (1,0) [0|4095] ""  ZCUF,ZCUT,ADC
 SG_ RBU_FRWheelSpdEdgesSum : 179|12@0+ (1,0) [0|4095] ""  ZCUF,ZCUT,ADC
 SG_ RBU_RLWheelSpdEdgesSum : 199|12@0+ (1,0) [0|4095] ""  ZCUF,ZCUT,ADC
 SG_ RBU_RRWheelSpdEdgesSum : 203|12@0+ (1,0) [0|4095] ""  ZCUF,ZCUT,ADC
 SG_ RBU_FLWheelSpdEdgesSumVD : 287|1@0+ (1,0) [0|1] ""  ZCUF,ZCUT,ADC
 SG_ RBU_FRWheelSpdEdgesSumVD : 286|1@0+ (1,0) [0|1] ""  ZCUF,ZCUT,ADC
 SG_ RBU_RLWheelSpdEdgesSumVD : 285|1@0+ (1,0) [0|1] ""  ZCUF,ZCUT,ADC
 SG_ RBU_RRWheelSpdEdgesSumVD : 284|1@0+ (1,0) [0|1] ""  ZCUF,ZCUT,ADC
 SG_ RBU_FLWheelSpd : 223|13@0+ (0.05625,0) [0|240] "km/h"  ZCUF,ZCUT,ADC
 SG_ RBU_FLWheelSpdVD : 226|1@0+ (1,0) [0|1] ""  ZCUF,ZCUT,ADC
 SG_ RBU_FRWheelSpd : 239|13@0+ (0.05625,0) [0|240] "km/h"  ZCUF,ZCUT,ADC
 SG_ RBU_FRWheelSpdVD : 242|1@0+ (1,0) [0|1] ""  ZCUF,ZCUT,ADC
 SG_ RBU_RLWheelSpd : 255|13@0+ (0.05625,0) [0|240] "km/h"  ZCUF,ZCUT,ADC
 SG_ RBU_RLWheelSpdVD : 258|1@0+ (1,0) [0|1] ""  ZCUF,ZCUT,ADC
 SG_ RBU_RRWheelSpd : 271|13@0+ (0.05625,0) [0|240] "km/h"  ZCUF,ZCUT,ADC
 SG_ RBU_RRWheelSpdVD : 274|1@0+ (1,0) [0|1] ""  ZCUF,ZCUT,ADC
 SG_ RBU_FLWheelRotatedDirectionNEW : 113|2@0+ (1,0) [0|3] ""  ADC
 SG_ RBU_FLWheelRotatedDirectionVD : 282|1@0+ (1,0) [0|1] ""  ADC
 SG_ RBU_FRWheelRotatedDirectionNEW : 115|2@0+ (1,0) [0|3] ""  ADC
 SG_ RBU_FRWheelRotatedDirectionVD : 280|1@0+ (1,0) [0|1] ""  ADC
 SG_ RBU_RLWheelRotatedDirectionNEW : 117|2@0+ (1,0) [0|3] ""  ADC
 SG_ RBU_RLWheelRotatedDirectionVD : 224|1@0+ (1,0) [0|1] ""  ADC
 SG_ RBU_RRWheelRotatedDirectionNEW : 119|2@0+ (1,0) [0|3] ""  ADC
 SG_ RBU_RRWheelRotatedDirectionVD : 240|1@0+ (1,0) [0|1] ""  ADC
 SG_ RBU_MasterCylinderPr : 311|12@0+ (0.1,0) [0|250] "bar"  ADC
 SG_ RBU_MasterCylinderPrVD : 296|1@0+ (1,0) [0|1] ""  ADC
 SG_ RBU_BrkTqCtrlAvlDriving : 90|3@0+ (1,0) [0|7] ""  ADC
 SG_ RBU_BrkTqCtrlAvlParking : 93|3@0+ (1,0) [0|7] ""  ADC
 SG_ RBU_BrkTqCtrlActv : 121|2@0+ (1,0) [0|3] ""  ADC
 SG_ RBU_L3CommunicationInvalid : 94|1@0+ (1,0) [0|1] ""  ADC
 SG_ RBU_BrkPedlStsValid : 122|1@0+ (1,0) [0|1] ""  ADC
 SG_ RBU_BrkPedlSts : 124|2@0+ (1,0) [0|3] ""  ADC
 SG_ RBU_SBSAvailability : 125|1@0+ (1,0) [0|1] ""  ADC
 SG_ RBU_SBSActive : 315|1@0+ (1,0) [0|1] ""  ADC
 SG_ RBU_ParkBrakeCapability : 127|2@0+ (1,0) [0|3] ""  ADC
 SG_ RBU_DrvrTqDesVld : 256|1@0+ (1,0) [0|1] ""  ADC
 SG_ RBU_BrkActvTqValid : 257|1@0+ (1,0) [0|1] ""  ADC
 SG_ RBU_NetModeResp : 314|2@0+ (1,0) [0|3] ""  ADC
 SG_ RBU_DrvrTqDes : 327|16@0+ (1,-32768) [-32768|32767] "Nm"  ADC
 SG_ RBU_BrkActvTq : 343|16@0+ (1,-32768) [-32768|32767] "Nm"  ADC
 SG_ RBU_DrvrBrkOvrdVld : 272|1@0+ (1,0) [0|1] ""  ADC
 SG_ RBU_DrvrBrkOvrd : 273|1@0+ (1,0) [0|1] ""  ADC
 SG_ RBU_ADSNetErrFb : 354|3@0+ (1,0) [0|7] ""  ADC
 SG_ RBU_BrkTqCtrlActv_L3 : 356|2@0+ (1,0) [0|3] ""  ADC
 SG_ RBU_BrkTqCtrlAvl_L3 : 359|3@0+ (1,0) [0|7] ""  ADC

BO_ 430 CCU_SRS_1: 64 CCU
 SG_ SRS_1_CRC_1 : 7|16@0+ (1,0) [0|65535] ""  ZCUF,ZCUL,ZCUR,ZCUT,EMS,EPB,ADC,IFC,FAPA,IDU,PSDL,PSDR,TBOX2,TBOX,FLPDM,RLPDM,FRPDM,RRPDM
 SG_ SRS_1_Counter_1 : 23|8@0+ (1,0) [0|255] ""  ZCUF,ZCUL,ZCUR,ZCUT,EMS,EPB,ADC,IFC,FAPA,IDU,PSDL,PSDR,TBOX2,TBOX,FLPDM,RLPDM,FRPDM,RRPDM
 SG_ SRS_CrashOutputSt : 31|8@0+ (1,0) [0|160] ""  ZCUF,ZCUL,ZCUR,ZCUT,EMS,ADC,IFC,FAPA,IDU,PSDL,PSDR,TBOX2,TBOX,FLPDM,RLPDM,FRPDM,RRPDM
 SG_ SRS_Front_CrashOutputSt : 39|1@0+ (1,0) [0|1] ""  ZCUF,ZCUL,ZCUR,ADC,IFC,FAPA,PSDL,PSDR,TBOX2,TBOX,FLPDM,RLPDM,FRPDM,RRPDM
 SG_ SRS_DriverSide_CrashOutputSt : 38|1@0+ (1,0) [0|1] ""  ZCUF,ZCUL,ZCUR,ADC,IFC,FAPA,PSDL,PSDR,TBOX2,TBOX,FLPDM,RLPDM,FRPDM,RRPDM
 SG_ SRS_PassengerSide_CrashOutputSt : 37|1@0+ (1,0) [0|1] ""  ZCUF,ZCUL,ZCUR,ADC,IFC,FAPA,PSDL,PSDR,TBOX2,TBOX,FLPDM,RLPDM,FRPDM,RRPDM
 SG_ SRS_Rear_CrashOutputSt : 36|1@0+ (1,0) [0|1] ""  ZCUF,ZCUL,ZCUR,ADC,IFC,FAPA,PSDL,PSDR,TBOX2,TBOX,FLPDM,RLPDM,FRPDM,RRPDM
 SG_ SRS_RolloverCrashOutputSt : 35|1@0+ (1,0) [0|1] ""  ZCUF,ZCUL,ZCUR,ADC,IFC,FAPA,PSDL,PSDR,TBOX2,TBOX,FLPDM,RLPDM,FRPDM,RRPDM
 SG_ SRS_NearCrashOutputSt : 34|1@0+ (1,0) [0|1] ""  ZCUF,ZCUL,ZCUR,ADC,IFC,FAPA,PSDL,PSDR,TBOX2,TBOX,FLPDM,RLPDM,FRPDM,RRPDM
 SG_ SRS_1_CRC_2 : 111|16@0+ (1,0) [0|65535] ""  ZCUF,ZCUL,ZCUR,ZCUT,EPS,ADC,IFC,FAPA,RRR,RLR
 SG_ SRS_1_Counter_2 : 127|8@0+ (1,0) [0|255] ""  ZCUF,ZCUL,ZCUR,ZCUT,EPS,ADC,IFC,FAPA,RRR,RLR
 SG_ SRS_YawSnsCalibSt : 135|1@0+ (1,0) [0|1] ""  ZCUF,ZCUL,ZCUR,ADC,IFC,FAPA,RRR,RLR
 SG_ SRS_VehLongAccelVD : 134|2@0+ (1,0) [0|3] ""  ZCUF,ZCUL,ZCUR,ZCUT,EPS,EPB,ADC,IFC,FAPA,RRR,RLR,PCS
 SG_ SRS_VehLatrlAccelVD : 132|2@0+ (1,0) [0|3] ""  ZCUF,ZCUL,ZCUR,EPS,ADC,IFC,FAPA,RRR,RLR,PCS
 SG_ SRS_YawRateVD : 130|2@0+ (1,0) [0|3] ""  ZCUF,ZCUL,ZCUR,EPS,ADC,IFC,FAPA,RRR,RLR,PCS
 SG_ SRS_VehLongAccel : 143|12@0+ (0.001,-2) [-2|2] "g"  ZCUF,ZCUL,ZCUR,ZCUT,EPS,EPB,ADC,IFC,FAPA,RRR,RLR,PCS
 SG_ SRS_VehLatrlAccel : 147|12@0+ (0.001,-2) [-2|2] "g"  ZCUF,ZCUL,ZCUR,EPS,ADC,IFC,FAPA,RRR,RLR,PCS
 SG_ SRS_YawRate : 167|16@0+ (0.01,-180) [-180|180] "deg/s"  ZCUF,ZCUL,ZCUR,EPS,ADC,IFC,FAPA,RRR,RLR,PCS

BO_ 939 CCU_SRS_2: 32 CCU
 SG_ SRS_PsngrSeatBeltSt : 31|2@0+ (1,0) [0|3] ""  ICM,IDC,ADC,IFC,FAPA,TBOX2
 SG_ SRS_DriverSeatBeltSt : 29|2@0+ (1,0) [0|3] ""  ZCUF,ZCUL,ZCUR,ZCUT,ICM,IDC,ADC,IFC,FAPA,TBOX2
 SG_ SRS_RearLeftSeatBeltSt : 27|2@0+ (1,0) [0|3] ""  ICM,IDC,ADC,IFC,FAPA,TBOX2
 SG_ SRS_AirbagFaultSt : 25|1@0+ (1,0) [0|1] ""  ICM,IID,IDC,ADC,FAPA
 SG_ SRS_RearRightSeatBeltSt : 39|2@0+ (1,0) [0|3] ""  ICM,IDC,ADC,IFC,FAPA,TBOX2
 SG_ SRS_RearMiddleSeatBeltSt : 37|2@0+ (1,0) [0|3] ""  ICM,IDC,ADC,IFC,FAPA,TBOX2
 SG_ SRS_ThirdRowLeftSeatBeltSt : 51|2@0+ (1,0) [0|3] ""  IDC,ADC,IFC
 SG_ SRS_ThirdRowRightSeatBeltSt : 49|2@0+ (1,0) [0|3] ""  IDC,ADC,IFC
 SG_ SRS_ThirdRowMiddleSeatBeltSt : 83|2@0+ (1,0) [0|3] ""  IDC,ADC,IFC

CM_ SG_ 400 UINM_1_CRC "E2E Profile 5 CRC";
CM_ SG_ 400 UINM_1_Counter "E2E Profile 5 Counter";
CM_ SG_ 400 UINM_DrvReqShft "Driver requested gear shift position";
CM_ SG_ 400 UINM_DrvReqShftInv "Driver requested gear shift position inverse";
CM_ SG_ 400 UINM_FuSaErrSt "function safety Error status";
CM_ SG_ 400 UINM_ShftFault "this signal indicate E-shift fault which represent E-shift can not reflect the real driver demand because of any reason.";
CM_ SG_ 400 UINM_PositionLightSwSt "Position light switch state";
CM_ SG_ 400 UINM_LowBeamSwSt "Low beam switch state";
CM_ SG_ 400 UINM_AutoLightSwSt "Auto light switch state";
CM_ SG_ 400 UINM_FrontFogLightSwSt "Front fog light switch state";
CM_ SG_ 400 UINM_RearFogLightSwSt "Rear fog light switch state";
CM_ SG_ 400 UINM_HighBeamSwSt "High beam switch state";
CM_ SG_ 400 UINM_TurnLightSwSt "Turn light switch state";
CM_ SG_ 400 UINM_FrontWiperSwSt "Front wiper  switch status";
CM_ SG_ 400 UINM_FrontWiperIntAdjSwSt "Front wiper interval switch state";
CM_ SG_ 400 UINM_FrontWasherSwSt "Front Washer switch status ";
CM_ SG_ 400 UINM_RearWiperSwSt "Rear Wiper Switch Status";
CM_ SG_ 400 UINM_RearWiperIntAdjSwSt "RearWiperIntAdjSwSt ";
CM_ SG_ 400 UINM_RearWasherSwSt "Front Washer switch status ";
CM_ SG_ 400 UINM_HeadLampWasherSwSt "HeadLamp Washer switch status";
CM_ SG_ 792 ZCUT_2_CRC "E2E Profile 5 CRC";
CM_ SG_ 792 ZCUT_2_Counter "E2E Profile 5 Counter";
CM_ SG_ 792 UMM_SecondMIDSeatSt "Second Middle Seat Sensor Status";
CM_ SG_ 792 UMM_SecondRHSeatSt "Second Right Seat Sensor Status";
CM_ SG_ 792 UMM_SecondLHSeatSt "Second Left Seat Sensor Status";
CM_ SG_ 792 EL_RADASLightSt "Rear ADAS light status";
CM_ SG_ 792 UMM_ThirdLHSeatSt "Third Left Seat Sensor Status";
CM_ SG_ 792 UMM_ThirdRHSeatSt "Third Right Seat Sensor Status";
CM_ SG_ 792 UMM_ThirdMIDSeatSt "Third Middle Seat Sensor Status";
CM_ SG_ 792 LCK_PowerFillerCapAngle "PowerFillerCapOpenAngle";
CM_ SG_ 792 EL_ReverseLightSt "Reverse light status";
CM_ SG_ 792 EL_ReverseLightFaultSt "Reverse light fault status";
CM_ SG_ 792 EL_SideBrkLightSt "Side brake light status";
CM_ SG_ 792 EL_SideBrkLightFaultSt "Side brake light fault status";
CM_ SG_ 792 EL_CHMSLSt "Centre high mounted stop lamp status";
CM_ SG_ 792 EL_CHMSLFaultSt "Centre high mounted stop lamp fault status";
CM_ SG_ 792 EL_RLPositionLightSt "Rear left position light status";
CM_ SG_ 792 EL_RLPositionLightFaultSt "Rear left position light fault status";
CM_ SG_ 792 EL_RRPositionLightSt "Rear right position light status";
CM_ SG_ 792 EL_RRPositionLightFaultSt "Rear right position light fault status";
CM_ SG_ 792 EL_RearFogLightSt "Rear fog light status";
CM_ SG_ 792 EL_RearFogLightFaultSt "Rear fog light fault status";
CM_ SG_ 792 EL_RLTurnLightSt "Rear left turn light status";
CM_ SG_ 792 EL_RLTurnLightFaultSt "Rear left turn light fault status";
CM_ SG_ 792 EL_RRTurnLightSt "Rear right turn light status";
CM_ SG_ 792 EL_RRTurnLightFaultSt "Rear right turn light fault status";
CM_ SG_ 446 RBU_VehSpd "Vehicle speed";
CM_ SG_ 446 RBU_VehSpdVD "Quality/fault information to vehicle speed";
CM_ SG_ 446 RBU_FLWheelSpdEdgesSum "Accumulated sum of rising and falling edges of front left wheel speed sensor output·since IGN ON( the wheel plate have 43 teeth/cycle,the edge is 86)";
CM_ SG_ 446 RBU_FRWheelSpdEdgesSum "Accumulated sum of rising and falling edges of front right wheel speed sensor output·since IGN ON( the wheel plate have 43 teeth/cycle,the edge is 86)";
CM_ SG_ 446 RBU_RLWheelSpdEdgesSum "Accumulated sum of rising and falling edges of rear left wheel speed sensor output·since IGN ON( the wheel plate have 43teeth/cycle,the edge is 86)";
CM_ SG_ 446 RBU_RRWheelSpdEdgesSum "Accumulated sum of rising and falling edges of  rear right wheel speed sensor output·since IGN ON( the wheel plate have 43 teeth/cycle,the edge is 86)";
CM_ SG_ 446 RBU_FLWheelSpdEdgesSumVD "Quality/fault information to current wheel speed edges sum of front left wheel";
CM_ SG_ 446 RBU_FRWheelSpdEdgesSumVD "Quality/fault information to current wheel speed edges sum of front right wheel";
CM_ SG_ 446 RBU_RLWheelSpdEdgesSumVD "Quality/fault information to current wheel speed edges sum of rear left wheel";
CM_ SG_ 446 RBU_RRWheelSpdEdgesSumVD "Quality/fault information to current wheel speed edges sum of rear right wheel";
CM_ SG_ 446 RBU_FLWheelSpd "Current wheel speed information of front left wheel";
CM_ SG_ 446 RBU_FLWheelSpdVD "Quality/fault information to current wheel speed of front left wheel,be used for validity of BCS_FLWheelSpd and BCS_FLWheelSpdEdgesSum signal";
CM_ SG_ 446 RBU_FRWheelSpd "Current wheel speed information of front right wheel";
CM_ SG_ 446 RBU_FRWheelSpdVD "Quality/fault information to current wheel speed of front left wheel,be used for validity of BCS_FRWheelSpd and BCS_FRWheelSpdEdgesSum signal";
CM_ SG_ 446 RBU_RLWheelSpd "Current wheel speed information of rear left wheel";
CM_ SG_ 446 RBU_RLWheelSpdVD "Quality/fault information to current wheel speed of front left wheel,be used for validity of BCS_RLWheelSpd and BCS_RLWheelSpdEdgesSum signal";
CM_ SG_ 446 RBU_RRWheelSpd "Current wheel speed information of rear right wheel";
CM_ SG_ 446 RBU_RRWheelSpdVD "Quality/fault information to current wheel speed of RRont left wheel,be used for validity of BCS_RRWheelSpd and BCS_RRWheelSpdEdgesSum signal";
CM_ SG_ 446 RBU_FLWheelRotatedDirectionNEW "FL wheel rotate direction";
CM_ SG_ 446 RBU_FLWheelRotatedDirectionVD "FL wheel rotate direction validity";
CM_ SG_ 446 RBU_FRWheelRotatedDirectionNEW "FR wheel rotate direction";
CM_ SG_ 446 RBU_FRWheelRotatedDirectionVD "FRwheel rotate direction validity";
CM_ SG_ 446 RBU_RLWheelRotatedDirectionNEW "RL wheel rotate direction";
CM_ SG_ 446 RBU_RLWheelRotatedDirectionVD "RL wheel rotate direction validity";
CM_ SG_ 446 RBU_RRWheelRotatedDirectionNEW "RRwheel rotate direction";
CM_ SG_ 446 RBU_RRWheelRotatedDirectionVD "RRwheel rotate direction validity";
CM_ SG_ 446 RBU_MasterCylinderPr "Master cylinder pressure";
CM_ SG_ 446 RBU_MasterCylinderPrVD "The valid value of RBU_MasterCylinderPr";
CM_ SG_ 446 RBU_BrkTqCtrlAvlDriving "It indicates  whether  RBU is available for cruise Brake Torque function";
CM_ SG_ 446 RBU_BrkTqCtrlAvlParking "It indicates  whether  RBU is available for parking Brake Torque function.";
CM_ SG_ 446 RBU_BrkTqCtrlActv "It indicates  whether RBU is  responsed for the brake request of ADAS.";
CM_ SG_ 446 RBU_L3CommunicationInvalid "The validity of L3 Communication";
CM_ SG_ 446 RBU_BrkPedlStsValid "The validity  of brake pedal for driver Status";
CM_ SG_ 446 RBU_BrkPedlSts "RBU brake pedal for driver Status";
CM_ SG_ 446 RBU_SBSAvailability "It indicates  whether  RBU is available ";
CM_ SG_ 446 RBU_SBSActive "It indicates  whether  RBU is active";
CM_ SG_ 446 RBU_ParkBrakeCapability "RBU_ParkBrakeCapability";
CM_ SG_ 446 RBU_DrvrTqDesVld "The validity of RBU_DrvrTqDes";
CM_ SG_ 446 RBU_BrkActvTqValid "The validity of RBU_BrkActvTq";
CM_ SG_ 446 RBU_NetModeResp " RBU Brake Torque Response Status in Main  Net";
CM_ SG_ 446 RBU_DrvrTqDes "When driver prsees brake pedal，It is the brake torque calculated by RBU corresponding to MasterCylinderPr.";
CM_ SG_ 446 RBU_BrkActvTq "It is the real total brake  torque carried out by electric motor";
CM_ SG_ 446 RBU_DrvrBrkOvrdVld "The validity  of  RBU_DrvrBrkOvrd";
CM_ SG_ 446 RBU_DrvrBrkOvrd "Indicate driver brakes torque more than the ADAS/ADS in RBU ";
CM_ SG_ 446 RBU_ADSNetErrFb "RBU_ADSNetErrFb";
CM_ SG_ 446 RBU_BrkTqCtrlActv_L3 "It indicates  whether RBU is  responsed for the brake request of ADAS for  L3.";
CM_ SG_ 446 RBU_BrkTqCtrlAvl_L3 "It indicates  whether  RBU is available for L3 cruise Brake Torque function";
CM_ SG_ 430 SRS_1_CRC_1 "E2E Profile 5 CRC";
CM_ SG_ 430 SRS_1_Counter_1 "E2E Profile 5 Counter";
CM_ SG_ 430 SRS_CrashOutputSt "To inform there's crash event happened in last 2 seconds.After 2 seconds, the signal will turn to 0(crash here means any one of the 5 status defined below)";
CM_ SG_ 430 SRS_Front_CrashOutputSt "To inform there's front crash event happened in last 2 seconds. After 2 seconds, the signal will turn to 0.";
CM_ SG_ 430 SRS_DriverSide_CrashOutputSt "To inform there's driver side crash event happened in last 2 seconds. After 2 seconds, the signal will turn to 0.(Driver side is the left side for the left-hand-drive vehicle, the right side for the right-hand-drive one. )";
CM_ SG_ 430 SRS_PassengerSide_CrashOutputSt "To inform there's passenger side crash event happened in last 2 seconds. After 2 seconds, the signal will turn to 0.(Passenger side is the right side for the left-hand-drive vehicle, the left side for the right-hand-drive one. )";
CM_ SG_ 430 SRS_Rear_CrashOutputSt "To inform there's rear crash event happened in last 2 seconds. After 2 seconds, the signal will turn to 0.";
CM_ SG_ 430 SRS_RolloverCrashOutputSt "To inform there's rollover crash event happened in last 2 seconds. After 2 seconds, the signal will turn to 0.";
CM_ SG_ 430 SRS_NearCrashOutputSt "To inform there's near crash event happened in last 2 seconds.After 2 seconds, the signal will turn to 0";
CM_ SG_ 430 SRS_1_CRC_2 "E2E Profile 5 CRC";
CM_ SG_ 430 SRS_1_Counter_2 "E2E Profile 5 Counter";
CM_ SG_ 430 SRS_YawSnsCalibSt "To indicates  yaw sensor calibration state";
CM_ SG_ 430 SRS_VehLongAccelVD "To indicate vehicle longitudinal acceleration valid state";
CM_ SG_ 430 SRS_VehLatrlAccelVD "To indicate vehicle lateral acceleration valid state";
CM_ SG_ 430 SRS_YawRateVD "To indicate yaw rate valid state";
CM_ SG_ 430 SRS_VehLongAccel "To indicate vehicle longitudinal acceleration";
CM_ SG_ 430 SRS_VehLatrlAccel "To indicate vehicle lateral acceleration";
CM_ SG_ 430 SRS_YawRate "To indicate vehicle yaw rate";
CM_ SG_ 939 SRS_PsngrSeatBeltSt "To identify whether first row passenger seat belt is buckled.(Passenger side is the right side for the left-hand-drive vehicle, the left side for the right-hand-drive one. )";
CM_ SG_ 939 SRS_DriverSeatBeltSt "To identify whether first row driver seat belt is buckled.(Driver side is the left side for the left-hand-drive vehicle, the right side for the right-hand-drive one. )";
CM_ SG_ 939 SRS_RearLeftSeatBeltSt "To identify whetherRearDriverSeatBelt is buckled";
CM_ SG_ 939 SRS_AirbagFaultSt "To illuminate or turn off airbag warning indicator";
CM_ SG_ 939 SRS_RearRightSeatBeltSt "To identify  whetherRearPassengerSeatBelt is buckled";
CM_ SG_ 939 SRS_RearMiddleSeatBeltSt "To identify whetherRearMiddleSeatBelt is buckled";
CM_ SG_ 939 SRS_ThirdRowLeftSeatBeltSt "To identify whetherThirdRowLeftSeatBelt is buckled";
CM_ SG_ 939 SRS_ThirdRowRightSeatBeltSt "To identify whetherThirdRowRightSeatBelt is buckled";
CM_ SG_ 939 SRS_ThirdRowMiddleSeatBeltSt "To identify whetherThirdRowMiddleSeatBelt is buckled";

BA_DEF_ BO_  "GenMsgCycleTime" INT 0 0;
BA_DEF_ BO_  "GenMsgCycleTimeFast" INT 0 0;
BA_DEF_ BO_  "GenMsgSendType" ENUM  "Periodic","Event","IfActive","POE","PA","FixedPeriodic","Event","EnabledPeriodic","NotUsed","NotUsed","EventPeriodic","NotUsed","NotUsed","NoMsgSendType";
BA_DEF_ BO_  "VFrameFormat" ENUM  "StandardCAN","ExtendedCAN","reserved","reserved","reserved","reserved","reserved","reserved","reserved","reserved","reserved","reserved","reserved","reserved","StandardCAN_FD","ExtendedCAN_FD";
BA_DEF_ BO_  "CANFD_BRS" ENUM  "0","1";
BA_DEF_ SG_  "EventCommandSignal" ENUM  "No","Yes";
BA_DEF_ SG_  "GatewayedSignals" ENUM  "No","Yes";
BA_DEF_ SG_  "GenSigInactiveValue" HEX 0 0;
BA_DEF_ SG_  "GenSigInvalidValue" HEX 0 0;
BA_DEF_ SG_  "GenSigSendType" ENUM  "Trigger","Passive","Cyclic","OnWrite","OnWriteWithRepetition","OnChange","OnChangeWithRepetition","IfActive","IfActiveWithRepetition","NoSigSendType";
BA_DEF_ SG_  "GenSigStartValue" HEX 0 0;
BA_DEF_ SG_  "GenSigTimeoutValue" HEX 0 0;
BA_DEF_ SG_  "Remark" STRING ;
BA_ "GenMsgCycleTime" BO_ 400 20;
BA_ "GenMsgCycleTimeFast" BO_ 400 0;
BA_ "GenMsgSendType" BO_ 400 0;
BA_ "VFrameFormat" BO_ 400 14;
BA_ "CANFD_BRS" BO_ 400 1;
BA_ "GenMsgCycleTime" BO_ 400 20;
BA_ "GenMsgCycleTimeFast" BO_ 400 0;
BA_ "GenMsgSendType" BO_ 400 0;
BA_ "VFrameFormat" BO_ 400 14;
BA_ "CANFD_BRS" BO_ 400 1;
BA_ "GenMsgCycleTime" BO_ 400 20;
BA_ "GenMsgCycleTimeFast" BO_ 400 0;
BA_ "GenMsgSendType" BO_ 400 0;
BA_ "VFrameFormat" BO_ 400 14;
BA_ "CANFD_BRS" BO_ 400 1;
BA_ "GenMsgCycleTime" BO_ 400 20;
BA_ "GenMsgCycleTimeFast" BO_ 400 0;
BA_ "GenMsgSendType" BO_ 400 0;
BA_ "VFrameFormat" BO_ 400 14;
BA_ "CANFD_BRS" BO_ 400 1;
BA_ "GenMsgCycleTime" BO_ 400 20;
BA_ "GenMsgCycleTimeFast" BO_ 400 0;
BA_ "GenMsgSendType" BO_ 400 0;
BA_ "VFrameFormat" BO_ 400 14;
BA_ "CANFD_BRS" BO_ 400 1;
BA_ "GenMsgCycleTime" BO_ 400 20;
BA_ "GenMsgCycleTimeFast" BO_ 400 0;
BA_ "GenMsgSendType" BO_ 400 0;
BA_ "VFrameFormat" BO_ 400 14;
BA_ "CANFD_BRS" BO_ 400 1;
BA_ "GenMsgCycleTime" BO_ 400 20;
BA_ "GenMsgCycleTimeFast" BO_ 400 0;
BA_ "GenMsgSendType" BO_ 400 0;
BA_ "VFrameFormat" BO_ 400 14;
BA_ "CANFD_BRS" BO_ 400 1;
BA_ "GenMsgCycleTime" BO_ 400 20;
BA_ "GenMsgCycleTimeFast" BO_ 400 0;
BA_ "GenMsgSendType" BO_ 400 0;
BA_ "VFrameFormat" BO_ 400 14;
BA_ "CANFD_BRS" BO_ 400 1;
BA_ "GenMsgCycleTime" BO_ 400 20;
BA_ "GenMsgCycleTimeFast" BO_ 400 0;
BA_ "GenMsgSendType" BO_ 400 0;
BA_ "VFrameFormat" BO_ 400 14;
BA_ "CANFD_BRS" BO_ 400 1;
BA_ "GenMsgCycleTime" BO_ 400 20;
BA_ "GenMsgCycleTimeFast" BO_ 400 0;
BA_ "GenMsgSendType" BO_ 400 0;
BA_ "VFrameFormat" BO_ 400 14;
BA_ "CANFD_BRS" BO_ 400 1;
BA_ "GenMsgCycleTime" BO_ 400 20;
BA_ "GenMsgCycleTimeFast" BO_ 400 0;
BA_ "GenMsgSendType" BO_ 400 0;
BA_ "VFrameFormat" BO_ 400 14;
BA_ "CANFD_BRS" BO_ 400 1;
BA_ "GenMsgCycleTime" BO_ 400 20;
BA_ "GenMsgCycleTimeFast" BO_ 400 0;
BA_ "GenMsgSendType" BO_ 400 0;
BA_ "VFrameFormat" BO_ 400 14;
BA_ "CANFD_BRS" BO_ 400 1;
BA_ "GenMsgCycleTime" BO_ 400 20;
BA_ "GenMsgCycleTimeFast" BO_ 400 0;
BA_ "GenMsgSendType" BO_ 400 0;
BA_ "VFrameFormat" BO_ 400 14;
BA_ "CANFD_BRS" BO_ 400 1;
BA_ "GenMsgCycleTime" BO_ 400 20;
BA_ "GenMsgCycleTimeFast" BO_ 400 0;
BA_ "GenMsgSendType" BO_ 400 0;
BA_ "VFrameFormat" BO_ 400 14;
BA_ "CANFD_BRS" BO_ 400 1;
BA_ "GenMsgCycleTime" BO_ 400 20;
BA_ "GenMsgCycleTimeFast" BO_ 400 0;
BA_ "GenMsgSendType" BO_ 400 0;
BA_ "VFrameFormat" BO_ 400 14;
BA_ "CANFD_BRS" BO_ 400 1;
BA_ "GenMsgCycleTime" BO_ 400 20;
BA_ "GenMsgCycleTimeFast" BO_ 400 0;
BA_ "GenMsgSendType" BO_ 400 0;
BA_ "VFrameFormat" BO_ 400 14;
BA_ "CANFD_BRS" BO_ 400 1;
BA_ "GenMsgCycleTime" BO_ 400 20;
BA_ "GenMsgCycleTimeFast" BO_ 400 0;
BA_ "GenMsgSendType" BO_ 400 0;
BA_ "VFrameFormat" BO_ 400 14;
BA_ "CANFD_BRS" BO_ 400 1;
BA_ "GenMsgCycleTime" BO_ 400 20;
BA_ "GenMsgCycleTimeFast" BO_ 400 0;
BA_ "GenMsgSendType" BO_ 400 0;
BA_ "VFrameFormat" BO_ 400 14;
BA_ "CANFD_BRS" BO_ 400 1;
BA_ "GenMsgCycleTime" BO_ 400 20;
BA_ "GenMsgCycleTimeFast" BO_ 400 0;
BA_ "GenMsgSendType" BO_ 400 0;
BA_ "VFrameFormat" BO_ 400 14;
BA_ "CANFD_BRS" BO_ 400 1;
BA_ "GenMsgCycleTime" BO_ 400 20;
BA_ "GenMsgCycleTimeFast" BO_ 400 0;
BA_ "GenMsgSendType" BO_ 400 0;
BA_ "VFrameFormat" BO_ 400 14;
BA_ "CANFD_BRS" BO_ 400 1;
BA_ "GenMsgCycleTime" BO_ 792 100;
BA_ "GenMsgCycleTimeFast" BO_ 792 0;
BA_ "GenMsgSendType" BO_ 792 0;
BA_ "VFrameFormat" BO_ 792 14;
BA_ "CANFD_BRS" BO_ 792 1;
BA_ "GenMsgCycleTime" BO_ 792 100;
BA_ "GenMsgCycleTimeFast" BO_ 792 0;
BA_ "GenMsgSendType" BO_ 792 0;
BA_ "VFrameFormat" BO_ 792 14;
BA_ "CANFD_BRS" BO_ 792 1;
BA_ "GenMsgCycleTime" BO_ 792 100;
BA_ "GenMsgCycleTimeFast" BO_ 792 0;
BA_ "GenMsgSendType" BO_ 792 0;
BA_ "VFrameFormat" BO_ 792 14;
BA_ "CANFD_BRS" BO_ 792 1;
BA_ "GenMsgCycleTime" BO_ 792 100;
BA_ "GenMsgCycleTimeFast" BO_ 792 0;
BA_ "GenMsgSendType" BO_ 792 0;
BA_ "VFrameFormat" BO_ 792 14;
BA_ "CANFD_BRS" BO_ 792 1;
BA_ "GenMsgCycleTime" BO_ 792 100;
BA_ "GenMsgCycleTimeFast" BO_ 792 0;
BA_ "GenMsgSendType" BO_ 792 0;
BA_ "VFrameFormat" BO_ 792 14;
BA_ "CANFD_BRS" BO_ 792 1;
BA_ "GenMsgCycleTime" BO_ 792 100;
BA_ "GenMsgCycleTimeFast" BO_ 792 0;
BA_ "GenMsgSendType" BO_ 792 0;
BA_ "VFrameFormat" BO_ 792 14;
BA_ "CANFD_BRS" BO_ 792 1;
BA_ "GenMsgCycleTime" BO_ 792 100;
BA_ "GenMsgCycleTimeFast" BO_ 792 0;
BA_ "GenMsgSendType" BO_ 792 0;
BA_ "VFrameFormat" BO_ 792 14;
BA_ "CANFD_BRS" BO_ 792 1;
BA_ "GenMsgCycleTime" BO_ 792 100;
BA_ "GenMsgCycleTimeFast" BO_ 792 0;
BA_ "GenMsgSendType" BO_ 792 0;
BA_ "VFrameFormat" BO_ 792 14;
BA_ "CANFD_BRS" BO_ 792 1;
BA_ "GenMsgCycleTime" BO_ 792 100;
BA_ "GenMsgCycleTimeFast" BO_ 792 0;
BA_ "GenMsgSendType" BO_ 792 0;
BA_ "VFrameFormat" BO_ 792 14;
BA_ "CANFD_BRS" BO_ 792 1;
BA_ "GenMsgCycleTime" BO_ 792 100;
BA_ "GenMsgCycleTimeFast" BO_ 792 0;
BA_ "GenMsgSendType" BO_ 792 0;
BA_ "VFrameFormat" BO_ 792 14;
BA_ "CANFD_BRS" BO_ 792 1;
BA_ "GenMsgCycleTime" BO_ 792 100;
BA_ "GenMsgCycleTimeFast" BO_ 792 0;
BA_ "GenMsgSendType" BO_ 792 0;
BA_ "VFrameFormat" BO_ 792 14;
BA_ "CANFD_BRS" BO_ 792 1;
BA_ "GenMsgCycleTime" BO_ 792 100;
BA_ "GenMsgCycleTimeFast" BO_ 792 0;
BA_ "GenMsgSendType" BO_ 792 0;
BA_ "VFrameFormat" BO_ 792 14;
BA_ "CANFD_BRS" BO_ 792 1;
BA_ "GenMsgCycleTime" BO_ 792 100;
BA_ "GenMsgCycleTimeFast" BO_ 792 0;
BA_ "GenMsgSendType" BO_ 792 0;
BA_ "VFrameFormat" BO_ 792 14;
BA_ "CANFD_BRS" BO_ 792 1;
BA_ "GenMsgCycleTime" BO_ 792 100;
BA_ "GenMsgCycleTimeFast" BO_ 792 0;
BA_ "GenMsgSendType" BO_ 792 0;
BA_ "VFrameFormat" BO_ 792 14;
BA_ "CANFD_BRS" BO_ 792 1;
BA_ "GenMsgCycleTime" BO_ 792 100;
BA_ "GenMsgCycleTimeFast" BO_ 792 0;
BA_ "GenMsgSendType" BO_ 792 0;
BA_ "VFrameFormat" BO_ 792 14;
BA_ "CANFD_BRS" BO_ 792 1;
BA_ "GenMsgCycleTime" BO_ 792 100;
BA_ "GenMsgCycleTimeFast" BO_ 792 0;
BA_ "GenMsgSendType" BO_ 792 0;
BA_ "VFrameFormat" BO_ 792 14;
BA_ "CANFD_BRS" BO_ 792 1;
BA_ "GenMsgCycleTime" BO_ 792 100;
BA_ "GenMsgCycleTimeFast" BO_ 792 0;
BA_ "GenMsgSendType" BO_ 792 0;
BA_ "VFrameFormat" BO_ 792 14;
BA_ "CANFD_BRS" BO_ 792 1;
BA_ "GenMsgCycleTime" BO_ 792 100;
BA_ "GenMsgCycleTimeFast" BO_ 792 0;
BA_ "GenMsgSendType" BO_ 792 0;
BA_ "VFrameFormat" BO_ 792 14;
BA_ "CANFD_BRS" BO_ 792 1;
BA_ "GenMsgCycleTime" BO_ 792 100;
BA_ "GenMsgCycleTimeFast" BO_ 792 0;
BA_ "GenMsgSendType" BO_ 792 0;
BA_ "VFrameFormat" BO_ 792 14;
BA_ "CANFD_BRS" BO_ 792 1;
BA_ "GenMsgCycleTime" BO_ 792 100;
BA_ "GenMsgCycleTimeFast" BO_ 792 0;
BA_ "GenMsgSendType" BO_ 792 0;
BA_ "VFrameFormat" BO_ 792 14;
BA_ "CANFD_BRS" BO_ 792 1;
BA_ "GenMsgCycleTime" BO_ 792 100;
BA_ "GenMsgCycleTimeFast" BO_ 792 0;
BA_ "GenMsgSendType" BO_ 792 0;
BA_ "VFrameFormat" BO_ 792 14;
BA_ "CANFD_BRS" BO_ 792 1;
BA_ "GenMsgCycleTime" BO_ 792 100;
BA_ "GenMsgCycleTimeFast" BO_ 792 0;
BA_ "GenMsgSendType" BO_ 792 0;
BA_ "VFrameFormat" BO_ 792 14;
BA_ "CANFD_BRS" BO_ 792 1;
BA_ "GenMsgCycleTime" BO_ 792 100;
BA_ "GenMsgCycleTimeFast" BO_ 792 0;
BA_ "GenMsgSendType" BO_ 792 0;
BA_ "VFrameFormat" BO_ 792 14;
BA_ "CANFD_BRS" BO_ 792 1;
BA_ "GenMsgCycleTime" BO_ 792 100;
BA_ "GenMsgCycleTimeFast" BO_ 792 0;
BA_ "GenMsgSendType" BO_ 792 0;
BA_ "VFrameFormat" BO_ 792 14;
BA_ "CANFD_BRS" BO_ 792 1;
BA_ "GenMsgCycleTime" BO_ 792 100;
BA_ "GenMsgCycleTimeFast" BO_ 792 0;
BA_ "GenMsgSendType" BO_ 792 0;
BA_ "VFrameFormat" BO_ 792 14;
BA_ "CANFD_BRS" BO_ 792 1;
BA_ "GenMsgCycleTime" BO_ 792 100;
BA_ "GenMsgCycleTimeFast" BO_ 792 0;
BA_ "GenMsgSendType" BO_ 792 0;
BA_ "VFrameFormat" BO_ 792 14;
BA_ "CANFD_BRS" BO_ 792 1;
BA_ "GenMsgCycleTime" BO_ 446 20;
BA_ "GenMsgCycleTimeFast" BO_ 446 0;
BA_ "GenMsgSendType" BO_ 446 0;
BA_ "VFrameFormat" BO_ 446 14;
BA_ "CANFD_BRS" BO_ 446 1;
BA_ "GenMsgCycleTime" BO_ 446 20;
BA_ "GenMsgCycleTimeFast" BO_ 446 0;
BA_ "GenMsgSendType" BO_ 446 0;
BA_ "VFrameFormat" BO_ 446 14;
BA_ "CANFD_BRS" BO_ 446 1;
BA_ "GenMsgCycleTime" BO_ 446 20;
BA_ "GenMsgCycleTimeFast" BO_ 446 0;
BA_ "GenMsgSendType" BO_ 446 0;
BA_ "VFrameFormat" BO_ 446 14;
BA_ "CANFD_BRS" BO_ 446 1;
BA_ "GenMsgCycleTime" BO_ 446 20;
BA_ "GenMsgCycleTimeFast" BO_ 446 0;
BA_ "GenMsgSendType" BO_ 446 0;
BA_ "VFrameFormat" BO_ 446 14;
BA_ "CANFD_BRS" BO_ 446 1;
BA_ "GenMsgCycleTime" BO_ 446 20;
BA_ "GenMsgCycleTimeFast" BO_ 446 0;
BA_ "GenMsgSendType" BO_ 446 0;
BA_ "VFrameFormat" BO_ 446 14;
BA_ "CANFD_BRS" BO_ 446 1;
BA_ "GenMsgCycleTime" BO_ 446 20;
BA_ "GenMsgCycleTimeFast" BO_ 446 0;
BA_ "GenMsgSendType" BO_ 446 0;
BA_ "VFrameFormat" BO_ 446 14;
BA_ "CANFD_BRS" BO_ 446 1;
BA_ "GenMsgCycleTime" BO_ 446 20;
BA_ "GenMsgCycleTimeFast" BO_ 446 0;
BA_ "GenMsgSendType" BO_ 446 0;
BA_ "VFrameFormat" BO_ 446 14;
BA_ "CANFD_BRS" BO_ 446 1;
BA_ "GenMsgCycleTime" BO_ 446 20;
BA_ "GenMsgCycleTimeFast" BO_ 446 0;
BA_ "GenMsgSendType" BO_ 446 0;
BA_ "VFrameFormat" BO_ 446 14;
BA_ "CANFD_BRS" BO_ 446 1;
BA_ "GenMsgCycleTime" BO_ 446 20;
BA_ "GenMsgCycleTimeFast" BO_ 446 0;
BA_ "GenMsgSendType" BO_ 446 0;
BA_ "VFrameFormat" BO_ 446 14;
BA_ "CANFD_BRS" BO_ 446 1;
BA_ "GenMsgCycleTime" BO_ 446 20;
BA_ "GenMsgCycleTimeFast" BO_ 446 0;
BA_ "GenMsgSendType" BO_ 446 0;
BA_ "VFrameFormat" BO_ 446 14;
BA_ "CANFD_BRS" BO_ 446 1;
BA_ "GenMsgCycleTime" BO_ 446 20;
BA_ "GenMsgCycleTimeFast" BO_ 446 0;
BA_ "GenMsgSendType" BO_ 446 0;
BA_ "VFrameFormat" BO_ 446 14;
BA_ "CANFD_BRS" BO_ 446 1;
BA_ "GenMsgCycleTime" BO_ 446 20;
BA_ "GenMsgCycleTimeFast" BO_ 446 0;
BA_ "GenMsgSendType" BO_ 446 0;
BA_ "VFrameFormat" BO_ 446 14;
BA_ "CANFD_BRS" BO_ 446 1;
BA_ "GenMsgCycleTime" BO_ 446 20;
BA_ "GenMsgCycleTimeFast" BO_ 446 0;
BA_ "GenMsgSendType" BO_ 446 0;
BA_ "VFrameFormat" BO_ 446 14;
BA_ "CANFD_BRS" BO_ 446 1;
BA_ "GenMsgCycleTime" BO_ 446 20;
BA_ "GenMsgCycleTimeFast" BO_ 446 0;
BA_ "GenMsgSendType" BO_ 446 0;
BA_ "VFrameFormat" BO_ 446 14;
BA_ "CANFD_BRS" BO_ 446 1;
BA_ "GenMsgCycleTime" BO_ 446 20;
BA_ "GenMsgCycleTimeFast" BO_ 446 0;
BA_ "GenMsgSendType" BO_ 446 0;
BA_ "VFrameFormat" BO_ 446 14;
BA_ "CANFD_BRS" BO_ 446 1;
BA_ "GenMsgCycleTime" BO_ 446 20;
BA_ "GenMsgCycleTimeFast" BO_ 446 0;
BA_ "GenMsgSendType" BO_ 446 0;
BA_ "VFrameFormat" BO_ 446 14;
BA_ "CANFD_BRS" BO_ 446 1;
BA_ "GenMsgCycleTime" BO_ 446 20;
BA_ "GenMsgCycleTimeFast" BO_ 446 0;
BA_ "GenMsgSendType" BO_ 446 0;
BA_ "VFrameFormat" BO_ 446 14;
BA_ "CANFD_BRS" BO_ 446 1;
BA_ "GenMsgCycleTime" BO_ 446 20;
BA_ "GenMsgCycleTimeFast" BO_ 446 0;
BA_ "GenMsgSendType" BO_ 446 0;
BA_ "VFrameFormat" BO_ 446 14;
BA_ "CANFD_BRS" BO_ 446 1;
BA_ "GenMsgCycleTime" BO_ 446 20;
BA_ "GenMsgCycleTimeFast" BO_ 446 0;
BA_ "GenMsgSendType" BO_ 446 0;
BA_ "VFrameFormat" BO_ 446 14;
BA_ "CANFD_BRS" BO_ 446 1;
BA_ "GenMsgCycleTime" BO_ 446 20;
BA_ "GenMsgCycleTimeFast" BO_ 446 0;
BA_ "GenMsgSendType" BO_ 446 0;
BA_ "VFrameFormat" BO_ 446 14;
BA_ "CANFD_BRS" BO_ 446 1;
BA_ "GenMsgCycleTime" BO_ 446 20;
BA_ "GenMsgCycleTimeFast" BO_ 446 0;
BA_ "GenMsgSendType" BO_ 446 0;
BA_ "VFrameFormat" BO_ 446 14;
BA_ "CANFD_BRS" BO_ 446 1;
BA_ "GenMsgCycleTime" BO_ 446 20;
BA_ "GenMsgCycleTimeFast" BO_ 446 0;
BA_ "GenMsgSendType" BO_ 446 0;
BA_ "VFrameFormat" BO_ 446 14;
BA_ "CANFD_BRS" BO_ 446 1;
BA_ "GenMsgCycleTime" BO_ 446 20;
BA_ "GenMsgCycleTimeFast" BO_ 446 0;
BA_ "GenMsgSendType" BO_ 446 0;
BA_ "VFrameFormat" BO_ 446 14;
BA_ "CANFD_BRS" BO_ 446 1;
BA_ "GenMsgCycleTime" BO_ 446 20;
BA_ "GenMsgCycleTimeFast" BO_ 446 0;
BA_ "GenMsgSendType" BO_ 446 0;
BA_ "VFrameFormat" BO_ 446 14;
BA_ "CANFD_BRS" BO_ 446 1;
BA_ "GenMsgCycleTime" BO_ 446 20;
BA_ "GenMsgCycleTimeFast" BO_ 446 0;
BA_ "GenMsgSendType" BO_ 446 0;
BA_ "VFrameFormat" BO_ 446 14;
BA_ "CANFD_BRS" BO_ 446 1;
BA_ "GenMsgCycleTime" BO_ 446 20;
BA_ "GenMsgCycleTimeFast" BO_ 446 0;
BA_ "GenMsgSendType" BO_ 446 0;
BA_ "VFrameFormat" BO_ 446 14;
BA_ "CANFD_BRS" BO_ 446 1;
BA_ "GenMsgCycleTime" BO_ 446 20;
BA_ "GenMsgCycleTimeFast" BO_ 446 0;
BA_ "GenMsgSendType" BO_ 446 0;
BA_ "VFrameFormat" BO_ 446 14;
BA_ "CANFD_BRS" BO_ 446 1;
BA_ "GenMsgCycleTime" BO_ 446 20;
BA_ "GenMsgCycleTimeFast" BO_ 446 0;
BA_ "GenMsgSendType" BO_ 446 0;
BA_ "VFrameFormat" BO_ 446 14;
BA_ "CANFD_BRS" BO_ 446 1;
BA_ "GenMsgCycleTime" BO_ 446 20;
BA_ "GenMsgCycleTimeFast" BO_ 446 0;
BA_ "GenMsgSendType" BO_ 446 0;
BA_ "VFrameFormat" BO_ 446 14;
BA_ "CANFD_BRS" BO_ 446 1;
BA_ "GenMsgCycleTime" BO_ 446 20;
BA_ "GenMsgCycleTimeFast" BO_ 446 0;
BA_ "GenMsgSendType" BO_ 446 0;
BA_ "VFrameFormat" BO_ 446 14;
BA_ "CANFD_BRS" BO_ 446 1;
BA_ "GenMsgCycleTime" BO_ 446 20;
BA_ "GenMsgCycleTimeFast" BO_ 446 0;
BA_ "GenMsgSendType" BO_ 446 0;
BA_ "VFrameFormat" BO_ 446 14;
BA_ "CANFD_BRS" BO_ 446 1;
BA_ "GenMsgCycleTime" BO_ 446 20;
BA_ "GenMsgCycleTimeFast" BO_ 446 0;
BA_ "GenMsgSendType" BO_ 446 0;
BA_ "VFrameFormat" BO_ 446 14;
BA_ "CANFD_BRS" BO_ 446 1;
BA_ "GenMsgCycleTime" BO_ 446 20;
BA_ "GenMsgCycleTimeFast" BO_ 446 0;
BA_ "GenMsgSendType" BO_ 446 0;
BA_ "VFrameFormat" BO_ 446 14;
BA_ "CANFD_BRS" BO_ 446 1;
BA_ "GenMsgCycleTime" BO_ 446 20;
BA_ "GenMsgCycleTimeFast" BO_ 446 0;
BA_ "GenMsgSendType" BO_ 446 0;
BA_ "VFrameFormat" BO_ 446 14;
BA_ "CANFD_BRS" BO_ 446 1;
BA_ "GenMsgCycleTime" BO_ 446 20;
BA_ "GenMsgCycleTimeFast" BO_ 446 0;
BA_ "GenMsgSendType" BO_ 446 0;
BA_ "VFrameFormat" BO_ 446 14;
BA_ "CANFD_BRS" BO_ 446 1;
BA_ "GenMsgCycleTime" BO_ 446 20;
BA_ "GenMsgCycleTimeFast" BO_ 446 0;
BA_ "GenMsgSendType" BO_ 446 0;
BA_ "VFrameFormat" BO_ 446 14;
BA_ "CANFD_BRS" BO_ 446 1;
BA_ "GenMsgCycleTime" BO_ 446 20;
BA_ "GenMsgCycleTimeFast" BO_ 446 0;
BA_ "GenMsgSendType" BO_ 446 0;
BA_ "VFrameFormat" BO_ 446 14;
BA_ "CANFD_BRS" BO_ 446 1;
BA_ "GenMsgCycleTime" BO_ 446 20;
BA_ "GenMsgCycleTimeFast" BO_ 446 0;
BA_ "GenMsgSendType" BO_ 446 0;
BA_ "VFrameFormat" BO_ 446 14;
BA_ "CANFD_BRS" BO_ 446 1;
BA_ "GenMsgCycleTime" BO_ 446 20;
BA_ "GenMsgCycleTimeFast" BO_ 446 0;
BA_ "GenMsgSendType" BO_ 446 0;
BA_ "VFrameFormat" BO_ 446 14;
BA_ "CANFD_BRS" BO_ 446 1;
BA_ "GenMsgCycleTime" BO_ 446 20;
BA_ "GenMsgCycleTimeFast" BO_ 446 0;
BA_ "GenMsgSendType" BO_ 446 0;
BA_ "VFrameFormat" BO_ 446 14;
BA_ "CANFD_BRS" BO_ 446 1;
BA_ "GenMsgCycleTime" BO_ 446 20;
BA_ "GenMsgCycleTimeFast" BO_ 446 0;
BA_ "GenMsgSendType" BO_ 446 0;
BA_ "VFrameFormat" BO_ 446 14;
BA_ "CANFD_BRS" BO_ 446 1;
BA_ "GenMsgCycleTime" BO_ 446 20;
BA_ "GenMsgCycleTimeFast" BO_ 446 0;
BA_ "GenMsgSendType" BO_ 446 0;
BA_ "VFrameFormat" BO_ 446 14;
BA_ "CANFD_BRS" BO_ 446 1;
BA_ "GenMsgCycleTime" BO_ 446 20;
BA_ "GenMsgCycleTimeFast" BO_ 446 0;
BA_ "GenMsgSendType" BO_ 446 0;
BA_ "VFrameFormat" BO_ 446 14;
BA_ "CANFD_BRS" BO_ 446 1;
BA_ "GenMsgCycleTime" BO_ 446 20;
BA_ "GenMsgCycleTimeFast" BO_ 446 0;
BA_ "GenMsgSendType" BO_ 446 0;
BA_ "VFrameFormat" BO_ 446 14;
BA_ "CANFD_BRS" BO_ 446 1;
BA_ "GenMsgCycleTime" BO_ 446 20;
BA_ "GenMsgCycleTimeFast" BO_ 446 0;
BA_ "GenMsgSendType" BO_ 446 0;
BA_ "VFrameFormat" BO_ 446 14;
BA_ "CANFD_BRS" BO_ 446 1;
BA_ "GenMsgCycleTime" BO_ 446 20;
BA_ "GenMsgCycleTimeFast" BO_ 446 0;
BA_ "GenMsgSendType" BO_ 446 0;
BA_ "VFrameFormat" BO_ 446 14;
BA_ "CANFD_BRS" BO_ 446 1;
BA_ "GenMsgCycleTime" BO_ 446 20;
BA_ "GenMsgCycleTimeFast" BO_ 446 0;
BA_ "GenMsgSendType" BO_ 446 0;
BA_ "VFrameFormat" BO_ 446 14;
BA_ "CANFD_BRS" BO_ 446 1;
BA_ "GenMsgCycleTime" BO_ 430 10;
BA_ "GenMsgCycleTimeFast" BO_ 430 0;
BA_ "GenMsgSendType" BO_ 430 0;
BA_ "VFrameFormat" BO_ 430 14;
BA_ "CANFD_BRS" BO_ 430 1;
BA_ "GenMsgCycleTime" BO_ 430 10;
BA_ "GenMsgCycleTimeFast" BO_ 430 0;
BA_ "GenMsgSendType" BO_ 430 0;
BA_ "VFrameFormat" BO_ 430 14;
BA_ "CANFD_BRS" BO_ 430 1;
BA_ "GenMsgCycleTime" BO_ 430 10;
BA_ "GenMsgCycleTimeFast" BO_ 430 0;
BA_ "GenMsgSendType" BO_ 430 0;
BA_ "VFrameFormat" BO_ 430 14;
BA_ "CANFD_BRS" BO_ 430 1;
BA_ "GenMsgCycleTime" BO_ 430 10;
BA_ "GenMsgCycleTimeFast" BO_ 430 0;
BA_ "GenMsgSendType" BO_ 430 0;
BA_ "VFrameFormat" BO_ 430 14;
BA_ "CANFD_BRS" BO_ 430 1;
BA_ "GenMsgCycleTime" BO_ 430 10;
BA_ "GenMsgCycleTimeFast" BO_ 430 0;
BA_ "GenMsgSendType" BO_ 430 0;
BA_ "VFrameFormat" BO_ 430 14;
BA_ "CANFD_BRS" BO_ 430 1;
BA_ "GenMsgCycleTime" BO_ 430 10;
BA_ "GenMsgCycleTimeFast" BO_ 430 0;
BA_ "GenMsgSendType" BO_ 430 0;
BA_ "VFrameFormat" BO_ 430 14;
BA_ "CANFD_BRS" BO_ 430 1;
BA_ "GenMsgCycleTime" BO_ 430 10;
BA_ "GenMsgCycleTimeFast" BO_ 430 0;
BA_ "GenMsgSendType" BO_ 430 0;
BA_ "VFrameFormat" BO_ 430 14;
BA_ "CANFD_BRS" BO_ 430 1;
BA_ "GenMsgCycleTime" BO_ 430 10;
BA_ "GenMsgCycleTimeFast" BO_ 430 0;
BA_ "GenMsgSendType" BO_ 430 0;
BA_ "VFrameFormat" BO_ 430 14;
BA_ "CANFD_BRS" BO_ 430 1;
BA_ "GenMsgCycleTime" BO_ 430 10;
BA_ "GenMsgCycleTimeFast" BO_ 430 0;
BA_ "GenMsgSendType" BO_ 430 0;
BA_ "VFrameFormat" BO_ 430 14;
BA_ "CANFD_BRS" BO_ 430 1;
BA_ "GenMsgCycleTime" BO_ 430 10;
BA_ "GenMsgCycleTimeFast" BO_ 430 0;
BA_ "GenMsgSendType" BO_ 430 0;
BA_ "VFrameFormat" BO_ 430 14;
BA_ "CANFD_BRS" BO_ 430 1;
BA_ "GenMsgCycleTime" BO_ 430 10;
BA_ "GenMsgCycleTimeFast" BO_ 430 0;
BA_ "GenMsgSendType" BO_ 430 0;
BA_ "VFrameFormat" BO_ 430 14;
BA_ "CANFD_BRS" BO_ 430 1;
BA_ "GenMsgCycleTime" BO_ 430 10;
BA_ "GenMsgCycleTimeFast" BO_ 430 0;
BA_ "GenMsgSendType" BO_ 430 0;
BA_ "VFrameFormat" BO_ 430 14;
BA_ "CANFD_BRS" BO_ 430 1;
BA_ "GenMsgCycleTime" BO_ 430 10;
BA_ "GenMsgCycleTimeFast" BO_ 430 0;
BA_ "GenMsgSendType" BO_ 430 0;
BA_ "VFrameFormat" BO_ 430 14;
BA_ "CANFD_BRS" BO_ 430 1;
BA_ "GenMsgCycleTime" BO_ 430 10;
BA_ "GenMsgCycleTimeFast" BO_ 430 0;
BA_ "GenMsgSendType" BO_ 430 0;
BA_ "VFrameFormat" BO_ 430 14;
BA_ "CANFD_BRS" BO_ 430 1;
BA_ "GenMsgCycleTime" BO_ 430 10;
BA_ "GenMsgCycleTimeFast" BO_ 430 0;
BA_ "GenMsgSendType" BO_ 430 0;
BA_ "VFrameFormat" BO_ 430 14;
BA_ "CANFD_BRS" BO_ 430 1;
BA_ "GenMsgCycleTime" BO_ 430 10;
BA_ "GenMsgCycleTimeFast" BO_ 430 0;
BA_ "GenMsgSendType" BO_ 430 0;
BA_ "VFrameFormat" BO_ 430 14;
BA_ "CANFD_BRS" BO_ 430 1;
BA_ "GenMsgCycleTime" BO_ 430 10;
BA_ "GenMsgCycleTimeFast" BO_ 430 0;
BA_ "GenMsgSendType" BO_ 430 0;
BA_ "VFrameFormat" BO_ 430 14;
BA_ "CANFD_BRS" BO_ 430 1;
BA_ "GenMsgCycleTime" BO_ 430 10;
BA_ "GenMsgCycleTimeFast" BO_ 430 0;
BA_ "GenMsgSendType" BO_ 430 0;
BA_ "VFrameFormat" BO_ 430 14;
BA_ "CANFD_BRS" BO_ 430 1;
BA_ "GenMsgCycleTime" BO_ 939 100;
BA_ "GenMsgCycleTimeFast" BO_ 939 0;
BA_ "GenMsgSendType" BO_ 939 0;
BA_ "VFrameFormat" BO_ 939 14;
BA_ "CANFD_BRS" BO_ 939 1;
BA_ "GenMsgCycleTime" BO_ 939 100;
BA_ "GenMsgCycleTimeFast" BO_ 939 0;
BA_ "GenMsgSendType" BO_ 939 0;
BA_ "VFrameFormat" BO_ 939 14;
BA_ "CANFD_BRS" BO_ 939 1;
BA_ "GenMsgCycleTime" BO_ 939 100;
BA_ "GenMsgCycleTimeFast" BO_ 939 0;
BA_ "GenMsgSendType" BO_ 939 0;
BA_ "VFrameFormat" BO_ 939 14;
BA_ "CANFD_BRS" BO_ 939 1;
BA_ "GenMsgCycleTime" BO_ 939 100;
BA_ "GenMsgCycleTimeFast" BO_ 939 0;
BA_ "GenMsgSendType" BO_ 939 0;
BA_ "VFrameFormat" BO_ 939 14;
BA_ "CANFD_BRS" BO_ 939 1;
BA_ "GenMsgCycleTime" BO_ 939 100;
BA_ "GenMsgCycleTimeFast" BO_ 939 0;
BA_ "GenMsgSendType" BO_ 939 0;
BA_ "VFrameFormat" BO_ 939 14;
BA_ "CANFD_BRS" BO_ 939 1;
BA_ "GenMsgCycleTime" BO_ 939 100;
BA_ "GenMsgCycleTimeFast" BO_ 939 0;
BA_ "GenMsgSendType" BO_ 939 0;
BA_ "VFrameFormat" BO_ 939 14;
BA_ "CANFD_BRS" BO_ 939 1;
BA_ "GenMsgCycleTime" BO_ 939 100;
BA_ "GenMsgCycleTimeFast" BO_ 939 0;
BA_ "GenMsgSendType" BO_ 939 0;
BA_ "VFrameFormat" BO_ 939 14;
BA_ "CANFD_BRS" BO_ 939 1;
BA_ "GenMsgCycleTime" BO_ 939 100;
BA_ "GenMsgCycleTimeFast" BO_ 939 0;
BA_ "GenMsgSendType" BO_ 939 0;
BA_ "VFrameFormat" BO_ 939 14;
BA_ "CANFD_BRS" BO_ 939 1;
BA_ "GenMsgCycleTime" BO_ 939 100;
BA_ "GenMsgCycleTimeFast" BO_ 939 0;
BA_ "GenMsgSendType" BO_ 939 0;
BA_ "VFrameFormat" BO_ 939 14;
BA_ "CANFD_BRS" BO_ 939 1;
BA_ "EventCommandSignal" SG_ 400 UINM_1_CRC 0;
BA_ "GatewayedSignals" SG_ 400 UINM_1_CRC 0;
BA_ "GenSigInactiveValue" SG_ 400 UINM_1_CRC 0;
BA_ "GenSigInvalidValue" SG_ 400 UINM_1_CRC 0;
BA_ "GenSigSendType" SG_ 400 UINM_1_CRC 1;
BA_ "GenSigStartValue" SG_ 400 UINM_1_CRC 0;
BA_ "GenSigTimeoutValue" SG_ 400 UINM_1_CRC 0;
BA_ "Remark" SG_ 400 UINM_1_CRC "";
BA_ "EventCommandSignal" SG_ 400 UINM_1_Counter 0;
BA_ "GatewayedSignals" SG_ 400 UINM_1_Counter 0;
BA_ "GenSigInactiveValue" SG_ 400 UINM_1_Counter 0;
BA_ "GenSigInvalidValue" SG_ 400 UINM_1_Counter 0;
BA_ "GenSigSendType" SG_ 400 UINM_1_Counter 1;
BA_ "GenSigStartValue" SG_ 400 UINM_1_Counter 0;
BA_ "GenSigTimeoutValue" SG_ 400 UINM_1_Counter 0;
BA_ "Remark" SG_ 400 UINM_1_Counter "";
BA_ "EventCommandSignal" SG_ 400 UINM_DrvReqShft 0;
BA_ "GatewayedSignals" SG_ 400 UINM_DrvReqShft 0;
BA_ "GenSigInactiveValue" SG_ 400 UINM_DrvReqShft 0;
BA_ "GenSigInvalidValue" SG_ 400 UINM_DrvReqShft 0;
BA_ "GenSigSendType" SG_ 400 UINM_DrvReqShft 1;
BA_ "GenSigStartValue" SG_ 400 UINM_DrvReqShft 5;
BA_ "GenSigTimeoutValue" SG_ 400 UINM_DrvReqShft 0;
BA_ "Remark" SG_ 400 UINM_DrvReqShft "";
BA_ "EventCommandSignal" SG_ 400 UINM_DrvReqShftInv 0;
BA_ "GatewayedSignals" SG_ 400 UINM_DrvReqShftInv 0;
BA_ "GenSigInactiveValue" SG_ 400 UINM_DrvReqShftInv 0;
BA_ "GenSigInvalidValue" SG_ 400 UINM_DrvReqShftInv 0;
BA_ "GenSigSendType" SG_ 400 UINM_DrvReqShftInv 1;
BA_ "GenSigStartValue" SG_ 400 UINM_DrvReqShftInv 10;
BA_ "GenSigTimeoutValue" SG_ 400 UINM_DrvReqShftInv 0;
BA_ "Remark" SG_ 400 UINM_DrvReqShftInv "";
BA_ "EventCommandSignal" SG_ 400 UINM_FuSaErrSt 0;
BA_ "GatewayedSignals" SG_ 400 UINM_FuSaErrSt 0;
BA_ "GenSigInactiveValue" SG_ 400 UINM_FuSaErrSt 0;
BA_ "GenSigInvalidValue" SG_ 400 UINM_FuSaErrSt 0;
BA_ "GenSigSendType" SG_ 400 UINM_FuSaErrSt 1;
BA_ "GenSigStartValue" SG_ 400 UINM_FuSaErrSt 0;
BA_ "GenSigTimeoutValue" SG_ 400 UINM_FuSaErrSt 0;
BA_ "Remark" SG_ 400 UINM_FuSaErrSt "";
BA_ "EventCommandSignal" SG_ 400 UINM_ShftFault 0;
BA_ "GatewayedSignals" SG_ 400 UINM_ShftFault 0;
BA_ "GenSigInactiveValue" SG_ 400 UINM_ShftFault 0;
BA_ "GenSigInvalidValue" SG_ 400 UINM_ShftFault 0;
BA_ "GenSigSendType" SG_ 400 UINM_ShftFault 1;
BA_ "GenSigStartValue" SG_ 400 UINM_ShftFault 0;
BA_ "GenSigTimeoutValue" SG_ 400 UINM_ShftFault 0;
BA_ "Remark" SG_ 400 UINM_ShftFault "";
BA_ "EventCommandSignal" SG_ 400 UINM_PositionLightSwSt 0;
BA_ "GatewayedSignals" SG_ 400 UINM_PositionLightSwSt 0;
BA_ "GenSigInactiveValue" SG_ 400 UINM_PositionLightSwSt 0;
BA_ "GenSigInvalidValue" SG_ 400 UINM_PositionLightSwSt 2;
BA_ "GenSigSendType" SG_ 400 UINM_PositionLightSwSt 1;
BA_ "GenSigStartValue" SG_ 400 UINM_PositionLightSwSt 0;
BA_ "GenSigTimeoutValue" SG_ 400 UINM_PositionLightSwSt 0;
BA_ "Remark" SG_ 400 UINM_PositionLightSwSt "";
BA_ "EventCommandSignal" SG_ 400 UINM_LowBeamSwSt 0;
BA_ "GatewayedSignals" SG_ 400 UINM_LowBeamSwSt 0;
BA_ "GenSigInactiveValue" SG_ 400 UINM_LowBeamSwSt 0;
BA_ "GenSigInvalidValue" SG_ 400 UINM_LowBeamSwSt 2;
BA_ "GenSigSendType" SG_ 400 UINM_LowBeamSwSt 1;
BA_ "GenSigStartValue" SG_ 400 UINM_LowBeamSwSt 0;
BA_ "GenSigTimeoutValue" SG_ 400 UINM_LowBeamSwSt 0;
BA_ "Remark" SG_ 400 UINM_LowBeamSwSt "";
BA_ "EventCommandSignal" SG_ 400 UINM_AutoLightSwSt 0;
BA_ "GatewayedSignals" SG_ 400 UINM_AutoLightSwSt 0;
BA_ "GenSigInactiveValue" SG_ 400 UINM_AutoLightSwSt 0;
BA_ "GenSigInvalidValue" SG_ 400 UINM_AutoLightSwSt 2;
BA_ "GenSigSendType" SG_ 400 UINM_AutoLightSwSt 1;
BA_ "GenSigStartValue" SG_ 400 UINM_AutoLightSwSt 0;
BA_ "GenSigTimeoutValue" SG_ 400 UINM_AutoLightSwSt 0;
BA_ "Remark" SG_ 400 UINM_AutoLightSwSt "";
BA_ "EventCommandSignal" SG_ 400 UINM_FrontFogLightSwSt 0;
BA_ "GatewayedSignals" SG_ 400 UINM_FrontFogLightSwSt 0;
BA_ "GenSigInactiveValue" SG_ 400 UINM_FrontFogLightSwSt 0;
BA_ "GenSigInvalidValue" SG_ 400 UINM_FrontFogLightSwSt 0;
BA_ "GenSigSendType" SG_ 400 UINM_FrontFogLightSwSt 1;
BA_ "GenSigStartValue" SG_ 400 UINM_FrontFogLightSwSt 0;
BA_ "GenSigTimeoutValue" SG_ 400 UINM_FrontFogLightSwSt 0;
BA_ "Remark" SG_ 400 UINM_FrontFogLightSwSt "";
BA_ "EventCommandSignal" SG_ 400 UINM_RearFogLightSwSt 0;
BA_ "GatewayedSignals" SG_ 400 UINM_RearFogLightSwSt 0;
BA_ "GenSigInactiveValue" SG_ 400 UINM_RearFogLightSwSt 0;
BA_ "GenSigInvalidValue" SG_ 400 UINM_RearFogLightSwSt 0;
BA_ "GenSigSendType" SG_ 400 UINM_RearFogLightSwSt 1;
BA_ "GenSigStartValue" SG_ 400 UINM_RearFogLightSwSt 0;
BA_ "GenSigTimeoutValue" SG_ 400 UINM_RearFogLightSwSt 0;
BA_ "Remark" SG_ 400 UINM_RearFogLightSwSt "";
BA_ "EventCommandSignal" SG_ 400 UINM_HighBeamSwSt 0;
BA_ "GatewayedSignals" SG_ 400 UINM_HighBeamSwSt 0;
BA_ "GenSigInactiveValue" SG_ 400 UINM_HighBeamSwSt 0;
BA_ "GenSigInvalidValue" SG_ 400 UINM_HighBeamSwSt 3;
BA_ "GenSigSendType" SG_ 400 UINM_HighBeamSwSt 1;
BA_ "GenSigStartValue" SG_ 400 UINM_HighBeamSwSt 0;
BA_ "GenSigTimeoutValue" SG_ 400 UINM_HighBeamSwSt 0;
BA_ "Remark" SG_ 400 UINM_HighBeamSwSt "";
BA_ "EventCommandSignal" SG_ 400 UINM_TurnLightSwSt 0;
BA_ "GatewayedSignals" SG_ 400 UINM_TurnLightSwSt 0;
BA_ "GenSigInactiveValue" SG_ 400 UINM_TurnLightSwSt 0;
BA_ "GenSigInvalidValue" SG_ 400 UINM_TurnLightSwSt 5;
BA_ "GenSigSendType" SG_ 400 UINM_TurnLightSwSt 1;
BA_ "GenSigStartValue" SG_ 400 UINM_TurnLightSwSt 0;
BA_ "GenSigTimeoutValue" SG_ 400 UINM_TurnLightSwSt 0;
BA_ "Remark" SG_ 400 UINM_TurnLightSwSt "";
BA_ "EventCommandSignal" SG_ 400 UINM_FrontWiperSwSt 0;
BA_ "GatewayedSignals" SG_ 400 UINM_FrontWiperSwSt 0;
BA_ "GenSigInactiveValue" SG_ 400 UINM_FrontWiperSwSt 0;
BA_ "GenSigInvalidValue" SG_ 400 UINM_FrontWiperSwSt 7;
BA_ "GenSigSendType" SG_ 400 UINM_FrontWiperSwSt 1;
BA_ "GenSigStartValue" SG_ 400 UINM_FrontWiperSwSt 0;
BA_ "GenSigTimeoutValue" SG_ 400 UINM_FrontWiperSwSt 0;
BA_ "Remark" SG_ 400 UINM_FrontWiperSwSt "";
BA_ "EventCommandSignal" SG_ 400 UINM_FrontWiperIntAdjSwSt 0;
BA_ "GatewayedSignals" SG_ 400 UINM_FrontWiperIntAdjSwSt 0;
BA_ "GenSigInactiveValue" SG_ 400 UINM_FrontWiperIntAdjSwSt 0;
BA_ "GenSigInvalidValue" SG_ 400 UINM_FrontWiperIntAdjSwSt 15;
BA_ "GenSigSendType" SG_ 400 UINM_FrontWiperIntAdjSwSt 1;
BA_ "GenSigStartValue" SG_ 400 UINM_FrontWiperIntAdjSwSt 0;
BA_ "GenSigTimeoutValue" SG_ 400 UINM_FrontWiperIntAdjSwSt 0;
BA_ "Remark" SG_ 400 UINM_FrontWiperIntAdjSwSt "";
BA_ "EventCommandSignal" SG_ 400 UINM_FrontWasherSwSt 0;
BA_ "GatewayedSignals" SG_ 400 UINM_FrontWasherSwSt 0;
BA_ "GenSigInactiveValue" SG_ 400 UINM_FrontWasherSwSt 0;
BA_ "GenSigInvalidValue" SG_ 400 UINM_FrontWasherSwSt 0;
BA_ "GenSigSendType" SG_ 400 UINM_FrontWasherSwSt 1;
BA_ "GenSigStartValue" SG_ 400 UINM_FrontWasherSwSt 0;
BA_ "GenSigTimeoutValue" SG_ 400 UINM_FrontWasherSwSt 0;
BA_ "Remark" SG_ 400 UINM_FrontWasherSwSt "";
BA_ "EventCommandSignal" SG_ 400 UINM_RearWiperSwSt 0;
BA_ "GatewayedSignals" SG_ 400 UINM_RearWiperSwSt 0;
BA_ "GenSigInactiveValue" SG_ 400 UINM_RearWiperSwSt 0;
BA_ "GenSigInvalidValue" SG_ 400 UINM_RearWiperSwSt 15;
BA_ "GenSigSendType" SG_ 400 UINM_RearWiperSwSt 1;
BA_ "GenSigStartValue" SG_ 400 UINM_RearWiperSwSt 0;
BA_ "GenSigTimeoutValue" SG_ 400 UINM_RearWiperSwSt 0;
BA_ "Remark" SG_ 400 UINM_RearWiperSwSt "";
BA_ "EventCommandSignal" SG_ 400 UINM_RearWiperIntAdjSwSt 0;
BA_ "GatewayedSignals" SG_ 400 UINM_RearWiperIntAdjSwSt 0;
BA_ "GenSigInactiveValue" SG_ 400 UINM_RearWiperIntAdjSwSt 0;
BA_ "GenSigInvalidValue" SG_ 400 UINM_RearWiperIntAdjSwSt 15;
BA_ "GenSigSendType" SG_ 400 UINM_RearWiperIntAdjSwSt 1;
BA_ "GenSigStartValue" SG_ 400 UINM_RearWiperIntAdjSwSt 0;
BA_ "GenSigTimeoutValue" SG_ 400 UINM_RearWiperIntAdjSwSt 0;
BA_ "Remark" SG_ 400 UINM_RearWiperIntAdjSwSt "";
BA_ "EventCommandSignal" SG_ 400 UINM_RearWasherSwSt 0;
BA_ "GatewayedSignals" SG_ 400 UINM_RearWasherSwSt 0;
BA_ "GenSigInactiveValue" SG_ 400 UINM_RearWasherSwSt 0;
BA_ "GenSigInvalidValue" SG_ 400 UINM_RearWasherSwSt 0;
BA_ "GenSigSendType" SG_ 400 UINM_RearWasherSwSt 1;
BA_ "GenSigStartValue" SG_ 400 UINM_RearWasherSwSt 0;
BA_ "GenSigTimeoutValue" SG_ 400 UINM_RearWasherSwSt 0;
BA_ "Remark" SG_ 400 UINM_RearWasherSwSt "";
BA_ "EventCommandSignal" SG_ 400 UINM_HeadLampWasherSwSt 0;
BA_ "GatewayedSignals" SG_ 400 UINM_HeadLampWasherSwSt 0;
BA_ "GenSigInactiveValue" SG_ 400 UINM_HeadLampWasherSwSt 0;
BA_ "GenSigInvalidValue" SG_ 400 UINM_HeadLampWasherSwSt 0;
BA_ "GenSigSendType" SG_ 400 UINM_HeadLampWasherSwSt 1;
BA_ "GenSigStartValue" SG_ 400 UINM_HeadLampWasherSwSt 0;
BA_ "GenSigTimeoutValue" SG_ 400 UINM_HeadLampWasherSwSt 0;
BA_ "Remark" SG_ 400 UINM_HeadLampWasherSwSt "";
BA_ "EventCommandSignal" SG_ 792 ZCUT_2_CRC 0;
BA_ "GatewayedSignals" SG_ 792 ZCUT_2_CRC 0;
BA_ "GenSigInactiveValue" SG_ 792 ZCUT_2_CRC 0;
BA_ "GenSigInvalidValue" SG_ 792 ZCUT_2_CRC 0;
BA_ "GenSigSendType" SG_ 792 ZCUT_2_CRC 1;
BA_ "GenSigStartValue" SG_ 792 ZCUT_2_CRC 0;
BA_ "GenSigTimeoutValue" SG_ 792 ZCUT_2_CRC 0;
BA_ "Remark" SG_ 792 ZCUT_2_CRC "";
BA_ "EventCommandSignal" SG_ 792 ZCUT_2_Counter 0;
BA_ "GatewayedSignals" SG_ 792 ZCUT_2_Counter 0;
BA_ "GenSigInactiveValue" SG_ 792 ZCUT_2_Counter 0;
BA_ "GenSigInvalidValue" SG_ 792 ZCUT_2_Counter 0;
BA_ "GenSigSendType" SG_ 792 ZCUT_2_Counter 1;
BA_ "GenSigStartValue" SG_ 792 ZCUT_2_Counter 0;
BA_ "GenSigTimeoutValue" SG_ 792 ZCUT_2_Counter 0;
BA_ "Remark" SG_ 792 ZCUT_2_Counter "";
BA_ "EventCommandSignal" SG_ 792 UMM_SecondMIDSeatSt 0;
BA_ "GatewayedSignals" SG_ 792 UMM_SecondMIDSeatSt 0;
BA_ "GenSigInactiveValue" SG_ 792 UMM_SecondMIDSeatSt 0;
BA_ "GenSigInvalidValue" SG_ 792 UMM_SecondMIDSeatSt 0;
BA_ "GenSigSendType" SG_ 792 UMM_SecondMIDSeatSt 1;
BA_ "GenSigStartValue" SG_ 792 UMM_SecondMIDSeatSt 0;
BA_ "GenSigTimeoutValue" SG_ 792 UMM_SecondMIDSeatSt 0;
BA_ "Remark" SG_ 792 UMM_SecondMIDSeatSt "";
BA_ "EventCommandSignal" SG_ 792 UMM_SecondRHSeatSt 0;
BA_ "GatewayedSignals" SG_ 792 UMM_SecondRHSeatSt 0;
BA_ "GenSigInactiveValue" SG_ 792 UMM_SecondRHSeatSt 0;
BA_ "GenSigInvalidValue" SG_ 792 UMM_SecondRHSeatSt 0;
BA_ "GenSigSendType" SG_ 792 UMM_SecondRHSeatSt 1;
BA_ "GenSigStartValue" SG_ 792 UMM_SecondRHSeatSt 0;
BA_ "GenSigTimeoutValue" SG_ 792 UMM_SecondRHSeatSt 0;
BA_ "Remark" SG_ 792 UMM_SecondRHSeatSt "";
BA_ "EventCommandSignal" SG_ 792 UMM_SecondLHSeatSt 0;
BA_ "GatewayedSignals" SG_ 792 UMM_SecondLHSeatSt 0;
BA_ "GenSigInactiveValue" SG_ 792 UMM_SecondLHSeatSt 0;
BA_ "GenSigInvalidValue" SG_ 792 UMM_SecondLHSeatSt 0;
BA_ "GenSigSendType" SG_ 792 UMM_SecondLHSeatSt 1;
BA_ "GenSigStartValue" SG_ 792 UMM_SecondLHSeatSt 0;
BA_ "GenSigTimeoutValue" SG_ 792 UMM_SecondLHSeatSt 0;
BA_ "Remark" SG_ 792 UMM_SecondLHSeatSt "";
BA_ "EventCommandSignal" SG_ 792 EL_RADASLightSt 0;
BA_ "GatewayedSignals" SG_ 792 EL_RADASLightSt 0;
BA_ "GenSigInactiveValue" SG_ 792 EL_RADASLightSt 0;
BA_ "GenSigInvalidValue" SG_ 792 EL_RADASLightSt 0;
BA_ "GenSigSendType" SG_ 792 EL_RADASLightSt 1;
BA_ "GenSigStartValue" SG_ 792 EL_RADASLightSt 0;
BA_ "GenSigTimeoutValue" SG_ 792 EL_RADASLightSt 0;
BA_ "Remark" SG_ 792 EL_RADASLightSt "";
BA_ "EventCommandSignal" SG_ 792 UMM_ThirdLHSeatSt 0;
BA_ "GatewayedSignals" SG_ 792 UMM_ThirdLHSeatSt 0;
BA_ "GenSigInactiveValue" SG_ 792 UMM_ThirdLHSeatSt 0;
BA_ "GenSigInvalidValue" SG_ 792 UMM_ThirdLHSeatSt 0;
BA_ "GenSigSendType" SG_ 792 UMM_ThirdLHSeatSt 1;
BA_ "GenSigStartValue" SG_ 792 UMM_ThirdLHSeatSt 0;
BA_ "GenSigTimeoutValue" SG_ 792 UMM_ThirdLHSeatSt 0;
BA_ "Remark" SG_ 792 UMM_ThirdLHSeatSt "";
BA_ "EventCommandSignal" SG_ 792 UMM_ThirdRHSeatSt 0;
BA_ "GatewayedSignals" SG_ 792 UMM_ThirdRHSeatSt 0;
BA_ "GenSigInactiveValue" SG_ 792 UMM_ThirdRHSeatSt 0;
BA_ "GenSigInvalidValue" SG_ 792 UMM_ThirdRHSeatSt 0;
BA_ "GenSigSendType" SG_ 792 UMM_ThirdRHSeatSt 1;
BA_ "GenSigStartValue" SG_ 792 UMM_ThirdRHSeatSt 0;
BA_ "GenSigTimeoutValue" SG_ 792 UMM_ThirdRHSeatSt 0;
BA_ "Remark" SG_ 792 UMM_ThirdRHSeatSt "";
BA_ "EventCommandSignal" SG_ 792 UMM_ThirdMIDSeatSt 0;
BA_ "GatewayedSignals" SG_ 792 UMM_ThirdMIDSeatSt 0;
BA_ "GenSigInactiveValue" SG_ 792 UMM_ThirdMIDSeatSt 0;
BA_ "GenSigInvalidValue" SG_ 792 UMM_ThirdMIDSeatSt 0;
BA_ "GenSigSendType" SG_ 792 UMM_ThirdMIDSeatSt 1;
BA_ "GenSigStartValue" SG_ 792 UMM_ThirdMIDSeatSt 0;
BA_ "GenSigTimeoutValue" SG_ 792 UMM_ThirdMIDSeatSt 0;
BA_ "Remark" SG_ 792 UMM_ThirdMIDSeatSt "";
BA_ "EventCommandSignal" SG_ 792 LCK_PowerFillerCapAngle 0;
BA_ "GatewayedSignals" SG_ 792 LCK_PowerFillerCapAngle 0;
BA_ "GenSigInactiveValue" SG_ 792 LCK_PowerFillerCapAngle 0;
BA_ "GenSigInvalidValue" SG_ 792 LCK_PowerFillerCapAngle 0;
BA_ "GenSigSendType" SG_ 792 LCK_PowerFillerCapAngle 1;
BA_ "GenSigStartValue" SG_ 792 LCK_PowerFillerCapAngle 0;
BA_ "GenSigTimeoutValue" SG_ 792 LCK_PowerFillerCapAngle 0;
BA_ "Remark" SG_ 792 LCK_PowerFillerCapAngle "";
BA_ "EventCommandSignal" SG_ 792 EL_ReverseLightSt 0;
BA_ "GatewayedSignals" SG_ 792 EL_ReverseLightSt 0;
BA_ "GenSigInactiveValue" SG_ 792 EL_ReverseLightSt 0;
BA_ "GenSigInvalidValue" SG_ 792 EL_ReverseLightSt 0;
BA_ "GenSigSendType" SG_ 792 EL_ReverseLightSt 1;
BA_ "GenSigStartValue" SG_ 792 EL_ReverseLightSt 0;
BA_ "GenSigTimeoutValue" SG_ 792 EL_ReverseLightSt 0;
BA_ "Remark" SG_ 792 EL_ReverseLightSt "";
BA_ "EventCommandSignal" SG_ 792 EL_ReverseLightFaultSt 0;
BA_ "GatewayedSignals" SG_ 792 EL_ReverseLightFaultSt 0;
BA_ "GenSigInactiveValue" SG_ 792 EL_ReverseLightFaultSt 0;
BA_ "GenSigInvalidValue" SG_ 792 EL_ReverseLightFaultSt 0;
BA_ "GenSigSendType" SG_ 792 EL_ReverseLightFaultSt 1;
BA_ "GenSigStartValue" SG_ 792 EL_ReverseLightFaultSt 0;
BA_ "GenSigTimeoutValue" SG_ 792 EL_ReverseLightFaultSt 0;
BA_ "Remark" SG_ 792 EL_ReverseLightFaultSt "";
BA_ "EventCommandSignal" SG_ 792 EL_SideBrkLightSt 0;
BA_ "GatewayedSignals" SG_ 792 EL_SideBrkLightSt 0;
BA_ "GenSigInactiveValue" SG_ 792 EL_SideBrkLightSt 0;
BA_ "GenSigInvalidValue" SG_ 792 EL_SideBrkLightSt 0;
BA_ "GenSigSendType" SG_ 792 EL_SideBrkLightSt 1;
BA_ "GenSigStartValue" SG_ 792 EL_SideBrkLightSt 0;
BA_ "GenSigTimeoutValue" SG_ 792 EL_SideBrkLightSt 0;
BA_ "Remark" SG_ 792 EL_SideBrkLightSt "";
BA_ "EventCommandSignal" SG_ 792 EL_SideBrkLightFaultSt 0;
BA_ "GatewayedSignals" SG_ 792 EL_SideBrkLightFaultSt 0;
BA_ "GenSigInactiveValue" SG_ 792 EL_SideBrkLightFaultSt 0;
BA_ "GenSigInvalidValue" SG_ 792 EL_SideBrkLightFaultSt 0;
BA_ "GenSigSendType" SG_ 792 EL_SideBrkLightFaultSt 1;
BA_ "GenSigStartValue" SG_ 792 EL_SideBrkLightFaultSt 0;
BA_ "GenSigTimeoutValue" SG_ 792 EL_SideBrkLightFaultSt 0;
BA_ "Remark" SG_ 792 EL_SideBrkLightFaultSt "";
BA_ "EventCommandSignal" SG_ 792 EL_CHMSLSt 0;
BA_ "GatewayedSignals" SG_ 792 EL_CHMSLSt 0;
BA_ "GenSigInactiveValue" SG_ 792 EL_CHMSLSt 0;
BA_ "GenSigInvalidValue" SG_ 792 EL_CHMSLSt 0;
BA_ "GenSigSendType" SG_ 792 EL_CHMSLSt 1;
BA_ "GenSigStartValue" SG_ 792 EL_CHMSLSt 0;
BA_ "GenSigTimeoutValue" SG_ 792 EL_CHMSLSt 0;
BA_ "Remark" SG_ 792 EL_CHMSLSt "";
BA_ "EventCommandSignal" SG_ 792 EL_CHMSLFaultSt 0;
BA_ "GatewayedSignals" SG_ 792 EL_CHMSLFaultSt 0;
BA_ "GenSigInactiveValue" SG_ 792 EL_CHMSLFaultSt 0;
BA_ "GenSigInvalidValue" SG_ 792 EL_CHMSLFaultSt 0;
BA_ "GenSigSendType" SG_ 792 EL_CHMSLFaultSt 1;
BA_ "GenSigStartValue" SG_ 792 EL_CHMSLFaultSt 0;
BA_ "GenSigTimeoutValue" SG_ 792 EL_CHMSLFaultSt 0;
BA_ "Remark" SG_ 792 EL_CHMSLFaultSt "";
BA_ "EventCommandSignal" SG_ 792 EL_RLPositionLightSt 0;
BA_ "GatewayedSignals" SG_ 792 EL_RLPositionLightSt 0;
BA_ "GenSigInactiveValue" SG_ 792 EL_RLPositionLightSt 0;
BA_ "GenSigInvalidValue" SG_ 792 EL_RLPositionLightSt 0;
BA_ "GenSigSendType" SG_ 792 EL_RLPositionLightSt 1;
BA_ "GenSigStartValue" SG_ 792 EL_RLPositionLightSt 0;
BA_ "GenSigTimeoutValue" SG_ 792 EL_RLPositionLightSt 0;
BA_ "Remark" SG_ 792 EL_RLPositionLightSt "";
BA_ "EventCommandSignal" SG_ 792 EL_RLPositionLightFaultSt 0;
BA_ "GatewayedSignals" SG_ 792 EL_RLPositionLightFaultSt 0;
BA_ "GenSigInactiveValue" SG_ 792 EL_RLPositionLightFaultSt 0;
BA_ "GenSigInvalidValue" SG_ 792 EL_RLPositionLightFaultSt 0;
BA_ "GenSigSendType" SG_ 792 EL_RLPositionLightFaultSt 1;
BA_ "GenSigStartValue" SG_ 792 EL_RLPositionLightFaultSt 0;
BA_ "GenSigTimeoutValue" SG_ 792 EL_RLPositionLightFaultSt 0;
BA_ "Remark" SG_ 792 EL_RLPositionLightFaultSt "";
BA_ "EventCommandSignal" SG_ 792 EL_RRPositionLightSt 0;
BA_ "GatewayedSignals" SG_ 792 EL_RRPositionLightSt 0;
BA_ "GenSigInactiveValue" SG_ 792 EL_RRPositionLightSt 0;
BA_ "GenSigInvalidValue" SG_ 792 EL_RRPositionLightSt 0;
BA_ "GenSigSendType" SG_ 792 EL_RRPositionLightSt 1;
BA_ "GenSigStartValue" SG_ 792 EL_RRPositionLightSt 0;
BA_ "GenSigTimeoutValue" SG_ 792 EL_RRPositionLightSt 0;
BA_ "Remark" SG_ 792 EL_RRPositionLightSt "";
BA_ "EventCommandSignal" SG_ 792 EL_RRPositionLightFaultSt 0;
BA_ "GatewayedSignals" SG_ 792 EL_RRPositionLightFaultSt 0;
BA_ "GenSigInactiveValue" SG_ 792 EL_RRPositionLightFaultSt 0;
BA_ "GenSigInvalidValue" SG_ 792 EL_RRPositionLightFaultSt 0;
BA_ "GenSigSendType" SG_ 792 EL_RRPositionLightFaultSt 1;
BA_ "GenSigStartValue" SG_ 792 EL_RRPositionLightFaultSt 0;
BA_ "GenSigTimeoutValue" SG_ 792 EL_RRPositionLightFaultSt 0;
BA_ "Remark" SG_ 792 EL_RRPositionLightFaultSt "";
BA_ "EventCommandSignal" SG_ 792 EL_RearFogLightSt 0;
BA_ "GatewayedSignals" SG_ 792 EL_RearFogLightSt 0;
BA_ "GenSigInactiveValue" SG_ 792 EL_RearFogLightSt 0;
BA_ "GenSigInvalidValue" SG_ 792 EL_RearFogLightSt 0;
BA_ "GenSigSendType" SG_ 792 EL_RearFogLightSt 1;
BA_ "GenSigStartValue" SG_ 792 EL_RearFogLightSt 0;
BA_ "GenSigTimeoutValue" SG_ 792 EL_RearFogLightSt 0;
BA_ "Remark" SG_ 792 EL_RearFogLightSt "";
BA_ "EventCommandSignal" SG_ 792 EL_RearFogLightFaultSt 0;
BA_ "GatewayedSignals" SG_ 792 EL_RearFogLightFaultSt 0;
BA_ "GenSigInactiveValue" SG_ 792 EL_RearFogLightFaultSt 0;
BA_ "GenSigInvalidValue" SG_ 792 EL_RearFogLightFaultSt 0;
BA_ "GenSigSendType" SG_ 792 EL_RearFogLightFaultSt 1;
BA_ "GenSigStartValue" SG_ 792 EL_RearFogLightFaultSt 0;
BA_ "GenSigTimeoutValue" SG_ 792 EL_RearFogLightFaultSt 0;
BA_ "Remark" SG_ 792 EL_RearFogLightFaultSt "";
BA_ "EventCommandSignal" SG_ 792 EL_RLTurnLightSt 0;
BA_ "GatewayedSignals" SG_ 792 EL_RLTurnLightSt 0;
BA_ "GenSigInactiveValue" SG_ 792 EL_RLTurnLightSt 0;
BA_ "GenSigInvalidValue" SG_ 792 EL_RLTurnLightSt 0;
BA_ "GenSigSendType" SG_ 792 EL_RLTurnLightSt 1;
BA_ "GenSigStartValue" SG_ 792 EL_RLTurnLightSt 0;
BA_ "GenSigTimeoutValue" SG_ 792 EL_RLTurnLightSt 0;
BA_ "Remark" SG_ 792 EL_RLTurnLightSt "";
BA_ "EventCommandSignal" SG_ 792 EL_RLTurnLightFaultSt 0;
BA_ "GatewayedSignals" SG_ 792 EL_RLTurnLightFaultSt 0;
BA_ "GenSigInactiveValue" SG_ 792 EL_RLTurnLightFaultSt 0;
BA_ "GenSigInvalidValue" SG_ 792 EL_RLTurnLightFaultSt 0;
BA_ "GenSigSendType" SG_ 792 EL_RLTurnLightFaultSt 1;
BA_ "GenSigStartValue" SG_ 792 EL_RLTurnLightFaultSt 0;
BA_ "GenSigTimeoutValue" SG_ 792 EL_RLTurnLightFaultSt 0;
BA_ "Remark" SG_ 792 EL_RLTurnLightFaultSt "";
BA_ "EventCommandSignal" SG_ 792 EL_RRTurnLightSt 0;
BA_ "GatewayedSignals" SG_ 792 EL_RRTurnLightSt 0;
BA_ "GenSigInactiveValue" SG_ 792 EL_RRTurnLightSt 0;
BA_ "GenSigInvalidValue" SG_ 792 EL_RRTurnLightSt 0;
BA_ "GenSigSendType" SG_ 792 EL_RRTurnLightSt 1;
BA_ "GenSigStartValue" SG_ 792 EL_RRTurnLightSt 0;
BA_ "GenSigTimeoutValue" SG_ 792 EL_RRTurnLightSt 0;
BA_ "Remark" SG_ 792 EL_RRTurnLightSt "";
BA_ "EventCommandSignal" SG_ 792 EL_RRTurnLightFaultSt 0;
BA_ "GatewayedSignals" SG_ 792 EL_RRTurnLightFaultSt 0;
BA_ "GenSigInactiveValue" SG_ 792 EL_RRTurnLightFaultSt 0;
BA_ "GenSigInvalidValue" SG_ 792 EL_RRTurnLightFaultSt 0;
BA_ "GenSigSendType" SG_ 792 EL_RRTurnLightFaultSt 1;
BA_ "GenSigStartValue" SG_ 792 EL_RRTurnLightFaultSt 0;
BA_ "GenSigTimeoutValue" SG_ 792 EL_RRTurnLightFaultSt 0;
BA_ "Remark" SG_ 792 EL_RRTurnLightFaultSt "";
BA_ "EventCommandSignal" SG_ 446 RBU_VehSpd 0;
BA_ "GatewayedSignals" SG_ 446 RBU_VehSpd 0;
BA_ "GenSigInactiveValue" SG_ 446 RBU_VehSpd 0;
BA_ "GenSigInvalidValue" SG_ 446 RBU_VehSpd 0;
BA_ "GenSigSendType" SG_ 446 RBU_VehSpd 1;
BA_ "GenSigStartValue" SG_ 446 RBU_VehSpd 0;
BA_ "GenSigTimeoutValue" SG_ 446 RBU_VehSpd 0;
BA_ "Remark" SG_ 446 RBU_VehSpd "";
BA_ "EventCommandSignal" SG_ 446 RBU_VehSpdVD 0;
BA_ "GatewayedSignals" SG_ 446 RBU_VehSpdVD 0;
BA_ "GenSigInactiveValue" SG_ 446 RBU_VehSpdVD 0;
BA_ "GenSigInvalidValue" SG_ 446 RBU_VehSpdVD 0;
BA_ "GenSigSendType" SG_ 446 RBU_VehSpdVD 1;
BA_ "GenSigStartValue" SG_ 446 RBU_VehSpdVD 0;
BA_ "GenSigTimeoutValue" SG_ 446 RBU_VehSpdVD 0;
BA_ "Remark" SG_ 446 RBU_VehSpdVD "";
BA_ "EventCommandSignal" SG_ 446 RBU_FLWheelSpdEdgesSum 0;
BA_ "GatewayedSignals" SG_ 446 RBU_FLWheelSpdEdgesSum 0;
BA_ "GenSigInactiveValue" SG_ 446 RBU_FLWheelSpdEdgesSum 0;
BA_ "GenSigInvalidValue" SG_ 446 RBU_FLWheelSpdEdgesSum 0;
BA_ "GenSigSendType" SG_ 446 RBU_FLWheelSpdEdgesSum 1;
BA_ "GenSigStartValue" SG_ 446 RBU_FLWheelSpdEdgesSum 0;
BA_ "GenSigTimeoutValue" SG_ 446 RBU_FLWheelSpdEdgesSum 0;
BA_ "Remark" SG_ 446 RBU_FLWheelSpdEdgesSum "";
BA_ "EventCommandSignal" SG_ 446 RBU_FRWheelSpdEdgesSum 0;
BA_ "GatewayedSignals" SG_ 446 RBU_FRWheelSpdEdgesSum 0;
BA_ "GenSigInactiveValue" SG_ 446 RBU_FRWheelSpdEdgesSum 0;
BA_ "GenSigInvalidValue" SG_ 446 RBU_FRWheelSpdEdgesSum 0;
BA_ "GenSigSendType" SG_ 446 RBU_FRWheelSpdEdgesSum 1;
BA_ "GenSigStartValue" SG_ 446 RBU_FRWheelSpdEdgesSum 0;
BA_ "GenSigTimeoutValue" SG_ 446 RBU_FRWheelSpdEdgesSum 0;
BA_ "Remark" SG_ 446 RBU_FRWheelSpdEdgesSum "";
BA_ "EventCommandSignal" SG_ 446 RBU_RLWheelSpdEdgesSum 0;
BA_ "GatewayedSignals" SG_ 446 RBU_RLWheelSpdEdgesSum 0;
BA_ "GenSigInactiveValue" SG_ 446 RBU_RLWheelSpdEdgesSum 0;
BA_ "GenSigInvalidValue" SG_ 446 RBU_RLWheelSpdEdgesSum 0;
BA_ "GenSigSendType" SG_ 446 RBU_RLWheelSpdEdgesSum 1;
BA_ "GenSigStartValue" SG_ 446 RBU_RLWheelSpdEdgesSum 0;
BA_ "GenSigTimeoutValue" SG_ 446 RBU_RLWheelSpdEdgesSum 0;
BA_ "Remark" SG_ 446 RBU_RLWheelSpdEdgesSum "";
BA_ "EventCommandSignal" SG_ 446 RBU_RRWheelSpdEdgesSum 0;
BA_ "GatewayedSignals" SG_ 446 RBU_RRWheelSpdEdgesSum 0;
BA_ "GenSigInactiveValue" SG_ 446 RBU_RRWheelSpdEdgesSum 0;
BA_ "GenSigInvalidValue" SG_ 446 RBU_RRWheelSpdEdgesSum 0;
BA_ "GenSigSendType" SG_ 446 RBU_RRWheelSpdEdgesSum 1;
BA_ "GenSigStartValue" SG_ 446 RBU_RRWheelSpdEdgesSum 0;
BA_ "GenSigTimeoutValue" SG_ 446 RBU_RRWheelSpdEdgesSum 0;
BA_ "Remark" SG_ 446 RBU_RRWheelSpdEdgesSum "";
BA_ "EventCommandSignal" SG_ 446 RBU_FLWheelSpdEdgesSumVD 0;
BA_ "GatewayedSignals" SG_ 446 RBU_FLWheelSpdEdgesSumVD 0;
BA_ "GenSigInactiveValue" SG_ 446 RBU_FLWheelSpdEdgesSumVD 0;
BA_ "GenSigInvalidValue" SG_ 446 RBU_FLWheelSpdEdgesSumVD 0;
BA_ "GenSigSendType" SG_ 446 RBU_FLWheelSpdEdgesSumVD 1;
BA_ "GenSigStartValue" SG_ 446 RBU_FLWheelSpdEdgesSumVD 0;
BA_ "GenSigTimeoutValue" SG_ 446 RBU_FLWheelSpdEdgesSumVD 0;
BA_ "Remark" SG_ 446 RBU_FLWheelSpdEdgesSumVD "";
BA_ "EventCommandSignal" SG_ 446 RBU_FRWheelSpdEdgesSumVD 0;
BA_ "GatewayedSignals" SG_ 446 RBU_FRWheelSpdEdgesSumVD 0;
BA_ "GenSigInactiveValue" SG_ 446 RBU_FRWheelSpdEdgesSumVD 0;
BA_ "GenSigInvalidValue" SG_ 446 RBU_FRWheelSpdEdgesSumVD 0;
BA_ "GenSigSendType" SG_ 446 RBU_FRWheelSpdEdgesSumVD 1;
BA_ "GenSigStartValue" SG_ 446 RBU_FRWheelSpdEdgesSumVD 0;
BA_ "GenSigTimeoutValue" SG_ 446 RBU_FRWheelSpdEdgesSumVD 0;
BA_ "Remark" SG_ 446 RBU_FRWheelSpdEdgesSumVD "";
BA_ "EventCommandSignal" SG_ 446 RBU_RLWheelSpdEdgesSumVD 0;
BA_ "GatewayedSignals" SG_ 446 RBU_RLWheelSpdEdgesSumVD 0;
BA_ "GenSigInactiveValue" SG_ 446 RBU_RLWheelSpdEdgesSumVD 0;
BA_ "GenSigInvalidValue" SG_ 446 RBU_RLWheelSpdEdgesSumVD 0;
BA_ "GenSigSendType" SG_ 446 RBU_RLWheelSpdEdgesSumVD 1;
BA_ "GenSigStartValue" SG_ 446 RBU_RLWheelSpdEdgesSumVD 0;
BA_ "GenSigTimeoutValue" SG_ 446 RBU_RLWheelSpdEdgesSumVD 0;
BA_ "Remark" SG_ 446 RBU_RLWheelSpdEdgesSumVD "";
BA_ "EventCommandSignal" SG_ 446 RBU_RRWheelSpdEdgesSumVD 0;
BA_ "GatewayedSignals" SG_ 446 RBU_RRWheelSpdEdgesSumVD 0;
BA_ "GenSigInactiveValue" SG_ 446 RBU_RRWheelSpdEdgesSumVD 0;
BA_ "GenSigInvalidValue" SG_ 446 RBU_RRWheelSpdEdgesSumVD 0;
BA_ "GenSigSendType" SG_ 446 RBU_RRWheelSpdEdgesSumVD 1;
BA_ "GenSigStartValue" SG_ 446 RBU_RRWheelSpdEdgesSumVD 0;
BA_ "GenSigTimeoutValue" SG_ 446 RBU_RRWheelSpdEdgesSumVD 0;
BA_ "Remark" SG_ 446 RBU_RRWheelSpdEdgesSumVD "";
BA_ "EventCommandSignal" SG_ 446 RBU_FLWheelSpd 0;
BA_ "GatewayedSignals" SG_ 446 RBU_FLWheelSpd 0;
BA_ "GenSigInactiveValue" SG_ 446 RBU_FLWheelSpd 0;
BA_ "GenSigInvalidValue" SG_ 446 RBU_FLWheelSpd 0;
BA_ "GenSigSendType" SG_ 446 RBU_FLWheelSpd 1;
BA_ "GenSigStartValue" SG_ 446 RBU_FLWheelSpd 0;
BA_ "GenSigTimeoutValue" SG_ 446 RBU_FLWheelSpd 0;
BA_ "Remark" SG_ 446 RBU_FLWheelSpd "";
BA_ "EventCommandSignal" SG_ 446 RBU_FLWheelSpdVD 0;
BA_ "GatewayedSignals" SG_ 446 RBU_FLWheelSpdVD 0;
BA_ "GenSigInactiveValue" SG_ 446 RBU_FLWheelSpdVD 0;
BA_ "GenSigInvalidValue" SG_ 446 RBU_FLWheelSpdVD 0;
BA_ "GenSigSendType" SG_ 446 RBU_FLWheelSpdVD 1;
BA_ "GenSigStartValue" SG_ 446 RBU_FLWheelSpdVD 0;
BA_ "GenSigTimeoutValue" SG_ 446 RBU_FLWheelSpdVD 0;
BA_ "Remark" SG_ 446 RBU_FLWheelSpdVD "";
BA_ "EventCommandSignal" SG_ 446 RBU_FRWheelSpd 0;
BA_ "GatewayedSignals" SG_ 446 RBU_FRWheelSpd 0;
BA_ "GenSigInactiveValue" SG_ 446 RBU_FRWheelSpd 0;
BA_ "GenSigInvalidValue" SG_ 446 RBU_FRWheelSpd 0;
BA_ "GenSigSendType" SG_ 446 RBU_FRWheelSpd 1;
BA_ "GenSigStartValue" SG_ 446 RBU_FRWheelSpd 0;
BA_ "GenSigTimeoutValue" SG_ 446 RBU_FRWheelSpd 0;
BA_ "Remark" SG_ 446 RBU_FRWheelSpd "";
BA_ "EventCommandSignal" SG_ 446 RBU_FRWheelSpdVD 0;
BA_ "GatewayedSignals" SG_ 446 RBU_FRWheelSpdVD 0;
BA_ "GenSigInactiveValue" SG_ 446 RBU_FRWheelSpdVD 0;
BA_ "GenSigInvalidValue" SG_ 446 RBU_FRWheelSpdVD 0;
BA_ "GenSigSendType" SG_ 446 RBU_FRWheelSpdVD 1;
BA_ "GenSigStartValue" SG_ 446 RBU_FRWheelSpdVD 0;
BA_ "GenSigTimeoutValue" SG_ 446 RBU_FRWheelSpdVD 0;
BA_ "Remark" SG_ 446 RBU_FRWheelSpdVD "";
BA_ "EventCommandSignal" SG_ 446 RBU_RLWheelSpd 0;
BA_ "GatewayedSignals" SG_ 446 RBU_RLWheelSpd 0;
BA_ "GenSigInactiveValue" SG_ 446 RBU_RLWheelSpd 0;
BA_ "GenSigInvalidValue" SG_ 446 RBU_RLWheelSpd 0;
BA_ "GenSigSendType" SG_ 446 RBU_RLWheelSpd 1;
BA_ "GenSigStartValue" SG_ 446 RBU_RLWheelSpd 0;
BA_ "GenSigTimeoutValue" SG_ 446 RBU_RLWheelSpd 0;
BA_ "Remark" SG_ 446 RBU_RLWheelSpd "";
BA_ "EventCommandSignal" SG_ 446 RBU_RLWheelSpdVD 0;
BA_ "GatewayedSignals" SG_ 446 RBU_RLWheelSpdVD 0;
BA_ "GenSigInactiveValue" SG_ 446 RBU_RLWheelSpdVD 0;
BA_ "GenSigInvalidValue" SG_ 446 RBU_RLWheelSpdVD 0;
BA_ "GenSigSendType" SG_ 446 RBU_RLWheelSpdVD 1;
BA_ "GenSigStartValue" SG_ 446 RBU_RLWheelSpdVD 0;
BA_ "GenSigTimeoutValue" SG_ 446 RBU_RLWheelSpdVD 0;
BA_ "Remark" SG_ 446 RBU_RLWheelSpdVD "";
BA_ "EventCommandSignal" SG_ 446 RBU_RRWheelSpd 0;
BA_ "GatewayedSignals" SG_ 446 RBU_RRWheelSpd 0;
BA_ "GenSigInactiveValue" SG_ 446 RBU_RRWheelSpd 0;
BA_ "GenSigInvalidValue" SG_ 446 RBU_RRWheelSpd 0;
BA_ "GenSigSendType" SG_ 446 RBU_RRWheelSpd 1;
BA_ "GenSigStartValue" SG_ 446 RBU_RRWheelSpd 0;
BA_ "GenSigTimeoutValue" SG_ 446 RBU_RRWheelSpd 0;
BA_ "Remark" SG_ 446 RBU_RRWheelSpd "";
BA_ "EventCommandSignal" SG_ 446 RBU_RRWheelSpdVD 0;
BA_ "GatewayedSignals" SG_ 446 RBU_RRWheelSpdVD 0;
BA_ "GenSigInactiveValue" SG_ 446 RBU_RRWheelSpdVD 0;
BA_ "GenSigInvalidValue" SG_ 446 RBU_RRWheelSpdVD 0;
BA_ "GenSigSendType" SG_ 446 RBU_RRWheelSpdVD 1;
BA_ "GenSigStartValue" SG_ 446 RBU_RRWheelSpdVD 0;
BA_ "GenSigTimeoutValue" SG_ 446 RBU_RRWheelSpdVD 0;
BA_ "Remark" SG_ 446 RBU_RRWheelSpdVD "";
BA_ "EventCommandSignal" SG_ 446 RBU_FLWheelRotatedDirectionNEW 0;
BA_ "GatewayedSignals" SG_ 446 RBU_FLWheelRotatedDirectionNEW 0;
BA_ "GenSigInactiveValue" SG_ 446 RBU_FLWheelRotatedDirectionNEW 0;
BA_ "GenSigInvalidValue" SG_ 446 RBU_FLWheelRotatedDirectionNEW 0;
BA_ "GenSigSendType" SG_ 446 RBU_FLWheelRotatedDirectionNEW 1;
BA_ "GenSigStartValue" SG_ 446 RBU_FLWheelRotatedDirectionNEW 0;
BA_ "GenSigTimeoutValue" SG_ 446 RBU_FLWheelRotatedDirectionNEW 0;
BA_ "Remark" SG_ 446 RBU_FLWheelRotatedDirectionNEW "";
BA_ "EventCommandSignal" SG_ 446 RBU_FLWheelRotatedDirectionVD 0;
BA_ "GatewayedSignals" SG_ 446 RBU_FLWheelRotatedDirectionVD 0;
BA_ "GenSigInactiveValue" SG_ 446 RBU_FLWheelRotatedDirectionVD 0;
BA_ "GenSigInvalidValue" SG_ 446 RBU_FLWheelRotatedDirectionVD 0;
BA_ "GenSigSendType" SG_ 446 RBU_FLWheelRotatedDirectionVD 1;
BA_ "GenSigStartValue" SG_ 446 RBU_FLWheelRotatedDirectionVD 0;
BA_ "GenSigTimeoutValue" SG_ 446 RBU_FLWheelRotatedDirectionVD 0;
BA_ "Remark" SG_ 446 RBU_FLWheelRotatedDirectionVD "";
BA_ "EventCommandSignal" SG_ 446 RBU_FRWheelRotatedDirectionNEW 0;
BA_ "GatewayedSignals" SG_ 446 RBU_FRWheelRotatedDirectionNEW 0;
BA_ "GenSigInactiveValue" SG_ 446 RBU_FRWheelRotatedDirectionNEW 0;
BA_ "GenSigInvalidValue" SG_ 446 RBU_FRWheelRotatedDirectionNEW 0;
BA_ "GenSigSendType" SG_ 446 RBU_FRWheelRotatedDirectionNEW 1;
BA_ "GenSigStartValue" SG_ 446 RBU_FRWheelRotatedDirectionNEW 0;
BA_ "GenSigTimeoutValue" SG_ 446 RBU_FRWheelRotatedDirectionNEW 0;
BA_ "Remark" SG_ 446 RBU_FRWheelRotatedDirectionNEW "";
BA_ "EventCommandSignal" SG_ 446 RBU_FRWheelRotatedDirectionVD 0;
BA_ "GatewayedSignals" SG_ 446 RBU_FRWheelRotatedDirectionVD 0;
BA_ "GenSigInactiveValue" SG_ 446 RBU_FRWheelRotatedDirectionVD 0;
BA_ "GenSigInvalidValue" SG_ 446 RBU_FRWheelRotatedDirectionVD 0;
BA_ "GenSigSendType" SG_ 446 RBU_FRWheelRotatedDirectionVD 1;
BA_ "GenSigStartValue" SG_ 446 RBU_FRWheelRotatedDirectionVD 0;
BA_ "GenSigTimeoutValue" SG_ 446 RBU_FRWheelRotatedDirectionVD 0;
BA_ "Remark" SG_ 446 RBU_FRWheelRotatedDirectionVD "";
BA_ "EventCommandSignal" SG_ 446 RBU_RLWheelRotatedDirectionNEW 0;
BA_ "GatewayedSignals" SG_ 446 RBU_RLWheelRotatedDirectionNEW 0;
BA_ "GenSigInactiveValue" SG_ 446 RBU_RLWheelRotatedDirectionNEW 0;
BA_ "GenSigInvalidValue" SG_ 446 RBU_RLWheelRotatedDirectionNEW 0;
BA_ "GenSigSendType" SG_ 446 RBU_RLWheelRotatedDirectionNEW 1;
BA_ "GenSigStartValue" SG_ 446 RBU_RLWheelRotatedDirectionNEW 0;
BA_ "GenSigTimeoutValue" SG_ 446 RBU_RLWheelRotatedDirectionNEW 0;
BA_ "Remark" SG_ 446 RBU_RLWheelRotatedDirectionNEW "";
BA_ "EventCommandSignal" SG_ 446 RBU_RLWheelRotatedDirectionVD 0;
BA_ "GatewayedSignals" SG_ 446 RBU_RLWheelRotatedDirectionVD 0;
BA_ "GenSigInactiveValue" SG_ 446 RBU_RLWheelRotatedDirectionVD 0;
BA_ "GenSigInvalidValue" SG_ 446 RBU_RLWheelRotatedDirectionVD 0;
BA_ "GenSigSendType" SG_ 446 RBU_RLWheelRotatedDirectionVD 1;
BA_ "GenSigStartValue" SG_ 446 RBU_RLWheelRotatedDirectionVD 0;
BA_ "GenSigTimeoutValue" SG_ 446 RBU_RLWheelRotatedDirectionVD 0;
BA_ "Remark" SG_ 446 RBU_RLWheelRotatedDirectionVD "";
BA_ "EventCommandSignal" SG_ 446 RBU_RRWheelRotatedDirectionNEW 0;
BA_ "GatewayedSignals" SG_ 446 RBU_RRWheelRotatedDirectionNEW 0;
BA_ "GenSigInactiveValue" SG_ 446 RBU_RRWheelRotatedDirectionNEW 0;
BA_ "GenSigInvalidValue" SG_ 446 RBU_RRWheelRotatedDirectionNEW 0;
BA_ "GenSigSendType" SG_ 446 RBU_RRWheelRotatedDirectionNEW 1;
BA_ "GenSigStartValue" SG_ 446 RBU_RRWheelRotatedDirectionNEW 0;
BA_ "GenSigTimeoutValue" SG_ 446 RBU_RRWheelRotatedDirectionNEW 0;
BA_ "Remark" SG_ 446 RBU_RRWheelRotatedDirectionNEW "";
BA_ "EventCommandSignal" SG_ 446 RBU_RRWheelRotatedDirectionVD 0;
BA_ "GatewayedSignals" SG_ 446 RBU_RRWheelRotatedDirectionVD 0;
BA_ "GenSigInactiveValue" SG_ 446 RBU_RRWheelRotatedDirectionVD 0;
BA_ "GenSigInvalidValue" SG_ 446 RBU_RRWheelRotatedDirectionVD 0;
BA_ "GenSigSendType" SG_ 446 RBU_RRWheelRotatedDirectionVD 1;
BA_ "GenSigStartValue" SG_ 446 RBU_RRWheelRotatedDirectionVD 0;
BA_ "GenSigTimeoutValue" SG_ 446 RBU_RRWheelRotatedDirectionVD 0;
BA_ "Remark" SG_ 446 RBU_RRWheelRotatedDirectionVD "";
BA_ "EventCommandSignal" SG_ 446 RBU_MasterCylinderPr 0;
BA_ "GatewayedSignals" SG_ 446 RBU_MasterCylinderPr 0;
BA_ "GenSigInactiveValue" SG_ 446 RBU_MasterCylinderPr 0;
BA_ "GenSigInvalidValue" SG_ 446 RBU_MasterCylinderPr 0;
BA_ "GenSigSendType" SG_ 446 RBU_MasterCylinderPr 1;
BA_ "GenSigStartValue" SG_ 446 RBU_MasterCylinderPr 0;
BA_ "GenSigTimeoutValue" SG_ 446 RBU_MasterCylinderPr 0;
BA_ "Remark" SG_ 446 RBU_MasterCylinderPr "";
BA_ "EventCommandSignal" SG_ 446 RBU_MasterCylinderPrVD 0;
BA_ "GatewayedSignals" SG_ 446 RBU_MasterCylinderPrVD 0;
BA_ "GenSigInactiveValue" SG_ 446 RBU_MasterCylinderPrVD 0;
BA_ "GenSigInvalidValue" SG_ 446 RBU_MasterCylinderPrVD 0;
BA_ "GenSigSendType" SG_ 446 RBU_MasterCylinderPrVD 1;
BA_ "GenSigStartValue" SG_ 446 RBU_MasterCylinderPrVD 0;
BA_ "GenSigTimeoutValue" SG_ 446 RBU_MasterCylinderPrVD 0;
BA_ "Remark" SG_ 446 RBU_MasterCylinderPrVD "";
BA_ "EventCommandSignal" SG_ 446 RBU_BrkTqCtrlAvlDriving 0;
BA_ "GatewayedSignals" SG_ 446 RBU_BrkTqCtrlAvlDriving 0;
BA_ "GenSigInactiveValue" SG_ 446 RBU_BrkTqCtrlAvlDriving 0;
BA_ "GenSigInvalidValue" SG_ 446 RBU_BrkTqCtrlAvlDriving 0;
BA_ "GenSigSendType" SG_ 446 RBU_BrkTqCtrlAvlDriving 1;
BA_ "GenSigStartValue" SG_ 446 RBU_BrkTqCtrlAvlDriving 0;
BA_ "GenSigTimeoutValue" SG_ 446 RBU_BrkTqCtrlAvlDriving 0;
BA_ "Remark" SG_ 446 RBU_BrkTqCtrlAvlDriving "";
BA_ "EventCommandSignal" SG_ 446 RBU_BrkTqCtrlAvlParking 0;
BA_ "GatewayedSignals" SG_ 446 RBU_BrkTqCtrlAvlParking 0;
BA_ "GenSigInactiveValue" SG_ 446 RBU_BrkTqCtrlAvlParking 0;
BA_ "GenSigInvalidValue" SG_ 446 RBU_BrkTqCtrlAvlParking 0;
BA_ "GenSigSendType" SG_ 446 RBU_BrkTqCtrlAvlParking 1;
BA_ "GenSigStartValue" SG_ 446 RBU_BrkTqCtrlAvlParking 0;
BA_ "GenSigTimeoutValue" SG_ 446 RBU_BrkTqCtrlAvlParking 0;
BA_ "Remark" SG_ 446 RBU_BrkTqCtrlAvlParking "";
BA_ "EventCommandSignal" SG_ 446 RBU_BrkTqCtrlActv 0;
BA_ "GatewayedSignals" SG_ 446 RBU_BrkTqCtrlActv 0;
BA_ "GenSigInactiveValue" SG_ 446 RBU_BrkTqCtrlActv 0;
BA_ "GenSigInvalidValue" SG_ 446 RBU_BrkTqCtrlActv 0;
BA_ "GenSigSendType" SG_ 446 RBU_BrkTqCtrlActv 1;
BA_ "GenSigStartValue" SG_ 446 RBU_BrkTqCtrlActv 0;
BA_ "GenSigTimeoutValue" SG_ 446 RBU_BrkTqCtrlActv 0;
BA_ "Remark" SG_ 446 RBU_BrkTqCtrlActv "";
BA_ "EventCommandSignal" SG_ 446 RBU_L3CommunicationInvalid 0;
BA_ "GatewayedSignals" SG_ 446 RBU_L3CommunicationInvalid 0;
BA_ "GenSigInactiveValue" SG_ 446 RBU_L3CommunicationInvalid 0;
BA_ "GenSigInvalidValue" SG_ 446 RBU_L3CommunicationInvalid 0;
BA_ "GenSigSendType" SG_ 446 RBU_L3CommunicationInvalid 1;
BA_ "GenSigStartValue" SG_ 446 RBU_L3CommunicationInvalid 0;
BA_ "GenSigTimeoutValue" SG_ 446 RBU_L3CommunicationInvalid 0;
BA_ "Remark" SG_ 446 RBU_L3CommunicationInvalid "";
BA_ "EventCommandSignal" SG_ 446 RBU_BrkPedlStsValid 0;
BA_ "GatewayedSignals" SG_ 446 RBU_BrkPedlStsValid 0;
BA_ "GenSigInactiveValue" SG_ 446 RBU_BrkPedlStsValid 0;
BA_ "GenSigInvalidValue" SG_ 446 RBU_BrkPedlStsValid 0;
BA_ "GenSigSendType" SG_ 446 RBU_BrkPedlStsValid 1;
BA_ "GenSigStartValue" SG_ 446 RBU_BrkPedlStsValid 0;
BA_ "GenSigTimeoutValue" SG_ 446 RBU_BrkPedlStsValid 0;
BA_ "Remark" SG_ 446 RBU_BrkPedlStsValid "";
BA_ "EventCommandSignal" SG_ 446 RBU_BrkPedlSts 0;
BA_ "GatewayedSignals" SG_ 446 RBU_BrkPedlSts 0;
BA_ "GenSigInactiveValue" SG_ 446 RBU_BrkPedlSts 0;
BA_ "GenSigInvalidValue" SG_ 446 RBU_BrkPedlSts 0;
BA_ "GenSigSendType" SG_ 446 RBU_BrkPedlSts 1;
BA_ "GenSigStartValue" SG_ 446 RBU_BrkPedlSts 0;
BA_ "GenSigTimeoutValue" SG_ 446 RBU_BrkPedlSts 0;
BA_ "Remark" SG_ 446 RBU_BrkPedlSts "";
BA_ "EventCommandSignal" SG_ 446 RBU_SBSAvailability 0;
BA_ "GatewayedSignals" SG_ 446 RBU_SBSAvailability 0;
BA_ "GenSigInactiveValue" SG_ 446 RBU_SBSAvailability 0;
BA_ "GenSigInvalidValue" SG_ 446 RBU_SBSAvailability 0;
BA_ "GenSigSendType" SG_ 446 RBU_SBSAvailability 1;
BA_ "GenSigStartValue" SG_ 446 RBU_SBSAvailability 0;
BA_ "GenSigTimeoutValue" SG_ 446 RBU_SBSAvailability 0;
BA_ "Remark" SG_ 446 RBU_SBSAvailability "";
BA_ "EventCommandSignal" SG_ 446 RBU_SBSActive 0;
BA_ "GatewayedSignals" SG_ 446 RBU_SBSActive 0;
BA_ "GenSigInactiveValue" SG_ 446 RBU_SBSActive 0;
BA_ "GenSigInvalidValue" SG_ 446 RBU_SBSActive 0;
BA_ "GenSigSendType" SG_ 446 RBU_SBSActive 1;
BA_ "GenSigStartValue" SG_ 446 RBU_SBSActive 0;
BA_ "GenSigTimeoutValue" SG_ 446 RBU_SBSActive 0;
BA_ "Remark" SG_ 446 RBU_SBSActive "";
BA_ "EventCommandSignal" SG_ 446 RBU_ParkBrakeCapability 0;
BA_ "GatewayedSignals" SG_ 446 RBU_ParkBrakeCapability 0;
BA_ "GenSigInactiveValue" SG_ 446 RBU_ParkBrakeCapability 0;
BA_ "GenSigInvalidValue" SG_ 446 RBU_ParkBrakeCapability 0;
BA_ "GenSigSendType" SG_ 446 RBU_ParkBrakeCapability 1;
BA_ "GenSigStartValue" SG_ 446 RBU_ParkBrakeCapability 0;
BA_ "GenSigTimeoutValue" SG_ 446 RBU_ParkBrakeCapability 0;
BA_ "Remark" SG_ 446 RBU_ParkBrakeCapability "";
BA_ "EventCommandSignal" SG_ 446 RBU_DrvrTqDesVld 0;
BA_ "GatewayedSignals" SG_ 446 RBU_DrvrTqDesVld 0;
BA_ "GenSigInactiveValue" SG_ 446 RBU_DrvrTqDesVld 0;
BA_ "GenSigInvalidValue" SG_ 446 RBU_DrvrTqDesVld 0;
BA_ "GenSigSendType" SG_ 446 RBU_DrvrTqDesVld 1;
BA_ "GenSigStartValue" SG_ 446 RBU_DrvrTqDesVld 0;
BA_ "GenSigTimeoutValue" SG_ 446 RBU_DrvrTqDesVld 0;
BA_ "Remark" SG_ 446 RBU_DrvrTqDesVld "";
BA_ "EventCommandSignal" SG_ 446 RBU_BrkActvTqValid 0;
BA_ "GatewayedSignals" SG_ 446 RBU_BrkActvTqValid 0;
BA_ "GenSigInactiveValue" SG_ 446 RBU_BrkActvTqValid 0;
BA_ "GenSigInvalidValue" SG_ 446 RBU_BrkActvTqValid 0;
BA_ "GenSigSendType" SG_ 446 RBU_BrkActvTqValid 1;
BA_ "GenSigStartValue" SG_ 446 RBU_BrkActvTqValid 0;
BA_ "GenSigTimeoutValue" SG_ 446 RBU_BrkActvTqValid 0;
BA_ "Remark" SG_ 446 RBU_BrkActvTqValid "";
BA_ "EventCommandSignal" SG_ 446 RBU_NetModeResp 0;
BA_ "GatewayedSignals" SG_ 446 RBU_NetModeResp 0;
BA_ "GenSigInactiveValue" SG_ 446 RBU_NetModeResp 0;
BA_ "GenSigInvalidValue" SG_ 446 RBU_NetModeResp 0;
BA_ "GenSigSendType" SG_ 446 RBU_NetModeResp 1;
BA_ "GenSigStartValue" SG_ 446 RBU_NetModeResp 0;
BA_ "GenSigTimeoutValue" SG_ 446 RBU_NetModeResp 0;
BA_ "Remark" SG_ 446 RBU_NetModeResp "";
BA_ "EventCommandSignal" SG_ 446 RBU_DrvrTqDes 0;
BA_ "GatewayedSignals" SG_ 446 RBU_DrvrTqDes 0;
BA_ "GenSigInactiveValue" SG_ 446 RBU_DrvrTqDes 0;
BA_ "GenSigInvalidValue" SG_ 446 RBU_DrvrTqDes 0;
BA_ "GenSigSendType" SG_ 446 RBU_DrvrTqDes 1;
BA_ "GenSigStartValue" SG_ 446 RBU_DrvrTqDes 0;
BA_ "GenSigTimeoutValue" SG_ 446 RBU_DrvrTqDes 0;
BA_ "Remark" SG_ 446 RBU_DrvrTqDes "";
BA_ "EventCommandSignal" SG_ 446 RBU_BrkActvTq 0;
BA_ "GatewayedSignals" SG_ 446 RBU_BrkActvTq 0;
BA_ "GenSigInactiveValue" SG_ 446 RBU_BrkActvTq 0;
BA_ "GenSigInvalidValue" SG_ 446 RBU_BrkActvTq 0;
BA_ "GenSigSendType" SG_ 446 RBU_BrkActvTq 1;
BA_ "GenSigStartValue" SG_ 446 RBU_BrkActvTq 0;
BA_ "GenSigTimeoutValue" SG_ 446 RBU_BrkActvTq 0;
BA_ "Remark" SG_ 446 RBU_BrkActvTq "";
BA_ "EventCommandSignal" SG_ 446 RBU_DrvrBrkOvrdVld 0;
BA_ "GatewayedSignals" SG_ 446 RBU_DrvrBrkOvrdVld 0;
BA_ "GenSigInactiveValue" SG_ 446 RBU_DrvrBrkOvrdVld 0;
BA_ "GenSigInvalidValue" SG_ 446 RBU_DrvrBrkOvrdVld 0;
BA_ "GenSigSendType" SG_ 446 RBU_DrvrBrkOvrdVld 1;
BA_ "GenSigStartValue" SG_ 446 RBU_DrvrBrkOvrdVld 0;
BA_ "GenSigTimeoutValue" SG_ 446 RBU_DrvrBrkOvrdVld 0;
BA_ "Remark" SG_ 446 RBU_DrvrBrkOvrdVld "";
BA_ "EventCommandSignal" SG_ 446 RBU_DrvrBrkOvrd 0;
BA_ "GatewayedSignals" SG_ 446 RBU_DrvrBrkOvrd 0;
BA_ "GenSigInactiveValue" SG_ 446 RBU_DrvrBrkOvrd 0;
BA_ "GenSigInvalidValue" SG_ 446 RBU_DrvrBrkOvrd 0;
BA_ "GenSigSendType" SG_ 446 RBU_DrvrBrkOvrd 1;
BA_ "GenSigStartValue" SG_ 446 RBU_DrvrBrkOvrd 0;
BA_ "GenSigTimeoutValue" SG_ 446 RBU_DrvrBrkOvrd 0;
BA_ "Remark" SG_ 446 RBU_DrvrBrkOvrd "";
BA_ "EventCommandSignal" SG_ 446 RBU_ADSNetErrFb 0;
BA_ "GatewayedSignals" SG_ 446 RBU_ADSNetErrFb 0;
BA_ "GenSigInactiveValue" SG_ 446 RBU_ADSNetErrFb 0;
BA_ "GenSigInvalidValue" SG_ 446 RBU_ADSNetErrFb 0;
BA_ "GenSigSendType" SG_ 446 RBU_ADSNetErrFb 1;
BA_ "GenSigStartValue" SG_ 446 RBU_ADSNetErrFb 0;
BA_ "GenSigTimeoutValue" SG_ 446 RBU_ADSNetErrFb 0;
BA_ "Remark" SG_ 446 RBU_ADSNetErrFb "";
BA_ "EventCommandSignal" SG_ 446 RBU_BrkTqCtrlActv_L3 0;
BA_ "GatewayedSignals" SG_ 446 RBU_BrkTqCtrlActv_L3 0;
BA_ "GenSigInactiveValue" SG_ 446 RBU_BrkTqCtrlActv_L3 0;
BA_ "GenSigInvalidValue" SG_ 446 RBU_BrkTqCtrlActv_L3 0;
BA_ "GenSigSendType" SG_ 446 RBU_BrkTqCtrlActv_L3 1;
BA_ "GenSigStartValue" SG_ 446 RBU_BrkTqCtrlActv_L3 0;
BA_ "GenSigTimeoutValue" SG_ 446 RBU_BrkTqCtrlActv_L3 0;
BA_ "Remark" SG_ 446 RBU_BrkTqCtrlActv_L3 "";
BA_ "EventCommandSignal" SG_ 446 RBU_BrkTqCtrlAvl_L3 0;
BA_ "GatewayedSignals" SG_ 446 RBU_BrkTqCtrlAvl_L3 0;
BA_ "GenSigInactiveValue" SG_ 446 RBU_BrkTqCtrlAvl_L3 0;
BA_ "GenSigInvalidValue" SG_ 446 RBU_BrkTqCtrlAvl_L3 0;
BA_ "GenSigSendType" SG_ 446 RBU_BrkTqCtrlAvl_L3 1;
BA_ "GenSigStartValue" SG_ 446 RBU_BrkTqCtrlAvl_L3 0;
BA_ "GenSigTimeoutValue" SG_ 446 RBU_BrkTqCtrlAvl_L3 0;
BA_ "Remark" SG_ 446 RBU_BrkTqCtrlAvl_L3 "";
BA_ "EventCommandSignal" SG_ 430 SRS_1_CRC_1 0;
BA_ "GatewayedSignals" SG_ 430 SRS_1_CRC_1 0;
BA_ "GenSigInactiveValue" SG_ 430 SRS_1_CRC_1 0;
BA_ "GenSigInvalidValue" SG_ 430 SRS_1_CRC_1 0;
BA_ "GenSigSendType" SG_ 430 SRS_1_CRC_1 1;
BA_ "GenSigStartValue" SG_ 430 SRS_1_CRC_1 0;
BA_ "GenSigTimeoutValue" SG_ 430 SRS_1_CRC_1 0;
BA_ "Remark" SG_ 430 SRS_1_CRC_1 "";
BA_ "EventCommandSignal" SG_ 430 SRS_1_Counter_1 0;
BA_ "GatewayedSignals" SG_ 430 SRS_1_Counter_1 0;
BA_ "GenSigInactiveValue" SG_ 430 SRS_1_Counter_1 0;
BA_ "GenSigInvalidValue" SG_ 430 SRS_1_Counter_1 0;
BA_ "GenSigSendType" SG_ 430 SRS_1_Counter_1 1;
BA_ "GenSigStartValue" SG_ 430 SRS_1_Counter_1 0;
BA_ "GenSigTimeoutValue" SG_ 430 SRS_1_Counter_1 0;
BA_ "Remark" SG_ 430 SRS_1_Counter_1 "";
BA_ "EventCommandSignal" SG_ 430 SRS_CrashOutputSt 0;
BA_ "GatewayedSignals" SG_ 430 SRS_CrashOutputSt 0;
BA_ "GenSigInactiveValue" SG_ 430 SRS_CrashOutputSt 0;
BA_ "GenSigInvalidValue" SG_ 430 SRS_CrashOutputSt 0;
BA_ "GenSigSendType" SG_ 430 SRS_CrashOutputSt 1;
BA_ "GenSigStartValue" SG_ 430 SRS_CrashOutputSt 0;
BA_ "GenSigTimeoutValue" SG_ 430 SRS_CrashOutputSt 0;
BA_ "Remark" SG_ 430 SRS_CrashOutputSt "";
BA_ "EventCommandSignal" SG_ 430 SRS_Front_CrashOutputSt 0;
BA_ "GatewayedSignals" SG_ 430 SRS_Front_CrashOutputSt 0;
BA_ "GenSigInactiveValue" SG_ 430 SRS_Front_CrashOutputSt 0;
BA_ "GenSigInvalidValue" SG_ 430 SRS_Front_CrashOutputSt 0;
BA_ "GenSigSendType" SG_ 430 SRS_Front_CrashOutputSt 1;
BA_ "GenSigStartValue" SG_ 430 SRS_Front_CrashOutputSt 0;
BA_ "GenSigTimeoutValue" SG_ 430 SRS_Front_CrashOutputSt 0;
BA_ "Remark" SG_ 430 SRS_Front_CrashOutputSt "";
BA_ "EventCommandSignal" SG_ 430 SRS_DriverSide_CrashOutputSt 0;
BA_ "GatewayedSignals" SG_ 430 SRS_DriverSide_CrashOutputSt 0;
BA_ "GenSigInactiveValue" SG_ 430 SRS_DriverSide_CrashOutputSt 0;
BA_ "GenSigInvalidValue" SG_ 430 SRS_DriverSide_CrashOutputSt 0;
BA_ "GenSigSendType" SG_ 430 SRS_DriverSide_CrashOutputSt 1;
BA_ "GenSigStartValue" SG_ 430 SRS_DriverSide_CrashOutputSt 0;
BA_ "GenSigTimeoutValue" SG_ 430 SRS_DriverSide_CrashOutputSt 0;
BA_ "Remark" SG_ 430 SRS_DriverSide_CrashOutputSt "";
BA_ "EventCommandSignal" SG_ 430 SRS_PassengerSide_CrashOutputSt 0;
BA_ "GatewayedSignals" SG_ 430 SRS_PassengerSide_CrashOutputSt 0;
BA_ "GenSigInactiveValue" SG_ 430 SRS_PassengerSide_CrashOutputSt 0;
BA_ "GenSigInvalidValue" SG_ 430 SRS_PassengerSide_CrashOutputSt 0;
BA_ "GenSigSendType" SG_ 430 SRS_PassengerSide_CrashOutputSt 1;
BA_ "GenSigStartValue" SG_ 430 SRS_PassengerSide_CrashOutputSt 0;
BA_ "GenSigTimeoutValue" SG_ 430 SRS_PassengerSide_CrashOutputSt 0;
BA_ "Remark" SG_ 430 SRS_PassengerSide_CrashOutputSt "";
BA_ "EventCommandSignal" SG_ 430 SRS_Rear_CrashOutputSt 0;
BA_ "GatewayedSignals" SG_ 430 SRS_Rear_CrashOutputSt 0;
BA_ "GenSigInactiveValue" SG_ 430 SRS_Rear_CrashOutputSt 0;
BA_ "GenSigInvalidValue" SG_ 430 SRS_Rear_CrashOutputSt 0;
BA_ "GenSigSendType" SG_ 430 SRS_Rear_CrashOutputSt 1;
BA_ "GenSigStartValue" SG_ 430 SRS_Rear_CrashOutputSt 0;
BA_ "GenSigTimeoutValue" SG_ 430 SRS_Rear_CrashOutputSt 0;
BA_ "Remark" SG_ 430 SRS_Rear_CrashOutputSt "";
BA_ "EventCommandSignal" SG_ 430 SRS_RolloverCrashOutputSt 0;
BA_ "GatewayedSignals" SG_ 430 SRS_RolloverCrashOutputSt 0;
BA_ "GenSigInactiveValue" SG_ 430 SRS_RolloverCrashOutputSt 0;
BA_ "GenSigInvalidValue" SG_ 430 SRS_RolloverCrashOutputSt 0;
BA_ "GenSigSendType" SG_ 430 SRS_RolloverCrashOutputSt 1;
BA_ "GenSigStartValue" SG_ 430 SRS_RolloverCrashOutputSt 0;
BA_ "GenSigTimeoutValue" SG_ 430 SRS_RolloverCrashOutputSt 0;
BA_ "Remark" SG_ 430 SRS_RolloverCrashOutputSt "";
BA_ "EventCommandSignal" SG_ 430 SRS_NearCrashOutputSt 0;
BA_ "GatewayedSignals" SG_ 430 SRS_NearCrashOutputSt 0;
BA_ "GenSigInactiveValue" SG_ 430 SRS_NearCrashOutputSt 0;
BA_ "GenSigInvalidValue" SG_ 430 SRS_NearCrashOutputSt 0;
BA_ "GenSigSendType" SG_ 430 SRS_NearCrashOutputSt 1;
BA_ "GenSigStartValue" SG_ 430 SRS_NearCrashOutputSt 0;
BA_ "GenSigTimeoutValue" SG_ 430 SRS_NearCrashOutputSt 0;
BA_ "Remark" SG_ 430 SRS_NearCrashOutputSt "";
BA_ "EventCommandSignal" SG_ 430 SRS_1_CRC_2 0;
BA_ "GatewayedSignals" SG_ 430 SRS_1_CRC_2 0;
BA_ "GenSigInactiveValue" SG_ 430 SRS_1_CRC_2 0;
BA_ "GenSigInvalidValue" SG_ 430 SRS_1_CRC_2 0;
BA_ "GenSigSendType" SG_ 430 SRS_1_CRC_2 1;
BA_ "GenSigStartValue" SG_ 430 SRS_1_CRC_2 0;
BA_ "GenSigTimeoutValue" SG_ 430 SRS_1_CRC_2 0;
BA_ "Remark" SG_ 430 SRS_1_CRC_2 "";
BA_ "EventCommandSignal" SG_ 430 SRS_1_Counter_2 0;
BA_ "GatewayedSignals" SG_ 430 SRS_1_Counter_2 0;
BA_ "GenSigInactiveValue" SG_ 430 SRS_1_Counter_2 0;
BA_ "GenSigInvalidValue" SG_ 430 SRS_1_Counter_2 0;
BA_ "GenSigSendType" SG_ 430 SRS_1_Counter_2 1;
BA_ "GenSigStartValue" SG_ 430 SRS_1_Counter_2 0;
BA_ "GenSigTimeoutValue" SG_ 430 SRS_1_Counter_2 0;
BA_ "Remark" SG_ 430 SRS_1_Counter_2 "";
BA_ "EventCommandSignal" SG_ 430 SRS_YawSnsCalibSt 0;
BA_ "GatewayedSignals" SG_ 430 SRS_YawSnsCalibSt 0;
BA_ "GenSigInactiveValue" SG_ 430 SRS_YawSnsCalibSt 0;
BA_ "GenSigInvalidValue" SG_ 430 SRS_YawSnsCalibSt 0;
BA_ "GenSigSendType" SG_ 430 SRS_YawSnsCalibSt 1;
BA_ "GenSigStartValue" SG_ 430 SRS_YawSnsCalibSt 0;
BA_ "GenSigTimeoutValue" SG_ 430 SRS_YawSnsCalibSt 0;
BA_ "Remark" SG_ 430 SRS_YawSnsCalibSt "";
BA_ "EventCommandSignal" SG_ 430 SRS_VehLongAccelVD 0;
BA_ "GatewayedSignals" SG_ 430 SRS_VehLongAccelVD 0;
BA_ "GenSigInactiveValue" SG_ 430 SRS_VehLongAccelVD 0;
BA_ "GenSigInvalidValue" SG_ 430 SRS_VehLongAccelVD 0;
BA_ "GenSigSendType" SG_ 430 SRS_VehLongAccelVD 1;
BA_ "GenSigStartValue" SG_ 430 SRS_VehLongAccelVD 0;
BA_ "GenSigTimeoutValue" SG_ 430 SRS_VehLongAccelVD 2;
BA_ "Remark" SG_ 430 SRS_VehLongAccelVD "";
BA_ "EventCommandSignal" SG_ 430 SRS_VehLatrlAccelVD 0;
BA_ "GatewayedSignals" SG_ 430 SRS_VehLatrlAccelVD 0;
BA_ "GenSigInactiveValue" SG_ 430 SRS_VehLatrlAccelVD 0;
BA_ "GenSigInvalidValue" SG_ 430 SRS_VehLatrlAccelVD 0;
BA_ "GenSigSendType" SG_ 430 SRS_VehLatrlAccelVD 1;
BA_ "GenSigStartValue" SG_ 430 SRS_VehLatrlAccelVD 0;
BA_ "GenSigTimeoutValue" SG_ 430 SRS_VehLatrlAccelVD 2;
BA_ "Remark" SG_ 430 SRS_VehLatrlAccelVD "";
BA_ "EventCommandSignal" SG_ 430 SRS_YawRateVD 0;
BA_ "GatewayedSignals" SG_ 430 SRS_YawRateVD 0;
BA_ "GenSigInactiveValue" SG_ 430 SRS_YawRateVD 0;
BA_ "GenSigInvalidValue" SG_ 430 SRS_YawRateVD 0;
BA_ "GenSigSendType" SG_ 430 SRS_YawRateVD 1;
BA_ "GenSigStartValue" SG_ 430 SRS_YawRateVD 0;
BA_ "GenSigTimeoutValue" SG_ 430 SRS_YawRateVD 2;
BA_ "Remark" SG_ 430 SRS_YawRateVD "";
BA_ "EventCommandSignal" SG_ 430 SRS_VehLongAccel 0;
BA_ "GatewayedSignals" SG_ 430 SRS_VehLongAccel 0;
BA_ "GenSigInactiveValue" SG_ 430 SRS_VehLongAccel 0;
BA_ "GenSigInvalidValue" SG_ 430 SRS_VehLongAccel 0;
BA_ "GenSigSendType" SG_ 430 SRS_VehLongAccel 1;
BA_ "GenSigStartValue" SG_ 430 SRS_VehLongAccel 2000;
BA_ "GenSigTimeoutValue" SG_ 430 SRS_VehLongAccel 2000;
BA_ "Remark" SG_ 430 SRS_VehLongAccel "";
BA_ "EventCommandSignal" SG_ 430 SRS_VehLatrlAccel 0;
BA_ "GatewayedSignals" SG_ 430 SRS_VehLatrlAccel 0;
BA_ "GenSigInactiveValue" SG_ 430 SRS_VehLatrlAccel 0;
BA_ "GenSigInvalidValue" SG_ 430 SRS_VehLatrlAccel 0;
BA_ "GenSigSendType" SG_ 430 SRS_VehLatrlAccel 1;
BA_ "GenSigStartValue" SG_ 430 SRS_VehLatrlAccel 2000;
BA_ "GenSigTimeoutValue" SG_ 430 SRS_VehLatrlAccel 2000;
BA_ "Remark" SG_ 430 SRS_VehLatrlAccel "";
BA_ "EventCommandSignal" SG_ 430 SRS_YawRate 0;
BA_ "GatewayedSignals" SG_ 430 SRS_YawRate 0;
BA_ "GenSigInactiveValue" SG_ 430 SRS_YawRate 0;
BA_ "GenSigInvalidValue" SG_ 430 SRS_YawRate 0;
BA_ "GenSigSendType" SG_ 430 SRS_YawRate 1;
BA_ "GenSigStartValue" SG_ 430 SRS_YawRate 18000;
BA_ "GenSigTimeoutValue" SG_ 430 SRS_YawRate 18000;
BA_ "Remark" SG_ 430 SRS_YawRate "";
BA_ "EventCommandSignal" SG_ 939 SRS_PsngrSeatBeltSt 0;
BA_ "GatewayedSignals" SG_ 939 SRS_PsngrSeatBeltSt 0;
BA_ "GenSigInactiveValue" SG_ 939 SRS_PsngrSeatBeltSt 0;
BA_ "GenSigInvalidValue" SG_ 939 SRS_PsngrSeatBeltSt 3;
BA_ "GenSigSendType" SG_ 939 SRS_PsngrSeatBeltSt 1;
BA_ "GenSigStartValue" SG_ 939 SRS_PsngrSeatBeltSt 0;
BA_ "GenSigTimeoutValue" SG_ 939 SRS_PsngrSeatBeltSt 3;
BA_ "Remark" SG_ 939 SRS_PsngrSeatBeltSt "";
BA_ "EventCommandSignal" SG_ 939 SRS_DriverSeatBeltSt 0;
BA_ "GatewayedSignals" SG_ 939 SRS_DriverSeatBeltSt 0;
BA_ "GenSigInactiveValue" SG_ 939 SRS_DriverSeatBeltSt 0;
BA_ "GenSigInvalidValue" SG_ 939 SRS_DriverSeatBeltSt 3;
BA_ "GenSigSendType" SG_ 939 SRS_DriverSeatBeltSt 1;
BA_ "GenSigStartValue" SG_ 939 SRS_DriverSeatBeltSt 0;
BA_ "GenSigTimeoutValue" SG_ 939 SRS_DriverSeatBeltSt 3;
BA_ "Remark" SG_ 939 SRS_DriverSeatBeltSt "";
BA_ "EventCommandSignal" SG_ 939 SRS_RearLeftSeatBeltSt 0;
BA_ "GatewayedSignals" SG_ 939 SRS_RearLeftSeatBeltSt 0;
BA_ "GenSigInactiveValue" SG_ 939 SRS_RearLeftSeatBeltSt 0;
BA_ "GenSigInvalidValue" SG_ 939 SRS_RearLeftSeatBeltSt 3;
BA_ "GenSigSendType" SG_ 939 SRS_RearLeftSeatBeltSt 1;
BA_ "GenSigStartValue" SG_ 939 SRS_RearLeftSeatBeltSt 0;
BA_ "GenSigTimeoutValue" SG_ 939 SRS_RearLeftSeatBeltSt 3;
BA_ "Remark" SG_ 939 SRS_RearLeftSeatBeltSt "";
BA_ "EventCommandSignal" SG_ 939 SRS_AirbagFaultSt 0;
BA_ "GatewayedSignals" SG_ 939 SRS_AirbagFaultSt 0;
BA_ "GenSigInactiveValue" SG_ 939 SRS_AirbagFaultSt 0;
BA_ "GenSigInvalidValue" SG_ 939 SRS_AirbagFaultSt 0;
BA_ "GenSigSendType" SG_ 939 SRS_AirbagFaultSt 1;
BA_ "GenSigStartValue" SG_ 939 SRS_AirbagFaultSt 0;
BA_ "GenSigTimeoutValue" SG_ 939 SRS_AirbagFaultSt 1;
BA_ "Remark" SG_ 939 SRS_AirbagFaultSt "";
BA_ "EventCommandSignal" SG_ 939 SRS_RearRightSeatBeltSt 0;
BA_ "GatewayedSignals" SG_ 939 SRS_RearRightSeatBeltSt 0;
BA_ "GenSigInactiveValue" SG_ 939 SRS_RearRightSeatBeltSt 0;
BA_ "GenSigInvalidValue" SG_ 939 SRS_RearRightSeatBeltSt 3;
BA_ "GenSigSendType" SG_ 939 SRS_RearRightSeatBeltSt 1;
BA_ "GenSigStartValue" SG_ 939 SRS_RearRightSeatBeltSt 0;
BA_ "GenSigTimeoutValue" SG_ 939 SRS_RearRightSeatBeltSt 3;
BA_ "Remark" SG_ 939 SRS_RearRightSeatBeltSt "";
BA_ "EventCommandSignal" SG_ 939 SRS_RearMiddleSeatBeltSt 0;
BA_ "GatewayedSignals" SG_ 939 SRS_RearMiddleSeatBeltSt 0;
BA_ "GenSigInactiveValue" SG_ 939 SRS_RearMiddleSeatBeltSt 0;
BA_ "GenSigInvalidValue" SG_ 939 SRS_RearMiddleSeatBeltSt 3;
BA_ "GenSigSendType" SG_ 939 SRS_RearMiddleSeatBeltSt 1;
BA_ "GenSigStartValue" SG_ 939 SRS_RearMiddleSeatBeltSt 0;
BA_ "GenSigTimeoutValue" SG_ 939 SRS_RearMiddleSeatBeltSt 3;
BA_ "Remark" SG_ 939 SRS_RearMiddleSeatBeltSt "";
BA_ "EventCommandSignal" SG_ 939 SRS_ThirdRowLeftSeatBeltSt 0;
BA_ "GatewayedSignals" SG_ 939 SRS_ThirdRowLeftSeatBeltSt 0;
BA_ "GenSigInactiveValue" SG_ 939 SRS_ThirdRowLeftSeatBeltSt 0;
BA_ "GenSigInvalidValue" SG_ 939 SRS_ThirdRowLeftSeatBeltSt 3;
BA_ "GenSigSendType" SG_ 939 SRS_ThirdRowLeftSeatBeltSt 1;
BA_ "GenSigStartValue" SG_ 939 SRS_ThirdRowLeftSeatBeltSt 0;
BA_ "GenSigTimeoutValue" SG_ 939 SRS_ThirdRowLeftSeatBeltSt 3;
BA_ "Remark" SG_ 939 SRS_ThirdRowLeftSeatBeltSt "";
BA_ "EventCommandSignal" SG_ 939 SRS_ThirdRowRightSeatBeltSt 0;
BA_ "GatewayedSignals" SG_ 939 SRS_ThirdRowRightSeatBeltSt 0;
BA_ "GenSigInactiveValue" SG_ 939 SRS_ThirdRowRightSeatBeltSt 0;
BA_ "GenSigInvalidValue" SG_ 939 SRS_ThirdRowRightSeatBeltSt 3;
BA_ "GenSigSendType" SG_ 939 SRS_ThirdRowRightSeatBeltSt 1;
BA_ "GenSigStartValue" SG_ 939 SRS_ThirdRowRightSeatBeltSt 0;
BA_ "GenSigTimeoutValue" SG_ 939 SRS_ThirdRowRightSeatBeltSt 3;
BA_ "Remark" SG_ 939 SRS_ThirdRowRightSeatBeltSt "";
BA_ "EventCommandSignal" SG_ 939 SRS_ThirdRowMiddleSeatBeltSt 0;
BA_ "GatewayedSignals" SG_ 939 SRS_ThirdRowMiddleSeatBeltSt 0;
BA_ "GenSigInactiveValue" SG_ 939 SRS_ThirdRowMiddleSeatBeltSt 0;
BA_ "GenSigInvalidValue" SG_ 939 SRS_ThirdRowMiddleSeatBeltSt 3;
BA_ "GenSigSendType" SG_ 939 SRS_ThirdRowMiddleSeatBeltSt 1;
BA_ "GenSigStartValue" SG_ 939 SRS_ThirdRowMiddleSeatBeltSt 0;
BA_ "GenSigTimeoutValue" SG_ 939 SRS_ThirdRowMiddleSeatBeltSt 3;
BA_ "Remark" SG_ 939 SRS_ThirdRowMiddleSeatBeltSt "";
VAL_ 400 UINM_DrvReqShft 0 "Shifter position O" 1 "Shifter position F1" 2 "Shifter position F2" 3 "Shifter position B1" 4 "Shifter position B2" 5 "Shifter not initialized / INIT" 6 "Signal not available / SNA (Double fault shifter sensor)"  ;
VAL_ 400 UINM_DrvReqShftInv 9 "Signal not available / SNA (Double fault shifter sensor)" 10 "Shifter not initialized / INIT" 11 "Shifter position B2" 12 "Shifter position B1" 13 "Shifter position F2" 14 "Shifter position F1" 15 "Shifter position O"  ;
VAL_ 400 UINM_FuSaErrSt 0 "No Error" 1 "Error"  ;
VAL_ 400 UINM_ShftFault 0 "E-shift Normal" 1 "E-shift fault"  ;
VAL_ 400 UINM_PositionLightSwSt 0 "Not Active" 1 "Active" 2 "fault" 3 "Reserved"  ;
VAL_ 400 UINM_LowBeamSwSt 0 "Not Active" 1 "Active" 2 "fault" 3 "Reserved"  ;
VAL_ 400 UINM_AutoLightSwSt 0 "Not Active" 1 "Active" 2 "fault" 3 "Reserved"  ;
VAL_ 400 UINM_FrontFogLightSwSt 0 "Not Active" 1 "Active"  ;
VAL_ 400 UINM_RearFogLightSwSt 0 "Not Active" 1 "Active"  ;
VAL_ 400 UINM_HighBeamSwSt 0 "Not active" 1 "Continue" 2 "Flash" 3 "fault"  ;
VAL_ 400 UINM_TurnLightSwSt 0 "Not active" 1 "Left turn" 2 "Right turn" 3 "Left change" 4 "Right change" 5 "Fault" 6 "Reserved" 7 "Reserved"  ;
VAL_ 400 UINM_FrontWiperSwSt 0 "Off" 1 "Low speed" 2 "Int/Auto" 3 "High speed" 4 "Mist" 7 "invaild"  ;
VAL_ 400 UINM_FrontWiperIntAdjSwSt 0 "No used" 15 "Invaild"  ;
VAL_ 400 UINM_FrontWasherSwSt 0 "Not Active" 1 "Active"  ;
VAL_ 400 UINM_RearWiperSwSt 0 "Off" 1 "Low speed" 2 "Int/Auto" 3 "High speed" 7 "invaild"  ;
VAL_ 400 UINM_RearWiperIntAdjSwSt 0 "No used" 15 "Invaild"  ;
VAL_ 400 UINM_RearWasherSwSt 0 "Inactive" 1 "Active"  ;
VAL_ 400 UINM_HeadLampWasherSwSt 0 "Inactive" 1 "Active"  ;
VAL_ 792 UMM_SecondMIDSeatSt 0 "Undefined" 1 "Off" 2 "On" 3 "Failure"  ;
VAL_ 792 UMM_SecondRHSeatSt 0 "Undefined" 1 "Off" 2 "On" 3 "Failure"  ;
VAL_ 792 UMM_SecondLHSeatSt 0 "Undefined" 1 "Off" 2 "On" 3 "Failure"  ;
VAL_ 792 EL_RADASLightSt 0 "Off" 1 "On" 2 "Fault" 3 "Not used"  ;
VAL_ 792 UMM_ThirdLHSeatSt 0 "Undefined" 1 "Off" 2 "On" 3 "Failure"  ;
VAL_ 792 UMM_ThirdRHSeatSt 0 "Undefined" 1 "Off" 2 "On" 3 "Failure"  ;
VAL_ 792 UMM_ThirdMIDSeatSt 0 "Undefined" 1 "Off" 2 "On" 3 "Failure"  ;
VAL_ 792 LCK_PowerFillerCapAngle 0 "FullyClosed" 255 "Unknown"  ;
VAL_ 792 EL_ReverseLightSt 0 "OFF" 1 "ON"  ;
VAL_ 792 EL_ReverseLightFaultSt 0 "Not fault" 1 "Fault"  ;
VAL_ 792 EL_SideBrkLightSt 0 "OFF" 1 "ON"  ;
VAL_ 792 EL_SideBrkLightFaultSt 0 "Not fault" 1 "Fault"  ;
VAL_ 792 EL_CHMSLSt 0 "OFF" 1 "ON"  ;
VAL_ 792 EL_CHMSLFaultSt 0 "Not fault" 1 "Fault"  ;
VAL_ 792 EL_RLPositionLightSt 0 "OFF" 1 "ON"  ;
VAL_ 792 EL_RLPositionLightFaultSt 0 "Not fault" 1 "Fault"  ;
VAL_ 792 EL_RRPositionLightSt 0 "OFF" 1 "ON"  ;
VAL_ 792 EL_RRPositionLightFaultSt 0 "Not fault" 1 "Fault"  ;
VAL_ 792 EL_RearFogLightSt 0 "OFF" 1 "ON"  ;
VAL_ 792 EL_RearFogLightFaultSt 0 "Not fault" 1 "Fault"  ;
VAL_ 792 EL_RLTurnLightSt 0 "Not active" 1 "OFF" 2 "ON" 3 "Not used"  ;
VAL_ 792 EL_RLTurnLightFaultSt 0 "Not fault" 1 "Fault"  ;
VAL_ 792 EL_RRTurnLightSt 0 "Not active" 1 "OFF" 2 "ON" 3 "Not used"  ;
VAL_ 792 EL_RRTurnLightFaultSt 0 "Not fault" 1 "Fault"  ;
VAL_ 446 RBU_VehSpdVD 0 "Invalid" 1 "Valid"  ;
VAL_ 446 RBU_FLWheelSpdEdgesSumVD 0 "Not valid" 1 "Valid"  ;
VAL_ 446 RBU_FRWheelSpdEdgesSumVD 0 "Not valid" 1 "Valid"  ;
VAL_ 446 RBU_RLWheelSpdEdgesSumVD 0 "Not valid" 1 "Valid"  ;
VAL_ 446 RBU_RRWheelSpdEdgesSumVD 0 "Not valid" 1 "Valid"  ;
VAL_ 446 RBU_FLWheelSpdVD 0 "Not valid" 1 "Valid"  ;
VAL_ 446 RBU_FRWheelSpdVD 0 "Not valid" 1 "Valid"  ;
VAL_ 446 RBU_RLWheelSpdVD 0 "Not valid" 1 "Valid"  ;
VAL_ 446 RBU_RRWheelSpdVD 0 "Not valid" 1 "Valid"  ;
VAL_ 446 RBU_FLWheelRotatedDirectionNEW 0 "Standstill" 1 "Forward" 2 "Backward" 3 "Unknown"  ;
VAL_ 446 RBU_FLWheelRotatedDirectionVD 0 "Not valid" 1 "Valid"  ;
VAL_ 446 RBU_FRWheelRotatedDirectionNEW 0 "Standstill" 1 "Forward" 2 "Backward" 3 "Unknown"  ;
VAL_ 446 RBU_FRWheelRotatedDirectionVD 0 "Not valid" 1 "Valid"  ;
VAL_ 446 RBU_RLWheelRotatedDirectionNEW 0 "Standstill" 1 "Forward" 2 "Backward" 3 "Unknown"  ;
VAL_ 446 RBU_RLWheelRotatedDirectionVD 0 "Not valid" 1 "Valid"  ;
VAL_ 446 RBU_RRWheelRotatedDirectionNEW 0 "Standstill" 1 "Forward" 2 "Backward" 3 "Unknown"  ;
VAL_ 446 RBU_RRWheelRotatedDirectionVD 0 "Not valid" 1 "Valid"  ;
VAL_ 446 RBU_MasterCylinderPrVD 0 "Not valid" 1 "Valid"  ;
VAL_ 446 RBU_BrkTqCtrlAvlDriving 0 "BrakeBackupStrategyAvailability_None" 1 "BrakeBackupStrategyAvailability_Full" 2 "BrakeBackupStrategyAvailability_Fault" 3 "BrakeBackupStrategyAvailability_TestPending" 4 "BrakeBackupStrategyAvailability_NotInitialized" 5 "Reserved" 6 "Reserved" 7 "Reserved"  ;
VAL_ 446 RBU_BrkTqCtrlAvlParking 0 "BrakeBackupStrategyAvailability_None" 1 "BrakeBackupStrategyAvailability_Full" 2 "BrakeBackupStrategyAvailability_Fault" 3 "BrakeBackupStrategyAvailability_TestPending" 4 "BrakeBackupStrategyAvailability_NotInitialized" 5 "Parking_Overspeed" 6 "Reserved" 7 "Reserved"  ;
VAL_ 446 RBU_BrkTqCtrlActv 0 "BrakeBackup_None" 1 "BrakeBackup_APAactive" 2 "BrakeBackup_ACCactive" 3 "Reserved"  ;
VAL_ 446 RBU_L3CommunicationInvalid 0 "Invalid" 1 "Valid"  ;
VAL_ 446 RBU_BrkPedlStsValid 0 "Invalid" 1 "Valid"  ;
VAL_ 446 RBU_BrkPedlSts 0 "Not_Pressed/Init/Default" 1 "Pressed" 2 "Reserved" 3 "Error"  ;
VAL_ 446 RBU_SBSAvailability 0 "Not Available" 1 "Available"  ;
VAL_ 446 RBU_SBSActive 0 "Not Active" 1 "Active"  ;
VAL_ 446 RBU_ParkBrakeCapability 0 "None" 1 "Reduced" 2 "Full" 3 "Reserved"  ;
VAL_ 446 RBU_DrvrTqDesVld 0 "Invalid" 1 "Valid"  ;
VAL_ 446 RBU_BrkActvTqValid 0 "Invalid" 1 "Valid"  ;
VAL_ 446 RBU_NetModeResp 0 "None" 1 "Main/sub Net active" 2 "Main/sub Net active with error" 3 "Reserved"  ;
VAL_ 446 RBU_DrvrBrkOvrdVld 0 "Invalid" 1 "Valid"  ;
VAL_ 446 RBU_DrvrBrkOvrd 0 "Not override" 1 "Override"  ;
VAL_ 446 RBU_ADSNetErrFb 0 "No Error" 1 "ADS1 MainNetE2EErr" 2 "ADS1 RedundancyNetE2EErr" 3 "ADS2 MainNetE2EErr" 4 "ADS1&2 MainNetE2EErr" 5 "ADS1Main&RedundancyNetE2EErr" 6 "ADS1RedunancyNet&ADS2MainNetErr" 7 "All Error"  ;
VAL_ 446 RBU_BrkTqCtrlActv_L3 0 "None" 1 "L3 Active with error" 2 "L3 Active"  ;
VAL_ 446 RBU_BrkTqCtrlAvl_L3 0 "BrkBkpStgyAvl_None" 1 "BrkBkpStgyAvl_NotInitialized" 2 "BrkBkpStgyAvl_Fault" 3 "BrkBkpStgyAvl_TestPending" 4 "BrkBkpStgyAvl_Full"  ;
VAL_ 430 SRS_CrashOutputSt 0 "No crash,"  ;
VAL_ 430 SRS_Front_CrashOutputSt 0 "No crash,"  ;
VAL_ 430 SRS_DriverSide_CrashOutputSt 0 "No crash,"  ;
VAL_ 430 SRS_PassengerSide_CrashOutputSt 0 "No crash,"  ;
VAL_ 430 SRS_Rear_CrashOutputSt 0 "No crash,"  ;
VAL_ 430 SRS_RolloverCrashOutputSt 0 "No crash,"  ;
VAL_ 430 SRS_NearCrashOutputSt 0 "No crash," 1 "(transition lasts for 2sec)"  ;
VAL_ 430 SRS_YawSnsCalibSt 0 "Sensor Not Calibrated" 1 "Sensor Calibrated"  ;
VAL_ 430 SRS_VehLongAccelVD 0 "Initializing" 1 "Valid" 2 "Invalid" 3 "Reserved"  ;
VAL_ 430 SRS_VehLatrlAccelVD 0 "Initializing" 1 "Valid" 2 "Invalid" 3 "Reserved"  ;
VAL_ 430 SRS_YawRateVD 0 "Initializing" 1 "Valid" 2 "Invalid" 3 "Reserved"  ;
VAL_ 939 SRS_PsngrSeatBeltSt 0 "Fastened" 1 "Unfastened" 2 "Not used" 3 "Invalid"  ;
VAL_ 939 SRS_DriverSeatBeltSt 0 "Fastened" 1 "Unfastened" 2 "Not used" 3 "Invalid"  ;
VAL_ 939 SRS_RearLeftSeatBeltSt 0 "Fastened" 1 "Unfastened" 2 "Not used" 3 "Invalid"  ;
VAL_ 939 SRS_AirbagFaultSt 0 "Not fault" 1 "Fault"  ;
VAL_ 939 SRS_RearRightSeatBeltSt 0 "Fastened" 1 "Unfastened" 2 "Not used" 3 "Invalid"  ;
VAL_ 939 SRS_RearMiddleSeatBeltSt 0 "Fastened" 1 "Unfastened" 2 "Not used" 3 "Invalid"  ;
VAL_ 939 SRS_ThirdRowLeftSeatBeltSt 0 "Fastened" 1 "Unfastened" 2 "Not used" 3 "Invalid"  ;
VAL_ 939 SRS_ThirdRowRightSeatBeltSt 0 "Fastened" 1 "Unfastened" 2 "Not used" 3 "Invalid"  ;
VAL_ 939 SRS_ThirdRowMiddleSeatBeltSt 0 "Fastened" 1 "Unfastened" 2 "Not used" 3 "Invalid"  ;
