VERSION "Version"

NS_ :

BS_:

BU_: Tester CCU INU ADC RRR RLR CCURT1 CCURT2 ZCUF ZCUL ZCUR ZCUT EMS IDM DCDC DCDCI IPS NIDU DCU2 OBC OPC LPC CPC EMCM GCU DCU IPU BMS EOP EVCC DCDC2 EDL SRS ECS EPS EPB RBM IBCS ICM IID IDC AMP WHUD ARHUD IMR FIMR CD IFC FAPA PAS PCS SCMF SCMR SCMRL SCMRR MFS DRM FCP RCP LBMSAD AVAS DLPFL FBLCM FLISD FLLCM FRLCM RLLCMA RLLCMB RRLCMA RRLCMB RLISD DLPML DLPMR TRM PSDL PSDR FLDCM FRDCM HVSPRL HVSPRR RFR SBM WCM ETC TBOX2 TBOX RLBMS EBU FLPDM RLPDM FRPDM RRPDM FLOAR FROAR RLOAR RROAR EOSL EOSR EOST PRBU RT1_C0 OTAWL RT2_C3 IDUR PHUDD RAS CBM PLGM TMC LPC2 SAS RCICP SCMRM SCMT SLMRL SLMRR IDU RRISD DSASBM LBMS RT1_C1

BO_ 904 CCU_GwMsg_4: 64 CCU
 SG_ CCU_GwMsg_4_CRC : 7|16@0+ (1,0) [0|65535] ""  ADC,FAPA
 SG_ CCU_GwMsg_4_Counter : 23|8@0+ (1,0) [0|255] ""  ADC,FAPA
 SG_ HVAC_RearDefrostSt : 24|1@0+ (1,0) [0|1] ""  ADC,IFC,FAPA
 SG_ HVAC_WindExitMode : 27|3@0+ (1,0) [0|7] ""  ADC,IFC,FAPA
 SG_ HVAC_CorrectedExterTemp : 39|8@0+ (0.5,-40) [-40|87.5] "°C"  ADC,IFC,FAPA,PAS
 SG_ HVAC_CorrectedExterTempVD : 28|1@0+ (1,0) [0|1] ""  ADC,IFC,FAPA,PAS
 SG_ HVAC_CorrectedCabinTemp : 47|8@0+ (0.5,-40) [-40|87.5] "°C"  ADC,IFC,FAPA
 SG_ HVAC_CorrectedCabinTempVD : 29|1@0+ (1,0) [0|1] ""  ADC,IFC,FAPA
 SG_ WW_FwpFaultSt : 30|1@0+ (1,0) [0|1] ""  ADC,IFC,FAPA
 SG_ WW_RwpFaultSt : 31|1@0+ (1,0) [0|1] ""  ADC,IFC,FAPA
 SG_ WW_FwshFaultSt : 48|1@0+ (1,0) [0|1] ""  ADC,IFC,FAPA
 SG_ WW_RwshFaultSt : 49|1@0+ (1,0) [0|1] ""  ADC,IFC,FAPA
 SG_ WW_FwpAutoModeSt : 50|1@0+ (1,0) [0|1] ""  ADC,IFC,FAPA
 SG_ WW_RainFallLevel : 55|4@0+ (1,0) [0|15] ""  ADC,IFC,FAPA
 SG_ RLS_LightOnReq : 51|1@0+ (1,0) [0|1] ""  ADC,IFC,FAPA
 SG_ RLS_LampOnReqValid : 60|1@0+ (1,0) [0|1] ""  ADC,IFC,FAPA
 SG_ RLS_WiperSpd : 59|4@0+ (1,0) [0|15] ""  ADC,IFC,FAPA
 SG_ RLS_AMBBrightness : 69|14@0+ (6,0) [0|98286] "Lux"  ADC,IFC,FAPA
 SG_ RLS_FWBrightness : 87|14@0+ (6,0) [0|98286] ""  ADC,IFC,FAPA
 SG_ RLS_RainfallLevel : 103|4@0+ (1,0) [0|15] ""  ADC,IFC,FAPA
 SG_ RLS_RSErr : 88|1@0+ (1,0) [0|1] ""  ADC,IFC,FAPA
 SG_ RLS_LSErr : 89|1@0+ (1,0) [0|1] ""  ADC,IFC,FAPA
 SG_ PM_AUTHPstState : 70|1@0+ (1,0) [0|1] ""  ADC,IFC,FAPA
 SG_ CCU_FuncReq_SentryMod : 71|1@0+ (1,0) [0|1] ""  ADC,IFC,FAPA
 SG_ RLS_WindShieldHum : 111|8@0+ (0.5,-0.5) [0|100] "%"  ADC,IFC,FAPA
 SG_ RLS_WindShieldTem : 119|8@0+ (0.5,-40) [-40|86.5] "℃"  ADC,IFC,FAPA
 SG_ RLS_DewPoint : 127|8@0+ (0.5,-40) [-40|86.5] "℃"  ADC,IFC,FAPA
 SG_ CCU_ModeSuppressSts : 62|2@0+ (1,0) [0|2] ""  ADC,IFC,FAPA
 SG_ RLS_HUTErr : 63|1@0+ (1,0) [0|1] ""  ADC,IFC,FAPA
 SG_ SR_SunroofCurrentPst : 135|8@0+ (0.5,0) [0|255] "%"  ADC,IFC,FAPA
 SG_ EL_LeftBSDIndicatorSt : 136|1@0+ (1,0) [0|1] ""  ADC,IFC,FAPA,RRR,RLR
 SG_ UINM_HazardLightSwSt : 137|1@0+ (1,0) [0|1] ""  ADC,IFC,FAPA,RRR,RLR
 SG_ EL_MLTurnLightSt : 139|2@0+ (1,0) [0|3] ""  ADC,IFC,FAPA
 SG_ EL_MLTurnLightFaultSt : 140|1@0+ (1,0) [0|1] ""  ADC,IFC,FAPA
 SG_ EL_LeftBSDIndicatorFaultSt : 141|1@0+ (1,0) [0|1] ""  ADC,IFC,FAPA,RRR,RLR
 SG_ ZCUL_FrtWindshildHeatSt : 143|2@0+ (1,0) [0|3] ""  ADC,IFC,FAPA
 SG_ ACU_PCS_SVM_MODCmd : 96|1@0+ (1,0) [0|1] ""  ADC,IFC,FAPA
 SG_ ACU_HeadLightVirtualSwSt : 99|3@0+ (1,0) [0|7] ""  ADC,IFC,FAPA
 SG_ ACU_FrontFogLightVirtualSwSt : 144|1@0+ (1,0) [0|1] ""  ADC,IFC,FAPA
 SG_ ACU_RearFogLightVirtualSwSt : 145|1@0+ (1,0) [0|1] ""  ADC,IFC,FAPA
 SG_ ACU_Account_Uid : 151|4@0+ (1,0) [0|15] ""  ADC,IFC,FAPA
 SG_ ACU_IHBC_SwitchReq : 147|2@0+ (1,0) [0|3] ""  ADC,IFC,FAPA
 SG_ ACU_NDASwitchReq : 153|2@0+ (1,0) [0|3] ""  ADC,IFC,FAPA
 SG_ ACU_NDALCConSwitchReq : 155|2@0+ (1,0) [0|3] ""  ADC,IFC,FAPA
 SG_ ACU_NDALCStySwitchReq : 157|2@0+ (1,0) [0|3] ""  ADC,IFC,FAPA
 SG_ ACU_ADASWarnTypeSwitch : 159|2@0+ (1,0) [0|3] ""  ADC,IFC,FAPA
 SG_ ACU_iACC_StyleConfirmSwitchReq : 177|2@0+ (1,0) [0|3] ""  ADC,IFC,FAPA
 SG_ ACU_IFC_SpeedLimit : 167|8@0+ (1,0) [0|255] "km/h"  ADC,IFC,FAPA
 SG_ ACU_IFC_ISDRestOfdis : 175|8@0+ (1,0) [0|70] "km"  ADC,IFC,FAPA
 SG_ ACU_IFC_SpeedLimitUnit : 183|2@0+ (1,0) [0|3] ""  ADC,IFC,FAPA
 SG_ ACU_ThemeType : 196|1@0+ (1,0) [0|1] ""  ADC,IFC,FAPA,PCS
 SG_ ACU_IFC_SpeedLimtType : 187|4@0+ (1,0) [0|15] ""  ADC,IFC,FAPA
 SG_ ACU_IFC_RoadType : 191|4@0+ (1,0) [0|15] ""  ADC,IFC,FAPA
 SG_ ACU_IFC_ZoneCode : 199|3@0+ (1,0) [0|7] ""  ADC,IFC,FAPA
 SG_ ACU_IFC_NaviSt : 195|2@0+ (1,0) [0|3] ""  ADC,IFC,FAPA
 SG_ ACU_IFC_NaviCorp : 207|3@0+ (1,0) [0|7] ""  ADC,IFC,FAPA
 SG_ ACU_IFC_NaviNewIconDis : 204|5@0+ (0.1,0) [0|2] "km"  ADC,IFC,FAPA
 SG_ ACU_IFC_OfframpSt : 192|1@0+ (1,0) [0|1] ""  ADC,IFC,FAPA
 SG_ ACU_IFC_NaviNewIcon : 211|4@0+ (1,0) [0|15] ""  ADC,IFC,FAPA
 SG_ ACU_IFC_SLCAheadDis : 223|8@0+ (5,0) [0|1250] "m"  ADC,IFC,FAPA
 SG_ ACU_DVR_Switch : 193|1@0+ (1,0) [0|1] ""  ADC,IFC,FAPA
 SG_ ACU_IFC_OfframpDis : 231|8@0+ (10,0) [0|2000] "m"  ADC,IFC,FAPA
 SG_ SSW_FLSeatSlideCurrentPst : 239|8@0+ (0.5,0) [0|100] "%"  ADC,FAPA
 SG_ SSW_FLSeatHeightCurrentPst : 247|8@0+ (0.5,0) [0|100] "%"  ADC,FAPA
 SG_ SSW_FLSeatBackrestCurrentPst : 255|8@0+ (0.5,0) [0|100] "%"  ADC,FAPA
 SG_ DrvrSideMotResp : 263|4@0+ (1,0) [0|15] ""  ADC,IFC,FAPA
 SG_ EL_LeftLowBeamSt : 256|1@0+ (1,0) [0|1] ""  ADC,IFC,FAPA
 SG_ EL_LeftLowBeamFaultSt : 257|1@0+ (1,0) [0|1] ""  ADC,IFC,FAPA
 SG_ EL_RightLowBeamSt : 258|1@0+ (1,0) [0|1] ""  ADC,IFC,FAPA
 SG_ EL_RightLowBeamFaultSt : 259|1@0+ (1,0) [0|1] ""  ADC,IFC,FAPA
 SG_ WW_FWPMotorSt : 271|3@0+ (1,0) [0|7] ""  ADC,IFC,FAPA
 SG_ EL_MLADASLightSt : 181|2@0+ (1,0) [0|3] ""  ADC,IFC
 SG_ EL_FLTurnLightSt : 268|2@0+ (1,0) [0|3] ""  ADC,IFC,FAPA
 SG_ EL_FLTurnLightFaultSt : 266|1@0+ (1,0) [0|1] ""  ADC,IFC,FAPA
 SG_ EL_FRTurnLightSt : 265|2@0+ (1,0) [0|3] ""  ADC,IFC,FAPA
 SG_ EL_FRTurnLightFaultSt : 279|1@0+ (1,0) [0|1] ""  ADC,IFC,FAPA
 SG_ EL_SideBrkLightSt : 278|1@0+ (1,0) [0|1] ""  ADC,IFC,FAPA
 SG_ EL_SideBrkLightFaultSt : 277|1@0+ (1,0) [0|1] ""  ADC,IFC,FAPA
 SG_ EL_CHMSLSt : 276|1@0+ (1,0) [0|1] ""  ADC,IFC,FAPA
 SG_ EL_CHMSLFaultSt : 275|1@0+ (1,0) [0|1] ""  ADC,IFC,FAPA
 SG_ EL_RLTurnLightSt : 274|2@0+ (1,0) [0|3] ""  ADC,IFC,FAPA
 SG_ EL_RLTurnLightFaultSt : 272|1@0+ (1,0) [0|1] ""  ADC,IFC,FAPA,PCS
 SG_ EL_RRTurnLightSt : 287|2@0+ (1,0) [0|3] ""  ADC,IFC,FAPA
 SG_ EL_RRTurnLightFaultSt : 285|1@0+ (1,0) [0|1] ""  ADC,IFC,FAPA,PCS
 SG_ IPDS_BAT1PowerSt : 280|1@0+ (1,0) [0|1] ""  ADC,FAPA
 SG_ IPDS_BAT2PowerSt : 299|1@0+ (1,0) [0|1] ""  ADC,FAPA
 SG_ IPDS_DCDC2PowerSt : 311|1@0+ (1,0) [0|1] ""  ADC,FAPA
 SG_ IPDS_GridIsoPowerSt : 310|1@0+ (1,0) [0|1] ""  ADC,FAPA
 SG_ IPS_DCDCModeSt : 298|3@0+ (1,0) [0|7] ""  ADC,IFC,FAPA
 SG_ IPDS_FRRadarPowerSup : 309|2@0+ (1,0) [0|3] ""  ADC,IFC,FAPA
 SG_ LBMS_SOFVD : 293|1@0+ (1,0) [0|1] ""  ADC,FAPA
 SG_ LBMS_SOFEN : 295|2@0+ (1,0) [0|3] ""  ADC,FAPA
 SG_ LBMSAD_SOFVD : 290|1@0+ (1,0) [0|1] ""  ADC,FAPA
 SG_ LBMSAD_SOFEN : 292|2@0+ (1,0) [0|3] ""  ADC,FAPA
 SG_ IPDS_FLRadarPowerSup : 307|2@0+ (1,0) [0|3] ""  ADC,IFC,FAPA
 SG_ IPDS_FrontRadarPowerSup : 305|2@0+ (1,0) [0|3] ""  ADC,IFC,FAPA
 SG_ IPDS_HDMapPowerSup : 319|2@0+ (1,0) [0|3] ""  ADC,IFC,FAPA
 SG_ IPDS_RearRadarPowerSup : 317|2@0+ (1,0) [0|3] ""  ADC,IFC,FAPA

BO_ 334 CCU_15: 64 CCU
 SG_ Theft_Auth_Status : 379|12@0+ (1,0) [0|4095] ""  CCURT1,ADC,FAPA
 SG_ CSM_RC_ViewExtvideo : 215|16@0+ (1,0) [0|65535] ""  IDC,ADC,FAPA
 SG_ CSM_RC_ViewExtvideoReq : 231|1@0+ (1,0) [0|1] ""  IDC,ADC,FAPA

BO_ 777 CCU_ZCUR_4: 64 CCU
 SG_ ZCUR_4_CRC : 7|16@0+ (1,0) [0|65535] ""  ADC,IFC,FAPA
 SG_ ZCUR_4_Counter : 23|8@0+ (1,0) [0|255] ""  ADC,IFC,FAPA
 SG_ EL_MRADASLightSt : 113|2@0+ (1,0) [0|3] ""  ADC,IFC
 SG_ MR_RightMirrorFoldUnfoldSt : 199|2@0+ (1,0) [0|3] ""  IDC,ADC,IFC,FAPA,PCS
 SG_ PWL_WinCurrentPos_FRWinPst : 303|8@0+ (0.5,0) [0|100] "％"  OTAWL,ZCUR,IDC,AMP,IMR,FIMR,ADC,FAPA
 SG_ EL_MRTurnLightSt : 325|2@0+ (1,0) [0|3] ""  ICM,IDC,ADC,IFC,FAPA
 SG_ EL_MRTurnLightFaultSt : 323|1@0+ (1,0) [0|1] ""  ICM,IDC,ADC,IFC,FAPA
 SG_ KAE_toADCDRVUnlockSensorSt : 328|1@0+ (1,0) [0|1] ""  OTAWL,ADC,FAPA
 SG_ KAE_toADCDRVLockSensorSt : 360|1@0+ (1,0) [0|1] ""  OTAWL,ADC,FAPA
 SG_ EL_RightBSDIndicatorSt : 353|1@0+ (1,0) [0|1] ""  ADC,IFC,FAPA
 SG_ EL_RightBSDIndicatorFaultSt : 352|1@0+ (1,0) [0|1] ""  ADC,IFC,FAPA

BO_ 342 CCU_ZCUR_8: 64 CCU
 SG_ ZCUR_8_CRC : 7|16@0+ (1,0) [0|65535] ""  OTAWL,ADC,IFC,FAPA
 SG_ ZCUR_8_Counter : 23|8@0+ (1,0) [0|255] ""  OTAWL,ADC,IFC,FAPA
 SG_ KAE_PassiveUnlockReq : 25|1@0+ (1,0) [0|1] ""  OTAWL,ADC,FAPA
 SG_ KAE_PassiveLockReq : 38|1@0+ (1,0) [0|1] ""  OTAWL,ADC,FAPA
 SG_ KAE_FOB1Position : 111|4@0+ (1,0) [0|15] ""  OTAWL,ADC,FAPA
 SG_ KAE_FOB2Position : 107|4@0+ (1,0) [0|15] ""  OTAWL,ADC,FAPA
 SG_ KAE_FOB3Position : 119|4@0+ (1,0) [0|15] ""  OTAWL,ADC,FAPA
 SG_ KAE_FOB2UnlockBtnPressS : 177|2@0+ (1,0) [0|3] ""  OTAWL,ADC,FAPA
 SG_ KAE_FOB2LockBtnPressSt : 179|2@0+ (1,0) [0|3] ""  OTAWL,ADC,FAPA
 SG_ KAE_FOB2TrunkBtnPressSt : 187|2@0+ (1,0) [0|3] ""  OTAWL,ADC,FAPA
 SG_ KAE_FOB2User_definedBtnPressSt : 191|2@0+ (1,0) [0|3] ""  OTAWL,ADC,FAPA
 SG_ KAE_FOB3UnlockBtnPressS : 169|2@0+ (1,0) [0|3] ""  OTAWL,ADC,FAPA
 SG_ KAE_FOB3LockBtnPressSt : 171|2@0+ (1,0) [0|3] ""  OTAWL,ADC,FAPA
 SG_ KAE_FOB3TrunkBinPressSt : 173|2@0+ (1,0) [0|3] ""  OTAWL,ADC,FAPA
 SG_ KAE_FOB3User_defnedBtnPressst : 175|2@0+ (1,0) [0|3] ""  OTAWL,ADC,FAPA
 SG_ KAE_FOBUnlockBtnPressSt : 199|2@0+ (1,0) [0|3] ""  OTAWL,ICM,IDC,ADC,IFC,FAPA
 SG_ KAE_FOBLockBtnPressSt : 197|2@0+ (1,0) [0|3] ""  OTAWL,ICM,IDC,ADC,IFC,FAPA
 SG_ KAE_FOBRESBtnPressSt : 195|2@0+ (1,0) [0|3] ""  OTAWL,ICM,IDC,ADC,IFC,FAPA
 SG_ KAE_FOBPSD_LBtnPressSt : 193|2@0+ (1,0) [0|3] ""  OTAWL,ICM,IDC,ADC,IFC,FAPA
 SG_ KAE_FOBPSD_RBtnPressSt : 207|2@0+ (1,0) [0|3] ""  OTAWL,ICM,IDC,ADC,IFC,FAPA
 SG_ KAE_FOBTrunkBtnPressSt : 205|2@0+ (1,0) [0|3] ""  OTAWL,ICM,IDC,ADC,IFC,FAPA
 SG_ KAE_FOBPanicBtnPressSt : 203|2@0+ (1,0) [0|3] ""  OTAWL,ICM,IDC,ADC,IFC,FAPA
 SG_ KAE_FOBUser_definedBtnPressSt : 201|2@0+ (1,0) [0|3] ""  OTAWL,ICM,IDC,ADC,IFC,FAPA
 SG_ KAE_FOB2RESBtnPressSt : 181|2@0+ (1,0) [0|3] ""  OTAWL,ADC,FAPA
 SG_ KAE_FOB2PanicBtnPressSt : 189|2@0+ (1,0) [0|3] ""  OTAWL,ADC,FAPA

BO_ 512 CCU_ZCUR_SBM_2: 64 CCU
 SG_ KAE_BLE1Position : 31|3@0+ (1,0) [0|7] ""  OTAWL,ADC,FAPA
 SG_ KAE_BLE2Position : 28|3@0+ (1,0) [0|7] ""  OTAWL,ADC,FAPA
 SG_ KAE_BLE3Position : 39|3@0+ (1,0) [0|7] ""  OTAWL,ADC,FAPA
 SG_ KAE_BLE4Position : 36|3@0+ (1,0) [0|7] ""  OTAWL,ADC,FAPA
 SG_ KAE_BLE5Position : 47|3@0+ (1,0) [0|7] ""  OTAWL,ADC,FAPA
 SG_ KAE_BLE1AuthSt : 137|2@0+ (1,0) [0|3] ""  OTAWL,ADC
 SG_ KAE_BLE2AuthSt : 151|2@0+ (1,0) [0|3] ""  OTAWL,ADC
 SG_ KAE_BLE3AuthSt : 149|2@0+ (1,0) [0|3] ""  OTAWL,ADC
 SG_ KAE_BLE4AuthSt : 147|2@0+ (1,0) [0|3] ""  OTAWL,ADC
 SG_ KAE_BLE5AuthSt : 145|2@0+ (1,0) [0|3] ""  OTAWL,ADC
 SG_ KAE_BLE1PKSPosition : 420|3@0+ (1,0) [0|7] ""  OTAWL,ADC
 SG_ KAE_BLE2PKSPosition : 423|3@0+ (1,0) [0|7] ""  OTAWL,ADC
 SG_ KAE_BLE3PKSPosition : 427|3@0+ (1,0) [0|7] ""  OTAWL,ADC
 SG_ KAE_BLE4PKSPosition : 430|3@0+ (1,0) [0|7] ""  OTAWL,ADC
 SG_ KAE_BLE5PKSPosition : 417|3@0+ (1,0) [0|7] ""  OTAWL,ADC

BO_ 909 CCU_ZCU_1: 64 CCU
 SG_ LCK_HoodAjarSt : 37|1@0+ (1,0) [0|1] ""  OTAWL,ZCUR,EMS,ECS,ICM,IID,IDC,PHUDD,AMP,ADC,IFC,FAPA,RRR,RLR,PCS
 SG_ LCK_FrontLeftDoorAjarSt : 36|1@0+ (1,0) [0|1] ""  OTAWL,ZCUF,ZCUR,ZCUT,EPB,IBCS,ICM,IID,IDC,PHUDD,AMP,IMR,FIMR,ADC,IFC,FAPA,RRR,RLR,DLPML,DLPMR,PLGM,PRBU
 SG_ LCK_FrontRightDoorAjarSt : 35|1@0+ (1,0) [0|1] ""  ZCUT,IBCS,ICM,IID,IDC,PHUDD,AMP,IMR,FIMR,ADC,IFC,FAPA,RRR,RLR,DLPML,DLPMR,PLGM,PRBU
 SG_ LCK_RearLeftDoorAjarSt : 34|1@0+ (1,0) [0|1] ""  OTAWL,ZCUL,ZCUR,ECS,IBCS,ICM,IID,IDC,PHUDD,AMP,IMR,FIMR,ADC,IFC,FAPA,RRR,RLR,PCS,DLPML,DLPMR,PLGM,PRBU
 SG_ LCK_RearRightDoorAjarSt : 33|1@0+ (1,0) [0|1] ""  OTAWL,ZCUL,ZCUR,ECS,IBCS,ICM,IID,IDC,AMP,IMR,FIMR,ADC,IFC,FAPA,RRR,RLR,PCS,DLPML,DLPMR,PLGM,PRBU
 SG_ LCK_TrunkAjarSt : 32|1@0+ (1,0) [0|1] ""  OTAWL,ZCUF,ZCUL,ZCUR,ECS,ICM,IID,IDC,AMP,IMR,FIMR,ADC,IFC,FAPA,RRR,RLR,PCS
 SG_ LCK_FrontLeftDoorLockSt : 47|1@0+ (1,0) [0|1] ""  OTAWL,ZCUR,CBM,ICM,IDC,ADC,IFC,FAPA,RRR,RLR,LBMS,FLPDM,RLPDM,FRPDM,RRPDM,PRBU
 SG_ LCK_FrontRightDoorLockSt : 46|1@0+ (1,0) [0|1] ""  CBM,ICM,IDC,ADC,IFC,FAPA,RRR,RLR,LBMS,FLPDM,RLPDM,FRPDM,RRPDM,PRBU
 SG_ LCK_RearLeftDoorLockSt : 45|1@0+ (1,0) [0|1] ""  OTAWL,ZCUL,ZCUR,ECS,CBM,ICM,IDC,ADC,IFC,FAPA,RRR,RLR,LBMS,FLPDM,RLPDM,FRPDM,RRPDM,PRBU
 SG_ LCK_RearRightDoorLockSt : 44|1@0+ (1,0) [0|1] ""  OTAWL,ZCUL,ZCUR,ECS,CBM,ICM,IDC,ADC,IFC,FAPA,RRR,RLR,LBMS,FLPDM,RLPDM,FRPDM,RRPDM,PRBU
 SG_ LCK_RearLeftChildSaftyLockSt : 43|1@0+ (1,0) [0|1] ""  ZCUL,ZCUR,CBM,ICM,IDC,ADC,IFC,FAPA,RRR,RLR,LBMS,RLPDM,RRPDM
 SG_ LCK_RearRightChildSaftyLockSt : 42|1@0+ (1,0) [0|1] ""  ZCUL,ZCUR,CBM,ICM,IDC,ADC,IFC,FAPA,RRR,RLR,LBMS,RLPDM,RRPDM
 SG_ EMS_EngStForPHEV : 79|3@0+ (1,0) [0|7] ""  IDC,ADC,FAPA
 SG_ WCM_Reminder : 103|1@0+ (1,0) [0|1] ""  ADC,FAPA
 SG_ WCM_ChargingSt : 89|2@0+ (1,0) [0|3] ""  ADC,FAPA
 SG_ LCK_FrontLeftDoorHandlePosition : 135|8@0+ (1,0) [0|255] ""  ICM,IDC,ADC,FAPA
 SG_ LCK_FrontRightDoorHandlePosition : 143|8@0+ (1,0) [0|255] ""  ICM,IDC,ADC,FAPA
 SG_ LCK_RearLeftDoorHandlePosition : 151|8@0+ (1,0) [0|255] ""  ZCUL,ZCUR,ICM,IDC,ADC,FAPA
 SG_ LCK_RearRightDoorHandlePosition : 159|8@0+ (1,0) [0|255] ""  ZCUL,ZCUR,ICM,IDC,ADC,FAPA
 SG_ WW_RWPMotorSt : 226|3@0+ (1,0) [0|7] ""  ADC,IFC,FAPA
 SG_ LCK_FillerCapASt : 239|1@0+ (1,0) [0|1] ""  ZCUL,ZCUR,EMS,ICM,IDC,ADC,FAPA
 SG_ LCK_FillerCapBSt : 238|1@0+ (1,0) [0|1] ""  ZCUL,ZCUR,EMS,ICM,IDC,ADC,FAPA
 SG_ AVAS_ActivatedSt : 231|3@0+ (1,0) [0|7] ""  ADC,FAPA
 SG_ MR_LeftMirrorFoldUnfoldSt : 233|2@0+ (1,0) [0|3] ""  ADC,IFC,FAPA,RRR,RLR,PCS,DLPML,DLPMR
 SG_ SBM_SwapHvBattModeSt : 247|4@0+ (1,0) [0|15] ""  ADC,FAPA
 SG_ SBM_SwapStaDiagCode : 243|4@0+ (1,0) [0|15] ""  ADC,FAPA
 SG_ SBM_SwapVehDiagCode : 255|4@0+ (1,0) [0|15] ""  ADC,FAPA
 SG_ SBM_SwapHvBattModeFaultSt : 251|3@0+ (1,0) [0|7] ""  ADC,FAPA
 SG_ IPDS_HDMapPowerSt : 271|1@0+ (1,0) [0|1] ""  ADC,IFC,FAPA
 SG_ IPDS_KL15L1PowerSt : 270|1@0+ (1,0) [0|1] ""  IBCS,ADC,IFC,FAPA,RRR,RLR
 SG_ IPDS_SRSECUPowerSt : 269|1@0+ (1,0) [0|1] ""  EPS,IBCS,ADC,IFC,FAPA
 SG_ IPDS_HODPowerSt : 268|1@0+ (1,0) [0|1] ""  ADC,IFC,FAPA
 SG_ KAE_BLEOption : 265|1@0+ (1,0) [0|1] ""  OTAWL,ADC,FAPA
 SG_ KAE_UWBOption : 264|1@0+ (1,0) [0|1] ""  OTAWL,ADC,FAPA
 SG_ PWL_WinCurrentPos_FLWinPst : 470|8@0+ (0.5,0) [0|100] "%"  ZCUT,ADC,FAPA,PLGM
 SG_ UINM_FrontLeftPowerReleaseReq : 456|1@0+ (1,0) [0|1] ""  ADC,FAPA
 SG_ UINM_FrontLeftPowerReleaseFaultSt : 457|1@0+ (1,0) [0|1] ""  ADC,FAPA
 SG_ UINM_FrontRightPowerReleaseReq : 458|1@0+ (1,0) [0|1] ""  ADC,FAPA
 SG_ UINM_FrontRightPowerReleaseFaultSt : 459|1@0+ (1,0) [0|1] ""  ADC,FAPA
 SG_ UINM_RearLeftPowerReleaseFaultSt : 460|1@0+ (1,0) [0|1] ""  ADC,FAPA
 SG_ UINM_RearLeftPowerReleaseReq : 461|1@0+ (1,0) [0|1] ""  ADC,FAPA
 SG_ UINM_RearRightPowerReleaseFaultSt : 462|1@0+ (1,0) [0|1] ""  ADC,FAPA
 SG_ UINM_RearRightPowerReleaseReq : 471|1@0+ (1,0) [0|1] ""  ADC,FAPA
 SG_ BMS_BattSOCAccurate : 478|14@0+ (0.01,0) [0|100] "%"  ADC,FAPA
 SG_ PWL_WinCurrentPos_RRWinPst : 503|8@0+ (0.5,0) [0|100] "％"  IDC,RCICP,AMP,IMR,FIMR,ADC,FAPA,PLGM
 SG_ PWL_WinCurrentPos_RLWinPst : 511|8@0+ (0.5,0) [0|100] "％"  IDC,RCICP,AMP,IMR,FIMR,ADC,FAPA,PLGM
 SG_ ACEleclocksSt : 282|3@0+ (1,0) [0|7] ""  ADC,FAPA
 SG_ DSASBM_MotResp : 375|4@0+ (1,0) [0|15] ""  ADC,FAPA
 SG_ FLISD_InteractLightSt : 382|5@0+ (1,0) [0|31] ""  ADC,IFC

BO_ 1078 CCU_ZCUR_ETC_1: 16 CCU
 SG_ ETC_GateProperty : 27|2@0+ (1,0) [0|3] ""  ICM,IDC,ADC,IFC
 SG_ ETC_TradeType : 25|2@0+ (1,0) [0|3] ""  ICM,IDC,ADC,IFC
 SG_ ETC_SystemSt : 39|1@0+ (1,0) [0|1] ""  ICM,IDC,ADC,IFC
 SG_ ETC_SysCfgst : 38|1@0+ (1,0) [0|1] ""  ICM,IDC,ADC,IFC
 SG_ ETC_ActivSt : 35|1@0+ (1,0) [0|1] ""  ICM,IDC,ADC,IFC
 SG_ ETC_TradeInfo : 47|32@0+ (0.01,0) [0|42949672.94] ""  ICM,IDC,ADC,IFC

BO_ 776 CCU_ZCUL_3: 64 CCU
 SG_ EL_LeftBSDIndicatorSt : 26|1@0+ (1,0) [0|1] ""  ADC,IFC
 SG_ UINM_HazardLightSwSt : 39|1@0+ (1,0) [0|1] ""  ICM,IDC,ADC,IFC
 SG_ EL_MLTurnLightSt : 35|2@0+ (1,0) [0|3] ""  ICM,IDC,ADC,IFC
 SG_ EL_MLTurnLightFaultSt : 33|1@0+ (1,0) [0|1] ""  ICM,IDC,ADC,IFC
 SG_ EL_LeftBSDIndicatorFaultSt : 48|1@0+ (1,0) [0|1] ""  ADC,IFC
 SG_ ZCUL_FrtWindshildHeatSt : 249|2@0+ (1,0) [0|3] ""  ADC,IFC

CM_ SG_ 904 CCU_GwMsg_4_CRC "E2E Profile 5 CRC";
CM_ SG_ 904 CCU_GwMsg_4_Counter "E2E Profile 5 Counter";
CM_ SG_ 904 HVAC_RearDefrostSt "Rear window and mirror heater activation status";
CM_ SG_ 904 HVAC_WindExitMode "The wind exit mode";
CM_ SG_ 904 HVAC_CorrectedExterTemp "Corrected External temperature";
CM_ SG_ 904 HVAC_CorrectedExterTempVD "External temperature valid data";
CM_ SG_ 904 HVAC_CorrectedCabinTemp "Corrected cabin temperature";
CM_ SG_ 904 HVAC_CorrectedCabinTempVD "Signal CorrectedCabinTemp validity";
CM_ SG_ 904 WW_FwpFaultSt "Front Wiper Fault state";
CM_ SG_ 904 WW_RwpFaultSt "Rear Wiper Fault state";
CM_ SG_ 904 WW_FwshFaultSt "Front Washer Fault state";
CM_ SG_ 904 WW_RwshFaultSt "Rear Washer Fault state";
CM_ SG_ 904 WW_FwpAutoModeSt "Front Wiper Auto Mode state";
CM_ SG_ 904 WW_RainFallLevel "Rain Fall Level";
CM_ SG_ 904 RLS_LightOnReq "Switch on/off low beam request";
CM_ SG_ 904 RLS_LampOnReqValid "Lamp On Request signal valid";
CM_ SG_ 904 RLS_WiperSpd "Wiper speed mode";
CM_ SG_ 904 RLS_AMBBrightness "Ambient Light Brightness";
CM_ SG_ 904 RLS_FWBrightness "Forward Light Brightness";
CM_ SG_ 904 RLS_RainfallLevel "Rain level";
CM_ SG_ 904 RLS_RSErr "Error status rain sensor";
CM_ SG_ 904 RLS_LSErr "Error status light sensor";
CM_ SG_ 904 PM_AUTHPstState "位置授权开关状态";
CM_ SG_ 904 CCU_FuncReq_SentryMod "Sentry Mode Wake SOC of MDC";
CM_ SG_ 904 RLS_WindShieldHum "Data windshield humidity";
CM_ SG_ 904 RLS_WindShieldTem "Temperature of the windscreen in ℃";
CM_ SG_ 904 RLS_DewPoint "Dew Temperature of the windscreen in ℃";
CM_ SG_ 904 CCU_ModeSuppressSts "Sentry Mode Suppress Status";
CM_ SG_ 904 RLS_HUTErr "HT sensor status";
CM_ SG_ 904 SR_SunroofCurrentPst "Sunroof current Position";
CM_ SG_ 904 EL_LeftBSDIndicatorSt "Left BSD indicator status";
CM_ SG_ 904 UINM_HazardLightSwSt "Hazard light switch status";
CM_ SG_ 904 EL_MLTurnLightSt "Middle left turn light status";
CM_ SG_ 904 EL_MLTurnLightFaultSt "Middle left turn light fault status";
CM_ SG_ 904 EL_LeftBSDIndicatorFaultSt "Left BSD indicator fault status";
CM_ SG_ 904 ZCUL_FrtWindshildHeatSt "Front windshield heating status";
CM_ SG_ 904 ACU_PCS_SVM_MODCmd "Panorama function setting option MOD function switch";
CM_ SG_ 904 ACU_HeadLightVirtualSwSt "HeadLight virtual switch status";
CM_ SG_ 904 ACU_FrontFogLightVirtualSwSt "Front fog light virtual switch status";
CM_ SG_ 904 ACU_RearFogLightVirtualSwSt "Rear fog light virtual switch status";
CM_ SG_ 904 ACU_Account_Uid "Account_Uid";
CM_ SG_ 904 ACU_IHBC_SwitchReq "IHBC(Intelligent High Beam Control) switch signal";
CM_ SG_ 904 ACU_NDASwitchReq "NDA main switch request";
CM_ SG_ 904 ACU_NDALCConSwitchReq "NDA lane change driver confirm switch request";
CM_ SG_ 904 ACU_NDALCStySwitchReq "NDA lane change style switch request";
CM_ SG_ 904 ACU_ADASWarnTypeSwitch "ADAS warning type switch signal";
CM_ SG_ 904 ACU_iACC_StyleConfirmSwitchReq "iACC Style confirm switch";
CM_ SG_ 904 ACU_IFC_SpeedLimit "Speed limit value from navigation map dataand GPS location.";
CM_ SG_ 904 ACU_IFC_ISDRestOfdis "Interval speed detection rest of distacne.Once navigation jduge vehicle run in aninterval speed detection area of road, thissignal begin to send specific value,otherwise keep sending 0x0.";
CM_ SG_ 904 ACU_IFC_SpeedLimitUnit "Speed limit unit ";
CM_ SG_ 904 ACU_ThemeType "AVNT theme type";
CM_ SG_ 904 ACU_IFC_SpeedLimtType "speed limit type from navigation map dataand GPS location.";
CM_ SG_ 904 ACU_IFC_RoadType "Road type from navigation map data andGPS location.";
CM_ SG_ 904 ACU_IFC_ZoneCode "Zone code ";
CM_ SG_ 904 ACU_IFC_NaviSt "Navigation state ";
CM_ SG_ 904 ACU_IFC_NaviCorp "the working navigation map corporation ";
CM_ SG_ 904 ACU_IFC_NaviNewIconDis "the remain distances of navigation newIcon ";
CM_ SG_ 904 ACU_IFC_OfframpSt "The front is off-ramp or not whennavigation";
CM_ SG_ 904 ACU_IFC_NaviNewIcon "indication the navigation newIcon ";
CM_ SG_ 904 ACU_IFC_SLCAheadDis "speed limit camera ahead distacne. Oncenavigation jduge there is a speed limitcamera ahead that the vehicle will pass by,this signal begin to send specific value,otherwise keep sending 0x0.";
CM_ SG_ 904 ACU_DVR_Switch "DVR Function Switch";
CM_ SG_ 904 ACU_IFC_OfframpDis "The distance to front off-ramp ";
CM_ SG_ 904 SSW_FLSeatSlideCurrentPst "Front Left Seat Slide Current  Position Percentage";
CM_ SG_ 904 SSW_FLSeatHeightCurrentPst "Front Left Seat Height Current  Position Percentage ";
CM_ SG_ 904 SSW_FLSeatBackrestCurrentPst "Front Left Seat Backrest Current  Position Percentage ";
CM_ SG_ 904 DrvrSideMotResp "Driver Side Seat Belt Motor Response";
CM_ SG_ 904 EL_LeftLowBeamSt "Left low beam status";
CM_ SG_ 904 EL_LeftLowBeamFaultSt "Left low beam fault status";
CM_ SG_ 904 EL_RightLowBeamSt "Right low beam status";
CM_ SG_ 904 EL_RightLowBeamFaultSt "Right low beam fault status";
CM_ SG_ 904 WW_FWPMotorSt "FrontWiper Motor status";
CM_ SG_ 904 EL_MLADASLightSt "Middle left ADAS light status";
CM_ SG_ 904 EL_FLTurnLightSt "Front left turn light status";
CM_ SG_ 904 EL_FLTurnLightFaultSt "Front left turn light fault status";
CM_ SG_ 904 EL_FRTurnLightSt "Front right turn light status";
CM_ SG_ 904 EL_FRTurnLightFaultSt "Front right turn light fault status";
CM_ SG_ 904 EL_SideBrkLightSt "Side brake light status";
CM_ SG_ 904 EL_SideBrkLightFaultSt "Side brake light fault status";
CM_ SG_ 904 EL_CHMSLSt "Centre high mounted stop lamp status";
CM_ SG_ 904 EL_CHMSLFaultSt "Centre high mounted stop lamp fault status";
CM_ SG_ 904 EL_RLTurnLightSt "Rear left turn light status";
CM_ SG_ 904 EL_RLTurnLightFaultSt "Rear left turn light fault status";
CM_ SG_ 904 EL_RRTurnLightSt "Rear right turn light status";
CM_ SG_ 904 EL_RRTurnLightFaultSt "Rear right turn light fault status";
CM_ SG_ 904 IPDS_BAT1PowerSt "BAT1 power  state";
CM_ SG_ 904 IPDS_BAT2PowerSt "BAT2 power  state";
CM_ SG_ 904 IPDS_DCDC2PowerSt "DCDC2 power  state";
CM_ SG_ 904 IPDS_GridIsoPowerSt "Grid Isolation Power State";
CM_ SG_ 904 IPS_DCDCModeSt "mode status of DCDC";
CM_ SG_ 904 IPDS_FRRadarPowerSup "FRR radar power supply";
CM_ SG_ 904 LBMS_SOFVD "LBMS Validity of SOF";
CM_ SG_ 904 LBMS_SOFEN "LBMS  State of Function Enable";
CM_ SG_ 904 LBMSAD_SOFVD "LBMSAD Validity of SOF";
CM_ SG_ 904 LBMSAD_SOFEN "LBMSAD  State of Function Enable";
CM_ SG_ 904 IPDS_FLRadarPowerSup "FLR radar power supply";
CM_ SG_ 904 IPDS_FrontRadarPowerSup "Front radar power supply";
CM_ SG_ 904 IPDS_HDMapPowerSup "HD map power supply";
CM_ SG_ 904 IPDS_RearRadarPowerSup "Rear radar power supply";
CM_ SG_ 334 Theft_Auth_Status "Anti-theft authentication result";
CM_ SG_ 334 CSM_RC_ViewExtvideo "View Exterior-car video remotely (远程查看车外视频)";
CM_ SG_ 334 CSM_RC_ViewExtvideoReq "View Exterior-car video remotely Request (远程查看车外视频请求信号)";
CM_ SG_ 777 ZCUR_4_CRC "E2E Profile 5 CRC";
CM_ SG_ 777 ZCUR_4_Counter "E2E Profile 5 Counter";
CM_ SG_ 777 EL_MRADASLightSt "Middle right ADAS light status";
CM_ SG_ 777 MR_RightMirrorFoldUnfoldSt "Right Mirror Fold Unfold Status";
CM_ SG_ 777 PWL_WinCurrentPos_FRWinPst "Front Right Window Current Position";
CM_ SG_ 777 EL_MRTurnLightSt "Middle right turn light status";
CM_ SG_ 777 EL_MRTurnLightFaultSt "Middle right turn light fault status";
CM_ SG_ 777 KAE_toADCDRVUnlockSensorSt "Driver Capa Unlock Switch Status";
CM_ SG_ 777 KAE_toADCDRVLockSensorSt "Driver Capa Lock Switch Status";
CM_ SG_ 777 EL_RightBSDIndicatorSt "Right BSD indicator status";
CM_ SG_ 777 EL_RightBSDIndicatorFaultSt "Right BSD indicator fault status";
CM_ SG_ 342 ZCUR_8_CRC "E2E Profile 5 CRC";
CM_ SG_ 342 ZCUR_8_Counter "E2E Profile 5 Counter";
CM_ SG_ 342 KAE_PassiveUnlockReq " Passive Unlock Request";
CM_ SG_ 342 KAE_PassiveLockReq "Passive Lock Request";
CM_ SG_ 342 KAE_FOB1Position " FOB1 Position";
CM_ SG_ 342 KAE_FOB2Position " FOB2 Position";
CM_ SG_ 342 KAE_FOB3Position " FOB3 Position";
CM_ SG_ 342 KAE_FOB2UnlockBtnPressS "FOB2 Unlock Button Pressed Status";
CM_ SG_ 342 KAE_FOB2LockBtnPressSt "FOB2 Lock Button Pressed Status";
CM_ SG_ 342 KAE_FOB2TrunkBtnPressSt "FOB2 Trunk Button Status";
CM_ SG_ 342 KAE_FOB2User_definedBtnPressSt "FOB2 User_defined Button Status";
CM_ SG_ 342 KAE_FOB3UnlockBtnPressS "FOB3 Unlock Button Pressed Status";
CM_ SG_ 342 KAE_FOB3LockBtnPressSt "FOB3 Lock Button Pressed Status";
CM_ SG_ 342 KAE_FOB3TrunkBinPressSt "FOB3 Trunk Button Status";
CM_ SG_ 342 KAE_FOB3User_defnedBtnPressst "FOB3 User_defined Button Status";
CM_ SG_ 342 KAE_FOBUnlockBtnPressSt "FOB Unlock Button Pressed Status";
CM_ SG_ 342 KAE_FOBLockBtnPressSt "FOB Lock Button Pressed Status";
CM_ SG_ 342 KAE_FOBRESBtnPressSt "FOB RES Button Status";
CM_ SG_ 342 KAE_FOBPSD_LBtnPressSt "FOB PSD_L Button Status";
CM_ SG_ 342 KAE_FOBPSD_RBtnPressSt "FOB PSD_R Button Status";
CM_ SG_ 342 KAE_FOBTrunkBtnPressSt "FOB Trunk Button Status";
CM_ SG_ 342 KAE_FOBPanicBtnPressSt "FOB Panic Button Status";
CM_ SG_ 342 KAE_FOBUser_definedBtnPressSt "FOB User_defined Button Status";
CM_ SG_ 342 KAE_FOB2RESBtnPressSt "FOB2 RES Button Status";
CM_ SG_ 342 KAE_FOB2PanicBtnPressSt "FOB2 Panic Button Status";
CM_ SG_ 512 KAE_BLE1Position "BLE Channel1 Key Position";
CM_ SG_ 512 KAE_BLE2Position "BLE Channel2 Key Position ";
CM_ SG_ 512 KAE_BLE3Position "BLE Channel3 Key Position ";
CM_ SG_ 512 KAE_BLE4Position "BLE Channel4 Key Position";
CM_ SG_ 512 KAE_BLE5Position "BLE Channel5 Key Position ";
CM_ SG_ 512 KAE_BLE1AuthSt "BLE Channel1 Authentication Stauts";
CM_ SG_ 512 KAE_BLE2AuthSt "BLE Channel2 Authentication Stauts";
CM_ SG_ 512 KAE_BLE3AuthSt "BLE Channel3 Authentication Stauts";
CM_ SG_ 512 KAE_BLE4AuthSt "BLE Channel4 Authentication Stauts";
CM_ SG_ 512 KAE_BLE5AuthSt "BLE Channel5 Authentication Stauts";
CM_ SG_ 512 KAE_BLE1PKSPosition "BLE Channel1 Key PKS Position";
CM_ SG_ 512 KAE_BLE2PKSPosition "BLE Channel2 Key PKS Position";
CM_ SG_ 512 KAE_BLE3PKSPosition "BLE Channel3 Key PKS Position";
CM_ SG_ 512 KAE_BLE4PKSPosition "BLE Channel4 Key PKS Position";
CM_ SG_ 512 KAE_BLE5PKSPosition "BLE Channel5 Key PKS Position";
CM_ SG_ 909 LCK_HoodAjarSt "HoodAjarSt";
CM_ SG_ 909 LCK_FrontLeftDoorAjarSt "FrontLeftDoorAjarSt";
CM_ SG_ 909 LCK_FrontRightDoorAjarSt "FrontRightDoorAjarSt";
CM_ SG_ 909 LCK_RearLeftDoorAjarSt "RearLeftDoorAjarSt";
CM_ SG_ 909 LCK_RearRightDoorAjarSt "RearRightDoorAjarSt";
CM_ SG_ 909 LCK_TrunkAjarSt "TrunkAjarSt";
CM_ SG_ 909 LCK_FrontLeftDoorLockSt "FrontLeftDoorLockSt";
CM_ SG_ 909 LCK_FrontRightDoorLockSt "FrontRightDoorLockSt";
CM_ SG_ 909 LCK_RearLeftDoorLockSt "RearLeftDoorLockSt";
CM_ SG_ 909 LCK_RearRightDoorLockSt "RearRightDoorLockSt";
CM_ SG_ 909 LCK_RearLeftChildSaftyLockSt "RearLeftChildSaftyLockSt";
CM_ SG_ 909 LCK_RearRightChildSaftyLockSt "RearRightChildSaftyLockSt";
CM_ SG_ 909 EMS_EngStForPHEV "Engine running status for PHEV";
CM_ SG_ 909 WCM_Reminder "Reminder the Phone lft";
CM_ SG_ 909 WCM_ChargingSt "Changing is ongoing or stopped";
CM_ SG_ 909 LCK_FrontLeftDoorHandlePosition "FrontLeftDoorHandlePosition";
CM_ SG_ 909 LCK_FrontRightDoorHandlePosition "FrontRightDoorHandlePosition";
CM_ SG_ 909 LCK_RearLeftDoorHandlePosition "RearLeftDoorHandlePosition";
CM_ SG_ 909 LCK_RearRightDoorHandlePosition "RearRightDoorHandlePosition";
CM_ SG_ 909 WW_RWPMotorSt "RearWiper Motor status";
CM_ SG_ 909 LCK_FillerCapASt "FillerCapASt";
CM_ SG_ 909 LCK_FillerCapBSt "FillerCapBSt";
CM_ SG_ 909 AVAS_ActivatedSt "AVAS activated status";
CM_ SG_ 909 MR_LeftMirrorFoldUnfoldSt "Left Mirror Fold Unfold Status";
CM_ SG_ 909 SBM_SwapHvBattModeSt "Swap station mode statue";
CM_ SG_ 909 SBM_SwapStaDiagCode "Swap station erroe";
CM_ SG_ 909 SBM_SwapVehDiagCode "vehicl erroe in swap station";
CM_ SG_ 909 SBM_SwapHvBattModeFaultSt "Swap station mode fault statue";
CM_ SG_ 909 IPDS_HDMapPowerSt "HD map power state";
CM_ SG_ 909 IPDS_KL15L1PowerSt "KL15 L1 power state";
CM_ SG_ 909 IPDS_SRSECUPowerSt "SRS ECU power state";
CM_ SG_ 909 IPDS_HODPowerSt "HOD power state";
CM_ SG_ 909 KAE_BLEOption "BLEOption";
CM_ SG_ 909 KAE_UWBOption "UWB Option";
CM_ SG_ 909 PWL_WinCurrentPos_FLWinPst "Window Current Position Front left Window";
CM_ SG_ 909 UINM_FrontLeftPowerReleaseReq "FrontLeftPowerReleaseReq";
CM_ SG_ 909 UINM_FrontLeftPowerReleaseFaultSt "Front Left Power Release Swtich fault state";
CM_ SG_ 909 UINM_FrontRightPowerReleaseReq "FrontRightPowerReleaseReq";
CM_ SG_ 909 UINM_FrontRightPowerReleaseFaultSt "Front Right Power Release Swtich fault state";
CM_ SG_ 909 UINM_RearLeftPowerReleaseFaultSt "RearLeftPowerReleaseReq";
CM_ SG_ 909 UINM_RearLeftPowerReleaseReq "RearLeftPowerReleaseReq";
CM_ SG_ 909 UINM_RearRightPowerReleaseFaultSt "RearRightPowerReleaseReq";
CM_ SG_ 909 UINM_RearRightPowerReleaseReq "RearRightPowerReleaseReq";
CM_ SG_ 909 BMS_BattSOCAccurate "Accurate SOC Value sent to other contoller";
CM_ SG_ 909 PWL_WinCurrentPos_RRWinPst "Rear Right Window Current Position";
CM_ SG_ 909 PWL_WinCurrentPos_RLWinPst "Rear Left Window Current Position";
CM_ SG_ 909 ACEleclocksSt "AC gun electronic lock status feedback";
CM_ SG_ 909 DSASBM_MotResp "Driver Side Active Seat Belt Motor Response";
CM_ SG_ 909 FLISD_InteractLightSt "Front left Intelligent signal display Interact light status";
CM_ SG_ 1078 ETC_GateProperty "RSU gate property";
CM_ SG_ 1078 ETC_TradeType "RSU trade type";
CM_ SG_ 1078 ETC_SystemSt "OBU System status";
CM_ SG_ 1078 ETC_SysCfgst "ETC System Enable & Disable configuration status";
CM_ SG_ 1078 ETC_ActivSt "OBU Activate status";
CM_ SG_ 1078 ETC_TradeInfo "Trade infomation";
CM_ SG_ 776 EL_LeftBSDIndicatorSt "Left BSD indicator status";
CM_ SG_ 776 UINM_HazardLightSwSt "Hazard light switch status";
CM_ SG_ 776 EL_MLTurnLightSt "Middle left turn light status";
CM_ SG_ 776 EL_MLTurnLightFaultSt "Middle left turn light fault status";
CM_ SG_ 776 EL_LeftBSDIndicatorFaultSt "Left BSD indicator fault status";
CM_ SG_ 776 ZCUL_FrtWindshildHeatSt "Front windshield heating status";

BA_DEF_ BO_  "GenMsgCycleTime" INT 0 0;
BA_DEF_ BO_  "GenMsgCycleTimeFast" INT 0 0;
BA_DEF_ BO_  "GenMsgSendType" ENUM  "Periodic","Event","IfActive","POE","PA","FixedPeriodic","Event","EnabledPeriodic","NotUsed","NotUsed","EventPeriodic","NotUsed","NotUsed","NoMsgSendType";
BA_DEF_ BO_  "VFrameFormat" ENUM  "StandardCAN","ExtendedCAN","reserved","reserved","reserved","reserved","reserved","reserved","reserved","reserved","reserved","reserved","reserved","reserved","StandardCAN_FD","ExtendedCAN_FD";
BA_DEF_ BO_  "CANFD_BRS" ENUM  "0","1";
BA_DEF_ SG_  "EventCommandSignal" ENUM  "No","Yes";
BA_DEF_ SG_  "GatewayedSignals" ENUM  "No","Yes";
BA_DEF_ SG_  "GenSigInactiveValue" HEX 0 0;
BA_DEF_ SG_  "GenSigInvalidValue" HEX 0 0;
BA_DEF_ SG_  "GenSigSendType" ENUM  "Trigger","Passive","Cyclic","OnWrite","OnWriteWithRepetition","OnChange","OnChangeWithRepetition","IfActive","IfActiveWithRepetition","NoSigSendType";
BA_DEF_ SG_  "GenSigStartValue" HEX 0 0;
BA_DEF_ SG_  "GenSigTimeoutValue" HEX 0 0;
BA_DEF_ SG_  "Remark" STRING ;
BA_ "GenMsgCycleTime" BO_ 904 100;
BA_ "GenMsgCycleTimeFast" BO_ 904 0;
BA_ "GenMsgSendType" BO_ 904 0;
BA_ "VFrameFormat" BO_ 904 14;
BA_ "CANFD_BRS" BO_ 904 1;
BA_ "GenMsgCycleTime" BO_ 904 100;
BA_ "GenMsgCycleTimeFast" BO_ 904 0;
BA_ "GenMsgSendType" BO_ 904 0;
BA_ "VFrameFormat" BO_ 904 14;
BA_ "CANFD_BRS" BO_ 904 1;
BA_ "GenMsgCycleTime" BO_ 904 100;
BA_ "GenMsgCycleTimeFast" BO_ 904 0;
BA_ "GenMsgSendType" BO_ 904 0;
BA_ "VFrameFormat" BO_ 904 14;
BA_ "CANFD_BRS" BO_ 904 1;
BA_ "GenMsgCycleTime" BO_ 904 100;
BA_ "GenMsgCycleTimeFast" BO_ 904 0;
BA_ "GenMsgSendType" BO_ 904 0;
BA_ "VFrameFormat" BO_ 904 14;
BA_ "CANFD_BRS" BO_ 904 1;
BA_ "GenMsgCycleTime" BO_ 904 100;
BA_ "GenMsgCycleTimeFast" BO_ 904 0;
BA_ "GenMsgSendType" BO_ 904 0;
BA_ "VFrameFormat" BO_ 904 14;
BA_ "CANFD_BRS" BO_ 904 1;
BA_ "GenMsgCycleTime" BO_ 904 100;
BA_ "GenMsgCycleTimeFast" BO_ 904 0;
BA_ "GenMsgSendType" BO_ 904 0;
BA_ "VFrameFormat" BO_ 904 14;
BA_ "CANFD_BRS" BO_ 904 1;
BA_ "GenMsgCycleTime" BO_ 904 100;
BA_ "GenMsgCycleTimeFast" BO_ 904 0;
BA_ "GenMsgSendType" BO_ 904 0;
BA_ "VFrameFormat" BO_ 904 14;
BA_ "CANFD_BRS" BO_ 904 1;
BA_ "GenMsgCycleTime" BO_ 904 100;
BA_ "GenMsgCycleTimeFast" BO_ 904 0;
BA_ "GenMsgSendType" BO_ 904 0;
BA_ "VFrameFormat" BO_ 904 14;
BA_ "CANFD_BRS" BO_ 904 1;
BA_ "GenMsgCycleTime" BO_ 904 100;
BA_ "GenMsgCycleTimeFast" BO_ 904 0;
BA_ "GenMsgSendType" BO_ 904 0;
BA_ "VFrameFormat" BO_ 904 14;
BA_ "CANFD_BRS" BO_ 904 1;
BA_ "GenMsgCycleTime" BO_ 904 100;
BA_ "GenMsgCycleTimeFast" BO_ 904 0;
BA_ "GenMsgSendType" BO_ 904 0;
BA_ "VFrameFormat" BO_ 904 14;
BA_ "CANFD_BRS" BO_ 904 1;
BA_ "GenMsgCycleTime" BO_ 904 100;
BA_ "GenMsgCycleTimeFast" BO_ 904 0;
BA_ "GenMsgSendType" BO_ 904 0;
BA_ "VFrameFormat" BO_ 904 14;
BA_ "CANFD_BRS" BO_ 904 1;
BA_ "GenMsgCycleTime" BO_ 904 100;
BA_ "GenMsgCycleTimeFast" BO_ 904 0;
BA_ "GenMsgSendType" BO_ 904 0;
BA_ "VFrameFormat" BO_ 904 14;
BA_ "CANFD_BRS" BO_ 904 1;
BA_ "GenMsgCycleTime" BO_ 904 100;
BA_ "GenMsgCycleTimeFast" BO_ 904 0;
BA_ "GenMsgSendType" BO_ 904 0;
BA_ "VFrameFormat" BO_ 904 14;
BA_ "CANFD_BRS" BO_ 904 1;
BA_ "GenMsgCycleTime" BO_ 904 100;
BA_ "GenMsgCycleTimeFast" BO_ 904 0;
BA_ "GenMsgSendType" BO_ 904 0;
BA_ "VFrameFormat" BO_ 904 14;
BA_ "CANFD_BRS" BO_ 904 1;
BA_ "GenMsgCycleTime" BO_ 904 100;
BA_ "GenMsgCycleTimeFast" BO_ 904 0;
BA_ "GenMsgSendType" BO_ 904 0;
BA_ "VFrameFormat" BO_ 904 14;
BA_ "CANFD_BRS" BO_ 904 1;
BA_ "GenMsgCycleTime" BO_ 904 100;
BA_ "GenMsgCycleTimeFast" BO_ 904 0;
BA_ "GenMsgSendType" BO_ 904 0;
BA_ "VFrameFormat" BO_ 904 14;
BA_ "CANFD_BRS" BO_ 904 1;
BA_ "GenMsgCycleTime" BO_ 904 100;
BA_ "GenMsgCycleTimeFast" BO_ 904 0;
BA_ "GenMsgSendType" BO_ 904 0;
BA_ "VFrameFormat" BO_ 904 14;
BA_ "CANFD_BRS" BO_ 904 1;
BA_ "GenMsgCycleTime" BO_ 904 100;
BA_ "GenMsgCycleTimeFast" BO_ 904 0;
BA_ "GenMsgSendType" BO_ 904 0;
BA_ "VFrameFormat" BO_ 904 14;
BA_ "CANFD_BRS" BO_ 904 1;
BA_ "GenMsgCycleTime" BO_ 904 100;
BA_ "GenMsgCycleTimeFast" BO_ 904 0;
BA_ "GenMsgSendType" BO_ 904 0;
BA_ "VFrameFormat" BO_ 904 14;
BA_ "CANFD_BRS" BO_ 904 1;
BA_ "GenMsgCycleTime" BO_ 904 100;
BA_ "GenMsgCycleTimeFast" BO_ 904 0;
BA_ "GenMsgSendType" BO_ 904 0;
BA_ "VFrameFormat" BO_ 904 14;
BA_ "CANFD_BRS" BO_ 904 1;
BA_ "GenMsgCycleTime" BO_ 904 100;
BA_ "GenMsgCycleTimeFast" BO_ 904 0;
BA_ "GenMsgSendType" BO_ 904 0;
BA_ "VFrameFormat" BO_ 904 14;
BA_ "CANFD_BRS" BO_ 904 1;
BA_ "GenMsgCycleTime" BO_ 904 100;
BA_ "GenMsgCycleTimeFast" BO_ 904 0;
BA_ "GenMsgSendType" BO_ 904 0;
BA_ "VFrameFormat" BO_ 904 14;
BA_ "CANFD_BRS" BO_ 904 1;
BA_ "GenMsgCycleTime" BO_ 904 100;
BA_ "GenMsgCycleTimeFast" BO_ 904 0;
BA_ "GenMsgSendType" BO_ 904 0;
BA_ "VFrameFormat" BO_ 904 14;
BA_ "CANFD_BRS" BO_ 904 1;
BA_ "GenMsgCycleTime" BO_ 904 100;
BA_ "GenMsgCycleTimeFast" BO_ 904 0;
BA_ "GenMsgSendType" BO_ 904 0;
BA_ "VFrameFormat" BO_ 904 14;
BA_ "CANFD_BRS" BO_ 904 1;
BA_ "GenMsgCycleTime" BO_ 904 100;
BA_ "GenMsgCycleTimeFast" BO_ 904 0;
BA_ "GenMsgSendType" BO_ 904 0;
BA_ "VFrameFormat" BO_ 904 14;
BA_ "CANFD_BRS" BO_ 904 1;
BA_ "GenMsgCycleTime" BO_ 904 100;
BA_ "GenMsgCycleTimeFast" BO_ 904 0;
BA_ "GenMsgSendType" BO_ 904 0;
BA_ "VFrameFormat" BO_ 904 14;
BA_ "CANFD_BRS" BO_ 904 1;
BA_ "GenMsgCycleTime" BO_ 904 100;
BA_ "GenMsgCycleTimeFast" BO_ 904 0;
BA_ "GenMsgSendType" BO_ 904 0;
BA_ "VFrameFormat" BO_ 904 14;
BA_ "CANFD_BRS" BO_ 904 1;
BA_ "GenMsgCycleTime" BO_ 904 100;
BA_ "GenMsgCycleTimeFast" BO_ 904 0;
BA_ "GenMsgSendType" BO_ 904 0;
BA_ "VFrameFormat" BO_ 904 14;
BA_ "CANFD_BRS" BO_ 904 1;
BA_ "GenMsgCycleTime" BO_ 904 100;
BA_ "GenMsgCycleTimeFast" BO_ 904 0;
BA_ "GenMsgSendType" BO_ 904 0;
BA_ "VFrameFormat" BO_ 904 14;
BA_ "CANFD_BRS" BO_ 904 1;
BA_ "GenMsgCycleTime" BO_ 904 100;
BA_ "GenMsgCycleTimeFast" BO_ 904 0;
BA_ "GenMsgSendType" BO_ 904 0;
BA_ "VFrameFormat" BO_ 904 14;
BA_ "CANFD_BRS" BO_ 904 1;
BA_ "GenMsgCycleTime" BO_ 904 100;
BA_ "GenMsgCycleTimeFast" BO_ 904 0;
BA_ "GenMsgSendType" BO_ 904 0;
BA_ "VFrameFormat" BO_ 904 14;
BA_ "CANFD_BRS" BO_ 904 1;
BA_ "GenMsgCycleTime" BO_ 904 100;
BA_ "GenMsgCycleTimeFast" BO_ 904 0;
BA_ "GenMsgSendType" BO_ 904 0;
BA_ "VFrameFormat" BO_ 904 14;
BA_ "CANFD_BRS" BO_ 904 1;
BA_ "GenMsgCycleTime" BO_ 904 100;
BA_ "GenMsgCycleTimeFast" BO_ 904 0;
BA_ "GenMsgSendType" BO_ 904 0;
BA_ "VFrameFormat" BO_ 904 14;
BA_ "CANFD_BRS" BO_ 904 1;
BA_ "GenMsgCycleTime" BO_ 904 100;
BA_ "GenMsgCycleTimeFast" BO_ 904 0;
BA_ "GenMsgSendType" BO_ 904 0;
BA_ "VFrameFormat" BO_ 904 14;
BA_ "CANFD_BRS" BO_ 904 1;
BA_ "GenMsgCycleTime" BO_ 904 100;
BA_ "GenMsgCycleTimeFast" BO_ 904 0;
BA_ "GenMsgSendType" BO_ 904 0;
BA_ "VFrameFormat" BO_ 904 14;
BA_ "CANFD_BRS" BO_ 904 1;
BA_ "GenMsgCycleTime" BO_ 904 100;
BA_ "GenMsgCycleTimeFast" BO_ 904 0;
BA_ "GenMsgSendType" BO_ 904 0;
BA_ "VFrameFormat" BO_ 904 14;
BA_ "CANFD_BRS" BO_ 904 1;
BA_ "GenMsgCycleTime" BO_ 904 100;
BA_ "GenMsgCycleTimeFast" BO_ 904 0;
BA_ "GenMsgSendType" BO_ 904 0;
BA_ "VFrameFormat" BO_ 904 14;
BA_ "CANFD_BRS" BO_ 904 1;
BA_ "GenMsgCycleTime" BO_ 904 100;
BA_ "GenMsgCycleTimeFast" BO_ 904 0;
BA_ "GenMsgSendType" BO_ 904 0;
BA_ "VFrameFormat" BO_ 904 14;
BA_ "CANFD_BRS" BO_ 904 1;
BA_ "GenMsgCycleTime" BO_ 904 100;
BA_ "GenMsgCycleTimeFast" BO_ 904 0;
BA_ "GenMsgSendType" BO_ 904 0;
BA_ "VFrameFormat" BO_ 904 14;
BA_ "CANFD_BRS" BO_ 904 1;
BA_ "GenMsgCycleTime" BO_ 904 100;
BA_ "GenMsgCycleTimeFast" BO_ 904 0;
BA_ "GenMsgSendType" BO_ 904 0;
BA_ "VFrameFormat" BO_ 904 14;
BA_ "CANFD_BRS" BO_ 904 1;
BA_ "GenMsgCycleTime" BO_ 904 100;
BA_ "GenMsgCycleTimeFast" BO_ 904 0;
BA_ "GenMsgSendType" BO_ 904 0;
BA_ "VFrameFormat" BO_ 904 14;
BA_ "CANFD_BRS" BO_ 904 1;
BA_ "GenMsgCycleTime" BO_ 904 100;
BA_ "GenMsgCycleTimeFast" BO_ 904 0;
BA_ "GenMsgSendType" BO_ 904 0;
BA_ "VFrameFormat" BO_ 904 14;
BA_ "CANFD_BRS" BO_ 904 1;
BA_ "GenMsgCycleTime" BO_ 904 100;
BA_ "GenMsgCycleTimeFast" BO_ 904 0;
BA_ "GenMsgSendType" BO_ 904 0;
BA_ "VFrameFormat" BO_ 904 14;
BA_ "CANFD_BRS" BO_ 904 1;
BA_ "GenMsgCycleTime" BO_ 904 100;
BA_ "GenMsgCycleTimeFast" BO_ 904 0;
BA_ "GenMsgSendType" BO_ 904 0;
BA_ "VFrameFormat" BO_ 904 14;
BA_ "CANFD_BRS" BO_ 904 1;
BA_ "GenMsgCycleTime" BO_ 904 100;
BA_ "GenMsgCycleTimeFast" BO_ 904 0;
BA_ "GenMsgSendType" BO_ 904 0;
BA_ "VFrameFormat" BO_ 904 14;
BA_ "CANFD_BRS" BO_ 904 1;
BA_ "GenMsgCycleTime" BO_ 904 100;
BA_ "GenMsgCycleTimeFast" BO_ 904 0;
BA_ "GenMsgSendType" BO_ 904 0;
BA_ "VFrameFormat" BO_ 904 14;
BA_ "CANFD_BRS" BO_ 904 1;
BA_ "GenMsgCycleTime" BO_ 904 100;
BA_ "GenMsgCycleTimeFast" BO_ 904 0;
BA_ "GenMsgSendType" BO_ 904 0;
BA_ "VFrameFormat" BO_ 904 14;
BA_ "CANFD_BRS" BO_ 904 1;
BA_ "GenMsgCycleTime" BO_ 904 100;
BA_ "GenMsgCycleTimeFast" BO_ 904 0;
BA_ "GenMsgSendType" BO_ 904 0;
BA_ "VFrameFormat" BO_ 904 14;
BA_ "CANFD_BRS" BO_ 904 1;
BA_ "GenMsgCycleTime" BO_ 904 100;
BA_ "GenMsgCycleTimeFast" BO_ 904 0;
BA_ "GenMsgSendType" BO_ 904 0;
BA_ "VFrameFormat" BO_ 904 14;
BA_ "CANFD_BRS" BO_ 904 1;
BA_ "GenMsgCycleTime" BO_ 904 100;
BA_ "GenMsgCycleTimeFast" BO_ 904 0;
BA_ "GenMsgSendType" BO_ 904 0;
BA_ "VFrameFormat" BO_ 904 14;
BA_ "CANFD_BRS" BO_ 904 1;
BA_ "GenMsgCycleTime" BO_ 904 100;
BA_ "GenMsgCycleTimeFast" BO_ 904 0;
BA_ "GenMsgSendType" BO_ 904 0;
BA_ "VFrameFormat" BO_ 904 14;
BA_ "CANFD_BRS" BO_ 904 1;
BA_ "GenMsgCycleTime" BO_ 904 100;
BA_ "GenMsgCycleTimeFast" BO_ 904 0;
BA_ "GenMsgSendType" BO_ 904 0;
BA_ "VFrameFormat" BO_ 904 14;
BA_ "CANFD_BRS" BO_ 904 1;
BA_ "GenMsgCycleTime" BO_ 904 100;
BA_ "GenMsgCycleTimeFast" BO_ 904 0;
BA_ "GenMsgSendType" BO_ 904 0;
BA_ "VFrameFormat" BO_ 904 14;
BA_ "CANFD_BRS" BO_ 904 1;
BA_ "GenMsgCycleTime" BO_ 904 100;
BA_ "GenMsgCycleTimeFast" BO_ 904 0;
BA_ "GenMsgSendType" BO_ 904 0;
BA_ "VFrameFormat" BO_ 904 14;
BA_ "CANFD_BRS" BO_ 904 1;
BA_ "GenMsgCycleTime" BO_ 904 100;
BA_ "GenMsgCycleTimeFast" BO_ 904 0;
BA_ "GenMsgSendType" BO_ 904 0;
BA_ "VFrameFormat" BO_ 904 14;
BA_ "CANFD_BRS" BO_ 904 1;
BA_ "GenMsgCycleTime" BO_ 904 100;
BA_ "GenMsgCycleTimeFast" BO_ 904 0;
BA_ "GenMsgSendType" BO_ 904 0;
BA_ "VFrameFormat" BO_ 904 14;
BA_ "CANFD_BRS" BO_ 904 1;
BA_ "GenMsgCycleTime" BO_ 904 100;
BA_ "GenMsgCycleTimeFast" BO_ 904 0;
BA_ "GenMsgSendType" BO_ 904 0;
BA_ "VFrameFormat" BO_ 904 14;
BA_ "CANFD_BRS" BO_ 904 1;
BA_ "GenMsgCycleTime" BO_ 904 100;
BA_ "GenMsgCycleTimeFast" BO_ 904 0;
BA_ "GenMsgSendType" BO_ 904 0;
BA_ "VFrameFormat" BO_ 904 14;
BA_ "CANFD_BRS" BO_ 904 1;
BA_ "GenMsgCycleTime" BO_ 904 100;
BA_ "GenMsgCycleTimeFast" BO_ 904 0;
BA_ "GenMsgSendType" BO_ 904 0;
BA_ "VFrameFormat" BO_ 904 14;
BA_ "CANFD_BRS" BO_ 904 1;
BA_ "GenMsgCycleTime" BO_ 904 100;
BA_ "GenMsgCycleTimeFast" BO_ 904 0;
BA_ "GenMsgSendType" BO_ 904 0;
BA_ "VFrameFormat" BO_ 904 14;
BA_ "CANFD_BRS" BO_ 904 1;
BA_ "GenMsgCycleTime" BO_ 904 100;
BA_ "GenMsgCycleTimeFast" BO_ 904 0;
BA_ "GenMsgSendType" BO_ 904 0;
BA_ "VFrameFormat" BO_ 904 14;
BA_ "CANFD_BRS" BO_ 904 1;
BA_ "GenMsgCycleTime" BO_ 904 100;
BA_ "GenMsgCycleTimeFast" BO_ 904 0;
BA_ "GenMsgSendType" BO_ 904 0;
BA_ "VFrameFormat" BO_ 904 14;
BA_ "CANFD_BRS" BO_ 904 1;
BA_ "GenMsgCycleTime" BO_ 904 100;
BA_ "GenMsgCycleTimeFast" BO_ 904 0;
BA_ "GenMsgSendType" BO_ 904 0;
BA_ "VFrameFormat" BO_ 904 14;
BA_ "CANFD_BRS" BO_ 904 1;
BA_ "GenMsgCycleTime" BO_ 904 100;
BA_ "GenMsgCycleTimeFast" BO_ 904 0;
BA_ "GenMsgSendType" BO_ 904 0;
BA_ "VFrameFormat" BO_ 904 14;
BA_ "CANFD_BRS" BO_ 904 1;
BA_ "GenMsgCycleTime" BO_ 904 100;
BA_ "GenMsgCycleTimeFast" BO_ 904 0;
BA_ "GenMsgSendType" BO_ 904 0;
BA_ "VFrameFormat" BO_ 904 14;
BA_ "CANFD_BRS" BO_ 904 1;
BA_ "GenMsgCycleTime" BO_ 904 100;
BA_ "GenMsgCycleTimeFast" BO_ 904 0;
BA_ "GenMsgSendType" BO_ 904 0;
BA_ "VFrameFormat" BO_ 904 14;
BA_ "CANFD_BRS" BO_ 904 1;
BA_ "GenMsgCycleTime" BO_ 904 100;
BA_ "GenMsgCycleTimeFast" BO_ 904 0;
BA_ "GenMsgSendType" BO_ 904 0;
BA_ "VFrameFormat" BO_ 904 14;
BA_ "CANFD_BRS" BO_ 904 1;
BA_ "GenMsgCycleTime" BO_ 904 100;
BA_ "GenMsgCycleTimeFast" BO_ 904 0;
BA_ "GenMsgSendType" BO_ 904 0;
BA_ "VFrameFormat" BO_ 904 14;
BA_ "CANFD_BRS" BO_ 904 1;
BA_ "GenMsgCycleTime" BO_ 904 100;
BA_ "GenMsgCycleTimeFast" BO_ 904 0;
BA_ "GenMsgSendType" BO_ 904 0;
BA_ "VFrameFormat" BO_ 904 14;
BA_ "CANFD_BRS" BO_ 904 1;
BA_ "GenMsgCycleTime" BO_ 904 100;
BA_ "GenMsgCycleTimeFast" BO_ 904 0;
BA_ "GenMsgSendType" BO_ 904 0;
BA_ "VFrameFormat" BO_ 904 14;
BA_ "CANFD_BRS" BO_ 904 1;
BA_ "GenMsgCycleTime" BO_ 904 100;
BA_ "GenMsgCycleTimeFast" BO_ 904 0;
BA_ "GenMsgSendType" BO_ 904 0;
BA_ "VFrameFormat" BO_ 904 14;
BA_ "CANFD_BRS" BO_ 904 1;
BA_ "GenMsgCycleTime" BO_ 904 100;
BA_ "GenMsgCycleTimeFast" BO_ 904 0;
BA_ "GenMsgSendType" BO_ 904 0;
BA_ "VFrameFormat" BO_ 904 14;
BA_ "CANFD_BRS" BO_ 904 1;
BA_ "GenMsgCycleTime" BO_ 904 100;
BA_ "GenMsgCycleTimeFast" BO_ 904 0;
BA_ "GenMsgSendType" BO_ 904 0;
BA_ "VFrameFormat" BO_ 904 14;
BA_ "CANFD_BRS" BO_ 904 1;
BA_ "GenMsgCycleTime" BO_ 904 100;
BA_ "GenMsgCycleTimeFast" BO_ 904 0;
BA_ "GenMsgSendType" BO_ 904 0;
BA_ "VFrameFormat" BO_ 904 14;
BA_ "CANFD_BRS" BO_ 904 1;
BA_ "GenMsgCycleTime" BO_ 904 100;
BA_ "GenMsgCycleTimeFast" BO_ 904 0;
BA_ "GenMsgSendType" BO_ 904 0;
BA_ "VFrameFormat" BO_ 904 14;
BA_ "CANFD_BRS" BO_ 904 1;
BA_ "GenMsgCycleTime" BO_ 904 100;
BA_ "GenMsgCycleTimeFast" BO_ 904 0;
BA_ "GenMsgSendType" BO_ 904 0;
BA_ "VFrameFormat" BO_ 904 14;
BA_ "CANFD_BRS" BO_ 904 1;
BA_ "GenMsgCycleTime" BO_ 904 100;
BA_ "GenMsgCycleTimeFast" BO_ 904 0;
BA_ "GenMsgSendType" BO_ 904 0;
BA_ "VFrameFormat" BO_ 904 14;
BA_ "CANFD_BRS" BO_ 904 1;
BA_ "GenMsgCycleTime" BO_ 904 100;
BA_ "GenMsgCycleTimeFast" BO_ 904 0;
BA_ "GenMsgSendType" BO_ 904 0;
BA_ "VFrameFormat" BO_ 904 14;
BA_ "CANFD_BRS" BO_ 904 1;
BA_ "GenMsgCycleTime" BO_ 904 100;
BA_ "GenMsgCycleTimeFast" BO_ 904 0;
BA_ "GenMsgSendType" BO_ 904 0;
BA_ "VFrameFormat" BO_ 904 14;
BA_ "CANFD_BRS" BO_ 904 1;
BA_ "GenMsgCycleTime" BO_ 904 100;
BA_ "GenMsgCycleTimeFast" BO_ 904 0;
BA_ "GenMsgSendType" BO_ 904 0;
BA_ "VFrameFormat" BO_ 904 14;
BA_ "CANFD_BRS" BO_ 904 1;
BA_ "GenMsgCycleTime" BO_ 904 100;
BA_ "GenMsgCycleTimeFast" BO_ 904 0;
BA_ "GenMsgSendType" BO_ 904 0;
BA_ "VFrameFormat" BO_ 904 14;
BA_ "CANFD_BRS" BO_ 904 1;
BA_ "GenMsgCycleTime" BO_ 904 100;
BA_ "GenMsgCycleTimeFast" BO_ 904 0;
BA_ "GenMsgSendType" BO_ 904 0;
BA_ "VFrameFormat" BO_ 904 14;
BA_ "CANFD_BRS" BO_ 904 1;
BA_ "GenMsgCycleTime" BO_ 904 100;
BA_ "GenMsgCycleTimeFast" BO_ 904 0;
BA_ "GenMsgSendType" BO_ 904 0;
BA_ "VFrameFormat" BO_ 904 14;
BA_ "CANFD_BRS" BO_ 904 1;
BA_ "GenMsgCycleTime" BO_ 904 100;
BA_ "GenMsgCycleTimeFast" BO_ 904 0;
BA_ "GenMsgSendType" BO_ 904 0;
BA_ "VFrameFormat" BO_ 904 14;
BA_ "CANFD_BRS" BO_ 904 1;
BA_ "GenMsgCycleTime" BO_ 904 100;
BA_ "GenMsgCycleTimeFast" BO_ 904 0;
BA_ "GenMsgSendType" BO_ 904 0;
BA_ "VFrameFormat" BO_ 904 14;
BA_ "CANFD_BRS" BO_ 904 1;
BA_ "GenMsgCycleTime" BO_ 904 100;
BA_ "GenMsgCycleTimeFast" BO_ 904 0;
BA_ "GenMsgSendType" BO_ 904 0;
BA_ "VFrameFormat" BO_ 904 14;
BA_ "CANFD_BRS" BO_ 904 1;
BA_ "GenMsgCycleTime" BO_ 904 100;
BA_ "GenMsgCycleTimeFast" BO_ 904 0;
BA_ "GenMsgSendType" BO_ 904 0;
BA_ "VFrameFormat" BO_ 904 14;
BA_ "CANFD_BRS" BO_ 904 1;
BA_ "GenMsgCycleTime" BO_ 904 100;
BA_ "GenMsgCycleTimeFast" BO_ 904 0;
BA_ "GenMsgSendType" BO_ 904 0;
BA_ "VFrameFormat" BO_ 904 14;
BA_ "CANFD_BRS" BO_ 904 1;
BA_ "GenMsgCycleTime" BO_ 904 100;
BA_ "GenMsgCycleTimeFast" BO_ 904 0;
BA_ "GenMsgSendType" BO_ 904 0;
BA_ "VFrameFormat" BO_ 904 14;
BA_ "CANFD_BRS" BO_ 904 1;
BA_ "GenMsgCycleTime" BO_ 904 100;
BA_ "GenMsgCycleTimeFast" BO_ 904 0;
BA_ "GenMsgSendType" BO_ 904 0;
BA_ "VFrameFormat" BO_ 904 14;
BA_ "CANFD_BRS" BO_ 904 1;
BA_ "GenMsgCycleTime" BO_ 904 100;
BA_ "GenMsgCycleTimeFast" BO_ 904 0;
BA_ "GenMsgSendType" BO_ 904 0;
BA_ "VFrameFormat" BO_ 904 14;
BA_ "CANFD_BRS" BO_ 904 1;
BA_ "GenMsgCycleTime" BO_ 904 100;
BA_ "GenMsgCycleTimeFast" BO_ 904 0;
BA_ "GenMsgSendType" BO_ 904 0;
BA_ "VFrameFormat" BO_ 904 14;
BA_ "CANFD_BRS" BO_ 904 1;
BA_ "GenMsgCycleTime" BO_ 904 100;
BA_ "GenMsgCycleTimeFast" BO_ 904 0;
BA_ "GenMsgSendType" BO_ 904 0;
BA_ "VFrameFormat" BO_ 904 14;
BA_ "CANFD_BRS" BO_ 904 1;
BA_ "GenMsgCycleTime" BO_ 904 100;
BA_ "GenMsgCycleTimeFast" BO_ 904 0;
BA_ "GenMsgSendType" BO_ 904 0;
BA_ "VFrameFormat" BO_ 904 14;
BA_ "CANFD_BRS" BO_ 904 1;
BA_ "GenMsgCycleTime" BO_ 904 100;
BA_ "GenMsgCycleTimeFast" BO_ 904 0;
BA_ "GenMsgSendType" BO_ 904 0;
BA_ "VFrameFormat" BO_ 904 14;
BA_ "CANFD_BRS" BO_ 904 1;
BA_ "GenMsgCycleTime" BO_ 904 100;
BA_ "GenMsgCycleTimeFast" BO_ 904 0;
BA_ "GenMsgSendType" BO_ 904 0;
BA_ "VFrameFormat" BO_ 904 14;
BA_ "CANFD_BRS" BO_ 904 1;
BA_ "GenMsgCycleTime" BO_ 904 100;
BA_ "GenMsgCycleTimeFast" BO_ 904 0;
BA_ "GenMsgSendType" BO_ 904 0;
BA_ "VFrameFormat" BO_ 904 14;
BA_ "CANFD_BRS" BO_ 904 1;
BA_ "GenMsgCycleTime" BO_ 904 100;
BA_ "GenMsgCycleTimeFast" BO_ 904 0;
BA_ "GenMsgSendType" BO_ 904 0;
BA_ "VFrameFormat" BO_ 904 14;
BA_ "CANFD_BRS" BO_ 904 1;
BA_ "GenMsgCycleTime" BO_ 334 500;
BA_ "GenMsgCycleTimeFast" BO_ 334 40;
BA_ "GenMsgSendType" BO_ 334 3;
BA_ "VFrameFormat" BO_ 334 14;
BA_ "CANFD_BRS" BO_ 334 1;
BA_ "GenMsgCycleTime" BO_ 334 500;
BA_ "GenMsgCycleTimeFast" BO_ 334 40;
BA_ "GenMsgSendType" BO_ 334 3;
BA_ "VFrameFormat" BO_ 334 14;
BA_ "CANFD_BRS" BO_ 334 1;
BA_ "GenMsgCycleTime" BO_ 334 500;
BA_ "GenMsgCycleTimeFast" BO_ 334 40;
BA_ "GenMsgSendType" BO_ 334 3;
BA_ "VFrameFormat" BO_ 334 14;
BA_ "CANFD_BRS" BO_ 334 1;
BA_ "GenMsgCycleTime" BO_ 777 100;
BA_ "GenMsgCycleTimeFast" BO_ 777 0;
BA_ "GenMsgSendType" BO_ 777 0;
BA_ "VFrameFormat" BO_ 777 14;
BA_ "CANFD_BRS" BO_ 777 1;
BA_ "GenMsgCycleTime" BO_ 777 100;
BA_ "GenMsgCycleTimeFast" BO_ 777 0;
BA_ "GenMsgSendType" BO_ 777 0;
BA_ "VFrameFormat" BO_ 777 14;
BA_ "CANFD_BRS" BO_ 777 1;
BA_ "GenMsgCycleTime" BO_ 777 100;
BA_ "GenMsgCycleTimeFast" BO_ 777 0;
BA_ "GenMsgSendType" BO_ 777 0;
BA_ "VFrameFormat" BO_ 777 14;
BA_ "CANFD_BRS" BO_ 777 1;
BA_ "GenMsgCycleTime" BO_ 777 100;
BA_ "GenMsgCycleTimeFast" BO_ 777 0;
BA_ "GenMsgSendType" BO_ 777 0;
BA_ "VFrameFormat" BO_ 777 14;
BA_ "CANFD_BRS" BO_ 777 1;
BA_ "GenMsgCycleTime" BO_ 777 100;
BA_ "GenMsgCycleTimeFast" BO_ 777 0;
BA_ "GenMsgSendType" BO_ 777 0;
BA_ "VFrameFormat" BO_ 777 14;
BA_ "CANFD_BRS" BO_ 777 1;
BA_ "GenMsgCycleTime" BO_ 777 100;
BA_ "GenMsgCycleTimeFast" BO_ 777 0;
BA_ "GenMsgSendType" BO_ 777 0;
BA_ "VFrameFormat" BO_ 777 14;
BA_ "CANFD_BRS" BO_ 777 1;
BA_ "GenMsgCycleTime" BO_ 777 100;
BA_ "GenMsgCycleTimeFast" BO_ 777 0;
BA_ "GenMsgSendType" BO_ 777 0;
BA_ "VFrameFormat" BO_ 777 14;
BA_ "CANFD_BRS" BO_ 777 1;
BA_ "GenMsgCycleTime" BO_ 777 100;
BA_ "GenMsgCycleTimeFast" BO_ 777 0;
BA_ "GenMsgSendType" BO_ 777 0;
BA_ "VFrameFormat" BO_ 777 14;
BA_ "CANFD_BRS" BO_ 777 1;
BA_ "GenMsgCycleTime" BO_ 777 100;
BA_ "GenMsgCycleTimeFast" BO_ 777 0;
BA_ "GenMsgSendType" BO_ 777 0;
BA_ "VFrameFormat" BO_ 777 14;
BA_ "CANFD_BRS" BO_ 777 1;
BA_ "GenMsgCycleTime" BO_ 777 100;
BA_ "GenMsgCycleTimeFast" BO_ 777 0;
BA_ "GenMsgSendType" BO_ 777 0;
BA_ "VFrameFormat" BO_ 777 14;
BA_ "CANFD_BRS" BO_ 777 1;
BA_ "GenMsgCycleTime" BO_ 777 100;
BA_ "GenMsgCycleTimeFast" BO_ 777 0;
BA_ "GenMsgSendType" BO_ 777 0;
BA_ "VFrameFormat" BO_ 777 14;
BA_ "CANFD_BRS" BO_ 777 1;
BA_ "GenMsgCycleTime" BO_ 342 40;
BA_ "GenMsgCycleTimeFast" BO_ 342 0;
BA_ "GenMsgSendType" BO_ 342 0;
BA_ "VFrameFormat" BO_ 342 14;
BA_ "CANFD_BRS" BO_ 342 1;
BA_ "GenMsgCycleTime" BO_ 342 40;
BA_ "GenMsgCycleTimeFast" BO_ 342 0;
BA_ "GenMsgSendType" BO_ 342 0;
BA_ "VFrameFormat" BO_ 342 14;
BA_ "CANFD_BRS" BO_ 342 1;
BA_ "GenMsgCycleTime" BO_ 342 40;
BA_ "GenMsgCycleTimeFast" BO_ 342 0;
BA_ "GenMsgSendType" BO_ 342 0;
BA_ "VFrameFormat" BO_ 342 14;
BA_ "CANFD_BRS" BO_ 342 1;
BA_ "GenMsgCycleTime" BO_ 342 40;
BA_ "GenMsgCycleTimeFast" BO_ 342 0;
BA_ "GenMsgSendType" BO_ 342 0;
BA_ "VFrameFormat" BO_ 342 14;
BA_ "CANFD_BRS" BO_ 342 1;
BA_ "GenMsgCycleTime" BO_ 342 40;
BA_ "GenMsgCycleTimeFast" BO_ 342 0;
BA_ "GenMsgSendType" BO_ 342 0;
BA_ "VFrameFormat" BO_ 342 14;
BA_ "CANFD_BRS" BO_ 342 1;
BA_ "GenMsgCycleTime" BO_ 342 40;
BA_ "GenMsgCycleTimeFast" BO_ 342 0;
BA_ "GenMsgSendType" BO_ 342 0;
BA_ "VFrameFormat" BO_ 342 14;
BA_ "CANFD_BRS" BO_ 342 1;
BA_ "GenMsgCycleTime" BO_ 342 40;
BA_ "GenMsgCycleTimeFast" BO_ 342 0;
BA_ "GenMsgSendType" BO_ 342 0;
BA_ "VFrameFormat" BO_ 342 14;
BA_ "CANFD_BRS" BO_ 342 1;
BA_ "GenMsgCycleTime" BO_ 342 40;
BA_ "GenMsgCycleTimeFast" BO_ 342 0;
BA_ "GenMsgSendType" BO_ 342 0;
BA_ "VFrameFormat" BO_ 342 14;
BA_ "CANFD_BRS" BO_ 342 1;
BA_ "GenMsgCycleTime" BO_ 342 40;
BA_ "GenMsgCycleTimeFast" BO_ 342 0;
BA_ "GenMsgSendType" BO_ 342 0;
BA_ "VFrameFormat" BO_ 342 14;
BA_ "CANFD_BRS" BO_ 342 1;
BA_ "GenMsgCycleTime" BO_ 342 40;
BA_ "GenMsgCycleTimeFast" BO_ 342 0;
BA_ "GenMsgSendType" BO_ 342 0;
BA_ "VFrameFormat" BO_ 342 14;
BA_ "CANFD_BRS" BO_ 342 1;
BA_ "GenMsgCycleTime" BO_ 342 40;
BA_ "GenMsgCycleTimeFast" BO_ 342 0;
BA_ "GenMsgSendType" BO_ 342 0;
BA_ "VFrameFormat" BO_ 342 14;
BA_ "CANFD_BRS" BO_ 342 1;
BA_ "GenMsgCycleTime" BO_ 342 40;
BA_ "GenMsgCycleTimeFast" BO_ 342 0;
BA_ "GenMsgSendType" BO_ 342 0;
BA_ "VFrameFormat" BO_ 342 14;
BA_ "CANFD_BRS" BO_ 342 1;
BA_ "GenMsgCycleTime" BO_ 342 40;
BA_ "GenMsgCycleTimeFast" BO_ 342 0;
BA_ "GenMsgSendType" BO_ 342 0;
BA_ "VFrameFormat" BO_ 342 14;
BA_ "CANFD_BRS" BO_ 342 1;
BA_ "GenMsgCycleTime" BO_ 342 40;
BA_ "GenMsgCycleTimeFast" BO_ 342 0;
BA_ "GenMsgSendType" BO_ 342 0;
BA_ "VFrameFormat" BO_ 342 14;
BA_ "CANFD_BRS" BO_ 342 1;
BA_ "GenMsgCycleTime" BO_ 342 40;
BA_ "GenMsgCycleTimeFast" BO_ 342 0;
BA_ "GenMsgSendType" BO_ 342 0;
BA_ "VFrameFormat" BO_ 342 14;
BA_ "CANFD_BRS" BO_ 342 1;
BA_ "GenMsgCycleTime" BO_ 342 40;
BA_ "GenMsgCycleTimeFast" BO_ 342 0;
BA_ "GenMsgSendType" BO_ 342 0;
BA_ "VFrameFormat" BO_ 342 14;
BA_ "CANFD_BRS" BO_ 342 1;
BA_ "GenMsgCycleTime" BO_ 342 40;
BA_ "GenMsgCycleTimeFast" BO_ 342 0;
BA_ "GenMsgSendType" BO_ 342 0;
BA_ "VFrameFormat" BO_ 342 14;
BA_ "CANFD_BRS" BO_ 342 1;
BA_ "GenMsgCycleTime" BO_ 342 40;
BA_ "GenMsgCycleTimeFast" BO_ 342 0;
BA_ "GenMsgSendType" BO_ 342 0;
BA_ "VFrameFormat" BO_ 342 14;
BA_ "CANFD_BRS" BO_ 342 1;
BA_ "GenMsgCycleTime" BO_ 342 40;
BA_ "GenMsgCycleTimeFast" BO_ 342 0;
BA_ "GenMsgSendType" BO_ 342 0;
BA_ "VFrameFormat" BO_ 342 14;
BA_ "CANFD_BRS" BO_ 342 1;
BA_ "GenMsgCycleTime" BO_ 342 40;
BA_ "GenMsgCycleTimeFast" BO_ 342 0;
BA_ "GenMsgSendType" BO_ 342 0;
BA_ "VFrameFormat" BO_ 342 14;
BA_ "CANFD_BRS" BO_ 342 1;
BA_ "GenMsgCycleTime" BO_ 342 40;
BA_ "GenMsgCycleTimeFast" BO_ 342 0;
BA_ "GenMsgSendType" BO_ 342 0;
BA_ "VFrameFormat" BO_ 342 14;
BA_ "CANFD_BRS" BO_ 342 1;
BA_ "GenMsgCycleTime" BO_ 342 40;
BA_ "GenMsgCycleTimeFast" BO_ 342 0;
BA_ "GenMsgSendType" BO_ 342 0;
BA_ "VFrameFormat" BO_ 342 14;
BA_ "CANFD_BRS" BO_ 342 1;
BA_ "GenMsgCycleTime" BO_ 342 40;
BA_ "GenMsgCycleTimeFast" BO_ 342 0;
BA_ "GenMsgSendType" BO_ 342 0;
BA_ "VFrameFormat" BO_ 342 14;
BA_ "CANFD_BRS" BO_ 342 1;
BA_ "GenMsgCycleTime" BO_ 342 40;
BA_ "GenMsgCycleTimeFast" BO_ 342 0;
BA_ "GenMsgSendType" BO_ 342 0;
BA_ "VFrameFormat" BO_ 342 14;
BA_ "CANFD_BRS" BO_ 342 1;
BA_ "GenMsgCycleTime" BO_ 342 40;
BA_ "GenMsgCycleTimeFast" BO_ 342 0;
BA_ "GenMsgSendType" BO_ 342 0;
BA_ "VFrameFormat" BO_ 342 14;
BA_ "CANFD_BRS" BO_ 342 1;
BA_ "GenMsgCycleTime" BO_ 512 500;
BA_ "GenMsgCycleTimeFast" BO_ 512 40;
BA_ "GenMsgSendType" BO_ 512 3;
BA_ "VFrameFormat" BO_ 512 14;
BA_ "CANFD_BRS" BO_ 512 1;
BA_ "GenMsgCycleTime" BO_ 512 500;
BA_ "GenMsgCycleTimeFast" BO_ 512 40;
BA_ "GenMsgSendType" BO_ 512 3;
BA_ "VFrameFormat" BO_ 512 14;
BA_ "CANFD_BRS" BO_ 512 1;
BA_ "GenMsgCycleTime" BO_ 512 500;
BA_ "GenMsgCycleTimeFast" BO_ 512 40;
BA_ "GenMsgSendType" BO_ 512 3;
BA_ "VFrameFormat" BO_ 512 14;
BA_ "CANFD_BRS" BO_ 512 1;
BA_ "GenMsgCycleTime" BO_ 512 500;
BA_ "GenMsgCycleTimeFast" BO_ 512 40;
BA_ "GenMsgSendType" BO_ 512 3;
BA_ "VFrameFormat" BO_ 512 14;
BA_ "CANFD_BRS" BO_ 512 1;
BA_ "GenMsgCycleTime" BO_ 512 500;
BA_ "GenMsgCycleTimeFast" BO_ 512 40;
BA_ "GenMsgSendType" BO_ 512 3;
BA_ "VFrameFormat" BO_ 512 14;
BA_ "CANFD_BRS" BO_ 512 1;
BA_ "GenMsgCycleTime" BO_ 512 500;
BA_ "GenMsgCycleTimeFast" BO_ 512 40;
BA_ "GenMsgSendType" BO_ 512 3;
BA_ "VFrameFormat" BO_ 512 14;
BA_ "CANFD_BRS" BO_ 512 1;
BA_ "GenMsgCycleTime" BO_ 512 500;
BA_ "GenMsgCycleTimeFast" BO_ 512 40;
BA_ "GenMsgSendType" BO_ 512 3;
BA_ "VFrameFormat" BO_ 512 14;
BA_ "CANFD_BRS" BO_ 512 1;
BA_ "GenMsgCycleTime" BO_ 512 500;
BA_ "GenMsgCycleTimeFast" BO_ 512 40;
BA_ "GenMsgSendType" BO_ 512 3;
BA_ "VFrameFormat" BO_ 512 14;
BA_ "CANFD_BRS" BO_ 512 1;
BA_ "GenMsgCycleTime" BO_ 512 500;
BA_ "GenMsgCycleTimeFast" BO_ 512 40;
BA_ "GenMsgSendType" BO_ 512 3;
BA_ "VFrameFormat" BO_ 512 14;
BA_ "CANFD_BRS" BO_ 512 1;
BA_ "GenMsgCycleTime" BO_ 512 500;
BA_ "GenMsgCycleTimeFast" BO_ 512 40;
BA_ "GenMsgSendType" BO_ 512 3;
BA_ "VFrameFormat" BO_ 512 14;
BA_ "CANFD_BRS" BO_ 512 1;
BA_ "GenMsgCycleTime" BO_ 512 500;
BA_ "GenMsgCycleTimeFast" BO_ 512 40;
BA_ "GenMsgSendType" BO_ 512 3;
BA_ "VFrameFormat" BO_ 512 14;
BA_ "CANFD_BRS" BO_ 512 1;
BA_ "GenMsgCycleTime" BO_ 512 500;
BA_ "GenMsgCycleTimeFast" BO_ 512 40;
BA_ "GenMsgSendType" BO_ 512 3;
BA_ "VFrameFormat" BO_ 512 14;
BA_ "CANFD_BRS" BO_ 512 1;
BA_ "GenMsgCycleTime" BO_ 512 500;
BA_ "GenMsgCycleTimeFast" BO_ 512 40;
BA_ "GenMsgSendType" BO_ 512 3;
BA_ "VFrameFormat" BO_ 512 14;
BA_ "CANFD_BRS" BO_ 512 1;
BA_ "GenMsgCycleTime" BO_ 512 500;
BA_ "GenMsgCycleTimeFast" BO_ 512 40;
BA_ "GenMsgSendType" BO_ 512 3;
BA_ "VFrameFormat" BO_ 512 14;
BA_ "CANFD_BRS" BO_ 512 1;
BA_ "GenMsgCycleTime" BO_ 512 500;
BA_ "GenMsgCycleTimeFast" BO_ 512 40;
BA_ "GenMsgSendType" BO_ 512 3;
BA_ "VFrameFormat" BO_ 512 14;
BA_ "CANFD_BRS" BO_ 512 1;
BA_ "GenMsgCycleTime" BO_ 909 100;
BA_ "GenMsgCycleTimeFast" BO_ 909 0;
BA_ "GenMsgSendType" BO_ 909 0;
BA_ "VFrameFormat" BO_ 909 14;
BA_ "CANFD_BRS" BO_ 909 1;
BA_ "GenMsgCycleTime" BO_ 909 100;
BA_ "GenMsgCycleTimeFast" BO_ 909 0;
BA_ "GenMsgSendType" BO_ 909 0;
BA_ "VFrameFormat" BO_ 909 14;
BA_ "CANFD_BRS" BO_ 909 1;
BA_ "GenMsgCycleTime" BO_ 909 100;
BA_ "GenMsgCycleTimeFast" BO_ 909 0;
BA_ "GenMsgSendType" BO_ 909 0;
BA_ "VFrameFormat" BO_ 909 14;
BA_ "CANFD_BRS" BO_ 909 1;
BA_ "GenMsgCycleTime" BO_ 909 100;
BA_ "GenMsgCycleTimeFast" BO_ 909 0;
BA_ "GenMsgSendType" BO_ 909 0;
BA_ "VFrameFormat" BO_ 909 14;
BA_ "CANFD_BRS" BO_ 909 1;
BA_ "GenMsgCycleTime" BO_ 909 100;
BA_ "GenMsgCycleTimeFast" BO_ 909 0;
BA_ "GenMsgSendType" BO_ 909 0;
BA_ "VFrameFormat" BO_ 909 14;
BA_ "CANFD_BRS" BO_ 909 1;
BA_ "GenMsgCycleTime" BO_ 909 100;
BA_ "GenMsgCycleTimeFast" BO_ 909 0;
BA_ "GenMsgSendType" BO_ 909 0;
BA_ "VFrameFormat" BO_ 909 14;
BA_ "CANFD_BRS" BO_ 909 1;
BA_ "GenMsgCycleTime" BO_ 909 100;
BA_ "GenMsgCycleTimeFast" BO_ 909 0;
BA_ "GenMsgSendType" BO_ 909 0;
BA_ "VFrameFormat" BO_ 909 14;
BA_ "CANFD_BRS" BO_ 909 1;
BA_ "GenMsgCycleTime" BO_ 909 100;
BA_ "GenMsgCycleTimeFast" BO_ 909 0;
BA_ "GenMsgSendType" BO_ 909 0;
BA_ "VFrameFormat" BO_ 909 14;
BA_ "CANFD_BRS" BO_ 909 1;
BA_ "GenMsgCycleTime" BO_ 909 100;
BA_ "GenMsgCycleTimeFast" BO_ 909 0;
BA_ "GenMsgSendType" BO_ 909 0;
BA_ "VFrameFormat" BO_ 909 14;
BA_ "CANFD_BRS" BO_ 909 1;
BA_ "GenMsgCycleTime" BO_ 909 100;
BA_ "GenMsgCycleTimeFast" BO_ 909 0;
BA_ "GenMsgSendType" BO_ 909 0;
BA_ "VFrameFormat" BO_ 909 14;
BA_ "CANFD_BRS" BO_ 909 1;
BA_ "GenMsgCycleTime" BO_ 909 100;
BA_ "GenMsgCycleTimeFast" BO_ 909 0;
BA_ "GenMsgSendType" BO_ 909 0;
BA_ "VFrameFormat" BO_ 909 14;
BA_ "CANFD_BRS" BO_ 909 1;
BA_ "GenMsgCycleTime" BO_ 909 100;
BA_ "GenMsgCycleTimeFast" BO_ 909 0;
BA_ "GenMsgSendType" BO_ 909 0;
BA_ "VFrameFormat" BO_ 909 14;
BA_ "CANFD_BRS" BO_ 909 1;
BA_ "GenMsgCycleTime" BO_ 909 100;
BA_ "GenMsgCycleTimeFast" BO_ 909 0;
BA_ "GenMsgSendType" BO_ 909 0;
BA_ "VFrameFormat" BO_ 909 14;
BA_ "CANFD_BRS" BO_ 909 1;
BA_ "GenMsgCycleTime" BO_ 909 100;
BA_ "GenMsgCycleTimeFast" BO_ 909 0;
BA_ "GenMsgSendType" BO_ 909 0;
BA_ "VFrameFormat" BO_ 909 14;
BA_ "CANFD_BRS" BO_ 909 1;
BA_ "GenMsgCycleTime" BO_ 909 100;
BA_ "GenMsgCycleTimeFast" BO_ 909 0;
BA_ "GenMsgSendType" BO_ 909 0;
BA_ "VFrameFormat" BO_ 909 14;
BA_ "CANFD_BRS" BO_ 909 1;
BA_ "GenMsgCycleTime" BO_ 909 100;
BA_ "GenMsgCycleTimeFast" BO_ 909 0;
BA_ "GenMsgSendType" BO_ 909 0;
BA_ "VFrameFormat" BO_ 909 14;
BA_ "CANFD_BRS" BO_ 909 1;
BA_ "GenMsgCycleTime" BO_ 909 100;
BA_ "GenMsgCycleTimeFast" BO_ 909 0;
BA_ "GenMsgSendType" BO_ 909 0;
BA_ "VFrameFormat" BO_ 909 14;
BA_ "CANFD_BRS" BO_ 909 1;
BA_ "GenMsgCycleTime" BO_ 909 100;
BA_ "GenMsgCycleTimeFast" BO_ 909 0;
BA_ "GenMsgSendType" BO_ 909 0;
BA_ "VFrameFormat" BO_ 909 14;
BA_ "CANFD_BRS" BO_ 909 1;
BA_ "GenMsgCycleTime" BO_ 909 100;
BA_ "GenMsgCycleTimeFast" BO_ 909 0;
BA_ "GenMsgSendType" BO_ 909 0;
BA_ "VFrameFormat" BO_ 909 14;
BA_ "CANFD_BRS" BO_ 909 1;
BA_ "GenMsgCycleTime" BO_ 909 100;
BA_ "GenMsgCycleTimeFast" BO_ 909 0;
BA_ "GenMsgSendType" BO_ 909 0;
BA_ "VFrameFormat" BO_ 909 14;
BA_ "CANFD_BRS" BO_ 909 1;
BA_ "GenMsgCycleTime" BO_ 909 100;
BA_ "GenMsgCycleTimeFast" BO_ 909 0;
BA_ "GenMsgSendType" BO_ 909 0;
BA_ "VFrameFormat" BO_ 909 14;
BA_ "CANFD_BRS" BO_ 909 1;
BA_ "GenMsgCycleTime" BO_ 909 100;
BA_ "GenMsgCycleTimeFast" BO_ 909 0;
BA_ "GenMsgSendType" BO_ 909 0;
BA_ "VFrameFormat" BO_ 909 14;
BA_ "CANFD_BRS" BO_ 909 1;
BA_ "GenMsgCycleTime" BO_ 909 100;
BA_ "GenMsgCycleTimeFast" BO_ 909 0;
BA_ "GenMsgSendType" BO_ 909 0;
BA_ "VFrameFormat" BO_ 909 14;
BA_ "CANFD_BRS" BO_ 909 1;
BA_ "GenMsgCycleTime" BO_ 909 100;
BA_ "GenMsgCycleTimeFast" BO_ 909 0;
BA_ "GenMsgSendType" BO_ 909 0;
BA_ "VFrameFormat" BO_ 909 14;
BA_ "CANFD_BRS" BO_ 909 1;
BA_ "GenMsgCycleTime" BO_ 909 100;
BA_ "GenMsgCycleTimeFast" BO_ 909 0;
BA_ "GenMsgSendType" BO_ 909 0;
BA_ "VFrameFormat" BO_ 909 14;
BA_ "CANFD_BRS" BO_ 909 1;
BA_ "GenMsgCycleTime" BO_ 909 100;
BA_ "GenMsgCycleTimeFast" BO_ 909 0;
BA_ "GenMsgSendType" BO_ 909 0;
BA_ "VFrameFormat" BO_ 909 14;
BA_ "CANFD_BRS" BO_ 909 1;
BA_ "GenMsgCycleTime" BO_ 909 100;
BA_ "GenMsgCycleTimeFast" BO_ 909 0;
BA_ "GenMsgSendType" BO_ 909 0;
BA_ "VFrameFormat" BO_ 909 14;
BA_ "CANFD_BRS" BO_ 909 1;
BA_ "GenMsgCycleTime" BO_ 909 100;
BA_ "GenMsgCycleTimeFast" BO_ 909 0;
BA_ "GenMsgSendType" BO_ 909 0;
BA_ "VFrameFormat" BO_ 909 14;
BA_ "CANFD_BRS" BO_ 909 1;
BA_ "GenMsgCycleTime" BO_ 909 100;
BA_ "GenMsgCycleTimeFast" BO_ 909 0;
BA_ "GenMsgSendType" BO_ 909 0;
BA_ "VFrameFormat" BO_ 909 14;
BA_ "CANFD_BRS" BO_ 909 1;
BA_ "GenMsgCycleTime" BO_ 909 100;
BA_ "GenMsgCycleTimeFast" BO_ 909 0;
BA_ "GenMsgSendType" BO_ 909 0;
BA_ "VFrameFormat" BO_ 909 14;
BA_ "CANFD_BRS" BO_ 909 1;
BA_ "GenMsgCycleTime" BO_ 909 100;
BA_ "GenMsgCycleTimeFast" BO_ 909 0;
BA_ "GenMsgSendType" BO_ 909 0;
BA_ "VFrameFormat" BO_ 909 14;
BA_ "CANFD_BRS" BO_ 909 1;
BA_ "GenMsgCycleTime" BO_ 909 100;
BA_ "GenMsgCycleTimeFast" BO_ 909 0;
BA_ "GenMsgSendType" BO_ 909 0;
BA_ "VFrameFormat" BO_ 909 14;
BA_ "CANFD_BRS" BO_ 909 1;
BA_ "GenMsgCycleTime" BO_ 909 100;
BA_ "GenMsgCycleTimeFast" BO_ 909 0;
BA_ "GenMsgSendType" BO_ 909 0;
BA_ "VFrameFormat" BO_ 909 14;
BA_ "CANFD_BRS" BO_ 909 1;
BA_ "GenMsgCycleTime" BO_ 909 100;
BA_ "GenMsgCycleTimeFast" BO_ 909 0;
BA_ "GenMsgSendType" BO_ 909 0;
BA_ "VFrameFormat" BO_ 909 14;
BA_ "CANFD_BRS" BO_ 909 1;
BA_ "GenMsgCycleTime" BO_ 909 100;
BA_ "GenMsgCycleTimeFast" BO_ 909 0;
BA_ "GenMsgSendType" BO_ 909 0;
BA_ "VFrameFormat" BO_ 909 14;
BA_ "CANFD_BRS" BO_ 909 1;
BA_ "GenMsgCycleTime" BO_ 909 100;
BA_ "GenMsgCycleTimeFast" BO_ 909 0;
BA_ "GenMsgSendType" BO_ 909 0;
BA_ "VFrameFormat" BO_ 909 14;
BA_ "CANFD_BRS" BO_ 909 1;
BA_ "GenMsgCycleTime" BO_ 909 100;
BA_ "GenMsgCycleTimeFast" BO_ 909 0;
BA_ "GenMsgSendType" BO_ 909 0;
BA_ "VFrameFormat" BO_ 909 14;
BA_ "CANFD_BRS" BO_ 909 1;
BA_ "GenMsgCycleTime" BO_ 909 100;
BA_ "GenMsgCycleTimeFast" BO_ 909 0;
BA_ "GenMsgSendType" BO_ 909 0;
BA_ "VFrameFormat" BO_ 909 14;
BA_ "CANFD_BRS" BO_ 909 1;
BA_ "GenMsgCycleTime" BO_ 909 100;
BA_ "GenMsgCycleTimeFast" BO_ 909 0;
BA_ "GenMsgSendType" BO_ 909 0;
BA_ "VFrameFormat" BO_ 909 14;
BA_ "CANFD_BRS" BO_ 909 1;
BA_ "GenMsgCycleTime" BO_ 909 100;
BA_ "GenMsgCycleTimeFast" BO_ 909 0;
BA_ "GenMsgSendType" BO_ 909 0;
BA_ "VFrameFormat" BO_ 909 14;
BA_ "CANFD_BRS" BO_ 909 1;
BA_ "GenMsgCycleTime" BO_ 909 100;
BA_ "GenMsgCycleTimeFast" BO_ 909 0;
BA_ "GenMsgSendType" BO_ 909 0;
BA_ "VFrameFormat" BO_ 909 14;
BA_ "CANFD_BRS" BO_ 909 1;
BA_ "GenMsgCycleTime" BO_ 909 100;
BA_ "GenMsgCycleTimeFast" BO_ 909 0;
BA_ "GenMsgSendType" BO_ 909 0;
BA_ "VFrameFormat" BO_ 909 14;
BA_ "CANFD_BRS" BO_ 909 1;
BA_ "GenMsgCycleTime" BO_ 909 100;
BA_ "GenMsgCycleTimeFast" BO_ 909 0;
BA_ "GenMsgSendType" BO_ 909 0;
BA_ "VFrameFormat" BO_ 909 14;
BA_ "CANFD_BRS" BO_ 909 1;
BA_ "GenMsgCycleTime" BO_ 909 100;
BA_ "GenMsgCycleTimeFast" BO_ 909 0;
BA_ "GenMsgSendType" BO_ 909 0;
BA_ "VFrameFormat" BO_ 909 14;
BA_ "CANFD_BRS" BO_ 909 1;
BA_ "GenMsgCycleTime" BO_ 909 100;
BA_ "GenMsgCycleTimeFast" BO_ 909 0;
BA_ "GenMsgSendType" BO_ 909 0;
BA_ "VFrameFormat" BO_ 909 14;
BA_ "CANFD_BRS" BO_ 909 1;
BA_ "GenMsgCycleTime" BO_ 909 100;
BA_ "GenMsgCycleTimeFast" BO_ 909 0;
BA_ "GenMsgSendType" BO_ 909 0;
BA_ "VFrameFormat" BO_ 909 14;
BA_ "CANFD_BRS" BO_ 909 1;
BA_ "GenMsgCycleTime" BO_ 909 100;
BA_ "GenMsgCycleTimeFast" BO_ 909 0;
BA_ "GenMsgSendType" BO_ 909 0;
BA_ "VFrameFormat" BO_ 909 14;
BA_ "CANFD_BRS" BO_ 909 1;
BA_ "GenMsgCycleTime" BO_ 909 100;
BA_ "GenMsgCycleTimeFast" BO_ 909 0;
BA_ "GenMsgSendType" BO_ 909 0;
BA_ "VFrameFormat" BO_ 909 14;
BA_ "CANFD_BRS" BO_ 909 1;
BA_ "GenMsgCycleTime" BO_ 909 100;
BA_ "GenMsgCycleTimeFast" BO_ 909 0;
BA_ "GenMsgSendType" BO_ 909 0;
BA_ "VFrameFormat" BO_ 909 14;
BA_ "CANFD_BRS" BO_ 909 1;
BA_ "GenMsgCycleTime" BO_ 1078 500;
BA_ "GenMsgCycleTimeFast" BO_ 1078 40;
BA_ "GenMsgSendType" BO_ 1078 3;
BA_ "VFrameFormat" BO_ 1078 14;
BA_ "CANFD_BRS" BO_ 1078 1;
BA_ "GenMsgCycleTime" BO_ 1078 500;
BA_ "GenMsgCycleTimeFast" BO_ 1078 40;
BA_ "GenMsgSendType" BO_ 1078 3;
BA_ "VFrameFormat" BO_ 1078 14;
BA_ "CANFD_BRS" BO_ 1078 1;
BA_ "GenMsgCycleTime" BO_ 1078 500;
BA_ "GenMsgCycleTimeFast" BO_ 1078 40;
BA_ "GenMsgSendType" BO_ 1078 3;
BA_ "VFrameFormat" BO_ 1078 14;
BA_ "CANFD_BRS" BO_ 1078 1;
BA_ "GenMsgCycleTime" BO_ 1078 500;
BA_ "GenMsgCycleTimeFast" BO_ 1078 40;
BA_ "GenMsgSendType" BO_ 1078 3;
BA_ "VFrameFormat" BO_ 1078 14;
BA_ "CANFD_BRS" BO_ 1078 1;
BA_ "GenMsgCycleTime" BO_ 1078 500;
BA_ "GenMsgCycleTimeFast" BO_ 1078 40;
BA_ "GenMsgSendType" BO_ 1078 3;
BA_ "VFrameFormat" BO_ 1078 14;
BA_ "CANFD_BRS" BO_ 1078 1;
BA_ "GenMsgCycleTime" BO_ 1078 500;
BA_ "GenMsgCycleTimeFast" BO_ 1078 40;
BA_ "GenMsgSendType" BO_ 1078 3;
BA_ "VFrameFormat" BO_ 1078 14;
BA_ "CANFD_BRS" BO_ 1078 1;
BA_ "GenMsgCycleTime" BO_ 776 100;
BA_ "GenMsgCycleTimeFast" BO_ 776 0;
BA_ "GenMsgSendType" BO_ 776 0;
BA_ "VFrameFormat" BO_ 776 14;
BA_ "CANFD_BRS" BO_ 776 1;
BA_ "GenMsgCycleTime" BO_ 776 100;
BA_ "GenMsgCycleTimeFast" BO_ 776 0;
BA_ "GenMsgSendType" BO_ 776 0;
BA_ "VFrameFormat" BO_ 776 14;
BA_ "CANFD_BRS" BO_ 776 1;
BA_ "GenMsgCycleTime" BO_ 776 100;
BA_ "GenMsgCycleTimeFast" BO_ 776 0;
BA_ "GenMsgSendType" BO_ 776 0;
BA_ "VFrameFormat" BO_ 776 14;
BA_ "CANFD_BRS" BO_ 776 1;
BA_ "GenMsgCycleTime" BO_ 776 100;
BA_ "GenMsgCycleTimeFast" BO_ 776 0;
BA_ "GenMsgSendType" BO_ 776 0;
BA_ "VFrameFormat" BO_ 776 14;
BA_ "CANFD_BRS" BO_ 776 1;
BA_ "GenMsgCycleTime" BO_ 776 100;
BA_ "GenMsgCycleTimeFast" BO_ 776 0;
BA_ "GenMsgSendType" BO_ 776 0;
BA_ "VFrameFormat" BO_ 776 14;
BA_ "CANFD_BRS" BO_ 776 1;
BA_ "GenMsgCycleTime" BO_ 776 100;
BA_ "GenMsgCycleTimeFast" BO_ 776 0;
BA_ "GenMsgSendType" BO_ 776 0;
BA_ "VFrameFormat" BO_ 776 14;
BA_ "CANFD_BRS" BO_ 776 1;
BA_ "EventCommandSignal" SG_ 904 CCU_GwMsg_4_CRC 0;
BA_ "GatewayedSignals" SG_ 904 CCU_GwMsg_4_CRC 0;
BA_ "GenSigInactiveValue" SG_ 904 CCU_GwMsg_4_CRC 0;
BA_ "GenSigInvalidValue" SG_ 904 CCU_GwMsg_4_CRC 0;
BA_ "GenSigSendType" SG_ 904 CCU_GwMsg_4_CRC 1;
BA_ "GenSigStartValue" SG_ 904 CCU_GwMsg_4_CRC 0;
BA_ "GenSigTimeoutValue" SG_ 904 CCU_GwMsg_4_CRC 0;
BA_ "Remark" SG_ 904 CCU_GwMsg_4_CRC "";
BA_ "EventCommandSignal" SG_ 904 CCU_GwMsg_4_Counter 0;
BA_ "GatewayedSignals" SG_ 904 CCU_GwMsg_4_Counter 0;
BA_ "GenSigInactiveValue" SG_ 904 CCU_GwMsg_4_Counter 0;
BA_ "GenSigInvalidValue" SG_ 904 CCU_GwMsg_4_Counter 0;
BA_ "GenSigSendType" SG_ 904 CCU_GwMsg_4_Counter 1;
BA_ "GenSigStartValue" SG_ 904 CCU_GwMsg_4_Counter 0;
BA_ "GenSigTimeoutValue" SG_ 904 CCU_GwMsg_4_Counter 0;
BA_ "Remark" SG_ 904 CCU_GwMsg_4_Counter "";
BA_ "EventCommandSignal" SG_ 904 HVAC_RearDefrostSt 0;
BA_ "GatewayedSignals" SG_ 904 HVAC_RearDefrostSt 0;
BA_ "GenSigInactiveValue" SG_ 904 HVAC_RearDefrostSt 0;
BA_ "GenSigInvalidValue" SG_ 904 HVAC_RearDefrostSt 0;
BA_ "GenSigSendType" SG_ 904 HVAC_RearDefrostSt 1;
BA_ "GenSigStartValue" SG_ 904 HVAC_RearDefrostSt 0;
BA_ "GenSigTimeoutValue" SG_ 904 HVAC_RearDefrostSt 0;
BA_ "Remark" SG_ 904 HVAC_RearDefrostSt "";
BA_ "EventCommandSignal" SG_ 904 HVAC_WindExitMode 0;
BA_ "GatewayedSignals" SG_ 904 HVAC_WindExitMode 0;
BA_ "GenSigInactiveValue" SG_ 904 HVAC_WindExitMode 0;
BA_ "GenSigInvalidValue" SG_ 904 HVAC_WindExitMode 0;
BA_ "GenSigSendType" SG_ 904 HVAC_WindExitMode 1;
BA_ "GenSigStartValue" SG_ 904 HVAC_WindExitMode 0;
BA_ "GenSigTimeoutValue" SG_ 904 HVAC_WindExitMode 0;
BA_ "Remark" SG_ 904 HVAC_WindExitMode "";
BA_ "EventCommandSignal" SG_ 904 HVAC_CorrectedExterTemp 0;
BA_ "GatewayedSignals" SG_ 904 HVAC_CorrectedExterTemp 0;
BA_ "GenSigInactiveValue" SG_ 904 HVAC_CorrectedExterTemp 0;
BA_ "GenSigInvalidValue" SG_ 904 HVAC_CorrectedExterTemp 0;
BA_ "GenSigSendType" SG_ 904 HVAC_CorrectedExterTemp 1;
BA_ "GenSigStartValue" SG_ 904 HVAC_CorrectedExterTemp 120;
BA_ "GenSigTimeoutValue" SG_ 904 HVAC_CorrectedExterTemp 120;
BA_ "Remark" SG_ 904 HVAC_CorrectedExterTemp "";
BA_ "EventCommandSignal" SG_ 904 HVAC_CorrectedExterTempVD 0;
BA_ "GatewayedSignals" SG_ 904 HVAC_CorrectedExterTempVD 0;
BA_ "GenSigInactiveValue" SG_ 904 HVAC_CorrectedExterTempVD 0;
BA_ "GenSigInvalidValue" SG_ 904 HVAC_CorrectedExterTempVD 0;
BA_ "GenSigSendType" SG_ 904 HVAC_CorrectedExterTempVD 1;
BA_ "GenSigStartValue" SG_ 904 HVAC_CorrectedExterTempVD 0;
BA_ "GenSigTimeoutValue" SG_ 904 HVAC_CorrectedExterTempVD 0;
BA_ "Remark" SG_ 904 HVAC_CorrectedExterTempVD "";
BA_ "EventCommandSignal" SG_ 904 HVAC_CorrectedCabinTemp 0;
BA_ "GatewayedSignals" SG_ 904 HVAC_CorrectedCabinTemp 0;
BA_ "GenSigInactiveValue" SG_ 904 HVAC_CorrectedCabinTemp 0;
BA_ "GenSigInvalidValue" SG_ 904 HVAC_CorrectedCabinTemp 0;
BA_ "GenSigSendType" SG_ 904 HVAC_CorrectedCabinTemp 1;
BA_ "GenSigStartValue" SG_ 904 HVAC_CorrectedCabinTemp 120;
BA_ "GenSigTimeoutValue" SG_ 904 HVAC_CorrectedCabinTemp 120;
BA_ "Remark" SG_ 904 HVAC_CorrectedCabinTemp "";
BA_ "EventCommandSignal" SG_ 904 HVAC_CorrectedCabinTempVD 0;
BA_ "GatewayedSignals" SG_ 904 HVAC_CorrectedCabinTempVD 0;
BA_ "GenSigInactiveValue" SG_ 904 HVAC_CorrectedCabinTempVD 0;
BA_ "GenSigInvalidValue" SG_ 904 HVAC_CorrectedCabinTempVD 0;
BA_ "GenSigSendType" SG_ 904 HVAC_CorrectedCabinTempVD 1;
BA_ "GenSigStartValue" SG_ 904 HVAC_CorrectedCabinTempVD 0;
BA_ "GenSigTimeoutValue" SG_ 904 HVAC_CorrectedCabinTempVD 0;
BA_ "Remark" SG_ 904 HVAC_CorrectedCabinTempVD "";
BA_ "EventCommandSignal" SG_ 904 WW_FwpFaultSt 0;
BA_ "GatewayedSignals" SG_ 904 WW_FwpFaultSt 0;
BA_ "GenSigInactiveValue" SG_ 904 WW_FwpFaultSt 0;
BA_ "GenSigInvalidValue" SG_ 904 WW_FwpFaultSt 0;
BA_ "GenSigSendType" SG_ 904 WW_FwpFaultSt 1;
BA_ "GenSigStartValue" SG_ 904 WW_FwpFaultSt 0;
BA_ "GenSigTimeoutValue" SG_ 904 WW_FwpFaultSt 0;
BA_ "Remark" SG_ 904 WW_FwpFaultSt "";
BA_ "EventCommandSignal" SG_ 904 WW_RwpFaultSt 0;
BA_ "GatewayedSignals" SG_ 904 WW_RwpFaultSt 0;
BA_ "GenSigInactiveValue" SG_ 904 WW_RwpFaultSt 0;
BA_ "GenSigInvalidValue" SG_ 904 WW_RwpFaultSt 0;
BA_ "GenSigSendType" SG_ 904 WW_RwpFaultSt 1;
BA_ "GenSigStartValue" SG_ 904 WW_RwpFaultSt 0;
BA_ "GenSigTimeoutValue" SG_ 904 WW_RwpFaultSt 0;
BA_ "Remark" SG_ 904 WW_RwpFaultSt "";
BA_ "EventCommandSignal" SG_ 904 WW_FwshFaultSt 0;
BA_ "GatewayedSignals" SG_ 904 WW_FwshFaultSt 0;
BA_ "GenSigInactiveValue" SG_ 904 WW_FwshFaultSt 0;
BA_ "GenSigInvalidValue" SG_ 904 WW_FwshFaultSt 0;
BA_ "GenSigSendType" SG_ 904 WW_FwshFaultSt 1;
BA_ "GenSigStartValue" SG_ 904 WW_FwshFaultSt 0;
BA_ "GenSigTimeoutValue" SG_ 904 WW_FwshFaultSt 0;
BA_ "Remark" SG_ 904 WW_FwshFaultSt "";
BA_ "EventCommandSignal" SG_ 904 WW_RwshFaultSt 0;
BA_ "GatewayedSignals" SG_ 904 WW_RwshFaultSt 0;
BA_ "GenSigInactiveValue" SG_ 904 WW_RwshFaultSt 0;
BA_ "GenSigInvalidValue" SG_ 904 WW_RwshFaultSt 0;
BA_ "GenSigSendType" SG_ 904 WW_RwshFaultSt 1;
BA_ "GenSigStartValue" SG_ 904 WW_RwshFaultSt 0;
BA_ "GenSigTimeoutValue" SG_ 904 WW_RwshFaultSt 0;
BA_ "Remark" SG_ 904 WW_RwshFaultSt "";
BA_ "EventCommandSignal" SG_ 904 WW_FwpAutoModeSt 0;
BA_ "GatewayedSignals" SG_ 904 WW_FwpAutoModeSt 0;
BA_ "GenSigInactiveValue" SG_ 904 WW_FwpAutoModeSt 0;
BA_ "GenSigInvalidValue" SG_ 904 WW_FwpAutoModeSt 0;
BA_ "GenSigSendType" SG_ 904 WW_FwpAutoModeSt 1;
BA_ "GenSigStartValue" SG_ 904 WW_FwpAutoModeSt 0;
BA_ "GenSigTimeoutValue" SG_ 904 WW_FwpAutoModeSt 0;
BA_ "Remark" SG_ 904 WW_FwpAutoModeSt "";
BA_ "EventCommandSignal" SG_ 904 WW_RainFallLevel 0;
BA_ "GatewayedSignals" SG_ 904 WW_RainFallLevel 0;
BA_ "GenSigInactiveValue" SG_ 904 WW_RainFallLevel 0;
BA_ "GenSigInvalidValue" SG_ 904 WW_RainFallLevel 0;
BA_ "GenSigSendType" SG_ 904 WW_RainFallLevel 1;
BA_ "GenSigStartValue" SG_ 904 WW_RainFallLevel 0;
BA_ "GenSigTimeoutValue" SG_ 904 WW_RainFallLevel 0;
BA_ "Remark" SG_ 904 WW_RainFallLevel "";
BA_ "EventCommandSignal" SG_ 904 RLS_LightOnReq 0;
BA_ "GatewayedSignals" SG_ 904 RLS_LightOnReq 0;
BA_ "GenSigInactiveValue" SG_ 904 RLS_LightOnReq 0;
BA_ "GenSigInvalidValue" SG_ 904 RLS_LightOnReq 0;
BA_ "GenSigSendType" SG_ 904 RLS_LightOnReq 1;
BA_ "GenSigStartValue" SG_ 904 RLS_LightOnReq 0;
BA_ "GenSigTimeoutValue" SG_ 904 RLS_LightOnReq 0;
BA_ "Remark" SG_ 904 RLS_LightOnReq "";
BA_ "EventCommandSignal" SG_ 904 RLS_LampOnReqValid 0;
BA_ "GatewayedSignals" SG_ 904 RLS_LampOnReqValid 0;
BA_ "GenSigInactiveValue" SG_ 904 RLS_LampOnReqValid 0;
BA_ "GenSigInvalidValue" SG_ 904 RLS_LampOnReqValid 0;
BA_ "GenSigSendType" SG_ 904 RLS_LampOnReqValid 1;
BA_ "GenSigStartValue" SG_ 904 RLS_LampOnReqValid 0;
BA_ "GenSigTimeoutValue" SG_ 904 RLS_LampOnReqValid 0;
BA_ "Remark" SG_ 904 RLS_LampOnReqValid "";
BA_ "EventCommandSignal" SG_ 904 RLS_WiperSpd 0;
BA_ "GatewayedSignals" SG_ 904 RLS_WiperSpd 0;
BA_ "GenSigInactiveValue" SG_ 904 RLS_WiperSpd 0;
BA_ "GenSigInvalidValue" SG_ 904 RLS_WiperSpd 0;
BA_ "GenSigSendType" SG_ 904 RLS_WiperSpd 1;
BA_ "GenSigStartValue" SG_ 904 RLS_WiperSpd 0;
BA_ "GenSigTimeoutValue" SG_ 904 RLS_WiperSpd 0;
BA_ "Remark" SG_ 904 RLS_WiperSpd "";
BA_ "EventCommandSignal" SG_ 904 RLS_AMBBrightness 0;
BA_ "GatewayedSignals" SG_ 904 RLS_AMBBrightness 0;
BA_ "GenSigInactiveValue" SG_ 904 RLS_AMBBrightness 0;
BA_ "GenSigInvalidValue" SG_ 904 RLS_AMBBrightness 0;
BA_ "GenSigSendType" SG_ 904 RLS_AMBBrightness 1;
BA_ "GenSigStartValue" SG_ 904 RLS_AMBBrightness 16382;
BA_ "GenSigTimeoutValue" SG_ 904 RLS_AMBBrightness 0;
BA_ "Remark" SG_ 904 RLS_AMBBrightness "";
BA_ "EventCommandSignal" SG_ 904 RLS_FWBrightness 0;
BA_ "GatewayedSignals" SG_ 904 RLS_FWBrightness 0;
BA_ "GenSigInactiveValue" SG_ 904 RLS_FWBrightness 0;
BA_ "GenSigInvalidValue" SG_ 904 RLS_FWBrightness 0;
BA_ "GenSigSendType" SG_ 904 RLS_FWBrightness 1;
BA_ "GenSigStartValue" SG_ 904 RLS_FWBrightness 16382;
BA_ "GenSigTimeoutValue" SG_ 904 RLS_FWBrightness 0;
BA_ "Remark" SG_ 904 RLS_FWBrightness "";
BA_ "EventCommandSignal" SG_ 904 RLS_RainfallLevel 0;
BA_ "GatewayedSignals" SG_ 904 RLS_RainfallLevel 0;
BA_ "GenSigInactiveValue" SG_ 904 RLS_RainfallLevel 0;
BA_ "GenSigInvalidValue" SG_ 904 RLS_RainfallLevel 0;
BA_ "GenSigSendType" SG_ 904 RLS_RainfallLevel 1;
BA_ "GenSigStartValue" SG_ 904 RLS_RainfallLevel 14;
BA_ "GenSigTimeoutValue" SG_ 904 RLS_RainfallLevel 0;
BA_ "Remark" SG_ 904 RLS_RainfallLevel "";
BA_ "EventCommandSignal" SG_ 904 RLS_RSErr 0;
BA_ "GatewayedSignals" SG_ 904 RLS_RSErr 0;
BA_ "GenSigInactiveValue" SG_ 904 RLS_RSErr 0;
BA_ "GenSigInvalidValue" SG_ 904 RLS_RSErr 0;
BA_ "GenSigSendType" SG_ 904 RLS_RSErr 1;
BA_ "GenSigStartValue" SG_ 904 RLS_RSErr 0;
BA_ "GenSigTimeoutValue" SG_ 904 RLS_RSErr 0;
BA_ "Remark" SG_ 904 RLS_RSErr "";
BA_ "EventCommandSignal" SG_ 904 RLS_LSErr 0;
BA_ "GatewayedSignals" SG_ 904 RLS_LSErr 0;
BA_ "GenSigInactiveValue" SG_ 904 RLS_LSErr 0;
BA_ "GenSigInvalidValue" SG_ 904 RLS_LSErr 0;
BA_ "GenSigSendType" SG_ 904 RLS_LSErr 1;
BA_ "GenSigStartValue" SG_ 904 RLS_LSErr 0;
BA_ "GenSigTimeoutValue" SG_ 904 RLS_LSErr 0;
BA_ "Remark" SG_ 904 RLS_LSErr "";
BA_ "EventCommandSignal" SG_ 904 PM_AUTHPstState 0;
BA_ "GatewayedSignals" SG_ 904 PM_AUTHPstState 0;
BA_ "GenSigInactiveValue" SG_ 904 PM_AUTHPstState 0;
BA_ "GenSigInvalidValue" SG_ 904 PM_AUTHPstState 0;
BA_ "GenSigSendType" SG_ 904 PM_AUTHPstState 1;
BA_ "GenSigStartValue" SG_ 904 PM_AUTHPstState 0;
BA_ "GenSigTimeoutValue" SG_ 904 PM_AUTHPstState 0;
BA_ "Remark" SG_ 904 PM_AUTHPstState "";
BA_ "EventCommandSignal" SG_ 904 CCU_FuncReq_SentryMod 0;
BA_ "GatewayedSignals" SG_ 904 CCU_FuncReq_SentryMod 0;
BA_ "GenSigInactiveValue" SG_ 904 CCU_FuncReq_SentryMod 0;
BA_ "GenSigInvalidValue" SG_ 904 CCU_FuncReq_SentryMod 0;
BA_ "GenSigSendType" SG_ 904 CCU_FuncReq_SentryMod 1;
BA_ "GenSigStartValue" SG_ 904 CCU_FuncReq_SentryMod 0;
BA_ "GenSigTimeoutValue" SG_ 904 CCU_FuncReq_SentryMod 0;
BA_ "Remark" SG_ 904 CCU_FuncReq_SentryMod "";
BA_ "EventCommandSignal" SG_ 904 RLS_WindShieldHum 0;
BA_ "GatewayedSignals" SG_ 904 RLS_WindShieldHum 0;
BA_ "GenSigInactiveValue" SG_ 904 RLS_WindShieldHum 0;
BA_ "GenSigInvalidValue" SG_ 904 RLS_WindShieldHum 0;
BA_ "GenSigSendType" SG_ 904 RLS_WindShieldHum 1;
BA_ "GenSigStartValue" SG_ 904 RLS_WindShieldHum 0;
BA_ "GenSigTimeoutValue" SG_ 904 RLS_WindShieldHum 0;
BA_ "Remark" SG_ 904 RLS_WindShieldHum "";
BA_ "EventCommandSignal" SG_ 904 RLS_WindShieldTem 0;
BA_ "GatewayedSignals" SG_ 904 RLS_WindShieldTem 0;
BA_ "GenSigInactiveValue" SG_ 904 RLS_WindShieldTem 0;
BA_ "GenSigInvalidValue" SG_ 904 RLS_WindShieldTem 0;
BA_ "GenSigSendType" SG_ 904 RLS_WindShieldTem 1;
BA_ "GenSigStartValue" SG_ 904 RLS_WindShieldTem 254;
BA_ "GenSigTimeoutValue" SG_ 904 RLS_WindShieldTem 0;
BA_ "Remark" SG_ 904 RLS_WindShieldTem "";
BA_ "EventCommandSignal" SG_ 904 RLS_DewPoint 0;
BA_ "GatewayedSignals" SG_ 904 RLS_DewPoint 0;
BA_ "GenSigInactiveValue" SG_ 904 RLS_DewPoint 0;
BA_ "GenSigInvalidValue" SG_ 904 RLS_DewPoint 0;
BA_ "GenSigSendType" SG_ 904 RLS_DewPoint 1;
BA_ "GenSigStartValue" SG_ 904 RLS_DewPoint 254;
BA_ "GenSigTimeoutValue" SG_ 904 RLS_DewPoint 0;
BA_ "Remark" SG_ 904 RLS_DewPoint "";
BA_ "EventCommandSignal" SG_ 904 CCU_ModeSuppressSts 0;
BA_ "GatewayedSignals" SG_ 904 CCU_ModeSuppressSts 0;
BA_ "GenSigInactiveValue" SG_ 904 CCU_ModeSuppressSts 0;
BA_ "GenSigInvalidValue" SG_ 904 CCU_ModeSuppressSts 0;
BA_ "GenSigSendType" SG_ 904 CCU_ModeSuppressSts 1;
BA_ "GenSigStartValue" SG_ 904 CCU_ModeSuppressSts 0;
BA_ "GenSigTimeoutValue" SG_ 904 CCU_ModeSuppressSts 0;
BA_ "Remark" SG_ 904 CCU_ModeSuppressSts "";
BA_ "EventCommandSignal" SG_ 904 RLS_HUTErr 0;
BA_ "GatewayedSignals" SG_ 904 RLS_HUTErr 0;
BA_ "GenSigInactiveValue" SG_ 904 RLS_HUTErr 0;
BA_ "GenSigInvalidValue" SG_ 904 RLS_HUTErr 0;
BA_ "GenSigSendType" SG_ 904 RLS_HUTErr 1;
BA_ "GenSigStartValue" SG_ 904 RLS_HUTErr 0;
BA_ "GenSigTimeoutValue" SG_ 904 RLS_HUTErr 0;
BA_ "Remark" SG_ 904 RLS_HUTErr "";
BA_ "EventCommandSignal" SG_ 904 SR_SunroofCurrentPst 0;
BA_ "GatewayedSignals" SG_ 904 SR_SunroofCurrentPst 0;
BA_ "GenSigInactiveValue" SG_ 904 SR_SunroofCurrentPst 0;
BA_ "GenSigInvalidValue" SG_ 904 SR_SunroofCurrentPst 0;
BA_ "GenSigSendType" SG_ 904 SR_SunroofCurrentPst 1;
BA_ "GenSigStartValue" SG_ 904 SR_SunroofCurrentPst 255;
BA_ "GenSigTimeoutValue" SG_ 904 SR_SunroofCurrentPst 0;
BA_ "Remark" SG_ 904 SR_SunroofCurrentPst "";
BA_ "EventCommandSignal" SG_ 904 EL_LeftBSDIndicatorSt 0;
BA_ "GatewayedSignals" SG_ 904 EL_LeftBSDIndicatorSt 0;
BA_ "GenSigInactiveValue" SG_ 904 EL_LeftBSDIndicatorSt 0;
BA_ "GenSigInvalidValue" SG_ 904 EL_LeftBSDIndicatorSt 0;
BA_ "GenSigSendType" SG_ 904 EL_LeftBSDIndicatorSt 1;
BA_ "GenSigStartValue" SG_ 904 EL_LeftBSDIndicatorSt 0;
BA_ "GenSigTimeoutValue" SG_ 904 EL_LeftBSDIndicatorSt 0;
BA_ "Remark" SG_ 904 EL_LeftBSDIndicatorSt "";
BA_ "EventCommandSignal" SG_ 904 UINM_HazardLightSwSt 0;
BA_ "GatewayedSignals" SG_ 904 UINM_HazardLightSwSt 0;
BA_ "GenSigInactiveValue" SG_ 904 UINM_HazardLightSwSt 0;
BA_ "GenSigInvalidValue" SG_ 904 UINM_HazardLightSwSt 0;
BA_ "GenSigSendType" SG_ 904 UINM_HazardLightSwSt 1;
BA_ "GenSigStartValue" SG_ 904 UINM_HazardLightSwSt 0;
BA_ "GenSigTimeoutValue" SG_ 904 UINM_HazardLightSwSt 0;
BA_ "Remark" SG_ 904 UINM_HazardLightSwSt "";
BA_ "EventCommandSignal" SG_ 904 EL_MLTurnLightSt 0;
BA_ "GatewayedSignals" SG_ 904 EL_MLTurnLightSt 0;
BA_ "GenSigInactiveValue" SG_ 904 EL_MLTurnLightSt 0;
BA_ "GenSigInvalidValue" SG_ 904 EL_MLTurnLightSt 0;
BA_ "GenSigSendType" SG_ 904 EL_MLTurnLightSt 1;
BA_ "GenSigStartValue" SG_ 904 EL_MLTurnLightSt 0;
BA_ "GenSigTimeoutValue" SG_ 904 EL_MLTurnLightSt 0;
BA_ "Remark" SG_ 904 EL_MLTurnLightSt "";
BA_ "EventCommandSignal" SG_ 904 EL_MLTurnLightFaultSt 0;
BA_ "GatewayedSignals" SG_ 904 EL_MLTurnLightFaultSt 0;
BA_ "GenSigInactiveValue" SG_ 904 EL_MLTurnLightFaultSt 0;
BA_ "GenSigInvalidValue" SG_ 904 EL_MLTurnLightFaultSt 0;
BA_ "GenSigSendType" SG_ 904 EL_MLTurnLightFaultSt 1;
BA_ "GenSigStartValue" SG_ 904 EL_MLTurnLightFaultSt 0;
BA_ "GenSigTimeoutValue" SG_ 904 EL_MLTurnLightFaultSt 0;
BA_ "Remark" SG_ 904 EL_MLTurnLightFaultSt "";
BA_ "EventCommandSignal" SG_ 904 EL_LeftBSDIndicatorFaultSt 0;
BA_ "GatewayedSignals" SG_ 904 EL_LeftBSDIndicatorFaultSt 0;
BA_ "GenSigInactiveValue" SG_ 904 EL_LeftBSDIndicatorFaultSt 0;
BA_ "GenSigInvalidValue" SG_ 904 EL_LeftBSDIndicatorFaultSt 0;
BA_ "GenSigSendType" SG_ 904 EL_LeftBSDIndicatorFaultSt 1;
BA_ "GenSigStartValue" SG_ 904 EL_LeftBSDIndicatorFaultSt 0;
BA_ "GenSigTimeoutValue" SG_ 904 EL_LeftBSDIndicatorFaultSt 0;
BA_ "Remark" SG_ 904 EL_LeftBSDIndicatorFaultSt "";
BA_ "EventCommandSignal" SG_ 904 ZCUL_FrtWindshildHeatSt 0;
BA_ "GatewayedSignals" SG_ 904 ZCUL_FrtWindshildHeatSt 0;
BA_ "GenSigInactiveValue" SG_ 904 ZCUL_FrtWindshildHeatSt 0;
BA_ "GenSigInvalidValue" SG_ 904 ZCUL_FrtWindshildHeatSt 0;
BA_ "GenSigSendType" SG_ 904 ZCUL_FrtWindshildHeatSt 1;
BA_ "GenSigStartValue" SG_ 904 ZCUL_FrtWindshildHeatSt 0;
BA_ "GenSigTimeoutValue" SG_ 904 ZCUL_FrtWindshildHeatSt 0;
BA_ "Remark" SG_ 904 ZCUL_FrtWindshildHeatSt "";
BA_ "EventCommandSignal" SG_ 904 ACU_PCS_SVM_MODCmd 0;
BA_ "GatewayedSignals" SG_ 904 ACU_PCS_SVM_MODCmd 0;
BA_ "GenSigInactiveValue" SG_ 904 ACU_PCS_SVM_MODCmd 0;
BA_ "GenSigInvalidValue" SG_ 904 ACU_PCS_SVM_MODCmd 0;
BA_ "GenSigSendType" SG_ 904 ACU_PCS_SVM_MODCmd 1;
BA_ "GenSigStartValue" SG_ 904 ACU_PCS_SVM_MODCmd 0;
BA_ "GenSigTimeoutValue" SG_ 904 ACU_PCS_SVM_MODCmd 0;
BA_ "Remark" SG_ 904 ACU_PCS_SVM_MODCmd "";
BA_ "EventCommandSignal" SG_ 904 ACU_HeadLightVirtualSwSt 0;
BA_ "GatewayedSignals" SG_ 904 ACU_HeadLightVirtualSwSt 0;
BA_ "GenSigInactiveValue" SG_ 904 ACU_HeadLightVirtualSwSt 0;
BA_ "GenSigInvalidValue" SG_ 904 ACU_HeadLightVirtualSwSt 0;
BA_ "GenSigSendType" SG_ 904 ACU_HeadLightVirtualSwSt 1;
BA_ "GenSigStartValue" SG_ 904 ACU_HeadLightVirtualSwSt 0;
BA_ "GenSigTimeoutValue" SG_ 904 ACU_HeadLightVirtualSwSt 0;
BA_ "Remark" SG_ 904 ACU_HeadLightVirtualSwSt "";
BA_ "EventCommandSignal" SG_ 904 ACU_FrontFogLightVirtualSwSt 0;
BA_ "GatewayedSignals" SG_ 904 ACU_FrontFogLightVirtualSwSt 0;
BA_ "GenSigInactiveValue" SG_ 904 ACU_FrontFogLightVirtualSwSt 0;
BA_ "GenSigInvalidValue" SG_ 904 ACU_FrontFogLightVirtualSwSt 0;
BA_ "GenSigSendType" SG_ 904 ACU_FrontFogLightVirtualSwSt 1;
BA_ "GenSigStartValue" SG_ 904 ACU_FrontFogLightVirtualSwSt 0;
BA_ "GenSigTimeoutValue" SG_ 904 ACU_FrontFogLightVirtualSwSt 0;
BA_ "Remark" SG_ 904 ACU_FrontFogLightVirtualSwSt "";
BA_ "EventCommandSignal" SG_ 904 ACU_RearFogLightVirtualSwSt 0;
BA_ "GatewayedSignals" SG_ 904 ACU_RearFogLightVirtualSwSt 0;
BA_ "GenSigInactiveValue" SG_ 904 ACU_RearFogLightVirtualSwSt 0;
BA_ "GenSigInvalidValue" SG_ 904 ACU_RearFogLightVirtualSwSt 0;
BA_ "GenSigSendType" SG_ 904 ACU_RearFogLightVirtualSwSt 1;
BA_ "GenSigStartValue" SG_ 904 ACU_RearFogLightVirtualSwSt 0;
BA_ "GenSigTimeoutValue" SG_ 904 ACU_RearFogLightVirtualSwSt 0;
BA_ "Remark" SG_ 904 ACU_RearFogLightVirtualSwSt "";
BA_ "EventCommandSignal" SG_ 904 ACU_Account_Uid 0;
BA_ "GatewayedSignals" SG_ 904 ACU_Account_Uid 0;
BA_ "GenSigInactiveValue" SG_ 904 ACU_Account_Uid 0;
BA_ "GenSigInvalidValue" SG_ 904 ACU_Account_Uid 0;
BA_ "GenSigSendType" SG_ 904 ACU_Account_Uid 1;
BA_ "GenSigStartValue" SG_ 904 ACU_Account_Uid 0;
BA_ "GenSigTimeoutValue" SG_ 904 ACU_Account_Uid 0;
BA_ "Remark" SG_ 904 ACU_Account_Uid "";
BA_ "EventCommandSignal" SG_ 904 ACU_IHBC_SwitchReq 0;
BA_ "GatewayedSignals" SG_ 904 ACU_IHBC_SwitchReq 0;
BA_ "GenSigInactiveValue" SG_ 904 ACU_IHBC_SwitchReq 0;
BA_ "GenSigInvalidValue" SG_ 904 ACU_IHBC_SwitchReq 0;
BA_ "GenSigSendType" SG_ 904 ACU_IHBC_SwitchReq 1;
BA_ "GenSigStartValue" SG_ 904 ACU_IHBC_SwitchReq 0;
BA_ "GenSigTimeoutValue" SG_ 904 ACU_IHBC_SwitchReq 0;
BA_ "Remark" SG_ 904 ACU_IHBC_SwitchReq "";
BA_ "EventCommandSignal" SG_ 904 ACU_NDASwitchReq 0;
BA_ "GatewayedSignals" SG_ 904 ACU_NDASwitchReq 0;
BA_ "GenSigInactiveValue" SG_ 904 ACU_NDASwitchReq 0;
BA_ "GenSigInvalidValue" SG_ 904 ACU_NDASwitchReq 0;
BA_ "GenSigSendType" SG_ 904 ACU_NDASwitchReq 1;
BA_ "GenSigStartValue" SG_ 904 ACU_NDASwitchReq 0;
BA_ "GenSigTimeoutValue" SG_ 904 ACU_NDASwitchReq 0;
BA_ "Remark" SG_ 904 ACU_NDASwitchReq "";
BA_ "EventCommandSignal" SG_ 904 ACU_NDALCConSwitchReq 0;
BA_ "GatewayedSignals" SG_ 904 ACU_NDALCConSwitchReq 0;
BA_ "GenSigInactiveValue" SG_ 904 ACU_NDALCConSwitchReq 0;
BA_ "GenSigInvalidValue" SG_ 904 ACU_NDALCConSwitchReq 0;
BA_ "GenSigSendType" SG_ 904 ACU_NDALCConSwitchReq 1;
BA_ "GenSigStartValue" SG_ 904 ACU_NDALCConSwitchReq 0;
BA_ "GenSigTimeoutValue" SG_ 904 ACU_NDALCConSwitchReq 0;
BA_ "Remark" SG_ 904 ACU_NDALCConSwitchReq "";
BA_ "EventCommandSignal" SG_ 904 ACU_NDALCStySwitchReq 0;
BA_ "GatewayedSignals" SG_ 904 ACU_NDALCStySwitchReq 0;
BA_ "GenSigInactiveValue" SG_ 904 ACU_NDALCStySwitchReq 0;
BA_ "GenSigInvalidValue" SG_ 904 ACU_NDALCStySwitchReq 0;
BA_ "GenSigSendType" SG_ 904 ACU_NDALCStySwitchReq 1;
BA_ "GenSigStartValue" SG_ 904 ACU_NDALCStySwitchReq 0;
BA_ "GenSigTimeoutValue" SG_ 904 ACU_NDALCStySwitchReq 0;
BA_ "Remark" SG_ 904 ACU_NDALCStySwitchReq "";
BA_ "EventCommandSignal" SG_ 904 ACU_ADASWarnTypeSwitch 0;
BA_ "GatewayedSignals" SG_ 904 ACU_ADASWarnTypeSwitch 0;
BA_ "GenSigInactiveValue" SG_ 904 ACU_ADASWarnTypeSwitch 0;
BA_ "GenSigInvalidValue" SG_ 904 ACU_ADASWarnTypeSwitch 0;
BA_ "GenSigSendType" SG_ 904 ACU_ADASWarnTypeSwitch 1;
BA_ "GenSigStartValue" SG_ 904 ACU_ADASWarnTypeSwitch 0;
BA_ "GenSigTimeoutValue" SG_ 904 ACU_ADASWarnTypeSwitch 0;
BA_ "Remark" SG_ 904 ACU_ADASWarnTypeSwitch "";
BA_ "EventCommandSignal" SG_ 904 ACU_iACC_StyleConfirmSwitchReq 0;
BA_ "GatewayedSignals" SG_ 904 ACU_iACC_StyleConfirmSwitchReq 0;
BA_ "GenSigInactiveValue" SG_ 904 ACU_iACC_StyleConfirmSwitchReq 0;
BA_ "GenSigInvalidValue" SG_ 904 ACU_iACC_StyleConfirmSwitchReq 0;
BA_ "GenSigSendType" SG_ 904 ACU_iACC_StyleConfirmSwitchReq 1;
BA_ "GenSigStartValue" SG_ 904 ACU_iACC_StyleConfirmSwitchReq 3;
BA_ "GenSigTimeoutValue" SG_ 904 ACU_iACC_StyleConfirmSwitchReq 0;
BA_ "Remark" SG_ 904 ACU_iACC_StyleConfirmSwitchReq "";
BA_ "EventCommandSignal" SG_ 904 ACU_IFC_SpeedLimit 0;
BA_ "GatewayedSignals" SG_ 904 ACU_IFC_SpeedLimit 0;
BA_ "GenSigInactiveValue" SG_ 904 ACU_IFC_SpeedLimit 0;
BA_ "GenSigInvalidValue" SG_ 904 ACU_IFC_SpeedLimit 0;
BA_ "GenSigSendType" SG_ 904 ACU_IFC_SpeedLimit 1;
BA_ "GenSigStartValue" SG_ 904 ACU_IFC_SpeedLimit 0;
BA_ "GenSigTimeoutValue" SG_ 904 ACU_IFC_SpeedLimit 0;
BA_ "Remark" SG_ 904 ACU_IFC_SpeedLimit "";
BA_ "EventCommandSignal" SG_ 904 ACU_IFC_ISDRestOfdis 0;
BA_ "GatewayedSignals" SG_ 904 ACU_IFC_ISDRestOfdis 0;
BA_ "GenSigInactiveValue" SG_ 904 ACU_IFC_ISDRestOfdis 0;
BA_ "GenSigInvalidValue" SG_ 904 ACU_IFC_ISDRestOfdis 0;
BA_ "GenSigSendType" SG_ 904 ACU_IFC_ISDRestOfdis 1;
BA_ "GenSigStartValue" SG_ 904 ACU_IFC_ISDRestOfdis 0;
BA_ "GenSigTimeoutValue" SG_ 904 ACU_IFC_ISDRestOfdis 0;
BA_ "Remark" SG_ 904 ACU_IFC_ISDRestOfdis "";
BA_ "EventCommandSignal" SG_ 904 ACU_IFC_SpeedLimitUnit 0;
BA_ "GatewayedSignals" SG_ 904 ACU_IFC_SpeedLimitUnit 0;
BA_ "GenSigInactiveValue" SG_ 904 ACU_IFC_SpeedLimitUnit 0;
BA_ "GenSigInvalidValue" SG_ 904 ACU_IFC_SpeedLimitUnit 0;
BA_ "GenSigSendType" SG_ 904 ACU_IFC_SpeedLimitUnit 1;
BA_ "GenSigStartValue" SG_ 904 ACU_IFC_SpeedLimitUnit 0;
BA_ "GenSigTimeoutValue" SG_ 904 ACU_IFC_SpeedLimitUnit 1;
BA_ "Remark" SG_ 904 ACU_IFC_SpeedLimitUnit "";
BA_ "EventCommandSignal" SG_ 904 ACU_ThemeType 0;
BA_ "GatewayedSignals" SG_ 904 ACU_ThemeType 0;
BA_ "GenSigInactiveValue" SG_ 904 ACU_ThemeType 0;
BA_ "GenSigInvalidValue" SG_ 904 ACU_ThemeType 0;
BA_ "GenSigSendType" SG_ 904 ACU_ThemeType 1;
BA_ "GenSigStartValue" SG_ 904 ACU_ThemeType 0;
BA_ "GenSigTimeoutValue" SG_ 904 ACU_ThemeType 0;
BA_ "Remark" SG_ 904 ACU_ThemeType "";
BA_ "EventCommandSignal" SG_ 904 ACU_IFC_SpeedLimtType 0;
BA_ "GatewayedSignals" SG_ 904 ACU_IFC_SpeedLimtType 0;
BA_ "GenSigInactiveValue" SG_ 904 ACU_IFC_SpeedLimtType 0;
BA_ "GenSigInvalidValue" SG_ 904 ACU_IFC_SpeedLimtType 0;
BA_ "GenSigSendType" SG_ 904 ACU_IFC_SpeedLimtType 1;
BA_ "GenSigStartValue" SG_ 904 ACU_IFC_SpeedLimtType 0;
BA_ "GenSigTimeoutValue" SG_ 904 ACU_IFC_SpeedLimtType 0;
BA_ "Remark" SG_ 904 ACU_IFC_SpeedLimtType "";
BA_ "EventCommandSignal" SG_ 904 ACU_IFC_RoadType 0;
BA_ "GatewayedSignals" SG_ 904 ACU_IFC_RoadType 0;
BA_ "GenSigInactiveValue" SG_ 904 ACU_IFC_RoadType 0;
BA_ "GenSigInvalidValue" SG_ 904 ACU_IFC_RoadType 0;
BA_ "GenSigSendType" SG_ 904 ACU_IFC_RoadType 1;
BA_ "GenSigStartValue" SG_ 904 ACU_IFC_RoadType 0;
BA_ "GenSigTimeoutValue" SG_ 904 ACU_IFC_RoadType 0;
BA_ "Remark" SG_ 904 ACU_IFC_RoadType "";
BA_ "EventCommandSignal" SG_ 904 ACU_IFC_ZoneCode 0;
BA_ "GatewayedSignals" SG_ 904 ACU_IFC_ZoneCode 0;
BA_ "GenSigInactiveValue" SG_ 904 ACU_IFC_ZoneCode 0;
BA_ "GenSigInvalidValue" SG_ 904 ACU_IFC_ZoneCode 0;
BA_ "GenSigSendType" SG_ 904 ACU_IFC_ZoneCode 1;
BA_ "GenSigStartValue" SG_ 904 ACU_IFC_ZoneCode 0;
BA_ "GenSigTimeoutValue" SG_ 904 ACU_IFC_ZoneCode 1;
BA_ "Remark" SG_ 904 ACU_IFC_ZoneCode "";
BA_ "EventCommandSignal" SG_ 904 ACU_IFC_NaviSt 0;
BA_ "GatewayedSignals" SG_ 904 ACU_IFC_NaviSt 0;
BA_ "GenSigInactiveValue" SG_ 904 ACU_IFC_NaviSt 0;
BA_ "GenSigInvalidValue" SG_ 904 ACU_IFC_NaviSt 0;
BA_ "GenSigSendType" SG_ 904 ACU_IFC_NaviSt 1;
BA_ "GenSigStartValue" SG_ 904 ACU_IFC_NaviSt 0;
BA_ "GenSigTimeoutValue" SG_ 904 ACU_IFC_NaviSt 0;
BA_ "Remark" SG_ 904 ACU_IFC_NaviSt "";
BA_ "EventCommandSignal" SG_ 904 ACU_IFC_NaviCorp 0;
BA_ "GatewayedSignals" SG_ 904 ACU_IFC_NaviCorp 0;
BA_ "GenSigInactiveValue" SG_ 904 ACU_IFC_NaviCorp 0;
BA_ "GenSigInvalidValue" SG_ 904 ACU_IFC_NaviCorp 0;
BA_ "GenSigSendType" SG_ 904 ACU_IFC_NaviCorp 1;
BA_ "GenSigStartValue" SG_ 904 ACU_IFC_NaviCorp 0;
BA_ "GenSigTimeoutValue" SG_ 904 ACU_IFC_NaviCorp 0;
BA_ "Remark" SG_ 904 ACU_IFC_NaviCorp "";
BA_ "EventCommandSignal" SG_ 904 ACU_IFC_NaviNewIconDis 0;
BA_ "GatewayedSignals" SG_ 904 ACU_IFC_NaviNewIconDis 0;
BA_ "GenSigInactiveValue" SG_ 904 ACU_IFC_NaviNewIconDis 0;
BA_ "GenSigInvalidValue" SG_ 904 ACU_IFC_NaviNewIconDis 0;
BA_ "GenSigSendType" SG_ 904 ACU_IFC_NaviNewIconDis 1;
BA_ "GenSigStartValue" SG_ 904 ACU_IFC_NaviNewIconDis 0;
BA_ "GenSigTimeoutValue" SG_ 904 ACU_IFC_NaviNewIconDis 0;
BA_ "Remark" SG_ 904 ACU_IFC_NaviNewIconDis "";
BA_ "EventCommandSignal" SG_ 904 ACU_IFC_OfframpSt 0;
BA_ "GatewayedSignals" SG_ 904 ACU_IFC_OfframpSt 0;
BA_ "GenSigInactiveValue" SG_ 904 ACU_IFC_OfframpSt 0;
BA_ "GenSigInvalidValue" SG_ 904 ACU_IFC_OfframpSt 0;
BA_ "GenSigSendType" SG_ 904 ACU_IFC_OfframpSt 1;
BA_ "GenSigStartValue" SG_ 904 ACU_IFC_OfframpSt 0;
BA_ "GenSigTimeoutValue" SG_ 904 ACU_IFC_OfframpSt 0;
BA_ "Remark" SG_ 904 ACU_IFC_OfframpSt "";
BA_ "EventCommandSignal" SG_ 904 ACU_IFC_NaviNewIcon 0;
BA_ "GatewayedSignals" SG_ 904 ACU_IFC_NaviNewIcon 0;
BA_ "GenSigInactiveValue" SG_ 904 ACU_IFC_NaviNewIcon 0;
BA_ "GenSigInvalidValue" SG_ 904 ACU_IFC_NaviNewIcon 0;
BA_ "GenSigSendType" SG_ 904 ACU_IFC_NaviNewIcon 1;
BA_ "GenSigStartValue" SG_ 904 ACU_IFC_NaviNewIcon 0;
BA_ "GenSigTimeoutValue" SG_ 904 ACU_IFC_NaviNewIcon 0;
BA_ "Remark" SG_ 904 ACU_IFC_NaviNewIcon "";
BA_ "EventCommandSignal" SG_ 904 ACU_IFC_SLCAheadDis 0;
BA_ "GatewayedSignals" SG_ 904 ACU_IFC_SLCAheadDis 0;
BA_ "GenSigInactiveValue" SG_ 904 ACU_IFC_SLCAheadDis 0;
BA_ "GenSigInvalidValue" SG_ 904 ACU_IFC_SLCAheadDis 0;
BA_ "GenSigSendType" SG_ 904 ACU_IFC_SLCAheadDis 1;
BA_ "GenSigStartValue" SG_ 904 ACU_IFC_SLCAheadDis 0;
BA_ "GenSigTimeoutValue" SG_ 904 ACU_IFC_SLCAheadDis 0;
BA_ "Remark" SG_ 904 ACU_IFC_SLCAheadDis "";
BA_ "EventCommandSignal" SG_ 904 ACU_DVR_Switch 0;
BA_ "GatewayedSignals" SG_ 904 ACU_DVR_Switch 0;
BA_ "GenSigInactiveValue" SG_ 904 ACU_DVR_Switch 0;
BA_ "GenSigInvalidValue" SG_ 904 ACU_DVR_Switch 0;
BA_ "GenSigSendType" SG_ 904 ACU_DVR_Switch 1;
BA_ "GenSigStartValue" SG_ 904 ACU_DVR_Switch 0;
BA_ "GenSigTimeoutValue" SG_ 904 ACU_DVR_Switch 0;
BA_ "Remark" SG_ 904 ACU_DVR_Switch "";
BA_ "EventCommandSignal" SG_ 904 ACU_IFC_OfframpDis 0;
BA_ "GatewayedSignals" SG_ 904 ACU_IFC_OfframpDis 0;
BA_ "GenSigInactiveValue" SG_ 904 ACU_IFC_OfframpDis 0;
BA_ "GenSigInvalidValue" SG_ 904 ACU_IFC_OfframpDis 0;
BA_ "GenSigSendType" SG_ 904 ACU_IFC_OfframpDis 1;
BA_ "GenSigStartValue" SG_ 904 ACU_IFC_OfframpDis 254;
BA_ "GenSigTimeoutValue" SG_ 904 ACU_IFC_OfframpDis 254;
BA_ "Remark" SG_ 904 ACU_IFC_OfframpDis "";
BA_ "EventCommandSignal" SG_ 904 SSW_FLSeatSlideCurrentPst 0;
BA_ "GatewayedSignals" SG_ 904 SSW_FLSeatSlideCurrentPst 0;
BA_ "GenSigInactiveValue" SG_ 904 SSW_FLSeatSlideCurrentPst 0;
BA_ "GenSigInvalidValue" SG_ 904 SSW_FLSeatSlideCurrentPst 0;
BA_ "GenSigSendType" SG_ 904 SSW_FLSeatSlideCurrentPst 1;
BA_ "GenSigStartValue" SG_ 904 SSW_FLSeatSlideCurrentPst 255;
BA_ "GenSigTimeoutValue" SG_ 904 SSW_FLSeatSlideCurrentPst 0;
BA_ "Remark" SG_ 904 SSW_FLSeatSlideCurrentPst "";
BA_ "EventCommandSignal" SG_ 904 SSW_FLSeatHeightCurrentPst 0;
BA_ "GatewayedSignals" SG_ 904 SSW_FLSeatHeightCurrentPst 0;
BA_ "GenSigInactiveValue" SG_ 904 SSW_FLSeatHeightCurrentPst 0;
BA_ "GenSigInvalidValue" SG_ 904 SSW_FLSeatHeightCurrentPst 0;
BA_ "GenSigSendType" SG_ 904 SSW_FLSeatHeightCurrentPst 1;
BA_ "GenSigStartValue" SG_ 904 SSW_FLSeatHeightCurrentPst 255;
BA_ "GenSigTimeoutValue" SG_ 904 SSW_FLSeatHeightCurrentPst 0;
BA_ "Remark" SG_ 904 SSW_FLSeatHeightCurrentPst "";
BA_ "EventCommandSignal" SG_ 904 SSW_FLSeatBackrestCurrentPst 0;
BA_ "GatewayedSignals" SG_ 904 SSW_FLSeatBackrestCurrentPst 0;
BA_ "GenSigInactiveValue" SG_ 904 SSW_FLSeatBackrestCurrentPst 0;
BA_ "GenSigInvalidValue" SG_ 904 SSW_FLSeatBackrestCurrentPst 0;
BA_ "GenSigSendType" SG_ 904 SSW_FLSeatBackrestCurrentPst 1;
BA_ "GenSigStartValue" SG_ 904 SSW_FLSeatBackrestCurrentPst 255;
BA_ "GenSigTimeoutValue" SG_ 904 SSW_FLSeatBackrestCurrentPst 0;
BA_ "Remark" SG_ 904 SSW_FLSeatBackrestCurrentPst "";
BA_ "EventCommandSignal" SG_ 904 DrvrSideMotResp 0;
BA_ "GatewayedSignals" SG_ 904 DrvrSideMotResp 0;
BA_ "GenSigInactiveValue" SG_ 904 DrvrSideMotResp 0;
BA_ "GenSigInvalidValue" SG_ 904 DrvrSideMotResp 0;
BA_ "GenSigSendType" SG_ 904 DrvrSideMotResp 1;
BA_ "GenSigStartValue" SG_ 904 DrvrSideMotResp 0;
BA_ "GenSigTimeoutValue" SG_ 904 DrvrSideMotResp 15;
BA_ "Remark" SG_ 904 DrvrSideMotResp "";
BA_ "EventCommandSignal" SG_ 904 EL_LeftLowBeamSt 0;
BA_ "GatewayedSignals" SG_ 904 EL_LeftLowBeamSt 0;
BA_ "GenSigInactiveValue" SG_ 904 EL_LeftLowBeamSt 0;
BA_ "GenSigInvalidValue" SG_ 904 EL_LeftLowBeamSt 0;
BA_ "GenSigSendType" SG_ 904 EL_LeftLowBeamSt 1;
BA_ "GenSigStartValue" SG_ 904 EL_LeftLowBeamSt 0;
BA_ "GenSigTimeoutValue" SG_ 904 EL_LeftLowBeamSt 0;
BA_ "Remark" SG_ 904 EL_LeftLowBeamSt "";
BA_ "EventCommandSignal" SG_ 904 EL_LeftLowBeamFaultSt 0;
BA_ "GatewayedSignals" SG_ 904 EL_LeftLowBeamFaultSt 0;
BA_ "GenSigInactiveValue" SG_ 904 EL_LeftLowBeamFaultSt 0;
BA_ "GenSigInvalidValue" SG_ 904 EL_LeftLowBeamFaultSt 0;
BA_ "GenSigSendType" SG_ 904 EL_LeftLowBeamFaultSt 1;
BA_ "GenSigStartValue" SG_ 904 EL_LeftLowBeamFaultSt 0;
BA_ "GenSigTimeoutValue" SG_ 904 EL_LeftLowBeamFaultSt 0;
BA_ "Remark" SG_ 904 EL_LeftLowBeamFaultSt "";
BA_ "EventCommandSignal" SG_ 904 EL_RightLowBeamSt 0;
BA_ "GatewayedSignals" SG_ 904 EL_RightLowBeamSt 0;
BA_ "GenSigInactiveValue" SG_ 904 EL_RightLowBeamSt 0;
BA_ "GenSigInvalidValue" SG_ 904 EL_RightLowBeamSt 0;
BA_ "GenSigSendType" SG_ 904 EL_RightLowBeamSt 1;
BA_ "GenSigStartValue" SG_ 904 EL_RightLowBeamSt 0;
BA_ "GenSigTimeoutValue" SG_ 904 EL_RightLowBeamSt 0;
BA_ "Remark" SG_ 904 EL_RightLowBeamSt "";
BA_ "EventCommandSignal" SG_ 904 EL_RightLowBeamFaultSt 0;
BA_ "GatewayedSignals" SG_ 904 EL_RightLowBeamFaultSt 0;
BA_ "GenSigInactiveValue" SG_ 904 EL_RightLowBeamFaultSt 0;
BA_ "GenSigInvalidValue" SG_ 904 EL_RightLowBeamFaultSt 0;
BA_ "GenSigSendType" SG_ 904 EL_RightLowBeamFaultSt 1;
BA_ "GenSigStartValue" SG_ 904 EL_RightLowBeamFaultSt 0;
BA_ "GenSigTimeoutValue" SG_ 904 EL_RightLowBeamFaultSt 0;
BA_ "Remark" SG_ 904 EL_RightLowBeamFaultSt "";
BA_ "EventCommandSignal" SG_ 904 WW_FWPMotorSt 0;
BA_ "GatewayedSignals" SG_ 904 WW_FWPMotorSt 0;
BA_ "GenSigInactiveValue" SG_ 904 WW_FWPMotorSt 0;
BA_ "GenSigInvalidValue" SG_ 904 WW_FWPMotorSt 0;
BA_ "GenSigSendType" SG_ 904 WW_FWPMotorSt 1;
BA_ "GenSigStartValue" SG_ 904 WW_FWPMotorSt 0;
BA_ "GenSigTimeoutValue" SG_ 904 WW_FWPMotorSt 0;
BA_ "Remark" SG_ 904 WW_FWPMotorSt "";
BA_ "EventCommandSignal" SG_ 904 EL_MLADASLightSt 0;
BA_ "GatewayedSignals" SG_ 904 EL_MLADASLightSt 0;
BA_ "GenSigInactiveValue" SG_ 904 EL_MLADASLightSt 0;
BA_ "GenSigInvalidValue" SG_ 904 EL_MLADASLightSt 0;
BA_ "GenSigSendType" SG_ 904 EL_MLADASLightSt 1;
BA_ "GenSigStartValue" SG_ 904 EL_MLADASLightSt 0;
BA_ "GenSigTimeoutValue" SG_ 904 EL_MLADASLightSt 0;
BA_ "Remark" SG_ 904 EL_MLADASLightSt "";
BA_ "EventCommandSignal" SG_ 904 EL_FLTurnLightSt 0;
BA_ "GatewayedSignals" SG_ 904 EL_FLTurnLightSt 0;
BA_ "GenSigInactiveValue" SG_ 904 EL_FLTurnLightSt 0;
BA_ "GenSigInvalidValue" SG_ 904 EL_FLTurnLightSt 0;
BA_ "GenSigSendType" SG_ 904 EL_FLTurnLightSt 1;
BA_ "GenSigStartValue" SG_ 904 EL_FLTurnLightSt 0;
BA_ "GenSigTimeoutValue" SG_ 904 EL_FLTurnLightSt 0;
BA_ "Remark" SG_ 904 EL_FLTurnLightSt "";
BA_ "EventCommandSignal" SG_ 904 EL_FLTurnLightFaultSt 0;
BA_ "GatewayedSignals" SG_ 904 EL_FLTurnLightFaultSt 0;
BA_ "GenSigInactiveValue" SG_ 904 EL_FLTurnLightFaultSt 0;
BA_ "GenSigInvalidValue" SG_ 904 EL_FLTurnLightFaultSt 0;
BA_ "GenSigSendType" SG_ 904 EL_FLTurnLightFaultSt 1;
BA_ "GenSigStartValue" SG_ 904 EL_FLTurnLightFaultSt 0;
BA_ "GenSigTimeoutValue" SG_ 904 EL_FLTurnLightFaultSt 0;
BA_ "Remark" SG_ 904 EL_FLTurnLightFaultSt "";
BA_ "EventCommandSignal" SG_ 904 EL_FRTurnLightSt 0;
BA_ "GatewayedSignals" SG_ 904 EL_FRTurnLightSt 0;
BA_ "GenSigInactiveValue" SG_ 904 EL_FRTurnLightSt 0;
BA_ "GenSigInvalidValue" SG_ 904 EL_FRTurnLightSt 0;
BA_ "GenSigSendType" SG_ 904 EL_FRTurnLightSt 1;
BA_ "GenSigStartValue" SG_ 904 EL_FRTurnLightSt 0;
BA_ "GenSigTimeoutValue" SG_ 904 EL_FRTurnLightSt 0;
BA_ "Remark" SG_ 904 EL_FRTurnLightSt "";
BA_ "EventCommandSignal" SG_ 904 EL_FRTurnLightFaultSt 0;
BA_ "GatewayedSignals" SG_ 904 EL_FRTurnLightFaultSt 0;
BA_ "GenSigInactiveValue" SG_ 904 EL_FRTurnLightFaultSt 0;
BA_ "GenSigInvalidValue" SG_ 904 EL_FRTurnLightFaultSt 0;
BA_ "GenSigSendType" SG_ 904 EL_FRTurnLightFaultSt 1;
BA_ "GenSigStartValue" SG_ 904 EL_FRTurnLightFaultSt 0;
BA_ "GenSigTimeoutValue" SG_ 904 EL_FRTurnLightFaultSt 0;
BA_ "Remark" SG_ 904 EL_FRTurnLightFaultSt "";
BA_ "EventCommandSignal" SG_ 904 EL_SideBrkLightSt 0;
BA_ "GatewayedSignals" SG_ 904 EL_SideBrkLightSt 0;
BA_ "GenSigInactiveValue" SG_ 904 EL_SideBrkLightSt 0;
BA_ "GenSigInvalidValue" SG_ 904 EL_SideBrkLightSt 0;
BA_ "GenSigSendType" SG_ 904 EL_SideBrkLightSt 1;
BA_ "GenSigStartValue" SG_ 904 EL_SideBrkLightSt 0;
BA_ "GenSigTimeoutValue" SG_ 904 EL_SideBrkLightSt 0;
BA_ "Remark" SG_ 904 EL_SideBrkLightSt "";
BA_ "EventCommandSignal" SG_ 904 EL_SideBrkLightFaultSt 0;
BA_ "GatewayedSignals" SG_ 904 EL_SideBrkLightFaultSt 0;
BA_ "GenSigInactiveValue" SG_ 904 EL_SideBrkLightFaultSt 0;
BA_ "GenSigInvalidValue" SG_ 904 EL_SideBrkLightFaultSt 0;
BA_ "GenSigSendType" SG_ 904 EL_SideBrkLightFaultSt 1;
BA_ "GenSigStartValue" SG_ 904 EL_SideBrkLightFaultSt 0;
BA_ "GenSigTimeoutValue" SG_ 904 EL_SideBrkLightFaultSt 0;
BA_ "Remark" SG_ 904 EL_SideBrkLightFaultSt "";
BA_ "EventCommandSignal" SG_ 904 EL_CHMSLSt 0;
BA_ "GatewayedSignals" SG_ 904 EL_CHMSLSt 0;
BA_ "GenSigInactiveValue" SG_ 904 EL_CHMSLSt 0;
BA_ "GenSigInvalidValue" SG_ 904 EL_CHMSLSt 0;
BA_ "GenSigSendType" SG_ 904 EL_CHMSLSt 1;
BA_ "GenSigStartValue" SG_ 904 EL_CHMSLSt 0;
BA_ "GenSigTimeoutValue" SG_ 904 EL_CHMSLSt 0;
BA_ "Remark" SG_ 904 EL_CHMSLSt "";
BA_ "EventCommandSignal" SG_ 904 EL_CHMSLFaultSt 0;
BA_ "GatewayedSignals" SG_ 904 EL_CHMSLFaultSt 0;
BA_ "GenSigInactiveValue" SG_ 904 EL_CHMSLFaultSt 0;
BA_ "GenSigInvalidValue" SG_ 904 EL_CHMSLFaultSt 0;
BA_ "GenSigSendType" SG_ 904 EL_CHMSLFaultSt 1;
BA_ "GenSigStartValue" SG_ 904 EL_CHMSLFaultSt 0;
BA_ "GenSigTimeoutValue" SG_ 904 EL_CHMSLFaultSt 0;
BA_ "Remark" SG_ 904 EL_CHMSLFaultSt "";
BA_ "EventCommandSignal" SG_ 904 EL_RLTurnLightSt 0;
BA_ "GatewayedSignals" SG_ 904 EL_RLTurnLightSt 0;
BA_ "GenSigInactiveValue" SG_ 904 EL_RLTurnLightSt 0;
BA_ "GenSigInvalidValue" SG_ 904 EL_RLTurnLightSt 0;
BA_ "GenSigSendType" SG_ 904 EL_RLTurnLightSt 1;
BA_ "GenSigStartValue" SG_ 904 EL_RLTurnLightSt 0;
BA_ "GenSigTimeoutValue" SG_ 904 EL_RLTurnLightSt 0;
BA_ "Remark" SG_ 904 EL_RLTurnLightSt "";
BA_ "EventCommandSignal" SG_ 904 EL_RLTurnLightFaultSt 0;
BA_ "GatewayedSignals" SG_ 904 EL_RLTurnLightFaultSt 0;
BA_ "GenSigInactiveValue" SG_ 904 EL_RLTurnLightFaultSt 0;
BA_ "GenSigInvalidValue" SG_ 904 EL_RLTurnLightFaultSt 0;
BA_ "GenSigSendType" SG_ 904 EL_RLTurnLightFaultSt 1;
BA_ "GenSigStartValue" SG_ 904 EL_RLTurnLightFaultSt 0;
BA_ "GenSigTimeoutValue" SG_ 904 EL_RLTurnLightFaultSt 0;
BA_ "Remark" SG_ 904 EL_RLTurnLightFaultSt "";
BA_ "EventCommandSignal" SG_ 904 EL_RRTurnLightSt 0;
BA_ "GatewayedSignals" SG_ 904 EL_RRTurnLightSt 0;
BA_ "GenSigInactiveValue" SG_ 904 EL_RRTurnLightSt 0;
BA_ "GenSigInvalidValue" SG_ 904 EL_RRTurnLightSt 0;
BA_ "GenSigSendType" SG_ 904 EL_RRTurnLightSt 1;
BA_ "GenSigStartValue" SG_ 904 EL_RRTurnLightSt 0;
BA_ "GenSigTimeoutValue" SG_ 904 EL_RRTurnLightSt 0;
BA_ "Remark" SG_ 904 EL_RRTurnLightSt "";
BA_ "EventCommandSignal" SG_ 904 EL_RRTurnLightFaultSt 0;
BA_ "GatewayedSignals" SG_ 904 EL_RRTurnLightFaultSt 0;
BA_ "GenSigInactiveValue" SG_ 904 EL_RRTurnLightFaultSt 0;
BA_ "GenSigInvalidValue" SG_ 904 EL_RRTurnLightFaultSt 0;
BA_ "GenSigSendType" SG_ 904 EL_RRTurnLightFaultSt 1;
BA_ "GenSigStartValue" SG_ 904 EL_RRTurnLightFaultSt 0;
BA_ "GenSigTimeoutValue" SG_ 904 EL_RRTurnLightFaultSt 0;
BA_ "Remark" SG_ 904 EL_RRTurnLightFaultSt "";
BA_ "EventCommandSignal" SG_ 904 IPDS_BAT1PowerSt 0;
BA_ "GatewayedSignals" SG_ 904 IPDS_BAT1PowerSt 0;
BA_ "GenSigInactiveValue" SG_ 904 IPDS_BAT1PowerSt 0;
BA_ "GenSigInvalidValue" SG_ 904 IPDS_BAT1PowerSt 0;
BA_ "GenSigSendType" SG_ 904 IPDS_BAT1PowerSt 1;
BA_ "GenSigStartValue" SG_ 904 IPDS_BAT1PowerSt 1;
BA_ "GenSigTimeoutValue" SG_ 904 IPDS_BAT1PowerSt 0;
BA_ "Remark" SG_ 904 IPDS_BAT1PowerSt "";
BA_ "EventCommandSignal" SG_ 904 IPDS_BAT2PowerSt 0;
BA_ "GatewayedSignals" SG_ 904 IPDS_BAT2PowerSt 0;
BA_ "GenSigInactiveValue" SG_ 904 IPDS_BAT2PowerSt 0;
BA_ "GenSigInvalidValue" SG_ 904 IPDS_BAT2PowerSt 0;
BA_ "GenSigSendType" SG_ 904 IPDS_BAT2PowerSt 1;
BA_ "GenSigStartValue" SG_ 904 IPDS_BAT2PowerSt 1;
BA_ "GenSigTimeoutValue" SG_ 904 IPDS_BAT2PowerSt 0;
BA_ "Remark" SG_ 904 IPDS_BAT2PowerSt "";
BA_ "EventCommandSignal" SG_ 904 IPDS_DCDC2PowerSt 0;
BA_ "GatewayedSignals" SG_ 904 IPDS_DCDC2PowerSt 0;
BA_ "GenSigInactiveValue" SG_ 904 IPDS_DCDC2PowerSt 0;
BA_ "GenSigInvalidValue" SG_ 904 IPDS_DCDC2PowerSt 0;
BA_ "GenSigSendType" SG_ 904 IPDS_DCDC2PowerSt 1;
BA_ "GenSigStartValue" SG_ 904 IPDS_DCDC2PowerSt 1;
BA_ "GenSigTimeoutValue" SG_ 904 IPDS_DCDC2PowerSt 0;
BA_ "Remark" SG_ 904 IPDS_DCDC2PowerSt "";
BA_ "EventCommandSignal" SG_ 904 IPDS_GridIsoPowerSt 0;
BA_ "GatewayedSignals" SG_ 904 IPDS_GridIsoPowerSt 0;
BA_ "GenSigInactiveValue" SG_ 904 IPDS_GridIsoPowerSt 0;
BA_ "GenSigInvalidValue" SG_ 904 IPDS_GridIsoPowerSt 0;
BA_ "GenSigSendType" SG_ 904 IPDS_GridIsoPowerSt 1;
BA_ "GenSigStartValue" SG_ 904 IPDS_GridIsoPowerSt 1;
BA_ "GenSigTimeoutValue" SG_ 904 IPDS_GridIsoPowerSt 1;
BA_ "Remark" SG_ 904 IPDS_GridIsoPowerSt "";
BA_ "EventCommandSignal" SG_ 904 IPS_DCDCModeSt 0;
BA_ "GatewayedSignals" SG_ 904 IPS_DCDCModeSt 0;
BA_ "GenSigInactiveValue" SG_ 904 IPS_DCDCModeSt 0;
BA_ "GenSigInvalidValue" SG_ 904 IPS_DCDCModeSt 0;
BA_ "GenSigSendType" SG_ 904 IPS_DCDCModeSt 1;
BA_ "GenSigStartValue" SG_ 904 IPS_DCDCModeSt 0;
BA_ "GenSigTimeoutValue" SG_ 904 IPS_DCDCModeSt 0;
BA_ "Remark" SG_ 904 IPS_DCDCModeSt "";
BA_ "EventCommandSignal" SG_ 904 IPDS_FRRadarPowerSup 0;
BA_ "GatewayedSignals" SG_ 904 IPDS_FRRadarPowerSup 0;
BA_ "GenSigInactiveValue" SG_ 904 IPDS_FRRadarPowerSup 0;
BA_ "GenSigInvalidValue" SG_ 904 IPDS_FRRadarPowerSup 0;
BA_ "GenSigSendType" SG_ 904 IPDS_FRRadarPowerSup 1;
BA_ "GenSigStartValue" SG_ 904 IPDS_FRRadarPowerSup 3;
BA_ "GenSigTimeoutValue" SG_ 904 IPDS_FRRadarPowerSup 0;
BA_ "Remark" SG_ 904 IPDS_FRRadarPowerSup "";
BA_ "EventCommandSignal" SG_ 904 LBMS_SOFVD 0;
BA_ "GatewayedSignals" SG_ 904 LBMS_SOFVD 0;
BA_ "GenSigInactiveValue" SG_ 904 LBMS_SOFVD 0;
BA_ "GenSigInvalidValue" SG_ 904 LBMS_SOFVD 0;
BA_ "GenSigSendType" SG_ 904 LBMS_SOFVD 1;
BA_ "GenSigStartValue" SG_ 904 LBMS_SOFVD 0;
BA_ "GenSigTimeoutValue" SG_ 904 LBMS_SOFVD 0;
BA_ "Remark" SG_ 904 LBMS_SOFVD "";
BA_ "EventCommandSignal" SG_ 904 LBMS_SOFEN 0;
BA_ "GatewayedSignals" SG_ 904 LBMS_SOFEN 0;
BA_ "GenSigInactiveValue" SG_ 904 LBMS_SOFEN 0;
BA_ "GenSigInvalidValue" SG_ 904 LBMS_SOFEN 0;
BA_ "GenSigSendType" SG_ 904 LBMS_SOFEN 1;
BA_ "GenSigStartValue" SG_ 904 LBMS_SOFEN 0;
BA_ "GenSigTimeoutValue" SG_ 904 LBMS_SOFEN 0;
BA_ "Remark" SG_ 904 LBMS_SOFEN "";
BA_ "EventCommandSignal" SG_ 904 LBMSAD_SOFVD 0;
BA_ "GatewayedSignals" SG_ 904 LBMSAD_SOFVD 0;
BA_ "GenSigInactiveValue" SG_ 904 LBMSAD_SOFVD 0;
BA_ "GenSigInvalidValue" SG_ 904 LBMSAD_SOFVD 0;
BA_ "GenSigSendType" SG_ 904 LBMSAD_SOFVD 1;
BA_ "GenSigStartValue" SG_ 904 LBMSAD_SOFVD 0;
BA_ "GenSigTimeoutValue" SG_ 904 LBMSAD_SOFVD 0;
BA_ "Remark" SG_ 904 LBMSAD_SOFVD "";
BA_ "EventCommandSignal" SG_ 904 LBMSAD_SOFEN 0;
BA_ "GatewayedSignals" SG_ 904 LBMSAD_SOFEN 0;
BA_ "GenSigInactiveValue" SG_ 904 LBMSAD_SOFEN 0;
BA_ "GenSigInvalidValue" SG_ 904 LBMSAD_SOFEN 0;
BA_ "GenSigSendType" SG_ 904 LBMSAD_SOFEN 1;
BA_ "GenSigStartValue" SG_ 904 LBMSAD_SOFEN 0;
BA_ "GenSigTimeoutValue" SG_ 904 LBMSAD_SOFEN 0;
BA_ "Remark" SG_ 904 LBMSAD_SOFEN "";
BA_ "EventCommandSignal" SG_ 904 IPDS_FLRadarPowerSup 0;
BA_ "GatewayedSignals" SG_ 904 IPDS_FLRadarPowerSup 0;
BA_ "GenSigInactiveValue" SG_ 904 IPDS_FLRadarPowerSup 0;
BA_ "GenSigInvalidValue" SG_ 904 IPDS_FLRadarPowerSup 0;
BA_ "GenSigSendType" SG_ 904 IPDS_FLRadarPowerSup 1;
BA_ "GenSigStartValue" SG_ 904 IPDS_FLRadarPowerSup 3;
BA_ "GenSigTimeoutValue" SG_ 904 IPDS_FLRadarPowerSup 0;
BA_ "Remark" SG_ 904 IPDS_FLRadarPowerSup "";
BA_ "EventCommandSignal" SG_ 904 IPDS_FrontRadarPowerSup 0;
BA_ "GatewayedSignals" SG_ 904 IPDS_FrontRadarPowerSup 0;
BA_ "GenSigInactiveValue" SG_ 904 IPDS_FrontRadarPowerSup 0;
BA_ "GenSigInvalidValue" SG_ 904 IPDS_FrontRadarPowerSup 0;
BA_ "GenSigSendType" SG_ 904 IPDS_FrontRadarPowerSup 1;
BA_ "GenSigStartValue" SG_ 904 IPDS_FrontRadarPowerSup 3;
BA_ "GenSigTimeoutValue" SG_ 904 IPDS_FrontRadarPowerSup 0;
BA_ "Remark" SG_ 904 IPDS_FrontRadarPowerSup "";
BA_ "EventCommandSignal" SG_ 904 IPDS_HDMapPowerSup 0;
BA_ "GatewayedSignals" SG_ 904 IPDS_HDMapPowerSup 0;
BA_ "GenSigInactiveValue" SG_ 904 IPDS_HDMapPowerSup 0;
BA_ "GenSigInvalidValue" SG_ 904 IPDS_HDMapPowerSup 0;
BA_ "GenSigSendType" SG_ 904 IPDS_HDMapPowerSup 1;
BA_ "GenSigStartValue" SG_ 904 IPDS_HDMapPowerSup 3;
BA_ "GenSigTimeoutValue" SG_ 904 IPDS_HDMapPowerSup 0;
BA_ "Remark" SG_ 904 IPDS_HDMapPowerSup "";
BA_ "EventCommandSignal" SG_ 904 IPDS_RearRadarPowerSup 0;
BA_ "GatewayedSignals" SG_ 904 IPDS_RearRadarPowerSup 0;
BA_ "GenSigInactiveValue" SG_ 904 IPDS_RearRadarPowerSup 0;
BA_ "GenSigInvalidValue" SG_ 904 IPDS_RearRadarPowerSup 0;
BA_ "GenSigSendType" SG_ 904 IPDS_RearRadarPowerSup 1;
BA_ "GenSigStartValue" SG_ 904 IPDS_RearRadarPowerSup 3;
BA_ "GenSigTimeoutValue" SG_ 904 IPDS_RearRadarPowerSup 0;
BA_ "Remark" SG_ 904 IPDS_RearRadarPowerSup "";
BA_ "EventCommandSignal" SG_ 334 Theft_Auth_Status 1;
BA_ "GatewayedSignals" SG_ 334 Theft_Auth_Status 0;
BA_ "GenSigInactiveValue" SG_ 334 Theft_Auth_Status 0;
BA_ "GenSigInvalidValue" SG_ 334 Theft_Auth_Status 0;
BA_ "GenSigSendType" SG_ 334 Theft_Auth_Status 0;
BA_ "GenSigStartValue" SG_ 334 Theft_Auth_Status 0;
BA_ "GenSigTimeoutValue" SG_ 334 Theft_Auth_Status 0;
BA_ "Remark" SG_ 334 Theft_Auth_Status "";
BA_ "EventCommandSignal" SG_ 334 CSM_RC_ViewExtvideo 0;
BA_ "GatewayedSignals" SG_ 334 CSM_RC_ViewExtvideo 0;
BA_ "GenSigInactiveValue" SG_ 334 CSM_RC_ViewExtvideo 0;
BA_ "GenSigInvalidValue" SG_ 334 CSM_RC_ViewExtvideo 65535;
BA_ "GenSigSendType" SG_ 334 CSM_RC_ViewExtvideo 1;
BA_ "GenSigStartValue" SG_ 334 CSM_RC_ViewExtvideo 0;
BA_ "GenSigTimeoutValue" SG_ 334 CSM_RC_ViewExtvideo 0;
BA_ "Remark" SG_ 334 CSM_RC_ViewExtvideo "";
BA_ "EventCommandSignal" SG_ 334 CSM_RC_ViewExtvideoReq 0;
BA_ "GatewayedSignals" SG_ 334 CSM_RC_ViewExtvideoReq 0;
BA_ "GenSigInactiveValue" SG_ 334 CSM_RC_ViewExtvideoReq 0;
BA_ "GenSigInvalidValue" SG_ 334 CSM_RC_ViewExtvideoReq 0;
BA_ "GenSigSendType" SG_ 334 CSM_RC_ViewExtvideoReq 1;
BA_ "GenSigStartValue" SG_ 334 CSM_RC_ViewExtvideoReq 0;
BA_ "GenSigTimeoutValue" SG_ 334 CSM_RC_ViewExtvideoReq 0;
BA_ "Remark" SG_ 334 CSM_RC_ViewExtvideoReq "";
BA_ "EventCommandSignal" SG_ 777 ZCUR_4_CRC 0;
BA_ "GatewayedSignals" SG_ 777 ZCUR_4_CRC 0;
BA_ "GenSigInactiveValue" SG_ 777 ZCUR_4_CRC 0;
BA_ "GenSigInvalidValue" SG_ 777 ZCUR_4_CRC 0;
BA_ "GenSigSendType" SG_ 777 ZCUR_4_CRC 1;
BA_ "GenSigStartValue" SG_ 777 ZCUR_4_CRC 0;
BA_ "GenSigTimeoutValue" SG_ 777 ZCUR_4_CRC 0;
BA_ "Remark" SG_ 777 ZCUR_4_CRC "源报文周期20ms，转发后报文周期100ms，转发后的counter值发送会不连续";
BA_ "EventCommandSignal" SG_ 777 ZCUR_4_Counter 0;
BA_ "GatewayedSignals" SG_ 777 ZCUR_4_Counter 0;
BA_ "GenSigInactiveValue" SG_ 777 ZCUR_4_Counter 0;
BA_ "GenSigInvalidValue" SG_ 777 ZCUR_4_Counter 0;
BA_ "GenSigSendType" SG_ 777 ZCUR_4_Counter 1;
BA_ "GenSigStartValue" SG_ 777 ZCUR_4_Counter 0;
BA_ "GenSigTimeoutValue" SG_ 777 ZCUR_4_Counter 0;
BA_ "Remark" SG_ 777 ZCUR_4_Counter "源报文周期20ms，转发后报文周期100ms，转发后的counter值发送会不连续";
BA_ "EventCommandSignal" SG_ 777 EL_MRADASLightSt 0;
BA_ "GatewayedSignals" SG_ 777 EL_MRADASLightSt 0;
BA_ "GenSigInactiveValue" SG_ 777 EL_MRADASLightSt 0;
BA_ "GenSigInvalidValue" SG_ 777 EL_MRADASLightSt 0;
BA_ "GenSigSendType" SG_ 777 EL_MRADASLightSt 1;
BA_ "GenSigStartValue" SG_ 777 EL_MRADASLightSt 0;
BA_ "GenSigTimeoutValue" SG_ 777 EL_MRADASLightSt 0;
BA_ "Remark" SG_ 777 EL_MRADASLightSt "源报文周期20ms，转发后报文周期100ms，转发后的counter值发送会不连续";
BA_ "EventCommandSignal" SG_ 777 MR_RightMirrorFoldUnfoldSt 0;
BA_ "GatewayedSignals" SG_ 777 MR_RightMirrorFoldUnfoldSt 0;
BA_ "GenSigInactiveValue" SG_ 777 MR_RightMirrorFoldUnfoldSt 0;
BA_ "GenSigInvalidValue" SG_ 777 MR_RightMirrorFoldUnfoldSt 0;
BA_ "GenSigSendType" SG_ 777 MR_RightMirrorFoldUnfoldSt 1;
BA_ "GenSigStartValue" SG_ 777 MR_RightMirrorFoldUnfoldSt 0;
BA_ "GenSigTimeoutValue" SG_ 777 MR_RightMirrorFoldUnfoldSt 0;
BA_ "Remark" SG_ 777 MR_RightMirrorFoldUnfoldSt "源报文周期20ms，转发后报文周期100ms，转发后的counter值发送会不连续";
BA_ "EventCommandSignal" SG_ 777 PWL_WinCurrentPos_FRWinPst 0;
BA_ "GatewayedSignals" SG_ 777 PWL_WinCurrentPos_FRWinPst 0;
BA_ "GenSigInactiveValue" SG_ 777 PWL_WinCurrentPos_FRWinPst 0;
BA_ "GenSigInvalidValue" SG_ 777 PWL_WinCurrentPos_FRWinPst 0;
BA_ "GenSigSendType" SG_ 777 PWL_WinCurrentPos_FRWinPst 1;
BA_ "GenSigStartValue" SG_ 777 PWL_WinCurrentPos_FRWinPst 255;
BA_ "GenSigTimeoutValue" SG_ 777 PWL_WinCurrentPos_FRWinPst 0;
BA_ "Remark" SG_ 777 PWL_WinCurrentPos_FRWinPst "源报文周期20ms，转发后报文周期100ms，转发后的counter值发送会不连续";
BA_ "EventCommandSignal" SG_ 777 EL_MRTurnLightSt 0;
BA_ "GatewayedSignals" SG_ 777 EL_MRTurnLightSt 0;
BA_ "GenSigInactiveValue" SG_ 777 EL_MRTurnLightSt 0;
BA_ "GenSigInvalidValue" SG_ 777 EL_MRTurnLightSt 0;
BA_ "GenSigSendType" SG_ 777 EL_MRTurnLightSt 1;
BA_ "GenSigStartValue" SG_ 777 EL_MRTurnLightSt 0;
BA_ "GenSigTimeoutValue" SG_ 777 EL_MRTurnLightSt 0;
BA_ "Remark" SG_ 777 EL_MRTurnLightSt "源报文周期20ms，转发后报文周期100ms，转发后的counter值发送会不连续";
BA_ "EventCommandSignal" SG_ 777 EL_MRTurnLightFaultSt 0;
BA_ "GatewayedSignals" SG_ 777 EL_MRTurnLightFaultSt 0;
BA_ "GenSigInactiveValue" SG_ 777 EL_MRTurnLightFaultSt 0;
BA_ "GenSigInvalidValue" SG_ 777 EL_MRTurnLightFaultSt 0;
BA_ "GenSigSendType" SG_ 777 EL_MRTurnLightFaultSt 1;
BA_ "GenSigStartValue" SG_ 777 EL_MRTurnLightFaultSt 0;
BA_ "GenSigTimeoutValue" SG_ 777 EL_MRTurnLightFaultSt 0;
BA_ "Remark" SG_ 777 EL_MRTurnLightFaultSt "源报文周期20ms，转发后报文周期100ms，转发后的counter值发送会不连续";
BA_ "EventCommandSignal" SG_ 777 KAE_toADCDRVUnlockSensorSt 0;
BA_ "GatewayedSignals" SG_ 777 KAE_toADCDRVUnlockSensorSt 0;
BA_ "GenSigInactiveValue" SG_ 777 KAE_toADCDRVUnlockSensorSt 0;
BA_ "GenSigInvalidValue" SG_ 777 KAE_toADCDRVUnlockSensorSt 0;
BA_ "GenSigSendType" SG_ 777 KAE_toADCDRVUnlockSensorSt 1;
BA_ "GenSigStartValue" SG_ 777 KAE_toADCDRVUnlockSensorSt 0;
BA_ "GenSigTimeoutValue" SG_ 777 KAE_toADCDRVUnlockSensorSt 0;
BA_ "Remark" SG_ 777 KAE_toADCDRVUnlockSensorSt "源报文周期20ms，转发后报文周期100ms，转发后的counter值发送会不连续";
BA_ "EventCommandSignal" SG_ 777 KAE_toADCDRVLockSensorSt 0;
BA_ "GatewayedSignals" SG_ 777 KAE_toADCDRVLockSensorSt 0;
BA_ "GenSigInactiveValue" SG_ 777 KAE_toADCDRVLockSensorSt 0;
BA_ "GenSigInvalidValue" SG_ 777 KAE_toADCDRVLockSensorSt 0;
BA_ "GenSigSendType" SG_ 777 KAE_toADCDRVLockSensorSt 1;
BA_ "GenSigStartValue" SG_ 777 KAE_toADCDRVLockSensorSt 0;
BA_ "GenSigTimeoutValue" SG_ 777 KAE_toADCDRVLockSensorSt 0;
BA_ "Remark" SG_ 777 KAE_toADCDRVLockSensorSt "源报文周期20ms，转发后报文周期100ms，转发后的counter值发送会不连续";
BA_ "EventCommandSignal" SG_ 777 EL_RightBSDIndicatorSt 0;
BA_ "GatewayedSignals" SG_ 777 EL_RightBSDIndicatorSt 0;
BA_ "GenSigInactiveValue" SG_ 777 EL_RightBSDIndicatorSt 0;
BA_ "GenSigInvalidValue" SG_ 777 EL_RightBSDIndicatorSt 0;
BA_ "GenSigSendType" SG_ 777 EL_RightBSDIndicatorSt 1;
BA_ "GenSigStartValue" SG_ 777 EL_RightBSDIndicatorSt 0;
BA_ "GenSigTimeoutValue" SG_ 777 EL_RightBSDIndicatorSt 0;
BA_ "Remark" SG_ 777 EL_RightBSDIndicatorSt "源报文周期20ms，转发后报文周期100ms，转发后的counter值发送会不连续";
BA_ "EventCommandSignal" SG_ 777 EL_RightBSDIndicatorFaultSt 0;
BA_ "GatewayedSignals" SG_ 777 EL_RightBSDIndicatorFaultSt 0;
BA_ "GenSigInactiveValue" SG_ 777 EL_RightBSDIndicatorFaultSt 0;
BA_ "GenSigInvalidValue" SG_ 777 EL_RightBSDIndicatorFaultSt 0;
BA_ "GenSigSendType" SG_ 777 EL_RightBSDIndicatorFaultSt 1;
BA_ "GenSigStartValue" SG_ 777 EL_RightBSDIndicatorFaultSt 0;
BA_ "GenSigTimeoutValue" SG_ 777 EL_RightBSDIndicatorFaultSt 0;
BA_ "Remark" SG_ 777 EL_RightBSDIndicatorFaultSt "源报文周期20ms，转发后报文周期100ms，转发后的counter值发送会不连续";
BA_ "EventCommandSignal" SG_ 342 ZCUR_8_CRC 0;
BA_ "GatewayedSignals" SG_ 342 ZCUR_8_CRC 0;
BA_ "GenSigInactiveValue" SG_ 342 ZCUR_8_CRC 0;
BA_ "GenSigInvalidValue" SG_ 342 ZCUR_8_CRC 0;
BA_ "GenSigSendType" SG_ 342 ZCUR_8_CRC 1;
BA_ "GenSigStartValue" SG_ 342 ZCUR_8_CRC 0;
BA_ "GenSigTimeoutValue" SG_ 342 ZCUR_8_CRC 0;
BA_ "Remark" SG_ 342 ZCUR_8_CRC "";
BA_ "EventCommandSignal" SG_ 342 ZCUR_8_Counter 0;
BA_ "GatewayedSignals" SG_ 342 ZCUR_8_Counter 0;
BA_ "GenSigInactiveValue" SG_ 342 ZCUR_8_Counter 0;
BA_ "GenSigInvalidValue" SG_ 342 ZCUR_8_Counter 0;
BA_ "GenSigSendType" SG_ 342 ZCUR_8_Counter 1;
BA_ "GenSigStartValue" SG_ 342 ZCUR_8_Counter 0;
BA_ "GenSigTimeoutValue" SG_ 342 ZCUR_8_Counter 0;
BA_ "Remark" SG_ 342 ZCUR_8_Counter "";
BA_ "EventCommandSignal" SG_ 342 KAE_PassiveUnlockReq 0;
BA_ "GatewayedSignals" SG_ 342 KAE_PassiveUnlockReq 0;
BA_ "GenSigInactiveValue" SG_ 342 KAE_PassiveUnlockReq 0;
BA_ "GenSigInvalidValue" SG_ 342 KAE_PassiveUnlockReq 0;
BA_ "GenSigSendType" SG_ 342 KAE_PassiveUnlockReq 1;
BA_ "GenSigStartValue" SG_ 342 KAE_PassiveUnlockReq 0;
BA_ "GenSigTimeoutValue" SG_ 342 KAE_PassiveUnlockReq 0;
BA_ "Remark" SG_ 342 KAE_PassiveUnlockReq "";
BA_ "EventCommandSignal" SG_ 342 KAE_PassiveLockReq 0;
BA_ "GatewayedSignals" SG_ 342 KAE_PassiveLockReq 0;
BA_ "GenSigInactiveValue" SG_ 342 KAE_PassiveLockReq 0;
BA_ "GenSigInvalidValue" SG_ 342 KAE_PassiveLockReq 0;
BA_ "GenSigSendType" SG_ 342 KAE_PassiveLockReq 1;
BA_ "GenSigStartValue" SG_ 342 KAE_PassiveLockReq 0;
BA_ "GenSigTimeoutValue" SG_ 342 KAE_PassiveLockReq 0;
BA_ "Remark" SG_ 342 KAE_PassiveLockReq "";
BA_ "EventCommandSignal" SG_ 342 KAE_FOB1Position 0;
BA_ "GatewayedSignals" SG_ 342 KAE_FOB1Position 0;
BA_ "GenSigInactiveValue" SG_ 342 KAE_FOB1Position 0;
BA_ "GenSigInvalidValue" SG_ 342 KAE_FOB1Position 0;
BA_ "GenSigSendType" SG_ 342 KAE_FOB1Position 1;
BA_ "GenSigStartValue" SG_ 342 KAE_FOB1Position 0;
BA_ "GenSigTimeoutValue" SG_ 342 KAE_FOB1Position 0;
BA_ "Remark" SG_ 342 KAE_FOB1Position "";
BA_ "EventCommandSignal" SG_ 342 KAE_FOB2Position 0;
BA_ "GatewayedSignals" SG_ 342 KAE_FOB2Position 0;
BA_ "GenSigInactiveValue" SG_ 342 KAE_FOB2Position 0;
BA_ "GenSigInvalidValue" SG_ 342 KAE_FOB2Position 0;
BA_ "GenSigSendType" SG_ 342 KAE_FOB2Position 1;
BA_ "GenSigStartValue" SG_ 342 KAE_FOB2Position 0;
BA_ "GenSigTimeoutValue" SG_ 342 KAE_FOB2Position 0;
BA_ "Remark" SG_ 342 KAE_FOB2Position "";
BA_ "EventCommandSignal" SG_ 342 KAE_FOB3Position 0;
BA_ "GatewayedSignals" SG_ 342 KAE_FOB3Position 0;
BA_ "GenSigInactiveValue" SG_ 342 KAE_FOB3Position 0;
BA_ "GenSigInvalidValue" SG_ 342 KAE_FOB3Position 0;
BA_ "GenSigSendType" SG_ 342 KAE_FOB3Position 1;
BA_ "GenSigStartValue" SG_ 342 KAE_FOB3Position 0;
BA_ "GenSigTimeoutValue" SG_ 342 KAE_FOB3Position 0;
BA_ "Remark" SG_ 342 KAE_FOB3Position "";
BA_ "EventCommandSignal" SG_ 342 KAE_FOB2UnlockBtnPressS 0;
BA_ "GatewayedSignals" SG_ 342 KAE_FOB2UnlockBtnPressS 0;
BA_ "GenSigInactiveValue" SG_ 342 KAE_FOB2UnlockBtnPressS 0;
BA_ "GenSigInvalidValue" SG_ 342 KAE_FOB2UnlockBtnPressS 0;
BA_ "GenSigSendType" SG_ 342 KAE_FOB2UnlockBtnPressS 1;
BA_ "GenSigStartValue" SG_ 342 KAE_FOB2UnlockBtnPressS 0;
BA_ "GenSigTimeoutValue" SG_ 342 KAE_FOB2UnlockBtnPressS 0;
BA_ "Remark" SG_ 342 KAE_FOB2UnlockBtnPressS "";
BA_ "EventCommandSignal" SG_ 342 KAE_FOB2LockBtnPressSt 0;
BA_ "GatewayedSignals" SG_ 342 KAE_FOB2LockBtnPressSt 0;
BA_ "GenSigInactiveValue" SG_ 342 KAE_FOB2LockBtnPressSt 0;
BA_ "GenSigInvalidValue" SG_ 342 KAE_FOB2LockBtnPressSt 0;
BA_ "GenSigSendType" SG_ 342 KAE_FOB2LockBtnPressSt 1;
BA_ "GenSigStartValue" SG_ 342 KAE_FOB2LockBtnPressSt 0;
BA_ "GenSigTimeoutValue" SG_ 342 KAE_FOB2LockBtnPressSt 0;
BA_ "Remark" SG_ 342 KAE_FOB2LockBtnPressSt "";
BA_ "EventCommandSignal" SG_ 342 KAE_FOB2TrunkBtnPressSt 0;
BA_ "GatewayedSignals" SG_ 342 KAE_FOB2TrunkBtnPressSt 0;
BA_ "GenSigInactiveValue" SG_ 342 KAE_FOB2TrunkBtnPressSt 0;
BA_ "GenSigInvalidValue" SG_ 342 KAE_FOB2TrunkBtnPressSt 0;
BA_ "GenSigSendType" SG_ 342 KAE_FOB2TrunkBtnPressSt 1;
BA_ "GenSigStartValue" SG_ 342 KAE_FOB2TrunkBtnPressSt 0;
BA_ "GenSigTimeoutValue" SG_ 342 KAE_FOB2TrunkBtnPressSt 0;
BA_ "Remark" SG_ 342 KAE_FOB2TrunkBtnPressSt "";
BA_ "EventCommandSignal" SG_ 342 KAE_FOB2User_definedBtnPressSt 0;
BA_ "GatewayedSignals" SG_ 342 KAE_FOB2User_definedBtnPressSt 0;
BA_ "GenSigInactiveValue" SG_ 342 KAE_FOB2User_definedBtnPressSt 0;
BA_ "GenSigInvalidValue" SG_ 342 KAE_FOB2User_definedBtnPressSt 0;
BA_ "GenSigSendType" SG_ 342 KAE_FOB2User_definedBtnPressSt 1;
BA_ "GenSigStartValue" SG_ 342 KAE_FOB2User_definedBtnPressSt 0;
BA_ "GenSigTimeoutValue" SG_ 342 KAE_FOB2User_definedBtnPressSt 0;
BA_ "Remark" SG_ 342 KAE_FOB2User_definedBtnPressSt "";
BA_ "EventCommandSignal" SG_ 342 KAE_FOB3UnlockBtnPressS 0;
BA_ "GatewayedSignals" SG_ 342 KAE_FOB3UnlockBtnPressS 0;
BA_ "GenSigInactiveValue" SG_ 342 KAE_FOB3UnlockBtnPressS 0;
BA_ "GenSigInvalidValue" SG_ 342 KAE_FOB3UnlockBtnPressS 0;
BA_ "GenSigSendType" SG_ 342 KAE_FOB3UnlockBtnPressS 1;
BA_ "GenSigStartValue" SG_ 342 KAE_FOB3UnlockBtnPressS 0;
BA_ "GenSigTimeoutValue" SG_ 342 KAE_FOB3UnlockBtnPressS 0;
BA_ "Remark" SG_ 342 KAE_FOB3UnlockBtnPressS "";
BA_ "EventCommandSignal" SG_ 342 KAE_FOB3LockBtnPressSt 0;
BA_ "GatewayedSignals" SG_ 342 KAE_FOB3LockBtnPressSt 0;
BA_ "GenSigInactiveValue" SG_ 342 KAE_FOB3LockBtnPressSt 0;
BA_ "GenSigInvalidValue" SG_ 342 KAE_FOB3LockBtnPressSt 0;
BA_ "GenSigSendType" SG_ 342 KAE_FOB3LockBtnPressSt 1;
BA_ "GenSigStartValue" SG_ 342 KAE_FOB3LockBtnPressSt 0;
BA_ "GenSigTimeoutValue" SG_ 342 KAE_FOB3LockBtnPressSt 0;
BA_ "Remark" SG_ 342 KAE_FOB3LockBtnPressSt "";
BA_ "EventCommandSignal" SG_ 342 KAE_FOB3TrunkBinPressSt 0;
BA_ "GatewayedSignals" SG_ 342 KAE_FOB3TrunkBinPressSt 0;
BA_ "GenSigInactiveValue" SG_ 342 KAE_FOB3TrunkBinPressSt 0;
BA_ "GenSigInvalidValue" SG_ 342 KAE_FOB3TrunkBinPressSt 0;
BA_ "GenSigSendType" SG_ 342 KAE_FOB3TrunkBinPressSt 1;
BA_ "GenSigStartValue" SG_ 342 KAE_FOB3TrunkBinPressSt 0;
BA_ "GenSigTimeoutValue" SG_ 342 KAE_FOB3TrunkBinPressSt 0;
BA_ "Remark" SG_ 342 KAE_FOB3TrunkBinPressSt "";
BA_ "EventCommandSignal" SG_ 342 KAE_FOB3User_defnedBtnPressst 0;
BA_ "GatewayedSignals" SG_ 342 KAE_FOB3User_defnedBtnPressst 0;
BA_ "GenSigInactiveValue" SG_ 342 KAE_FOB3User_defnedBtnPressst 0;
BA_ "GenSigInvalidValue" SG_ 342 KAE_FOB3User_defnedBtnPressst 0;
BA_ "GenSigSendType" SG_ 342 KAE_FOB3User_defnedBtnPressst 1;
BA_ "GenSigStartValue" SG_ 342 KAE_FOB3User_defnedBtnPressst 0;
BA_ "GenSigTimeoutValue" SG_ 342 KAE_FOB3User_defnedBtnPressst 0;
BA_ "Remark" SG_ 342 KAE_FOB3User_defnedBtnPressst "";
BA_ "EventCommandSignal" SG_ 342 KAE_FOBUnlockBtnPressSt 0;
BA_ "GatewayedSignals" SG_ 342 KAE_FOBUnlockBtnPressSt 0;
BA_ "GenSigInactiveValue" SG_ 342 KAE_FOBUnlockBtnPressSt 0;
BA_ "GenSigInvalidValue" SG_ 342 KAE_FOBUnlockBtnPressSt 0;
BA_ "GenSigSendType" SG_ 342 KAE_FOBUnlockBtnPressSt 1;
BA_ "GenSigStartValue" SG_ 342 KAE_FOBUnlockBtnPressSt 0;
BA_ "GenSigTimeoutValue" SG_ 342 KAE_FOBUnlockBtnPressSt 0;
BA_ "Remark" SG_ 342 KAE_FOBUnlockBtnPressSt "";
BA_ "EventCommandSignal" SG_ 342 KAE_FOBLockBtnPressSt 0;
BA_ "GatewayedSignals" SG_ 342 KAE_FOBLockBtnPressSt 0;
BA_ "GenSigInactiveValue" SG_ 342 KAE_FOBLockBtnPressSt 0;
BA_ "GenSigInvalidValue" SG_ 342 KAE_FOBLockBtnPressSt 0;
BA_ "GenSigSendType" SG_ 342 KAE_FOBLockBtnPressSt 1;
BA_ "GenSigStartValue" SG_ 342 KAE_FOBLockBtnPressSt 0;
BA_ "GenSigTimeoutValue" SG_ 342 KAE_FOBLockBtnPressSt 0;
BA_ "Remark" SG_ 342 KAE_FOBLockBtnPressSt "";
BA_ "EventCommandSignal" SG_ 342 KAE_FOBRESBtnPressSt 0;
BA_ "GatewayedSignals" SG_ 342 KAE_FOBRESBtnPressSt 0;
BA_ "GenSigInactiveValue" SG_ 342 KAE_FOBRESBtnPressSt 0;
BA_ "GenSigInvalidValue" SG_ 342 KAE_FOBRESBtnPressSt 0;
BA_ "GenSigSendType" SG_ 342 KAE_FOBRESBtnPressSt 1;
BA_ "GenSigStartValue" SG_ 342 KAE_FOBRESBtnPressSt 0;
BA_ "GenSigTimeoutValue" SG_ 342 KAE_FOBRESBtnPressSt 0;
BA_ "Remark" SG_ 342 KAE_FOBRESBtnPressSt "";
BA_ "EventCommandSignal" SG_ 342 KAE_FOBPSD_LBtnPressSt 0;
BA_ "GatewayedSignals" SG_ 342 KAE_FOBPSD_LBtnPressSt 0;
BA_ "GenSigInactiveValue" SG_ 342 KAE_FOBPSD_LBtnPressSt 0;
BA_ "GenSigInvalidValue" SG_ 342 KAE_FOBPSD_LBtnPressSt 0;
BA_ "GenSigSendType" SG_ 342 KAE_FOBPSD_LBtnPressSt 1;
BA_ "GenSigStartValue" SG_ 342 KAE_FOBPSD_LBtnPressSt 0;
BA_ "GenSigTimeoutValue" SG_ 342 KAE_FOBPSD_LBtnPressSt 0;
BA_ "Remark" SG_ 342 KAE_FOBPSD_LBtnPressSt "";
BA_ "EventCommandSignal" SG_ 342 KAE_FOBPSD_RBtnPressSt 0;
BA_ "GatewayedSignals" SG_ 342 KAE_FOBPSD_RBtnPressSt 0;
BA_ "GenSigInactiveValue" SG_ 342 KAE_FOBPSD_RBtnPressSt 0;
BA_ "GenSigInvalidValue" SG_ 342 KAE_FOBPSD_RBtnPressSt 0;
BA_ "GenSigSendType" SG_ 342 KAE_FOBPSD_RBtnPressSt 1;
BA_ "GenSigStartValue" SG_ 342 KAE_FOBPSD_RBtnPressSt 0;
BA_ "GenSigTimeoutValue" SG_ 342 KAE_FOBPSD_RBtnPressSt 0;
BA_ "Remark" SG_ 342 KAE_FOBPSD_RBtnPressSt "";
BA_ "EventCommandSignal" SG_ 342 KAE_FOBTrunkBtnPressSt 0;
BA_ "GatewayedSignals" SG_ 342 KAE_FOBTrunkBtnPressSt 0;
BA_ "GenSigInactiveValue" SG_ 342 KAE_FOBTrunkBtnPressSt 0;
BA_ "GenSigInvalidValue" SG_ 342 KAE_FOBTrunkBtnPressSt 0;
BA_ "GenSigSendType" SG_ 342 KAE_FOBTrunkBtnPressSt 1;
BA_ "GenSigStartValue" SG_ 342 KAE_FOBTrunkBtnPressSt 0;
BA_ "GenSigTimeoutValue" SG_ 342 KAE_FOBTrunkBtnPressSt 0;
BA_ "Remark" SG_ 342 KAE_FOBTrunkBtnPressSt "";
BA_ "EventCommandSignal" SG_ 342 KAE_FOBPanicBtnPressSt 0;
BA_ "GatewayedSignals" SG_ 342 KAE_FOBPanicBtnPressSt 0;
BA_ "GenSigInactiveValue" SG_ 342 KAE_FOBPanicBtnPressSt 0;
BA_ "GenSigInvalidValue" SG_ 342 KAE_FOBPanicBtnPressSt 0;
BA_ "GenSigSendType" SG_ 342 KAE_FOBPanicBtnPressSt 1;
BA_ "GenSigStartValue" SG_ 342 KAE_FOBPanicBtnPressSt 0;
BA_ "GenSigTimeoutValue" SG_ 342 KAE_FOBPanicBtnPressSt 0;
BA_ "Remark" SG_ 342 KAE_FOBPanicBtnPressSt "";
BA_ "EventCommandSignal" SG_ 342 KAE_FOBUser_definedBtnPressSt 0;
BA_ "GatewayedSignals" SG_ 342 KAE_FOBUser_definedBtnPressSt 0;
BA_ "GenSigInactiveValue" SG_ 342 KAE_FOBUser_definedBtnPressSt 0;
BA_ "GenSigInvalidValue" SG_ 342 KAE_FOBUser_definedBtnPressSt 0;
BA_ "GenSigSendType" SG_ 342 KAE_FOBUser_definedBtnPressSt 1;
BA_ "GenSigStartValue" SG_ 342 KAE_FOBUser_definedBtnPressSt 0;
BA_ "GenSigTimeoutValue" SG_ 342 KAE_FOBUser_definedBtnPressSt 0;
BA_ "Remark" SG_ 342 KAE_FOBUser_definedBtnPressSt "";
BA_ "EventCommandSignal" SG_ 342 KAE_FOB2RESBtnPressSt 1;
BA_ "GatewayedSignals" SG_ 342 KAE_FOB2RESBtnPressSt 0;
BA_ "GenSigInactiveValue" SG_ 342 KAE_FOB2RESBtnPressSt 0;
BA_ "GenSigInvalidValue" SG_ 342 KAE_FOB2RESBtnPressSt 0;
BA_ "GenSigSendType" SG_ 342 KAE_FOB2RESBtnPressSt 0;
BA_ "GenSigStartValue" SG_ 342 KAE_FOB2RESBtnPressSt 0;
BA_ "GenSigTimeoutValue" SG_ 342 KAE_FOB2RESBtnPressSt 0;
BA_ "Remark" SG_ 342 KAE_FOB2RESBtnPressSt "";
BA_ "EventCommandSignal" SG_ 342 KAE_FOB2PanicBtnPressSt 1;
BA_ "GatewayedSignals" SG_ 342 KAE_FOB2PanicBtnPressSt 0;
BA_ "GenSigInactiveValue" SG_ 342 KAE_FOB2PanicBtnPressSt 0;
BA_ "GenSigInvalidValue" SG_ 342 KAE_FOB2PanicBtnPressSt 0;
BA_ "GenSigSendType" SG_ 342 KAE_FOB2PanicBtnPressSt 0;
BA_ "GenSigStartValue" SG_ 342 KAE_FOB2PanicBtnPressSt 0;
BA_ "GenSigTimeoutValue" SG_ 342 KAE_FOB2PanicBtnPressSt 0;
BA_ "Remark" SG_ 342 KAE_FOB2PanicBtnPressSt "";
BA_ "EventCommandSignal" SG_ 512 KAE_BLE1Position 1;
BA_ "GatewayedSignals" SG_ 512 KAE_BLE1Position 0;
BA_ "GenSigInactiveValue" SG_ 512 KAE_BLE1Position 0;
BA_ "GenSigInvalidValue" SG_ 512 KAE_BLE1Position 0;
BA_ "GenSigSendType" SG_ 512 KAE_BLE1Position 0;
BA_ "GenSigStartValue" SG_ 512 KAE_BLE1Position 0;
BA_ "GenSigTimeoutValue" SG_ 512 KAE_BLE1Position 0;
BA_ "Remark" SG_ 512 KAE_BLE1Position "";
BA_ "EventCommandSignal" SG_ 512 KAE_BLE2Position 1;
BA_ "GatewayedSignals" SG_ 512 KAE_BLE2Position 0;
BA_ "GenSigInactiveValue" SG_ 512 KAE_BLE2Position 0;
BA_ "GenSigInvalidValue" SG_ 512 KAE_BLE2Position 0;
BA_ "GenSigSendType" SG_ 512 KAE_BLE2Position 0;
BA_ "GenSigStartValue" SG_ 512 KAE_BLE2Position 0;
BA_ "GenSigTimeoutValue" SG_ 512 KAE_BLE2Position 0;
BA_ "Remark" SG_ 512 KAE_BLE2Position "";
BA_ "EventCommandSignal" SG_ 512 KAE_BLE3Position 1;
BA_ "GatewayedSignals" SG_ 512 KAE_BLE3Position 0;
BA_ "GenSigInactiveValue" SG_ 512 KAE_BLE3Position 0;
BA_ "GenSigInvalidValue" SG_ 512 KAE_BLE3Position 0;
BA_ "GenSigSendType" SG_ 512 KAE_BLE3Position 0;
BA_ "GenSigStartValue" SG_ 512 KAE_BLE3Position 0;
BA_ "GenSigTimeoutValue" SG_ 512 KAE_BLE3Position 0;
BA_ "Remark" SG_ 512 KAE_BLE3Position "";
BA_ "EventCommandSignal" SG_ 512 KAE_BLE4Position 1;
BA_ "GatewayedSignals" SG_ 512 KAE_BLE4Position 0;
BA_ "GenSigInactiveValue" SG_ 512 KAE_BLE4Position 0;
BA_ "GenSigInvalidValue" SG_ 512 KAE_BLE4Position 0;
BA_ "GenSigSendType" SG_ 512 KAE_BLE4Position 0;
BA_ "GenSigStartValue" SG_ 512 KAE_BLE4Position 0;
BA_ "GenSigTimeoutValue" SG_ 512 KAE_BLE4Position 0;
BA_ "Remark" SG_ 512 KAE_BLE4Position "";
BA_ "EventCommandSignal" SG_ 512 KAE_BLE5Position 1;
BA_ "GatewayedSignals" SG_ 512 KAE_BLE5Position 0;
BA_ "GenSigInactiveValue" SG_ 512 KAE_BLE5Position 0;
BA_ "GenSigInvalidValue" SG_ 512 KAE_BLE5Position 0;
BA_ "GenSigSendType" SG_ 512 KAE_BLE5Position 0;
BA_ "GenSigStartValue" SG_ 512 KAE_BLE5Position 0;
BA_ "GenSigTimeoutValue" SG_ 512 KAE_BLE5Position 0;
BA_ "Remark" SG_ 512 KAE_BLE5Position "";
BA_ "EventCommandSignal" SG_ 512 KAE_BLE1AuthSt 1;
BA_ "GatewayedSignals" SG_ 512 KAE_BLE1AuthSt 0;
BA_ "GenSigInactiveValue" SG_ 512 KAE_BLE1AuthSt 0;
BA_ "GenSigInvalidValue" SG_ 512 KAE_BLE1AuthSt 0;
BA_ "GenSigSendType" SG_ 512 KAE_BLE1AuthSt 0;
BA_ "GenSigStartValue" SG_ 512 KAE_BLE1AuthSt 0;
BA_ "GenSigTimeoutValue" SG_ 512 KAE_BLE1AuthSt 0;
BA_ "Remark" SG_ 512 KAE_BLE1AuthSt "";
BA_ "EventCommandSignal" SG_ 512 KAE_BLE2AuthSt 1;
BA_ "GatewayedSignals" SG_ 512 KAE_BLE2AuthSt 0;
BA_ "GenSigInactiveValue" SG_ 512 KAE_BLE2AuthSt 0;
BA_ "GenSigInvalidValue" SG_ 512 KAE_BLE2AuthSt 0;
BA_ "GenSigSendType" SG_ 512 KAE_BLE2AuthSt 0;
BA_ "GenSigStartValue" SG_ 512 KAE_BLE2AuthSt 0;
BA_ "GenSigTimeoutValue" SG_ 512 KAE_BLE2AuthSt 0;
BA_ "Remark" SG_ 512 KAE_BLE2AuthSt "";
BA_ "EventCommandSignal" SG_ 512 KAE_BLE3AuthSt 1;
BA_ "GatewayedSignals" SG_ 512 KAE_BLE3AuthSt 0;
BA_ "GenSigInactiveValue" SG_ 512 KAE_BLE3AuthSt 0;
BA_ "GenSigInvalidValue" SG_ 512 KAE_BLE3AuthSt 0;
BA_ "GenSigSendType" SG_ 512 KAE_BLE3AuthSt 0;
BA_ "GenSigStartValue" SG_ 512 KAE_BLE3AuthSt 0;
BA_ "GenSigTimeoutValue" SG_ 512 KAE_BLE3AuthSt 0;
BA_ "Remark" SG_ 512 KAE_BLE3AuthSt "";
BA_ "EventCommandSignal" SG_ 512 KAE_BLE4AuthSt 1;
BA_ "GatewayedSignals" SG_ 512 KAE_BLE4AuthSt 0;
BA_ "GenSigInactiveValue" SG_ 512 KAE_BLE4AuthSt 0;
BA_ "GenSigInvalidValue" SG_ 512 KAE_BLE4AuthSt 0;
BA_ "GenSigSendType" SG_ 512 KAE_BLE4AuthSt 0;
BA_ "GenSigStartValue" SG_ 512 KAE_BLE4AuthSt 0;
BA_ "GenSigTimeoutValue" SG_ 512 KAE_BLE4AuthSt 0;
BA_ "Remark" SG_ 512 KAE_BLE4AuthSt "";
BA_ "EventCommandSignal" SG_ 512 KAE_BLE5AuthSt 1;
BA_ "GatewayedSignals" SG_ 512 KAE_BLE5AuthSt 0;
BA_ "GenSigInactiveValue" SG_ 512 KAE_BLE5AuthSt 0;
BA_ "GenSigInvalidValue" SG_ 512 KAE_BLE5AuthSt 0;
BA_ "GenSigSendType" SG_ 512 KAE_BLE5AuthSt 0;
BA_ "GenSigStartValue" SG_ 512 KAE_BLE5AuthSt 0;
BA_ "GenSigTimeoutValue" SG_ 512 KAE_BLE5AuthSt 0;
BA_ "Remark" SG_ 512 KAE_BLE5AuthSt "";
BA_ "EventCommandSignal" SG_ 512 KAE_BLE1PKSPosition 1;
BA_ "GatewayedSignals" SG_ 512 KAE_BLE1PKSPosition 0;
BA_ "GenSigInactiveValue" SG_ 512 KAE_BLE1PKSPosition 0;
BA_ "GenSigInvalidValue" SG_ 512 KAE_BLE1PKSPosition 0;
BA_ "GenSigSendType" SG_ 512 KAE_BLE1PKSPosition 0;
BA_ "GenSigStartValue" SG_ 512 KAE_BLE1PKSPosition 0;
BA_ "GenSigTimeoutValue" SG_ 512 KAE_BLE1PKSPosition 0;
BA_ "Remark" SG_ 512 KAE_BLE1PKSPosition "";
BA_ "EventCommandSignal" SG_ 512 KAE_BLE2PKSPosition 1;
BA_ "GatewayedSignals" SG_ 512 KAE_BLE2PKSPosition 0;
BA_ "GenSigInactiveValue" SG_ 512 KAE_BLE2PKSPosition 0;
BA_ "GenSigInvalidValue" SG_ 512 KAE_BLE2PKSPosition 0;
BA_ "GenSigSendType" SG_ 512 KAE_BLE2PKSPosition 0;
BA_ "GenSigStartValue" SG_ 512 KAE_BLE2PKSPosition 0;
BA_ "GenSigTimeoutValue" SG_ 512 KAE_BLE2PKSPosition 0;
BA_ "Remark" SG_ 512 KAE_BLE2PKSPosition "";
BA_ "EventCommandSignal" SG_ 512 KAE_BLE3PKSPosition 1;
BA_ "GatewayedSignals" SG_ 512 KAE_BLE3PKSPosition 0;
BA_ "GenSigInactiveValue" SG_ 512 KAE_BLE3PKSPosition 0;
BA_ "GenSigInvalidValue" SG_ 512 KAE_BLE3PKSPosition 0;
BA_ "GenSigSendType" SG_ 512 KAE_BLE3PKSPosition 0;
BA_ "GenSigStartValue" SG_ 512 KAE_BLE3PKSPosition 0;
BA_ "GenSigTimeoutValue" SG_ 512 KAE_BLE3PKSPosition 0;
BA_ "Remark" SG_ 512 KAE_BLE3PKSPosition "";
BA_ "EventCommandSignal" SG_ 512 KAE_BLE4PKSPosition 1;
BA_ "GatewayedSignals" SG_ 512 KAE_BLE4PKSPosition 0;
BA_ "GenSigInactiveValue" SG_ 512 KAE_BLE4PKSPosition 0;
BA_ "GenSigInvalidValue" SG_ 512 KAE_BLE4PKSPosition 0;
BA_ "GenSigSendType" SG_ 512 KAE_BLE4PKSPosition 0;
BA_ "GenSigStartValue" SG_ 512 KAE_BLE4PKSPosition 0;
BA_ "GenSigTimeoutValue" SG_ 512 KAE_BLE4PKSPosition 0;
BA_ "Remark" SG_ 512 KAE_BLE4PKSPosition "";
BA_ "EventCommandSignal" SG_ 512 KAE_BLE5PKSPosition 1;
BA_ "GatewayedSignals" SG_ 512 KAE_BLE5PKSPosition 0;
BA_ "GenSigInactiveValue" SG_ 512 KAE_BLE5PKSPosition 0;
BA_ "GenSigInvalidValue" SG_ 512 KAE_BLE5PKSPosition 0;
BA_ "GenSigSendType" SG_ 512 KAE_BLE5PKSPosition 0;
BA_ "GenSigStartValue" SG_ 512 KAE_BLE5PKSPosition 0;
BA_ "GenSigTimeoutValue" SG_ 512 KAE_BLE5PKSPosition 0;
BA_ "Remark" SG_ 512 KAE_BLE5PKSPosition "";
BA_ "EventCommandSignal" SG_ 909 LCK_HoodAjarSt 0;
BA_ "GatewayedSignals" SG_ 909 LCK_HoodAjarSt 0;
BA_ "GenSigInactiveValue" SG_ 909 LCK_HoodAjarSt 0;
BA_ "GenSigInvalidValue" SG_ 909 LCK_HoodAjarSt 0;
BA_ "GenSigSendType" SG_ 909 LCK_HoodAjarSt 0;
BA_ "GenSigStartValue" SG_ 909 LCK_HoodAjarSt 0;
BA_ "GenSigTimeoutValue" SG_ 909 LCK_HoodAjarSt 0;
BA_ "Remark" SG_ 909 LCK_HoodAjarSt "";
BA_ "EventCommandSignal" SG_ 909 LCK_FrontLeftDoorAjarSt 0;
BA_ "GatewayedSignals" SG_ 909 LCK_FrontLeftDoorAjarSt 0;
BA_ "GenSigInactiveValue" SG_ 909 LCK_FrontLeftDoorAjarSt 0;
BA_ "GenSigInvalidValue" SG_ 909 LCK_FrontLeftDoorAjarSt 0;
BA_ "GenSigSendType" SG_ 909 LCK_FrontLeftDoorAjarSt 0;
BA_ "GenSigStartValue" SG_ 909 LCK_FrontLeftDoorAjarSt 0;
BA_ "GenSigTimeoutValue" SG_ 909 LCK_FrontLeftDoorAjarSt 0;
BA_ "Remark" SG_ 909 LCK_FrontLeftDoorAjarSt "";
BA_ "EventCommandSignal" SG_ 909 LCK_FrontRightDoorAjarSt 0;
BA_ "GatewayedSignals" SG_ 909 LCK_FrontRightDoorAjarSt 0;
BA_ "GenSigInactiveValue" SG_ 909 LCK_FrontRightDoorAjarSt 0;
BA_ "GenSigInvalidValue" SG_ 909 LCK_FrontRightDoorAjarSt 0;
BA_ "GenSigSendType" SG_ 909 LCK_FrontRightDoorAjarSt 0;
BA_ "GenSigStartValue" SG_ 909 LCK_FrontRightDoorAjarSt 0;
BA_ "GenSigTimeoutValue" SG_ 909 LCK_FrontRightDoorAjarSt 0;
BA_ "Remark" SG_ 909 LCK_FrontRightDoorAjarSt "";
BA_ "EventCommandSignal" SG_ 909 LCK_RearLeftDoorAjarSt 0;
BA_ "GatewayedSignals" SG_ 909 LCK_RearLeftDoorAjarSt 0;
BA_ "GenSigInactiveValue" SG_ 909 LCK_RearLeftDoorAjarSt 0;
BA_ "GenSigInvalidValue" SG_ 909 LCK_RearLeftDoorAjarSt 0;
BA_ "GenSigSendType" SG_ 909 LCK_RearLeftDoorAjarSt 0;
BA_ "GenSigStartValue" SG_ 909 LCK_RearLeftDoorAjarSt 0;
BA_ "GenSigTimeoutValue" SG_ 909 LCK_RearLeftDoorAjarSt 0;
BA_ "Remark" SG_ 909 LCK_RearLeftDoorAjarSt "";
BA_ "EventCommandSignal" SG_ 909 LCK_RearRightDoorAjarSt 0;
BA_ "GatewayedSignals" SG_ 909 LCK_RearRightDoorAjarSt 0;
BA_ "GenSigInactiveValue" SG_ 909 LCK_RearRightDoorAjarSt 0;
BA_ "GenSigInvalidValue" SG_ 909 LCK_RearRightDoorAjarSt 0;
BA_ "GenSigSendType" SG_ 909 LCK_RearRightDoorAjarSt 0;
BA_ "GenSigStartValue" SG_ 909 LCK_RearRightDoorAjarSt 0;
BA_ "GenSigTimeoutValue" SG_ 909 LCK_RearRightDoorAjarSt 0;
BA_ "Remark" SG_ 909 LCK_RearRightDoorAjarSt "";
BA_ "EventCommandSignal" SG_ 909 LCK_TrunkAjarSt 0;
BA_ "GatewayedSignals" SG_ 909 LCK_TrunkAjarSt 0;
BA_ "GenSigInactiveValue" SG_ 909 LCK_TrunkAjarSt 0;
BA_ "GenSigInvalidValue" SG_ 909 LCK_TrunkAjarSt 0;
BA_ "GenSigSendType" SG_ 909 LCK_TrunkAjarSt 0;
BA_ "GenSigStartValue" SG_ 909 LCK_TrunkAjarSt 0;
BA_ "GenSigTimeoutValue" SG_ 909 LCK_TrunkAjarSt 0;
BA_ "Remark" SG_ 909 LCK_TrunkAjarSt "";
BA_ "EventCommandSignal" SG_ 909 LCK_FrontLeftDoorLockSt 0;
BA_ "GatewayedSignals" SG_ 909 LCK_FrontLeftDoorLockSt 0;
BA_ "GenSigInactiveValue" SG_ 909 LCK_FrontLeftDoorLockSt 0;
BA_ "GenSigInvalidValue" SG_ 909 LCK_FrontLeftDoorLockSt 0;
BA_ "GenSigSendType" SG_ 909 LCK_FrontLeftDoorLockSt 0;
BA_ "GenSigStartValue" SG_ 909 LCK_FrontLeftDoorLockSt 0;
BA_ "GenSigTimeoutValue" SG_ 909 LCK_FrontLeftDoorLockSt 0;
BA_ "Remark" SG_ 909 LCK_FrontLeftDoorLockSt "";
BA_ "EventCommandSignal" SG_ 909 LCK_FrontRightDoorLockSt 0;
BA_ "GatewayedSignals" SG_ 909 LCK_FrontRightDoorLockSt 0;
BA_ "GenSigInactiveValue" SG_ 909 LCK_FrontRightDoorLockSt 0;
BA_ "GenSigInvalidValue" SG_ 909 LCK_FrontRightDoorLockSt 0;
BA_ "GenSigSendType" SG_ 909 LCK_FrontRightDoorLockSt 0;
BA_ "GenSigStartValue" SG_ 909 LCK_FrontRightDoorLockSt 0;
BA_ "GenSigTimeoutValue" SG_ 909 LCK_FrontRightDoorLockSt 0;
BA_ "Remark" SG_ 909 LCK_FrontRightDoorLockSt "";
BA_ "EventCommandSignal" SG_ 909 LCK_RearLeftDoorLockSt 0;
BA_ "GatewayedSignals" SG_ 909 LCK_RearLeftDoorLockSt 0;
BA_ "GenSigInactiveValue" SG_ 909 LCK_RearLeftDoorLockSt 0;
BA_ "GenSigInvalidValue" SG_ 909 LCK_RearLeftDoorLockSt 0;
BA_ "GenSigSendType" SG_ 909 LCK_RearLeftDoorLockSt 0;
BA_ "GenSigStartValue" SG_ 909 LCK_RearLeftDoorLockSt 0;
BA_ "GenSigTimeoutValue" SG_ 909 LCK_RearLeftDoorLockSt 0;
BA_ "Remark" SG_ 909 LCK_RearLeftDoorLockSt "";
BA_ "EventCommandSignal" SG_ 909 LCK_RearRightDoorLockSt 0;
BA_ "GatewayedSignals" SG_ 909 LCK_RearRightDoorLockSt 0;
BA_ "GenSigInactiveValue" SG_ 909 LCK_RearRightDoorLockSt 0;
BA_ "GenSigInvalidValue" SG_ 909 LCK_RearRightDoorLockSt 0;
BA_ "GenSigSendType" SG_ 909 LCK_RearRightDoorLockSt 0;
BA_ "GenSigStartValue" SG_ 909 LCK_RearRightDoorLockSt 0;
BA_ "GenSigTimeoutValue" SG_ 909 LCK_RearRightDoorLockSt 0;
BA_ "Remark" SG_ 909 LCK_RearRightDoorLockSt "";
BA_ "EventCommandSignal" SG_ 909 LCK_RearLeftChildSaftyLockSt 0;
BA_ "GatewayedSignals" SG_ 909 LCK_RearLeftChildSaftyLockSt 0;
BA_ "GenSigInactiveValue" SG_ 909 LCK_RearLeftChildSaftyLockSt 0;
BA_ "GenSigInvalidValue" SG_ 909 LCK_RearLeftChildSaftyLockSt 0;
BA_ "GenSigSendType" SG_ 909 LCK_RearLeftChildSaftyLockSt 0;
BA_ "GenSigStartValue" SG_ 909 LCK_RearLeftChildSaftyLockSt 0;
BA_ "GenSigTimeoutValue" SG_ 909 LCK_RearLeftChildSaftyLockSt 0;
BA_ "Remark" SG_ 909 LCK_RearLeftChildSaftyLockSt "";
BA_ "EventCommandSignal" SG_ 909 LCK_RearRightChildSaftyLockSt 0;
BA_ "GatewayedSignals" SG_ 909 LCK_RearRightChildSaftyLockSt 0;
BA_ "GenSigInactiveValue" SG_ 909 LCK_RearRightChildSaftyLockSt 0;
BA_ "GenSigInvalidValue" SG_ 909 LCK_RearRightChildSaftyLockSt 0;
BA_ "GenSigSendType" SG_ 909 LCK_RearRightChildSaftyLockSt 0;
BA_ "GenSigStartValue" SG_ 909 LCK_RearRightChildSaftyLockSt 0;
BA_ "GenSigTimeoutValue" SG_ 909 LCK_RearRightChildSaftyLockSt 0;
BA_ "Remark" SG_ 909 LCK_RearRightChildSaftyLockSt "";
BA_ "EventCommandSignal" SG_ 909 EMS_EngStForPHEV 0;
BA_ "GatewayedSignals" SG_ 909 EMS_EngStForPHEV 0;
BA_ "GenSigInactiveValue" SG_ 909 EMS_EngStForPHEV 0;
BA_ "GenSigInvalidValue" SG_ 909 EMS_EngStForPHEV 0;
BA_ "GenSigSendType" SG_ 909 EMS_EngStForPHEV 1;
BA_ "GenSigStartValue" SG_ 909 EMS_EngStForPHEV 0;
BA_ "GenSigTimeoutValue" SG_ 909 EMS_EngStForPHEV 0;
BA_ "Remark" SG_ 909 EMS_EngStForPHEV "";
BA_ "EventCommandSignal" SG_ 909 WCM_Reminder 0;
BA_ "GatewayedSignals" SG_ 909 WCM_Reminder 0;
BA_ "GenSigInactiveValue" SG_ 909 WCM_Reminder 0;
BA_ "GenSigInvalidValue" SG_ 909 WCM_Reminder 0;
BA_ "GenSigSendType" SG_ 909 WCM_Reminder 1;
BA_ "GenSigStartValue" SG_ 909 WCM_Reminder 0;
BA_ "GenSigTimeoutValue" SG_ 909 WCM_Reminder 0;
BA_ "Remark" SG_ 909 WCM_Reminder "";
BA_ "EventCommandSignal" SG_ 909 WCM_ChargingSt 0;
BA_ "GatewayedSignals" SG_ 909 WCM_ChargingSt 0;
BA_ "GenSigInactiveValue" SG_ 909 WCM_ChargingSt 0;
BA_ "GenSigInvalidValue" SG_ 909 WCM_ChargingSt 0;
BA_ "GenSigSendType" SG_ 909 WCM_ChargingSt 1;
BA_ "GenSigStartValue" SG_ 909 WCM_ChargingSt 0;
BA_ "GenSigTimeoutValue" SG_ 909 WCM_ChargingSt 0;
BA_ "Remark" SG_ 909 WCM_ChargingSt "";
BA_ "EventCommandSignal" SG_ 909 LCK_FrontLeftDoorHandlePosition 0;
BA_ "GatewayedSignals" SG_ 909 LCK_FrontLeftDoorHandlePosition 0;
BA_ "GenSigInactiveValue" SG_ 909 LCK_FrontLeftDoorHandlePosition 0;
BA_ "GenSigInvalidValue" SG_ 909 LCK_FrontLeftDoorHandlePosition 255;
BA_ "GenSigSendType" SG_ 909 LCK_FrontLeftDoorHandlePosition 0;
BA_ "GenSigStartValue" SG_ 909 LCK_FrontLeftDoorHandlePosition 0;
BA_ "GenSigTimeoutValue" SG_ 909 LCK_FrontLeftDoorHandlePosition 0;
BA_ "Remark" SG_ 909 LCK_FrontLeftDoorHandlePosition "";
BA_ "EventCommandSignal" SG_ 909 LCK_FrontRightDoorHandlePosition 0;
BA_ "GatewayedSignals" SG_ 909 LCK_FrontRightDoorHandlePosition 0;
BA_ "GenSigInactiveValue" SG_ 909 LCK_FrontRightDoorHandlePosition 0;
BA_ "GenSigInvalidValue" SG_ 909 LCK_FrontRightDoorHandlePosition 255;
BA_ "GenSigSendType" SG_ 909 LCK_FrontRightDoorHandlePosition 0;
BA_ "GenSigStartValue" SG_ 909 LCK_FrontRightDoorHandlePosition 0;
BA_ "GenSigTimeoutValue" SG_ 909 LCK_FrontRightDoorHandlePosition 0;
BA_ "Remark" SG_ 909 LCK_FrontRightDoorHandlePosition "";
BA_ "EventCommandSignal" SG_ 909 LCK_RearLeftDoorHandlePosition 0;
BA_ "GatewayedSignals" SG_ 909 LCK_RearLeftDoorHandlePosition 0;
BA_ "GenSigInactiveValue" SG_ 909 LCK_RearLeftDoorHandlePosition 0;
BA_ "GenSigInvalidValue" SG_ 909 LCK_RearLeftDoorHandlePosition 255;
BA_ "GenSigSendType" SG_ 909 LCK_RearLeftDoorHandlePosition 0;
BA_ "GenSigStartValue" SG_ 909 LCK_RearLeftDoorHandlePosition 0;
BA_ "GenSigTimeoutValue" SG_ 909 LCK_RearLeftDoorHandlePosition 0;
BA_ "Remark" SG_ 909 LCK_RearLeftDoorHandlePosition "";
BA_ "EventCommandSignal" SG_ 909 LCK_RearRightDoorHandlePosition 0;
BA_ "GatewayedSignals" SG_ 909 LCK_RearRightDoorHandlePosition 0;
BA_ "GenSigInactiveValue" SG_ 909 LCK_RearRightDoorHandlePosition 0;
BA_ "GenSigInvalidValue" SG_ 909 LCK_RearRightDoorHandlePosition 255;
BA_ "GenSigSendType" SG_ 909 LCK_RearRightDoorHandlePosition 0;
BA_ "GenSigStartValue" SG_ 909 LCK_RearRightDoorHandlePosition 0;
BA_ "GenSigTimeoutValue" SG_ 909 LCK_RearRightDoorHandlePosition 0;
BA_ "Remark" SG_ 909 LCK_RearRightDoorHandlePosition "";
BA_ "EventCommandSignal" SG_ 909 WW_RWPMotorSt 0;
BA_ "GatewayedSignals" SG_ 909 WW_RWPMotorSt 0;
BA_ "GenSigInactiveValue" SG_ 909 WW_RWPMotorSt 0;
BA_ "GenSigInvalidValue" SG_ 909 WW_RWPMotorSt 0;
BA_ "GenSigSendType" SG_ 909 WW_RWPMotorSt 1;
BA_ "GenSigStartValue" SG_ 909 WW_RWPMotorSt 0;
BA_ "GenSigTimeoutValue" SG_ 909 WW_RWPMotorSt 0;
BA_ "Remark" SG_ 909 WW_RWPMotorSt "";
BA_ "EventCommandSignal" SG_ 909 LCK_FillerCapASt 0;
BA_ "GatewayedSignals" SG_ 909 LCK_FillerCapASt 0;
BA_ "GenSigInactiveValue" SG_ 909 LCK_FillerCapASt 0;
BA_ "GenSigInvalidValue" SG_ 909 LCK_FillerCapASt 0;
BA_ "GenSigSendType" SG_ 909 LCK_FillerCapASt 0;
BA_ "GenSigStartValue" SG_ 909 LCK_FillerCapASt 0;
BA_ "GenSigTimeoutValue" SG_ 909 LCK_FillerCapASt 0;
BA_ "Remark" SG_ 909 LCK_FillerCapASt "";
BA_ "EventCommandSignal" SG_ 909 LCK_FillerCapBSt 0;
BA_ "GatewayedSignals" SG_ 909 LCK_FillerCapBSt 0;
BA_ "GenSigInactiveValue" SG_ 909 LCK_FillerCapBSt 0;
BA_ "GenSigInvalidValue" SG_ 909 LCK_FillerCapBSt 0;
BA_ "GenSigSendType" SG_ 909 LCK_FillerCapBSt 0;
BA_ "GenSigStartValue" SG_ 909 LCK_FillerCapBSt 0;
BA_ "GenSigTimeoutValue" SG_ 909 LCK_FillerCapBSt 0;
BA_ "Remark" SG_ 909 LCK_FillerCapBSt "";
BA_ "EventCommandSignal" SG_ 909 AVAS_ActivatedSt 0;
BA_ "GatewayedSignals" SG_ 909 AVAS_ActivatedSt 0;
BA_ "GenSigInactiveValue" SG_ 909 AVAS_ActivatedSt 0;
BA_ "GenSigInvalidValue" SG_ 909 AVAS_ActivatedSt 0;
BA_ "GenSigSendType" SG_ 909 AVAS_ActivatedSt 1;
BA_ "GenSigStartValue" SG_ 909 AVAS_ActivatedSt 0;
BA_ "GenSigTimeoutValue" SG_ 909 AVAS_ActivatedSt 0;
BA_ "Remark" SG_ 909 AVAS_ActivatedSt "";
BA_ "EventCommandSignal" SG_ 909 MR_LeftMirrorFoldUnfoldSt 0;
BA_ "GatewayedSignals" SG_ 909 MR_LeftMirrorFoldUnfoldSt 0;
BA_ "GenSigInactiveValue" SG_ 909 MR_LeftMirrorFoldUnfoldSt 0;
BA_ "GenSigInvalidValue" SG_ 909 MR_LeftMirrorFoldUnfoldSt 0;
BA_ "GenSigSendType" SG_ 909 MR_LeftMirrorFoldUnfoldSt 1;
BA_ "GenSigStartValue" SG_ 909 MR_LeftMirrorFoldUnfoldSt 0;
BA_ "GenSigTimeoutValue" SG_ 909 MR_LeftMirrorFoldUnfoldSt 0;
BA_ "Remark" SG_ 909 MR_LeftMirrorFoldUnfoldSt "";
BA_ "EventCommandSignal" SG_ 909 SBM_SwapHvBattModeSt 0;
BA_ "GatewayedSignals" SG_ 909 SBM_SwapHvBattModeSt 0;
BA_ "GenSigInactiveValue" SG_ 909 SBM_SwapHvBattModeSt 0;
BA_ "GenSigInvalidValue" SG_ 909 SBM_SwapHvBattModeSt 0;
BA_ "GenSigSendType" SG_ 909 SBM_SwapHvBattModeSt 1;
BA_ "GenSigStartValue" SG_ 909 SBM_SwapHvBattModeSt 0;
BA_ "GenSigTimeoutValue" SG_ 909 SBM_SwapHvBattModeSt 0;
BA_ "Remark" SG_ 909 SBM_SwapHvBattModeSt "";
BA_ "EventCommandSignal" SG_ 909 SBM_SwapStaDiagCode 0;
BA_ "GatewayedSignals" SG_ 909 SBM_SwapStaDiagCode 0;
BA_ "GenSigInactiveValue" SG_ 909 SBM_SwapStaDiagCode 0;
BA_ "GenSigInvalidValue" SG_ 909 SBM_SwapStaDiagCode 0;
BA_ "GenSigSendType" SG_ 909 SBM_SwapStaDiagCode 1;
BA_ "GenSigStartValue" SG_ 909 SBM_SwapStaDiagCode 0;
BA_ "GenSigTimeoutValue" SG_ 909 SBM_SwapStaDiagCode 0;
BA_ "Remark" SG_ 909 SBM_SwapStaDiagCode "";
BA_ "EventCommandSignal" SG_ 909 SBM_SwapVehDiagCode 0;
BA_ "GatewayedSignals" SG_ 909 SBM_SwapVehDiagCode 0;
BA_ "GenSigInactiveValue" SG_ 909 SBM_SwapVehDiagCode 0;
BA_ "GenSigInvalidValue" SG_ 909 SBM_SwapVehDiagCode 0;
BA_ "GenSigSendType" SG_ 909 SBM_SwapVehDiagCode 1;
BA_ "GenSigStartValue" SG_ 909 SBM_SwapVehDiagCode 0;
BA_ "GenSigTimeoutValue" SG_ 909 SBM_SwapVehDiagCode 0;
BA_ "Remark" SG_ 909 SBM_SwapVehDiagCode "";
BA_ "EventCommandSignal" SG_ 909 SBM_SwapHvBattModeFaultSt 0;
BA_ "GatewayedSignals" SG_ 909 SBM_SwapHvBattModeFaultSt 0;
BA_ "GenSigInactiveValue" SG_ 909 SBM_SwapHvBattModeFaultSt 0;
BA_ "GenSigInvalidValue" SG_ 909 SBM_SwapHvBattModeFaultSt 0;
BA_ "GenSigSendType" SG_ 909 SBM_SwapHvBattModeFaultSt 1;
BA_ "GenSigStartValue" SG_ 909 SBM_SwapHvBattModeFaultSt 0;
BA_ "GenSigTimeoutValue" SG_ 909 SBM_SwapHvBattModeFaultSt 0;
BA_ "Remark" SG_ 909 SBM_SwapHvBattModeFaultSt "";
BA_ "EventCommandSignal" SG_ 909 IPDS_HDMapPowerSt 0;
BA_ "GatewayedSignals" SG_ 909 IPDS_HDMapPowerSt 0;
BA_ "GenSigInactiveValue" SG_ 909 IPDS_HDMapPowerSt 0;
BA_ "GenSigInvalidValue" SG_ 909 IPDS_HDMapPowerSt 0;
BA_ "GenSigSendType" SG_ 909 IPDS_HDMapPowerSt 1;
BA_ "GenSigStartValue" SG_ 909 IPDS_HDMapPowerSt 0;
BA_ "GenSigTimeoutValue" SG_ 909 IPDS_HDMapPowerSt 0;
BA_ "Remark" SG_ 909 IPDS_HDMapPowerSt "";
BA_ "EventCommandSignal" SG_ 909 IPDS_KL15L1PowerSt 0;
BA_ "GatewayedSignals" SG_ 909 IPDS_KL15L1PowerSt 0;
BA_ "GenSigInactiveValue" SG_ 909 IPDS_KL15L1PowerSt 0;
BA_ "GenSigInvalidValue" SG_ 909 IPDS_KL15L1PowerSt 0;
BA_ "GenSigSendType" SG_ 909 IPDS_KL15L1PowerSt 1;
BA_ "GenSigStartValue" SG_ 909 IPDS_KL15L1PowerSt 0;
BA_ "GenSigTimeoutValue" SG_ 909 IPDS_KL15L1PowerSt 0;
BA_ "Remark" SG_ 909 IPDS_KL15L1PowerSt "";
BA_ "EventCommandSignal" SG_ 909 IPDS_SRSECUPowerSt 0;
BA_ "GatewayedSignals" SG_ 909 IPDS_SRSECUPowerSt 0;
BA_ "GenSigInactiveValue" SG_ 909 IPDS_SRSECUPowerSt 0;
BA_ "GenSigInvalidValue" SG_ 909 IPDS_SRSECUPowerSt 0;
BA_ "GenSigSendType" SG_ 909 IPDS_SRSECUPowerSt 1;
BA_ "GenSigStartValue" SG_ 909 IPDS_SRSECUPowerSt 0;
BA_ "GenSigTimeoutValue" SG_ 909 IPDS_SRSECUPowerSt 0;
BA_ "Remark" SG_ 909 IPDS_SRSECUPowerSt "";
BA_ "EventCommandSignal" SG_ 909 IPDS_HODPowerSt 0;
BA_ "GatewayedSignals" SG_ 909 IPDS_HODPowerSt 0;
BA_ "GenSigInactiveValue" SG_ 909 IPDS_HODPowerSt 0;
BA_ "GenSigInvalidValue" SG_ 909 IPDS_HODPowerSt 0;
BA_ "GenSigSendType" SG_ 909 IPDS_HODPowerSt 1;
BA_ "GenSigStartValue" SG_ 909 IPDS_HODPowerSt 0;
BA_ "GenSigTimeoutValue" SG_ 909 IPDS_HODPowerSt 0;
BA_ "Remark" SG_ 909 IPDS_HODPowerSt "";
BA_ "EventCommandSignal" SG_ 909 KAE_BLEOption 0;
BA_ "GatewayedSignals" SG_ 909 KAE_BLEOption 0;
BA_ "GenSigInactiveValue" SG_ 909 KAE_BLEOption 0;
BA_ "GenSigInvalidValue" SG_ 909 KAE_BLEOption 0;
BA_ "GenSigSendType" SG_ 909 KAE_BLEOption 1;
BA_ "GenSigStartValue" SG_ 909 KAE_BLEOption 0;
BA_ "GenSigTimeoutValue" SG_ 909 KAE_BLEOption 0;
BA_ "Remark" SG_ 909 KAE_BLEOption "";
BA_ "EventCommandSignal" SG_ 909 KAE_UWBOption 0;
BA_ "GatewayedSignals" SG_ 909 KAE_UWBOption 0;
BA_ "GenSigInactiveValue" SG_ 909 KAE_UWBOption 0;
BA_ "GenSigInvalidValue" SG_ 909 KAE_UWBOption 0;
BA_ "GenSigSendType" SG_ 909 KAE_UWBOption 1;
BA_ "GenSigStartValue" SG_ 909 KAE_UWBOption 0;
BA_ "GenSigTimeoutValue" SG_ 909 KAE_UWBOption 0;
BA_ "Remark" SG_ 909 KAE_UWBOption "";
BA_ "EventCommandSignal" SG_ 909 PWL_WinCurrentPos_FLWinPst 0;
BA_ "GatewayedSignals" SG_ 909 PWL_WinCurrentPos_FLWinPst 0;
BA_ "GenSigInactiveValue" SG_ 909 PWL_WinCurrentPos_FLWinPst 0;
BA_ "GenSigInvalidValue" SG_ 909 PWL_WinCurrentPos_FLWinPst 0;
BA_ "GenSigSendType" SG_ 909 PWL_WinCurrentPos_FLWinPst 1;
BA_ "GenSigStartValue" SG_ 909 PWL_WinCurrentPos_FLWinPst 255;
BA_ "GenSigTimeoutValue" SG_ 909 PWL_WinCurrentPos_FLWinPst 0;
BA_ "Remark" SG_ 909 PWL_WinCurrentPos_FLWinPst "";
BA_ "EventCommandSignal" SG_ 909 UINM_FrontLeftPowerReleaseReq 0;
BA_ "GatewayedSignals" SG_ 909 UINM_FrontLeftPowerReleaseReq 0;
BA_ "GenSigInactiveValue" SG_ 909 UINM_FrontLeftPowerReleaseReq 0;
BA_ "GenSigInvalidValue" SG_ 909 UINM_FrontLeftPowerReleaseReq 0;
BA_ "GenSigSendType" SG_ 909 UINM_FrontLeftPowerReleaseReq 1;
BA_ "GenSigStartValue" SG_ 909 UINM_FrontLeftPowerReleaseReq 0;
BA_ "GenSigTimeoutValue" SG_ 909 UINM_FrontLeftPowerReleaseReq 0;
BA_ "Remark" SG_ 909 UINM_FrontLeftPowerReleaseReq "";
BA_ "EventCommandSignal" SG_ 909 UINM_FrontLeftPowerReleaseFaultSt 0;
BA_ "GatewayedSignals" SG_ 909 UINM_FrontLeftPowerReleaseFaultSt 0;
BA_ "GenSigInactiveValue" SG_ 909 UINM_FrontLeftPowerReleaseFaultSt 0;
BA_ "GenSigInvalidValue" SG_ 909 UINM_FrontLeftPowerReleaseFaultSt 0;
BA_ "GenSigSendType" SG_ 909 UINM_FrontLeftPowerReleaseFaultSt 1;
BA_ "GenSigStartValue" SG_ 909 UINM_FrontLeftPowerReleaseFaultSt 0;
BA_ "GenSigTimeoutValue" SG_ 909 UINM_FrontLeftPowerReleaseFaultSt 0;
BA_ "Remark" SG_ 909 UINM_FrontLeftPowerReleaseFaultSt "";
BA_ "EventCommandSignal" SG_ 909 UINM_FrontRightPowerReleaseReq 0;
BA_ "GatewayedSignals" SG_ 909 UINM_FrontRightPowerReleaseReq 0;
BA_ "GenSigInactiveValue" SG_ 909 UINM_FrontRightPowerReleaseReq 0;
BA_ "GenSigInvalidValue" SG_ 909 UINM_FrontRightPowerReleaseReq 0;
BA_ "GenSigSendType" SG_ 909 UINM_FrontRightPowerReleaseReq 1;
BA_ "GenSigStartValue" SG_ 909 UINM_FrontRightPowerReleaseReq 0;
BA_ "GenSigTimeoutValue" SG_ 909 UINM_FrontRightPowerReleaseReq 0;
BA_ "Remark" SG_ 909 UINM_FrontRightPowerReleaseReq "";
BA_ "EventCommandSignal" SG_ 909 UINM_FrontRightPowerReleaseFaultSt 0;
BA_ "GatewayedSignals" SG_ 909 UINM_FrontRightPowerReleaseFaultSt 0;
BA_ "GenSigInactiveValue" SG_ 909 UINM_FrontRightPowerReleaseFaultSt 0;
BA_ "GenSigInvalidValue" SG_ 909 UINM_FrontRightPowerReleaseFaultSt 0;
BA_ "GenSigSendType" SG_ 909 UINM_FrontRightPowerReleaseFaultSt 1;
BA_ "GenSigStartValue" SG_ 909 UINM_FrontRightPowerReleaseFaultSt 0;
BA_ "GenSigTimeoutValue" SG_ 909 UINM_FrontRightPowerReleaseFaultSt 0;
BA_ "Remark" SG_ 909 UINM_FrontRightPowerReleaseFaultSt "";
BA_ "EventCommandSignal" SG_ 909 UINM_RearLeftPowerReleaseFaultSt 0;
BA_ "GatewayedSignals" SG_ 909 UINM_RearLeftPowerReleaseFaultSt 0;
BA_ "GenSigInactiveValue" SG_ 909 UINM_RearLeftPowerReleaseFaultSt 0;
BA_ "GenSigInvalidValue" SG_ 909 UINM_RearLeftPowerReleaseFaultSt 0;
BA_ "GenSigSendType" SG_ 909 UINM_RearLeftPowerReleaseFaultSt 1;
BA_ "GenSigStartValue" SG_ 909 UINM_RearLeftPowerReleaseFaultSt 0;
BA_ "GenSigTimeoutValue" SG_ 909 UINM_RearLeftPowerReleaseFaultSt 0;
BA_ "Remark" SG_ 909 UINM_RearLeftPowerReleaseFaultSt "";
BA_ "EventCommandSignal" SG_ 909 UINM_RearLeftPowerReleaseReq 0;
BA_ "GatewayedSignals" SG_ 909 UINM_RearLeftPowerReleaseReq 0;
BA_ "GenSigInactiveValue" SG_ 909 UINM_RearLeftPowerReleaseReq 0;
BA_ "GenSigInvalidValue" SG_ 909 UINM_RearLeftPowerReleaseReq 0;
BA_ "GenSigSendType" SG_ 909 UINM_RearLeftPowerReleaseReq 1;
BA_ "GenSigStartValue" SG_ 909 UINM_RearLeftPowerReleaseReq 0;
BA_ "GenSigTimeoutValue" SG_ 909 UINM_RearLeftPowerReleaseReq 0;
BA_ "Remark" SG_ 909 UINM_RearLeftPowerReleaseReq "";
BA_ "EventCommandSignal" SG_ 909 UINM_RearRightPowerReleaseFaultSt 0;
BA_ "GatewayedSignals" SG_ 909 UINM_RearRightPowerReleaseFaultSt 0;
BA_ "GenSigInactiveValue" SG_ 909 UINM_RearRightPowerReleaseFaultSt 0;
BA_ "GenSigInvalidValue" SG_ 909 UINM_RearRightPowerReleaseFaultSt 0;
BA_ "GenSigSendType" SG_ 909 UINM_RearRightPowerReleaseFaultSt 1;
BA_ "GenSigStartValue" SG_ 909 UINM_RearRightPowerReleaseFaultSt 0;
BA_ "GenSigTimeoutValue" SG_ 909 UINM_RearRightPowerReleaseFaultSt 0;
BA_ "Remark" SG_ 909 UINM_RearRightPowerReleaseFaultSt "";
BA_ "EventCommandSignal" SG_ 909 UINM_RearRightPowerReleaseReq 0;
BA_ "GatewayedSignals" SG_ 909 UINM_RearRightPowerReleaseReq 0;
BA_ "GenSigInactiveValue" SG_ 909 UINM_RearRightPowerReleaseReq 0;
BA_ "GenSigInvalidValue" SG_ 909 UINM_RearRightPowerReleaseReq 0;
BA_ "GenSigSendType" SG_ 909 UINM_RearRightPowerReleaseReq 1;
BA_ "GenSigStartValue" SG_ 909 UINM_RearRightPowerReleaseReq 0;
BA_ "GenSigTimeoutValue" SG_ 909 UINM_RearRightPowerReleaseReq 0;
BA_ "Remark" SG_ 909 UINM_RearRightPowerReleaseReq "";
BA_ "EventCommandSignal" SG_ 909 BMS_BattSOCAccurate 0;
BA_ "GatewayedSignals" SG_ 909 BMS_BattSOCAccurate 0;
BA_ "GenSigInactiveValue" SG_ 909 BMS_BattSOCAccurate 0;
BA_ "GenSigInvalidValue" SG_ 909 BMS_BattSOCAccurate 0;
BA_ "GenSigSendType" SG_ 909 BMS_BattSOCAccurate 1;
BA_ "GenSigStartValue" SG_ 909 BMS_BattSOCAccurate 5550;
BA_ "GenSigTimeoutValue" SG_ 909 BMS_BattSOCAccurate 0;
BA_ "Remark" SG_ 909 BMS_BattSOCAccurate "";
BA_ "EventCommandSignal" SG_ 909 PWL_WinCurrentPos_RRWinPst 0;
BA_ "GatewayedSignals" SG_ 909 PWL_WinCurrentPos_RRWinPst 0;
BA_ "GenSigInactiveValue" SG_ 909 PWL_WinCurrentPos_RRWinPst 0;
BA_ "GenSigInvalidValue" SG_ 909 PWL_WinCurrentPos_RRWinPst 0;
BA_ "GenSigSendType" SG_ 909 PWL_WinCurrentPos_RRWinPst 1;
BA_ "GenSigStartValue" SG_ 909 PWL_WinCurrentPos_RRWinPst 255;
BA_ "GenSigTimeoutValue" SG_ 909 PWL_WinCurrentPos_RRWinPst 0;
BA_ "Remark" SG_ 909 PWL_WinCurrentPos_RRWinPst "";
BA_ "EventCommandSignal" SG_ 909 PWL_WinCurrentPos_RLWinPst 0;
BA_ "GatewayedSignals" SG_ 909 PWL_WinCurrentPos_RLWinPst 0;
BA_ "GenSigInactiveValue" SG_ 909 PWL_WinCurrentPos_RLWinPst 0;
BA_ "GenSigInvalidValue" SG_ 909 PWL_WinCurrentPos_RLWinPst 0;
BA_ "GenSigSendType" SG_ 909 PWL_WinCurrentPos_RLWinPst 1;
BA_ "GenSigStartValue" SG_ 909 PWL_WinCurrentPos_RLWinPst 255;
BA_ "GenSigTimeoutValue" SG_ 909 PWL_WinCurrentPos_RLWinPst 0;
BA_ "Remark" SG_ 909 PWL_WinCurrentPos_RLWinPst "";
BA_ "EventCommandSignal" SG_ 909 ACEleclocksSt 0;
BA_ "GatewayedSignals" SG_ 909 ACEleclocksSt 0;
BA_ "GenSigInactiveValue" SG_ 909 ACEleclocksSt 0;
BA_ "GenSigInvalidValue" SG_ 909 ACEleclocksSt 0;
BA_ "GenSigSendType" SG_ 909 ACEleclocksSt 1;
BA_ "GenSigStartValue" SG_ 909 ACEleclocksSt 0;
BA_ "GenSigTimeoutValue" SG_ 909 ACEleclocksSt 0;
BA_ "Remark" SG_ 909 ACEleclocksSt "";
BA_ "EventCommandSignal" SG_ 909 DSASBM_MotResp 0;
BA_ "GatewayedSignals" SG_ 909 DSASBM_MotResp 0;
BA_ "GenSigInactiveValue" SG_ 909 DSASBM_MotResp 0;
BA_ "GenSigInvalidValue" SG_ 909 DSASBM_MotResp 0;
BA_ "GenSigSendType" SG_ 909 DSASBM_MotResp 1;
BA_ "GenSigStartValue" SG_ 909 DSASBM_MotResp 0;
BA_ "GenSigTimeoutValue" SG_ 909 DSASBM_MotResp 0;
BA_ "Remark" SG_ 909 DSASBM_MotResp "";
BA_ "EventCommandSignal" SG_ 909 FLISD_InteractLightSt 0;
BA_ "GatewayedSignals" SG_ 909 FLISD_InteractLightSt 0;
BA_ "GenSigInactiveValue" SG_ 909 FLISD_InteractLightSt 0;
BA_ "GenSigInvalidValue" SG_ 909 FLISD_InteractLightSt 0;
BA_ "GenSigSendType" SG_ 909 FLISD_InteractLightSt 1;
BA_ "GenSigStartValue" SG_ 909 FLISD_InteractLightSt 0;
BA_ "GenSigTimeoutValue" SG_ 909 FLISD_InteractLightSt 0;
BA_ "Remark" SG_ 909 FLISD_InteractLightSt "";
BA_ "EventCommandSignal" SG_ 1078 ETC_GateProperty 1;
BA_ "GatewayedSignals" SG_ 1078 ETC_GateProperty 0;
BA_ "GenSigInactiveValue" SG_ 1078 ETC_GateProperty 0;
BA_ "GenSigInvalidValue" SG_ 1078 ETC_GateProperty 0;
BA_ "GenSigSendType" SG_ 1078 ETC_GateProperty 0;
BA_ "GenSigStartValue" SG_ 1078 ETC_GateProperty 0;
BA_ "GenSigTimeoutValue" SG_ 1078 ETC_GateProperty 0;
BA_ "Remark" SG_ 1078 ETC_GateProperty "";
BA_ "EventCommandSignal" SG_ 1078 ETC_TradeType 1;
BA_ "GatewayedSignals" SG_ 1078 ETC_TradeType 0;
BA_ "GenSigInactiveValue" SG_ 1078 ETC_TradeType 0;
BA_ "GenSigInvalidValue" SG_ 1078 ETC_TradeType 0;
BA_ "GenSigSendType" SG_ 1078 ETC_TradeType 0;
BA_ "GenSigStartValue" SG_ 1078 ETC_TradeType 1;
BA_ "GenSigTimeoutValue" SG_ 1078 ETC_TradeType 0;
BA_ "Remark" SG_ 1078 ETC_TradeType "";
BA_ "EventCommandSignal" SG_ 1078 ETC_SystemSt 1;
BA_ "GatewayedSignals" SG_ 1078 ETC_SystemSt 0;
BA_ "GenSigInactiveValue" SG_ 1078 ETC_SystemSt 0;
BA_ "GenSigInvalidValue" SG_ 1078 ETC_SystemSt 0;
BA_ "GenSigSendType" SG_ 1078 ETC_SystemSt 0;
BA_ "GenSigStartValue" SG_ 1078 ETC_SystemSt 0;
BA_ "GenSigTimeoutValue" SG_ 1078 ETC_SystemSt 0;
BA_ "Remark" SG_ 1078 ETC_SystemSt "";
BA_ "EventCommandSignal" SG_ 1078 ETC_SysCfgst 1;
BA_ "GatewayedSignals" SG_ 1078 ETC_SysCfgst 0;
BA_ "GenSigInactiveValue" SG_ 1078 ETC_SysCfgst 0;
BA_ "GenSigInvalidValue" SG_ 1078 ETC_SysCfgst 0;
BA_ "GenSigSendType" SG_ 1078 ETC_SysCfgst 0;
BA_ "GenSigStartValue" SG_ 1078 ETC_SysCfgst 1;
BA_ "GenSigTimeoutValue" SG_ 1078 ETC_SysCfgst 0;
BA_ "Remark" SG_ 1078 ETC_SysCfgst "";
BA_ "EventCommandSignal" SG_ 1078 ETC_ActivSt 1;
BA_ "GatewayedSignals" SG_ 1078 ETC_ActivSt 0;
BA_ "GenSigInactiveValue" SG_ 1078 ETC_ActivSt 0;
BA_ "GenSigInvalidValue" SG_ 1078 ETC_ActivSt 0;
BA_ "GenSigSendType" SG_ 1078 ETC_ActivSt 0;
BA_ "GenSigStartValue" SG_ 1078 ETC_ActivSt 1;
BA_ "GenSigTimeoutValue" SG_ 1078 ETC_ActivSt 0;
BA_ "Remark" SG_ 1078 ETC_ActivSt "";
BA_ "EventCommandSignal" SG_ 1078 ETC_TradeInfo 1;
BA_ "GatewayedSignals" SG_ 1078 ETC_TradeInfo 0;
BA_ "GenSigInactiveValue" SG_ 1078 ETC_TradeInfo 0;
BA_ "GenSigInvalidValue" SG_ 1078 ETC_TradeInfo -1;
BA_ "GenSigSendType" SG_ 1078 ETC_TradeInfo 0;
BA_ "GenSigStartValue" SG_ 1078 ETC_TradeInfo 0;
BA_ "GenSigTimeoutValue" SG_ 1078 ETC_TradeInfo 0;
BA_ "Remark" SG_ 1078 ETC_TradeInfo "";
BA_ "EventCommandSignal" SG_ 776 EL_LeftBSDIndicatorSt 0;
BA_ "GatewayedSignals" SG_ 776 EL_LeftBSDIndicatorSt 0;
BA_ "GenSigInactiveValue" SG_ 776 EL_LeftBSDIndicatorSt 0;
BA_ "GenSigInvalidValue" SG_ 776 EL_LeftBSDIndicatorSt 0;
BA_ "GenSigSendType" SG_ 776 EL_LeftBSDIndicatorSt 1;
BA_ "GenSigStartValue" SG_ 776 EL_LeftBSDIndicatorSt 0;
BA_ "GenSigTimeoutValue" SG_ 776 EL_LeftBSDIndicatorSt 0;
BA_ "Remark" SG_ 776 EL_LeftBSDIndicatorSt "";
BA_ "EventCommandSignal" SG_ 776 UINM_HazardLightSwSt 0;
BA_ "GatewayedSignals" SG_ 776 UINM_HazardLightSwSt 0;
BA_ "GenSigInactiveValue" SG_ 776 UINM_HazardLightSwSt 0;
BA_ "GenSigInvalidValue" SG_ 776 UINM_HazardLightSwSt 0;
BA_ "GenSigSendType" SG_ 776 UINM_HazardLightSwSt 1;
BA_ "GenSigStartValue" SG_ 776 UINM_HazardLightSwSt 0;
BA_ "GenSigTimeoutValue" SG_ 776 UINM_HazardLightSwSt 0;
BA_ "Remark" SG_ 776 UINM_HazardLightSwSt "";
BA_ "EventCommandSignal" SG_ 776 EL_MLTurnLightSt 0;
BA_ "GatewayedSignals" SG_ 776 EL_MLTurnLightSt 0;
BA_ "GenSigInactiveValue" SG_ 776 EL_MLTurnLightSt 0;
BA_ "GenSigInvalidValue" SG_ 776 EL_MLTurnLightSt 0;
BA_ "GenSigSendType" SG_ 776 EL_MLTurnLightSt 1;
BA_ "GenSigStartValue" SG_ 776 EL_MLTurnLightSt 0;
BA_ "GenSigTimeoutValue" SG_ 776 EL_MLTurnLightSt 0;
BA_ "Remark" SG_ 776 EL_MLTurnLightSt "";
BA_ "EventCommandSignal" SG_ 776 EL_MLTurnLightFaultSt 0;
BA_ "GatewayedSignals" SG_ 776 EL_MLTurnLightFaultSt 0;
BA_ "GenSigInactiveValue" SG_ 776 EL_MLTurnLightFaultSt 0;
BA_ "GenSigInvalidValue" SG_ 776 EL_MLTurnLightFaultSt 0;
BA_ "GenSigSendType" SG_ 776 EL_MLTurnLightFaultSt 1;
BA_ "GenSigStartValue" SG_ 776 EL_MLTurnLightFaultSt 0;
BA_ "GenSigTimeoutValue" SG_ 776 EL_MLTurnLightFaultSt 0;
BA_ "Remark" SG_ 776 EL_MLTurnLightFaultSt "";
BA_ "EventCommandSignal" SG_ 776 EL_LeftBSDIndicatorFaultSt 0;
BA_ "GatewayedSignals" SG_ 776 EL_LeftBSDIndicatorFaultSt 0;
BA_ "GenSigInactiveValue" SG_ 776 EL_LeftBSDIndicatorFaultSt 0;
BA_ "GenSigInvalidValue" SG_ 776 EL_LeftBSDIndicatorFaultSt 0;
BA_ "GenSigSendType" SG_ 776 EL_LeftBSDIndicatorFaultSt 1;
BA_ "GenSigStartValue" SG_ 776 EL_LeftBSDIndicatorFaultSt 0;
BA_ "GenSigTimeoutValue" SG_ 776 EL_LeftBSDIndicatorFaultSt 0;
BA_ "Remark" SG_ 776 EL_LeftBSDIndicatorFaultSt "";
BA_ "EventCommandSignal" SG_ 776 ZCUL_FrtWindshildHeatSt 0;
BA_ "GatewayedSignals" SG_ 776 ZCUL_FrtWindshildHeatSt 0;
BA_ "GenSigInactiveValue" SG_ 776 ZCUL_FrtWindshildHeatSt 0;
BA_ "GenSigInvalidValue" SG_ 776 ZCUL_FrtWindshildHeatSt 0;
BA_ "GenSigSendType" SG_ 776 ZCUL_FrtWindshildHeatSt 1;
BA_ "GenSigStartValue" SG_ 776 ZCUL_FrtWindshildHeatSt 0;
BA_ "GenSigTimeoutValue" SG_ 776 ZCUL_FrtWindshildHeatSt 0;
BA_ "Remark" SG_ 776 ZCUL_FrtWindshildHeatSt "";
VAL_ 904 HVAC_RearDefrostSt 0 "Not acitve" 1 "Active"  ;
VAL_ 904 HVAC_WindExitMode 0 "Invalid" 1 "Face" 2 "Face/Foot" 3 "Foot" 4 "Foot/Defrost" 5 "Defrost" 6 "Face/DEF" 7 "Face/Foot/DEF"  ;
VAL_ 904 HVAC_CorrectedExterTempVD 0 "Not valid" 1 "Valid"  ;
VAL_ 904 HVAC_CorrectedCabinTempVD 0 "Not valid" 1 "Valid"  ;
VAL_ 904 WW_FwpFaultSt 0 "Not fault" 1 "Fault"  ;
VAL_ 904 WW_RwpFaultSt 0 "Not fault" 1 "Fault"  ;
VAL_ 904 WW_FwshFaultSt 0 "Not fault" 1 "Fault"  ;
VAL_ 904 WW_RwshFaultSt 0 "Not fault" 1 "Fault"  ;
VAL_ 904 WW_FwpAutoModeSt 0 "False" 1 "True"  ;
VAL_ 904 WW_RainFallLevel 0 "No Rain" 1 "Level 1" 2 "Level 2" 3 "Level 3" 4 "Level 4" 5 "Level 5" 6 "Level 6" 7 "Level 7" 8 "Level 8" 9 "Level 9" 10 "Level 10" 11 "Level 11" 12 "Level 12" 13 "Level 13" 14 "Init value" 15 "Invalid value"  ;
VAL_ 904 RLS_LightOnReq 0 "Light Off" 1 "Light On"  ;
VAL_ 904 RLS_LampOnReqValid 0 "Valid value" 1 "Invalid value"  ;
VAL_ 904 RLS_WiperSpd 0 "Switch Off" 1 "Low speed/speed 1" 2 "speed 2" 3 "speed 3" 4 "speed 4" 5 "speed 5" 6 "speed 6" 7 "speed 7" 8 "speed 8" 9 "speed 9" 10 "speed 10" 11 "speed 11" 12 "speed 12" 13 "speed 13" 14 "High speed/speed 14" 15 "Invalid"  ;
VAL_ 904 RLS_RainfallLevel 0 "No Rain" 1 "Level 1" 2 "Level 2" 3 "Level 3" 4 "Level 4" 5 "Level 5" 6 "Level 6" 7 "Level 7" 8 "Level 8" 9 "Level 9" 10 "Level 10" 11 "Level 11" 12 "Level 12" 13 "Level 13" 14 "Init value" 15 "Invalid value"  ;
VAL_ 904 RLS_RSErr 0 "No Error" 1 "Error"  ;
VAL_ 904 RLS_LSErr 0 "No Error" 1 "Error"  ;
VAL_ 904 PM_AUTHPstState 0 "Disable" 1 "Enable"  ;
VAL_ 904 CCU_FuncReq_SentryMod 0 "OFF" 1 "SentryModeWake"  ;
VAL_ 904 CCU_ModeSuppressSts 0 "OFF" 1 "ON" 2 "UNKNOWN"  ;
VAL_ 904 RLS_HUTErr 0 "HUT sensor normal" 1 "HUT sensor error"  ;
VAL_ 904 SR_SunroofCurrentPst 255 "Undefined Sunroof position"  ;
VAL_ 904 EL_LeftBSDIndicatorSt 0 "OFF" 1 "ON"  ;
VAL_ 904 UINM_HazardLightSwSt 0 "No Request" 1 "Request"  ;
VAL_ 904 EL_MLTurnLightSt 0 "Not active" 1 "OFF" 2 "ON" 3 "Not used"  ;
VAL_ 904 EL_MLTurnLightFaultSt 0 "Not fault" 1 "Fault"  ;
VAL_ 904 EL_LeftBSDIndicatorFaultSt 0 "Not fault" 1 "Fault"  ;
VAL_ 904 ZCUL_FrtWindshildHeatSt 0 "No" 1 "Heating" 2 "Fault" 3 "reserve"  ;
VAL_ 904 ACU_PCS_SVM_MODCmd 0 "Disable" 1 "Enalbe"  ;
VAL_ 904 ACU_HeadLightVirtualSwSt 0 "NotActive" 1 "PositionLight" 2 "LowBeam" 3 "AutoLight"  ;
VAL_ 904 ACU_FrontFogLightVirtualSwSt 0 "Not Active" 1 "Active"  ;
VAL_ 904 ACU_RearFogLightVirtualSwSt 0 "Not Active" 1 "Active"  ;
VAL_ 904 ACU_Account_Uid 0 "No command" 1 "account 0" 2 "account 1" 3 "account 2" 4 "account 3" 5 "account 4" 6 "account 5" 7 "account 6" 8 "account 7" 9 "account 8" 10 "Not used" 11 "Not used" 12 "Not used" 13 "Not used" 14 "Not used" 15 "Not used"  ;
VAL_ 904 ACU_IHBC_SwitchReq 0 "No command" 1 "Not active" 2 "Active" 3 "Not used"  ;
VAL_ 904 ACU_NDASwitchReq 0 "No command" 1 "Not active" 2 "Active" 3 "Not used"  ;
VAL_ 904 ACU_NDALCConSwitchReq 0 "No command" 1 "Need confirm" 2 "No need confirm" 3 "Not used"  ;
VAL_ 904 ACU_NDALCStySwitchReq 0 "No command" 1 "Standard" 2 "Radical" 3 "Not used"  ;
VAL_ 904 ACU_ADASWarnTypeSwitch 0 "No command" 1 "Sound" 2 "Voice" 3 "Seat vibration"  ;
VAL_ 904 ACU_iACC_StyleConfirmSwitchReq 0 "No Command" 1 "Need confirm" 2 "No need confirm" 3 "OFF"  ;
VAL_ 904 ACU_IFC_ISDRestOfdis 0 "not in ISD" 251 "over 70km"  ;
VAL_ 904 ACU_IFC_SpeedLimitUnit 0 "Not used" 1 "Km/h" 2 "Miles/h" 3 "Not used"  ;
VAL_ 904 ACU_ThemeType 0 "Day mode" 1 "Night mode"  ;
VAL_ 904 ACU_IFC_SpeedLimtType 0 "Not specific" 1 "Speed limit camera detection" 2 "Interval speed detectionlimit"  ;
VAL_ 904 ACU_IFC_RoadType 0 "unknown" 1 "High way" 2 "National road" 3 "Provincial road" 4 "County road" 5 "Village road" 6 "City express way" 7 "Major urban road" 8 "Secondary urban road" 9 "Normal urban road" 10 "Non-Navigation Road" 11 "Ramp" 12 "Reserve" 13 "Reserve" 14 "Reserve" 15 "Reserve"  ;
VAL_ 904 ACU_IFC_ZoneCode 0 "Not used" 1 "China"  ;
VAL_ 904 ACU_IFC_NaviSt 0 "Unknown" 1 "Cruise" 2 "Navigate" 3 "Failure"  ;
VAL_ 904 ACU_IFC_NaviCorp 0 "unknown" 1 "Gaode Map" 2 "Tescent Map" 3 "Baidu Map" 4 "Ruitu Map"  ;
VAL_ 904 ACU_IFC_NaviNewIconDis 0 "no newIcon ahead" 21 "over 2.0km"  ;
VAL_ 904 ACU_IFC_OfframpSt 0 "Not off-ramp" 1 "Off-ramp"  ;
VAL_ 904 ACU_IFC_NaviNewIcon 0 "unknown" 1 "left" 2 "right" 3 "left front" 4 "right front" 5 "left rear" 6 "right rear" 7 "left u-turn" 8 "right u-turn" 9 "go straight" 10 "roundabout entrance" 11 "roundabout exit" 12 "service area" 13 "toll station" 14 "tunnel" 15 "not used"  ;
VAL_ 904 ACU_IFC_SLCAheadDis 251 "over 1.25km"  ;
VAL_ 904 ACU_DVR_Switch 0 "Off" 1 "On"  ;
VAL_ 904 ACU_IFC_OfframpDis 254 "over 2km"  ;
VAL_ 904 DrvrSideMotResp 0 "No Action" 1 "Executing Retraction Assistance" 2 "Executing Clearance Removal 1" 3 "Executing Clearance Removal 2" 4 "Executing Dynamic Support 1" 5 "Executing Dynamic Support 2" 6 "Executing Pre-crash Protection" 7 "Executing Vibration Warning 1" 8 "Executing Vibration Warning 2" 9 "Reserved" 10 "Retraction Assistance Completed" 11 "Clearance Removal Completed" 12 "Executing Dynamic Support 3" 13 "Executing Dynamic Support 4" 14 "Executing Vibration Notification" 15 "Timeout"  ;
VAL_ 904 EL_LeftLowBeamSt 0 "OFF" 1 "ON"  ;
VAL_ 904 EL_LeftLowBeamFaultSt 0 "Not fault" 1 "Fault"  ;
VAL_ 904 EL_RightLowBeamSt 0 "OFF" 1 "ON"  ;
VAL_ 904 EL_RightLowBeamFaultSt 0 "Not fault" 1 "Fault"  ;
VAL_ 904 WW_FWPMotorSt 0 "Off" 1 "Reserve" 2 "Stall protection" 3 "Failure" 4 "Low speed" 5 "High speed" 6 "Hard stopped" 7 "Interval delaying"  ;
VAL_ 904 EL_MLADASLightSt 0 "Off" 1 "On" 2 "Fault" 3 "Not used"  ;
VAL_ 904 EL_FLTurnLightSt 0 "Not active" 1 "OFF" 2 "ON" 3 "Not used"  ;
VAL_ 904 EL_FLTurnLightFaultSt 0 "Not fault" 1 "Fault"  ;
VAL_ 904 EL_FRTurnLightSt 0 "Not active" 1 "OFF" 2 "ON" 3 "Not used"  ;
VAL_ 904 EL_FRTurnLightFaultSt 0 "Not fault" 1 "Fault"  ;
VAL_ 904 EL_SideBrkLightSt 0 "OFF" 1 "ON"  ;
VAL_ 904 EL_SideBrkLightFaultSt 0 "Not fault" 1 "Fault"  ;
VAL_ 904 EL_CHMSLSt 0 "OFF" 1 "ON"  ;
VAL_ 904 EL_CHMSLFaultSt 0 "Not fault" 1 "Fault"  ;
VAL_ 904 EL_RLTurnLightSt 0 "Not active" 1 "OFF" 2 "ON" 3 "Not used"  ;
VAL_ 904 EL_RLTurnLightFaultSt 0 "Not fault" 1 "Fault"  ;
VAL_ 904 EL_RRTurnLightSt 0 "Not active" 1 "OFF" 2 "ON" 3 "Not used"  ;
VAL_ 904 EL_RRTurnLightFaultSt 0 "Not fault" 1 "Fault"  ;
VAL_ 904 IPDS_BAT1PowerSt 0 "Not Active" 1 "Active"  ;
VAL_ 904 IPDS_BAT2PowerSt 0 "Not Active" 1 "Active"  ;
VAL_ 904 IPDS_DCDC2PowerSt 0 "Not Active" 1 "Active"  ;
VAL_ 904 IPDS_GridIsoPowerSt 0 "Not Active" 1 "Active"  ;
VAL_ 904 IPS_DCDCModeSt 7 "Failure;" 3 "Active - Buck Mode;" 2 "Connected (HV is active);" 1 "Disconnected;" 0 "Init;"  ;
VAL_ 904 IPDS_FRRadarPowerSup 0 "Not Active" 1 "Active" 2 "PreOFF" 3 "Invalid"  ;
VAL_ 904 LBMS_SOFVD 0 "Invalid" 1 "Valid"  ;
VAL_ 904 LBMS_SOFEN 0 "Keep to the side parking False,Original lane parking False" 1 "Keep to the side parking True,Original lane parking False" 2 "Keep to the side parking False,Original lane parking True" 3 "Keep to the side parking True,Original lane parking True"  ;
VAL_ 904 LBMSAD_SOFVD 0 "Invalid" 1 "Valid"  ;
VAL_ 904 LBMSAD_SOFEN 0 "Keep to the side parking False,Original lane parking False" 1 "Keep to the side parking True,Original lane parking False" 2 "Keep to the side parking False,Original lane parking True" 3 "Keep to the side parking True,Original lane parking True"  ;
VAL_ 904 IPDS_FLRadarPowerSup 0 "Not Active" 1 "Active" 2 "PreOFF" 3 "Invalid"  ;
VAL_ 904 IPDS_FrontRadarPowerSup 0 "Not Active" 1 "Active" 2 "PreOFF" 3 "Invalid"  ;
VAL_ 904 IPDS_HDMapPowerSup 0 "Not Active" 1 "Active" 2 "PreOFF" 3 "Invalid"  ;
VAL_ 904 IPDS_RearRadarPowerSup 0 "Not Active" 1 "Active" 2 "PreOFF" 3 "Invalid"  ;
VAL_ 334 CSM_RC_ViewExtvideo 65535 "invalid? 无效值"  ;
VAL_ 334 CSM_RC_ViewExtvideoReq 0 "No Request" 1 "Request"  ;
VAL_ 777 EL_MRADASLightSt 0 "Off" 1 "On" 2 "Fault" 3 "Not used"  ;
VAL_ 777 MR_RightMirrorFoldUnfoldSt 0 "Unknown" 1 "Mirror fold" 2 "Mirror unfold" 3 "Reserved"  ;
VAL_ 777 PWL_WinCurrentPos_FRWinPst 255 "Undefined window position"  ;
VAL_ 777 EL_MRTurnLightSt 0 "Not active" 1 "OFF" 2 "ON" 3 "Not used"  ;
VAL_ 777 EL_MRTurnLightFaultSt 0 "Not fault" 1 "Fault"  ;
VAL_ 777 KAE_toADCDRVUnlockSensorSt 0 "No active" 1 "Active"  ;
VAL_ 777 KAE_toADCDRVLockSensorSt 0 "No active" 1 "Active"  ;
VAL_ 777 EL_RightBSDIndicatorSt 0 "OFF" 1 "ON"  ;
VAL_ 777 EL_RightBSDIndicatorFaultSt 0 "Not fault" 1 "Fault"  ;
VAL_ 342 KAE_PassiveUnlockReq 0 "No command" 1 "Unlock"  ;
VAL_ 342 KAE_PassiveLockReq 0 "No command" 1 "Lock"  ;
VAL_ 342 KAE_FOB1Position 0 "Undifiend" 1 "Inside vehicle" 2 "Outside vehicle" 3 "Not used" 4 "Inside trunk"  ;
VAL_ 342 KAE_FOB2Position 0 "Undifiend" 1 "Inside vehicle" 2 "Outside vehicle" 3 "Not used" 4 "Inside trunk"  ;
VAL_ 342 KAE_FOB3Position 0 "Undifiend" 1 "Inside vehicle" 2 "Outside vehicle" 3 "Not used" 4 "Inside trunk"  ;
VAL_ 342 KAE_FOB2UnlockBtnPressS 0 "Undefined" 1 "Short Press" 2 "Twice short Press" 3 "Long Press"  ;
VAL_ 342 KAE_FOB2LockBtnPressSt 0 "Undefined" 1 "Short Press" 2 "Twice short Press" 3 "Long Press"  ;
VAL_ 342 KAE_FOB2TrunkBtnPressSt 0 "Undefined" 1 "Short Press" 2 "Twice short Press" 3 "Long Press"  ;
VAL_ 342 KAE_FOB2User_definedBtnPressSt 0 "Undefined" 1 "Short Press" 2 "Twice short Press" 3 "Long Press"  ;
VAL_ 342 KAE_FOB3UnlockBtnPressS 0 "Undefined" 1 "Short Press" 2 "Twice short Press" 3 "Long Press"  ;
VAL_ 342 KAE_FOB3LockBtnPressSt 0 "Undefined" 1 "Short Press" 2 "Twice short Press" 3 "Long Press"  ;
VAL_ 342 KAE_FOB3TrunkBinPressSt 0 "Undefined" 1 "Short Press" 2 "Twice short Press" 3 "Long Press"  ;
VAL_ 342 KAE_FOB3User_defnedBtnPressst 0 "Undefined" 1 "Short Press" 2 "Twice short Press" 3 "Long Press"  ;
VAL_ 342 KAE_FOBUnlockBtnPressSt 0 "Not press" 1 "Short press" 2 "Twice short press" 3 "Long press"  ;
VAL_ 342 KAE_FOBLockBtnPressSt 0 "Not press" 1 "Short press" 2 "Twice short press" 3 "Long press"  ;
VAL_ 342 KAE_FOBRESBtnPressSt 0 "Not press" 1 "Short press" 2 "Twice short press" 3 "Long press"  ;
VAL_ 342 KAE_FOBPSD_LBtnPressSt 0 "Not press" 1 "Short press" 2 "Twice short press" 3 "Long press"  ;
VAL_ 342 KAE_FOBPSD_RBtnPressSt 0 "Not press" 1 "Short press" 2 "Twice short press" 3 "Long press"  ;
VAL_ 342 KAE_FOBTrunkBtnPressSt 0 "Not press" 1 "Short press" 2 "Twice short press" 3 "Long press"  ;
VAL_ 342 KAE_FOBPanicBtnPressSt 0 "Not press" 1 "Short press" 2 "Twice short press" 3 "Long press"  ;
VAL_ 342 KAE_FOBUser_definedBtnPressSt 0 "Not press" 1 "Short press" 2 "Twice short press" 3 "Long press"  ;
VAL_ 342 KAE_FOB2RESBtnPressSt 0 "Undifiend" 1 "Short press" 2 "Twice short press" 3 "Long press"  ;
VAL_ 342 KAE_FOB2PanicBtnPressSt 0 "Undifiend" 1 "Short press" 2 "Twice short press" 3 "Long press"  ;
VAL_ 512 KAE_BLE1Position 0 "Undefined" 1 "Passive start zone" 2 "Inside trunk zone" 3 "In  passive access left zone" 4 "In  paasive access right zone" 5 "In trunk passive access zone" 6 "In Passive start and paasive access zone"  ;
VAL_ 512 KAE_BLE2Position 0 "Undefined" 1 "Passive start zone" 2 "Inside trunk zone" 3 "In  passive access left zone" 4 "In  paasive access right zone" 5 "In trunk passive access zone" 6 "In Passive start and paasive access zone"  ;
VAL_ 512 KAE_BLE3Position 0 "Undefined" 1 "Passive start zone" 2 "Inside trunk zone" 3 "In  passive access left zone" 4 "In  paasive access right zone" 5 "In trunk passive access zone" 6 "In Passive start and paasive access zone"  ;
VAL_ 512 KAE_BLE4Position 0 "Undefined" 1 "Passive start zone" 2 "Inside trunk zone" 3 "In  passive access left zone" 4 "In  paasive access right zone" 5 "In trunk passive access zone" 6 "In Passive start and paasive access zone"  ;
VAL_ 512 KAE_BLE5Position 0 "Undefined" 1 "Passive start zone" 2 "Inside trunk zone" 3 "In  passive access left zone" 4 "In  paasive access right zone" 5 "In trunk passive access zone" 6 "In Passive start and paasive access zone"  ;
VAL_ 512 KAE_BLE1AuthSt 0 "Undefined" 1 "Failed" 2 "Pass" 3 "Busy"  ;
VAL_ 512 KAE_BLE2AuthSt 0 "Undefined" 1 "Failed" 2 "Pass" 3 "Busy"  ;
VAL_ 512 KAE_BLE3AuthSt 0 "Undefined" 1 "Failed" 2 "Pass" 3 "Busy"  ;
VAL_ 512 KAE_BLE4AuthSt 0 "Undefined" 1 "Failed" 2 "Pass" 3 "Busy"  ;
VAL_ 512 KAE_BLE5AuthSt 0 "Undefined" 1 "Failed" 2 "Pass" 3 "Busy"  ;
VAL_ 512 KAE_BLE1PKSPosition 0 "Undefined" 1 "Passive start zone" 2 "Inside trunk zone" 3 "In  passive access left zone" 4 "In  paasive access right zone" 5 "In trunk passive access zone" 6 "In Passive start and paasive access zone"  ;
VAL_ 512 KAE_BLE2PKSPosition 0 "Undefined" 1 "Passive start zone" 2 "Inside trunk zone" 3 "In  passive access left zone" 4 "In  paasive access right zone" 5 "In trunk passive access zone" 6 "In Passive start and paasive access zone"  ;
VAL_ 512 KAE_BLE3PKSPosition 0 "Undefined" 1 "Passive start zone" 2 "Inside trunk zone" 3 "In  passive access left zone" 4 "In  paasive access right zone" 5 "In trunk passive access zone" 6 "In Passive start and paasive access zone"  ;
VAL_ 512 KAE_BLE4PKSPosition 0 "Undefined" 1 "Passive start zone" 2 "Inside trunk zone" 3 "In  passive access left zone" 4 "In  paasive access right zone" 5 "In trunk passive access zone" 6 "In Passive start and paasive access zone"  ;
VAL_ 512 KAE_BLE5PKSPosition 0 "Undefined" 1 "Passive start zone" 2 "Inside trunk zone" 3 "In  passive access left zone" 4 "In  paasive access right zone" 5 "In trunk passive access zone" 6 "In Passive start and paasive access zone"  ;
VAL_ 909 LCK_HoodAjarSt 0 "Closed" 1 "Opened"  ;
VAL_ 909 LCK_FrontLeftDoorAjarSt 0 "Closed" 1 "Opened"  ;
VAL_ 909 LCK_FrontRightDoorAjarSt 0 "Closed" 1 "Opened"  ;
VAL_ 909 LCK_RearLeftDoorAjarSt 0 "Closed" 1 "Opened"  ;
VAL_ 909 LCK_RearRightDoorAjarSt 0 "Closed" 1 "Opened"  ;
VAL_ 909 LCK_TrunkAjarSt 0 "Closed" 1 "Opened"  ;
VAL_ 909 LCK_FrontLeftDoorLockSt 0 "Locked" 1 "Unlocked"  ;
VAL_ 909 LCK_FrontRightDoorLockSt 0 "Locked" 1 "Unlocked"  ;
VAL_ 909 LCK_RearLeftDoorLockSt 0 "Locked" 1 "Unlocked"  ;
VAL_ 909 LCK_RearRightDoorLockSt 0 "Locked" 1 "Unlocked"  ;
VAL_ 909 LCK_RearLeftChildSaftyLockSt 0 "Locked" 1 "Unlocked"  ;
VAL_ 909 LCK_RearRightChildSaftyLockSt 0 "Locked" 1 "Unlocked"  ;
VAL_ 909 EMS_EngStForPHEV 0 "Standby" 1 "Ready" 2 "Cranking" 3 "Running" 4 "Stopping" 5 "Stopped" 6 "Aotostopping"  ;
VAL_ 909 WCM_Reminder 0 "No warning" 1 "Phone left in car"  ;
VAL_ 909 WCM_ChargingSt 0 "Standby" 1 "Charging" 2 "Charging completed (available when Rx support)" 3 "Not standby"  ;
VAL_ 909 LCK_FrontLeftDoorHandlePosition 0 "FullyClosed" 100 "FullyOpened" 254 "Uninitialized" 255 "Unknown"  ;
VAL_ 909 LCK_FrontRightDoorHandlePosition 0 "FullyClosed" 100 "FullyOpened" 254 "Uninitialized" 255 "Unknown"  ;
VAL_ 909 LCK_RearLeftDoorHandlePosition 0 "FullyClosed" 100 "FullyOpened" 254 "Uninitialized" 255 "Unknown"  ;
VAL_ 909 LCK_RearRightDoorHandlePosition 0 "FullyClosed" 100 "FullyOpened" 254 "Uninitialized" 255 "Unknown"  ;
VAL_ 909 WW_RWPMotorSt 0 "Off" 1 "Reserve" 2 "Stall protection" 3 "Failure" 4 "Low speed" 5 "High speed" 6 "Hard stopped" 7 "Interval delaying"  ;
VAL_ 909 LCK_FillerCapASt 0 "Closed" 1 "Opened"  ;
VAL_ 909 LCK_FillerCapBSt 0 "Closed" 1 "Opened"  ;
VAL_ 909 AVAS_ActivatedSt 0 "OFF" 1 "ON" 2 "Sound_AVAS" 3 "Sound_UnLock" 4 "Sound_Lock"  ;
VAL_ 909 MR_LeftMirrorFoldUnfoldSt 0 "Unknown" 1 "Mirror fold" 2 "Mirror unfold" 3 "Reserved"  ;
VAL_ 909 SBM_SwapHvBattModeSt 0 "default" 1 "Station open the door for veichle go in" 2 "Station find Vehicle stop OK" 3 "Station prepare to swap" 4 "Station begin to swap" 5 "Station finish assembling" 6 "Station complete to swap" 7 "Station pause swapping" 8 "Station open the door for veichle go out"  ;
VAL_ 909 SBM_SwapStaDiagCode 0 "Normal" 1 "Fault,BT cominication error" 2 "Fault,SWAP station error" 3 "Fault,vehile error"  ;
VAL_ 909 SBM_SwapHvBattModeFaultSt 0 "default" 1 "Normal" 2 "Error,can recovery" 3 "Error,can not recover"  ;
VAL_ 909 IPDS_HDMapPowerSt 0 "Not Active" 1 "Active"  ;
VAL_ 909 IPDS_KL15L1PowerSt 0 "Not Active" 1 "Active"  ;
VAL_ 909 IPDS_SRSECUPowerSt 0 "Not Active" 1 "Active"  ;
VAL_ 909 IPDS_HODPowerSt 0 "Not Active" 1 "Active"  ;
VAL_ 909 KAE_BLEOption 0 "Not active" 1 "Active"  ;
VAL_ 909 KAE_UWBOption 0 "Not active" 1 "Active"  ;
VAL_ 909 PWL_WinCurrentPos_FLWinPst 255 "Undefined window position"  ;
VAL_ 909 UINM_FrontLeftPowerReleaseReq 0 "NoReq" 1 "Release"  ;
VAL_ 909 UINM_FrontLeftPowerReleaseFaultSt 0 "noraml" 1 "fault"  ;
VAL_ 909 UINM_FrontRightPowerReleaseReq 0 "NoReq" 1 "Release"  ;
VAL_ 909 UINM_FrontRightPowerReleaseFaultSt 0 "noraml" 1 "fault"  ;
VAL_ 909 UINM_RearLeftPowerReleaseFaultSt 0 "noraml" 1 "fault"  ;
VAL_ 909 UINM_RearLeftPowerReleaseReq 0 "NoReq" 1 "Release"  ;
VAL_ 909 UINM_RearRightPowerReleaseFaultSt 0 "noraml" 1 "fault"  ;
VAL_ 909 UINM_RearRightPowerReleaseReq 0 "NoReq" 1 "Release"  ;
VAL_ 909 PWL_WinCurrentPos_RRWinPst 255 "Undefined window position"  ;
VAL_ 909 PWL_WinCurrentPos_RLWinPst 255 "Undefined window position"  ;
VAL_ 909 ACEleclocksSt 0 "init" 1 "Uncloked" 2 "Locked" 3 "Error,bosh open" 4 "Error,bosh close"  ;
VAL_ 909 DSASBM_MotResp 0 "No Action" 1 "Executing Retraction Assistance" 2 "Executing Clearance Removal 1" 3 "Executing Clearance Removal 2" 4 "Executing Dynamic Support 1" 5 "Executing Dynamic Support 2" 6 "Executing Pre-crash Protection" 7 "Executing Vibration Warning 1" 8 "Executing Vibration Warning 2" 9 "Reserved" 10 "Retraction Assistance Completed" 11 "Clearance Removal Completed" 12 "Executing Dynamic Support 3" 13 "Executing Dynamic Support 4" 14 "Executing Vibration Notification" 15 "Reserved"  ;
VAL_ 909 FLISD_InteractLightSt 0 "norequest" 1 "Mode1准备中" 2 "Mode2行驶方向向左" 3 "Mode3行驶方向向右" 4 "Mode4行驶方向向前" 5 "Mode5起步" 6 "Mode6泊车等待中" 7 "Mode7礼让车辆" 8 "Mode8礼让行人" 9 "Mode9避让障碍物" 10 "Mode10靠边临停" 11 "Mode11已泊入车位" 12 "Mode12已泊出，请上车" 13 "Mode13已到达上车点，请上车" 14 "Mode14已退出，等待接管(告警等级1)" 15 "Mode15已退出，等待接管(告警等级2)" 16 "Mode16功能异常，注意安全" 17 "Mode17 泊车暂停，请及时接管" 18 "Mode18 保持车距" 19 "Mode19 请让我通行" 20 "Mode20 感谢" 21 "Mode21 前方堵车" 22 "reserved" 23 "reserved" 24 "reserved" 25 "reserved" 26 "reserved" 27 "reserved" 28 "reserved" 29 "reserved" 30 "reserved" 31 "reserved"  ;
VAL_ 1078 ETC_GateProperty 0 "reserved" 1 "entrance" 2 "exit" 3 "reserved"  ;
VAL_ 1078 ETC_TradeType 0 "highway unclose toll" 1 "highway close toll" 2 "other close toll"  ;
VAL_ 1078 ETC_SystemSt 0 "nomal" 1 "abnormal"  ;
VAL_ 1078 ETC_SysCfgst 0 "Disable" 1 "Enable"  ;
VAL_ 1078 ETC_ActivSt 0 "Normal" 1 "Abnormal"  ;
VAL_ 776 EL_LeftBSDIndicatorSt 0 "OFF" 1 "ON"  ;
VAL_ 776 UINM_HazardLightSwSt 0 "No Request" 1 "Request"  ;
VAL_ 776 EL_MLTurnLightSt 0 "Not active" 1 "OFF" 2 "ON" 3 "Not used"  ;
VAL_ 776 EL_MLTurnLightFaultSt 0 "Not fault" 1 "Fault"  ;
VAL_ 776 EL_LeftBSDIndicatorFaultSt 0 "Not fault" 1 "Fault"  ;
VAL_ 776 ZCUL_FrtWindshildHeatSt 0 "No" 1 "Heating" 2 "Fault" 3 "reserve"  ;
