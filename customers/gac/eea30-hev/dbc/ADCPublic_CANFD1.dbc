VERSION "Version"

NS_ :

BS_:

BU_: Tester CCU INU ADC RRR RLR CCURT1 CCURT2 ZCUF ZCUL ZCUR ZCUT EMS IDM DCDC DCDCI IPS NIDU DCU2 OBC OPC LPC CPC EMCM GCU DCU IPU BMS EOP EVCC DCDC2 EDL SRS ECS EPS EPB RBM IBCS ICM IID IDC AMP WHUD ARHUD IMR FIMR CD IFC FAPA PAS PCS SCMF SCMR SCMRL SCMRR MFS DRM FCP RCP LBMSAD AVAS DLPFL FBLCM FLISD FLLCM FRLCM RLLCMA RLLCMB RRLCMA RRLCMB RLISD DLPML DLPMR TRM PSDL PSDR FLDCM FRDCM HVSPRL HVSPRR RFR SBM WCM ETC TBOX2 TBOX RLBMS EBU FLPDM RLPDM FRPDM RRPDM FLOAR FROAR RLOAR RROAR EOSL EOSR EOST PRBU RT1_C0 OTAWL RT2_C3 IDUR PHUDD RAS CBM PLGM TMC LPC2 SAS RCICP SCMRM SCMT SLMRL SLMRR IDU RRISD DSASBM LBMS RT1_C1

BO_ 971 ADC_16: 64 ADC
 SG_ ADC_MnvrOrintChng6 : 31|2@0+ (1,0) [0|3] ""  CCU
 SG_ ADC_TarParkSt_Posn6 : 29|3@0+ (1,0) [0|7] ""  CCU
 SG_ ADC_ParkChkSrc_Posn6 : 26|3@0+ (1,0) [0|3] ""  CCU
 SG_ ADC_ParkPosn7_ID : 39|4@0+ (1,0) [0|15] ""  CCU
 SG_ ADC_MnvrOrintChng7 : 35|2@0+ (1,0) [0|3] ""  CCU
 SG_ ADC_TarParkSt_Posn7 : 33|3@0+ (1,0) [0|7] ""  CCU
 SG_ ADC_ParkChkSrc_Posn7 : 46|3@0+ (1,0) [0|3] ""  CCU
 SG_ ADC_ParkPosn8_ID : 43|4@0+ (1,0) [0|15] ""  CCU
 SG_ ADC_MnvrOrintChng8 : 55|2@0+ (1,0) [0|3] ""  CCU
 SG_ ADC_TarParkSt_Posn8 : 53|3@0+ (1,0) [0|7] ""  CCU
 SG_ ADC_ParkChkSrc_Posn8 : 50|3@0+ (1,0) [0|3] ""  CCU
 SG_ ADC_ParkRelPos5_x1 : 63|10@0+ (0.1,-50) [-50|50] "m"  CCU
 SG_ ADC_ParkRelPos5_y1 : 69|10@0+ (0.1,-50) [-50|50] "m"  CCU
 SG_ ADC_ParkRelPos5_x2 : 75|10@0+ (0.1,-50) [-50|50] "m"  CCU
 SG_ ADC_ParkRelPos5_y2 : 81|10@0+ (0.1,-50) [-50|50] "m"  CCU
 SG_ ADC_ParkRelPos5_x3 : 103|10@0+ (0.1,-50) [-50|50] "m"  CCU
 SG_ ADC_ParkRelPos5_y3 : 109|10@0+ (0.1,-50) [-50|50] "m"  CCU
 SG_ ADC_ParkRelPos5_x4 : 115|10@0+ (0.1,-50) [-50|50] "m"  CCU
 SG_ ADC_ParkRelPos5_y4 : 121|10@0+ (0.1,-50) [-50|50] "m"  CCU
 SG_ ADC_ParkRelPos6_x1 : 143|10@0+ (0.1,-50) [-50|50] "m"  CCU
 SG_ ADC_ParkRelPos6_y1 : 149|10@0+ (0.1,-50) [-50|50] "m"  CCU
 SG_ ADC_ParkRelPos6_x2 : 155|10@0+ (0.1,-50) [-50|50] "m"  CCU
 SG_ ADC_ParkRelPos6_y2 : 161|10@0+ (0.1,-50) [-50|50] "m"  CCU
 SG_ ADC_ParkRelPos6_x3 : 183|10@0+ (0.1,-50) [-50|50] "m"  CCU
 SG_ ADC_ParkRelPos6_y3 : 189|10@0+ (0.1,-50) [-50|50] "m"  CCU
 SG_ ADC_ParkRelPos6_x4 : 195|10@0+ (0.1,-50) [-50|50] "m"  CCU
 SG_ ADC_ParkRelPos6_y4 : 201|10@0+ (0.1,-50) [-50|50] "m"  CCU
 SG_ ADC_ParkRelPos7_x1 : 223|10@0+ (0.1,-50) [-50|50] "m"  CCU
 SG_ ADC_ParkRelPos7_y1 : 229|10@0+ (0.1,-50) [-50|50] "m"  CCU
 SG_ ADC_ParkRelPos7_x2 : 235|10@0+ (0.1,-50) [-50|50] "m"  CCU
 SG_ ADC_ParkRelPos7_y2 : 241|10@0+ (0.1,-50) [-50|50] "m"  CCU
 SG_ ADC_ParkRelPos7_x3 : 263|10@0+ (0.1,-50) [-50|50] "m"  CCU
 SG_ ADC_ParkRelPos7_y3 : 269|10@0+ (0.1,-50) [-50|50] "m"  CCU
 SG_ ADC_ParkRelPos7_x4 : 275|10@0+ (0.1,-50) [-50|50] "m"  CCU
 SG_ ADC_ParkRelPos7_y4 : 281|10@0+ (0.1,-50) [-50|50] "m"  CCU
 SG_ ADC_ParkRelPos8_x1 : 303|10@0+ (0.1,-50) [-50|50] "m"  CCU
 SG_ ADC_ParkRelPos8_y1 : 309|10@0+ (0.1,-50) [-50|50] "m"  CCU
 SG_ ADC_ParkRelPos8_x2 : 315|10@0+ (0.1,-50) [-50|50] "m"  CCU
 SG_ ADC_ParkRelPos8_y2 : 321|10@0+ (0.1,-50) [-50|50] "m"  CCU
 SG_ ADC_ParkRelPos8_x3 : 343|10@0+ (0.1,-50) [-50|50] "m"  CCU
 SG_ ADC_ParkRelPos8_y3 : 349|10@0+ (0.1,-50) [-50|50] "m"  CCU
 SG_ ADC_ParkRelPos8_x4 : 355|10@0+ (0.1,-50) [-50|50] "m"  CCU
 SG_ ADC_ParkRelPos8_y4 : 361|10@0+ (0.1,-50) [-50|50] "m"  CCU
 SG_ ADC_ParkPosn5_ID : 383|4@0+ (1,0) [0|15] ""  CCU
 SG_ ADC_MnvrOrintChng5 : 379|2@0+ (1,0) [0|3] ""  CCU
 SG_ ADC_TarParkSt_Posn5 : 377|3@0+ (1,0) [0|7] ""  CCU
 SG_ ADC_ParkChkSrc_Posn5 : 390|3@0+ (1,0) [0|3] ""  CCU
 SG_ ADC_ParkPosn6_ID : 387|4@0+ (1,0) [0|15] ""  CCU

BO_ 1110 ADC_17: 64 ADC
 SG_ ADAS_CANTRACE_EventType : 7|8@0+ (1,0) [0|255] ""  CCU
 SG_ ADAS_CANTRACE_EventSubModule : 15|8@0+ (1,0) [0|255] ""  CCU
 SG_ ADAS_CANTRACE_EventInfo0 : 23|8@0+ (1,0) [0|255] ""  CCU
 SG_ ADAS_CANTRACE_EventInfo1 : 31|8@0+ (1,0) [0|255] ""  CCU
 SG_ ADAS_CANTRACE_EventInfo2 : 39|8@0+ (1,0) [0|255] ""  CCU
 SG_ ADAS_CANTRACE_EventInfo3 : 47|8@0+ (1,0) [0|255] ""  CCU
 SG_ ADAS_CANTRACE_EventInfo4 : 55|8@0+ (1,0) [0|255] ""  CCU
 SG_ ADAS_CANTRACE_EventInfo5 : 63|8@0+ (1,0) [0|255] ""  CCU
 SG_ ADAS_CANTRACE_EventInfo6 : 71|8@0+ (1,0) [0|255] ""  CCU
 SG_ ADAS_CANTRACE_EventInfo7 : 79|8@0+ (1,0) [0|255] ""  CCU
 SG_ ADAS_CANTRACE_EventInfo8 : 87|8@0+ (1,0) [0|255] ""  CCU
 SG_ ADAS_CANTRACE_EventInfo9 : 95|8@0+ (1,0) [0|255] ""  CCU
 SG_ ADAS_CANTRACE_EventInfo10 : 103|8@0+ (1,0) [0|255] ""  CCU
 SG_ ADAS_CANTRACE_EventInfo11 : 111|8@0+ (1,0) [0|255] ""  CCU
 SG_ ADAS_CANTRACE_EventInfo12 : 119|8@0+ (1,0) [0|255] ""  CCU
 SG_ ADAS_CANTRACE_EventInfo13 : 127|8@0+ (1,0) [0|255] ""  CCU
 SG_ ADAS_CANTRACE_EventInfo14 : 135|8@0+ (1,0) [0|255] ""  CCU
 SG_ ADAS_CANTRACE_EventInfo15 : 143|8@0+ (1,0) [0|255] ""  CCU
 SG_ ADAS_CANTRACE_EventInfo16 : 151|8@0+ (1,0) [0|255] ""  CCU
 SG_ ADAS_CANTRACE_EventInfo17 : 159|8@0+ (1,0) [0|255] ""  CCU
 SG_ ADAS_CANTRACE_EventInfo18 : 167|8@0+ (1,0) [0|255] ""  CCU
 SG_ ADAS_CANTRACE_EventInfo19 : 175|8@0+ (1,0) [0|255] ""  CCU
 SG_ ADAS_CANTRACE_EventInfo20 : 183|8@0+ (1,0) [0|255] ""  CCU
 SG_ ADAS_CANTRACE_EventInfo21 : 191|8@0+ (1,0) [0|255] ""  CCU
 SG_ ADAS_CANTRACE_EventInfo22 : 199|8@0+ (1,0) [0|255] ""  CCU
 SG_ ADAS_CANTRACE_EventInfo23 : 207|8@0+ (1,0) [0|255] ""  CCU
 SG_ ADAS_CANTRACE_EventInfo24 : 215|8@0+ (1,0) [0|255] ""  CCU
 SG_ ADAS_CANTRACE_EventInfo25 : 223|8@0+ (1,0) [0|255] ""  CCU
 SG_ ADAS_CANTRACE_EventInfo26 : 231|8@0+ (1,0) [0|255] ""  CCU
 SG_ ADAS_CANTRACE_EventInfo27 : 239|8@0+ (1,0) [0|255] ""  CCU
 SG_ ADAS_CANTRACE_EventInfo28 : 247|8@0+ (1,0) [0|255] ""  CCU
 SG_ ADAS_CANTRACE_EventInfo29 : 255|8@0+ (1,0) [0|255] ""  CCU
 SG_ ADAS_CANTRACE_EventInfo30 : 263|8@0+ (1,0) [0|255] ""  CCU
 SG_ ADAS_CANTRACE_EventInfo31 : 271|8@0+ (1,0) [0|255] ""  CCU
 SG_ ADAS_CANTRACE_EventInfo32 : 279|8@0+ (1,0) [0|255] ""  CCU
 SG_ ADAS_CANTRACE_EventInfo33 : 287|8@0+ (1,0) [0|255] ""  CCU
 SG_ ADAS_CANTRACE_EventInfo34 : 295|8@0+ (1,0) [0|255] ""  CCU
 SG_ ADAS_CANTRACE_EventInfo35 : 303|8@0+ (1,0) [0|255] ""  CCU
 SG_ ADAS_CANTRACE_EventInfo36 : 311|8@0+ (1,0) [0|255] ""  CCU
 SG_ ADAS_CANTRACE_EventInfo37 : 319|8@0+ (1,0) [0|255] ""  CCU
 SG_ ADAS_CANTRACE_EventInfo38 : 327|8@0+ (1,0) [0|255] ""  CCU
 SG_ ADAS_CANTRACE_EventInfo39 : 335|8@0+ (1,0) [0|255] ""  CCU
 SG_ ADAS_CANTRACE_EventInfo40 : 343|8@0+ (1,0) [0|255] ""  CCU
 SG_ ADAS_CANTRACE_EventInfo41 : 351|8@0+ (1,0) [0|255] ""  CCU
 SG_ ADAS_CANTRACE_EventInfo42 : 359|8@0+ (1,0) [0|255] ""  CCU
 SG_ ADAS_CANTRACE_EventInfo43 : 367|8@0+ (1,0) [0|255] ""  CCU
 SG_ ADAS_CANTRACE_EventInfo44 : 375|8@0+ (1,0) [0|255] ""  CCU
 SG_ ADAS_CANTRACE_EventInfo45 : 383|8@0+ (1,0) [0|255] ""  CCU
 SG_ ADAS_CANTRACE_EventInfo46 : 391|8@0+ (1,0) [0|255] ""  CCU
 SG_ ADAS_CANTRACE_EventInfo47 : 399|8@0+ (1,0) [0|255] ""  CCU
 SG_ ADAS_CANTRACE_EventInfo48 : 407|8@0+ (1,0) [0|255] ""  CCU
 SG_ ADAS_CANTRACE_EventInfo49 : 415|8@0+ (1,0) [0|255] ""  CCU
 SG_ ADAS_CANTRACE_EventInfo50 : 423|8@0+ (1,0) [0|255] ""  CCU
 SG_ ADAS_CANTRACE_EventInfo51 : 431|8@0+ (1,0) [0|255] ""  CCU
 SG_ ADAS_CANTRACE_EventInfo52 : 439|8@0+ (1,0) [0|255] ""  CCU
 SG_ ADAS_CANTRACE_EventInfo53 : 447|8@0+ (1,0) [0|255] ""  CCU
 SG_ ADAS_CANTRACE_EventInfo54 : 455|8@0+ (1,0) [0|255] ""  CCU
 SG_ ADAS_CANTRACE_EventInfo55 : 463|8@0+ (1,0) [0|255] ""  CCU
 SG_ ADAS_CANTRACE_EventInfo56 : 471|8@0+ (1,0) [0|255] ""  CCU
 SG_ ADAS_CANTRACE_EventInfo57 : 479|8@0+ (1,0) [0|255] ""  CCU
 SG_ ADAS_CANTRACE_EventInfo58 : 487|8@0+ (1,0) [0|255] ""  CCU
 SG_ ADAS_CANTRACE_EventInfo59 : 495|8@0+ (1,0) [0|255] ""  CCU
 SG_ ADAS_CANTRACE_EventInfo60 : 503|8@0+ (1,0) [0|255] ""  CCU
 SG_ ADAS_CANTRACE_EventInfo61 : 511|8@0+ (1,0) [0|255] ""  CCU

BO_ 1111 ADC_18: 64 ADC
 SG_ ADAS_CANTRACE_AlarmPktType : 7|8@0+ (1,0) [0|255] ""  CCU
 SG_ ADAS_CANTRACE_AlarmPktCount : 15|8@0+ (1,0) [0|255] ""  CCU
 SG_ ADAS_CANTRACE_AlarmNum : 23|8@0+ (1,0) [0|255] ""  CCU
 SG_ ADAS_CANTRACE_AlarmFaultId0 : 31|16@0+ (1,0) [0|65535] ""  CCU
 SG_ ADAS_CANTRACE_AlarmKeyPara0 : 47|16@0+ (1,0) [0|65535] ""  CCU
 SG_ ADAS_CANTRACE_AlarmFaultId1 : 63|16@0+ (1,0) [0|65535] ""  CCU
 SG_ ADAS_CANTRACE_AlarmKeyPara1 : 79|16@0+ (1,0) [0|65535] ""  CCU
 SG_ ADAS_CANTRACE_AlarmFaultId2 : 95|16@0+ (1,0) [0|65535] ""  CCU
 SG_ ADAS_CANTRACE_AlarmKeyPara2 : 111|16@0+ (1,0) [0|65535] ""  CCU
 SG_ ADAS_CANTRACE_AlarmFaultId3 : 127|16@0+ (1,0) [0|65535] ""  CCU
 SG_ ADAS_CANTRACE_AlarmKeyPara3 : 143|16@0+ (1,0) [0|65535] ""  CCU
 SG_ ADAS_CANTRACE_AlarmFaultId4 : 159|16@0+ (1,0) [0|65535] ""  CCU
 SG_ ADAS_CANTRACE_AlarmKeyPara4 : 175|16@0+ (1,0) [0|65535] ""  CCU
 SG_ ADAS_CANTRACE_AlarmFaultId5 : 191|16@0+ (1,0) [0|65535] ""  CCU
 SG_ ADAS_CANTRACE_AlarmKeyPara5 : 207|16@0+ (1,0) [0|65535] ""  CCU
 SG_ ADAS_CANTRACE_AlarmFaultId6 : 223|16@0+ (1,0) [0|65535] ""  CCU
 SG_ ADAS_CANTRACE_AlarmKeyPara6 : 239|16@0+ (1,0) [0|65535] ""  CCU
 SG_ ADAS_CANTRACE_AlarmFaultId7 : 255|16@0+ (1,0) [0|65535] ""  CCU
 SG_ ADAS_CANTRACE_AlarmKeyPara7 : 271|16@0+ (1,0) [0|65535] ""  CCU
 SG_ ADAS_CANTRACE_AlarmFaultId8 : 287|16@0+ (1,0) [0|65535] ""  CCU
 SG_ ADAS_CANTRACE_AlarmKeyPara8 : 303|16@0+ (1,0) [0|65535] ""  CCU
 SG_ ADAS_CANTRACE_AlarmFaultId9 : 319|16@0+ (1,0) [0|65535] ""  CCU
 SG_ ADAS_CANTRACE_AlarmKeyPara9 : 335|16@0+ (1,0) [0|65535] ""  CCU
 SG_ ADAS_CANTRACE_AlarmFaultId10 : 351|16@0+ (1,0) [0|65535] ""  CCU
 SG_ ADAS_CANTRACE_AlarmKeyPara10 : 367|16@0+ (1,0) [0|65535] ""  CCU
 SG_ ADAS_CANTRACE_AlarmFaultId11 : 383|16@0+ (1,0) [0|65535] ""  CCU
 SG_ ADAS_CANTRACE_AlarmKeyPara11 : 399|16@0+ (1,0) [0|65535] ""  CCU
 SG_ ADAS_CANTRACE_AlarmFaultId12 : 415|16@0+ (1,0) [0|65535] ""  CCU
 SG_ ADAS_CANTRACE_AlarmKeyPara12 : 431|16@0+ (1,0) [0|65535] ""  CCU
 SG_ ADAS_CANTRACE_AlarmFaultId13 : 447|16@0+ (1,0) [0|65535] ""  CCU
 SG_ ADAS_CANTRACE_AlarmKeyPara13 : 463|16@0+ (1,0) [0|65535] ""  CCU
 SG_ ADAS_CANTRACE_AlarmFaultId14 : 479|16@0+ (1,0) [0|65535] ""  CCU
 SG_ ADAS_CANTRACE_AlarmKeyPara14 : 495|16@0+ (1,0) [0|65535] ""  CCU
 SG_ ADAS_CANTRACE_AlarmRsv : 511|8@0+ (1,0) [0|255] ""  CCU

BO_ 365 ADC_19: 64 ADC
 SG_ ADC_19_CRC : 7|16@0+ (1,0) [0|65535] ""  CCU,CCURT2,RT2_C3
 SG_ ADC_19_Counter : 23|8@0+ (1,0) [0|255] ""  CCU,CCURT2,RT2_C3
 SG_ ADC_Obj02_ID : 411|6@0+ (1,0) [0|63] ""  CCU,CCURT2
 SG_ ADC_Obj03Dist : 55|12@0+ (0.1,0) [0|409.5] "m"  CCU,CCURT2
 SG_ ADC_Obj03HoztAngSpd : 264|10@0+ (0.2,-50) [-50|150] "deg/s"  CCU,CCURT2
 SG_ ADC_Obj03LeftAngle : 159|11@0+ (0.05,-40) [-40|40] "deg"  CCU,CCURT2
 SG_ ADC_Obj03RightAngle : 164|11@0+ (0.05,-40) [-40|40] "deg"  CCU,CCURT2
 SG_ ADC_Obj03BottomAngle : 346|7@0+ (0.2,-12) [-12|13.4] "deg"  CCU,CCURT2
 SG_ ADC_Obj03TopAngle : 355|7@0+ (0.2,-12) [-12|13.4] "deg"  CCU,CCURT2
 SG_ ADC_Obj04_ID : 425|6@0+ (1,0) [0|63] ""  CCU,CCURT2
 SG_ ADC_Obj01_ID : 421|6@0+ (1,0) [0|63] ""  CCU,CCURT2
 SG_ ADC_Obj04Dist : 59|12@0+ (0.1,0) [0|409.5] "m"  CCU,CCURT2
 SG_ ADC_Obj04HoztAngSpd : 286|10@0+ (0.2,-50) [-50|150] "deg/s"  CCU,CCURT2
 SG_ ADC_Obj04LeftAngle : 169|11@0+ (0.05,-40) [-40|40] "deg"  CCU,CCURT2
 SG_ ADC_Obj04RightAngle : 190|11@0+ (0.05,-40) [-40|40] "deg"  CCU,CCURT2
 SG_ ADC_Obj04BottomAngle : 364|7@0+ (0.2,-12) [-12|13.4] "deg"  CCU,CCURT2
 SG_ ADC_Obj04TopAngle : 373|7@0+ (0.2,-12) [-12|13.4] "deg"  CCU,CCURT2
 SG_ ADC_Obj03_ID : 431|6@0+ (1,0) [0|63] ""  CCU,CCURT2
 SG_ ADC_Obj06_ID : 435|6@0+ (1,0) [0|63] ""  CCU,CCURT2
 SG_ ADC_Obj01Dist : 31|12@0+ (0.1,0) [0|409.5] "m"  CCU,CCURT2
 SG_ ADC_Obj01HoztAngSpd : 252|10@0+ (0.2,-50) [-50|150] "deg/s"  CCU,CCURT2
 SG_ ADC_Obj01LeftAngle : 107|11@0+ (0.05,-40) [-40|40] "deg"  CCU,CCURT2
 SG_ ADC_Obj01RightAngle : 112|11@0+ (0.05,-40) [-40|40] "deg"  CCU,CCURT2
 SG_ ADC_Obj01BottomAngle : 326|7@0+ (0.2,-12) [-12|13.4] "deg"  CCU,CCURT2
 SG_ ADC_Obj01TopAngle : 335|7@0+ (0.2,-12) [-12|13.4] "deg"  CCU,CCURT2
 SG_ ADC_Obj05Dist : 79|12@0+ (0.1,0) [0|409.5] "m"  CCU,CCURT2
 SG_ ADC_Obj05HoztAngSpd : 292|10@0+ (0.2,-50) [-50|150] "deg/s"  CCU,CCURT2
 SG_ ADC_Obj05LeftAngle : 195|11@0+ (0.05,-40) [-40|40] "deg"  CCU,CCURT2
 SG_ ADC_Obj05RightAngle : 200|11@0+ (0.05,-40) [-40|40] "deg"  CCU,CCURT2
 SG_ ADC_Obj05BottomAngle : 382|7@0+ (0.2,-12) [-12|13.4] "deg"  CCU,CCURT2
 SG_ ADC_Obj05TopAngle : 391|7@0+ (0.2,-12) [-12|13.4] "deg"  CCU,CCURT2
 SG_ ADC_Obj06Dist : 83|12@0+ (0.1,0) [0|409.5] "m"  CCU,CCURT2
 SG_ ADC_Obj06HoztAngSpd : 298|10@0+ (0.2,-50) [-50|150] "deg/s"  CCU,CCURT2
 SG_ ADC_Obj06LeftAngle : 221|11@0+ (0.05,-40) [-40|40] "deg"  CCU,CCURT2
 SG_ ADC_Obj06RightAngle : 226|11@0+ (0.05,-40) [-40|40] "deg"  CCU,CCURT2
 SG_ ADC_Obj06BottomAngle : 384|7@0+ (0.2,-12) [-12|13.4] "deg"  CCU,CCURT2
 SG_ ADC_Obj02Dist : 35|12@0+ (0.1,0) [0|409.5] "m"  CCU,CCURT2
 SG_ ADC_Obj02HoztAngSpd : 258|10@0+ (0.2,-50) [-50|150] "deg/s"  CCU,CCURT2
 SG_ ADC_Obj02LeftAngle : 133|11@0+ (0.05,-40) [-40|40] "deg"  CCU,CCURT2
 SG_ ADC_Obj02RightAngle : 138|11@0+ (0.05,-40) [-40|40] "deg"  CCU,CCURT2
 SG_ ADC_Obj02BottomAngle : 328|7@0+ (0.2,-12) [-12|13.4] "deg"  CCU,CCURT2
 SG_ ADC_Obj02TopAngle : 337|7@0+ (0.2,-12) [-12|13.4] "deg"  CCU,CCURT2
 SG_ ADC_Obj06TopAngle : 393|7@0+ (0.2,-12) [-12|13.4] "deg"  CCU,CCURT2
 SG_ ADC_Obj07Dist : 103|12@0+ (0.1,0) [0|409.5] "m"  CCU,CCURT2
 SG_ ADC_Obj07HoztAngSpd : 304|10@0+ (0.2,-50) [-50|150] "deg/s"  CCU,CCURT2
 SG_ ADC_Obj07LeftAngle : 247|11@0+ (0.05,-40) [-40|40] "deg"  CCU,CCURT2
 SG_ ADC_Obj07BottomAngle : 402|7@0+ (0.2,-12) [-12|13.4] "deg"  CCU,CCURT2
 SG_ ADC_Obj05_ID : 445|6@0+ (1,0) [0|63] ""  CCU,CCURT2
 SG_ ADC_Obj04Typ : 467|4@0+ (1,0) [0|15] ""  CCU,CCURT2
 SG_ ADC_Obj04Dir : 511|2@0+ (1,0) [0|3] ""  CCU,CCURT2
 SG_ ADC_ADBCamSt : 463|4@0+ (1,0) [0|15] ""  CCU,CCURT2
 SG_ ADC_Obj03Dir : 499|2@0+ (1,0) [0|3] ""  CCU,CCURT2
 SG_ ADC_Obj02Dir : 497|2@0+ (1,0) [0|3] ""  CCU,CCURT2
 SG_ ADC_Obj02Typ : 503|4@0+ (1,0) [0|15] ""  CCU,CCURT2
 SG_ ADC_Obj03Typ : 459|4@0+ (1,0) [0|15] ""  CCU,CCURT2
 SG_ ADC_Obj01Typ : 495|4@0+ (1,0) [0|15] ""  CCU,CCURT2
 SG_ ADC_Obj01Dir : 449|2@0+ (1,0) [0|3] ""  CCU,CCURT2
 SG_ ADC_ObjNum : 471|4@0+ (1,0) [0|15] ""  CCU,CCURT2
 SG_ ADC_AmbLightCondition : 479|4@0+ (1,0) [0|15] ""  CCU,CCURT2,RT2_C3
 SG_ ADC_TrafficStyle : 487|4@0+ (1,0) [0|15] ""  CCU,CCURT2
 SG_ ADC_Obj05Typ : 475|4@0+ (1,0) [0|15] ""  CCU,CCURT2
 SG_ ADC_Obj05Dir : 509|2@0+ (1,0) [0|3] ""  CCU,CCURT2
 SG_ ADC_Obj06Typ : 483|4@0+ (1,0) [0|15] ""  CCU,CCURT2
 SG_ ADC_Obj06Dir : 507|2@0+ (1,0) [0|3] ""  CCU,CCURT2
 SG_ ADC_Obj07_ID : 455|6@0+ (1,0) [0|63] ""  CCU,CCURT2
 SG_ ADC_Obj07Typ : 491|4@0+ (1,0) [0|15] ""  CCU,CCURT2
 SG_ ADC_Obj07Dir : 505|2@0+ (1,0) [0|3] ""  CCU,CCURT2

BO_ 366 ADC_20: 32 ADC
 SG_ ADC_20_CRC : 7|16@0+ (1,0) [0|65535] ""  CCU,CCURT2
 SG_ ADC_20_Counter : 23|8@0+ (1,0) [0|255] ""  CCU,CCURT2
 SG_ ADC_Obj07RightAngle : 59|11@0+ (0.05,-40) [-40|40] "deg"  CCU,CCURT2
 SG_ ADC_Obj07TopAngle : 160|7@0+ (0.2,-12) [-12|13.4] "deg"  CCU,CCURT2
 SG_ ADC_Obj08_ID : 223|6@0+ (1,0) [0|63] ""  CCU,CCURT2
 SG_ ADC_Obj08Typ : 237|4@0+ (1,0) [0|15] ""  CCU,CCURT2
 SG_ ADC_Obj08Dir : 241|2@0+ (1,0) [0|3] ""  CCU,CCURT2
 SG_ ADC_Obj08Dist : 31|12@0+ (0.1,0) [0|409.5] "m"  CCU,CCURT2
 SG_ ADC_Obj08HoztAngSpd : 142|10@0+ (0.2,-50) [-50|150] "deg/s"  CCU,CCURT2
 SG_ ADC_Obj08LeftAngle : 64|11@0+ (0.05,-40) [-40|40] "deg"  CCU,CCURT2
 SG_ ADC_Obj08RightAngle : 85|11@0+ (0.05,-40) [-40|40] "deg"  CCU,CCURT2
 SG_ ADC_Obj08BottomAngle : 169|7@0+ (0.2,-12) [-12|13.4] "deg"  CCU,CCURT2
 SG_ ADC_Obj08TopAngle : 178|7@0+ (0.2,-12) [-12|13.4] "deg"  CCU,CCURT2
 SG_ ADC_Obj09_ID : 217|6@0+ (1,0) [0|63] ""  CCU,CCURT2
 SG_ ADC_Obj09Typ : 233|4@0+ (1,0) [0|15] ""  CCU,CCURT2
 SG_ ADC_Obj09Dir : 253|2@0+ (1,0) [0|3] ""  CCU,CCURT2
 SG_ ADC_Obj09Dist : 35|12@0+ (0.1,0) [0|409.5] "m"  CCU,CCURT2
 SG_ ADC_Obj09HoztAngSpd : 148|10@0+ (0.2,-50) [-50|150] "deg/s"  CCU,CCURT2
 SG_ ADC_Obj09LeftAngle : 90|11@0+ (0.05,-40) [-40|40] "deg"  CCU,CCURT2
 SG_ ADC_Obj09RightAngle : 111|11@0+ (0.05,-40) [-40|40] "deg"  CCU,CCURT2
 SG_ ADC_Obj09BottomAngle : 187|7@0+ (0.2,-12) [-12|13.4] "deg"  CCU,CCURT2
 SG_ ADC_Obj09TopAngle : 196|7@0+ (0.2,-12) [-12|13.4] "deg"  CCU,CCURT2
 SG_ ADC_Obj010_ID : 227|6@0+ (1,0) [0|63] ""  CCU,CCURT2
 SG_ ADC_Obj010Typ : 245|4@0+ (1,0) [0|15] ""  CCU,CCURT2
 SG_ ADC_Obj010Dir : 255|2@0+ (1,0) [0|3] ""  CCU,CCURT2
 SG_ ADC_Obj010Dist : 55|12@0+ (0.1,0) [0|409.5] "m"  CCU,CCURT2
 SG_ ADC_Obj010HoztAngSpd : 154|10@0+ (0.2,-50) [-50|150] "deg/s"  CCU,CCURT2
 SG_ ADC_Obj010LeftAngle : 116|11@0+ (0.05,-40) [-40|40] "deg"  CCU,CCURT2
 SG_ ADC_Obj010RightAngle : 121|11@0+ (0.05,-40) [-40|40] "deg"  CCU,CCURT2
 SG_ ADC_Obj010BottomAngle : 205|7@0+ (0.2,-12) [-12|13.4] "deg"  CCU,CCURT2
 SG_ ADC_Obj010TopAngle : 214|7@0+ (0.2,-12) [-12|13.4] "deg"  CCU,CCURT2
 SG_ Reserved1 : 248|1@0+ (1,0) [0|0] ""  CCU,CCURT2

CM_ SG_ 971 ADC_MnvrOrintChng6 "ADC_MnvrOrintChng6";
CM_ SG_ 971 ADC_TarParkSt_Posn6 "ADC_TarParkSt_Posn6";
CM_ SG_ 971 ADC_ParkChkSrc_Posn6 "ADC_ParkChkSrc_Posn6";
CM_ SG_ 971 ADC_ParkPosn7_ID "ADC_ParkPosn7_ID";
CM_ SG_ 971 ADC_MnvrOrintChng7 "ADC_MnvrOrintChng7";
CM_ SG_ 971 ADC_TarParkSt_Posn7 "ADC_TarParkSt_Posn7";
CM_ SG_ 971 ADC_ParkChkSrc_Posn7 "ADC_ParkChkSrc_Posn7";
CM_ SG_ 971 ADC_ParkPosn8_ID "ADC_ParkPosn8_ID";
CM_ SG_ 971 ADC_MnvrOrintChng8 "ADC_MnvrOrintChng8";
CM_ SG_ 971 ADC_TarParkSt_Posn8 "ADC_TarParkSt_Posn8";
CM_ SG_ 971 ADC_ParkChkSrc_Posn8 "ADC_ParkChkSrc_Posn8";
CM_ SG_ 971 ADC_ParkRelPos5_x1 "ADC_ParkRelPos5_x1";
CM_ SG_ 971 ADC_ParkRelPos5_y1 "ADC_ParkRelPos5_y1";
CM_ SG_ 971 ADC_ParkRelPos5_x2 "ADC_ParkRelPos5_x2";
CM_ SG_ 971 ADC_ParkRelPos5_y2 "ADC_ParkRelPos5_y2";
CM_ SG_ 971 ADC_ParkRelPos5_x3 "ADC_ParkRelPos5_x3";
CM_ SG_ 971 ADC_ParkRelPos5_y3 "ADC_ParkRelPos5_y3";
CM_ SG_ 971 ADC_ParkRelPos5_x4 "ADC_ParkRelPos5_x4";
CM_ SG_ 971 ADC_ParkRelPos5_y4 "ADC_ParkRelPos5_y4";
CM_ SG_ 971 ADC_ParkRelPos6_x1 "ADC_ParkRelPos6_x1";
CM_ SG_ 971 ADC_ParkRelPos6_y1 "ADC_ParkRelPos6_y1";
CM_ SG_ 971 ADC_ParkRelPos6_x2 "ADC_ParkRelPos6_x2";
CM_ SG_ 971 ADC_ParkRelPos6_y2 "ADC_ParkRelPos6_y2";
CM_ SG_ 971 ADC_ParkRelPos6_x3 "ADC_ParkRelPos6_x3";
CM_ SG_ 971 ADC_ParkRelPos6_y3 "ADC_ParkRelPos6_y3";
CM_ SG_ 971 ADC_ParkRelPos6_x4 "ADC_ParkRelPos6_x4";
CM_ SG_ 971 ADC_ParkRelPos6_y4 "ADC_ParkRelPos6_y4";
CM_ SG_ 971 ADC_ParkRelPos7_x1 "ADC_ParkRelPos7_x1";
CM_ SG_ 971 ADC_ParkRelPos7_y1 "ADC_ParkRelPos7_y1";
CM_ SG_ 971 ADC_ParkRelPos7_x2 "ADC_ParkRelPos7_x2";
CM_ SG_ 971 ADC_ParkRelPos7_y2 "ADC_ParkRelPos7_y2";
CM_ SG_ 971 ADC_ParkRelPos7_x3 "ADC_ParkRelPos7_x3";
CM_ SG_ 971 ADC_ParkRelPos7_y3 "ADC_ParkRelPos7_y3";
CM_ SG_ 971 ADC_ParkRelPos7_x4 "ADC_ParkRelPos7_x4";
CM_ SG_ 971 ADC_ParkRelPos7_y4 "ADC_ParkRelPos7_y4";
CM_ SG_ 971 ADC_ParkRelPos8_x1 "ADC_ParkRelPos8_x1";
CM_ SG_ 971 ADC_ParkRelPos8_y1 "ADC_ParkRelPos8_y1";
CM_ SG_ 971 ADC_ParkRelPos8_x2 "ADC_ParkRelPos8_x2";
CM_ SG_ 971 ADC_ParkRelPos8_y2 "ADC_ParkRelPos8_y2";
CM_ SG_ 971 ADC_ParkRelPos8_x3 "ADC_ParkRelPos8_x3";
CM_ SG_ 971 ADC_ParkRelPos8_y3 "ADC_ParkRelPos8_y3";
CM_ SG_ 971 ADC_ParkRelPos8_x4 "ADC_ParkRelPos8_x4";
CM_ SG_ 971 ADC_ParkRelPos8_y4 "ADC_ParkRelPos8_y4";
CM_ SG_ 971 ADC_ParkPosn5_ID "ADC_ParkPosn5_ID";
CM_ SG_ 971 ADC_MnvrOrintChng5 "ADC_MnvrOrintChng5";
CM_ SG_ 971 ADC_TarParkSt_Posn5 "ADC_TarParkSt_Posn5";
CM_ SG_ 971 ADC_ParkChkSrc_Posn5 "ADC_ParkChkSrc_Posn5";
CM_ SG_ 971 ADC_ParkPosn6_ID "ADC_ParkPosn6_ID";
CM_ SG_ 1110 ADAS_CANTRACE_EventType "Messag type";
CM_ SG_ 1110 ADAS_CANTRACE_EventSubModule "ADAS_CANTRACE_EventModuleID";
CM_ SG_ 1110 ADAS_CANTRACE_EventInfo0 "ADAS_CANTRACE_EventInfo0";
CM_ SG_ 1110 ADAS_CANTRACE_EventInfo1 "ADAS_CANTRACE_EventInfo1";
CM_ SG_ 1110 ADAS_CANTRACE_EventInfo2 "ADAS_CANTRACE_EventInfo2";
CM_ SG_ 1110 ADAS_CANTRACE_EventInfo3 "ADAS_CANTRACE_EventInfo3";
CM_ SG_ 1110 ADAS_CANTRACE_EventInfo4 "ADAS_CANTRACE_EventInfo4";
CM_ SG_ 1110 ADAS_CANTRACE_EventInfo5 "ADAS_CANTRACE_EventInfo5";
CM_ SG_ 1110 ADAS_CANTRACE_EventInfo6 "ADAS_CANTRACE_EventInfo6";
CM_ SG_ 1110 ADAS_CANTRACE_EventInfo7 "ADAS_CANTRACE_EventInfo7";
CM_ SG_ 1110 ADAS_CANTRACE_EventInfo8 "ADAS_CANTRACE_EventInfo8";
CM_ SG_ 1110 ADAS_CANTRACE_EventInfo9 "ADAS_CANTRACE_EventInfo9";
CM_ SG_ 1110 ADAS_CANTRACE_EventInfo10 "ADAS_CANTRACE_EventInfo10";
CM_ SG_ 1110 ADAS_CANTRACE_EventInfo11 "ADAS_CANTRACE_EventInfo11";
CM_ SG_ 1110 ADAS_CANTRACE_EventInfo12 "ADAS_CANTRACE_EventInfo12";
CM_ SG_ 1110 ADAS_CANTRACE_EventInfo13 "ADAS_CANTRACE_EventInfo13";
CM_ SG_ 1110 ADAS_CANTRACE_EventInfo14 "ADAS_CANTRACE_EventInfo14";
CM_ SG_ 1110 ADAS_CANTRACE_EventInfo15 "ADAS_CANTRACE_EventInfo15";
CM_ SG_ 1110 ADAS_CANTRACE_EventInfo16 "ADAS_CANTRACE_EventInfo16";
CM_ SG_ 1110 ADAS_CANTRACE_EventInfo17 "ADAS_CANTRACE_EventInfo17";
CM_ SG_ 1110 ADAS_CANTRACE_EventInfo18 "ADAS_CANTRACE_EventInfo18";
CM_ SG_ 1110 ADAS_CANTRACE_EventInfo19 "ADAS_CANTRACE_EventInfo19";
CM_ SG_ 1110 ADAS_CANTRACE_EventInfo20 "ADAS_CANTRACE_EventInfo20";
CM_ SG_ 1110 ADAS_CANTRACE_EventInfo21 "ADAS_CANTRACE_EventInfo21";
CM_ SG_ 1110 ADAS_CANTRACE_EventInfo22 "ADAS_CANTRACE_EventInfo22";
CM_ SG_ 1110 ADAS_CANTRACE_EventInfo23 "ADAS_CANTRACE_EventInfo23";
CM_ SG_ 1110 ADAS_CANTRACE_EventInfo24 "ADAS_CANTRACE_EventInfo24";
CM_ SG_ 1110 ADAS_CANTRACE_EventInfo25 "ADAS_CANTRACE_EventInfo25";
CM_ SG_ 1110 ADAS_CANTRACE_EventInfo26 "ADAS_CANTRACE_EventInfo26";
CM_ SG_ 1110 ADAS_CANTRACE_EventInfo27 "ADAS_CANTRACE_EventInfo27";
CM_ SG_ 1110 ADAS_CANTRACE_EventInfo28 "ADAS_CANTRACE_EventInfo28";
CM_ SG_ 1110 ADAS_CANTRACE_EventInfo29 "ADAS_CANTRACE_EventInfo29";
CM_ SG_ 1110 ADAS_CANTRACE_EventInfo30 "ADAS_CANTRACE_EventInfo30";
CM_ SG_ 1110 ADAS_CANTRACE_EventInfo31 "ADAS_CANTRACE_EventInfo31";
CM_ SG_ 1110 ADAS_CANTRACE_EventInfo32 "ADAS_CANTRACE_EventInfo32";
CM_ SG_ 1110 ADAS_CANTRACE_EventInfo33 "ADAS_CANTRACE_EventInfo33";
CM_ SG_ 1110 ADAS_CANTRACE_EventInfo34 "ADAS_CANTRACE_EventInfo34";
CM_ SG_ 1110 ADAS_CANTRACE_EventInfo35 "ADAS_CANTRACE_EventInfo35";
CM_ SG_ 1110 ADAS_CANTRACE_EventInfo36 "ADAS_CANTRACE_EventInfo36";
CM_ SG_ 1110 ADAS_CANTRACE_EventInfo37 "ADAS_CANTRACE_EventInfo37";
CM_ SG_ 1110 ADAS_CANTRACE_EventInfo38 "ADAS_CANTRACE_EventInfo38";
CM_ SG_ 1110 ADAS_CANTRACE_EventInfo39 "ADAS_CANTRACE_EventInfo39";
CM_ SG_ 1110 ADAS_CANTRACE_EventInfo40 "ADAS_CANTRACE_EventInfo40";
CM_ SG_ 1110 ADAS_CANTRACE_EventInfo41 "ADAS_CANTRACE_EventInfo41";
CM_ SG_ 1110 ADAS_CANTRACE_EventInfo42 "ADAS_CANTRACE_EventInfo42";
CM_ SG_ 1110 ADAS_CANTRACE_EventInfo43 "ADAS_CANTRACE_EventInfo43";
CM_ SG_ 1110 ADAS_CANTRACE_EventInfo44 "ADAS_CANTRACE_EventInfo44";
CM_ SG_ 1110 ADAS_CANTRACE_EventInfo45 "ADAS_CANTRACE_EventInfo45";
CM_ SG_ 1110 ADAS_CANTRACE_EventInfo46 "ADAS_CANTRACE_EventInfo46";
CM_ SG_ 1110 ADAS_CANTRACE_EventInfo47 "ADAS_CANTRACE_EventInfo47";
CM_ SG_ 1110 ADAS_CANTRACE_EventInfo48 "ADAS_CANTRACE_EventInfo48";
CM_ SG_ 1110 ADAS_CANTRACE_EventInfo49 "ADAS_CANTRACE_EventInfo49";
CM_ SG_ 1110 ADAS_CANTRACE_EventInfo50 "ADAS_CANTRACE_EventInfo50";
CM_ SG_ 1110 ADAS_CANTRACE_EventInfo51 "ADAS_CANTRACE_EventInfo51";
CM_ SG_ 1110 ADAS_CANTRACE_EventInfo52 "ADAS_CANTRACE_EventInfo52";
CM_ SG_ 1110 ADAS_CANTRACE_EventInfo53 "ADAS_CANTRACE_EventInfo53";
CM_ SG_ 1110 ADAS_CANTRACE_EventInfo54 "ADAS_CANTRACE_EventInfo54";
CM_ SG_ 1110 ADAS_CANTRACE_EventInfo55 "ADAS_CANTRACE_EventInfo55";
CM_ SG_ 1110 ADAS_CANTRACE_EventInfo56 "ADAS_CANTRACE_EventInfo56";
CM_ SG_ 1110 ADAS_CANTRACE_EventInfo57 "ADAS_CANTRACE_EventInfo57";
CM_ SG_ 1110 ADAS_CANTRACE_EventInfo58 "ADAS_CANTRACE_EventInfo58";
CM_ SG_ 1110 ADAS_CANTRACE_EventInfo59 "ADAS_CANTRACE_EventInfo59";
CM_ SG_ 1110 ADAS_CANTRACE_EventInfo60 "ADAS_CANTRACE_EventInfo60";
CM_ SG_ 1110 ADAS_CANTRACE_EventInfo61 "ADAS_CANTRACE_EventInfo61";
CM_ SG_ 1111 ADAS_CANTRACE_AlarmPktType "ADAS_CANTRACE_AlarmPktType";
CM_ SG_ 1111 ADAS_CANTRACE_AlarmPktCount "ADAS_CANTRACE_AlarmPktCount";
CM_ SG_ 1111 ADAS_CANTRACE_AlarmNum "ADAS_CANTRACE_AlarmNum";
CM_ SG_ 1111 ADAS_CANTRACE_AlarmFaultId0 "ADAS_CANTRACE_AlarmFaultId0";
CM_ SG_ 1111 ADAS_CANTRACE_AlarmKeyPara0 "ADAS_CANTRACE_AlarmKeyPara0";
CM_ SG_ 1111 ADAS_CANTRACE_AlarmFaultId1 "ADAS_CANTRACE_AlarmFaultId1";
CM_ SG_ 1111 ADAS_CANTRACE_AlarmKeyPara1 "ADAS_CANTRACE_AlarmKeyPara1";
CM_ SG_ 1111 ADAS_CANTRACE_AlarmFaultId2 "ADAS_CANTRACE_AlarmFaultId2";
CM_ SG_ 1111 ADAS_CANTRACE_AlarmKeyPara2 "ADAS_CANTRACE_AlarmKeyPara2";
CM_ SG_ 1111 ADAS_CANTRACE_AlarmFaultId3 "ADAS_CANTRACE_AlarmFaultId3";
CM_ SG_ 1111 ADAS_CANTRACE_AlarmKeyPara3 "ADAS_CANTRACE_AlarmKeyPara3";
CM_ SG_ 1111 ADAS_CANTRACE_AlarmFaultId4 "ADAS_CANTRACE_AlarmFaultId4";
CM_ SG_ 1111 ADAS_CANTRACE_AlarmKeyPara4 "ADAS_CANTRACE_AlarmKeyPara4";
CM_ SG_ 1111 ADAS_CANTRACE_AlarmFaultId5 "ADAS_CANTRACE_AlarmFaultId5";
CM_ SG_ 1111 ADAS_CANTRACE_AlarmKeyPara5 "ADAS_CANTRACE_AlarmKeyPara5";
CM_ SG_ 1111 ADAS_CANTRACE_AlarmFaultId6 "ADAS_CANTRACE_AlarmFaultId6";
CM_ SG_ 1111 ADAS_CANTRACE_AlarmKeyPara6 "ADAS_CANTRACE_AlarmKeyPara6";
CM_ SG_ 1111 ADAS_CANTRACE_AlarmFaultId7 "ADAS_CANTRACE_AlarmFaultId7";
CM_ SG_ 1111 ADAS_CANTRACE_AlarmKeyPara7 "ADAS_CANTRACE_AlarmKeyPara7";
CM_ SG_ 1111 ADAS_CANTRACE_AlarmFaultId8 "ADAS_CANTRACE_AlarmFaultId8";
CM_ SG_ 1111 ADAS_CANTRACE_AlarmKeyPara8 "ADAS_CANTRACE_AlarmKeyPara8";
CM_ SG_ 1111 ADAS_CANTRACE_AlarmFaultId9 "ADAS_CANTRACE_AlarmFaultId9";
CM_ SG_ 1111 ADAS_CANTRACE_AlarmKeyPara9 "ADAS_CANTRACE_AlarmKeyPara9";
CM_ SG_ 1111 ADAS_CANTRACE_AlarmFaultId10 "ADAS_CANTRACE_AlarmFaultId10";
CM_ SG_ 1111 ADAS_CANTRACE_AlarmKeyPara10 "ADAS_CANTRACE_AlarmKeyPara10";
CM_ SG_ 1111 ADAS_CANTRACE_AlarmFaultId11 "ADAS_CANTRACE_AlarmFaultId11";
CM_ SG_ 1111 ADAS_CANTRACE_AlarmKeyPara11 "ADAS_CANTRACE_AlarmKeyPara11";
CM_ SG_ 1111 ADAS_CANTRACE_AlarmFaultId12 "ADAS_CANTRACE_AlarmFaultId12";
CM_ SG_ 1111 ADAS_CANTRACE_AlarmKeyPara12 "ADAS_CANTRACE_AlarmKeyPara12";
CM_ SG_ 1111 ADAS_CANTRACE_AlarmFaultId13 "ADAS_CANTRACE_AlarmFaultId13";
CM_ SG_ 1111 ADAS_CANTRACE_AlarmKeyPara13 "ADAS_CANTRACE_AlarmKeyPara13";
CM_ SG_ 1111 ADAS_CANTRACE_AlarmFaultId14 "ADAS_CANTRACE_AlarmFaultId14";
CM_ SG_ 1111 ADAS_CANTRACE_AlarmKeyPara14 "ADAS_CANTRACE_AlarmKeyPara14";
CM_ SG_ 1111 ADAS_CANTRACE_AlarmRsv "ADAS_CANTRACE_AlarmRsv";
CM_ SG_ 365 ADC_19_CRC "E2E Profile 5 CRC";
CM_ SG_ 365 ADC_19_Counter "E2E Profile 5 Counter";
CM_ SG_ 365 ADC_Obj02_ID "ADC Adb Object2 ID";
CM_ SG_ 365 ADC_Obj03Dist "ADC Object3 Distance";
CM_ SG_ 365 ADC_Obj03HoztAngSpd "ADC Object3 Horizontal Angle Speed";
CM_ SG_ 365 ADC_Obj03LeftAngle "ADC Object3 Left Angle";
CM_ SG_ 365 ADC_Obj03RightAngle "ADC Object3 Right Angle";
CM_ SG_ 365 ADC_Obj03BottomAngle "ADC Object3 Bottom Angle";
CM_ SG_ 365 ADC_Obj03TopAngle "ADC Object3 Top Angle";
CM_ SG_ 365 ADC_Obj04_ID "ADC Adb Object4 ID";
CM_ SG_ 365 ADC_Obj01_ID "ADC Adb Object1 ID";
CM_ SG_ 365 ADC_Obj04Dist "ADC Object4 Distance";
CM_ SG_ 365 ADC_Obj04HoztAngSpd "ADC Object4 Horizontal Angle Speed";
CM_ SG_ 365 ADC_Obj04LeftAngle "ADC Object4 Left Angle";
CM_ SG_ 365 ADC_Obj04RightAngle "ADC Object4 Right Angle";
CM_ SG_ 365 ADC_Obj04BottomAngle "ADC Object4 Bottom Angle";
CM_ SG_ 365 ADC_Obj04TopAngle "ADC Object4 Top Angle";
CM_ SG_ 365 ADC_Obj03_ID "ADC Adb Object3 ID";
CM_ SG_ 365 ADC_Obj06_ID "ADC Adb Object6 ID";
CM_ SG_ 365 ADC_Obj01Dist "ADC Object1 Distance";
CM_ SG_ 365 ADC_Obj01HoztAngSpd "ADC Object1 Horizontal Angle Speed";
CM_ SG_ 365 ADC_Obj01LeftAngle "ADC Object1 Left Angle";
CM_ SG_ 365 ADC_Obj01RightAngle "ADC Object1 Right Angle";
CM_ SG_ 365 ADC_Obj01BottomAngle "ADC Object1 Bottom Angle";
CM_ SG_ 365 ADC_Obj01TopAngle "ADC Object1 Top Angle";
CM_ SG_ 365 ADC_Obj05Dist "ADC Object5 Distance";
CM_ SG_ 365 ADC_Obj05HoztAngSpd "ADC Object5 Horizontal Angle Speed";
CM_ SG_ 365 ADC_Obj05LeftAngle "ADC Object5 Left Angle";
CM_ SG_ 365 ADC_Obj05RightAngle "ADC Object5 Right Angle";
CM_ SG_ 365 ADC_Obj05BottomAngle "ADC Object5 Bottom Angle";
CM_ SG_ 365 ADC_Obj05TopAngle "ADC Object5 Top Angle";
CM_ SG_ 365 ADC_Obj06Dist "ADC Object6 Distance";
CM_ SG_ 365 ADC_Obj06HoztAngSpd "ADC Object6 Horizontal Angle Speed";
CM_ SG_ 365 ADC_Obj06LeftAngle "ADC Object6 Left Angle";
CM_ SG_ 365 ADC_Obj06RightAngle "ADC Object6 Right Angle";
CM_ SG_ 365 ADC_Obj06BottomAngle "ADC Object6 Bottom Angle";
CM_ SG_ 365 ADC_Obj02Dist "ADC Object2 Distance";
CM_ SG_ 365 ADC_Obj02HoztAngSpd "ADC Object2 Horizontal Angle Speed";
CM_ SG_ 365 ADC_Obj02LeftAngle "ADC Object2 Left Angle";
CM_ SG_ 365 ADC_Obj02RightAngle "ADC Object2 Right Angle";
CM_ SG_ 365 ADC_Obj02BottomAngle "ADC Object2 Bottom Angle";
CM_ SG_ 365 ADC_Obj02TopAngle "ADC Object2 Top Angle";
CM_ SG_ 365 ADC_Obj06TopAngle "ADC Object6 Top Angle";
CM_ SG_ 365 ADC_Obj07Dist "ADC Object7 Distance";
CM_ SG_ 365 ADC_Obj07HoztAngSpd "ADC Object7 Horizontal Angle Speed";
CM_ SG_ 365 ADC_Obj07LeftAngle "ADC Object7 Left Angle";
CM_ SG_ 365 ADC_Obj07BottomAngle "ADC Object7 Bottom Angle";
CM_ SG_ 365 ADC_Obj05_ID "ADC Adb Object5 ID";
CM_ SG_ 365 ADC_Obj04Typ "ADC Object4 Classification";
CM_ SG_ 365 ADC_Obj04Dir "ADC Object4 Direction";
CM_ SG_ 365 ADC_ADBCamSt "ADC Camera Status";
CM_ SG_ 365 ADC_Obj03Dir "ADC Object3 Direction";
CM_ SG_ 365 ADC_Obj02Dir "ADC Object2 Direction";
CM_ SG_ 365 ADC_Obj02Typ "ADC Object2 Classification";
CM_ SG_ 365 ADC_Obj03Typ "ADC Object3 Classification";
CM_ SG_ 365 ADC_Obj01Typ "ADC Object1 Classification";
CM_ SG_ 365 ADC_Obj01Dir "ADC Object1 Direction";
CM_ SG_ 365 ADC_ObjNum "ADC Object Number";
CM_ SG_ 365 ADC_AmbLightCondition "ADC Ambient Light Condition";
CM_ SG_ 365 ADC_TrafficStyle "ADC Object Traffic Style";
CM_ SG_ 365 ADC_Obj05Typ "ADC Object5 Classification";
CM_ SG_ 365 ADC_Obj05Dir "ADC Object5 Direction";
CM_ SG_ 365 ADC_Obj06Typ "ADC Object6 Classification";
CM_ SG_ 365 ADC_Obj06Dir "ADC Object6 Direction";
CM_ SG_ 365 ADC_Obj07_ID "ADC Adb Object7 ID";
CM_ SG_ 365 ADC_Obj07Typ "ADC Object7 Classification";
CM_ SG_ 365 ADC_Obj07Dir "ADC Object7 Direction";
CM_ SG_ 366 ADC_20_CRC "E2E Profile 5 CRC";
CM_ SG_ 366 ADC_20_Counter "E2E Profile 5 Counter";
CM_ SG_ 366 ADC_Obj07RightAngle "ADC Object7 Right Angle";
CM_ SG_ 366 ADC_Obj07TopAngle "ADC Object7 Top Angle";
CM_ SG_ 366 ADC_Obj08_ID "ADC Adb Object8 ID";
CM_ SG_ 366 ADC_Obj08Typ "ADC Object8 Classification";
CM_ SG_ 366 ADC_Obj08Dir "ADC Object8 Direction";
CM_ SG_ 366 ADC_Obj08Dist "ADC Object8 Distance";
CM_ SG_ 366 ADC_Obj08HoztAngSpd "ADC Object8 Horizontal Angle Speed";
CM_ SG_ 366 ADC_Obj08LeftAngle "ADC Object8 Left Angle";
CM_ SG_ 366 ADC_Obj08RightAngle "ADC Object8 Right Angle";
CM_ SG_ 366 ADC_Obj08BottomAngle "ADC Object8 Bottom Angle";
CM_ SG_ 366 ADC_Obj08TopAngle "ADC Object8 Top Angle";
CM_ SG_ 366 ADC_Obj09_ID "ADC Adb Object9 ID";
CM_ SG_ 366 ADC_Obj09Typ "ADC Object9 Classification";
CM_ SG_ 366 ADC_Obj09Dir "ADC Object9 Direction";
CM_ SG_ 366 ADC_Obj09Dist "ADC Object9 Distance";
CM_ SG_ 366 ADC_Obj09HoztAngSpd "ADC Object9 Horizontal Angle Speed";
CM_ SG_ 366 ADC_Obj09LeftAngle "ADC Object9 Left Angle";
CM_ SG_ 366 ADC_Obj09RightAngle "ADC Object9 Right Angle";
CM_ SG_ 366 ADC_Obj09BottomAngle "ADC Object9 Bottom Angle";
CM_ SG_ 366 ADC_Obj09TopAngle "ADC Object9 Top Angle";
CM_ SG_ 366 ADC_Obj010_ID "ADC Adb Object10 ID";
CM_ SG_ 366 ADC_Obj010Typ "ADC Object10 Classification";
CM_ SG_ 366 ADC_Obj010Dir "ADC Object10 Direction";
CM_ SG_ 366 ADC_Obj010Dist "ADC Object10 Distance";
CM_ SG_ 366 ADC_Obj010HoztAngSpd "ADC Object10 Horizontal Angle Speed";
CM_ SG_ 366 ADC_Obj010LeftAngle "ADC Object10 Left Angle";
CM_ SG_ 366 ADC_Obj010RightAngle "ADC Object10 Right Angle";
CM_ SG_ 366 ADC_Obj010BottomAngle "ADC Object10 Bottom Angle";
CM_ SG_ 366 ADC_Obj010TopAngle "ADC Object10 Top Angle";

BA_DEF_ BO_  "GenMsgCycleTime" INT 0 0;
BA_DEF_ BO_  "GenMsgCycleTimeFast" INT 0 0;
BA_DEF_ BO_  "GenMsgSendType" ENUM  "Periodic","Event","IfActive","POE","PA","FixedPeriodic","Event","EnabledPeriodic","NotUsed","NotUsed","EventPeriodic","NotUsed","NotUsed","NoMsgSendType";
BA_DEF_ BO_  "VFrameFormat" ENUM  "StandardCAN","ExtendedCAN","reserved","reserved","reserved","reserved","reserved","reserved","reserved","reserved","reserved","reserved","reserved","reserved","StandardCAN_FD","ExtendedCAN_FD";
BA_DEF_ BO_  "CANFD_BRS" ENUM  "0","1";
BA_DEF_ SG_  "EventCommandSignal" ENUM  "No","Yes";
BA_DEF_ SG_  "GatewayedSignals" ENUM  "No","Yes";
BA_DEF_ SG_  "GenSigInactiveValue" HEX 0 0;
BA_DEF_ SG_  "GenSigInvalidValue" HEX 0 0;
BA_DEF_ SG_  "GenSigSendType" ENUM  "Trigger","Passive","Cyclic","OnWrite","OnWriteWithRepetition","OnChange","OnChangeWithRepetition","IfActive","IfActiveWithRepetition","NoSigSendType";
BA_DEF_ SG_  "GenSigStartValue" HEX 0 0;
BA_DEF_ SG_  "GenSigTimeoutValue" HEX 0 0;
BA_DEF_ SG_  "Remark" STRING ;
BA_ "GenMsgCycleTime" BO_ 971 100;
BA_ "GenMsgCycleTimeFast" BO_ 971 0;
BA_ "GenMsgSendType" BO_ 971 0;
BA_ "VFrameFormat" BO_ 971 14;
BA_ "CANFD_BRS" BO_ 971 1;
BA_ "GenMsgCycleTime" BO_ 971 100;
BA_ "GenMsgCycleTimeFast" BO_ 971 0;
BA_ "GenMsgSendType" BO_ 971 0;
BA_ "VFrameFormat" BO_ 971 14;
BA_ "CANFD_BRS" BO_ 971 1;
BA_ "GenMsgCycleTime" BO_ 971 100;
BA_ "GenMsgCycleTimeFast" BO_ 971 0;
BA_ "GenMsgSendType" BO_ 971 0;
BA_ "VFrameFormat" BO_ 971 14;
BA_ "CANFD_BRS" BO_ 971 1;
BA_ "GenMsgCycleTime" BO_ 971 100;
BA_ "GenMsgCycleTimeFast" BO_ 971 0;
BA_ "GenMsgSendType" BO_ 971 0;
BA_ "VFrameFormat" BO_ 971 14;
BA_ "CANFD_BRS" BO_ 971 1;
BA_ "GenMsgCycleTime" BO_ 971 100;
BA_ "GenMsgCycleTimeFast" BO_ 971 0;
BA_ "GenMsgSendType" BO_ 971 0;
BA_ "VFrameFormat" BO_ 971 14;
BA_ "CANFD_BRS" BO_ 971 1;
BA_ "GenMsgCycleTime" BO_ 971 100;
BA_ "GenMsgCycleTimeFast" BO_ 971 0;
BA_ "GenMsgSendType" BO_ 971 0;
BA_ "VFrameFormat" BO_ 971 14;
BA_ "CANFD_BRS" BO_ 971 1;
BA_ "GenMsgCycleTime" BO_ 971 100;
BA_ "GenMsgCycleTimeFast" BO_ 971 0;
BA_ "GenMsgSendType" BO_ 971 0;
BA_ "VFrameFormat" BO_ 971 14;
BA_ "CANFD_BRS" BO_ 971 1;
BA_ "GenMsgCycleTime" BO_ 971 100;
BA_ "GenMsgCycleTimeFast" BO_ 971 0;
BA_ "GenMsgSendType" BO_ 971 0;
BA_ "VFrameFormat" BO_ 971 14;
BA_ "CANFD_BRS" BO_ 971 1;
BA_ "GenMsgCycleTime" BO_ 971 100;
BA_ "GenMsgCycleTimeFast" BO_ 971 0;
BA_ "GenMsgSendType" BO_ 971 0;
BA_ "VFrameFormat" BO_ 971 14;
BA_ "CANFD_BRS" BO_ 971 1;
BA_ "GenMsgCycleTime" BO_ 971 100;
BA_ "GenMsgCycleTimeFast" BO_ 971 0;
BA_ "GenMsgSendType" BO_ 971 0;
BA_ "VFrameFormat" BO_ 971 14;
BA_ "CANFD_BRS" BO_ 971 1;
BA_ "GenMsgCycleTime" BO_ 971 100;
BA_ "GenMsgCycleTimeFast" BO_ 971 0;
BA_ "GenMsgSendType" BO_ 971 0;
BA_ "VFrameFormat" BO_ 971 14;
BA_ "CANFD_BRS" BO_ 971 1;
BA_ "GenMsgCycleTime" BO_ 971 100;
BA_ "GenMsgCycleTimeFast" BO_ 971 0;
BA_ "GenMsgSendType" BO_ 971 0;
BA_ "VFrameFormat" BO_ 971 14;
BA_ "CANFD_BRS" BO_ 971 1;
BA_ "GenMsgCycleTime" BO_ 971 100;
BA_ "GenMsgCycleTimeFast" BO_ 971 0;
BA_ "GenMsgSendType" BO_ 971 0;
BA_ "VFrameFormat" BO_ 971 14;
BA_ "CANFD_BRS" BO_ 971 1;
BA_ "GenMsgCycleTime" BO_ 971 100;
BA_ "GenMsgCycleTimeFast" BO_ 971 0;
BA_ "GenMsgSendType" BO_ 971 0;
BA_ "VFrameFormat" BO_ 971 14;
BA_ "CANFD_BRS" BO_ 971 1;
BA_ "GenMsgCycleTime" BO_ 971 100;
BA_ "GenMsgCycleTimeFast" BO_ 971 0;
BA_ "GenMsgSendType" BO_ 971 0;
BA_ "VFrameFormat" BO_ 971 14;
BA_ "CANFD_BRS" BO_ 971 1;
BA_ "GenMsgCycleTime" BO_ 971 100;
BA_ "GenMsgCycleTimeFast" BO_ 971 0;
BA_ "GenMsgSendType" BO_ 971 0;
BA_ "VFrameFormat" BO_ 971 14;
BA_ "CANFD_BRS" BO_ 971 1;
BA_ "GenMsgCycleTime" BO_ 971 100;
BA_ "GenMsgCycleTimeFast" BO_ 971 0;
BA_ "GenMsgSendType" BO_ 971 0;
BA_ "VFrameFormat" BO_ 971 14;
BA_ "CANFD_BRS" BO_ 971 1;
BA_ "GenMsgCycleTime" BO_ 971 100;
BA_ "GenMsgCycleTimeFast" BO_ 971 0;
BA_ "GenMsgSendType" BO_ 971 0;
BA_ "VFrameFormat" BO_ 971 14;
BA_ "CANFD_BRS" BO_ 971 1;
BA_ "GenMsgCycleTime" BO_ 971 100;
BA_ "GenMsgCycleTimeFast" BO_ 971 0;
BA_ "GenMsgSendType" BO_ 971 0;
BA_ "VFrameFormat" BO_ 971 14;
BA_ "CANFD_BRS" BO_ 971 1;
BA_ "GenMsgCycleTime" BO_ 971 100;
BA_ "GenMsgCycleTimeFast" BO_ 971 0;
BA_ "GenMsgSendType" BO_ 971 0;
BA_ "VFrameFormat" BO_ 971 14;
BA_ "CANFD_BRS" BO_ 971 1;
BA_ "GenMsgCycleTime" BO_ 971 100;
BA_ "GenMsgCycleTimeFast" BO_ 971 0;
BA_ "GenMsgSendType" BO_ 971 0;
BA_ "VFrameFormat" BO_ 971 14;
BA_ "CANFD_BRS" BO_ 971 1;
BA_ "GenMsgCycleTime" BO_ 971 100;
BA_ "GenMsgCycleTimeFast" BO_ 971 0;
BA_ "GenMsgSendType" BO_ 971 0;
BA_ "VFrameFormat" BO_ 971 14;
BA_ "CANFD_BRS" BO_ 971 1;
BA_ "GenMsgCycleTime" BO_ 971 100;
BA_ "GenMsgCycleTimeFast" BO_ 971 0;
BA_ "GenMsgSendType" BO_ 971 0;
BA_ "VFrameFormat" BO_ 971 14;
BA_ "CANFD_BRS" BO_ 971 1;
BA_ "GenMsgCycleTime" BO_ 971 100;
BA_ "GenMsgCycleTimeFast" BO_ 971 0;
BA_ "GenMsgSendType" BO_ 971 0;
BA_ "VFrameFormat" BO_ 971 14;
BA_ "CANFD_BRS" BO_ 971 1;
BA_ "GenMsgCycleTime" BO_ 971 100;
BA_ "GenMsgCycleTimeFast" BO_ 971 0;
BA_ "GenMsgSendType" BO_ 971 0;
BA_ "VFrameFormat" BO_ 971 14;
BA_ "CANFD_BRS" BO_ 971 1;
BA_ "GenMsgCycleTime" BO_ 971 100;
BA_ "GenMsgCycleTimeFast" BO_ 971 0;
BA_ "GenMsgSendType" BO_ 971 0;
BA_ "VFrameFormat" BO_ 971 14;
BA_ "CANFD_BRS" BO_ 971 1;
BA_ "GenMsgCycleTime" BO_ 971 100;
BA_ "GenMsgCycleTimeFast" BO_ 971 0;
BA_ "GenMsgSendType" BO_ 971 0;
BA_ "VFrameFormat" BO_ 971 14;
BA_ "CANFD_BRS" BO_ 971 1;
BA_ "GenMsgCycleTime" BO_ 971 100;
BA_ "GenMsgCycleTimeFast" BO_ 971 0;
BA_ "GenMsgSendType" BO_ 971 0;
BA_ "VFrameFormat" BO_ 971 14;
BA_ "CANFD_BRS" BO_ 971 1;
BA_ "GenMsgCycleTime" BO_ 971 100;
BA_ "GenMsgCycleTimeFast" BO_ 971 0;
BA_ "GenMsgSendType" BO_ 971 0;
BA_ "VFrameFormat" BO_ 971 14;
BA_ "CANFD_BRS" BO_ 971 1;
BA_ "GenMsgCycleTime" BO_ 971 100;
BA_ "GenMsgCycleTimeFast" BO_ 971 0;
BA_ "GenMsgSendType" BO_ 971 0;
BA_ "VFrameFormat" BO_ 971 14;
BA_ "CANFD_BRS" BO_ 971 1;
BA_ "GenMsgCycleTime" BO_ 971 100;
BA_ "GenMsgCycleTimeFast" BO_ 971 0;
BA_ "GenMsgSendType" BO_ 971 0;
BA_ "VFrameFormat" BO_ 971 14;
BA_ "CANFD_BRS" BO_ 971 1;
BA_ "GenMsgCycleTime" BO_ 971 100;
BA_ "GenMsgCycleTimeFast" BO_ 971 0;
BA_ "GenMsgSendType" BO_ 971 0;
BA_ "VFrameFormat" BO_ 971 14;
BA_ "CANFD_BRS" BO_ 971 1;
BA_ "GenMsgCycleTime" BO_ 971 100;
BA_ "GenMsgCycleTimeFast" BO_ 971 0;
BA_ "GenMsgSendType" BO_ 971 0;
BA_ "VFrameFormat" BO_ 971 14;
BA_ "CANFD_BRS" BO_ 971 1;
BA_ "GenMsgCycleTime" BO_ 971 100;
BA_ "GenMsgCycleTimeFast" BO_ 971 0;
BA_ "GenMsgSendType" BO_ 971 0;
BA_ "VFrameFormat" BO_ 971 14;
BA_ "CANFD_BRS" BO_ 971 1;
BA_ "GenMsgCycleTime" BO_ 971 100;
BA_ "GenMsgCycleTimeFast" BO_ 971 0;
BA_ "GenMsgSendType" BO_ 971 0;
BA_ "VFrameFormat" BO_ 971 14;
BA_ "CANFD_BRS" BO_ 971 1;
BA_ "GenMsgCycleTime" BO_ 971 100;
BA_ "GenMsgCycleTimeFast" BO_ 971 0;
BA_ "GenMsgSendType" BO_ 971 0;
BA_ "VFrameFormat" BO_ 971 14;
BA_ "CANFD_BRS" BO_ 971 1;
BA_ "GenMsgCycleTime" BO_ 971 100;
BA_ "GenMsgCycleTimeFast" BO_ 971 0;
BA_ "GenMsgSendType" BO_ 971 0;
BA_ "VFrameFormat" BO_ 971 14;
BA_ "CANFD_BRS" BO_ 971 1;
BA_ "GenMsgCycleTime" BO_ 971 100;
BA_ "GenMsgCycleTimeFast" BO_ 971 0;
BA_ "GenMsgSendType" BO_ 971 0;
BA_ "VFrameFormat" BO_ 971 14;
BA_ "CANFD_BRS" BO_ 971 1;
BA_ "GenMsgCycleTime" BO_ 971 100;
BA_ "GenMsgCycleTimeFast" BO_ 971 0;
BA_ "GenMsgSendType" BO_ 971 0;
BA_ "VFrameFormat" BO_ 971 14;
BA_ "CANFD_BRS" BO_ 971 1;
BA_ "GenMsgCycleTime" BO_ 971 100;
BA_ "GenMsgCycleTimeFast" BO_ 971 0;
BA_ "GenMsgSendType" BO_ 971 0;
BA_ "VFrameFormat" BO_ 971 14;
BA_ "CANFD_BRS" BO_ 971 1;
BA_ "GenMsgCycleTime" BO_ 971 100;
BA_ "GenMsgCycleTimeFast" BO_ 971 0;
BA_ "GenMsgSendType" BO_ 971 0;
BA_ "VFrameFormat" BO_ 971 14;
BA_ "CANFD_BRS" BO_ 971 1;
BA_ "GenMsgCycleTime" BO_ 971 100;
BA_ "GenMsgCycleTimeFast" BO_ 971 0;
BA_ "GenMsgSendType" BO_ 971 0;
BA_ "VFrameFormat" BO_ 971 14;
BA_ "CANFD_BRS" BO_ 971 1;
BA_ "GenMsgCycleTime" BO_ 971 100;
BA_ "GenMsgCycleTimeFast" BO_ 971 0;
BA_ "GenMsgSendType" BO_ 971 0;
BA_ "VFrameFormat" BO_ 971 14;
BA_ "CANFD_BRS" BO_ 971 1;
BA_ "GenMsgCycleTime" BO_ 971 100;
BA_ "GenMsgCycleTimeFast" BO_ 971 0;
BA_ "GenMsgSendType" BO_ 971 0;
BA_ "VFrameFormat" BO_ 971 14;
BA_ "CANFD_BRS" BO_ 971 1;
BA_ "GenMsgCycleTime" BO_ 971 100;
BA_ "GenMsgCycleTimeFast" BO_ 971 0;
BA_ "GenMsgSendType" BO_ 971 0;
BA_ "VFrameFormat" BO_ 971 14;
BA_ "CANFD_BRS" BO_ 971 1;
BA_ "GenMsgCycleTime" BO_ 971 100;
BA_ "GenMsgCycleTimeFast" BO_ 971 0;
BA_ "GenMsgSendType" BO_ 971 0;
BA_ "VFrameFormat" BO_ 971 14;
BA_ "CANFD_BRS" BO_ 971 1;
BA_ "GenMsgCycleTime" BO_ 971 100;
BA_ "GenMsgCycleTimeFast" BO_ 971 0;
BA_ "GenMsgSendType" BO_ 971 0;
BA_ "VFrameFormat" BO_ 971 14;
BA_ "CANFD_BRS" BO_ 971 1;
BA_ "GenMsgCycleTime" BO_ 971 100;
BA_ "GenMsgCycleTimeFast" BO_ 971 0;
BA_ "GenMsgSendType" BO_ 971 0;
BA_ "VFrameFormat" BO_ 971 14;
BA_ "CANFD_BRS" BO_ 971 1;
BA_ "GenMsgCycleTime" BO_ 1110 1000;
BA_ "GenMsgCycleTimeFast" BO_ 1110 0;
BA_ "GenMsgSendType" BO_ 1110 0;
BA_ "VFrameFormat" BO_ 1110 14;
BA_ "CANFD_BRS" BO_ 1110 1;
BA_ "GenMsgCycleTime" BO_ 1110 1000;
BA_ "GenMsgCycleTimeFast" BO_ 1110 0;
BA_ "GenMsgSendType" BO_ 1110 0;
BA_ "VFrameFormat" BO_ 1110 14;
BA_ "CANFD_BRS" BO_ 1110 1;
BA_ "GenMsgCycleTime" BO_ 1110 1000;
BA_ "GenMsgCycleTimeFast" BO_ 1110 0;
BA_ "GenMsgSendType" BO_ 1110 0;
BA_ "VFrameFormat" BO_ 1110 14;
BA_ "CANFD_BRS" BO_ 1110 1;
BA_ "GenMsgCycleTime" BO_ 1110 1000;
BA_ "GenMsgCycleTimeFast" BO_ 1110 0;
BA_ "GenMsgSendType" BO_ 1110 0;
BA_ "VFrameFormat" BO_ 1110 14;
BA_ "CANFD_BRS" BO_ 1110 1;
BA_ "GenMsgCycleTime" BO_ 1110 1000;
BA_ "GenMsgCycleTimeFast" BO_ 1110 0;
BA_ "GenMsgSendType" BO_ 1110 0;
BA_ "VFrameFormat" BO_ 1110 14;
BA_ "CANFD_BRS" BO_ 1110 1;
BA_ "GenMsgCycleTime" BO_ 1110 1000;
BA_ "GenMsgCycleTimeFast" BO_ 1110 0;
BA_ "GenMsgSendType" BO_ 1110 0;
BA_ "VFrameFormat" BO_ 1110 14;
BA_ "CANFD_BRS" BO_ 1110 1;
BA_ "GenMsgCycleTime" BO_ 1110 1000;
BA_ "GenMsgCycleTimeFast" BO_ 1110 0;
BA_ "GenMsgSendType" BO_ 1110 0;
BA_ "VFrameFormat" BO_ 1110 14;
BA_ "CANFD_BRS" BO_ 1110 1;
BA_ "GenMsgCycleTime" BO_ 1110 1000;
BA_ "GenMsgCycleTimeFast" BO_ 1110 0;
BA_ "GenMsgSendType" BO_ 1110 0;
BA_ "VFrameFormat" BO_ 1110 14;
BA_ "CANFD_BRS" BO_ 1110 1;
BA_ "GenMsgCycleTime" BO_ 1110 1000;
BA_ "GenMsgCycleTimeFast" BO_ 1110 0;
BA_ "GenMsgSendType" BO_ 1110 0;
BA_ "VFrameFormat" BO_ 1110 14;
BA_ "CANFD_BRS" BO_ 1110 1;
BA_ "GenMsgCycleTime" BO_ 1110 1000;
BA_ "GenMsgCycleTimeFast" BO_ 1110 0;
BA_ "GenMsgSendType" BO_ 1110 0;
BA_ "VFrameFormat" BO_ 1110 14;
BA_ "CANFD_BRS" BO_ 1110 1;
BA_ "GenMsgCycleTime" BO_ 1110 1000;
BA_ "GenMsgCycleTimeFast" BO_ 1110 0;
BA_ "GenMsgSendType" BO_ 1110 0;
BA_ "VFrameFormat" BO_ 1110 14;
BA_ "CANFD_BRS" BO_ 1110 1;
BA_ "GenMsgCycleTime" BO_ 1110 1000;
BA_ "GenMsgCycleTimeFast" BO_ 1110 0;
BA_ "GenMsgSendType" BO_ 1110 0;
BA_ "VFrameFormat" BO_ 1110 14;
BA_ "CANFD_BRS" BO_ 1110 1;
BA_ "GenMsgCycleTime" BO_ 1110 1000;
BA_ "GenMsgCycleTimeFast" BO_ 1110 0;
BA_ "GenMsgSendType" BO_ 1110 0;
BA_ "VFrameFormat" BO_ 1110 14;
BA_ "CANFD_BRS" BO_ 1110 1;
BA_ "GenMsgCycleTime" BO_ 1110 1000;
BA_ "GenMsgCycleTimeFast" BO_ 1110 0;
BA_ "GenMsgSendType" BO_ 1110 0;
BA_ "VFrameFormat" BO_ 1110 14;
BA_ "CANFD_BRS" BO_ 1110 1;
BA_ "GenMsgCycleTime" BO_ 1110 1000;
BA_ "GenMsgCycleTimeFast" BO_ 1110 0;
BA_ "GenMsgSendType" BO_ 1110 0;
BA_ "VFrameFormat" BO_ 1110 14;
BA_ "CANFD_BRS" BO_ 1110 1;
BA_ "GenMsgCycleTime" BO_ 1110 1000;
BA_ "GenMsgCycleTimeFast" BO_ 1110 0;
BA_ "GenMsgSendType" BO_ 1110 0;
BA_ "VFrameFormat" BO_ 1110 14;
BA_ "CANFD_BRS" BO_ 1110 1;
BA_ "GenMsgCycleTime" BO_ 1110 1000;
BA_ "GenMsgCycleTimeFast" BO_ 1110 0;
BA_ "GenMsgSendType" BO_ 1110 0;
BA_ "VFrameFormat" BO_ 1110 14;
BA_ "CANFD_BRS" BO_ 1110 1;
BA_ "GenMsgCycleTime" BO_ 1110 1000;
BA_ "GenMsgCycleTimeFast" BO_ 1110 0;
BA_ "GenMsgSendType" BO_ 1110 0;
BA_ "VFrameFormat" BO_ 1110 14;
BA_ "CANFD_BRS" BO_ 1110 1;
BA_ "GenMsgCycleTime" BO_ 1110 1000;
BA_ "GenMsgCycleTimeFast" BO_ 1110 0;
BA_ "GenMsgSendType" BO_ 1110 0;
BA_ "VFrameFormat" BO_ 1110 14;
BA_ "CANFD_BRS" BO_ 1110 1;
BA_ "GenMsgCycleTime" BO_ 1110 1000;
BA_ "GenMsgCycleTimeFast" BO_ 1110 0;
BA_ "GenMsgSendType" BO_ 1110 0;
BA_ "VFrameFormat" BO_ 1110 14;
BA_ "CANFD_BRS" BO_ 1110 1;
BA_ "GenMsgCycleTime" BO_ 1110 1000;
BA_ "GenMsgCycleTimeFast" BO_ 1110 0;
BA_ "GenMsgSendType" BO_ 1110 0;
BA_ "VFrameFormat" BO_ 1110 14;
BA_ "CANFD_BRS" BO_ 1110 1;
BA_ "GenMsgCycleTime" BO_ 1110 1000;
BA_ "GenMsgCycleTimeFast" BO_ 1110 0;
BA_ "GenMsgSendType" BO_ 1110 0;
BA_ "VFrameFormat" BO_ 1110 14;
BA_ "CANFD_BRS" BO_ 1110 1;
BA_ "GenMsgCycleTime" BO_ 1110 1000;
BA_ "GenMsgCycleTimeFast" BO_ 1110 0;
BA_ "GenMsgSendType" BO_ 1110 0;
BA_ "VFrameFormat" BO_ 1110 14;
BA_ "CANFD_BRS" BO_ 1110 1;
BA_ "GenMsgCycleTime" BO_ 1110 1000;
BA_ "GenMsgCycleTimeFast" BO_ 1110 0;
BA_ "GenMsgSendType" BO_ 1110 0;
BA_ "VFrameFormat" BO_ 1110 14;
BA_ "CANFD_BRS" BO_ 1110 1;
BA_ "GenMsgCycleTime" BO_ 1110 1000;
BA_ "GenMsgCycleTimeFast" BO_ 1110 0;
BA_ "GenMsgSendType" BO_ 1110 0;
BA_ "VFrameFormat" BO_ 1110 14;
BA_ "CANFD_BRS" BO_ 1110 1;
BA_ "GenMsgCycleTime" BO_ 1110 1000;
BA_ "GenMsgCycleTimeFast" BO_ 1110 0;
BA_ "GenMsgSendType" BO_ 1110 0;
BA_ "VFrameFormat" BO_ 1110 14;
BA_ "CANFD_BRS" BO_ 1110 1;
BA_ "GenMsgCycleTime" BO_ 1110 1000;
BA_ "GenMsgCycleTimeFast" BO_ 1110 0;
BA_ "GenMsgSendType" BO_ 1110 0;
BA_ "VFrameFormat" BO_ 1110 14;
BA_ "CANFD_BRS" BO_ 1110 1;
BA_ "GenMsgCycleTime" BO_ 1110 1000;
BA_ "GenMsgCycleTimeFast" BO_ 1110 0;
BA_ "GenMsgSendType" BO_ 1110 0;
BA_ "VFrameFormat" BO_ 1110 14;
BA_ "CANFD_BRS" BO_ 1110 1;
BA_ "GenMsgCycleTime" BO_ 1110 1000;
BA_ "GenMsgCycleTimeFast" BO_ 1110 0;
BA_ "GenMsgSendType" BO_ 1110 0;
BA_ "VFrameFormat" BO_ 1110 14;
BA_ "CANFD_BRS" BO_ 1110 1;
BA_ "GenMsgCycleTime" BO_ 1110 1000;
BA_ "GenMsgCycleTimeFast" BO_ 1110 0;
BA_ "GenMsgSendType" BO_ 1110 0;
BA_ "VFrameFormat" BO_ 1110 14;
BA_ "CANFD_BRS" BO_ 1110 1;
BA_ "GenMsgCycleTime" BO_ 1110 1000;
BA_ "GenMsgCycleTimeFast" BO_ 1110 0;
BA_ "GenMsgSendType" BO_ 1110 0;
BA_ "VFrameFormat" BO_ 1110 14;
BA_ "CANFD_BRS" BO_ 1110 1;
BA_ "GenMsgCycleTime" BO_ 1110 1000;
BA_ "GenMsgCycleTimeFast" BO_ 1110 0;
BA_ "GenMsgSendType" BO_ 1110 0;
BA_ "VFrameFormat" BO_ 1110 14;
BA_ "CANFD_BRS" BO_ 1110 1;
BA_ "GenMsgCycleTime" BO_ 1110 1000;
BA_ "GenMsgCycleTimeFast" BO_ 1110 0;
BA_ "GenMsgSendType" BO_ 1110 0;
BA_ "VFrameFormat" BO_ 1110 14;
BA_ "CANFD_BRS" BO_ 1110 1;
BA_ "GenMsgCycleTime" BO_ 1110 1000;
BA_ "GenMsgCycleTimeFast" BO_ 1110 0;
BA_ "GenMsgSendType" BO_ 1110 0;
BA_ "VFrameFormat" BO_ 1110 14;
BA_ "CANFD_BRS" BO_ 1110 1;
BA_ "GenMsgCycleTime" BO_ 1110 1000;
BA_ "GenMsgCycleTimeFast" BO_ 1110 0;
BA_ "GenMsgSendType" BO_ 1110 0;
BA_ "VFrameFormat" BO_ 1110 14;
BA_ "CANFD_BRS" BO_ 1110 1;
BA_ "GenMsgCycleTime" BO_ 1110 1000;
BA_ "GenMsgCycleTimeFast" BO_ 1110 0;
BA_ "GenMsgSendType" BO_ 1110 0;
BA_ "VFrameFormat" BO_ 1110 14;
BA_ "CANFD_BRS" BO_ 1110 1;
BA_ "GenMsgCycleTime" BO_ 1110 1000;
BA_ "GenMsgCycleTimeFast" BO_ 1110 0;
BA_ "GenMsgSendType" BO_ 1110 0;
BA_ "VFrameFormat" BO_ 1110 14;
BA_ "CANFD_BRS" BO_ 1110 1;
BA_ "GenMsgCycleTime" BO_ 1110 1000;
BA_ "GenMsgCycleTimeFast" BO_ 1110 0;
BA_ "GenMsgSendType" BO_ 1110 0;
BA_ "VFrameFormat" BO_ 1110 14;
BA_ "CANFD_BRS" BO_ 1110 1;
BA_ "GenMsgCycleTime" BO_ 1110 1000;
BA_ "GenMsgCycleTimeFast" BO_ 1110 0;
BA_ "GenMsgSendType" BO_ 1110 0;
BA_ "VFrameFormat" BO_ 1110 14;
BA_ "CANFD_BRS" BO_ 1110 1;
BA_ "GenMsgCycleTime" BO_ 1110 1000;
BA_ "GenMsgCycleTimeFast" BO_ 1110 0;
BA_ "GenMsgSendType" BO_ 1110 0;
BA_ "VFrameFormat" BO_ 1110 14;
BA_ "CANFD_BRS" BO_ 1110 1;
BA_ "GenMsgCycleTime" BO_ 1110 1000;
BA_ "GenMsgCycleTimeFast" BO_ 1110 0;
BA_ "GenMsgSendType" BO_ 1110 0;
BA_ "VFrameFormat" BO_ 1110 14;
BA_ "CANFD_BRS" BO_ 1110 1;
BA_ "GenMsgCycleTime" BO_ 1110 1000;
BA_ "GenMsgCycleTimeFast" BO_ 1110 0;
BA_ "GenMsgSendType" BO_ 1110 0;
BA_ "VFrameFormat" BO_ 1110 14;
BA_ "CANFD_BRS" BO_ 1110 1;
BA_ "GenMsgCycleTime" BO_ 1110 1000;
BA_ "GenMsgCycleTimeFast" BO_ 1110 0;
BA_ "GenMsgSendType" BO_ 1110 0;
BA_ "VFrameFormat" BO_ 1110 14;
BA_ "CANFD_BRS" BO_ 1110 1;
BA_ "GenMsgCycleTime" BO_ 1110 1000;
BA_ "GenMsgCycleTimeFast" BO_ 1110 0;
BA_ "GenMsgSendType" BO_ 1110 0;
BA_ "VFrameFormat" BO_ 1110 14;
BA_ "CANFD_BRS" BO_ 1110 1;
BA_ "GenMsgCycleTime" BO_ 1110 1000;
BA_ "GenMsgCycleTimeFast" BO_ 1110 0;
BA_ "GenMsgSendType" BO_ 1110 0;
BA_ "VFrameFormat" BO_ 1110 14;
BA_ "CANFD_BRS" BO_ 1110 1;
BA_ "GenMsgCycleTime" BO_ 1110 1000;
BA_ "GenMsgCycleTimeFast" BO_ 1110 0;
BA_ "GenMsgSendType" BO_ 1110 0;
BA_ "VFrameFormat" BO_ 1110 14;
BA_ "CANFD_BRS" BO_ 1110 1;
BA_ "GenMsgCycleTime" BO_ 1110 1000;
BA_ "GenMsgCycleTimeFast" BO_ 1110 0;
BA_ "GenMsgSendType" BO_ 1110 0;
BA_ "VFrameFormat" BO_ 1110 14;
BA_ "CANFD_BRS" BO_ 1110 1;
BA_ "GenMsgCycleTime" BO_ 1110 1000;
BA_ "GenMsgCycleTimeFast" BO_ 1110 0;
BA_ "GenMsgSendType" BO_ 1110 0;
BA_ "VFrameFormat" BO_ 1110 14;
BA_ "CANFD_BRS" BO_ 1110 1;
BA_ "GenMsgCycleTime" BO_ 1110 1000;
BA_ "GenMsgCycleTimeFast" BO_ 1110 0;
BA_ "GenMsgSendType" BO_ 1110 0;
BA_ "VFrameFormat" BO_ 1110 14;
BA_ "CANFD_BRS" BO_ 1110 1;
BA_ "GenMsgCycleTime" BO_ 1110 1000;
BA_ "GenMsgCycleTimeFast" BO_ 1110 0;
BA_ "GenMsgSendType" BO_ 1110 0;
BA_ "VFrameFormat" BO_ 1110 14;
BA_ "CANFD_BRS" BO_ 1110 1;
BA_ "GenMsgCycleTime" BO_ 1110 1000;
BA_ "GenMsgCycleTimeFast" BO_ 1110 0;
BA_ "GenMsgSendType" BO_ 1110 0;
BA_ "VFrameFormat" BO_ 1110 14;
BA_ "CANFD_BRS" BO_ 1110 1;
BA_ "GenMsgCycleTime" BO_ 1110 1000;
BA_ "GenMsgCycleTimeFast" BO_ 1110 0;
BA_ "GenMsgSendType" BO_ 1110 0;
BA_ "VFrameFormat" BO_ 1110 14;
BA_ "CANFD_BRS" BO_ 1110 1;
BA_ "GenMsgCycleTime" BO_ 1110 1000;
BA_ "GenMsgCycleTimeFast" BO_ 1110 0;
BA_ "GenMsgSendType" BO_ 1110 0;
BA_ "VFrameFormat" BO_ 1110 14;
BA_ "CANFD_BRS" BO_ 1110 1;
BA_ "GenMsgCycleTime" BO_ 1110 1000;
BA_ "GenMsgCycleTimeFast" BO_ 1110 0;
BA_ "GenMsgSendType" BO_ 1110 0;
BA_ "VFrameFormat" BO_ 1110 14;
BA_ "CANFD_BRS" BO_ 1110 1;
BA_ "GenMsgCycleTime" BO_ 1110 1000;
BA_ "GenMsgCycleTimeFast" BO_ 1110 0;
BA_ "GenMsgSendType" BO_ 1110 0;
BA_ "VFrameFormat" BO_ 1110 14;
BA_ "CANFD_BRS" BO_ 1110 1;
BA_ "GenMsgCycleTime" BO_ 1110 1000;
BA_ "GenMsgCycleTimeFast" BO_ 1110 0;
BA_ "GenMsgSendType" BO_ 1110 0;
BA_ "VFrameFormat" BO_ 1110 14;
BA_ "CANFD_BRS" BO_ 1110 1;
BA_ "GenMsgCycleTime" BO_ 1110 1000;
BA_ "GenMsgCycleTimeFast" BO_ 1110 0;
BA_ "GenMsgSendType" BO_ 1110 0;
BA_ "VFrameFormat" BO_ 1110 14;
BA_ "CANFD_BRS" BO_ 1110 1;
BA_ "GenMsgCycleTime" BO_ 1110 1000;
BA_ "GenMsgCycleTimeFast" BO_ 1110 0;
BA_ "GenMsgSendType" BO_ 1110 0;
BA_ "VFrameFormat" BO_ 1110 14;
BA_ "CANFD_BRS" BO_ 1110 1;
BA_ "GenMsgCycleTime" BO_ 1110 1000;
BA_ "GenMsgCycleTimeFast" BO_ 1110 0;
BA_ "GenMsgSendType" BO_ 1110 0;
BA_ "VFrameFormat" BO_ 1110 14;
BA_ "CANFD_BRS" BO_ 1110 1;
BA_ "GenMsgCycleTime" BO_ 1110 1000;
BA_ "GenMsgCycleTimeFast" BO_ 1110 0;
BA_ "GenMsgSendType" BO_ 1110 0;
BA_ "VFrameFormat" BO_ 1110 14;
BA_ "CANFD_BRS" BO_ 1110 1;
BA_ "GenMsgCycleTime" BO_ 1110 1000;
BA_ "GenMsgCycleTimeFast" BO_ 1110 0;
BA_ "GenMsgSendType" BO_ 1110 0;
BA_ "VFrameFormat" BO_ 1110 14;
BA_ "CANFD_BRS" BO_ 1110 1;
BA_ "GenMsgCycleTime" BO_ 1110 1000;
BA_ "GenMsgCycleTimeFast" BO_ 1110 0;
BA_ "GenMsgSendType" BO_ 1110 0;
BA_ "VFrameFormat" BO_ 1110 14;
BA_ "CANFD_BRS" BO_ 1110 1;
BA_ "GenMsgCycleTime" BO_ 1110 1000;
BA_ "GenMsgCycleTimeFast" BO_ 1110 0;
BA_ "GenMsgSendType" BO_ 1110 0;
BA_ "VFrameFormat" BO_ 1110 14;
BA_ "CANFD_BRS" BO_ 1110 1;
BA_ "GenMsgCycleTime" BO_ 1110 1000;
BA_ "GenMsgCycleTimeFast" BO_ 1110 0;
BA_ "GenMsgSendType" BO_ 1110 0;
BA_ "VFrameFormat" BO_ 1110 14;
BA_ "CANFD_BRS" BO_ 1110 1;
BA_ "GenMsgCycleTime" BO_ 1111 1000;
BA_ "GenMsgCycleTimeFast" BO_ 1111 0;
BA_ "GenMsgSendType" BO_ 1111 0;
BA_ "VFrameFormat" BO_ 1111 14;
BA_ "CANFD_BRS" BO_ 1111 1;
BA_ "GenMsgCycleTime" BO_ 1111 1000;
BA_ "GenMsgCycleTimeFast" BO_ 1111 0;
BA_ "GenMsgSendType" BO_ 1111 0;
BA_ "VFrameFormat" BO_ 1111 14;
BA_ "CANFD_BRS" BO_ 1111 1;
BA_ "GenMsgCycleTime" BO_ 1111 1000;
BA_ "GenMsgCycleTimeFast" BO_ 1111 0;
BA_ "GenMsgSendType" BO_ 1111 0;
BA_ "VFrameFormat" BO_ 1111 14;
BA_ "CANFD_BRS" BO_ 1111 1;
BA_ "GenMsgCycleTime" BO_ 1111 1000;
BA_ "GenMsgCycleTimeFast" BO_ 1111 0;
BA_ "GenMsgSendType" BO_ 1111 0;
BA_ "VFrameFormat" BO_ 1111 14;
BA_ "CANFD_BRS" BO_ 1111 1;
BA_ "GenMsgCycleTime" BO_ 1111 1000;
BA_ "GenMsgCycleTimeFast" BO_ 1111 0;
BA_ "GenMsgSendType" BO_ 1111 0;
BA_ "VFrameFormat" BO_ 1111 14;
BA_ "CANFD_BRS" BO_ 1111 1;
BA_ "GenMsgCycleTime" BO_ 1111 1000;
BA_ "GenMsgCycleTimeFast" BO_ 1111 0;
BA_ "GenMsgSendType" BO_ 1111 0;
BA_ "VFrameFormat" BO_ 1111 14;
BA_ "CANFD_BRS" BO_ 1111 1;
BA_ "GenMsgCycleTime" BO_ 1111 1000;
BA_ "GenMsgCycleTimeFast" BO_ 1111 0;
BA_ "GenMsgSendType" BO_ 1111 0;
BA_ "VFrameFormat" BO_ 1111 14;
BA_ "CANFD_BRS" BO_ 1111 1;
BA_ "GenMsgCycleTime" BO_ 1111 1000;
BA_ "GenMsgCycleTimeFast" BO_ 1111 0;
BA_ "GenMsgSendType" BO_ 1111 0;
BA_ "VFrameFormat" BO_ 1111 14;
BA_ "CANFD_BRS" BO_ 1111 1;
BA_ "GenMsgCycleTime" BO_ 1111 1000;
BA_ "GenMsgCycleTimeFast" BO_ 1111 0;
BA_ "GenMsgSendType" BO_ 1111 0;
BA_ "VFrameFormat" BO_ 1111 14;
BA_ "CANFD_BRS" BO_ 1111 1;
BA_ "GenMsgCycleTime" BO_ 1111 1000;
BA_ "GenMsgCycleTimeFast" BO_ 1111 0;
BA_ "GenMsgSendType" BO_ 1111 0;
BA_ "VFrameFormat" BO_ 1111 14;
BA_ "CANFD_BRS" BO_ 1111 1;
BA_ "GenMsgCycleTime" BO_ 1111 1000;
BA_ "GenMsgCycleTimeFast" BO_ 1111 0;
BA_ "GenMsgSendType" BO_ 1111 0;
BA_ "VFrameFormat" BO_ 1111 14;
BA_ "CANFD_BRS" BO_ 1111 1;
BA_ "GenMsgCycleTime" BO_ 1111 1000;
BA_ "GenMsgCycleTimeFast" BO_ 1111 0;
BA_ "GenMsgSendType" BO_ 1111 0;
BA_ "VFrameFormat" BO_ 1111 14;
BA_ "CANFD_BRS" BO_ 1111 1;
BA_ "GenMsgCycleTime" BO_ 1111 1000;
BA_ "GenMsgCycleTimeFast" BO_ 1111 0;
BA_ "GenMsgSendType" BO_ 1111 0;
BA_ "VFrameFormat" BO_ 1111 14;
BA_ "CANFD_BRS" BO_ 1111 1;
BA_ "GenMsgCycleTime" BO_ 1111 1000;
BA_ "GenMsgCycleTimeFast" BO_ 1111 0;
BA_ "GenMsgSendType" BO_ 1111 0;
BA_ "VFrameFormat" BO_ 1111 14;
BA_ "CANFD_BRS" BO_ 1111 1;
BA_ "GenMsgCycleTime" BO_ 1111 1000;
BA_ "GenMsgCycleTimeFast" BO_ 1111 0;
BA_ "GenMsgSendType" BO_ 1111 0;
BA_ "VFrameFormat" BO_ 1111 14;
BA_ "CANFD_BRS" BO_ 1111 1;
BA_ "GenMsgCycleTime" BO_ 1111 1000;
BA_ "GenMsgCycleTimeFast" BO_ 1111 0;
BA_ "GenMsgSendType" BO_ 1111 0;
BA_ "VFrameFormat" BO_ 1111 14;
BA_ "CANFD_BRS" BO_ 1111 1;
BA_ "GenMsgCycleTime" BO_ 1111 1000;
BA_ "GenMsgCycleTimeFast" BO_ 1111 0;
BA_ "GenMsgSendType" BO_ 1111 0;
BA_ "VFrameFormat" BO_ 1111 14;
BA_ "CANFD_BRS" BO_ 1111 1;
BA_ "GenMsgCycleTime" BO_ 1111 1000;
BA_ "GenMsgCycleTimeFast" BO_ 1111 0;
BA_ "GenMsgSendType" BO_ 1111 0;
BA_ "VFrameFormat" BO_ 1111 14;
BA_ "CANFD_BRS" BO_ 1111 1;
BA_ "GenMsgCycleTime" BO_ 1111 1000;
BA_ "GenMsgCycleTimeFast" BO_ 1111 0;
BA_ "GenMsgSendType" BO_ 1111 0;
BA_ "VFrameFormat" BO_ 1111 14;
BA_ "CANFD_BRS" BO_ 1111 1;
BA_ "GenMsgCycleTime" BO_ 1111 1000;
BA_ "GenMsgCycleTimeFast" BO_ 1111 0;
BA_ "GenMsgSendType" BO_ 1111 0;
BA_ "VFrameFormat" BO_ 1111 14;
BA_ "CANFD_BRS" BO_ 1111 1;
BA_ "GenMsgCycleTime" BO_ 1111 1000;
BA_ "GenMsgCycleTimeFast" BO_ 1111 0;
BA_ "GenMsgSendType" BO_ 1111 0;
BA_ "VFrameFormat" BO_ 1111 14;
BA_ "CANFD_BRS" BO_ 1111 1;
BA_ "GenMsgCycleTime" BO_ 1111 1000;
BA_ "GenMsgCycleTimeFast" BO_ 1111 0;
BA_ "GenMsgSendType" BO_ 1111 0;
BA_ "VFrameFormat" BO_ 1111 14;
BA_ "CANFD_BRS" BO_ 1111 1;
BA_ "GenMsgCycleTime" BO_ 1111 1000;
BA_ "GenMsgCycleTimeFast" BO_ 1111 0;
BA_ "GenMsgSendType" BO_ 1111 0;
BA_ "VFrameFormat" BO_ 1111 14;
BA_ "CANFD_BRS" BO_ 1111 1;
BA_ "GenMsgCycleTime" BO_ 1111 1000;
BA_ "GenMsgCycleTimeFast" BO_ 1111 0;
BA_ "GenMsgSendType" BO_ 1111 0;
BA_ "VFrameFormat" BO_ 1111 14;
BA_ "CANFD_BRS" BO_ 1111 1;
BA_ "GenMsgCycleTime" BO_ 1111 1000;
BA_ "GenMsgCycleTimeFast" BO_ 1111 0;
BA_ "GenMsgSendType" BO_ 1111 0;
BA_ "VFrameFormat" BO_ 1111 14;
BA_ "CANFD_BRS" BO_ 1111 1;
BA_ "GenMsgCycleTime" BO_ 1111 1000;
BA_ "GenMsgCycleTimeFast" BO_ 1111 0;
BA_ "GenMsgSendType" BO_ 1111 0;
BA_ "VFrameFormat" BO_ 1111 14;
BA_ "CANFD_BRS" BO_ 1111 1;
BA_ "GenMsgCycleTime" BO_ 1111 1000;
BA_ "GenMsgCycleTimeFast" BO_ 1111 0;
BA_ "GenMsgSendType" BO_ 1111 0;
BA_ "VFrameFormat" BO_ 1111 14;
BA_ "CANFD_BRS" BO_ 1111 1;
BA_ "GenMsgCycleTime" BO_ 1111 1000;
BA_ "GenMsgCycleTimeFast" BO_ 1111 0;
BA_ "GenMsgSendType" BO_ 1111 0;
BA_ "VFrameFormat" BO_ 1111 14;
BA_ "CANFD_BRS" BO_ 1111 1;
BA_ "GenMsgCycleTime" BO_ 1111 1000;
BA_ "GenMsgCycleTimeFast" BO_ 1111 0;
BA_ "GenMsgSendType" BO_ 1111 0;
BA_ "VFrameFormat" BO_ 1111 14;
BA_ "CANFD_BRS" BO_ 1111 1;
BA_ "GenMsgCycleTime" BO_ 1111 1000;
BA_ "GenMsgCycleTimeFast" BO_ 1111 0;
BA_ "GenMsgSendType" BO_ 1111 0;
BA_ "VFrameFormat" BO_ 1111 14;
BA_ "CANFD_BRS" BO_ 1111 1;
BA_ "GenMsgCycleTime" BO_ 1111 1000;
BA_ "GenMsgCycleTimeFast" BO_ 1111 0;
BA_ "GenMsgSendType" BO_ 1111 0;
BA_ "VFrameFormat" BO_ 1111 14;
BA_ "CANFD_BRS" BO_ 1111 1;
BA_ "GenMsgCycleTime" BO_ 1111 1000;
BA_ "GenMsgCycleTimeFast" BO_ 1111 0;
BA_ "GenMsgSendType" BO_ 1111 0;
BA_ "VFrameFormat" BO_ 1111 14;
BA_ "CANFD_BRS" BO_ 1111 1;
BA_ "GenMsgCycleTime" BO_ 1111 1000;
BA_ "GenMsgCycleTimeFast" BO_ 1111 0;
BA_ "GenMsgSendType" BO_ 1111 0;
BA_ "VFrameFormat" BO_ 1111 14;
BA_ "CANFD_BRS" BO_ 1111 1;
BA_ "GenMsgCycleTime" BO_ 1111 1000;
BA_ "GenMsgCycleTimeFast" BO_ 1111 0;
BA_ "GenMsgSendType" BO_ 1111 0;
BA_ "VFrameFormat" BO_ 1111 14;
BA_ "CANFD_BRS" BO_ 1111 1;
BA_ "GenMsgCycleTime" BO_ 365 40;
BA_ "GenMsgCycleTimeFast" BO_ 365 0;
BA_ "GenMsgSendType" BO_ 365 0;
BA_ "VFrameFormat" BO_ 365 14;
BA_ "CANFD_BRS" BO_ 365 1;
BA_ "GenMsgCycleTime" BO_ 365 40;
BA_ "GenMsgCycleTimeFast" BO_ 365 0;
BA_ "GenMsgSendType" BO_ 365 0;
BA_ "VFrameFormat" BO_ 365 14;
BA_ "CANFD_BRS" BO_ 365 1;
BA_ "GenMsgCycleTime" BO_ 365 40;
BA_ "GenMsgCycleTimeFast" BO_ 365 0;
BA_ "GenMsgSendType" BO_ 365 0;
BA_ "VFrameFormat" BO_ 365 14;
BA_ "CANFD_BRS" BO_ 365 1;
BA_ "GenMsgCycleTime" BO_ 365 40;
BA_ "GenMsgCycleTimeFast" BO_ 365 0;
BA_ "GenMsgSendType" BO_ 365 0;
BA_ "VFrameFormat" BO_ 365 14;
BA_ "CANFD_BRS" BO_ 365 1;
BA_ "GenMsgCycleTime" BO_ 365 40;
BA_ "GenMsgCycleTimeFast" BO_ 365 0;
BA_ "GenMsgSendType" BO_ 365 0;
BA_ "VFrameFormat" BO_ 365 14;
BA_ "CANFD_BRS" BO_ 365 1;
BA_ "GenMsgCycleTime" BO_ 365 40;
BA_ "GenMsgCycleTimeFast" BO_ 365 0;
BA_ "GenMsgSendType" BO_ 365 0;
BA_ "VFrameFormat" BO_ 365 14;
BA_ "CANFD_BRS" BO_ 365 1;
BA_ "GenMsgCycleTime" BO_ 365 40;
BA_ "GenMsgCycleTimeFast" BO_ 365 0;
BA_ "GenMsgSendType" BO_ 365 0;
BA_ "VFrameFormat" BO_ 365 14;
BA_ "CANFD_BRS" BO_ 365 1;
BA_ "GenMsgCycleTime" BO_ 365 40;
BA_ "GenMsgCycleTimeFast" BO_ 365 0;
BA_ "GenMsgSendType" BO_ 365 0;
BA_ "VFrameFormat" BO_ 365 14;
BA_ "CANFD_BRS" BO_ 365 1;
BA_ "GenMsgCycleTime" BO_ 365 40;
BA_ "GenMsgCycleTimeFast" BO_ 365 0;
BA_ "GenMsgSendType" BO_ 365 0;
BA_ "VFrameFormat" BO_ 365 14;
BA_ "CANFD_BRS" BO_ 365 1;
BA_ "GenMsgCycleTime" BO_ 365 40;
BA_ "GenMsgCycleTimeFast" BO_ 365 0;
BA_ "GenMsgSendType" BO_ 365 0;
BA_ "VFrameFormat" BO_ 365 14;
BA_ "CANFD_BRS" BO_ 365 1;
BA_ "GenMsgCycleTime" BO_ 365 40;
BA_ "GenMsgCycleTimeFast" BO_ 365 0;
BA_ "GenMsgSendType" BO_ 365 0;
BA_ "VFrameFormat" BO_ 365 14;
BA_ "CANFD_BRS" BO_ 365 1;
BA_ "GenMsgCycleTime" BO_ 365 40;
BA_ "GenMsgCycleTimeFast" BO_ 365 0;
BA_ "GenMsgSendType" BO_ 365 0;
BA_ "VFrameFormat" BO_ 365 14;
BA_ "CANFD_BRS" BO_ 365 1;
BA_ "GenMsgCycleTime" BO_ 365 40;
BA_ "GenMsgCycleTimeFast" BO_ 365 0;
BA_ "GenMsgSendType" BO_ 365 0;
BA_ "VFrameFormat" BO_ 365 14;
BA_ "CANFD_BRS" BO_ 365 1;
BA_ "GenMsgCycleTime" BO_ 365 40;
BA_ "GenMsgCycleTimeFast" BO_ 365 0;
BA_ "GenMsgSendType" BO_ 365 0;
BA_ "VFrameFormat" BO_ 365 14;
BA_ "CANFD_BRS" BO_ 365 1;
BA_ "GenMsgCycleTime" BO_ 365 40;
BA_ "GenMsgCycleTimeFast" BO_ 365 0;
BA_ "GenMsgSendType" BO_ 365 0;
BA_ "VFrameFormat" BO_ 365 14;
BA_ "CANFD_BRS" BO_ 365 1;
BA_ "GenMsgCycleTime" BO_ 365 40;
BA_ "GenMsgCycleTimeFast" BO_ 365 0;
BA_ "GenMsgSendType" BO_ 365 0;
BA_ "VFrameFormat" BO_ 365 14;
BA_ "CANFD_BRS" BO_ 365 1;
BA_ "GenMsgCycleTime" BO_ 365 40;
BA_ "GenMsgCycleTimeFast" BO_ 365 0;
BA_ "GenMsgSendType" BO_ 365 0;
BA_ "VFrameFormat" BO_ 365 14;
BA_ "CANFD_BRS" BO_ 365 1;
BA_ "GenMsgCycleTime" BO_ 365 40;
BA_ "GenMsgCycleTimeFast" BO_ 365 0;
BA_ "GenMsgSendType" BO_ 365 0;
BA_ "VFrameFormat" BO_ 365 14;
BA_ "CANFD_BRS" BO_ 365 1;
BA_ "GenMsgCycleTime" BO_ 365 40;
BA_ "GenMsgCycleTimeFast" BO_ 365 0;
BA_ "GenMsgSendType" BO_ 365 0;
BA_ "VFrameFormat" BO_ 365 14;
BA_ "CANFD_BRS" BO_ 365 1;
BA_ "GenMsgCycleTime" BO_ 365 40;
BA_ "GenMsgCycleTimeFast" BO_ 365 0;
BA_ "GenMsgSendType" BO_ 365 0;
BA_ "VFrameFormat" BO_ 365 14;
BA_ "CANFD_BRS" BO_ 365 1;
BA_ "GenMsgCycleTime" BO_ 365 40;
BA_ "GenMsgCycleTimeFast" BO_ 365 0;
BA_ "GenMsgSendType" BO_ 365 0;
BA_ "VFrameFormat" BO_ 365 14;
BA_ "CANFD_BRS" BO_ 365 1;
BA_ "GenMsgCycleTime" BO_ 365 40;
BA_ "GenMsgCycleTimeFast" BO_ 365 0;
BA_ "GenMsgSendType" BO_ 365 0;
BA_ "VFrameFormat" BO_ 365 14;
BA_ "CANFD_BRS" BO_ 365 1;
BA_ "GenMsgCycleTime" BO_ 365 40;
BA_ "GenMsgCycleTimeFast" BO_ 365 0;
BA_ "GenMsgSendType" BO_ 365 0;
BA_ "VFrameFormat" BO_ 365 14;
BA_ "CANFD_BRS" BO_ 365 1;
BA_ "GenMsgCycleTime" BO_ 365 40;
BA_ "GenMsgCycleTimeFast" BO_ 365 0;
BA_ "GenMsgSendType" BO_ 365 0;
BA_ "VFrameFormat" BO_ 365 14;
BA_ "CANFD_BRS" BO_ 365 1;
BA_ "GenMsgCycleTime" BO_ 365 40;
BA_ "GenMsgCycleTimeFast" BO_ 365 0;
BA_ "GenMsgSendType" BO_ 365 0;
BA_ "VFrameFormat" BO_ 365 14;
BA_ "CANFD_BRS" BO_ 365 1;
BA_ "GenMsgCycleTime" BO_ 365 40;
BA_ "GenMsgCycleTimeFast" BO_ 365 0;
BA_ "GenMsgSendType" BO_ 365 0;
BA_ "VFrameFormat" BO_ 365 14;
BA_ "CANFD_BRS" BO_ 365 1;
BA_ "GenMsgCycleTime" BO_ 365 40;
BA_ "GenMsgCycleTimeFast" BO_ 365 0;
BA_ "GenMsgSendType" BO_ 365 0;
BA_ "VFrameFormat" BO_ 365 14;
BA_ "CANFD_BRS" BO_ 365 1;
BA_ "GenMsgCycleTime" BO_ 365 40;
BA_ "GenMsgCycleTimeFast" BO_ 365 0;
BA_ "GenMsgSendType" BO_ 365 0;
BA_ "VFrameFormat" BO_ 365 14;
BA_ "CANFD_BRS" BO_ 365 1;
BA_ "GenMsgCycleTime" BO_ 365 40;
BA_ "GenMsgCycleTimeFast" BO_ 365 0;
BA_ "GenMsgSendType" BO_ 365 0;
BA_ "VFrameFormat" BO_ 365 14;
BA_ "CANFD_BRS" BO_ 365 1;
BA_ "GenMsgCycleTime" BO_ 365 40;
BA_ "GenMsgCycleTimeFast" BO_ 365 0;
BA_ "GenMsgSendType" BO_ 365 0;
BA_ "VFrameFormat" BO_ 365 14;
BA_ "CANFD_BRS" BO_ 365 1;
BA_ "GenMsgCycleTime" BO_ 365 40;
BA_ "GenMsgCycleTimeFast" BO_ 365 0;
BA_ "GenMsgSendType" BO_ 365 0;
BA_ "VFrameFormat" BO_ 365 14;
BA_ "CANFD_BRS" BO_ 365 1;
BA_ "GenMsgCycleTime" BO_ 365 40;
BA_ "GenMsgCycleTimeFast" BO_ 365 0;
BA_ "GenMsgSendType" BO_ 365 0;
BA_ "VFrameFormat" BO_ 365 14;
BA_ "CANFD_BRS" BO_ 365 1;
BA_ "GenMsgCycleTime" BO_ 365 40;
BA_ "GenMsgCycleTimeFast" BO_ 365 0;
BA_ "GenMsgSendType" BO_ 365 0;
BA_ "VFrameFormat" BO_ 365 14;
BA_ "CANFD_BRS" BO_ 365 1;
BA_ "GenMsgCycleTime" BO_ 365 40;
BA_ "GenMsgCycleTimeFast" BO_ 365 0;
BA_ "GenMsgSendType" BO_ 365 0;
BA_ "VFrameFormat" BO_ 365 14;
BA_ "CANFD_BRS" BO_ 365 1;
BA_ "GenMsgCycleTime" BO_ 365 40;
BA_ "GenMsgCycleTimeFast" BO_ 365 0;
BA_ "GenMsgSendType" BO_ 365 0;
BA_ "VFrameFormat" BO_ 365 14;
BA_ "CANFD_BRS" BO_ 365 1;
BA_ "GenMsgCycleTime" BO_ 365 40;
BA_ "GenMsgCycleTimeFast" BO_ 365 0;
BA_ "GenMsgSendType" BO_ 365 0;
BA_ "VFrameFormat" BO_ 365 14;
BA_ "CANFD_BRS" BO_ 365 1;
BA_ "GenMsgCycleTime" BO_ 365 40;
BA_ "GenMsgCycleTimeFast" BO_ 365 0;
BA_ "GenMsgSendType" BO_ 365 0;
BA_ "VFrameFormat" BO_ 365 14;
BA_ "CANFD_BRS" BO_ 365 1;
BA_ "GenMsgCycleTime" BO_ 365 40;
BA_ "GenMsgCycleTimeFast" BO_ 365 0;
BA_ "GenMsgSendType" BO_ 365 0;
BA_ "VFrameFormat" BO_ 365 14;
BA_ "CANFD_BRS" BO_ 365 1;
BA_ "GenMsgCycleTime" BO_ 365 40;
BA_ "GenMsgCycleTimeFast" BO_ 365 0;
BA_ "GenMsgSendType" BO_ 365 0;
BA_ "VFrameFormat" BO_ 365 14;
BA_ "CANFD_BRS" BO_ 365 1;
BA_ "GenMsgCycleTime" BO_ 365 40;
BA_ "GenMsgCycleTimeFast" BO_ 365 0;
BA_ "GenMsgSendType" BO_ 365 0;
BA_ "VFrameFormat" BO_ 365 14;
BA_ "CANFD_BRS" BO_ 365 1;
BA_ "GenMsgCycleTime" BO_ 365 40;
BA_ "GenMsgCycleTimeFast" BO_ 365 0;
BA_ "GenMsgSendType" BO_ 365 0;
BA_ "VFrameFormat" BO_ 365 14;
BA_ "CANFD_BRS" BO_ 365 1;
BA_ "GenMsgCycleTime" BO_ 365 40;
BA_ "GenMsgCycleTimeFast" BO_ 365 0;
BA_ "GenMsgSendType" BO_ 365 0;
BA_ "VFrameFormat" BO_ 365 14;
BA_ "CANFD_BRS" BO_ 365 1;
BA_ "GenMsgCycleTime" BO_ 365 40;
BA_ "GenMsgCycleTimeFast" BO_ 365 0;
BA_ "GenMsgSendType" BO_ 365 0;
BA_ "VFrameFormat" BO_ 365 14;
BA_ "CANFD_BRS" BO_ 365 1;
BA_ "GenMsgCycleTime" BO_ 365 40;
BA_ "GenMsgCycleTimeFast" BO_ 365 0;
BA_ "GenMsgSendType" BO_ 365 0;
BA_ "VFrameFormat" BO_ 365 14;
BA_ "CANFD_BRS" BO_ 365 1;
BA_ "GenMsgCycleTime" BO_ 365 40;
BA_ "GenMsgCycleTimeFast" BO_ 365 0;
BA_ "GenMsgSendType" BO_ 365 0;
BA_ "VFrameFormat" BO_ 365 14;
BA_ "CANFD_BRS" BO_ 365 1;
BA_ "GenMsgCycleTime" BO_ 365 40;
BA_ "GenMsgCycleTimeFast" BO_ 365 0;
BA_ "GenMsgSendType" BO_ 365 0;
BA_ "VFrameFormat" BO_ 365 14;
BA_ "CANFD_BRS" BO_ 365 1;
BA_ "GenMsgCycleTime" BO_ 365 40;
BA_ "GenMsgCycleTimeFast" BO_ 365 0;
BA_ "GenMsgSendType" BO_ 365 0;
BA_ "VFrameFormat" BO_ 365 14;
BA_ "CANFD_BRS" BO_ 365 1;
BA_ "GenMsgCycleTime" BO_ 365 40;
BA_ "GenMsgCycleTimeFast" BO_ 365 0;
BA_ "GenMsgSendType" BO_ 365 0;
BA_ "VFrameFormat" BO_ 365 14;
BA_ "CANFD_BRS" BO_ 365 1;
BA_ "GenMsgCycleTime" BO_ 365 40;
BA_ "GenMsgCycleTimeFast" BO_ 365 0;
BA_ "GenMsgSendType" BO_ 365 0;
BA_ "VFrameFormat" BO_ 365 14;
BA_ "CANFD_BRS" BO_ 365 1;
BA_ "GenMsgCycleTime" BO_ 365 40;
BA_ "GenMsgCycleTimeFast" BO_ 365 0;
BA_ "GenMsgSendType" BO_ 365 0;
BA_ "VFrameFormat" BO_ 365 14;
BA_ "CANFD_BRS" BO_ 365 1;
BA_ "GenMsgCycleTime" BO_ 365 40;
BA_ "GenMsgCycleTimeFast" BO_ 365 0;
BA_ "GenMsgSendType" BO_ 365 0;
BA_ "VFrameFormat" BO_ 365 14;
BA_ "CANFD_BRS" BO_ 365 1;
BA_ "GenMsgCycleTime" BO_ 365 40;
BA_ "GenMsgCycleTimeFast" BO_ 365 0;
BA_ "GenMsgSendType" BO_ 365 0;
BA_ "VFrameFormat" BO_ 365 14;
BA_ "CANFD_BRS" BO_ 365 1;
BA_ "GenMsgCycleTime" BO_ 365 40;
BA_ "GenMsgCycleTimeFast" BO_ 365 0;
BA_ "GenMsgSendType" BO_ 365 0;
BA_ "VFrameFormat" BO_ 365 14;
BA_ "CANFD_BRS" BO_ 365 1;
BA_ "GenMsgCycleTime" BO_ 365 40;
BA_ "GenMsgCycleTimeFast" BO_ 365 0;
BA_ "GenMsgSendType" BO_ 365 0;
BA_ "VFrameFormat" BO_ 365 14;
BA_ "CANFD_BRS" BO_ 365 1;
BA_ "GenMsgCycleTime" BO_ 365 40;
BA_ "GenMsgCycleTimeFast" BO_ 365 0;
BA_ "GenMsgSendType" BO_ 365 0;
BA_ "VFrameFormat" BO_ 365 14;
BA_ "CANFD_BRS" BO_ 365 1;
BA_ "GenMsgCycleTime" BO_ 365 40;
BA_ "GenMsgCycleTimeFast" BO_ 365 0;
BA_ "GenMsgSendType" BO_ 365 0;
BA_ "VFrameFormat" BO_ 365 14;
BA_ "CANFD_BRS" BO_ 365 1;
BA_ "GenMsgCycleTime" BO_ 365 40;
BA_ "GenMsgCycleTimeFast" BO_ 365 0;
BA_ "GenMsgSendType" BO_ 365 0;
BA_ "VFrameFormat" BO_ 365 14;
BA_ "CANFD_BRS" BO_ 365 1;
BA_ "GenMsgCycleTime" BO_ 365 40;
BA_ "GenMsgCycleTimeFast" BO_ 365 0;
BA_ "GenMsgSendType" BO_ 365 0;
BA_ "VFrameFormat" BO_ 365 14;
BA_ "CANFD_BRS" BO_ 365 1;
BA_ "GenMsgCycleTime" BO_ 365 40;
BA_ "GenMsgCycleTimeFast" BO_ 365 0;
BA_ "GenMsgSendType" BO_ 365 0;
BA_ "VFrameFormat" BO_ 365 14;
BA_ "CANFD_BRS" BO_ 365 1;
BA_ "GenMsgCycleTime" BO_ 365 40;
BA_ "GenMsgCycleTimeFast" BO_ 365 0;
BA_ "GenMsgSendType" BO_ 365 0;
BA_ "VFrameFormat" BO_ 365 14;
BA_ "CANFD_BRS" BO_ 365 1;
BA_ "GenMsgCycleTime" BO_ 365 40;
BA_ "GenMsgCycleTimeFast" BO_ 365 0;
BA_ "GenMsgSendType" BO_ 365 0;
BA_ "VFrameFormat" BO_ 365 14;
BA_ "CANFD_BRS" BO_ 365 1;
BA_ "GenMsgCycleTime" BO_ 365 40;
BA_ "GenMsgCycleTimeFast" BO_ 365 0;
BA_ "GenMsgSendType" BO_ 365 0;
BA_ "VFrameFormat" BO_ 365 14;
BA_ "CANFD_BRS" BO_ 365 1;
BA_ "GenMsgCycleTime" BO_ 365 40;
BA_ "GenMsgCycleTimeFast" BO_ 365 0;
BA_ "GenMsgSendType" BO_ 365 0;
BA_ "VFrameFormat" BO_ 365 14;
BA_ "CANFD_BRS" BO_ 365 1;
BA_ "GenMsgCycleTime" BO_ 365 40;
BA_ "GenMsgCycleTimeFast" BO_ 365 0;
BA_ "GenMsgSendType" BO_ 365 0;
BA_ "VFrameFormat" BO_ 365 14;
BA_ "CANFD_BRS" BO_ 365 1;
BA_ "GenMsgCycleTime" BO_ 365 40;
BA_ "GenMsgCycleTimeFast" BO_ 365 0;
BA_ "GenMsgSendType" BO_ 365 0;
BA_ "VFrameFormat" BO_ 365 14;
BA_ "CANFD_BRS" BO_ 365 1;
BA_ "GenMsgCycleTime" BO_ 365 40;
BA_ "GenMsgCycleTimeFast" BO_ 365 0;
BA_ "GenMsgSendType" BO_ 365 0;
BA_ "VFrameFormat" BO_ 365 14;
BA_ "CANFD_BRS" BO_ 365 1;
BA_ "GenMsgCycleTime" BO_ 365 40;
BA_ "GenMsgCycleTimeFast" BO_ 365 0;
BA_ "GenMsgSendType" BO_ 365 0;
BA_ "VFrameFormat" BO_ 365 14;
BA_ "CANFD_BRS" BO_ 365 1;
BA_ "GenMsgCycleTime" BO_ 366 40;
BA_ "GenMsgCycleTimeFast" BO_ 366 0;
BA_ "GenMsgSendType" BO_ 366 0;
BA_ "VFrameFormat" BO_ 366 14;
BA_ "CANFD_BRS" BO_ 366 1;
BA_ "GenMsgCycleTime" BO_ 366 40;
BA_ "GenMsgCycleTimeFast" BO_ 366 0;
BA_ "GenMsgSendType" BO_ 366 0;
BA_ "VFrameFormat" BO_ 366 14;
BA_ "CANFD_BRS" BO_ 366 1;
BA_ "GenMsgCycleTime" BO_ 366 40;
BA_ "GenMsgCycleTimeFast" BO_ 366 0;
BA_ "GenMsgSendType" BO_ 366 0;
BA_ "VFrameFormat" BO_ 366 14;
BA_ "CANFD_BRS" BO_ 366 1;
BA_ "GenMsgCycleTime" BO_ 366 40;
BA_ "GenMsgCycleTimeFast" BO_ 366 0;
BA_ "GenMsgSendType" BO_ 366 0;
BA_ "VFrameFormat" BO_ 366 14;
BA_ "CANFD_BRS" BO_ 366 1;
BA_ "GenMsgCycleTime" BO_ 366 40;
BA_ "GenMsgCycleTimeFast" BO_ 366 0;
BA_ "GenMsgSendType" BO_ 366 0;
BA_ "VFrameFormat" BO_ 366 14;
BA_ "CANFD_BRS" BO_ 366 1;
BA_ "GenMsgCycleTime" BO_ 366 40;
BA_ "GenMsgCycleTimeFast" BO_ 366 0;
BA_ "GenMsgSendType" BO_ 366 0;
BA_ "VFrameFormat" BO_ 366 14;
BA_ "CANFD_BRS" BO_ 366 1;
BA_ "GenMsgCycleTime" BO_ 366 40;
BA_ "GenMsgCycleTimeFast" BO_ 366 0;
BA_ "GenMsgSendType" BO_ 366 0;
BA_ "VFrameFormat" BO_ 366 14;
BA_ "CANFD_BRS" BO_ 366 1;
BA_ "GenMsgCycleTime" BO_ 366 40;
BA_ "GenMsgCycleTimeFast" BO_ 366 0;
BA_ "GenMsgSendType" BO_ 366 0;
BA_ "VFrameFormat" BO_ 366 14;
BA_ "CANFD_BRS" BO_ 366 1;
BA_ "GenMsgCycleTime" BO_ 366 40;
BA_ "GenMsgCycleTimeFast" BO_ 366 0;
BA_ "GenMsgSendType" BO_ 366 0;
BA_ "VFrameFormat" BO_ 366 14;
BA_ "CANFD_BRS" BO_ 366 1;
BA_ "GenMsgCycleTime" BO_ 366 40;
BA_ "GenMsgCycleTimeFast" BO_ 366 0;
BA_ "GenMsgSendType" BO_ 366 0;
BA_ "VFrameFormat" BO_ 366 14;
BA_ "CANFD_BRS" BO_ 366 1;
BA_ "GenMsgCycleTime" BO_ 366 40;
BA_ "GenMsgCycleTimeFast" BO_ 366 0;
BA_ "GenMsgSendType" BO_ 366 0;
BA_ "VFrameFormat" BO_ 366 14;
BA_ "CANFD_BRS" BO_ 366 1;
BA_ "GenMsgCycleTime" BO_ 366 40;
BA_ "GenMsgCycleTimeFast" BO_ 366 0;
BA_ "GenMsgSendType" BO_ 366 0;
BA_ "VFrameFormat" BO_ 366 14;
BA_ "CANFD_BRS" BO_ 366 1;
BA_ "GenMsgCycleTime" BO_ 366 40;
BA_ "GenMsgCycleTimeFast" BO_ 366 0;
BA_ "GenMsgSendType" BO_ 366 0;
BA_ "VFrameFormat" BO_ 366 14;
BA_ "CANFD_BRS" BO_ 366 1;
BA_ "GenMsgCycleTime" BO_ 366 40;
BA_ "GenMsgCycleTimeFast" BO_ 366 0;
BA_ "GenMsgSendType" BO_ 366 0;
BA_ "VFrameFormat" BO_ 366 14;
BA_ "CANFD_BRS" BO_ 366 1;
BA_ "GenMsgCycleTime" BO_ 366 40;
BA_ "GenMsgCycleTimeFast" BO_ 366 0;
BA_ "GenMsgSendType" BO_ 366 0;
BA_ "VFrameFormat" BO_ 366 14;
BA_ "CANFD_BRS" BO_ 366 1;
BA_ "GenMsgCycleTime" BO_ 366 40;
BA_ "GenMsgCycleTimeFast" BO_ 366 0;
BA_ "GenMsgSendType" BO_ 366 0;
BA_ "VFrameFormat" BO_ 366 14;
BA_ "CANFD_BRS" BO_ 366 1;
BA_ "GenMsgCycleTime" BO_ 366 40;
BA_ "GenMsgCycleTimeFast" BO_ 366 0;
BA_ "GenMsgSendType" BO_ 366 0;
BA_ "VFrameFormat" BO_ 366 14;
BA_ "CANFD_BRS" BO_ 366 1;
BA_ "GenMsgCycleTime" BO_ 366 40;
BA_ "GenMsgCycleTimeFast" BO_ 366 0;
BA_ "GenMsgSendType" BO_ 366 0;
BA_ "VFrameFormat" BO_ 366 14;
BA_ "CANFD_BRS" BO_ 366 1;
BA_ "GenMsgCycleTime" BO_ 366 40;
BA_ "GenMsgCycleTimeFast" BO_ 366 0;
BA_ "GenMsgSendType" BO_ 366 0;
BA_ "VFrameFormat" BO_ 366 14;
BA_ "CANFD_BRS" BO_ 366 1;
BA_ "GenMsgCycleTime" BO_ 366 40;
BA_ "GenMsgCycleTimeFast" BO_ 366 0;
BA_ "GenMsgSendType" BO_ 366 0;
BA_ "VFrameFormat" BO_ 366 14;
BA_ "CANFD_BRS" BO_ 366 1;
BA_ "GenMsgCycleTime" BO_ 366 40;
BA_ "GenMsgCycleTimeFast" BO_ 366 0;
BA_ "GenMsgSendType" BO_ 366 0;
BA_ "VFrameFormat" BO_ 366 14;
BA_ "CANFD_BRS" BO_ 366 1;
BA_ "GenMsgCycleTime" BO_ 366 40;
BA_ "GenMsgCycleTimeFast" BO_ 366 0;
BA_ "GenMsgSendType" BO_ 366 0;
BA_ "VFrameFormat" BO_ 366 14;
BA_ "CANFD_BRS" BO_ 366 1;
BA_ "GenMsgCycleTime" BO_ 366 40;
BA_ "GenMsgCycleTimeFast" BO_ 366 0;
BA_ "GenMsgSendType" BO_ 366 0;
BA_ "VFrameFormat" BO_ 366 14;
BA_ "CANFD_BRS" BO_ 366 1;
BA_ "GenMsgCycleTime" BO_ 366 40;
BA_ "GenMsgCycleTimeFast" BO_ 366 0;
BA_ "GenMsgSendType" BO_ 366 0;
BA_ "VFrameFormat" BO_ 366 14;
BA_ "CANFD_BRS" BO_ 366 1;
BA_ "GenMsgCycleTime" BO_ 366 40;
BA_ "GenMsgCycleTimeFast" BO_ 366 0;
BA_ "GenMsgSendType" BO_ 366 0;
BA_ "VFrameFormat" BO_ 366 14;
BA_ "CANFD_BRS" BO_ 366 1;
BA_ "GenMsgCycleTime" BO_ 366 40;
BA_ "GenMsgCycleTimeFast" BO_ 366 0;
BA_ "GenMsgSendType" BO_ 366 0;
BA_ "VFrameFormat" BO_ 366 14;
BA_ "CANFD_BRS" BO_ 366 1;
BA_ "GenMsgCycleTime" BO_ 366 40;
BA_ "GenMsgCycleTimeFast" BO_ 366 0;
BA_ "GenMsgSendType" BO_ 366 0;
BA_ "VFrameFormat" BO_ 366 14;
BA_ "CANFD_BRS" BO_ 366 1;
BA_ "GenMsgCycleTime" BO_ 366 40;
BA_ "GenMsgCycleTimeFast" BO_ 366 0;
BA_ "GenMsgSendType" BO_ 366 0;
BA_ "VFrameFormat" BO_ 366 14;
BA_ "CANFD_BRS" BO_ 366 1;
BA_ "GenMsgCycleTime" BO_ 366 40;
BA_ "GenMsgCycleTimeFast" BO_ 366 0;
BA_ "GenMsgSendType" BO_ 366 0;
BA_ "VFrameFormat" BO_ 366 14;
BA_ "CANFD_BRS" BO_ 366 1;
BA_ "GenMsgCycleTime" BO_ 366 40;
BA_ "GenMsgCycleTimeFast" BO_ 366 0;
BA_ "GenMsgSendType" BO_ 366 0;
BA_ "VFrameFormat" BO_ 366 14;
BA_ "CANFD_BRS" BO_ 366 1;
BA_ "GenMsgCycleTime" BO_ 366 40;
BA_ "GenMsgCycleTimeFast" BO_ 366 0;
BA_ "GenMsgSendType" BO_ 366 0;
BA_ "VFrameFormat" BO_ 366 14;
BA_ "CANFD_BRS" BO_ 366 1;
BA_ "GenMsgCycleTime" BO_ 366 40;
BA_ "GenMsgCycleTimeFast" BO_ 366 0;
BA_ "GenMsgSendType" BO_ 366 0;
BA_ "VFrameFormat" BO_ 366 14;
BA_ "CANFD_BRS" BO_ 366 1;
BA_ "EventCommandSignal" SG_ 971 ADC_MnvrOrintChng6 0;
BA_ "GatewayedSignals" SG_ 971 ADC_MnvrOrintChng6 0;
BA_ "GenSigInactiveValue" SG_ 971 ADC_MnvrOrintChng6 0;
BA_ "GenSigInvalidValue" SG_ 971 ADC_MnvrOrintChng6 0;
BA_ "GenSigSendType" SG_ 971 ADC_MnvrOrintChng6 1;
BA_ "GenSigStartValue" SG_ 971 ADC_MnvrOrintChng6 0;
BA_ "GenSigTimeoutValue" SG_ 971 ADC_MnvrOrintChng6 0;
BA_ "Remark" SG_ 971 ADC_MnvrOrintChng6 "";
BA_ "EventCommandSignal" SG_ 971 ADC_TarParkSt_Posn6 0;
BA_ "GatewayedSignals" SG_ 971 ADC_TarParkSt_Posn6 0;
BA_ "GenSigInactiveValue" SG_ 971 ADC_TarParkSt_Posn6 0;
BA_ "GenSigInvalidValue" SG_ 971 ADC_TarParkSt_Posn6 0;
BA_ "GenSigSendType" SG_ 971 ADC_TarParkSt_Posn6 1;
BA_ "GenSigStartValue" SG_ 971 ADC_TarParkSt_Posn6 0;
BA_ "GenSigTimeoutValue" SG_ 971 ADC_TarParkSt_Posn6 0;
BA_ "Remark" SG_ 971 ADC_TarParkSt_Posn6 "";
BA_ "EventCommandSignal" SG_ 971 ADC_ParkChkSrc_Posn6 0;
BA_ "GatewayedSignals" SG_ 971 ADC_ParkChkSrc_Posn6 0;
BA_ "GenSigInactiveValue" SG_ 971 ADC_ParkChkSrc_Posn6 0;
BA_ "GenSigInvalidValue" SG_ 971 ADC_ParkChkSrc_Posn6 0;
BA_ "GenSigSendType" SG_ 971 ADC_ParkChkSrc_Posn6 1;
BA_ "GenSigStartValue" SG_ 971 ADC_ParkChkSrc_Posn6 0;
BA_ "GenSigTimeoutValue" SG_ 971 ADC_ParkChkSrc_Posn6 0;
BA_ "Remark" SG_ 971 ADC_ParkChkSrc_Posn6 "";
BA_ "EventCommandSignal" SG_ 971 ADC_ParkPosn7_ID 0;
BA_ "GatewayedSignals" SG_ 971 ADC_ParkPosn7_ID 0;
BA_ "GenSigInactiveValue" SG_ 971 ADC_ParkPosn7_ID 0;
BA_ "GenSigInvalidValue" SG_ 971 ADC_ParkPosn7_ID 0;
BA_ "GenSigSendType" SG_ 971 ADC_ParkPosn7_ID 1;
BA_ "GenSigStartValue" SG_ 971 ADC_ParkPosn7_ID 0;
BA_ "GenSigTimeoutValue" SG_ 971 ADC_ParkPosn7_ID 0;
BA_ "Remark" SG_ 971 ADC_ParkPosn7_ID "";
BA_ "EventCommandSignal" SG_ 971 ADC_MnvrOrintChng7 0;
BA_ "GatewayedSignals" SG_ 971 ADC_MnvrOrintChng7 0;
BA_ "GenSigInactiveValue" SG_ 971 ADC_MnvrOrintChng7 0;
BA_ "GenSigInvalidValue" SG_ 971 ADC_MnvrOrintChng7 0;
BA_ "GenSigSendType" SG_ 971 ADC_MnvrOrintChng7 1;
BA_ "GenSigStartValue" SG_ 971 ADC_MnvrOrintChng7 0;
BA_ "GenSigTimeoutValue" SG_ 971 ADC_MnvrOrintChng7 0;
BA_ "Remark" SG_ 971 ADC_MnvrOrintChng7 "";
BA_ "EventCommandSignal" SG_ 971 ADC_TarParkSt_Posn7 0;
BA_ "GatewayedSignals" SG_ 971 ADC_TarParkSt_Posn7 0;
BA_ "GenSigInactiveValue" SG_ 971 ADC_TarParkSt_Posn7 0;
BA_ "GenSigInvalidValue" SG_ 971 ADC_TarParkSt_Posn7 0;
BA_ "GenSigSendType" SG_ 971 ADC_TarParkSt_Posn7 1;
BA_ "GenSigStartValue" SG_ 971 ADC_TarParkSt_Posn7 0;
BA_ "GenSigTimeoutValue" SG_ 971 ADC_TarParkSt_Posn7 0;
BA_ "Remark" SG_ 971 ADC_TarParkSt_Posn7 "";
BA_ "EventCommandSignal" SG_ 971 ADC_ParkChkSrc_Posn7 0;
BA_ "GatewayedSignals" SG_ 971 ADC_ParkChkSrc_Posn7 0;
BA_ "GenSigInactiveValue" SG_ 971 ADC_ParkChkSrc_Posn7 0;
BA_ "GenSigInvalidValue" SG_ 971 ADC_ParkChkSrc_Posn7 0;
BA_ "GenSigSendType" SG_ 971 ADC_ParkChkSrc_Posn7 1;
BA_ "GenSigStartValue" SG_ 971 ADC_ParkChkSrc_Posn7 0;
BA_ "GenSigTimeoutValue" SG_ 971 ADC_ParkChkSrc_Posn7 0;
BA_ "Remark" SG_ 971 ADC_ParkChkSrc_Posn7 "";
BA_ "EventCommandSignal" SG_ 971 ADC_ParkPosn8_ID 0;
BA_ "GatewayedSignals" SG_ 971 ADC_ParkPosn8_ID 0;
BA_ "GenSigInactiveValue" SG_ 971 ADC_ParkPosn8_ID 0;
BA_ "GenSigInvalidValue" SG_ 971 ADC_ParkPosn8_ID 0;
BA_ "GenSigSendType" SG_ 971 ADC_ParkPosn8_ID 1;
BA_ "GenSigStartValue" SG_ 971 ADC_ParkPosn8_ID 0;
BA_ "GenSigTimeoutValue" SG_ 971 ADC_ParkPosn8_ID 0;
BA_ "Remark" SG_ 971 ADC_ParkPosn8_ID "";
BA_ "EventCommandSignal" SG_ 971 ADC_MnvrOrintChng8 0;
BA_ "GatewayedSignals" SG_ 971 ADC_MnvrOrintChng8 0;
BA_ "GenSigInactiveValue" SG_ 971 ADC_MnvrOrintChng8 0;
BA_ "GenSigInvalidValue" SG_ 971 ADC_MnvrOrintChng8 0;
BA_ "GenSigSendType" SG_ 971 ADC_MnvrOrintChng8 1;
BA_ "GenSigStartValue" SG_ 971 ADC_MnvrOrintChng8 0;
BA_ "GenSigTimeoutValue" SG_ 971 ADC_MnvrOrintChng8 0;
BA_ "Remark" SG_ 971 ADC_MnvrOrintChng8 "";
BA_ "EventCommandSignal" SG_ 971 ADC_TarParkSt_Posn8 0;
BA_ "GatewayedSignals" SG_ 971 ADC_TarParkSt_Posn8 0;
BA_ "GenSigInactiveValue" SG_ 971 ADC_TarParkSt_Posn8 0;
BA_ "GenSigInvalidValue" SG_ 971 ADC_TarParkSt_Posn8 0;
BA_ "GenSigSendType" SG_ 971 ADC_TarParkSt_Posn8 1;
BA_ "GenSigStartValue" SG_ 971 ADC_TarParkSt_Posn8 0;
BA_ "GenSigTimeoutValue" SG_ 971 ADC_TarParkSt_Posn8 0;
BA_ "Remark" SG_ 971 ADC_TarParkSt_Posn8 "";
BA_ "EventCommandSignal" SG_ 971 ADC_ParkChkSrc_Posn8 0;
BA_ "GatewayedSignals" SG_ 971 ADC_ParkChkSrc_Posn8 0;
BA_ "GenSigInactiveValue" SG_ 971 ADC_ParkChkSrc_Posn8 0;
BA_ "GenSigInvalidValue" SG_ 971 ADC_ParkChkSrc_Posn8 0;
BA_ "GenSigSendType" SG_ 971 ADC_ParkChkSrc_Posn8 1;
BA_ "GenSigStartValue" SG_ 971 ADC_ParkChkSrc_Posn8 0;
BA_ "GenSigTimeoutValue" SG_ 971 ADC_ParkChkSrc_Posn8 0;
BA_ "Remark" SG_ 971 ADC_ParkChkSrc_Posn8 "";
BA_ "EventCommandSignal" SG_ 971 ADC_ParkRelPos5_x1 0;
BA_ "GatewayedSignals" SG_ 971 ADC_ParkRelPos5_x1 0;
BA_ "GenSigInactiveValue" SG_ 971 ADC_ParkRelPos5_x1 0;
BA_ "GenSigInvalidValue" SG_ 971 ADC_ParkRelPos5_x1 0;
BA_ "GenSigSendType" SG_ 971 ADC_ParkRelPos5_x1 1;
BA_ "GenSigStartValue" SG_ 971 ADC_ParkRelPos5_x1 0;
BA_ "GenSigTimeoutValue" SG_ 971 ADC_ParkRelPos5_x1 0;
BA_ "Remark" SG_ 971 ADC_ParkRelPos5_x1 "";
BA_ "EventCommandSignal" SG_ 971 ADC_ParkRelPos5_y1 0;
BA_ "GatewayedSignals" SG_ 971 ADC_ParkRelPos5_y1 0;
BA_ "GenSigInactiveValue" SG_ 971 ADC_ParkRelPos5_y1 0;
BA_ "GenSigInvalidValue" SG_ 971 ADC_ParkRelPos5_y1 0;
BA_ "GenSigSendType" SG_ 971 ADC_ParkRelPos5_y1 1;
BA_ "GenSigStartValue" SG_ 971 ADC_ParkRelPos5_y1 0;
BA_ "GenSigTimeoutValue" SG_ 971 ADC_ParkRelPos5_y1 0;
BA_ "Remark" SG_ 971 ADC_ParkRelPos5_y1 "";
BA_ "EventCommandSignal" SG_ 971 ADC_ParkRelPos5_x2 0;
BA_ "GatewayedSignals" SG_ 971 ADC_ParkRelPos5_x2 0;
BA_ "GenSigInactiveValue" SG_ 971 ADC_ParkRelPos5_x2 0;
BA_ "GenSigInvalidValue" SG_ 971 ADC_ParkRelPos5_x2 0;
BA_ "GenSigSendType" SG_ 971 ADC_ParkRelPos5_x2 1;
BA_ "GenSigStartValue" SG_ 971 ADC_ParkRelPos5_x2 0;
BA_ "GenSigTimeoutValue" SG_ 971 ADC_ParkRelPos5_x2 0;
BA_ "Remark" SG_ 971 ADC_ParkRelPos5_x2 "";
BA_ "EventCommandSignal" SG_ 971 ADC_ParkRelPos5_y2 0;
BA_ "GatewayedSignals" SG_ 971 ADC_ParkRelPos5_y2 0;
BA_ "GenSigInactiveValue" SG_ 971 ADC_ParkRelPos5_y2 0;
BA_ "GenSigInvalidValue" SG_ 971 ADC_ParkRelPos5_y2 0;
BA_ "GenSigSendType" SG_ 971 ADC_ParkRelPos5_y2 1;
BA_ "GenSigStartValue" SG_ 971 ADC_ParkRelPos5_y2 0;
BA_ "GenSigTimeoutValue" SG_ 971 ADC_ParkRelPos5_y2 0;
BA_ "Remark" SG_ 971 ADC_ParkRelPos5_y2 "";
BA_ "EventCommandSignal" SG_ 971 ADC_ParkRelPos5_x3 0;
BA_ "GatewayedSignals" SG_ 971 ADC_ParkRelPos5_x3 0;
BA_ "GenSigInactiveValue" SG_ 971 ADC_ParkRelPos5_x3 0;
BA_ "GenSigInvalidValue" SG_ 971 ADC_ParkRelPos5_x3 0;
BA_ "GenSigSendType" SG_ 971 ADC_ParkRelPos5_x3 1;
BA_ "GenSigStartValue" SG_ 971 ADC_ParkRelPos5_x3 0;
BA_ "GenSigTimeoutValue" SG_ 971 ADC_ParkRelPos5_x3 0;
BA_ "Remark" SG_ 971 ADC_ParkRelPos5_x3 "";
BA_ "EventCommandSignal" SG_ 971 ADC_ParkRelPos5_y3 0;
BA_ "GatewayedSignals" SG_ 971 ADC_ParkRelPos5_y3 0;
BA_ "GenSigInactiveValue" SG_ 971 ADC_ParkRelPos5_y3 0;
BA_ "GenSigInvalidValue" SG_ 971 ADC_ParkRelPos5_y3 0;
BA_ "GenSigSendType" SG_ 971 ADC_ParkRelPos5_y3 1;
BA_ "GenSigStartValue" SG_ 971 ADC_ParkRelPos5_y3 0;
BA_ "GenSigTimeoutValue" SG_ 971 ADC_ParkRelPos5_y3 0;
BA_ "Remark" SG_ 971 ADC_ParkRelPos5_y3 "";
BA_ "EventCommandSignal" SG_ 971 ADC_ParkRelPos5_x4 0;
BA_ "GatewayedSignals" SG_ 971 ADC_ParkRelPos5_x4 0;
BA_ "GenSigInactiveValue" SG_ 971 ADC_ParkRelPos5_x4 0;
BA_ "GenSigInvalidValue" SG_ 971 ADC_ParkRelPos5_x4 0;
BA_ "GenSigSendType" SG_ 971 ADC_ParkRelPos5_x4 1;
BA_ "GenSigStartValue" SG_ 971 ADC_ParkRelPos5_x4 0;
BA_ "GenSigTimeoutValue" SG_ 971 ADC_ParkRelPos5_x4 0;
BA_ "Remark" SG_ 971 ADC_ParkRelPos5_x4 "";
BA_ "EventCommandSignal" SG_ 971 ADC_ParkRelPos5_y4 0;
BA_ "GatewayedSignals" SG_ 971 ADC_ParkRelPos5_y4 0;
BA_ "GenSigInactiveValue" SG_ 971 ADC_ParkRelPos5_y4 0;
BA_ "GenSigInvalidValue" SG_ 971 ADC_ParkRelPos5_y4 0;
BA_ "GenSigSendType" SG_ 971 ADC_ParkRelPos5_y4 1;
BA_ "GenSigStartValue" SG_ 971 ADC_ParkRelPos5_y4 0;
BA_ "GenSigTimeoutValue" SG_ 971 ADC_ParkRelPos5_y4 0;
BA_ "Remark" SG_ 971 ADC_ParkRelPos5_y4 "";
BA_ "EventCommandSignal" SG_ 971 ADC_ParkRelPos6_x1 0;
BA_ "GatewayedSignals" SG_ 971 ADC_ParkRelPos6_x1 0;
BA_ "GenSigInactiveValue" SG_ 971 ADC_ParkRelPos6_x1 0;
BA_ "GenSigInvalidValue" SG_ 971 ADC_ParkRelPos6_x1 0;
BA_ "GenSigSendType" SG_ 971 ADC_ParkRelPos6_x1 1;
BA_ "GenSigStartValue" SG_ 971 ADC_ParkRelPos6_x1 0;
BA_ "GenSigTimeoutValue" SG_ 971 ADC_ParkRelPos6_x1 0;
BA_ "Remark" SG_ 971 ADC_ParkRelPos6_x1 "";
BA_ "EventCommandSignal" SG_ 971 ADC_ParkRelPos6_y1 0;
BA_ "GatewayedSignals" SG_ 971 ADC_ParkRelPos6_y1 0;
BA_ "GenSigInactiveValue" SG_ 971 ADC_ParkRelPos6_y1 0;
BA_ "GenSigInvalidValue" SG_ 971 ADC_ParkRelPos6_y1 0;
BA_ "GenSigSendType" SG_ 971 ADC_ParkRelPos6_y1 1;
BA_ "GenSigStartValue" SG_ 971 ADC_ParkRelPos6_y1 0;
BA_ "GenSigTimeoutValue" SG_ 971 ADC_ParkRelPos6_y1 0;
BA_ "Remark" SG_ 971 ADC_ParkRelPos6_y1 "";
BA_ "EventCommandSignal" SG_ 971 ADC_ParkRelPos6_x2 0;
BA_ "GatewayedSignals" SG_ 971 ADC_ParkRelPos6_x2 0;
BA_ "GenSigInactiveValue" SG_ 971 ADC_ParkRelPos6_x2 0;
BA_ "GenSigInvalidValue" SG_ 971 ADC_ParkRelPos6_x2 0;
BA_ "GenSigSendType" SG_ 971 ADC_ParkRelPos6_x2 1;
BA_ "GenSigStartValue" SG_ 971 ADC_ParkRelPos6_x2 0;
BA_ "GenSigTimeoutValue" SG_ 971 ADC_ParkRelPos6_x2 0;
BA_ "Remark" SG_ 971 ADC_ParkRelPos6_x2 "";
BA_ "EventCommandSignal" SG_ 971 ADC_ParkRelPos6_y2 0;
BA_ "GatewayedSignals" SG_ 971 ADC_ParkRelPos6_y2 0;
BA_ "GenSigInactiveValue" SG_ 971 ADC_ParkRelPos6_y2 0;
BA_ "GenSigInvalidValue" SG_ 971 ADC_ParkRelPos6_y2 0;
BA_ "GenSigSendType" SG_ 971 ADC_ParkRelPos6_y2 1;
BA_ "GenSigStartValue" SG_ 971 ADC_ParkRelPos6_y2 0;
BA_ "GenSigTimeoutValue" SG_ 971 ADC_ParkRelPos6_y2 0;
BA_ "Remark" SG_ 971 ADC_ParkRelPos6_y2 "";
BA_ "EventCommandSignal" SG_ 971 ADC_ParkRelPos6_x3 0;
BA_ "GatewayedSignals" SG_ 971 ADC_ParkRelPos6_x3 0;
BA_ "GenSigInactiveValue" SG_ 971 ADC_ParkRelPos6_x3 0;
BA_ "GenSigInvalidValue" SG_ 971 ADC_ParkRelPos6_x3 0;
BA_ "GenSigSendType" SG_ 971 ADC_ParkRelPos6_x3 1;
BA_ "GenSigStartValue" SG_ 971 ADC_ParkRelPos6_x3 0;
BA_ "GenSigTimeoutValue" SG_ 971 ADC_ParkRelPos6_x3 0;
BA_ "Remark" SG_ 971 ADC_ParkRelPos6_x3 "";
BA_ "EventCommandSignal" SG_ 971 ADC_ParkRelPos6_y3 0;
BA_ "GatewayedSignals" SG_ 971 ADC_ParkRelPos6_y3 0;
BA_ "GenSigInactiveValue" SG_ 971 ADC_ParkRelPos6_y3 0;
BA_ "GenSigInvalidValue" SG_ 971 ADC_ParkRelPos6_y3 0;
BA_ "GenSigSendType" SG_ 971 ADC_ParkRelPos6_y3 1;
BA_ "GenSigStartValue" SG_ 971 ADC_ParkRelPos6_y3 0;
BA_ "GenSigTimeoutValue" SG_ 971 ADC_ParkRelPos6_y3 0;
BA_ "Remark" SG_ 971 ADC_ParkRelPos6_y3 "";
BA_ "EventCommandSignal" SG_ 971 ADC_ParkRelPos6_x4 0;
BA_ "GatewayedSignals" SG_ 971 ADC_ParkRelPos6_x4 0;
BA_ "GenSigInactiveValue" SG_ 971 ADC_ParkRelPos6_x4 0;
BA_ "GenSigInvalidValue" SG_ 971 ADC_ParkRelPos6_x4 0;
BA_ "GenSigSendType" SG_ 971 ADC_ParkRelPos6_x4 1;
BA_ "GenSigStartValue" SG_ 971 ADC_ParkRelPos6_x4 0;
BA_ "GenSigTimeoutValue" SG_ 971 ADC_ParkRelPos6_x4 0;
BA_ "Remark" SG_ 971 ADC_ParkRelPos6_x4 "";
BA_ "EventCommandSignal" SG_ 971 ADC_ParkRelPos6_y4 0;
BA_ "GatewayedSignals" SG_ 971 ADC_ParkRelPos6_y4 0;
BA_ "GenSigInactiveValue" SG_ 971 ADC_ParkRelPos6_y4 0;
BA_ "GenSigInvalidValue" SG_ 971 ADC_ParkRelPos6_y4 0;
BA_ "GenSigSendType" SG_ 971 ADC_ParkRelPos6_y4 1;
BA_ "GenSigStartValue" SG_ 971 ADC_ParkRelPos6_y4 0;
BA_ "GenSigTimeoutValue" SG_ 971 ADC_ParkRelPos6_y4 0;
BA_ "Remark" SG_ 971 ADC_ParkRelPos6_y4 "";
BA_ "EventCommandSignal" SG_ 971 ADC_ParkRelPos7_x1 0;
BA_ "GatewayedSignals" SG_ 971 ADC_ParkRelPos7_x1 0;
BA_ "GenSigInactiveValue" SG_ 971 ADC_ParkRelPos7_x1 0;
BA_ "GenSigInvalidValue" SG_ 971 ADC_ParkRelPos7_x1 0;
BA_ "GenSigSendType" SG_ 971 ADC_ParkRelPos7_x1 1;
BA_ "GenSigStartValue" SG_ 971 ADC_ParkRelPos7_x1 0;
BA_ "GenSigTimeoutValue" SG_ 971 ADC_ParkRelPos7_x1 0;
BA_ "Remark" SG_ 971 ADC_ParkRelPos7_x1 "";
BA_ "EventCommandSignal" SG_ 971 ADC_ParkRelPos7_y1 0;
BA_ "GatewayedSignals" SG_ 971 ADC_ParkRelPos7_y1 0;
BA_ "GenSigInactiveValue" SG_ 971 ADC_ParkRelPos7_y1 0;
BA_ "GenSigInvalidValue" SG_ 971 ADC_ParkRelPos7_y1 0;
BA_ "GenSigSendType" SG_ 971 ADC_ParkRelPos7_y1 1;
BA_ "GenSigStartValue" SG_ 971 ADC_ParkRelPos7_y1 0;
BA_ "GenSigTimeoutValue" SG_ 971 ADC_ParkRelPos7_y1 0;
BA_ "Remark" SG_ 971 ADC_ParkRelPos7_y1 "";
BA_ "EventCommandSignal" SG_ 971 ADC_ParkRelPos7_x2 0;
BA_ "GatewayedSignals" SG_ 971 ADC_ParkRelPos7_x2 0;
BA_ "GenSigInactiveValue" SG_ 971 ADC_ParkRelPos7_x2 0;
BA_ "GenSigInvalidValue" SG_ 971 ADC_ParkRelPos7_x2 0;
BA_ "GenSigSendType" SG_ 971 ADC_ParkRelPos7_x2 1;
BA_ "GenSigStartValue" SG_ 971 ADC_ParkRelPos7_x2 0;
BA_ "GenSigTimeoutValue" SG_ 971 ADC_ParkRelPos7_x2 0;
BA_ "Remark" SG_ 971 ADC_ParkRelPos7_x2 "";
BA_ "EventCommandSignal" SG_ 971 ADC_ParkRelPos7_y2 0;
BA_ "GatewayedSignals" SG_ 971 ADC_ParkRelPos7_y2 0;
BA_ "GenSigInactiveValue" SG_ 971 ADC_ParkRelPos7_y2 0;
BA_ "GenSigInvalidValue" SG_ 971 ADC_ParkRelPos7_y2 0;
BA_ "GenSigSendType" SG_ 971 ADC_ParkRelPos7_y2 1;
BA_ "GenSigStartValue" SG_ 971 ADC_ParkRelPos7_y2 0;
BA_ "GenSigTimeoutValue" SG_ 971 ADC_ParkRelPos7_y2 0;
BA_ "Remark" SG_ 971 ADC_ParkRelPos7_y2 "";
BA_ "EventCommandSignal" SG_ 971 ADC_ParkRelPos7_x3 0;
BA_ "GatewayedSignals" SG_ 971 ADC_ParkRelPos7_x3 0;
BA_ "GenSigInactiveValue" SG_ 971 ADC_ParkRelPos7_x3 0;
BA_ "GenSigInvalidValue" SG_ 971 ADC_ParkRelPos7_x3 0;
BA_ "GenSigSendType" SG_ 971 ADC_ParkRelPos7_x3 1;
BA_ "GenSigStartValue" SG_ 971 ADC_ParkRelPos7_x3 0;
BA_ "GenSigTimeoutValue" SG_ 971 ADC_ParkRelPos7_x3 0;
BA_ "Remark" SG_ 971 ADC_ParkRelPos7_x3 "";
BA_ "EventCommandSignal" SG_ 971 ADC_ParkRelPos7_y3 0;
BA_ "GatewayedSignals" SG_ 971 ADC_ParkRelPos7_y3 0;
BA_ "GenSigInactiveValue" SG_ 971 ADC_ParkRelPos7_y3 0;
BA_ "GenSigInvalidValue" SG_ 971 ADC_ParkRelPos7_y3 0;
BA_ "GenSigSendType" SG_ 971 ADC_ParkRelPos7_y3 1;
BA_ "GenSigStartValue" SG_ 971 ADC_ParkRelPos7_y3 0;
BA_ "GenSigTimeoutValue" SG_ 971 ADC_ParkRelPos7_y3 0;
BA_ "Remark" SG_ 971 ADC_ParkRelPos7_y3 "";
BA_ "EventCommandSignal" SG_ 971 ADC_ParkRelPos7_x4 0;
BA_ "GatewayedSignals" SG_ 971 ADC_ParkRelPos7_x4 0;
BA_ "GenSigInactiveValue" SG_ 971 ADC_ParkRelPos7_x4 0;
BA_ "GenSigInvalidValue" SG_ 971 ADC_ParkRelPos7_x4 0;
BA_ "GenSigSendType" SG_ 971 ADC_ParkRelPos7_x4 1;
BA_ "GenSigStartValue" SG_ 971 ADC_ParkRelPos7_x4 0;
BA_ "GenSigTimeoutValue" SG_ 971 ADC_ParkRelPos7_x4 0;
BA_ "Remark" SG_ 971 ADC_ParkRelPos7_x4 "";
BA_ "EventCommandSignal" SG_ 971 ADC_ParkRelPos7_y4 0;
BA_ "GatewayedSignals" SG_ 971 ADC_ParkRelPos7_y4 0;
BA_ "GenSigInactiveValue" SG_ 971 ADC_ParkRelPos7_y4 0;
BA_ "GenSigInvalidValue" SG_ 971 ADC_ParkRelPos7_y4 0;
BA_ "GenSigSendType" SG_ 971 ADC_ParkRelPos7_y4 1;
BA_ "GenSigStartValue" SG_ 971 ADC_ParkRelPos7_y4 0;
BA_ "GenSigTimeoutValue" SG_ 971 ADC_ParkRelPos7_y4 0;
BA_ "Remark" SG_ 971 ADC_ParkRelPos7_y4 "";
BA_ "EventCommandSignal" SG_ 971 ADC_ParkRelPos8_x1 0;
BA_ "GatewayedSignals" SG_ 971 ADC_ParkRelPos8_x1 0;
BA_ "GenSigInactiveValue" SG_ 971 ADC_ParkRelPos8_x1 0;
BA_ "GenSigInvalidValue" SG_ 971 ADC_ParkRelPos8_x1 0;
BA_ "GenSigSendType" SG_ 971 ADC_ParkRelPos8_x1 1;
BA_ "GenSigStartValue" SG_ 971 ADC_ParkRelPos8_x1 0;
BA_ "GenSigTimeoutValue" SG_ 971 ADC_ParkRelPos8_x1 0;
BA_ "Remark" SG_ 971 ADC_ParkRelPos8_x1 "";
BA_ "EventCommandSignal" SG_ 971 ADC_ParkRelPos8_y1 0;
BA_ "GatewayedSignals" SG_ 971 ADC_ParkRelPos8_y1 0;
BA_ "GenSigInactiveValue" SG_ 971 ADC_ParkRelPos8_y1 0;
BA_ "GenSigInvalidValue" SG_ 971 ADC_ParkRelPos8_y1 0;
BA_ "GenSigSendType" SG_ 971 ADC_ParkRelPos8_y1 1;
BA_ "GenSigStartValue" SG_ 971 ADC_ParkRelPos8_y1 0;
BA_ "GenSigTimeoutValue" SG_ 971 ADC_ParkRelPos8_y1 0;
BA_ "Remark" SG_ 971 ADC_ParkRelPos8_y1 "";
BA_ "EventCommandSignal" SG_ 971 ADC_ParkRelPos8_x2 0;
BA_ "GatewayedSignals" SG_ 971 ADC_ParkRelPos8_x2 0;
BA_ "GenSigInactiveValue" SG_ 971 ADC_ParkRelPos8_x2 0;
BA_ "GenSigInvalidValue" SG_ 971 ADC_ParkRelPos8_x2 0;
BA_ "GenSigSendType" SG_ 971 ADC_ParkRelPos8_x2 1;
BA_ "GenSigStartValue" SG_ 971 ADC_ParkRelPos8_x2 0;
BA_ "GenSigTimeoutValue" SG_ 971 ADC_ParkRelPos8_x2 0;
BA_ "Remark" SG_ 971 ADC_ParkRelPos8_x2 "";
BA_ "EventCommandSignal" SG_ 971 ADC_ParkRelPos8_y2 0;
BA_ "GatewayedSignals" SG_ 971 ADC_ParkRelPos8_y2 0;
BA_ "GenSigInactiveValue" SG_ 971 ADC_ParkRelPos8_y2 0;
BA_ "GenSigInvalidValue" SG_ 971 ADC_ParkRelPos8_y2 0;
BA_ "GenSigSendType" SG_ 971 ADC_ParkRelPos8_y2 1;
BA_ "GenSigStartValue" SG_ 971 ADC_ParkRelPos8_y2 0;
BA_ "GenSigTimeoutValue" SG_ 971 ADC_ParkRelPos8_y2 0;
BA_ "Remark" SG_ 971 ADC_ParkRelPos8_y2 "";
BA_ "EventCommandSignal" SG_ 971 ADC_ParkRelPos8_x3 0;
BA_ "GatewayedSignals" SG_ 971 ADC_ParkRelPos8_x3 0;
BA_ "GenSigInactiveValue" SG_ 971 ADC_ParkRelPos8_x3 0;
BA_ "GenSigInvalidValue" SG_ 971 ADC_ParkRelPos8_x3 0;
BA_ "GenSigSendType" SG_ 971 ADC_ParkRelPos8_x3 1;
BA_ "GenSigStartValue" SG_ 971 ADC_ParkRelPos8_x3 0;
BA_ "GenSigTimeoutValue" SG_ 971 ADC_ParkRelPos8_x3 0;
BA_ "Remark" SG_ 971 ADC_ParkRelPos8_x3 "";
BA_ "EventCommandSignal" SG_ 971 ADC_ParkRelPos8_y3 0;
BA_ "GatewayedSignals" SG_ 971 ADC_ParkRelPos8_y3 0;
BA_ "GenSigInactiveValue" SG_ 971 ADC_ParkRelPos8_y3 0;
BA_ "GenSigInvalidValue" SG_ 971 ADC_ParkRelPos8_y3 0;
BA_ "GenSigSendType" SG_ 971 ADC_ParkRelPos8_y3 1;
BA_ "GenSigStartValue" SG_ 971 ADC_ParkRelPos8_y3 0;
BA_ "GenSigTimeoutValue" SG_ 971 ADC_ParkRelPos8_y3 0;
BA_ "Remark" SG_ 971 ADC_ParkRelPos8_y3 "";
BA_ "EventCommandSignal" SG_ 971 ADC_ParkRelPos8_x4 0;
BA_ "GatewayedSignals" SG_ 971 ADC_ParkRelPos8_x4 0;
BA_ "GenSigInactiveValue" SG_ 971 ADC_ParkRelPos8_x4 0;
BA_ "GenSigInvalidValue" SG_ 971 ADC_ParkRelPos8_x4 0;
BA_ "GenSigSendType" SG_ 971 ADC_ParkRelPos8_x4 1;
BA_ "GenSigStartValue" SG_ 971 ADC_ParkRelPos8_x4 0;
BA_ "GenSigTimeoutValue" SG_ 971 ADC_ParkRelPos8_x4 0;
BA_ "Remark" SG_ 971 ADC_ParkRelPos8_x4 "";
BA_ "EventCommandSignal" SG_ 971 ADC_ParkRelPos8_y4 0;
BA_ "GatewayedSignals" SG_ 971 ADC_ParkRelPos8_y4 0;
BA_ "GenSigInactiveValue" SG_ 971 ADC_ParkRelPos8_y4 0;
BA_ "GenSigInvalidValue" SG_ 971 ADC_ParkRelPos8_y4 0;
BA_ "GenSigSendType" SG_ 971 ADC_ParkRelPos8_y4 1;
BA_ "GenSigStartValue" SG_ 971 ADC_ParkRelPos8_y4 0;
BA_ "GenSigTimeoutValue" SG_ 971 ADC_ParkRelPos8_y4 0;
BA_ "Remark" SG_ 971 ADC_ParkRelPos8_y4 "";
BA_ "EventCommandSignal" SG_ 971 ADC_ParkPosn5_ID 0;
BA_ "GatewayedSignals" SG_ 971 ADC_ParkPosn5_ID 0;
BA_ "GenSigInactiveValue" SG_ 971 ADC_ParkPosn5_ID 0;
BA_ "GenSigInvalidValue" SG_ 971 ADC_ParkPosn5_ID 0;
BA_ "GenSigSendType" SG_ 971 ADC_ParkPosn5_ID 1;
BA_ "GenSigStartValue" SG_ 971 ADC_ParkPosn5_ID 0;
BA_ "GenSigTimeoutValue" SG_ 971 ADC_ParkPosn5_ID 0;
BA_ "Remark" SG_ 971 ADC_ParkPosn5_ID "";
BA_ "EventCommandSignal" SG_ 971 ADC_MnvrOrintChng5 0;
BA_ "GatewayedSignals" SG_ 971 ADC_MnvrOrintChng5 0;
BA_ "GenSigInactiveValue" SG_ 971 ADC_MnvrOrintChng5 0;
BA_ "GenSigInvalidValue" SG_ 971 ADC_MnvrOrintChng5 0;
BA_ "GenSigSendType" SG_ 971 ADC_MnvrOrintChng5 1;
BA_ "GenSigStartValue" SG_ 971 ADC_MnvrOrintChng5 0;
BA_ "GenSigTimeoutValue" SG_ 971 ADC_MnvrOrintChng5 0;
BA_ "Remark" SG_ 971 ADC_MnvrOrintChng5 "";
BA_ "EventCommandSignal" SG_ 971 ADC_TarParkSt_Posn5 0;
BA_ "GatewayedSignals" SG_ 971 ADC_TarParkSt_Posn5 0;
BA_ "GenSigInactiveValue" SG_ 971 ADC_TarParkSt_Posn5 0;
BA_ "GenSigInvalidValue" SG_ 971 ADC_TarParkSt_Posn5 0;
BA_ "GenSigSendType" SG_ 971 ADC_TarParkSt_Posn5 1;
BA_ "GenSigStartValue" SG_ 971 ADC_TarParkSt_Posn5 0;
BA_ "GenSigTimeoutValue" SG_ 971 ADC_TarParkSt_Posn5 0;
BA_ "Remark" SG_ 971 ADC_TarParkSt_Posn5 "";
BA_ "EventCommandSignal" SG_ 971 ADC_ParkChkSrc_Posn5 0;
BA_ "GatewayedSignals" SG_ 971 ADC_ParkChkSrc_Posn5 0;
BA_ "GenSigInactiveValue" SG_ 971 ADC_ParkChkSrc_Posn5 0;
BA_ "GenSigInvalidValue" SG_ 971 ADC_ParkChkSrc_Posn5 0;
BA_ "GenSigSendType" SG_ 971 ADC_ParkChkSrc_Posn5 1;
BA_ "GenSigStartValue" SG_ 971 ADC_ParkChkSrc_Posn5 0;
BA_ "GenSigTimeoutValue" SG_ 971 ADC_ParkChkSrc_Posn5 0;
BA_ "Remark" SG_ 971 ADC_ParkChkSrc_Posn5 "";
BA_ "EventCommandSignal" SG_ 971 ADC_ParkPosn6_ID 0;
BA_ "GatewayedSignals" SG_ 971 ADC_ParkPosn6_ID 0;
BA_ "GenSigInactiveValue" SG_ 971 ADC_ParkPosn6_ID 0;
BA_ "GenSigInvalidValue" SG_ 971 ADC_ParkPosn6_ID 0;
BA_ "GenSigSendType" SG_ 971 ADC_ParkPosn6_ID 1;
BA_ "GenSigStartValue" SG_ 971 ADC_ParkPosn6_ID 0;
BA_ "GenSigTimeoutValue" SG_ 971 ADC_ParkPosn6_ID 0;
BA_ "Remark" SG_ 971 ADC_ParkPosn6_ID "";
BA_ "EventCommandSignal" SG_ 1110 ADAS_CANTRACE_EventType 0;
BA_ "GatewayedSignals" SG_ 1110 ADAS_CANTRACE_EventType 0;
BA_ "GenSigInactiveValue" SG_ 1110 ADAS_CANTRACE_EventType 0;
BA_ "GenSigInvalidValue" SG_ 1110 ADAS_CANTRACE_EventType 0;
BA_ "GenSigSendType" SG_ 1110 ADAS_CANTRACE_EventType 1;
BA_ "GenSigStartValue" SG_ 1110 ADAS_CANTRACE_EventType 0;
BA_ "GenSigTimeoutValue" SG_ 1110 ADAS_CANTRACE_EventType 0;
BA_ "Remark" SG_ 1110 ADAS_CANTRACE_EventType "";
BA_ "EventCommandSignal" SG_ 1110 ADAS_CANTRACE_EventSubModule 0;
BA_ "GatewayedSignals" SG_ 1110 ADAS_CANTRACE_EventSubModule 0;
BA_ "GenSigInactiveValue" SG_ 1110 ADAS_CANTRACE_EventSubModule 0;
BA_ "GenSigInvalidValue" SG_ 1110 ADAS_CANTRACE_EventSubModule 0;
BA_ "GenSigSendType" SG_ 1110 ADAS_CANTRACE_EventSubModule 1;
BA_ "GenSigStartValue" SG_ 1110 ADAS_CANTRACE_EventSubModule 0;
BA_ "GenSigTimeoutValue" SG_ 1110 ADAS_CANTRACE_EventSubModule 0;
BA_ "Remark" SG_ 1110 ADAS_CANTRACE_EventSubModule "";
BA_ "EventCommandSignal" SG_ 1110 ADAS_CANTRACE_EventInfo0 0;
BA_ "GatewayedSignals" SG_ 1110 ADAS_CANTRACE_EventInfo0 0;
BA_ "GenSigInactiveValue" SG_ 1110 ADAS_CANTRACE_EventInfo0 0;
BA_ "GenSigInvalidValue" SG_ 1110 ADAS_CANTRACE_EventInfo0 0;
BA_ "GenSigSendType" SG_ 1110 ADAS_CANTRACE_EventInfo0 1;
BA_ "GenSigStartValue" SG_ 1110 ADAS_CANTRACE_EventInfo0 0;
BA_ "GenSigTimeoutValue" SG_ 1110 ADAS_CANTRACE_EventInfo0 0;
BA_ "Remark" SG_ 1110 ADAS_CANTRACE_EventInfo0 "";
BA_ "EventCommandSignal" SG_ 1110 ADAS_CANTRACE_EventInfo1 0;
BA_ "GatewayedSignals" SG_ 1110 ADAS_CANTRACE_EventInfo1 0;
BA_ "GenSigInactiveValue" SG_ 1110 ADAS_CANTRACE_EventInfo1 0;
BA_ "GenSigInvalidValue" SG_ 1110 ADAS_CANTRACE_EventInfo1 0;
BA_ "GenSigSendType" SG_ 1110 ADAS_CANTRACE_EventInfo1 1;
BA_ "GenSigStartValue" SG_ 1110 ADAS_CANTRACE_EventInfo1 0;
BA_ "GenSigTimeoutValue" SG_ 1110 ADAS_CANTRACE_EventInfo1 0;
BA_ "Remark" SG_ 1110 ADAS_CANTRACE_EventInfo1 "";
BA_ "EventCommandSignal" SG_ 1110 ADAS_CANTRACE_EventInfo2 0;
BA_ "GatewayedSignals" SG_ 1110 ADAS_CANTRACE_EventInfo2 0;
BA_ "GenSigInactiveValue" SG_ 1110 ADAS_CANTRACE_EventInfo2 0;
BA_ "GenSigInvalidValue" SG_ 1110 ADAS_CANTRACE_EventInfo2 0;
BA_ "GenSigSendType" SG_ 1110 ADAS_CANTRACE_EventInfo2 1;
BA_ "GenSigStartValue" SG_ 1110 ADAS_CANTRACE_EventInfo2 0;
BA_ "GenSigTimeoutValue" SG_ 1110 ADAS_CANTRACE_EventInfo2 0;
BA_ "Remark" SG_ 1110 ADAS_CANTRACE_EventInfo2 "";
BA_ "EventCommandSignal" SG_ 1110 ADAS_CANTRACE_EventInfo3 0;
BA_ "GatewayedSignals" SG_ 1110 ADAS_CANTRACE_EventInfo3 0;
BA_ "GenSigInactiveValue" SG_ 1110 ADAS_CANTRACE_EventInfo3 0;
BA_ "GenSigInvalidValue" SG_ 1110 ADAS_CANTRACE_EventInfo3 0;
BA_ "GenSigSendType" SG_ 1110 ADAS_CANTRACE_EventInfo3 1;
BA_ "GenSigStartValue" SG_ 1110 ADAS_CANTRACE_EventInfo3 0;
BA_ "GenSigTimeoutValue" SG_ 1110 ADAS_CANTRACE_EventInfo3 0;
BA_ "Remark" SG_ 1110 ADAS_CANTRACE_EventInfo3 "";
BA_ "EventCommandSignal" SG_ 1110 ADAS_CANTRACE_EventInfo4 0;
BA_ "GatewayedSignals" SG_ 1110 ADAS_CANTRACE_EventInfo4 0;
BA_ "GenSigInactiveValue" SG_ 1110 ADAS_CANTRACE_EventInfo4 0;
BA_ "GenSigInvalidValue" SG_ 1110 ADAS_CANTRACE_EventInfo4 0;
BA_ "GenSigSendType" SG_ 1110 ADAS_CANTRACE_EventInfo4 1;
BA_ "GenSigStartValue" SG_ 1110 ADAS_CANTRACE_EventInfo4 0;
BA_ "GenSigTimeoutValue" SG_ 1110 ADAS_CANTRACE_EventInfo4 0;
BA_ "Remark" SG_ 1110 ADAS_CANTRACE_EventInfo4 "";
BA_ "EventCommandSignal" SG_ 1110 ADAS_CANTRACE_EventInfo5 0;
BA_ "GatewayedSignals" SG_ 1110 ADAS_CANTRACE_EventInfo5 0;
BA_ "GenSigInactiveValue" SG_ 1110 ADAS_CANTRACE_EventInfo5 0;
BA_ "GenSigInvalidValue" SG_ 1110 ADAS_CANTRACE_EventInfo5 0;
BA_ "GenSigSendType" SG_ 1110 ADAS_CANTRACE_EventInfo5 1;
BA_ "GenSigStartValue" SG_ 1110 ADAS_CANTRACE_EventInfo5 0;
BA_ "GenSigTimeoutValue" SG_ 1110 ADAS_CANTRACE_EventInfo5 0;
BA_ "Remark" SG_ 1110 ADAS_CANTRACE_EventInfo5 "";
BA_ "EventCommandSignal" SG_ 1110 ADAS_CANTRACE_EventInfo6 0;
BA_ "GatewayedSignals" SG_ 1110 ADAS_CANTRACE_EventInfo6 0;
BA_ "GenSigInactiveValue" SG_ 1110 ADAS_CANTRACE_EventInfo6 0;
BA_ "GenSigInvalidValue" SG_ 1110 ADAS_CANTRACE_EventInfo6 0;
BA_ "GenSigSendType" SG_ 1110 ADAS_CANTRACE_EventInfo6 1;
BA_ "GenSigStartValue" SG_ 1110 ADAS_CANTRACE_EventInfo6 0;
BA_ "GenSigTimeoutValue" SG_ 1110 ADAS_CANTRACE_EventInfo6 0;
BA_ "Remark" SG_ 1110 ADAS_CANTRACE_EventInfo6 "";
BA_ "EventCommandSignal" SG_ 1110 ADAS_CANTRACE_EventInfo7 0;
BA_ "GatewayedSignals" SG_ 1110 ADAS_CANTRACE_EventInfo7 0;
BA_ "GenSigInactiveValue" SG_ 1110 ADAS_CANTRACE_EventInfo7 0;
BA_ "GenSigInvalidValue" SG_ 1110 ADAS_CANTRACE_EventInfo7 0;
BA_ "GenSigSendType" SG_ 1110 ADAS_CANTRACE_EventInfo7 1;
BA_ "GenSigStartValue" SG_ 1110 ADAS_CANTRACE_EventInfo7 0;
BA_ "GenSigTimeoutValue" SG_ 1110 ADAS_CANTRACE_EventInfo7 0;
BA_ "Remark" SG_ 1110 ADAS_CANTRACE_EventInfo7 "";
BA_ "EventCommandSignal" SG_ 1110 ADAS_CANTRACE_EventInfo8 0;
BA_ "GatewayedSignals" SG_ 1110 ADAS_CANTRACE_EventInfo8 0;
BA_ "GenSigInactiveValue" SG_ 1110 ADAS_CANTRACE_EventInfo8 0;
BA_ "GenSigInvalidValue" SG_ 1110 ADAS_CANTRACE_EventInfo8 0;
BA_ "GenSigSendType" SG_ 1110 ADAS_CANTRACE_EventInfo8 1;
BA_ "GenSigStartValue" SG_ 1110 ADAS_CANTRACE_EventInfo8 0;
BA_ "GenSigTimeoutValue" SG_ 1110 ADAS_CANTRACE_EventInfo8 0;
BA_ "Remark" SG_ 1110 ADAS_CANTRACE_EventInfo8 "";
BA_ "EventCommandSignal" SG_ 1110 ADAS_CANTRACE_EventInfo9 0;
BA_ "GatewayedSignals" SG_ 1110 ADAS_CANTRACE_EventInfo9 0;
BA_ "GenSigInactiveValue" SG_ 1110 ADAS_CANTRACE_EventInfo9 0;
BA_ "GenSigInvalidValue" SG_ 1110 ADAS_CANTRACE_EventInfo9 0;
BA_ "GenSigSendType" SG_ 1110 ADAS_CANTRACE_EventInfo9 1;
BA_ "GenSigStartValue" SG_ 1110 ADAS_CANTRACE_EventInfo9 0;
BA_ "GenSigTimeoutValue" SG_ 1110 ADAS_CANTRACE_EventInfo9 0;
BA_ "Remark" SG_ 1110 ADAS_CANTRACE_EventInfo9 "";
BA_ "EventCommandSignal" SG_ 1110 ADAS_CANTRACE_EventInfo10 0;
BA_ "GatewayedSignals" SG_ 1110 ADAS_CANTRACE_EventInfo10 0;
BA_ "GenSigInactiveValue" SG_ 1110 ADAS_CANTRACE_EventInfo10 0;
BA_ "GenSigInvalidValue" SG_ 1110 ADAS_CANTRACE_EventInfo10 0;
BA_ "GenSigSendType" SG_ 1110 ADAS_CANTRACE_EventInfo10 1;
BA_ "GenSigStartValue" SG_ 1110 ADAS_CANTRACE_EventInfo10 0;
BA_ "GenSigTimeoutValue" SG_ 1110 ADAS_CANTRACE_EventInfo10 0;
BA_ "Remark" SG_ 1110 ADAS_CANTRACE_EventInfo10 "";
BA_ "EventCommandSignal" SG_ 1110 ADAS_CANTRACE_EventInfo11 0;
BA_ "GatewayedSignals" SG_ 1110 ADAS_CANTRACE_EventInfo11 0;
BA_ "GenSigInactiveValue" SG_ 1110 ADAS_CANTRACE_EventInfo11 0;
BA_ "GenSigInvalidValue" SG_ 1110 ADAS_CANTRACE_EventInfo11 0;
BA_ "GenSigSendType" SG_ 1110 ADAS_CANTRACE_EventInfo11 1;
BA_ "GenSigStartValue" SG_ 1110 ADAS_CANTRACE_EventInfo11 0;
BA_ "GenSigTimeoutValue" SG_ 1110 ADAS_CANTRACE_EventInfo11 0;
BA_ "Remark" SG_ 1110 ADAS_CANTRACE_EventInfo11 "";
BA_ "EventCommandSignal" SG_ 1110 ADAS_CANTRACE_EventInfo12 0;
BA_ "GatewayedSignals" SG_ 1110 ADAS_CANTRACE_EventInfo12 0;
BA_ "GenSigInactiveValue" SG_ 1110 ADAS_CANTRACE_EventInfo12 0;
BA_ "GenSigInvalidValue" SG_ 1110 ADAS_CANTRACE_EventInfo12 0;
BA_ "GenSigSendType" SG_ 1110 ADAS_CANTRACE_EventInfo12 1;
BA_ "GenSigStartValue" SG_ 1110 ADAS_CANTRACE_EventInfo12 0;
BA_ "GenSigTimeoutValue" SG_ 1110 ADAS_CANTRACE_EventInfo12 0;
BA_ "Remark" SG_ 1110 ADAS_CANTRACE_EventInfo12 "";
BA_ "EventCommandSignal" SG_ 1110 ADAS_CANTRACE_EventInfo13 0;
BA_ "GatewayedSignals" SG_ 1110 ADAS_CANTRACE_EventInfo13 0;
BA_ "GenSigInactiveValue" SG_ 1110 ADAS_CANTRACE_EventInfo13 0;
BA_ "GenSigInvalidValue" SG_ 1110 ADAS_CANTRACE_EventInfo13 0;
BA_ "GenSigSendType" SG_ 1110 ADAS_CANTRACE_EventInfo13 1;
BA_ "GenSigStartValue" SG_ 1110 ADAS_CANTRACE_EventInfo13 0;
BA_ "GenSigTimeoutValue" SG_ 1110 ADAS_CANTRACE_EventInfo13 0;
BA_ "Remark" SG_ 1110 ADAS_CANTRACE_EventInfo13 "";
BA_ "EventCommandSignal" SG_ 1110 ADAS_CANTRACE_EventInfo14 0;
BA_ "GatewayedSignals" SG_ 1110 ADAS_CANTRACE_EventInfo14 0;
BA_ "GenSigInactiveValue" SG_ 1110 ADAS_CANTRACE_EventInfo14 0;
BA_ "GenSigInvalidValue" SG_ 1110 ADAS_CANTRACE_EventInfo14 0;
BA_ "GenSigSendType" SG_ 1110 ADAS_CANTRACE_EventInfo14 1;
BA_ "GenSigStartValue" SG_ 1110 ADAS_CANTRACE_EventInfo14 0;
BA_ "GenSigTimeoutValue" SG_ 1110 ADAS_CANTRACE_EventInfo14 0;
BA_ "Remark" SG_ 1110 ADAS_CANTRACE_EventInfo14 "";
BA_ "EventCommandSignal" SG_ 1110 ADAS_CANTRACE_EventInfo15 0;
BA_ "GatewayedSignals" SG_ 1110 ADAS_CANTRACE_EventInfo15 0;
BA_ "GenSigInactiveValue" SG_ 1110 ADAS_CANTRACE_EventInfo15 0;
BA_ "GenSigInvalidValue" SG_ 1110 ADAS_CANTRACE_EventInfo15 0;
BA_ "GenSigSendType" SG_ 1110 ADAS_CANTRACE_EventInfo15 1;
BA_ "GenSigStartValue" SG_ 1110 ADAS_CANTRACE_EventInfo15 0;
BA_ "GenSigTimeoutValue" SG_ 1110 ADAS_CANTRACE_EventInfo15 0;
BA_ "Remark" SG_ 1110 ADAS_CANTRACE_EventInfo15 "";
BA_ "EventCommandSignal" SG_ 1110 ADAS_CANTRACE_EventInfo16 0;
BA_ "GatewayedSignals" SG_ 1110 ADAS_CANTRACE_EventInfo16 0;
BA_ "GenSigInactiveValue" SG_ 1110 ADAS_CANTRACE_EventInfo16 0;
BA_ "GenSigInvalidValue" SG_ 1110 ADAS_CANTRACE_EventInfo16 0;
BA_ "GenSigSendType" SG_ 1110 ADAS_CANTRACE_EventInfo16 1;
BA_ "GenSigStartValue" SG_ 1110 ADAS_CANTRACE_EventInfo16 0;
BA_ "GenSigTimeoutValue" SG_ 1110 ADAS_CANTRACE_EventInfo16 0;
BA_ "Remark" SG_ 1110 ADAS_CANTRACE_EventInfo16 "";
BA_ "EventCommandSignal" SG_ 1110 ADAS_CANTRACE_EventInfo17 0;
BA_ "GatewayedSignals" SG_ 1110 ADAS_CANTRACE_EventInfo17 0;
BA_ "GenSigInactiveValue" SG_ 1110 ADAS_CANTRACE_EventInfo17 0;
BA_ "GenSigInvalidValue" SG_ 1110 ADAS_CANTRACE_EventInfo17 0;
BA_ "GenSigSendType" SG_ 1110 ADAS_CANTRACE_EventInfo17 1;
BA_ "GenSigStartValue" SG_ 1110 ADAS_CANTRACE_EventInfo17 0;
BA_ "GenSigTimeoutValue" SG_ 1110 ADAS_CANTRACE_EventInfo17 0;
BA_ "Remark" SG_ 1110 ADAS_CANTRACE_EventInfo17 "";
BA_ "EventCommandSignal" SG_ 1110 ADAS_CANTRACE_EventInfo18 0;
BA_ "GatewayedSignals" SG_ 1110 ADAS_CANTRACE_EventInfo18 0;
BA_ "GenSigInactiveValue" SG_ 1110 ADAS_CANTRACE_EventInfo18 0;
BA_ "GenSigInvalidValue" SG_ 1110 ADAS_CANTRACE_EventInfo18 0;
BA_ "GenSigSendType" SG_ 1110 ADAS_CANTRACE_EventInfo18 1;
BA_ "GenSigStartValue" SG_ 1110 ADAS_CANTRACE_EventInfo18 0;
BA_ "GenSigTimeoutValue" SG_ 1110 ADAS_CANTRACE_EventInfo18 0;
BA_ "Remark" SG_ 1110 ADAS_CANTRACE_EventInfo18 "";
BA_ "EventCommandSignal" SG_ 1110 ADAS_CANTRACE_EventInfo19 0;
BA_ "GatewayedSignals" SG_ 1110 ADAS_CANTRACE_EventInfo19 0;
BA_ "GenSigInactiveValue" SG_ 1110 ADAS_CANTRACE_EventInfo19 0;
BA_ "GenSigInvalidValue" SG_ 1110 ADAS_CANTRACE_EventInfo19 0;
BA_ "GenSigSendType" SG_ 1110 ADAS_CANTRACE_EventInfo19 1;
BA_ "GenSigStartValue" SG_ 1110 ADAS_CANTRACE_EventInfo19 0;
BA_ "GenSigTimeoutValue" SG_ 1110 ADAS_CANTRACE_EventInfo19 0;
BA_ "Remark" SG_ 1110 ADAS_CANTRACE_EventInfo19 "";
BA_ "EventCommandSignal" SG_ 1110 ADAS_CANTRACE_EventInfo20 0;
BA_ "GatewayedSignals" SG_ 1110 ADAS_CANTRACE_EventInfo20 0;
BA_ "GenSigInactiveValue" SG_ 1110 ADAS_CANTRACE_EventInfo20 0;
BA_ "GenSigInvalidValue" SG_ 1110 ADAS_CANTRACE_EventInfo20 0;
BA_ "GenSigSendType" SG_ 1110 ADAS_CANTRACE_EventInfo20 1;
BA_ "GenSigStartValue" SG_ 1110 ADAS_CANTRACE_EventInfo20 0;
BA_ "GenSigTimeoutValue" SG_ 1110 ADAS_CANTRACE_EventInfo20 0;
BA_ "Remark" SG_ 1110 ADAS_CANTRACE_EventInfo20 "";
BA_ "EventCommandSignal" SG_ 1110 ADAS_CANTRACE_EventInfo21 0;
BA_ "GatewayedSignals" SG_ 1110 ADAS_CANTRACE_EventInfo21 0;
BA_ "GenSigInactiveValue" SG_ 1110 ADAS_CANTRACE_EventInfo21 0;
BA_ "GenSigInvalidValue" SG_ 1110 ADAS_CANTRACE_EventInfo21 0;
BA_ "GenSigSendType" SG_ 1110 ADAS_CANTRACE_EventInfo21 1;
BA_ "GenSigStartValue" SG_ 1110 ADAS_CANTRACE_EventInfo21 0;
BA_ "GenSigTimeoutValue" SG_ 1110 ADAS_CANTRACE_EventInfo21 0;
BA_ "Remark" SG_ 1110 ADAS_CANTRACE_EventInfo21 "";
BA_ "EventCommandSignal" SG_ 1110 ADAS_CANTRACE_EventInfo22 0;
BA_ "GatewayedSignals" SG_ 1110 ADAS_CANTRACE_EventInfo22 0;
BA_ "GenSigInactiveValue" SG_ 1110 ADAS_CANTRACE_EventInfo22 0;
BA_ "GenSigInvalidValue" SG_ 1110 ADAS_CANTRACE_EventInfo22 0;
BA_ "GenSigSendType" SG_ 1110 ADAS_CANTRACE_EventInfo22 1;
BA_ "GenSigStartValue" SG_ 1110 ADAS_CANTRACE_EventInfo22 0;
BA_ "GenSigTimeoutValue" SG_ 1110 ADAS_CANTRACE_EventInfo22 0;
BA_ "Remark" SG_ 1110 ADAS_CANTRACE_EventInfo22 "";
BA_ "EventCommandSignal" SG_ 1110 ADAS_CANTRACE_EventInfo23 0;
BA_ "GatewayedSignals" SG_ 1110 ADAS_CANTRACE_EventInfo23 0;
BA_ "GenSigInactiveValue" SG_ 1110 ADAS_CANTRACE_EventInfo23 0;
BA_ "GenSigInvalidValue" SG_ 1110 ADAS_CANTRACE_EventInfo23 0;
BA_ "GenSigSendType" SG_ 1110 ADAS_CANTRACE_EventInfo23 1;
BA_ "GenSigStartValue" SG_ 1110 ADAS_CANTRACE_EventInfo23 0;
BA_ "GenSigTimeoutValue" SG_ 1110 ADAS_CANTRACE_EventInfo23 0;
BA_ "Remark" SG_ 1110 ADAS_CANTRACE_EventInfo23 "";
BA_ "EventCommandSignal" SG_ 1110 ADAS_CANTRACE_EventInfo24 0;
BA_ "GatewayedSignals" SG_ 1110 ADAS_CANTRACE_EventInfo24 0;
BA_ "GenSigInactiveValue" SG_ 1110 ADAS_CANTRACE_EventInfo24 0;
BA_ "GenSigInvalidValue" SG_ 1110 ADAS_CANTRACE_EventInfo24 0;
BA_ "GenSigSendType" SG_ 1110 ADAS_CANTRACE_EventInfo24 1;
BA_ "GenSigStartValue" SG_ 1110 ADAS_CANTRACE_EventInfo24 0;
BA_ "GenSigTimeoutValue" SG_ 1110 ADAS_CANTRACE_EventInfo24 0;
BA_ "Remark" SG_ 1110 ADAS_CANTRACE_EventInfo24 "";
BA_ "EventCommandSignal" SG_ 1110 ADAS_CANTRACE_EventInfo25 0;
BA_ "GatewayedSignals" SG_ 1110 ADAS_CANTRACE_EventInfo25 0;
BA_ "GenSigInactiveValue" SG_ 1110 ADAS_CANTRACE_EventInfo25 0;
BA_ "GenSigInvalidValue" SG_ 1110 ADAS_CANTRACE_EventInfo25 0;
BA_ "GenSigSendType" SG_ 1110 ADAS_CANTRACE_EventInfo25 1;
BA_ "GenSigStartValue" SG_ 1110 ADAS_CANTRACE_EventInfo25 0;
BA_ "GenSigTimeoutValue" SG_ 1110 ADAS_CANTRACE_EventInfo25 0;
BA_ "Remark" SG_ 1110 ADAS_CANTRACE_EventInfo25 "";
BA_ "EventCommandSignal" SG_ 1110 ADAS_CANTRACE_EventInfo26 0;
BA_ "GatewayedSignals" SG_ 1110 ADAS_CANTRACE_EventInfo26 0;
BA_ "GenSigInactiveValue" SG_ 1110 ADAS_CANTRACE_EventInfo26 0;
BA_ "GenSigInvalidValue" SG_ 1110 ADAS_CANTRACE_EventInfo26 0;
BA_ "GenSigSendType" SG_ 1110 ADAS_CANTRACE_EventInfo26 1;
BA_ "GenSigStartValue" SG_ 1110 ADAS_CANTRACE_EventInfo26 0;
BA_ "GenSigTimeoutValue" SG_ 1110 ADAS_CANTRACE_EventInfo26 0;
BA_ "Remark" SG_ 1110 ADAS_CANTRACE_EventInfo26 "";
BA_ "EventCommandSignal" SG_ 1110 ADAS_CANTRACE_EventInfo27 0;
BA_ "GatewayedSignals" SG_ 1110 ADAS_CANTRACE_EventInfo27 0;
BA_ "GenSigInactiveValue" SG_ 1110 ADAS_CANTRACE_EventInfo27 0;
BA_ "GenSigInvalidValue" SG_ 1110 ADAS_CANTRACE_EventInfo27 0;
BA_ "GenSigSendType" SG_ 1110 ADAS_CANTRACE_EventInfo27 1;
BA_ "GenSigStartValue" SG_ 1110 ADAS_CANTRACE_EventInfo27 0;
BA_ "GenSigTimeoutValue" SG_ 1110 ADAS_CANTRACE_EventInfo27 0;
BA_ "Remark" SG_ 1110 ADAS_CANTRACE_EventInfo27 "";
BA_ "EventCommandSignal" SG_ 1110 ADAS_CANTRACE_EventInfo28 0;
BA_ "GatewayedSignals" SG_ 1110 ADAS_CANTRACE_EventInfo28 0;
BA_ "GenSigInactiveValue" SG_ 1110 ADAS_CANTRACE_EventInfo28 0;
BA_ "GenSigInvalidValue" SG_ 1110 ADAS_CANTRACE_EventInfo28 0;
BA_ "GenSigSendType" SG_ 1110 ADAS_CANTRACE_EventInfo28 1;
BA_ "GenSigStartValue" SG_ 1110 ADAS_CANTRACE_EventInfo28 0;
BA_ "GenSigTimeoutValue" SG_ 1110 ADAS_CANTRACE_EventInfo28 0;
BA_ "Remark" SG_ 1110 ADAS_CANTRACE_EventInfo28 "";
BA_ "EventCommandSignal" SG_ 1110 ADAS_CANTRACE_EventInfo29 0;
BA_ "GatewayedSignals" SG_ 1110 ADAS_CANTRACE_EventInfo29 0;
BA_ "GenSigInactiveValue" SG_ 1110 ADAS_CANTRACE_EventInfo29 0;
BA_ "GenSigInvalidValue" SG_ 1110 ADAS_CANTRACE_EventInfo29 0;
BA_ "GenSigSendType" SG_ 1110 ADAS_CANTRACE_EventInfo29 1;
BA_ "GenSigStartValue" SG_ 1110 ADAS_CANTRACE_EventInfo29 0;
BA_ "GenSigTimeoutValue" SG_ 1110 ADAS_CANTRACE_EventInfo29 0;
BA_ "Remark" SG_ 1110 ADAS_CANTRACE_EventInfo29 "";
BA_ "EventCommandSignal" SG_ 1110 ADAS_CANTRACE_EventInfo30 0;
BA_ "GatewayedSignals" SG_ 1110 ADAS_CANTRACE_EventInfo30 0;
BA_ "GenSigInactiveValue" SG_ 1110 ADAS_CANTRACE_EventInfo30 0;
BA_ "GenSigInvalidValue" SG_ 1110 ADAS_CANTRACE_EventInfo30 0;
BA_ "GenSigSendType" SG_ 1110 ADAS_CANTRACE_EventInfo30 1;
BA_ "GenSigStartValue" SG_ 1110 ADAS_CANTRACE_EventInfo30 0;
BA_ "GenSigTimeoutValue" SG_ 1110 ADAS_CANTRACE_EventInfo30 0;
BA_ "Remark" SG_ 1110 ADAS_CANTRACE_EventInfo30 "";
BA_ "EventCommandSignal" SG_ 1110 ADAS_CANTRACE_EventInfo31 0;
BA_ "GatewayedSignals" SG_ 1110 ADAS_CANTRACE_EventInfo31 0;
BA_ "GenSigInactiveValue" SG_ 1110 ADAS_CANTRACE_EventInfo31 0;
BA_ "GenSigInvalidValue" SG_ 1110 ADAS_CANTRACE_EventInfo31 0;
BA_ "GenSigSendType" SG_ 1110 ADAS_CANTRACE_EventInfo31 1;
BA_ "GenSigStartValue" SG_ 1110 ADAS_CANTRACE_EventInfo31 0;
BA_ "GenSigTimeoutValue" SG_ 1110 ADAS_CANTRACE_EventInfo31 0;
BA_ "Remark" SG_ 1110 ADAS_CANTRACE_EventInfo31 "";
BA_ "EventCommandSignal" SG_ 1110 ADAS_CANTRACE_EventInfo32 0;
BA_ "GatewayedSignals" SG_ 1110 ADAS_CANTRACE_EventInfo32 0;
BA_ "GenSigInactiveValue" SG_ 1110 ADAS_CANTRACE_EventInfo32 0;
BA_ "GenSigInvalidValue" SG_ 1110 ADAS_CANTRACE_EventInfo32 0;
BA_ "GenSigSendType" SG_ 1110 ADAS_CANTRACE_EventInfo32 1;
BA_ "GenSigStartValue" SG_ 1110 ADAS_CANTRACE_EventInfo32 0;
BA_ "GenSigTimeoutValue" SG_ 1110 ADAS_CANTRACE_EventInfo32 0;
BA_ "Remark" SG_ 1110 ADAS_CANTRACE_EventInfo32 "";
BA_ "EventCommandSignal" SG_ 1110 ADAS_CANTRACE_EventInfo33 0;
BA_ "GatewayedSignals" SG_ 1110 ADAS_CANTRACE_EventInfo33 0;
BA_ "GenSigInactiveValue" SG_ 1110 ADAS_CANTRACE_EventInfo33 0;
BA_ "GenSigInvalidValue" SG_ 1110 ADAS_CANTRACE_EventInfo33 0;
BA_ "GenSigSendType" SG_ 1110 ADAS_CANTRACE_EventInfo33 1;
BA_ "GenSigStartValue" SG_ 1110 ADAS_CANTRACE_EventInfo33 0;
BA_ "GenSigTimeoutValue" SG_ 1110 ADAS_CANTRACE_EventInfo33 0;
BA_ "Remark" SG_ 1110 ADAS_CANTRACE_EventInfo33 "";
BA_ "EventCommandSignal" SG_ 1110 ADAS_CANTRACE_EventInfo34 0;
BA_ "GatewayedSignals" SG_ 1110 ADAS_CANTRACE_EventInfo34 0;
BA_ "GenSigInactiveValue" SG_ 1110 ADAS_CANTRACE_EventInfo34 0;
BA_ "GenSigInvalidValue" SG_ 1110 ADAS_CANTRACE_EventInfo34 0;
BA_ "GenSigSendType" SG_ 1110 ADAS_CANTRACE_EventInfo34 1;
BA_ "GenSigStartValue" SG_ 1110 ADAS_CANTRACE_EventInfo34 0;
BA_ "GenSigTimeoutValue" SG_ 1110 ADAS_CANTRACE_EventInfo34 0;
BA_ "Remark" SG_ 1110 ADAS_CANTRACE_EventInfo34 "";
BA_ "EventCommandSignal" SG_ 1110 ADAS_CANTRACE_EventInfo35 0;
BA_ "GatewayedSignals" SG_ 1110 ADAS_CANTRACE_EventInfo35 0;
BA_ "GenSigInactiveValue" SG_ 1110 ADAS_CANTRACE_EventInfo35 0;
BA_ "GenSigInvalidValue" SG_ 1110 ADAS_CANTRACE_EventInfo35 0;
BA_ "GenSigSendType" SG_ 1110 ADAS_CANTRACE_EventInfo35 1;
BA_ "GenSigStartValue" SG_ 1110 ADAS_CANTRACE_EventInfo35 0;
BA_ "GenSigTimeoutValue" SG_ 1110 ADAS_CANTRACE_EventInfo35 0;
BA_ "Remark" SG_ 1110 ADAS_CANTRACE_EventInfo35 "";
BA_ "EventCommandSignal" SG_ 1110 ADAS_CANTRACE_EventInfo36 0;
BA_ "GatewayedSignals" SG_ 1110 ADAS_CANTRACE_EventInfo36 0;
BA_ "GenSigInactiveValue" SG_ 1110 ADAS_CANTRACE_EventInfo36 0;
BA_ "GenSigInvalidValue" SG_ 1110 ADAS_CANTRACE_EventInfo36 0;
BA_ "GenSigSendType" SG_ 1110 ADAS_CANTRACE_EventInfo36 1;
BA_ "GenSigStartValue" SG_ 1110 ADAS_CANTRACE_EventInfo36 0;
BA_ "GenSigTimeoutValue" SG_ 1110 ADAS_CANTRACE_EventInfo36 0;
BA_ "Remark" SG_ 1110 ADAS_CANTRACE_EventInfo36 "";
BA_ "EventCommandSignal" SG_ 1110 ADAS_CANTRACE_EventInfo37 0;
BA_ "GatewayedSignals" SG_ 1110 ADAS_CANTRACE_EventInfo37 0;
BA_ "GenSigInactiveValue" SG_ 1110 ADAS_CANTRACE_EventInfo37 0;
BA_ "GenSigInvalidValue" SG_ 1110 ADAS_CANTRACE_EventInfo37 0;
BA_ "GenSigSendType" SG_ 1110 ADAS_CANTRACE_EventInfo37 1;
BA_ "GenSigStartValue" SG_ 1110 ADAS_CANTRACE_EventInfo37 0;
BA_ "GenSigTimeoutValue" SG_ 1110 ADAS_CANTRACE_EventInfo37 0;
BA_ "Remark" SG_ 1110 ADAS_CANTRACE_EventInfo37 "";
BA_ "EventCommandSignal" SG_ 1110 ADAS_CANTRACE_EventInfo38 0;
BA_ "GatewayedSignals" SG_ 1110 ADAS_CANTRACE_EventInfo38 0;
BA_ "GenSigInactiveValue" SG_ 1110 ADAS_CANTRACE_EventInfo38 0;
BA_ "GenSigInvalidValue" SG_ 1110 ADAS_CANTRACE_EventInfo38 0;
BA_ "GenSigSendType" SG_ 1110 ADAS_CANTRACE_EventInfo38 1;
BA_ "GenSigStartValue" SG_ 1110 ADAS_CANTRACE_EventInfo38 0;
BA_ "GenSigTimeoutValue" SG_ 1110 ADAS_CANTRACE_EventInfo38 0;
BA_ "Remark" SG_ 1110 ADAS_CANTRACE_EventInfo38 "";
BA_ "EventCommandSignal" SG_ 1110 ADAS_CANTRACE_EventInfo39 0;
BA_ "GatewayedSignals" SG_ 1110 ADAS_CANTRACE_EventInfo39 0;
BA_ "GenSigInactiveValue" SG_ 1110 ADAS_CANTRACE_EventInfo39 0;
BA_ "GenSigInvalidValue" SG_ 1110 ADAS_CANTRACE_EventInfo39 0;
BA_ "GenSigSendType" SG_ 1110 ADAS_CANTRACE_EventInfo39 1;
BA_ "GenSigStartValue" SG_ 1110 ADAS_CANTRACE_EventInfo39 0;
BA_ "GenSigTimeoutValue" SG_ 1110 ADAS_CANTRACE_EventInfo39 0;
BA_ "Remark" SG_ 1110 ADAS_CANTRACE_EventInfo39 "";
BA_ "EventCommandSignal" SG_ 1110 ADAS_CANTRACE_EventInfo40 0;
BA_ "GatewayedSignals" SG_ 1110 ADAS_CANTRACE_EventInfo40 0;
BA_ "GenSigInactiveValue" SG_ 1110 ADAS_CANTRACE_EventInfo40 0;
BA_ "GenSigInvalidValue" SG_ 1110 ADAS_CANTRACE_EventInfo40 0;
BA_ "GenSigSendType" SG_ 1110 ADAS_CANTRACE_EventInfo40 1;
BA_ "GenSigStartValue" SG_ 1110 ADAS_CANTRACE_EventInfo40 0;
BA_ "GenSigTimeoutValue" SG_ 1110 ADAS_CANTRACE_EventInfo40 0;
BA_ "Remark" SG_ 1110 ADAS_CANTRACE_EventInfo40 "";
BA_ "EventCommandSignal" SG_ 1110 ADAS_CANTRACE_EventInfo41 0;
BA_ "GatewayedSignals" SG_ 1110 ADAS_CANTRACE_EventInfo41 0;
BA_ "GenSigInactiveValue" SG_ 1110 ADAS_CANTRACE_EventInfo41 0;
BA_ "GenSigInvalidValue" SG_ 1110 ADAS_CANTRACE_EventInfo41 0;
BA_ "GenSigSendType" SG_ 1110 ADAS_CANTRACE_EventInfo41 1;
BA_ "GenSigStartValue" SG_ 1110 ADAS_CANTRACE_EventInfo41 0;
BA_ "GenSigTimeoutValue" SG_ 1110 ADAS_CANTRACE_EventInfo41 0;
BA_ "Remark" SG_ 1110 ADAS_CANTRACE_EventInfo41 "";
BA_ "EventCommandSignal" SG_ 1110 ADAS_CANTRACE_EventInfo42 0;
BA_ "GatewayedSignals" SG_ 1110 ADAS_CANTRACE_EventInfo42 0;
BA_ "GenSigInactiveValue" SG_ 1110 ADAS_CANTRACE_EventInfo42 0;
BA_ "GenSigInvalidValue" SG_ 1110 ADAS_CANTRACE_EventInfo42 0;
BA_ "GenSigSendType" SG_ 1110 ADAS_CANTRACE_EventInfo42 1;
BA_ "GenSigStartValue" SG_ 1110 ADAS_CANTRACE_EventInfo42 0;
BA_ "GenSigTimeoutValue" SG_ 1110 ADAS_CANTRACE_EventInfo42 0;
BA_ "Remark" SG_ 1110 ADAS_CANTRACE_EventInfo42 "";
BA_ "EventCommandSignal" SG_ 1110 ADAS_CANTRACE_EventInfo43 0;
BA_ "GatewayedSignals" SG_ 1110 ADAS_CANTRACE_EventInfo43 0;
BA_ "GenSigInactiveValue" SG_ 1110 ADAS_CANTRACE_EventInfo43 0;
BA_ "GenSigInvalidValue" SG_ 1110 ADAS_CANTRACE_EventInfo43 0;
BA_ "GenSigSendType" SG_ 1110 ADAS_CANTRACE_EventInfo43 1;
BA_ "GenSigStartValue" SG_ 1110 ADAS_CANTRACE_EventInfo43 0;
BA_ "GenSigTimeoutValue" SG_ 1110 ADAS_CANTRACE_EventInfo43 0;
BA_ "Remark" SG_ 1110 ADAS_CANTRACE_EventInfo43 "";
BA_ "EventCommandSignal" SG_ 1110 ADAS_CANTRACE_EventInfo44 0;
BA_ "GatewayedSignals" SG_ 1110 ADAS_CANTRACE_EventInfo44 0;
BA_ "GenSigInactiveValue" SG_ 1110 ADAS_CANTRACE_EventInfo44 0;
BA_ "GenSigInvalidValue" SG_ 1110 ADAS_CANTRACE_EventInfo44 0;
BA_ "GenSigSendType" SG_ 1110 ADAS_CANTRACE_EventInfo44 1;
BA_ "GenSigStartValue" SG_ 1110 ADAS_CANTRACE_EventInfo44 0;
BA_ "GenSigTimeoutValue" SG_ 1110 ADAS_CANTRACE_EventInfo44 0;
BA_ "Remark" SG_ 1110 ADAS_CANTRACE_EventInfo44 "";
BA_ "EventCommandSignal" SG_ 1110 ADAS_CANTRACE_EventInfo45 0;
BA_ "GatewayedSignals" SG_ 1110 ADAS_CANTRACE_EventInfo45 0;
BA_ "GenSigInactiveValue" SG_ 1110 ADAS_CANTRACE_EventInfo45 0;
BA_ "GenSigInvalidValue" SG_ 1110 ADAS_CANTRACE_EventInfo45 0;
BA_ "GenSigSendType" SG_ 1110 ADAS_CANTRACE_EventInfo45 1;
BA_ "GenSigStartValue" SG_ 1110 ADAS_CANTRACE_EventInfo45 0;
BA_ "GenSigTimeoutValue" SG_ 1110 ADAS_CANTRACE_EventInfo45 0;
BA_ "Remark" SG_ 1110 ADAS_CANTRACE_EventInfo45 "";
BA_ "EventCommandSignal" SG_ 1110 ADAS_CANTRACE_EventInfo46 0;
BA_ "GatewayedSignals" SG_ 1110 ADAS_CANTRACE_EventInfo46 0;
BA_ "GenSigInactiveValue" SG_ 1110 ADAS_CANTRACE_EventInfo46 0;
BA_ "GenSigInvalidValue" SG_ 1110 ADAS_CANTRACE_EventInfo46 0;
BA_ "GenSigSendType" SG_ 1110 ADAS_CANTRACE_EventInfo46 1;
BA_ "GenSigStartValue" SG_ 1110 ADAS_CANTRACE_EventInfo46 0;
BA_ "GenSigTimeoutValue" SG_ 1110 ADAS_CANTRACE_EventInfo46 0;
BA_ "Remark" SG_ 1110 ADAS_CANTRACE_EventInfo46 "";
BA_ "EventCommandSignal" SG_ 1110 ADAS_CANTRACE_EventInfo47 0;
BA_ "GatewayedSignals" SG_ 1110 ADAS_CANTRACE_EventInfo47 0;
BA_ "GenSigInactiveValue" SG_ 1110 ADAS_CANTRACE_EventInfo47 0;
BA_ "GenSigInvalidValue" SG_ 1110 ADAS_CANTRACE_EventInfo47 0;
BA_ "GenSigSendType" SG_ 1110 ADAS_CANTRACE_EventInfo47 1;
BA_ "GenSigStartValue" SG_ 1110 ADAS_CANTRACE_EventInfo47 0;
BA_ "GenSigTimeoutValue" SG_ 1110 ADAS_CANTRACE_EventInfo47 0;
BA_ "Remark" SG_ 1110 ADAS_CANTRACE_EventInfo47 "";
BA_ "EventCommandSignal" SG_ 1110 ADAS_CANTRACE_EventInfo48 0;
BA_ "GatewayedSignals" SG_ 1110 ADAS_CANTRACE_EventInfo48 0;
BA_ "GenSigInactiveValue" SG_ 1110 ADAS_CANTRACE_EventInfo48 0;
BA_ "GenSigInvalidValue" SG_ 1110 ADAS_CANTRACE_EventInfo48 0;
BA_ "GenSigSendType" SG_ 1110 ADAS_CANTRACE_EventInfo48 1;
BA_ "GenSigStartValue" SG_ 1110 ADAS_CANTRACE_EventInfo48 0;
BA_ "GenSigTimeoutValue" SG_ 1110 ADAS_CANTRACE_EventInfo48 0;
BA_ "Remark" SG_ 1110 ADAS_CANTRACE_EventInfo48 "";
BA_ "EventCommandSignal" SG_ 1110 ADAS_CANTRACE_EventInfo49 0;
BA_ "GatewayedSignals" SG_ 1110 ADAS_CANTRACE_EventInfo49 0;
BA_ "GenSigInactiveValue" SG_ 1110 ADAS_CANTRACE_EventInfo49 0;
BA_ "GenSigInvalidValue" SG_ 1110 ADAS_CANTRACE_EventInfo49 0;
BA_ "GenSigSendType" SG_ 1110 ADAS_CANTRACE_EventInfo49 1;
BA_ "GenSigStartValue" SG_ 1110 ADAS_CANTRACE_EventInfo49 0;
BA_ "GenSigTimeoutValue" SG_ 1110 ADAS_CANTRACE_EventInfo49 0;
BA_ "Remark" SG_ 1110 ADAS_CANTRACE_EventInfo49 "";
BA_ "EventCommandSignal" SG_ 1110 ADAS_CANTRACE_EventInfo50 0;
BA_ "GatewayedSignals" SG_ 1110 ADAS_CANTRACE_EventInfo50 0;
BA_ "GenSigInactiveValue" SG_ 1110 ADAS_CANTRACE_EventInfo50 0;
BA_ "GenSigInvalidValue" SG_ 1110 ADAS_CANTRACE_EventInfo50 0;
BA_ "GenSigSendType" SG_ 1110 ADAS_CANTRACE_EventInfo50 1;
BA_ "GenSigStartValue" SG_ 1110 ADAS_CANTRACE_EventInfo50 0;
BA_ "GenSigTimeoutValue" SG_ 1110 ADAS_CANTRACE_EventInfo50 0;
BA_ "Remark" SG_ 1110 ADAS_CANTRACE_EventInfo50 "";
BA_ "EventCommandSignal" SG_ 1110 ADAS_CANTRACE_EventInfo51 0;
BA_ "GatewayedSignals" SG_ 1110 ADAS_CANTRACE_EventInfo51 0;
BA_ "GenSigInactiveValue" SG_ 1110 ADAS_CANTRACE_EventInfo51 0;
BA_ "GenSigInvalidValue" SG_ 1110 ADAS_CANTRACE_EventInfo51 0;
BA_ "GenSigSendType" SG_ 1110 ADAS_CANTRACE_EventInfo51 1;
BA_ "GenSigStartValue" SG_ 1110 ADAS_CANTRACE_EventInfo51 0;
BA_ "GenSigTimeoutValue" SG_ 1110 ADAS_CANTRACE_EventInfo51 0;
BA_ "Remark" SG_ 1110 ADAS_CANTRACE_EventInfo51 "";
BA_ "EventCommandSignal" SG_ 1110 ADAS_CANTRACE_EventInfo52 0;
BA_ "GatewayedSignals" SG_ 1110 ADAS_CANTRACE_EventInfo52 0;
BA_ "GenSigInactiveValue" SG_ 1110 ADAS_CANTRACE_EventInfo52 0;
BA_ "GenSigInvalidValue" SG_ 1110 ADAS_CANTRACE_EventInfo52 0;
BA_ "GenSigSendType" SG_ 1110 ADAS_CANTRACE_EventInfo52 1;
BA_ "GenSigStartValue" SG_ 1110 ADAS_CANTRACE_EventInfo52 0;
BA_ "GenSigTimeoutValue" SG_ 1110 ADAS_CANTRACE_EventInfo52 0;
BA_ "Remark" SG_ 1110 ADAS_CANTRACE_EventInfo52 "";
BA_ "EventCommandSignal" SG_ 1110 ADAS_CANTRACE_EventInfo53 0;
BA_ "GatewayedSignals" SG_ 1110 ADAS_CANTRACE_EventInfo53 0;
BA_ "GenSigInactiveValue" SG_ 1110 ADAS_CANTRACE_EventInfo53 0;
BA_ "GenSigInvalidValue" SG_ 1110 ADAS_CANTRACE_EventInfo53 0;
BA_ "GenSigSendType" SG_ 1110 ADAS_CANTRACE_EventInfo53 1;
BA_ "GenSigStartValue" SG_ 1110 ADAS_CANTRACE_EventInfo53 0;
BA_ "GenSigTimeoutValue" SG_ 1110 ADAS_CANTRACE_EventInfo53 0;
BA_ "Remark" SG_ 1110 ADAS_CANTRACE_EventInfo53 "";
BA_ "EventCommandSignal" SG_ 1110 ADAS_CANTRACE_EventInfo54 0;
BA_ "GatewayedSignals" SG_ 1110 ADAS_CANTRACE_EventInfo54 0;
BA_ "GenSigInactiveValue" SG_ 1110 ADAS_CANTRACE_EventInfo54 0;
BA_ "GenSigInvalidValue" SG_ 1110 ADAS_CANTRACE_EventInfo54 0;
BA_ "GenSigSendType" SG_ 1110 ADAS_CANTRACE_EventInfo54 1;
BA_ "GenSigStartValue" SG_ 1110 ADAS_CANTRACE_EventInfo54 0;
BA_ "GenSigTimeoutValue" SG_ 1110 ADAS_CANTRACE_EventInfo54 0;
BA_ "Remark" SG_ 1110 ADAS_CANTRACE_EventInfo54 "";
BA_ "EventCommandSignal" SG_ 1110 ADAS_CANTRACE_EventInfo55 0;
BA_ "GatewayedSignals" SG_ 1110 ADAS_CANTRACE_EventInfo55 0;
BA_ "GenSigInactiveValue" SG_ 1110 ADAS_CANTRACE_EventInfo55 0;
BA_ "GenSigInvalidValue" SG_ 1110 ADAS_CANTRACE_EventInfo55 0;
BA_ "GenSigSendType" SG_ 1110 ADAS_CANTRACE_EventInfo55 1;
BA_ "GenSigStartValue" SG_ 1110 ADAS_CANTRACE_EventInfo55 0;
BA_ "GenSigTimeoutValue" SG_ 1110 ADAS_CANTRACE_EventInfo55 0;
BA_ "Remark" SG_ 1110 ADAS_CANTRACE_EventInfo55 "";
BA_ "EventCommandSignal" SG_ 1110 ADAS_CANTRACE_EventInfo56 0;
BA_ "GatewayedSignals" SG_ 1110 ADAS_CANTRACE_EventInfo56 0;
BA_ "GenSigInactiveValue" SG_ 1110 ADAS_CANTRACE_EventInfo56 0;
BA_ "GenSigInvalidValue" SG_ 1110 ADAS_CANTRACE_EventInfo56 0;
BA_ "GenSigSendType" SG_ 1110 ADAS_CANTRACE_EventInfo56 1;
BA_ "GenSigStartValue" SG_ 1110 ADAS_CANTRACE_EventInfo56 0;
BA_ "GenSigTimeoutValue" SG_ 1110 ADAS_CANTRACE_EventInfo56 0;
BA_ "Remark" SG_ 1110 ADAS_CANTRACE_EventInfo56 "";
BA_ "EventCommandSignal" SG_ 1110 ADAS_CANTRACE_EventInfo57 0;
BA_ "GatewayedSignals" SG_ 1110 ADAS_CANTRACE_EventInfo57 0;
BA_ "GenSigInactiveValue" SG_ 1110 ADAS_CANTRACE_EventInfo57 0;
BA_ "GenSigInvalidValue" SG_ 1110 ADAS_CANTRACE_EventInfo57 0;
BA_ "GenSigSendType" SG_ 1110 ADAS_CANTRACE_EventInfo57 1;
BA_ "GenSigStartValue" SG_ 1110 ADAS_CANTRACE_EventInfo57 0;
BA_ "GenSigTimeoutValue" SG_ 1110 ADAS_CANTRACE_EventInfo57 0;
BA_ "Remark" SG_ 1110 ADAS_CANTRACE_EventInfo57 "";
BA_ "EventCommandSignal" SG_ 1110 ADAS_CANTRACE_EventInfo58 0;
BA_ "GatewayedSignals" SG_ 1110 ADAS_CANTRACE_EventInfo58 0;
BA_ "GenSigInactiveValue" SG_ 1110 ADAS_CANTRACE_EventInfo58 0;
BA_ "GenSigInvalidValue" SG_ 1110 ADAS_CANTRACE_EventInfo58 0;
BA_ "GenSigSendType" SG_ 1110 ADAS_CANTRACE_EventInfo58 1;
BA_ "GenSigStartValue" SG_ 1110 ADAS_CANTRACE_EventInfo58 0;
BA_ "GenSigTimeoutValue" SG_ 1110 ADAS_CANTRACE_EventInfo58 0;
BA_ "Remark" SG_ 1110 ADAS_CANTRACE_EventInfo58 "";
BA_ "EventCommandSignal" SG_ 1110 ADAS_CANTRACE_EventInfo59 0;
BA_ "GatewayedSignals" SG_ 1110 ADAS_CANTRACE_EventInfo59 0;
BA_ "GenSigInactiveValue" SG_ 1110 ADAS_CANTRACE_EventInfo59 0;
BA_ "GenSigInvalidValue" SG_ 1110 ADAS_CANTRACE_EventInfo59 0;
BA_ "GenSigSendType" SG_ 1110 ADAS_CANTRACE_EventInfo59 1;
BA_ "GenSigStartValue" SG_ 1110 ADAS_CANTRACE_EventInfo59 0;
BA_ "GenSigTimeoutValue" SG_ 1110 ADAS_CANTRACE_EventInfo59 0;
BA_ "Remark" SG_ 1110 ADAS_CANTRACE_EventInfo59 "";
BA_ "EventCommandSignal" SG_ 1110 ADAS_CANTRACE_EventInfo60 0;
BA_ "GatewayedSignals" SG_ 1110 ADAS_CANTRACE_EventInfo60 0;
BA_ "GenSigInactiveValue" SG_ 1110 ADAS_CANTRACE_EventInfo60 0;
BA_ "GenSigInvalidValue" SG_ 1110 ADAS_CANTRACE_EventInfo60 0;
BA_ "GenSigSendType" SG_ 1110 ADAS_CANTRACE_EventInfo60 1;
BA_ "GenSigStartValue" SG_ 1110 ADAS_CANTRACE_EventInfo60 0;
BA_ "GenSigTimeoutValue" SG_ 1110 ADAS_CANTRACE_EventInfo60 0;
BA_ "Remark" SG_ 1110 ADAS_CANTRACE_EventInfo60 "";
BA_ "EventCommandSignal" SG_ 1110 ADAS_CANTRACE_EventInfo61 0;
BA_ "GatewayedSignals" SG_ 1110 ADAS_CANTRACE_EventInfo61 0;
BA_ "GenSigInactiveValue" SG_ 1110 ADAS_CANTRACE_EventInfo61 0;
BA_ "GenSigInvalidValue" SG_ 1110 ADAS_CANTRACE_EventInfo61 0;
BA_ "GenSigSendType" SG_ 1110 ADAS_CANTRACE_EventInfo61 1;
BA_ "GenSigStartValue" SG_ 1110 ADAS_CANTRACE_EventInfo61 0;
BA_ "GenSigTimeoutValue" SG_ 1110 ADAS_CANTRACE_EventInfo61 0;
BA_ "Remark" SG_ 1110 ADAS_CANTRACE_EventInfo61 "";
BA_ "EventCommandSignal" SG_ 1111 ADAS_CANTRACE_AlarmPktType 0;
BA_ "GatewayedSignals" SG_ 1111 ADAS_CANTRACE_AlarmPktType 0;
BA_ "GenSigInactiveValue" SG_ 1111 ADAS_CANTRACE_AlarmPktType 0;
BA_ "GenSigInvalidValue" SG_ 1111 ADAS_CANTRACE_AlarmPktType 255;
BA_ "GenSigSendType" SG_ 1111 ADAS_CANTRACE_AlarmPktType 1;
BA_ "GenSigStartValue" SG_ 1111 ADAS_CANTRACE_AlarmPktType 0;
BA_ "GenSigTimeoutValue" SG_ 1111 ADAS_CANTRACE_AlarmPktType 0;
BA_ "Remark" SG_ 1111 ADAS_CANTRACE_AlarmPktType "";
BA_ "EventCommandSignal" SG_ 1111 ADAS_CANTRACE_AlarmPktCount 0;
BA_ "GatewayedSignals" SG_ 1111 ADAS_CANTRACE_AlarmPktCount 0;
BA_ "GenSigInactiveValue" SG_ 1111 ADAS_CANTRACE_AlarmPktCount 0;
BA_ "GenSigInvalidValue" SG_ 1111 ADAS_CANTRACE_AlarmPktCount 255;
BA_ "GenSigSendType" SG_ 1111 ADAS_CANTRACE_AlarmPktCount 1;
BA_ "GenSigStartValue" SG_ 1111 ADAS_CANTRACE_AlarmPktCount 0;
BA_ "GenSigTimeoutValue" SG_ 1111 ADAS_CANTRACE_AlarmPktCount 0;
BA_ "Remark" SG_ 1111 ADAS_CANTRACE_AlarmPktCount "";
BA_ "EventCommandSignal" SG_ 1111 ADAS_CANTRACE_AlarmNum 0;
BA_ "GatewayedSignals" SG_ 1111 ADAS_CANTRACE_AlarmNum 0;
BA_ "GenSigInactiveValue" SG_ 1111 ADAS_CANTRACE_AlarmNum 0;
BA_ "GenSigInvalidValue" SG_ 1111 ADAS_CANTRACE_AlarmNum 255;
BA_ "GenSigSendType" SG_ 1111 ADAS_CANTRACE_AlarmNum 1;
BA_ "GenSigStartValue" SG_ 1111 ADAS_CANTRACE_AlarmNum 0;
BA_ "GenSigTimeoutValue" SG_ 1111 ADAS_CANTRACE_AlarmNum 0;
BA_ "Remark" SG_ 1111 ADAS_CANTRACE_AlarmNum "";
BA_ "EventCommandSignal" SG_ 1111 ADAS_CANTRACE_AlarmFaultId0 0;
BA_ "GatewayedSignals" SG_ 1111 ADAS_CANTRACE_AlarmFaultId0 0;
BA_ "GenSigInactiveValue" SG_ 1111 ADAS_CANTRACE_AlarmFaultId0 0;
BA_ "GenSigInvalidValue" SG_ 1111 ADAS_CANTRACE_AlarmFaultId0 65535;
BA_ "GenSigSendType" SG_ 1111 ADAS_CANTRACE_AlarmFaultId0 1;
BA_ "GenSigStartValue" SG_ 1111 ADAS_CANTRACE_AlarmFaultId0 0;
BA_ "GenSigTimeoutValue" SG_ 1111 ADAS_CANTRACE_AlarmFaultId0 0;
BA_ "Remark" SG_ 1111 ADAS_CANTRACE_AlarmFaultId0 "";
BA_ "EventCommandSignal" SG_ 1111 ADAS_CANTRACE_AlarmKeyPara0 0;
BA_ "GatewayedSignals" SG_ 1111 ADAS_CANTRACE_AlarmKeyPara0 0;
BA_ "GenSigInactiveValue" SG_ 1111 ADAS_CANTRACE_AlarmKeyPara0 0;
BA_ "GenSigInvalidValue" SG_ 1111 ADAS_CANTRACE_AlarmKeyPara0 65535;
BA_ "GenSigSendType" SG_ 1111 ADAS_CANTRACE_AlarmKeyPara0 1;
BA_ "GenSigStartValue" SG_ 1111 ADAS_CANTRACE_AlarmKeyPara0 0;
BA_ "GenSigTimeoutValue" SG_ 1111 ADAS_CANTRACE_AlarmKeyPara0 0;
BA_ "Remark" SG_ 1111 ADAS_CANTRACE_AlarmKeyPara0 "";
BA_ "EventCommandSignal" SG_ 1111 ADAS_CANTRACE_AlarmFaultId1 0;
BA_ "GatewayedSignals" SG_ 1111 ADAS_CANTRACE_AlarmFaultId1 0;
BA_ "GenSigInactiveValue" SG_ 1111 ADAS_CANTRACE_AlarmFaultId1 0;
BA_ "GenSigInvalidValue" SG_ 1111 ADAS_CANTRACE_AlarmFaultId1 65535;
BA_ "GenSigSendType" SG_ 1111 ADAS_CANTRACE_AlarmFaultId1 1;
BA_ "GenSigStartValue" SG_ 1111 ADAS_CANTRACE_AlarmFaultId1 0;
BA_ "GenSigTimeoutValue" SG_ 1111 ADAS_CANTRACE_AlarmFaultId1 0;
BA_ "Remark" SG_ 1111 ADAS_CANTRACE_AlarmFaultId1 "";
BA_ "EventCommandSignal" SG_ 1111 ADAS_CANTRACE_AlarmKeyPara1 0;
BA_ "GatewayedSignals" SG_ 1111 ADAS_CANTRACE_AlarmKeyPara1 0;
BA_ "GenSigInactiveValue" SG_ 1111 ADAS_CANTRACE_AlarmKeyPara1 0;
BA_ "GenSigInvalidValue" SG_ 1111 ADAS_CANTRACE_AlarmKeyPara1 65535;
BA_ "GenSigSendType" SG_ 1111 ADAS_CANTRACE_AlarmKeyPara1 1;
BA_ "GenSigStartValue" SG_ 1111 ADAS_CANTRACE_AlarmKeyPara1 0;
BA_ "GenSigTimeoutValue" SG_ 1111 ADAS_CANTRACE_AlarmKeyPara1 0;
BA_ "Remark" SG_ 1111 ADAS_CANTRACE_AlarmKeyPara1 "";
BA_ "EventCommandSignal" SG_ 1111 ADAS_CANTRACE_AlarmFaultId2 0;
BA_ "GatewayedSignals" SG_ 1111 ADAS_CANTRACE_AlarmFaultId2 0;
BA_ "GenSigInactiveValue" SG_ 1111 ADAS_CANTRACE_AlarmFaultId2 0;
BA_ "GenSigInvalidValue" SG_ 1111 ADAS_CANTRACE_AlarmFaultId2 65535;
BA_ "GenSigSendType" SG_ 1111 ADAS_CANTRACE_AlarmFaultId2 1;
BA_ "GenSigStartValue" SG_ 1111 ADAS_CANTRACE_AlarmFaultId2 0;
BA_ "GenSigTimeoutValue" SG_ 1111 ADAS_CANTRACE_AlarmFaultId2 0;
BA_ "Remark" SG_ 1111 ADAS_CANTRACE_AlarmFaultId2 "";
BA_ "EventCommandSignal" SG_ 1111 ADAS_CANTRACE_AlarmKeyPara2 0;
BA_ "GatewayedSignals" SG_ 1111 ADAS_CANTRACE_AlarmKeyPara2 0;
BA_ "GenSigInactiveValue" SG_ 1111 ADAS_CANTRACE_AlarmKeyPara2 0;
BA_ "GenSigInvalidValue" SG_ 1111 ADAS_CANTRACE_AlarmKeyPara2 65535;
BA_ "GenSigSendType" SG_ 1111 ADAS_CANTRACE_AlarmKeyPara2 1;
BA_ "GenSigStartValue" SG_ 1111 ADAS_CANTRACE_AlarmKeyPara2 0;
BA_ "GenSigTimeoutValue" SG_ 1111 ADAS_CANTRACE_AlarmKeyPara2 0;
BA_ "Remark" SG_ 1111 ADAS_CANTRACE_AlarmKeyPara2 "";
BA_ "EventCommandSignal" SG_ 1111 ADAS_CANTRACE_AlarmFaultId3 0;
BA_ "GatewayedSignals" SG_ 1111 ADAS_CANTRACE_AlarmFaultId3 0;
BA_ "GenSigInactiveValue" SG_ 1111 ADAS_CANTRACE_AlarmFaultId3 0;
BA_ "GenSigInvalidValue" SG_ 1111 ADAS_CANTRACE_AlarmFaultId3 65535;
BA_ "GenSigSendType" SG_ 1111 ADAS_CANTRACE_AlarmFaultId3 1;
BA_ "GenSigStartValue" SG_ 1111 ADAS_CANTRACE_AlarmFaultId3 0;
BA_ "GenSigTimeoutValue" SG_ 1111 ADAS_CANTRACE_AlarmFaultId3 0;
BA_ "Remark" SG_ 1111 ADAS_CANTRACE_AlarmFaultId3 "";
BA_ "EventCommandSignal" SG_ 1111 ADAS_CANTRACE_AlarmKeyPara3 0;
BA_ "GatewayedSignals" SG_ 1111 ADAS_CANTRACE_AlarmKeyPara3 0;
BA_ "GenSigInactiveValue" SG_ 1111 ADAS_CANTRACE_AlarmKeyPara3 0;
BA_ "GenSigInvalidValue" SG_ 1111 ADAS_CANTRACE_AlarmKeyPara3 65535;
BA_ "GenSigSendType" SG_ 1111 ADAS_CANTRACE_AlarmKeyPara3 1;
BA_ "GenSigStartValue" SG_ 1111 ADAS_CANTRACE_AlarmKeyPara3 0;
BA_ "GenSigTimeoutValue" SG_ 1111 ADAS_CANTRACE_AlarmKeyPara3 0;
BA_ "Remark" SG_ 1111 ADAS_CANTRACE_AlarmKeyPara3 "";
BA_ "EventCommandSignal" SG_ 1111 ADAS_CANTRACE_AlarmFaultId4 0;
BA_ "GatewayedSignals" SG_ 1111 ADAS_CANTRACE_AlarmFaultId4 0;
BA_ "GenSigInactiveValue" SG_ 1111 ADAS_CANTRACE_AlarmFaultId4 0;
BA_ "GenSigInvalidValue" SG_ 1111 ADAS_CANTRACE_AlarmFaultId4 65535;
BA_ "GenSigSendType" SG_ 1111 ADAS_CANTRACE_AlarmFaultId4 1;
BA_ "GenSigStartValue" SG_ 1111 ADAS_CANTRACE_AlarmFaultId4 0;
BA_ "GenSigTimeoutValue" SG_ 1111 ADAS_CANTRACE_AlarmFaultId4 0;
BA_ "Remark" SG_ 1111 ADAS_CANTRACE_AlarmFaultId4 "";
BA_ "EventCommandSignal" SG_ 1111 ADAS_CANTRACE_AlarmKeyPara4 0;
BA_ "GatewayedSignals" SG_ 1111 ADAS_CANTRACE_AlarmKeyPara4 0;
BA_ "GenSigInactiveValue" SG_ 1111 ADAS_CANTRACE_AlarmKeyPara4 0;
BA_ "GenSigInvalidValue" SG_ 1111 ADAS_CANTRACE_AlarmKeyPara4 65535;
BA_ "GenSigSendType" SG_ 1111 ADAS_CANTRACE_AlarmKeyPara4 1;
BA_ "GenSigStartValue" SG_ 1111 ADAS_CANTRACE_AlarmKeyPara4 0;
BA_ "GenSigTimeoutValue" SG_ 1111 ADAS_CANTRACE_AlarmKeyPara4 0;
BA_ "Remark" SG_ 1111 ADAS_CANTRACE_AlarmKeyPara4 "";
BA_ "EventCommandSignal" SG_ 1111 ADAS_CANTRACE_AlarmFaultId5 0;
BA_ "GatewayedSignals" SG_ 1111 ADAS_CANTRACE_AlarmFaultId5 0;
BA_ "GenSigInactiveValue" SG_ 1111 ADAS_CANTRACE_AlarmFaultId5 0;
BA_ "GenSigInvalidValue" SG_ 1111 ADAS_CANTRACE_AlarmFaultId5 65535;
BA_ "GenSigSendType" SG_ 1111 ADAS_CANTRACE_AlarmFaultId5 1;
BA_ "GenSigStartValue" SG_ 1111 ADAS_CANTRACE_AlarmFaultId5 0;
BA_ "GenSigTimeoutValue" SG_ 1111 ADAS_CANTRACE_AlarmFaultId5 0;
BA_ "Remark" SG_ 1111 ADAS_CANTRACE_AlarmFaultId5 "";
BA_ "EventCommandSignal" SG_ 1111 ADAS_CANTRACE_AlarmKeyPara5 0;
BA_ "GatewayedSignals" SG_ 1111 ADAS_CANTRACE_AlarmKeyPara5 0;
BA_ "GenSigInactiveValue" SG_ 1111 ADAS_CANTRACE_AlarmKeyPara5 0;
BA_ "GenSigInvalidValue" SG_ 1111 ADAS_CANTRACE_AlarmKeyPara5 65535;
BA_ "GenSigSendType" SG_ 1111 ADAS_CANTRACE_AlarmKeyPara5 1;
BA_ "GenSigStartValue" SG_ 1111 ADAS_CANTRACE_AlarmKeyPara5 0;
BA_ "GenSigTimeoutValue" SG_ 1111 ADAS_CANTRACE_AlarmKeyPara5 0;
BA_ "Remark" SG_ 1111 ADAS_CANTRACE_AlarmKeyPara5 "";
BA_ "EventCommandSignal" SG_ 1111 ADAS_CANTRACE_AlarmFaultId6 0;
BA_ "GatewayedSignals" SG_ 1111 ADAS_CANTRACE_AlarmFaultId6 0;
BA_ "GenSigInactiveValue" SG_ 1111 ADAS_CANTRACE_AlarmFaultId6 0;
BA_ "GenSigInvalidValue" SG_ 1111 ADAS_CANTRACE_AlarmFaultId6 65535;
BA_ "GenSigSendType" SG_ 1111 ADAS_CANTRACE_AlarmFaultId6 1;
BA_ "GenSigStartValue" SG_ 1111 ADAS_CANTRACE_AlarmFaultId6 0;
BA_ "GenSigTimeoutValue" SG_ 1111 ADAS_CANTRACE_AlarmFaultId6 0;
BA_ "Remark" SG_ 1111 ADAS_CANTRACE_AlarmFaultId6 "";
BA_ "EventCommandSignal" SG_ 1111 ADAS_CANTRACE_AlarmKeyPara6 0;
BA_ "GatewayedSignals" SG_ 1111 ADAS_CANTRACE_AlarmKeyPara6 0;
BA_ "GenSigInactiveValue" SG_ 1111 ADAS_CANTRACE_AlarmKeyPara6 0;
BA_ "GenSigInvalidValue" SG_ 1111 ADAS_CANTRACE_AlarmKeyPara6 65535;
BA_ "GenSigSendType" SG_ 1111 ADAS_CANTRACE_AlarmKeyPara6 1;
BA_ "GenSigStartValue" SG_ 1111 ADAS_CANTRACE_AlarmKeyPara6 0;
BA_ "GenSigTimeoutValue" SG_ 1111 ADAS_CANTRACE_AlarmKeyPara6 0;
BA_ "Remark" SG_ 1111 ADAS_CANTRACE_AlarmKeyPara6 "";
BA_ "EventCommandSignal" SG_ 1111 ADAS_CANTRACE_AlarmFaultId7 0;
BA_ "GatewayedSignals" SG_ 1111 ADAS_CANTRACE_AlarmFaultId7 0;
BA_ "GenSigInactiveValue" SG_ 1111 ADAS_CANTRACE_AlarmFaultId7 0;
BA_ "GenSigInvalidValue" SG_ 1111 ADAS_CANTRACE_AlarmFaultId7 65535;
BA_ "GenSigSendType" SG_ 1111 ADAS_CANTRACE_AlarmFaultId7 1;
BA_ "GenSigStartValue" SG_ 1111 ADAS_CANTRACE_AlarmFaultId7 0;
BA_ "GenSigTimeoutValue" SG_ 1111 ADAS_CANTRACE_AlarmFaultId7 0;
BA_ "Remark" SG_ 1111 ADAS_CANTRACE_AlarmFaultId7 "";
BA_ "EventCommandSignal" SG_ 1111 ADAS_CANTRACE_AlarmKeyPara7 0;
BA_ "GatewayedSignals" SG_ 1111 ADAS_CANTRACE_AlarmKeyPara7 0;
BA_ "GenSigInactiveValue" SG_ 1111 ADAS_CANTRACE_AlarmKeyPara7 0;
BA_ "GenSigInvalidValue" SG_ 1111 ADAS_CANTRACE_AlarmKeyPara7 65535;
BA_ "GenSigSendType" SG_ 1111 ADAS_CANTRACE_AlarmKeyPara7 1;
BA_ "GenSigStartValue" SG_ 1111 ADAS_CANTRACE_AlarmKeyPara7 0;
BA_ "GenSigTimeoutValue" SG_ 1111 ADAS_CANTRACE_AlarmKeyPara7 0;
BA_ "Remark" SG_ 1111 ADAS_CANTRACE_AlarmKeyPara7 "";
BA_ "EventCommandSignal" SG_ 1111 ADAS_CANTRACE_AlarmFaultId8 0;
BA_ "GatewayedSignals" SG_ 1111 ADAS_CANTRACE_AlarmFaultId8 0;
BA_ "GenSigInactiveValue" SG_ 1111 ADAS_CANTRACE_AlarmFaultId8 0;
BA_ "GenSigInvalidValue" SG_ 1111 ADAS_CANTRACE_AlarmFaultId8 65535;
BA_ "GenSigSendType" SG_ 1111 ADAS_CANTRACE_AlarmFaultId8 1;
BA_ "GenSigStartValue" SG_ 1111 ADAS_CANTRACE_AlarmFaultId8 0;
BA_ "GenSigTimeoutValue" SG_ 1111 ADAS_CANTRACE_AlarmFaultId8 0;
BA_ "Remark" SG_ 1111 ADAS_CANTRACE_AlarmFaultId8 "";
BA_ "EventCommandSignal" SG_ 1111 ADAS_CANTRACE_AlarmKeyPara8 0;
BA_ "GatewayedSignals" SG_ 1111 ADAS_CANTRACE_AlarmKeyPara8 0;
BA_ "GenSigInactiveValue" SG_ 1111 ADAS_CANTRACE_AlarmKeyPara8 0;
BA_ "GenSigInvalidValue" SG_ 1111 ADAS_CANTRACE_AlarmKeyPara8 65535;
BA_ "GenSigSendType" SG_ 1111 ADAS_CANTRACE_AlarmKeyPara8 1;
BA_ "GenSigStartValue" SG_ 1111 ADAS_CANTRACE_AlarmKeyPara8 0;
BA_ "GenSigTimeoutValue" SG_ 1111 ADAS_CANTRACE_AlarmKeyPara8 0;
BA_ "Remark" SG_ 1111 ADAS_CANTRACE_AlarmKeyPara8 "";
BA_ "EventCommandSignal" SG_ 1111 ADAS_CANTRACE_AlarmFaultId9 0;
BA_ "GatewayedSignals" SG_ 1111 ADAS_CANTRACE_AlarmFaultId9 0;
BA_ "GenSigInactiveValue" SG_ 1111 ADAS_CANTRACE_AlarmFaultId9 0;
BA_ "GenSigInvalidValue" SG_ 1111 ADAS_CANTRACE_AlarmFaultId9 65535;
BA_ "GenSigSendType" SG_ 1111 ADAS_CANTRACE_AlarmFaultId9 1;
BA_ "GenSigStartValue" SG_ 1111 ADAS_CANTRACE_AlarmFaultId9 0;
BA_ "GenSigTimeoutValue" SG_ 1111 ADAS_CANTRACE_AlarmFaultId9 0;
BA_ "Remark" SG_ 1111 ADAS_CANTRACE_AlarmFaultId9 "";
BA_ "EventCommandSignal" SG_ 1111 ADAS_CANTRACE_AlarmKeyPara9 0;
BA_ "GatewayedSignals" SG_ 1111 ADAS_CANTRACE_AlarmKeyPara9 0;
BA_ "GenSigInactiveValue" SG_ 1111 ADAS_CANTRACE_AlarmKeyPara9 0;
BA_ "GenSigInvalidValue" SG_ 1111 ADAS_CANTRACE_AlarmKeyPara9 65535;
BA_ "GenSigSendType" SG_ 1111 ADAS_CANTRACE_AlarmKeyPara9 1;
BA_ "GenSigStartValue" SG_ 1111 ADAS_CANTRACE_AlarmKeyPara9 0;
BA_ "GenSigTimeoutValue" SG_ 1111 ADAS_CANTRACE_AlarmKeyPara9 0;
BA_ "Remark" SG_ 1111 ADAS_CANTRACE_AlarmKeyPara9 "";
BA_ "EventCommandSignal" SG_ 1111 ADAS_CANTRACE_AlarmFaultId10 0;
BA_ "GatewayedSignals" SG_ 1111 ADAS_CANTRACE_AlarmFaultId10 0;
BA_ "GenSigInactiveValue" SG_ 1111 ADAS_CANTRACE_AlarmFaultId10 0;
BA_ "GenSigInvalidValue" SG_ 1111 ADAS_CANTRACE_AlarmFaultId10 65535;
BA_ "GenSigSendType" SG_ 1111 ADAS_CANTRACE_AlarmFaultId10 1;
BA_ "GenSigStartValue" SG_ 1111 ADAS_CANTRACE_AlarmFaultId10 0;
BA_ "GenSigTimeoutValue" SG_ 1111 ADAS_CANTRACE_AlarmFaultId10 0;
BA_ "Remark" SG_ 1111 ADAS_CANTRACE_AlarmFaultId10 "";
BA_ "EventCommandSignal" SG_ 1111 ADAS_CANTRACE_AlarmKeyPara10 0;
BA_ "GatewayedSignals" SG_ 1111 ADAS_CANTRACE_AlarmKeyPara10 0;
BA_ "GenSigInactiveValue" SG_ 1111 ADAS_CANTRACE_AlarmKeyPara10 0;
BA_ "GenSigInvalidValue" SG_ 1111 ADAS_CANTRACE_AlarmKeyPara10 65535;
BA_ "GenSigSendType" SG_ 1111 ADAS_CANTRACE_AlarmKeyPara10 1;
BA_ "GenSigStartValue" SG_ 1111 ADAS_CANTRACE_AlarmKeyPara10 0;
BA_ "GenSigTimeoutValue" SG_ 1111 ADAS_CANTRACE_AlarmKeyPara10 0;
BA_ "Remark" SG_ 1111 ADAS_CANTRACE_AlarmKeyPara10 "";
BA_ "EventCommandSignal" SG_ 1111 ADAS_CANTRACE_AlarmFaultId11 0;
BA_ "GatewayedSignals" SG_ 1111 ADAS_CANTRACE_AlarmFaultId11 0;
BA_ "GenSigInactiveValue" SG_ 1111 ADAS_CANTRACE_AlarmFaultId11 0;
BA_ "GenSigInvalidValue" SG_ 1111 ADAS_CANTRACE_AlarmFaultId11 65535;
BA_ "GenSigSendType" SG_ 1111 ADAS_CANTRACE_AlarmFaultId11 1;
BA_ "GenSigStartValue" SG_ 1111 ADAS_CANTRACE_AlarmFaultId11 0;
BA_ "GenSigTimeoutValue" SG_ 1111 ADAS_CANTRACE_AlarmFaultId11 0;
BA_ "Remark" SG_ 1111 ADAS_CANTRACE_AlarmFaultId11 "";
BA_ "EventCommandSignal" SG_ 1111 ADAS_CANTRACE_AlarmKeyPara11 0;
BA_ "GatewayedSignals" SG_ 1111 ADAS_CANTRACE_AlarmKeyPara11 0;
BA_ "GenSigInactiveValue" SG_ 1111 ADAS_CANTRACE_AlarmKeyPara11 0;
BA_ "GenSigInvalidValue" SG_ 1111 ADAS_CANTRACE_AlarmKeyPara11 65535;
BA_ "GenSigSendType" SG_ 1111 ADAS_CANTRACE_AlarmKeyPara11 1;
BA_ "GenSigStartValue" SG_ 1111 ADAS_CANTRACE_AlarmKeyPara11 0;
BA_ "GenSigTimeoutValue" SG_ 1111 ADAS_CANTRACE_AlarmKeyPara11 0;
BA_ "Remark" SG_ 1111 ADAS_CANTRACE_AlarmKeyPara11 "";
BA_ "EventCommandSignal" SG_ 1111 ADAS_CANTRACE_AlarmFaultId12 0;
BA_ "GatewayedSignals" SG_ 1111 ADAS_CANTRACE_AlarmFaultId12 0;
BA_ "GenSigInactiveValue" SG_ 1111 ADAS_CANTRACE_AlarmFaultId12 0;
BA_ "GenSigInvalidValue" SG_ 1111 ADAS_CANTRACE_AlarmFaultId12 65535;
BA_ "GenSigSendType" SG_ 1111 ADAS_CANTRACE_AlarmFaultId12 1;
BA_ "GenSigStartValue" SG_ 1111 ADAS_CANTRACE_AlarmFaultId12 0;
BA_ "GenSigTimeoutValue" SG_ 1111 ADAS_CANTRACE_AlarmFaultId12 0;
BA_ "Remark" SG_ 1111 ADAS_CANTRACE_AlarmFaultId12 "";
BA_ "EventCommandSignal" SG_ 1111 ADAS_CANTRACE_AlarmKeyPara12 0;
BA_ "GatewayedSignals" SG_ 1111 ADAS_CANTRACE_AlarmKeyPara12 0;
BA_ "GenSigInactiveValue" SG_ 1111 ADAS_CANTRACE_AlarmKeyPara12 0;
BA_ "GenSigInvalidValue" SG_ 1111 ADAS_CANTRACE_AlarmKeyPara12 65535;
BA_ "GenSigSendType" SG_ 1111 ADAS_CANTRACE_AlarmKeyPara12 1;
BA_ "GenSigStartValue" SG_ 1111 ADAS_CANTRACE_AlarmKeyPara12 0;
BA_ "GenSigTimeoutValue" SG_ 1111 ADAS_CANTRACE_AlarmKeyPara12 0;
BA_ "Remark" SG_ 1111 ADAS_CANTRACE_AlarmKeyPara12 "";
BA_ "EventCommandSignal" SG_ 1111 ADAS_CANTRACE_AlarmFaultId13 0;
BA_ "GatewayedSignals" SG_ 1111 ADAS_CANTRACE_AlarmFaultId13 0;
BA_ "GenSigInactiveValue" SG_ 1111 ADAS_CANTRACE_AlarmFaultId13 0;
BA_ "GenSigInvalidValue" SG_ 1111 ADAS_CANTRACE_AlarmFaultId13 65535;
BA_ "GenSigSendType" SG_ 1111 ADAS_CANTRACE_AlarmFaultId13 1;
BA_ "GenSigStartValue" SG_ 1111 ADAS_CANTRACE_AlarmFaultId13 0;
BA_ "GenSigTimeoutValue" SG_ 1111 ADAS_CANTRACE_AlarmFaultId13 0;
BA_ "Remark" SG_ 1111 ADAS_CANTRACE_AlarmFaultId13 "";
BA_ "EventCommandSignal" SG_ 1111 ADAS_CANTRACE_AlarmKeyPara13 0;
BA_ "GatewayedSignals" SG_ 1111 ADAS_CANTRACE_AlarmKeyPara13 0;
BA_ "GenSigInactiveValue" SG_ 1111 ADAS_CANTRACE_AlarmKeyPara13 0;
BA_ "GenSigInvalidValue" SG_ 1111 ADAS_CANTRACE_AlarmKeyPara13 65535;
BA_ "GenSigSendType" SG_ 1111 ADAS_CANTRACE_AlarmKeyPara13 1;
BA_ "GenSigStartValue" SG_ 1111 ADAS_CANTRACE_AlarmKeyPara13 0;
BA_ "GenSigTimeoutValue" SG_ 1111 ADAS_CANTRACE_AlarmKeyPara13 0;
BA_ "Remark" SG_ 1111 ADAS_CANTRACE_AlarmKeyPara13 "";
BA_ "EventCommandSignal" SG_ 1111 ADAS_CANTRACE_AlarmFaultId14 0;
BA_ "GatewayedSignals" SG_ 1111 ADAS_CANTRACE_AlarmFaultId14 0;
BA_ "GenSigInactiveValue" SG_ 1111 ADAS_CANTRACE_AlarmFaultId14 0;
BA_ "GenSigInvalidValue" SG_ 1111 ADAS_CANTRACE_AlarmFaultId14 65535;
BA_ "GenSigSendType" SG_ 1111 ADAS_CANTRACE_AlarmFaultId14 1;
BA_ "GenSigStartValue" SG_ 1111 ADAS_CANTRACE_AlarmFaultId14 0;
BA_ "GenSigTimeoutValue" SG_ 1111 ADAS_CANTRACE_AlarmFaultId14 0;
BA_ "Remark" SG_ 1111 ADAS_CANTRACE_AlarmFaultId14 "";
BA_ "EventCommandSignal" SG_ 1111 ADAS_CANTRACE_AlarmKeyPara14 0;
BA_ "GatewayedSignals" SG_ 1111 ADAS_CANTRACE_AlarmKeyPara14 0;
BA_ "GenSigInactiveValue" SG_ 1111 ADAS_CANTRACE_AlarmKeyPara14 0;
BA_ "GenSigInvalidValue" SG_ 1111 ADAS_CANTRACE_AlarmKeyPara14 65535;
BA_ "GenSigSendType" SG_ 1111 ADAS_CANTRACE_AlarmKeyPara14 1;
BA_ "GenSigStartValue" SG_ 1111 ADAS_CANTRACE_AlarmKeyPara14 0;
BA_ "GenSigTimeoutValue" SG_ 1111 ADAS_CANTRACE_AlarmKeyPara14 0;
BA_ "Remark" SG_ 1111 ADAS_CANTRACE_AlarmKeyPara14 "";
BA_ "EventCommandSignal" SG_ 1111 ADAS_CANTRACE_AlarmRsv 0;
BA_ "GatewayedSignals" SG_ 1111 ADAS_CANTRACE_AlarmRsv 0;
BA_ "GenSigInactiveValue" SG_ 1111 ADAS_CANTRACE_AlarmRsv 0;
BA_ "GenSigInvalidValue" SG_ 1111 ADAS_CANTRACE_AlarmRsv 255;
BA_ "GenSigSendType" SG_ 1111 ADAS_CANTRACE_AlarmRsv 1;
BA_ "GenSigStartValue" SG_ 1111 ADAS_CANTRACE_AlarmRsv 0;
BA_ "GenSigTimeoutValue" SG_ 1111 ADAS_CANTRACE_AlarmRsv 0;
BA_ "Remark" SG_ 1111 ADAS_CANTRACE_AlarmRsv "";
BA_ "EventCommandSignal" SG_ 365 ADC_19_CRC 0;
BA_ "GatewayedSignals" SG_ 365 ADC_19_CRC 0;
BA_ "GenSigInactiveValue" SG_ 365 ADC_19_CRC 0;
BA_ "GenSigInvalidValue" SG_ 365 ADC_19_CRC 0;
BA_ "GenSigSendType" SG_ 365 ADC_19_CRC 1;
BA_ "GenSigStartValue" SG_ 365 ADC_19_CRC 0;
BA_ "GenSigTimeoutValue" SG_ 365 ADC_19_CRC 0;
BA_ "Remark" SG_ 365 ADC_19_CRC "";
BA_ "EventCommandSignal" SG_ 365 ADC_19_Counter 0;
BA_ "GatewayedSignals" SG_ 365 ADC_19_Counter 0;
BA_ "GenSigInactiveValue" SG_ 365 ADC_19_Counter 0;
BA_ "GenSigInvalidValue" SG_ 365 ADC_19_Counter 0;
BA_ "GenSigSendType" SG_ 365 ADC_19_Counter 1;
BA_ "GenSigStartValue" SG_ 365 ADC_19_Counter 0;
BA_ "GenSigTimeoutValue" SG_ 365 ADC_19_Counter 0;
BA_ "Remark" SG_ 365 ADC_19_Counter "";
BA_ "EventCommandSignal" SG_ 365 ADC_Obj02_ID 0;
BA_ "GatewayedSignals" SG_ 365 ADC_Obj02_ID 0;
BA_ "GenSigInactiveValue" SG_ 365 ADC_Obj02_ID 0;
BA_ "GenSigInvalidValue" SG_ 365 ADC_Obj02_ID 0;
BA_ "GenSigSendType" SG_ 365 ADC_Obj02_ID 1;
BA_ "GenSigStartValue" SG_ 365 ADC_Obj02_ID 0;
BA_ "GenSigTimeoutValue" SG_ 365 ADC_Obj02_ID 0;
BA_ "Remark" SG_ 365 ADC_Obj02_ID "";
BA_ "EventCommandSignal" SG_ 365 ADC_Obj03Dist 0;
BA_ "GatewayedSignals" SG_ 365 ADC_Obj03Dist 0;
BA_ "GenSigInactiveValue" SG_ 365 ADC_Obj03Dist 0;
BA_ "GenSigInvalidValue" SG_ 365 ADC_Obj03Dist 0;
BA_ "GenSigSendType" SG_ 365 ADC_Obj03Dist 1;
BA_ "GenSigStartValue" SG_ 365 ADC_Obj03Dist 0;
BA_ "GenSigTimeoutValue" SG_ 365 ADC_Obj03Dist 0;
BA_ "Remark" SG_ 365 ADC_Obj03Dist "";
BA_ "EventCommandSignal" SG_ 365 ADC_Obj03HoztAngSpd 0;
BA_ "GatewayedSignals" SG_ 365 ADC_Obj03HoztAngSpd 0;
BA_ "GenSigInactiveValue" SG_ 365 ADC_Obj03HoztAngSpd 0;
BA_ "GenSigInvalidValue" SG_ 365 ADC_Obj03HoztAngSpd 0;
BA_ "GenSigSendType" SG_ 365 ADC_Obj03HoztAngSpd 1;
BA_ "GenSigStartValue" SG_ 365 ADC_Obj03HoztAngSpd 0;
BA_ "GenSigTimeoutValue" SG_ 365 ADC_Obj03HoztAngSpd 0;
BA_ "Remark" SG_ 365 ADC_Obj03HoztAngSpd "";
BA_ "EventCommandSignal" SG_ 365 ADC_Obj03LeftAngle 0;
BA_ "GatewayedSignals" SG_ 365 ADC_Obj03LeftAngle 0;
BA_ "GenSigInactiveValue" SG_ 365 ADC_Obj03LeftAngle 0;
BA_ "GenSigInvalidValue" SG_ 365 ADC_Obj03LeftAngle 0;
BA_ "GenSigSendType" SG_ 365 ADC_Obj03LeftAngle 1;
BA_ "GenSigStartValue" SG_ 365 ADC_Obj03LeftAngle 0;
BA_ "GenSigTimeoutValue" SG_ 365 ADC_Obj03LeftAngle 0;
BA_ "Remark" SG_ 365 ADC_Obj03LeftAngle "";
BA_ "EventCommandSignal" SG_ 365 ADC_Obj03RightAngle 0;
BA_ "GatewayedSignals" SG_ 365 ADC_Obj03RightAngle 0;
BA_ "GenSigInactiveValue" SG_ 365 ADC_Obj03RightAngle 0;
BA_ "GenSigInvalidValue" SG_ 365 ADC_Obj03RightAngle 0;
BA_ "GenSigSendType" SG_ 365 ADC_Obj03RightAngle 1;
BA_ "GenSigStartValue" SG_ 365 ADC_Obj03RightAngle 0;
BA_ "GenSigTimeoutValue" SG_ 365 ADC_Obj03RightAngle 0;
BA_ "Remark" SG_ 365 ADC_Obj03RightAngle "";
BA_ "EventCommandSignal" SG_ 365 ADC_Obj03BottomAngle 0;
BA_ "GatewayedSignals" SG_ 365 ADC_Obj03BottomAngle 0;
BA_ "GenSigInactiveValue" SG_ 365 ADC_Obj03BottomAngle 0;
BA_ "GenSigInvalidValue" SG_ 365 ADC_Obj03BottomAngle 0;
BA_ "GenSigSendType" SG_ 365 ADC_Obj03BottomAngle 1;
BA_ "GenSigStartValue" SG_ 365 ADC_Obj03BottomAngle 0;
BA_ "GenSigTimeoutValue" SG_ 365 ADC_Obj03BottomAngle 0;
BA_ "Remark" SG_ 365 ADC_Obj03BottomAngle "";
BA_ "EventCommandSignal" SG_ 365 ADC_Obj03TopAngle 0;
BA_ "GatewayedSignals" SG_ 365 ADC_Obj03TopAngle 0;
BA_ "GenSigInactiveValue" SG_ 365 ADC_Obj03TopAngle 0;
BA_ "GenSigInvalidValue" SG_ 365 ADC_Obj03TopAngle 0;
BA_ "GenSigSendType" SG_ 365 ADC_Obj03TopAngle 1;
BA_ "GenSigStartValue" SG_ 365 ADC_Obj03TopAngle 0;
BA_ "GenSigTimeoutValue" SG_ 365 ADC_Obj03TopAngle 0;
BA_ "Remark" SG_ 365 ADC_Obj03TopAngle "";
BA_ "EventCommandSignal" SG_ 365 ADC_Obj04_ID 0;
BA_ "GatewayedSignals" SG_ 365 ADC_Obj04_ID 0;
BA_ "GenSigInactiveValue" SG_ 365 ADC_Obj04_ID 0;
BA_ "GenSigInvalidValue" SG_ 365 ADC_Obj04_ID 0;
BA_ "GenSigSendType" SG_ 365 ADC_Obj04_ID 1;
BA_ "GenSigStartValue" SG_ 365 ADC_Obj04_ID 0;
BA_ "GenSigTimeoutValue" SG_ 365 ADC_Obj04_ID 0;
BA_ "Remark" SG_ 365 ADC_Obj04_ID "";
BA_ "EventCommandSignal" SG_ 365 ADC_Obj01_ID 0;
BA_ "GatewayedSignals" SG_ 365 ADC_Obj01_ID 0;
BA_ "GenSigInactiveValue" SG_ 365 ADC_Obj01_ID 0;
BA_ "GenSigInvalidValue" SG_ 365 ADC_Obj01_ID 0;
BA_ "GenSigSendType" SG_ 365 ADC_Obj01_ID 1;
BA_ "GenSigStartValue" SG_ 365 ADC_Obj01_ID 0;
BA_ "GenSigTimeoutValue" SG_ 365 ADC_Obj01_ID 0;
BA_ "Remark" SG_ 365 ADC_Obj01_ID "";
BA_ "EventCommandSignal" SG_ 365 ADC_Obj04Dist 0;
BA_ "GatewayedSignals" SG_ 365 ADC_Obj04Dist 0;
BA_ "GenSigInactiveValue" SG_ 365 ADC_Obj04Dist 0;
BA_ "GenSigInvalidValue" SG_ 365 ADC_Obj04Dist 0;
BA_ "GenSigSendType" SG_ 365 ADC_Obj04Dist 1;
BA_ "GenSigStartValue" SG_ 365 ADC_Obj04Dist 0;
BA_ "GenSigTimeoutValue" SG_ 365 ADC_Obj04Dist 0;
BA_ "Remark" SG_ 365 ADC_Obj04Dist "";
BA_ "EventCommandSignal" SG_ 365 ADC_Obj04HoztAngSpd 0;
BA_ "GatewayedSignals" SG_ 365 ADC_Obj04HoztAngSpd 0;
BA_ "GenSigInactiveValue" SG_ 365 ADC_Obj04HoztAngSpd 0;
BA_ "GenSigInvalidValue" SG_ 365 ADC_Obj04HoztAngSpd 0;
BA_ "GenSigSendType" SG_ 365 ADC_Obj04HoztAngSpd 1;
BA_ "GenSigStartValue" SG_ 365 ADC_Obj04HoztAngSpd 0;
BA_ "GenSigTimeoutValue" SG_ 365 ADC_Obj04HoztAngSpd 0;
BA_ "Remark" SG_ 365 ADC_Obj04HoztAngSpd "";
BA_ "EventCommandSignal" SG_ 365 ADC_Obj04LeftAngle 0;
BA_ "GatewayedSignals" SG_ 365 ADC_Obj04LeftAngle 0;
BA_ "GenSigInactiveValue" SG_ 365 ADC_Obj04LeftAngle 0;
BA_ "GenSigInvalidValue" SG_ 365 ADC_Obj04LeftAngle 0;
BA_ "GenSigSendType" SG_ 365 ADC_Obj04LeftAngle 1;
BA_ "GenSigStartValue" SG_ 365 ADC_Obj04LeftAngle 0;
BA_ "GenSigTimeoutValue" SG_ 365 ADC_Obj04LeftAngle 0;
BA_ "Remark" SG_ 365 ADC_Obj04LeftAngle "";
BA_ "EventCommandSignal" SG_ 365 ADC_Obj04RightAngle 0;
BA_ "GatewayedSignals" SG_ 365 ADC_Obj04RightAngle 0;
BA_ "GenSigInactiveValue" SG_ 365 ADC_Obj04RightAngle 0;
BA_ "GenSigInvalidValue" SG_ 365 ADC_Obj04RightAngle 0;
BA_ "GenSigSendType" SG_ 365 ADC_Obj04RightAngle 1;
BA_ "GenSigStartValue" SG_ 365 ADC_Obj04RightAngle 0;
BA_ "GenSigTimeoutValue" SG_ 365 ADC_Obj04RightAngle 0;
BA_ "Remark" SG_ 365 ADC_Obj04RightAngle "";
BA_ "EventCommandSignal" SG_ 365 ADC_Obj04BottomAngle 0;
BA_ "GatewayedSignals" SG_ 365 ADC_Obj04BottomAngle 0;
BA_ "GenSigInactiveValue" SG_ 365 ADC_Obj04BottomAngle 0;
BA_ "GenSigInvalidValue" SG_ 365 ADC_Obj04BottomAngle 0;
BA_ "GenSigSendType" SG_ 365 ADC_Obj04BottomAngle 1;
BA_ "GenSigStartValue" SG_ 365 ADC_Obj04BottomAngle 0;
BA_ "GenSigTimeoutValue" SG_ 365 ADC_Obj04BottomAngle 0;
BA_ "Remark" SG_ 365 ADC_Obj04BottomAngle "";
BA_ "EventCommandSignal" SG_ 365 ADC_Obj04TopAngle 0;
BA_ "GatewayedSignals" SG_ 365 ADC_Obj04TopAngle 0;
BA_ "GenSigInactiveValue" SG_ 365 ADC_Obj04TopAngle 0;
BA_ "GenSigInvalidValue" SG_ 365 ADC_Obj04TopAngle 0;
BA_ "GenSigSendType" SG_ 365 ADC_Obj04TopAngle 1;
BA_ "GenSigStartValue" SG_ 365 ADC_Obj04TopAngle 0;
BA_ "GenSigTimeoutValue" SG_ 365 ADC_Obj04TopAngle 0;
BA_ "Remark" SG_ 365 ADC_Obj04TopAngle "";
BA_ "EventCommandSignal" SG_ 365 ADC_Obj03_ID 0;
BA_ "GatewayedSignals" SG_ 365 ADC_Obj03_ID 0;
BA_ "GenSigInactiveValue" SG_ 365 ADC_Obj03_ID 0;
BA_ "GenSigInvalidValue" SG_ 365 ADC_Obj03_ID 0;
BA_ "GenSigSendType" SG_ 365 ADC_Obj03_ID 1;
BA_ "GenSigStartValue" SG_ 365 ADC_Obj03_ID 0;
BA_ "GenSigTimeoutValue" SG_ 365 ADC_Obj03_ID 0;
BA_ "Remark" SG_ 365 ADC_Obj03_ID "";
BA_ "EventCommandSignal" SG_ 365 ADC_Obj06_ID 0;
BA_ "GatewayedSignals" SG_ 365 ADC_Obj06_ID 0;
BA_ "GenSigInactiveValue" SG_ 365 ADC_Obj06_ID 0;
BA_ "GenSigInvalidValue" SG_ 365 ADC_Obj06_ID 0;
BA_ "GenSigSendType" SG_ 365 ADC_Obj06_ID 1;
BA_ "GenSigStartValue" SG_ 365 ADC_Obj06_ID 0;
BA_ "GenSigTimeoutValue" SG_ 365 ADC_Obj06_ID 0;
BA_ "Remark" SG_ 365 ADC_Obj06_ID "";
BA_ "EventCommandSignal" SG_ 365 ADC_Obj01Dist 0;
BA_ "GatewayedSignals" SG_ 365 ADC_Obj01Dist 0;
BA_ "GenSigInactiveValue" SG_ 365 ADC_Obj01Dist 0;
BA_ "GenSigInvalidValue" SG_ 365 ADC_Obj01Dist 0;
BA_ "GenSigSendType" SG_ 365 ADC_Obj01Dist 1;
BA_ "GenSigStartValue" SG_ 365 ADC_Obj01Dist 0;
BA_ "GenSigTimeoutValue" SG_ 365 ADC_Obj01Dist 0;
BA_ "Remark" SG_ 365 ADC_Obj01Dist "";
BA_ "EventCommandSignal" SG_ 365 ADC_Obj01HoztAngSpd 0;
BA_ "GatewayedSignals" SG_ 365 ADC_Obj01HoztAngSpd 0;
BA_ "GenSigInactiveValue" SG_ 365 ADC_Obj01HoztAngSpd 0;
BA_ "GenSigInvalidValue" SG_ 365 ADC_Obj01HoztAngSpd 0;
BA_ "GenSigSendType" SG_ 365 ADC_Obj01HoztAngSpd 1;
BA_ "GenSigStartValue" SG_ 365 ADC_Obj01HoztAngSpd 0;
BA_ "GenSigTimeoutValue" SG_ 365 ADC_Obj01HoztAngSpd 0;
BA_ "Remark" SG_ 365 ADC_Obj01HoztAngSpd "";
BA_ "EventCommandSignal" SG_ 365 ADC_Obj01LeftAngle 0;
BA_ "GatewayedSignals" SG_ 365 ADC_Obj01LeftAngle 0;
BA_ "GenSigInactiveValue" SG_ 365 ADC_Obj01LeftAngle 0;
BA_ "GenSigInvalidValue" SG_ 365 ADC_Obj01LeftAngle 0;
BA_ "GenSigSendType" SG_ 365 ADC_Obj01LeftAngle 1;
BA_ "GenSigStartValue" SG_ 365 ADC_Obj01LeftAngle 0;
BA_ "GenSigTimeoutValue" SG_ 365 ADC_Obj01LeftAngle 0;
BA_ "Remark" SG_ 365 ADC_Obj01LeftAngle "";
BA_ "EventCommandSignal" SG_ 365 ADC_Obj01RightAngle 0;
BA_ "GatewayedSignals" SG_ 365 ADC_Obj01RightAngle 0;
BA_ "GenSigInactiveValue" SG_ 365 ADC_Obj01RightAngle 0;
BA_ "GenSigInvalidValue" SG_ 365 ADC_Obj01RightAngle 0;
BA_ "GenSigSendType" SG_ 365 ADC_Obj01RightAngle 1;
BA_ "GenSigStartValue" SG_ 365 ADC_Obj01RightAngle 0;
BA_ "GenSigTimeoutValue" SG_ 365 ADC_Obj01RightAngle 0;
BA_ "Remark" SG_ 365 ADC_Obj01RightAngle "";
BA_ "EventCommandSignal" SG_ 365 ADC_Obj01BottomAngle 0;
BA_ "GatewayedSignals" SG_ 365 ADC_Obj01BottomAngle 0;
BA_ "GenSigInactiveValue" SG_ 365 ADC_Obj01BottomAngle 0;
BA_ "GenSigInvalidValue" SG_ 365 ADC_Obj01BottomAngle 0;
BA_ "GenSigSendType" SG_ 365 ADC_Obj01BottomAngle 1;
BA_ "GenSigStartValue" SG_ 365 ADC_Obj01BottomAngle 0;
BA_ "GenSigTimeoutValue" SG_ 365 ADC_Obj01BottomAngle 0;
BA_ "Remark" SG_ 365 ADC_Obj01BottomAngle "";
BA_ "EventCommandSignal" SG_ 365 ADC_Obj01TopAngle 0;
BA_ "GatewayedSignals" SG_ 365 ADC_Obj01TopAngle 0;
BA_ "GenSigInactiveValue" SG_ 365 ADC_Obj01TopAngle 0;
BA_ "GenSigInvalidValue" SG_ 365 ADC_Obj01TopAngle 0;
BA_ "GenSigSendType" SG_ 365 ADC_Obj01TopAngle 1;
BA_ "GenSigStartValue" SG_ 365 ADC_Obj01TopAngle 0;
BA_ "GenSigTimeoutValue" SG_ 365 ADC_Obj01TopAngle 0;
BA_ "Remark" SG_ 365 ADC_Obj01TopAngle "";
BA_ "EventCommandSignal" SG_ 365 ADC_Obj05Dist 0;
BA_ "GatewayedSignals" SG_ 365 ADC_Obj05Dist 0;
BA_ "GenSigInactiveValue" SG_ 365 ADC_Obj05Dist 0;
BA_ "GenSigInvalidValue" SG_ 365 ADC_Obj05Dist 0;
BA_ "GenSigSendType" SG_ 365 ADC_Obj05Dist 1;
BA_ "GenSigStartValue" SG_ 365 ADC_Obj05Dist 0;
BA_ "GenSigTimeoutValue" SG_ 365 ADC_Obj05Dist 0;
BA_ "Remark" SG_ 365 ADC_Obj05Dist "";
BA_ "EventCommandSignal" SG_ 365 ADC_Obj05HoztAngSpd 0;
BA_ "GatewayedSignals" SG_ 365 ADC_Obj05HoztAngSpd 0;
BA_ "GenSigInactiveValue" SG_ 365 ADC_Obj05HoztAngSpd 0;
BA_ "GenSigInvalidValue" SG_ 365 ADC_Obj05HoztAngSpd 0;
BA_ "GenSigSendType" SG_ 365 ADC_Obj05HoztAngSpd 1;
BA_ "GenSigStartValue" SG_ 365 ADC_Obj05HoztAngSpd 0;
BA_ "GenSigTimeoutValue" SG_ 365 ADC_Obj05HoztAngSpd 0;
BA_ "Remark" SG_ 365 ADC_Obj05HoztAngSpd "";
BA_ "EventCommandSignal" SG_ 365 ADC_Obj05LeftAngle 0;
BA_ "GatewayedSignals" SG_ 365 ADC_Obj05LeftAngle 0;
BA_ "GenSigInactiveValue" SG_ 365 ADC_Obj05LeftAngle 0;
BA_ "GenSigInvalidValue" SG_ 365 ADC_Obj05LeftAngle 0;
BA_ "GenSigSendType" SG_ 365 ADC_Obj05LeftAngle 1;
BA_ "GenSigStartValue" SG_ 365 ADC_Obj05LeftAngle 0;
BA_ "GenSigTimeoutValue" SG_ 365 ADC_Obj05LeftAngle 0;
BA_ "Remark" SG_ 365 ADC_Obj05LeftAngle "";
BA_ "EventCommandSignal" SG_ 365 ADC_Obj05RightAngle 0;
BA_ "GatewayedSignals" SG_ 365 ADC_Obj05RightAngle 0;
BA_ "GenSigInactiveValue" SG_ 365 ADC_Obj05RightAngle 0;
BA_ "GenSigInvalidValue" SG_ 365 ADC_Obj05RightAngle 0;
BA_ "GenSigSendType" SG_ 365 ADC_Obj05RightAngle 1;
BA_ "GenSigStartValue" SG_ 365 ADC_Obj05RightAngle 0;
BA_ "GenSigTimeoutValue" SG_ 365 ADC_Obj05RightAngle 0;
BA_ "Remark" SG_ 365 ADC_Obj05RightAngle "";
BA_ "EventCommandSignal" SG_ 365 ADC_Obj05BottomAngle 0;
BA_ "GatewayedSignals" SG_ 365 ADC_Obj05BottomAngle 0;
BA_ "GenSigInactiveValue" SG_ 365 ADC_Obj05BottomAngle 0;
BA_ "GenSigInvalidValue" SG_ 365 ADC_Obj05BottomAngle 0;
BA_ "GenSigSendType" SG_ 365 ADC_Obj05BottomAngle 1;
BA_ "GenSigStartValue" SG_ 365 ADC_Obj05BottomAngle 0;
BA_ "GenSigTimeoutValue" SG_ 365 ADC_Obj05BottomAngle 0;
BA_ "Remark" SG_ 365 ADC_Obj05BottomAngle "";
BA_ "EventCommandSignal" SG_ 365 ADC_Obj05TopAngle 0;
BA_ "GatewayedSignals" SG_ 365 ADC_Obj05TopAngle 0;
BA_ "GenSigInactiveValue" SG_ 365 ADC_Obj05TopAngle 0;
BA_ "GenSigInvalidValue" SG_ 365 ADC_Obj05TopAngle 0;
BA_ "GenSigSendType" SG_ 365 ADC_Obj05TopAngle 1;
BA_ "GenSigStartValue" SG_ 365 ADC_Obj05TopAngle 0;
BA_ "GenSigTimeoutValue" SG_ 365 ADC_Obj05TopAngle 0;
BA_ "Remark" SG_ 365 ADC_Obj05TopAngle "";
BA_ "EventCommandSignal" SG_ 365 ADC_Obj06Dist 0;
BA_ "GatewayedSignals" SG_ 365 ADC_Obj06Dist 0;
BA_ "GenSigInactiveValue" SG_ 365 ADC_Obj06Dist 0;
BA_ "GenSigInvalidValue" SG_ 365 ADC_Obj06Dist 0;
BA_ "GenSigSendType" SG_ 365 ADC_Obj06Dist 1;
BA_ "GenSigStartValue" SG_ 365 ADC_Obj06Dist 0;
BA_ "GenSigTimeoutValue" SG_ 365 ADC_Obj06Dist 0;
BA_ "Remark" SG_ 365 ADC_Obj06Dist "";
BA_ "EventCommandSignal" SG_ 365 ADC_Obj06HoztAngSpd 0;
BA_ "GatewayedSignals" SG_ 365 ADC_Obj06HoztAngSpd 0;
BA_ "GenSigInactiveValue" SG_ 365 ADC_Obj06HoztAngSpd 0;
BA_ "GenSigInvalidValue" SG_ 365 ADC_Obj06HoztAngSpd 0;
BA_ "GenSigSendType" SG_ 365 ADC_Obj06HoztAngSpd 1;
BA_ "GenSigStartValue" SG_ 365 ADC_Obj06HoztAngSpd 0;
BA_ "GenSigTimeoutValue" SG_ 365 ADC_Obj06HoztAngSpd 0;
BA_ "Remark" SG_ 365 ADC_Obj06HoztAngSpd "";
BA_ "EventCommandSignal" SG_ 365 ADC_Obj06LeftAngle 0;
BA_ "GatewayedSignals" SG_ 365 ADC_Obj06LeftAngle 0;
BA_ "GenSigInactiveValue" SG_ 365 ADC_Obj06LeftAngle 0;
BA_ "GenSigInvalidValue" SG_ 365 ADC_Obj06LeftAngle 0;
BA_ "GenSigSendType" SG_ 365 ADC_Obj06LeftAngle 1;
BA_ "GenSigStartValue" SG_ 365 ADC_Obj06LeftAngle 0;
BA_ "GenSigTimeoutValue" SG_ 365 ADC_Obj06LeftAngle 0;
BA_ "Remark" SG_ 365 ADC_Obj06LeftAngle "";
BA_ "EventCommandSignal" SG_ 365 ADC_Obj06RightAngle 0;
BA_ "GatewayedSignals" SG_ 365 ADC_Obj06RightAngle 0;
BA_ "GenSigInactiveValue" SG_ 365 ADC_Obj06RightAngle 0;
BA_ "GenSigInvalidValue" SG_ 365 ADC_Obj06RightAngle 0;
BA_ "GenSigSendType" SG_ 365 ADC_Obj06RightAngle 1;
BA_ "GenSigStartValue" SG_ 365 ADC_Obj06RightAngle 0;
BA_ "GenSigTimeoutValue" SG_ 365 ADC_Obj06RightAngle 0;
BA_ "Remark" SG_ 365 ADC_Obj06RightAngle "";
BA_ "EventCommandSignal" SG_ 365 ADC_Obj06BottomAngle 0;
BA_ "GatewayedSignals" SG_ 365 ADC_Obj06BottomAngle 0;
BA_ "GenSigInactiveValue" SG_ 365 ADC_Obj06BottomAngle 0;
BA_ "GenSigInvalidValue" SG_ 365 ADC_Obj06BottomAngle 0;
BA_ "GenSigSendType" SG_ 365 ADC_Obj06BottomAngle 1;
BA_ "GenSigStartValue" SG_ 365 ADC_Obj06BottomAngle 0;
BA_ "GenSigTimeoutValue" SG_ 365 ADC_Obj06BottomAngle 0;
BA_ "Remark" SG_ 365 ADC_Obj06BottomAngle "";
BA_ "EventCommandSignal" SG_ 365 ADC_Obj02Dist 0;
BA_ "GatewayedSignals" SG_ 365 ADC_Obj02Dist 0;
BA_ "GenSigInactiveValue" SG_ 365 ADC_Obj02Dist 0;
BA_ "GenSigInvalidValue" SG_ 365 ADC_Obj02Dist 0;
BA_ "GenSigSendType" SG_ 365 ADC_Obj02Dist 1;
BA_ "GenSigStartValue" SG_ 365 ADC_Obj02Dist 0;
BA_ "GenSigTimeoutValue" SG_ 365 ADC_Obj02Dist 0;
BA_ "Remark" SG_ 365 ADC_Obj02Dist "";
BA_ "EventCommandSignal" SG_ 365 ADC_Obj02HoztAngSpd 0;
BA_ "GatewayedSignals" SG_ 365 ADC_Obj02HoztAngSpd 0;
BA_ "GenSigInactiveValue" SG_ 365 ADC_Obj02HoztAngSpd 0;
BA_ "GenSigInvalidValue" SG_ 365 ADC_Obj02HoztAngSpd 0;
BA_ "GenSigSendType" SG_ 365 ADC_Obj02HoztAngSpd 1;
BA_ "GenSigStartValue" SG_ 365 ADC_Obj02HoztAngSpd 0;
BA_ "GenSigTimeoutValue" SG_ 365 ADC_Obj02HoztAngSpd 0;
BA_ "Remark" SG_ 365 ADC_Obj02HoztAngSpd "";
BA_ "EventCommandSignal" SG_ 365 ADC_Obj02LeftAngle 0;
BA_ "GatewayedSignals" SG_ 365 ADC_Obj02LeftAngle 0;
BA_ "GenSigInactiveValue" SG_ 365 ADC_Obj02LeftAngle 0;
BA_ "GenSigInvalidValue" SG_ 365 ADC_Obj02LeftAngle 0;
BA_ "GenSigSendType" SG_ 365 ADC_Obj02LeftAngle 1;
BA_ "GenSigStartValue" SG_ 365 ADC_Obj02LeftAngle 0;
BA_ "GenSigTimeoutValue" SG_ 365 ADC_Obj02LeftAngle 0;
BA_ "Remark" SG_ 365 ADC_Obj02LeftAngle "";
BA_ "EventCommandSignal" SG_ 365 ADC_Obj02RightAngle 0;
BA_ "GatewayedSignals" SG_ 365 ADC_Obj02RightAngle 0;
BA_ "GenSigInactiveValue" SG_ 365 ADC_Obj02RightAngle 0;
BA_ "GenSigInvalidValue" SG_ 365 ADC_Obj02RightAngle 0;
BA_ "GenSigSendType" SG_ 365 ADC_Obj02RightAngle 1;
BA_ "GenSigStartValue" SG_ 365 ADC_Obj02RightAngle 0;
BA_ "GenSigTimeoutValue" SG_ 365 ADC_Obj02RightAngle 0;
BA_ "Remark" SG_ 365 ADC_Obj02RightAngle "";
BA_ "EventCommandSignal" SG_ 365 ADC_Obj02BottomAngle 0;
BA_ "GatewayedSignals" SG_ 365 ADC_Obj02BottomAngle 0;
BA_ "GenSigInactiveValue" SG_ 365 ADC_Obj02BottomAngle 0;
BA_ "GenSigInvalidValue" SG_ 365 ADC_Obj02BottomAngle 0;
BA_ "GenSigSendType" SG_ 365 ADC_Obj02BottomAngle 1;
BA_ "GenSigStartValue" SG_ 365 ADC_Obj02BottomAngle 0;
BA_ "GenSigTimeoutValue" SG_ 365 ADC_Obj02BottomAngle 0;
BA_ "Remark" SG_ 365 ADC_Obj02BottomAngle "";
BA_ "EventCommandSignal" SG_ 365 ADC_Obj02TopAngle 0;
BA_ "GatewayedSignals" SG_ 365 ADC_Obj02TopAngle 0;
BA_ "GenSigInactiveValue" SG_ 365 ADC_Obj02TopAngle 0;
BA_ "GenSigInvalidValue" SG_ 365 ADC_Obj02TopAngle 0;
BA_ "GenSigSendType" SG_ 365 ADC_Obj02TopAngle 1;
BA_ "GenSigStartValue" SG_ 365 ADC_Obj02TopAngle 0;
BA_ "GenSigTimeoutValue" SG_ 365 ADC_Obj02TopAngle 0;
BA_ "Remark" SG_ 365 ADC_Obj02TopAngle "";
BA_ "EventCommandSignal" SG_ 365 ADC_Obj06TopAngle 0;
BA_ "GatewayedSignals" SG_ 365 ADC_Obj06TopAngle 0;
BA_ "GenSigInactiveValue" SG_ 365 ADC_Obj06TopAngle 0;
BA_ "GenSigInvalidValue" SG_ 365 ADC_Obj06TopAngle 0;
BA_ "GenSigSendType" SG_ 365 ADC_Obj06TopAngle 1;
BA_ "GenSigStartValue" SG_ 365 ADC_Obj06TopAngle 0;
BA_ "GenSigTimeoutValue" SG_ 365 ADC_Obj06TopAngle 0;
BA_ "Remark" SG_ 365 ADC_Obj06TopAngle "";
BA_ "EventCommandSignal" SG_ 365 ADC_Obj07Dist 0;
BA_ "GatewayedSignals" SG_ 365 ADC_Obj07Dist 0;
BA_ "GenSigInactiveValue" SG_ 365 ADC_Obj07Dist 0;
BA_ "GenSigInvalidValue" SG_ 365 ADC_Obj07Dist 0;
BA_ "GenSigSendType" SG_ 365 ADC_Obj07Dist 1;
BA_ "GenSigStartValue" SG_ 365 ADC_Obj07Dist 0;
BA_ "GenSigTimeoutValue" SG_ 365 ADC_Obj07Dist 0;
BA_ "Remark" SG_ 365 ADC_Obj07Dist "";
BA_ "EventCommandSignal" SG_ 365 ADC_Obj07HoztAngSpd 0;
BA_ "GatewayedSignals" SG_ 365 ADC_Obj07HoztAngSpd 0;
BA_ "GenSigInactiveValue" SG_ 365 ADC_Obj07HoztAngSpd 0;
BA_ "GenSigInvalidValue" SG_ 365 ADC_Obj07HoztAngSpd 0;
BA_ "GenSigSendType" SG_ 365 ADC_Obj07HoztAngSpd 1;
BA_ "GenSigStartValue" SG_ 365 ADC_Obj07HoztAngSpd 0;
BA_ "GenSigTimeoutValue" SG_ 365 ADC_Obj07HoztAngSpd 0;
BA_ "Remark" SG_ 365 ADC_Obj07HoztAngSpd "";
BA_ "EventCommandSignal" SG_ 365 ADC_Obj07LeftAngle 0;
BA_ "GatewayedSignals" SG_ 365 ADC_Obj07LeftAngle 0;
BA_ "GenSigInactiveValue" SG_ 365 ADC_Obj07LeftAngle 0;
BA_ "GenSigInvalidValue" SG_ 365 ADC_Obj07LeftAngle 0;
BA_ "GenSigSendType" SG_ 365 ADC_Obj07LeftAngle 1;
BA_ "GenSigStartValue" SG_ 365 ADC_Obj07LeftAngle 0;
BA_ "GenSigTimeoutValue" SG_ 365 ADC_Obj07LeftAngle 0;
BA_ "Remark" SG_ 365 ADC_Obj07LeftAngle "";
BA_ "EventCommandSignal" SG_ 365 ADC_Obj07BottomAngle 0;
BA_ "GatewayedSignals" SG_ 365 ADC_Obj07BottomAngle 0;
BA_ "GenSigInactiveValue" SG_ 365 ADC_Obj07BottomAngle 0;
BA_ "GenSigInvalidValue" SG_ 365 ADC_Obj07BottomAngle 0;
BA_ "GenSigSendType" SG_ 365 ADC_Obj07BottomAngle 1;
BA_ "GenSigStartValue" SG_ 365 ADC_Obj07BottomAngle 0;
BA_ "GenSigTimeoutValue" SG_ 365 ADC_Obj07BottomAngle 0;
BA_ "Remark" SG_ 365 ADC_Obj07BottomAngle "";
BA_ "EventCommandSignal" SG_ 365 ADC_Obj05_ID 0;
BA_ "GatewayedSignals" SG_ 365 ADC_Obj05_ID 0;
BA_ "GenSigInactiveValue" SG_ 365 ADC_Obj05_ID 0;
BA_ "GenSigInvalidValue" SG_ 365 ADC_Obj05_ID 0;
BA_ "GenSigSendType" SG_ 365 ADC_Obj05_ID 1;
BA_ "GenSigStartValue" SG_ 365 ADC_Obj05_ID 0;
BA_ "GenSigTimeoutValue" SG_ 365 ADC_Obj05_ID 0;
BA_ "Remark" SG_ 365 ADC_Obj05_ID "";
BA_ "EventCommandSignal" SG_ 365 ADC_Obj04Typ 0;
BA_ "GatewayedSignals" SG_ 365 ADC_Obj04Typ 0;
BA_ "GenSigInactiveValue" SG_ 365 ADC_Obj04Typ 0;
BA_ "GenSigInvalidValue" SG_ 365 ADC_Obj04Typ 0;
BA_ "GenSigSendType" SG_ 365 ADC_Obj04Typ 1;
BA_ "GenSigStartValue" SG_ 365 ADC_Obj04Typ 0;
BA_ "GenSigTimeoutValue" SG_ 365 ADC_Obj04Typ 0;
BA_ "Remark" SG_ 365 ADC_Obj04Typ "";
BA_ "EventCommandSignal" SG_ 365 ADC_Obj04Dir 0;
BA_ "GatewayedSignals" SG_ 365 ADC_Obj04Dir 0;
BA_ "GenSigInactiveValue" SG_ 365 ADC_Obj04Dir 0;
BA_ "GenSigInvalidValue" SG_ 365 ADC_Obj04Dir 0;
BA_ "GenSigSendType" SG_ 365 ADC_Obj04Dir 1;
BA_ "GenSigStartValue" SG_ 365 ADC_Obj04Dir 0;
BA_ "GenSigTimeoutValue" SG_ 365 ADC_Obj04Dir 0;
BA_ "Remark" SG_ 365 ADC_Obj04Dir "";
BA_ "EventCommandSignal" SG_ 365 ADC_ADBCamSt 0;
BA_ "GatewayedSignals" SG_ 365 ADC_ADBCamSt 0;
BA_ "GenSigInactiveValue" SG_ 365 ADC_ADBCamSt 0;
BA_ "GenSigInvalidValue" SG_ 365 ADC_ADBCamSt 0;
BA_ "GenSigSendType" SG_ 365 ADC_ADBCamSt 1;
BA_ "GenSigStartValue" SG_ 365 ADC_ADBCamSt 15;
BA_ "GenSigTimeoutValue" SG_ 365 ADC_ADBCamSt 0;
BA_ "Remark" SG_ 365 ADC_ADBCamSt "";
BA_ "EventCommandSignal" SG_ 365 ADC_Obj03Dir 0;
BA_ "GatewayedSignals" SG_ 365 ADC_Obj03Dir 0;
BA_ "GenSigInactiveValue" SG_ 365 ADC_Obj03Dir 0;
BA_ "GenSigInvalidValue" SG_ 365 ADC_Obj03Dir 0;
BA_ "GenSigSendType" SG_ 365 ADC_Obj03Dir 1;
BA_ "GenSigStartValue" SG_ 365 ADC_Obj03Dir 0;
BA_ "GenSigTimeoutValue" SG_ 365 ADC_Obj03Dir 0;
BA_ "Remark" SG_ 365 ADC_Obj03Dir "";
BA_ "EventCommandSignal" SG_ 365 ADC_Obj02Dir 0;
BA_ "GatewayedSignals" SG_ 365 ADC_Obj02Dir 0;
BA_ "GenSigInactiveValue" SG_ 365 ADC_Obj02Dir 0;
BA_ "GenSigInvalidValue" SG_ 365 ADC_Obj02Dir 0;
BA_ "GenSigSendType" SG_ 365 ADC_Obj02Dir 1;
BA_ "GenSigStartValue" SG_ 365 ADC_Obj02Dir 0;
BA_ "GenSigTimeoutValue" SG_ 365 ADC_Obj02Dir 0;
BA_ "Remark" SG_ 365 ADC_Obj02Dir "";
BA_ "EventCommandSignal" SG_ 365 ADC_Obj02Typ 0;
BA_ "GatewayedSignals" SG_ 365 ADC_Obj02Typ 0;
BA_ "GenSigInactiveValue" SG_ 365 ADC_Obj02Typ 0;
BA_ "GenSigInvalidValue" SG_ 365 ADC_Obj02Typ 0;
BA_ "GenSigSendType" SG_ 365 ADC_Obj02Typ 1;
BA_ "GenSigStartValue" SG_ 365 ADC_Obj02Typ 0;
BA_ "GenSigTimeoutValue" SG_ 365 ADC_Obj02Typ 0;
BA_ "Remark" SG_ 365 ADC_Obj02Typ "";
BA_ "EventCommandSignal" SG_ 365 ADC_Obj03Typ 0;
BA_ "GatewayedSignals" SG_ 365 ADC_Obj03Typ 0;
BA_ "GenSigInactiveValue" SG_ 365 ADC_Obj03Typ 0;
BA_ "GenSigInvalidValue" SG_ 365 ADC_Obj03Typ 0;
BA_ "GenSigSendType" SG_ 365 ADC_Obj03Typ 1;
BA_ "GenSigStartValue" SG_ 365 ADC_Obj03Typ 0;
BA_ "GenSigTimeoutValue" SG_ 365 ADC_Obj03Typ 0;
BA_ "Remark" SG_ 365 ADC_Obj03Typ "";
BA_ "EventCommandSignal" SG_ 365 ADC_Obj01Typ 0;
BA_ "GatewayedSignals" SG_ 365 ADC_Obj01Typ 0;
BA_ "GenSigInactiveValue" SG_ 365 ADC_Obj01Typ 0;
BA_ "GenSigInvalidValue" SG_ 365 ADC_Obj01Typ 0;
BA_ "GenSigSendType" SG_ 365 ADC_Obj01Typ 1;
BA_ "GenSigStartValue" SG_ 365 ADC_Obj01Typ 0;
BA_ "GenSigTimeoutValue" SG_ 365 ADC_Obj01Typ 0;
BA_ "Remark" SG_ 365 ADC_Obj01Typ "";
BA_ "EventCommandSignal" SG_ 365 ADC_Obj01Dir 0;
BA_ "GatewayedSignals" SG_ 365 ADC_Obj01Dir 0;
BA_ "GenSigInactiveValue" SG_ 365 ADC_Obj01Dir 0;
BA_ "GenSigInvalidValue" SG_ 365 ADC_Obj01Dir 0;
BA_ "GenSigSendType" SG_ 365 ADC_Obj01Dir 1;
BA_ "GenSigStartValue" SG_ 365 ADC_Obj01Dir 0;
BA_ "GenSigTimeoutValue" SG_ 365 ADC_Obj01Dir 0;
BA_ "Remark" SG_ 365 ADC_Obj01Dir "";
BA_ "EventCommandSignal" SG_ 365 ADC_ObjNum 0;
BA_ "GatewayedSignals" SG_ 365 ADC_ObjNum 0;
BA_ "GenSigInactiveValue" SG_ 365 ADC_ObjNum 0;
BA_ "GenSigInvalidValue" SG_ 365 ADC_ObjNum 0;
BA_ "GenSigSendType" SG_ 365 ADC_ObjNum 1;
BA_ "GenSigStartValue" SG_ 365 ADC_ObjNum 0;
BA_ "GenSigTimeoutValue" SG_ 365 ADC_ObjNum 0;
BA_ "Remark" SG_ 365 ADC_ObjNum "";
BA_ "EventCommandSignal" SG_ 365 ADC_AmbLightCondition 0;
BA_ "GatewayedSignals" SG_ 365 ADC_AmbLightCondition 0;
BA_ "GenSigInactiveValue" SG_ 365 ADC_AmbLightCondition 0;
BA_ "GenSigInvalidValue" SG_ 365 ADC_AmbLightCondition 0;
BA_ "GenSigSendType" SG_ 365 ADC_AmbLightCondition 1;
BA_ "GenSigStartValue" SG_ 365 ADC_AmbLightCondition 0;
BA_ "GenSigTimeoutValue" SG_ 365 ADC_AmbLightCondition 0;
BA_ "Remark" SG_ 365 ADC_AmbLightCondition "";
BA_ "EventCommandSignal" SG_ 365 ADC_TrafficStyle 0;
BA_ "GatewayedSignals" SG_ 365 ADC_TrafficStyle 0;
BA_ "GenSigInactiveValue" SG_ 365 ADC_TrafficStyle 0;
BA_ "GenSigInvalidValue" SG_ 365 ADC_TrafficStyle 0;
BA_ "GenSigSendType" SG_ 365 ADC_TrafficStyle 1;
BA_ "GenSigStartValue" SG_ 365 ADC_TrafficStyle 0;
BA_ "GenSigTimeoutValue" SG_ 365 ADC_TrafficStyle 0;
BA_ "Remark" SG_ 365 ADC_TrafficStyle "";
BA_ "EventCommandSignal" SG_ 365 ADC_Obj05Typ 0;
BA_ "GatewayedSignals" SG_ 365 ADC_Obj05Typ 0;
BA_ "GenSigInactiveValue" SG_ 365 ADC_Obj05Typ 0;
BA_ "GenSigInvalidValue" SG_ 365 ADC_Obj05Typ 0;
BA_ "GenSigSendType" SG_ 365 ADC_Obj05Typ 1;
BA_ "GenSigStartValue" SG_ 365 ADC_Obj05Typ 0;
BA_ "GenSigTimeoutValue" SG_ 365 ADC_Obj05Typ 0;
BA_ "Remark" SG_ 365 ADC_Obj05Typ "";
BA_ "EventCommandSignal" SG_ 365 ADC_Obj05Dir 0;
BA_ "GatewayedSignals" SG_ 365 ADC_Obj05Dir 0;
BA_ "GenSigInactiveValue" SG_ 365 ADC_Obj05Dir 0;
BA_ "GenSigInvalidValue" SG_ 365 ADC_Obj05Dir 0;
BA_ "GenSigSendType" SG_ 365 ADC_Obj05Dir 1;
BA_ "GenSigStartValue" SG_ 365 ADC_Obj05Dir 0;
BA_ "GenSigTimeoutValue" SG_ 365 ADC_Obj05Dir 0;
BA_ "Remark" SG_ 365 ADC_Obj05Dir "";
BA_ "EventCommandSignal" SG_ 365 ADC_Obj06Typ 0;
BA_ "GatewayedSignals" SG_ 365 ADC_Obj06Typ 0;
BA_ "GenSigInactiveValue" SG_ 365 ADC_Obj06Typ 0;
BA_ "GenSigInvalidValue" SG_ 365 ADC_Obj06Typ 0;
BA_ "GenSigSendType" SG_ 365 ADC_Obj06Typ 1;
BA_ "GenSigStartValue" SG_ 365 ADC_Obj06Typ 0;
BA_ "GenSigTimeoutValue" SG_ 365 ADC_Obj06Typ 0;
BA_ "Remark" SG_ 365 ADC_Obj06Typ "";
BA_ "EventCommandSignal" SG_ 365 ADC_Obj06Dir 0;
BA_ "GatewayedSignals" SG_ 365 ADC_Obj06Dir 0;
BA_ "GenSigInactiveValue" SG_ 365 ADC_Obj06Dir 0;
BA_ "GenSigInvalidValue" SG_ 365 ADC_Obj06Dir 0;
BA_ "GenSigSendType" SG_ 365 ADC_Obj06Dir 1;
BA_ "GenSigStartValue" SG_ 365 ADC_Obj06Dir 0;
BA_ "GenSigTimeoutValue" SG_ 365 ADC_Obj06Dir 0;
BA_ "Remark" SG_ 365 ADC_Obj06Dir "";
BA_ "EventCommandSignal" SG_ 365 ADC_Obj07_ID 0;
BA_ "GatewayedSignals" SG_ 365 ADC_Obj07_ID 0;
BA_ "GenSigInactiveValue" SG_ 365 ADC_Obj07_ID 0;
BA_ "GenSigInvalidValue" SG_ 365 ADC_Obj07_ID 0;
BA_ "GenSigSendType" SG_ 365 ADC_Obj07_ID 1;
BA_ "GenSigStartValue" SG_ 365 ADC_Obj07_ID 0;
BA_ "GenSigTimeoutValue" SG_ 365 ADC_Obj07_ID 0;
BA_ "Remark" SG_ 365 ADC_Obj07_ID "";
BA_ "EventCommandSignal" SG_ 365 ADC_Obj07Typ 0;
BA_ "GatewayedSignals" SG_ 365 ADC_Obj07Typ 0;
BA_ "GenSigInactiveValue" SG_ 365 ADC_Obj07Typ 0;
BA_ "GenSigInvalidValue" SG_ 365 ADC_Obj07Typ 0;
BA_ "GenSigSendType" SG_ 365 ADC_Obj07Typ 1;
BA_ "GenSigStartValue" SG_ 365 ADC_Obj07Typ 0;
BA_ "GenSigTimeoutValue" SG_ 365 ADC_Obj07Typ 0;
BA_ "Remark" SG_ 365 ADC_Obj07Typ "";
BA_ "EventCommandSignal" SG_ 365 ADC_Obj07Dir 0;
BA_ "GatewayedSignals" SG_ 365 ADC_Obj07Dir 0;
BA_ "GenSigInactiveValue" SG_ 365 ADC_Obj07Dir 0;
BA_ "GenSigInvalidValue" SG_ 365 ADC_Obj07Dir 0;
BA_ "GenSigSendType" SG_ 365 ADC_Obj07Dir 1;
BA_ "GenSigStartValue" SG_ 365 ADC_Obj07Dir 0;
BA_ "GenSigTimeoutValue" SG_ 365 ADC_Obj07Dir 0;
BA_ "Remark" SG_ 365 ADC_Obj07Dir "";
BA_ "EventCommandSignal" SG_ 366 ADC_20_CRC 0;
BA_ "GatewayedSignals" SG_ 366 ADC_20_CRC 0;
BA_ "GenSigInactiveValue" SG_ 366 ADC_20_CRC 0;
BA_ "GenSigInvalidValue" SG_ 366 ADC_20_CRC 0;
BA_ "GenSigSendType" SG_ 366 ADC_20_CRC 1;
BA_ "GenSigStartValue" SG_ 366 ADC_20_CRC 0;
BA_ "GenSigTimeoutValue" SG_ 366 ADC_20_CRC 0;
BA_ "Remark" SG_ 366 ADC_20_CRC "";
BA_ "EventCommandSignal" SG_ 366 ADC_20_Counter 0;
BA_ "GatewayedSignals" SG_ 366 ADC_20_Counter 0;
BA_ "GenSigInactiveValue" SG_ 366 ADC_20_Counter 0;
BA_ "GenSigInvalidValue" SG_ 366 ADC_20_Counter 0;
BA_ "GenSigSendType" SG_ 366 ADC_20_Counter 1;
BA_ "GenSigStartValue" SG_ 366 ADC_20_Counter 0;
BA_ "GenSigTimeoutValue" SG_ 366 ADC_20_Counter 0;
BA_ "Remark" SG_ 366 ADC_20_Counter "";
BA_ "EventCommandSignal" SG_ 366 ADC_Obj07RightAngle 0;
BA_ "GatewayedSignals" SG_ 366 ADC_Obj07RightAngle 0;
BA_ "GenSigInactiveValue" SG_ 366 ADC_Obj07RightAngle 0;
BA_ "GenSigInvalidValue" SG_ 366 ADC_Obj07RightAngle 0;
BA_ "GenSigSendType" SG_ 366 ADC_Obj07RightAngle 1;
BA_ "GenSigStartValue" SG_ 366 ADC_Obj07RightAngle 0;
BA_ "GenSigTimeoutValue" SG_ 366 ADC_Obj07RightAngle 0;
BA_ "Remark" SG_ 366 ADC_Obj07RightAngle "";
BA_ "EventCommandSignal" SG_ 366 ADC_Obj07TopAngle 0;
BA_ "GatewayedSignals" SG_ 366 ADC_Obj07TopAngle 0;
BA_ "GenSigInactiveValue" SG_ 366 ADC_Obj07TopAngle 0;
BA_ "GenSigInvalidValue" SG_ 366 ADC_Obj07TopAngle 0;
BA_ "GenSigSendType" SG_ 366 ADC_Obj07TopAngle 1;
BA_ "GenSigStartValue" SG_ 366 ADC_Obj07TopAngle 0;
BA_ "GenSigTimeoutValue" SG_ 366 ADC_Obj07TopAngle 0;
BA_ "Remark" SG_ 366 ADC_Obj07TopAngle "";
BA_ "EventCommandSignal" SG_ 366 ADC_Obj08_ID 0;
BA_ "GatewayedSignals" SG_ 366 ADC_Obj08_ID 0;
BA_ "GenSigInactiveValue" SG_ 366 ADC_Obj08_ID 0;
BA_ "GenSigInvalidValue" SG_ 366 ADC_Obj08_ID 0;
BA_ "GenSigSendType" SG_ 366 ADC_Obj08_ID 1;
BA_ "GenSigStartValue" SG_ 366 ADC_Obj08_ID 0;
BA_ "GenSigTimeoutValue" SG_ 366 ADC_Obj08_ID 0;
BA_ "Remark" SG_ 366 ADC_Obj08_ID "";
BA_ "EventCommandSignal" SG_ 366 ADC_Obj08Typ 0;
BA_ "GatewayedSignals" SG_ 366 ADC_Obj08Typ 0;
BA_ "GenSigInactiveValue" SG_ 366 ADC_Obj08Typ 0;
BA_ "GenSigInvalidValue" SG_ 366 ADC_Obj08Typ 0;
BA_ "GenSigSendType" SG_ 366 ADC_Obj08Typ 1;
BA_ "GenSigStartValue" SG_ 366 ADC_Obj08Typ 0;
BA_ "GenSigTimeoutValue" SG_ 366 ADC_Obj08Typ 0;
BA_ "Remark" SG_ 366 ADC_Obj08Typ "";
BA_ "EventCommandSignal" SG_ 366 ADC_Obj08Dir 0;
BA_ "GatewayedSignals" SG_ 366 ADC_Obj08Dir 0;
BA_ "GenSigInactiveValue" SG_ 366 ADC_Obj08Dir 0;
BA_ "GenSigInvalidValue" SG_ 366 ADC_Obj08Dir 0;
BA_ "GenSigSendType" SG_ 366 ADC_Obj08Dir 1;
BA_ "GenSigStartValue" SG_ 366 ADC_Obj08Dir 0;
BA_ "GenSigTimeoutValue" SG_ 366 ADC_Obj08Dir 0;
BA_ "Remark" SG_ 366 ADC_Obj08Dir "";
BA_ "EventCommandSignal" SG_ 366 ADC_Obj08Dist 0;
BA_ "GatewayedSignals" SG_ 366 ADC_Obj08Dist 0;
BA_ "GenSigInactiveValue" SG_ 366 ADC_Obj08Dist 0;
BA_ "GenSigInvalidValue" SG_ 366 ADC_Obj08Dist 0;
BA_ "GenSigSendType" SG_ 366 ADC_Obj08Dist 1;
BA_ "GenSigStartValue" SG_ 366 ADC_Obj08Dist 0;
BA_ "GenSigTimeoutValue" SG_ 366 ADC_Obj08Dist 0;
BA_ "Remark" SG_ 366 ADC_Obj08Dist "";
BA_ "EventCommandSignal" SG_ 366 ADC_Obj08HoztAngSpd 0;
BA_ "GatewayedSignals" SG_ 366 ADC_Obj08HoztAngSpd 0;
BA_ "GenSigInactiveValue" SG_ 366 ADC_Obj08HoztAngSpd 0;
BA_ "GenSigInvalidValue" SG_ 366 ADC_Obj08HoztAngSpd 0;
BA_ "GenSigSendType" SG_ 366 ADC_Obj08HoztAngSpd 1;
BA_ "GenSigStartValue" SG_ 366 ADC_Obj08HoztAngSpd 0;
BA_ "GenSigTimeoutValue" SG_ 366 ADC_Obj08HoztAngSpd 0;
BA_ "Remark" SG_ 366 ADC_Obj08HoztAngSpd "";
BA_ "EventCommandSignal" SG_ 366 ADC_Obj08LeftAngle 0;
BA_ "GatewayedSignals" SG_ 366 ADC_Obj08LeftAngle 0;
BA_ "GenSigInactiveValue" SG_ 366 ADC_Obj08LeftAngle 0;
BA_ "GenSigInvalidValue" SG_ 366 ADC_Obj08LeftAngle 0;
BA_ "GenSigSendType" SG_ 366 ADC_Obj08LeftAngle 1;
BA_ "GenSigStartValue" SG_ 366 ADC_Obj08LeftAngle 0;
BA_ "GenSigTimeoutValue" SG_ 366 ADC_Obj08LeftAngle 0;
BA_ "Remark" SG_ 366 ADC_Obj08LeftAngle "";
BA_ "EventCommandSignal" SG_ 366 ADC_Obj08RightAngle 0;
BA_ "GatewayedSignals" SG_ 366 ADC_Obj08RightAngle 0;
BA_ "GenSigInactiveValue" SG_ 366 ADC_Obj08RightAngle 0;
BA_ "GenSigInvalidValue" SG_ 366 ADC_Obj08RightAngle 0;
BA_ "GenSigSendType" SG_ 366 ADC_Obj08RightAngle 1;
BA_ "GenSigStartValue" SG_ 366 ADC_Obj08RightAngle 0;
BA_ "GenSigTimeoutValue" SG_ 366 ADC_Obj08RightAngle 0;
BA_ "Remark" SG_ 366 ADC_Obj08RightAngle "";
BA_ "EventCommandSignal" SG_ 366 ADC_Obj08BottomAngle 0;
BA_ "GatewayedSignals" SG_ 366 ADC_Obj08BottomAngle 0;
BA_ "GenSigInactiveValue" SG_ 366 ADC_Obj08BottomAngle 0;
BA_ "GenSigInvalidValue" SG_ 366 ADC_Obj08BottomAngle 0;
BA_ "GenSigSendType" SG_ 366 ADC_Obj08BottomAngle 1;
BA_ "GenSigStartValue" SG_ 366 ADC_Obj08BottomAngle 0;
BA_ "GenSigTimeoutValue" SG_ 366 ADC_Obj08BottomAngle 0;
BA_ "Remark" SG_ 366 ADC_Obj08BottomAngle "";
BA_ "EventCommandSignal" SG_ 366 ADC_Obj08TopAngle 0;
BA_ "GatewayedSignals" SG_ 366 ADC_Obj08TopAngle 0;
BA_ "GenSigInactiveValue" SG_ 366 ADC_Obj08TopAngle 0;
BA_ "GenSigInvalidValue" SG_ 366 ADC_Obj08TopAngle 0;
BA_ "GenSigSendType" SG_ 366 ADC_Obj08TopAngle 1;
BA_ "GenSigStartValue" SG_ 366 ADC_Obj08TopAngle 0;
BA_ "GenSigTimeoutValue" SG_ 366 ADC_Obj08TopAngle 0;
BA_ "Remark" SG_ 366 ADC_Obj08TopAngle "";
BA_ "EventCommandSignal" SG_ 366 ADC_Obj09_ID 0;
BA_ "GatewayedSignals" SG_ 366 ADC_Obj09_ID 0;
BA_ "GenSigInactiveValue" SG_ 366 ADC_Obj09_ID 0;
BA_ "GenSigInvalidValue" SG_ 366 ADC_Obj09_ID 0;
BA_ "GenSigSendType" SG_ 366 ADC_Obj09_ID 1;
BA_ "GenSigStartValue" SG_ 366 ADC_Obj09_ID 0;
BA_ "GenSigTimeoutValue" SG_ 366 ADC_Obj09_ID 0;
BA_ "Remark" SG_ 366 ADC_Obj09_ID "";
BA_ "EventCommandSignal" SG_ 366 ADC_Obj09Typ 0;
BA_ "GatewayedSignals" SG_ 366 ADC_Obj09Typ 0;
BA_ "GenSigInactiveValue" SG_ 366 ADC_Obj09Typ 0;
BA_ "GenSigInvalidValue" SG_ 366 ADC_Obj09Typ 0;
BA_ "GenSigSendType" SG_ 366 ADC_Obj09Typ 1;
BA_ "GenSigStartValue" SG_ 366 ADC_Obj09Typ 0;
BA_ "GenSigTimeoutValue" SG_ 366 ADC_Obj09Typ 0;
BA_ "Remark" SG_ 366 ADC_Obj09Typ "";
BA_ "EventCommandSignal" SG_ 366 ADC_Obj09Dir 0;
BA_ "GatewayedSignals" SG_ 366 ADC_Obj09Dir 0;
BA_ "GenSigInactiveValue" SG_ 366 ADC_Obj09Dir 0;
BA_ "GenSigInvalidValue" SG_ 366 ADC_Obj09Dir 0;
BA_ "GenSigSendType" SG_ 366 ADC_Obj09Dir 1;
BA_ "GenSigStartValue" SG_ 366 ADC_Obj09Dir 0;
BA_ "GenSigTimeoutValue" SG_ 366 ADC_Obj09Dir 0;
BA_ "Remark" SG_ 366 ADC_Obj09Dir "";
BA_ "EventCommandSignal" SG_ 366 ADC_Obj09Dist 0;
BA_ "GatewayedSignals" SG_ 366 ADC_Obj09Dist 0;
BA_ "GenSigInactiveValue" SG_ 366 ADC_Obj09Dist 0;
BA_ "GenSigInvalidValue" SG_ 366 ADC_Obj09Dist 0;
BA_ "GenSigSendType" SG_ 366 ADC_Obj09Dist 1;
BA_ "GenSigStartValue" SG_ 366 ADC_Obj09Dist 0;
BA_ "GenSigTimeoutValue" SG_ 366 ADC_Obj09Dist 0;
BA_ "Remark" SG_ 366 ADC_Obj09Dist "";
BA_ "EventCommandSignal" SG_ 366 ADC_Obj09HoztAngSpd 0;
BA_ "GatewayedSignals" SG_ 366 ADC_Obj09HoztAngSpd 0;
BA_ "GenSigInactiveValue" SG_ 366 ADC_Obj09HoztAngSpd 0;
BA_ "GenSigInvalidValue" SG_ 366 ADC_Obj09HoztAngSpd 0;
BA_ "GenSigSendType" SG_ 366 ADC_Obj09HoztAngSpd 1;
BA_ "GenSigStartValue" SG_ 366 ADC_Obj09HoztAngSpd 0;
BA_ "GenSigTimeoutValue" SG_ 366 ADC_Obj09HoztAngSpd 0;
BA_ "Remark" SG_ 366 ADC_Obj09HoztAngSpd "";
BA_ "EventCommandSignal" SG_ 366 ADC_Obj09LeftAngle 0;
BA_ "GatewayedSignals" SG_ 366 ADC_Obj09LeftAngle 0;
BA_ "GenSigInactiveValue" SG_ 366 ADC_Obj09LeftAngle 0;
BA_ "GenSigInvalidValue" SG_ 366 ADC_Obj09LeftAngle 0;
BA_ "GenSigSendType" SG_ 366 ADC_Obj09LeftAngle 1;
BA_ "GenSigStartValue" SG_ 366 ADC_Obj09LeftAngle 0;
BA_ "GenSigTimeoutValue" SG_ 366 ADC_Obj09LeftAngle 0;
BA_ "Remark" SG_ 366 ADC_Obj09LeftAngle "";
BA_ "EventCommandSignal" SG_ 366 ADC_Obj09RightAngle 0;
BA_ "GatewayedSignals" SG_ 366 ADC_Obj09RightAngle 0;
BA_ "GenSigInactiveValue" SG_ 366 ADC_Obj09RightAngle 0;
BA_ "GenSigInvalidValue" SG_ 366 ADC_Obj09RightAngle 0;
BA_ "GenSigSendType" SG_ 366 ADC_Obj09RightAngle 1;
BA_ "GenSigStartValue" SG_ 366 ADC_Obj09RightAngle 0;
BA_ "GenSigTimeoutValue" SG_ 366 ADC_Obj09RightAngle 0;
BA_ "Remark" SG_ 366 ADC_Obj09RightAngle "";
BA_ "EventCommandSignal" SG_ 366 ADC_Obj09BottomAngle 0;
BA_ "GatewayedSignals" SG_ 366 ADC_Obj09BottomAngle 0;
BA_ "GenSigInactiveValue" SG_ 366 ADC_Obj09BottomAngle 0;
BA_ "GenSigInvalidValue" SG_ 366 ADC_Obj09BottomAngle 0;
BA_ "GenSigSendType" SG_ 366 ADC_Obj09BottomAngle 1;
BA_ "GenSigStartValue" SG_ 366 ADC_Obj09BottomAngle 0;
BA_ "GenSigTimeoutValue" SG_ 366 ADC_Obj09BottomAngle 0;
BA_ "Remark" SG_ 366 ADC_Obj09BottomAngle "";
BA_ "EventCommandSignal" SG_ 366 ADC_Obj09TopAngle 0;
BA_ "GatewayedSignals" SG_ 366 ADC_Obj09TopAngle 0;
BA_ "GenSigInactiveValue" SG_ 366 ADC_Obj09TopAngle 0;
BA_ "GenSigInvalidValue" SG_ 366 ADC_Obj09TopAngle 0;
BA_ "GenSigSendType" SG_ 366 ADC_Obj09TopAngle 1;
BA_ "GenSigStartValue" SG_ 366 ADC_Obj09TopAngle 0;
BA_ "GenSigTimeoutValue" SG_ 366 ADC_Obj09TopAngle 0;
BA_ "Remark" SG_ 366 ADC_Obj09TopAngle "";
BA_ "EventCommandSignal" SG_ 366 ADC_Obj010_ID 0;
BA_ "GatewayedSignals" SG_ 366 ADC_Obj010_ID 0;
BA_ "GenSigInactiveValue" SG_ 366 ADC_Obj010_ID 0;
BA_ "GenSigInvalidValue" SG_ 366 ADC_Obj010_ID 0;
BA_ "GenSigSendType" SG_ 366 ADC_Obj010_ID 1;
BA_ "GenSigStartValue" SG_ 366 ADC_Obj010_ID 0;
BA_ "GenSigTimeoutValue" SG_ 366 ADC_Obj010_ID 0;
BA_ "Remark" SG_ 366 ADC_Obj010_ID "";
BA_ "EventCommandSignal" SG_ 366 ADC_Obj010Typ 0;
BA_ "GatewayedSignals" SG_ 366 ADC_Obj010Typ 0;
BA_ "GenSigInactiveValue" SG_ 366 ADC_Obj010Typ 0;
BA_ "GenSigInvalidValue" SG_ 366 ADC_Obj010Typ 0;
BA_ "GenSigSendType" SG_ 366 ADC_Obj010Typ 1;
BA_ "GenSigStartValue" SG_ 366 ADC_Obj010Typ 0;
BA_ "GenSigTimeoutValue" SG_ 366 ADC_Obj010Typ 0;
BA_ "Remark" SG_ 366 ADC_Obj010Typ "";
BA_ "EventCommandSignal" SG_ 366 ADC_Obj010Dir 0;
BA_ "GatewayedSignals" SG_ 366 ADC_Obj010Dir 0;
BA_ "GenSigInactiveValue" SG_ 366 ADC_Obj010Dir 0;
BA_ "GenSigInvalidValue" SG_ 366 ADC_Obj010Dir 0;
BA_ "GenSigSendType" SG_ 366 ADC_Obj010Dir 1;
BA_ "GenSigStartValue" SG_ 366 ADC_Obj010Dir 0;
BA_ "GenSigTimeoutValue" SG_ 366 ADC_Obj010Dir 0;
BA_ "Remark" SG_ 366 ADC_Obj010Dir "";
BA_ "EventCommandSignal" SG_ 366 ADC_Obj010Dist 0;
BA_ "GatewayedSignals" SG_ 366 ADC_Obj010Dist 0;
BA_ "GenSigInactiveValue" SG_ 366 ADC_Obj010Dist 0;
BA_ "GenSigInvalidValue" SG_ 366 ADC_Obj010Dist 0;
BA_ "GenSigSendType" SG_ 366 ADC_Obj010Dist 1;
BA_ "GenSigStartValue" SG_ 366 ADC_Obj010Dist 0;
BA_ "GenSigTimeoutValue" SG_ 366 ADC_Obj010Dist 0;
BA_ "Remark" SG_ 366 ADC_Obj010Dist "";
BA_ "EventCommandSignal" SG_ 366 ADC_Obj010HoztAngSpd 0;
BA_ "GatewayedSignals" SG_ 366 ADC_Obj010HoztAngSpd 0;
BA_ "GenSigInactiveValue" SG_ 366 ADC_Obj010HoztAngSpd 0;
BA_ "GenSigInvalidValue" SG_ 366 ADC_Obj010HoztAngSpd 0;
BA_ "GenSigSendType" SG_ 366 ADC_Obj010HoztAngSpd 1;
BA_ "GenSigStartValue" SG_ 366 ADC_Obj010HoztAngSpd 0;
BA_ "GenSigTimeoutValue" SG_ 366 ADC_Obj010HoztAngSpd 0;
BA_ "Remark" SG_ 366 ADC_Obj010HoztAngSpd "";
BA_ "EventCommandSignal" SG_ 366 ADC_Obj010LeftAngle 0;
BA_ "GatewayedSignals" SG_ 366 ADC_Obj010LeftAngle 0;
BA_ "GenSigInactiveValue" SG_ 366 ADC_Obj010LeftAngle 0;
BA_ "GenSigInvalidValue" SG_ 366 ADC_Obj010LeftAngle 0;
BA_ "GenSigSendType" SG_ 366 ADC_Obj010LeftAngle 1;
BA_ "GenSigStartValue" SG_ 366 ADC_Obj010LeftAngle 0;
BA_ "GenSigTimeoutValue" SG_ 366 ADC_Obj010LeftAngle 0;
BA_ "Remark" SG_ 366 ADC_Obj010LeftAngle "";
BA_ "EventCommandSignal" SG_ 366 ADC_Obj010RightAngle 0;
BA_ "GatewayedSignals" SG_ 366 ADC_Obj010RightAngle 0;
BA_ "GenSigInactiveValue" SG_ 366 ADC_Obj010RightAngle 0;
BA_ "GenSigInvalidValue" SG_ 366 ADC_Obj010RightAngle 0;
BA_ "GenSigSendType" SG_ 366 ADC_Obj010RightAngle 1;
BA_ "GenSigStartValue" SG_ 366 ADC_Obj010RightAngle 0;
BA_ "GenSigTimeoutValue" SG_ 366 ADC_Obj010RightAngle 0;
BA_ "Remark" SG_ 366 ADC_Obj010RightAngle "";
BA_ "EventCommandSignal" SG_ 366 ADC_Obj010BottomAngle 0;
BA_ "GatewayedSignals" SG_ 366 ADC_Obj010BottomAngle 0;
BA_ "GenSigInactiveValue" SG_ 366 ADC_Obj010BottomAngle 0;
BA_ "GenSigInvalidValue" SG_ 366 ADC_Obj010BottomAngle 0;
BA_ "GenSigSendType" SG_ 366 ADC_Obj010BottomAngle 1;
BA_ "GenSigStartValue" SG_ 366 ADC_Obj010BottomAngle 0;
BA_ "GenSigTimeoutValue" SG_ 366 ADC_Obj010BottomAngle 0;
BA_ "Remark" SG_ 366 ADC_Obj010BottomAngle "";
BA_ "EventCommandSignal" SG_ 366 ADC_Obj010TopAngle 0;
BA_ "GatewayedSignals" SG_ 366 ADC_Obj010TopAngle 0;
BA_ "GenSigInactiveValue" SG_ 366 ADC_Obj010TopAngle 0;
BA_ "GenSigInvalidValue" SG_ 366 ADC_Obj010TopAngle 0;
BA_ "GenSigSendType" SG_ 366 ADC_Obj010TopAngle 1;
BA_ "GenSigStartValue" SG_ 366 ADC_Obj010TopAngle 0;
BA_ "GenSigTimeoutValue" SG_ 366 ADC_Obj010TopAngle 0;
BA_ "Remark" SG_ 366 ADC_Obj010TopAngle "";
BA_ "EventCommandSignal" SG_ 366 Reserved1 0;
BA_ "GatewayedSignals" SG_ 366 Reserved1 0;
BA_ "GenSigInactiveValue" SG_ 366 Reserved1 0;
BA_ "GenSigInvalidValue" SG_ 366 Reserved1 0;
BA_ "GenSigSendType" SG_ 366 Reserved1 1;
BA_ "GenSigStartValue" SG_ 366 Reserved1 0;
BA_ "GenSigTimeoutValue" SG_ 366 Reserved1 0;
BA_ "Remark" SG_ 366 Reserved1 "";
VAL_ 971 ADC_MnvrOrintChng6 0 "None" 1 "Parallel" 2 "Cross" 3 "Oblique"  ;
VAL_ 971 ADC_TarParkSt_Posn6 0 "None" 1 "Invalid" 2 "Valid" 3 "Selectable" 4 "Selected" 5 "Reserved" 6 "Reserved" 7 "Reserved"  ;
VAL_ 971 ADC_ParkChkSrc_Posn6 0 "None" 1 "camera" 2 "lidar" 3 "mixed" 4 "Reserved" 5 "Reserved" 6 "Reserved" 7 "Reserved"  ;
VAL_ 971 ADC_MnvrOrintChng7 0 "None" 1 "Parallel" 2 "Cross" 3 "Oblique"  ;
VAL_ 971 ADC_TarParkSt_Posn7 0 "None" 1 "Invalid" 2 "Valid" 3 "Selectable" 4 "Selected" 5 "Reserved" 6 "Reserved" 7 "Reserved"  ;
VAL_ 971 ADC_ParkChkSrc_Posn7 0 "None" 1 "camera" 2 "lidar" 3 "mixed" 4 "Reserved" 5 "Reserved" 6 "Reserved" 7 "Reserved"  ;
VAL_ 971 ADC_MnvrOrintChng8 0 "None" 1 "Parallel" 2 "Cross" 3 "Oblique"  ;
VAL_ 971 ADC_TarParkSt_Posn8 0 "None" 1 "Invalid" 2 "Valid" 3 "Selectable" 4 "Selected" 5 "Reserved" 6 "Reserved" 7 "Reserved"  ;
VAL_ 971 ADC_ParkChkSrc_Posn8 0 "None" 1 "camera" 2 "lidar" 3 "mixed" 4 "Reserved" 5 "Reserved" 6 "Reserved" 7 "Reserved"  ;
VAL_ 971 ADC_MnvrOrintChng5 0 "None" 1 "Parallel" 2 "Cross" 3 "Oblique"  ;
VAL_ 971 ADC_TarParkSt_Posn5 0 "None" 1 "Invalid" 2 "Valid" 3 "Selectable" 4 "Selected" 5 "Reserved" 6 "Reserved" 7 "Reserved"  ;
VAL_ 971 ADC_ParkChkSrc_Posn5 0 "None" 1 "camera" 2 "lidar" 3 "mixed" 4 "Reserved" 5 "Reserved" 6 "Reserved" 7 "Reserved"  ;
VAL_ 365 ADC_Obj02_ID 0 "No Object" 62 "Initating" 63 "Not Available"  ;
VAL_ 365 ADC_Obj04_ID 0 "No Object" 62 "Initating" 63 "Not Available"  ;
VAL_ 365 ADC_Obj01_ID 0 "No Object" 62 "Initating" 63 "Not Available"  ;
VAL_ 365 ADC_Obj03_ID 0 "No Object" 62 "Initating" 63 "Not Available"  ;
VAL_ 365 ADC_Obj06_ID 0 "No Object" 62 "Initating" 63 "Not Available"  ;
VAL_ 365 ADC_Obj05_ID 0 "No Object" 62 "Initating" 63 "Not Available"  ;
VAL_ 365 ADC_Obj04Typ 0 "NoVehicle" 1 "Car" 2 "Truck" 3 "Bus" 4 "Bike" 5 "Pedestrain" 6 "Mixed" 7 "Billboard" 8 "Unknown" 9 "Front single lamp" 10 "Front double lamp" 11 "Tail single lamp" 12 "Tail double lamp"  ;
VAL_ 365 ADC_Obj04Dir 0 "Idle" 1 "Oncoming" 2 "Preceding" 3 "Others"  ;
VAL_ 365 ADC_ADBCamSt 0 "On Passive" 1 "On Active" 2 "On Reduced Sight" 3 "On Faliure" 4 "Off" 5 "Reserved" 6 "Reserved" 7 "Reserved" 8 "Reserved" 9 "Reserved" 10 "Reserved" 11 "Reserved" 12 "Reserved" 13 "Reserved" 14 "Initating" 15 "Not Available"  ;
VAL_ 365 ADC_Obj03Dir 0 "Idle" 1 "Oncoming" 2 "Preceding" 3 "Others"  ;
VAL_ 365 ADC_Obj02Dir 0 "Idle" 1 "Oncoming" 2 "Preceding" 3 "Others"  ;
VAL_ 365 ADC_Obj02Typ 0 "NoVehicle" 1 "Car" 2 "Truck" 3 "Bus" 4 "Bike" 5 "Pedestrain" 6 "Mixed" 7 "Billboard" 8 "Unknown" 9 "Front single lamp" 10 "Front double lamp" 11 "Tail single lamp" 12 "Tail double lamp"  ;
VAL_ 365 ADC_Obj03Typ 0 "NoVehicle" 1 "Car" 2 "Truck" 3 "Bus" 4 "Bike" 5 "Pedestrain" 6 "Mixed" 7 "Billboard" 8 "Unknown" 9 "Front single lamp" 10 "Front double lamp" 11 "Tail single lamp" 12 "Tail double lamp"  ;
VAL_ 365 ADC_Obj01Typ 0 "NoVehicle" 1 "Car" 2 "Truck" 3 "Bus" 4 "Bike" 5 "Pedestrain" 6 "Mixed" 7 "Billboard" 8 "Unknown" 9 "Front single lamp" 10 "Front double lamp" 11 "Tail single lamp" 12 "Tail double lamp"  ;
VAL_ 365 ADC_Obj01Dir 0 "Idle" 1 "Oncoming" 2 "Preceding" 3 "Others"  ;
VAL_ 365 ADC_ObjNum 0 "No Object Detected" 1 "1 Object Detected" 2 "2 Object Detected" 3 "3 Object Detected" 4 "4 Object Detected" 5 "5 Object Detected" 6 "6 Object Detected" 7 "7 Object Detected" 8 "8 Object Detected" 9 "9 Object Detected" 10 "10 Object Detected" 11 ">10 Object Detected" 12 "Reserved" 13 "Reserved" 14 "Initating" 15 "Not Available"  ;
VAL_ 365 ADC_AmbLightCondition 0 "No Object Detected" 1 "Day" 2 "Night with Road Lamp" 3 "Night without Road Lamp" 4 "Reserved" 5 "Reserved" 6 "Reserved" 7 "Reserved" 8 "Reserved" 9 "Reserved" 10 "Reserved" 11 "Reserved" 12 "Reserved" 13 "Reserved" 14 "Initating" 15 "Not Available"  ;
VAL_ 365 ADC_TrafficStyle 0 "Unknow" 1 "Right Hand Traffic" 2 "Left Hand Traffic" 3 "Reserved" 4 "Reserved" 5 "Reserved" 6 "Reserved" 7 "Reserved" 8 "Reserved" 9 "Reserved" 10 "Reserved" 11 "Reserved" 12 "Reserved" 13 "Reserved" 14 "Initating" 15 "Not Available"  ;
VAL_ 365 ADC_Obj05Typ 0 "NoVehicle" 1 "Car" 2 "Truck" 3 "Bus" 4 "Bike" 5 "Pedestrain" 6 "Mixed" 7 "Billboard" 8 "Unknown" 9 "Front single lamp" 10 "Front double lamp" 11 "Tail single lamp" 12 "Tail double lamp"  ;
VAL_ 365 ADC_Obj05Dir 0 "Idle" 1 "Oncoming" 2 "Preceding" 3 "Others"  ;
VAL_ 365 ADC_Obj06Typ 0 "NoVehicle" 1 "Car" 2 "Truck" 3 "Bus" 4 "Bike" 5 "Pedestrain" 6 "Mixed" 7 "Billboard" 8 "Unknown" 9 "Front single lamp" 10 "Front double lamp" 11 "Tail single lamp" 12 "Tail double lamp"  ;
VAL_ 365 ADC_Obj06Dir 0 "Idle" 1 "Oncoming" 2 "Preceding" 3 "Others"  ;
VAL_ 365 ADC_Obj07_ID 0 "No Object" 62 "Initating" 63 "Not Available"  ;
VAL_ 365 ADC_Obj07Typ 0 "NoVehicle" 1 "Car" 2 "Truck" 3 "Bus" 4 "Bike" 5 "Pedestrain" 6 "Mixed" 7 "Billboard" 8 "Unknown" 9 "Front single lamp" 10 "Front double lamp" 11 "Tail single lamp" 12 "Tail double lamp"  ;
VAL_ 365 ADC_Obj07Dir 0 "Idle" 1 "Oncoming" 2 "Preceding" 3 "Others"  ;
VAL_ 366 ADC_Obj08_ID 0 "No Object" 62 "Initating" 63 "Not Available"  ;
VAL_ 366 ADC_Obj08Typ 0 "NoVehicle" 1 "Car" 2 "Truck" 3 "Bus" 4 "Bike" 5 "Pedestrain" 6 "Mixed" 7 "Billboard" 8 "Unknown" 9 "Front single lamp" 10 "Front double lamp" 11 "Tail single lamp" 12 "Tail double lamp"  ;
VAL_ 366 ADC_Obj08Dir 0 "Idle" 1 "Oncoming" 2 "Preceding" 3 "Others"  ;
VAL_ 366 ADC_Obj09_ID 0 "No Object" 62 "Initating" 63 "Not Available"  ;
VAL_ 366 ADC_Obj09Typ 0 "NoVehicle" 1 "Car" 2 "Truck" 3 "Bus" 4 "Bike" 5 "Pedestrain" 6 "Mixed" 7 "Billboard" 8 "Unknown" 9 "Front single lamp" 10 "Front double lamp" 11 "Tail single lamp" 12 "Tail double lamp"  ;
VAL_ 366 ADC_Obj09Dir 0 "Idle" 1 "Oncoming" 2 "Preceding" 3 "Others"  ;
VAL_ 366 ADC_Obj010_ID 0 "No Object" 62 "Initating" 63 "Not Available"  ;
VAL_ 366 ADC_Obj010Typ 0 "NoVehicle" 1 "Car" 2 "Truck" 3 "Bus" 4 "Bike" 5 "Pedestrain" 6 "Mixed" 7 "Billboard" 8 "Unknown" 9 "Front single lamp" 10 "Front double lamp" 11 "Tail single lamp" 12 "Tail double lamp"  ;
VAL_ 366 ADC_Obj010Dir 0 "Idle" 1 "Oncoming" 2 "Preceding" 3 "Others"  ;
