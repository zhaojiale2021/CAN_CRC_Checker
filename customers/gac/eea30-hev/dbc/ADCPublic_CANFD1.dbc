VERSION "Version"

NS_ :

BS_:

BU_: Tester CCU INU ADC RRR RLR CCURT1 CCURT2 ZCUF ZCUL ZCUR ZCUT EMS IDM DCDC DCDCI IPS NIDU DCU2 OBC OPC LPC CPC EMCM GCU DCU IPU BMS EOP EVCC DCDC2 EDL SRS ECS EPS EPB RBM IBCS ICM IID IDC AMP WHUD ARHUD IMR FIMR CD IFC FAPA PAS PCS SCMF SCMR SCMRL SCMRR MFS DRM FCP RCP LBMSAD AVAS DLPFL FBLCM FLISD FLLCM FRLCM RLLCMA RLLCMB RRLCMA RRLCMB RLISD DLPML DLPMR TRM PSDL PSDR FLDCM FRDCM HVSPRL HVSPRR RFR SBM WCM ETC TBOX2 TBOX RLBMS EBU FLPDM RLPDM FRPDM RRPDM FLOAR FROAR RLOAR RROAR EOSL EOSR EOST PRBU RT1_C0 OTAWL RT2_C3 IDUR PHUDD RAS CBM PLGM TMC LPC2 SAS RCICP SCMRM SCMT SLMRL SLMRR IDU RRISD DSASBM LBMS RT1_C1

BO_ 419 ADC_4: 64 ADC
 SG_ ADC_4_CRC : 7|16@0+ (1,0) [0|65535] ""  CCU,CCURT1,CCURT2,RT1_C1,RT2_C3,FAPA
 SG_ ADC_4_Counter : 23|8@0+ (1,0) [0|255] ""  CCU,CCURT1,CCURT2,RT1_C1,RT2_C3,FAPA
 SG_ ADC_AngReqSt_A : 31|2@0+ (1,0) [0|3] ""  CCU,CCURT1,FAPA
 SG_ ADC_AngReqFunction : 29|2@0+ (1,0) [0|3] ""  CCU,CCURT1,FAPA
 SG_ ADC_BrakeLightReq : 27|2@0+ (1,0) [0|3] ""  CCU,CCURT1,CCURT2,RT2_C3,FAPA
 SG_ ADC_StrAngleReq_A : 39|16@0+ (0.1,-780) [-780|779.9] "deg"  CCU,CCURT1,FAPA
 SG_ ADC_SACMotorTorLimExtMax_A : 55|8@0+ (0.02,0) [0|5.08] "Nm"  CCU,CCURT1,FAPA
 SG_ ADC_SACMotorTorLimExtMin_A : 63|8@0+ (0.02,-5.08) [-5.08|0] "Nm"  CCU,CCURT1,FAPA
 SG_ ADC_AssistParaSwitchReq : 71|1@0+ (1,0) [0|1] ""  CCU,CCURT1,FAPA
 SG_ ADC_AngReqRdntReq_A : 70|1@0+ (1,0) [0|1] ""  CCU,CCURT1,FAPA
 SG_ ADC_SteerGainReq : 69|1@0+ (1,0) [0|1] ""  CCU,CCURT1,FAPA
 SG_ ADC_StrgWhlVibrWarnLevel : 68|2@0+ (1,0) [0|3] ""  CCU,CCURT1,FAPA
 SG_ ADC_ActTrqReqEnable : 66|1@0+ (1,0) [0|1] ""  CCU,CCURT1,RT1_C1,FAPA
 SG_ ADC_VLCSt : 65|2@0+ (1,0) [0|2] ""  CCU,CCURT1,RT1_C1,FAPA
 SG_ ADC_SteerGainLevel : 79|8@0+ (1,0) [0|254] "%"  CCU,CCURT1,FAPA
 SG_ ADC_EvsSteerReq : 87|1@0+ (1,0) [0|1] ""  CCU,CCURT1,FAPA
 SG_ ADC_StrgWhlVibrWarnReq : 86|1@0+ (1,0) [0|1] ""  CCU,CCURT1,FAPA
 SG_ ADC_ActTrqReq : 85|14@0+ (1,-5000) [-5000|5000] "Nm"  CCU,CCURT1,RT1_C1,FAPA
 SG_ ADC_ADASLongCtrlFuncMode : 135|3@0+ (1,0) [0|7] ""  CCU,CCURT1,FAPA
 SG_ ADC_LongCtrlAvailability : 132|1@0+ (1,0) [0|1] ""  CCU,CCURT1,RT1_C1,FAPA
 SG_ ADC_LongCtrlModeForBrkSys : 131|3@0+ (1,0) [0|7] ""  CCU,CCURT1,RT1_C1,FAPA
 SG_ IFC_DPTst : 122|3@0+ (1,0) [0|7] ""  CCU,FAPA
 SG_ ADC_DrvTarTqMod2EPB : 124|2@0+ (1,0) [0|3] ""  CCU,FAPA
 SG_ ADC_LongCtrlTargetAxReq : 128|1@0+ (1,0) [0|1] ""  CCU,CCURT1,FAPA
 SG_ ADC_LongCtrlTypReq : 143|1@0+ (1,0) [0|1] ""  CCU,CCURT1,FAPA
 SG_ ADC_LongCtrlDecToStopReq : 142|1@0+ (1,0) [0|1] ""  CCU,CCURT1,FAPA
 SG_ ADC_LongCtrlDriveOff : 141|1@0+ (1,0) [0|1] ""  CCU,CCURT1,FAPA
 SG_ ADC_LongctrlSecureReq : 140|1@0+ (1,0) [0|1] ""  CCU,CCURT1,FAPA
 SG_ ADC_ShifttoAVHReq : 139|1@0+ (1,0) [0|1] ""  CCU,CCURT1,FAPA
 SG_ ADC_LongCtrlTargetAx : 138|11@0+ (0.01,-10) [-10|10] "m/s2"  CCU,CCURT1,FAPA
 SG_ ADC_TrkTargt0St : 159|1@0+ (1,0) [0|1] ""  CCU,CCURT1,RT1_C1,FAPA
 SG_ ADC_TrkTargt0longPos : 158|10@0+ (0.2,0) [0|204.4] "m"  CCU,CCURT1,RT1_C1,FAPA
 SG_ ADC_TrkTargt0latPos : 164|10@0+ (0.1,-51.2) [-51.2|51.1] "m"  CCU,CCURT1,RT1_C1,FAPA
 SG_ ADC_TrkTargt0LatRelSpd : 170|9@0+ (0.1,-25.5) [-25.5|25.5] "m/s"  CCU,CCURT1,RT1_C1,FAPA
 SG_ ADC_TrkTargt0LongRelSpd : 177|10@0+ (0.1,-51.2) [-51.2|51.1] "m/s"  CCU,CCURT1,RT1_C1,FAPA
 SG_ ADC_AS_pauseReq : 199|1@0+ (1,0) [0|1] ""  CCU,FAPA
 SG_ ADC_AS_calibrationReq : 198|3@0+ (1,0) [0|5] ""  CCU,FAPA
 SG_ ADC_AS_exitcurrentlevelReq : 195|1@0+ (1,0) [0|1] ""  CCU,FAPA
 SG_ ADC_AS_ReqToadjust : 194|3@0+ (1,0) [0|5] ""  CCU,FAPA
 SG_ ADC_AS_UnsafelevelunableReq : 207|1@0+ (1,0) [0|1] ""  CCU,FAPA
 SG_ ADC_AEBTargetDecel : 243|12@0+ (0.008,-16) [-16|16] "m/s2"  CCU,CCURT1,FAPA
 SG_ ADC_AEBFaultSt : 263|1@0+ (1,0) [0|1] ""  CCU,CCURT1,RT1_C1,FAPA
 SG_ ADC_AEBOffSt : 262|1@0+ (1,0) [0|1] ""  CCU,CCURT1,RT1_C1,FAPA
 SG_ ADC_AEBInterventionSt : 261|1@0+ (1,0) [0|1] ""  CCU,CCURT1,RT1_C1,FAPA
 SG_ ADC_AEBDecelCtrlReq : 260|1@0+ (1,0) [0|1] ""  CCU,CCURT1,RT1_C1,FAPA
 SG_ ADC_AEBLVehHoldReq : 259|1@0+ (1,0) [0|1] ""  CCU,CCURT1,FAPA
 SG_ ADC_ABAReq : 258|1@0+ (1,0) [0|1] ""  CCU,CCURT1,FAPA
 SG_ ADC_ABALevel : 257|2@0+ (1,0) [0|3] ""  CCU,CCURT1,FAPA
 SG_ ADC_AWBReq : 271|1@0+ (1,0) [0|1] ""  CCU,CCURT1,FAPA
 SG_ ADC_ABPReq : 270|1@0+ (1,0) [0|1] ""  CCU,CCURT1,FAPA
 SG_ ADC_AWBLevel : 269|3@0+ (1,0) [0|7] ""  CCU,CCURT1,FAPA
 SG_ ADC_AEBTarCalss : 266|3@0+ (1,0) [0|7] ""  CCU,CCURT1,RT1_C1,FAPA
 SG_ ADC_AEBTarDetSensor : 277|2@0+ (1,0) [0|3] ""  CCU,CCURT1,RT1_C1,FAPA
 SG_ ADC_TurnLightReq : 275|3@0+ (1,0) [0|7] ""  CCU,CCURT1,CCURT2,RT2_C3,FAPA
 SG_ ADC_PAA2ESPAxReqEnable : 272|1@0+ (1,0) [0|1] ""  CCU,CCURT1,FAPA
 SG_ ADC_PAA2ESPBrakeFunctionMode : 287|3@0+ (1,0) [0|7] ""  CCU,CCURT1,RT1_C1,FAPA
 SG_ ADC_PAA2ESPEpbReq : 284|2@0+ (1,0) [0|2] ""  CCU,CCURT1,FAPA
 SG_ ADC_PAA2ESPEpbReqSt : 282|1@0+ (1,0) [0|1] ""  CCU,CCURT1,FAPA
 SG_ ADC_PAA2EPBEpbReq : 281|2@0+ (1,0) [0|2] ""  CCU,CCURT1,FAPA
 SG_ ADC_ESPSwitchReq : 295|1@0+ (1,0) [0|1] ""  CCU,CCURT1,FAPA
 SG_ ADC_PAA2EPBEpbReqSt : 294|1@0+ (1,0) [0|1] ""  CCU,CCURT1,FAPA
 SG_ ADC_PAA2EPBBrakeFunctionMode : 293|1@0+ (1,0) [0|1] ""  CCU,CCURT1,FAPA
 SG_ ADC_PAA2ESPApEmgyBrkReq : 292|1@0+ (1,0) [0|1] ""  CCU,CCURT1,FAPA
 SG_ ADC_PAA2ESPComfBrakeReq : 291|2@0+ (1,0) [0|3] ""  CCU,CCURT1,FAPA
 SG_ ADC_PAA2ESPApDriveOffReq : 289|1@0+ (1,0) [0|1] ""  CCU,CCURT1,FAPA
 SG_ ADC_AEBObjectTTC : 288|9@0+ (0.01,0) [0|5] "s"  CCU,CCURT1,RT1_C1,FAPA
 SG_ ADC_PAA2ESPApStandstillReq : 311|1@0+ (1,0) [0|1] ""  CCU,CCURT1,FAPA
 SG_ ADC_PAA2ESPApPrefillReq : 310|1@0+ (1,0) [0|1] ""  CCU,CCURT1,FAPA
 SG_ ADC_AEBObjRelativeSpd : 304|9@0+ (0.1,0) [0|50] "m/s"  CCU,CCURT1,RT1_C1,FAPA
 SG_ ADC_PAA2ESPAxReq : 327|14@0+ (0.001,-10) [-10|6] "m/s2"  CCU,CCURT1,FAPA
 SG_ ADC_EPBReq : 329|1@0+ (1,0) [0|1] ""  CCU,CCURT1,FAPA
 SG_ ADC_PAA2ESPDistoStop : 339|12@0+ (1,0) [0|4095] "cm"  CCU,CCURT1,FAPA
 SG_ ADC_PAA2ESPTarTorquePTDriveoff : 359|16@0+ (1,-30000) [-30000|30000] "Nm"  CCU,CCURT1,FAPA
 SG_ ADC_VehTorqLimit : 375|16@0+ (1,-5000) [-5000|5000] "Nm"  CCU,CCURT1,FAPA
 SG_ ADC_VehTorqReqValue : 391|16@0+ (1,-5000) [-5000|5000] "Nm"  CCU,CCURT1,FAPA
 SG_ ADC_VehTorqLimitEnable : 407|1@0+ (1,0) [0|1] ""  CCU,CCURT1,FAPA
 SG_ ADC_VehTorqReqEnable : 406|1@0+ (1,0) [0|1] ""  CCU,CCURT1,FAPA
 SG_ ADC_PAAPwrModeReq : 405|1@0+ (1,0) [0|1] ""  CCU,CCURT1,RT1_C1,FAPA
 SG_ ADC_PAAGrarLvlReq : 404|3@0+ (1,0) [0|7] ""  CCU,CCURT1,RT1_C1,FAPA
 SG_ ADC_PAAGrarLvlReqEnable : 401|1@0+ (1,0) [0|1] ""  CCU,CCURT1,RT1_C1,FAPA
 SG_ ADC_ACCMode_C : 415|4@0+ (1,0) [0|15] ""  CCU,CCURT1,FAPA
 SG_ ADC_FcsActiveStatus : 205|1@0+ (1,0) [0|1] ""  CCU,CCURT1,RT1_C1,FAPA
 SG_ ADC_ActTrqReqVD : 341|1@0+ (1,0) [0|1] ""  CCU,CCURT1,RT1_C1,FAPA
 SG_ ADC_RCTBTargetDecel : 411|8@0+ (0.05,-10) [-10|2.75] "m/s2"  CCU,CCURT1,FAPA
 SG_ ADC_RCTBBrkReq : 419|1@0+ (1,0) [0|1] ""  CCU,CCURT1,FAPA
 SG_ ADC_BrkTarTqEna : 125|1@0+ (1,0) [0|1] ""  CCU,CCURT1,FAPA
 SG_ ADC_BrkTarTqMod : 25|2@0+ (1,0) [0|3] ""  CCU,CCURT1,FAPA
 SG_ ADC_AebBrkTarTq : 111|16@0+ (1,0) [0|65535] "Nm"  CCU,CCURT1,FAPA
 SG_ ADC_EpbModReqVld : 126|1@0+ (1,0) [0|1] ""  CCU,CCURT1,FAPA
 SG_ ADC_RWUEna : 127|1@0+ (1,0) [0|1] ""  CCU,CCURT1,FAPA
 SG_ ADC_BrkHoldReq : 279|2@0+ (1,0) [0|3] ""  CCU,CCURT1,FAPA
 SG_ ADC_AngReqAvl : 340|1@0+ (1,0) [0|1] ""  CCU,CCURT1,FAPA
 SG_ ADC_TarGearReqVld : 342|1@0+ (1,0) [0|1] ""  CCU,CCURT1,RT1_C1,FAPA
 SG_ ADC_FctSts : 343|1@0+ (1,0) [0|1] ""  CCU,CCURT1,RT1_C0,RT1_C1,FAPA
 SG_ ADC_BrkTarTqVld : 328|1@0+ (1,0) [0|1] ""  CCU,CCURT1,FAPA
 SG_ ADC_AebBrkTarTqVld : 305|1@0+ (1,0) [0|1] ""  CCU,CCURT1,FAPA
 SG_ ADC_AebBrkTarTqEna : 306|1@0+ (1,0) [0|1] ""  CCU,CCURT1,FAPA
 SG_ ADC_ElecBrkFnSwitch : 307|1@0+ (1,0) [0|1] ""  CCU,CCURT1,RT1_C1,FAPA
 SG_ ADC_RWUVld : 400|1@0+ (1,0) [0|1] ""  CCU,CCURT1,FAPA
 SG_ ADC_DriverPresent : 309|2@0+ (1,0) [0|3] ""  CCU,CCURT1,FAPA
 SG_ ADC_BrkTarTq : 439|16@0+ (1,0) [0|65535] "Nm"  CCU,CCURT1,FAPA
 SG_ ADC_4_FreshnessValue : 455|16@0+ (1,0) [0|255] ""  CCU,CCURT1,FAPA
 SG_ ADC_4_MAC_Check : 471|48@0+ (1,0) [0|255] ""  CCU,CCURT1,FAPA

BO_ 969 ADC_14: 64 ADC
 SG_ ADAS_RemoterParkingOnlineOrNot : 31|8@0+ (1,0) [0|255] ""  CCU,CCURT1,CCURT2,RT1_C0,RT1_C1
 SG_ ADC_RpaParkAuthn : 33|2@0+ (1,0) [0|3] ""  CCU
 SG_ ADC_RemParkPatSel : 35|2@0+ (1,0) [0|2] ""  CCU
 SG_ ADC_ParkDirCfm : 39|4@0+ (1,0) [0|8] ""  CCU
 SG_ ADC_ParkStMac : 44|5@0+ (1,0) [0|31] ""  CCU
 SG_ ADC_PwrOnOffReq : 47|3@0+ (1,0) [0|7] ""  CCU,CCURT1,CCURT2,RT1_C0,RT1_C1
 SG_ ADC_ParkOutDir_ParaLe : 48|1@0+ (1,0) [0|1] ""  CCU
 SG_ ADC_ParkOutDir_ParaRi : 49|1@0+ (1,0) [0|1] ""  CCU
 SG_ ADC_ParkOutDir_PerpFwd : 50|1@0+ (1,0) [0|1] ""  CCU
 SG_ ADC_ParkOutDir_PerpLeFwd : 51|1@0+ (1,0) [0|1] ""  CCU
 SG_ ADC_ParkOutDir_PerpRiFwd : 52|1@0+ (1,0) [0|1] ""  CCU
 SG_ ADC_ParkOutDir_PerpLeBack : 53|1@0+ (1,0) [0|1] ""  CCU
 SG_ ADC_ParkOutDir_PerpRiBack : 54|1@0+ (1,0) [0|1] ""  CCU
 SG_ ADC_ParkOutDir_PerpBack : 55|1@0+ (1,0) [0|1] ""  CCU
 SG_ ADC_APA_RPAFctUnavlMsg1 : 56|1@0+ (1,0) [0|1] ""  CCU
 SG_ ADC_APA_RPAFctUnavlMsg2 : 57|1@0+ (1,0) [0|1] ""  CCU
 SG_ ADC_APA_RPAFctUnavlMsg3 : 58|1@0+ (1,0) [0|1] ""  CCU
 SG_ ADC_APA_RPAFctUnavlMsg4 : 59|1@0+ (1,0) [0|1] ""  CCU
 SG_ ADC_APA_RPAFctUnavlMsg5 : 60|1@0+ (1,0) [0|1] ""  CCU
 SG_ ADC_APA_RPAFctUnavlMsg6 : 61|1@0+ (1,0) [0|1] ""  CCU
 SG_ ADC_APA_RPAFctUnavlMsg7 : 62|1@0+ (1,0) [0|1] ""  CCU
 SG_ ADC_APA_RPAFctUnavlMsg8 : 63|1@0+ (1,0) [0|1] ""  CCU
 SG_ ADC_APA_RPAFctUnavlMsg9 : 64|1@0+ (1,0) [0|1] ""  CCU
 SG_ ADC_APA_RPAFctUnavlMsg10 : 65|1@0+ (1,0) [0|1] ""  CCU
 SG_ ADC_APA_RPAFctUnavlMsg11 : 66|1@0+ (1,0) [0|1] ""  CCU
 SG_ ADC_APA_RPAFctUnavlMsg12 : 67|1@0+ (1,0) [0|1] ""  CCU
 SG_ ADC_APA_RPAFctUnavlMsg13 : 68|1@0+ (1,0) [0|1] ""  CCU
 SG_ ADC_APA_RPAFctUnavlMsg14 : 69|1@0+ (1,0) [0|1] ""  CCU
 SG_ ADC_APA_RPAFctUnavlMsg15 : 70|1@0+ (1,0) [0|1] ""  CCU
 SG_ ADC_APA_RPAFctUnavlMsg16 : 71|1@0+ (1,0) [0|1] ""  CCU
 SG_ ADC_APA_RPAFctUnavlMsg17 : 72|1@0+ (1,0) [0|1] ""  CCU
 SG_ ADC_APA_RPAFctUnavlMsg18 : 73|1@0+ (1,0) [0|1] ""  CCU
 SG_ ADC_APA_RPAFctUnavlMsg19 : 74|1@0+ (1,0) [0|1] ""  CCU
 SG_ ADC_APA_RPAFctUnavlMsg20 : 75|1@0+ (1,0) [0|1] ""  CCU
 SG_ ADC_APA_RPAFctUnavlMsg21 : 76|1@0+ (1,0) [0|1] ""  CCU
 SG_ ADC_APA_RPAFctUnavlMsg22 : 77|1@0+ (1,0) [0|1] ""  CCU
 SG_ ADC_APA_RPAFctUnavlMsg23 : 78|1@0+ (1,0) [0|1] ""  CCU
 SG_ ADC_APA_RPAFctUnavlMsg24 : 79|1@0+ (1,0) [0|1] ""  CCU
 SG_ ADC_APA_RPAFctUnavlMsg25 : 80|1@0+ (1,0) [0|1] ""  CCU
 SG_ ADC_APA_RPACnclMsg1 : 81|1@0+ (1,0) [0|1] ""  CCU
 SG_ ADC_APA_RPACnclMsg2 : 82|1@0+ (1,0) [0|1] ""  CCU
 SG_ ADC_APA_RPACnclMsg3 : 83|1@0+ (1,0) [0|1] ""  CCU
 SG_ ADC_APA_RPACnclMsg4 : 84|1@0+ (1,0) [0|1] ""  CCU
 SG_ ADC_APA_RPACnclMsg5 : 85|1@0+ (1,0) [0|1] ""  CCU
 SG_ ADC_APA_RPACnclMsg6 : 86|1@0+ (1,0) [0|1] ""  CCU
 SG_ ADC_APA_RPACnclMsg7 : 87|1@0+ (1,0) [0|1] ""  CCU
 SG_ ADC_APA_RPACnclMsg8 : 88|1@0+ (1,0) [0|1] ""  CCU
 SG_ ADC_APA_RPACnclMsg9 : 89|1@0+ (1,0) [0|1] ""  CCU
 SG_ ADC_APA_RPACnclMsg10 : 90|1@0+ (1,0) [0|1] ""  CCU
 SG_ ADC_APA_RPACnclMsg11 : 91|1@0+ (1,0) [0|1] ""  CCU
 SG_ ADC_APA_RPACnclMsg12 : 92|1@0+ (1,0) [0|1] ""  CCU
 SG_ ADC_APA_RPACnclMsg13 : 93|1@0+ (1,0) [0|1] ""  CCU
 SG_ ADC_APA_RPACnclMsg14 : 94|1@0+ (1,0) [0|1] ""  CCU
 SG_ ADC_APA_RPACnclMsg15 : 95|1@0+ (1,0) [0|1] ""  CCU
 SG_ ADC_APA_RPACnclMsg16 : 96|1@0+ (1,0) [0|1] ""  CCU
 SG_ ADC_APA_RPACnclMsg17 : 97|1@0+ (1,0) [0|1] ""  CCU
 SG_ ADC_APA_RPACnclMsg18 : 98|1@0+ (1,0) [0|1] ""  CCU
 SG_ ADC_APA_RPACnclMsg19 : 99|1@0+ (1,0) [0|1] ""  CCU
 SG_ ADC_APA_RPACnclMsg20 : 100|1@0+ (1,0) [0|1] ""  CCU
 SG_ ADC_APA_RPAPauseMsg1 : 101|1@0+ (1,0) [0|1] ""  CCU
 SG_ ADC_APA_RPAPauseMsg2 : 102|1@0+ (1,0) [0|1] ""  CCU
 SG_ ADC_APA_RPAPauseMsg3 : 103|1@0+ (1,0) [0|1] ""  CCU
 SG_ ADC_APA_RPAPauseMsg4 : 104|1@0+ (1,0) [0|1] ""  CCU
 SG_ ADC_APA_RPAPauseMsg5 : 105|1@0+ (1,0) [0|1] ""  CCU
 SG_ ADC_APA_RPAPauseMsg6 : 106|1@0+ (1,0) [0|1] ""  CCU
 SG_ ADC_APA_RPAPauseMsg7 : 107|1@0+ (1,0) [0|1] ""  CCU
 SG_ ADC_APA_RPAPauseMsg8 : 108|1@0+ (1,0) [0|1] ""  CCU
 SG_ ADC_APA_RPAPauseMsg9 : 109|1@0+ (1,0) [0|1] ""  CCU
 SG_ ADC_APA_RPAPauseMsg10 : 110|1@0+ (1,0) [0|1] ""  CCU
 SG_ ADC_PathPlanPos1X : 119|10@0+ (0.1,-50) [-50|50] "m"  CCU
 SG_ ADC_PathPlanPos1Y : 125|10@0+ (0.1,-50) [-50|50] "m"  CCU
 SG_ ADC_PathPlanPos2X : 131|10@0+ (0.1,-50) [-50|50] "m"  CCU
 SG_ ADC_PathPlanPos2Y : 137|10@0+ (0.1,-50) [-50|50] "m"  CCU
 SG_ ADC_PathPlanPos3X : 159|10@0+ (0.1,-50) [-50|50] "m"  CCU
 SG_ ADC_PathPlanPos3Y : 165|10@0+ (0.1,-50) [-50|50] "m"  CCU
 SG_ ADC_PathPlanPos4X : 171|10@0+ (0.1,-50) [-50|50] "m"  CCU
 SG_ ADC_PathPlanPos4Y : 177|10@0+ (0.1,-50) [-50|50] "m"  CCU
 SG_ ADC_PathPlanPos5X : 199|10@0+ (0.1,-50) [-50|50] "m"  CCU
 SG_ ADC_PathPlanPos5Y : 205|10@0+ (0.1,-50) [-50|50] "m"  CCU
 SG_ ADC_PathPlanPos6X : 211|10@0+ (0.1,-50) [-50|50] "m"  CCU
 SG_ ADC_PathPlanPos6Y : 217|10@0+ (0.1,-50) [-50|50] "m"  CCU
 SG_ ADC_PathPlanPos7X : 239|10@0+ (0.1,-50) [-50|50] "m"  CCU
 SG_ ADC_PathPlanPos7Y : 245|10@0+ (0.1,-50) [-50|50] "m"  CCU
 SG_ ADC_PathPlanPos8X : 251|10@0+ (0.1,-50) [-50|50] "m"  CCU
 SG_ ADC_PathPlanPos8Y : 257|10@0+ (0.1,-50) [-50|50] "m"  CCU
 SG_ ADC_PathPlanPos9X : 279|10@0+ (0.1,-50) [-50|50] "m"  CCU
 SG_ ADC_PathPlanPos9Y : 285|10@0+ (0.1,-50) [-50|50] "m"  CCU
 SG_ ADC_PathPlanPos10X : 291|10@0+ (0.1,-50) [-50|50] "m"  CCU
 SG_ ADC_PathPlanPos10Y : 297|10@0+ (0.1,-50) [-50|50] "m"  CCU
 SG_ ADC_PathPlanPos11X : 319|10@0+ (0.1,-50) [-50|50] "m"  CCU
 SG_ ADC_PathPlanPos11Y : 325|10@0+ (0.1,-50) [-50|50] "m"  CCU
 SG_ ADC_PathPlanPos12X : 331|10@0+ (0.1,-50) [-50|50] "m"  CCU
 SG_ ADC_PathPlanPos12Y : 337|10@0+ (0.1,-50) [-50|50] "m"  CCU
 SG_ ADC_PathPlanPos13X : 359|10@0+ (0.1,-50) [-50|50] "m"  CCU
 SG_ ADC_PathPlanPos13Y : 365|10@0+ (0.1,-50) [-50|50] "m"  CCU
 SG_ ADC_PathPlanPos14X : 371|10@0+ (0.1,-50) [-50|50] "m"  CCU
 SG_ ADC_PathPlanPos14Y : 377|10@0+ (0.1,-50) [-50|50] "m"  CCU
 SG_ ADC_PathPlanPos15X : 399|10@0+ (0.1,-50) [-50|50] "m"  CCU
 SG_ ADC_PathPlanPos15Y : 405|10@0+ (0.1,-50) [-50|50] "m"  CCU
 SG_ ADC_PathPlanPos16X : 411|10@0+ (0.1,-50) [-50|50] "m"  CCU
 SG_ ADC_PathPlanPos16Y : 417|10@0+ (0.1,-50) [-50|50] "m"  CCU
 SG_ ADC_PathPlanPos17X : 439|10@0+ (0.1,-50) [-50|50] "m"  CCU
 SG_ ADC_PathPlanPos17Y : 445|10@0+ (0.1,-50) [-50|50] "m"  CCU
 SG_ ADC_PathPlanPos18X : 451|10@0+ (0.1,-50) [-50|50] "m"  CCU
 SG_ ADC_PathPlanPos18Y : 457|10@0+ (0.1,-50) [-50|50] "m"  CCU
 SG_ ADC_PathPlanPos19X : 479|10@0+ (0.1,-50) [-50|50] "m"  CCU
 SG_ ADC_PathPlanPos19Y : 485|10@0+ (0.1,-50) [-50|50] "m"  CCU
 SG_ ADC_PathPlanPos20X : 491|10@0+ (0.1,-50) [-50|50] "m"  CCU
 SG_ ADC_PathPlanPos20Y : 497|10@0+ (0.1,-50) [-50|50] "m"  CCU

BO_ 970 ADC_15: 64 ADC
 SG_ ADC_AutEve : 27|4@0+ (1,0) [0|15] ""  CCU
 SG_ ADC_SeldParkID : 31|4@0+ (1,0) [0|10] ""  CCU
 SG_ ADC_VehParkMod : 39|3@0+ (1,0) [0|2] ""  CCU
 SG_ ADC_ParkProgs : 36|7@0+ (1,0) [0|100] "%"  CCU
 SG_ ADC_ParkRmngDst : 479|9@0+ (0.1,0) [0|50] "m"  CCU
 SG_ ADC_ObstclDst : 55|5@0+ (1,0) [0|31] ""  CCU

CM_ SG_ 419 ADC_4_CRC "E2E Profile 5 CRC";
CM_ SG_ 419 ADC_4_Counter "E2E Profile 5 Counter";
CM_ SG_ 419 ADC_AngReqSt_A "Lateral control Function Request State";
CM_ SG_ 419 ADC_AngReqFunction "Indicates which function request angle control";
CM_ SG_ 419 ADC_BrakeLightReq "Brake Light Request?";
CM_ SG_ 419 ADC_StrAngleReq_A "Steering Angle Request Value";
CM_ SG_ 419 ADC_SACMotorTorLimExtMax_A "Maximum Motor External Torque Limitation of Angle Following";
CM_ SG_ 419 ADC_SACMotorTorLimExtMin_A "Minimum Motor External Torque Limitation of Angle Following";
CM_ SG_ 419 ADC_AssistParaSwitchReq "Request EPS Switch Assist Parameter to LKAmode";
CM_ SG_ 419 ADC_AngReqRdntReq_A "Angle following control redundancy request";
CM_ SG_ 419 ADC_SteerGainReq "Driver steering  gain request signal";
CM_ SG_ 419 ADC_StrgWhlVibrWarnLevel "Steering wheel vibratio Warn Frequency";
CM_ SG_ 419 ADC_ActTrqReqEnable "Enable flag for VCU for realization of target torque ActTrqReq";
CM_ SG_ 419 ADC_VLCSt "Vehicle Longitudinal Power Control status of ADAS to VCU/EMS";
CM_ SG_ 419 ADC_SteerGainLevel "Driver steering gain request value";
CM_ SG_ 419 ADC_EvsSteerReq "Emergency Collision avoidance steering mode request";
CM_ SG_ 419 ADC_StrgWhlVibrWarnReq "Steering wheel vibration Warn request";
CM_ SG_ 419 ADC_ActTrqReq "VLC Request Effective target torque on wheel level to VCU";
CM_ SG_ 419 ADC_ADASLongCtrlFuncMode "This signal indicates ADC Longitudinal Control acceleration belongs to which function (ACC or APA)";
CM_ SG_ 419 ADC_LongCtrlAvailability "Main ADC Vehicle motion control availability (The longitudinal controller will avoid to erroneously perform the requests from a ADC not indicated as available).";
CM_ SG_ 419 ADC_LongCtrlModeForBrkSys "Main ADC Longitudinal Control Mode For BrakeSys.Off mode: ADAS Not engage.L2 Active: ADAS working in L2 Function.L2++ Active: ADAS working in L2++ or Advance Cruise ,Brake system has a redundant actuator.";
CM_ SG_ 419 IFC_DPTst "IFC DPT status";
CM_ SG_ 419 ADC_DrvTarTqMod2EPB "Drive torque mode to EPB";
CM_ SG_ 419 ADC_LongCtrlTargetAxReq "Main ADC Request from the Longitudinal Control acceleration to BrakeSys";
CM_ SG_ 419 ADC_LongCtrlTypReq "Main ADC  Longitudinal Control Brake type.Comfort Mode : The controller and brake system will consider NVH limitations, carefully reaction for good driving feeling, etc.Emergency Mode: the controller react fast and the brake system will achieve maximum performance (No limitations, eg. NVH limitations, HW protection).";
CM_ SG_ 419 ADC_LongCtrlDecToStopReq "Main ADC LongitudinalControl requires deceleration to stop";
CM_ SG_ 419 ADC_LongCtrlDriveOff "Main ADC LongitudinalControl requires driving off";
CM_ SG_ 419 ADC_LongctrlSecureReq "Main ADC L2++ system request secure the vehicle, such as use case: L2++ fail operation active, driver no take over, need to stop in emergency lane, request secure vehicle at standstill by EPB Applied.";
CM_ SG_ 419 ADC_ShifttoAVHReq "Request Brake System Change to AVH From ACC Standstill Hold State";
CM_ SG_ 419 ADC_LongCtrlTargetAx "Main ADC Longitudinal Control acceleration forBrakeSystem";
CM_ SG_ 419 ADC_TrkTargt0St "Front Track Target 0（Closest Same Lane）detection state";
CM_ SG_ 419 ADC_TrkTargt0longPos "Track Target 0（Closest Same Lane）Longitudinal Position";
CM_ SG_ 419 ADC_TrkTargt0latPos "Track Target 0（Closest Same Lane）Lateral Position";
CM_ SG_ 419 ADC_TrkTargt0LatRelSpd "Track Target 0（Closest Same Lane）Lateral Relative Speed";
CM_ SG_ 419 ADC_TrkTargt0LongRelSpd "Track Target 0（Closest Same Lane）Longitudinal Relative Speed";
CM_ SG_ 419 ADC_AS_pauseReq "Inhibit suspension adjustment requests";
CM_ SG_ 419 ADC_AS_calibrationReq "Suspension adjustment is requested during calibration";
CM_ SG_ 419 ADC_AS_exitcurrentlevelReq "Parking request air spring out of the current height Level signal";
CM_ SG_ 419 ADC_AS_ReqToadjust "For specific parking functions, the AS is requested to be adjusted to the specific suspension level";
CM_ SG_ 419 ADC_AS_UnsafelevelunableReq "Parking request no air spring into unsafe Level height signal";
CM_ SG_ 419 ADC_AEBTargetDecel "Target deceleration value from AEB(Automatic Emergency Braking)/EBA(Emergence Braking Assist)";
CM_ SG_ 419 ADC_AEBFaultSt "This signal indicates the AEB(Auto Emerrgency Braking) fault status";
CM_ SG_ 419 ADC_AEBOffSt "This signal indicates if the AEB(Auto Emerrgency Braking) is deactivated";
CM_ SG_ 419 ADC_AEBInterventionSt "This signal indicates if the AEB(Auto Emerrgency Braking) intervents";
CM_ SG_ 419 ADC_AEBDecelCtrlReq "Request of the AEB/EBA/FCTB/RCTB deceleration control";
CM_ SG_ 419 ADC_AEBLVehHoldReq "Request ESP to hold vehilce if AEB active and vehilce stopped";
CM_ SG_ 419 ADC_ABAReq "Request of the ABA support from ESP";
CM_ SG_ 419 ADC_ABALevel "ABA(Adaptive Brake Assistance) level to the ESP HBA";
CM_ SG_ 419 ADC_AWBReq "Request of the brake jerk warning to ESP";
CM_ SG_ 419 ADC_ABPReq "Request of the Prefill to ESP";
CM_ SG_ 419 ADC_AWBLevel "Different level request of the brake jerk";
CM_ SG_ 419 ADC_AEBTarCalss "AEB Target Object Class";
CM_ SG_ 419 ADC_AEBTarDetSensor "AEB Target Property Detected by Sensor with Fusion or not.";
CM_ SG_ 419 ADC_TurnLightReq "Turn Lamp and Hazard Lamp Request?";
CM_ SG_ 419 ADC_PAA2ESPAxReqEnable "Target Ax value request enable";
CM_ SG_ 419 ADC_PAA2ESPBrakeFunctionMode "Indicate APA or RPA or AVP";
CM_ SG_ 419 ADC_PAA2ESPEpbReq "PAA to ESP to do EPB request";
CM_ SG_ 419 ADC_PAA2ESPEpbReqSt "PAA to ESP to do EPB request  status";
CM_ SG_ 419 ADC_PAA2EPBEpbReq "PAA to EPB request  ";
CM_ SG_ 419 ADC_ESPSwitchReq "ADAS ESP Switch to full function Request";
CM_ SG_ 419 ADC_PAA2EPBEpbReqSt "PAA to EPB request  status";
CM_ SG_ 419 ADC_PAA2EPBBrakeFunctionMode "Brake Function Mode";
CM_ SG_ 419 ADC_PAA2ESPApEmgyBrkReq "Emergency brake request";
CM_ SG_ 419 ADC_PAA2ESPComfBrakeReq "comfort brake request";
CM_ SG_ 419 ADC_PAA2ESPApDriveOffReq "Drive off request";
CM_ SG_ 419 ADC_AEBObjectTTC "Time-to-collision between ego vehicle and collision object, and the relative acceleration should be considered";
CM_ SG_ 419 ADC_PAA2ESPApStandstillReq "Vechile standstill request";
CM_ SG_ 419 ADC_PAA2ESPApPrefillReq "Prefill request";
CM_ SG_ 419 ADC_AEBObjRelativeSpd "Relative Speed between ego vehicle and collision object. Means Ego speed > collision object speed situation";
CM_ SG_ 419 ADC_PAA2ESPAxReq "Target Ax value";
CM_ SG_ 419 ADC_EPBReq "ADAS EPB Request";
CM_ SG_ 419 ADC_PAA2ESPDistoStop "Distance to target stop point";
CM_ SG_ 419 ADC_PAA2ESPTarTorquePTDriveoff "target propulsive torque for drive off";
CM_ SG_ 419 ADC_VehTorqLimit "Torque limit to VCU";
CM_ SG_ 419 ADC_VehTorqReqValue "Torque request to VCU";
CM_ SG_ 419 ADC_VehTorqLimitEnable "Torque limit enable status to VCU";
CM_ SG_ 419 ADC_VehTorqReqEnable "Torque request enable status to VCU";
CM_ SG_ 419 ADC_PAAPwrModeReq "PAA Powertrain Request";
CM_ SG_ 419 ADC_PAAGrarLvlReq "Gear lever position request for the vehicle mo-tion control";
CM_ SG_ 419 ADC_PAAGrarLvlReqEnable "enable flag to control the gear box";
CM_ SG_ 419 ADC_ACCMode_C "This signal indicates ACC(Adaptive cruise control)status";
CM_ SG_ 419 ADC_FcsActiveStatus "indicate ADS Fuction is Active for energe save mode";
CM_ SG_ 419 ADC_ActTrqReqVD "The validity of ADC torque request to VCU";
CM_ SG_ 419 ADC_RCTBTargetDecel "target deceleration value from RCTB";
CM_ SG_ 419 ADC_RCTBBrkReq "RCTB brake request";
CM_ SG_ 419 ADC_BrkTarTqEna "The enable status  of total target brake torque";
CM_ SG_ 419 ADC_BrkTarTqMod "This signal indicates which function the total target brake torque is used for，cruise or parking function.";
CM_ SG_ 419 ADC_AebBrkTarTq "Total taget brake torque of the AEB";
CM_ SG_ 419 ADC_EpbModReqVld "The validity of the  request from the ADAS/ADS to the  EPB";
CM_ SG_ 419 ADC_RWUEna "The enable status of the  RWU";
CM_ SG_ 419 ADC_BrkHoldReq "The AVH request from the ADAS/ADS to the ESP/IPB.Not active：AVH no activeActive：AVH active";
CM_ SG_ 419 ADC_AngReqAvl "Steering angle request avaliable state";
CM_ SG_ 419 ADC_TarGearReqVld "Gear lever request validity";
CM_ SG_ 419 ADC_FctSts "ADAS active status";
CM_ SG_ 419 ADC_BrkTarTqVld "The validity of total  target brake torque";
CM_ SG_ 419 ADC_AebBrkTarTqVld "The validity of total target brake torque of the AEB";
CM_ SG_ 419 ADC_AebBrkTarTqEna "The enable status  of total  target brake torque of the AEB";
CM_ SG_ 419 ADC_ElecBrkFnSwitch "The switch for regenerative brake and hydraulic brake。Off：The ESP/IPB can not assign regenerative brake torque to the VCU/DCU。On：The ESP/IPB can assign regenerative brake torque to the VCUDCU。";
CM_ SG_ 419 ADC_RWUVld "The validity  of the RWU";
CM_ SG_ 419 ADC_DriverPresent "It indicates whether someone is in the driver's seat.";
CM_ SG_ 419 ADC_BrkTarTq "Total target brake torque for cruise and parking function ";
CM_ SG_ 419 ADC_4_FreshnessValue "Freshness value in SecOC security message";
CM_ SG_ 419 ADC_4_MAC_Check "MAC value in SecOC security message";
CM_ SG_ 969 ADAS_RemoterParkingOnlineOrNot "Indicate RemoterParkingOnline Or Not";
CM_ SG_ 969 ADC_RpaParkAuthn "RPA phone authorized_confirm state";
CM_ SG_ 969 ADC_RemParkPatSel "Parkin or Parkout";
CM_ SG_ 969 ADC_ParkDirCfm "Parkout direction";
CM_ SG_ 969 ADC_ParkStMac "APA state machine";
CM_ SG_ 969 ADC_PwrOnOffReq "Vehicle power-on and power-off control request";
CM_ SG_ 969 ADC_ParkOutDir_ParaLe "Parallel Left parkout direction";
CM_ SG_ 969 ADC_ParkOutDir_ParaRi "Parallel right parkout direction";
CM_ SG_ 969 ADC_ParkOutDir_PerpFwd "Perpendicular Forward parkout direction";
CM_ SG_ 969 ADC_ParkOutDir_PerpLeFwd "Perpendicular left Forward parkout direction";
CM_ SG_ 969 ADC_ParkOutDir_PerpRiFwd "Perpendicular right Forward parkout direction";
CM_ SG_ 969 ADC_ParkOutDir_PerpLeBack "Perpendicular left backward parkout direction";
CM_ SG_ 969 ADC_ParkOutDir_PerpRiBack "Perpendicular right backward parkout direction";
CM_ SG_ 969 ADC_ParkOutDir_PerpBack "Perpendicular backward parkout direction";
CM_ SG_ 969 ADC_APA_RPAFctUnavlMsg1 "RPA unavailable reason 1";
CM_ SG_ 969 ADC_APA_RPAFctUnavlMsg2 "RPA unavailable reason 2";
CM_ SG_ 969 ADC_APA_RPAFctUnavlMsg3 "RPA unavailable reason 3";
CM_ SG_ 969 ADC_APA_RPAFctUnavlMsg4 "RPA unavailable reason 4";
CM_ SG_ 969 ADC_APA_RPAFctUnavlMsg5 "RPA unavailable reason 5";
CM_ SG_ 969 ADC_APA_RPAFctUnavlMsg6 "RPA unavailable reason 6";
CM_ SG_ 969 ADC_APA_RPAFctUnavlMsg7 "RPA unavailable reason 7";
CM_ SG_ 969 ADC_APA_RPAFctUnavlMsg8 "RPA unavailable reason 8";
CM_ SG_ 969 ADC_APA_RPAFctUnavlMsg9 "RPA unavailable reason 9";
CM_ SG_ 969 ADC_APA_RPAFctUnavlMsg10 "RPA unavailable reason 10";
CM_ SG_ 969 ADC_APA_RPAFctUnavlMsg11 "RPA unavailable reason 11";
CM_ SG_ 969 ADC_APA_RPAFctUnavlMsg12 "RPA unavailable reason 12";
CM_ SG_ 969 ADC_APA_RPAFctUnavlMsg13 "RPA unavailable reason 13";
CM_ SG_ 969 ADC_APA_RPAFctUnavlMsg14 "RPA unavailable reason 14";
CM_ SG_ 969 ADC_APA_RPAFctUnavlMsg15 "RPA unavailable reason 15";
CM_ SG_ 969 ADC_APA_RPAFctUnavlMsg16 "RPA unavailable reason 16";
CM_ SG_ 969 ADC_APA_RPAFctUnavlMsg17 "RPA unavailable reason 17";
CM_ SG_ 969 ADC_APA_RPAFctUnavlMsg18 "RPA unavailable reason 18";
CM_ SG_ 969 ADC_APA_RPAFctUnavlMsg19 "RPA unavailable reason 19";
CM_ SG_ 969 ADC_APA_RPAFctUnavlMsg20 "RPA unavailable reason 20";
CM_ SG_ 969 ADC_APA_RPAFctUnavlMsg21 "RPA unavailable reason 21";
CM_ SG_ 969 ADC_APA_RPAFctUnavlMsg22 "RPA unavailable reason 22";
CM_ SG_ 969 ADC_APA_RPAFctUnavlMsg23 "RPA unavailable reason 23";
CM_ SG_ 969 ADC_APA_RPAFctUnavlMsg24 "RPA unavailable reason 24";
CM_ SG_ 969 ADC_APA_RPAFctUnavlMsg25 "RPA unavailable reason 25";
CM_ SG_ 969 ADC_APA_RPACnclMsg1 "RPA cancel reason 1";
CM_ SG_ 969 ADC_APA_RPACnclMsg2 "RPA cancel reason 2";
CM_ SG_ 969 ADC_APA_RPACnclMsg3 "RPA cancel reason 3";
CM_ SG_ 969 ADC_APA_RPACnclMsg4 "RPA cancel reason 4";
CM_ SG_ 969 ADC_APA_RPACnclMsg5 "RPA cancel reason 5";
CM_ SG_ 969 ADC_APA_RPACnclMsg6 "RPA cancel reason 6";
CM_ SG_ 969 ADC_APA_RPACnclMsg7 "RPA cancel reason 7";
CM_ SG_ 969 ADC_APA_RPACnclMsg8 "RPA cancel reason 8";
CM_ SG_ 969 ADC_APA_RPACnclMsg9 "RPA cancel reason 9";
CM_ SG_ 969 ADC_APA_RPACnclMsg10 "RPA cancel reason 10";
CM_ SG_ 969 ADC_APA_RPACnclMsg11 "RPA cancel reason 11";
CM_ SG_ 969 ADC_APA_RPACnclMsg12 "RPA cancel reason 12";
CM_ SG_ 969 ADC_APA_RPACnclMsg13 "RPA cancel reason 13";
CM_ SG_ 969 ADC_APA_RPACnclMsg14 "RPA cancel reason 14";
CM_ SG_ 969 ADC_APA_RPACnclMsg15 "RPA cancel reason 15";
CM_ SG_ 969 ADC_APA_RPACnclMsg16 "RPA cancel reason 16";
CM_ SG_ 969 ADC_APA_RPACnclMsg17 "RPA cancel reason 17";
CM_ SG_ 969 ADC_APA_RPACnclMsg18 "RPA cancel reason 18";
CM_ SG_ 969 ADC_APA_RPACnclMsg19 "RPA cancel reason 19";
CM_ SG_ 969 ADC_APA_RPACnclMsg20 "RPA cancel reason 20";
CM_ SG_ 969 ADC_APA_RPAPauseMsg1 "RPA pause reason 1";
CM_ SG_ 969 ADC_APA_RPAPauseMsg2 "RPA pause reason 2";
CM_ SG_ 969 ADC_APA_RPAPauseMsg3 "RPA pause reason 3";
CM_ SG_ 969 ADC_APA_RPAPauseMsg4 "RPA pause reason 4";
CM_ SG_ 969 ADC_APA_RPAPauseMsg5 "RPA pause reason 5";
CM_ SG_ 969 ADC_APA_RPAPauseMsg6 "RPA pause reason 6";
CM_ SG_ 969 ADC_APA_RPAPauseMsg7 "RPA pause reason 7";
CM_ SG_ 969 ADC_APA_RPAPauseMsg8 "RPA pause reason 8";
CM_ SG_ 969 ADC_APA_RPAPauseMsg9 "RPA pause reason 9";
CM_ SG_ 969 ADC_APA_RPAPauseMsg10 "RPA pause reason 10";
CM_ SG_ 969 ADC_PathPlanPos1X "ADC_PathPlanPos1_x";
CM_ SG_ 969 ADC_PathPlanPos1Y "ADC_PathPlanPos1_y";
CM_ SG_ 969 ADC_PathPlanPos2X "ADC_PathPlanPos2_x";
CM_ SG_ 969 ADC_PathPlanPos2Y "ADC_PathPlanPos2_y";
CM_ SG_ 969 ADC_PathPlanPos3X "ADC_PathPlanPos3_x";
CM_ SG_ 969 ADC_PathPlanPos3Y "ADC_PathPlanPos3_y";
CM_ SG_ 969 ADC_PathPlanPos4X "ADC_PathPlanPos4_x";
CM_ SG_ 969 ADC_PathPlanPos4Y "ADC_PathPlanPos4_y";
CM_ SG_ 969 ADC_PathPlanPos5X "ADC_PathPlanPos5_x";
CM_ SG_ 969 ADC_PathPlanPos5Y "ADC_PathPlanPos5_y";
CM_ SG_ 969 ADC_PathPlanPos6X "ADC_PathPlanPos6_x";
CM_ SG_ 969 ADC_PathPlanPos6Y "ADC_PathPlanPos6_y";
CM_ SG_ 969 ADC_PathPlanPos7X "ADC_PathPlanPos7_x";
CM_ SG_ 969 ADC_PathPlanPos7Y "ADC_PathPlanPos7_y";
CM_ SG_ 969 ADC_PathPlanPos8X "ADC_PathPlanPos8_x";
CM_ SG_ 969 ADC_PathPlanPos8Y "ADC_PathPlanPos8_y";
CM_ SG_ 969 ADC_PathPlanPos9X "ADC_PathPlanPos9_x";
CM_ SG_ 969 ADC_PathPlanPos9Y "ADC_PathPlanPos9_y";
CM_ SG_ 969 ADC_PathPlanPos10X "ADC_PathPlanPos10_x";
CM_ SG_ 969 ADC_PathPlanPos10Y "ADC_PathPlanPos10_y";
CM_ SG_ 969 ADC_PathPlanPos11X "ADC_PathPlanPos11_x";
CM_ SG_ 969 ADC_PathPlanPos11Y "ADC_PathPlanPos11_y";
CM_ SG_ 969 ADC_PathPlanPos12X "ADC_PathPlanPos12_x";
CM_ SG_ 969 ADC_PathPlanPos12Y "ADC_PathPlanPos12_y";
CM_ SG_ 969 ADC_PathPlanPos13X "ADC_PathPlanPos13_x";
CM_ SG_ 969 ADC_PathPlanPos13Y "ADC_PathPlanPos13_y";
CM_ SG_ 969 ADC_PathPlanPos14X "ADC_PathPlanPos14_x";
CM_ SG_ 969 ADC_PathPlanPos14Y "ADC_PathPlanPos14_y";
CM_ SG_ 969 ADC_PathPlanPos15X "ADC_PathPlanPos15_x";
CM_ SG_ 969 ADC_PathPlanPos15Y "ADC_PathPlanPos15_y";
CM_ SG_ 969 ADC_PathPlanPos16X "ADC_PathPlanPos16_x";
CM_ SG_ 969 ADC_PathPlanPos16Y "ADC_PathPlanPos16_y";
CM_ SG_ 969 ADC_PathPlanPos17X "ADC_PathPlanPos17_x";
CM_ SG_ 969 ADC_PathPlanPos17Y "ADC_PathPlanPos17_y";
CM_ SG_ 969 ADC_PathPlanPos18X "ADC_PathPlanPos18_x";
CM_ SG_ 969 ADC_PathPlanPos18Y "ADC_PathPlanPos18_y";
CM_ SG_ 969 ADC_PathPlanPos19X "ADC_PathPlanPos19_x";
CM_ SG_ 969 ADC_PathPlanPos19Y "ADC_PathPlanPos19_y";
CM_ SG_ 969 ADC_PathPlanPos20X "ADC_PathPlanPos20_x";
CM_ SG_ 969 ADC_PathPlanPos20Y "ADC_PathPlanPos20_y";
CM_ SG_ 970 ADC_AutEve "Intelligent Driving Events (RPA indicators)";
CM_ SG_ 970 ADC_SeldParkID "RPA select Park ID";
CM_ SG_ 970 ADC_VehParkMod "Parkinin mode";
CM_ SG_ 970 ADC_ParkProgs "the progress of parking";
CM_ SG_ 970 ADC_ParkRmngDst "the remain distance of parking";
CM_ SG_ 970 ADC_ObstclDst "obstacle distance";

BA_DEF_ BO_  "GenMsgCycleTime" INT 0 0;
BA_DEF_ BO_  "GenMsgCycleTimeFast" INT 0 0;
BA_DEF_ BO_  "GenMsgSendType" ENUM  "Periodic","Event","IfActive","POE","PA","FixedPeriodic","Event","EnabledPeriodic","NotUsed","NotUsed","EventPeriodic","NotUsed","NotUsed","NoMsgSendType";
BA_DEF_ BO_  "VFrameFormat" ENUM  "StandardCAN","ExtendedCAN","reserved","reserved","reserved","reserved","reserved","reserved","reserved","reserved","reserved","reserved","reserved","reserved","StandardCAN_FD","ExtendedCAN_FD";
BA_DEF_ BO_  "CANFD_BRS" ENUM  "0","1";
BA_DEF_ SG_  "EventCommandSignal" ENUM  "No","Yes";
BA_DEF_ SG_  "GatewayedSignals" ENUM  "No","Yes";
BA_DEF_ SG_  "GenSigInactiveValue" HEX 0 0;
BA_DEF_ SG_  "GenSigInvalidValue" HEX 0 0;
BA_DEF_ SG_  "GenSigSendType" ENUM  "Trigger","Passive","Cyclic","OnWrite","OnWriteWithRepetition","OnChange","OnChangeWithRepetition","IfActive","IfActiveWithRepetition","NoSigSendType";
BA_DEF_ SG_  "GenSigStartValue" HEX 0 0;
BA_DEF_ SG_  "GenSigTimeoutValue" HEX 0 0;
BA_DEF_ SG_  "Remark" STRING ;
BA_ "GenMsgCycleTime" BO_ 419 10;
BA_ "GenMsgCycleTimeFast" BO_ 419 0;
BA_ "GenMsgSendType" BO_ 419 0;
BA_ "VFrameFormat" BO_ 419 14;
BA_ "CANFD_BRS" BO_ 419 1;
BA_ "GenMsgCycleTime" BO_ 419 10;
BA_ "GenMsgCycleTimeFast" BO_ 419 0;
BA_ "GenMsgSendType" BO_ 419 0;
BA_ "VFrameFormat" BO_ 419 14;
BA_ "CANFD_BRS" BO_ 419 1;
BA_ "GenMsgCycleTime" BO_ 419 10;
BA_ "GenMsgCycleTimeFast" BO_ 419 0;
BA_ "GenMsgSendType" BO_ 419 0;
BA_ "VFrameFormat" BO_ 419 14;
BA_ "CANFD_BRS" BO_ 419 1;
BA_ "GenMsgCycleTime" BO_ 419 10;
BA_ "GenMsgCycleTimeFast" BO_ 419 0;
BA_ "GenMsgSendType" BO_ 419 0;
BA_ "VFrameFormat" BO_ 419 14;
BA_ "CANFD_BRS" BO_ 419 1;
BA_ "GenMsgCycleTime" BO_ 419 10;
BA_ "GenMsgCycleTimeFast" BO_ 419 0;
BA_ "GenMsgSendType" BO_ 419 0;
BA_ "VFrameFormat" BO_ 419 14;
BA_ "CANFD_BRS" BO_ 419 1;
BA_ "GenMsgCycleTime" BO_ 419 10;
BA_ "GenMsgCycleTimeFast" BO_ 419 0;
BA_ "GenMsgSendType" BO_ 419 0;
BA_ "VFrameFormat" BO_ 419 14;
BA_ "CANFD_BRS" BO_ 419 1;
BA_ "GenMsgCycleTime" BO_ 419 10;
BA_ "GenMsgCycleTimeFast" BO_ 419 0;
BA_ "GenMsgSendType" BO_ 419 0;
BA_ "VFrameFormat" BO_ 419 14;
BA_ "CANFD_BRS" BO_ 419 1;
BA_ "GenMsgCycleTime" BO_ 419 10;
BA_ "GenMsgCycleTimeFast" BO_ 419 0;
BA_ "GenMsgSendType" BO_ 419 0;
BA_ "VFrameFormat" BO_ 419 14;
BA_ "CANFD_BRS" BO_ 419 1;
BA_ "GenMsgCycleTime" BO_ 419 10;
BA_ "GenMsgCycleTimeFast" BO_ 419 0;
BA_ "GenMsgSendType" BO_ 419 0;
BA_ "VFrameFormat" BO_ 419 14;
BA_ "CANFD_BRS" BO_ 419 1;
BA_ "GenMsgCycleTime" BO_ 419 10;
BA_ "GenMsgCycleTimeFast" BO_ 419 0;
BA_ "GenMsgSendType" BO_ 419 0;
BA_ "VFrameFormat" BO_ 419 14;
BA_ "CANFD_BRS" BO_ 419 1;
BA_ "GenMsgCycleTime" BO_ 419 10;
BA_ "GenMsgCycleTimeFast" BO_ 419 0;
BA_ "GenMsgSendType" BO_ 419 0;
BA_ "VFrameFormat" BO_ 419 14;
BA_ "CANFD_BRS" BO_ 419 1;
BA_ "GenMsgCycleTime" BO_ 419 10;
BA_ "GenMsgCycleTimeFast" BO_ 419 0;
BA_ "GenMsgSendType" BO_ 419 0;
BA_ "VFrameFormat" BO_ 419 14;
BA_ "CANFD_BRS" BO_ 419 1;
BA_ "GenMsgCycleTime" BO_ 419 10;
BA_ "GenMsgCycleTimeFast" BO_ 419 0;
BA_ "GenMsgSendType" BO_ 419 0;
BA_ "VFrameFormat" BO_ 419 14;
BA_ "CANFD_BRS" BO_ 419 1;
BA_ "GenMsgCycleTime" BO_ 419 10;
BA_ "GenMsgCycleTimeFast" BO_ 419 0;
BA_ "GenMsgSendType" BO_ 419 0;
BA_ "VFrameFormat" BO_ 419 14;
BA_ "CANFD_BRS" BO_ 419 1;
BA_ "GenMsgCycleTime" BO_ 419 10;
BA_ "GenMsgCycleTimeFast" BO_ 419 0;
BA_ "GenMsgSendType" BO_ 419 0;
BA_ "VFrameFormat" BO_ 419 14;
BA_ "CANFD_BRS" BO_ 419 1;
BA_ "GenMsgCycleTime" BO_ 419 10;
BA_ "GenMsgCycleTimeFast" BO_ 419 0;
BA_ "GenMsgSendType" BO_ 419 0;
BA_ "VFrameFormat" BO_ 419 14;
BA_ "CANFD_BRS" BO_ 419 1;
BA_ "GenMsgCycleTime" BO_ 419 10;
BA_ "GenMsgCycleTimeFast" BO_ 419 0;
BA_ "GenMsgSendType" BO_ 419 0;
BA_ "VFrameFormat" BO_ 419 14;
BA_ "CANFD_BRS" BO_ 419 1;
BA_ "GenMsgCycleTime" BO_ 419 10;
BA_ "GenMsgCycleTimeFast" BO_ 419 0;
BA_ "GenMsgSendType" BO_ 419 0;
BA_ "VFrameFormat" BO_ 419 14;
BA_ "CANFD_BRS" BO_ 419 1;
BA_ "GenMsgCycleTime" BO_ 419 10;
BA_ "GenMsgCycleTimeFast" BO_ 419 0;
BA_ "GenMsgSendType" BO_ 419 0;
BA_ "VFrameFormat" BO_ 419 14;
BA_ "CANFD_BRS" BO_ 419 1;
BA_ "GenMsgCycleTime" BO_ 419 10;
BA_ "GenMsgCycleTimeFast" BO_ 419 0;
BA_ "GenMsgSendType" BO_ 419 0;
BA_ "VFrameFormat" BO_ 419 14;
BA_ "CANFD_BRS" BO_ 419 1;
BA_ "GenMsgCycleTime" BO_ 419 10;
BA_ "GenMsgCycleTimeFast" BO_ 419 0;
BA_ "GenMsgSendType" BO_ 419 0;
BA_ "VFrameFormat" BO_ 419 14;
BA_ "CANFD_BRS" BO_ 419 1;
BA_ "GenMsgCycleTime" BO_ 419 10;
BA_ "GenMsgCycleTimeFast" BO_ 419 0;
BA_ "GenMsgSendType" BO_ 419 0;
BA_ "VFrameFormat" BO_ 419 14;
BA_ "CANFD_BRS" BO_ 419 1;
BA_ "GenMsgCycleTime" BO_ 419 10;
BA_ "GenMsgCycleTimeFast" BO_ 419 0;
BA_ "GenMsgSendType" BO_ 419 0;
BA_ "VFrameFormat" BO_ 419 14;
BA_ "CANFD_BRS" BO_ 419 1;
BA_ "GenMsgCycleTime" BO_ 419 10;
BA_ "GenMsgCycleTimeFast" BO_ 419 0;
BA_ "GenMsgSendType" BO_ 419 0;
BA_ "VFrameFormat" BO_ 419 14;
BA_ "CANFD_BRS" BO_ 419 1;
BA_ "GenMsgCycleTime" BO_ 419 10;
BA_ "GenMsgCycleTimeFast" BO_ 419 0;
BA_ "GenMsgSendType" BO_ 419 0;
BA_ "VFrameFormat" BO_ 419 14;
BA_ "CANFD_BRS" BO_ 419 1;
BA_ "GenMsgCycleTime" BO_ 419 10;
BA_ "GenMsgCycleTimeFast" BO_ 419 0;
BA_ "GenMsgSendType" BO_ 419 0;
BA_ "VFrameFormat" BO_ 419 14;
BA_ "CANFD_BRS" BO_ 419 1;
BA_ "GenMsgCycleTime" BO_ 419 10;
BA_ "GenMsgCycleTimeFast" BO_ 419 0;
BA_ "GenMsgSendType" BO_ 419 0;
BA_ "VFrameFormat" BO_ 419 14;
BA_ "CANFD_BRS" BO_ 419 1;
BA_ "GenMsgCycleTime" BO_ 419 10;
BA_ "GenMsgCycleTimeFast" BO_ 419 0;
BA_ "GenMsgSendType" BO_ 419 0;
BA_ "VFrameFormat" BO_ 419 14;
BA_ "CANFD_BRS" BO_ 419 1;
BA_ "GenMsgCycleTime" BO_ 419 10;
BA_ "GenMsgCycleTimeFast" BO_ 419 0;
BA_ "GenMsgSendType" BO_ 419 0;
BA_ "VFrameFormat" BO_ 419 14;
BA_ "CANFD_BRS" BO_ 419 1;
BA_ "GenMsgCycleTime" BO_ 419 10;
BA_ "GenMsgCycleTimeFast" BO_ 419 0;
BA_ "GenMsgSendType" BO_ 419 0;
BA_ "VFrameFormat" BO_ 419 14;
BA_ "CANFD_BRS" BO_ 419 1;
BA_ "GenMsgCycleTime" BO_ 419 10;
BA_ "GenMsgCycleTimeFast" BO_ 419 0;
BA_ "GenMsgSendType" BO_ 419 0;
BA_ "VFrameFormat" BO_ 419 14;
BA_ "CANFD_BRS" BO_ 419 1;
BA_ "GenMsgCycleTime" BO_ 419 10;
BA_ "GenMsgCycleTimeFast" BO_ 419 0;
BA_ "GenMsgSendType" BO_ 419 0;
BA_ "VFrameFormat" BO_ 419 14;
BA_ "CANFD_BRS" BO_ 419 1;
BA_ "GenMsgCycleTime" BO_ 419 10;
BA_ "GenMsgCycleTimeFast" BO_ 419 0;
BA_ "GenMsgSendType" BO_ 419 0;
BA_ "VFrameFormat" BO_ 419 14;
BA_ "CANFD_BRS" BO_ 419 1;
BA_ "GenMsgCycleTime" BO_ 419 10;
BA_ "GenMsgCycleTimeFast" BO_ 419 0;
BA_ "GenMsgSendType" BO_ 419 0;
BA_ "VFrameFormat" BO_ 419 14;
BA_ "CANFD_BRS" BO_ 419 1;
BA_ "GenMsgCycleTime" BO_ 419 10;
BA_ "GenMsgCycleTimeFast" BO_ 419 0;
BA_ "GenMsgSendType" BO_ 419 0;
BA_ "VFrameFormat" BO_ 419 14;
BA_ "CANFD_BRS" BO_ 419 1;
BA_ "GenMsgCycleTime" BO_ 419 10;
BA_ "GenMsgCycleTimeFast" BO_ 419 0;
BA_ "GenMsgSendType" BO_ 419 0;
BA_ "VFrameFormat" BO_ 419 14;
BA_ "CANFD_BRS" BO_ 419 1;
BA_ "GenMsgCycleTime" BO_ 419 10;
BA_ "GenMsgCycleTimeFast" BO_ 419 0;
BA_ "GenMsgSendType" BO_ 419 0;
BA_ "VFrameFormat" BO_ 419 14;
BA_ "CANFD_BRS" BO_ 419 1;
BA_ "GenMsgCycleTime" BO_ 419 10;
BA_ "GenMsgCycleTimeFast" BO_ 419 0;
BA_ "GenMsgSendType" BO_ 419 0;
BA_ "VFrameFormat" BO_ 419 14;
BA_ "CANFD_BRS" BO_ 419 1;
BA_ "GenMsgCycleTime" BO_ 419 10;
BA_ "GenMsgCycleTimeFast" BO_ 419 0;
BA_ "GenMsgSendType" BO_ 419 0;
BA_ "VFrameFormat" BO_ 419 14;
BA_ "CANFD_BRS" BO_ 419 1;
BA_ "GenMsgCycleTime" BO_ 419 10;
BA_ "GenMsgCycleTimeFast" BO_ 419 0;
BA_ "GenMsgSendType" BO_ 419 0;
BA_ "VFrameFormat" BO_ 419 14;
BA_ "CANFD_BRS" BO_ 419 1;
BA_ "GenMsgCycleTime" BO_ 419 10;
BA_ "GenMsgCycleTimeFast" BO_ 419 0;
BA_ "GenMsgSendType" BO_ 419 0;
BA_ "VFrameFormat" BO_ 419 14;
BA_ "CANFD_BRS" BO_ 419 1;
BA_ "GenMsgCycleTime" BO_ 419 10;
BA_ "GenMsgCycleTimeFast" BO_ 419 0;
BA_ "GenMsgSendType" BO_ 419 0;
BA_ "VFrameFormat" BO_ 419 14;
BA_ "CANFD_BRS" BO_ 419 1;
BA_ "GenMsgCycleTime" BO_ 419 10;
BA_ "GenMsgCycleTimeFast" BO_ 419 0;
BA_ "GenMsgSendType" BO_ 419 0;
BA_ "VFrameFormat" BO_ 419 14;
BA_ "CANFD_BRS" BO_ 419 1;
BA_ "GenMsgCycleTime" BO_ 419 10;
BA_ "GenMsgCycleTimeFast" BO_ 419 0;
BA_ "GenMsgSendType" BO_ 419 0;
BA_ "VFrameFormat" BO_ 419 14;
BA_ "CANFD_BRS" BO_ 419 1;
BA_ "GenMsgCycleTime" BO_ 419 10;
BA_ "GenMsgCycleTimeFast" BO_ 419 0;
BA_ "GenMsgSendType" BO_ 419 0;
BA_ "VFrameFormat" BO_ 419 14;
BA_ "CANFD_BRS" BO_ 419 1;
BA_ "GenMsgCycleTime" BO_ 419 10;
BA_ "GenMsgCycleTimeFast" BO_ 419 0;
BA_ "GenMsgSendType" BO_ 419 0;
BA_ "VFrameFormat" BO_ 419 14;
BA_ "CANFD_BRS" BO_ 419 1;
BA_ "GenMsgCycleTime" BO_ 419 10;
BA_ "GenMsgCycleTimeFast" BO_ 419 0;
BA_ "GenMsgSendType" BO_ 419 0;
BA_ "VFrameFormat" BO_ 419 14;
BA_ "CANFD_BRS" BO_ 419 1;
BA_ "GenMsgCycleTime" BO_ 419 10;
BA_ "GenMsgCycleTimeFast" BO_ 419 0;
BA_ "GenMsgSendType" BO_ 419 0;
BA_ "VFrameFormat" BO_ 419 14;
BA_ "CANFD_BRS" BO_ 419 1;
BA_ "GenMsgCycleTime" BO_ 419 10;
BA_ "GenMsgCycleTimeFast" BO_ 419 0;
BA_ "GenMsgSendType" BO_ 419 0;
BA_ "VFrameFormat" BO_ 419 14;
BA_ "CANFD_BRS" BO_ 419 1;
BA_ "GenMsgCycleTime" BO_ 419 10;
BA_ "GenMsgCycleTimeFast" BO_ 419 0;
BA_ "GenMsgSendType" BO_ 419 0;
BA_ "VFrameFormat" BO_ 419 14;
BA_ "CANFD_BRS" BO_ 419 1;
BA_ "GenMsgCycleTime" BO_ 419 10;
BA_ "GenMsgCycleTimeFast" BO_ 419 0;
BA_ "GenMsgSendType" BO_ 419 0;
BA_ "VFrameFormat" BO_ 419 14;
BA_ "CANFD_BRS" BO_ 419 1;
BA_ "GenMsgCycleTime" BO_ 419 10;
BA_ "GenMsgCycleTimeFast" BO_ 419 0;
BA_ "GenMsgSendType" BO_ 419 0;
BA_ "VFrameFormat" BO_ 419 14;
BA_ "CANFD_BRS" BO_ 419 1;
BA_ "GenMsgCycleTime" BO_ 419 10;
BA_ "GenMsgCycleTimeFast" BO_ 419 0;
BA_ "GenMsgSendType" BO_ 419 0;
BA_ "VFrameFormat" BO_ 419 14;
BA_ "CANFD_BRS" BO_ 419 1;
BA_ "GenMsgCycleTime" BO_ 419 10;
BA_ "GenMsgCycleTimeFast" BO_ 419 0;
BA_ "GenMsgSendType" BO_ 419 0;
BA_ "VFrameFormat" BO_ 419 14;
BA_ "CANFD_BRS" BO_ 419 1;
BA_ "GenMsgCycleTime" BO_ 419 10;
BA_ "GenMsgCycleTimeFast" BO_ 419 0;
BA_ "GenMsgSendType" BO_ 419 0;
BA_ "VFrameFormat" BO_ 419 14;
BA_ "CANFD_BRS" BO_ 419 1;
BA_ "GenMsgCycleTime" BO_ 419 10;
BA_ "GenMsgCycleTimeFast" BO_ 419 0;
BA_ "GenMsgSendType" BO_ 419 0;
BA_ "VFrameFormat" BO_ 419 14;
BA_ "CANFD_BRS" BO_ 419 1;
BA_ "GenMsgCycleTime" BO_ 419 10;
BA_ "GenMsgCycleTimeFast" BO_ 419 0;
BA_ "GenMsgSendType" BO_ 419 0;
BA_ "VFrameFormat" BO_ 419 14;
BA_ "CANFD_BRS" BO_ 419 1;
BA_ "GenMsgCycleTime" BO_ 419 10;
BA_ "GenMsgCycleTimeFast" BO_ 419 0;
BA_ "GenMsgSendType" BO_ 419 0;
BA_ "VFrameFormat" BO_ 419 14;
BA_ "CANFD_BRS" BO_ 419 1;
BA_ "GenMsgCycleTime" BO_ 419 10;
BA_ "GenMsgCycleTimeFast" BO_ 419 0;
BA_ "GenMsgSendType" BO_ 419 0;
BA_ "VFrameFormat" BO_ 419 14;
BA_ "CANFD_BRS" BO_ 419 1;
BA_ "GenMsgCycleTime" BO_ 419 10;
BA_ "GenMsgCycleTimeFast" BO_ 419 0;
BA_ "GenMsgSendType" BO_ 419 0;
BA_ "VFrameFormat" BO_ 419 14;
BA_ "CANFD_BRS" BO_ 419 1;
BA_ "GenMsgCycleTime" BO_ 419 10;
BA_ "GenMsgCycleTimeFast" BO_ 419 0;
BA_ "GenMsgSendType" BO_ 419 0;
BA_ "VFrameFormat" BO_ 419 14;
BA_ "CANFD_BRS" BO_ 419 1;
BA_ "GenMsgCycleTime" BO_ 419 10;
BA_ "GenMsgCycleTimeFast" BO_ 419 0;
BA_ "GenMsgSendType" BO_ 419 0;
BA_ "VFrameFormat" BO_ 419 14;
BA_ "CANFD_BRS" BO_ 419 1;
BA_ "GenMsgCycleTime" BO_ 419 10;
BA_ "GenMsgCycleTimeFast" BO_ 419 0;
BA_ "GenMsgSendType" BO_ 419 0;
BA_ "VFrameFormat" BO_ 419 14;
BA_ "CANFD_BRS" BO_ 419 1;
BA_ "GenMsgCycleTime" BO_ 419 10;
BA_ "GenMsgCycleTimeFast" BO_ 419 0;
BA_ "GenMsgSendType" BO_ 419 0;
BA_ "VFrameFormat" BO_ 419 14;
BA_ "CANFD_BRS" BO_ 419 1;
BA_ "GenMsgCycleTime" BO_ 419 10;
BA_ "GenMsgCycleTimeFast" BO_ 419 0;
BA_ "GenMsgSendType" BO_ 419 0;
BA_ "VFrameFormat" BO_ 419 14;
BA_ "CANFD_BRS" BO_ 419 1;
BA_ "GenMsgCycleTime" BO_ 419 10;
BA_ "GenMsgCycleTimeFast" BO_ 419 0;
BA_ "GenMsgSendType" BO_ 419 0;
BA_ "VFrameFormat" BO_ 419 14;
BA_ "CANFD_BRS" BO_ 419 1;
BA_ "GenMsgCycleTime" BO_ 419 10;
BA_ "GenMsgCycleTimeFast" BO_ 419 0;
BA_ "GenMsgSendType" BO_ 419 0;
BA_ "VFrameFormat" BO_ 419 14;
BA_ "CANFD_BRS" BO_ 419 1;
BA_ "GenMsgCycleTime" BO_ 419 10;
BA_ "GenMsgCycleTimeFast" BO_ 419 0;
BA_ "GenMsgSendType" BO_ 419 0;
BA_ "VFrameFormat" BO_ 419 14;
BA_ "CANFD_BRS" BO_ 419 1;
BA_ "GenMsgCycleTime" BO_ 419 10;
BA_ "GenMsgCycleTimeFast" BO_ 419 0;
BA_ "GenMsgSendType" BO_ 419 0;
BA_ "VFrameFormat" BO_ 419 14;
BA_ "CANFD_BRS" BO_ 419 1;
BA_ "GenMsgCycleTime" BO_ 419 10;
BA_ "GenMsgCycleTimeFast" BO_ 419 0;
BA_ "GenMsgSendType" BO_ 419 0;
BA_ "VFrameFormat" BO_ 419 14;
BA_ "CANFD_BRS" BO_ 419 1;
BA_ "GenMsgCycleTime" BO_ 419 10;
BA_ "GenMsgCycleTimeFast" BO_ 419 0;
BA_ "GenMsgSendType" BO_ 419 0;
BA_ "VFrameFormat" BO_ 419 14;
BA_ "CANFD_BRS" BO_ 419 1;
BA_ "GenMsgCycleTime" BO_ 419 10;
BA_ "GenMsgCycleTimeFast" BO_ 419 0;
BA_ "GenMsgSendType" BO_ 419 0;
BA_ "VFrameFormat" BO_ 419 14;
BA_ "CANFD_BRS" BO_ 419 1;
BA_ "GenMsgCycleTime" BO_ 419 10;
BA_ "GenMsgCycleTimeFast" BO_ 419 0;
BA_ "GenMsgSendType" BO_ 419 0;
BA_ "VFrameFormat" BO_ 419 14;
BA_ "CANFD_BRS" BO_ 419 1;
BA_ "GenMsgCycleTime" BO_ 419 10;
BA_ "GenMsgCycleTimeFast" BO_ 419 0;
BA_ "GenMsgSendType" BO_ 419 0;
BA_ "VFrameFormat" BO_ 419 14;
BA_ "CANFD_BRS" BO_ 419 1;
BA_ "GenMsgCycleTime" BO_ 419 10;
BA_ "GenMsgCycleTimeFast" BO_ 419 0;
BA_ "GenMsgSendType" BO_ 419 0;
BA_ "VFrameFormat" BO_ 419 14;
BA_ "CANFD_BRS" BO_ 419 1;
BA_ "GenMsgCycleTime" BO_ 419 10;
BA_ "GenMsgCycleTimeFast" BO_ 419 0;
BA_ "GenMsgSendType" BO_ 419 0;
BA_ "VFrameFormat" BO_ 419 14;
BA_ "CANFD_BRS" BO_ 419 1;
BA_ "GenMsgCycleTime" BO_ 419 10;
BA_ "GenMsgCycleTimeFast" BO_ 419 0;
BA_ "GenMsgSendType" BO_ 419 0;
BA_ "VFrameFormat" BO_ 419 14;
BA_ "CANFD_BRS" BO_ 419 1;
BA_ "GenMsgCycleTime" BO_ 419 10;
BA_ "GenMsgCycleTimeFast" BO_ 419 0;
BA_ "GenMsgSendType" BO_ 419 0;
BA_ "VFrameFormat" BO_ 419 14;
BA_ "CANFD_BRS" BO_ 419 1;
BA_ "GenMsgCycleTime" BO_ 419 10;
BA_ "GenMsgCycleTimeFast" BO_ 419 0;
BA_ "GenMsgSendType" BO_ 419 0;
BA_ "VFrameFormat" BO_ 419 14;
BA_ "CANFD_BRS" BO_ 419 1;
BA_ "GenMsgCycleTime" BO_ 419 10;
BA_ "GenMsgCycleTimeFast" BO_ 419 0;
BA_ "GenMsgSendType" BO_ 419 0;
BA_ "VFrameFormat" BO_ 419 14;
BA_ "CANFD_BRS" BO_ 419 1;
BA_ "GenMsgCycleTime" BO_ 419 10;
BA_ "GenMsgCycleTimeFast" BO_ 419 0;
BA_ "GenMsgSendType" BO_ 419 0;
BA_ "VFrameFormat" BO_ 419 14;
BA_ "CANFD_BRS" BO_ 419 1;
BA_ "GenMsgCycleTime" BO_ 419 10;
BA_ "GenMsgCycleTimeFast" BO_ 419 0;
BA_ "GenMsgSendType" BO_ 419 0;
BA_ "VFrameFormat" BO_ 419 14;
BA_ "CANFD_BRS" BO_ 419 1;
BA_ "GenMsgCycleTime" BO_ 419 10;
BA_ "GenMsgCycleTimeFast" BO_ 419 0;
BA_ "GenMsgSendType" BO_ 419 0;
BA_ "VFrameFormat" BO_ 419 14;
BA_ "CANFD_BRS" BO_ 419 1;
BA_ "GenMsgCycleTime" BO_ 419 10;
BA_ "GenMsgCycleTimeFast" BO_ 419 0;
BA_ "GenMsgSendType" BO_ 419 0;
BA_ "VFrameFormat" BO_ 419 14;
BA_ "CANFD_BRS" BO_ 419 1;
BA_ "GenMsgCycleTime" BO_ 419 10;
BA_ "GenMsgCycleTimeFast" BO_ 419 0;
BA_ "GenMsgSendType" BO_ 419 0;
BA_ "VFrameFormat" BO_ 419 14;
BA_ "CANFD_BRS" BO_ 419 1;
BA_ "GenMsgCycleTime" BO_ 419 10;
BA_ "GenMsgCycleTimeFast" BO_ 419 0;
BA_ "GenMsgSendType" BO_ 419 0;
BA_ "VFrameFormat" BO_ 419 14;
BA_ "CANFD_BRS" BO_ 419 1;
BA_ "GenMsgCycleTime" BO_ 419 10;
BA_ "GenMsgCycleTimeFast" BO_ 419 0;
BA_ "GenMsgSendType" BO_ 419 0;
BA_ "VFrameFormat" BO_ 419 14;
BA_ "CANFD_BRS" BO_ 419 1;
BA_ "GenMsgCycleTime" BO_ 419 10;
BA_ "GenMsgCycleTimeFast" BO_ 419 0;
BA_ "GenMsgSendType" BO_ 419 0;
BA_ "VFrameFormat" BO_ 419 14;
BA_ "CANFD_BRS" BO_ 419 1;
BA_ "GenMsgCycleTime" BO_ 419 10;
BA_ "GenMsgCycleTimeFast" BO_ 419 0;
BA_ "GenMsgSendType" BO_ 419 0;
BA_ "VFrameFormat" BO_ 419 14;
BA_ "CANFD_BRS" BO_ 419 1;
BA_ "GenMsgCycleTime" BO_ 419 10;
BA_ "GenMsgCycleTimeFast" BO_ 419 0;
BA_ "GenMsgSendType" BO_ 419 0;
BA_ "VFrameFormat" BO_ 419 14;
BA_ "CANFD_BRS" BO_ 419 1;
BA_ "GenMsgCycleTime" BO_ 419 10;
BA_ "GenMsgCycleTimeFast" BO_ 419 0;
BA_ "GenMsgSendType" BO_ 419 0;
BA_ "VFrameFormat" BO_ 419 14;
BA_ "CANFD_BRS" BO_ 419 1;
BA_ "GenMsgCycleTime" BO_ 419 10;
BA_ "GenMsgCycleTimeFast" BO_ 419 0;
BA_ "GenMsgSendType" BO_ 419 0;
BA_ "VFrameFormat" BO_ 419 14;
BA_ "CANFD_BRS" BO_ 419 1;
BA_ "GenMsgCycleTime" BO_ 419 10;
BA_ "GenMsgCycleTimeFast" BO_ 419 0;
BA_ "GenMsgSendType" BO_ 419 0;
BA_ "VFrameFormat" BO_ 419 14;
BA_ "CANFD_BRS" BO_ 419 1;
BA_ "GenMsgCycleTime" BO_ 419 10;
BA_ "GenMsgCycleTimeFast" BO_ 419 0;
BA_ "GenMsgSendType" BO_ 419 0;
BA_ "VFrameFormat" BO_ 419 14;
BA_ "CANFD_BRS" BO_ 419 1;
BA_ "GenMsgCycleTime" BO_ 419 10;
BA_ "GenMsgCycleTimeFast" BO_ 419 0;
BA_ "GenMsgSendType" BO_ 419 0;
BA_ "VFrameFormat" BO_ 419 14;
BA_ "CANFD_BRS" BO_ 419 1;
BA_ "GenMsgCycleTime" BO_ 419 10;
BA_ "GenMsgCycleTimeFast" BO_ 419 0;
BA_ "GenMsgSendType" BO_ 419 0;
BA_ "VFrameFormat" BO_ 419 14;
BA_ "CANFD_BRS" BO_ 419 1;
BA_ "GenMsgCycleTime" BO_ 419 10;
BA_ "GenMsgCycleTimeFast" BO_ 419 0;
BA_ "GenMsgSendType" BO_ 419 0;
BA_ "VFrameFormat" BO_ 419 14;
BA_ "CANFD_BRS" BO_ 419 1;
BA_ "GenMsgCycleTime" BO_ 419 10;
BA_ "GenMsgCycleTimeFast" BO_ 419 0;
BA_ "GenMsgSendType" BO_ 419 0;
BA_ "VFrameFormat" BO_ 419 14;
BA_ "CANFD_BRS" BO_ 419 1;
BA_ "GenMsgCycleTime" BO_ 419 10;
BA_ "GenMsgCycleTimeFast" BO_ 419 0;
BA_ "GenMsgSendType" BO_ 419 0;
BA_ "VFrameFormat" BO_ 419 14;
BA_ "CANFD_BRS" BO_ 419 1;
BA_ "GenMsgCycleTime" BO_ 419 10;
BA_ "GenMsgCycleTimeFast" BO_ 419 0;
BA_ "GenMsgSendType" BO_ 419 0;
BA_ "VFrameFormat" BO_ 419 14;
BA_ "CANFD_BRS" BO_ 419 1;
BA_ "GenMsgCycleTime" BO_ 419 10;
BA_ "GenMsgCycleTimeFast" BO_ 419 0;
BA_ "GenMsgSendType" BO_ 419 0;
BA_ "VFrameFormat" BO_ 419 14;
BA_ "CANFD_BRS" BO_ 419 1;
BA_ "GenMsgCycleTime" BO_ 419 10;
BA_ "GenMsgCycleTimeFast" BO_ 419 0;
BA_ "GenMsgSendType" BO_ 419 0;
BA_ "VFrameFormat" BO_ 419 14;
BA_ "CANFD_BRS" BO_ 419 1;
BA_ "GenMsgCycleTime" BO_ 419 10;
BA_ "GenMsgCycleTimeFast" BO_ 419 0;
BA_ "GenMsgSendType" BO_ 419 0;
BA_ "VFrameFormat" BO_ 419 14;
BA_ "CANFD_BRS" BO_ 419 1;
BA_ "GenMsgCycleTime" BO_ 969 100;
BA_ "GenMsgCycleTimeFast" BO_ 969 0;
BA_ "GenMsgSendType" BO_ 969 0;
BA_ "VFrameFormat" BO_ 969 14;
BA_ "CANFD_BRS" BO_ 969 1;
BA_ "GenMsgCycleTime" BO_ 969 100;
BA_ "GenMsgCycleTimeFast" BO_ 969 0;
BA_ "GenMsgSendType" BO_ 969 0;
BA_ "VFrameFormat" BO_ 969 14;
BA_ "CANFD_BRS" BO_ 969 1;
BA_ "GenMsgCycleTime" BO_ 969 100;
BA_ "GenMsgCycleTimeFast" BO_ 969 0;
BA_ "GenMsgSendType" BO_ 969 0;
BA_ "VFrameFormat" BO_ 969 14;
BA_ "CANFD_BRS" BO_ 969 1;
BA_ "GenMsgCycleTime" BO_ 969 100;
BA_ "GenMsgCycleTimeFast" BO_ 969 0;
BA_ "GenMsgSendType" BO_ 969 0;
BA_ "VFrameFormat" BO_ 969 14;
BA_ "CANFD_BRS" BO_ 969 1;
BA_ "GenMsgCycleTime" BO_ 969 100;
BA_ "GenMsgCycleTimeFast" BO_ 969 0;
BA_ "GenMsgSendType" BO_ 969 0;
BA_ "VFrameFormat" BO_ 969 14;
BA_ "CANFD_BRS" BO_ 969 1;
BA_ "GenMsgCycleTime" BO_ 969 100;
BA_ "GenMsgCycleTimeFast" BO_ 969 0;
BA_ "GenMsgSendType" BO_ 969 0;
BA_ "VFrameFormat" BO_ 969 14;
BA_ "CANFD_BRS" BO_ 969 1;
BA_ "GenMsgCycleTime" BO_ 969 100;
BA_ "GenMsgCycleTimeFast" BO_ 969 0;
BA_ "GenMsgSendType" BO_ 969 0;
BA_ "VFrameFormat" BO_ 969 14;
BA_ "CANFD_BRS" BO_ 969 1;
BA_ "GenMsgCycleTime" BO_ 969 100;
BA_ "GenMsgCycleTimeFast" BO_ 969 0;
BA_ "GenMsgSendType" BO_ 969 0;
BA_ "VFrameFormat" BO_ 969 14;
BA_ "CANFD_BRS" BO_ 969 1;
BA_ "GenMsgCycleTime" BO_ 969 100;
BA_ "GenMsgCycleTimeFast" BO_ 969 0;
BA_ "GenMsgSendType" BO_ 969 0;
BA_ "VFrameFormat" BO_ 969 14;
BA_ "CANFD_BRS" BO_ 969 1;
BA_ "GenMsgCycleTime" BO_ 969 100;
BA_ "GenMsgCycleTimeFast" BO_ 969 0;
BA_ "GenMsgSendType" BO_ 969 0;
BA_ "VFrameFormat" BO_ 969 14;
BA_ "CANFD_BRS" BO_ 969 1;
BA_ "GenMsgCycleTime" BO_ 969 100;
BA_ "GenMsgCycleTimeFast" BO_ 969 0;
BA_ "GenMsgSendType" BO_ 969 0;
BA_ "VFrameFormat" BO_ 969 14;
BA_ "CANFD_BRS" BO_ 969 1;
BA_ "GenMsgCycleTime" BO_ 969 100;
BA_ "GenMsgCycleTimeFast" BO_ 969 0;
BA_ "GenMsgSendType" BO_ 969 0;
BA_ "VFrameFormat" BO_ 969 14;
BA_ "CANFD_BRS" BO_ 969 1;
BA_ "GenMsgCycleTime" BO_ 969 100;
BA_ "GenMsgCycleTimeFast" BO_ 969 0;
BA_ "GenMsgSendType" BO_ 969 0;
BA_ "VFrameFormat" BO_ 969 14;
BA_ "CANFD_BRS" BO_ 969 1;
BA_ "GenMsgCycleTime" BO_ 969 100;
BA_ "GenMsgCycleTimeFast" BO_ 969 0;
BA_ "GenMsgSendType" BO_ 969 0;
BA_ "VFrameFormat" BO_ 969 14;
BA_ "CANFD_BRS" BO_ 969 1;
BA_ "GenMsgCycleTime" BO_ 969 100;
BA_ "GenMsgCycleTimeFast" BO_ 969 0;
BA_ "GenMsgSendType" BO_ 969 0;
BA_ "VFrameFormat" BO_ 969 14;
BA_ "CANFD_BRS" BO_ 969 1;
BA_ "GenMsgCycleTime" BO_ 969 100;
BA_ "GenMsgCycleTimeFast" BO_ 969 0;
BA_ "GenMsgSendType" BO_ 969 0;
BA_ "VFrameFormat" BO_ 969 14;
BA_ "CANFD_BRS" BO_ 969 1;
BA_ "GenMsgCycleTime" BO_ 969 100;
BA_ "GenMsgCycleTimeFast" BO_ 969 0;
BA_ "GenMsgSendType" BO_ 969 0;
BA_ "VFrameFormat" BO_ 969 14;
BA_ "CANFD_BRS" BO_ 969 1;
BA_ "GenMsgCycleTime" BO_ 969 100;
BA_ "GenMsgCycleTimeFast" BO_ 969 0;
BA_ "GenMsgSendType" BO_ 969 0;
BA_ "VFrameFormat" BO_ 969 14;
BA_ "CANFD_BRS" BO_ 969 1;
BA_ "GenMsgCycleTime" BO_ 969 100;
BA_ "GenMsgCycleTimeFast" BO_ 969 0;
BA_ "GenMsgSendType" BO_ 969 0;
BA_ "VFrameFormat" BO_ 969 14;
BA_ "CANFD_BRS" BO_ 969 1;
BA_ "GenMsgCycleTime" BO_ 969 100;
BA_ "GenMsgCycleTimeFast" BO_ 969 0;
BA_ "GenMsgSendType" BO_ 969 0;
BA_ "VFrameFormat" BO_ 969 14;
BA_ "CANFD_BRS" BO_ 969 1;
BA_ "GenMsgCycleTime" BO_ 969 100;
BA_ "GenMsgCycleTimeFast" BO_ 969 0;
BA_ "GenMsgSendType" BO_ 969 0;
BA_ "VFrameFormat" BO_ 969 14;
BA_ "CANFD_BRS" BO_ 969 1;
BA_ "GenMsgCycleTime" BO_ 969 100;
BA_ "GenMsgCycleTimeFast" BO_ 969 0;
BA_ "GenMsgSendType" BO_ 969 0;
BA_ "VFrameFormat" BO_ 969 14;
BA_ "CANFD_BRS" BO_ 969 1;
BA_ "GenMsgCycleTime" BO_ 969 100;
BA_ "GenMsgCycleTimeFast" BO_ 969 0;
BA_ "GenMsgSendType" BO_ 969 0;
BA_ "VFrameFormat" BO_ 969 14;
BA_ "CANFD_BRS" BO_ 969 1;
BA_ "GenMsgCycleTime" BO_ 969 100;
BA_ "GenMsgCycleTimeFast" BO_ 969 0;
BA_ "GenMsgSendType" BO_ 969 0;
BA_ "VFrameFormat" BO_ 969 14;
BA_ "CANFD_BRS" BO_ 969 1;
BA_ "GenMsgCycleTime" BO_ 969 100;
BA_ "GenMsgCycleTimeFast" BO_ 969 0;
BA_ "GenMsgSendType" BO_ 969 0;
BA_ "VFrameFormat" BO_ 969 14;
BA_ "CANFD_BRS" BO_ 969 1;
BA_ "GenMsgCycleTime" BO_ 969 100;
BA_ "GenMsgCycleTimeFast" BO_ 969 0;
BA_ "GenMsgSendType" BO_ 969 0;
BA_ "VFrameFormat" BO_ 969 14;
BA_ "CANFD_BRS" BO_ 969 1;
BA_ "GenMsgCycleTime" BO_ 969 100;
BA_ "GenMsgCycleTimeFast" BO_ 969 0;
BA_ "GenMsgSendType" BO_ 969 0;
BA_ "VFrameFormat" BO_ 969 14;
BA_ "CANFD_BRS" BO_ 969 1;
BA_ "GenMsgCycleTime" BO_ 969 100;
BA_ "GenMsgCycleTimeFast" BO_ 969 0;
BA_ "GenMsgSendType" BO_ 969 0;
BA_ "VFrameFormat" BO_ 969 14;
BA_ "CANFD_BRS" BO_ 969 1;
BA_ "GenMsgCycleTime" BO_ 969 100;
BA_ "GenMsgCycleTimeFast" BO_ 969 0;
BA_ "GenMsgSendType" BO_ 969 0;
BA_ "VFrameFormat" BO_ 969 14;
BA_ "CANFD_BRS" BO_ 969 1;
BA_ "GenMsgCycleTime" BO_ 969 100;
BA_ "GenMsgCycleTimeFast" BO_ 969 0;
BA_ "GenMsgSendType" BO_ 969 0;
BA_ "VFrameFormat" BO_ 969 14;
BA_ "CANFD_BRS" BO_ 969 1;
BA_ "GenMsgCycleTime" BO_ 969 100;
BA_ "GenMsgCycleTimeFast" BO_ 969 0;
BA_ "GenMsgSendType" BO_ 969 0;
BA_ "VFrameFormat" BO_ 969 14;
BA_ "CANFD_BRS" BO_ 969 1;
BA_ "GenMsgCycleTime" BO_ 969 100;
BA_ "GenMsgCycleTimeFast" BO_ 969 0;
BA_ "GenMsgSendType" BO_ 969 0;
BA_ "VFrameFormat" BO_ 969 14;
BA_ "CANFD_BRS" BO_ 969 1;
BA_ "GenMsgCycleTime" BO_ 969 100;
BA_ "GenMsgCycleTimeFast" BO_ 969 0;
BA_ "GenMsgSendType" BO_ 969 0;
BA_ "VFrameFormat" BO_ 969 14;
BA_ "CANFD_BRS" BO_ 969 1;
BA_ "GenMsgCycleTime" BO_ 969 100;
BA_ "GenMsgCycleTimeFast" BO_ 969 0;
BA_ "GenMsgSendType" BO_ 969 0;
BA_ "VFrameFormat" BO_ 969 14;
BA_ "CANFD_BRS" BO_ 969 1;
BA_ "GenMsgCycleTime" BO_ 969 100;
BA_ "GenMsgCycleTimeFast" BO_ 969 0;
BA_ "GenMsgSendType" BO_ 969 0;
BA_ "VFrameFormat" BO_ 969 14;
BA_ "CANFD_BRS" BO_ 969 1;
BA_ "GenMsgCycleTime" BO_ 969 100;
BA_ "GenMsgCycleTimeFast" BO_ 969 0;
BA_ "GenMsgSendType" BO_ 969 0;
BA_ "VFrameFormat" BO_ 969 14;
BA_ "CANFD_BRS" BO_ 969 1;
BA_ "GenMsgCycleTime" BO_ 969 100;
BA_ "GenMsgCycleTimeFast" BO_ 969 0;
BA_ "GenMsgSendType" BO_ 969 0;
BA_ "VFrameFormat" BO_ 969 14;
BA_ "CANFD_BRS" BO_ 969 1;
BA_ "GenMsgCycleTime" BO_ 969 100;
BA_ "GenMsgCycleTimeFast" BO_ 969 0;
BA_ "GenMsgSendType" BO_ 969 0;
BA_ "VFrameFormat" BO_ 969 14;
BA_ "CANFD_BRS" BO_ 969 1;
BA_ "GenMsgCycleTime" BO_ 969 100;
BA_ "GenMsgCycleTimeFast" BO_ 969 0;
BA_ "GenMsgSendType" BO_ 969 0;
BA_ "VFrameFormat" BO_ 969 14;
BA_ "CANFD_BRS" BO_ 969 1;
BA_ "GenMsgCycleTime" BO_ 969 100;
BA_ "GenMsgCycleTimeFast" BO_ 969 0;
BA_ "GenMsgSendType" BO_ 969 0;
BA_ "VFrameFormat" BO_ 969 14;
BA_ "CANFD_BRS" BO_ 969 1;
BA_ "GenMsgCycleTime" BO_ 969 100;
BA_ "GenMsgCycleTimeFast" BO_ 969 0;
BA_ "GenMsgSendType" BO_ 969 0;
BA_ "VFrameFormat" BO_ 969 14;
BA_ "CANFD_BRS" BO_ 969 1;
BA_ "GenMsgCycleTime" BO_ 969 100;
BA_ "GenMsgCycleTimeFast" BO_ 969 0;
BA_ "GenMsgSendType" BO_ 969 0;
BA_ "VFrameFormat" BO_ 969 14;
BA_ "CANFD_BRS" BO_ 969 1;
BA_ "GenMsgCycleTime" BO_ 969 100;
BA_ "GenMsgCycleTimeFast" BO_ 969 0;
BA_ "GenMsgSendType" BO_ 969 0;
BA_ "VFrameFormat" BO_ 969 14;
BA_ "CANFD_BRS" BO_ 969 1;
BA_ "GenMsgCycleTime" BO_ 969 100;
BA_ "GenMsgCycleTimeFast" BO_ 969 0;
BA_ "GenMsgSendType" BO_ 969 0;
BA_ "VFrameFormat" BO_ 969 14;
BA_ "CANFD_BRS" BO_ 969 1;
BA_ "GenMsgCycleTime" BO_ 969 100;
BA_ "GenMsgCycleTimeFast" BO_ 969 0;
BA_ "GenMsgSendType" BO_ 969 0;
BA_ "VFrameFormat" BO_ 969 14;
BA_ "CANFD_BRS" BO_ 969 1;
BA_ "GenMsgCycleTime" BO_ 969 100;
BA_ "GenMsgCycleTimeFast" BO_ 969 0;
BA_ "GenMsgSendType" BO_ 969 0;
BA_ "VFrameFormat" BO_ 969 14;
BA_ "CANFD_BRS" BO_ 969 1;
BA_ "GenMsgCycleTime" BO_ 969 100;
BA_ "GenMsgCycleTimeFast" BO_ 969 0;
BA_ "GenMsgSendType" BO_ 969 0;
BA_ "VFrameFormat" BO_ 969 14;
BA_ "CANFD_BRS" BO_ 969 1;
BA_ "GenMsgCycleTime" BO_ 969 100;
BA_ "GenMsgCycleTimeFast" BO_ 969 0;
BA_ "GenMsgSendType" BO_ 969 0;
BA_ "VFrameFormat" BO_ 969 14;
BA_ "CANFD_BRS" BO_ 969 1;
BA_ "GenMsgCycleTime" BO_ 969 100;
BA_ "GenMsgCycleTimeFast" BO_ 969 0;
BA_ "GenMsgSendType" BO_ 969 0;
BA_ "VFrameFormat" BO_ 969 14;
BA_ "CANFD_BRS" BO_ 969 1;
BA_ "GenMsgCycleTime" BO_ 969 100;
BA_ "GenMsgCycleTimeFast" BO_ 969 0;
BA_ "GenMsgSendType" BO_ 969 0;
BA_ "VFrameFormat" BO_ 969 14;
BA_ "CANFD_BRS" BO_ 969 1;
BA_ "GenMsgCycleTime" BO_ 969 100;
BA_ "GenMsgCycleTimeFast" BO_ 969 0;
BA_ "GenMsgSendType" BO_ 969 0;
BA_ "VFrameFormat" BO_ 969 14;
BA_ "CANFD_BRS" BO_ 969 1;
BA_ "GenMsgCycleTime" BO_ 969 100;
BA_ "GenMsgCycleTimeFast" BO_ 969 0;
BA_ "GenMsgSendType" BO_ 969 0;
BA_ "VFrameFormat" BO_ 969 14;
BA_ "CANFD_BRS" BO_ 969 1;
BA_ "GenMsgCycleTime" BO_ 969 100;
BA_ "GenMsgCycleTimeFast" BO_ 969 0;
BA_ "GenMsgSendType" BO_ 969 0;
BA_ "VFrameFormat" BO_ 969 14;
BA_ "CANFD_BRS" BO_ 969 1;
BA_ "GenMsgCycleTime" BO_ 969 100;
BA_ "GenMsgCycleTimeFast" BO_ 969 0;
BA_ "GenMsgSendType" BO_ 969 0;
BA_ "VFrameFormat" BO_ 969 14;
BA_ "CANFD_BRS" BO_ 969 1;
BA_ "GenMsgCycleTime" BO_ 969 100;
BA_ "GenMsgCycleTimeFast" BO_ 969 0;
BA_ "GenMsgSendType" BO_ 969 0;
BA_ "VFrameFormat" BO_ 969 14;
BA_ "CANFD_BRS" BO_ 969 1;
BA_ "GenMsgCycleTime" BO_ 969 100;
BA_ "GenMsgCycleTimeFast" BO_ 969 0;
BA_ "GenMsgSendType" BO_ 969 0;
BA_ "VFrameFormat" BO_ 969 14;
BA_ "CANFD_BRS" BO_ 969 1;
BA_ "GenMsgCycleTime" BO_ 969 100;
BA_ "GenMsgCycleTimeFast" BO_ 969 0;
BA_ "GenMsgSendType" BO_ 969 0;
BA_ "VFrameFormat" BO_ 969 14;
BA_ "CANFD_BRS" BO_ 969 1;
BA_ "GenMsgCycleTime" BO_ 969 100;
BA_ "GenMsgCycleTimeFast" BO_ 969 0;
BA_ "GenMsgSendType" BO_ 969 0;
BA_ "VFrameFormat" BO_ 969 14;
BA_ "CANFD_BRS" BO_ 969 1;
BA_ "GenMsgCycleTime" BO_ 969 100;
BA_ "GenMsgCycleTimeFast" BO_ 969 0;
BA_ "GenMsgSendType" BO_ 969 0;
BA_ "VFrameFormat" BO_ 969 14;
BA_ "CANFD_BRS" BO_ 969 1;
BA_ "GenMsgCycleTime" BO_ 969 100;
BA_ "GenMsgCycleTimeFast" BO_ 969 0;
BA_ "GenMsgSendType" BO_ 969 0;
BA_ "VFrameFormat" BO_ 969 14;
BA_ "CANFD_BRS" BO_ 969 1;
BA_ "GenMsgCycleTime" BO_ 969 100;
BA_ "GenMsgCycleTimeFast" BO_ 969 0;
BA_ "GenMsgSendType" BO_ 969 0;
BA_ "VFrameFormat" BO_ 969 14;
BA_ "CANFD_BRS" BO_ 969 1;
BA_ "GenMsgCycleTime" BO_ 969 100;
BA_ "GenMsgCycleTimeFast" BO_ 969 0;
BA_ "GenMsgSendType" BO_ 969 0;
BA_ "VFrameFormat" BO_ 969 14;
BA_ "CANFD_BRS" BO_ 969 1;
BA_ "GenMsgCycleTime" BO_ 969 100;
BA_ "GenMsgCycleTimeFast" BO_ 969 0;
BA_ "GenMsgSendType" BO_ 969 0;
BA_ "VFrameFormat" BO_ 969 14;
BA_ "CANFD_BRS" BO_ 969 1;
BA_ "GenMsgCycleTime" BO_ 969 100;
BA_ "GenMsgCycleTimeFast" BO_ 969 0;
BA_ "GenMsgSendType" BO_ 969 0;
BA_ "VFrameFormat" BO_ 969 14;
BA_ "CANFD_BRS" BO_ 969 1;
BA_ "GenMsgCycleTime" BO_ 969 100;
BA_ "GenMsgCycleTimeFast" BO_ 969 0;
BA_ "GenMsgSendType" BO_ 969 0;
BA_ "VFrameFormat" BO_ 969 14;
BA_ "CANFD_BRS" BO_ 969 1;
BA_ "GenMsgCycleTime" BO_ 969 100;
BA_ "GenMsgCycleTimeFast" BO_ 969 0;
BA_ "GenMsgSendType" BO_ 969 0;
BA_ "VFrameFormat" BO_ 969 14;
BA_ "CANFD_BRS" BO_ 969 1;
BA_ "GenMsgCycleTime" BO_ 969 100;
BA_ "GenMsgCycleTimeFast" BO_ 969 0;
BA_ "GenMsgSendType" BO_ 969 0;
BA_ "VFrameFormat" BO_ 969 14;
BA_ "CANFD_BRS" BO_ 969 1;
BA_ "GenMsgCycleTime" BO_ 969 100;
BA_ "GenMsgCycleTimeFast" BO_ 969 0;
BA_ "GenMsgSendType" BO_ 969 0;
BA_ "VFrameFormat" BO_ 969 14;
BA_ "CANFD_BRS" BO_ 969 1;
BA_ "GenMsgCycleTime" BO_ 969 100;
BA_ "GenMsgCycleTimeFast" BO_ 969 0;
BA_ "GenMsgSendType" BO_ 969 0;
BA_ "VFrameFormat" BO_ 969 14;
BA_ "CANFD_BRS" BO_ 969 1;
BA_ "GenMsgCycleTime" BO_ 969 100;
BA_ "GenMsgCycleTimeFast" BO_ 969 0;
BA_ "GenMsgSendType" BO_ 969 0;
BA_ "VFrameFormat" BO_ 969 14;
BA_ "CANFD_BRS" BO_ 969 1;
BA_ "GenMsgCycleTime" BO_ 969 100;
BA_ "GenMsgCycleTimeFast" BO_ 969 0;
BA_ "GenMsgSendType" BO_ 969 0;
BA_ "VFrameFormat" BO_ 969 14;
BA_ "CANFD_BRS" BO_ 969 1;
BA_ "GenMsgCycleTime" BO_ 969 100;
BA_ "GenMsgCycleTimeFast" BO_ 969 0;
BA_ "GenMsgSendType" BO_ 969 0;
BA_ "VFrameFormat" BO_ 969 14;
BA_ "CANFD_BRS" BO_ 969 1;
BA_ "GenMsgCycleTime" BO_ 969 100;
BA_ "GenMsgCycleTimeFast" BO_ 969 0;
BA_ "GenMsgSendType" BO_ 969 0;
BA_ "VFrameFormat" BO_ 969 14;
BA_ "CANFD_BRS" BO_ 969 1;
BA_ "GenMsgCycleTime" BO_ 969 100;
BA_ "GenMsgCycleTimeFast" BO_ 969 0;
BA_ "GenMsgSendType" BO_ 969 0;
BA_ "VFrameFormat" BO_ 969 14;
BA_ "CANFD_BRS" BO_ 969 1;
BA_ "GenMsgCycleTime" BO_ 969 100;
BA_ "GenMsgCycleTimeFast" BO_ 969 0;
BA_ "GenMsgSendType" BO_ 969 0;
BA_ "VFrameFormat" BO_ 969 14;
BA_ "CANFD_BRS" BO_ 969 1;
BA_ "GenMsgCycleTime" BO_ 969 100;
BA_ "GenMsgCycleTimeFast" BO_ 969 0;
BA_ "GenMsgSendType" BO_ 969 0;
BA_ "VFrameFormat" BO_ 969 14;
BA_ "CANFD_BRS" BO_ 969 1;
BA_ "GenMsgCycleTime" BO_ 969 100;
BA_ "GenMsgCycleTimeFast" BO_ 969 0;
BA_ "GenMsgSendType" BO_ 969 0;
BA_ "VFrameFormat" BO_ 969 14;
BA_ "CANFD_BRS" BO_ 969 1;
BA_ "GenMsgCycleTime" BO_ 969 100;
BA_ "GenMsgCycleTimeFast" BO_ 969 0;
BA_ "GenMsgSendType" BO_ 969 0;
BA_ "VFrameFormat" BO_ 969 14;
BA_ "CANFD_BRS" BO_ 969 1;
BA_ "GenMsgCycleTime" BO_ 969 100;
BA_ "GenMsgCycleTimeFast" BO_ 969 0;
BA_ "GenMsgSendType" BO_ 969 0;
BA_ "VFrameFormat" BO_ 969 14;
BA_ "CANFD_BRS" BO_ 969 1;
BA_ "GenMsgCycleTime" BO_ 969 100;
BA_ "GenMsgCycleTimeFast" BO_ 969 0;
BA_ "GenMsgSendType" BO_ 969 0;
BA_ "VFrameFormat" BO_ 969 14;
BA_ "CANFD_BRS" BO_ 969 1;
BA_ "GenMsgCycleTime" BO_ 969 100;
BA_ "GenMsgCycleTimeFast" BO_ 969 0;
BA_ "GenMsgSendType" BO_ 969 0;
BA_ "VFrameFormat" BO_ 969 14;
BA_ "CANFD_BRS" BO_ 969 1;
BA_ "GenMsgCycleTime" BO_ 969 100;
BA_ "GenMsgCycleTimeFast" BO_ 969 0;
BA_ "GenMsgSendType" BO_ 969 0;
BA_ "VFrameFormat" BO_ 969 14;
BA_ "CANFD_BRS" BO_ 969 1;
BA_ "GenMsgCycleTime" BO_ 969 100;
BA_ "GenMsgCycleTimeFast" BO_ 969 0;
BA_ "GenMsgSendType" BO_ 969 0;
BA_ "VFrameFormat" BO_ 969 14;
BA_ "CANFD_BRS" BO_ 969 1;
BA_ "GenMsgCycleTime" BO_ 969 100;
BA_ "GenMsgCycleTimeFast" BO_ 969 0;
BA_ "GenMsgSendType" BO_ 969 0;
BA_ "VFrameFormat" BO_ 969 14;
BA_ "CANFD_BRS" BO_ 969 1;
BA_ "GenMsgCycleTime" BO_ 969 100;
BA_ "GenMsgCycleTimeFast" BO_ 969 0;
BA_ "GenMsgSendType" BO_ 969 0;
BA_ "VFrameFormat" BO_ 969 14;
BA_ "CANFD_BRS" BO_ 969 1;
BA_ "GenMsgCycleTime" BO_ 969 100;
BA_ "GenMsgCycleTimeFast" BO_ 969 0;
BA_ "GenMsgSendType" BO_ 969 0;
BA_ "VFrameFormat" BO_ 969 14;
BA_ "CANFD_BRS" BO_ 969 1;
BA_ "GenMsgCycleTime" BO_ 969 100;
BA_ "GenMsgCycleTimeFast" BO_ 969 0;
BA_ "GenMsgSendType" BO_ 969 0;
BA_ "VFrameFormat" BO_ 969 14;
BA_ "CANFD_BRS" BO_ 969 1;
BA_ "GenMsgCycleTime" BO_ 969 100;
BA_ "GenMsgCycleTimeFast" BO_ 969 0;
BA_ "GenMsgSendType" BO_ 969 0;
BA_ "VFrameFormat" BO_ 969 14;
BA_ "CANFD_BRS" BO_ 969 1;
BA_ "GenMsgCycleTime" BO_ 969 100;
BA_ "GenMsgCycleTimeFast" BO_ 969 0;
BA_ "GenMsgSendType" BO_ 969 0;
BA_ "VFrameFormat" BO_ 969 14;
BA_ "CANFD_BRS" BO_ 969 1;
BA_ "GenMsgCycleTime" BO_ 969 100;
BA_ "GenMsgCycleTimeFast" BO_ 969 0;
BA_ "GenMsgSendType" BO_ 969 0;
BA_ "VFrameFormat" BO_ 969 14;
BA_ "CANFD_BRS" BO_ 969 1;
BA_ "GenMsgCycleTime" BO_ 969 100;
BA_ "GenMsgCycleTimeFast" BO_ 969 0;
BA_ "GenMsgSendType" BO_ 969 0;
BA_ "VFrameFormat" BO_ 969 14;
BA_ "CANFD_BRS" BO_ 969 1;
BA_ "GenMsgCycleTime" BO_ 969 100;
BA_ "GenMsgCycleTimeFast" BO_ 969 0;
BA_ "GenMsgSendType" BO_ 969 0;
BA_ "VFrameFormat" BO_ 969 14;
BA_ "CANFD_BRS" BO_ 969 1;
BA_ "GenMsgCycleTime" BO_ 969 100;
BA_ "GenMsgCycleTimeFast" BO_ 969 0;
BA_ "GenMsgSendType" BO_ 969 0;
BA_ "VFrameFormat" BO_ 969 14;
BA_ "CANFD_BRS" BO_ 969 1;
BA_ "GenMsgCycleTime" BO_ 969 100;
BA_ "GenMsgCycleTimeFast" BO_ 969 0;
BA_ "GenMsgSendType" BO_ 969 0;
BA_ "VFrameFormat" BO_ 969 14;
BA_ "CANFD_BRS" BO_ 969 1;
BA_ "GenMsgCycleTime" BO_ 969 100;
BA_ "GenMsgCycleTimeFast" BO_ 969 0;
BA_ "GenMsgSendType" BO_ 969 0;
BA_ "VFrameFormat" BO_ 969 14;
BA_ "CANFD_BRS" BO_ 969 1;
BA_ "GenMsgCycleTime" BO_ 969 100;
BA_ "GenMsgCycleTimeFast" BO_ 969 0;
BA_ "GenMsgSendType" BO_ 969 0;
BA_ "VFrameFormat" BO_ 969 14;
BA_ "CANFD_BRS" BO_ 969 1;
BA_ "GenMsgCycleTime" BO_ 969 100;
BA_ "GenMsgCycleTimeFast" BO_ 969 0;
BA_ "GenMsgSendType" BO_ 969 0;
BA_ "VFrameFormat" BO_ 969 14;
BA_ "CANFD_BRS" BO_ 969 1;
BA_ "GenMsgCycleTime" BO_ 969 100;
BA_ "GenMsgCycleTimeFast" BO_ 969 0;
BA_ "GenMsgSendType" BO_ 969 0;
BA_ "VFrameFormat" BO_ 969 14;
BA_ "CANFD_BRS" BO_ 969 1;
BA_ "GenMsgCycleTime" BO_ 969 100;
BA_ "GenMsgCycleTimeFast" BO_ 969 0;
BA_ "GenMsgSendType" BO_ 969 0;
BA_ "VFrameFormat" BO_ 969 14;
BA_ "CANFD_BRS" BO_ 969 1;
BA_ "GenMsgCycleTime" BO_ 969 100;
BA_ "GenMsgCycleTimeFast" BO_ 969 0;
BA_ "GenMsgSendType" BO_ 969 0;
BA_ "VFrameFormat" BO_ 969 14;
BA_ "CANFD_BRS" BO_ 969 1;
BA_ "GenMsgCycleTime" BO_ 969 100;
BA_ "GenMsgCycleTimeFast" BO_ 969 0;
BA_ "GenMsgSendType" BO_ 969 0;
BA_ "VFrameFormat" BO_ 969 14;
BA_ "CANFD_BRS" BO_ 969 1;
BA_ "GenMsgCycleTime" BO_ 969 100;
BA_ "GenMsgCycleTimeFast" BO_ 969 0;
BA_ "GenMsgSendType" BO_ 969 0;
BA_ "VFrameFormat" BO_ 969 14;
BA_ "CANFD_BRS" BO_ 969 1;
BA_ "GenMsgCycleTime" BO_ 969 100;
BA_ "GenMsgCycleTimeFast" BO_ 969 0;
BA_ "GenMsgSendType" BO_ 969 0;
BA_ "VFrameFormat" BO_ 969 14;
BA_ "CANFD_BRS" BO_ 969 1;
BA_ "GenMsgCycleTime" BO_ 969 100;
BA_ "GenMsgCycleTimeFast" BO_ 969 0;
BA_ "GenMsgSendType" BO_ 969 0;
BA_ "VFrameFormat" BO_ 969 14;
BA_ "CANFD_BRS" BO_ 969 1;
BA_ "GenMsgCycleTime" BO_ 969 100;
BA_ "GenMsgCycleTimeFast" BO_ 969 0;
BA_ "GenMsgSendType" BO_ 969 0;
BA_ "VFrameFormat" BO_ 969 14;
BA_ "CANFD_BRS" BO_ 969 1;
BA_ "GenMsgCycleTime" BO_ 969 100;
BA_ "GenMsgCycleTimeFast" BO_ 969 0;
BA_ "GenMsgSendType" BO_ 969 0;
BA_ "VFrameFormat" BO_ 969 14;
BA_ "CANFD_BRS" BO_ 969 1;
BA_ "GenMsgCycleTime" BO_ 969 100;
BA_ "GenMsgCycleTimeFast" BO_ 969 0;
BA_ "GenMsgSendType" BO_ 969 0;
BA_ "VFrameFormat" BO_ 969 14;
BA_ "CANFD_BRS" BO_ 969 1;
BA_ "GenMsgCycleTime" BO_ 969 100;
BA_ "GenMsgCycleTimeFast" BO_ 969 0;
BA_ "GenMsgSendType" BO_ 969 0;
BA_ "VFrameFormat" BO_ 969 14;
BA_ "CANFD_BRS" BO_ 969 1;
BA_ "GenMsgCycleTime" BO_ 969 100;
BA_ "GenMsgCycleTimeFast" BO_ 969 0;
BA_ "GenMsgSendType" BO_ 969 0;
BA_ "VFrameFormat" BO_ 969 14;
BA_ "CANFD_BRS" BO_ 969 1;
BA_ "GenMsgCycleTime" BO_ 970 100;
BA_ "GenMsgCycleTimeFast" BO_ 970 0;
BA_ "GenMsgSendType" BO_ 970 0;
BA_ "VFrameFormat" BO_ 970 14;
BA_ "CANFD_BRS" BO_ 970 1;
BA_ "GenMsgCycleTime" BO_ 970 100;
BA_ "GenMsgCycleTimeFast" BO_ 970 0;
BA_ "GenMsgSendType" BO_ 970 0;
BA_ "VFrameFormat" BO_ 970 14;
BA_ "CANFD_BRS" BO_ 970 1;
BA_ "GenMsgCycleTime" BO_ 970 100;
BA_ "GenMsgCycleTimeFast" BO_ 970 0;
BA_ "GenMsgSendType" BO_ 970 0;
BA_ "VFrameFormat" BO_ 970 14;
BA_ "CANFD_BRS" BO_ 970 1;
BA_ "GenMsgCycleTime" BO_ 970 100;
BA_ "GenMsgCycleTimeFast" BO_ 970 0;
BA_ "GenMsgSendType" BO_ 970 0;
BA_ "VFrameFormat" BO_ 970 14;
BA_ "CANFD_BRS" BO_ 970 1;
BA_ "GenMsgCycleTime" BO_ 970 100;
BA_ "GenMsgCycleTimeFast" BO_ 970 0;
BA_ "GenMsgSendType" BO_ 970 0;
BA_ "VFrameFormat" BO_ 970 14;
BA_ "CANFD_BRS" BO_ 970 1;
BA_ "GenMsgCycleTime" BO_ 970 100;
BA_ "GenMsgCycleTimeFast" BO_ 970 0;
BA_ "GenMsgSendType" BO_ 970 0;
BA_ "VFrameFormat" BO_ 970 14;
BA_ "CANFD_BRS" BO_ 970 1;
BA_ "GenMsgCycleTime" BO_ 970 100;
BA_ "GenMsgCycleTimeFast" BO_ 970 0;
BA_ "GenMsgSendType" BO_ 970 0;
BA_ "VFrameFormat" BO_ 970 14;
BA_ "CANFD_BRS" BO_ 970 1;
BA_ "GenMsgCycleTime" BO_ 970 100;
BA_ "GenMsgCycleTimeFast" BO_ 970 0;
BA_ "GenMsgSendType" BO_ 970 0;
BA_ "VFrameFormat" BO_ 970 14;
BA_ "CANFD_BRS" BO_ 970 1;
BA_ "GenMsgCycleTime" BO_ 970 100;
BA_ "GenMsgCycleTimeFast" BO_ 970 0;
BA_ "GenMsgSendType" BO_ 970 0;
BA_ "VFrameFormat" BO_ 970 14;
BA_ "CANFD_BRS" BO_ 970 1;
BA_ "GenMsgCycleTime" BO_ 970 100;
BA_ "GenMsgCycleTimeFast" BO_ 970 0;
BA_ "GenMsgSendType" BO_ 970 0;
BA_ "VFrameFormat" BO_ 970 14;
BA_ "CANFD_BRS" BO_ 970 1;
BA_ "GenMsgCycleTime" BO_ 970 100;
BA_ "GenMsgCycleTimeFast" BO_ 970 0;
BA_ "GenMsgSendType" BO_ 970 0;
BA_ "VFrameFormat" BO_ 970 14;
BA_ "CANFD_BRS" BO_ 970 1;
BA_ "GenMsgCycleTime" BO_ 970 100;
BA_ "GenMsgCycleTimeFast" BO_ 970 0;
BA_ "GenMsgSendType" BO_ 970 0;
BA_ "VFrameFormat" BO_ 970 14;
BA_ "CANFD_BRS" BO_ 970 1;
BA_ "GenMsgCycleTime" BO_ 970 100;
BA_ "GenMsgCycleTimeFast" BO_ 970 0;
BA_ "GenMsgSendType" BO_ 970 0;
BA_ "VFrameFormat" BO_ 970 14;
BA_ "CANFD_BRS" BO_ 970 1;
BA_ "GenMsgCycleTime" BO_ 970 100;
BA_ "GenMsgCycleTimeFast" BO_ 970 0;
BA_ "GenMsgSendType" BO_ 970 0;
BA_ "VFrameFormat" BO_ 970 14;
BA_ "CANFD_BRS" BO_ 970 1;
BA_ "GenMsgCycleTime" BO_ 970 100;
BA_ "GenMsgCycleTimeFast" BO_ 970 0;
BA_ "GenMsgSendType" BO_ 970 0;
BA_ "VFrameFormat" BO_ 970 14;
BA_ "CANFD_BRS" BO_ 970 1;
BA_ "GenMsgCycleTime" BO_ 970 100;
BA_ "GenMsgCycleTimeFast" BO_ 970 0;
BA_ "GenMsgSendType" BO_ 970 0;
BA_ "VFrameFormat" BO_ 970 14;
BA_ "CANFD_BRS" BO_ 970 1;
BA_ "GenMsgCycleTime" BO_ 970 100;
BA_ "GenMsgCycleTimeFast" BO_ 970 0;
BA_ "GenMsgSendType" BO_ 970 0;
BA_ "VFrameFormat" BO_ 970 14;
BA_ "CANFD_BRS" BO_ 970 1;
BA_ "GenMsgCycleTime" BO_ 970 100;
BA_ "GenMsgCycleTimeFast" BO_ 970 0;
BA_ "GenMsgSendType" BO_ 970 0;
BA_ "VFrameFormat" BO_ 970 14;
BA_ "CANFD_BRS" BO_ 970 1;
BA_ "GenMsgCycleTime" BO_ 970 100;
BA_ "GenMsgCycleTimeFast" BO_ 970 0;
BA_ "GenMsgSendType" BO_ 970 0;
BA_ "VFrameFormat" BO_ 970 14;
BA_ "CANFD_BRS" BO_ 970 1;
BA_ "GenMsgCycleTime" BO_ 970 100;
BA_ "GenMsgCycleTimeFast" BO_ 970 0;
BA_ "GenMsgSendType" BO_ 970 0;
BA_ "VFrameFormat" BO_ 970 14;
BA_ "CANFD_BRS" BO_ 970 1;
BA_ "GenMsgCycleTime" BO_ 970 100;
BA_ "GenMsgCycleTimeFast" BO_ 970 0;
BA_ "GenMsgSendType" BO_ 970 0;
BA_ "VFrameFormat" BO_ 970 14;
BA_ "CANFD_BRS" BO_ 970 1;
BA_ "GenMsgCycleTime" BO_ 970 100;
BA_ "GenMsgCycleTimeFast" BO_ 970 0;
BA_ "GenMsgSendType" BO_ 970 0;
BA_ "VFrameFormat" BO_ 970 14;
BA_ "CANFD_BRS" BO_ 970 1;
BA_ "GenMsgCycleTime" BO_ 970 100;
BA_ "GenMsgCycleTimeFast" BO_ 970 0;
BA_ "GenMsgSendType" BO_ 970 0;
BA_ "VFrameFormat" BO_ 970 14;
BA_ "CANFD_BRS" BO_ 970 1;
BA_ "GenMsgCycleTime" BO_ 970 100;
BA_ "GenMsgCycleTimeFast" BO_ 970 0;
BA_ "GenMsgSendType" BO_ 970 0;
BA_ "VFrameFormat" BO_ 970 14;
BA_ "CANFD_BRS" BO_ 970 1;
BA_ "GenMsgCycleTime" BO_ 970 100;
BA_ "GenMsgCycleTimeFast" BO_ 970 0;
BA_ "GenMsgSendType" BO_ 970 0;
BA_ "VFrameFormat" BO_ 970 14;
BA_ "CANFD_BRS" BO_ 970 1;
BA_ "GenMsgCycleTime" BO_ 970 100;
BA_ "GenMsgCycleTimeFast" BO_ 970 0;
BA_ "GenMsgSendType" BO_ 970 0;
BA_ "VFrameFormat" BO_ 970 14;
BA_ "CANFD_BRS" BO_ 970 1;
BA_ "GenMsgCycleTime" BO_ 970 100;
BA_ "GenMsgCycleTimeFast" BO_ 970 0;
BA_ "GenMsgSendType" BO_ 970 0;
BA_ "VFrameFormat" BO_ 970 14;
BA_ "CANFD_BRS" BO_ 970 1;
BA_ "GenMsgCycleTime" BO_ 970 100;
BA_ "GenMsgCycleTimeFast" BO_ 970 0;
BA_ "GenMsgSendType" BO_ 970 0;
BA_ "VFrameFormat" BO_ 970 14;
BA_ "CANFD_BRS" BO_ 970 1;
BA_ "GenMsgCycleTime" BO_ 970 100;
BA_ "GenMsgCycleTimeFast" BO_ 970 0;
BA_ "GenMsgSendType" BO_ 970 0;
BA_ "VFrameFormat" BO_ 970 14;
BA_ "CANFD_BRS" BO_ 970 1;
BA_ "GenMsgCycleTime" BO_ 970 100;
BA_ "GenMsgCycleTimeFast" BO_ 970 0;
BA_ "GenMsgSendType" BO_ 970 0;
BA_ "VFrameFormat" BO_ 970 14;
BA_ "CANFD_BRS" BO_ 970 1;
BA_ "GenMsgCycleTime" BO_ 970 100;
BA_ "GenMsgCycleTimeFast" BO_ 970 0;
BA_ "GenMsgSendType" BO_ 970 0;
BA_ "VFrameFormat" BO_ 970 14;
BA_ "CANFD_BRS" BO_ 970 1;
BA_ "GenMsgCycleTime" BO_ 970 100;
BA_ "GenMsgCycleTimeFast" BO_ 970 0;
BA_ "GenMsgSendType" BO_ 970 0;
BA_ "VFrameFormat" BO_ 970 14;
BA_ "CANFD_BRS" BO_ 970 1;
BA_ "GenMsgCycleTime" BO_ 970 100;
BA_ "GenMsgCycleTimeFast" BO_ 970 0;
BA_ "GenMsgSendType" BO_ 970 0;
BA_ "VFrameFormat" BO_ 970 14;
BA_ "CANFD_BRS" BO_ 970 1;
BA_ "GenMsgCycleTime" BO_ 970 100;
BA_ "GenMsgCycleTimeFast" BO_ 970 0;
BA_ "GenMsgSendType" BO_ 970 0;
BA_ "VFrameFormat" BO_ 970 14;
BA_ "CANFD_BRS" BO_ 970 1;
BA_ "GenMsgCycleTime" BO_ 970 100;
BA_ "GenMsgCycleTimeFast" BO_ 970 0;
BA_ "GenMsgSendType" BO_ 970 0;
BA_ "VFrameFormat" BO_ 970 14;
BA_ "CANFD_BRS" BO_ 970 1;
BA_ "GenMsgCycleTime" BO_ 970 100;
BA_ "GenMsgCycleTimeFast" BO_ 970 0;
BA_ "GenMsgSendType" BO_ 970 0;
BA_ "VFrameFormat" BO_ 970 14;
BA_ "CANFD_BRS" BO_ 970 1;
BA_ "GenMsgCycleTime" BO_ 970 100;
BA_ "GenMsgCycleTimeFast" BO_ 970 0;
BA_ "GenMsgSendType" BO_ 970 0;
BA_ "VFrameFormat" BO_ 970 14;
BA_ "CANFD_BRS" BO_ 970 1;
BA_ "GenMsgCycleTime" BO_ 970 100;
BA_ "GenMsgCycleTimeFast" BO_ 970 0;
BA_ "GenMsgSendType" BO_ 970 0;
BA_ "VFrameFormat" BO_ 970 14;
BA_ "CANFD_BRS" BO_ 970 1;
BA_ "GenMsgCycleTime" BO_ 970 100;
BA_ "GenMsgCycleTimeFast" BO_ 970 0;
BA_ "GenMsgSendType" BO_ 970 0;
BA_ "VFrameFormat" BO_ 970 14;
BA_ "CANFD_BRS" BO_ 970 1;
BA_ "GenMsgCycleTime" BO_ 970 100;
BA_ "GenMsgCycleTimeFast" BO_ 970 0;
BA_ "GenMsgSendType" BO_ 970 0;
BA_ "VFrameFormat" BO_ 970 14;
BA_ "CANFD_BRS" BO_ 970 1;
BA_ "GenMsgCycleTime" BO_ 970 100;
BA_ "GenMsgCycleTimeFast" BO_ 970 0;
BA_ "GenMsgSendType" BO_ 970 0;
BA_ "VFrameFormat" BO_ 970 14;
BA_ "CANFD_BRS" BO_ 970 1;
BA_ "GenMsgCycleTime" BO_ 970 100;
BA_ "GenMsgCycleTimeFast" BO_ 970 0;
BA_ "GenMsgSendType" BO_ 970 0;
BA_ "VFrameFormat" BO_ 970 14;
BA_ "CANFD_BRS" BO_ 970 1;
BA_ "GenMsgCycleTime" BO_ 970 100;
BA_ "GenMsgCycleTimeFast" BO_ 970 0;
BA_ "GenMsgSendType" BO_ 970 0;
BA_ "VFrameFormat" BO_ 970 14;
BA_ "CANFD_BRS" BO_ 970 1;
BA_ "GenMsgCycleTime" BO_ 970 100;
BA_ "GenMsgCycleTimeFast" BO_ 970 0;
BA_ "GenMsgSendType" BO_ 970 0;
BA_ "VFrameFormat" BO_ 970 14;
BA_ "CANFD_BRS" BO_ 970 1;
BA_ "GenMsgCycleTime" BO_ 970 100;
BA_ "GenMsgCycleTimeFast" BO_ 970 0;
BA_ "GenMsgSendType" BO_ 970 0;
BA_ "VFrameFormat" BO_ 970 14;
BA_ "CANFD_BRS" BO_ 970 1;
BA_ "GenMsgCycleTime" BO_ 970 100;
BA_ "GenMsgCycleTimeFast" BO_ 970 0;
BA_ "GenMsgSendType" BO_ 970 0;
BA_ "VFrameFormat" BO_ 970 14;
BA_ "CANFD_BRS" BO_ 970 1;
BA_ "GenMsgCycleTime" BO_ 970 100;
BA_ "GenMsgCycleTimeFast" BO_ 970 0;
BA_ "GenMsgSendType" BO_ 970 0;
BA_ "VFrameFormat" BO_ 970 14;
BA_ "CANFD_BRS" BO_ 970 1;
BA_ "GenMsgCycleTime" BO_ 970 100;
BA_ "GenMsgCycleTimeFast" BO_ 970 0;
BA_ "GenMsgSendType" BO_ 970 0;
BA_ "VFrameFormat" BO_ 970 14;
BA_ "CANFD_BRS" BO_ 970 1;
BA_ "GenMsgCycleTime" BO_ 970 100;
BA_ "GenMsgCycleTimeFast" BO_ 970 0;
BA_ "GenMsgSendType" BO_ 970 0;
BA_ "VFrameFormat" BO_ 970 14;
BA_ "CANFD_BRS" BO_ 970 1;
BA_ "GenMsgCycleTime" BO_ 970 100;
BA_ "GenMsgCycleTimeFast" BO_ 970 0;
BA_ "GenMsgSendType" BO_ 970 0;
BA_ "VFrameFormat" BO_ 970 14;
BA_ "CANFD_BRS" BO_ 970 1;
BA_ "GenMsgCycleTime" BO_ 970 100;
BA_ "GenMsgCycleTimeFast" BO_ 970 0;
BA_ "GenMsgSendType" BO_ 970 0;
BA_ "VFrameFormat" BO_ 970 14;
BA_ "CANFD_BRS" BO_ 970 1;
BA_ "GenMsgCycleTime" BO_ 970 100;
BA_ "GenMsgCycleTimeFast" BO_ 970 0;
BA_ "GenMsgSendType" BO_ 970 0;
BA_ "VFrameFormat" BO_ 970 14;
BA_ "CANFD_BRS" BO_ 970 1;
BA_ "GenMsgCycleTime" BO_ 970 100;
BA_ "GenMsgCycleTimeFast" BO_ 970 0;
BA_ "GenMsgSendType" BO_ 970 0;
BA_ "VFrameFormat" BO_ 970 14;
BA_ "CANFD_BRS" BO_ 970 1;
BA_ "GenMsgCycleTime" BO_ 970 100;
BA_ "GenMsgCycleTimeFast" BO_ 970 0;
BA_ "GenMsgSendType" BO_ 970 0;
BA_ "VFrameFormat" BO_ 970 14;
BA_ "CANFD_BRS" BO_ 970 1;
BA_ "GenMsgCycleTime" BO_ 970 100;
BA_ "GenMsgCycleTimeFast" BO_ 970 0;
BA_ "GenMsgSendType" BO_ 970 0;
BA_ "VFrameFormat" BO_ 970 14;
BA_ "CANFD_BRS" BO_ 970 1;
BA_ "GenMsgCycleTime" BO_ 970 100;
BA_ "GenMsgCycleTimeFast" BO_ 970 0;
BA_ "GenMsgSendType" BO_ 970 0;
BA_ "VFrameFormat" BO_ 970 14;
BA_ "CANFD_BRS" BO_ 970 1;
BA_ "GenMsgCycleTime" BO_ 970 100;
BA_ "GenMsgCycleTimeFast" BO_ 970 0;
BA_ "GenMsgSendType" BO_ 970 0;
BA_ "VFrameFormat" BO_ 970 14;
BA_ "CANFD_BRS" BO_ 970 1;
BA_ "GenMsgCycleTime" BO_ 970 100;
BA_ "GenMsgCycleTimeFast" BO_ 970 0;
BA_ "GenMsgSendType" BO_ 970 0;
BA_ "VFrameFormat" BO_ 970 14;
BA_ "CANFD_BRS" BO_ 970 1;
BA_ "GenMsgCycleTime" BO_ 970 100;
BA_ "GenMsgCycleTimeFast" BO_ 970 0;
BA_ "GenMsgSendType" BO_ 970 0;
BA_ "VFrameFormat" BO_ 970 14;
BA_ "CANFD_BRS" BO_ 970 1;
BA_ "GenMsgCycleTime" BO_ 970 100;
BA_ "GenMsgCycleTimeFast" BO_ 970 0;
BA_ "GenMsgSendType" BO_ 970 0;
BA_ "VFrameFormat" BO_ 970 14;
BA_ "CANFD_BRS" BO_ 970 1;
BA_ "GenMsgCycleTime" BO_ 970 100;
BA_ "GenMsgCycleTimeFast" BO_ 970 0;
BA_ "GenMsgSendType" BO_ 970 0;
BA_ "VFrameFormat" BO_ 970 14;
BA_ "CANFD_BRS" BO_ 970 1;
BA_ "EventCommandSignal" SG_ 419 ADC_4_CRC 0;
BA_ "GatewayedSignals" SG_ 419 ADC_4_CRC 0;
BA_ "GenSigInactiveValue" SG_ 419 ADC_4_CRC 0;
BA_ "GenSigInvalidValue" SG_ 419 ADC_4_CRC 0;
BA_ "GenSigSendType" SG_ 419 ADC_4_CRC 1;
BA_ "GenSigStartValue" SG_ 419 ADC_4_CRC 0;
BA_ "GenSigTimeoutValue" SG_ 419 ADC_4_CRC 0;
BA_ "Remark" SG_ 419 ADC_4_CRC "";
BA_ "EventCommandSignal" SG_ 419 ADC_4_Counter 0;
BA_ "GatewayedSignals" SG_ 419 ADC_4_Counter 0;
BA_ "GenSigInactiveValue" SG_ 419 ADC_4_Counter 0;
BA_ "GenSigInvalidValue" SG_ 419 ADC_4_Counter 0;
BA_ "GenSigSendType" SG_ 419 ADC_4_Counter 1;
BA_ "GenSigStartValue" SG_ 419 ADC_4_Counter 0;
BA_ "GenSigTimeoutValue" SG_ 419 ADC_4_Counter 0;
BA_ "Remark" SG_ 419 ADC_4_Counter "";
BA_ "EventCommandSignal" SG_ 419 ADC_AngReqSt_A 0;
BA_ "GatewayedSignals" SG_ 419 ADC_AngReqSt_A 0;
BA_ "GenSigInactiveValue" SG_ 419 ADC_AngReqSt_A 0;
BA_ "GenSigInvalidValue" SG_ 419 ADC_AngReqSt_A 0;
BA_ "GenSigSendType" SG_ 419 ADC_AngReqSt_A 1;
BA_ "GenSigStartValue" SG_ 419 ADC_AngReqSt_A 0;
BA_ "GenSigTimeoutValue" SG_ 419 ADC_AngReqSt_A 0;
BA_ "Remark" SG_ 419 ADC_AngReqSt_A "";
BA_ "EventCommandSignal" SG_ 419 ADC_AngReqFunction 0;
BA_ "GatewayedSignals" SG_ 419 ADC_AngReqFunction 0;
BA_ "GenSigInactiveValue" SG_ 419 ADC_AngReqFunction 0;
BA_ "GenSigInvalidValue" SG_ 419 ADC_AngReqFunction 0;
BA_ "GenSigSendType" SG_ 419 ADC_AngReqFunction 1;
BA_ "GenSigStartValue" SG_ 419 ADC_AngReqFunction 0;
BA_ "GenSigTimeoutValue" SG_ 419 ADC_AngReqFunction 0;
BA_ "Remark" SG_ 419 ADC_AngReqFunction "";
BA_ "EventCommandSignal" SG_ 419 ADC_BrakeLightReq 0;
BA_ "GatewayedSignals" SG_ 419 ADC_BrakeLightReq 0;
BA_ "GenSigInactiveValue" SG_ 419 ADC_BrakeLightReq 0;
BA_ "GenSigInvalidValue" SG_ 419 ADC_BrakeLightReq 0;
BA_ "GenSigSendType" SG_ 419 ADC_BrakeLightReq 1;
BA_ "GenSigStartValue" SG_ 419 ADC_BrakeLightReq 0;
BA_ "GenSigTimeoutValue" SG_ 419 ADC_BrakeLightReq 0;
BA_ "Remark" SG_ 419 ADC_BrakeLightReq "";
BA_ "EventCommandSignal" SG_ 419 ADC_StrAngleReq_A 0;
BA_ "GatewayedSignals" SG_ 419 ADC_StrAngleReq_A 0;
BA_ "GenSigInactiveValue" SG_ 419 ADC_StrAngleReq_A 0;
BA_ "GenSigInvalidValue" SG_ 419 ADC_StrAngleReq_A 65535;
BA_ "GenSigSendType" SG_ 419 ADC_StrAngleReq_A 1;
BA_ "GenSigStartValue" SG_ 419 ADC_StrAngleReq_A 7800;
BA_ "GenSigTimeoutValue" SG_ 419 ADC_StrAngleReq_A 65535;
BA_ "Remark" SG_ 419 ADC_StrAngleReq_A "";
BA_ "EventCommandSignal" SG_ 419 ADC_SACMotorTorLimExtMax_A 0;
BA_ "GatewayedSignals" SG_ 419 ADC_SACMotorTorLimExtMax_A 0;
BA_ "GenSigInactiveValue" SG_ 419 ADC_SACMotorTorLimExtMax_A 0;
BA_ "GenSigInvalidValue" SG_ 419 ADC_SACMotorTorLimExtMax_A 255;
BA_ "GenSigSendType" SG_ 419 ADC_SACMotorTorLimExtMax_A 1;
BA_ "GenSigStartValue" SG_ 419 ADC_SACMotorTorLimExtMax_A 254;
BA_ "GenSigTimeoutValue" SG_ 419 ADC_SACMotorTorLimExtMax_A 255;
BA_ "Remark" SG_ 419 ADC_SACMotorTorLimExtMax_A "";
BA_ "EventCommandSignal" SG_ 419 ADC_SACMotorTorLimExtMin_A 0;
BA_ "GatewayedSignals" SG_ 419 ADC_SACMotorTorLimExtMin_A 0;
BA_ "GenSigInactiveValue" SG_ 419 ADC_SACMotorTorLimExtMin_A 0;
BA_ "GenSigInvalidValue" SG_ 419 ADC_SACMotorTorLimExtMin_A 255;
BA_ "GenSigSendType" SG_ 419 ADC_SACMotorTorLimExtMin_A 1;
BA_ "GenSigStartValue" SG_ 419 ADC_SACMotorTorLimExtMin_A 0;
BA_ "GenSigTimeoutValue" SG_ 419 ADC_SACMotorTorLimExtMin_A 255;
BA_ "Remark" SG_ 419 ADC_SACMotorTorLimExtMin_A "";
BA_ "EventCommandSignal" SG_ 419 ADC_AssistParaSwitchReq 0;
BA_ "GatewayedSignals" SG_ 419 ADC_AssistParaSwitchReq 0;
BA_ "GenSigInactiveValue" SG_ 419 ADC_AssistParaSwitchReq 0;
BA_ "GenSigInvalidValue" SG_ 419 ADC_AssistParaSwitchReq 0;
BA_ "GenSigSendType" SG_ 419 ADC_AssistParaSwitchReq 1;
BA_ "GenSigStartValue" SG_ 419 ADC_AssistParaSwitchReq 0;
BA_ "GenSigTimeoutValue" SG_ 419 ADC_AssistParaSwitchReq 0;
BA_ "Remark" SG_ 419 ADC_AssistParaSwitchReq "";
BA_ "EventCommandSignal" SG_ 419 ADC_AngReqRdntReq_A 0;
BA_ "GatewayedSignals" SG_ 419 ADC_AngReqRdntReq_A 0;
BA_ "GenSigInactiveValue" SG_ 419 ADC_AngReqRdntReq_A 0;
BA_ "GenSigInvalidValue" SG_ 419 ADC_AngReqRdntReq_A 0;
BA_ "GenSigSendType" SG_ 419 ADC_AngReqRdntReq_A 1;
BA_ "GenSigStartValue" SG_ 419 ADC_AngReqRdntReq_A 0;
BA_ "GenSigTimeoutValue" SG_ 419 ADC_AngReqRdntReq_A 0;
BA_ "Remark" SG_ 419 ADC_AngReqRdntReq_A "";
BA_ "EventCommandSignal" SG_ 419 ADC_SteerGainReq 0;
BA_ "GatewayedSignals" SG_ 419 ADC_SteerGainReq 0;
BA_ "GenSigInactiveValue" SG_ 419 ADC_SteerGainReq 0;
BA_ "GenSigInvalidValue" SG_ 419 ADC_SteerGainReq 0;
BA_ "GenSigSendType" SG_ 419 ADC_SteerGainReq 1;
BA_ "GenSigStartValue" SG_ 419 ADC_SteerGainReq 0;
BA_ "GenSigTimeoutValue" SG_ 419 ADC_SteerGainReq 0;
BA_ "Remark" SG_ 419 ADC_SteerGainReq "";
BA_ "EventCommandSignal" SG_ 419 ADC_StrgWhlVibrWarnLevel 0;
BA_ "GatewayedSignals" SG_ 419 ADC_StrgWhlVibrWarnLevel 0;
BA_ "GenSigInactiveValue" SG_ 419 ADC_StrgWhlVibrWarnLevel 0;
BA_ "GenSigInvalidValue" SG_ 419 ADC_StrgWhlVibrWarnLevel 0;
BA_ "GenSigSendType" SG_ 419 ADC_StrgWhlVibrWarnLevel 1;
BA_ "GenSigStartValue" SG_ 419 ADC_StrgWhlVibrWarnLevel 0;
BA_ "GenSigTimeoutValue" SG_ 419 ADC_StrgWhlVibrWarnLevel 0;
BA_ "Remark" SG_ 419 ADC_StrgWhlVibrWarnLevel "";
BA_ "EventCommandSignal" SG_ 419 ADC_ActTrqReqEnable 0;
BA_ "GatewayedSignals" SG_ 419 ADC_ActTrqReqEnable 0;
BA_ "GenSigInactiveValue" SG_ 419 ADC_ActTrqReqEnable 0;
BA_ "GenSigInvalidValue" SG_ 419 ADC_ActTrqReqEnable 0;
BA_ "GenSigSendType" SG_ 419 ADC_ActTrqReqEnable 1;
BA_ "GenSigStartValue" SG_ 419 ADC_ActTrqReqEnable 0;
BA_ "GenSigTimeoutValue" SG_ 419 ADC_ActTrqReqEnable 0;
BA_ "Remark" SG_ 419 ADC_ActTrqReqEnable "";
BA_ "EventCommandSignal" SG_ 419 ADC_VLCSt 0;
BA_ "GatewayedSignals" SG_ 419 ADC_VLCSt 0;
BA_ "GenSigInactiveValue" SG_ 419 ADC_VLCSt 0;
BA_ "GenSigInvalidValue" SG_ 419 ADC_VLCSt 0;
BA_ "GenSigSendType" SG_ 419 ADC_VLCSt 1;
BA_ "GenSigStartValue" SG_ 419 ADC_VLCSt 0;
BA_ "GenSigTimeoutValue" SG_ 419 ADC_VLCSt 0;
BA_ "Remark" SG_ 419 ADC_VLCSt "";
BA_ "EventCommandSignal" SG_ 419 ADC_SteerGainLevel 0;
BA_ "GatewayedSignals" SG_ 419 ADC_SteerGainLevel 0;
BA_ "GenSigInactiveValue" SG_ 419 ADC_SteerGainLevel 0;
BA_ "GenSigInvalidValue" SG_ 419 ADC_SteerGainLevel 255;
BA_ "GenSigSendType" SG_ 419 ADC_SteerGainLevel 1;
BA_ "GenSigStartValue" SG_ 419 ADC_SteerGainLevel 0;
BA_ "GenSigTimeoutValue" SG_ 419 ADC_SteerGainLevel 100;
BA_ "Remark" SG_ 419 ADC_SteerGainLevel "";
BA_ "EventCommandSignal" SG_ 419 ADC_EvsSteerReq 0;
BA_ "GatewayedSignals" SG_ 419 ADC_EvsSteerReq 0;
BA_ "GenSigInactiveValue" SG_ 419 ADC_EvsSteerReq 0;
BA_ "GenSigInvalidValue" SG_ 419 ADC_EvsSteerReq 0;
BA_ "GenSigSendType" SG_ 419 ADC_EvsSteerReq 1;
BA_ "GenSigStartValue" SG_ 419 ADC_EvsSteerReq 0;
BA_ "GenSigTimeoutValue" SG_ 419 ADC_EvsSteerReq 0;
BA_ "Remark" SG_ 419 ADC_EvsSteerReq "";
BA_ "EventCommandSignal" SG_ 419 ADC_StrgWhlVibrWarnReq 0;
BA_ "GatewayedSignals" SG_ 419 ADC_StrgWhlVibrWarnReq 0;
BA_ "GenSigInactiveValue" SG_ 419 ADC_StrgWhlVibrWarnReq 0;
BA_ "GenSigInvalidValue" SG_ 419 ADC_StrgWhlVibrWarnReq 0;
BA_ "GenSigSendType" SG_ 419 ADC_StrgWhlVibrWarnReq 1;
BA_ "GenSigStartValue" SG_ 419 ADC_StrgWhlVibrWarnReq 0;
BA_ "GenSigTimeoutValue" SG_ 419 ADC_StrgWhlVibrWarnReq 0;
BA_ "Remark" SG_ 419 ADC_StrgWhlVibrWarnReq "";
BA_ "EventCommandSignal" SG_ 419 ADC_ActTrqReq 0;
BA_ "GatewayedSignals" SG_ 419 ADC_ActTrqReq 0;
BA_ "GenSigInactiveValue" SG_ 419 ADC_ActTrqReq 0;
BA_ "GenSigInvalidValue" SG_ 419 ADC_ActTrqReq 0;
BA_ "GenSigSendType" SG_ 419 ADC_ActTrqReq 1;
BA_ "GenSigStartValue" SG_ 419 ADC_ActTrqReq 0;
BA_ "GenSigTimeoutValue" SG_ 419 ADC_ActTrqReq 0;
BA_ "Remark" SG_ 419 ADC_ActTrqReq "";
BA_ "EventCommandSignal" SG_ 419 ADC_ADASLongCtrlFuncMode 0;
BA_ "GatewayedSignals" SG_ 419 ADC_ADASLongCtrlFuncMode 0;
BA_ "GenSigInactiveValue" SG_ 419 ADC_ADASLongCtrlFuncMode 0;
BA_ "GenSigInvalidValue" SG_ 419 ADC_ADASLongCtrlFuncMode 0;
BA_ "GenSigSendType" SG_ 419 ADC_ADASLongCtrlFuncMode 1;
BA_ "GenSigStartValue" SG_ 419 ADC_ADASLongCtrlFuncMode 0;
BA_ "GenSigTimeoutValue" SG_ 419 ADC_ADASLongCtrlFuncMode 0;
BA_ "Remark" SG_ 419 ADC_ADASLongCtrlFuncMode "";
BA_ "EventCommandSignal" SG_ 419 ADC_LongCtrlAvailability 0;
BA_ "GatewayedSignals" SG_ 419 ADC_LongCtrlAvailability 0;
BA_ "GenSigInactiveValue" SG_ 419 ADC_LongCtrlAvailability 0;
BA_ "GenSigInvalidValue" SG_ 419 ADC_LongCtrlAvailability 0;
BA_ "GenSigSendType" SG_ 419 ADC_LongCtrlAvailability 1;
BA_ "GenSigStartValue" SG_ 419 ADC_LongCtrlAvailability 0;
BA_ "GenSigTimeoutValue" SG_ 419 ADC_LongCtrlAvailability 0;
BA_ "Remark" SG_ 419 ADC_LongCtrlAvailability "";
BA_ "EventCommandSignal" SG_ 419 ADC_LongCtrlModeForBrkSys 0;
BA_ "GatewayedSignals" SG_ 419 ADC_LongCtrlModeForBrkSys 0;
BA_ "GenSigInactiveValue" SG_ 419 ADC_LongCtrlModeForBrkSys 0;
BA_ "GenSigInvalidValue" SG_ 419 ADC_LongCtrlModeForBrkSys 0;
BA_ "GenSigSendType" SG_ 419 ADC_LongCtrlModeForBrkSys 1;
BA_ "GenSigStartValue" SG_ 419 ADC_LongCtrlModeForBrkSys 0;
BA_ "GenSigTimeoutValue" SG_ 419 ADC_LongCtrlModeForBrkSys 0;
BA_ "Remark" SG_ 419 ADC_LongCtrlModeForBrkSys "";
BA_ "EventCommandSignal" SG_ 419 IFC_DPTst 0;
BA_ "GatewayedSignals" SG_ 419 IFC_DPTst 0;
BA_ "GenSigInactiveValue" SG_ 419 IFC_DPTst 0;
BA_ "GenSigInvalidValue" SG_ 419 IFC_DPTst 0;
BA_ "GenSigSendType" SG_ 419 IFC_DPTst 1;
BA_ "GenSigStartValue" SG_ 419 IFC_DPTst 0;
BA_ "GenSigTimeoutValue" SG_ 419 IFC_DPTst 0;
BA_ "Remark" SG_ 419 IFC_DPTst "";
BA_ "EventCommandSignal" SG_ 419 ADC_DrvTarTqMod2EPB 0;
BA_ "GatewayedSignals" SG_ 419 ADC_DrvTarTqMod2EPB 0;
BA_ "GenSigInactiveValue" SG_ 419 ADC_DrvTarTqMod2EPB 0;
BA_ "GenSigInvalidValue" SG_ 419 ADC_DrvTarTqMod2EPB 0;
BA_ "GenSigSendType" SG_ 419 ADC_DrvTarTqMod2EPB 1;
BA_ "GenSigStartValue" SG_ 419 ADC_DrvTarTqMod2EPB 0;
BA_ "GenSigTimeoutValue" SG_ 419 ADC_DrvTarTqMod2EPB 0;
BA_ "Remark" SG_ 419 ADC_DrvTarTqMod2EPB "";
BA_ "EventCommandSignal" SG_ 419 ADC_LongCtrlTargetAxReq 0;
BA_ "GatewayedSignals" SG_ 419 ADC_LongCtrlTargetAxReq 0;
BA_ "GenSigInactiveValue" SG_ 419 ADC_LongCtrlTargetAxReq 0;
BA_ "GenSigInvalidValue" SG_ 419 ADC_LongCtrlTargetAxReq 0;
BA_ "GenSigSendType" SG_ 419 ADC_LongCtrlTargetAxReq 1;
BA_ "GenSigStartValue" SG_ 419 ADC_LongCtrlTargetAxReq 0;
BA_ "GenSigTimeoutValue" SG_ 419 ADC_LongCtrlTargetAxReq 0;
BA_ "Remark" SG_ 419 ADC_LongCtrlTargetAxReq "";
BA_ "EventCommandSignal" SG_ 419 ADC_LongCtrlTypReq 0;
BA_ "GatewayedSignals" SG_ 419 ADC_LongCtrlTypReq 0;
BA_ "GenSigInactiveValue" SG_ 419 ADC_LongCtrlTypReq 0;
BA_ "GenSigInvalidValue" SG_ 419 ADC_LongCtrlTypReq 0;
BA_ "GenSigSendType" SG_ 419 ADC_LongCtrlTypReq 1;
BA_ "GenSigStartValue" SG_ 419 ADC_LongCtrlTypReq 0;
BA_ "GenSigTimeoutValue" SG_ 419 ADC_LongCtrlTypReq 0;
BA_ "Remark" SG_ 419 ADC_LongCtrlTypReq "";
BA_ "EventCommandSignal" SG_ 419 ADC_LongCtrlDecToStopReq 0;
BA_ "GatewayedSignals" SG_ 419 ADC_LongCtrlDecToStopReq 0;
BA_ "GenSigInactiveValue" SG_ 419 ADC_LongCtrlDecToStopReq 0;
BA_ "GenSigInvalidValue" SG_ 419 ADC_LongCtrlDecToStopReq 0;
BA_ "GenSigSendType" SG_ 419 ADC_LongCtrlDecToStopReq 1;
BA_ "GenSigStartValue" SG_ 419 ADC_LongCtrlDecToStopReq 0;
BA_ "GenSigTimeoutValue" SG_ 419 ADC_LongCtrlDecToStopReq 0;
BA_ "Remark" SG_ 419 ADC_LongCtrlDecToStopReq "";
BA_ "EventCommandSignal" SG_ 419 ADC_LongCtrlDriveOff 0;
BA_ "GatewayedSignals" SG_ 419 ADC_LongCtrlDriveOff 0;
BA_ "GenSigInactiveValue" SG_ 419 ADC_LongCtrlDriveOff 0;
BA_ "GenSigInvalidValue" SG_ 419 ADC_LongCtrlDriveOff 0;
BA_ "GenSigSendType" SG_ 419 ADC_LongCtrlDriveOff 1;
BA_ "GenSigStartValue" SG_ 419 ADC_LongCtrlDriveOff 0;
BA_ "GenSigTimeoutValue" SG_ 419 ADC_LongCtrlDriveOff 0;
BA_ "Remark" SG_ 419 ADC_LongCtrlDriveOff "";
BA_ "EventCommandSignal" SG_ 419 ADC_LongctrlSecureReq 0;
BA_ "GatewayedSignals" SG_ 419 ADC_LongctrlSecureReq 0;
BA_ "GenSigInactiveValue" SG_ 419 ADC_LongctrlSecureReq 0;
BA_ "GenSigInvalidValue" SG_ 419 ADC_LongctrlSecureReq 0;
BA_ "GenSigSendType" SG_ 419 ADC_LongctrlSecureReq 1;
BA_ "GenSigStartValue" SG_ 419 ADC_LongctrlSecureReq 0;
BA_ "GenSigTimeoutValue" SG_ 419 ADC_LongctrlSecureReq 0;
BA_ "Remark" SG_ 419 ADC_LongctrlSecureReq "";
BA_ "EventCommandSignal" SG_ 419 ADC_ShifttoAVHReq 0;
BA_ "GatewayedSignals" SG_ 419 ADC_ShifttoAVHReq 0;
BA_ "GenSigInactiveValue" SG_ 419 ADC_ShifttoAVHReq 0;
BA_ "GenSigInvalidValue" SG_ 419 ADC_ShifttoAVHReq 0;
BA_ "GenSigSendType" SG_ 419 ADC_ShifttoAVHReq 1;
BA_ "GenSigStartValue" SG_ 419 ADC_ShifttoAVHReq 0;
BA_ "GenSigTimeoutValue" SG_ 419 ADC_ShifttoAVHReq 0;
BA_ "Remark" SG_ 419 ADC_ShifttoAVHReq "";
BA_ "EventCommandSignal" SG_ 419 ADC_LongCtrlTargetAx 0;
BA_ "GatewayedSignals" SG_ 419 ADC_LongCtrlTargetAx 0;
BA_ "GenSigInactiveValue" SG_ 419 ADC_LongCtrlTargetAx 0;
BA_ "GenSigInvalidValue" SG_ 419 ADC_LongCtrlTargetAx 0;
BA_ "GenSigSendType" SG_ 419 ADC_LongCtrlTargetAx 1;
BA_ "GenSigStartValue" SG_ 419 ADC_LongCtrlTargetAx 0;
BA_ "GenSigTimeoutValue" SG_ 419 ADC_LongCtrlTargetAx 0;
BA_ "Remark" SG_ 419 ADC_LongCtrlTargetAx "";
BA_ "EventCommandSignal" SG_ 419 ADC_TrkTargt0St 0;
BA_ "GatewayedSignals" SG_ 419 ADC_TrkTargt0St 0;
BA_ "GenSigInactiveValue" SG_ 419 ADC_TrkTargt0St 0;
BA_ "GenSigInvalidValue" SG_ 419 ADC_TrkTargt0St 0;
BA_ "GenSigSendType" SG_ 419 ADC_TrkTargt0St 1;
BA_ "GenSigStartValue" SG_ 419 ADC_TrkTargt0St 0;
BA_ "GenSigTimeoutValue" SG_ 419 ADC_TrkTargt0St 0;
BA_ "Remark" SG_ 419 ADC_TrkTargt0St "";
BA_ "EventCommandSignal" SG_ 419 ADC_TrkTargt0longPos 0;
BA_ "GatewayedSignals" SG_ 419 ADC_TrkTargt0longPos 0;
BA_ "GenSigInactiveValue" SG_ 419 ADC_TrkTargt0longPos 0;
BA_ "GenSigInvalidValue" SG_ 419 ADC_TrkTargt0longPos 1023;
BA_ "GenSigSendType" SG_ 419 ADC_TrkTargt0longPos 1;
BA_ "GenSigStartValue" SG_ 419 ADC_TrkTargt0longPos 0;
BA_ "GenSigTimeoutValue" SG_ 419 ADC_TrkTargt0longPos 0;
BA_ "Remark" SG_ 419 ADC_TrkTargt0longPos "";
BA_ "EventCommandSignal" SG_ 419 ADC_TrkTargt0latPos 0;
BA_ "GatewayedSignals" SG_ 419 ADC_TrkTargt0latPos 0;
BA_ "GenSigInactiveValue" SG_ 419 ADC_TrkTargt0latPos 0;
BA_ "GenSigInvalidValue" SG_ 419 ADC_TrkTargt0latPos 0;
BA_ "GenSigSendType" SG_ 419 ADC_TrkTargt0latPos 1;
BA_ "GenSigStartValue" SG_ 419 ADC_TrkTargt0latPos 512;
BA_ "GenSigTimeoutValue" SG_ 419 ADC_TrkTargt0latPos 0;
BA_ "Remark" SG_ 419 ADC_TrkTargt0latPos "";
BA_ "EventCommandSignal" SG_ 419 ADC_TrkTargt0LatRelSpd 0;
BA_ "GatewayedSignals" SG_ 419 ADC_TrkTargt0LatRelSpd 0;
BA_ "GenSigInactiveValue" SG_ 419 ADC_TrkTargt0LatRelSpd 0;
BA_ "GenSigInvalidValue" SG_ 419 ADC_TrkTargt0LatRelSpd 511;
BA_ "GenSigSendType" SG_ 419 ADC_TrkTargt0LatRelSpd 1;
BA_ "GenSigStartValue" SG_ 419 ADC_TrkTargt0LatRelSpd 0;
BA_ "GenSigTimeoutValue" SG_ 419 ADC_TrkTargt0LatRelSpd 0;
BA_ "Remark" SG_ 419 ADC_TrkTargt0LatRelSpd "";
BA_ "EventCommandSignal" SG_ 419 ADC_TrkTargt0LongRelSpd 0;
BA_ "GatewayedSignals" SG_ 419 ADC_TrkTargt0LongRelSpd 0;
BA_ "GenSigInactiveValue" SG_ 419 ADC_TrkTargt0LongRelSpd 0;
BA_ "GenSigInvalidValue" SG_ 419 ADC_TrkTargt0LongRelSpd 0;
BA_ "GenSigSendType" SG_ 419 ADC_TrkTargt0LongRelSpd 1;
BA_ "GenSigStartValue" SG_ 419 ADC_TrkTargt0LongRelSpd 0;
BA_ "GenSigTimeoutValue" SG_ 419 ADC_TrkTargt0LongRelSpd 0;
BA_ "Remark" SG_ 419 ADC_TrkTargt0LongRelSpd "";
BA_ "EventCommandSignal" SG_ 419 ADC_AS_pauseReq 0;
BA_ "GatewayedSignals" SG_ 419 ADC_AS_pauseReq 0;
BA_ "GenSigInactiveValue" SG_ 419 ADC_AS_pauseReq 0;
BA_ "GenSigInvalidValue" SG_ 419 ADC_AS_pauseReq 0;
BA_ "GenSigSendType" SG_ 419 ADC_AS_pauseReq 1;
BA_ "GenSigStartValue" SG_ 419 ADC_AS_pauseReq 0;
BA_ "GenSigTimeoutValue" SG_ 419 ADC_AS_pauseReq 0;
BA_ "Remark" SG_ 419 ADC_AS_pauseReq "";
BA_ "EventCommandSignal" SG_ 419 ADC_AS_calibrationReq 0;
BA_ "GatewayedSignals" SG_ 419 ADC_AS_calibrationReq 0;
BA_ "GenSigInactiveValue" SG_ 419 ADC_AS_calibrationReq 0;
BA_ "GenSigInvalidValue" SG_ 419 ADC_AS_calibrationReq 0;
BA_ "GenSigSendType" SG_ 419 ADC_AS_calibrationReq 1;
BA_ "GenSigStartValue" SG_ 419 ADC_AS_calibrationReq 0;
BA_ "GenSigTimeoutValue" SG_ 419 ADC_AS_calibrationReq 0;
BA_ "Remark" SG_ 419 ADC_AS_calibrationReq "";
BA_ "EventCommandSignal" SG_ 419 ADC_AS_exitcurrentlevelReq 0;
BA_ "GatewayedSignals" SG_ 419 ADC_AS_exitcurrentlevelReq 0;
BA_ "GenSigInactiveValue" SG_ 419 ADC_AS_exitcurrentlevelReq 0;
BA_ "GenSigInvalidValue" SG_ 419 ADC_AS_exitcurrentlevelReq 0;
BA_ "GenSigSendType" SG_ 419 ADC_AS_exitcurrentlevelReq 1;
BA_ "GenSigStartValue" SG_ 419 ADC_AS_exitcurrentlevelReq 0;
BA_ "GenSigTimeoutValue" SG_ 419 ADC_AS_exitcurrentlevelReq 0;
BA_ "Remark" SG_ 419 ADC_AS_exitcurrentlevelReq "";
BA_ "EventCommandSignal" SG_ 419 ADC_AS_ReqToadjust 0;
BA_ "GatewayedSignals" SG_ 419 ADC_AS_ReqToadjust 0;
BA_ "GenSigInactiveValue" SG_ 419 ADC_AS_ReqToadjust 0;
BA_ "GenSigInvalidValue" SG_ 419 ADC_AS_ReqToadjust 0;
BA_ "GenSigSendType" SG_ 419 ADC_AS_ReqToadjust 1;
BA_ "GenSigStartValue" SG_ 419 ADC_AS_ReqToadjust 0;
BA_ "GenSigTimeoutValue" SG_ 419 ADC_AS_ReqToadjust 0;
BA_ "Remark" SG_ 419 ADC_AS_ReqToadjust "";
BA_ "EventCommandSignal" SG_ 419 ADC_AS_UnsafelevelunableReq 0;
BA_ "GatewayedSignals" SG_ 419 ADC_AS_UnsafelevelunableReq 0;
BA_ "GenSigInactiveValue" SG_ 419 ADC_AS_UnsafelevelunableReq 0;
BA_ "GenSigInvalidValue" SG_ 419 ADC_AS_UnsafelevelunableReq 0;
BA_ "GenSigSendType" SG_ 419 ADC_AS_UnsafelevelunableReq 1;
BA_ "GenSigStartValue" SG_ 419 ADC_AS_UnsafelevelunableReq 0;
BA_ "GenSigTimeoutValue" SG_ 419 ADC_AS_UnsafelevelunableReq 0;
BA_ "Remark" SG_ 419 ADC_AS_UnsafelevelunableReq "";
BA_ "EventCommandSignal" SG_ 419 ADC_AEBTargetDecel 0;
BA_ "GatewayedSignals" SG_ 419 ADC_AEBTargetDecel 0;
BA_ "GenSigInactiveValue" SG_ 419 ADC_AEBTargetDecel 0;
BA_ "GenSigInvalidValue" SG_ 419 ADC_AEBTargetDecel 0;
BA_ "GenSigSendType" SG_ 419 ADC_AEBTargetDecel 1;
BA_ "GenSigStartValue" SG_ 419 ADC_AEBTargetDecel 0;
BA_ "GenSigTimeoutValue" SG_ 419 ADC_AEBTargetDecel 0;
BA_ "Remark" SG_ 419 ADC_AEBTargetDecel "";
BA_ "EventCommandSignal" SG_ 419 ADC_AEBFaultSt 0;
BA_ "GatewayedSignals" SG_ 419 ADC_AEBFaultSt 0;
BA_ "GenSigInactiveValue" SG_ 419 ADC_AEBFaultSt 0;
BA_ "GenSigInvalidValue" SG_ 419 ADC_AEBFaultSt 0;
BA_ "GenSigSendType" SG_ 419 ADC_AEBFaultSt 1;
BA_ "GenSigStartValue" SG_ 419 ADC_AEBFaultSt 0;
BA_ "GenSigTimeoutValue" SG_ 419 ADC_AEBFaultSt 1;
BA_ "Remark" SG_ 419 ADC_AEBFaultSt "";
BA_ "EventCommandSignal" SG_ 419 ADC_AEBOffSt 0;
BA_ "GatewayedSignals" SG_ 419 ADC_AEBOffSt 0;
BA_ "GenSigInactiveValue" SG_ 419 ADC_AEBOffSt 0;
BA_ "GenSigInvalidValue" SG_ 419 ADC_AEBOffSt 0;
BA_ "GenSigSendType" SG_ 419 ADC_AEBOffSt 1;
BA_ "GenSigStartValue" SG_ 419 ADC_AEBOffSt 0;
BA_ "GenSigTimeoutValue" SG_ 419 ADC_AEBOffSt 1;
BA_ "Remark" SG_ 419 ADC_AEBOffSt "";
BA_ "EventCommandSignal" SG_ 419 ADC_AEBInterventionSt 0;
BA_ "GatewayedSignals" SG_ 419 ADC_AEBInterventionSt 0;
BA_ "GenSigInactiveValue" SG_ 419 ADC_AEBInterventionSt 0;
BA_ "GenSigInvalidValue" SG_ 419 ADC_AEBInterventionSt 0;
BA_ "GenSigSendType" SG_ 419 ADC_AEBInterventionSt 1;
BA_ "GenSigStartValue" SG_ 419 ADC_AEBInterventionSt 0;
BA_ "GenSigTimeoutValue" SG_ 419 ADC_AEBInterventionSt 0;
BA_ "Remark" SG_ 419 ADC_AEBInterventionSt "";
BA_ "EventCommandSignal" SG_ 419 ADC_AEBDecelCtrlReq 0;
BA_ "GatewayedSignals" SG_ 419 ADC_AEBDecelCtrlReq 0;
BA_ "GenSigInactiveValue" SG_ 419 ADC_AEBDecelCtrlReq 0;
BA_ "GenSigInvalidValue" SG_ 419 ADC_AEBDecelCtrlReq 0;
BA_ "GenSigSendType" SG_ 419 ADC_AEBDecelCtrlReq 1;
BA_ "GenSigStartValue" SG_ 419 ADC_AEBDecelCtrlReq 0;
BA_ "GenSigTimeoutValue" SG_ 419 ADC_AEBDecelCtrlReq 0;
BA_ "Remark" SG_ 419 ADC_AEBDecelCtrlReq "";
BA_ "EventCommandSignal" SG_ 419 ADC_AEBLVehHoldReq 0;
BA_ "GatewayedSignals" SG_ 419 ADC_AEBLVehHoldReq 0;
BA_ "GenSigInactiveValue" SG_ 419 ADC_AEBLVehHoldReq 0;
BA_ "GenSigInvalidValue" SG_ 419 ADC_AEBLVehHoldReq 0;
BA_ "GenSigSendType" SG_ 419 ADC_AEBLVehHoldReq 1;
BA_ "GenSigStartValue" SG_ 419 ADC_AEBLVehHoldReq 0;
BA_ "GenSigTimeoutValue" SG_ 419 ADC_AEBLVehHoldReq 0;
BA_ "Remark" SG_ 419 ADC_AEBLVehHoldReq "";
BA_ "EventCommandSignal" SG_ 419 ADC_ABAReq 0;
BA_ "GatewayedSignals" SG_ 419 ADC_ABAReq 0;
BA_ "GenSigInactiveValue" SG_ 419 ADC_ABAReq 0;
BA_ "GenSigInvalidValue" SG_ 419 ADC_ABAReq 0;
BA_ "GenSigSendType" SG_ 419 ADC_ABAReq 1;
BA_ "GenSigStartValue" SG_ 419 ADC_ABAReq 0;
BA_ "GenSigTimeoutValue" SG_ 419 ADC_ABAReq 0;
BA_ "Remark" SG_ 419 ADC_ABAReq "";
BA_ "EventCommandSignal" SG_ 419 ADC_ABALevel 0;
BA_ "GatewayedSignals" SG_ 419 ADC_ABALevel 0;
BA_ "GenSigInactiveValue" SG_ 419 ADC_ABALevel 0;
BA_ "GenSigInvalidValue" SG_ 419 ADC_ABALevel 0;
BA_ "GenSigSendType" SG_ 419 ADC_ABALevel 1;
BA_ "GenSigStartValue" SG_ 419 ADC_ABALevel 0;
BA_ "GenSigTimeoutValue" SG_ 419 ADC_ABALevel 0;
BA_ "Remark" SG_ 419 ADC_ABALevel "";
BA_ "EventCommandSignal" SG_ 419 ADC_AWBReq 0;
BA_ "GatewayedSignals" SG_ 419 ADC_AWBReq 0;
BA_ "GenSigInactiveValue" SG_ 419 ADC_AWBReq 0;
BA_ "GenSigInvalidValue" SG_ 419 ADC_AWBReq 0;
BA_ "GenSigSendType" SG_ 419 ADC_AWBReq 1;
BA_ "GenSigStartValue" SG_ 419 ADC_AWBReq 0;
BA_ "GenSigTimeoutValue" SG_ 419 ADC_AWBReq 0;
BA_ "Remark" SG_ 419 ADC_AWBReq "";
BA_ "EventCommandSignal" SG_ 419 ADC_ABPReq 0;
BA_ "GatewayedSignals" SG_ 419 ADC_ABPReq 0;
BA_ "GenSigInactiveValue" SG_ 419 ADC_ABPReq 0;
BA_ "GenSigInvalidValue" SG_ 419 ADC_ABPReq 0;
BA_ "GenSigSendType" SG_ 419 ADC_ABPReq 1;
BA_ "GenSigStartValue" SG_ 419 ADC_ABPReq 0;
BA_ "GenSigTimeoutValue" SG_ 419 ADC_ABPReq 0;
BA_ "Remark" SG_ 419 ADC_ABPReq "";
BA_ "EventCommandSignal" SG_ 419 ADC_AWBLevel 0;
BA_ "GatewayedSignals" SG_ 419 ADC_AWBLevel 0;
BA_ "GenSigInactiveValue" SG_ 419 ADC_AWBLevel 0;
BA_ "GenSigInvalidValue" SG_ 419 ADC_AWBLevel 0;
BA_ "GenSigSendType" SG_ 419 ADC_AWBLevel 1;
BA_ "GenSigStartValue" SG_ 419 ADC_AWBLevel 0;
BA_ "GenSigTimeoutValue" SG_ 419 ADC_AWBLevel 0;
BA_ "Remark" SG_ 419 ADC_AWBLevel "";
BA_ "EventCommandSignal" SG_ 419 ADC_AEBTarCalss 0;
BA_ "GatewayedSignals" SG_ 419 ADC_AEBTarCalss 0;
BA_ "GenSigInactiveValue" SG_ 419 ADC_AEBTarCalss 0;
BA_ "GenSigInvalidValue" SG_ 419 ADC_AEBTarCalss 0;
BA_ "GenSigSendType" SG_ 419 ADC_AEBTarCalss 1;
BA_ "GenSigStartValue" SG_ 419 ADC_AEBTarCalss 0;
BA_ "GenSigTimeoutValue" SG_ 419 ADC_AEBTarCalss 0;
BA_ "Remark" SG_ 419 ADC_AEBTarCalss "";
BA_ "EventCommandSignal" SG_ 419 ADC_AEBTarDetSensor 0;
BA_ "GatewayedSignals" SG_ 419 ADC_AEBTarDetSensor 0;
BA_ "GenSigInactiveValue" SG_ 419 ADC_AEBTarDetSensor 0;
BA_ "GenSigInvalidValue" SG_ 419 ADC_AEBTarDetSensor 0;
BA_ "GenSigSendType" SG_ 419 ADC_AEBTarDetSensor 1;
BA_ "GenSigStartValue" SG_ 419 ADC_AEBTarDetSensor 0;
BA_ "GenSigTimeoutValue" SG_ 419 ADC_AEBTarDetSensor 0;
BA_ "Remark" SG_ 419 ADC_AEBTarDetSensor "";
BA_ "EventCommandSignal" SG_ 419 ADC_TurnLightReq 0;
BA_ "GatewayedSignals" SG_ 419 ADC_TurnLightReq 0;
BA_ "GenSigInactiveValue" SG_ 419 ADC_TurnLightReq 0;
BA_ "GenSigInvalidValue" SG_ 419 ADC_TurnLightReq 0;
BA_ "GenSigSendType" SG_ 419 ADC_TurnLightReq 1;
BA_ "GenSigStartValue" SG_ 419 ADC_TurnLightReq 0;
BA_ "GenSigTimeoutValue" SG_ 419 ADC_TurnLightReq 0;
BA_ "Remark" SG_ 419 ADC_TurnLightReq "";
BA_ "EventCommandSignal" SG_ 419 ADC_PAA2ESPAxReqEnable 0;
BA_ "GatewayedSignals" SG_ 419 ADC_PAA2ESPAxReqEnable 0;
BA_ "GenSigInactiveValue" SG_ 419 ADC_PAA2ESPAxReqEnable 0;
BA_ "GenSigInvalidValue" SG_ 419 ADC_PAA2ESPAxReqEnable 0;
BA_ "GenSigSendType" SG_ 419 ADC_PAA2ESPAxReqEnable 1;
BA_ "GenSigStartValue" SG_ 419 ADC_PAA2ESPAxReqEnable 0;
BA_ "GenSigTimeoutValue" SG_ 419 ADC_PAA2ESPAxReqEnable 0;
BA_ "Remark" SG_ 419 ADC_PAA2ESPAxReqEnable "";
BA_ "EventCommandSignal" SG_ 419 ADC_PAA2ESPBrakeFunctionMode 0;
BA_ "GatewayedSignals" SG_ 419 ADC_PAA2ESPBrakeFunctionMode 0;
BA_ "GenSigInactiveValue" SG_ 419 ADC_PAA2ESPBrakeFunctionMode 0;
BA_ "GenSigInvalidValue" SG_ 419 ADC_PAA2ESPBrakeFunctionMode 0;
BA_ "GenSigSendType" SG_ 419 ADC_PAA2ESPBrakeFunctionMode 1;
BA_ "GenSigStartValue" SG_ 419 ADC_PAA2ESPBrakeFunctionMode 0;
BA_ "GenSigTimeoutValue" SG_ 419 ADC_PAA2ESPBrakeFunctionMode 0;
BA_ "Remark" SG_ 419 ADC_PAA2ESPBrakeFunctionMode "";
BA_ "EventCommandSignal" SG_ 419 ADC_PAA2ESPEpbReq 0;
BA_ "GatewayedSignals" SG_ 419 ADC_PAA2ESPEpbReq 0;
BA_ "GenSigInactiveValue" SG_ 419 ADC_PAA2ESPEpbReq 0;
BA_ "GenSigInvalidValue" SG_ 419 ADC_PAA2ESPEpbReq 0;
BA_ "GenSigSendType" SG_ 419 ADC_PAA2ESPEpbReq 1;
BA_ "GenSigStartValue" SG_ 419 ADC_PAA2ESPEpbReq 0;
BA_ "GenSigTimeoutValue" SG_ 419 ADC_PAA2ESPEpbReq 0;
BA_ "Remark" SG_ 419 ADC_PAA2ESPEpbReq "";
BA_ "EventCommandSignal" SG_ 419 ADC_PAA2ESPEpbReqSt 0;
BA_ "GatewayedSignals" SG_ 419 ADC_PAA2ESPEpbReqSt 0;
BA_ "GenSigInactiveValue" SG_ 419 ADC_PAA2ESPEpbReqSt 0;
BA_ "GenSigInvalidValue" SG_ 419 ADC_PAA2ESPEpbReqSt 0;
BA_ "GenSigSendType" SG_ 419 ADC_PAA2ESPEpbReqSt 1;
BA_ "GenSigStartValue" SG_ 419 ADC_PAA2ESPEpbReqSt 0;
BA_ "GenSigTimeoutValue" SG_ 419 ADC_PAA2ESPEpbReqSt 0;
BA_ "Remark" SG_ 419 ADC_PAA2ESPEpbReqSt "";
BA_ "EventCommandSignal" SG_ 419 ADC_PAA2EPBEpbReq 0;
BA_ "GatewayedSignals" SG_ 419 ADC_PAA2EPBEpbReq 0;
BA_ "GenSigInactiveValue" SG_ 419 ADC_PAA2EPBEpbReq 0;
BA_ "GenSigInvalidValue" SG_ 419 ADC_PAA2EPBEpbReq 0;
BA_ "GenSigSendType" SG_ 419 ADC_PAA2EPBEpbReq 1;
BA_ "GenSigStartValue" SG_ 419 ADC_PAA2EPBEpbReq 0;
BA_ "GenSigTimeoutValue" SG_ 419 ADC_PAA2EPBEpbReq 0;
BA_ "Remark" SG_ 419 ADC_PAA2EPBEpbReq "";
BA_ "EventCommandSignal" SG_ 419 ADC_ESPSwitchReq 0;
BA_ "GatewayedSignals" SG_ 419 ADC_ESPSwitchReq 0;
BA_ "GenSigInactiveValue" SG_ 419 ADC_ESPSwitchReq 0;
BA_ "GenSigInvalidValue" SG_ 419 ADC_ESPSwitchReq 0;
BA_ "GenSigSendType" SG_ 419 ADC_ESPSwitchReq 1;
BA_ "GenSigStartValue" SG_ 419 ADC_ESPSwitchReq 0;
BA_ "GenSigTimeoutValue" SG_ 419 ADC_ESPSwitchReq 0;
BA_ "Remark" SG_ 419 ADC_ESPSwitchReq "";
BA_ "EventCommandSignal" SG_ 419 ADC_PAA2EPBEpbReqSt 0;
BA_ "GatewayedSignals" SG_ 419 ADC_PAA2EPBEpbReqSt 0;
BA_ "GenSigInactiveValue" SG_ 419 ADC_PAA2EPBEpbReqSt 0;
BA_ "GenSigInvalidValue" SG_ 419 ADC_PAA2EPBEpbReqSt 0;
BA_ "GenSigSendType" SG_ 419 ADC_PAA2EPBEpbReqSt 1;
BA_ "GenSigStartValue" SG_ 419 ADC_PAA2EPBEpbReqSt 0;
BA_ "GenSigTimeoutValue" SG_ 419 ADC_PAA2EPBEpbReqSt 0;
BA_ "Remark" SG_ 419 ADC_PAA2EPBEpbReqSt "";
BA_ "EventCommandSignal" SG_ 419 ADC_PAA2EPBBrakeFunctionMode 0;
BA_ "GatewayedSignals" SG_ 419 ADC_PAA2EPBBrakeFunctionMode 0;
BA_ "GenSigInactiveValue" SG_ 419 ADC_PAA2EPBBrakeFunctionMode 0;
BA_ "GenSigInvalidValue" SG_ 419 ADC_PAA2EPBBrakeFunctionMode 0;
BA_ "GenSigSendType" SG_ 419 ADC_PAA2EPBBrakeFunctionMode 1;
BA_ "GenSigStartValue" SG_ 419 ADC_PAA2EPBBrakeFunctionMode 0;
BA_ "GenSigTimeoutValue" SG_ 419 ADC_PAA2EPBBrakeFunctionMode 0;
BA_ "Remark" SG_ 419 ADC_PAA2EPBBrakeFunctionMode "";
BA_ "EventCommandSignal" SG_ 419 ADC_PAA2ESPApEmgyBrkReq 0;
BA_ "GatewayedSignals" SG_ 419 ADC_PAA2ESPApEmgyBrkReq 0;
BA_ "GenSigInactiveValue" SG_ 419 ADC_PAA2ESPApEmgyBrkReq 0;
BA_ "GenSigInvalidValue" SG_ 419 ADC_PAA2ESPApEmgyBrkReq 0;
BA_ "GenSigSendType" SG_ 419 ADC_PAA2ESPApEmgyBrkReq 1;
BA_ "GenSigStartValue" SG_ 419 ADC_PAA2ESPApEmgyBrkReq 0;
BA_ "GenSigTimeoutValue" SG_ 419 ADC_PAA2ESPApEmgyBrkReq 0;
BA_ "Remark" SG_ 419 ADC_PAA2ESPApEmgyBrkReq "";
BA_ "EventCommandSignal" SG_ 419 ADC_PAA2ESPComfBrakeReq 0;
BA_ "GatewayedSignals" SG_ 419 ADC_PAA2ESPComfBrakeReq 0;
BA_ "GenSigInactiveValue" SG_ 419 ADC_PAA2ESPComfBrakeReq 0;
BA_ "GenSigInvalidValue" SG_ 419 ADC_PAA2ESPComfBrakeReq 0;
BA_ "GenSigSendType" SG_ 419 ADC_PAA2ESPComfBrakeReq 1;
BA_ "GenSigStartValue" SG_ 419 ADC_PAA2ESPComfBrakeReq 0;
BA_ "GenSigTimeoutValue" SG_ 419 ADC_PAA2ESPComfBrakeReq 0;
BA_ "Remark" SG_ 419 ADC_PAA2ESPComfBrakeReq "";
BA_ "EventCommandSignal" SG_ 419 ADC_PAA2ESPApDriveOffReq 0;
BA_ "GatewayedSignals" SG_ 419 ADC_PAA2ESPApDriveOffReq 0;
BA_ "GenSigInactiveValue" SG_ 419 ADC_PAA2ESPApDriveOffReq 0;
BA_ "GenSigInvalidValue" SG_ 419 ADC_PAA2ESPApDriveOffReq 0;
BA_ "GenSigSendType" SG_ 419 ADC_PAA2ESPApDriveOffReq 1;
BA_ "GenSigStartValue" SG_ 419 ADC_PAA2ESPApDriveOffReq 0;
BA_ "GenSigTimeoutValue" SG_ 419 ADC_PAA2ESPApDriveOffReq 0;
BA_ "Remark" SG_ 419 ADC_PAA2ESPApDriveOffReq "";
BA_ "EventCommandSignal" SG_ 419 ADC_AEBObjectTTC 0;
BA_ "GatewayedSignals" SG_ 419 ADC_AEBObjectTTC 0;
BA_ "GenSigInactiveValue" SG_ 419 ADC_AEBObjectTTC 0;
BA_ "GenSigInvalidValue" SG_ 419 ADC_AEBObjectTTC 510;
BA_ "GenSigSendType" SG_ 419 ADC_AEBObjectTTC 1;
BA_ "GenSigStartValue" SG_ 419 ADC_AEBObjectTTC 501;
BA_ "GenSigTimeoutValue" SG_ 419 ADC_AEBObjectTTC 510;
BA_ "Remark" SG_ 419 ADC_AEBObjectTTC "";
BA_ "EventCommandSignal" SG_ 419 ADC_PAA2ESPApStandstillReq 0;
BA_ "GatewayedSignals" SG_ 419 ADC_PAA2ESPApStandstillReq 0;
BA_ "GenSigInactiveValue" SG_ 419 ADC_PAA2ESPApStandstillReq 0;
BA_ "GenSigInvalidValue" SG_ 419 ADC_PAA2ESPApStandstillReq 0;
BA_ "GenSigSendType" SG_ 419 ADC_PAA2ESPApStandstillReq 1;
BA_ "GenSigStartValue" SG_ 419 ADC_PAA2ESPApStandstillReq 0;
BA_ "GenSigTimeoutValue" SG_ 419 ADC_PAA2ESPApStandstillReq 0;
BA_ "Remark" SG_ 419 ADC_PAA2ESPApStandstillReq "";
BA_ "EventCommandSignal" SG_ 419 ADC_PAA2ESPApPrefillReq 0;
BA_ "GatewayedSignals" SG_ 419 ADC_PAA2ESPApPrefillReq 0;
BA_ "GenSigInactiveValue" SG_ 419 ADC_PAA2ESPApPrefillReq 0;
BA_ "GenSigInvalidValue" SG_ 419 ADC_PAA2ESPApPrefillReq 0;
BA_ "GenSigSendType" SG_ 419 ADC_PAA2ESPApPrefillReq 1;
BA_ "GenSigStartValue" SG_ 419 ADC_PAA2ESPApPrefillReq 0;
BA_ "GenSigTimeoutValue" SG_ 419 ADC_PAA2ESPApPrefillReq 0;
BA_ "Remark" SG_ 419 ADC_PAA2ESPApPrefillReq "";
BA_ "EventCommandSignal" SG_ 419 ADC_AEBObjRelativeSpd 0;
BA_ "GatewayedSignals" SG_ 419 ADC_AEBObjRelativeSpd 0;
BA_ "GenSigInactiveValue" SG_ 419 ADC_AEBObjRelativeSpd 0;
BA_ "GenSigInvalidValue" SG_ 419 ADC_AEBObjRelativeSpd 510;
BA_ "GenSigSendType" SG_ 419 ADC_AEBObjRelativeSpd 1;
BA_ "GenSigStartValue" SG_ 419 ADC_AEBObjRelativeSpd 0;
BA_ "GenSigTimeoutValue" SG_ 419 ADC_AEBObjRelativeSpd 510;
BA_ "Remark" SG_ 419 ADC_AEBObjRelativeSpd "";
BA_ "EventCommandSignal" SG_ 419 ADC_PAA2ESPAxReq 0;
BA_ "GatewayedSignals" SG_ 419 ADC_PAA2ESPAxReq 0;
BA_ "GenSigInactiveValue" SG_ 419 ADC_PAA2ESPAxReq 0;
BA_ "GenSigInvalidValue" SG_ 419 ADC_PAA2ESPAxReq 0;
BA_ "GenSigSendType" SG_ 419 ADC_PAA2ESPAxReq 1;
BA_ "GenSigStartValue" SG_ 419 ADC_PAA2ESPAxReq 0;
BA_ "GenSigTimeoutValue" SG_ 419 ADC_PAA2ESPAxReq 0;
BA_ "Remark" SG_ 419 ADC_PAA2ESPAxReq "";
BA_ "EventCommandSignal" SG_ 419 ADC_EPBReq 0;
BA_ "GatewayedSignals" SG_ 419 ADC_EPBReq 0;
BA_ "GenSigInactiveValue" SG_ 419 ADC_EPBReq 0;
BA_ "GenSigInvalidValue" SG_ 419 ADC_EPBReq 0;
BA_ "GenSigSendType" SG_ 419 ADC_EPBReq 1;
BA_ "GenSigStartValue" SG_ 419 ADC_EPBReq 0;
BA_ "GenSigTimeoutValue" SG_ 419 ADC_EPBReq 0;
BA_ "Remark" SG_ 419 ADC_EPBReq "";
BA_ "EventCommandSignal" SG_ 419 ADC_PAA2ESPDistoStop 0;
BA_ "GatewayedSignals" SG_ 419 ADC_PAA2ESPDistoStop 0;
BA_ "GenSigInactiveValue" SG_ 419 ADC_PAA2ESPDistoStop 0;
BA_ "GenSigInvalidValue" SG_ 419 ADC_PAA2ESPDistoStop 0;
BA_ "GenSigSendType" SG_ 419 ADC_PAA2ESPDistoStop 1;
BA_ "GenSigStartValue" SG_ 419 ADC_PAA2ESPDistoStop 0;
BA_ "GenSigTimeoutValue" SG_ 419 ADC_PAA2ESPDistoStop 0;
BA_ "Remark" SG_ 419 ADC_PAA2ESPDistoStop "";
BA_ "EventCommandSignal" SG_ 419 ADC_PAA2ESPTarTorquePTDriveoff 0;
BA_ "GatewayedSignals" SG_ 419 ADC_PAA2ESPTarTorquePTDriveoff 0;
BA_ "GenSigInactiveValue" SG_ 419 ADC_PAA2ESPTarTorquePTDriveoff 0;
BA_ "GenSigInvalidValue" SG_ 419 ADC_PAA2ESPTarTorquePTDriveoff 0;
BA_ "GenSigSendType" SG_ 419 ADC_PAA2ESPTarTorquePTDriveoff 1;
BA_ "GenSigStartValue" SG_ 419 ADC_PAA2ESPTarTorquePTDriveoff 0;
BA_ "GenSigTimeoutValue" SG_ 419 ADC_PAA2ESPTarTorquePTDriveoff 0;
BA_ "Remark" SG_ 419 ADC_PAA2ESPTarTorquePTDriveoff "";
BA_ "EventCommandSignal" SG_ 419 ADC_VehTorqLimit 0;
BA_ "GatewayedSignals" SG_ 419 ADC_VehTorqLimit 0;
BA_ "GenSigInactiveValue" SG_ 419 ADC_VehTorqLimit 0;
BA_ "GenSigInvalidValue" SG_ 419 ADC_VehTorqLimit 0;
BA_ "GenSigSendType" SG_ 419 ADC_VehTorqLimit 1;
BA_ "GenSigStartValue" SG_ 419 ADC_VehTorqLimit 0;
BA_ "GenSigTimeoutValue" SG_ 419 ADC_VehTorqLimit 0;
BA_ "Remark" SG_ 419 ADC_VehTorqLimit "";
BA_ "EventCommandSignal" SG_ 419 ADC_VehTorqReqValue 0;
BA_ "GatewayedSignals" SG_ 419 ADC_VehTorqReqValue 0;
BA_ "GenSigInactiveValue" SG_ 419 ADC_VehTorqReqValue 0;
BA_ "GenSigInvalidValue" SG_ 419 ADC_VehTorqReqValue 0;
BA_ "GenSigSendType" SG_ 419 ADC_VehTorqReqValue 1;
BA_ "GenSigStartValue" SG_ 419 ADC_VehTorqReqValue 0;
BA_ "GenSigTimeoutValue" SG_ 419 ADC_VehTorqReqValue 0;
BA_ "Remark" SG_ 419 ADC_VehTorqReqValue "";
BA_ "EventCommandSignal" SG_ 419 ADC_VehTorqLimitEnable 0;
BA_ "GatewayedSignals" SG_ 419 ADC_VehTorqLimitEnable 0;
BA_ "GenSigInactiveValue" SG_ 419 ADC_VehTorqLimitEnable 0;
BA_ "GenSigInvalidValue" SG_ 419 ADC_VehTorqLimitEnable 0;
BA_ "GenSigSendType" SG_ 419 ADC_VehTorqLimitEnable 1;
BA_ "GenSigStartValue" SG_ 419 ADC_VehTorqLimitEnable 0;
BA_ "GenSigTimeoutValue" SG_ 419 ADC_VehTorqLimitEnable 0;
BA_ "Remark" SG_ 419 ADC_VehTorqLimitEnable "";
BA_ "EventCommandSignal" SG_ 419 ADC_VehTorqReqEnable 0;
BA_ "GatewayedSignals" SG_ 419 ADC_VehTorqReqEnable 0;
BA_ "GenSigInactiveValue" SG_ 419 ADC_VehTorqReqEnable 0;
BA_ "GenSigInvalidValue" SG_ 419 ADC_VehTorqReqEnable 0;
BA_ "GenSigSendType" SG_ 419 ADC_VehTorqReqEnable 1;
BA_ "GenSigStartValue" SG_ 419 ADC_VehTorqReqEnable 0;
BA_ "GenSigTimeoutValue" SG_ 419 ADC_VehTorqReqEnable 0;
BA_ "Remark" SG_ 419 ADC_VehTorqReqEnable "";
BA_ "EventCommandSignal" SG_ 419 ADC_PAAPwrModeReq 0;
BA_ "GatewayedSignals" SG_ 419 ADC_PAAPwrModeReq 0;
BA_ "GenSigInactiveValue" SG_ 419 ADC_PAAPwrModeReq 0;
BA_ "GenSigInvalidValue" SG_ 419 ADC_PAAPwrModeReq 0;
BA_ "GenSigSendType" SG_ 419 ADC_PAAPwrModeReq 1;
BA_ "GenSigStartValue" SG_ 419 ADC_PAAPwrModeReq 0;
BA_ "GenSigTimeoutValue" SG_ 419 ADC_PAAPwrModeReq 0;
BA_ "Remark" SG_ 419 ADC_PAAPwrModeReq "";
BA_ "EventCommandSignal" SG_ 419 ADC_PAAGrarLvlReq 0;
BA_ "GatewayedSignals" SG_ 419 ADC_PAAGrarLvlReq 0;
BA_ "GenSigInactiveValue" SG_ 419 ADC_PAAGrarLvlReq 0;
BA_ "GenSigInvalidValue" SG_ 419 ADC_PAAGrarLvlReq 0;
BA_ "GenSigSendType" SG_ 419 ADC_PAAGrarLvlReq 1;
BA_ "GenSigStartValue" SG_ 419 ADC_PAAGrarLvlReq 0;
BA_ "GenSigTimeoutValue" SG_ 419 ADC_PAAGrarLvlReq 0;
BA_ "Remark" SG_ 419 ADC_PAAGrarLvlReq "";
BA_ "EventCommandSignal" SG_ 419 ADC_PAAGrarLvlReqEnable 0;
BA_ "GatewayedSignals" SG_ 419 ADC_PAAGrarLvlReqEnable 0;
BA_ "GenSigInactiveValue" SG_ 419 ADC_PAAGrarLvlReqEnable 0;
BA_ "GenSigInvalidValue" SG_ 419 ADC_PAAGrarLvlReqEnable 0;
BA_ "GenSigSendType" SG_ 419 ADC_PAAGrarLvlReqEnable 1;
BA_ "GenSigStartValue" SG_ 419 ADC_PAAGrarLvlReqEnable 0;
BA_ "GenSigTimeoutValue" SG_ 419 ADC_PAAGrarLvlReqEnable 0;
BA_ "Remark" SG_ 419 ADC_PAAGrarLvlReqEnable "";
BA_ "EventCommandSignal" SG_ 419 ADC_ACCMode_C 0;
BA_ "GatewayedSignals" SG_ 419 ADC_ACCMode_C 0;
BA_ "GenSigInactiveValue" SG_ 419 ADC_ACCMode_C 0;
BA_ "GenSigInvalidValue" SG_ 419 ADC_ACCMode_C 0;
BA_ "GenSigSendType" SG_ 419 ADC_ACCMode_C 1;
BA_ "GenSigStartValue" SG_ 419 ADC_ACCMode_C 1;
BA_ "GenSigTimeoutValue" SG_ 419 ADC_ACCMode_C 0;
BA_ "Remark" SG_ 419 ADC_ACCMode_C "";
BA_ "EventCommandSignal" SG_ 419 ADC_FcsActiveStatus 0;
BA_ "GatewayedSignals" SG_ 419 ADC_FcsActiveStatus 0;
BA_ "GenSigInactiveValue" SG_ 419 ADC_FcsActiveStatus 0;
BA_ "GenSigInvalidValue" SG_ 419 ADC_FcsActiveStatus 0;
BA_ "GenSigSendType" SG_ 419 ADC_FcsActiveStatus 1;
BA_ "GenSigStartValue" SG_ 419 ADC_FcsActiveStatus 0;
BA_ "GenSigTimeoutValue" SG_ 419 ADC_FcsActiveStatus 0;
BA_ "Remark" SG_ 419 ADC_FcsActiveStatus "";
BA_ "EventCommandSignal" SG_ 419 ADC_ActTrqReqVD 0;
BA_ "GatewayedSignals" SG_ 419 ADC_ActTrqReqVD 0;
BA_ "GenSigInactiveValue" SG_ 419 ADC_ActTrqReqVD 0;
BA_ "GenSigInvalidValue" SG_ 419 ADC_ActTrqReqVD 0;
BA_ "GenSigSendType" SG_ 419 ADC_ActTrqReqVD 1;
BA_ "GenSigStartValue" SG_ 419 ADC_ActTrqReqVD 0;
BA_ "GenSigTimeoutValue" SG_ 419 ADC_ActTrqReqVD 0;
BA_ "Remark" SG_ 419 ADC_ActTrqReqVD "";
BA_ "EventCommandSignal" SG_ 419 ADC_RCTBTargetDecel 0;
BA_ "GatewayedSignals" SG_ 419 ADC_RCTBTargetDecel 0;
BA_ "GenSigInactiveValue" SG_ 419 ADC_RCTBTargetDecel 0;
BA_ "GenSigInvalidValue" SG_ 419 ADC_RCTBTargetDecel 0;
BA_ "GenSigSendType" SG_ 419 ADC_RCTBTargetDecel 1;
BA_ "GenSigStartValue" SG_ 419 ADC_RCTBTargetDecel 0;
BA_ "GenSigTimeoutValue" SG_ 419 ADC_RCTBTargetDecel 0;
BA_ "Remark" SG_ 419 ADC_RCTBTargetDecel "";
BA_ "EventCommandSignal" SG_ 419 ADC_RCTBBrkReq 0;
BA_ "GatewayedSignals" SG_ 419 ADC_RCTBBrkReq 0;
BA_ "GenSigInactiveValue" SG_ 419 ADC_RCTBBrkReq 0;
BA_ "GenSigInvalidValue" SG_ 419 ADC_RCTBBrkReq 0;
BA_ "GenSigSendType" SG_ 419 ADC_RCTBBrkReq 1;
BA_ "GenSigStartValue" SG_ 419 ADC_RCTBBrkReq 0;
BA_ "GenSigTimeoutValue" SG_ 419 ADC_RCTBBrkReq 0;
BA_ "Remark" SG_ 419 ADC_RCTBBrkReq "";
BA_ "EventCommandSignal" SG_ 419 ADC_BrkTarTqEna 0;
BA_ "GatewayedSignals" SG_ 419 ADC_BrkTarTqEna 0;
BA_ "GenSigInactiveValue" SG_ 419 ADC_BrkTarTqEna 0;
BA_ "GenSigInvalidValue" SG_ 419 ADC_BrkTarTqEna 0;
BA_ "GenSigSendType" SG_ 419 ADC_BrkTarTqEna 1;
BA_ "GenSigStartValue" SG_ 419 ADC_BrkTarTqEna 0;
BA_ "GenSigTimeoutValue" SG_ 419 ADC_BrkTarTqEna 0;
BA_ "Remark" SG_ 419 ADC_BrkTarTqEna "";
BA_ "EventCommandSignal" SG_ 419 ADC_BrkTarTqMod 0;
BA_ "GatewayedSignals" SG_ 419 ADC_BrkTarTqMod 0;
BA_ "GenSigInactiveValue" SG_ 419 ADC_BrkTarTqMod 0;
BA_ "GenSigInvalidValue" SG_ 419 ADC_BrkTarTqMod 0;
BA_ "GenSigSendType" SG_ 419 ADC_BrkTarTqMod 1;
BA_ "GenSigStartValue" SG_ 419 ADC_BrkTarTqMod 0;
BA_ "GenSigTimeoutValue" SG_ 419 ADC_BrkTarTqMod 0;
BA_ "Remark" SG_ 419 ADC_BrkTarTqMod "";
BA_ "EventCommandSignal" SG_ 419 ADC_AebBrkTarTq 0;
BA_ "GatewayedSignals" SG_ 419 ADC_AebBrkTarTq 0;
BA_ "GenSigInactiveValue" SG_ 419 ADC_AebBrkTarTq 0;
BA_ "GenSigInvalidValue" SG_ 419 ADC_AebBrkTarTq 0;
BA_ "GenSigSendType" SG_ 419 ADC_AebBrkTarTq 1;
BA_ "GenSigStartValue" SG_ 419 ADC_AebBrkTarTq 0;
BA_ "GenSigTimeoutValue" SG_ 419 ADC_AebBrkTarTq 0;
BA_ "Remark" SG_ 419 ADC_AebBrkTarTq "";
BA_ "EventCommandSignal" SG_ 419 ADC_EpbModReqVld 0;
BA_ "GatewayedSignals" SG_ 419 ADC_EpbModReqVld 0;
BA_ "GenSigInactiveValue" SG_ 419 ADC_EpbModReqVld 0;
BA_ "GenSigInvalidValue" SG_ 419 ADC_EpbModReqVld 0;
BA_ "GenSigSendType" SG_ 419 ADC_EpbModReqVld 1;
BA_ "GenSigStartValue" SG_ 419 ADC_EpbModReqVld 0;
BA_ "GenSigTimeoutValue" SG_ 419 ADC_EpbModReqVld 0;
BA_ "Remark" SG_ 419 ADC_EpbModReqVld "";
BA_ "EventCommandSignal" SG_ 419 ADC_RWUEna 0;
BA_ "GatewayedSignals" SG_ 419 ADC_RWUEna 0;
BA_ "GenSigInactiveValue" SG_ 419 ADC_RWUEna 0;
BA_ "GenSigInvalidValue" SG_ 419 ADC_RWUEna 0;
BA_ "GenSigSendType" SG_ 419 ADC_RWUEna 1;
BA_ "GenSigStartValue" SG_ 419 ADC_RWUEna 0;
BA_ "GenSigTimeoutValue" SG_ 419 ADC_RWUEna 0;
BA_ "Remark" SG_ 419 ADC_RWUEna "";
BA_ "EventCommandSignal" SG_ 419 ADC_BrkHoldReq 0;
BA_ "GatewayedSignals" SG_ 419 ADC_BrkHoldReq 0;
BA_ "GenSigInactiveValue" SG_ 419 ADC_BrkHoldReq 0;
BA_ "GenSigInvalidValue" SG_ 419 ADC_BrkHoldReq 0;
BA_ "GenSigSendType" SG_ 419 ADC_BrkHoldReq 1;
BA_ "GenSigStartValue" SG_ 419 ADC_BrkHoldReq 0;
BA_ "GenSigTimeoutValue" SG_ 419 ADC_BrkHoldReq 0;
BA_ "Remark" SG_ 419 ADC_BrkHoldReq "";
BA_ "EventCommandSignal" SG_ 419 ADC_AngReqAvl 0;
BA_ "GatewayedSignals" SG_ 419 ADC_AngReqAvl 0;
BA_ "GenSigInactiveValue" SG_ 419 ADC_AngReqAvl 0;
BA_ "GenSigInvalidValue" SG_ 419 ADC_AngReqAvl 0;
BA_ "GenSigSendType" SG_ 419 ADC_AngReqAvl 1;
BA_ "GenSigStartValue" SG_ 419 ADC_AngReqAvl 0;
BA_ "GenSigTimeoutValue" SG_ 419 ADC_AngReqAvl 0;
BA_ "Remark" SG_ 419 ADC_AngReqAvl "";
BA_ "EventCommandSignal" SG_ 419 ADC_TarGearReqVld 0;
BA_ "GatewayedSignals" SG_ 419 ADC_TarGearReqVld 0;
BA_ "GenSigInactiveValue" SG_ 419 ADC_TarGearReqVld 0;
BA_ "GenSigInvalidValue" SG_ 419 ADC_TarGearReqVld 0;
BA_ "GenSigSendType" SG_ 419 ADC_TarGearReqVld 1;
BA_ "GenSigStartValue" SG_ 419 ADC_TarGearReqVld 0;
BA_ "GenSigTimeoutValue" SG_ 419 ADC_TarGearReqVld 0;
BA_ "Remark" SG_ 419 ADC_TarGearReqVld "";
BA_ "EventCommandSignal" SG_ 419 ADC_FctSts 0;
BA_ "GatewayedSignals" SG_ 419 ADC_FctSts 0;
BA_ "GenSigInactiveValue" SG_ 419 ADC_FctSts 0;
BA_ "GenSigInvalidValue" SG_ 419 ADC_FctSts 0;
BA_ "GenSigSendType" SG_ 419 ADC_FctSts 1;
BA_ "GenSigStartValue" SG_ 419 ADC_FctSts 0;
BA_ "GenSigTimeoutValue" SG_ 419 ADC_FctSts 0;
BA_ "Remark" SG_ 419 ADC_FctSts "";
BA_ "EventCommandSignal" SG_ 419 ADC_BrkTarTqVld 0;
BA_ "GatewayedSignals" SG_ 419 ADC_BrkTarTqVld 0;
BA_ "GenSigInactiveValue" SG_ 419 ADC_BrkTarTqVld 0;
BA_ "GenSigInvalidValue" SG_ 419 ADC_BrkTarTqVld 0;
BA_ "GenSigSendType" SG_ 419 ADC_BrkTarTqVld 1;
BA_ "GenSigStartValue" SG_ 419 ADC_BrkTarTqVld 0;
BA_ "GenSigTimeoutValue" SG_ 419 ADC_BrkTarTqVld 0;
BA_ "Remark" SG_ 419 ADC_BrkTarTqVld "";
BA_ "EventCommandSignal" SG_ 419 ADC_AebBrkTarTqVld 0;
BA_ "GatewayedSignals" SG_ 419 ADC_AebBrkTarTqVld 0;
BA_ "GenSigInactiveValue" SG_ 419 ADC_AebBrkTarTqVld 0;
BA_ "GenSigInvalidValue" SG_ 419 ADC_AebBrkTarTqVld 0;
BA_ "GenSigSendType" SG_ 419 ADC_AebBrkTarTqVld 1;
BA_ "GenSigStartValue" SG_ 419 ADC_AebBrkTarTqVld 0;
BA_ "GenSigTimeoutValue" SG_ 419 ADC_AebBrkTarTqVld 0;
BA_ "Remark" SG_ 419 ADC_AebBrkTarTqVld "";
BA_ "EventCommandSignal" SG_ 419 ADC_AebBrkTarTqEna 0;
BA_ "GatewayedSignals" SG_ 419 ADC_AebBrkTarTqEna 0;
BA_ "GenSigInactiveValue" SG_ 419 ADC_AebBrkTarTqEna 0;
BA_ "GenSigInvalidValue" SG_ 419 ADC_AebBrkTarTqEna 0;
BA_ "GenSigSendType" SG_ 419 ADC_AebBrkTarTqEna 1;
BA_ "GenSigStartValue" SG_ 419 ADC_AebBrkTarTqEna 0;
BA_ "GenSigTimeoutValue" SG_ 419 ADC_AebBrkTarTqEna 0;
BA_ "Remark" SG_ 419 ADC_AebBrkTarTqEna "";
BA_ "EventCommandSignal" SG_ 419 ADC_ElecBrkFnSwitch 0;
BA_ "GatewayedSignals" SG_ 419 ADC_ElecBrkFnSwitch 0;
BA_ "GenSigInactiveValue" SG_ 419 ADC_ElecBrkFnSwitch 0;
BA_ "GenSigInvalidValue" SG_ 419 ADC_ElecBrkFnSwitch 0;
BA_ "GenSigSendType" SG_ 419 ADC_ElecBrkFnSwitch 1;
BA_ "GenSigStartValue" SG_ 419 ADC_ElecBrkFnSwitch 0;
BA_ "GenSigTimeoutValue" SG_ 419 ADC_ElecBrkFnSwitch 0;
BA_ "Remark" SG_ 419 ADC_ElecBrkFnSwitch "";
BA_ "EventCommandSignal" SG_ 419 ADC_RWUVld 0;
BA_ "GatewayedSignals" SG_ 419 ADC_RWUVld 0;
BA_ "GenSigInactiveValue" SG_ 419 ADC_RWUVld 0;
BA_ "GenSigInvalidValue" SG_ 419 ADC_RWUVld 0;
BA_ "GenSigSendType" SG_ 419 ADC_RWUVld 1;
BA_ "GenSigStartValue" SG_ 419 ADC_RWUVld 0;
BA_ "GenSigTimeoutValue" SG_ 419 ADC_RWUVld 0;
BA_ "Remark" SG_ 419 ADC_RWUVld "";
BA_ "EventCommandSignal" SG_ 419 ADC_DriverPresent 0;
BA_ "GatewayedSignals" SG_ 419 ADC_DriverPresent 0;
BA_ "GenSigInactiveValue" SG_ 419 ADC_DriverPresent 0;
BA_ "GenSigInvalidValue" SG_ 419 ADC_DriverPresent 0;
BA_ "GenSigSendType" SG_ 419 ADC_DriverPresent 1;
BA_ "GenSigStartValue" SG_ 419 ADC_DriverPresent 0;
BA_ "GenSigTimeoutValue" SG_ 419 ADC_DriverPresent 0;
BA_ "Remark" SG_ 419 ADC_DriverPresent "";
BA_ "EventCommandSignal" SG_ 419 ADC_BrkTarTq 0;
BA_ "GatewayedSignals" SG_ 419 ADC_BrkTarTq 0;
BA_ "GenSigInactiveValue" SG_ 419 ADC_BrkTarTq 0;
BA_ "GenSigInvalidValue" SG_ 419 ADC_BrkTarTq 0;
BA_ "GenSigSendType" SG_ 419 ADC_BrkTarTq 1;
BA_ "GenSigStartValue" SG_ 419 ADC_BrkTarTq 0;
BA_ "GenSigTimeoutValue" SG_ 419 ADC_BrkTarTq 0;
BA_ "Remark" SG_ 419 ADC_BrkTarTq "";
BA_ "EventCommandSignal" SG_ 419 ADC_4_FreshnessValue 0;
BA_ "GatewayedSignals" SG_ 419 ADC_4_FreshnessValue 0;
BA_ "GenSigInactiveValue" SG_ 419 ADC_4_FreshnessValue 0;
BA_ "GenSigInvalidValue" SG_ 419 ADC_4_FreshnessValue 0;
BA_ "GenSigSendType" SG_ 419 ADC_4_FreshnessValue 1;
BA_ "GenSigStartValue" SG_ 419 ADC_4_FreshnessValue 0;
BA_ "GenSigTimeoutValue" SG_ 419 ADC_4_FreshnessValue 0;
BA_ "Remark" SG_ 419 ADC_4_FreshnessValue "";
BA_ "EventCommandSignal" SG_ 419 ADC_4_MAC_Check 0;
BA_ "GatewayedSignals" SG_ 419 ADC_4_MAC_Check 0;
BA_ "GenSigInactiveValue" SG_ 419 ADC_4_MAC_Check 0;
BA_ "GenSigInvalidValue" SG_ 419 ADC_4_MAC_Check 0;
BA_ "GenSigSendType" SG_ 419 ADC_4_MAC_Check 1;
BA_ "GenSigStartValue" SG_ 419 ADC_4_MAC_Check 0;
BA_ "GenSigTimeoutValue" SG_ 419 ADC_4_MAC_Check 0;
BA_ "Remark" SG_ 419 ADC_4_MAC_Check "";
BA_ "EventCommandSignal" SG_ 969 ADAS_RemoterParkingOnlineOrNot 0;
BA_ "GatewayedSignals" SG_ 969 ADAS_RemoterParkingOnlineOrNot 0;
BA_ "GenSigInactiveValue" SG_ 969 ADAS_RemoterParkingOnlineOrNot 0;
BA_ "GenSigInvalidValue" SG_ 969 ADAS_RemoterParkingOnlineOrNot 0;
BA_ "GenSigSendType" SG_ 969 ADAS_RemoterParkingOnlineOrNot 1;
BA_ "GenSigStartValue" SG_ 969 ADAS_RemoterParkingOnlineOrNot 0;
BA_ "GenSigTimeoutValue" SG_ 969 ADAS_RemoterParkingOnlineOrNot 0;
BA_ "Remark" SG_ 969 ADAS_RemoterParkingOnlineOrNot "";
BA_ "EventCommandSignal" SG_ 969 ADC_RpaParkAuthn 0;
BA_ "GatewayedSignals" SG_ 969 ADC_RpaParkAuthn 0;
BA_ "GenSigInactiveValue" SG_ 969 ADC_RpaParkAuthn 0;
BA_ "GenSigInvalidValue" SG_ 969 ADC_RpaParkAuthn 0;
BA_ "GenSigSendType" SG_ 969 ADC_RpaParkAuthn 1;
BA_ "GenSigStartValue" SG_ 969 ADC_RpaParkAuthn 0;
BA_ "GenSigTimeoutValue" SG_ 969 ADC_RpaParkAuthn 0;
BA_ "Remark" SG_ 969 ADC_RpaParkAuthn "";
BA_ "EventCommandSignal" SG_ 969 ADC_RemParkPatSel 0;
BA_ "GatewayedSignals" SG_ 969 ADC_RemParkPatSel 0;
BA_ "GenSigInactiveValue" SG_ 969 ADC_RemParkPatSel 0;
BA_ "GenSigInvalidValue" SG_ 969 ADC_RemParkPatSel 0;
BA_ "GenSigSendType" SG_ 969 ADC_RemParkPatSel 1;
BA_ "GenSigStartValue" SG_ 969 ADC_RemParkPatSel 0;
BA_ "GenSigTimeoutValue" SG_ 969 ADC_RemParkPatSel 0;
BA_ "Remark" SG_ 969 ADC_RemParkPatSel "";
BA_ "EventCommandSignal" SG_ 969 ADC_ParkDirCfm 0;
BA_ "GatewayedSignals" SG_ 969 ADC_ParkDirCfm 0;
BA_ "GenSigInactiveValue" SG_ 969 ADC_ParkDirCfm 0;
BA_ "GenSigInvalidValue" SG_ 969 ADC_ParkDirCfm 0;
BA_ "GenSigSendType" SG_ 969 ADC_ParkDirCfm 1;
BA_ "GenSigStartValue" SG_ 969 ADC_ParkDirCfm 0;
BA_ "GenSigTimeoutValue" SG_ 969 ADC_ParkDirCfm 0;
BA_ "Remark" SG_ 969 ADC_ParkDirCfm "";
BA_ "EventCommandSignal" SG_ 969 ADC_ParkStMac 0;
BA_ "GatewayedSignals" SG_ 969 ADC_ParkStMac 0;
BA_ "GenSigInactiveValue" SG_ 969 ADC_ParkStMac 0;
BA_ "GenSigInvalidValue" SG_ 969 ADC_ParkStMac 0;
BA_ "GenSigSendType" SG_ 969 ADC_ParkStMac 1;
BA_ "GenSigStartValue" SG_ 969 ADC_ParkStMac 0;
BA_ "GenSigTimeoutValue" SG_ 969 ADC_ParkStMac 0;
BA_ "Remark" SG_ 969 ADC_ParkStMac "";
BA_ "EventCommandSignal" SG_ 969 ADC_PwrOnOffReq 0;
BA_ "GatewayedSignals" SG_ 969 ADC_PwrOnOffReq 0;
BA_ "GenSigInactiveValue" SG_ 969 ADC_PwrOnOffReq 0;
BA_ "GenSigInvalidValue" SG_ 969 ADC_PwrOnOffReq 0;
BA_ "GenSigSendType" SG_ 969 ADC_PwrOnOffReq 1;
BA_ "GenSigStartValue" SG_ 969 ADC_PwrOnOffReq 0;
BA_ "GenSigTimeoutValue" SG_ 969 ADC_PwrOnOffReq 0;
BA_ "Remark" SG_ 969 ADC_PwrOnOffReq "";
BA_ "EventCommandSignal" SG_ 969 ADC_ParkOutDir_ParaLe 0;
BA_ "GatewayedSignals" SG_ 969 ADC_ParkOutDir_ParaLe 0;
BA_ "GenSigInactiveValue" SG_ 969 ADC_ParkOutDir_ParaLe 0;
BA_ "GenSigInvalidValue" SG_ 969 ADC_ParkOutDir_ParaLe 0;
BA_ "GenSigSendType" SG_ 969 ADC_ParkOutDir_ParaLe 1;
BA_ "GenSigStartValue" SG_ 969 ADC_ParkOutDir_ParaLe 0;
BA_ "GenSigTimeoutValue" SG_ 969 ADC_ParkOutDir_ParaLe 0;
BA_ "Remark" SG_ 969 ADC_ParkOutDir_ParaLe "";
BA_ "EventCommandSignal" SG_ 969 ADC_ParkOutDir_ParaRi 0;
BA_ "GatewayedSignals" SG_ 969 ADC_ParkOutDir_ParaRi 0;
BA_ "GenSigInactiveValue" SG_ 969 ADC_ParkOutDir_ParaRi 0;
BA_ "GenSigInvalidValue" SG_ 969 ADC_ParkOutDir_ParaRi 0;
BA_ "GenSigSendType" SG_ 969 ADC_ParkOutDir_ParaRi 1;
BA_ "GenSigStartValue" SG_ 969 ADC_ParkOutDir_ParaRi 0;
BA_ "GenSigTimeoutValue" SG_ 969 ADC_ParkOutDir_ParaRi 0;
BA_ "Remark" SG_ 969 ADC_ParkOutDir_ParaRi "";
BA_ "EventCommandSignal" SG_ 969 ADC_ParkOutDir_PerpFwd 0;
BA_ "GatewayedSignals" SG_ 969 ADC_ParkOutDir_PerpFwd 0;
BA_ "GenSigInactiveValue" SG_ 969 ADC_ParkOutDir_PerpFwd 0;
BA_ "GenSigInvalidValue" SG_ 969 ADC_ParkOutDir_PerpFwd 0;
BA_ "GenSigSendType" SG_ 969 ADC_ParkOutDir_PerpFwd 1;
BA_ "GenSigStartValue" SG_ 969 ADC_ParkOutDir_PerpFwd 0;
BA_ "GenSigTimeoutValue" SG_ 969 ADC_ParkOutDir_PerpFwd 0;
BA_ "Remark" SG_ 969 ADC_ParkOutDir_PerpFwd "";
BA_ "EventCommandSignal" SG_ 969 ADC_ParkOutDir_PerpLeFwd 0;
BA_ "GatewayedSignals" SG_ 969 ADC_ParkOutDir_PerpLeFwd 0;
BA_ "GenSigInactiveValue" SG_ 969 ADC_ParkOutDir_PerpLeFwd 0;
BA_ "GenSigInvalidValue" SG_ 969 ADC_ParkOutDir_PerpLeFwd 0;
BA_ "GenSigSendType" SG_ 969 ADC_ParkOutDir_PerpLeFwd 1;
BA_ "GenSigStartValue" SG_ 969 ADC_ParkOutDir_PerpLeFwd 0;
BA_ "GenSigTimeoutValue" SG_ 969 ADC_ParkOutDir_PerpLeFwd 0;
BA_ "Remark" SG_ 969 ADC_ParkOutDir_PerpLeFwd "";
BA_ "EventCommandSignal" SG_ 969 ADC_ParkOutDir_PerpRiFwd 0;
BA_ "GatewayedSignals" SG_ 969 ADC_ParkOutDir_PerpRiFwd 0;
BA_ "GenSigInactiveValue" SG_ 969 ADC_ParkOutDir_PerpRiFwd 0;
BA_ "GenSigInvalidValue" SG_ 969 ADC_ParkOutDir_PerpRiFwd 0;
BA_ "GenSigSendType" SG_ 969 ADC_ParkOutDir_PerpRiFwd 1;
BA_ "GenSigStartValue" SG_ 969 ADC_ParkOutDir_PerpRiFwd 0;
BA_ "GenSigTimeoutValue" SG_ 969 ADC_ParkOutDir_PerpRiFwd 0;
BA_ "Remark" SG_ 969 ADC_ParkOutDir_PerpRiFwd "";
BA_ "EventCommandSignal" SG_ 969 ADC_ParkOutDir_PerpLeBack 0;
BA_ "GatewayedSignals" SG_ 969 ADC_ParkOutDir_PerpLeBack 0;
BA_ "GenSigInactiveValue" SG_ 969 ADC_ParkOutDir_PerpLeBack 0;
BA_ "GenSigInvalidValue" SG_ 969 ADC_ParkOutDir_PerpLeBack 0;
BA_ "GenSigSendType" SG_ 969 ADC_ParkOutDir_PerpLeBack 1;
BA_ "GenSigStartValue" SG_ 969 ADC_ParkOutDir_PerpLeBack 0;
BA_ "GenSigTimeoutValue" SG_ 969 ADC_ParkOutDir_PerpLeBack 0;
BA_ "Remark" SG_ 969 ADC_ParkOutDir_PerpLeBack "";
BA_ "EventCommandSignal" SG_ 969 ADC_ParkOutDir_PerpRiBack 0;
BA_ "GatewayedSignals" SG_ 969 ADC_ParkOutDir_PerpRiBack 0;
BA_ "GenSigInactiveValue" SG_ 969 ADC_ParkOutDir_PerpRiBack 0;
BA_ "GenSigInvalidValue" SG_ 969 ADC_ParkOutDir_PerpRiBack 0;
BA_ "GenSigSendType" SG_ 969 ADC_ParkOutDir_PerpRiBack 1;
BA_ "GenSigStartValue" SG_ 969 ADC_ParkOutDir_PerpRiBack 0;
BA_ "GenSigTimeoutValue" SG_ 969 ADC_ParkOutDir_PerpRiBack 0;
BA_ "Remark" SG_ 969 ADC_ParkOutDir_PerpRiBack "";
BA_ "EventCommandSignal" SG_ 969 ADC_ParkOutDir_PerpBack 0;
BA_ "GatewayedSignals" SG_ 969 ADC_ParkOutDir_PerpBack 0;
BA_ "GenSigInactiveValue" SG_ 969 ADC_ParkOutDir_PerpBack 0;
BA_ "GenSigInvalidValue" SG_ 969 ADC_ParkOutDir_PerpBack 0;
BA_ "GenSigSendType" SG_ 969 ADC_ParkOutDir_PerpBack 1;
BA_ "GenSigStartValue" SG_ 969 ADC_ParkOutDir_PerpBack 0;
BA_ "GenSigTimeoutValue" SG_ 969 ADC_ParkOutDir_PerpBack 0;
BA_ "Remark" SG_ 969 ADC_ParkOutDir_PerpBack "";
BA_ "EventCommandSignal" SG_ 969 ADC_APA_RPAFctUnavlMsg1 0;
BA_ "GatewayedSignals" SG_ 969 ADC_APA_RPAFctUnavlMsg1 0;
BA_ "GenSigInactiveValue" SG_ 969 ADC_APA_RPAFctUnavlMsg1 0;
BA_ "GenSigInvalidValue" SG_ 969 ADC_APA_RPAFctUnavlMsg1 0;
BA_ "GenSigSendType" SG_ 969 ADC_APA_RPAFctUnavlMsg1 1;
BA_ "GenSigStartValue" SG_ 969 ADC_APA_RPAFctUnavlMsg1 0;
BA_ "GenSigTimeoutValue" SG_ 969 ADC_APA_RPAFctUnavlMsg1 0;
BA_ "Remark" SG_ 969 ADC_APA_RPAFctUnavlMsg1 "";
BA_ "EventCommandSignal" SG_ 969 ADC_APA_RPAFctUnavlMsg2 0;
BA_ "GatewayedSignals" SG_ 969 ADC_APA_RPAFctUnavlMsg2 0;
BA_ "GenSigInactiveValue" SG_ 969 ADC_APA_RPAFctUnavlMsg2 0;
BA_ "GenSigInvalidValue" SG_ 969 ADC_APA_RPAFctUnavlMsg2 0;
BA_ "GenSigSendType" SG_ 969 ADC_APA_RPAFctUnavlMsg2 1;
BA_ "GenSigStartValue" SG_ 969 ADC_APA_RPAFctUnavlMsg2 0;
BA_ "GenSigTimeoutValue" SG_ 969 ADC_APA_RPAFctUnavlMsg2 0;
BA_ "Remark" SG_ 969 ADC_APA_RPAFctUnavlMsg2 "";
BA_ "EventCommandSignal" SG_ 969 ADC_APA_RPAFctUnavlMsg3 0;
BA_ "GatewayedSignals" SG_ 969 ADC_APA_RPAFctUnavlMsg3 0;
BA_ "GenSigInactiveValue" SG_ 969 ADC_APA_RPAFctUnavlMsg3 0;
BA_ "GenSigInvalidValue" SG_ 969 ADC_APA_RPAFctUnavlMsg3 0;
BA_ "GenSigSendType" SG_ 969 ADC_APA_RPAFctUnavlMsg3 1;
BA_ "GenSigStartValue" SG_ 969 ADC_APA_RPAFctUnavlMsg3 0;
BA_ "GenSigTimeoutValue" SG_ 969 ADC_APA_RPAFctUnavlMsg3 0;
BA_ "Remark" SG_ 969 ADC_APA_RPAFctUnavlMsg3 "";
BA_ "EventCommandSignal" SG_ 969 ADC_APA_RPAFctUnavlMsg4 0;
BA_ "GatewayedSignals" SG_ 969 ADC_APA_RPAFctUnavlMsg4 0;
BA_ "GenSigInactiveValue" SG_ 969 ADC_APA_RPAFctUnavlMsg4 0;
BA_ "GenSigInvalidValue" SG_ 969 ADC_APA_RPAFctUnavlMsg4 0;
BA_ "GenSigSendType" SG_ 969 ADC_APA_RPAFctUnavlMsg4 1;
BA_ "GenSigStartValue" SG_ 969 ADC_APA_RPAFctUnavlMsg4 0;
BA_ "GenSigTimeoutValue" SG_ 969 ADC_APA_RPAFctUnavlMsg4 0;
BA_ "Remark" SG_ 969 ADC_APA_RPAFctUnavlMsg4 "";
BA_ "EventCommandSignal" SG_ 969 ADC_APA_RPAFctUnavlMsg5 0;
BA_ "GatewayedSignals" SG_ 969 ADC_APA_RPAFctUnavlMsg5 0;
BA_ "GenSigInactiveValue" SG_ 969 ADC_APA_RPAFctUnavlMsg5 0;
BA_ "GenSigInvalidValue" SG_ 969 ADC_APA_RPAFctUnavlMsg5 0;
BA_ "GenSigSendType" SG_ 969 ADC_APA_RPAFctUnavlMsg5 1;
BA_ "GenSigStartValue" SG_ 969 ADC_APA_RPAFctUnavlMsg5 0;
BA_ "GenSigTimeoutValue" SG_ 969 ADC_APA_RPAFctUnavlMsg5 0;
BA_ "Remark" SG_ 969 ADC_APA_RPAFctUnavlMsg5 "";
BA_ "EventCommandSignal" SG_ 969 ADC_APA_RPAFctUnavlMsg6 0;
BA_ "GatewayedSignals" SG_ 969 ADC_APA_RPAFctUnavlMsg6 0;
BA_ "GenSigInactiveValue" SG_ 969 ADC_APA_RPAFctUnavlMsg6 0;
BA_ "GenSigInvalidValue" SG_ 969 ADC_APA_RPAFctUnavlMsg6 0;
BA_ "GenSigSendType" SG_ 969 ADC_APA_RPAFctUnavlMsg6 1;
BA_ "GenSigStartValue" SG_ 969 ADC_APA_RPAFctUnavlMsg6 0;
BA_ "GenSigTimeoutValue" SG_ 969 ADC_APA_RPAFctUnavlMsg6 0;
BA_ "Remark" SG_ 969 ADC_APA_RPAFctUnavlMsg6 "";
BA_ "EventCommandSignal" SG_ 969 ADC_APA_RPAFctUnavlMsg7 0;
BA_ "GatewayedSignals" SG_ 969 ADC_APA_RPAFctUnavlMsg7 0;
BA_ "GenSigInactiveValue" SG_ 969 ADC_APA_RPAFctUnavlMsg7 0;
BA_ "GenSigInvalidValue" SG_ 969 ADC_APA_RPAFctUnavlMsg7 0;
BA_ "GenSigSendType" SG_ 969 ADC_APA_RPAFctUnavlMsg7 1;
BA_ "GenSigStartValue" SG_ 969 ADC_APA_RPAFctUnavlMsg7 0;
BA_ "GenSigTimeoutValue" SG_ 969 ADC_APA_RPAFctUnavlMsg7 0;
BA_ "Remark" SG_ 969 ADC_APA_RPAFctUnavlMsg7 "";
BA_ "EventCommandSignal" SG_ 969 ADC_APA_RPAFctUnavlMsg8 0;
BA_ "GatewayedSignals" SG_ 969 ADC_APA_RPAFctUnavlMsg8 0;
BA_ "GenSigInactiveValue" SG_ 969 ADC_APA_RPAFctUnavlMsg8 0;
BA_ "GenSigInvalidValue" SG_ 969 ADC_APA_RPAFctUnavlMsg8 0;
BA_ "GenSigSendType" SG_ 969 ADC_APA_RPAFctUnavlMsg8 1;
BA_ "GenSigStartValue" SG_ 969 ADC_APA_RPAFctUnavlMsg8 0;
BA_ "GenSigTimeoutValue" SG_ 969 ADC_APA_RPAFctUnavlMsg8 0;
BA_ "Remark" SG_ 969 ADC_APA_RPAFctUnavlMsg8 "";
BA_ "EventCommandSignal" SG_ 969 ADC_APA_RPAFctUnavlMsg9 0;
BA_ "GatewayedSignals" SG_ 969 ADC_APA_RPAFctUnavlMsg9 0;
BA_ "GenSigInactiveValue" SG_ 969 ADC_APA_RPAFctUnavlMsg9 0;
BA_ "GenSigInvalidValue" SG_ 969 ADC_APA_RPAFctUnavlMsg9 0;
BA_ "GenSigSendType" SG_ 969 ADC_APA_RPAFctUnavlMsg9 1;
BA_ "GenSigStartValue" SG_ 969 ADC_APA_RPAFctUnavlMsg9 0;
BA_ "GenSigTimeoutValue" SG_ 969 ADC_APA_RPAFctUnavlMsg9 0;
BA_ "Remark" SG_ 969 ADC_APA_RPAFctUnavlMsg9 "";
BA_ "EventCommandSignal" SG_ 969 ADC_APA_RPAFctUnavlMsg10 0;
BA_ "GatewayedSignals" SG_ 969 ADC_APA_RPAFctUnavlMsg10 0;
BA_ "GenSigInactiveValue" SG_ 969 ADC_APA_RPAFctUnavlMsg10 0;
BA_ "GenSigInvalidValue" SG_ 969 ADC_APA_RPAFctUnavlMsg10 0;
BA_ "GenSigSendType" SG_ 969 ADC_APA_RPAFctUnavlMsg10 1;
BA_ "GenSigStartValue" SG_ 969 ADC_APA_RPAFctUnavlMsg10 0;
BA_ "GenSigTimeoutValue" SG_ 969 ADC_APA_RPAFctUnavlMsg10 0;
BA_ "Remark" SG_ 969 ADC_APA_RPAFctUnavlMsg10 "";
BA_ "EventCommandSignal" SG_ 969 ADC_APA_RPAFctUnavlMsg11 0;
BA_ "GatewayedSignals" SG_ 969 ADC_APA_RPAFctUnavlMsg11 0;
BA_ "GenSigInactiveValue" SG_ 969 ADC_APA_RPAFctUnavlMsg11 0;
BA_ "GenSigInvalidValue" SG_ 969 ADC_APA_RPAFctUnavlMsg11 0;
BA_ "GenSigSendType" SG_ 969 ADC_APA_RPAFctUnavlMsg11 1;
BA_ "GenSigStartValue" SG_ 969 ADC_APA_RPAFctUnavlMsg11 0;
BA_ "GenSigTimeoutValue" SG_ 969 ADC_APA_RPAFctUnavlMsg11 0;
BA_ "Remark" SG_ 969 ADC_APA_RPAFctUnavlMsg11 "";
BA_ "EventCommandSignal" SG_ 969 ADC_APA_RPAFctUnavlMsg12 0;
BA_ "GatewayedSignals" SG_ 969 ADC_APA_RPAFctUnavlMsg12 0;
BA_ "GenSigInactiveValue" SG_ 969 ADC_APA_RPAFctUnavlMsg12 0;
BA_ "GenSigInvalidValue" SG_ 969 ADC_APA_RPAFctUnavlMsg12 0;
BA_ "GenSigSendType" SG_ 969 ADC_APA_RPAFctUnavlMsg12 1;
BA_ "GenSigStartValue" SG_ 969 ADC_APA_RPAFctUnavlMsg12 0;
BA_ "GenSigTimeoutValue" SG_ 969 ADC_APA_RPAFctUnavlMsg12 0;
BA_ "Remark" SG_ 969 ADC_APA_RPAFctUnavlMsg12 "";
BA_ "EventCommandSignal" SG_ 969 ADC_APA_RPAFctUnavlMsg13 0;
BA_ "GatewayedSignals" SG_ 969 ADC_APA_RPAFctUnavlMsg13 0;
BA_ "GenSigInactiveValue" SG_ 969 ADC_APA_RPAFctUnavlMsg13 0;
BA_ "GenSigInvalidValue" SG_ 969 ADC_APA_RPAFctUnavlMsg13 0;
BA_ "GenSigSendType" SG_ 969 ADC_APA_RPAFctUnavlMsg13 1;
BA_ "GenSigStartValue" SG_ 969 ADC_APA_RPAFctUnavlMsg13 0;
BA_ "GenSigTimeoutValue" SG_ 969 ADC_APA_RPAFctUnavlMsg13 0;
BA_ "Remark" SG_ 969 ADC_APA_RPAFctUnavlMsg13 "";
BA_ "EventCommandSignal" SG_ 969 ADC_APA_RPAFctUnavlMsg14 0;
BA_ "GatewayedSignals" SG_ 969 ADC_APA_RPAFctUnavlMsg14 0;
BA_ "GenSigInactiveValue" SG_ 969 ADC_APA_RPAFctUnavlMsg14 0;
BA_ "GenSigInvalidValue" SG_ 969 ADC_APA_RPAFctUnavlMsg14 0;
BA_ "GenSigSendType" SG_ 969 ADC_APA_RPAFctUnavlMsg14 1;
BA_ "GenSigStartValue" SG_ 969 ADC_APA_RPAFctUnavlMsg14 0;
BA_ "GenSigTimeoutValue" SG_ 969 ADC_APA_RPAFctUnavlMsg14 0;
BA_ "Remark" SG_ 969 ADC_APA_RPAFctUnavlMsg14 "";
BA_ "EventCommandSignal" SG_ 969 ADC_APA_RPAFctUnavlMsg15 0;
BA_ "GatewayedSignals" SG_ 969 ADC_APA_RPAFctUnavlMsg15 0;
BA_ "GenSigInactiveValue" SG_ 969 ADC_APA_RPAFctUnavlMsg15 0;
BA_ "GenSigInvalidValue" SG_ 969 ADC_APA_RPAFctUnavlMsg15 0;
BA_ "GenSigSendType" SG_ 969 ADC_APA_RPAFctUnavlMsg15 1;
BA_ "GenSigStartValue" SG_ 969 ADC_APA_RPAFctUnavlMsg15 0;
BA_ "GenSigTimeoutValue" SG_ 969 ADC_APA_RPAFctUnavlMsg15 0;
BA_ "Remark" SG_ 969 ADC_APA_RPAFctUnavlMsg15 "";
BA_ "EventCommandSignal" SG_ 969 ADC_APA_RPAFctUnavlMsg16 0;
BA_ "GatewayedSignals" SG_ 969 ADC_APA_RPAFctUnavlMsg16 0;
BA_ "GenSigInactiveValue" SG_ 969 ADC_APA_RPAFctUnavlMsg16 0;
BA_ "GenSigInvalidValue" SG_ 969 ADC_APA_RPAFctUnavlMsg16 0;
BA_ "GenSigSendType" SG_ 969 ADC_APA_RPAFctUnavlMsg16 1;
BA_ "GenSigStartValue" SG_ 969 ADC_APA_RPAFctUnavlMsg16 0;
BA_ "GenSigTimeoutValue" SG_ 969 ADC_APA_RPAFctUnavlMsg16 0;
BA_ "Remark" SG_ 969 ADC_APA_RPAFctUnavlMsg16 "";
BA_ "EventCommandSignal" SG_ 969 ADC_APA_RPAFctUnavlMsg17 0;
BA_ "GatewayedSignals" SG_ 969 ADC_APA_RPAFctUnavlMsg17 0;
BA_ "GenSigInactiveValue" SG_ 969 ADC_APA_RPAFctUnavlMsg17 0;
BA_ "GenSigInvalidValue" SG_ 969 ADC_APA_RPAFctUnavlMsg17 0;
BA_ "GenSigSendType" SG_ 969 ADC_APA_RPAFctUnavlMsg17 1;
BA_ "GenSigStartValue" SG_ 969 ADC_APA_RPAFctUnavlMsg17 0;
BA_ "GenSigTimeoutValue" SG_ 969 ADC_APA_RPAFctUnavlMsg17 0;
BA_ "Remark" SG_ 969 ADC_APA_RPAFctUnavlMsg17 "";
BA_ "EventCommandSignal" SG_ 969 ADC_APA_RPAFctUnavlMsg18 0;
BA_ "GatewayedSignals" SG_ 969 ADC_APA_RPAFctUnavlMsg18 0;
BA_ "GenSigInactiveValue" SG_ 969 ADC_APA_RPAFctUnavlMsg18 0;
BA_ "GenSigInvalidValue" SG_ 969 ADC_APA_RPAFctUnavlMsg18 0;
BA_ "GenSigSendType" SG_ 969 ADC_APA_RPAFctUnavlMsg18 1;
BA_ "GenSigStartValue" SG_ 969 ADC_APA_RPAFctUnavlMsg18 0;
BA_ "GenSigTimeoutValue" SG_ 969 ADC_APA_RPAFctUnavlMsg18 0;
BA_ "Remark" SG_ 969 ADC_APA_RPAFctUnavlMsg18 "";
BA_ "EventCommandSignal" SG_ 969 ADC_APA_RPAFctUnavlMsg19 0;
BA_ "GatewayedSignals" SG_ 969 ADC_APA_RPAFctUnavlMsg19 0;
BA_ "GenSigInactiveValue" SG_ 969 ADC_APA_RPAFctUnavlMsg19 0;
BA_ "GenSigInvalidValue" SG_ 969 ADC_APA_RPAFctUnavlMsg19 0;
BA_ "GenSigSendType" SG_ 969 ADC_APA_RPAFctUnavlMsg19 1;
BA_ "GenSigStartValue" SG_ 969 ADC_APA_RPAFctUnavlMsg19 0;
BA_ "GenSigTimeoutValue" SG_ 969 ADC_APA_RPAFctUnavlMsg19 0;
BA_ "Remark" SG_ 969 ADC_APA_RPAFctUnavlMsg19 "";
BA_ "EventCommandSignal" SG_ 969 ADC_APA_RPAFctUnavlMsg20 0;
BA_ "GatewayedSignals" SG_ 969 ADC_APA_RPAFctUnavlMsg20 0;
BA_ "GenSigInactiveValue" SG_ 969 ADC_APA_RPAFctUnavlMsg20 0;
BA_ "GenSigInvalidValue" SG_ 969 ADC_APA_RPAFctUnavlMsg20 0;
BA_ "GenSigSendType" SG_ 969 ADC_APA_RPAFctUnavlMsg20 1;
BA_ "GenSigStartValue" SG_ 969 ADC_APA_RPAFctUnavlMsg20 0;
BA_ "GenSigTimeoutValue" SG_ 969 ADC_APA_RPAFctUnavlMsg20 0;
BA_ "Remark" SG_ 969 ADC_APA_RPAFctUnavlMsg20 "";
BA_ "EventCommandSignal" SG_ 969 ADC_APA_RPAFctUnavlMsg21 0;
BA_ "GatewayedSignals" SG_ 969 ADC_APA_RPAFctUnavlMsg21 0;
BA_ "GenSigInactiveValue" SG_ 969 ADC_APA_RPAFctUnavlMsg21 0;
BA_ "GenSigInvalidValue" SG_ 969 ADC_APA_RPAFctUnavlMsg21 0;
BA_ "GenSigSendType" SG_ 969 ADC_APA_RPAFctUnavlMsg21 1;
BA_ "GenSigStartValue" SG_ 969 ADC_APA_RPAFctUnavlMsg21 0;
BA_ "GenSigTimeoutValue" SG_ 969 ADC_APA_RPAFctUnavlMsg21 0;
BA_ "Remark" SG_ 969 ADC_APA_RPAFctUnavlMsg21 "";
BA_ "EventCommandSignal" SG_ 969 ADC_APA_RPAFctUnavlMsg22 0;
BA_ "GatewayedSignals" SG_ 969 ADC_APA_RPAFctUnavlMsg22 0;
BA_ "GenSigInactiveValue" SG_ 969 ADC_APA_RPAFctUnavlMsg22 0;
BA_ "GenSigInvalidValue" SG_ 969 ADC_APA_RPAFctUnavlMsg22 0;
BA_ "GenSigSendType" SG_ 969 ADC_APA_RPAFctUnavlMsg22 1;
BA_ "GenSigStartValue" SG_ 969 ADC_APA_RPAFctUnavlMsg22 0;
BA_ "GenSigTimeoutValue" SG_ 969 ADC_APA_RPAFctUnavlMsg22 0;
BA_ "Remark" SG_ 969 ADC_APA_RPAFctUnavlMsg22 "";
BA_ "EventCommandSignal" SG_ 969 ADC_APA_RPAFctUnavlMsg23 0;
BA_ "GatewayedSignals" SG_ 969 ADC_APA_RPAFctUnavlMsg23 0;
BA_ "GenSigInactiveValue" SG_ 969 ADC_APA_RPAFctUnavlMsg23 0;
BA_ "GenSigInvalidValue" SG_ 969 ADC_APA_RPAFctUnavlMsg23 0;
BA_ "GenSigSendType" SG_ 969 ADC_APA_RPAFctUnavlMsg23 1;
BA_ "GenSigStartValue" SG_ 969 ADC_APA_RPAFctUnavlMsg23 0;
BA_ "GenSigTimeoutValue" SG_ 969 ADC_APA_RPAFctUnavlMsg23 0;
BA_ "Remark" SG_ 969 ADC_APA_RPAFctUnavlMsg23 "";
BA_ "EventCommandSignal" SG_ 969 ADC_APA_RPAFctUnavlMsg24 0;
BA_ "GatewayedSignals" SG_ 969 ADC_APA_RPAFctUnavlMsg24 0;
BA_ "GenSigInactiveValue" SG_ 969 ADC_APA_RPAFctUnavlMsg24 0;
BA_ "GenSigInvalidValue" SG_ 969 ADC_APA_RPAFctUnavlMsg24 0;
BA_ "GenSigSendType" SG_ 969 ADC_APA_RPAFctUnavlMsg24 1;
BA_ "GenSigStartValue" SG_ 969 ADC_APA_RPAFctUnavlMsg24 0;
BA_ "GenSigTimeoutValue" SG_ 969 ADC_APA_RPAFctUnavlMsg24 0;
BA_ "Remark" SG_ 969 ADC_APA_RPAFctUnavlMsg24 "";
BA_ "EventCommandSignal" SG_ 969 ADC_APA_RPAFctUnavlMsg25 0;
BA_ "GatewayedSignals" SG_ 969 ADC_APA_RPAFctUnavlMsg25 0;
BA_ "GenSigInactiveValue" SG_ 969 ADC_APA_RPAFctUnavlMsg25 0;
BA_ "GenSigInvalidValue" SG_ 969 ADC_APA_RPAFctUnavlMsg25 0;
BA_ "GenSigSendType" SG_ 969 ADC_APA_RPAFctUnavlMsg25 1;
BA_ "GenSigStartValue" SG_ 969 ADC_APA_RPAFctUnavlMsg25 0;
BA_ "GenSigTimeoutValue" SG_ 969 ADC_APA_RPAFctUnavlMsg25 0;
BA_ "Remark" SG_ 969 ADC_APA_RPAFctUnavlMsg25 "";
BA_ "EventCommandSignal" SG_ 969 ADC_APA_RPACnclMsg1 0;
BA_ "GatewayedSignals" SG_ 969 ADC_APA_RPACnclMsg1 0;
BA_ "GenSigInactiveValue" SG_ 969 ADC_APA_RPACnclMsg1 0;
BA_ "GenSigInvalidValue" SG_ 969 ADC_APA_RPACnclMsg1 0;
BA_ "GenSigSendType" SG_ 969 ADC_APA_RPACnclMsg1 1;
BA_ "GenSigStartValue" SG_ 969 ADC_APA_RPACnclMsg1 0;
BA_ "GenSigTimeoutValue" SG_ 969 ADC_APA_RPACnclMsg1 0;
BA_ "Remark" SG_ 969 ADC_APA_RPACnclMsg1 "";
BA_ "EventCommandSignal" SG_ 969 ADC_APA_RPACnclMsg2 0;
BA_ "GatewayedSignals" SG_ 969 ADC_APA_RPACnclMsg2 0;
BA_ "GenSigInactiveValue" SG_ 969 ADC_APA_RPACnclMsg2 0;
BA_ "GenSigInvalidValue" SG_ 969 ADC_APA_RPACnclMsg2 0;
BA_ "GenSigSendType" SG_ 969 ADC_APA_RPACnclMsg2 1;
BA_ "GenSigStartValue" SG_ 969 ADC_APA_RPACnclMsg2 0;
BA_ "GenSigTimeoutValue" SG_ 969 ADC_APA_RPACnclMsg2 0;
BA_ "Remark" SG_ 969 ADC_APA_RPACnclMsg2 "";
BA_ "EventCommandSignal" SG_ 969 ADC_APA_RPACnclMsg3 0;
BA_ "GatewayedSignals" SG_ 969 ADC_APA_RPACnclMsg3 0;
BA_ "GenSigInactiveValue" SG_ 969 ADC_APA_RPACnclMsg3 0;
BA_ "GenSigInvalidValue" SG_ 969 ADC_APA_RPACnclMsg3 0;
BA_ "GenSigSendType" SG_ 969 ADC_APA_RPACnclMsg3 1;
BA_ "GenSigStartValue" SG_ 969 ADC_APA_RPACnclMsg3 0;
BA_ "GenSigTimeoutValue" SG_ 969 ADC_APA_RPACnclMsg3 0;
BA_ "Remark" SG_ 969 ADC_APA_RPACnclMsg3 "";
BA_ "EventCommandSignal" SG_ 969 ADC_APA_RPACnclMsg4 0;
BA_ "GatewayedSignals" SG_ 969 ADC_APA_RPACnclMsg4 0;
BA_ "GenSigInactiveValue" SG_ 969 ADC_APA_RPACnclMsg4 0;
BA_ "GenSigInvalidValue" SG_ 969 ADC_APA_RPACnclMsg4 0;
BA_ "GenSigSendType" SG_ 969 ADC_APA_RPACnclMsg4 1;
BA_ "GenSigStartValue" SG_ 969 ADC_APA_RPACnclMsg4 0;
BA_ "GenSigTimeoutValue" SG_ 969 ADC_APA_RPACnclMsg4 0;
BA_ "Remark" SG_ 969 ADC_APA_RPACnclMsg4 "";
BA_ "EventCommandSignal" SG_ 969 ADC_APA_RPACnclMsg5 0;
BA_ "GatewayedSignals" SG_ 969 ADC_APA_RPACnclMsg5 0;
BA_ "GenSigInactiveValue" SG_ 969 ADC_APA_RPACnclMsg5 0;
BA_ "GenSigInvalidValue" SG_ 969 ADC_APA_RPACnclMsg5 0;
BA_ "GenSigSendType" SG_ 969 ADC_APA_RPACnclMsg5 1;
BA_ "GenSigStartValue" SG_ 969 ADC_APA_RPACnclMsg5 0;
BA_ "GenSigTimeoutValue" SG_ 969 ADC_APA_RPACnclMsg5 0;
BA_ "Remark" SG_ 969 ADC_APA_RPACnclMsg5 "";
BA_ "EventCommandSignal" SG_ 969 ADC_APA_RPACnclMsg6 0;
BA_ "GatewayedSignals" SG_ 969 ADC_APA_RPACnclMsg6 0;
BA_ "GenSigInactiveValue" SG_ 969 ADC_APA_RPACnclMsg6 0;
BA_ "GenSigInvalidValue" SG_ 969 ADC_APA_RPACnclMsg6 0;
BA_ "GenSigSendType" SG_ 969 ADC_APA_RPACnclMsg6 1;
BA_ "GenSigStartValue" SG_ 969 ADC_APA_RPACnclMsg6 0;
BA_ "GenSigTimeoutValue" SG_ 969 ADC_APA_RPACnclMsg6 0;
BA_ "Remark" SG_ 969 ADC_APA_RPACnclMsg6 "";
BA_ "EventCommandSignal" SG_ 969 ADC_APA_RPACnclMsg7 0;
BA_ "GatewayedSignals" SG_ 969 ADC_APA_RPACnclMsg7 0;
BA_ "GenSigInactiveValue" SG_ 969 ADC_APA_RPACnclMsg7 0;
BA_ "GenSigInvalidValue" SG_ 969 ADC_APA_RPACnclMsg7 0;
BA_ "GenSigSendType" SG_ 969 ADC_APA_RPACnclMsg7 1;
BA_ "GenSigStartValue" SG_ 969 ADC_APA_RPACnclMsg7 0;
BA_ "GenSigTimeoutValue" SG_ 969 ADC_APA_RPACnclMsg7 0;
BA_ "Remark" SG_ 969 ADC_APA_RPACnclMsg7 "";
BA_ "EventCommandSignal" SG_ 969 ADC_APA_RPACnclMsg8 0;
BA_ "GatewayedSignals" SG_ 969 ADC_APA_RPACnclMsg8 0;
BA_ "GenSigInactiveValue" SG_ 969 ADC_APA_RPACnclMsg8 0;
BA_ "GenSigInvalidValue" SG_ 969 ADC_APA_RPACnclMsg8 0;
BA_ "GenSigSendType" SG_ 969 ADC_APA_RPACnclMsg8 1;
BA_ "GenSigStartValue" SG_ 969 ADC_APA_RPACnclMsg8 0;
BA_ "GenSigTimeoutValue" SG_ 969 ADC_APA_RPACnclMsg8 0;
BA_ "Remark" SG_ 969 ADC_APA_RPACnclMsg8 "";
BA_ "EventCommandSignal" SG_ 969 ADC_APA_RPACnclMsg9 0;
BA_ "GatewayedSignals" SG_ 969 ADC_APA_RPACnclMsg9 0;
BA_ "GenSigInactiveValue" SG_ 969 ADC_APA_RPACnclMsg9 0;
BA_ "GenSigInvalidValue" SG_ 969 ADC_APA_RPACnclMsg9 0;
BA_ "GenSigSendType" SG_ 969 ADC_APA_RPACnclMsg9 1;
BA_ "GenSigStartValue" SG_ 969 ADC_APA_RPACnclMsg9 0;
BA_ "GenSigTimeoutValue" SG_ 969 ADC_APA_RPACnclMsg9 0;
BA_ "Remark" SG_ 969 ADC_APA_RPACnclMsg9 "";
BA_ "EventCommandSignal" SG_ 969 ADC_APA_RPACnclMsg10 0;
BA_ "GatewayedSignals" SG_ 969 ADC_APA_RPACnclMsg10 0;
BA_ "GenSigInactiveValue" SG_ 969 ADC_APA_RPACnclMsg10 0;
BA_ "GenSigInvalidValue" SG_ 969 ADC_APA_RPACnclMsg10 0;
BA_ "GenSigSendType" SG_ 969 ADC_APA_RPACnclMsg10 1;
BA_ "GenSigStartValue" SG_ 969 ADC_APA_RPACnclMsg10 0;
BA_ "GenSigTimeoutValue" SG_ 969 ADC_APA_RPACnclMsg10 0;
BA_ "Remark" SG_ 969 ADC_APA_RPACnclMsg10 "";
BA_ "EventCommandSignal" SG_ 969 ADC_APA_RPACnclMsg11 0;
BA_ "GatewayedSignals" SG_ 969 ADC_APA_RPACnclMsg11 0;
BA_ "GenSigInactiveValue" SG_ 969 ADC_APA_RPACnclMsg11 0;
BA_ "GenSigInvalidValue" SG_ 969 ADC_APA_RPACnclMsg11 0;
BA_ "GenSigSendType" SG_ 969 ADC_APA_RPACnclMsg11 1;
BA_ "GenSigStartValue" SG_ 969 ADC_APA_RPACnclMsg11 0;
BA_ "GenSigTimeoutValue" SG_ 969 ADC_APA_RPACnclMsg11 0;
BA_ "Remark" SG_ 969 ADC_APA_RPACnclMsg11 "";
BA_ "EventCommandSignal" SG_ 969 ADC_APA_RPACnclMsg12 0;
BA_ "GatewayedSignals" SG_ 969 ADC_APA_RPACnclMsg12 0;
BA_ "GenSigInactiveValue" SG_ 969 ADC_APA_RPACnclMsg12 0;
BA_ "GenSigInvalidValue" SG_ 969 ADC_APA_RPACnclMsg12 0;
BA_ "GenSigSendType" SG_ 969 ADC_APA_RPACnclMsg12 1;
BA_ "GenSigStartValue" SG_ 969 ADC_APA_RPACnclMsg12 0;
BA_ "GenSigTimeoutValue" SG_ 969 ADC_APA_RPACnclMsg12 0;
BA_ "Remark" SG_ 969 ADC_APA_RPACnclMsg12 "";
BA_ "EventCommandSignal" SG_ 969 ADC_APA_RPACnclMsg13 0;
BA_ "GatewayedSignals" SG_ 969 ADC_APA_RPACnclMsg13 0;
BA_ "GenSigInactiveValue" SG_ 969 ADC_APA_RPACnclMsg13 0;
BA_ "GenSigInvalidValue" SG_ 969 ADC_APA_RPACnclMsg13 0;
BA_ "GenSigSendType" SG_ 969 ADC_APA_RPACnclMsg13 1;
BA_ "GenSigStartValue" SG_ 969 ADC_APA_RPACnclMsg13 0;
BA_ "GenSigTimeoutValue" SG_ 969 ADC_APA_RPACnclMsg13 0;
BA_ "Remark" SG_ 969 ADC_APA_RPACnclMsg13 "";
BA_ "EventCommandSignal" SG_ 969 ADC_APA_RPACnclMsg14 0;
BA_ "GatewayedSignals" SG_ 969 ADC_APA_RPACnclMsg14 0;
BA_ "GenSigInactiveValue" SG_ 969 ADC_APA_RPACnclMsg14 0;
BA_ "GenSigInvalidValue" SG_ 969 ADC_APA_RPACnclMsg14 0;
BA_ "GenSigSendType" SG_ 969 ADC_APA_RPACnclMsg14 1;
BA_ "GenSigStartValue" SG_ 969 ADC_APA_RPACnclMsg14 0;
BA_ "GenSigTimeoutValue" SG_ 969 ADC_APA_RPACnclMsg14 0;
BA_ "Remark" SG_ 969 ADC_APA_RPACnclMsg14 "";
BA_ "EventCommandSignal" SG_ 969 ADC_APA_RPACnclMsg15 0;
BA_ "GatewayedSignals" SG_ 969 ADC_APA_RPACnclMsg15 0;
BA_ "GenSigInactiveValue" SG_ 969 ADC_APA_RPACnclMsg15 0;
BA_ "GenSigInvalidValue" SG_ 969 ADC_APA_RPACnclMsg15 0;
BA_ "GenSigSendType" SG_ 969 ADC_APA_RPACnclMsg15 1;
BA_ "GenSigStartValue" SG_ 969 ADC_APA_RPACnclMsg15 0;
BA_ "GenSigTimeoutValue" SG_ 969 ADC_APA_RPACnclMsg15 0;
BA_ "Remark" SG_ 969 ADC_APA_RPACnclMsg15 "";
BA_ "EventCommandSignal" SG_ 969 ADC_APA_RPACnclMsg16 0;
BA_ "GatewayedSignals" SG_ 969 ADC_APA_RPACnclMsg16 0;
BA_ "GenSigInactiveValue" SG_ 969 ADC_APA_RPACnclMsg16 0;
BA_ "GenSigInvalidValue" SG_ 969 ADC_APA_RPACnclMsg16 0;
BA_ "GenSigSendType" SG_ 969 ADC_APA_RPACnclMsg16 1;
BA_ "GenSigStartValue" SG_ 969 ADC_APA_RPACnclMsg16 0;
BA_ "GenSigTimeoutValue" SG_ 969 ADC_APA_RPACnclMsg16 0;
BA_ "Remark" SG_ 969 ADC_APA_RPACnclMsg16 "";
BA_ "EventCommandSignal" SG_ 969 ADC_APA_RPACnclMsg17 0;
BA_ "GatewayedSignals" SG_ 969 ADC_APA_RPACnclMsg17 0;
BA_ "GenSigInactiveValue" SG_ 969 ADC_APA_RPACnclMsg17 0;
BA_ "GenSigInvalidValue" SG_ 969 ADC_APA_RPACnclMsg17 0;
BA_ "GenSigSendType" SG_ 969 ADC_APA_RPACnclMsg17 1;
BA_ "GenSigStartValue" SG_ 969 ADC_APA_RPACnclMsg17 0;
BA_ "GenSigTimeoutValue" SG_ 969 ADC_APA_RPACnclMsg17 0;
BA_ "Remark" SG_ 969 ADC_APA_RPACnclMsg17 "";
BA_ "EventCommandSignal" SG_ 969 ADC_APA_RPACnclMsg18 0;
BA_ "GatewayedSignals" SG_ 969 ADC_APA_RPACnclMsg18 0;
BA_ "GenSigInactiveValue" SG_ 969 ADC_APA_RPACnclMsg18 0;
BA_ "GenSigInvalidValue" SG_ 969 ADC_APA_RPACnclMsg18 0;
BA_ "GenSigSendType" SG_ 969 ADC_APA_RPACnclMsg18 1;
BA_ "GenSigStartValue" SG_ 969 ADC_APA_RPACnclMsg18 0;
BA_ "GenSigTimeoutValue" SG_ 969 ADC_APA_RPACnclMsg18 0;
BA_ "Remark" SG_ 969 ADC_APA_RPACnclMsg18 "";
BA_ "EventCommandSignal" SG_ 969 ADC_APA_RPACnclMsg19 0;
BA_ "GatewayedSignals" SG_ 969 ADC_APA_RPACnclMsg19 0;
BA_ "GenSigInactiveValue" SG_ 969 ADC_APA_RPACnclMsg19 0;
BA_ "GenSigInvalidValue" SG_ 969 ADC_APA_RPACnclMsg19 0;
BA_ "GenSigSendType" SG_ 969 ADC_APA_RPACnclMsg19 1;
BA_ "GenSigStartValue" SG_ 969 ADC_APA_RPACnclMsg19 0;
BA_ "GenSigTimeoutValue" SG_ 969 ADC_APA_RPACnclMsg19 0;
BA_ "Remark" SG_ 969 ADC_APA_RPACnclMsg19 "";
BA_ "EventCommandSignal" SG_ 969 ADC_APA_RPACnclMsg20 0;
BA_ "GatewayedSignals" SG_ 969 ADC_APA_RPACnclMsg20 0;
BA_ "GenSigInactiveValue" SG_ 969 ADC_APA_RPACnclMsg20 0;
BA_ "GenSigInvalidValue" SG_ 969 ADC_APA_RPACnclMsg20 0;
BA_ "GenSigSendType" SG_ 969 ADC_APA_RPACnclMsg20 1;
BA_ "GenSigStartValue" SG_ 969 ADC_APA_RPACnclMsg20 0;
BA_ "GenSigTimeoutValue" SG_ 969 ADC_APA_RPACnclMsg20 0;
BA_ "Remark" SG_ 969 ADC_APA_RPACnclMsg20 "";
BA_ "EventCommandSignal" SG_ 969 ADC_APA_RPAPauseMsg1 0;
BA_ "GatewayedSignals" SG_ 969 ADC_APA_RPAPauseMsg1 0;
BA_ "GenSigInactiveValue" SG_ 969 ADC_APA_RPAPauseMsg1 0;
BA_ "GenSigInvalidValue" SG_ 969 ADC_APA_RPAPauseMsg1 0;
BA_ "GenSigSendType" SG_ 969 ADC_APA_RPAPauseMsg1 1;
BA_ "GenSigStartValue" SG_ 969 ADC_APA_RPAPauseMsg1 0;
BA_ "GenSigTimeoutValue" SG_ 969 ADC_APA_RPAPauseMsg1 0;
BA_ "Remark" SG_ 969 ADC_APA_RPAPauseMsg1 "";
BA_ "EventCommandSignal" SG_ 969 ADC_APA_RPAPauseMsg2 0;
BA_ "GatewayedSignals" SG_ 969 ADC_APA_RPAPauseMsg2 0;
BA_ "GenSigInactiveValue" SG_ 969 ADC_APA_RPAPauseMsg2 0;
BA_ "GenSigInvalidValue" SG_ 969 ADC_APA_RPAPauseMsg2 0;
BA_ "GenSigSendType" SG_ 969 ADC_APA_RPAPauseMsg2 1;
BA_ "GenSigStartValue" SG_ 969 ADC_APA_RPAPauseMsg2 0;
BA_ "GenSigTimeoutValue" SG_ 969 ADC_APA_RPAPauseMsg2 0;
BA_ "Remark" SG_ 969 ADC_APA_RPAPauseMsg2 "";
BA_ "EventCommandSignal" SG_ 969 ADC_APA_RPAPauseMsg3 0;
BA_ "GatewayedSignals" SG_ 969 ADC_APA_RPAPauseMsg3 0;
BA_ "GenSigInactiveValue" SG_ 969 ADC_APA_RPAPauseMsg3 0;
BA_ "GenSigInvalidValue" SG_ 969 ADC_APA_RPAPauseMsg3 0;
BA_ "GenSigSendType" SG_ 969 ADC_APA_RPAPauseMsg3 1;
BA_ "GenSigStartValue" SG_ 969 ADC_APA_RPAPauseMsg3 0;
BA_ "GenSigTimeoutValue" SG_ 969 ADC_APA_RPAPauseMsg3 0;
BA_ "Remark" SG_ 969 ADC_APA_RPAPauseMsg3 "";
BA_ "EventCommandSignal" SG_ 969 ADC_APA_RPAPauseMsg4 0;
BA_ "GatewayedSignals" SG_ 969 ADC_APA_RPAPauseMsg4 0;
BA_ "GenSigInactiveValue" SG_ 969 ADC_APA_RPAPauseMsg4 0;
BA_ "GenSigInvalidValue" SG_ 969 ADC_APA_RPAPauseMsg4 0;
BA_ "GenSigSendType" SG_ 969 ADC_APA_RPAPauseMsg4 1;
BA_ "GenSigStartValue" SG_ 969 ADC_APA_RPAPauseMsg4 0;
BA_ "GenSigTimeoutValue" SG_ 969 ADC_APA_RPAPauseMsg4 0;
BA_ "Remark" SG_ 969 ADC_APA_RPAPauseMsg4 "";
BA_ "EventCommandSignal" SG_ 969 ADC_APA_RPAPauseMsg5 0;
BA_ "GatewayedSignals" SG_ 969 ADC_APA_RPAPauseMsg5 0;
BA_ "GenSigInactiveValue" SG_ 969 ADC_APA_RPAPauseMsg5 0;
BA_ "GenSigInvalidValue" SG_ 969 ADC_APA_RPAPauseMsg5 0;
BA_ "GenSigSendType" SG_ 969 ADC_APA_RPAPauseMsg5 1;
BA_ "GenSigStartValue" SG_ 969 ADC_APA_RPAPauseMsg5 0;
BA_ "GenSigTimeoutValue" SG_ 969 ADC_APA_RPAPauseMsg5 0;
BA_ "Remark" SG_ 969 ADC_APA_RPAPauseMsg5 "";
BA_ "EventCommandSignal" SG_ 969 ADC_APA_RPAPauseMsg6 0;
BA_ "GatewayedSignals" SG_ 969 ADC_APA_RPAPauseMsg6 0;
BA_ "GenSigInactiveValue" SG_ 969 ADC_APA_RPAPauseMsg6 0;
BA_ "GenSigInvalidValue" SG_ 969 ADC_APA_RPAPauseMsg6 0;
BA_ "GenSigSendType" SG_ 969 ADC_APA_RPAPauseMsg6 1;
BA_ "GenSigStartValue" SG_ 969 ADC_APA_RPAPauseMsg6 0;
BA_ "GenSigTimeoutValue" SG_ 969 ADC_APA_RPAPauseMsg6 0;
BA_ "Remark" SG_ 969 ADC_APA_RPAPauseMsg6 "";
BA_ "EventCommandSignal" SG_ 969 ADC_APA_RPAPauseMsg7 0;
BA_ "GatewayedSignals" SG_ 969 ADC_APA_RPAPauseMsg7 0;
BA_ "GenSigInactiveValue" SG_ 969 ADC_APA_RPAPauseMsg7 0;
BA_ "GenSigInvalidValue" SG_ 969 ADC_APA_RPAPauseMsg7 0;
BA_ "GenSigSendType" SG_ 969 ADC_APA_RPAPauseMsg7 1;
BA_ "GenSigStartValue" SG_ 969 ADC_APA_RPAPauseMsg7 0;
BA_ "GenSigTimeoutValue" SG_ 969 ADC_APA_RPAPauseMsg7 0;
BA_ "Remark" SG_ 969 ADC_APA_RPAPauseMsg7 "";
BA_ "EventCommandSignal" SG_ 969 ADC_APA_RPAPauseMsg8 0;
BA_ "GatewayedSignals" SG_ 969 ADC_APA_RPAPauseMsg8 0;
BA_ "GenSigInactiveValue" SG_ 969 ADC_APA_RPAPauseMsg8 0;
BA_ "GenSigInvalidValue" SG_ 969 ADC_APA_RPAPauseMsg8 0;
BA_ "GenSigSendType" SG_ 969 ADC_APA_RPAPauseMsg8 1;
BA_ "GenSigStartValue" SG_ 969 ADC_APA_RPAPauseMsg8 0;
BA_ "GenSigTimeoutValue" SG_ 969 ADC_APA_RPAPauseMsg8 0;
BA_ "Remark" SG_ 969 ADC_APA_RPAPauseMsg8 "";
BA_ "EventCommandSignal" SG_ 969 ADC_APA_RPAPauseMsg9 0;
BA_ "GatewayedSignals" SG_ 969 ADC_APA_RPAPauseMsg9 0;
BA_ "GenSigInactiveValue" SG_ 969 ADC_APA_RPAPauseMsg9 0;
BA_ "GenSigInvalidValue" SG_ 969 ADC_APA_RPAPauseMsg9 0;
BA_ "GenSigSendType" SG_ 969 ADC_APA_RPAPauseMsg9 1;
BA_ "GenSigStartValue" SG_ 969 ADC_APA_RPAPauseMsg9 0;
BA_ "GenSigTimeoutValue" SG_ 969 ADC_APA_RPAPauseMsg9 0;
BA_ "Remark" SG_ 969 ADC_APA_RPAPauseMsg9 "";
BA_ "EventCommandSignal" SG_ 969 ADC_APA_RPAPauseMsg10 0;
BA_ "GatewayedSignals" SG_ 969 ADC_APA_RPAPauseMsg10 0;
BA_ "GenSigInactiveValue" SG_ 969 ADC_APA_RPAPauseMsg10 0;
BA_ "GenSigInvalidValue" SG_ 969 ADC_APA_RPAPauseMsg10 0;
BA_ "GenSigSendType" SG_ 969 ADC_APA_RPAPauseMsg10 1;
BA_ "GenSigStartValue" SG_ 969 ADC_APA_RPAPauseMsg10 0;
BA_ "GenSigTimeoutValue" SG_ 969 ADC_APA_RPAPauseMsg10 0;
BA_ "Remark" SG_ 969 ADC_APA_RPAPauseMsg10 "";
BA_ "EventCommandSignal" SG_ 969 ADC_PathPlanPos1X 0;
BA_ "GatewayedSignals" SG_ 969 ADC_PathPlanPos1X 0;
BA_ "GenSigInactiveValue" SG_ 969 ADC_PathPlanPos1X 0;
BA_ "GenSigInvalidValue" SG_ 969 ADC_PathPlanPos1X 0;
BA_ "GenSigSendType" SG_ 969 ADC_PathPlanPos1X 1;
BA_ "GenSigStartValue" SG_ 969 ADC_PathPlanPos1X 0;
BA_ "GenSigTimeoutValue" SG_ 969 ADC_PathPlanPos1X 0;
BA_ "Remark" SG_ 969 ADC_PathPlanPos1X "";
BA_ "EventCommandSignal" SG_ 969 ADC_PathPlanPos1Y 0;
BA_ "GatewayedSignals" SG_ 969 ADC_PathPlanPos1Y 0;
BA_ "GenSigInactiveValue" SG_ 969 ADC_PathPlanPos1Y 0;
BA_ "GenSigInvalidValue" SG_ 969 ADC_PathPlanPos1Y 0;
BA_ "GenSigSendType" SG_ 969 ADC_PathPlanPos1Y 1;
BA_ "GenSigStartValue" SG_ 969 ADC_PathPlanPos1Y 0;
BA_ "GenSigTimeoutValue" SG_ 969 ADC_PathPlanPos1Y 0;
BA_ "Remark" SG_ 969 ADC_PathPlanPos1Y "";
BA_ "EventCommandSignal" SG_ 969 ADC_PathPlanPos2X 0;
BA_ "GatewayedSignals" SG_ 969 ADC_PathPlanPos2X 0;
BA_ "GenSigInactiveValue" SG_ 969 ADC_PathPlanPos2X 0;
BA_ "GenSigInvalidValue" SG_ 969 ADC_PathPlanPos2X 0;
BA_ "GenSigSendType" SG_ 969 ADC_PathPlanPos2X 1;
BA_ "GenSigStartValue" SG_ 969 ADC_PathPlanPos2X 0;
BA_ "GenSigTimeoutValue" SG_ 969 ADC_PathPlanPos2X 0;
BA_ "Remark" SG_ 969 ADC_PathPlanPos2X "";
BA_ "EventCommandSignal" SG_ 969 ADC_PathPlanPos2Y 0;
BA_ "GatewayedSignals" SG_ 969 ADC_PathPlanPos2Y 0;
BA_ "GenSigInactiveValue" SG_ 969 ADC_PathPlanPos2Y 0;
BA_ "GenSigInvalidValue" SG_ 969 ADC_PathPlanPos2Y 0;
BA_ "GenSigSendType" SG_ 969 ADC_PathPlanPos2Y 1;
BA_ "GenSigStartValue" SG_ 969 ADC_PathPlanPos2Y 0;
BA_ "GenSigTimeoutValue" SG_ 969 ADC_PathPlanPos2Y 0;
BA_ "Remark" SG_ 969 ADC_PathPlanPos2Y "";
BA_ "EventCommandSignal" SG_ 969 ADC_PathPlanPos3X 0;
BA_ "GatewayedSignals" SG_ 969 ADC_PathPlanPos3X 0;
BA_ "GenSigInactiveValue" SG_ 969 ADC_PathPlanPos3X 0;
BA_ "GenSigInvalidValue" SG_ 969 ADC_PathPlanPos3X 0;
BA_ "GenSigSendType" SG_ 969 ADC_PathPlanPos3X 1;
BA_ "GenSigStartValue" SG_ 969 ADC_PathPlanPos3X 0;
BA_ "GenSigTimeoutValue" SG_ 969 ADC_PathPlanPos3X 0;
BA_ "Remark" SG_ 969 ADC_PathPlanPos3X "";
BA_ "EventCommandSignal" SG_ 969 ADC_PathPlanPos3Y 0;
BA_ "GatewayedSignals" SG_ 969 ADC_PathPlanPos3Y 0;
BA_ "GenSigInactiveValue" SG_ 969 ADC_PathPlanPos3Y 0;
BA_ "GenSigInvalidValue" SG_ 969 ADC_PathPlanPos3Y 0;
BA_ "GenSigSendType" SG_ 969 ADC_PathPlanPos3Y 1;
BA_ "GenSigStartValue" SG_ 969 ADC_PathPlanPos3Y 0;
BA_ "GenSigTimeoutValue" SG_ 969 ADC_PathPlanPos3Y 0;
BA_ "Remark" SG_ 969 ADC_PathPlanPos3Y "";
BA_ "EventCommandSignal" SG_ 969 ADC_PathPlanPos4X 0;
BA_ "GatewayedSignals" SG_ 969 ADC_PathPlanPos4X 0;
BA_ "GenSigInactiveValue" SG_ 969 ADC_PathPlanPos4X 0;
BA_ "GenSigInvalidValue" SG_ 969 ADC_PathPlanPos4X 0;
BA_ "GenSigSendType" SG_ 969 ADC_PathPlanPos4X 1;
BA_ "GenSigStartValue" SG_ 969 ADC_PathPlanPos4X 0;
BA_ "GenSigTimeoutValue" SG_ 969 ADC_PathPlanPos4X 0;
BA_ "Remark" SG_ 969 ADC_PathPlanPos4X "";
BA_ "EventCommandSignal" SG_ 969 ADC_PathPlanPos4Y 0;
BA_ "GatewayedSignals" SG_ 969 ADC_PathPlanPos4Y 0;
BA_ "GenSigInactiveValue" SG_ 969 ADC_PathPlanPos4Y 0;
BA_ "GenSigInvalidValue" SG_ 969 ADC_PathPlanPos4Y 0;
BA_ "GenSigSendType" SG_ 969 ADC_PathPlanPos4Y 1;
BA_ "GenSigStartValue" SG_ 969 ADC_PathPlanPos4Y 0;
BA_ "GenSigTimeoutValue" SG_ 969 ADC_PathPlanPos4Y 0;
BA_ "Remark" SG_ 969 ADC_PathPlanPos4Y "";
BA_ "EventCommandSignal" SG_ 969 ADC_PathPlanPos5X 0;
BA_ "GatewayedSignals" SG_ 969 ADC_PathPlanPos5X 0;
BA_ "GenSigInactiveValue" SG_ 969 ADC_PathPlanPos5X 0;
BA_ "GenSigInvalidValue" SG_ 969 ADC_PathPlanPos5X 0;
BA_ "GenSigSendType" SG_ 969 ADC_PathPlanPos5X 1;
BA_ "GenSigStartValue" SG_ 969 ADC_PathPlanPos5X 0;
BA_ "GenSigTimeoutValue" SG_ 969 ADC_PathPlanPos5X 0;
BA_ "Remark" SG_ 969 ADC_PathPlanPos5X "";
BA_ "EventCommandSignal" SG_ 969 ADC_PathPlanPos5Y 0;
BA_ "GatewayedSignals" SG_ 969 ADC_PathPlanPos5Y 0;
BA_ "GenSigInactiveValue" SG_ 969 ADC_PathPlanPos5Y 0;
BA_ "GenSigInvalidValue" SG_ 969 ADC_PathPlanPos5Y 0;
BA_ "GenSigSendType" SG_ 969 ADC_PathPlanPos5Y 1;
BA_ "GenSigStartValue" SG_ 969 ADC_PathPlanPos5Y 0;
BA_ "GenSigTimeoutValue" SG_ 969 ADC_PathPlanPos5Y 0;
BA_ "Remark" SG_ 969 ADC_PathPlanPos5Y "";
BA_ "EventCommandSignal" SG_ 969 ADC_PathPlanPos6X 0;
BA_ "GatewayedSignals" SG_ 969 ADC_PathPlanPos6X 0;
BA_ "GenSigInactiveValue" SG_ 969 ADC_PathPlanPos6X 0;
BA_ "GenSigInvalidValue" SG_ 969 ADC_PathPlanPos6X 0;
BA_ "GenSigSendType" SG_ 969 ADC_PathPlanPos6X 1;
BA_ "GenSigStartValue" SG_ 969 ADC_PathPlanPos6X 0;
BA_ "GenSigTimeoutValue" SG_ 969 ADC_PathPlanPos6X 0;
BA_ "Remark" SG_ 969 ADC_PathPlanPos6X "";
BA_ "EventCommandSignal" SG_ 969 ADC_PathPlanPos6Y 0;
BA_ "GatewayedSignals" SG_ 969 ADC_PathPlanPos6Y 0;
BA_ "GenSigInactiveValue" SG_ 969 ADC_PathPlanPos6Y 0;
BA_ "GenSigInvalidValue" SG_ 969 ADC_PathPlanPos6Y 0;
BA_ "GenSigSendType" SG_ 969 ADC_PathPlanPos6Y 1;
BA_ "GenSigStartValue" SG_ 969 ADC_PathPlanPos6Y 0;
BA_ "GenSigTimeoutValue" SG_ 969 ADC_PathPlanPos6Y 0;
BA_ "Remark" SG_ 969 ADC_PathPlanPos6Y "";
BA_ "EventCommandSignal" SG_ 969 ADC_PathPlanPos7X 0;
BA_ "GatewayedSignals" SG_ 969 ADC_PathPlanPos7X 0;
BA_ "GenSigInactiveValue" SG_ 969 ADC_PathPlanPos7X 0;
BA_ "GenSigInvalidValue" SG_ 969 ADC_PathPlanPos7X 0;
BA_ "GenSigSendType" SG_ 969 ADC_PathPlanPos7X 1;
BA_ "GenSigStartValue" SG_ 969 ADC_PathPlanPos7X 0;
BA_ "GenSigTimeoutValue" SG_ 969 ADC_PathPlanPos7X 0;
BA_ "Remark" SG_ 969 ADC_PathPlanPos7X "";
BA_ "EventCommandSignal" SG_ 969 ADC_PathPlanPos7Y 0;
BA_ "GatewayedSignals" SG_ 969 ADC_PathPlanPos7Y 0;
BA_ "GenSigInactiveValue" SG_ 969 ADC_PathPlanPos7Y 0;
BA_ "GenSigInvalidValue" SG_ 969 ADC_PathPlanPos7Y 0;
BA_ "GenSigSendType" SG_ 969 ADC_PathPlanPos7Y 1;
BA_ "GenSigStartValue" SG_ 969 ADC_PathPlanPos7Y 0;
BA_ "GenSigTimeoutValue" SG_ 969 ADC_PathPlanPos7Y 0;
BA_ "Remark" SG_ 969 ADC_PathPlanPos7Y "";
BA_ "EventCommandSignal" SG_ 969 ADC_PathPlanPos8X 0;
BA_ "GatewayedSignals" SG_ 969 ADC_PathPlanPos8X 0;
BA_ "GenSigInactiveValue" SG_ 969 ADC_PathPlanPos8X 0;
BA_ "GenSigInvalidValue" SG_ 969 ADC_PathPlanPos8X 0;
BA_ "GenSigSendType" SG_ 969 ADC_PathPlanPos8X 1;
BA_ "GenSigStartValue" SG_ 969 ADC_PathPlanPos8X 0;
BA_ "GenSigTimeoutValue" SG_ 969 ADC_PathPlanPos8X 0;
BA_ "Remark" SG_ 969 ADC_PathPlanPos8X "";
BA_ "EventCommandSignal" SG_ 969 ADC_PathPlanPos8Y 0;
BA_ "GatewayedSignals" SG_ 969 ADC_PathPlanPos8Y 0;
BA_ "GenSigInactiveValue" SG_ 969 ADC_PathPlanPos8Y 0;
BA_ "GenSigInvalidValue" SG_ 969 ADC_PathPlanPos8Y 0;
BA_ "GenSigSendType" SG_ 969 ADC_PathPlanPos8Y 1;
BA_ "GenSigStartValue" SG_ 969 ADC_PathPlanPos8Y 0;
BA_ "GenSigTimeoutValue" SG_ 969 ADC_PathPlanPos8Y 0;
BA_ "Remark" SG_ 969 ADC_PathPlanPos8Y "";
BA_ "EventCommandSignal" SG_ 969 ADC_PathPlanPos9X 0;
BA_ "GatewayedSignals" SG_ 969 ADC_PathPlanPos9X 0;
BA_ "GenSigInactiveValue" SG_ 969 ADC_PathPlanPos9X 0;
BA_ "GenSigInvalidValue" SG_ 969 ADC_PathPlanPos9X 0;
BA_ "GenSigSendType" SG_ 969 ADC_PathPlanPos9X 1;
BA_ "GenSigStartValue" SG_ 969 ADC_PathPlanPos9X 0;
BA_ "GenSigTimeoutValue" SG_ 969 ADC_PathPlanPos9X 0;
BA_ "Remark" SG_ 969 ADC_PathPlanPos9X "";
BA_ "EventCommandSignal" SG_ 969 ADC_PathPlanPos9Y 0;
BA_ "GatewayedSignals" SG_ 969 ADC_PathPlanPos9Y 0;
BA_ "GenSigInactiveValue" SG_ 969 ADC_PathPlanPos9Y 0;
BA_ "GenSigInvalidValue" SG_ 969 ADC_PathPlanPos9Y 0;
BA_ "GenSigSendType" SG_ 969 ADC_PathPlanPos9Y 1;
BA_ "GenSigStartValue" SG_ 969 ADC_PathPlanPos9Y 0;
BA_ "GenSigTimeoutValue" SG_ 969 ADC_PathPlanPos9Y 0;
BA_ "Remark" SG_ 969 ADC_PathPlanPos9Y "";
BA_ "EventCommandSignal" SG_ 969 ADC_PathPlanPos10X 0;
BA_ "GatewayedSignals" SG_ 969 ADC_PathPlanPos10X 0;
BA_ "GenSigInactiveValue" SG_ 969 ADC_PathPlanPos10X 0;
BA_ "GenSigInvalidValue" SG_ 969 ADC_PathPlanPos10X 0;
BA_ "GenSigSendType" SG_ 969 ADC_PathPlanPos10X 1;
BA_ "GenSigStartValue" SG_ 969 ADC_PathPlanPos10X 0;
BA_ "GenSigTimeoutValue" SG_ 969 ADC_PathPlanPos10X 0;
BA_ "Remark" SG_ 969 ADC_PathPlanPos10X "";
BA_ "EventCommandSignal" SG_ 969 ADC_PathPlanPos10Y 0;
BA_ "GatewayedSignals" SG_ 969 ADC_PathPlanPos10Y 0;
BA_ "GenSigInactiveValue" SG_ 969 ADC_PathPlanPos10Y 0;
BA_ "GenSigInvalidValue" SG_ 969 ADC_PathPlanPos10Y 0;
BA_ "GenSigSendType" SG_ 969 ADC_PathPlanPos10Y 1;
BA_ "GenSigStartValue" SG_ 969 ADC_PathPlanPos10Y 0;
BA_ "GenSigTimeoutValue" SG_ 969 ADC_PathPlanPos10Y 0;
BA_ "Remark" SG_ 969 ADC_PathPlanPos10Y "";
BA_ "EventCommandSignal" SG_ 969 ADC_PathPlanPos11X 0;
BA_ "GatewayedSignals" SG_ 969 ADC_PathPlanPos11X 0;
BA_ "GenSigInactiveValue" SG_ 969 ADC_PathPlanPos11X 0;
BA_ "GenSigInvalidValue" SG_ 969 ADC_PathPlanPos11X 0;
BA_ "GenSigSendType" SG_ 969 ADC_PathPlanPos11X 1;
BA_ "GenSigStartValue" SG_ 969 ADC_PathPlanPos11X 0;
BA_ "GenSigTimeoutValue" SG_ 969 ADC_PathPlanPos11X 0;
BA_ "Remark" SG_ 969 ADC_PathPlanPos11X "";
BA_ "EventCommandSignal" SG_ 969 ADC_PathPlanPos11Y 0;
BA_ "GatewayedSignals" SG_ 969 ADC_PathPlanPos11Y 0;
BA_ "GenSigInactiveValue" SG_ 969 ADC_PathPlanPos11Y 0;
BA_ "GenSigInvalidValue" SG_ 969 ADC_PathPlanPos11Y 0;
BA_ "GenSigSendType" SG_ 969 ADC_PathPlanPos11Y 1;
BA_ "GenSigStartValue" SG_ 969 ADC_PathPlanPos11Y 0;
BA_ "GenSigTimeoutValue" SG_ 969 ADC_PathPlanPos11Y 0;
BA_ "Remark" SG_ 969 ADC_PathPlanPos11Y "";
BA_ "EventCommandSignal" SG_ 969 ADC_PathPlanPos12X 0;
BA_ "GatewayedSignals" SG_ 969 ADC_PathPlanPos12X 0;
BA_ "GenSigInactiveValue" SG_ 969 ADC_PathPlanPos12X 0;
BA_ "GenSigInvalidValue" SG_ 969 ADC_PathPlanPos12X 0;
BA_ "GenSigSendType" SG_ 969 ADC_PathPlanPos12X 1;
BA_ "GenSigStartValue" SG_ 969 ADC_PathPlanPos12X 0;
BA_ "GenSigTimeoutValue" SG_ 969 ADC_PathPlanPos12X 0;
BA_ "Remark" SG_ 969 ADC_PathPlanPos12X "";
BA_ "EventCommandSignal" SG_ 969 ADC_PathPlanPos12Y 0;
BA_ "GatewayedSignals" SG_ 969 ADC_PathPlanPos12Y 0;
BA_ "GenSigInactiveValue" SG_ 969 ADC_PathPlanPos12Y 0;
BA_ "GenSigInvalidValue" SG_ 969 ADC_PathPlanPos12Y 0;
BA_ "GenSigSendType" SG_ 969 ADC_PathPlanPos12Y 1;
BA_ "GenSigStartValue" SG_ 969 ADC_PathPlanPos12Y 0;
BA_ "GenSigTimeoutValue" SG_ 969 ADC_PathPlanPos12Y 0;
BA_ "Remark" SG_ 969 ADC_PathPlanPos12Y "";
BA_ "EventCommandSignal" SG_ 969 ADC_PathPlanPos13X 0;
BA_ "GatewayedSignals" SG_ 969 ADC_PathPlanPos13X 0;
BA_ "GenSigInactiveValue" SG_ 969 ADC_PathPlanPos13X 0;
BA_ "GenSigInvalidValue" SG_ 969 ADC_PathPlanPos13X 0;
BA_ "GenSigSendType" SG_ 969 ADC_PathPlanPos13X 1;
BA_ "GenSigStartValue" SG_ 969 ADC_PathPlanPos13X 0;
BA_ "GenSigTimeoutValue" SG_ 969 ADC_PathPlanPos13X 0;
BA_ "Remark" SG_ 969 ADC_PathPlanPos13X "";
BA_ "EventCommandSignal" SG_ 969 ADC_PathPlanPos13Y 0;
BA_ "GatewayedSignals" SG_ 969 ADC_PathPlanPos13Y 0;
BA_ "GenSigInactiveValue" SG_ 969 ADC_PathPlanPos13Y 0;
BA_ "GenSigInvalidValue" SG_ 969 ADC_PathPlanPos13Y 0;
BA_ "GenSigSendType" SG_ 969 ADC_PathPlanPos13Y 1;
BA_ "GenSigStartValue" SG_ 969 ADC_PathPlanPos13Y 0;
BA_ "GenSigTimeoutValue" SG_ 969 ADC_PathPlanPos13Y 0;
BA_ "Remark" SG_ 969 ADC_PathPlanPos13Y "";
BA_ "EventCommandSignal" SG_ 969 ADC_PathPlanPos14X 0;
BA_ "GatewayedSignals" SG_ 969 ADC_PathPlanPos14X 0;
BA_ "GenSigInactiveValue" SG_ 969 ADC_PathPlanPos14X 0;
BA_ "GenSigInvalidValue" SG_ 969 ADC_PathPlanPos14X 0;
BA_ "GenSigSendType" SG_ 969 ADC_PathPlanPos14X 1;
BA_ "GenSigStartValue" SG_ 969 ADC_PathPlanPos14X 0;
BA_ "GenSigTimeoutValue" SG_ 969 ADC_PathPlanPos14X 0;
BA_ "Remark" SG_ 969 ADC_PathPlanPos14X "";
BA_ "EventCommandSignal" SG_ 969 ADC_PathPlanPos14Y 0;
BA_ "GatewayedSignals" SG_ 969 ADC_PathPlanPos14Y 0;
BA_ "GenSigInactiveValue" SG_ 969 ADC_PathPlanPos14Y 0;
BA_ "GenSigInvalidValue" SG_ 969 ADC_PathPlanPos14Y 0;
BA_ "GenSigSendType" SG_ 969 ADC_PathPlanPos14Y 1;
BA_ "GenSigStartValue" SG_ 969 ADC_PathPlanPos14Y 0;
BA_ "GenSigTimeoutValue" SG_ 969 ADC_PathPlanPos14Y 0;
BA_ "Remark" SG_ 969 ADC_PathPlanPos14Y "";
BA_ "EventCommandSignal" SG_ 969 ADC_PathPlanPos15X 0;
BA_ "GatewayedSignals" SG_ 969 ADC_PathPlanPos15X 0;
BA_ "GenSigInactiveValue" SG_ 969 ADC_PathPlanPos15X 0;
BA_ "GenSigInvalidValue" SG_ 969 ADC_PathPlanPos15X 0;
BA_ "GenSigSendType" SG_ 969 ADC_PathPlanPos15X 1;
BA_ "GenSigStartValue" SG_ 969 ADC_PathPlanPos15X 0;
BA_ "GenSigTimeoutValue" SG_ 969 ADC_PathPlanPos15X 0;
BA_ "Remark" SG_ 969 ADC_PathPlanPos15X "";
BA_ "EventCommandSignal" SG_ 969 ADC_PathPlanPos15Y 0;
BA_ "GatewayedSignals" SG_ 969 ADC_PathPlanPos15Y 0;
BA_ "GenSigInactiveValue" SG_ 969 ADC_PathPlanPos15Y 0;
BA_ "GenSigInvalidValue" SG_ 969 ADC_PathPlanPos15Y 0;
BA_ "GenSigSendType" SG_ 969 ADC_PathPlanPos15Y 1;
BA_ "GenSigStartValue" SG_ 969 ADC_PathPlanPos15Y 0;
BA_ "GenSigTimeoutValue" SG_ 969 ADC_PathPlanPos15Y 0;
BA_ "Remark" SG_ 969 ADC_PathPlanPos15Y "";
BA_ "EventCommandSignal" SG_ 969 ADC_PathPlanPos16X 0;
BA_ "GatewayedSignals" SG_ 969 ADC_PathPlanPos16X 0;
BA_ "GenSigInactiveValue" SG_ 969 ADC_PathPlanPos16X 0;
BA_ "GenSigInvalidValue" SG_ 969 ADC_PathPlanPos16X 0;
BA_ "GenSigSendType" SG_ 969 ADC_PathPlanPos16X 1;
BA_ "GenSigStartValue" SG_ 969 ADC_PathPlanPos16X 0;
BA_ "GenSigTimeoutValue" SG_ 969 ADC_PathPlanPos16X 0;
BA_ "Remark" SG_ 969 ADC_PathPlanPos16X "";
BA_ "EventCommandSignal" SG_ 969 ADC_PathPlanPos16Y 0;
BA_ "GatewayedSignals" SG_ 969 ADC_PathPlanPos16Y 0;
BA_ "GenSigInactiveValue" SG_ 969 ADC_PathPlanPos16Y 0;
BA_ "GenSigInvalidValue" SG_ 969 ADC_PathPlanPos16Y 0;
BA_ "GenSigSendType" SG_ 969 ADC_PathPlanPos16Y 1;
BA_ "GenSigStartValue" SG_ 969 ADC_PathPlanPos16Y 0;
BA_ "GenSigTimeoutValue" SG_ 969 ADC_PathPlanPos16Y 0;
BA_ "Remark" SG_ 969 ADC_PathPlanPos16Y "";
BA_ "EventCommandSignal" SG_ 969 ADC_PathPlanPos17X 0;
BA_ "GatewayedSignals" SG_ 969 ADC_PathPlanPos17X 0;
BA_ "GenSigInactiveValue" SG_ 969 ADC_PathPlanPos17X 0;
BA_ "GenSigInvalidValue" SG_ 969 ADC_PathPlanPos17X 0;
BA_ "GenSigSendType" SG_ 969 ADC_PathPlanPos17X 1;
BA_ "GenSigStartValue" SG_ 969 ADC_PathPlanPos17X 0;
BA_ "GenSigTimeoutValue" SG_ 969 ADC_PathPlanPos17X 0;
BA_ "Remark" SG_ 969 ADC_PathPlanPos17X "";
BA_ "EventCommandSignal" SG_ 969 ADC_PathPlanPos17Y 0;
BA_ "GatewayedSignals" SG_ 969 ADC_PathPlanPos17Y 0;
BA_ "GenSigInactiveValue" SG_ 969 ADC_PathPlanPos17Y 0;
BA_ "GenSigInvalidValue" SG_ 969 ADC_PathPlanPos17Y 0;
BA_ "GenSigSendType" SG_ 969 ADC_PathPlanPos17Y 1;
BA_ "GenSigStartValue" SG_ 969 ADC_PathPlanPos17Y 0;
BA_ "GenSigTimeoutValue" SG_ 969 ADC_PathPlanPos17Y 0;
BA_ "Remark" SG_ 969 ADC_PathPlanPos17Y "";
BA_ "EventCommandSignal" SG_ 969 ADC_PathPlanPos18X 0;
BA_ "GatewayedSignals" SG_ 969 ADC_PathPlanPos18X 0;
BA_ "GenSigInactiveValue" SG_ 969 ADC_PathPlanPos18X 0;
BA_ "GenSigInvalidValue" SG_ 969 ADC_PathPlanPos18X 0;
BA_ "GenSigSendType" SG_ 969 ADC_PathPlanPos18X 1;
BA_ "GenSigStartValue" SG_ 969 ADC_PathPlanPos18X 0;
BA_ "GenSigTimeoutValue" SG_ 969 ADC_PathPlanPos18X 0;
BA_ "Remark" SG_ 969 ADC_PathPlanPos18X "";
BA_ "EventCommandSignal" SG_ 969 ADC_PathPlanPos18Y 0;
BA_ "GatewayedSignals" SG_ 969 ADC_PathPlanPos18Y 0;
BA_ "GenSigInactiveValue" SG_ 969 ADC_PathPlanPos18Y 0;
BA_ "GenSigInvalidValue" SG_ 969 ADC_PathPlanPos18Y 0;
BA_ "GenSigSendType" SG_ 969 ADC_PathPlanPos18Y 1;
BA_ "GenSigStartValue" SG_ 969 ADC_PathPlanPos18Y 0;
BA_ "GenSigTimeoutValue" SG_ 969 ADC_PathPlanPos18Y 0;
BA_ "Remark" SG_ 969 ADC_PathPlanPos18Y "";
BA_ "EventCommandSignal" SG_ 969 ADC_PathPlanPos19X 0;
BA_ "GatewayedSignals" SG_ 969 ADC_PathPlanPos19X 0;
BA_ "GenSigInactiveValue" SG_ 969 ADC_PathPlanPos19X 0;
BA_ "GenSigInvalidValue" SG_ 969 ADC_PathPlanPos19X 0;
BA_ "GenSigSendType" SG_ 969 ADC_PathPlanPos19X 1;
BA_ "GenSigStartValue" SG_ 969 ADC_PathPlanPos19X 0;
BA_ "GenSigTimeoutValue" SG_ 969 ADC_PathPlanPos19X 0;
BA_ "Remark" SG_ 969 ADC_PathPlanPos19X "";
BA_ "EventCommandSignal" SG_ 969 ADC_PathPlanPos19Y 0;
BA_ "GatewayedSignals" SG_ 969 ADC_PathPlanPos19Y 0;
BA_ "GenSigInactiveValue" SG_ 969 ADC_PathPlanPos19Y 0;
BA_ "GenSigInvalidValue" SG_ 969 ADC_PathPlanPos19Y 0;
BA_ "GenSigSendType" SG_ 969 ADC_PathPlanPos19Y 1;
BA_ "GenSigStartValue" SG_ 969 ADC_PathPlanPos19Y 0;
BA_ "GenSigTimeoutValue" SG_ 969 ADC_PathPlanPos19Y 0;
BA_ "Remark" SG_ 969 ADC_PathPlanPos19Y "";
BA_ "EventCommandSignal" SG_ 969 ADC_PathPlanPos20X 0;
BA_ "GatewayedSignals" SG_ 969 ADC_PathPlanPos20X 0;
BA_ "GenSigInactiveValue" SG_ 969 ADC_PathPlanPos20X 0;
BA_ "GenSigInvalidValue" SG_ 969 ADC_PathPlanPos20X 0;
BA_ "GenSigSendType" SG_ 969 ADC_PathPlanPos20X 1;
BA_ "GenSigStartValue" SG_ 969 ADC_PathPlanPos20X 0;
BA_ "GenSigTimeoutValue" SG_ 969 ADC_PathPlanPos20X 0;
BA_ "Remark" SG_ 969 ADC_PathPlanPos20X "";
BA_ "EventCommandSignal" SG_ 969 ADC_PathPlanPos20Y 0;
BA_ "GatewayedSignals" SG_ 969 ADC_PathPlanPos20Y 0;
BA_ "GenSigInactiveValue" SG_ 969 ADC_PathPlanPos20Y 0;
BA_ "GenSigInvalidValue" SG_ 969 ADC_PathPlanPos20Y 0;
BA_ "GenSigSendType" SG_ 969 ADC_PathPlanPos20Y 1;
BA_ "GenSigStartValue" SG_ 969 ADC_PathPlanPos20Y 0;
BA_ "GenSigTimeoutValue" SG_ 969 ADC_PathPlanPos20Y 0;
BA_ "Remark" SG_ 969 ADC_PathPlanPos20Y "";
BA_ "EventCommandSignal" SG_ 970 ADC_AutEve 0;
BA_ "GatewayedSignals" SG_ 970 ADC_AutEve 0;
BA_ "GenSigInactiveValue" SG_ 970 ADC_AutEve 0;
BA_ "GenSigInvalidValue" SG_ 970 ADC_AutEve 0;
BA_ "GenSigSendType" SG_ 970 ADC_AutEve 1;
BA_ "GenSigStartValue" SG_ 970 ADC_AutEve 0;
BA_ "GenSigTimeoutValue" SG_ 970 ADC_AutEve 0;
BA_ "Remark" SG_ 970 ADC_AutEve "";
BA_ "EventCommandSignal" SG_ 970 ADC_SeldParkID 0;
BA_ "GatewayedSignals" SG_ 970 ADC_SeldParkID 0;
BA_ "GenSigInactiveValue" SG_ 970 ADC_SeldParkID 0;
BA_ "GenSigInvalidValue" SG_ 970 ADC_SeldParkID 0;
BA_ "GenSigSendType" SG_ 970 ADC_SeldParkID 1;
BA_ "GenSigStartValue" SG_ 970 ADC_SeldParkID 0;
BA_ "GenSigTimeoutValue" SG_ 970 ADC_SeldParkID 0;
BA_ "Remark" SG_ 970 ADC_SeldParkID "";
BA_ "EventCommandSignal" SG_ 970 ADC_VehParkMod 0;
BA_ "GatewayedSignals" SG_ 970 ADC_VehParkMod 0;
BA_ "GenSigInactiveValue" SG_ 970 ADC_VehParkMod 0;
BA_ "GenSigInvalidValue" SG_ 970 ADC_VehParkMod 0;
BA_ "GenSigSendType" SG_ 970 ADC_VehParkMod 1;
BA_ "GenSigStartValue" SG_ 970 ADC_VehParkMod 0;
BA_ "GenSigTimeoutValue" SG_ 970 ADC_VehParkMod 0;
BA_ "Remark" SG_ 970 ADC_VehParkMod "";
BA_ "EventCommandSignal" SG_ 970 ADC_ParkProgs 0;
BA_ "GatewayedSignals" SG_ 970 ADC_ParkProgs 0;
BA_ "GenSigInactiveValue" SG_ 970 ADC_ParkProgs 0;
BA_ "GenSigInvalidValue" SG_ 970 ADC_ParkProgs 0;
BA_ "GenSigSendType" SG_ 970 ADC_ParkProgs 1;
BA_ "GenSigStartValue" SG_ 970 ADC_ParkProgs 0;
BA_ "GenSigTimeoutValue" SG_ 970 ADC_ParkProgs 0;
BA_ "Remark" SG_ 970 ADC_ParkProgs "";
BA_ "EventCommandSignal" SG_ 970 ADC_ParkRmngDst 0;
BA_ "GatewayedSignals" SG_ 970 ADC_ParkRmngDst 0;
BA_ "GenSigInactiveValue" SG_ 970 ADC_ParkRmngDst 0;
BA_ "GenSigInvalidValue" SG_ 970 ADC_ParkRmngDst 0;
BA_ "GenSigSendType" SG_ 970 ADC_ParkRmngDst 1;
BA_ "GenSigStartValue" SG_ 970 ADC_ParkRmngDst 0;
BA_ "GenSigTimeoutValue" SG_ 970 ADC_ParkRmngDst 0;
BA_ "Remark" SG_ 970 ADC_ParkRmngDst "";
BA_ "EventCommandSignal" SG_ 970 ADC_ObstclDst 0;
BA_ "GatewayedSignals" SG_ 970 ADC_ObstclDst 0;
BA_ "GenSigInactiveValue" SG_ 970 ADC_ObstclDst 0;
BA_ "GenSigInvalidValue" SG_ 970 ADC_ObstclDst 0;
BA_ "GenSigSendType" SG_ 970 ADC_ObstclDst 1;
BA_ "GenSigStartValue" SG_ 970 ADC_ObstclDst 0;
BA_ "GenSigTimeoutValue" SG_ 970 ADC_ObstclDst 0;
BA_ "Remark" SG_ 970 ADC_ObstclDst "";
VAL_ 419 ADC_AngReqSt_A 0 "Inhibited" 1 "Ready" 2 "Active" 3 "Failed"  ;
VAL_ 419 ADC_AngReqFunction 0 "No request" 1 "Request by LKAS" 2 "Request by PAS" 3 "Reserved"  ;
VAL_ 419 ADC_BrakeLightReq 0 "No Request" 1 "turn on" 2 "turn off"  ;
VAL_ 419 ADC_AssistParaSwitchReq 0 "No request" 1 "Request"  ;
VAL_ 419 ADC_AngReqRdntReq_A 0 "No request" 1 "Request"  ;
VAL_ 419 ADC_SteerGainReq 0 "No request" 1 "Request"  ;
VAL_ 419 ADC_StrgWhlVibrWarnLevel 0 "No request" 1 "Request level 1" 2 "Request level 2" 3 "Request level 3"  ;
VAL_ 419 ADC_ActTrqReqEnable 0 "Disable" 1 "Enable"  ;
VAL_ 419 ADC_VLCSt 0 "VLC not working" 1 "VLC Override possible" 2 "VLC Override impossible" 3 "Reserve"  ;
VAL_ 419 ADC_EvsSteerReq 0 "No request" 1 "Request"  ;
VAL_ 419 ADC_StrgWhlVibrWarnReq 0 "No request" 1 "Request"  ;
VAL_ 419 ADC_ADASLongCtrlFuncMode 0 "Cruise" 1 "APA" 2 "Reserve" 3 "Reserve" 4 "Reserve" 5 "Reserve" 6 "Reserve" 7 "Reserve"  ;
VAL_ 419 ADC_LongCtrlAvailability 0 "Not available" 1 "Available"  ;
VAL_ 419 ADC_LongCtrlModeForBrkSys 0 "Off mode" 1 "L2 Active" 2 "L2++ Active" 3 "Not used" 4 "Not used" 5 "Not used" 6 "Not used" 7 "Not used"  ;
VAL_ 419 IFC_DPTst 0 "None" 1 "DrivingTransporting" 2 "ParkingTransporting" 3 "DrivingSignFailed" 4 "ParkingSignFailed" 5 "Failed"  ;
VAL_ 419 ADC_DrvTarTqMod2EPB 0 "Override mode" 1 "Inhibit mode" 2 "reserved" 3 "reserved"  ;
VAL_ 419 ADC_LongCtrlTargetAxReq 0 "No request" 1 "Request"  ;
VAL_ 419 ADC_LongCtrlTypReq 0 "Comfort Mode" 1 "Emergency Mode"  ;
VAL_ 419 ADC_LongCtrlDecToStopReq 0 "No request" 1 "Request"  ;
VAL_ 419 ADC_LongCtrlDriveOff 0 "No request" 1 "Request"  ;
VAL_ 419 ADC_LongctrlSecureReq 0 "NoRequest" 1 "Request"  ;
VAL_ 419 ADC_ShifttoAVHReq 0 "Not active" 1 "Active"  ;
VAL_ 419 ADC_TrkTargt0St 0 "not dectected" 1 "dectected"  ;
VAL_ 419 ADC_AS_pauseReq 0 "No request" 1 "request"  ;
VAL_ 419 ADC_AS_calibrationReq 0 "Invalid" 1 "Request to Very high level" 2 "Request to High level" 3 "Request to Normal level" 4 "Request to Low level" 5 "Request to Very low level"  ;
VAL_ 419 ADC_AS_exitcurrentlevelReq 0 "No request" 1 "request"  ;
VAL_ 419 ADC_AS_ReqToadjust 0 "Invalid" 1 "PAS Request to Very high level" 2 "PAS Request to High level" 3 "PAS Request to Normal level" 4 "PAS Request to Low level" 5 "PAS Request to Very low level"  ;
VAL_ 419 ADC_AS_UnsafelevelunableReq 0 "No request" 1 "request"  ;
VAL_ 419 ADC_AEBFaultSt 0 "Not fault" 1 "Fault"  ;
VAL_ 419 ADC_AEBOffSt 0 "On" 1 "Off"  ;
VAL_ 419 ADC_AEBInterventionSt 0 "No intervention" 1 "Intervention"  ;
VAL_ 419 ADC_AEBDecelCtrlReq 0 "No request" 1 "Request"  ;
VAL_ 419 ADC_AEBLVehHoldReq 0 "No request" 1 "Request"  ;
VAL_ 419 ADC_ABAReq 0 "No request" 1 "Request"  ;
VAL_ 419 ADC_ABALevel 0 "Level 0" 1 "Level 1" 2 "Level 2" 3 "Level 3"  ;
VAL_ 419 ADC_AWBReq 0 "No request" 1 "Request"  ;
VAL_ 419 ADC_ABPReq 0 "No request" 1 "Request"  ;
VAL_ 419 ADC_AWBLevel 0 "No level" 1 "Level 1" 2 "Level 2" 3 "Level 3" 4 "Level 4" 5 "Not used" 6 "Not used" 7 "Not used"  ;
VAL_ 419 ADC_AEBTarCalss 0 "Not dectected" 1 "Car" 2 "Pedestrian" 3 "Two wheels" 4 "Motorcycle" 5 "Truck" 6 "Unknown" 7 "Reserve"  ;
VAL_ 419 ADC_AEBTarDetSensor 0 "Invalid" 1 "Not Fusion" 2 "Not used" 3 "Fusion"  ;
VAL_ 419 ADC_TurnLightReq 0 "No Request" 1 "turn off" 2 "turn on left turn lamp" 3 "turn on right turn lamp" 4 "turn on Hazard Lamp" 5 "turn on RCW Hazard Lamp(4HZ)"  ;
VAL_ 419 ADC_PAA2ESPAxReqEnable 0 "Flase" 1 "True"  ;
VAL_ 419 ADC_PAA2ESPBrakeFunctionMode 0 "None" 1 "APA" 2 "RPA" 3 "AVP" 4 "Dynamic AVP"  ;
VAL_ 419 ADC_PAA2ESPEpbReq 0 "None" 1 "ReleaseReq" 2 "ApplyReq"  ;
VAL_ 419 ADC_PAA2ESPEpbReqSt 0 "No request" 1 "Request"  ;
VAL_ 419 ADC_PAA2EPBEpbReq 0 "None" 1 "ReleaseReq" 2 "ApplyReq"  ;
VAL_ 419 ADC_ESPSwitchReq 0 "Not Request" 1 "Request"  ;
VAL_ 419 ADC_PAA2EPBEpbReqSt 0 "No request" 1 "Request"  ;
VAL_ 419 ADC_PAA2EPBBrakeFunctionMode 0 "Not active" 1 "Active"  ;
VAL_ 419 ADC_PAA2ESPApEmgyBrkReq 0 "Flase" 1 "True"  ;
VAL_ 419 ADC_PAA2ESPComfBrakeReq 0 "ComfBrakeReq_NoReq" 1 "ComfBrakeReq_Type1" 2 "ComfBrakeReq_Type2"  ;
VAL_ 419 ADC_PAA2ESPApDriveOffReq 0 "Flase" 1 "True"  ;
VAL_ 419 ADC_PAA2ESPApStandstillReq 0 "Flase" 1 "True"  ;
VAL_ 419 ADC_PAA2ESPApPrefillReq 0 "Flase" 1 "True"  ;
VAL_ 419 ADC_EPBReq 0 "Not Request" 1 "Request"  ;
VAL_ 419 ADC_VehTorqLimitEnable 0 "Not enable" 1 "Enable"  ;
VAL_ 419 ADC_VehTorqReqEnable 0 "Not enable" 1 "Enable"  ;
VAL_ 419 ADC_PAAPwrModeReq 0 "No Request" 1 "Power On Request (PTready)"  ;
VAL_ 419 ADC_PAAGrarLvlReq 0 "No Request" 1 "Park" 2 "Reversed" 3 "Neutral" 4 "Drive" 5 "Reversed" 6 "Reversed" 7 "Reversed"  ;
VAL_ 419 ADC_PAAGrarLvlReqEnable 0 "No request" 1 "Gear shift request"  ;
VAL_ 419 ADC_ACCMode_C 0 "Failure" 1 "Passive mode" 2 "Standby mode" 3 "Active control mode" 4 "Brake only mode" 5 "Override" 6 "Standwait" 7 "Standactive" 8 "Not used" 9 "Not used" 10 "Not used" 11 "Not used" 12 "Not used" 13 "Not used" 14 "Not used" 15 "Not used"  ;
VAL_ 419 ADC_FcsActiveStatus 0 "No Active" 1 "Active"  ;
VAL_ 419 ADC_ActTrqReqVD 0 "invalid" 1 "valid"  ;
VAL_ 419 ADC_RCTBBrkReq 0 "No request" 1 "Request"  ;
VAL_ 419 ADC_BrkTarTqEna 0 "disable" 1 "enable"  ;
VAL_ 419 ADC_BrkTarTqMod 0 "no request" 1 "Cruise function" 2 "Parking function" 3 "Reserved"  ;
VAL_ 419 ADC_EpbModReqVld 0 "Invalid" 1 "Valid"  ;
VAL_ 419 ADC_RWUEna 0 "disable" 1 "enable"  ;
VAL_ 419 ADC_BrkHoldReq 0 "No request" 1 "Not active" 2 "Active" 3 "Reserved"  ;
VAL_ 419 ADC_AngReqAvl 0 "Not available" 1 "Available"  ;
VAL_ 419 ADC_TarGearReqVld 0 "Invalid" 1 "Valid"  ;
VAL_ 419 ADC_FctSts 0 "Off" 1 "On"  ;
VAL_ 419 ADC_BrkTarTqVld 0 "Invalid" 1 "Valid"  ;
VAL_ 419 ADC_AebBrkTarTqVld 0 "Invalid" 1 "Valid"  ;
VAL_ 419 ADC_AebBrkTarTqEna 0 "disable" 1 "enable"  ;
VAL_ 419 ADC_ElecBrkFnSwitch 0 "ON" 1 "OFF"  ;
VAL_ 419 ADC_RWUVld 0 "Invalid" 1 "Valid"  ;
VAL_ 419 ADC_DriverPresent 0 "Undefined" 1 "Driver  Not Present" 2 "Driver  Present" 3 "Failure"  ;
VAL_ 969 ADAS_RemoterParkingOnlineOrNot 0 "None" 1 "rolling counter" 2 "rolling counter" 3 "rolling counter" 4 "rolling counter" 5 "rolling counter" 6 "rolling counter" 7 "rolling counter" 8 "rolling counter" 9 "rolling counter" 10 "rolling counter" 11 "rolling counter" 12 "rolling counter" 13 "rolling counter" 14 "rolling counter" 15 "rolling counter" 16 "rolling counter" 17 "rolling counter" 18 "rolling counter" 19 "rolling counter" 20 "rolling counter" 21 "rolling counter" 22 "rolling counter" 23 "rolling counter" 24 "rolling counter" 25 "rolling counter" 26 "rolling counter" 27 "rolling counter" 28 "rolling counter" 29 "rolling counter" 30 "rolling counter" 31 "rolling counter" 32 "rolling counter" 33 "rolling counter" 34 "rolling counter" 35 "rolling counter" 36 "rolling counter" 37 "rolling counter" 38 "rolling counter" 39 "rolling counter" 40 "rolling counter" 41 "rolling counter" 42 "rolling counter" 43 "rolling counter" 44 "rolling counter" 45 "rolling counter" 46 "rolling counter" 47 "rolling counter" 48 "rolling counter" 49 "rolling counter" 50 "rolling counter" 51 "rolling counter" 52 "rolling counter" 53 "rolling counter" 54 "rolling counter" 55 "rolling counter" 56 "rolling counter" 57 "rolling counter" 58 "rolling counter" 59 "rolling counter" 60 "rolling counter" 61 "rolling counter" 62 "rolling counter" 63 "rolling counter" 64 "rolling counter" 65 "rolling counter" 66 "rolling counter" 67 "rolling counter" 68 "rolling counter" 69 "rolling counter" 70 "rolling counter" 71 "rolling counter" 72 "rolling counter" 73 "rolling counter" 74 "rolling counter" 75 "rolling counter" 76 "rolling counter" 77 "rolling counter" 78 "rolling counter" 79 "rolling counter" 80 "rolling counter" 81 "rolling counter" 82 "rolling counter" 83 "rolling counter" 84 "rolling counter" 85 "rolling counter" 86 "rolling counter" 87 "rolling counter" 88 "rolling counter" 89 "rolling counter" 90 "rolling counter" 91 "rolling counter" 92 "rolling counter" 93 "rolling counter" 94 "rolling counter" 95 "rolling counter" 96 "rolling counter" 97 "rolling counter" 98 "rolling counter" 99 "rolling counter" 100 "rolling counter" 101 "rolling counter" 102 "rolling counter" 103 "rolling counter" 104 "rolling counter" 105 "rolling counter" 106 "rolling counter" 107 "rolling counter" 108 "rolling counter" 109 "rolling counter" 110 "rolling counter" 111 "rolling counter" 112 "rolling counter" 113 "rolling counter" 114 "rolling counter" 115 "rolling counter" 116 "rolling counter" 117 "rolling counter" 118 "rolling counter" 119 "rolling counter" 120 "rolling counter" 121 "rolling counter" 122 "rolling counter" 123 "rolling counter" 124 "rolling counter" 125 "rolling counter" 126 "rolling counter" 127 "rolling counter" 128 "rolling counter" 129 "rolling counter" 130 "rolling counter" 131 "rolling counter" 132 "rolling counter" 133 "rolling counter" 134 "rolling counter" 135 "rolling counter" 136 "rolling counter" 137 "rolling counter" 138 "rolling counter" 139 "rolling counter" 140 "rolling counter" 141 "rolling counter" 142 "rolling counter" 143 "rolling counter" 144 "rolling counter" 145 "rolling counter" 146 "rolling counter" 147 "rolling counter" 148 "rolling counter" 149 "rolling counter" 150 "rolling counter" 151 "rolling counter" 152 "rolling counter" 153 "rolling counter" 154 "rolling counter" 155 "rolling counter" 156 "rolling counter" 157 "rolling counter" 158 "rolling counter" 159 "rolling counter" 160 "rolling counter" 161 "rolling counter" 162 "rolling counter" 163 "rolling counter" 164 "rolling counter" 165 "rolling counter" 166 "rolling counter" 167 "rolling counter" 168 "rolling counter" 169 "rolling counter" 170 "rolling counter" 171 "rolling counter" 172 "rolling counter" 173 "rolling counter" 174 "rolling counter" 175 "rolling counter" 176 "rolling counter" 177 "rolling counter" 178 "rolling counter" 179 "rolling counter" 180 "rolling counter" 181 "rolling counter" 182 "rolling counter" 183 "rolling counter" 184 "rolling counter" 185 "rolling counter" 186 "rolling counter" 187 "rolling counter" 188 "rolling counter" 189 "rolling counter" 190 "rolling counter" 191 "rolling counter" 192 "rolling counter" 193 "rolling counter" 194 "rolling counter" 195 "rolling counter" 196 "rolling counter" 197 "rolling counter" 198 "rolling counter" 199 "rolling counter" 200 "rolling counter" 201 "rolling counter" 202 "rolling counter" 203 "rolling counter" 204 "rolling counter" 205 "rolling counter" 206 "rolling counter" 207 "rolling counter" 208 "rolling counter" 209 "rolling counter" 210 "rolling counter" 211 "rolling counter" 212 "rolling counter" 213 "rolling counter" 214 "rolling counter" 215 "rolling counter" 216 "rolling counter" 217 "rolling counter" 218 "rolling counter" 219 "rolling counter" 220 "rolling counter" 221 "rolling counter" 222 "rolling counter" 223 "rolling counter" 224 "rolling counter" 225 "rolling counter" 226 "rolling counter" 227 "rolling counter" 228 "rolling counter" 229 "rolling counter" 230 "rolling counter" 231 "rolling counter" 232 "rolling counter" 233 "rolling counter" 234 "rolling counter" 235 "rolling counter" 236 "rolling counter" 237 "rolling counter" 238 "rolling counter" 239 "rolling counter" 240 "rolling counter" 241 "rolling counter" 242 "rolling counter" 243 "rolling counter" 244 "rolling counter" 245 "rolling counter" 246 "rolling counter" 247 "rolling counter" 248 "rolling counter" 249 "rolling counter" 250 "rolling counter" 251 "rolling counter" 252 "rolling counter" 253 "rolling counter" 254 "rolling counter" 255 "rolling counter"  ;
VAL_ 969 ADC_RpaParkAuthn 0 "phone_authorized_unconfirm" 1 "phone_authorized_confirm" 2 "reserve_1" 3 "reserve_2"  ;
VAL_ 969 ADC_RemParkPatSel 0 "NONE" 1 "PARK_IN_REQUEST_CONFIRMED" 2 "PARK_OUT_REQUEST_CONFIRMED" 3 "RESERVED"  ;
VAL_ 969 ADC_ParkDirCfm 0 "None" 1 "ParallelLeft_confirm" 2 "ParallelRight_confirm" 3 "PerpendicularForward_confirm" 4 "PerpendicularLeftForward_confirm" 5 "PerpendicularRightForward_confirm" 6 "PerpendicularLeftBack_confirm" 7 "PerpendicularRightBack_confirm" 8 "PerpendicularBack_confirm" 9 "Reserved" 10 "Reserved" 11 "Reserved" 12 "Reserved" 13 "Reserved" 14 "Reserved" 15 "Reserved"  ;
VAL_ 969 ADC_ParkStMac 0 "STATE_OFF" 1 "STATE_RDA_FORWARD" 2 "STATE_RDA_BACK" 3 "STATE_RDA_ABORT" 4 "STATE_RDA_FINISH" 5 "STATE_CRUISE_FINISH" 6 "STATE_APA_SUSPEND" 7 "STATE_APA_SEARCH" 8 "STATE_APA_STANDBY" 9 "STATE_PARK_OUT" 10 "STATE_PARK_IN" 11 "STATE_APA_FINISH" 12 "STATE_PAUSE" 13 "STATE_OVERRIDE" 14 "Reserved" 15 "Reserved"  ;
VAL_ 969 ADC_PwrOnOffReq 0 "None" 1 "Power on & Enter Ready" 2 "Power off & Lock car" 3 "Enter the ready state" 4 "Exit ready state (maintain high voltage)" 5 "Power off only" 6 "Reserved" 7 "Reserved"  ;
VAL_ 969 ADC_ParkOutDir_ParaLe 0 "Not available" 1 "Available"  ;
VAL_ 969 ADC_ParkOutDir_ParaRi 0 "Not available" 1 "Available"  ;
VAL_ 969 ADC_ParkOutDir_PerpFwd 0 "Not available" 1 "Available"  ;
VAL_ 969 ADC_ParkOutDir_PerpLeFwd 0 "Not available" 1 "Available"  ;
VAL_ 969 ADC_ParkOutDir_PerpRiFwd 0 "Not available" 1 "Available"  ;
VAL_ 969 ADC_ParkOutDir_PerpLeBack 0 "Not available" 1 "Available"  ;
VAL_ 969 ADC_ParkOutDir_PerpRiBack 0 "Not available" 1 "Available"  ;
VAL_ 969 ADC_ParkOutDir_PerpBack 0 "Not available" 1 "Available"  ;
VAL_ 969 ADC_APA_RPAFctUnavlMsg1 0 "none" 1 "happened"  ;
VAL_ 969 ADC_APA_RPAFctUnavlMsg2 0 "none" 1 "happened"  ;
VAL_ 969 ADC_APA_RPAFctUnavlMsg3 0 "none" 1 "happened"  ;
VAL_ 969 ADC_APA_RPAFctUnavlMsg4 0 "none" 1 "happened"  ;
VAL_ 969 ADC_APA_RPAFctUnavlMsg5 0 "none" 1 "happened"  ;
VAL_ 969 ADC_APA_RPAFctUnavlMsg6 0 "none" 1 "happened"  ;
VAL_ 969 ADC_APA_RPAFctUnavlMsg7 0 "none" 1 "happened"  ;
VAL_ 969 ADC_APA_RPAFctUnavlMsg8 0 "none" 1 "happened"  ;
VAL_ 969 ADC_APA_RPAFctUnavlMsg9 0 "none" 1 "happened"  ;
VAL_ 969 ADC_APA_RPAFctUnavlMsg10 0 "none" 1 "happened"  ;
VAL_ 969 ADC_APA_RPAFctUnavlMsg11 0 "none" 1 "happened"  ;
VAL_ 969 ADC_APA_RPAFctUnavlMsg12 0 "none" 1 "happened"  ;
VAL_ 969 ADC_APA_RPAFctUnavlMsg13 0 "none" 1 "happened"  ;
VAL_ 969 ADC_APA_RPAFctUnavlMsg14 0 "none" 1 "happened"  ;
VAL_ 969 ADC_APA_RPAFctUnavlMsg15 0 "none" 1 "happened"  ;
VAL_ 969 ADC_APA_RPAFctUnavlMsg16 0 "none" 1 "happened"  ;
VAL_ 969 ADC_APA_RPAFctUnavlMsg17 0 "none" 1 "happened"  ;
VAL_ 969 ADC_APA_RPAFctUnavlMsg18 0 "none" 1 "happened"  ;
VAL_ 969 ADC_APA_RPAFctUnavlMsg19 0 "none" 1 "happened"  ;
VAL_ 969 ADC_APA_RPAFctUnavlMsg20 0 "none" 1 "happened"  ;
VAL_ 969 ADC_APA_RPAFctUnavlMsg21 0 "none" 1 "happened"  ;
VAL_ 969 ADC_APA_RPAFctUnavlMsg22 0 "none" 1 "happened"  ;
VAL_ 969 ADC_APA_RPAFctUnavlMsg23 0 "none" 1 "happened"  ;
VAL_ 969 ADC_APA_RPAFctUnavlMsg24 0 "none" 1 "happened"  ;
VAL_ 969 ADC_APA_RPAFctUnavlMsg25 0 "none" 1 "happened"  ;
VAL_ 969 ADC_APA_RPACnclMsg1 0 "none" 1 "happened"  ;
VAL_ 969 ADC_APA_RPACnclMsg2 0 "none" 1 "happened"  ;
VAL_ 969 ADC_APA_RPACnclMsg3 0 "none" 1 "happened"  ;
VAL_ 969 ADC_APA_RPACnclMsg4 0 "none" 1 "happened"  ;
VAL_ 969 ADC_APA_RPACnclMsg5 0 "none" 1 "happened"  ;
VAL_ 969 ADC_APA_RPACnclMsg6 0 "none" 1 "happened"  ;
VAL_ 969 ADC_APA_RPACnclMsg7 0 "none" 1 "happened"  ;
VAL_ 969 ADC_APA_RPACnclMsg8 0 "none" 1 "happened"  ;
VAL_ 969 ADC_APA_RPACnclMsg9 0 "none" 1 "happened"  ;
VAL_ 969 ADC_APA_RPACnclMsg10 0 "none" 1 "happened"  ;
VAL_ 969 ADC_APA_RPACnclMsg11 0 "none" 1 "happened"  ;
VAL_ 969 ADC_APA_RPACnclMsg12 0 "none" 1 "happened"  ;
VAL_ 969 ADC_APA_RPACnclMsg13 0 "none" 1 "happened"  ;
VAL_ 969 ADC_APA_RPACnclMsg14 0 "none" 1 "happened"  ;
VAL_ 969 ADC_APA_RPACnclMsg15 0 "none" 1 "happened"  ;
VAL_ 969 ADC_APA_RPACnclMsg16 0 "none" 1 "happened"  ;
VAL_ 969 ADC_APA_RPACnclMsg17 0 "none" 1 "happened"  ;
VAL_ 969 ADC_APA_RPACnclMsg18 0 "none" 1 "happened"  ;
VAL_ 969 ADC_APA_RPACnclMsg19 0 "none" 1 "happened"  ;
VAL_ 969 ADC_APA_RPACnclMsg20 0 "none" 1 "happened"  ;
VAL_ 969 ADC_APA_RPAPauseMsg1 0 "none" 1 "happened"  ;
VAL_ 969 ADC_APA_RPAPauseMsg2 0 "none" 1 "happened"  ;
VAL_ 969 ADC_APA_RPAPauseMsg3 0 "none" 1 "happened"  ;
VAL_ 969 ADC_APA_RPAPauseMsg4 0 "none" 1 "happened"  ;
VAL_ 969 ADC_APA_RPAPauseMsg5 0 "none" 1 "happened"  ;
VAL_ 969 ADC_APA_RPAPauseMsg6 0 "none" 1 "happened"  ;
VAL_ 969 ADC_APA_RPAPauseMsg7 0 "none" 1 "happened"  ;
VAL_ 969 ADC_APA_RPAPauseMsg8 0 "none" 1 "happened"  ;
VAL_ 969 ADC_APA_RPAPauseMsg9 0 "none" 1 "happened"  ;
VAL_ 969 ADC_APA_RPAPauseMsg10 0 "none" 1 "happened"  ;
VAL_ 970 ADC_AutEve 1 "MOP_HMI_NULL" 2 "MOP_HMI_CRUISE" 3 "MOP_HMI_BYPASS" 4 "MOP_HMI_STOP_MAN" 5 "MOP_HMI_STOP_CAR" 6 "MOP_HMI_FOLLOW" 7 "MOP_HMI_MEET" 8 "MOP_HMI_TIME_OUT" 9 "Reserved" 10 "Reserved" 11 "Reserved" 12 "Reserved" 13 "Reserved" 14 "Reserved" 15 "Reserved"  ;
VAL_ 970 ADC_VehParkMod 0 "None" 1 "Head parkin" 2 "Tail parkin" 3 "reserve_1" 4 "reserver_2"  ;
VAL_ 970 ADC_ObstclDst 0 "None" 1 "FLOBSDistance_Level1" 2 "FLOBSDistance_Level2" 3 "FLOBSDistance_Level3" 4 "FMidOBSDistance_Level1" 5 "FMidOBSDistance_Level2" 6 "FMidOBSDistance_Level3" 7 "FROBSDistance_Level1" 8 "FROBSDistance_Level2" 9 "FROBSDistance_Level3" 10 "RLOBSDistance_Level1" 11 "RLOBSDistanceLevel2" 12 "RLOBSDistanceLevel3" 13 "RMidOBSDistance_Level1" 14 "RMidOBSDistance_Level2" 15 "RMidOBSDistance_Level3" 16 "RROBSDistance_Level1" 17 "RROBSDistance_Level2" 18 "RROBSDistance_Level3" 19 "Reserved" 20 "Reserved" 21 "Reserved" 22 "Reserved" 23 "Reserved" 24 "Reserved" 25 "Reserved" 26 "Reserved" 27 "Reserved" 28 "Reserved" 29 "Reserved" 30 "Reserved" 31 "Reserved"  ;
