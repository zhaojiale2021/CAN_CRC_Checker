VERSION "Version"

NS_ :

BS_:

BU_: Tester CCU IBCS EPB EPS ADC CCURT1 CCURT2 ZCUF ZCUL ZCUR ZCUT EMS IDM DCDC DCDCI IPS NIDU DCU2 OBC OPC LPC CPC EMCM GCU DCU IPU BMS EOP EVCC DCDC2 EDL SRS ECS RBM ICM IID IDC AMP WHUD ARHUD IMR FIMR CD INU IFC FAPA RRR RLR PAS PCS SCMF SCMR SCMRL SCMRR MFS DRM FCP RCP LBMSAD AVAS DLPFL FBLCM FLISD FLLCM FRLCM RLLCMA RLLCMB RRLCMA RRLCMB RLISD DLPML DLPMR TRM PSDL PSDR FLDCM FRDCM HVSPRL HVSPRR RFR SBM WCM ETC TBOX2 TBOX RLBMS EBU FLPDM RLPDM FRPDM RRPDM FLOAR FROAR RLOAR RROAR EOSL EOSR EOST PRBU RT2_C3 OTAWL IDUR PHUDD RAS CBM PLGM TMC LPC2 SAS RCICP SCMRM SCMT SLMRL SLMRR IDU RRISD DSASBM LBMS RT1_C0 RT1_C1

BO_ 389 ADC_4_B_New: 64 ADC
 SG_ ADC_4_B_New_CRC : 7|16@0+ (1,0) [0|65535] ""  CCU,CCURT1,CCURT2,RT1_C1,EPS,EPB,IBCS
 SG_ ADC_4_B_New_Counter : 23|8@0+ (1,0) [0|255] ""  CCU,CCURT1,CCURT2,RT1_C1,EPS,EPB,IBCS
 SG_ ADC_AngReqSt_A_B1 : 31|2@0+ (1,0) [0|3] ""  CCU,CCURT1,CCURT2,RT1_C0,RT1_C1,EPS
 SG_ ADC_AngReqFunction_B1 : 29|2@0+ (1,0) [0|3] ""  CCU,CCURT1,CCURT2,RT1_C0,RT1_C1,EPS
 SG_ ADC_BrakeLightReq_B1 : 27|2@0+ (1,0) [0|3] ""  CCU,CCURT1,CCURT2
 SG_ ADC_StrAngleReq_A_B1 : 39|16@0+ (0.1,-780) [-780|780] "deg"  CCU,CCURT1,CCURT2,EPS
 SG_ ADC_SACMotorTorLimExtMax_A_B1 : 55|8@0+ (0.02,0) [0|5.08] "Nm"  CCU,CCURT1,CCURT2,EPS
 SG_ ADC_SACMotorTorLimExtMin_A_B1 : 63|8@0+ (0.02,-5.08) [-5.08|0] "Nm"  CCU,CCURT1,CCURT2,EPS
 SG_ ADC_AssistParaSwitchReq_B1 : 71|1@0+ (1,0) [0|1] ""  CCU,CCURT1,CCURT2,EPS
 SG_ ADC_SteerGainReq_B1 : 69|1@0+ (1,0) [0|1] ""  CCU,CCURT1,CCURT2,EPS
 SG_ ADC_StrgWhlVibrWarnLevel_B1 : 68|2@0+ (1,0) [0|3] ""  CCU,CCURT1,CCURT2,EPS
 SG_ ADC_ActTrqReqEnable_B1 : 66|1@0+ (1,0) [0|1] ""  CCU,CCURT1,CCURT2,RT1_C1
 SG_ ADC_SteerGainLevel_B1 : 79|8@0+ (1,0) [0|254] "%"  CCU,CCURT1,CCURT2,EPS
 SG_ ADC_EvsSteerReq_B1 : 87|1@0+ (1,0) [0|1] ""  CCU,CCURT1,CCURT2,EPS
 SG_ ADC_StrgWhlVibrWarnReq_B1 : 86|1@0+ (1,0) [0|1] ""  CCU,CCURT1,CCURT2,EPS
 SG_ ADC_ActTrqReq_B1 : 85|14@0+ (1,-5000) [-5000|5000] "Nm"  CCU,CCURT1,CCURT2,RT1_C1
 SG_ ADC_DrvTarTqMod2EPB_B : 124|2@0+ (1,0) [0|3] ""  CCU,CCURT1,CCURT2,EPB
 SG_ ADC_LongCtrlTypReq_B1 : 143|1@0+ (1,0) [0|1] ""  CCU,CCURT1,CCURT2,IBCS
 SG_ ADC_AEBFaultSt_B1 : 263|1@0+ (1,0) [0|1] ""  CCU,CCURT1,CCURT2,IBCS
 SG_ ADC_AEBOffSt_B1 : 262|1@0+ (1,0) [0|1] ""  CCU,CCURT1,CCURT2,IBCS
 SG_ ADC_AEBInterventionSt_B1 : 261|1@0+ (1,0) [0|1] ""  CCU,CCURT1,CCURT2,IBCS
 SG_ ADC_AEBDecelCtrlReq_B1 : 260|1@0+ (1,0) [0|1] ""  CCU,CCURT1,CCURT2,IBCS
 SG_ ADC_AEBLVehHoldReq_B1 : 259|1@0+ (1,0) [0|1] ""  CCU,CCURT1,CCURT2,IBCS
 SG_ ADC_ABAReq_B1 : 258|1@0+ (1,0) [0|1] ""  CCU,CCURT1,CCURT2,IBCS
 SG_ ADC_ABALevel_B1 : 257|2@0+ (1,0) [0|3] ""  CCU,CCURT1,CCURT2,IBCS
 SG_ ADC_AWBReq_B1 : 271|1@0+ (1,0) [0|1] ""  CCU,CCURT1,CCURT2,IBCS
 SG_ ADC_ABPReq_B1 : 270|1@0+ (1,0) [0|1] ""  CCU,CCURT1,CCURT2,IBCS
 SG_ ADC_AWBLevel_B1 : 269|3@0+ (1,0) [0|7] ""  CCU,CCURT1,CCURT2,IBCS
 SG_ ADC_AEBTarCalss_B1 : 266|3@0+ (1,0) [0|7] ""  CCU,CCURT1,CCURT2
 SG_ ADC_AEBTarDetSensor_B1 : 277|2@0+ (1,0) [0|3] ""  CCU,CCURT1,CCURT2
 SG_ ADC_TurnLightReq_B1 : 275|3@0+ (1,0) [0|7] ""  CCU,CCURT1,CCURT2
 SG_ ADC_EpbModReq_B1 : 281|2@0+ (1,0) [0|3] ""  CCU,CCURT1,CCURT2,EPB,IBCS
 SG_ ADC_EpbModReqEna_B1 : 294|1@0+ (1,0) [0|1] ""  CCU,CCURT1,CCURT2,EPB,IBCS
 SG_ ADC_AEBObjectTTC_B1 : 288|9@0+ (0.01,0) [0|5] "s"  CCU,CCURT1,CCURT2
 SG_ ADC_AEBObjRelativeSpd_B1 : 304|9@0+ (0.1,0) [0|50] "m/s"  CCU,CCURT1,CCURT2
 SG_ ADC_PAAPwrModeReq_B1 : 405|1@0+ (1,0) [0|1] ""  CCU,CCURT1,CCURT2
 SG_ ADC_PAAGrarLvlReq_B1 : 404|3@0+ (1,0) [0|7] ""  CCU,CCURT1,CCURT2,RT1_C1
 SG_ ADC_PAAGrarLvlReqEnable_B1 : 401|1@0+ (1,0) [0|1] ""  CCU,CCURT1,CCURT2,RT1_C1
 SG_ ADC_ActTrqReqVD_B1 : 341|1@0+ (1,0) [0|1] ""  CCU,CCURT1,CCURT2,RT1_C1
 SG_ ADC_BrkTarTqEna_B1 : 125|1@0+ (1,0) [0|1] ""  CCU,CCURT1,CCURT2,EPB,IBCS
 SG_ ADC_BrkTarTqMod_B1 : 25|2@0+ (1,0) [0|3] ""  CCU,CCURT1,CCURT2,EPB,IBCS
 SG_ ADC_AebBrkTarTq_B1 : 111|16@0+ (1,0) [0|65535] "Nm"  CCU,CCURT1,CCURT2,IBCS
 SG_ ADC_EpbModReqVld_B1 : 126|1@0+ (1,0) [0|1] ""  CCU,CCURT1,CCURT2,EPB
 SG_ ADC_RWUEna_B1 : 127|1@0+ (1,0) [0|1] ""  CCU,CCURT1,CCURT2,EPB
 SG_ ADC_BrkOffEnable_B1 : 135|1@0+ (1,0) [0|1] ""  CCU,IBCS
 SG_ ADC_BrkHoldReq_B1 : 279|2@0+ (1,0) [0|3] ""  CCU,CCURT1,CCURT2,IBCS
 SG_ ADC_AngReqAvl_B1 : 340|1@0+ (1,0) [0|1] ""  CCU,CCURT1,CCURT2,EPS
 SG_ ADC_TarGearReqVld_B1 : 342|1@0+ (1,0) [0|1] ""  CCU,CCURT1,CCURT2,RT1_C1
 SG_ ADC_FctSts_B1 : 343|1@0+ (1,0) [0|1] ""  CCU,CCURT1,CCURT2,RT1_C0,RT1_C1
 SG_ ADC_BrkTarTqVld_B1 : 328|1@0+ (1,0) [0|1] ""  CCU,CCURT1,CCURT2,IBCS
 SG_ ADC_AebBrkTarTqVld_B1 : 305|1@0+ (1,0) [0|1] ""  CCU,CCURT1,CCURT2,IBCS
 SG_ ADC_AebBrkTarTqEna_B1 : 306|1@0+ (1,0) [0|1] ""  CCU,CCURT1,CCURT2,RT1_C0,RT1_C1,IBCS
 SG_ ADC_ElecBrkFnSwitch_B1 : 307|1@0+ (1,0) [0|1] ""  CCU,CCURT1,CCURT2,RT1_C1,IBCS
 SG_ ADC_RedundantSwt_B1 : 142|1@0+ (1,0) [0|1] ""  CCU,EPS,IBCS
 SG_ ADC_ImmediateStopEna_B1 : 295|1@0+ (1,0) [0|1] ""  IBCS
 SG_ ADC_RWUVld_B1 : 400|1@0+ (1,0) [0|1] ""  CCU,CCURT1,CCURT2,EPB
 SG_ ADC_DriverPresent_B1 : 309|2@0+ (1,0) [0|3] ""  CCU,CCURT1,CCURT2,EPB,IBCS
 SG_ ADC_AD_NetMode_B : 65|2@0+ (1,0) [0|3] "/"  CCU,CCURT1,CCURT2,RT1_C1,EPS,EPB,IBCS
 SG_ ADC_ChrgPwrMode_B : 70|1@0+ (1,0) [0|1] ""  CCU,CCURT1,CCURT2
 SG_ ADC_FcsActiveStatus_B : 122|1@0+ (1,0) [0|1] ""  CCU,CCURT1,CCURT2,RT1_C1
 SG_ ADC_DriverSeatBeltPretightenReq_B : 120|1@0+ (1,0) [0|1] ""  CCU,CCURT1,CCURT2,RT1_C1
 SG_ ADC_SteerVibrAvl_B : 121|1@0+ (1,0) [0|1] ""  CCU,CCURT1,CCURT2,EPS
 SG_ ADC_VehSpd_B : 140|13@0+ (0.05625,0) [0|240] "km/h"  CCU,CCURT1,CCURT2,EPS
 SG_ ADC_VehSpdVD_B : 141|1@0+ (1,0) [0|1] ""  CCU,CCURT1,CCURT2,EPS
 SG_ ADC_DriverSeatBeltVibrWarnReq_B : 293|3@0+ (1,0) [0|7] ""  CCU,CCURT1,CCURT2,RT1_C1
 SG_ ADC_RasAngReqAvl_B1 : 251|2@0+ (1,0) [0|3] "/"  CCU,CCURT1,RT1_C0,RT1_C1
 SG_ ADC_RasAngReqSt_A_B1 : 253|2@0+ (1,0) [0|3] "/"  CCU,CCURT1,RT1_C0,RT1_C1,EPS
 SG_ ADC_RasModReq_B1 : 255|2@0+ (1,0) [0|3] "/"  CCU,CCURT1,RT1_C0,RT1_C1,EPS
 SG_ ADC_RasAngleReq_A_B1 : 327|12@0+ (0.01,-20.48) [-20.48|20.48] "deg"  CCU,CCURT1,RT1_C0,RT1_C1,EPS
 SG_ ADC_BrkTarTq_B1 : 439|16@0+ (1,0) [0|65535] "Nm"  CCU,CCURT1,CCURT2,IBCS

BO_ 361 ADC_4_B: 64 ADC
 SG_ ADC_4_B_CRC : 7|16@0+ (1,0) [0|65535] ""  CCU,CCURT1,CCURT2,RT1_C1,EPS,IBCS
 SG_ ADC_4_B_Counter : 23|8@0+ (1,0) [0|255] ""  CCU,CCURT1,CCURT2,RT1_C1,EPS,IBCS
 SG_ ADC_AngReqSt_A_B1 : 31|2@0+ (1,0) [0|3] ""  CCU,CCURT1,RT1_C0,RT1_C1,EPS
 SG_ ADC_AngReqFunction_B1 : 29|2@0+ (1,0) [0|3] ""  CCU,CCURT1,RT1_C0,RT1_C1,EPS
 SG_ ADC_BrakeLightReq_B1 : 27|2@0+ (1,0) [0|3] ""  CCU,CCURT1,CCURT2
 SG_ ADC_StrAngleReq_A_B1 : 39|16@0+ (0.1,-780) [-780|779.9] "deg"  CCU,CCURT1,EPS
 SG_ ADC_SACMotorTorLimExtMax_A_B1 : 55|8@0+ (0.02,0) [0|5.08] "Nm"  CCU,CCURT1,EPS
 SG_ ADC_SACMotorTorLimExtMin_A_B1 : 63|8@0+ (0.02,-5.08) [-5.08|0] "Nm"  CCU,CCURT1,EPS
 SG_ ADC_AssistParaSwitchReq_B1 : 71|1@0+ (1,0) [0|1] ""  CCU,CCURT1,EPS
 SG_ ADC_AngReqRdntReq_A_B1 : 70|1@0+ (1,0) [0|1] ""  CCU,CCURT1,EPS
 SG_ ADC_SteerGainReq_B1 : 69|1@0+ (1,0) [0|1] ""  CCU,CCURT1,EPS
 SG_ ADC_StrgWhlVibrWarnLevel_B1 : 68|2@0+ (1,0) [0|3] ""  CCU,CCURT1,EPS
 SG_ ADC_ActTrqReqEnable_B1 : 66|1@0+ (1,0) [0|1] ""  CCU,CCURT1,RT1_C1
 SG_ ADC_VLCSt_B1 : 65|2@0+ (1,0) [0|2] ""  CCU,CCURT1
 SG_ ADC_SteerGainLevel_B1 : 79|8@0+ (1,0) [0|254] "%"  CCU,CCURT1,EPS
 SG_ ADC_EvsSteerReq_B1 : 87|1@0+ (1,0) [0|1] ""  CCU,CCURT1,EPS
 SG_ ADC_StrgWhlVibrWarnReq_B1 : 86|1@0+ (1,0) [0|1] ""  CCU,CCURT1,EPS
 SG_ ADC_ActTrqReq_B1 : 85|14@0+ (1,-5000) [-5000|5000] "Nm"  CCU,CCURT1,RT1_C1
 SG_ ADC_ADASLongCtrlFuncMode_B1 : 135|3@0+ (1,0) [0|7] ""  CCU,CCURT1,IBCS
 SG_ ADC_LongCtrlAvailability_B1 : 132|1@0+ (1,0) [0|1] ""  CCU,CCURT1,IBCS
 SG_ ADC_LongCtrlModeForBrkSys_B1 : 131|3@0+ (1,0) [0|7] ""  CCU,CCURT1,IBCS
 SG_ ADC_LongCtrlTargetAxReq_B1 : 128|1@0+ (1,0) [0|1] ""  CCU,CCURT1,IBCS
 SG_ ADC_LongCtrlTypReq_B1 : 143|1@0+ (1,0) [0|1] ""  CCU,CCURT1,IBCS
 SG_ ADC_LongCtrlDecToStopReq_B1 : 142|1@0+ (1,0) [0|1] ""  CCU,CCURT1,IBCS
 SG_ ADC_LongCtrlDriveOff_B1 : 141|1@0+ (1,0) [0|1] ""  CCU,CCURT1,IBCS
 SG_ ADC_LongctrlSecureReq_B1 : 140|1@0+ (1,0) [0|1] ""  CCU,CCURT1,IBCS
 SG_ ADC_ShifttoAVHReq_B1 : 139|1@0+ (1,0) [0|1] ""  CCU,CCURT1,IBCS
 SG_ ADC_LongCtrlTargetAx_B1 : 138|11@0+ (0.01,-10) [-10|10] "m/s2"  CCU,CCURT1,IBCS
 SG_ ADC_TrkTargt0St_B1 : 159|1@0+ (1,0) [0|1] ""  CCU,CCURT1
 SG_ ADC_TrkTargt0longPos_B1 : 158|10@0+ (0.2,0) [0|204.4] "m"  CCU,CCURT1
 SG_ ADC_TrkTargt0latPos_B1 : 164|10@0+ (0.1,-51.2) [-51.2|51.1] "m"  CCU,CCURT1
 SG_ ADC_TrkTargt0LatRelSpd_B1 : 170|9@0+ (0.1,-25.5) [-25.5|25.5] "m/s"  CCU,CCURT1
 SG_ ADC_TrkTargt0LongRelSpd_B1 : 177|10@0+ (0.1,-51.2) [-51.2|51.1] "m/s"  CCU,CCURT1
 SG_ ADC_AS_pauseReq_B1 : 199|1@0+ (1,0) [0|1] ""  CCU
 SG_ ADC_AS_calibrationReq_B1 : 198|3@0+ (1,0) [0|5] ""  CCU
 SG_ ADC_AS_exitcurrentlevelReq_B1 : 195|1@0+ (1,0) [0|1] ""  CCU
 SG_ ADC_AS_ReqToadjust_B1 : 194|3@0+ (1,0) [0|5] ""  CCU
 SG_ ADC_AS_UnsafelevelunableReq_B1 : 207|1@0+ (1,0) [0|1] ""  CCU
 SG_ ADC_AEBTargetDecel_B1 : 243|12@0+ (0.008,-16) [-16|16] "m/s2"  CCU,CCURT1,IBCS
 SG_ ADC_AEBFaultSt_B1 : 263|1@0+ (1,0) [0|1] ""  CCU,CCURT1,IBCS
 SG_ ADC_AEBOffSt_B1 : 262|1@0+ (1,0) [0|1] ""  CCU,CCURT1,IBCS
 SG_ ADC_AEBInterventionSt_B1 : 261|1@0+ (1,0) [0|1] ""  CCU,CCURT1,IBCS
 SG_ ADC_AEBDecelCtrlReq_B1 : 260|1@0+ (1,0) [0|1] ""  CCU,CCURT1,IBCS
 SG_ ADC_AEBLVehHoldReq_B1 : 259|1@0+ (1,0) [0|1] ""  CCU,CCURT1,IBCS
 SG_ ADC_ABAReq_B1 : 258|1@0+ (1,0) [0|1] ""  CCU,CCURT1,IBCS
 SG_ ADC_ABALevel_B1 : 257|2@0+ (1,0) [0|3] ""  CCU,CCURT1,IBCS
 SG_ ADC_AWBReq_B1 : 271|1@0+ (1,0) [0|1] ""  CCU,CCURT1,IBCS
 SG_ ADC_ABPReq_B1 : 270|1@0+ (1,0) [0|1] ""  CCU,CCURT1,IBCS
 SG_ ADC_AWBLevel_B1 : 269|3@0+ (1,0) [0|7] ""  CCU,CCURT1,IBCS
 SG_ ADC_AEBTarCalss_B1 : 266|3@0+ (1,0) [0|7] ""  CCU,CCURT1
 SG_ ADC_AEBTarDetSensor_B1 : 277|2@0+ (1,0) [0|3] ""  CCU,CCURT1
 SG_ ADC_TurnLightReq_B1 : 275|3@0+ (1,0) [0|7] ""  CCU,CCURT1,CCURT2
 SG_ ADC_PAA2ESPAxReqEnable_B1 : 272|1@0+ (1,0) [0|1] ""  CCU,CCURT1,IBCS
 SG_ ADC_PAA2ESPBrakeFunctionMode_B1 : 287|3@0+ (1,0) [0|7] ""  CCU,CCURT1,IBCS
 SG_ ADC_PAA2ESPEpbReq_B1 : 284|2@0+ (1,0) [0|2] ""  CCU,CCURT1,IBCS
 SG_ ADC_PAA2ESPEpbReqSt_B1 : 282|1@0+ (1,0) [0|1] ""  CCU,CCURT1,IBCS
 SG_ ADC_FcsActiveStatus_B : 205|1@0+ (1,0) [0|1] ""  CCU,CCURT1,RT1_C1,IBCS
 SG_ ADC_EpbModReq_B1 : 281|2@0+ (1,0) [0|3] ""  CCU,CCURT1,IBCS
 SG_ ADC_ESPSwitchReq_B1 : 295|1@0+ (1,0) [0|1] ""  CCU,CCURT1,IBCS
 SG_ ADC_EpbModReqEna_B1 : 294|1@0+ (1,0) [0|1] ""  CCU,CCURT1,IBCS
 SG_ ADC_PAA2EPBBrakeFunctionMode_B1 : 293|1@0+ (1,0) [0|1] ""  CCU,CCURT1,IBCS
 SG_ ADC_PAA2ESPApEmgyBrkReq_B1 : 292|1@0+ (1,0) [0|1] ""  CCU,CCURT1,IBCS
 SG_ ADC_PAA2ESPComfBrakeReq_B1 : 291|2@0+ (1,0) [0|3] ""  CCU,CCURT1,IBCS
 SG_ ADC_PAA2ESPApDriveOffReq_B1 : 289|1@0+ (1,0) [0|1] ""  CCU,CCURT1,IBCS
 SG_ ADC_PAA2ESPApStandstillReq_B1 : 311|1@0+ (1,0) [0|1] ""  CCU,CCURT1,IBCS
 SG_ ADC_PAA2ESPApPrefillReq_B1 : 310|1@0+ (1,0) [0|1] ""  CCU,CCURT1,IBCS
 SG_ ADC_PAA2ESPAxReq_B1 : 327|14@0+ (0.001,-10) [-10|6] "m/s2"  CCU,CCURT1,IBCS
 SG_ ADC_EPBReq_B1 : 329|1@0+ (1,0) [0|1] ""  CCU,CCURT1,IBCS
 SG_ ADC_PAA2ESPDistoStop_B1 : 339|12@0+ (1,0) [0|4095] "cm"  CCU,CCURT1,IBCS
 SG_ ADC_PAA2ESPTarTorquePTDriveoff_B1 : 359|16@0+ (1,-30000) [-30000|30000] "Nm"  CCU,CCURT1,IBCS
 SG_ ADC_VehTorqLimit_B1 : 375|16@0+ (1,-5000) [-5000|5000] "Nm"  CCU,CCURT1
 SG_ ADC_VehTorqReqValue_B1 : 391|16@0+ (1,-5000) [-5000|5000] "Nm"  CCU,CCURT1
 SG_ ADC_VehTorqLimitEnable_B1 : 407|1@0+ (1,0) [0|1] ""  CCU,CCURT1
 SG_ ADC_VehTorqReqEnable_B1 : 406|1@0+ (1,0) [0|1] ""  CCU,CCURT1
 SG_ ADC_PAAPwrModeReq_B1 : 405|1@0+ (1,0) [0|1] ""  CCU,CCURT1
 SG_ ADC_PAAGrarLvlReq_B1 : 404|3@0+ (1,0) [0|7] ""  CCU,CCURT1,RT1_C1
 SG_ ADC_PAAGrarLvlReqEnable_B1 : 401|1@0+ (1,0) [0|1] ""  CCU,CCURT1,RT1_C1
 SG_ ADC_ActTrqReqVD_B1 : 341|1@0+ (1,0) [0|1] ""  CCU,CCURT1,RT1_C1
 SG_ ADC_RCTBTargetDecel_B1 : 411|8@0+ (0.05,-10) [-10|2.75] "m/s2"  CCU
 SG_ ADC_RCTBBrkReq_B1 : 419|1@0+ (1,0) [0|1] ""  CCU
 SG_ ADC_BrkTarTqEna_B1 : 125|1@0+ (1,0) [0|1] ""  CCU,EPB,IBCS
 SG_ ADC_BrkTarTqMod_B1 : 25|2@0+ (1,0) [0|3] ""  CCU,EPB,IBCS
 SG_ ADC_AebBrkTarTq_B1 : 111|16@0+ (1,0) [0|65535] "Nm"  CCU,IBCS
 SG_ ADC_EpbModReqVld_B1 : 126|1@0+ (1,0) [0|1] ""  CCU
 SG_ ADC_RWUEna_B1 : 127|1@0+ (1,0) [0|1] ""  CCU
 SG_ ADC_BrkHoldReq_B1 : 279|2@0+ (1,0) [0|3] ""  CCU,IBCS
 SG_ ADC_AngReqAvl_B1 : 340|1@0+ (1,0) [0|1] ""  CCU,EPS
 SG_ ADC_TarGearReqVld_B1 : 342|1@0+ (1,0) [0|1] ""  CCU,CCURT1,RT1_C1
 SG_ ADC_FctSts_B1 : 343|1@0+ (1,0) [0|1] ""  CCU,CCURT1,RT1_C0,RT1_C1
 SG_ ADC_BrkTarTqVld_B1 : 328|1@0+ (1,0) [0|1] ""  CCU,IBCS
 SG_ ADC_AebBrkTarTqVld_B1 : 305|1@0+ (1,0) [0|1] ""  CCU,IBCS
 SG_ ADC_AebBrkTarTqEna_B1 : 306|1@0+ (1,0) [0|1] ""  CCU,CCURT1,RT1_C0,RT1_C1,IBCS
 SG_ ADC_ElecBrkFnSwitch_B1 : 307|1@0+ (1,0) [0|1] ""  CCU,CCURT1,RT1_C1,IBCS
 SG_ ADC_RWUVld_B1 : 400|1@0+ (1,0) [0|1] ""  CCU
 SG_ ADC_DriverPresent_B1 : 309|2@0+ (1,0) [0|3] ""  CCU,IBCS
 SG_ ADC_BrkTarTq_B1 : 439|16@0+ (1,0) [0|65535] "Nm"  CCU,IBCS

BO_ 371 ADC_13_B: 64 ADC
 SG_ ADC_13_B_CRC : 7|16@0+ (1,0) [0|65535] ""  CCU,CCURT1,RT1_C1,EPS,IBCS
 SG_ ADC_13_B_Counter : 23|8@0+ (1,0) [0|255] ""  CCU,CCURT1,RT1_C1,EPS,IBCS
 SG_ ADC_TotalRefTorque : 31|16@0+ (1,-32768) [-32768|32767] "Nm"  CCU,CCURT1,RT1_C1
 SG_ ADC_MotTarSpd : 47|16@0+ (1,-32768) [-32768|32767] "rpm"  CCU,CCURT1,RT1_C1
 SG_ ADC_DycEscTarTq : 63|16@0+ (1,-32768) [-32768|32767] "Nm"  IBCS
 SG_ ADC_DycEscTarTqfactor : 79|8@0+ (0.01,0) [0|1] ""  IBCS
 SG_ ADC_SteerTqReq : 87|12@0+ (0.01,-20) [-20|20] "Nm"  EPS
 SG_ ADC_LimTqFactorK : 91|10@0+ (0.001,0) [0|1] ""  CCU,CCURT1,RT1_C1
 SG_ ADC_MotTqLimMin : 97|9@0+ (25,-6375) [-6375|6400] "Nm"  CCU,CCURT1,RT1_C1
 SG_ ADC_MotTqLimMax : 104|9@0+ (25,-6375) [-6375|6400] "Nm"  CCU,CCURT1,RT1_C1
 SG_ ADC_MotTqRateLimMin : 127|9@0+ (50,-12750) [-12750|12800] "Nm/s"  CCU,CCURT1,RT1_C1
 SG_ ADC_MotTqRateLimMax : 134|9@0+ (50,-12750) [-12750|12800] "Nm/s"  CCU,CCURT1,RT1_C1
 SG_ ADC_TqUnloadRate : 141|9@0+ (50,-12750) [-12750|12800] "Nm/s"  CCU,CCURT1,RT1_C1
 SG_ ADC_MotCtrlTar : 148|3@0+ (1,0) [0|7] ""  CCU,CCURT1,RT1_C1
 SG_ ADC_MotTarMod : 145|2@0+ (1,0) [0|3] ""  CCU,CCURT1,RT1_C1
 SG_ ADC_SteerTqSt : 157|2@0+ (1,0) [0|3] ""  EPS
 SG_ ADC_DrvTarTqMod : 159|2@0+ (1,0) [0|3] ""  CCU,CCURT1,RT1_C1,IBCS
 SG_ ADC_TqEvsSteerReq : 152|1@0+ (1,0) [0|1] ""  EPS
 SG_ ADC_SteerTqAvl : 153|1@0+ (1,0) [0|1] ""  EPS
 SG_ ADC_RapidRespEna : 154|1@0+ (1,0) [0|1] ""  CCU,CCURT1,RT1_C1
 SG_ ADC_LimTqEnable : 155|1@0+ (1,0) [0|1] ""  CCU,CCURT1,RT1_C1
 SG_ ADC_MotSpdCtrlEna : 163|1@0+ (1,0) [0|1] ""  CCU,CCURT1,RT1_C1
 SG_ ADC_TqUnloadEna : 164|1@0+ (1,0) [0|1] ""  CCU,CCURT1,RT1_C1
 SG_ ADC_MotTarSpdSvValid : 165|1@0+ (1,0) [0|1] ""  CCU,CCURT1,RT1_C1
 SG_ ADC_DycEscTarTqVld : 166|1@0+ (1,0) [0|1] ""  IBCS
 SG_ ADC_DycEscTarTqEna : 167|1@0+ (1,0) [0|1] ""  IBCS
 SG_ ADC_RoadTyp : 162|3@0+ (1,0) [0|7] ""  CCU
 SG_ ADC_LeWhlLgtDst : 175|12@0+ (0.01,0) [0|30] "m"  CCU
 SG_ ADC_LeWhlRoadHei : 179|12@0+ (0.001,-0.5) [-0.5|0.523] "m"  CCU
 SG_ ADC_RiWhlLgtDst : 199|12@0+ (0.01,0) [0|30] "m"  CCU
 SG_ ADC_RiWhlRoadHei : 203|12@0+ (0.001,-0.5) [-0.5|0.523] "m"  CCU
 SG_ ADC_RiWhlRoadFeature : 223|5@0+ (1,0) [0|15] ""  CCU
 SG_ ADC_SuspensionStatus : 218|3@0+ (1,0) [0|7] ""  CCU
 SG_ ADC_LeWhlRoadSts : 231|2@0+ (1,0) [0|3] ""  CCU
 SG_ ADC_LeWhlRoadFeature : 229|4@0+ (1,0) [0|15] ""  CCU
 SG_ ADC_RiWhlRoadSts : 225|2@0+ (1,0) [0|3] ""  CCU
 SG_ ADC_CDCCtrlEnable : 239|1@0+ (1,0) [0|1] ""  CCU
 SG_ ADC_RoadInfoAvl : 238|1@0+ (1,0) [0|1] ""  CCU
 SG_ ADC_RoadFeatureDetFalutSts : 295|1@0+ (1,0) [0|1] ""  CCU
 SG_ ADC_RoadFeatureDetWorkSts : 247|2@0+ (1,0) [0|3] ""  CCU
 SG_ ADC_LeWhlRoadFeature2 : 251|4@0+ (1,0) [0|15] ""  CCU
 SG_ ADC_LeWhlRoadFeature3 : 255|4@0+ (1,0) [0|15] ""  CCU
 SG_ ADC_RiWhlRoadFeature2 : 259|4@0+ (1,0) [0|15] ""  CCU
 SG_ ADC_RiWhlRoadFeature3 : 263|4@0+ (1,0) [0|15] ""  CCU
 SG_ ADC_LeWhlRoadHei2 : 271|3@0+ (1,0) [0|7] ""  CCU
 SG_ ADC_LeWhlRoadHei3 : 268|3@0+ (1,0) [0|7] ""  CCU
 SG_ ADC_RiWhlRoadHei2 : 265|3@0+ (1,0) [0|7] ""  CCU
 SG_ ADC_RiWhlRoadHei3 : 278|3@0+ (1,0) [0|7] ""  CCU
 SG_ ADC_LeWhlLgtDst2 : 237|6@0+ (0.25,0) [0|15] "m"  CCU
 SG_ ADC_LeWhlLgtDst3 : 245|6@0+ (0.25,0) [0|15] "m"  CCU
 SG_ ADC_RiWhlLgtDst2 : 275|6@0+ (0.25,0) [0|15] "m"  CCU
 SG_ ADC_RiWhlLgtDst3 : 285|6@0+ (0.25,0) [0|15] "m"  CCU
 SG_ ADC_AS_SuspHeiAdj : 290|3@0+ (1,0) [0|7] ""  CCU
 SG_ ADC_AS_SuspHeiAdjVld : 291|1@0+ (1,0) [0|1] ""  CCU
 SG_ ADC_AS_SusStfnAdj : 300|3@0+ (1,0) [0|7] ""  CCU
 SG_ ADC_AS_SusStfnAdjVld : 292|1@0+ (1,0) [0|1] ""  CCU
 SG_ ADC_CDCModReq : 303|3@0+ (1,0) [0|7] ""  CCU
 SG_ ADC_CDCModReqVld : 294|1@0+ (1,0) [0|1] ""  CCU
 SG_ ADC_UrgentSteerFlg : 317|1@0+ (1,0) [0|1] ""  CCU,CCURT1,RT1_C1
 SG_ ADC_OneMotorCtrlEna : 316|2@0+ (1,0) [0|3] ""  CCU,CCURT1,RT1_C1
 SG_ ADC_MotorCtrlTqWhlRL : 327|16@0+ (1,-32768) [-32768|32767] "Nm"  CCU,CCURT1,RT1_C1
 SG_ ADC_MotorCtrlTqWhlRR : 343|16@0+ (1,-32768) [-32768|32767] "Nm"  CCU,CCURT1,RT1_C1
 SG_ ADC_SteerGainLevelTqCtrl : 359|8@0+ (1,0) [0|254] "%"  EPS
 SG_ ADC_MotorCtrlTqWhlFR : 383|16@0+ (1,-32768) [-32768|32767] "Nm"  CCU,CCURT1,RT1_C1
 SG_ ADC_MotorCtrlTqWhlFL : 431|16@0+ (1,-32768) [-32768|32767] "Nm"  CCU,CCURT1,RT1_C1
 SG_ Reserved1 : 440|1@0+ (1,0) [0|0] ""  CCU

CM_ SG_ 389 ADC_4_B_New_CRC "E2E Profile 5 CRC";
CM_ SG_ 389 ADC_4_B_New_Counter "E2E Profile 5 Counter";
CM_ SG_ 389 ADC_AngReqSt_A_B1 "Lateral control Function Request State";
CM_ SG_ 389 ADC_AngReqFunction_B1 "Indicates which function request angle control";
CM_ SG_ 389 ADC_BrakeLightReq_B1 "Brake Light Request?";
CM_ SG_ 389 ADC_StrAngleReq_A_B1 "Steering Angle Request Value";
CM_ SG_ 389 ADC_SACMotorTorLimExtMax_A_B1 "Maximum Motor External Torque Limitation of Angle Following";
CM_ SG_ 389 ADC_SACMotorTorLimExtMin_A_B1 "Minimum Motor External Torque Limitation of Angle Following";
CM_ SG_ 389 ADC_AssistParaSwitchReq_B1 "Request EPS Switch Assist Parameter to LKAmode";
CM_ SG_ 389 ADC_SteerGainReq_B1 "Driver steering  gain request signal";
CM_ SG_ 389 ADC_StrgWhlVibrWarnLevel_B1 "Steering wheel vibratio Warn Frequency";
CM_ SG_ 389 ADC_ActTrqReqEnable_B1 "Enable flag for VCU for realization of target torque ActTrqReq";
CM_ SG_ 389 ADC_SteerGainLevel_B1 "Driver steering gain request value";
CM_ SG_ 389 ADC_EvsSteerReq_B1 "Emergency Collision avoidance steering mode request";
CM_ SG_ 389 ADC_StrgWhlVibrWarnReq_B1 "Steering wheel vibration Warn request";
CM_ SG_ 389 ADC_ActTrqReq_B1 "VLC Request Effective target torque on wheel level to VCU";
CM_ SG_ 389 ADC_DrvTarTqMod2EPB_B "Drive torque mode to EPB";
CM_ SG_ 389 ADC_LongCtrlTypReq_B1 "Main ADC  Longitudinal Control Brake type.Comfort Mode : The controller and brake system will consider NVH limitations, carefully reaction for good driving feeling, etc.Emergency Mode: the controller react fast and the brake system will achieve maximum performance (No limitations, eg. NVH limitations, HW protection).";
CM_ SG_ 389 ADC_AEBFaultSt_B1 "This signal indicates the AEB(Auto Emerrgency Braking) fault status";
CM_ SG_ 389 ADC_AEBOffSt_B1 "This signal indicates if the AEB(Auto Emerrgency Braking) is deactivated";
CM_ SG_ 389 ADC_AEBInterventionSt_B1 "This signal indicates if the AEB(Auto Emerrgency Braking) intervents";
CM_ SG_ 389 ADC_AEBDecelCtrlReq_B1 "Request of the AEB/EBA/FCTB/RCTB deceleration control";
CM_ SG_ 389 ADC_AEBLVehHoldReq_B1 "Request ESP to hold vehilce if AEB active and vehilce stopped";
CM_ SG_ 389 ADC_ABAReq_B1 "Request of the ABA support from ESP";
CM_ SG_ 389 ADC_ABALevel_B1 "ABA(Adaptive Brake Assistance) level to the ESP HBA";
CM_ SG_ 389 ADC_AWBReq_B1 "Request of the brake jerk warning to ESP";
CM_ SG_ 389 ADC_ABPReq_B1 "Request of the Prefill to ESP";
CM_ SG_ 389 ADC_AWBLevel_B1 "Different level request of the brake jerk";
CM_ SG_ 389 ADC_AEBTarCalss_B1 "AEB Target Object Class";
CM_ SG_ 389 ADC_AEBTarDetSensor_B1 "AEB Target Property Detected by Sensor with Fusion or not.";
CM_ SG_ 389 ADC_TurnLightReq_B1 "Turn Lamp and Hazard Lamp Request?";
CM_ SG_ 389 ADC_EpbModReq_B1 "The  request from the ADAS/ADS to the EPB, ADC_PAA2EPBEpbReq redundant signal";
CM_ SG_ 389 ADC_EpbModReqEna_B1 "The enable status  of the  request from the ADAS/ADS to the  EPB Status, ADC_PAA2EPBEpbReqSt_B redundant signal";
CM_ SG_ 389 ADC_AEBObjectTTC_B1 "Time-to-collision between ego vehicle and collision object, and the relative acceleration should be considered";
CM_ SG_ 389 ADC_AEBObjRelativeSpd_B1 "Relative Speed between ego vehicle and collision object. Means Ego speed > collision object speed situation";
CM_ SG_ 389 ADC_PAAPwrModeReq_B1 "PAA Powertrain Request";
CM_ SG_ 389 ADC_PAAGrarLvlReq_B1 "Gear lever position request for the vehicle mo-tion control";
CM_ SG_ 389 ADC_PAAGrarLvlReqEnable_B1 "enable flag to control the gear box";
CM_ SG_ 389 ADC_ActTrqReqVD_B1 "The validity of ADC torque request to VCU";
CM_ SG_ 389 ADC_BrkTarTqEna_B1 "The enable status  of total target brake torque";
CM_ SG_ 389 ADC_BrkTarTqMod_B1 "This signal indicates which function the total target brake torque is used for，cruise or parking function.";
CM_ SG_ 389 ADC_AebBrkTarTq_B1 "Total taget brake torque of the AEB";
CM_ SG_ 389 ADC_EpbModReqVld_B1 "The validity of the  request from the ADAS/ADS to the  EPB";
CM_ SG_ 389 ADC_RWUEna_B1 "The enable status of the  RWU";
CM_ SG_ 389 ADC_BrkOffEnable_B1 "Allow the brake to actively retract the hand grip";
CM_ SG_ 389 ADC_BrkHoldReq_B1 "The AVH request from the ADAS/ADS to the ESP/IPB.Not active：AVH no activeActive：AVH active";
CM_ SG_ 389 ADC_AngReqAvl_B1 "Steering angle request avaliable state";
CM_ SG_ 389 ADC_TarGearReqVld_B1 "Gear lever request validity";
CM_ SG_ 389 ADC_FctSts_B1 "ADAS active status";
CM_ SG_ 389 ADC_BrkTarTqVld_B1 "The validity of total  target brake torque";
CM_ SG_ 389 ADC_AebBrkTarTqVld_B1 "The validity of total target brake torque of the AEB";
CM_ SG_ 389 ADC_AebBrkTarTqEna_B1 "The enable status  of total  target brake torque of the AEB";
CM_ SG_ 389 ADC_ElecBrkFnSwitch_B1 "The switch for regenerative brake and hydraulic brake。Off：The ESP/IPB can not assign regenerative brake torque to the VCU/DCU。On：The ESP/IPB can assign regenerative brake torque to the VCUDCU。";
CM_ SG_ 389 ADC_RedundantSwt_B1 "It is the switch for the redundancy mode.";
CM_ SG_ 389 ADC_ImmediateStopEna_B1 "It indicates whether ESP is permitted to perform blind braking.（It indicates whether the ESP is permitted to immediately brake the vehicle to a stop.）";
CM_ SG_ 389 ADC_RWUVld_B1 "The validity  of the RWU";
CM_ SG_ 389 ADC_DriverPresent_B1 "It indicates whether someone is in the driver's seat.";
CM_ SG_ 389 ADC_AD_NetMode_B "Autonomous_Driving Request Net Mode";
CM_ SG_ 389 ADC_ChrgPwrMode_B "ADC VCU Torque Control Mode";
CM_ SG_ 389 ADC_FcsActiveStatus_B "indicate ADS Fuction is Active for energe save mode";
CM_ SG_ 389 ADC_DriverSeatBeltPretightenReq_B "Driver Seat Belt Pretighten Request";
CM_ SG_ 389 ADC_SteerVibrAvl_B "Steering wheel vibration warn available state";
CM_ SG_ 389 ADC_VehSpd_B "ADC Vehicle speed";
CM_ SG_ 389 ADC_VehSpdVD_B "ADC Quality/fault information to vehicle speed";
CM_ SG_ 389 ADC_DriverSeatBeltVibrWarnReq_B "ADAS active driver seat belt vibration warning request";
CM_ SG_ 389 ADC_RasAngReqAvl_B1 "Steering angle request avaliable state";
CM_ SG_ 389 ADC_RasAngReqSt_A_B1 "Steering angle control Request State";
CM_ SG_ 389 ADC_RasModReq_B1 "Emergency steering mode request";
CM_ SG_ 389 ADC_RasAngleReq_A_B1 "Steering Angle Request Value";
CM_ SG_ 389 ADC_BrkTarTq_B1 "Total target brake torque for cruise and parking function ";
CM_ SG_ 361 ADC_4_B_CRC "E2E Profile 5 CRC";
CM_ SG_ 361 ADC_4_B_Counter "E2E Profile 5 Counter";
CM_ SG_ 361 ADC_AngReqSt_A_B1 "Lateral control Function Request State";
CM_ SG_ 361 ADC_AngReqFunction_B1 "Indicates which function request angle control";
CM_ SG_ 361 ADC_BrakeLightReq_B1 "Brake Light Request?";
CM_ SG_ 361 ADC_StrAngleReq_A_B1 "Steering Angle Request Value";
CM_ SG_ 361 ADC_SACMotorTorLimExtMax_A_B1 "Maximum Motor External Torque Limitation of Angle Following";
CM_ SG_ 361 ADC_SACMotorTorLimExtMin_A_B1 "Minimum Motor External Torque Limitation of Angle Following";
CM_ SG_ 361 ADC_AssistParaSwitchReq_B1 "Request EPS Switch Assist Parameter to LKAmode";
CM_ SG_ 361 ADC_AngReqRdntReq_A_B1 "Angle following control redundancy request";
CM_ SG_ 361 ADC_SteerGainReq_B1 "Driver steering  gain request signal";
CM_ SG_ 361 ADC_StrgWhlVibrWarnLevel_B1 "Steering wheel vibratio Warn Frequency";
CM_ SG_ 361 ADC_ActTrqReqEnable_B1 "Enable flag for VCU for realization of target torque ActTrqReq";
CM_ SG_ 361 ADC_VLCSt_B1 "Vehicle Longitudinal Power Control status of ADAS to VCU/EMS";
CM_ SG_ 361 ADC_SteerGainLevel_B1 "Driver steering gain request value";
CM_ SG_ 361 ADC_EvsSteerReq_B1 "Emergency Collision avoidance steering mode request";
CM_ SG_ 361 ADC_StrgWhlVibrWarnReq_B1 "Steering wheel vibration Warn request";
CM_ SG_ 361 ADC_ActTrqReq_B1 "VLC Request Effective target torque on wheel level to VCU";
CM_ SG_ 361 ADC_ADASLongCtrlFuncMode_B1 "This signal indicates ADC Longitudinal Control acceleration belongs to which function (ACC or APA)";
CM_ SG_ 361 ADC_LongCtrlAvailability_B1 "Main ADC Vehicle motion control availability (The longitudinal controller will avoid to erroneously perform the requests from a ADC not indicated as available).";
CM_ SG_ 361 ADC_LongCtrlModeForBrkSys_B1 "Main ADC Longitudinal Control Mode For BrakeSys.Off mode: ADAS Not engage.L2 Active: ADAS working in L2 Function.L2++ Active: ADAS working in L2++ or Advance Cruise ,Brake system has a redundant actuator.";
CM_ SG_ 361 ADC_LongCtrlTargetAxReq_B1 "Main ADC Request from the Longitudinal Control acceleration to BrakeSys";
CM_ SG_ 361 ADC_LongCtrlTypReq_B1 "Main ADC  Longitudinal Control Brake type.Comfort Mode : The controller and brake system will consider NVH limitations, carefully reaction for good driving feeling, etc.Emergency Mode: the controller react fast and the brake system will achieve maximum performance (No limitations, eg. NVH limitations, HW protection).";
CM_ SG_ 361 ADC_LongCtrlDecToStopReq_B1 "Main ADC LongitudinalControl requires deceleration to stop";
CM_ SG_ 361 ADC_LongCtrlDriveOff_B1 "Main ADC LongitudinalControl requires driving off";
CM_ SG_ 361 ADC_LongctrlSecureReq_B1 "Main ADC L2++ system request secure the vehicle, such as use case: L2++ fail operation active, driver no take over, need to stop in emergency lane, request secure vehicle at standstill by EPB Applied.";
CM_ SG_ 361 ADC_ShifttoAVHReq_B1 "Request Brake System Change to AVH From ACC Standstill Hold State";
CM_ SG_ 361 ADC_LongCtrlTargetAx_B1 "Main ADC Longitudinal Control acceleration forBrakeSystem";
CM_ SG_ 361 ADC_TrkTargt0St_B1 "Front Track Target 0（Closest Same Lane）detection state";
CM_ SG_ 361 ADC_TrkTargt0longPos_B1 "Track Target 0（Closest Same Lane）Longitudinal Position";
CM_ SG_ 361 ADC_TrkTargt0latPos_B1 "Track Target 0（Closest Same Lane）Lateral Position";
CM_ SG_ 361 ADC_TrkTargt0LatRelSpd_B1 "Track Target 0（Closest Same Lane）Lateral Relative Speed";
CM_ SG_ 361 ADC_TrkTargt0LongRelSpd_B1 "Track Target 0（Closest Same Lane）Longitudinal Relative Speed";
CM_ SG_ 361 ADC_AS_pauseReq_B1 "Inhibit suspension adjustment requests";
CM_ SG_ 361 ADC_AS_calibrationReq_B1 "Suspension adjustment is requested during calibration";
CM_ SG_ 361 ADC_AS_exitcurrentlevelReq_B1 "Parking request air spring out of the current height Level signal";
CM_ SG_ 361 ADC_AS_ReqToadjust_B1 "For specific parking functions, the AS is requested to be adjusted to the specific suspension level";
CM_ SG_ 361 ADC_AS_UnsafelevelunableReq_B1 "Parking request no air spring into unsafe Level height signal";
CM_ SG_ 361 ADC_AEBTargetDecel_B1 "Target deceleration value from AEB(Automatic Emergency Braking)/EBA(Emergence Braking Assist)";
CM_ SG_ 361 ADC_AEBFaultSt_B1 "This signal indicates the AEB(Auto Emerrgency Braking) fault status";
CM_ SG_ 361 ADC_AEBOffSt_B1 "This signal indicates if the AEB(Auto Emerrgency Braking) is deactivated";
CM_ SG_ 361 ADC_AEBInterventionSt_B1 "This signal indicates if the AEB(Auto Emerrgency Braking) intervents";
CM_ SG_ 361 ADC_AEBDecelCtrlReq_B1 "Request of the AEB/EBA/FCTB/RCTB deceleration control";
CM_ SG_ 361 ADC_AEBLVehHoldReq_B1 "Request ESP to hold vehilce if AEB active and vehilce stopped";
CM_ SG_ 361 ADC_ABAReq_B1 "Request of the ABA support from ESP";
CM_ SG_ 361 ADC_ABALevel_B1 "ABA(Adaptive Brake Assistance) level to the ESP HBA";
CM_ SG_ 361 ADC_AWBReq_B1 "Request of the brake jerk warning to ESP";
CM_ SG_ 361 ADC_ABPReq_B1 "Request of the Prefill to ESP";
CM_ SG_ 361 ADC_AWBLevel_B1 "Different level request of the brake jerk";
CM_ SG_ 361 ADC_AEBTarCalss_B1 "AEB Target Object Class";
CM_ SG_ 361 ADC_AEBTarDetSensor_B1 "AEB Target Property Detected by Sensor with Fusion or not.";
CM_ SG_ 361 ADC_TurnLightReq_B1 "Turn Lamp and Hazard Lamp Request?";
CM_ SG_ 361 ADC_PAA2ESPAxReqEnable_B1 "Target Ax value request enable";
CM_ SG_ 361 ADC_PAA2ESPBrakeFunctionMode_B1 "Indicate APA or RPA or AVP";
CM_ SG_ 361 ADC_PAA2ESPEpbReq_B1 "PAA to ESP to do EPB request";
CM_ SG_ 361 ADC_PAA2ESPEpbReqSt_B1 "PAA to ESP to do EPB request  status";
CM_ SG_ 361 ADC_FcsActiveStatus_B "indicate ADS Fuction is Active for energe save mode";
CM_ SG_ 361 ADC_EpbModReq_B1 "The  request from the ADAS/ADS to the EPB";
CM_ SG_ 361 ADC_ESPSwitchReq_B1 "ADAS ESP Switch to full function Request";
CM_ SG_ 361 ADC_EpbModReqEna_B1 "The enable status  of the  request from the ADAS/ADS to the  EPB";
CM_ SG_ 361 ADC_PAA2EPBBrakeFunctionMode_B1 "Brake Function Mode";
CM_ SG_ 361 ADC_PAA2ESPApEmgyBrkReq_B1 "Emergency brake request";
CM_ SG_ 361 ADC_PAA2ESPComfBrakeReq_B1 "comfort brake request";
CM_ SG_ 361 ADC_PAA2ESPApDriveOffReq_B1 "Drive off request";
CM_ SG_ 361 ADC_PAA2ESPApStandstillReq_B1 "Vechile standstill request";
CM_ SG_ 361 ADC_PAA2ESPApPrefillReq_B1 "Prefill request";
CM_ SG_ 361 ADC_PAA2ESPAxReq_B1 "Target Ax value";
CM_ SG_ 361 ADC_EPBReq_B1 "ADAS EPB Request";
CM_ SG_ 361 ADC_PAA2ESPDistoStop_B1 "Distance to target stop point";
CM_ SG_ 361 ADC_PAA2ESPTarTorquePTDriveoff_B1 "target propulsive torque for drive off";
CM_ SG_ 361 ADC_VehTorqLimit_B1 "Torque limit to VCU";
CM_ SG_ 361 ADC_VehTorqReqValue_B1 "Torque request to VCU";
CM_ SG_ 361 ADC_VehTorqLimitEnable_B1 "Torque limit enable status to VCU";
CM_ SG_ 361 ADC_VehTorqReqEnable_B1 "Torque request enable status to VCU";
CM_ SG_ 361 ADC_PAAPwrModeReq_B1 "PAA Powertrain Request";
CM_ SG_ 361 ADC_PAAGrarLvlReq_B1 "Gear lever position request for the vehicle mo-tion control";
CM_ SG_ 361 ADC_PAAGrarLvlReqEnable_B1 "enable flag to control the gear box";
CM_ SG_ 361 ADC_ActTrqReqVD_B1 "The validity of ADC torque request to VCU";
CM_ SG_ 361 ADC_RCTBTargetDecel_B1 "target deceleration value from RCTB";
CM_ SG_ 361 ADC_RCTBBrkReq_B1 "RCTB brake request";
CM_ SG_ 361 ADC_BrkTarTqEna_B1 "The enable status  of total target brake torque";
CM_ SG_ 361 ADC_BrkTarTqMod_B1 "This signal indicates which function the total target brake torque is used for，cruise or parking function.";
CM_ SG_ 361 ADC_AebBrkTarTq_B1 "Total taget brake torque of the AEB";
CM_ SG_ 361 ADC_EpbModReqVld_B1 "The validity of the  request from the ADAS/ADS to the  EPB";
CM_ SG_ 361 ADC_RWUEna_B1 "The enable status of the  RWU";
CM_ SG_ 361 ADC_BrkHoldReq_B1 "The AVH request from the ADAS/ADS to the ESP/IPB.Not active：AVH no activeActive：AVH active";
CM_ SG_ 361 ADC_AngReqAvl_B1 "Steering angle request avaliable state";
CM_ SG_ 361 ADC_TarGearReqVld_B1 "Gear lever request validity";
CM_ SG_ 361 ADC_FctSts_B1 "ADAS active status";
CM_ SG_ 361 ADC_BrkTarTqVld_B1 "The validity of total  target brake torque";
CM_ SG_ 361 ADC_AebBrkTarTqVld_B1 "The validity of total target brake torque of the AEB";
CM_ SG_ 361 ADC_AebBrkTarTqEna_B1 "The enable status  of total  target brake torque of the AEB";
CM_ SG_ 361 ADC_ElecBrkFnSwitch_B1 "The switch for regenerative brake and hydraulic brake。Off：The ESP/IPB can not assign regenerative brake torque to the VCU/DCU。On：The ESP/IPB can assign regenerative brake torque to the VCUDCU。";
CM_ SG_ 361 ADC_RWUVld_B1 "The validity  of the RWU";
CM_ SG_ 361 ADC_DriverPresent_B1 "It indicates whether someone is in the driver's seat.";
CM_ SG_ 361 ADC_BrkTarTq_B1 "Total target brake torque for cruise and parking function ";
CM_ SG_ 371 ADC_13_B_CRC "E2E Profile 5 CRC";
CM_ SG_ 371 ADC_13_B_Counter "E2E Profile 5 Counter";
CM_ SG_ 371 ADC_TotalRefTorque "ADAS total  torque request";
CM_ SG_ 371 ADC_MotTarSpd "target motor speed";
CM_ SG_ 371 ADC_DycEscTarTq "The total target torque of the DYC(Direct  yaw moment control).";
CM_ SG_ 371 ADC_DycEscTarTqfactor "Partition coefficient of  total target torque of the DYC:front axle/total";
CM_ SG_ 371 ADC_SteerTqReq "Steering torque request value";
CM_ SG_ 371 ADC_LimTqFactorK "Limit torque request factor";
CM_ SG_ 371 ADC_MotTqLimMin "Wheel torque lower limit";
CM_ SG_ 371 ADC_MotTqLimMax "Wheel torque upper limit";
CM_ SG_ 371 ADC_MotTqRateLimMin "Wheel torque rate lower limit";
CM_ SG_ 371 ADC_MotTqRateLimMax "Wheel torque rate upper limit";
CM_ SG_ 371 ADC_TqUnloadRate "Unload torque rate";
CM_ SG_ 371 ADC_MotCtrlTar "Target control motor";
CM_ SG_ 371 ADC_MotTarMod "Target motor working mode";
CM_ SG_ 371 ADC_SteerTqSt "Steering torque request  enable state";
CM_ SG_ 371 ADC_DrvTarTqMod "Drive torque mode";
CM_ SG_ 371 ADC_TqEvsSteerReq "Emergency Collision avoidance steering mode request";
CM_ SG_ 371 ADC_SteerTqAvl "Steering torque request avaliable state";
CM_ SG_ 371 ADC_RapidRespEna "Rapid response mode enable flag";
CM_ SG_ 371 ADC_LimTqEnable "Limit torque request enable flag";
CM_ SG_ 371 ADC_MotSpdCtrlEna "Speed mode control enable flag";
CM_ SG_ 371 ADC_TqUnloadEna "Unload torque request enable flag";
CM_ SG_ 371 ADC_MotTarSpdSvValid "Speed mode control validity";
CM_ SG_ 371 ADC_DycEscTarTqVld "The validity of total target torque of the DYC.";
CM_ SG_ 371 ADC_DycEscTarTqEna "The enable status  of total target torque of the DYC.";
CM_ SG_ 371 ADC_RoadTyp "Pavement condition type";
CM_ SG_ 371 ADC_LeWhlLgtDst "The distance from the projection point of the left front wheel center on the ground to the edge of the road feature area";
CM_ SG_ 371 ADC_LeWhlRoadHei "Left front wheel front feature road bump height (or dip depth)";
CM_ SG_ 371 ADC_RiWhlLgtDst "The distance from the projection point of the right front wheel center on the ground to the edge of the road feature area";
CM_ SG_ 371 ADC_RiWhlRoadHei "Right front wheel front feature road bump height (or dip depth)";
CM_ SG_ 371 ADC_RiWhlRoadFeature "Right wheel single road feature type";
CM_ SG_ 371 ADC_SuspensionStatus "ADS air suspension status request";
CM_ SG_ 371 ADC_LeWhlRoadSts "Left wheel pavement uneven (concave/convex) condition";
CM_ SG_ 371 ADC_LeWhlRoadFeature "Left-wheel single road feature type";
CM_ SG_ 371 ADC_RiWhlRoadSts "Uneven (concave/convex) condition of the right wheel pavement";
CM_ SG_ 371 ADC_CDCCtrlEnable "ADS Enable signal";
CM_ SG_ 371 ADC_RoadInfoAvl "Road information significance";
CM_ SG_ 371 ADC_RoadFeatureDetFalutSts "Road feature Dettion Fault Status";
CM_ SG_ 371 ADC_RoadFeatureDetWorkSts "Road feature Dettion Work Status";
CM_ SG_ 371 ADC_LeWhlRoadFeature2 "Left-wheel single road feature2 type";
CM_ SG_ 371 ADC_LeWhlRoadFeature3 "Left-wheel single road feature3 type";
CM_ SG_ 371 ADC_RiWhlRoadFeature2 "Right wheel single road feature2 type";
CM_ SG_ 371 ADC_RiWhlRoadFeature3 "Right wheel single road feature3 type";
CM_ SG_ 371 ADC_LeWhlRoadHei2 "Left front wheel front feature2 road bump height (or dip depth)";
CM_ SG_ 371 ADC_LeWhlRoadHei3 "Left front wheel front feature3 road bump height (or dip depth)";
CM_ SG_ 371 ADC_RiWhlRoadHei2 "Right front wheel front feature2 road bump height (or dip depth)";
CM_ SG_ 371 ADC_RiWhlRoadHei3 "Right front wheel front feature3 road bump height (or dip depth)";
CM_ SG_ 371 ADC_LeWhlLgtDst2 "The distance from the projection point of the left front wheel center on the ground to the edge of the road feature2 area";
CM_ SG_ 371 ADC_LeWhlLgtDst3 "The distance from the projection point of the left front wheel center on the ground to the edge of the road feature3 area";
CM_ SG_ 371 ADC_RiWhlLgtDst2 "The distance from the projection point of the right front wheel center on the ground to the edge of the road feature2 area";
CM_ SG_ 371 ADC_RiWhlLgtDst3 "The distance from the projection point of the right front wheel center on the ground to the edge of the road feature3 area";
CM_ SG_ 371 ADC_AS_SuspHeiAdj "Request suspension adjustment control signal";
CM_ SG_ 371 ADC_AS_SuspHeiAdjVld "Request?suspension?adjustment?control?significant?signal";
CM_ SG_ 371 ADC_AS_SusStfnAdj "Request suspension stiffness adjustment control signal";
CM_ SG_ 371 ADC_AS_SusStfnAdjVld "Request suspension stiffness adjustment to control the significant signal";
CM_ SG_ 371 ADC_CDCModReq "Request?shock?absorber?damper?adjustment?control?signal";
CM_ SG_ 371 ADC_CDCModReqVld "Request damper damper regulation control significant signal";
CM_ SG_ 371 ADC_UrgentSteerFlg "Urgent Steering Flag of ADC";
CM_ SG_ 371 ADC_OneMotorCtrlEna "Motor Direct Control Enable Flag";
CM_ SG_ 371 ADC_MotorCtrlTqWhlRL "Target Drive Torque for Rear Left Motor";
CM_ SG_ 371 ADC_MotorCtrlTqWhlRR "Target Drive Torque for Rear Right Motor";
CM_ SG_ 371 ADC_SteerGainLevelTqCtrl "Driver steering torque gain request value";
CM_ SG_ 371 ADC_MotorCtrlTqWhlFR "Target Drive Torque for Front Right Motor";
CM_ SG_ 371 ADC_MotorCtrlTqWhlFL "Target Drive Torque for Front Left Motor";

BA_DEF_ BO_  "GenMsgCycleTime" INT 0 0;
BA_DEF_ BO_  "GenMsgCycleTimeFast" INT 0 0;
BA_DEF_ BO_  "GenMsgSendType" ENUM  "Periodic","Event","IfActive","POE","PA","FixedPeriodic","Event","EnabledPeriodic","NotUsed","NotUsed","EventPeriodic","NotUsed","NotUsed","NoMsgSendType";
BA_DEF_ BO_  "VFrameFormat" ENUM  "StandardCAN","ExtendedCAN","reserved","reserved","reserved","reserved","reserved","reserved","reserved","reserved","reserved","reserved","reserved","reserved","StandardCAN_FD","ExtendedCAN_FD";
BA_DEF_ BO_  "CANFD_BRS" ENUM  "0","1";
BA_DEF_ SG_  "EventCommandSignal" ENUM  "No","Yes";
BA_DEF_ SG_  "GatewayedSignals" ENUM  "No","Yes";
BA_DEF_ SG_  "GenSigInactiveValue" HEX 0 0;
BA_DEF_ SG_  "GenSigInvalidValue" HEX 0 0;
BA_DEF_ SG_  "GenSigSendType" ENUM  "Trigger","Passive","Cyclic","OnWrite","OnWriteWithRepetition","OnChange","OnChangeWithRepetition","IfActive","IfActiveWithRepetition","NoSigSendType";
BA_DEF_ SG_  "GenSigStartValue" HEX 0 0;
BA_DEF_ SG_  "GenSigTimeoutValue" HEX 0 0;
BA_DEF_ SG_  "Remark" STRING ;
BA_ "GenMsgCycleTime" BO_ 389 10;
BA_ "GenMsgCycleTimeFast" BO_ 389 0;
BA_ "GenMsgSendType" BO_ 389 0;
BA_ "VFrameFormat" BO_ 389 14;
BA_ "CANFD_BRS" BO_ 389 1;
BA_ "GenMsgCycleTime" BO_ 389 10;
BA_ "GenMsgCycleTimeFast" BO_ 389 0;
BA_ "GenMsgSendType" BO_ 389 0;
BA_ "VFrameFormat" BO_ 389 14;
BA_ "CANFD_BRS" BO_ 389 1;
BA_ "GenMsgCycleTime" BO_ 389 10;
BA_ "GenMsgCycleTimeFast" BO_ 389 0;
BA_ "GenMsgSendType" BO_ 389 0;
BA_ "VFrameFormat" BO_ 389 14;
BA_ "CANFD_BRS" BO_ 389 1;
BA_ "GenMsgCycleTime" BO_ 389 10;
BA_ "GenMsgCycleTimeFast" BO_ 389 0;
BA_ "GenMsgSendType" BO_ 389 0;
BA_ "VFrameFormat" BO_ 389 14;
BA_ "CANFD_BRS" BO_ 389 1;
BA_ "GenMsgCycleTime" BO_ 389 10;
BA_ "GenMsgCycleTimeFast" BO_ 389 0;
BA_ "GenMsgSendType" BO_ 389 0;
BA_ "VFrameFormat" BO_ 389 14;
BA_ "CANFD_BRS" BO_ 389 1;
BA_ "GenMsgCycleTime" BO_ 389 10;
BA_ "GenMsgCycleTimeFast" BO_ 389 0;
BA_ "GenMsgSendType" BO_ 389 0;
BA_ "VFrameFormat" BO_ 389 14;
BA_ "CANFD_BRS" BO_ 389 1;
BA_ "GenMsgCycleTime" BO_ 389 10;
BA_ "GenMsgCycleTimeFast" BO_ 389 0;
BA_ "GenMsgSendType" BO_ 389 0;
BA_ "VFrameFormat" BO_ 389 14;
BA_ "CANFD_BRS" BO_ 389 1;
BA_ "GenMsgCycleTime" BO_ 389 10;
BA_ "GenMsgCycleTimeFast" BO_ 389 0;
BA_ "GenMsgSendType" BO_ 389 0;
BA_ "VFrameFormat" BO_ 389 14;
BA_ "CANFD_BRS" BO_ 389 1;
BA_ "GenMsgCycleTime" BO_ 389 10;
BA_ "GenMsgCycleTimeFast" BO_ 389 0;
BA_ "GenMsgSendType" BO_ 389 0;
BA_ "VFrameFormat" BO_ 389 14;
BA_ "CANFD_BRS" BO_ 389 1;
BA_ "GenMsgCycleTime" BO_ 389 10;
BA_ "GenMsgCycleTimeFast" BO_ 389 0;
BA_ "GenMsgSendType" BO_ 389 0;
BA_ "VFrameFormat" BO_ 389 14;
BA_ "CANFD_BRS" BO_ 389 1;
BA_ "GenMsgCycleTime" BO_ 389 10;
BA_ "GenMsgCycleTimeFast" BO_ 389 0;
BA_ "GenMsgSendType" BO_ 389 0;
BA_ "VFrameFormat" BO_ 389 14;
BA_ "CANFD_BRS" BO_ 389 1;
BA_ "GenMsgCycleTime" BO_ 389 10;
BA_ "GenMsgCycleTimeFast" BO_ 389 0;
BA_ "GenMsgSendType" BO_ 389 0;
BA_ "VFrameFormat" BO_ 389 14;
BA_ "CANFD_BRS" BO_ 389 1;
BA_ "GenMsgCycleTime" BO_ 389 10;
BA_ "GenMsgCycleTimeFast" BO_ 389 0;
BA_ "GenMsgSendType" BO_ 389 0;
BA_ "VFrameFormat" BO_ 389 14;
BA_ "CANFD_BRS" BO_ 389 1;
BA_ "GenMsgCycleTime" BO_ 389 10;
BA_ "GenMsgCycleTimeFast" BO_ 389 0;
BA_ "GenMsgSendType" BO_ 389 0;
BA_ "VFrameFormat" BO_ 389 14;
BA_ "CANFD_BRS" BO_ 389 1;
BA_ "GenMsgCycleTime" BO_ 389 10;
BA_ "GenMsgCycleTimeFast" BO_ 389 0;
BA_ "GenMsgSendType" BO_ 389 0;
BA_ "VFrameFormat" BO_ 389 14;
BA_ "CANFD_BRS" BO_ 389 1;
BA_ "GenMsgCycleTime" BO_ 389 10;
BA_ "GenMsgCycleTimeFast" BO_ 389 0;
BA_ "GenMsgSendType" BO_ 389 0;
BA_ "VFrameFormat" BO_ 389 14;
BA_ "CANFD_BRS" BO_ 389 1;
BA_ "GenMsgCycleTime" BO_ 389 10;
BA_ "GenMsgCycleTimeFast" BO_ 389 0;
BA_ "GenMsgSendType" BO_ 389 0;
BA_ "VFrameFormat" BO_ 389 14;
BA_ "CANFD_BRS" BO_ 389 1;
BA_ "GenMsgCycleTime" BO_ 389 10;
BA_ "GenMsgCycleTimeFast" BO_ 389 0;
BA_ "GenMsgSendType" BO_ 389 0;
BA_ "VFrameFormat" BO_ 389 14;
BA_ "CANFD_BRS" BO_ 389 1;
BA_ "GenMsgCycleTime" BO_ 389 10;
BA_ "GenMsgCycleTimeFast" BO_ 389 0;
BA_ "GenMsgSendType" BO_ 389 0;
BA_ "VFrameFormat" BO_ 389 14;
BA_ "CANFD_BRS" BO_ 389 1;
BA_ "GenMsgCycleTime" BO_ 389 10;
BA_ "GenMsgCycleTimeFast" BO_ 389 0;
BA_ "GenMsgSendType" BO_ 389 0;
BA_ "VFrameFormat" BO_ 389 14;
BA_ "CANFD_BRS" BO_ 389 1;
BA_ "GenMsgCycleTime" BO_ 389 10;
BA_ "GenMsgCycleTimeFast" BO_ 389 0;
BA_ "GenMsgSendType" BO_ 389 0;
BA_ "VFrameFormat" BO_ 389 14;
BA_ "CANFD_BRS" BO_ 389 1;
BA_ "GenMsgCycleTime" BO_ 389 10;
BA_ "GenMsgCycleTimeFast" BO_ 389 0;
BA_ "GenMsgSendType" BO_ 389 0;
BA_ "VFrameFormat" BO_ 389 14;
BA_ "CANFD_BRS" BO_ 389 1;
BA_ "GenMsgCycleTime" BO_ 389 10;
BA_ "GenMsgCycleTimeFast" BO_ 389 0;
BA_ "GenMsgSendType" BO_ 389 0;
BA_ "VFrameFormat" BO_ 389 14;
BA_ "CANFD_BRS" BO_ 389 1;
BA_ "GenMsgCycleTime" BO_ 389 10;
BA_ "GenMsgCycleTimeFast" BO_ 389 0;
BA_ "GenMsgSendType" BO_ 389 0;
BA_ "VFrameFormat" BO_ 389 14;
BA_ "CANFD_BRS" BO_ 389 1;
BA_ "GenMsgCycleTime" BO_ 389 10;
BA_ "GenMsgCycleTimeFast" BO_ 389 0;
BA_ "GenMsgSendType" BO_ 389 0;
BA_ "VFrameFormat" BO_ 389 14;
BA_ "CANFD_BRS" BO_ 389 1;
BA_ "GenMsgCycleTime" BO_ 389 10;
BA_ "GenMsgCycleTimeFast" BO_ 389 0;
BA_ "GenMsgSendType" BO_ 389 0;
BA_ "VFrameFormat" BO_ 389 14;
BA_ "CANFD_BRS" BO_ 389 1;
BA_ "GenMsgCycleTime" BO_ 389 10;
BA_ "GenMsgCycleTimeFast" BO_ 389 0;
BA_ "GenMsgSendType" BO_ 389 0;
BA_ "VFrameFormat" BO_ 389 14;
BA_ "CANFD_BRS" BO_ 389 1;
BA_ "GenMsgCycleTime" BO_ 389 10;
BA_ "GenMsgCycleTimeFast" BO_ 389 0;
BA_ "GenMsgSendType" BO_ 389 0;
BA_ "VFrameFormat" BO_ 389 14;
BA_ "CANFD_BRS" BO_ 389 1;
BA_ "GenMsgCycleTime" BO_ 389 10;
BA_ "GenMsgCycleTimeFast" BO_ 389 0;
BA_ "GenMsgSendType" BO_ 389 0;
BA_ "VFrameFormat" BO_ 389 14;
BA_ "CANFD_BRS" BO_ 389 1;
BA_ "GenMsgCycleTime" BO_ 389 10;
BA_ "GenMsgCycleTimeFast" BO_ 389 0;
BA_ "GenMsgSendType" BO_ 389 0;
BA_ "VFrameFormat" BO_ 389 14;
BA_ "CANFD_BRS" BO_ 389 1;
BA_ "GenMsgCycleTime" BO_ 389 10;
BA_ "GenMsgCycleTimeFast" BO_ 389 0;
BA_ "GenMsgSendType" BO_ 389 0;
BA_ "VFrameFormat" BO_ 389 14;
BA_ "CANFD_BRS" BO_ 389 1;
BA_ "GenMsgCycleTime" BO_ 389 10;
BA_ "GenMsgCycleTimeFast" BO_ 389 0;
BA_ "GenMsgSendType" BO_ 389 0;
BA_ "VFrameFormat" BO_ 389 14;
BA_ "CANFD_BRS" BO_ 389 1;
BA_ "GenMsgCycleTime" BO_ 389 10;
BA_ "GenMsgCycleTimeFast" BO_ 389 0;
BA_ "GenMsgSendType" BO_ 389 0;
BA_ "VFrameFormat" BO_ 389 14;
BA_ "CANFD_BRS" BO_ 389 1;
BA_ "GenMsgCycleTime" BO_ 389 10;
BA_ "GenMsgCycleTimeFast" BO_ 389 0;
BA_ "GenMsgSendType" BO_ 389 0;
BA_ "VFrameFormat" BO_ 389 14;
BA_ "CANFD_BRS" BO_ 389 1;
BA_ "GenMsgCycleTime" BO_ 389 10;
BA_ "GenMsgCycleTimeFast" BO_ 389 0;
BA_ "GenMsgSendType" BO_ 389 0;
BA_ "VFrameFormat" BO_ 389 14;
BA_ "CANFD_BRS" BO_ 389 1;
BA_ "GenMsgCycleTime" BO_ 389 10;
BA_ "GenMsgCycleTimeFast" BO_ 389 0;
BA_ "GenMsgSendType" BO_ 389 0;
BA_ "VFrameFormat" BO_ 389 14;
BA_ "CANFD_BRS" BO_ 389 1;
BA_ "GenMsgCycleTime" BO_ 389 10;
BA_ "GenMsgCycleTimeFast" BO_ 389 0;
BA_ "GenMsgSendType" BO_ 389 0;
BA_ "VFrameFormat" BO_ 389 14;
BA_ "CANFD_BRS" BO_ 389 1;
BA_ "GenMsgCycleTime" BO_ 389 10;
BA_ "GenMsgCycleTimeFast" BO_ 389 0;
BA_ "GenMsgSendType" BO_ 389 0;
BA_ "VFrameFormat" BO_ 389 14;
BA_ "CANFD_BRS" BO_ 389 1;
BA_ "GenMsgCycleTime" BO_ 389 10;
BA_ "GenMsgCycleTimeFast" BO_ 389 0;
BA_ "GenMsgSendType" BO_ 389 0;
BA_ "VFrameFormat" BO_ 389 14;
BA_ "CANFD_BRS" BO_ 389 1;
BA_ "GenMsgCycleTime" BO_ 389 10;
BA_ "GenMsgCycleTimeFast" BO_ 389 0;
BA_ "GenMsgSendType" BO_ 389 0;
BA_ "VFrameFormat" BO_ 389 14;
BA_ "CANFD_BRS" BO_ 389 1;
BA_ "GenMsgCycleTime" BO_ 389 10;
BA_ "GenMsgCycleTimeFast" BO_ 389 0;
BA_ "GenMsgSendType" BO_ 389 0;
BA_ "VFrameFormat" BO_ 389 14;
BA_ "CANFD_BRS" BO_ 389 1;
BA_ "GenMsgCycleTime" BO_ 389 10;
BA_ "GenMsgCycleTimeFast" BO_ 389 0;
BA_ "GenMsgSendType" BO_ 389 0;
BA_ "VFrameFormat" BO_ 389 14;
BA_ "CANFD_BRS" BO_ 389 1;
BA_ "GenMsgCycleTime" BO_ 389 10;
BA_ "GenMsgCycleTimeFast" BO_ 389 0;
BA_ "GenMsgSendType" BO_ 389 0;
BA_ "VFrameFormat" BO_ 389 14;
BA_ "CANFD_BRS" BO_ 389 1;
BA_ "GenMsgCycleTime" BO_ 389 10;
BA_ "GenMsgCycleTimeFast" BO_ 389 0;
BA_ "GenMsgSendType" BO_ 389 0;
BA_ "VFrameFormat" BO_ 389 14;
BA_ "CANFD_BRS" BO_ 389 1;
BA_ "GenMsgCycleTime" BO_ 389 10;
BA_ "GenMsgCycleTimeFast" BO_ 389 0;
BA_ "GenMsgSendType" BO_ 389 0;
BA_ "VFrameFormat" BO_ 389 14;
BA_ "CANFD_BRS" BO_ 389 1;
BA_ "GenMsgCycleTime" BO_ 389 10;
BA_ "GenMsgCycleTimeFast" BO_ 389 0;
BA_ "GenMsgSendType" BO_ 389 0;
BA_ "VFrameFormat" BO_ 389 14;
BA_ "CANFD_BRS" BO_ 389 1;
BA_ "GenMsgCycleTime" BO_ 389 10;
BA_ "GenMsgCycleTimeFast" BO_ 389 0;
BA_ "GenMsgSendType" BO_ 389 0;
BA_ "VFrameFormat" BO_ 389 14;
BA_ "CANFD_BRS" BO_ 389 1;
BA_ "GenMsgCycleTime" BO_ 389 10;
BA_ "GenMsgCycleTimeFast" BO_ 389 0;
BA_ "GenMsgSendType" BO_ 389 0;
BA_ "VFrameFormat" BO_ 389 14;
BA_ "CANFD_BRS" BO_ 389 1;
BA_ "GenMsgCycleTime" BO_ 389 10;
BA_ "GenMsgCycleTimeFast" BO_ 389 0;
BA_ "GenMsgSendType" BO_ 389 0;
BA_ "VFrameFormat" BO_ 389 14;
BA_ "CANFD_BRS" BO_ 389 1;
BA_ "GenMsgCycleTime" BO_ 389 10;
BA_ "GenMsgCycleTimeFast" BO_ 389 0;
BA_ "GenMsgSendType" BO_ 389 0;
BA_ "VFrameFormat" BO_ 389 14;
BA_ "CANFD_BRS" BO_ 389 1;
BA_ "GenMsgCycleTime" BO_ 389 10;
BA_ "GenMsgCycleTimeFast" BO_ 389 0;
BA_ "GenMsgSendType" BO_ 389 0;
BA_ "VFrameFormat" BO_ 389 14;
BA_ "CANFD_BRS" BO_ 389 1;
BA_ "GenMsgCycleTime" BO_ 389 10;
BA_ "GenMsgCycleTimeFast" BO_ 389 0;
BA_ "GenMsgSendType" BO_ 389 0;
BA_ "VFrameFormat" BO_ 389 14;
BA_ "CANFD_BRS" BO_ 389 1;
BA_ "GenMsgCycleTime" BO_ 389 10;
BA_ "GenMsgCycleTimeFast" BO_ 389 0;
BA_ "GenMsgSendType" BO_ 389 0;
BA_ "VFrameFormat" BO_ 389 14;
BA_ "CANFD_BRS" BO_ 389 1;
BA_ "GenMsgCycleTime" BO_ 389 10;
BA_ "GenMsgCycleTimeFast" BO_ 389 0;
BA_ "GenMsgSendType" BO_ 389 0;
BA_ "VFrameFormat" BO_ 389 14;
BA_ "CANFD_BRS" BO_ 389 1;
BA_ "GenMsgCycleTime" BO_ 389 10;
BA_ "GenMsgCycleTimeFast" BO_ 389 0;
BA_ "GenMsgSendType" BO_ 389 0;
BA_ "VFrameFormat" BO_ 389 14;
BA_ "CANFD_BRS" BO_ 389 1;
BA_ "GenMsgCycleTime" BO_ 389 10;
BA_ "GenMsgCycleTimeFast" BO_ 389 0;
BA_ "GenMsgSendType" BO_ 389 0;
BA_ "VFrameFormat" BO_ 389 14;
BA_ "CANFD_BRS" BO_ 389 1;
BA_ "GenMsgCycleTime" BO_ 389 10;
BA_ "GenMsgCycleTimeFast" BO_ 389 0;
BA_ "GenMsgSendType" BO_ 389 0;
BA_ "VFrameFormat" BO_ 389 14;
BA_ "CANFD_BRS" BO_ 389 1;
BA_ "GenMsgCycleTime" BO_ 389 10;
BA_ "GenMsgCycleTimeFast" BO_ 389 0;
BA_ "GenMsgSendType" BO_ 389 0;
BA_ "VFrameFormat" BO_ 389 14;
BA_ "CANFD_BRS" BO_ 389 1;
BA_ "GenMsgCycleTime" BO_ 389 10;
BA_ "GenMsgCycleTimeFast" BO_ 389 0;
BA_ "GenMsgSendType" BO_ 389 0;
BA_ "VFrameFormat" BO_ 389 14;
BA_ "CANFD_BRS" BO_ 389 1;
BA_ "GenMsgCycleTime" BO_ 389 10;
BA_ "GenMsgCycleTimeFast" BO_ 389 0;
BA_ "GenMsgSendType" BO_ 389 0;
BA_ "VFrameFormat" BO_ 389 14;
BA_ "CANFD_BRS" BO_ 389 1;
BA_ "GenMsgCycleTime" BO_ 389 10;
BA_ "GenMsgCycleTimeFast" BO_ 389 0;
BA_ "GenMsgSendType" BO_ 389 0;
BA_ "VFrameFormat" BO_ 389 14;
BA_ "CANFD_BRS" BO_ 389 1;
BA_ "GenMsgCycleTime" BO_ 389 10;
BA_ "GenMsgCycleTimeFast" BO_ 389 0;
BA_ "GenMsgSendType" BO_ 389 0;
BA_ "VFrameFormat" BO_ 389 14;
BA_ "CANFD_BRS" BO_ 389 1;
BA_ "GenMsgCycleTime" BO_ 389 10;
BA_ "GenMsgCycleTimeFast" BO_ 389 0;
BA_ "GenMsgSendType" BO_ 389 0;
BA_ "VFrameFormat" BO_ 389 14;
BA_ "CANFD_BRS" BO_ 389 1;
BA_ "GenMsgCycleTime" BO_ 389 10;
BA_ "GenMsgCycleTimeFast" BO_ 389 0;
BA_ "GenMsgSendType" BO_ 389 0;
BA_ "VFrameFormat" BO_ 389 14;
BA_ "CANFD_BRS" BO_ 389 1;
BA_ "GenMsgCycleTime" BO_ 389 10;
BA_ "GenMsgCycleTimeFast" BO_ 389 0;
BA_ "GenMsgSendType" BO_ 389 0;
BA_ "VFrameFormat" BO_ 389 14;
BA_ "CANFD_BRS" BO_ 389 1;
BA_ "GenMsgCycleTime" BO_ 389 10;
BA_ "GenMsgCycleTimeFast" BO_ 389 0;
BA_ "GenMsgSendType" BO_ 389 0;
BA_ "VFrameFormat" BO_ 389 14;
BA_ "CANFD_BRS" BO_ 389 1;
BA_ "GenMsgCycleTime" BO_ 389 10;
BA_ "GenMsgCycleTimeFast" BO_ 389 0;
BA_ "GenMsgSendType" BO_ 389 0;
BA_ "VFrameFormat" BO_ 389 14;
BA_ "CANFD_BRS" BO_ 389 1;
BA_ "GenMsgCycleTime" BO_ 389 10;
BA_ "GenMsgCycleTimeFast" BO_ 389 0;
BA_ "GenMsgSendType" BO_ 389 0;
BA_ "VFrameFormat" BO_ 389 14;
BA_ "CANFD_BRS" BO_ 389 1;
BA_ "GenMsgCycleTime" BO_ 389 10;
BA_ "GenMsgCycleTimeFast" BO_ 389 0;
BA_ "GenMsgSendType" BO_ 389 0;
BA_ "VFrameFormat" BO_ 389 14;
BA_ "CANFD_BRS" BO_ 389 1;
BA_ "GenMsgCycleTime" BO_ 389 10;
BA_ "GenMsgCycleTimeFast" BO_ 389 0;
BA_ "GenMsgSendType" BO_ 389 0;
BA_ "VFrameFormat" BO_ 389 14;
BA_ "CANFD_BRS" BO_ 389 1;
BA_ "GenMsgCycleTime" BO_ 361 10;
BA_ "GenMsgCycleTimeFast" BO_ 361 0;
BA_ "GenMsgSendType" BO_ 361 0;
BA_ "VFrameFormat" BO_ 361 14;
BA_ "CANFD_BRS" BO_ 361 1;
BA_ "GenMsgCycleTime" BO_ 361 10;
BA_ "GenMsgCycleTimeFast" BO_ 361 0;
BA_ "GenMsgSendType" BO_ 361 0;
BA_ "VFrameFormat" BO_ 361 14;
BA_ "CANFD_BRS" BO_ 361 1;
BA_ "GenMsgCycleTime" BO_ 361 10;
BA_ "GenMsgCycleTimeFast" BO_ 361 0;
BA_ "GenMsgSendType" BO_ 361 0;
BA_ "VFrameFormat" BO_ 361 14;
BA_ "CANFD_BRS" BO_ 361 1;
BA_ "GenMsgCycleTime" BO_ 361 10;
BA_ "GenMsgCycleTimeFast" BO_ 361 0;
BA_ "GenMsgSendType" BO_ 361 0;
BA_ "VFrameFormat" BO_ 361 14;
BA_ "CANFD_BRS" BO_ 361 1;
BA_ "GenMsgCycleTime" BO_ 361 10;
BA_ "GenMsgCycleTimeFast" BO_ 361 0;
BA_ "GenMsgSendType" BO_ 361 0;
BA_ "VFrameFormat" BO_ 361 14;
BA_ "CANFD_BRS" BO_ 361 1;
BA_ "GenMsgCycleTime" BO_ 361 10;
BA_ "GenMsgCycleTimeFast" BO_ 361 0;
BA_ "GenMsgSendType" BO_ 361 0;
BA_ "VFrameFormat" BO_ 361 14;
BA_ "CANFD_BRS" BO_ 361 1;
BA_ "GenMsgCycleTime" BO_ 361 10;
BA_ "GenMsgCycleTimeFast" BO_ 361 0;
BA_ "GenMsgSendType" BO_ 361 0;
BA_ "VFrameFormat" BO_ 361 14;
BA_ "CANFD_BRS" BO_ 361 1;
BA_ "GenMsgCycleTime" BO_ 361 10;
BA_ "GenMsgCycleTimeFast" BO_ 361 0;
BA_ "GenMsgSendType" BO_ 361 0;
BA_ "VFrameFormat" BO_ 361 14;
BA_ "CANFD_BRS" BO_ 361 1;
BA_ "GenMsgCycleTime" BO_ 361 10;
BA_ "GenMsgCycleTimeFast" BO_ 361 0;
BA_ "GenMsgSendType" BO_ 361 0;
BA_ "VFrameFormat" BO_ 361 14;
BA_ "CANFD_BRS" BO_ 361 1;
BA_ "GenMsgCycleTime" BO_ 361 10;
BA_ "GenMsgCycleTimeFast" BO_ 361 0;
BA_ "GenMsgSendType" BO_ 361 0;
BA_ "VFrameFormat" BO_ 361 14;
BA_ "CANFD_BRS" BO_ 361 1;
BA_ "GenMsgCycleTime" BO_ 361 10;
BA_ "GenMsgCycleTimeFast" BO_ 361 0;
BA_ "GenMsgSendType" BO_ 361 0;
BA_ "VFrameFormat" BO_ 361 14;
BA_ "CANFD_BRS" BO_ 361 1;
BA_ "GenMsgCycleTime" BO_ 361 10;
BA_ "GenMsgCycleTimeFast" BO_ 361 0;
BA_ "GenMsgSendType" BO_ 361 0;
BA_ "VFrameFormat" BO_ 361 14;
BA_ "CANFD_BRS" BO_ 361 1;
BA_ "GenMsgCycleTime" BO_ 361 10;
BA_ "GenMsgCycleTimeFast" BO_ 361 0;
BA_ "GenMsgSendType" BO_ 361 0;
BA_ "VFrameFormat" BO_ 361 14;
BA_ "CANFD_BRS" BO_ 361 1;
BA_ "GenMsgCycleTime" BO_ 361 10;
BA_ "GenMsgCycleTimeFast" BO_ 361 0;
BA_ "GenMsgSendType" BO_ 361 0;
BA_ "VFrameFormat" BO_ 361 14;
BA_ "CANFD_BRS" BO_ 361 1;
BA_ "GenMsgCycleTime" BO_ 361 10;
BA_ "GenMsgCycleTimeFast" BO_ 361 0;
BA_ "GenMsgSendType" BO_ 361 0;
BA_ "VFrameFormat" BO_ 361 14;
BA_ "CANFD_BRS" BO_ 361 1;
BA_ "GenMsgCycleTime" BO_ 361 10;
BA_ "GenMsgCycleTimeFast" BO_ 361 0;
BA_ "GenMsgSendType" BO_ 361 0;
BA_ "VFrameFormat" BO_ 361 14;
BA_ "CANFD_BRS" BO_ 361 1;
BA_ "GenMsgCycleTime" BO_ 361 10;
BA_ "GenMsgCycleTimeFast" BO_ 361 0;
BA_ "GenMsgSendType" BO_ 361 0;
BA_ "VFrameFormat" BO_ 361 14;
BA_ "CANFD_BRS" BO_ 361 1;
BA_ "GenMsgCycleTime" BO_ 361 10;
BA_ "GenMsgCycleTimeFast" BO_ 361 0;
BA_ "GenMsgSendType" BO_ 361 0;
BA_ "VFrameFormat" BO_ 361 14;
BA_ "CANFD_BRS" BO_ 361 1;
BA_ "GenMsgCycleTime" BO_ 361 10;
BA_ "GenMsgCycleTimeFast" BO_ 361 0;
BA_ "GenMsgSendType" BO_ 361 0;
BA_ "VFrameFormat" BO_ 361 14;
BA_ "CANFD_BRS" BO_ 361 1;
BA_ "GenMsgCycleTime" BO_ 361 10;
BA_ "GenMsgCycleTimeFast" BO_ 361 0;
BA_ "GenMsgSendType" BO_ 361 0;
BA_ "VFrameFormat" BO_ 361 14;
BA_ "CANFD_BRS" BO_ 361 1;
BA_ "GenMsgCycleTime" BO_ 361 10;
BA_ "GenMsgCycleTimeFast" BO_ 361 0;
BA_ "GenMsgSendType" BO_ 361 0;
BA_ "VFrameFormat" BO_ 361 14;
BA_ "CANFD_BRS" BO_ 361 1;
BA_ "GenMsgCycleTime" BO_ 361 10;
BA_ "GenMsgCycleTimeFast" BO_ 361 0;
BA_ "GenMsgSendType" BO_ 361 0;
BA_ "VFrameFormat" BO_ 361 14;
BA_ "CANFD_BRS" BO_ 361 1;
BA_ "GenMsgCycleTime" BO_ 361 10;
BA_ "GenMsgCycleTimeFast" BO_ 361 0;
BA_ "GenMsgSendType" BO_ 361 0;
BA_ "VFrameFormat" BO_ 361 14;
BA_ "CANFD_BRS" BO_ 361 1;
BA_ "GenMsgCycleTime" BO_ 361 10;
BA_ "GenMsgCycleTimeFast" BO_ 361 0;
BA_ "GenMsgSendType" BO_ 361 0;
BA_ "VFrameFormat" BO_ 361 14;
BA_ "CANFD_BRS" BO_ 361 1;
BA_ "GenMsgCycleTime" BO_ 361 10;
BA_ "GenMsgCycleTimeFast" BO_ 361 0;
BA_ "GenMsgSendType" BO_ 361 0;
BA_ "VFrameFormat" BO_ 361 14;
BA_ "CANFD_BRS" BO_ 361 1;
BA_ "GenMsgCycleTime" BO_ 361 10;
BA_ "GenMsgCycleTimeFast" BO_ 361 0;
BA_ "GenMsgSendType" BO_ 361 0;
BA_ "VFrameFormat" BO_ 361 14;
BA_ "CANFD_BRS" BO_ 361 1;
BA_ "GenMsgCycleTime" BO_ 361 10;
BA_ "GenMsgCycleTimeFast" BO_ 361 0;
BA_ "GenMsgSendType" BO_ 361 0;
BA_ "VFrameFormat" BO_ 361 14;
BA_ "CANFD_BRS" BO_ 361 1;
BA_ "GenMsgCycleTime" BO_ 361 10;
BA_ "GenMsgCycleTimeFast" BO_ 361 0;
BA_ "GenMsgSendType" BO_ 361 0;
BA_ "VFrameFormat" BO_ 361 14;
BA_ "CANFD_BRS" BO_ 361 1;
BA_ "GenMsgCycleTime" BO_ 361 10;
BA_ "GenMsgCycleTimeFast" BO_ 361 0;
BA_ "GenMsgSendType" BO_ 361 0;
BA_ "VFrameFormat" BO_ 361 14;
BA_ "CANFD_BRS" BO_ 361 1;
BA_ "GenMsgCycleTime" BO_ 361 10;
BA_ "GenMsgCycleTimeFast" BO_ 361 0;
BA_ "GenMsgSendType" BO_ 361 0;
BA_ "VFrameFormat" BO_ 361 14;
BA_ "CANFD_BRS" BO_ 361 1;
BA_ "GenMsgCycleTime" BO_ 361 10;
BA_ "GenMsgCycleTimeFast" BO_ 361 0;
BA_ "GenMsgSendType" BO_ 361 0;
BA_ "VFrameFormat" BO_ 361 14;
BA_ "CANFD_BRS" BO_ 361 1;
BA_ "GenMsgCycleTime" BO_ 361 10;
BA_ "GenMsgCycleTimeFast" BO_ 361 0;
BA_ "GenMsgSendType" BO_ 361 0;
BA_ "VFrameFormat" BO_ 361 14;
BA_ "CANFD_BRS" BO_ 361 1;
BA_ "GenMsgCycleTime" BO_ 361 10;
BA_ "GenMsgCycleTimeFast" BO_ 361 0;
BA_ "GenMsgSendType" BO_ 361 0;
BA_ "VFrameFormat" BO_ 361 14;
BA_ "CANFD_BRS" BO_ 361 1;
BA_ "GenMsgCycleTime" BO_ 361 10;
BA_ "GenMsgCycleTimeFast" BO_ 361 0;
BA_ "GenMsgSendType" BO_ 361 0;
BA_ "VFrameFormat" BO_ 361 14;
BA_ "CANFD_BRS" BO_ 361 1;
BA_ "GenMsgCycleTime" BO_ 361 10;
BA_ "GenMsgCycleTimeFast" BO_ 361 0;
BA_ "GenMsgSendType" BO_ 361 0;
BA_ "VFrameFormat" BO_ 361 14;
BA_ "CANFD_BRS" BO_ 361 1;
BA_ "GenMsgCycleTime" BO_ 361 10;
BA_ "GenMsgCycleTimeFast" BO_ 361 0;
BA_ "GenMsgSendType" BO_ 361 0;
BA_ "VFrameFormat" BO_ 361 14;
BA_ "CANFD_BRS" BO_ 361 1;
BA_ "GenMsgCycleTime" BO_ 361 10;
BA_ "GenMsgCycleTimeFast" BO_ 361 0;
BA_ "GenMsgSendType" BO_ 361 0;
BA_ "VFrameFormat" BO_ 361 14;
BA_ "CANFD_BRS" BO_ 361 1;
BA_ "GenMsgCycleTime" BO_ 361 10;
BA_ "GenMsgCycleTimeFast" BO_ 361 0;
BA_ "GenMsgSendType" BO_ 361 0;
BA_ "VFrameFormat" BO_ 361 14;
BA_ "CANFD_BRS" BO_ 361 1;
BA_ "GenMsgCycleTime" BO_ 361 10;
BA_ "GenMsgCycleTimeFast" BO_ 361 0;
BA_ "GenMsgSendType" BO_ 361 0;
BA_ "VFrameFormat" BO_ 361 14;
BA_ "CANFD_BRS" BO_ 361 1;
BA_ "GenMsgCycleTime" BO_ 361 10;
BA_ "GenMsgCycleTimeFast" BO_ 361 0;
BA_ "GenMsgSendType" BO_ 361 0;
BA_ "VFrameFormat" BO_ 361 14;
BA_ "CANFD_BRS" BO_ 361 1;
BA_ "GenMsgCycleTime" BO_ 361 10;
BA_ "GenMsgCycleTimeFast" BO_ 361 0;
BA_ "GenMsgSendType" BO_ 361 0;
BA_ "VFrameFormat" BO_ 361 14;
BA_ "CANFD_BRS" BO_ 361 1;
BA_ "GenMsgCycleTime" BO_ 361 10;
BA_ "GenMsgCycleTimeFast" BO_ 361 0;
BA_ "GenMsgSendType" BO_ 361 0;
BA_ "VFrameFormat" BO_ 361 14;
BA_ "CANFD_BRS" BO_ 361 1;
BA_ "GenMsgCycleTime" BO_ 361 10;
BA_ "GenMsgCycleTimeFast" BO_ 361 0;
BA_ "GenMsgSendType" BO_ 361 0;
BA_ "VFrameFormat" BO_ 361 14;
BA_ "CANFD_BRS" BO_ 361 1;
BA_ "GenMsgCycleTime" BO_ 361 10;
BA_ "GenMsgCycleTimeFast" BO_ 361 0;
BA_ "GenMsgSendType" BO_ 361 0;
BA_ "VFrameFormat" BO_ 361 14;
BA_ "CANFD_BRS" BO_ 361 1;
BA_ "GenMsgCycleTime" BO_ 361 10;
BA_ "GenMsgCycleTimeFast" BO_ 361 0;
BA_ "GenMsgSendType" BO_ 361 0;
BA_ "VFrameFormat" BO_ 361 14;
BA_ "CANFD_BRS" BO_ 361 1;
BA_ "GenMsgCycleTime" BO_ 361 10;
BA_ "GenMsgCycleTimeFast" BO_ 361 0;
BA_ "GenMsgSendType" BO_ 361 0;
BA_ "VFrameFormat" BO_ 361 14;
BA_ "CANFD_BRS" BO_ 361 1;
BA_ "GenMsgCycleTime" BO_ 361 10;
BA_ "GenMsgCycleTimeFast" BO_ 361 0;
BA_ "GenMsgSendType" BO_ 361 0;
BA_ "VFrameFormat" BO_ 361 14;
BA_ "CANFD_BRS" BO_ 361 1;
BA_ "GenMsgCycleTime" BO_ 361 10;
BA_ "GenMsgCycleTimeFast" BO_ 361 0;
BA_ "GenMsgSendType" BO_ 361 0;
BA_ "VFrameFormat" BO_ 361 14;
BA_ "CANFD_BRS" BO_ 361 1;
BA_ "GenMsgCycleTime" BO_ 361 10;
BA_ "GenMsgCycleTimeFast" BO_ 361 0;
BA_ "GenMsgSendType" BO_ 361 0;
BA_ "VFrameFormat" BO_ 361 14;
BA_ "CANFD_BRS" BO_ 361 1;
BA_ "GenMsgCycleTime" BO_ 361 10;
BA_ "GenMsgCycleTimeFast" BO_ 361 0;
BA_ "GenMsgSendType" BO_ 361 0;
BA_ "VFrameFormat" BO_ 361 14;
BA_ "CANFD_BRS" BO_ 361 1;
BA_ "GenMsgCycleTime" BO_ 361 10;
BA_ "GenMsgCycleTimeFast" BO_ 361 0;
BA_ "GenMsgSendType" BO_ 361 0;
BA_ "VFrameFormat" BO_ 361 14;
BA_ "CANFD_BRS" BO_ 361 1;
BA_ "GenMsgCycleTime" BO_ 361 10;
BA_ "GenMsgCycleTimeFast" BO_ 361 0;
BA_ "GenMsgSendType" BO_ 361 0;
BA_ "VFrameFormat" BO_ 361 14;
BA_ "CANFD_BRS" BO_ 361 1;
BA_ "GenMsgCycleTime" BO_ 361 10;
BA_ "GenMsgCycleTimeFast" BO_ 361 0;
BA_ "GenMsgSendType" BO_ 361 0;
BA_ "VFrameFormat" BO_ 361 14;
BA_ "CANFD_BRS" BO_ 361 1;
BA_ "GenMsgCycleTime" BO_ 361 10;
BA_ "GenMsgCycleTimeFast" BO_ 361 0;
BA_ "GenMsgSendType" BO_ 361 0;
BA_ "VFrameFormat" BO_ 361 14;
BA_ "CANFD_BRS" BO_ 361 1;
BA_ "GenMsgCycleTime" BO_ 361 10;
BA_ "GenMsgCycleTimeFast" BO_ 361 0;
BA_ "GenMsgSendType" BO_ 361 0;
BA_ "VFrameFormat" BO_ 361 14;
BA_ "CANFD_BRS" BO_ 361 1;
BA_ "GenMsgCycleTime" BO_ 361 10;
BA_ "GenMsgCycleTimeFast" BO_ 361 0;
BA_ "GenMsgSendType" BO_ 361 0;
BA_ "VFrameFormat" BO_ 361 14;
BA_ "CANFD_BRS" BO_ 361 1;
BA_ "GenMsgCycleTime" BO_ 361 10;
BA_ "GenMsgCycleTimeFast" BO_ 361 0;
BA_ "GenMsgSendType" BO_ 361 0;
BA_ "VFrameFormat" BO_ 361 14;
BA_ "CANFD_BRS" BO_ 361 1;
BA_ "GenMsgCycleTime" BO_ 361 10;
BA_ "GenMsgCycleTimeFast" BO_ 361 0;
BA_ "GenMsgSendType" BO_ 361 0;
BA_ "VFrameFormat" BO_ 361 14;
BA_ "CANFD_BRS" BO_ 361 1;
BA_ "GenMsgCycleTime" BO_ 361 10;
BA_ "GenMsgCycleTimeFast" BO_ 361 0;
BA_ "GenMsgSendType" BO_ 361 0;
BA_ "VFrameFormat" BO_ 361 14;
BA_ "CANFD_BRS" BO_ 361 1;
BA_ "GenMsgCycleTime" BO_ 361 10;
BA_ "GenMsgCycleTimeFast" BO_ 361 0;
BA_ "GenMsgSendType" BO_ 361 0;
BA_ "VFrameFormat" BO_ 361 14;
BA_ "CANFD_BRS" BO_ 361 1;
BA_ "GenMsgCycleTime" BO_ 361 10;
BA_ "GenMsgCycleTimeFast" BO_ 361 0;
BA_ "GenMsgSendType" BO_ 361 0;
BA_ "VFrameFormat" BO_ 361 14;
BA_ "CANFD_BRS" BO_ 361 1;
BA_ "GenMsgCycleTime" BO_ 361 10;
BA_ "GenMsgCycleTimeFast" BO_ 361 0;
BA_ "GenMsgSendType" BO_ 361 0;
BA_ "VFrameFormat" BO_ 361 14;
BA_ "CANFD_BRS" BO_ 361 1;
BA_ "GenMsgCycleTime" BO_ 361 10;
BA_ "GenMsgCycleTimeFast" BO_ 361 0;
BA_ "GenMsgSendType" BO_ 361 0;
BA_ "VFrameFormat" BO_ 361 14;
BA_ "CANFD_BRS" BO_ 361 1;
BA_ "GenMsgCycleTime" BO_ 361 10;
BA_ "GenMsgCycleTimeFast" BO_ 361 0;
BA_ "GenMsgSendType" BO_ 361 0;
BA_ "VFrameFormat" BO_ 361 14;
BA_ "CANFD_BRS" BO_ 361 1;
BA_ "GenMsgCycleTime" BO_ 361 10;
BA_ "GenMsgCycleTimeFast" BO_ 361 0;
BA_ "GenMsgSendType" BO_ 361 0;
BA_ "VFrameFormat" BO_ 361 14;
BA_ "CANFD_BRS" BO_ 361 1;
BA_ "GenMsgCycleTime" BO_ 361 10;
BA_ "GenMsgCycleTimeFast" BO_ 361 0;
BA_ "GenMsgSendType" BO_ 361 0;
BA_ "VFrameFormat" BO_ 361 14;
BA_ "CANFD_BRS" BO_ 361 1;
BA_ "GenMsgCycleTime" BO_ 361 10;
BA_ "GenMsgCycleTimeFast" BO_ 361 0;
BA_ "GenMsgSendType" BO_ 361 0;
BA_ "VFrameFormat" BO_ 361 14;
BA_ "CANFD_BRS" BO_ 361 1;
BA_ "GenMsgCycleTime" BO_ 361 10;
BA_ "GenMsgCycleTimeFast" BO_ 361 0;
BA_ "GenMsgSendType" BO_ 361 0;
BA_ "VFrameFormat" BO_ 361 14;
BA_ "CANFD_BRS" BO_ 361 1;
BA_ "GenMsgCycleTime" BO_ 361 10;
BA_ "GenMsgCycleTimeFast" BO_ 361 0;
BA_ "GenMsgSendType" BO_ 361 0;
BA_ "VFrameFormat" BO_ 361 14;
BA_ "CANFD_BRS" BO_ 361 1;
BA_ "GenMsgCycleTime" BO_ 361 10;
BA_ "GenMsgCycleTimeFast" BO_ 361 0;
BA_ "GenMsgSendType" BO_ 361 0;
BA_ "VFrameFormat" BO_ 361 14;
BA_ "CANFD_BRS" BO_ 361 1;
BA_ "GenMsgCycleTime" BO_ 361 10;
BA_ "GenMsgCycleTimeFast" BO_ 361 0;
BA_ "GenMsgSendType" BO_ 361 0;
BA_ "VFrameFormat" BO_ 361 14;
BA_ "CANFD_BRS" BO_ 361 1;
BA_ "GenMsgCycleTime" BO_ 361 10;
BA_ "GenMsgCycleTimeFast" BO_ 361 0;
BA_ "GenMsgSendType" BO_ 361 0;
BA_ "VFrameFormat" BO_ 361 14;
BA_ "CANFD_BRS" BO_ 361 1;
BA_ "GenMsgCycleTime" BO_ 361 10;
BA_ "GenMsgCycleTimeFast" BO_ 361 0;
BA_ "GenMsgSendType" BO_ 361 0;
BA_ "VFrameFormat" BO_ 361 14;
BA_ "CANFD_BRS" BO_ 361 1;
BA_ "GenMsgCycleTime" BO_ 361 10;
BA_ "GenMsgCycleTimeFast" BO_ 361 0;
BA_ "GenMsgSendType" BO_ 361 0;
BA_ "VFrameFormat" BO_ 361 14;
BA_ "CANFD_BRS" BO_ 361 1;
BA_ "GenMsgCycleTime" BO_ 361 10;
BA_ "GenMsgCycleTimeFast" BO_ 361 0;
BA_ "GenMsgSendType" BO_ 361 0;
BA_ "VFrameFormat" BO_ 361 14;
BA_ "CANFD_BRS" BO_ 361 1;
BA_ "GenMsgCycleTime" BO_ 361 10;
BA_ "GenMsgCycleTimeFast" BO_ 361 0;
BA_ "GenMsgSendType" BO_ 361 0;
BA_ "VFrameFormat" BO_ 361 14;
BA_ "CANFD_BRS" BO_ 361 1;
BA_ "GenMsgCycleTime" BO_ 361 10;
BA_ "GenMsgCycleTimeFast" BO_ 361 0;
BA_ "GenMsgSendType" BO_ 361 0;
BA_ "VFrameFormat" BO_ 361 14;
BA_ "CANFD_BRS" BO_ 361 1;
BA_ "GenMsgCycleTime" BO_ 361 10;
BA_ "GenMsgCycleTimeFast" BO_ 361 0;
BA_ "GenMsgSendType" BO_ 361 0;
BA_ "VFrameFormat" BO_ 361 14;
BA_ "CANFD_BRS" BO_ 361 1;
BA_ "GenMsgCycleTime" BO_ 361 10;
BA_ "GenMsgCycleTimeFast" BO_ 361 0;
BA_ "GenMsgSendType" BO_ 361 0;
BA_ "VFrameFormat" BO_ 361 14;
BA_ "CANFD_BRS" BO_ 361 1;
BA_ "GenMsgCycleTime" BO_ 361 10;
BA_ "GenMsgCycleTimeFast" BO_ 361 0;
BA_ "GenMsgSendType" BO_ 361 0;
BA_ "VFrameFormat" BO_ 361 14;
BA_ "CANFD_BRS" BO_ 361 1;
BA_ "GenMsgCycleTime" BO_ 361 10;
BA_ "GenMsgCycleTimeFast" BO_ 361 0;
BA_ "GenMsgSendType" BO_ 361 0;
BA_ "VFrameFormat" BO_ 361 14;
BA_ "CANFD_BRS" BO_ 361 1;
BA_ "GenMsgCycleTime" BO_ 361 10;
BA_ "GenMsgCycleTimeFast" BO_ 361 0;
BA_ "GenMsgSendType" BO_ 361 0;
BA_ "VFrameFormat" BO_ 361 14;
BA_ "CANFD_BRS" BO_ 361 1;
BA_ "GenMsgCycleTime" BO_ 361 10;
BA_ "GenMsgCycleTimeFast" BO_ 361 0;
BA_ "GenMsgSendType" BO_ 361 0;
BA_ "VFrameFormat" BO_ 361 14;
BA_ "CANFD_BRS" BO_ 361 1;
BA_ "GenMsgCycleTime" BO_ 361 10;
BA_ "GenMsgCycleTimeFast" BO_ 361 0;
BA_ "GenMsgSendType" BO_ 361 0;
BA_ "VFrameFormat" BO_ 361 14;
BA_ "CANFD_BRS" BO_ 361 1;
BA_ "GenMsgCycleTime" BO_ 361 10;
BA_ "GenMsgCycleTimeFast" BO_ 361 0;
BA_ "GenMsgSendType" BO_ 361 0;
BA_ "VFrameFormat" BO_ 361 14;
BA_ "CANFD_BRS" BO_ 361 1;
BA_ "GenMsgCycleTime" BO_ 361 10;
BA_ "GenMsgCycleTimeFast" BO_ 361 0;
BA_ "GenMsgSendType" BO_ 361 0;
BA_ "VFrameFormat" BO_ 361 14;
BA_ "CANFD_BRS" BO_ 361 1;
BA_ "GenMsgCycleTime" BO_ 361 10;
BA_ "GenMsgCycleTimeFast" BO_ 361 0;
BA_ "GenMsgSendType" BO_ 361 0;
BA_ "VFrameFormat" BO_ 361 14;
BA_ "CANFD_BRS" BO_ 361 1;
BA_ "GenMsgCycleTime" BO_ 361 10;
BA_ "GenMsgCycleTimeFast" BO_ 361 0;
BA_ "GenMsgSendType" BO_ 361 0;
BA_ "VFrameFormat" BO_ 361 14;
BA_ "CANFD_BRS" BO_ 361 1;
BA_ "GenMsgCycleTime" BO_ 361 10;
BA_ "GenMsgCycleTimeFast" BO_ 361 0;
BA_ "GenMsgSendType" BO_ 361 0;
BA_ "VFrameFormat" BO_ 361 14;
BA_ "CANFD_BRS" BO_ 361 1;
BA_ "GenMsgCycleTime" BO_ 361 10;
BA_ "GenMsgCycleTimeFast" BO_ 361 0;
BA_ "GenMsgSendType" BO_ 361 0;
BA_ "VFrameFormat" BO_ 361 14;
BA_ "CANFD_BRS" BO_ 361 1;
BA_ "GenMsgCycleTime" BO_ 361 10;
BA_ "GenMsgCycleTimeFast" BO_ 361 0;
BA_ "GenMsgSendType" BO_ 361 0;
BA_ "VFrameFormat" BO_ 361 14;
BA_ "CANFD_BRS" BO_ 361 1;
BA_ "GenMsgCycleTime" BO_ 361 10;
BA_ "GenMsgCycleTimeFast" BO_ 361 0;
BA_ "GenMsgSendType" BO_ 361 0;
BA_ "VFrameFormat" BO_ 361 14;
BA_ "CANFD_BRS" BO_ 361 1;
BA_ "GenMsgCycleTime" BO_ 361 10;
BA_ "GenMsgCycleTimeFast" BO_ 361 0;
BA_ "GenMsgSendType" BO_ 361 0;
BA_ "VFrameFormat" BO_ 361 14;
BA_ "CANFD_BRS" BO_ 361 1;
BA_ "GenMsgCycleTime" BO_ 361 10;
BA_ "GenMsgCycleTimeFast" BO_ 361 0;
BA_ "GenMsgSendType" BO_ 361 0;
BA_ "VFrameFormat" BO_ 361 14;
BA_ "CANFD_BRS" BO_ 361 1;
BA_ "GenMsgCycleTime" BO_ 361 10;
BA_ "GenMsgCycleTimeFast" BO_ 361 0;
BA_ "GenMsgSendType" BO_ 361 0;
BA_ "VFrameFormat" BO_ 361 14;
BA_ "CANFD_BRS" BO_ 361 1;
BA_ "GenMsgCycleTime" BO_ 361 10;
BA_ "GenMsgCycleTimeFast" BO_ 361 0;
BA_ "GenMsgSendType" BO_ 361 0;
BA_ "VFrameFormat" BO_ 361 14;
BA_ "CANFD_BRS" BO_ 361 1;
BA_ "GenMsgCycleTime" BO_ 371 10;
BA_ "GenMsgCycleTimeFast" BO_ 371 0;
BA_ "GenMsgSendType" BO_ 371 0;
BA_ "VFrameFormat" BO_ 371 14;
BA_ "CANFD_BRS" BO_ 371 1;
BA_ "GenMsgCycleTime" BO_ 371 10;
BA_ "GenMsgCycleTimeFast" BO_ 371 0;
BA_ "GenMsgSendType" BO_ 371 0;
BA_ "VFrameFormat" BO_ 371 14;
BA_ "CANFD_BRS" BO_ 371 1;
BA_ "GenMsgCycleTime" BO_ 371 10;
BA_ "GenMsgCycleTimeFast" BO_ 371 0;
BA_ "GenMsgSendType" BO_ 371 0;
BA_ "VFrameFormat" BO_ 371 14;
BA_ "CANFD_BRS" BO_ 371 1;
BA_ "GenMsgCycleTime" BO_ 371 10;
BA_ "GenMsgCycleTimeFast" BO_ 371 0;
BA_ "GenMsgSendType" BO_ 371 0;
BA_ "VFrameFormat" BO_ 371 14;
BA_ "CANFD_BRS" BO_ 371 1;
BA_ "GenMsgCycleTime" BO_ 371 10;
BA_ "GenMsgCycleTimeFast" BO_ 371 0;
BA_ "GenMsgSendType" BO_ 371 0;
BA_ "VFrameFormat" BO_ 371 14;
BA_ "CANFD_BRS" BO_ 371 1;
BA_ "GenMsgCycleTime" BO_ 371 10;
BA_ "GenMsgCycleTimeFast" BO_ 371 0;
BA_ "GenMsgSendType" BO_ 371 0;
BA_ "VFrameFormat" BO_ 371 14;
BA_ "CANFD_BRS" BO_ 371 1;
BA_ "GenMsgCycleTime" BO_ 371 10;
BA_ "GenMsgCycleTimeFast" BO_ 371 0;
BA_ "GenMsgSendType" BO_ 371 0;
BA_ "VFrameFormat" BO_ 371 14;
BA_ "CANFD_BRS" BO_ 371 1;
BA_ "GenMsgCycleTime" BO_ 371 10;
BA_ "GenMsgCycleTimeFast" BO_ 371 0;
BA_ "GenMsgSendType" BO_ 371 0;
BA_ "VFrameFormat" BO_ 371 14;
BA_ "CANFD_BRS" BO_ 371 1;
BA_ "GenMsgCycleTime" BO_ 371 10;
BA_ "GenMsgCycleTimeFast" BO_ 371 0;
BA_ "GenMsgSendType" BO_ 371 0;
BA_ "VFrameFormat" BO_ 371 14;
BA_ "CANFD_BRS" BO_ 371 1;
BA_ "GenMsgCycleTime" BO_ 371 10;
BA_ "GenMsgCycleTimeFast" BO_ 371 0;
BA_ "GenMsgSendType" BO_ 371 0;
BA_ "VFrameFormat" BO_ 371 14;
BA_ "CANFD_BRS" BO_ 371 1;
BA_ "GenMsgCycleTime" BO_ 371 10;
BA_ "GenMsgCycleTimeFast" BO_ 371 0;
BA_ "GenMsgSendType" BO_ 371 0;
BA_ "VFrameFormat" BO_ 371 14;
BA_ "CANFD_BRS" BO_ 371 1;
BA_ "GenMsgCycleTime" BO_ 371 10;
BA_ "GenMsgCycleTimeFast" BO_ 371 0;
BA_ "GenMsgSendType" BO_ 371 0;
BA_ "VFrameFormat" BO_ 371 14;
BA_ "CANFD_BRS" BO_ 371 1;
BA_ "GenMsgCycleTime" BO_ 371 10;
BA_ "GenMsgCycleTimeFast" BO_ 371 0;
BA_ "GenMsgSendType" BO_ 371 0;
BA_ "VFrameFormat" BO_ 371 14;
BA_ "CANFD_BRS" BO_ 371 1;
BA_ "GenMsgCycleTime" BO_ 371 10;
BA_ "GenMsgCycleTimeFast" BO_ 371 0;
BA_ "GenMsgSendType" BO_ 371 0;
BA_ "VFrameFormat" BO_ 371 14;
BA_ "CANFD_BRS" BO_ 371 1;
BA_ "GenMsgCycleTime" BO_ 371 10;
BA_ "GenMsgCycleTimeFast" BO_ 371 0;
BA_ "GenMsgSendType" BO_ 371 0;
BA_ "VFrameFormat" BO_ 371 14;
BA_ "CANFD_BRS" BO_ 371 1;
BA_ "GenMsgCycleTime" BO_ 371 10;
BA_ "GenMsgCycleTimeFast" BO_ 371 0;
BA_ "GenMsgSendType" BO_ 371 0;
BA_ "VFrameFormat" BO_ 371 14;
BA_ "CANFD_BRS" BO_ 371 1;
BA_ "GenMsgCycleTime" BO_ 371 10;
BA_ "GenMsgCycleTimeFast" BO_ 371 0;
BA_ "GenMsgSendType" BO_ 371 0;
BA_ "VFrameFormat" BO_ 371 14;
BA_ "CANFD_BRS" BO_ 371 1;
BA_ "GenMsgCycleTime" BO_ 371 10;
BA_ "GenMsgCycleTimeFast" BO_ 371 0;
BA_ "GenMsgSendType" BO_ 371 0;
BA_ "VFrameFormat" BO_ 371 14;
BA_ "CANFD_BRS" BO_ 371 1;
BA_ "GenMsgCycleTime" BO_ 371 10;
BA_ "GenMsgCycleTimeFast" BO_ 371 0;
BA_ "GenMsgSendType" BO_ 371 0;
BA_ "VFrameFormat" BO_ 371 14;
BA_ "CANFD_BRS" BO_ 371 1;
BA_ "GenMsgCycleTime" BO_ 371 10;
BA_ "GenMsgCycleTimeFast" BO_ 371 0;
BA_ "GenMsgSendType" BO_ 371 0;
BA_ "VFrameFormat" BO_ 371 14;
BA_ "CANFD_BRS" BO_ 371 1;
BA_ "GenMsgCycleTime" BO_ 371 10;
BA_ "GenMsgCycleTimeFast" BO_ 371 0;
BA_ "GenMsgSendType" BO_ 371 0;
BA_ "VFrameFormat" BO_ 371 14;
BA_ "CANFD_BRS" BO_ 371 1;
BA_ "GenMsgCycleTime" BO_ 371 10;
BA_ "GenMsgCycleTimeFast" BO_ 371 0;
BA_ "GenMsgSendType" BO_ 371 0;
BA_ "VFrameFormat" BO_ 371 14;
BA_ "CANFD_BRS" BO_ 371 1;
BA_ "GenMsgCycleTime" BO_ 371 10;
BA_ "GenMsgCycleTimeFast" BO_ 371 0;
BA_ "GenMsgSendType" BO_ 371 0;
BA_ "VFrameFormat" BO_ 371 14;
BA_ "CANFD_BRS" BO_ 371 1;
BA_ "GenMsgCycleTime" BO_ 371 10;
BA_ "GenMsgCycleTimeFast" BO_ 371 0;
BA_ "GenMsgSendType" BO_ 371 0;
BA_ "VFrameFormat" BO_ 371 14;
BA_ "CANFD_BRS" BO_ 371 1;
BA_ "GenMsgCycleTime" BO_ 371 10;
BA_ "GenMsgCycleTimeFast" BO_ 371 0;
BA_ "GenMsgSendType" BO_ 371 0;
BA_ "VFrameFormat" BO_ 371 14;
BA_ "CANFD_BRS" BO_ 371 1;
BA_ "GenMsgCycleTime" BO_ 371 10;
BA_ "GenMsgCycleTimeFast" BO_ 371 0;
BA_ "GenMsgSendType" BO_ 371 0;
BA_ "VFrameFormat" BO_ 371 14;
BA_ "CANFD_BRS" BO_ 371 1;
BA_ "GenMsgCycleTime" BO_ 371 10;
BA_ "GenMsgCycleTimeFast" BO_ 371 0;
BA_ "GenMsgSendType" BO_ 371 0;
BA_ "VFrameFormat" BO_ 371 14;
BA_ "CANFD_BRS" BO_ 371 1;
BA_ "GenMsgCycleTime" BO_ 371 10;
BA_ "GenMsgCycleTimeFast" BO_ 371 0;
BA_ "GenMsgSendType" BO_ 371 0;
BA_ "VFrameFormat" BO_ 371 14;
BA_ "CANFD_BRS" BO_ 371 1;
BA_ "GenMsgCycleTime" BO_ 371 10;
BA_ "GenMsgCycleTimeFast" BO_ 371 0;
BA_ "GenMsgSendType" BO_ 371 0;
BA_ "VFrameFormat" BO_ 371 14;
BA_ "CANFD_BRS" BO_ 371 1;
BA_ "GenMsgCycleTime" BO_ 371 10;
BA_ "GenMsgCycleTimeFast" BO_ 371 0;
BA_ "GenMsgSendType" BO_ 371 0;
BA_ "VFrameFormat" BO_ 371 14;
BA_ "CANFD_BRS" BO_ 371 1;
BA_ "GenMsgCycleTime" BO_ 371 10;
BA_ "GenMsgCycleTimeFast" BO_ 371 0;
BA_ "GenMsgSendType" BO_ 371 0;
BA_ "VFrameFormat" BO_ 371 14;
BA_ "CANFD_BRS" BO_ 371 1;
BA_ "GenMsgCycleTime" BO_ 371 10;
BA_ "GenMsgCycleTimeFast" BO_ 371 0;
BA_ "GenMsgSendType" BO_ 371 0;
BA_ "VFrameFormat" BO_ 371 14;
BA_ "CANFD_BRS" BO_ 371 1;
BA_ "GenMsgCycleTime" BO_ 371 10;
BA_ "GenMsgCycleTimeFast" BO_ 371 0;
BA_ "GenMsgSendType" BO_ 371 0;
BA_ "VFrameFormat" BO_ 371 14;
BA_ "CANFD_BRS" BO_ 371 1;
BA_ "GenMsgCycleTime" BO_ 371 10;
BA_ "GenMsgCycleTimeFast" BO_ 371 0;
BA_ "GenMsgSendType" BO_ 371 0;
BA_ "VFrameFormat" BO_ 371 14;
BA_ "CANFD_BRS" BO_ 371 1;
BA_ "GenMsgCycleTime" BO_ 371 10;
BA_ "GenMsgCycleTimeFast" BO_ 371 0;
BA_ "GenMsgSendType" BO_ 371 0;
BA_ "VFrameFormat" BO_ 371 14;
BA_ "CANFD_BRS" BO_ 371 1;
BA_ "GenMsgCycleTime" BO_ 371 10;
BA_ "GenMsgCycleTimeFast" BO_ 371 0;
BA_ "GenMsgSendType" BO_ 371 0;
BA_ "VFrameFormat" BO_ 371 14;
BA_ "CANFD_BRS" BO_ 371 1;
BA_ "GenMsgCycleTime" BO_ 371 10;
BA_ "GenMsgCycleTimeFast" BO_ 371 0;
BA_ "GenMsgSendType" BO_ 371 0;
BA_ "VFrameFormat" BO_ 371 14;
BA_ "CANFD_BRS" BO_ 371 1;
BA_ "GenMsgCycleTime" BO_ 371 10;
BA_ "GenMsgCycleTimeFast" BO_ 371 0;
BA_ "GenMsgSendType" BO_ 371 0;
BA_ "VFrameFormat" BO_ 371 14;
BA_ "CANFD_BRS" BO_ 371 1;
BA_ "GenMsgCycleTime" BO_ 371 10;
BA_ "GenMsgCycleTimeFast" BO_ 371 0;
BA_ "GenMsgSendType" BO_ 371 0;
BA_ "VFrameFormat" BO_ 371 14;
BA_ "CANFD_BRS" BO_ 371 1;
BA_ "GenMsgCycleTime" BO_ 371 10;
BA_ "GenMsgCycleTimeFast" BO_ 371 0;
BA_ "GenMsgSendType" BO_ 371 0;
BA_ "VFrameFormat" BO_ 371 14;
BA_ "CANFD_BRS" BO_ 371 1;
BA_ "GenMsgCycleTime" BO_ 371 10;
BA_ "GenMsgCycleTimeFast" BO_ 371 0;
BA_ "GenMsgSendType" BO_ 371 0;
BA_ "VFrameFormat" BO_ 371 14;
BA_ "CANFD_BRS" BO_ 371 1;
BA_ "GenMsgCycleTime" BO_ 371 10;
BA_ "GenMsgCycleTimeFast" BO_ 371 0;
BA_ "GenMsgSendType" BO_ 371 0;
BA_ "VFrameFormat" BO_ 371 14;
BA_ "CANFD_BRS" BO_ 371 1;
BA_ "GenMsgCycleTime" BO_ 371 10;
BA_ "GenMsgCycleTimeFast" BO_ 371 0;
BA_ "GenMsgSendType" BO_ 371 0;
BA_ "VFrameFormat" BO_ 371 14;
BA_ "CANFD_BRS" BO_ 371 1;
BA_ "GenMsgCycleTime" BO_ 371 10;
BA_ "GenMsgCycleTimeFast" BO_ 371 0;
BA_ "GenMsgSendType" BO_ 371 0;
BA_ "VFrameFormat" BO_ 371 14;
BA_ "CANFD_BRS" BO_ 371 1;
BA_ "GenMsgCycleTime" BO_ 371 10;
BA_ "GenMsgCycleTimeFast" BO_ 371 0;
BA_ "GenMsgSendType" BO_ 371 0;
BA_ "VFrameFormat" BO_ 371 14;
BA_ "CANFD_BRS" BO_ 371 1;
BA_ "GenMsgCycleTime" BO_ 371 10;
BA_ "GenMsgCycleTimeFast" BO_ 371 0;
BA_ "GenMsgSendType" BO_ 371 0;
BA_ "VFrameFormat" BO_ 371 14;
BA_ "CANFD_BRS" BO_ 371 1;
BA_ "GenMsgCycleTime" BO_ 371 10;
BA_ "GenMsgCycleTimeFast" BO_ 371 0;
BA_ "GenMsgSendType" BO_ 371 0;
BA_ "VFrameFormat" BO_ 371 14;
BA_ "CANFD_BRS" BO_ 371 1;
BA_ "GenMsgCycleTime" BO_ 371 10;
BA_ "GenMsgCycleTimeFast" BO_ 371 0;
BA_ "GenMsgSendType" BO_ 371 0;
BA_ "VFrameFormat" BO_ 371 14;
BA_ "CANFD_BRS" BO_ 371 1;
BA_ "GenMsgCycleTime" BO_ 371 10;
BA_ "GenMsgCycleTimeFast" BO_ 371 0;
BA_ "GenMsgSendType" BO_ 371 0;
BA_ "VFrameFormat" BO_ 371 14;
BA_ "CANFD_BRS" BO_ 371 1;
BA_ "GenMsgCycleTime" BO_ 371 10;
BA_ "GenMsgCycleTimeFast" BO_ 371 0;
BA_ "GenMsgSendType" BO_ 371 0;
BA_ "VFrameFormat" BO_ 371 14;
BA_ "CANFD_BRS" BO_ 371 1;
BA_ "GenMsgCycleTime" BO_ 371 10;
BA_ "GenMsgCycleTimeFast" BO_ 371 0;
BA_ "GenMsgSendType" BO_ 371 0;
BA_ "VFrameFormat" BO_ 371 14;
BA_ "CANFD_BRS" BO_ 371 1;
BA_ "GenMsgCycleTime" BO_ 371 10;
BA_ "GenMsgCycleTimeFast" BO_ 371 0;
BA_ "GenMsgSendType" BO_ 371 0;
BA_ "VFrameFormat" BO_ 371 14;
BA_ "CANFD_BRS" BO_ 371 1;
BA_ "GenMsgCycleTime" BO_ 371 10;
BA_ "GenMsgCycleTimeFast" BO_ 371 0;
BA_ "GenMsgSendType" BO_ 371 0;
BA_ "VFrameFormat" BO_ 371 14;
BA_ "CANFD_BRS" BO_ 371 1;
BA_ "GenMsgCycleTime" BO_ 371 10;
BA_ "GenMsgCycleTimeFast" BO_ 371 0;
BA_ "GenMsgSendType" BO_ 371 0;
BA_ "VFrameFormat" BO_ 371 14;
BA_ "CANFD_BRS" BO_ 371 1;
BA_ "GenMsgCycleTime" BO_ 371 10;
BA_ "GenMsgCycleTimeFast" BO_ 371 0;
BA_ "GenMsgSendType" BO_ 371 0;
BA_ "VFrameFormat" BO_ 371 14;
BA_ "CANFD_BRS" BO_ 371 1;
BA_ "GenMsgCycleTime" BO_ 371 10;
BA_ "GenMsgCycleTimeFast" BO_ 371 0;
BA_ "GenMsgSendType" BO_ 371 0;
BA_ "VFrameFormat" BO_ 371 14;
BA_ "CANFD_BRS" BO_ 371 1;
BA_ "GenMsgCycleTime" BO_ 371 10;
BA_ "GenMsgCycleTimeFast" BO_ 371 0;
BA_ "GenMsgSendType" BO_ 371 0;
BA_ "VFrameFormat" BO_ 371 14;
BA_ "CANFD_BRS" BO_ 371 1;
BA_ "GenMsgCycleTime" BO_ 371 10;
BA_ "GenMsgCycleTimeFast" BO_ 371 0;
BA_ "GenMsgSendType" BO_ 371 0;
BA_ "VFrameFormat" BO_ 371 14;
BA_ "CANFD_BRS" BO_ 371 1;
BA_ "GenMsgCycleTime" BO_ 371 10;
BA_ "GenMsgCycleTimeFast" BO_ 371 0;
BA_ "GenMsgSendType" BO_ 371 0;
BA_ "VFrameFormat" BO_ 371 14;
BA_ "CANFD_BRS" BO_ 371 1;
BA_ "GenMsgCycleTime" BO_ 371 10;
BA_ "GenMsgCycleTimeFast" BO_ 371 0;
BA_ "GenMsgSendType" BO_ 371 0;
BA_ "VFrameFormat" BO_ 371 14;
BA_ "CANFD_BRS" BO_ 371 1;
BA_ "GenMsgCycleTime" BO_ 371 10;
BA_ "GenMsgCycleTimeFast" BO_ 371 0;
BA_ "GenMsgSendType" BO_ 371 0;
BA_ "VFrameFormat" BO_ 371 14;
BA_ "CANFD_BRS" BO_ 371 1;
BA_ "GenMsgCycleTime" BO_ 371 10;
BA_ "GenMsgCycleTimeFast" BO_ 371 0;
BA_ "GenMsgSendType" BO_ 371 0;
BA_ "VFrameFormat" BO_ 371 14;
BA_ "CANFD_BRS" BO_ 371 1;
BA_ "GenMsgCycleTime" BO_ 371 10;
BA_ "GenMsgCycleTimeFast" BO_ 371 0;
BA_ "GenMsgSendType" BO_ 371 0;
BA_ "VFrameFormat" BO_ 371 14;
BA_ "CANFD_BRS" BO_ 371 1;
BA_ "GenMsgCycleTime" BO_ 371 10;
BA_ "GenMsgCycleTimeFast" BO_ 371 0;
BA_ "GenMsgSendType" BO_ 371 0;
BA_ "VFrameFormat" BO_ 371 14;
BA_ "CANFD_BRS" BO_ 371 1;
BA_ "GenMsgCycleTime" BO_ 371 10;
BA_ "GenMsgCycleTimeFast" BO_ 371 0;
BA_ "GenMsgSendType" BO_ 371 0;
BA_ "VFrameFormat" BO_ 371 14;
BA_ "CANFD_BRS" BO_ 371 1;
BA_ "GenMsgCycleTime" BO_ 371 10;
BA_ "GenMsgCycleTimeFast" BO_ 371 0;
BA_ "GenMsgSendType" BO_ 371 0;
BA_ "VFrameFormat" BO_ 371 14;
BA_ "CANFD_BRS" BO_ 371 1;
BA_ "EventCommandSignal" SG_ 389 ADC_4_B_New_CRC 0;
BA_ "GatewayedSignals" SG_ 389 ADC_4_B_New_CRC 0;
BA_ "GenSigInactiveValue" SG_ 389 ADC_4_B_New_CRC 0;
BA_ "GenSigInvalidValue" SG_ 389 ADC_4_B_New_CRC 0;
BA_ "GenSigSendType" SG_ 389 ADC_4_B_New_CRC 1;
BA_ "GenSigStartValue" SG_ 389 ADC_4_B_New_CRC 0;
BA_ "GenSigTimeoutValue" SG_ 389 ADC_4_B_New_CRC 0;
BA_ "Remark" SG_ 389 ADC_4_B_New_CRC "";
BA_ "EventCommandSignal" SG_ 389 ADC_4_B_New_Counter 0;
BA_ "GatewayedSignals" SG_ 389 ADC_4_B_New_Counter 0;
BA_ "GenSigInactiveValue" SG_ 389 ADC_4_B_New_Counter 0;
BA_ "GenSigInvalidValue" SG_ 389 ADC_4_B_New_Counter 0;
BA_ "GenSigSendType" SG_ 389 ADC_4_B_New_Counter 1;
BA_ "GenSigStartValue" SG_ 389 ADC_4_B_New_Counter 0;
BA_ "GenSigTimeoutValue" SG_ 389 ADC_4_B_New_Counter 0;
BA_ "Remark" SG_ 389 ADC_4_B_New_Counter "";
BA_ "EventCommandSignal" SG_ 389 ADC_AngReqSt_A_B1 0;
BA_ "GatewayedSignals" SG_ 389 ADC_AngReqSt_A_B1 0;
BA_ "GenSigInactiveValue" SG_ 389 ADC_AngReqSt_A_B1 0;
BA_ "GenSigInvalidValue" SG_ 389 ADC_AngReqSt_A_B1 0;
BA_ "GenSigSendType" SG_ 389 ADC_AngReqSt_A_B1 1;
BA_ "GenSigStartValue" SG_ 389 ADC_AngReqSt_A_B1 0;
BA_ "GenSigTimeoutValue" SG_ 389 ADC_AngReqSt_A_B1 0;
BA_ "Remark" SG_ 389 ADC_AngReqSt_A_B1 "";
BA_ "EventCommandSignal" SG_ 389 ADC_AngReqFunction_B1 0;
BA_ "GatewayedSignals" SG_ 389 ADC_AngReqFunction_B1 0;
BA_ "GenSigInactiveValue" SG_ 389 ADC_AngReqFunction_B1 0;
BA_ "GenSigInvalidValue" SG_ 389 ADC_AngReqFunction_B1 0;
BA_ "GenSigSendType" SG_ 389 ADC_AngReqFunction_B1 1;
BA_ "GenSigStartValue" SG_ 389 ADC_AngReqFunction_B1 0;
BA_ "GenSigTimeoutValue" SG_ 389 ADC_AngReqFunction_B1 0;
BA_ "Remark" SG_ 389 ADC_AngReqFunction_B1 "";
BA_ "EventCommandSignal" SG_ 389 ADC_BrakeLightReq_B1 0;
BA_ "GatewayedSignals" SG_ 389 ADC_BrakeLightReq_B1 0;
BA_ "GenSigInactiveValue" SG_ 389 ADC_BrakeLightReq_B1 0;
BA_ "GenSigInvalidValue" SG_ 389 ADC_BrakeLightReq_B1 0;
BA_ "GenSigSendType" SG_ 389 ADC_BrakeLightReq_B1 1;
BA_ "GenSigStartValue" SG_ 389 ADC_BrakeLightReq_B1 0;
BA_ "GenSigTimeoutValue" SG_ 389 ADC_BrakeLightReq_B1 0;
BA_ "Remark" SG_ 389 ADC_BrakeLightReq_B1 "";
BA_ "EventCommandSignal" SG_ 389 ADC_StrAngleReq_A_B1 0;
BA_ "GatewayedSignals" SG_ 389 ADC_StrAngleReq_A_B1 0;
BA_ "GenSigInactiveValue" SG_ 389 ADC_StrAngleReq_A_B1 0;
BA_ "GenSigInvalidValue" SG_ 389 ADC_StrAngleReq_A_B1 65535;
BA_ "GenSigSendType" SG_ 389 ADC_StrAngleReq_A_B1 1;
BA_ "GenSigStartValue" SG_ 389 ADC_StrAngleReq_A_B1 7800;
BA_ "GenSigTimeoutValue" SG_ 389 ADC_StrAngleReq_A_B1 65535;
BA_ "Remark" SG_ 389 ADC_StrAngleReq_A_B1 "";
BA_ "EventCommandSignal" SG_ 389 ADC_SACMotorTorLimExtMax_A_B1 0;
BA_ "GatewayedSignals" SG_ 389 ADC_SACMotorTorLimExtMax_A_B1 0;
BA_ "GenSigInactiveValue" SG_ 389 ADC_SACMotorTorLimExtMax_A_B1 0;
BA_ "GenSigInvalidValue" SG_ 389 ADC_SACMotorTorLimExtMax_A_B1 255;
BA_ "GenSigSendType" SG_ 389 ADC_SACMotorTorLimExtMax_A_B1 1;
BA_ "GenSigStartValue" SG_ 389 ADC_SACMotorTorLimExtMax_A_B1 254;
BA_ "GenSigTimeoutValue" SG_ 389 ADC_SACMotorTorLimExtMax_A_B1 255;
BA_ "Remark" SG_ 389 ADC_SACMotorTorLimExtMax_A_B1 "";
BA_ "EventCommandSignal" SG_ 389 ADC_SACMotorTorLimExtMin_A_B1 0;
BA_ "GatewayedSignals" SG_ 389 ADC_SACMotorTorLimExtMin_A_B1 0;
BA_ "GenSigInactiveValue" SG_ 389 ADC_SACMotorTorLimExtMin_A_B1 0;
BA_ "GenSigInvalidValue" SG_ 389 ADC_SACMotorTorLimExtMin_A_B1 0;
BA_ "GenSigSendType" SG_ 389 ADC_SACMotorTorLimExtMin_A_B1 1;
BA_ "GenSigStartValue" SG_ 389 ADC_SACMotorTorLimExtMin_A_B1 0;
BA_ "GenSigTimeoutValue" SG_ 389 ADC_SACMotorTorLimExtMin_A_B1 255;
BA_ "Remark" SG_ 389 ADC_SACMotorTorLimExtMin_A_B1 "";
BA_ "EventCommandSignal" SG_ 389 ADC_AssistParaSwitchReq_B1 0;
BA_ "GatewayedSignals" SG_ 389 ADC_AssistParaSwitchReq_B1 0;
BA_ "GenSigInactiveValue" SG_ 389 ADC_AssistParaSwitchReq_B1 0;
BA_ "GenSigInvalidValue" SG_ 389 ADC_AssistParaSwitchReq_B1 0;
BA_ "GenSigSendType" SG_ 389 ADC_AssistParaSwitchReq_B1 1;
BA_ "GenSigStartValue" SG_ 389 ADC_AssistParaSwitchReq_B1 0;
BA_ "GenSigTimeoutValue" SG_ 389 ADC_AssistParaSwitchReq_B1 0;
BA_ "Remark" SG_ 389 ADC_AssistParaSwitchReq_B1 "";
BA_ "EventCommandSignal" SG_ 389 ADC_SteerGainReq_B1 0;
BA_ "GatewayedSignals" SG_ 389 ADC_SteerGainReq_B1 0;
BA_ "GenSigInactiveValue" SG_ 389 ADC_SteerGainReq_B1 0;
BA_ "GenSigInvalidValue" SG_ 389 ADC_SteerGainReq_B1 0;
BA_ "GenSigSendType" SG_ 389 ADC_SteerGainReq_B1 1;
BA_ "GenSigStartValue" SG_ 389 ADC_SteerGainReq_B1 0;
BA_ "GenSigTimeoutValue" SG_ 389 ADC_SteerGainReq_B1 0;
BA_ "Remark" SG_ 389 ADC_SteerGainReq_B1 "";
BA_ "EventCommandSignal" SG_ 389 ADC_StrgWhlVibrWarnLevel_B1 0;
BA_ "GatewayedSignals" SG_ 389 ADC_StrgWhlVibrWarnLevel_B1 0;
BA_ "GenSigInactiveValue" SG_ 389 ADC_StrgWhlVibrWarnLevel_B1 0;
BA_ "GenSigInvalidValue" SG_ 389 ADC_StrgWhlVibrWarnLevel_B1 0;
BA_ "GenSigSendType" SG_ 389 ADC_StrgWhlVibrWarnLevel_B1 1;
BA_ "GenSigStartValue" SG_ 389 ADC_StrgWhlVibrWarnLevel_B1 0;
BA_ "GenSigTimeoutValue" SG_ 389 ADC_StrgWhlVibrWarnLevel_B1 0;
BA_ "Remark" SG_ 389 ADC_StrgWhlVibrWarnLevel_B1 "";
BA_ "EventCommandSignal" SG_ 389 ADC_ActTrqReqEnable_B1 0;
BA_ "GatewayedSignals" SG_ 389 ADC_ActTrqReqEnable_B1 0;
BA_ "GenSigInactiveValue" SG_ 389 ADC_ActTrqReqEnable_B1 0;
BA_ "GenSigInvalidValue" SG_ 389 ADC_ActTrqReqEnable_B1 0;
BA_ "GenSigSendType" SG_ 389 ADC_ActTrqReqEnable_B1 1;
BA_ "GenSigStartValue" SG_ 389 ADC_ActTrqReqEnable_B1 0;
BA_ "GenSigTimeoutValue" SG_ 389 ADC_ActTrqReqEnable_B1 0;
BA_ "Remark" SG_ 389 ADC_ActTrqReqEnable_B1 "";
BA_ "EventCommandSignal" SG_ 389 ADC_SteerGainLevel_B1 0;
BA_ "GatewayedSignals" SG_ 389 ADC_SteerGainLevel_B1 0;
BA_ "GenSigInactiveValue" SG_ 389 ADC_SteerGainLevel_B1 0;
BA_ "GenSigInvalidValue" SG_ 389 ADC_SteerGainLevel_B1 0;
BA_ "GenSigSendType" SG_ 389 ADC_SteerGainLevel_B1 1;
BA_ "GenSigStartValue" SG_ 389 ADC_SteerGainLevel_B1 0;
BA_ "GenSigTimeoutValue" SG_ 389 ADC_SteerGainLevel_B1 100;
BA_ "Remark" SG_ 389 ADC_SteerGainLevel_B1 "";
BA_ "EventCommandSignal" SG_ 389 ADC_EvsSteerReq_B1 0;
BA_ "GatewayedSignals" SG_ 389 ADC_EvsSteerReq_B1 0;
BA_ "GenSigInactiveValue" SG_ 389 ADC_EvsSteerReq_B1 0;
BA_ "GenSigInvalidValue" SG_ 389 ADC_EvsSteerReq_B1 0;
BA_ "GenSigSendType" SG_ 389 ADC_EvsSteerReq_B1 1;
BA_ "GenSigStartValue" SG_ 389 ADC_EvsSteerReq_B1 0;
BA_ "GenSigTimeoutValue" SG_ 389 ADC_EvsSteerReq_B1 0;
BA_ "Remark" SG_ 389 ADC_EvsSteerReq_B1 "";
BA_ "EventCommandSignal" SG_ 389 ADC_StrgWhlVibrWarnReq_B1 0;
BA_ "GatewayedSignals" SG_ 389 ADC_StrgWhlVibrWarnReq_B1 0;
BA_ "GenSigInactiveValue" SG_ 389 ADC_StrgWhlVibrWarnReq_B1 0;
BA_ "GenSigInvalidValue" SG_ 389 ADC_StrgWhlVibrWarnReq_B1 0;
BA_ "GenSigSendType" SG_ 389 ADC_StrgWhlVibrWarnReq_B1 1;
BA_ "GenSigStartValue" SG_ 389 ADC_StrgWhlVibrWarnReq_B1 0;
BA_ "GenSigTimeoutValue" SG_ 389 ADC_StrgWhlVibrWarnReq_B1 0;
BA_ "Remark" SG_ 389 ADC_StrgWhlVibrWarnReq_B1 "";
BA_ "EventCommandSignal" SG_ 389 ADC_ActTrqReq_B1 0;
BA_ "GatewayedSignals" SG_ 389 ADC_ActTrqReq_B1 0;
BA_ "GenSigInactiveValue" SG_ 389 ADC_ActTrqReq_B1 0;
BA_ "GenSigInvalidValue" SG_ 389 ADC_ActTrqReq_B1 0;
BA_ "GenSigSendType" SG_ 389 ADC_ActTrqReq_B1 1;
BA_ "GenSigStartValue" SG_ 389 ADC_ActTrqReq_B1 0;
BA_ "GenSigTimeoutValue" SG_ 389 ADC_ActTrqReq_B1 0;
BA_ "Remark" SG_ 389 ADC_ActTrqReq_B1 "";
BA_ "EventCommandSignal" SG_ 389 ADC_DrvTarTqMod2EPB_B 0;
BA_ "GatewayedSignals" SG_ 389 ADC_DrvTarTqMod2EPB_B 0;
BA_ "GenSigInactiveValue" SG_ 389 ADC_DrvTarTqMod2EPB_B 0;
BA_ "GenSigInvalidValue" SG_ 389 ADC_DrvTarTqMod2EPB_B 0;
BA_ "GenSigSendType" SG_ 389 ADC_DrvTarTqMod2EPB_B 1;
BA_ "GenSigStartValue" SG_ 389 ADC_DrvTarTqMod2EPB_B 0;
BA_ "GenSigTimeoutValue" SG_ 389 ADC_DrvTarTqMod2EPB_B 0;
BA_ "Remark" SG_ 389 ADC_DrvTarTqMod2EPB_B "";
BA_ "EventCommandSignal" SG_ 389 ADC_LongCtrlTypReq_B1 0;
BA_ "GatewayedSignals" SG_ 389 ADC_LongCtrlTypReq_B1 0;
BA_ "GenSigInactiveValue" SG_ 389 ADC_LongCtrlTypReq_B1 0;
BA_ "GenSigInvalidValue" SG_ 389 ADC_LongCtrlTypReq_B1 0;
BA_ "GenSigSendType" SG_ 389 ADC_LongCtrlTypReq_B1 1;
BA_ "GenSigStartValue" SG_ 389 ADC_LongCtrlTypReq_B1 0;
BA_ "GenSigTimeoutValue" SG_ 389 ADC_LongCtrlTypReq_B1 0;
BA_ "Remark" SG_ 389 ADC_LongCtrlTypReq_B1 "";
BA_ "EventCommandSignal" SG_ 389 ADC_AEBFaultSt_B1 0;
BA_ "GatewayedSignals" SG_ 389 ADC_AEBFaultSt_B1 0;
BA_ "GenSigInactiveValue" SG_ 389 ADC_AEBFaultSt_B1 0;
BA_ "GenSigInvalidValue" SG_ 389 ADC_AEBFaultSt_B1 0;
BA_ "GenSigSendType" SG_ 389 ADC_AEBFaultSt_B1 1;
BA_ "GenSigStartValue" SG_ 389 ADC_AEBFaultSt_B1 0;
BA_ "GenSigTimeoutValue" SG_ 389 ADC_AEBFaultSt_B1 1;
BA_ "Remark" SG_ 389 ADC_AEBFaultSt_B1 "";
BA_ "EventCommandSignal" SG_ 389 ADC_AEBOffSt_B1 0;
BA_ "GatewayedSignals" SG_ 389 ADC_AEBOffSt_B1 0;
BA_ "GenSigInactiveValue" SG_ 389 ADC_AEBOffSt_B1 0;
BA_ "GenSigInvalidValue" SG_ 389 ADC_AEBOffSt_B1 0;
BA_ "GenSigSendType" SG_ 389 ADC_AEBOffSt_B1 1;
BA_ "GenSigStartValue" SG_ 389 ADC_AEBOffSt_B1 0;
BA_ "GenSigTimeoutValue" SG_ 389 ADC_AEBOffSt_B1 1;
BA_ "Remark" SG_ 389 ADC_AEBOffSt_B1 "";
BA_ "EventCommandSignal" SG_ 389 ADC_AEBInterventionSt_B1 0;
BA_ "GatewayedSignals" SG_ 389 ADC_AEBInterventionSt_B1 0;
BA_ "GenSigInactiveValue" SG_ 389 ADC_AEBInterventionSt_B1 0;
BA_ "GenSigInvalidValue" SG_ 389 ADC_AEBInterventionSt_B1 0;
BA_ "GenSigSendType" SG_ 389 ADC_AEBInterventionSt_B1 1;
BA_ "GenSigStartValue" SG_ 389 ADC_AEBInterventionSt_B1 0;
BA_ "GenSigTimeoutValue" SG_ 389 ADC_AEBInterventionSt_B1 0;
BA_ "Remark" SG_ 389 ADC_AEBInterventionSt_B1 "";
BA_ "EventCommandSignal" SG_ 389 ADC_AEBDecelCtrlReq_B1 0;
BA_ "GatewayedSignals" SG_ 389 ADC_AEBDecelCtrlReq_B1 0;
BA_ "GenSigInactiveValue" SG_ 389 ADC_AEBDecelCtrlReq_B1 0;
BA_ "GenSigInvalidValue" SG_ 389 ADC_AEBDecelCtrlReq_B1 0;
BA_ "GenSigSendType" SG_ 389 ADC_AEBDecelCtrlReq_B1 1;
BA_ "GenSigStartValue" SG_ 389 ADC_AEBDecelCtrlReq_B1 0;
BA_ "GenSigTimeoutValue" SG_ 389 ADC_AEBDecelCtrlReq_B1 0;
BA_ "Remark" SG_ 389 ADC_AEBDecelCtrlReq_B1 "";
BA_ "EventCommandSignal" SG_ 389 ADC_AEBLVehHoldReq_B1 0;
BA_ "GatewayedSignals" SG_ 389 ADC_AEBLVehHoldReq_B1 0;
BA_ "GenSigInactiveValue" SG_ 389 ADC_AEBLVehHoldReq_B1 0;
BA_ "GenSigInvalidValue" SG_ 389 ADC_AEBLVehHoldReq_B1 0;
BA_ "GenSigSendType" SG_ 389 ADC_AEBLVehHoldReq_B1 1;
BA_ "GenSigStartValue" SG_ 389 ADC_AEBLVehHoldReq_B1 0;
BA_ "GenSigTimeoutValue" SG_ 389 ADC_AEBLVehHoldReq_B1 0;
BA_ "Remark" SG_ 389 ADC_AEBLVehHoldReq_B1 "";
BA_ "EventCommandSignal" SG_ 389 ADC_ABAReq_B1 0;
BA_ "GatewayedSignals" SG_ 389 ADC_ABAReq_B1 0;
BA_ "GenSigInactiveValue" SG_ 389 ADC_ABAReq_B1 0;
BA_ "GenSigInvalidValue" SG_ 389 ADC_ABAReq_B1 0;
BA_ "GenSigSendType" SG_ 389 ADC_ABAReq_B1 1;
BA_ "GenSigStartValue" SG_ 389 ADC_ABAReq_B1 0;
BA_ "GenSigTimeoutValue" SG_ 389 ADC_ABAReq_B1 0;
BA_ "Remark" SG_ 389 ADC_ABAReq_B1 "";
BA_ "EventCommandSignal" SG_ 389 ADC_ABALevel_B1 0;
BA_ "GatewayedSignals" SG_ 389 ADC_ABALevel_B1 0;
BA_ "GenSigInactiveValue" SG_ 389 ADC_ABALevel_B1 0;
BA_ "GenSigInvalidValue" SG_ 389 ADC_ABALevel_B1 0;
BA_ "GenSigSendType" SG_ 389 ADC_ABALevel_B1 1;
BA_ "GenSigStartValue" SG_ 389 ADC_ABALevel_B1 0;
BA_ "GenSigTimeoutValue" SG_ 389 ADC_ABALevel_B1 0;
BA_ "Remark" SG_ 389 ADC_ABALevel_B1 "";
BA_ "EventCommandSignal" SG_ 389 ADC_AWBReq_B1 0;
BA_ "GatewayedSignals" SG_ 389 ADC_AWBReq_B1 0;
BA_ "GenSigInactiveValue" SG_ 389 ADC_AWBReq_B1 0;
BA_ "GenSigInvalidValue" SG_ 389 ADC_AWBReq_B1 0;
BA_ "GenSigSendType" SG_ 389 ADC_AWBReq_B1 1;
BA_ "GenSigStartValue" SG_ 389 ADC_AWBReq_B1 0;
BA_ "GenSigTimeoutValue" SG_ 389 ADC_AWBReq_B1 0;
BA_ "Remark" SG_ 389 ADC_AWBReq_B1 "";
BA_ "EventCommandSignal" SG_ 389 ADC_ABPReq_B1 0;
BA_ "GatewayedSignals" SG_ 389 ADC_ABPReq_B1 0;
BA_ "GenSigInactiveValue" SG_ 389 ADC_ABPReq_B1 0;
BA_ "GenSigInvalidValue" SG_ 389 ADC_ABPReq_B1 0;
BA_ "GenSigSendType" SG_ 389 ADC_ABPReq_B1 1;
BA_ "GenSigStartValue" SG_ 389 ADC_ABPReq_B1 0;
BA_ "GenSigTimeoutValue" SG_ 389 ADC_ABPReq_B1 0;
BA_ "Remark" SG_ 389 ADC_ABPReq_B1 "";
BA_ "EventCommandSignal" SG_ 389 ADC_AWBLevel_B1 0;
BA_ "GatewayedSignals" SG_ 389 ADC_AWBLevel_B1 0;
BA_ "GenSigInactiveValue" SG_ 389 ADC_AWBLevel_B1 0;
BA_ "GenSigInvalidValue" SG_ 389 ADC_AWBLevel_B1 0;
BA_ "GenSigSendType" SG_ 389 ADC_AWBLevel_B1 1;
BA_ "GenSigStartValue" SG_ 389 ADC_AWBLevel_B1 0;
BA_ "GenSigTimeoutValue" SG_ 389 ADC_AWBLevel_B1 0;
BA_ "Remark" SG_ 389 ADC_AWBLevel_B1 "";
BA_ "EventCommandSignal" SG_ 389 ADC_AEBTarCalss_B1 0;
BA_ "GatewayedSignals" SG_ 389 ADC_AEBTarCalss_B1 0;
BA_ "GenSigInactiveValue" SG_ 389 ADC_AEBTarCalss_B1 0;
BA_ "GenSigInvalidValue" SG_ 389 ADC_AEBTarCalss_B1 0;
BA_ "GenSigSendType" SG_ 389 ADC_AEBTarCalss_B1 1;
BA_ "GenSigStartValue" SG_ 389 ADC_AEBTarCalss_B1 0;
BA_ "GenSigTimeoutValue" SG_ 389 ADC_AEBTarCalss_B1 0;
BA_ "Remark" SG_ 389 ADC_AEBTarCalss_B1 "";
BA_ "EventCommandSignal" SG_ 389 ADC_AEBTarDetSensor_B1 0;
BA_ "GatewayedSignals" SG_ 389 ADC_AEBTarDetSensor_B1 0;
BA_ "GenSigInactiveValue" SG_ 389 ADC_AEBTarDetSensor_B1 0;
BA_ "GenSigInvalidValue" SG_ 389 ADC_AEBTarDetSensor_B1 0;
BA_ "GenSigSendType" SG_ 389 ADC_AEBTarDetSensor_B1 1;
BA_ "GenSigStartValue" SG_ 389 ADC_AEBTarDetSensor_B1 0;
BA_ "GenSigTimeoutValue" SG_ 389 ADC_AEBTarDetSensor_B1 0;
BA_ "Remark" SG_ 389 ADC_AEBTarDetSensor_B1 "";
BA_ "EventCommandSignal" SG_ 389 ADC_TurnLightReq_B1 0;
BA_ "GatewayedSignals" SG_ 389 ADC_TurnLightReq_B1 0;
BA_ "GenSigInactiveValue" SG_ 389 ADC_TurnLightReq_B1 0;
BA_ "GenSigInvalidValue" SG_ 389 ADC_TurnLightReq_B1 0;
BA_ "GenSigSendType" SG_ 389 ADC_TurnLightReq_B1 1;
BA_ "GenSigStartValue" SG_ 389 ADC_TurnLightReq_B1 0;
BA_ "GenSigTimeoutValue" SG_ 389 ADC_TurnLightReq_B1 0;
BA_ "Remark" SG_ 389 ADC_TurnLightReq_B1 "";
BA_ "EventCommandSignal" SG_ 389 ADC_EpbModReq_B1 0;
BA_ "GatewayedSignals" SG_ 389 ADC_EpbModReq_B1 0;
BA_ "GenSigInactiveValue" SG_ 389 ADC_EpbModReq_B1 0;
BA_ "GenSigInvalidValue" SG_ 389 ADC_EpbModReq_B1 0;
BA_ "GenSigSendType" SG_ 389 ADC_EpbModReq_B1 1;
BA_ "GenSigStartValue" SG_ 389 ADC_EpbModReq_B1 0;
BA_ "GenSigTimeoutValue" SG_ 389 ADC_EpbModReq_B1 0;
BA_ "Remark" SG_ 389 ADC_EpbModReq_B1 "";
BA_ "EventCommandSignal" SG_ 389 ADC_EpbModReqEna_B1 0;
BA_ "GatewayedSignals" SG_ 389 ADC_EpbModReqEna_B1 0;
BA_ "GenSigInactiveValue" SG_ 389 ADC_EpbModReqEna_B1 0;
BA_ "GenSigInvalidValue" SG_ 389 ADC_EpbModReqEna_B1 0;
BA_ "GenSigSendType" SG_ 389 ADC_EpbModReqEna_B1 1;
BA_ "GenSigStartValue" SG_ 389 ADC_EpbModReqEna_B1 0;
BA_ "GenSigTimeoutValue" SG_ 389 ADC_EpbModReqEna_B1 0;
BA_ "Remark" SG_ 389 ADC_EpbModReqEna_B1 "";
BA_ "EventCommandSignal" SG_ 389 ADC_AEBObjectTTC_B1 0;
BA_ "GatewayedSignals" SG_ 389 ADC_AEBObjectTTC_B1 0;
BA_ "GenSigInactiveValue" SG_ 389 ADC_AEBObjectTTC_B1 0;
BA_ "GenSigInvalidValue" SG_ 389 ADC_AEBObjectTTC_B1 0;
BA_ "GenSigSendType" SG_ 389 ADC_AEBObjectTTC_B1 1;
BA_ "GenSigStartValue" SG_ 389 ADC_AEBObjectTTC_B1 501;
BA_ "GenSigTimeoutValue" SG_ 389 ADC_AEBObjectTTC_B1 510;
BA_ "Remark" SG_ 389 ADC_AEBObjectTTC_B1 "";
BA_ "EventCommandSignal" SG_ 389 ADC_AEBObjRelativeSpd_B1 0;
BA_ "GatewayedSignals" SG_ 389 ADC_AEBObjRelativeSpd_B1 0;
BA_ "GenSigInactiveValue" SG_ 389 ADC_AEBObjRelativeSpd_B1 0;
BA_ "GenSigInvalidValue" SG_ 389 ADC_AEBObjRelativeSpd_B1 0;
BA_ "GenSigSendType" SG_ 389 ADC_AEBObjRelativeSpd_B1 1;
BA_ "GenSigStartValue" SG_ 389 ADC_AEBObjRelativeSpd_B1 0;
BA_ "GenSigTimeoutValue" SG_ 389 ADC_AEBObjRelativeSpd_B1 510;
BA_ "Remark" SG_ 389 ADC_AEBObjRelativeSpd_B1 "";
BA_ "EventCommandSignal" SG_ 389 ADC_PAAPwrModeReq_B1 0;
BA_ "GatewayedSignals" SG_ 389 ADC_PAAPwrModeReq_B1 0;
BA_ "GenSigInactiveValue" SG_ 389 ADC_PAAPwrModeReq_B1 0;
BA_ "GenSigInvalidValue" SG_ 389 ADC_PAAPwrModeReq_B1 0;
BA_ "GenSigSendType" SG_ 389 ADC_PAAPwrModeReq_B1 1;
BA_ "GenSigStartValue" SG_ 389 ADC_PAAPwrModeReq_B1 0;
BA_ "GenSigTimeoutValue" SG_ 389 ADC_PAAPwrModeReq_B1 0;
BA_ "Remark" SG_ 389 ADC_PAAPwrModeReq_B1 "";
BA_ "EventCommandSignal" SG_ 389 ADC_PAAGrarLvlReq_B1 0;
BA_ "GatewayedSignals" SG_ 389 ADC_PAAGrarLvlReq_B1 0;
BA_ "GenSigInactiveValue" SG_ 389 ADC_PAAGrarLvlReq_B1 0;
BA_ "GenSigInvalidValue" SG_ 389 ADC_PAAGrarLvlReq_B1 0;
BA_ "GenSigSendType" SG_ 389 ADC_PAAGrarLvlReq_B1 1;
BA_ "GenSigStartValue" SG_ 389 ADC_PAAGrarLvlReq_B1 0;
BA_ "GenSigTimeoutValue" SG_ 389 ADC_PAAGrarLvlReq_B1 0;
BA_ "Remark" SG_ 389 ADC_PAAGrarLvlReq_B1 "";
BA_ "EventCommandSignal" SG_ 389 ADC_PAAGrarLvlReqEnable_B1 0;
BA_ "GatewayedSignals" SG_ 389 ADC_PAAGrarLvlReqEnable_B1 0;
BA_ "GenSigInactiveValue" SG_ 389 ADC_PAAGrarLvlReqEnable_B1 0;
BA_ "GenSigInvalidValue" SG_ 389 ADC_PAAGrarLvlReqEnable_B1 0;
BA_ "GenSigSendType" SG_ 389 ADC_PAAGrarLvlReqEnable_B1 1;
BA_ "GenSigStartValue" SG_ 389 ADC_PAAGrarLvlReqEnable_B1 0;
BA_ "GenSigTimeoutValue" SG_ 389 ADC_PAAGrarLvlReqEnable_B1 0;
BA_ "Remark" SG_ 389 ADC_PAAGrarLvlReqEnable_B1 "";
BA_ "EventCommandSignal" SG_ 389 ADC_ActTrqReqVD_B1 0;
BA_ "GatewayedSignals" SG_ 389 ADC_ActTrqReqVD_B1 0;
BA_ "GenSigInactiveValue" SG_ 389 ADC_ActTrqReqVD_B1 0;
BA_ "GenSigInvalidValue" SG_ 389 ADC_ActTrqReqVD_B1 0;
BA_ "GenSigSendType" SG_ 389 ADC_ActTrqReqVD_B1 1;
BA_ "GenSigStartValue" SG_ 389 ADC_ActTrqReqVD_B1 0;
BA_ "GenSigTimeoutValue" SG_ 389 ADC_ActTrqReqVD_B1 0;
BA_ "Remark" SG_ 389 ADC_ActTrqReqVD_B1 "";
BA_ "EventCommandSignal" SG_ 389 ADC_BrkTarTqEna_B1 0;
BA_ "GatewayedSignals" SG_ 389 ADC_BrkTarTqEna_B1 0;
BA_ "GenSigInactiveValue" SG_ 389 ADC_BrkTarTqEna_B1 0;
BA_ "GenSigInvalidValue" SG_ 389 ADC_BrkTarTqEna_B1 0;
BA_ "GenSigSendType" SG_ 389 ADC_BrkTarTqEna_B1 1;
BA_ "GenSigStartValue" SG_ 389 ADC_BrkTarTqEna_B1 0;
BA_ "GenSigTimeoutValue" SG_ 389 ADC_BrkTarTqEna_B1 0;
BA_ "Remark" SG_ 389 ADC_BrkTarTqEna_B1 "";
BA_ "EventCommandSignal" SG_ 389 ADC_BrkTarTqMod_B1 0;
BA_ "GatewayedSignals" SG_ 389 ADC_BrkTarTqMod_B1 0;
BA_ "GenSigInactiveValue" SG_ 389 ADC_BrkTarTqMod_B1 0;
BA_ "GenSigInvalidValue" SG_ 389 ADC_BrkTarTqMod_B1 0;
BA_ "GenSigSendType" SG_ 389 ADC_BrkTarTqMod_B1 1;
BA_ "GenSigStartValue" SG_ 389 ADC_BrkTarTqMod_B1 0;
BA_ "GenSigTimeoutValue" SG_ 389 ADC_BrkTarTqMod_B1 0;
BA_ "Remark" SG_ 389 ADC_BrkTarTqMod_B1 "";
BA_ "EventCommandSignal" SG_ 389 ADC_AebBrkTarTq_B1 0;
BA_ "GatewayedSignals" SG_ 389 ADC_AebBrkTarTq_B1 0;
BA_ "GenSigInactiveValue" SG_ 389 ADC_AebBrkTarTq_B1 0;
BA_ "GenSigInvalidValue" SG_ 389 ADC_AebBrkTarTq_B1 0;
BA_ "GenSigSendType" SG_ 389 ADC_AebBrkTarTq_B1 1;
BA_ "GenSigStartValue" SG_ 389 ADC_AebBrkTarTq_B1 0;
BA_ "GenSigTimeoutValue" SG_ 389 ADC_AebBrkTarTq_B1 0;
BA_ "Remark" SG_ 389 ADC_AebBrkTarTq_B1 "";
BA_ "EventCommandSignal" SG_ 389 ADC_EpbModReqVld_B1 0;
BA_ "GatewayedSignals" SG_ 389 ADC_EpbModReqVld_B1 0;
BA_ "GenSigInactiveValue" SG_ 389 ADC_EpbModReqVld_B1 0;
BA_ "GenSigInvalidValue" SG_ 389 ADC_EpbModReqVld_B1 0;
BA_ "GenSigSendType" SG_ 389 ADC_EpbModReqVld_B1 1;
BA_ "GenSigStartValue" SG_ 389 ADC_EpbModReqVld_B1 0;
BA_ "GenSigTimeoutValue" SG_ 389 ADC_EpbModReqVld_B1 0;
BA_ "Remark" SG_ 389 ADC_EpbModReqVld_B1 "";
BA_ "EventCommandSignal" SG_ 389 ADC_RWUEna_B1 0;
BA_ "GatewayedSignals" SG_ 389 ADC_RWUEna_B1 0;
BA_ "GenSigInactiveValue" SG_ 389 ADC_RWUEna_B1 0;
BA_ "GenSigInvalidValue" SG_ 389 ADC_RWUEna_B1 0;
BA_ "GenSigSendType" SG_ 389 ADC_RWUEna_B1 1;
BA_ "GenSigStartValue" SG_ 389 ADC_RWUEna_B1 0;
BA_ "GenSigTimeoutValue" SG_ 389 ADC_RWUEna_B1 0;
BA_ "Remark" SG_ 389 ADC_RWUEna_B1 "";
BA_ "EventCommandSignal" SG_ 389 ADC_BrkOffEnable_B1 0;
BA_ "GatewayedSignals" SG_ 389 ADC_BrkOffEnable_B1 0;
BA_ "GenSigInactiveValue" SG_ 389 ADC_BrkOffEnable_B1 0;
BA_ "GenSigInvalidValue" SG_ 389 ADC_BrkOffEnable_B1 0;
BA_ "GenSigSendType" SG_ 389 ADC_BrkOffEnable_B1 1;
BA_ "GenSigStartValue" SG_ 389 ADC_BrkOffEnable_B1 0;
BA_ "GenSigTimeoutValue" SG_ 389 ADC_BrkOffEnable_B1 0;
BA_ "Remark" SG_ 389 ADC_BrkOffEnable_B1 "";
BA_ "EventCommandSignal" SG_ 389 ADC_BrkHoldReq_B1 0;
BA_ "GatewayedSignals" SG_ 389 ADC_BrkHoldReq_B1 0;
BA_ "GenSigInactiveValue" SG_ 389 ADC_BrkHoldReq_B1 0;
BA_ "GenSigInvalidValue" SG_ 389 ADC_BrkHoldReq_B1 0;
BA_ "GenSigSendType" SG_ 389 ADC_BrkHoldReq_B1 1;
BA_ "GenSigStartValue" SG_ 389 ADC_BrkHoldReq_B1 0;
BA_ "GenSigTimeoutValue" SG_ 389 ADC_BrkHoldReq_B1 0;
BA_ "Remark" SG_ 389 ADC_BrkHoldReq_B1 "";
BA_ "EventCommandSignal" SG_ 389 ADC_AngReqAvl_B1 0;
BA_ "GatewayedSignals" SG_ 389 ADC_AngReqAvl_B1 0;
BA_ "GenSigInactiveValue" SG_ 389 ADC_AngReqAvl_B1 0;
BA_ "GenSigInvalidValue" SG_ 389 ADC_AngReqAvl_B1 0;
BA_ "GenSigSendType" SG_ 389 ADC_AngReqAvl_B1 1;
BA_ "GenSigStartValue" SG_ 389 ADC_AngReqAvl_B1 0;
BA_ "GenSigTimeoutValue" SG_ 389 ADC_AngReqAvl_B1 0;
BA_ "Remark" SG_ 389 ADC_AngReqAvl_B1 "";
BA_ "EventCommandSignal" SG_ 389 ADC_TarGearReqVld_B1 0;
BA_ "GatewayedSignals" SG_ 389 ADC_TarGearReqVld_B1 0;
BA_ "GenSigInactiveValue" SG_ 389 ADC_TarGearReqVld_B1 0;
BA_ "GenSigInvalidValue" SG_ 389 ADC_TarGearReqVld_B1 0;
BA_ "GenSigSendType" SG_ 389 ADC_TarGearReqVld_B1 1;
BA_ "GenSigStartValue" SG_ 389 ADC_TarGearReqVld_B1 0;
BA_ "GenSigTimeoutValue" SG_ 389 ADC_TarGearReqVld_B1 0;
BA_ "Remark" SG_ 389 ADC_TarGearReqVld_B1 "";
BA_ "EventCommandSignal" SG_ 389 ADC_FctSts_B1 0;
BA_ "GatewayedSignals" SG_ 389 ADC_FctSts_B1 0;
BA_ "GenSigInactiveValue" SG_ 389 ADC_FctSts_B1 0;
BA_ "GenSigInvalidValue" SG_ 389 ADC_FctSts_B1 0;
BA_ "GenSigSendType" SG_ 389 ADC_FctSts_B1 1;
BA_ "GenSigStartValue" SG_ 389 ADC_FctSts_B1 0;
BA_ "GenSigTimeoutValue" SG_ 389 ADC_FctSts_B1 0;
BA_ "Remark" SG_ 389 ADC_FctSts_B1 "";
BA_ "EventCommandSignal" SG_ 389 ADC_BrkTarTqVld_B1 0;
BA_ "GatewayedSignals" SG_ 389 ADC_BrkTarTqVld_B1 0;
BA_ "GenSigInactiveValue" SG_ 389 ADC_BrkTarTqVld_B1 0;
BA_ "GenSigInvalidValue" SG_ 389 ADC_BrkTarTqVld_B1 0;
BA_ "GenSigSendType" SG_ 389 ADC_BrkTarTqVld_B1 1;
BA_ "GenSigStartValue" SG_ 389 ADC_BrkTarTqVld_B1 0;
BA_ "GenSigTimeoutValue" SG_ 389 ADC_BrkTarTqVld_B1 0;
BA_ "Remark" SG_ 389 ADC_BrkTarTqVld_B1 "";
BA_ "EventCommandSignal" SG_ 389 ADC_AebBrkTarTqVld_B1 0;
BA_ "GatewayedSignals" SG_ 389 ADC_AebBrkTarTqVld_B1 0;
BA_ "GenSigInactiveValue" SG_ 389 ADC_AebBrkTarTqVld_B1 0;
BA_ "GenSigInvalidValue" SG_ 389 ADC_AebBrkTarTqVld_B1 0;
BA_ "GenSigSendType" SG_ 389 ADC_AebBrkTarTqVld_B1 1;
BA_ "GenSigStartValue" SG_ 389 ADC_AebBrkTarTqVld_B1 0;
BA_ "GenSigTimeoutValue" SG_ 389 ADC_AebBrkTarTqVld_B1 0;
BA_ "Remark" SG_ 389 ADC_AebBrkTarTqVld_B1 "";
BA_ "EventCommandSignal" SG_ 389 ADC_AebBrkTarTqEna_B1 0;
BA_ "GatewayedSignals" SG_ 389 ADC_AebBrkTarTqEna_B1 0;
BA_ "GenSigInactiveValue" SG_ 389 ADC_AebBrkTarTqEna_B1 0;
BA_ "GenSigInvalidValue" SG_ 389 ADC_AebBrkTarTqEna_B1 0;
BA_ "GenSigSendType" SG_ 389 ADC_AebBrkTarTqEna_B1 1;
BA_ "GenSigStartValue" SG_ 389 ADC_AebBrkTarTqEna_B1 0;
BA_ "GenSigTimeoutValue" SG_ 389 ADC_AebBrkTarTqEna_B1 0;
BA_ "Remark" SG_ 389 ADC_AebBrkTarTqEna_B1 "";
BA_ "EventCommandSignal" SG_ 389 ADC_ElecBrkFnSwitch_B1 0;
BA_ "GatewayedSignals" SG_ 389 ADC_ElecBrkFnSwitch_B1 0;
BA_ "GenSigInactiveValue" SG_ 389 ADC_ElecBrkFnSwitch_B1 0;
BA_ "GenSigInvalidValue" SG_ 389 ADC_ElecBrkFnSwitch_B1 0;
BA_ "GenSigSendType" SG_ 389 ADC_ElecBrkFnSwitch_B1 1;
BA_ "GenSigStartValue" SG_ 389 ADC_ElecBrkFnSwitch_B1 0;
BA_ "GenSigTimeoutValue" SG_ 389 ADC_ElecBrkFnSwitch_B1 0;
BA_ "Remark" SG_ 389 ADC_ElecBrkFnSwitch_B1 "";
BA_ "EventCommandSignal" SG_ 389 ADC_RedundantSwt_B1 0;
BA_ "GatewayedSignals" SG_ 389 ADC_RedundantSwt_B1 0;
BA_ "GenSigInactiveValue" SG_ 389 ADC_RedundantSwt_B1 0;
BA_ "GenSigInvalidValue" SG_ 389 ADC_RedundantSwt_B1 0;
BA_ "GenSigSendType" SG_ 389 ADC_RedundantSwt_B1 1;
BA_ "GenSigStartValue" SG_ 389 ADC_RedundantSwt_B1 0;
BA_ "GenSigTimeoutValue" SG_ 389 ADC_RedundantSwt_B1 0;
BA_ "Remark" SG_ 389 ADC_RedundantSwt_B1 "";
BA_ "EventCommandSignal" SG_ 389 ADC_ImmediateStopEna_B1 0;
BA_ "GatewayedSignals" SG_ 389 ADC_ImmediateStopEna_B1 0;
BA_ "GenSigInactiveValue" SG_ 389 ADC_ImmediateStopEna_B1 0;
BA_ "GenSigInvalidValue" SG_ 389 ADC_ImmediateStopEna_B1 0;
BA_ "GenSigSendType" SG_ 389 ADC_ImmediateStopEna_B1 1;
BA_ "GenSigStartValue" SG_ 389 ADC_ImmediateStopEna_B1 0;
BA_ "GenSigTimeoutValue" SG_ 389 ADC_ImmediateStopEna_B1 0;
BA_ "Remark" SG_ 389 ADC_ImmediateStopEna_B1 "";
BA_ "EventCommandSignal" SG_ 389 ADC_RWUVld_B1 0;
BA_ "GatewayedSignals" SG_ 389 ADC_RWUVld_B1 0;
BA_ "GenSigInactiveValue" SG_ 389 ADC_RWUVld_B1 0;
BA_ "GenSigInvalidValue" SG_ 389 ADC_RWUVld_B1 0;
BA_ "GenSigSendType" SG_ 389 ADC_RWUVld_B1 1;
BA_ "GenSigStartValue" SG_ 389 ADC_RWUVld_B1 0;
BA_ "GenSigTimeoutValue" SG_ 389 ADC_RWUVld_B1 0;
BA_ "Remark" SG_ 389 ADC_RWUVld_B1 "";
BA_ "EventCommandSignal" SG_ 389 ADC_DriverPresent_B1 0;
BA_ "GatewayedSignals" SG_ 389 ADC_DriverPresent_B1 0;
BA_ "GenSigInactiveValue" SG_ 389 ADC_DriverPresent_B1 0;
BA_ "GenSigInvalidValue" SG_ 389 ADC_DriverPresent_B1 0;
BA_ "GenSigSendType" SG_ 389 ADC_DriverPresent_B1 1;
BA_ "GenSigStartValue" SG_ 389 ADC_DriverPresent_B1 0;
BA_ "GenSigTimeoutValue" SG_ 389 ADC_DriverPresent_B1 0;
BA_ "Remark" SG_ 389 ADC_DriverPresent_B1 "";
BA_ "EventCommandSignal" SG_ 389 ADC_AD_NetMode_B 0;
BA_ "GatewayedSignals" SG_ 389 ADC_AD_NetMode_B 0;
BA_ "GenSigInactiveValue" SG_ 389 ADC_AD_NetMode_B 0;
BA_ "GenSigInvalidValue" SG_ 389 ADC_AD_NetMode_B 0;
BA_ "GenSigSendType" SG_ 389 ADC_AD_NetMode_B 1;
BA_ "GenSigStartValue" SG_ 389 ADC_AD_NetMode_B 0;
BA_ "GenSigTimeoutValue" SG_ 389 ADC_AD_NetMode_B 0;
BA_ "Remark" SG_ 389 ADC_AD_NetMode_B "";
BA_ "EventCommandSignal" SG_ 389 ADC_ChrgPwrMode_B 0;
BA_ "GatewayedSignals" SG_ 389 ADC_ChrgPwrMode_B 0;
BA_ "GenSigInactiveValue" SG_ 389 ADC_ChrgPwrMode_B 0;
BA_ "GenSigInvalidValue" SG_ 389 ADC_ChrgPwrMode_B 0;
BA_ "GenSigSendType" SG_ 389 ADC_ChrgPwrMode_B 1;
BA_ "GenSigStartValue" SG_ 389 ADC_ChrgPwrMode_B 0;
BA_ "GenSigTimeoutValue" SG_ 389 ADC_ChrgPwrMode_B 0;
BA_ "Remark" SG_ 389 ADC_ChrgPwrMode_B "";
BA_ "EventCommandSignal" SG_ 389 ADC_FcsActiveStatus_B 0;
BA_ "GatewayedSignals" SG_ 389 ADC_FcsActiveStatus_B 0;
BA_ "GenSigInactiveValue" SG_ 389 ADC_FcsActiveStatus_B 0;
BA_ "GenSigInvalidValue" SG_ 389 ADC_FcsActiveStatus_B 0;
BA_ "GenSigSendType" SG_ 389 ADC_FcsActiveStatus_B 1;
BA_ "GenSigStartValue" SG_ 389 ADC_FcsActiveStatus_B 0;
BA_ "GenSigTimeoutValue" SG_ 389 ADC_FcsActiveStatus_B 0;
BA_ "Remark" SG_ 389 ADC_FcsActiveStatus_B "";
BA_ "EventCommandSignal" SG_ 389 ADC_DriverSeatBeltPretightenReq_B 0;
BA_ "GatewayedSignals" SG_ 389 ADC_DriverSeatBeltPretightenReq_B 0;
BA_ "GenSigInactiveValue" SG_ 389 ADC_DriverSeatBeltPretightenReq_B 0;
BA_ "GenSigInvalidValue" SG_ 389 ADC_DriverSeatBeltPretightenReq_B 0;
BA_ "GenSigSendType" SG_ 389 ADC_DriverSeatBeltPretightenReq_B 1;
BA_ "GenSigStartValue" SG_ 389 ADC_DriverSeatBeltPretightenReq_B 0;
BA_ "GenSigTimeoutValue" SG_ 389 ADC_DriverSeatBeltPretightenReq_B 0;
BA_ "Remark" SG_ 389 ADC_DriverSeatBeltPretightenReq_B "";
BA_ "EventCommandSignal" SG_ 389 ADC_SteerVibrAvl_B 0;
BA_ "GatewayedSignals" SG_ 389 ADC_SteerVibrAvl_B 0;
BA_ "GenSigInactiveValue" SG_ 389 ADC_SteerVibrAvl_B 0;
BA_ "GenSigInvalidValue" SG_ 389 ADC_SteerVibrAvl_B 0;
BA_ "GenSigSendType" SG_ 389 ADC_SteerVibrAvl_B 1;
BA_ "GenSigStartValue" SG_ 389 ADC_SteerVibrAvl_B 0;
BA_ "GenSigTimeoutValue" SG_ 389 ADC_SteerVibrAvl_B 0;
BA_ "Remark" SG_ 389 ADC_SteerVibrAvl_B "";
BA_ "EventCommandSignal" SG_ 389 ADC_VehSpd_B 0;
BA_ "GatewayedSignals" SG_ 389 ADC_VehSpd_B 0;
BA_ "GenSigInactiveValue" SG_ 389 ADC_VehSpd_B 0;
BA_ "GenSigInvalidValue" SG_ 389 ADC_VehSpd_B 0;
BA_ "GenSigSendType" SG_ 389 ADC_VehSpd_B 1;
BA_ "GenSigStartValue" SG_ 389 ADC_VehSpd_B 0;
BA_ "GenSigTimeoutValue" SG_ 389 ADC_VehSpd_B 0;
BA_ "Remark" SG_ 389 ADC_VehSpd_B "";
BA_ "EventCommandSignal" SG_ 389 ADC_VehSpdVD_B 0;
BA_ "GatewayedSignals" SG_ 389 ADC_VehSpdVD_B 0;
BA_ "GenSigInactiveValue" SG_ 389 ADC_VehSpdVD_B 0;
BA_ "GenSigInvalidValue" SG_ 389 ADC_VehSpdVD_B 0;
BA_ "GenSigSendType" SG_ 389 ADC_VehSpdVD_B 1;
BA_ "GenSigStartValue" SG_ 389 ADC_VehSpdVD_B 0;
BA_ "GenSigTimeoutValue" SG_ 389 ADC_VehSpdVD_B 0;
BA_ "Remark" SG_ 389 ADC_VehSpdVD_B "";
BA_ "EventCommandSignal" SG_ 389 ADC_DriverSeatBeltVibrWarnReq_B 0;
BA_ "GatewayedSignals" SG_ 389 ADC_DriverSeatBeltVibrWarnReq_B 0;
BA_ "GenSigInactiveValue" SG_ 389 ADC_DriverSeatBeltVibrWarnReq_B 0;
BA_ "GenSigInvalidValue" SG_ 389 ADC_DriverSeatBeltVibrWarnReq_B 0;
BA_ "GenSigSendType" SG_ 389 ADC_DriverSeatBeltVibrWarnReq_B 0;
BA_ "GenSigStartValue" SG_ 389 ADC_DriverSeatBeltVibrWarnReq_B 0;
BA_ "GenSigTimeoutValue" SG_ 389 ADC_DriverSeatBeltVibrWarnReq_B 0;
BA_ "Remark" SG_ 389 ADC_DriverSeatBeltVibrWarnReq_B "";
BA_ "EventCommandSignal" SG_ 389 ADC_RasAngReqAvl_B1 0;
BA_ "GatewayedSignals" SG_ 389 ADC_RasAngReqAvl_B1 0;
BA_ "GenSigInactiveValue" SG_ 389 ADC_RasAngReqAvl_B1 0;
BA_ "GenSigInvalidValue" SG_ 389 ADC_RasAngReqAvl_B1 0;
BA_ "GenSigSendType" SG_ 389 ADC_RasAngReqAvl_B1 1;
BA_ "GenSigStartValue" SG_ 389 ADC_RasAngReqAvl_B1 0;
BA_ "GenSigTimeoutValue" SG_ 389 ADC_RasAngReqAvl_B1 0;
BA_ "Remark" SG_ 389 ADC_RasAngReqAvl_B1 "";
BA_ "EventCommandSignal" SG_ 389 ADC_RasAngReqSt_A_B1 0;
BA_ "GatewayedSignals" SG_ 389 ADC_RasAngReqSt_A_B1 0;
BA_ "GenSigInactiveValue" SG_ 389 ADC_RasAngReqSt_A_B1 0;
BA_ "GenSigInvalidValue" SG_ 389 ADC_RasAngReqSt_A_B1 0;
BA_ "GenSigSendType" SG_ 389 ADC_RasAngReqSt_A_B1 1;
BA_ "GenSigStartValue" SG_ 389 ADC_RasAngReqSt_A_B1 0;
BA_ "GenSigTimeoutValue" SG_ 389 ADC_RasAngReqSt_A_B1 0;
BA_ "Remark" SG_ 389 ADC_RasAngReqSt_A_B1 "";
BA_ "EventCommandSignal" SG_ 389 ADC_RasModReq_B1 0;
BA_ "GatewayedSignals" SG_ 389 ADC_RasModReq_B1 0;
BA_ "GenSigInactiveValue" SG_ 389 ADC_RasModReq_B1 0;
BA_ "GenSigInvalidValue" SG_ 389 ADC_RasModReq_B1 0;
BA_ "GenSigSendType" SG_ 389 ADC_RasModReq_B1 1;
BA_ "GenSigStartValue" SG_ 389 ADC_RasModReq_B1 0;
BA_ "GenSigTimeoutValue" SG_ 389 ADC_RasModReq_B1 0;
BA_ "Remark" SG_ 389 ADC_RasModReq_B1 "";
BA_ "EventCommandSignal" SG_ 389 ADC_RasAngleReq_A_B1 0;
BA_ "GatewayedSignals" SG_ 389 ADC_RasAngleReq_A_B1 0;
BA_ "GenSigInactiveValue" SG_ 389 ADC_RasAngleReq_A_B1 0;
BA_ "GenSigInvalidValue" SG_ 389 ADC_RasAngleReq_A_B1 4095;
BA_ "GenSigSendType" SG_ 389 ADC_RasAngleReq_A_B1 1;
BA_ "GenSigStartValue" SG_ 389 ADC_RasAngleReq_A_B1 2048;
BA_ "GenSigTimeoutValue" SG_ 389 ADC_RasAngleReq_A_B1 4095;
BA_ "Remark" SG_ 389 ADC_RasAngleReq_A_B1 "";
BA_ "EventCommandSignal" SG_ 389 ADC_BrkTarTq_B1 0;
BA_ "GatewayedSignals" SG_ 389 ADC_BrkTarTq_B1 0;
BA_ "GenSigInactiveValue" SG_ 389 ADC_BrkTarTq_B1 0;
BA_ "GenSigInvalidValue" SG_ 389 ADC_BrkTarTq_B1 0;
BA_ "GenSigSendType" SG_ 389 ADC_BrkTarTq_B1 1;
BA_ "GenSigStartValue" SG_ 389 ADC_BrkTarTq_B1 0;
BA_ "GenSigTimeoutValue" SG_ 389 ADC_BrkTarTq_B1 0;
BA_ "Remark" SG_ 389 ADC_BrkTarTq_B1 "";
BA_ "EventCommandSignal" SG_ 361 ADC_4_B_CRC 0;
BA_ "GatewayedSignals" SG_ 361 ADC_4_B_CRC 0;
BA_ "GenSigInactiveValue" SG_ 361 ADC_4_B_CRC 0;
BA_ "GenSigInvalidValue" SG_ 361 ADC_4_B_CRC 0;
BA_ "GenSigSendType" SG_ 361 ADC_4_B_CRC 1;
BA_ "GenSigStartValue" SG_ 361 ADC_4_B_CRC 0;
BA_ "GenSigTimeoutValue" SG_ 361 ADC_4_B_CRC 0;
BA_ "Remark" SG_ 361 ADC_4_B_CRC "";
BA_ "EventCommandSignal" SG_ 361 ADC_4_B_Counter 0;
BA_ "GatewayedSignals" SG_ 361 ADC_4_B_Counter 0;
BA_ "GenSigInactiveValue" SG_ 361 ADC_4_B_Counter 0;
BA_ "GenSigInvalidValue" SG_ 361 ADC_4_B_Counter 0;
BA_ "GenSigSendType" SG_ 361 ADC_4_B_Counter 1;
BA_ "GenSigStartValue" SG_ 361 ADC_4_B_Counter 0;
BA_ "GenSigTimeoutValue" SG_ 361 ADC_4_B_Counter 0;
BA_ "Remark" SG_ 361 ADC_4_B_Counter "";
BA_ "EventCommandSignal" SG_ 361 ADC_AngReqSt_A_B1 0;
BA_ "GatewayedSignals" SG_ 361 ADC_AngReqSt_A_B1 0;
BA_ "GenSigInactiveValue" SG_ 361 ADC_AngReqSt_A_B1 0;
BA_ "GenSigInvalidValue" SG_ 361 ADC_AngReqSt_A_B1 0;
BA_ "GenSigSendType" SG_ 361 ADC_AngReqSt_A_B1 1;
BA_ "GenSigStartValue" SG_ 361 ADC_AngReqSt_A_B1 0;
BA_ "GenSigTimeoutValue" SG_ 361 ADC_AngReqSt_A_B1 0;
BA_ "Remark" SG_ 361 ADC_AngReqSt_A_B1 "";
BA_ "EventCommandSignal" SG_ 361 ADC_AngReqFunction_B1 0;
BA_ "GatewayedSignals" SG_ 361 ADC_AngReqFunction_B1 0;
BA_ "GenSigInactiveValue" SG_ 361 ADC_AngReqFunction_B1 0;
BA_ "GenSigInvalidValue" SG_ 361 ADC_AngReqFunction_B1 0;
BA_ "GenSigSendType" SG_ 361 ADC_AngReqFunction_B1 1;
BA_ "GenSigStartValue" SG_ 361 ADC_AngReqFunction_B1 0;
BA_ "GenSigTimeoutValue" SG_ 361 ADC_AngReqFunction_B1 0;
BA_ "Remark" SG_ 361 ADC_AngReqFunction_B1 "";
BA_ "EventCommandSignal" SG_ 361 ADC_BrakeLightReq_B1 0;
BA_ "GatewayedSignals" SG_ 361 ADC_BrakeLightReq_B1 0;
BA_ "GenSigInactiveValue" SG_ 361 ADC_BrakeLightReq_B1 0;
BA_ "GenSigInvalidValue" SG_ 361 ADC_BrakeLightReq_B1 0;
BA_ "GenSigSendType" SG_ 361 ADC_BrakeLightReq_B1 1;
BA_ "GenSigStartValue" SG_ 361 ADC_BrakeLightReq_B1 0;
BA_ "GenSigTimeoutValue" SG_ 361 ADC_BrakeLightReq_B1 0;
BA_ "Remark" SG_ 361 ADC_BrakeLightReq_B1 "";
BA_ "EventCommandSignal" SG_ 361 ADC_StrAngleReq_A_B1 0;
BA_ "GatewayedSignals" SG_ 361 ADC_StrAngleReq_A_B1 0;
BA_ "GenSigInactiveValue" SG_ 361 ADC_StrAngleReq_A_B1 0;
BA_ "GenSigInvalidValue" SG_ 361 ADC_StrAngleReq_A_B1 65535;
BA_ "GenSigSendType" SG_ 361 ADC_StrAngleReq_A_B1 1;
BA_ "GenSigStartValue" SG_ 361 ADC_StrAngleReq_A_B1 7800;
BA_ "GenSigTimeoutValue" SG_ 361 ADC_StrAngleReq_A_B1 65535;
BA_ "Remark" SG_ 361 ADC_StrAngleReq_A_B1 "";
BA_ "EventCommandSignal" SG_ 361 ADC_SACMotorTorLimExtMax_A_B1 0;
BA_ "GatewayedSignals" SG_ 361 ADC_SACMotorTorLimExtMax_A_B1 0;
BA_ "GenSigInactiveValue" SG_ 361 ADC_SACMotorTorLimExtMax_A_B1 0;
BA_ "GenSigInvalidValue" SG_ 361 ADC_SACMotorTorLimExtMax_A_B1 255;
BA_ "GenSigSendType" SG_ 361 ADC_SACMotorTorLimExtMax_A_B1 1;
BA_ "GenSigStartValue" SG_ 361 ADC_SACMotorTorLimExtMax_A_B1 254;
BA_ "GenSigTimeoutValue" SG_ 361 ADC_SACMotorTorLimExtMax_A_B1 255;
BA_ "Remark" SG_ 361 ADC_SACMotorTorLimExtMax_A_B1 "";
BA_ "EventCommandSignal" SG_ 361 ADC_SACMotorTorLimExtMin_A_B1 0;
BA_ "GatewayedSignals" SG_ 361 ADC_SACMotorTorLimExtMin_A_B1 0;
BA_ "GenSigInactiveValue" SG_ 361 ADC_SACMotorTorLimExtMin_A_B1 0;
BA_ "GenSigInvalidValue" SG_ 361 ADC_SACMotorTorLimExtMin_A_B1 255;
BA_ "GenSigSendType" SG_ 361 ADC_SACMotorTorLimExtMin_A_B1 1;
BA_ "GenSigStartValue" SG_ 361 ADC_SACMotorTorLimExtMin_A_B1 0;
BA_ "GenSigTimeoutValue" SG_ 361 ADC_SACMotorTorLimExtMin_A_B1 255;
BA_ "Remark" SG_ 361 ADC_SACMotorTorLimExtMin_A_B1 "";
BA_ "EventCommandSignal" SG_ 361 ADC_AssistParaSwitchReq_B1 0;
BA_ "GatewayedSignals" SG_ 361 ADC_AssistParaSwitchReq_B1 0;
BA_ "GenSigInactiveValue" SG_ 361 ADC_AssistParaSwitchReq_B1 0;
BA_ "GenSigInvalidValue" SG_ 361 ADC_AssistParaSwitchReq_B1 0;
BA_ "GenSigSendType" SG_ 361 ADC_AssistParaSwitchReq_B1 1;
BA_ "GenSigStartValue" SG_ 361 ADC_AssistParaSwitchReq_B1 0;
BA_ "GenSigTimeoutValue" SG_ 361 ADC_AssistParaSwitchReq_B1 0;
BA_ "Remark" SG_ 361 ADC_AssistParaSwitchReq_B1 "";
BA_ "EventCommandSignal" SG_ 361 ADC_AngReqRdntReq_A_B1 0;
BA_ "GatewayedSignals" SG_ 361 ADC_AngReqRdntReq_A_B1 0;
BA_ "GenSigInactiveValue" SG_ 361 ADC_AngReqRdntReq_A_B1 0;
BA_ "GenSigInvalidValue" SG_ 361 ADC_AngReqRdntReq_A_B1 0;
BA_ "GenSigSendType" SG_ 361 ADC_AngReqRdntReq_A_B1 1;
BA_ "GenSigStartValue" SG_ 361 ADC_AngReqRdntReq_A_B1 0;
BA_ "GenSigTimeoutValue" SG_ 361 ADC_AngReqRdntReq_A_B1 0;
BA_ "Remark" SG_ 361 ADC_AngReqRdntReq_A_B1 "";
BA_ "EventCommandSignal" SG_ 361 ADC_SteerGainReq_B1 0;
BA_ "GatewayedSignals" SG_ 361 ADC_SteerGainReq_B1 0;
BA_ "GenSigInactiveValue" SG_ 361 ADC_SteerGainReq_B1 0;
BA_ "GenSigInvalidValue" SG_ 361 ADC_SteerGainReq_B1 0;
BA_ "GenSigSendType" SG_ 361 ADC_SteerGainReq_B1 1;
BA_ "GenSigStartValue" SG_ 361 ADC_SteerGainReq_B1 0;
BA_ "GenSigTimeoutValue" SG_ 361 ADC_SteerGainReq_B1 0;
BA_ "Remark" SG_ 361 ADC_SteerGainReq_B1 "";
BA_ "EventCommandSignal" SG_ 361 ADC_StrgWhlVibrWarnLevel_B1 0;
BA_ "GatewayedSignals" SG_ 361 ADC_StrgWhlVibrWarnLevel_B1 0;
BA_ "GenSigInactiveValue" SG_ 361 ADC_StrgWhlVibrWarnLevel_B1 0;
BA_ "GenSigInvalidValue" SG_ 361 ADC_StrgWhlVibrWarnLevel_B1 0;
BA_ "GenSigSendType" SG_ 361 ADC_StrgWhlVibrWarnLevel_B1 1;
BA_ "GenSigStartValue" SG_ 361 ADC_StrgWhlVibrWarnLevel_B1 0;
BA_ "GenSigTimeoutValue" SG_ 361 ADC_StrgWhlVibrWarnLevel_B1 0;
BA_ "Remark" SG_ 361 ADC_StrgWhlVibrWarnLevel_B1 "";
BA_ "EventCommandSignal" SG_ 361 ADC_ActTrqReqEnable_B1 0;
BA_ "GatewayedSignals" SG_ 361 ADC_ActTrqReqEnable_B1 0;
BA_ "GenSigInactiveValue" SG_ 361 ADC_ActTrqReqEnable_B1 0;
BA_ "GenSigInvalidValue" SG_ 361 ADC_ActTrqReqEnable_B1 0;
BA_ "GenSigSendType" SG_ 361 ADC_ActTrqReqEnable_B1 1;
BA_ "GenSigStartValue" SG_ 361 ADC_ActTrqReqEnable_B1 0;
BA_ "GenSigTimeoutValue" SG_ 361 ADC_ActTrqReqEnable_B1 0;
BA_ "Remark" SG_ 361 ADC_ActTrqReqEnable_B1 "";
BA_ "EventCommandSignal" SG_ 361 ADC_VLCSt_B1 0;
BA_ "GatewayedSignals" SG_ 361 ADC_VLCSt_B1 0;
BA_ "GenSigInactiveValue" SG_ 361 ADC_VLCSt_B1 0;
BA_ "GenSigInvalidValue" SG_ 361 ADC_VLCSt_B1 0;
BA_ "GenSigSendType" SG_ 361 ADC_VLCSt_B1 1;
BA_ "GenSigStartValue" SG_ 361 ADC_VLCSt_B1 0;
BA_ "GenSigTimeoutValue" SG_ 361 ADC_VLCSt_B1 0;
BA_ "Remark" SG_ 361 ADC_VLCSt_B1 "";
BA_ "EventCommandSignal" SG_ 361 ADC_SteerGainLevel_B1 0;
BA_ "GatewayedSignals" SG_ 361 ADC_SteerGainLevel_B1 0;
BA_ "GenSigInactiveValue" SG_ 361 ADC_SteerGainLevel_B1 0;
BA_ "GenSigInvalidValue" SG_ 361 ADC_SteerGainLevel_B1 255;
BA_ "GenSigSendType" SG_ 361 ADC_SteerGainLevel_B1 1;
BA_ "GenSigStartValue" SG_ 361 ADC_SteerGainLevel_B1 0;
BA_ "GenSigTimeoutValue" SG_ 361 ADC_SteerGainLevel_B1 100;
BA_ "Remark" SG_ 361 ADC_SteerGainLevel_B1 "";
BA_ "EventCommandSignal" SG_ 361 ADC_EvsSteerReq_B1 0;
BA_ "GatewayedSignals" SG_ 361 ADC_EvsSteerReq_B1 0;
BA_ "GenSigInactiveValue" SG_ 361 ADC_EvsSteerReq_B1 0;
BA_ "GenSigInvalidValue" SG_ 361 ADC_EvsSteerReq_B1 0;
BA_ "GenSigSendType" SG_ 361 ADC_EvsSteerReq_B1 1;
BA_ "GenSigStartValue" SG_ 361 ADC_EvsSteerReq_B1 0;
BA_ "GenSigTimeoutValue" SG_ 361 ADC_EvsSteerReq_B1 0;
BA_ "Remark" SG_ 361 ADC_EvsSteerReq_B1 "";
BA_ "EventCommandSignal" SG_ 361 ADC_StrgWhlVibrWarnReq_B1 0;
BA_ "GatewayedSignals" SG_ 361 ADC_StrgWhlVibrWarnReq_B1 0;
BA_ "GenSigInactiveValue" SG_ 361 ADC_StrgWhlVibrWarnReq_B1 0;
BA_ "GenSigInvalidValue" SG_ 361 ADC_StrgWhlVibrWarnReq_B1 0;
BA_ "GenSigSendType" SG_ 361 ADC_StrgWhlVibrWarnReq_B1 1;
BA_ "GenSigStartValue" SG_ 361 ADC_StrgWhlVibrWarnReq_B1 0;
BA_ "GenSigTimeoutValue" SG_ 361 ADC_StrgWhlVibrWarnReq_B1 0;
BA_ "Remark" SG_ 361 ADC_StrgWhlVibrWarnReq_B1 "";
BA_ "EventCommandSignal" SG_ 361 ADC_ActTrqReq_B1 0;
BA_ "GatewayedSignals" SG_ 361 ADC_ActTrqReq_B1 0;
BA_ "GenSigInactiveValue" SG_ 361 ADC_ActTrqReq_B1 0;
BA_ "GenSigInvalidValue" SG_ 361 ADC_ActTrqReq_B1 0;
BA_ "GenSigSendType" SG_ 361 ADC_ActTrqReq_B1 1;
BA_ "GenSigStartValue" SG_ 361 ADC_ActTrqReq_B1 0;
BA_ "GenSigTimeoutValue" SG_ 361 ADC_ActTrqReq_B1 0;
BA_ "Remark" SG_ 361 ADC_ActTrqReq_B1 "";
BA_ "EventCommandSignal" SG_ 361 ADC_ADASLongCtrlFuncMode_B1 0;
BA_ "GatewayedSignals" SG_ 361 ADC_ADASLongCtrlFuncMode_B1 0;
BA_ "GenSigInactiveValue" SG_ 361 ADC_ADASLongCtrlFuncMode_B1 0;
BA_ "GenSigInvalidValue" SG_ 361 ADC_ADASLongCtrlFuncMode_B1 0;
BA_ "GenSigSendType" SG_ 361 ADC_ADASLongCtrlFuncMode_B1 1;
BA_ "GenSigStartValue" SG_ 361 ADC_ADASLongCtrlFuncMode_B1 0;
BA_ "GenSigTimeoutValue" SG_ 361 ADC_ADASLongCtrlFuncMode_B1 0;
BA_ "Remark" SG_ 361 ADC_ADASLongCtrlFuncMode_B1 "";
BA_ "EventCommandSignal" SG_ 361 ADC_LongCtrlAvailability_B1 0;
BA_ "GatewayedSignals" SG_ 361 ADC_LongCtrlAvailability_B1 0;
BA_ "GenSigInactiveValue" SG_ 361 ADC_LongCtrlAvailability_B1 0;
BA_ "GenSigInvalidValue" SG_ 361 ADC_LongCtrlAvailability_B1 0;
BA_ "GenSigSendType" SG_ 361 ADC_LongCtrlAvailability_B1 1;
BA_ "GenSigStartValue" SG_ 361 ADC_LongCtrlAvailability_B1 0;
BA_ "GenSigTimeoutValue" SG_ 361 ADC_LongCtrlAvailability_B1 0;
BA_ "Remark" SG_ 361 ADC_LongCtrlAvailability_B1 "";
BA_ "EventCommandSignal" SG_ 361 ADC_LongCtrlModeForBrkSys_B1 0;
BA_ "GatewayedSignals" SG_ 361 ADC_LongCtrlModeForBrkSys_B1 0;
BA_ "GenSigInactiveValue" SG_ 361 ADC_LongCtrlModeForBrkSys_B1 0;
BA_ "GenSigInvalidValue" SG_ 361 ADC_LongCtrlModeForBrkSys_B1 0;
BA_ "GenSigSendType" SG_ 361 ADC_LongCtrlModeForBrkSys_B1 1;
BA_ "GenSigStartValue" SG_ 361 ADC_LongCtrlModeForBrkSys_B1 0;
BA_ "GenSigTimeoutValue" SG_ 361 ADC_LongCtrlModeForBrkSys_B1 0;
BA_ "Remark" SG_ 361 ADC_LongCtrlModeForBrkSys_B1 "";
BA_ "EventCommandSignal" SG_ 361 ADC_LongCtrlTargetAxReq_B1 0;
BA_ "GatewayedSignals" SG_ 361 ADC_LongCtrlTargetAxReq_B1 0;
BA_ "GenSigInactiveValue" SG_ 361 ADC_LongCtrlTargetAxReq_B1 0;
BA_ "GenSigInvalidValue" SG_ 361 ADC_LongCtrlTargetAxReq_B1 0;
BA_ "GenSigSendType" SG_ 361 ADC_LongCtrlTargetAxReq_B1 1;
BA_ "GenSigStartValue" SG_ 361 ADC_LongCtrlTargetAxReq_B1 0;
BA_ "GenSigTimeoutValue" SG_ 361 ADC_LongCtrlTargetAxReq_B1 0;
BA_ "Remark" SG_ 361 ADC_LongCtrlTargetAxReq_B1 "";
BA_ "EventCommandSignal" SG_ 361 ADC_LongCtrlTypReq_B1 0;
BA_ "GatewayedSignals" SG_ 361 ADC_LongCtrlTypReq_B1 0;
BA_ "GenSigInactiveValue" SG_ 361 ADC_LongCtrlTypReq_B1 0;
BA_ "GenSigInvalidValue" SG_ 361 ADC_LongCtrlTypReq_B1 0;
BA_ "GenSigSendType" SG_ 361 ADC_LongCtrlTypReq_B1 1;
BA_ "GenSigStartValue" SG_ 361 ADC_LongCtrlTypReq_B1 0;
BA_ "GenSigTimeoutValue" SG_ 361 ADC_LongCtrlTypReq_B1 0;
BA_ "Remark" SG_ 361 ADC_LongCtrlTypReq_B1 "";
BA_ "EventCommandSignal" SG_ 361 ADC_LongCtrlDecToStopReq_B1 0;
BA_ "GatewayedSignals" SG_ 361 ADC_LongCtrlDecToStopReq_B1 0;
BA_ "GenSigInactiveValue" SG_ 361 ADC_LongCtrlDecToStopReq_B1 0;
BA_ "GenSigInvalidValue" SG_ 361 ADC_LongCtrlDecToStopReq_B1 0;
BA_ "GenSigSendType" SG_ 361 ADC_LongCtrlDecToStopReq_B1 1;
BA_ "GenSigStartValue" SG_ 361 ADC_LongCtrlDecToStopReq_B1 0;
BA_ "GenSigTimeoutValue" SG_ 361 ADC_LongCtrlDecToStopReq_B1 0;
BA_ "Remark" SG_ 361 ADC_LongCtrlDecToStopReq_B1 "";
BA_ "EventCommandSignal" SG_ 361 ADC_LongCtrlDriveOff_B1 0;
BA_ "GatewayedSignals" SG_ 361 ADC_LongCtrlDriveOff_B1 0;
BA_ "GenSigInactiveValue" SG_ 361 ADC_LongCtrlDriveOff_B1 0;
BA_ "GenSigInvalidValue" SG_ 361 ADC_LongCtrlDriveOff_B1 0;
BA_ "GenSigSendType" SG_ 361 ADC_LongCtrlDriveOff_B1 1;
BA_ "GenSigStartValue" SG_ 361 ADC_LongCtrlDriveOff_B1 0;
BA_ "GenSigTimeoutValue" SG_ 361 ADC_LongCtrlDriveOff_B1 0;
BA_ "Remark" SG_ 361 ADC_LongCtrlDriveOff_B1 "";
BA_ "EventCommandSignal" SG_ 361 ADC_LongctrlSecureReq_B1 0;
BA_ "GatewayedSignals" SG_ 361 ADC_LongctrlSecureReq_B1 0;
BA_ "GenSigInactiveValue" SG_ 361 ADC_LongctrlSecureReq_B1 0;
BA_ "GenSigInvalidValue" SG_ 361 ADC_LongctrlSecureReq_B1 0;
BA_ "GenSigSendType" SG_ 361 ADC_LongctrlSecureReq_B1 1;
BA_ "GenSigStartValue" SG_ 361 ADC_LongctrlSecureReq_B1 0;
BA_ "GenSigTimeoutValue" SG_ 361 ADC_LongctrlSecureReq_B1 0;
BA_ "Remark" SG_ 361 ADC_LongctrlSecureReq_B1 "";
BA_ "EventCommandSignal" SG_ 361 ADC_ShifttoAVHReq_B1 0;
BA_ "GatewayedSignals" SG_ 361 ADC_ShifttoAVHReq_B1 0;
BA_ "GenSigInactiveValue" SG_ 361 ADC_ShifttoAVHReq_B1 0;
BA_ "GenSigInvalidValue" SG_ 361 ADC_ShifttoAVHReq_B1 0;
BA_ "GenSigSendType" SG_ 361 ADC_ShifttoAVHReq_B1 1;
BA_ "GenSigStartValue" SG_ 361 ADC_ShifttoAVHReq_B1 0;
BA_ "GenSigTimeoutValue" SG_ 361 ADC_ShifttoAVHReq_B1 0;
BA_ "Remark" SG_ 361 ADC_ShifttoAVHReq_B1 "";
BA_ "EventCommandSignal" SG_ 361 ADC_LongCtrlTargetAx_B1 0;
BA_ "GatewayedSignals" SG_ 361 ADC_LongCtrlTargetAx_B1 0;
BA_ "GenSigInactiveValue" SG_ 361 ADC_LongCtrlTargetAx_B1 0;
BA_ "GenSigInvalidValue" SG_ 361 ADC_LongCtrlTargetAx_B1 0;
BA_ "GenSigSendType" SG_ 361 ADC_LongCtrlTargetAx_B1 1;
BA_ "GenSigStartValue" SG_ 361 ADC_LongCtrlTargetAx_B1 0;
BA_ "GenSigTimeoutValue" SG_ 361 ADC_LongCtrlTargetAx_B1 0;
BA_ "Remark" SG_ 361 ADC_LongCtrlTargetAx_B1 "";
BA_ "EventCommandSignal" SG_ 361 ADC_TrkTargt0St_B1 0;
BA_ "GatewayedSignals" SG_ 361 ADC_TrkTargt0St_B1 0;
BA_ "GenSigInactiveValue" SG_ 361 ADC_TrkTargt0St_B1 0;
BA_ "GenSigInvalidValue" SG_ 361 ADC_TrkTargt0St_B1 0;
BA_ "GenSigSendType" SG_ 361 ADC_TrkTargt0St_B1 1;
BA_ "GenSigStartValue" SG_ 361 ADC_TrkTargt0St_B1 0;
BA_ "GenSigTimeoutValue" SG_ 361 ADC_TrkTargt0St_B1 0;
BA_ "Remark" SG_ 361 ADC_TrkTargt0St_B1 "";
BA_ "EventCommandSignal" SG_ 361 ADC_TrkTargt0longPos_B1 0;
BA_ "GatewayedSignals" SG_ 361 ADC_TrkTargt0longPos_B1 0;
BA_ "GenSigInactiveValue" SG_ 361 ADC_TrkTargt0longPos_B1 0;
BA_ "GenSigInvalidValue" SG_ 361 ADC_TrkTargt0longPos_B1 1023;
BA_ "GenSigSendType" SG_ 361 ADC_TrkTargt0longPos_B1 1;
BA_ "GenSigStartValue" SG_ 361 ADC_TrkTargt0longPos_B1 0;
BA_ "GenSigTimeoutValue" SG_ 361 ADC_TrkTargt0longPos_B1 0;
BA_ "Remark" SG_ 361 ADC_TrkTargt0longPos_B1 "";
BA_ "EventCommandSignal" SG_ 361 ADC_TrkTargt0latPos_B1 0;
BA_ "GatewayedSignals" SG_ 361 ADC_TrkTargt0latPos_B1 0;
BA_ "GenSigInactiveValue" SG_ 361 ADC_TrkTargt0latPos_B1 0;
BA_ "GenSigInvalidValue" SG_ 361 ADC_TrkTargt0latPos_B1 0;
BA_ "GenSigSendType" SG_ 361 ADC_TrkTargt0latPos_B1 1;
BA_ "GenSigStartValue" SG_ 361 ADC_TrkTargt0latPos_B1 512;
BA_ "GenSigTimeoutValue" SG_ 361 ADC_TrkTargt0latPos_B1 0;
BA_ "Remark" SG_ 361 ADC_TrkTargt0latPos_B1 "";
BA_ "EventCommandSignal" SG_ 361 ADC_TrkTargt0LatRelSpd_B1 0;
BA_ "GatewayedSignals" SG_ 361 ADC_TrkTargt0LatRelSpd_B1 0;
BA_ "GenSigInactiveValue" SG_ 361 ADC_TrkTargt0LatRelSpd_B1 0;
BA_ "GenSigInvalidValue" SG_ 361 ADC_TrkTargt0LatRelSpd_B1 511;
BA_ "GenSigSendType" SG_ 361 ADC_TrkTargt0LatRelSpd_B1 1;
BA_ "GenSigStartValue" SG_ 361 ADC_TrkTargt0LatRelSpd_B1 0;
BA_ "GenSigTimeoutValue" SG_ 361 ADC_TrkTargt0LatRelSpd_B1 0;
BA_ "Remark" SG_ 361 ADC_TrkTargt0LatRelSpd_B1 "";
BA_ "EventCommandSignal" SG_ 361 ADC_TrkTargt0LongRelSpd_B1 0;
BA_ "GatewayedSignals" SG_ 361 ADC_TrkTargt0LongRelSpd_B1 0;
BA_ "GenSigInactiveValue" SG_ 361 ADC_TrkTargt0LongRelSpd_B1 0;
BA_ "GenSigInvalidValue" SG_ 361 ADC_TrkTargt0LongRelSpd_B1 0;
BA_ "GenSigSendType" SG_ 361 ADC_TrkTargt0LongRelSpd_B1 1;
BA_ "GenSigStartValue" SG_ 361 ADC_TrkTargt0LongRelSpd_B1 0;
BA_ "GenSigTimeoutValue" SG_ 361 ADC_TrkTargt0LongRelSpd_B1 0;
BA_ "Remark" SG_ 361 ADC_TrkTargt0LongRelSpd_B1 "";
BA_ "EventCommandSignal" SG_ 361 ADC_AS_pauseReq_B1 0;
BA_ "GatewayedSignals" SG_ 361 ADC_AS_pauseReq_B1 0;
BA_ "GenSigInactiveValue" SG_ 361 ADC_AS_pauseReq_B1 0;
BA_ "GenSigInvalidValue" SG_ 361 ADC_AS_pauseReq_B1 0;
BA_ "GenSigSendType" SG_ 361 ADC_AS_pauseReq_B1 1;
BA_ "GenSigStartValue" SG_ 361 ADC_AS_pauseReq_B1 0;
BA_ "GenSigTimeoutValue" SG_ 361 ADC_AS_pauseReq_B1 0;
BA_ "Remark" SG_ 361 ADC_AS_pauseReq_B1 "";
BA_ "EventCommandSignal" SG_ 361 ADC_AS_calibrationReq_B1 0;
BA_ "GatewayedSignals" SG_ 361 ADC_AS_calibrationReq_B1 0;
BA_ "GenSigInactiveValue" SG_ 361 ADC_AS_calibrationReq_B1 0;
BA_ "GenSigInvalidValue" SG_ 361 ADC_AS_calibrationReq_B1 0;
BA_ "GenSigSendType" SG_ 361 ADC_AS_calibrationReq_B1 1;
BA_ "GenSigStartValue" SG_ 361 ADC_AS_calibrationReq_B1 0;
BA_ "GenSigTimeoutValue" SG_ 361 ADC_AS_calibrationReq_B1 0;
BA_ "Remark" SG_ 361 ADC_AS_calibrationReq_B1 "";
BA_ "EventCommandSignal" SG_ 361 ADC_AS_exitcurrentlevelReq_B1 0;
BA_ "GatewayedSignals" SG_ 361 ADC_AS_exitcurrentlevelReq_B1 0;
BA_ "GenSigInactiveValue" SG_ 361 ADC_AS_exitcurrentlevelReq_B1 0;
BA_ "GenSigInvalidValue" SG_ 361 ADC_AS_exitcurrentlevelReq_B1 0;
BA_ "GenSigSendType" SG_ 361 ADC_AS_exitcurrentlevelReq_B1 1;
BA_ "GenSigStartValue" SG_ 361 ADC_AS_exitcurrentlevelReq_B1 0;
BA_ "GenSigTimeoutValue" SG_ 361 ADC_AS_exitcurrentlevelReq_B1 0;
BA_ "Remark" SG_ 361 ADC_AS_exitcurrentlevelReq_B1 "";
BA_ "EventCommandSignal" SG_ 361 ADC_AS_ReqToadjust_B1 0;
BA_ "GatewayedSignals" SG_ 361 ADC_AS_ReqToadjust_B1 0;
BA_ "GenSigInactiveValue" SG_ 361 ADC_AS_ReqToadjust_B1 0;
BA_ "GenSigInvalidValue" SG_ 361 ADC_AS_ReqToadjust_B1 0;
BA_ "GenSigSendType" SG_ 361 ADC_AS_ReqToadjust_B1 1;
BA_ "GenSigStartValue" SG_ 361 ADC_AS_ReqToadjust_B1 0;
BA_ "GenSigTimeoutValue" SG_ 361 ADC_AS_ReqToadjust_B1 0;
BA_ "Remark" SG_ 361 ADC_AS_ReqToadjust_B1 "";
BA_ "EventCommandSignal" SG_ 361 ADC_AS_UnsafelevelunableReq_B1 0;
BA_ "GatewayedSignals" SG_ 361 ADC_AS_UnsafelevelunableReq_B1 0;
BA_ "GenSigInactiveValue" SG_ 361 ADC_AS_UnsafelevelunableReq_B1 0;
BA_ "GenSigInvalidValue" SG_ 361 ADC_AS_UnsafelevelunableReq_B1 0;
BA_ "GenSigSendType" SG_ 361 ADC_AS_UnsafelevelunableReq_B1 1;
BA_ "GenSigStartValue" SG_ 361 ADC_AS_UnsafelevelunableReq_B1 0;
BA_ "GenSigTimeoutValue" SG_ 361 ADC_AS_UnsafelevelunableReq_B1 0;
BA_ "Remark" SG_ 361 ADC_AS_UnsafelevelunableReq_B1 "";
BA_ "EventCommandSignal" SG_ 361 ADC_AEBTargetDecel_B1 0;
BA_ "GatewayedSignals" SG_ 361 ADC_AEBTargetDecel_B1 0;
BA_ "GenSigInactiveValue" SG_ 361 ADC_AEBTargetDecel_B1 0;
BA_ "GenSigInvalidValue" SG_ 361 ADC_AEBTargetDecel_B1 0;
BA_ "GenSigSendType" SG_ 361 ADC_AEBTargetDecel_B1 1;
BA_ "GenSigStartValue" SG_ 361 ADC_AEBTargetDecel_B1 0;
BA_ "GenSigTimeoutValue" SG_ 361 ADC_AEBTargetDecel_B1 0;
BA_ "Remark" SG_ 361 ADC_AEBTargetDecel_B1 "";
BA_ "EventCommandSignal" SG_ 361 ADC_AEBFaultSt_B1 0;
BA_ "GatewayedSignals" SG_ 361 ADC_AEBFaultSt_B1 0;
BA_ "GenSigInactiveValue" SG_ 361 ADC_AEBFaultSt_B1 0;
BA_ "GenSigInvalidValue" SG_ 361 ADC_AEBFaultSt_B1 0;
BA_ "GenSigSendType" SG_ 361 ADC_AEBFaultSt_B1 1;
BA_ "GenSigStartValue" SG_ 361 ADC_AEBFaultSt_B1 0;
BA_ "GenSigTimeoutValue" SG_ 361 ADC_AEBFaultSt_B1 1;
BA_ "Remark" SG_ 361 ADC_AEBFaultSt_B1 "";
BA_ "EventCommandSignal" SG_ 361 ADC_AEBOffSt_B1 0;
BA_ "GatewayedSignals" SG_ 361 ADC_AEBOffSt_B1 0;
BA_ "GenSigInactiveValue" SG_ 361 ADC_AEBOffSt_B1 0;
BA_ "GenSigInvalidValue" SG_ 361 ADC_AEBOffSt_B1 0;
BA_ "GenSigSendType" SG_ 361 ADC_AEBOffSt_B1 1;
BA_ "GenSigStartValue" SG_ 361 ADC_AEBOffSt_B1 0;
BA_ "GenSigTimeoutValue" SG_ 361 ADC_AEBOffSt_B1 1;
BA_ "Remark" SG_ 361 ADC_AEBOffSt_B1 "";
BA_ "EventCommandSignal" SG_ 361 ADC_AEBInterventionSt_B1 0;
BA_ "GatewayedSignals" SG_ 361 ADC_AEBInterventionSt_B1 0;
BA_ "GenSigInactiveValue" SG_ 361 ADC_AEBInterventionSt_B1 0;
BA_ "GenSigInvalidValue" SG_ 361 ADC_AEBInterventionSt_B1 0;
BA_ "GenSigSendType" SG_ 361 ADC_AEBInterventionSt_B1 1;
BA_ "GenSigStartValue" SG_ 361 ADC_AEBInterventionSt_B1 0;
BA_ "GenSigTimeoutValue" SG_ 361 ADC_AEBInterventionSt_B1 0;
BA_ "Remark" SG_ 361 ADC_AEBInterventionSt_B1 "";
BA_ "EventCommandSignal" SG_ 361 ADC_AEBDecelCtrlReq_B1 0;
BA_ "GatewayedSignals" SG_ 361 ADC_AEBDecelCtrlReq_B1 0;
BA_ "GenSigInactiveValue" SG_ 361 ADC_AEBDecelCtrlReq_B1 0;
BA_ "GenSigInvalidValue" SG_ 361 ADC_AEBDecelCtrlReq_B1 0;
BA_ "GenSigSendType" SG_ 361 ADC_AEBDecelCtrlReq_B1 1;
BA_ "GenSigStartValue" SG_ 361 ADC_AEBDecelCtrlReq_B1 0;
BA_ "GenSigTimeoutValue" SG_ 361 ADC_AEBDecelCtrlReq_B1 0;
BA_ "Remark" SG_ 361 ADC_AEBDecelCtrlReq_B1 "";
BA_ "EventCommandSignal" SG_ 361 ADC_AEBLVehHoldReq_B1 0;
BA_ "GatewayedSignals" SG_ 361 ADC_AEBLVehHoldReq_B1 0;
BA_ "GenSigInactiveValue" SG_ 361 ADC_AEBLVehHoldReq_B1 0;
BA_ "GenSigInvalidValue" SG_ 361 ADC_AEBLVehHoldReq_B1 0;
BA_ "GenSigSendType" SG_ 361 ADC_AEBLVehHoldReq_B1 1;
BA_ "GenSigStartValue" SG_ 361 ADC_AEBLVehHoldReq_B1 0;
BA_ "GenSigTimeoutValue" SG_ 361 ADC_AEBLVehHoldReq_B1 0;
BA_ "Remark" SG_ 361 ADC_AEBLVehHoldReq_B1 "";
BA_ "EventCommandSignal" SG_ 361 ADC_ABAReq_B1 0;
BA_ "GatewayedSignals" SG_ 361 ADC_ABAReq_B1 0;
BA_ "GenSigInactiveValue" SG_ 361 ADC_ABAReq_B1 0;
BA_ "GenSigInvalidValue" SG_ 361 ADC_ABAReq_B1 0;
BA_ "GenSigSendType" SG_ 361 ADC_ABAReq_B1 1;
BA_ "GenSigStartValue" SG_ 361 ADC_ABAReq_B1 0;
BA_ "GenSigTimeoutValue" SG_ 361 ADC_ABAReq_B1 0;
BA_ "Remark" SG_ 361 ADC_ABAReq_B1 "";
BA_ "EventCommandSignal" SG_ 361 ADC_ABALevel_B1 0;
BA_ "GatewayedSignals" SG_ 361 ADC_ABALevel_B1 0;
BA_ "GenSigInactiveValue" SG_ 361 ADC_ABALevel_B1 0;
BA_ "GenSigInvalidValue" SG_ 361 ADC_ABALevel_B1 0;
BA_ "GenSigSendType" SG_ 361 ADC_ABALevel_B1 1;
BA_ "GenSigStartValue" SG_ 361 ADC_ABALevel_B1 0;
BA_ "GenSigTimeoutValue" SG_ 361 ADC_ABALevel_B1 0;
BA_ "Remark" SG_ 361 ADC_ABALevel_B1 "";
BA_ "EventCommandSignal" SG_ 361 ADC_AWBReq_B1 0;
BA_ "GatewayedSignals" SG_ 361 ADC_AWBReq_B1 0;
BA_ "GenSigInactiveValue" SG_ 361 ADC_AWBReq_B1 0;
BA_ "GenSigInvalidValue" SG_ 361 ADC_AWBReq_B1 0;
BA_ "GenSigSendType" SG_ 361 ADC_AWBReq_B1 1;
BA_ "GenSigStartValue" SG_ 361 ADC_AWBReq_B1 0;
BA_ "GenSigTimeoutValue" SG_ 361 ADC_AWBReq_B1 0;
BA_ "Remark" SG_ 361 ADC_AWBReq_B1 "";
BA_ "EventCommandSignal" SG_ 361 ADC_ABPReq_B1 0;
BA_ "GatewayedSignals" SG_ 361 ADC_ABPReq_B1 0;
BA_ "GenSigInactiveValue" SG_ 361 ADC_ABPReq_B1 0;
BA_ "GenSigInvalidValue" SG_ 361 ADC_ABPReq_B1 0;
BA_ "GenSigSendType" SG_ 361 ADC_ABPReq_B1 1;
BA_ "GenSigStartValue" SG_ 361 ADC_ABPReq_B1 0;
BA_ "GenSigTimeoutValue" SG_ 361 ADC_ABPReq_B1 0;
BA_ "Remark" SG_ 361 ADC_ABPReq_B1 "";
BA_ "EventCommandSignal" SG_ 361 ADC_AWBLevel_B1 0;
BA_ "GatewayedSignals" SG_ 361 ADC_AWBLevel_B1 0;
BA_ "GenSigInactiveValue" SG_ 361 ADC_AWBLevel_B1 0;
BA_ "GenSigInvalidValue" SG_ 361 ADC_AWBLevel_B1 0;
BA_ "GenSigSendType" SG_ 361 ADC_AWBLevel_B1 1;
BA_ "GenSigStartValue" SG_ 361 ADC_AWBLevel_B1 0;
BA_ "GenSigTimeoutValue" SG_ 361 ADC_AWBLevel_B1 0;
BA_ "Remark" SG_ 361 ADC_AWBLevel_B1 "";
BA_ "EventCommandSignal" SG_ 361 ADC_AEBTarCalss_B1 0;
BA_ "GatewayedSignals" SG_ 361 ADC_AEBTarCalss_B1 0;
BA_ "GenSigInactiveValue" SG_ 361 ADC_AEBTarCalss_B1 0;
BA_ "GenSigInvalidValue" SG_ 361 ADC_AEBTarCalss_B1 0;
BA_ "GenSigSendType" SG_ 361 ADC_AEBTarCalss_B1 1;
BA_ "GenSigStartValue" SG_ 361 ADC_AEBTarCalss_B1 0;
BA_ "GenSigTimeoutValue" SG_ 361 ADC_AEBTarCalss_B1 0;
BA_ "Remark" SG_ 361 ADC_AEBTarCalss_B1 "";
BA_ "EventCommandSignal" SG_ 361 ADC_AEBTarDetSensor_B1 0;
BA_ "GatewayedSignals" SG_ 361 ADC_AEBTarDetSensor_B1 0;
BA_ "GenSigInactiveValue" SG_ 361 ADC_AEBTarDetSensor_B1 0;
BA_ "GenSigInvalidValue" SG_ 361 ADC_AEBTarDetSensor_B1 0;
BA_ "GenSigSendType" SG_ 361 ADC_AEBTarDetSensor_B1 1;
BA_ "GenSigStartValue" SG_ 361 ADC_AEBTarDetSensor_B1 0;
BA_ "GenSigTimeoutValue" SG_ 361 ADC_AEBTarDetSensor_B1 0;
BA_ "Remark" SG_ 361 ADC_AEBTarDetSensor_B1 "";
BA_ "EventCommandSignal" SG_ 361 ADC_TurnLightReq_B1 0;
BA_ "GatewayedSignals" SG_ 361 ADC_TurnLightReq_B1 0;
BA_ "GenSigInactiveValue" SG_ 361 ADC_TurnLightReq_B1 0;
BA_ "GenSigInvalidValue" SG_ 361 ADC_TurnLightReq_B1 0;
BA_ "GenSigSendType" SG_ 361 ADC_TurnLightReq_B1 1;
BA_ "GenSigStartValue" SG_ 361 ADC_TurnLightReq_B1 0;
BA_ "GenSigTimeoutValue" SG_ 361 ADC_TurnLightReq_B1 0;
BA_ "Remark" SG_ 361 ADC_TurnLightReq_B1 "";
BA_ "EventCommandSignal" SG_ 361 ADC_PAA2ESPAxReqEnable_B1 0;
BA_ "GatewayedSignals" SG_ 361 ADC_PAA2ESPAxReqEnable_B1 0;
BA_ "GenSigInactiveValue" SG_ 361 ADC_PAA2ESPAxReqEnable_B1 0;
BA_ "GenSigInvalidValue" SG_ 361 ADC_PAA2ESPAxReqEnable_B1 0;
BA_ "GenSigSendType" SG_ 361 ADC_PAA2ESPAxReqEnable_B1 1;
BA_ "GenSigStartValue" SG_ 361 ADC_PAA2ESPAxReqEnable_B1 0;
BA_ "GenSigTimeoutValue" SG_ 361 ADC_PAA2ESPAxReqEnable_B1 0;
BA_ "Remark" SG_ 361 ADC_PAA2ESPAxReqEnable_B1 "";
BA_ "EventCommandSignal" SG_ 361 ADC_PAA2ESPBrakeFunctionMode_B1 0;
BA_ "GatewayedSignals" SG_ 361 ADC_PAA2ESPBrakeFunctionMode_B1 0;
BA_ "GenSigInactiveValue" SG_ 361 ADC_PAA2ESPBrakeFunctionMode_B1 0;
BA_ "GenSigInvalidValue" SG_ 361 ADC_PAA2ESPBrakeFunctionMode_B1 0;
BA_ "GenSigSendType" SG_ 361 ADC_PAA2ESPBrakeFunctionMode_B1 1;
BA_ "GenSigStartValue" SG_ 361 ADC_PAA2ESPBrakeFunctionMode_B1 0;
BA_ "GenSigTimeoutValue" SG_ 361 ADC_PAA2ESPBrakeFunctionMode_B1 0;
BA_ "Remark" SG_ 361 ADC_PAA2ESPBrakeFunctionMode_B1 "";
BA_ "EventCommandSignal" SG_ 361 ADC_PAA2ESPEpbReq_B1 0;
BA_ "GatewayedSignals" SG_ 361 ADC_PAA2ESPEpbReq_B1 0;
BA_ "GenSigInactiveValue" SG_ 361 ADC_PAA2ESPEpbReq_B1 0;
BA_ "GenSigInvalidValue" SG_ 361 ADC_PAA2ESPEpbReq_B1 0;
BA_ "GenSigSendType" SG_ 361 ADC_PAA2ESPEpbReq_B1 1;
BA_ "GenSigStartValue" SG_ 361 ADC_PAA2ESPEpbReq_B1 0;
BA_ "GenSigTimeoutValue" SG_ 361 ADC_PAA2ESPEpbReq_B1 0;
BA_ "Remark" SG_ 361 ADC_PAA2ESPEpbReq_B1 "";
BA_ "EventCommandSignal" SG_ 361 ADC_PAA2ESPEpbReqSt_B1 0;
BA_ "GatewayedSignals" SG_ 361 ADC_PAA2ESPEpbReqSt_B1 0;
BA_ "GenSigInactiveValue" SG_ 361 ADC_PAA2ESPEpbReqSt_B1 0;
BA_ "GenSigInvalidValue" SG_ 361 ADC_PAA2ESPEpbReqSt_B1 0;
BA_ "GenSigSendType" SG_ 361 ADC_PAA2ESPEpbReqSt_B1 1;
BA_ "GenSigStartValue" SG_ 361 ADC_PAA2ESPEpbReqSt_B1 0;
BA_ "GenSigTimeoutValue" SG_ 361 ADC_PAA2ESPEpbReqSt_B1 0;
BA_ "Remark" SG_ 361 ADC_PAA2ESPEpbReqSt_B1 "";
BA_ "EventCommandSignal" SG_ 361 ADC_FcsActiveStatus_B 0;
BA_ "GatewayedSignals" SG_ 361 ADC_FcsActiveStatus_B 0;
BA_ "GenSigInactiveValue" SG_ 361 ADC_FcsActiveStatus_B 0;
BA_ "GenSigInvalidValue" SG_ 361 ADC_FcsActiveStatus_B 0;
BA_ "GenSigSendType" SG_ 361 ADC_FcsActiveStatus_B 1;
BA_ "GenSigStartValue" SG_ 361 ADC_FcsActiveStatus_B 0;
BA_ "GenSigTimeoutValue" SG_ 361 ADC_FcsActiveStatus_B 0;
BA_ "Remark" SG_ 361 ADC_FcsActiveStatus_B "";
BA_ "EventCommandSignal" SG_ 361 ADC_EpbModReq_B1 0;
BA_ "GatewayedSignals" SG_ 361 ADC_EpbModReq_B1 0;
BA_ "GenSigInactiveValue" SG_ 361 ADC_EpbModReq_B1 0;
BA_ "GenSigInvalidValue" SG_ 361 ADC_EpbModReq_B1 0;
BA_ "GenSigSendType" SG_ 361 ADC_EpbModReq_B1 1;
BA_ "GenSigStartValue" SG_ 361 ADC_EpbModReq_B1 0;
BA_ "GenSigTimeoutValue" SG_ 361 ADC_EpbModReq_B1 0;
BA_ "Remark" SG_ 361 ADC_EpbModReq_B1 "";
BA_ "EventCommandSignal" SG_ 361 ADC_ESPSwitchReq_B1 0;
BA_ "GatewayedSignals" SG_ 361 ADC_ESPSwitchReq_B1 0;
BA_ "GenSigInactiveValue" SG_ 361 ADC_ESPSwitchReq_B1 0;
BA_ "GenSigInvalidValue" SG_ 361 ADC_ESPSwitchReq_B1 0;
BA_ "GenSigSendType" SG_ 361 ADC_ESPSwitchReq_B1 1;
BA_ "GenSigStartValue" SG_ 361 ADC_ESPSwitchReq_B1 0;
BA_ "GenSigTimeoutValue" SG_ 361 ADC_ESPSwitchReq_B1 0;
BA_ "Remark" SG_ 361 ADC_ESPSwitchReq_B1 "";
BA_ "EventCommandSignal" SG_ 361 ADC_EpbModReqEna_B1 0;
BA_ "GatewayedSignals" SG_ 361 ADC_EpbModReqEna_B1 0;
BA_ "GenSigInactiveValue" SG_ 361 ADC_EpbModReqEna_B1 0;
BA_ "GenSigInvalidValue" SG_ 361 ADC_EpbModReqEna_B1 0;
BA_ "GenSigSendType" SG_ 361 ADC_EpbModReqEna_B1 1;
BA_ "GenSigStartValue" SG_ 361 ADC_EpbModReqEna_B1 0;
BA_ "GenSigTimeoutValue" SG_ 361 ADC_EpbModReqEna_B1 0;
BA_ "Remark" SG_ 361 ADC_EpbModReqEna_B1 "";
BA_ "EventCommandSignal" SG_ 361 ADC_PAA2EPBBrakeFunctionMode_B1 0;
BA_ "GatewayedSignals" SG_ 361 ADC_PAA2EPBBrakeFunctionMode_B1 0;
BA_ "GenSigInactiveValue" SG_ 361 ADC_PAA2EPBBrakeFunctionMode_B1 0;
BA_ "GenSigInvalidValue" SG_ 361 ADC_PAA2EPBBrakeFunctionMode_B1 0;
BA_ "GenSigSendType" SG_ 361 ADC_PAA2EPBBrakeFunctionMode_B1 1;
BA_ "GenSigStartValue" SG_ 361 ADC_PAA2EPBBrakeFunctionMode_B1 0;
BA_ "GenSigTimeoutValue" SG_ 361 ADC_PAA2EPBBrakeFunctionMode_B1 0;
BA_ "Remark" SG_ 361 ADC_PAA2EPBBrakeFunctionMode_B1 "";
BA_ "EventCommandSignal" SG_ 361 ADC_PAA2ESPApEmgyBrkReq_B1 0;
BA_ "GatewayedSignals" SG_ 361 ADC_PAA2ESPApEmgyBrkReq_B1 0;
BA_ "GenSigInactiveValue" SG_ 361 ADC_PAA2ESPApEmgyBrkReq_B1 0;
BA_ "GenSigInvalidValue" SG_ 361 ADC_PAA2ESPApEmgyBrkReq_B1 0;
BA_ "GenSigSendType" SG_ 361 ADC_PAA2ESPApEmgyBrkReq_B1 1;
BA_ "GenSigStartValue" SG_ 361 ADC_PAA2ESPApEmgyBrkReq_B1 0;
BA_ "GenSigTimeoutValue" SG_ 361 ADC_PAA2ESPApEmgyBrkReq_B1 0;
BA_ "Remark" SG_ 361 ADC_PAA2ESPApEmgyBrkReq_B1 "";
BA_ "EventCommandSignal" SG_ 361 ADC_PAA2ESPComfBrakeReq_B1 0;
BA_ "GatewayedSignals" SG_ 361 ADC_PAA2ESPComfBrakeReq_B1 0;
BA_ "GenSigInactiveValue" SG_ 361 ADC_PAA2ESPComfBrakeReq_B1 0;
BA_ "GenSigInvalidValue" SG_ 361 ADC_PAA2ESPComfBrakeReq_B1 0;
BA_ "GenSigSendType" SG_ 361 ADC_PAA2ESPComfBrakeReq_B1 1;
BA_ "GenSigStartValue" SG_ 361 ADC_PAA2ESPComfBrakeReq_B1 0;
BA_ "GenSigTimeoutValue" SG_ 361 ADC_PAA2ESPComfBrakeReq_B1 0;
BA_ "Remark" SG_ 361 ADC_PAA2ESPComfBrakeReq_B1 "";
BA_ "EventCommandSignal" SG_ 361 ADC_PAA2ESPApDriveOffReq_B1 0;
BA_ "GatewayedSignals" SG_ 361 ADC_PAA2ESPApDriveOffReq_B1 0;
BA_ "GenSigInactiveValue" SG_ 361 ADC_PAA2ESPApDriveOffReq_B1 0;
BA_ "GenSigInvalidValue" SG_ 361 ADC_PAA2ESPApDriveOffReq_B1 0;
BA_ "GenSigSendType" SG_ 361 ADC_PAA2ESPApDriveOffReq_B1 1;
BA_ "GenSigStartValue" SG_ 361 ADC_PAA2ESPApDriveOffReq_B1 0;
BA_ "GenSigTimeoutValue" SG_ 361 ADC_PAA2ESPApDriveOffReq_B1 0;
BA_ "Remark" SG_ 361 ADC_PAA2ESPApDriveOffReq_B1 "";
BA_ "EventCommandSignal" SG_ 361 ADC_PAA2ESPApStandstillReq_B1 0;
BA_ "GatewayedSignals" SG_ 361 ADC_PAA2ESPApStandstillReq_B1 0;
BA_ "GenSigInactiveValue" SG_ 361 ADC_PAA2ESPApStandstillReq_B1 0;
BA_ "GenSigInvalidValue" SG_ 361 ADC_PAA2ESPApStandstillReq_B1 0;
BA_ "GenSigSendType" SG_ 361 ADC_PAA2ESPApStandstillReq_B1 1;
BA_ "GenSigStartValue" SG_ 361 ADC_PAA2ESPApStandstillReq_B1 0;
BA_ "GenSigTimeoutValue" SG_ 361 ADC_PAA2ESPApStandstillReq_B1 0;
BA_ "Remark" SG_ 361 ADC_PAA2ESPApStandstillReq_B1 "";
BA_ "EventCommandSignal" SG_ 361 ADC_PAA2ESPApPrefillReq_B1 0;
BA_ "GatewayedSignals" SG_ 361 ADC_PAA2ESPApPrefillReq_B1 0;
BA_ "GenSigInactiveValue" SG_ 361 ADC_PAA2ESPApPrefillReq_B1 0;
BA_ "GenSigInvalidValue" SG_ 361 ADC_PAA2ESPApPrefillReq_B1 0;
BA_ "GenSigSendType" SG_ 361 ADC_PAA2ESPApPrefillReq_B1 1;
BA_ "GenSigStartValue" SG_ 361 ADC_PAA2ESPApPrefillReq_B1 0;
BA_ "GenSigTimeoutValue" SG_ 361 ADC_PAA2ESPApPrefillReq_B1 0;
BA_ "Remark" SG_ 361 ADC_PAA2ESPApPrefillReq_B1 "";
BA_ "EventCommandSignal" SG_ 361 ADC_PAA2ESPAxReq_B1 0;
BA_ "GatewayedSignals" SG_ 361 ADC_PAA2ESPAxReq_B1 0;
BA_ "GenSigInactiveValue" SG_ 361 ADC_PAA2ESPAxReq_B1 0;
BA_ "GenSigInvalidValue" SG_ 361 ADC_PAA2ESPAxReq_B1 0;
BA_ "GenSigSendType" SG_ 361 ADC_PAA2ESPAxReq_B1 1;
BA_ "GenSigStartValue" SG_ 361 ADC_PAA2ESPAxReq_B1 0;
BA_ "GenSigTimeoutValue" SG_ 361 ADC_PAA2ESPAxReq_B1 0;
BA_ "Remark" SG_ 361 ADC_PAA2ESPAxReq_B1 "";
BA_ "EventCommandSignal" SG_ 361 ADC_EPBReq_B1 0;
BA_ "GatewayedSignals" SG_ 361 ADC_EPBReq_B1 0;
BA_ "GenSigInactiveValue" SG_ 361 ADC_EPBReq_B1 0;
BA_ "GenSigInvalidValue" SG_ 361 ADC_EPBReq_B1 0;
BA_ "GenSigSendType" SG_ 361 ADC_EPBReq_B1 1;
BA_ "GenSigStartValue" SG_ 361 ADC_EPBReq_B1 0;
BA_ "GenSigTimeoutValue" SG_ 361 ADC_EPBReq_B1 0;
BA_ "Remark" SG_ 361 ADC_EPBReq_B1 "";
BA_ "EventCommandSignal" SG_ 361 ADC_PAA2ESPDistoStop_B1 0;
BA_ "GatewayedSignals" SG_ 361 ADC_PAA2ESPDistoStop_B1 0;
BA_ "GenSigInactiveValue" SG_ 361 ADC_PAA2ESPDistoStop_B1 0;
BA_ "GenSigInvalidValue" SG_ 361 ADC_PAA2ESPDistoStop_B1 0;
BA_ "GenSigSendType" SG_ 361 ADC_PAA2ESPDistoStop_B1 1;
BA_ "GenSigStartValue" SG_ 361 ADC_PAA2ESPDistoStop_B1 0;
BA_ "GenSigTimeoutValue" SG_ 361 ADC_PAA2ESPDistoStop_B1 0;
BA_ "Remark" SG_ 361 ADC_PAA2ESPDistoStop_B1 "";
BA_ "EventCommandSignal" SG_ 361 ADC_PAA2ESPTarTorquePTDriveoff_B1 0;
BA_ "GatewayedSignals" SG_ 361 ADC_PAA2ESPTarTorquePTDriveoff_B1 0;
BA_ "GenSigInactiveValue" SG_ 361 ADC_PAA2ESPTarTorquePTDriveoff_B1 0;
BA_ "GenSigInvalidValue" SG_ 361 ADC_PAA2ESPTarTorquePTDriveoff_B1 0;
BA_ "GenSigSendType" SG_ 361 ADC_PAA2ESPTarTorquePTDriveoff_B1 1;
BA_ "GenSigStartValue" SG_ 361 ADC_PAA2ESPTarTorquePTDriveoff_B1 0;
BA_ "GenSigTimeoutValue" SG_ 361 ADC_PAA2ESPTarTorquePTDriveoff_B1 0;
BA_ "Remark" SG_ 361 ADC_PAA2ESPTarTorquePTDriveoff_B1 "";
BA_ "EventCommandSignal" SG_ 361 ADC_VehTorqLimit_B1 0;
BA_ "GatewayedSignals" SG_ 361 ADC_VehTorqLimit_B1 0;
BA_ "GenSigInactiveValue" SG_ 361 ADC_VehTorqLimit_B1 0;
BA_ "GenSigInvalidValue" SG_ 361 ADC_VehTorqLimit_B1 0;
BA_ "GenSigSendType" SG_ 361 ADC_VehTorqLimit_B1 1;
BA_ "GenSigStartValue" SG_ 361 ADC_VehTorqLimit_B1 0;
BA_ "GenSigTimeoutValue" SG_ 361 ADC_VehTorqLimit_B1 0;
BA_ "Remark" SG_ 361 ADC_VehTorqLimit_B1 "";
BA_ "EventCommandSignal" SG_ 361 ADC_VehTorqReqValue_B1 0;
BA_ "GatewayedSignals" SG_ 361 ADC_VehTorqReqValue_B1 0;
BA_ "GenSigInactiveValue" SG_ 361 ADC_VehTorqReqValue_B1 0;
BA_ "GenSigInvalidValue" SG_ 361 ADC_VehTorqReqValue_B1 0;
BA_ "GenSigSendType" SG_ 361 ADC_VehTorqReqValue_B1 1;
BA_ "GenSigStartValue" SG_ 361 ADC_VehTorqReqValue_B1 0;
BA_ "GenSigTimeoutValue" SG_ 361 ADC_VehTorqReqValue_B1 0;
BA_ "Remark" SG_ 361 ADC_VehTorqReqValue_B1 "";
BA_ "EventCommandSignal" SG_ 361 ADC_VehTorqLimitEnable_B1 0;
BA_ "GatewayedSignals" SG_ 361 ADC_VehTorqLimitEnable_B1 0;
BA_ "GenSigInactiveValue" SG_ 361 ADC_VehTorqLimitEnable_B1 0;
BA_ "GenSigInvalidValue" SG_ 361 ADC_VehTorqLimitEnable_B1 0;
BA_ "GenSigSendType" SG_ 361 ADC_VehTorqLimitEnable_B1 1;
BA_ "GenSigStartValue" SG_ 361 ADC_VehTorqLimitEnable_B1 0;
BA_ "GenSigTimeoutValue" SG_ 361 ADC_VehTorqLimitEnable_B1 0;
BA_ "Remark" SG_ 361 ADC_VehTorqLimitEnable_B1 "";
BA_ "EventCommandSignal" SG_ 361 ADC_VehTorqReqEnable_B1 0;
BA_ "GatewayedSignals" SG_ 361 ADC_VehTorqReqEnable_B1 0;
BA_ "GenSigInactiveValue" SG_ 361 ADC_VehTorqReqEnable_B1 0;
BA_ "GenSigInvalidValue" SG_ 361 ADC_VehTorqReqEnable_B1 0;
BA_ "GenSigSendType" SG_ 361 ADC_VehTorqReqEnable_B1 1;
BA_ "GenSigStartValue" SG_ 361 ADC_VehTorqReqEnable_B1 0;
BA_ "GenSigTimeoutValue" SG_ 361 ADC_VehTorqReqEnable_B1 0;
BA_ "Remark" SG_ 361 ADC_VehTorqReqEnable_B1 "";
BA_ "EventCommandSignal" SG_ 361 ADC_PAAPwrModeReq_B1 0;
BA_ "GatewayedSignals" SG_ 361 ADC_PAAPwrModeReq_B1 0;
BA_ "GenSigInactiveValue" SG_ 361 ADC_PAAPwrModeReq_B1 0;
BA_ "GenSigInvalidValue" SG_ 361 ADC_PAAPwrModeReq_B1 0;
BA_ "GenSigSendType" SG_ 361 ADC_PAAPwrModeReq_B1 1;
BA_ "GenSigStartValue" SG_ 361 ADC_PAAPwrModeReq_B1 0;
BA_ "GenSigTimeoutValue" SG_ 361 ADC_PAAPwrModeReq_B1 0;
BA_ "Remark" SG_ 361 ADC_PAAPwrModeReq_B1 "";
BA_ "EventCommandSignal" SG_ 361 ADC_PAAGrarLvlReq_B1 0;
BA_ "GatewayedSignals" SG_ 361 ADC_PAAGrarLvlReq_B1 0;
BA_ "GenSigInactiveValue" SG_ 361 ADC_PAAGrarLvlReq_B1 0;
BA_ "GenSigInvalidValue" SG_ 361 ADC_PAAGrarLvlReq_B1 0;
BA_ "GenSigSendType" SG_ 361 ADC_PAAGrarLvlReq_B1 1;
BA_ "GenSigStartValue" SG_ 361 ADC_PAAGrarLvlReq_B1 0;
BA_ "GenSigTimeoutValue" SG_ 361 ADC_PAAGrarLvlReq_B1 0;
BA_ "Remark" SG_ 361 ADC_PAAGrarLvlReq_B1 "";
BA_ "EventCommandSignal" SG_ 361 ADC_PAAGrarLvlReqEnable_B1 0;
BA_ "GatewayedSignals" SG_ 361 ADC_PAAGrarLvlReqEnable_B1 0;
BA_ "GenSigInactiveValue" SG_ 361 ADC_PAAGrarLvlReqEnable_B1 0;
BA_ "GenSigInvalidValue" SG_ 361 ADC_PAAGrarLvlReqEnable_B1 0;
BA_ "GenSigSendType" SG_ 361 ADC_PAAGrarLvlReqEnable_B1 1;
BA_ "GenSigStartValue" SG_ 361 ADC_PAAGrarLvlReqEnable_B1 0;
BA_ "GenSigTimeoutValue" SG_ 361 ADC_PAAGrarLvlReqEnable_B1 0;
BA_ "Remark" SG_ 361 ADC_PAAGrarLvlReqEnable_B1 "";
BA_ "EventCommandSignal" SG_ 361 ADC_ActTrqReqVD_B1 0;
BA_ "GatewayedSignals" SG_ 361 ADC_ActTrqReqVD_B1 0;
BA_ "GenSigInactiveValue" SG_ 361 ADC_ActTrqReqVD_B1 0;
BA_ "GenSigInvalidValue" SG_ 361 ADC_ActTrqReqVD_B1 0;
BA_ "GenSigSendType" SG_ 361 ADC_ActTrqReqVD_B1 1;
BA_ "GenSigStartValue" SG_ 361 ADC_ActTrqReqVD_B1 0;
BA_ "GenSigTimeoutValue" SG_ 361 ADC_ActTrqReqVD_B1 0;
BA_ "Remark" SG_ 361 ADC_ActTrqReqVD_B1 "";
BA_ "EventCommandSignal" SG_ 361 ADC_RCTBTargetDecel_B1 0;
BA_ "GatewayedSignals" SG_ 361 ADC_RCTBTargetDecel_B1 0;
BA_ "GenSigInactiveValue" SG_ 361 ADC_RCTBTargetDecel_B1 0;
BA_ "GenSigInvalidValue" SG_ 361 ADC_RCTBTargetDecel_B1 0;
BA_ "GenSigSendType" SG_ 361 ADC_RCTBTargetDecel_B1 1;
BA_ "GenSigStartValue" SG_ 361 ADC_RCTBTargetDecel_B1 0;
BA_ "GenSigTimeoutValue" SG_ 361 ADC_RCTBTargetDecel_B1 0;
BA_ "Remark" SG_ 361 ADC_RCTBTargetDecel_B1 "";
BA_ "EventCommandSignal" SG_ 361 ADC_RCTBBrkReq_B1 0;
BA_ "GatewayedSignals" SG_ 361 ADC_RCTBBrkReq_B1 0;
BA_ "GenSigInactiveValue" SG_ 361 ADC_RCTBBrkReq_B1 0;
BA_ "GenSigInvalidValue" SG_ 361 ADC_RCTBBrkReq_B1 0;
BA_ "GenSigSendType" SG_ 361 ADC_RCTBBrkReq_B1 1;
BA_ "GenSigStartValue" SG_ 361 ADC_RCTBBrkReq_B1 0;
BA_ "GenSigTimeoutValue" SG_ 361 ADC_RCTBBrkReq_B1 0;
BA_ "Remark" SG_ 361 ADC_RCTBBrkReq_B1 "";
BA_ "EventCommandSignal" SG_ 361 ADC_BrkTarTqEna_B1 0;
BA_ "GatewayedSignals" SG_ 361 ADC_BrkTarTqEna_B1 0;
BA_ "GenSigInactiveValue" SG_ 361 ADC_BrkTarTqEna_B1 0;
BA_ "GenSigInvalidValue" SG_ 361 ADC_BrkTarTqEna_B1 0;
BA_ "GenSigSendType" SG_ 361 ADC_BrkTarTqEna_B1 1;
BA_ "GenSigStartValue" SG_ 361 ADC_BrkTarTqEna_B1 0;
BA_ "GenSigTimeoutValue" SG_ 361 ADC_BrkTarTqEna_B1 0;
BA_ "Remark" SG_ 361 ADC_BrkTarTqEna_B1 "";
BA_ "EventCommandSignal" SG_ 361 ADC_BrkTarTqMod_B1 0;
BA_ "GatewayedSignals" SG_ 361 ADC_BrkTarTqMod_B1 0;
BA_ "GenSigInactiveValue" SG_ 361 ADC_BrkTarTqMod_B1 0;
BA_ "GenSigInvalidValue" SG_ 361 ADC_BrkTarTqMod_B1 0;
BA_ "GenSigSendType" SG_ 361 ADC_BrkTarTqMod_B1 1;
BA_ "GenSigStartValue" SG_ 361 ADC_BrkTarTqMod_B1 0;
BA_ "GenSigTimeoutValue" SG_ 361 ADC_BrkTarTqMod_B1 0;
BA_ "Remark" SG_ 361 ADC_BrkTarTqMod_B1 "";
BA_ "EventCommandSignal" SG_ 361 ADC_AebBrkTarTq_B1 0;
BA_ "GatewayedSignals" SG_ 361 ADC_AebBrkTarTq_B1 0;
BA_ "GenSigInactiveValue" SG_ 361 ADC_AebBrkTarTq_B1 0;
BA_ "GenSigInvalidValue" SG_ 361 ADC_AebBrkTarTq_B1 0;
BA_ "GenSigSendType" SG_ 361 ADC_AebBrkTarTq_B1 1;
BA_ "GenSigStartValue" SG_ 361 ADC_AebBrkTarTq_B1 0;
BA_ "GenSigTimeoutValue" SG_ 361 ADC_AebBrkTarTq_B1 0;
BA_ "Remark" SG_ 361 ADC_AebBrkTarTq_B1 "";
BA_ "EventCommandSignal" SG_ 361 ADC_EpbModReqVld_B1 0;
BA_ "GatewayedSignals" SG_ 361 ADC_EpbModReqVld_B1 0;
BA_ "GenSigInactiveValue" SG_ 361 ADC_EpbModReqVld_B1 0;
BA_ "GenSigInvalidValue" SG_ 361 ADC_EpbModReqVld_B1 0;
BA_ "GenSigSendType" SG_ 361 ADC_EpbModReqVld_B1 1;
BA_ "GenSigStartValue" SG_ 361 ADC_EpbModReqVld_B1 0;
BA_ "GenSigTimeoutValue" SG_ 361 ADC_EpbModReqVld_B1 0;
BA_ "Remark" SG_ 361 ADC_EpbModReqVld_B1 "";
BA_ "EventCommandSignal" SG_ 361 ADC_RWUEna_B1 0;
BA_ "GatewayedSignals" SG_ 361 ADC_RWUEna_B1 0;
BA_ "GenSigInactiveValue" SG_ 361 ADC_RWUEna_B1 0;
BA_ "GenSigInvalidValue" SG_ 361 ADC_RWUEna_B1 0;
BA_ "GenSigSendType" SG_ 361 ADC_RWUEna_B1 1;
BA_ "GenSigStartValue" SG_ 361 ADC_RWUEna_B1 0;
BA_ "GenSigTimeoutValue" SG_ 361 ADC_RWUEna_B1 0;
BA_ "Remark" SG_ 361 ADC_RWUEna_B1 "";
BA_ "EventCommandSignal" SG_ 361 ADC_BrkHoldReq_B1 0;
BA_ "GatewayedSignals" SG_ 361 ADC_BrkHoldReq_B1 0;
BA_ "GenSigInactiveValue" SG_ 361 ADC_BrkHoldReq_B1 0;
BA_ "GenSigInvalidValue" SG_ 361 ADC_BrkHoldReq_B1 0;
BA_ "GenSigSendType" SG_ 361 ADC_BrkHoldReq_B1 1;
BA_ "GenSigStartValue" SG_ 361 ADC_BrkHoldReq_B1 0;
BA_ "GenSigTimeoutValue" SG_ 361 ADC_BrkHoldReq_B1 0;
BA_ "Remark" SG_ 361 ADC_BrkHoldReq_B1 "";
BA_ "EventCommandSignal" SG_ 361 ADC_AngReqAvl_B1 0;
BA_ "GatewayedSignals" SG_ 361 ADC_AngReqAvl_B1 0;
BA_ "GenSigInactiveValue" SG_ 361 ADC_AngReqAvl_B1 0;
BA_ "GenSigInvalidValue" SG_ 361 ADC_AngReqAvl_B1 0;
BA_ "GenSigSendType" SG_ 361 ADC_AngReqAvl_B1 1;
BA_ "GenSigStartValue" SG_ 361 ADC_AngReqAvl_B1 0;
BA_ "GenSigTimeoutValue" SG_ 361 ADC_AngReqAvl_B1 0;
BA_ "Remark" SG_ 361 ADC_AngReqAvl_B1 "";
BA_ "EventCommandSignal" SG_ 361 ADC_TarGearReqVld_B1 0;
BA_ "GatewayedSignals" SG_ 361 ADC_TarGearReqVld_B1 0;
BA_ "GenSigInactiveValue" SG_ 361 ADC_TarGearReqVld_B1 0;
BA_ "GenSigInvalidValue" SG_ 361 ADC_TarGearReqVld_B1 0;
BA_ "GenSigSendType" SG_ 361 ADC_TarGearReqVld_B1 1;
BA_ "GenSigStartValue" SG_ 361 ADC_TarGearReqVld_B1 0;
BA_ "GenSigTimeoutValue" SG_ 361 ADC_TarGearReqVld_B1 0;
BA_ "Remark" SG_ 361 ADC_TarGearReqVld_B1 "";
BA_ "EventCommandSignal" SG_ 361 ADC_FctSts_B1 0;
BA_ "GatewayedSignals" SG_ 361 ADC_FctSts_B1 0;
BA_ "GenSigInactiveValue" SG_ 361 ADC_FctSts_B1 0;
BA_ "GenSigInvalidValue" SG_ 361 ADC_FctSts_B1 0;
BA_ "GenSigSendType" SG_ 361 ADC_FctSts_B1 1;
BA_ "GenSigStartValue" SG_ 361 ADC_FctSts_B1 0;
BA_ "GenSigTimeoutValue" SG_ 361 ADC_FctSts_B1 0;
BA_ "Remark" SG_ 361 ADC_FctSts_B1 "";
BA_ "EventCommandSignal" SG_ 361 ADC_BrkTarTqVld_B1 0;
BA_ "GatewayedSignals" SG_ 361 ADC_BrkTarTqVld_B1 0;
BA_ "GenSigInactiveValue" SG_ 361 ADC_BrkTarTqVld_B1 0;
BA_ "GenSigInvalidValue" SG_ 361 ADC_BrkTarTqVld_B1 0;
BA_ "GenSigSendType" SG_ 361 ADC_BrkTarTqVld_B1 1;
BA_ "GenSigStartValue" SG_ 361 ADC_BrkTarTqVld_B1 0;
BA_ "GenSigTimeoutValue" SG_ 361 ADC_BrkTarTqVld_B1 0;
BA_ "Remark" SG_ 361 ADC_BrkTarTqVld_B1 "";
BA_ "EventCommandSignal" SG_ 361 ADC_AebBrkTarTqVld_B1 0;
BA_ "GatewayedSignals" SG_ 361 ADC_AebBrkTarTqVld_B1 0;
BA_ "GenSigInactiveValue" SG_ 361 ADC_AebBrkTarTqVld_B1 0;
BA_ "GenSigInvalidValue" SG_ 361 ADC_AebBrkTarTqVld_B1 0;
BA_ "GenSigSendType" SG_ 361 ADC_AebBrkTarTqVld_B1 1;
BA_ "GenSigStartValue" SG_ 361 ADC_AebBrkTarTqVld_B1 0;
BA_ "GenSigTimeoutValue" SG_ 361 ADC_AebBrkTarTqVld_B1 0;
BA_ "Remark" SG_ 361 ADC_AebBrkTarTqVld_B1 "";
BA_ "EventCommandSignal" SG_ 361 ADC_AebBrkTarTqEna_B1 0;
BA_ "GatewayedSignals" SG_ 361 ADC_AebBrkTarTqEna_B1 0;
BA_ "GenSigInactiveValue" SG_ 361 ADC_AebBrkTarTqEna_B1 0;
BA_ "GenSigInvalidValue" SG_ 361 ADC_AebBrkTarTqEna_B1 0;
BA_ "GenSigSendType" SG_ 361 ADC_AebBrkTarTqEna_B1 1;
BA_ "GenSigStartValue" SG_ 361 ADC_AebBrkTarTqEna_B1 0;
BA_ "GenSigTimeoutValue" SG_ 361 ADC_AebBrkTarTqEna_B1 0;
BA_ "Remark" SG_ 361 ADC_AebBrkTarTqEna_B1 "";
BA_ "EventCommandSignal" SG_ 361 ADC_ElecBrkFnSwitch_B1 0;
BA_ "GatewayedSignals" SG_ 361 ADC_ElecBrkFnSwitch_B1 0;
BA_ "GenSigInactiveValue" SG_ 361 ADC_ElecBrkFnSwitch_B1 0;
BA_ "GenSigInvalidValue" SG_ 361 ADC_ElecBrkFnSwitch_B1 0;
BA_ "GenSigSendType" SG_ 361 ADC_ElecBrkFnSwitch_B1 1;
BA_ "GenSigStartValue" SG_ 361 ADC_ElecBrkFnSwitch_B1 0;
BA_ "GenSigTimeoutValue" SG_ 361 ADC_ElecBrkFnSwitch_B1 0;
BA_ "Remark" SG_ 361 ADC_ElecBrkFnSwitch_B1 "";
BA_ "EventCommandSignal" SG_ 361 ADC_RWUVld_B1 0;
BA_ "GatewayedSignals" SG_ 361 ADC_RWUVld_B1 0;
BA_ "GenSigInactiveValue" SG_ 361 ADC_RWUVld_B1 0;
BA_ "GenSigInvalidValue" SG_ 361 ADC_RWUVld_B1 0;
BA_ "GenSigSendType" SG_ 361 ADC_RWUVld_B1 1;
BA_ "GenSigStartValue" SG_ 361 ADC_RWUVld_B1 0;
BA_ "GenSigTimeoutValue" SG_ 361 ADC_RWUVld_B1 0;
BA_ "Remark" SG_ 361 ADC_RWUVld_B1 "";
BA_ "EventCommandSignal" SG_ 361 ADC_DriverPresent_B1 0;
BA_ "GatewayedSignals" SG_ 361 ADC_DriverPresent_B1 0;
BA_ "GenSigInactiveValue" SG_ 361 ADC_DriverPresent_B1 0;
BA_ "GenSigInvalidValue" SG_ 361 ADC_DriverPresent_B1 0;
BA_ "GenSigSendType" SG_ 361 ADC_DriverPresent_B1 1;
BA_ "GenSigStartValue" SG_ 361 ADC_DriverPresent_B1 0;
BA_ "GenSigTimeoutValue" SG_ 361 ADC_DriverPresent_B1 0;
BA_ "Remark" SG_ 361 ADC_DriverPresent_B1 "";
BA_ "EventCommandSignal" SG_ 361 ADC_BrkTarTq_B1 0;
BA_ "GatewayedSignals" SG_ 361 ADC_BrkTarTq_B1 0;
BA_ "GenSigInactiveValue" SG_ 361 ADC_BrkTarTq_B1 0;
BA_ "GenSigInvalidValue" SG_ 361 ADC_BrkTarTq_B1 0;
BA_ "GenSigSendType" SG_ 361 ADC_BrkTarTq_B1 1;
BA_ "GenSigStartValue" SG_ 361 ADC_BrkTarTq_B1 0;
BA_ "GenSigTimeoutValue" SG_ 361 ADC_BrkTarTq_B1 0;
BA_ "Remark" SG_ 361 ADC_BrkTarTq_B1 "";
BA_ "EventCommandSignal" SG_ 371 ADC_13_B_CRC 0;
BA_ "GatewayedSignals" SG_ 371 ADC_13_B_CRC 0;
BA_ "GenSigInactiveValue" SG_ 371 ADC_13_B_CRC 0;
BA_ "GenSigInvalidValue" SG_ 371 ADC_13_B_CRC 0;
BA_ "GenSigSendType" SG_ 371 ADC_13_B_CRC 1;
BA_ "GenSigStartValue" SG_ 371 ADC_13_B_CRC 0;
BA_ "GenSigTimeoutValue" SG_ 371 ADC_13_B_CRC 0;
BA_ "Remark" SG_ 371 ADC_13_B_CRC "";
BA_ "EventCommandSignal" SG_ 371 ADC_13_B_Counter 0;
BA_ "GatewayedSignals" SG_ 371 ADC_13_B_Counter 0;
BA_ "GenSigInactiveValue" SG_ 371 ADC_13_B_Counter 0;
BA_ "GenSigInvalidValue" SG_ 371 ADC_13_B_Counter 0;
BA_ "GenSigSendType" SG_ 371 ADC_13_B_Counter 1;
BA_ "GenSigStartValue" SG_ 371 ADC_13_B_Counter 0;
BA_ "GenSigTimeoutValue" SG_ 371 ADC_13_B_Counter 0;
BA_ "Remark" SG_ 371 ADC_13_B_Counter "";
BA_ "EventCommandSignal" SG_ 371 ADC_TotalRefTorque 0;
BA_ "GatewayedSignals" SG_ 371 ADC_TotalRefTorque 0;
BA_ "GenSigInactiveValue" SG_ 371 ADC_TotalRefTorque 0;
BA_ "GenSigInvalidValue" SG_ 371 ADC_TotalRefTorque 0;
BA_ "GenSigSendType" SG_ 371 ADC_TotalRefTorque 1;
BA_ "GenSigStartValue" SG_ 371 ADC_TotalRefTorque 0;
BA_ "GenSigTimeoutValue" SG_ 371 ADC_TotalRefTorque 0;
BA_ "Remark" SG_ 371 ADC_TotalRefTorque "";
BA_ "EventCommandSignal" SG_ 371 ADC_MotTarSpd 0;
BA_ "GatewayedSignals" SG_ 371 ADC_MotTarSpd 0;
BA_ "GenSigInactiveValue" SG_ 371 ADC_MotTarSpd 0;
BA_ "GenSigInvalidValue" SG_ 371 ADC_MotTarSpd 0;
BA_ "GenSigSendType" SG_ 371 ADC_MotTarSpd 1;
BA_ "GenSigStartValue" SG_ 371 ADC_MotTarSpd 0;
BA_ "GenSigTimeoutValue" SG_ 371 ADC_MotTarSpd 0;
BA_ "Remark" SG_ 371 ADC_MotTarSpd "";
BA_ "EventCommandSignal" SG_ 371 ADC_DycEscTarTq 0;
BA_ "GatewayedSignals" SG_ 371 ADC_DycEscTarTq 0;
BA_ "GenSigInactiveValue" SG_ 371 ADC_DycEscTarTq 0;
BA_ "GenSigInvalidValue" SG_ 371 ADC_DycEscTarTq 0;
BA_ "GenSigSendType" SG_ 371 ADC_DycEscTarTq 1;
BA_ "GenSigStartValue" SG_ 371 ADC_DycEscTarTq 0;
BA_ "GenSigTimeoutValue" SG_ 371 ADC_DycEscTarTq 0;
BA_ "Remark" SG_ 371 ADC_DycEscTarTq "";
BA_ "EventCommandSignal" SG_ 371 ADC_DycEscTarTqfactor 0;
BA_ "GatewayedSignals" SG_ 371 ADC_DycEscTarTqfactor 0;
BA_ "GenSigInactiveValue" SG_ 371 ADC_DycEscTarTqfactor 0;
BA_ "GenSigInvalidValue" SG_ 371 ADC_DycEscTarTqfactor 0;
BA_ "GenSigSendType" SG_ 371 ADC_DycEscTarTqfactor 1;
BA_ "GenSigStartValue" SG_ 371 ADC_DycEscTarTqfactor 0;
BA_ "GenSigTimeoutValue" SG_ 371 ADC_DycEscTarTqfactor 0;
BA_ "Remark" SG_ 371 ADC_DycEscTarTqfactor "";
BA_ "EventCommandSignal" SG_ 371 ADC_SteerTqReq 0;
BA_ "GatewayedSignals" SG_ 371 ADC_SteerTqReq 0;
BA_ "GenSigInactiveValue" SG_ 371 ADC_SteerTqReq 0;
BA_ "GenSigInvalidValue" SG_ 371 ADC_SteerTqReq 4095;
BA_ "GenSigSendType" SG_ 371 ADC_SteerTqReq 1;
BA_ "GenSigStartValue" SG_ 371 ADC_SteerTqReq 2000;
BA_ "GenSigTimeoutValue" SG_ 371 ADC_SteerTqReq 4095;
BA_ "Remark" SG_ 371 ADC_SteerTqReq "";
BA_ "EventCommandSignal" SG_ 371 ADC_LimTqFactorK 0;
BA_ "GatewayedSignals" SG_ 371 ADC_LimTqFactorK 0;
BA_ "GenSigInactiveValue" SG_ 371 ADC_LimTqFactorK 0;
BA_ "GenSigInvalidValue" SG_ 371 ADC_LimTqFactorK 0;
BA_ "GenSigSendType" SG_ 371 ADC_LimTqFactorK 1;
BA_ "GenSigStartValue" SG_ 371 ADC_LimTqFactorK 0;
BA_ "GenSigTimeoutValue" SG_ 371 ADC_LimTqFactorK 0;
BA_ "Remark" SG_ 371 ADC_LimTqFactorK "";
BA_ "EventCommandSignal" SG_ 371 ADC_MotTqLimMin 0;
BA_ "GatewayedSignals" SG_ 371 ADC_MotTqLimMin 0;
BA_ "GenSigInactiveValue" SG_ 371 ADC_MotTqLimMin 0;
BA_ "GenSigInvalidValue" SG_ 371 ADC_MotTqLimMin 0;
BA_ "GenSigSendType" SG_ 371 ADC_MotTqLimMin 1;
BA_ "GenSigStartValue" SG_ 371 ADC_MotTqLimMin 0;
BA_ "GenSigTimeoutValue" SG_ 371 ADC_MotTqLimMin 0;
BA_ "Remark" SG_ 371 ADC_MotTqLimMin "";
BA_ "EventCommandSignal" SG_ 371 ADC_MotTqLimMax 0;
BA_ "GatewayedSignals" SG_ 371 ADC_MotTqLimMax 0;
BA_ "GenSigInactiveValue" SG_ 371 ADC_MotTqLimMax 0;
BA_ "GenSigInvalidValue" SG_ 371 ADC_MotTqLimMax 0;
BA_ "GenSigSendType" SG_ 371 ADC_MotTqLimMax 1;
BA_ "GenSigStartValue" SG_ 371 ADC_MotTqLimMax 0;
BA_ "GenSigTimeoutValue" SG_ 371 ADC_MotTqLimMax 0;
BA_ "Remark" SG_ 371 ADC_MotTqLimMax "";
BA_ "EventCommandSignal" SG_ 371 ADC_MotTqRateLimMin 0;
BA_ "GatewayedSignals" SG_ 371 ADC_MotTqRateLimMin 0;
BA_ "GenSigInactiveValue" SG_ 371 ADC_MotTqRateLimMin 0;
BA_ "GenSigInvalidValue" SG_ 371 ADC_MotTqRateLimMin 0;
BA_ "GenSigSendType" SG_ 371 ADC_MotTqRateLimMin 1;
BA_ "GenSigStartValue" SG_ 371 ADC_MotTqRateLimMin 0;
BA_ "GenSigTimeoutValue" SG_ 371 ADC_MotTqRateLimMin 0;
BA_ "Remark" SG_ 371 ADC_MotTqRateLimMin "";
BA_ "EventCommandSignal" SG_ 371 ADC_MotTqRateLimMax 0;
BA_ "GatewayedSignals" SG_ 371 ADC_MotTqRateLimMax 0;
BA_ "GenSigInactiveValue" SG_ 371 ADC_MotTqRateLimMax 0;
BA_ "GenSigInvalidValue" SG_ 371 ADC_MotTqRateLimMax 0;
BA_ "GenSigSendType" SG_ 371 ADC_MotTqRateLimMax 1;
BA_ "GenSigStartValue" SG_ 371 ADC_MotTqRateLimMax 0;
BA_ "GenSigTimeoutValue" SG_ 371 ADC_MotTqRateLimMax 0;
BA_ "Remark" SG_ 371 ADC_MotTqRateLimMax "";
BA_ "EventCommandSignal" SG_ 371 ADC_TqUnloadRate 0;
BA_ "GatewayedSignals" SG_ 371 ADC_TqUnloadRate 0;
BA_ "GenSigInactiveValue" SG_ 371 ADC_TqUnloadRate 0;
BA_ "GenSigInvalidValue" SG_ 371 ADC_TqUnloadRate 0;
BA_ "GenSigSendType" SG_ 371 ADC_TqUnloadRate 1;
BA_ "GenSigStartValue" SG_ 371 ADC_TqUnloadRate 0;
BA_ "GenSigTimeoutValue" SG_ 371 ADC_TqUnloadRate 0;
BA_ "Remark" SG_ 371 ADC_TqUnloadRate "";
BA_ "EventCommandSignal" SG_ 371 ADC_MotCtrlTar 0;
BA_ "GatewayedSignals" SG_ 371 ADC_MotCtrlTar 0;
BA_ "GenSigInactiveValue" SG_ 371 ADC_MotCtrlTar 0;
BA_ "GenSigInvalidValue" SG_ 371 ADC_MotCtrlTar 0;
BA_ "GenSigSendType" SG_ 371 ADC_MotCtrlTar 1;
BA_ "GenSigStartValue" SG_ 371 ADC_MotCtrlTar 0;
BA_ "GenSigTimeoutValue" SG_ 371 ADC_MotCtrlTar 0;
BA_ "Remark" SG_ 371 ADC_MotCtrlTar "";
BA_ "EventCommandSignal" SG_ 371 ADC_MotTarMod 0;
BA_ "GatewayedSignals" SG_ 371 ADC_MotTarMod 0;
BA_ "GenSigInactiveValue" SG_ 371 ADC_MotTarMod 0;
BA_ "GenSigInvalidValue" SG_ 371 ADC_MotTarMod 0;
BA_ "GenSigSendType" SG_ 371 ADC_MotTarMod 1;
BA_ "GenSigStartValue" SG_ 371 ADC_MotTarMod 0;
BA_ "GenSigTimeoutValue" SG_ 371 ADC_MotTarMod 0;
BA_ "Remark" SG_ 371 ADC_MotTarMod "";
BA_ "EventCommandSignal" SG_ 371 ADC_SteerTqSt 0;
BA_ "GatewayedSignals" SG_ 371 ADC_SteerTqSt 0;
BA_ "GenSigInactiveValue" SG_ 371 ADC_SteerTqSt 0;
BA_ "GenSigInvalidValue" SG_ 371 ADC_SteerTqSt 0;
BA_ "GenSigSendType" SG_ 371 ADC_SteerTqSt 1;
BA_ "GenSigStartValue" SG_ 371 ADC_SteerTqSt 0;
BA_ "GenSigTimeoutValue" SG_ 371 ADC_SteerTqSt 0;
BA_ "Remark" SG_ 371 ADC_SteerTqSt "";
BA_ "EventCommandSignal" SG_ 371 ADC_DrvTarTqMod 0;
BA_ "GatewayedSignals" SG_ 371 ADC_DrvTarTqMod 0;
BA_ "GenSigInactiveValue" SG_ 371 ADC_DrvTarTqMod 0;
BA_ "GenSigInvalidValue" SG_ 371 ADC_DrvTarTqMod 0;
BA_ "GenSigSendType" SG_ 371 ADC_DrvTarTqMod 1;
BA_ "GenSigStartValue" SG_ 371 ADC_DrvTarTqMod 0;
BA_ "GenSigTimeoutValue" SG_ 371 ADC_DrvTarTqMod 0;
BA_ "Remark" SG_ 371 ADC_DrvTarTqMod "";
BA_ "EventCommandSignal" SG_ 371 ADC_TqEvsSteerReq 0;
BA_ "GatewayedSignals" SG_ 371 ADC_TqEvsSteerReq 0;
BA_ "GenSigInactiveValue" SG_ 371 ADC_TqEvsSteerReq 0;
BA_ "GenSigInvalidValue" SG_ 371 ADC_TqEvsSteerReq 0;
BA_ "GenSigSendType" SG_ 371 ADC_TqEvsSteerReq 1;
BA_ "GenSigStartValue" SG_ 371 ADC_TqEvsSteerReq 0;
BA_ "GenSigTimeoutValue" SG_ 371 ADC_TqEvsSteerReq 0;
BA_ "Remark" SG_ 371 ADC_TqEvsSteerReq "";
BA_ "EventCommandSignal" SG_ 371 ADC_SteerTqAvl 0;
BA_ "GatewayedSignals" SG_ 371 ADC_SteerTqAvl 0;
BA_ "GenSigInactiveValue" SG_ 371 ADC_SteerTqAvl 0;
BA_ "GenSigInvalidValue" SG_ 371 ADC_SteerTqAvl 0;
BA_ "GenSigSendType" SG_ 371 ADC_SteerTqAvl 1;
BA_ "GenSigStartValue" SG_ 371 ADC_SteerTqAvl 0;
BA_ "GenSigTimeoutValue" SG_ 371 ADC_SteerTqAvl 0;
BA_ "Remark" SG_ 371 ADC_SteerTqAvl "";
BA_ "EventCommandSignal" SG_ 371 ADC_RapidRespEna 0;
BA_ "GatewayedSignals" SG_ 371 ADC_RapidRespEna 0;
BA_ "GenSigInactiveValue" SG_ 371 ADC_RapidRespEna 0;
BA_ "GenSigInvalidValue" SG_ 371 ADC_RapidRespEna 0;
BA_ "GenSigSendType" SG_ 371 ADC_RapidRespEna 1;
BA_ "GenSigStartValue" SG_ 371 ADC_RapidRespEna 0;
BA_ "GenSigTimeoutValue" SG_ 371 ADC_RapidRespEna 0;
BA_ "Remark" SG_ 371 ADC_RapidRespEna "";
BA_ "EventCommandSignal" SG_ 371 ADC_LimTqEnable 0;
BA_ "GatewayedSignals" SG_ 371 ADC_LimTqEnable 0;
BA_ "GenSigInactiveValue" SG_ 371 ADC_LimTqEnable 0;
BA_ "GenSigInvalidValue" SG_ 371 ADC_LimTqEnable 0;
BA_ "GenSigSendType" SG_ 371 ADC_LimTqEnable 1;
BA_ "GenSigStartValue" SG_ 371 ADC_LimTqEnable 0;
BA_ "GenSigTimeoutValue" SG_ 371 ADC_LimTqEnable 0;
BA_ "Remark" SG_ 371 ADC_LimTqEnable "";
BA_ "EventCommandSignal" SG_ 371 ADC_MotSpdCtrlEna 0;
BA_ "GatewayedSignals" SG_ 371 ADC_MotSpdCtrlEna 0;
BA_ "GenSigInactiveValue" SG_ 371 ADC_MotSpdCtrlEna 0;
BA_ "GenSigInvalidValue" SG_ 371 ADC_MotSpdCtrlEna 0;
BA_ "GenSigSendType" SG_ 371 ADC_MotSpdCtrlEna 1;
BA_ "GenSigStartValue" SG_ 371 ADC_MotSpdCtrlEna 0;
BA_ "GenSigTimeoutValue" SG_ 371 ADC_MotSpdCtrlEna 0;
BA_ "Remark" SG_ 371 ADC_MotSpdCtrlEna "";
BA_ "EventCommandSignal" SG_ 371 ADC_TqUnloadEna 0;
BA_ "GatewayedSignals" SG_ 371 ADC_TqUnloadEna 0;
BA_ "GenSigInactiveValue" SG_ 371 ADC_TqUnloadEna 0;
BA_ "GenSigInvalidValue" SG_ 371 ADC_TqUnloadEna 0;
BA_ "GenSigSendType" SG_ 371 ADC_TqUnloadEna 1;
BA_ "GenSigStartValue" SG_ 371 ADC_TqUnloadEna 0;
BA_ "GenSigTimeoutValue" SG_ 371 ADC_TqUnloadEna 0;
BA_ "Remark" SG_ 371 ADC_TqUnloadEna "";
BA_ "EventCommandSignal" SG_ 371 ADC_MotTarSpdSvValid 0;
BA_ "GatewayedSignals" SG_ 371 ADC_MotTarSpdSvValid 0;
BA_ "GenSigInactiveValue" SG_ 371 ADC_MotTarSpdSvValid 0;
BA_ "GenSigInvalidValue" SG_ 371 ADC_MotTarSpdSvValid 0;
BA_ "GenSigSendType" SG_ 371 ADC_MotTarSpdSvValid 1;
BA_ "GenSigStartValue" SG_ 371 ADC_MotTarSpdSvValid 0;
BA_ "GenSigTimeoutValue" SG_ 371 ADC_MotTarSpdSvValid 0;
BA_ "Remark" SG_ 371 ADC_MotTarSpdSvValid "";
BA_ "EventCommandSignal" SG_ 371 ADC_DycEscTarTqVld 0;
BA_ "GatewayedSignals" SG_ 371 ADC_DycEscTarTqVld 0;
BA_ "GenSigInactiveValue" SG_ 371 ADC_DycEscTarTqVld 0;
BA_ "GenSigInvalidValue" SG_ 371 ADC_DycEscTarTqVld 0;
BA_ "GenSigSendType" SG_ 371 ADC_DycEscTarTqVld 1;
BA_ "GenSigStartValue" SG_ 371 ADC_DycEscTarTqVld 0;
BA_ "GenSigTimeoutValue" SG_ 371 ADC_DycEscTarTqVld 0;
BA_ "Remark" SG_ 371 ADC_DycEscTarTqVld "";
BA_ "EventCommandSignal" SG_ 371 ADC_DycEscTarTqEna 0;
BA_ "GatewayedSignals" SG_ 371 ADC_DycEscTarTqEna 0;
BA_ "GenSigInactiveValue" SG_ 371 ADC_DycEscTarTqEna 0;
BA_ "GenSigInvalidValue" SG_ 371 ADC_DycEscTarTqEna 0;
BA_ "GenSigSendType" SG_ 371 ADC_DycEscTarTqEna 1;
BA_ "GenSigStartValue" SG_ 371 ADC_DycEscTarTqEna 0;
BA_ "GenSigTimeoutValue" SG_ 371 ADC_DycEscTarTqEna 0;
BA_ "Remark" SG_ 371 ADC_DycEscTarTqEna "";
BA_ "EventCommandSignal" SG_ 371 ADC_RoadTyp 0;
BA_ "GatewayedSignals" SG_ 371 ADC_RoadTyp 0;
BA_ "GenSigInactiveValue" SG_ 371 ADC_RoadTyp 0;
BA_ "GenSigInvalidValue" SG_ 371 ADC_RoadTyp 7;
BA_ "GenSigSendType" SG_ 371 ADC_RoadTyp 1;
BA_ "GenSigStartValue" SG_ 371 ADC_RoadTyp 0;
BA_ "GenSigTimeoutValue" SG_ 371 ADC_RoadTyp 0;
BA_ "Remark" SG_ 371 ADC_RoadTyp "";
BA_ "EventCommandSignal" SG_ 371 ADC_LeWhlLgtDst 0;
BA_ "GatewayedSignals" SG_ 371 ADC_LeWhlLgtDst 0;
BA_ "GenSigInactiveValue" SG_ 371 ADC_LeWhlLgtDst 0;
BA_ "GenSigInvalidValue" SG_ 371 ADC_LeWhlLgtDst 0;
BA_ "GenSigSendType" SG_ 371 ADC_LeWhlLgtDst 1;
BA_ "GenSigStartValue" SG_ 371 ADC_LeWhlLgtDst 0;
BA_ "GenSigTimeoutValue" SG_ 371 ADC_LeWhlLgtDst 0;
BA_ "Remark" SG_ 371 ADC_LeWhlLgtDst "";
BA_ "EventCommandSignal" SG_ 371 ADC_LeWhlRoadHei 0;
BA_ "GatewayedSignals" SG_ 371 ADC_LeWhlRoadHei 0;
BA_ "GenSigInactiveValue" SG_ 371 ADC_LeWhlRoadHei 0;
BA_ "GenSigInvalidValue" SG_ 371 ADC_LeWhlRoadHei 0;
BA_ "GenSigSendType" SG_ 371 ADC_LeWhlRoadHei 1;
BA_ "GenSigStartValue" SG_ 371 ADC_LeWhlRoadHei 500;
BA_ "GenSigTimeoutValue" SG_ 371 ADC_LeWhlRoadHei 0;
BA_ "Remark" SG_ 371 ADC_LeWhlRoadHei "";
BA_ "EventCommandSignal" SG_ 371 ADC_RiWhlLgtDst 0;
BA_ "GatewayedSignals" SG_ 371 ADC_RiWhlLgtDst 0;
BA_ "GenSigInactiveValue" SG_ 371 ADC_RiWhlLgtDst 0;
BA_ "GenSigInvalidValue" SG_ 371 ADC_RiWhlLgtDst 0;
BA_ "GenSigSendType" SG_ 371 ADC_RiWhlLgtDst 1;
BA_ "GenSigStartValue" SG_ 371 ADC_RiWhlLgtDst 0;
BA_ "GenSigTimeoutValue" SG_ 371 ADC_RiWhlLgtDst 0;
BA_ "Remark" SG_ 371 ADC_RiWhlLgtDst "";
BA_ "EventCommandSignal" SG_ 371 ADC_RiWhlRoadHei 0;
BA_ "GatewayedSignals" SG_ 371 ADC_RiWhlRoadHei 0;
BA_ "GenSigInactiveValue" SG_ 371 ADC_RiWhlRoadHei 0;
BA_ "GenSigInvalidValue" SG_ 371 ADC_RiWhlRoadHei 0;
BA_ "GenSigSendType" SG_ 371 ADC_RiWhlRoadHei 1;
BA_ "GenSigStartValue" SG_ 371 ADC_RiWhlRoadHei 500;
BA_ "GenSigTimeoutValue" SG_ 371 ADC_RiWhlRoadHei 0;
BA_ "Remark" SG_ 371 ADC_RiWhlRoadHei "";
BA_ "EventCommandSignal" SG_ 371 ADC_RiWhlRoadFeature 0;
BA_ "GatewayedSignals" SG_ 371 ADC_RiWhlRoadFeature 0;
BA_ "GenSigInactiveValue" SG_ 371 ADC_RiWhlRoadFeature 0;
BA_ "GenSigInvalidValue" SG_ 371 ADC_RiWhlRoadFeature 15;
BA_ "GenSigSendType" SG_ 371 ADC_RiWhlRoadFeature 1;
BA_ "GenSigStartValue" SG_ 371 ADC_RiWhlRoadFeature 0;
BA_ "GenSigTimeoutValue" SG_ 371 ADC_RiWhlRoadFeature 0;
BA_ "Remark" SG_ 371 ADC_RiWhlRoadFeature "";
BA_ "EventCommandSignal" SG_ 371 ADC_SuspensionStatus 0;
BA_ "GatewayedSignals" SG_ 371 ADC_SuspensionStatus 0;
BA_ "GenSigInactiveValue" SG_ 371 ADC_SuspensionStatus 0;
BA_ "GenSigInvalidValue" SG_ 371 ADC_SuspensionStatus 0;
BA_ "GenSigSendType" SG_ 371 ADC_SuspensionStatus 1;
BA_ "GenSigStartValue" SG_ 371 ADC_SuspensionStatus 0;
BA_ "GenSigTimeoutValue" SG_ 371 ADC_SuspensionStatus 0;
BA_ "Remark" SG_ 371 ADC_SuspensionStatus "";
BA_ "EventCommandSignal" SG_ 371 ADC_LeWhlRoadSts 0;
BA_ "GatewayedSignals" SG_ 371 ADC_LeWhlRoadSts 0;
BA_ "GenSigInactiveValue" SG_ 371 ADC_LeWhlRoadSts 0;
BA_ "GenSigInvalidValue" SG_ 371 ADC_LeWhlRoadSts 0;
BA_ "GenSigSendType" SG_ 371 ADC_LeWhlRoadSts 1;
BA_ "GenSigStartValue" SG_ 371 ADC_LeWhlRoadSts 0;
BA_ "GenSigTimeoutValue" SG_ 371 ADC_LeWhlRoadSts 0;
BA_ "Remark" SG_ 371 ADC_LeWhlRoadSts "";
BA_ "EventCommandSignal" SG_ 371 ADC_LeWhlRoadFeature 0;
BA_ "GatewayedSignals" SG_ 371 ADC_LeWhlRoadFeature 0;
BA_ "GenSigInactiveValue" SG_ 371 ADC_LeWhlRoadFeature 0;
BA_ "GenSigInvalidValue" SG_ 371 ADC_LeWhlRoadFeature 15;
BA_ "GenSigSendType" SG_ 371 ADC_LeWhlRoadFeature 1;
BA_ "GenSigStartValue" SG_ 371 ADC_LeWhlRoadFeature 0;
BA_ "GenSigTimeoutValue" SG_ 371 ADC_LeWhlRoadFeature 0;
BA_ "Remark" SG_ 371 ADC_LeWhlRoadFeature "";
BA_ "EventCommandSignal" SG_ 371 ADC_RiWhlRoadSts 0;
BA_ "GatewayedSignals" SG_ 371 ADC_RiWhlRoadSts 0;
BA_ "GenSigInactiveValue" SG_ 371 ADC_RiWhlRoadSts 0;
BA_ "GenSigInvalidValue" SG_ 371 ADC_RiWhlRoadSts 0;
BA_ "GenSigSendType" SG_ 371 ADC_RiWhlRoadSts 1;
BA_ "GenSigStartValue" SG_ 371 ADC_RiWhlRoadSts 0;
BA_ "GenSigTimeoutValue" SG_ 371 ADC_RiWhlRoadSts 0;
BA_ "Remark" SG_ 371 ADC_RiWhlRoadSts "";
BA_ "EventCommandSignal" SG_ 371 ADC_CDCCtrlEnable 0;
BA_ "GatewayedSignals" SG_ 371 ADC_CDCCtrlEnable 0;
BA_ "GenSigInactiveValue" SG_ 371 ADC_CDCCtrlEnable 0;
BA_ "GenSigInvalidValue" SG_ 371 ADC_CDCCtrlEnable 0;
BA_ "GenSigSendType" SG_ 371 ADC_CDCCtrlEnable 1;
BA_ "GenSigStartValue" SG_ 371 ADC_CDCCtrlEnable 0;
BA_ "GenSigTimeoutValue" SG_ 371 ADC_CDCCtrlEnable 0;
BA_ "Remark" SG_ 371 ADC_CDCCtrlEnable "";
BA_ "EventCommandSignal" SG_ 371 ADC_RoadInfoAvl 0;
BA_ "GatewayedSignals" SG_ 371 ADC_RoadInfoAvl 0;
BA_ "GenSigInactiveValue" SG_ 371 ADC_RoadInfoAvl 0;
BA_ "GenSigInvalidValue" SG_ 371 ADC_RoadInfoAvl 0;
BA_ "GenSigSendType" SG_ 371 ADC_RoadInfoAvl 1;
BA_ "GenSigStartValue" SG_ 371 ADC_RoadInfoAvl 0;
BA_ "GenSigTimeoutValue" SG_ 371 ADC_RoadInfoAvl 0;
BA_ "Remark" SG_ 371 ADC_RoadInfoAvl "";
BA_ "EventCommandSignal" SG_ 371 ADC_RoadFeatureDetFalutSts 0;
BA_ "GatewayedSignals" SG_ 371 ADC_RoadFeatureDetFalutSts 0;
BA_ "GenSigInactiveValue" SG_ 371 ADC_RoadFeatureDetFalutSts 0;
BA_ "GenSigInvalidValue" SG_ 371 ADC_RoadFeatureDetFalutSts 0;
BA_ "GenSigSendType" SG_ 371 ADC_RoadFeatureDetFalutSts 1;
BA_ "GenSigStartValue" SG_ 371 ADC_RoadFeatureDetFalutSts 0;
BA_ "GenSigTimeoutValue" SG_ 371 ADC_RoadFeatureDetFalutSts 1;
BA_ "Remark" SG_ 371 ADC_RoadFeatureDetFalutSts "";
BA_ "EventCommandSignal" SG_ 371 ADC_RoadFeatureDetWorkSts 0;
BA_ "GatewayedSignals" SG_ 371 ADC_RoadFeatureDetWorkSts 0;
BA_ "GenSigInactiveValue" SG_ 371 ADC_RoadFeatureDetWorkSts 0;
BA_ "GenSigInvalidValue" SG_ 371 ADC_RoadFeatureDetWorkSts 0;
BA_ "GenSigSendType" SG_ 371 ADC_RoadFeatureDetWorkSts 1;
BA_ "GenSigStartValue" SG_ 371 ADC_RoadFeatureDetWorkSts 0;
BA_ "GenSigTimeoutValue" SG_ 371 ADC_RoadFeatureDetWorkSts 0;
BA_ "Remark" SG_ 371 ADC_RoadFeatureDetWorkSts "";
BA_ "EventCommandSignal" SG_ 371 ADC_LeWhlRoadFeature2 0;
BA_ "GatewayedSignals" SG_ 371 ADC_LeWhlRoadFeature2 0;
BA_ "GenSigInactiveValue" SG_ 371 ADC_LeWhlRoadFeature2 0;
BA_ "GenSigInvalidValue" SG_ 371 ADC_LeWhlRoadFeature2 15;
BA_ "GenSigSendType" SG_ 371 ADC_LeWhlRoadFeature2 1;
BA_ "GenSigStartValue" SG_ 371 ADC_LeWhlRoadFeature2 0;
BA_ "GenSigTimeoutValue" SG_ 371 ADC_LeWhlRoadFeature2 0;
BA_ "Remark" SG_ 371 ADC_LeWhlRoadFeature2 "";
BA_ "EventCommandSignal" SG_ 371 ADC_LeWhlRoadFeature3 0;
BA_ "GatewayedSignals" SG_ 371 ADC_LeWhlRoadFeature3 0;
BA_ "GenSigInactiveValue" SG_ 371 ADC_LeWhlRoadFeature3 0;
BA_ "GenSigInvalidValue" SG_ 371 ADC_LeWhlRoadFeature3 15;
BA_ "GenSigSendType" SG_ 371 ADC_LeWhlRoadFeature3 1;
BA_ "GenSigStartValue" SG_ 371 ADC_LeWhlRoadFeature3 0;
BA_ "GenSigTimeoutValue" SG_ 371 ADC_LeWhlRoadFeature3 0;
BA_ "Remark" SG_ 371 ADC_LeWhlRoadFeature3 "";
BA_ "EventCommandSignal" SG_ 371 ADC_RiWhlRoadFeature2 0;
BA_ "GatewayedSignals" SG_ 371 ADC_RiWhlRoadFeature2 0;
BA_ "GenSigInactiveValue" SG_ 371 ADC_RiWhlRoadFeature2 0;
BA_ "GenSigInvalidValue" SG_ 371 ADC_RiWhlRoadFeature2 15;
BA_ "GenSigSendType" SG_ 371 ADC_RiWhlRoadFeature2 1;
BA_ "GenSigStartValue" SG_ 371 ADC_RiWhlRoadFeature2 0;
BA_ "GenSigTimeoutValue" SG_ 371 ADC_RiWhlRoadFeature2 0;
BA_ "Remark" SG_ 371 ADC_RiWhlRoadFeature2 "";
BA_ "EventCommandSignal" SG_ 371 ADC_RiWhlRoadFeature3 0;
BA_ "GatewayedSignals" SG_ 371 ADC_RiWhlRoadFeature3 0;
BA_ "GenSigInactiveValue" SG_ 371 ADC_RiWhlRoadFeature3 0;
BA_ "GenSigInvalidValue" SG_ 371 ADC_RiWhlRoadFeature3 15;
BA_ "GenSigSendType" SG_ 371 ADC_RiWhlRoadFeature3 1;
BA_ "GenSigStartValue" SG_ 371 ADC_RiWhlRoadFeature3 0;
BA_ "GenSigTimeoutValue" SG_ 371 ADC_RiWhlRoadFeature3 0;
BA_ "Remark" SG_ 371 ADC_RiWhlRoadFeature3 "";
BA_ "EventCommandSignal" SG_ 371 ADC_LeWhlRoadHei2 0;
BA_ "GatewayedSignals" SG_ 371 ADC_LeWhlRoadHei2 0;
BA_ "GenSigInactiveValue" SG_ 371 ADC_LeWhlRoadHei2 0;
BA_ "GenSigInvalidValue" SG_ 371 ADC_LeWhlRoadHei2 0;
BA_ "GenSigSendType" SG_ 371 ADC_LeWhlRoadHei2 1;
BA_ "GenSigStartValue" SG_ 371 ADC_LeWhlRoadHei2 0;
BA_ "GenSigTimeoutValue" SG_ 371 ADC_LeWhlRoadHei2 0;
BA_ "Remark" SG_ 371 ADC_LeWhlRoadHei2 "";
BA_ "EventCommandSignal" SG_ 371 ADC_LeWhlRoadHei3 0;
BA_ "GatewayedSignals" SG_ 371 ADC_LeWhlRoadHei3 0;
BA_ "GenSigInactiveValue" SG_ 371 ADC_LeWhlRoadHei3 0;
BA_ "GenSigInvalidValue" SG_ 371 ADC_LeWhlRoadHei3 0;
BA_ "GenSigSendType" SG_ 371 ADC_LeWhlRoadHei3 1;
BA_ "GenSigStartValue" SG_ 371 ADC_LeWhlRoadHei3 0;
BA_ "GenSigTimeoutValue" SG_ 371 ADC_LeWhlRoadHei3 0;
BA_ "Remark" SG_ 371 ADC_LeWhlRoadHei3 "";
BA_ "EventCommandSignal" SG_ 371 ADC_RiWhlRoadHei2 0;
BA_ "GatewayedSignals" SG_ 371 ADC_RiWhlRoadHei2 0;
BA_ "GenSigInactiveValue" SG_ 371 ADC_RiWhlRoadHei2 0;
BA_ "GenSigInvalidValue" SG_ 371 ADC_RiWhlRoadHei2 0;
BA_ "GenSigSendType" SG_ 371 ADC_RiWhlRoadHei2 1;
BA_ "GenSigStartValue" SG_ 371 ADC_RiWhlRoadHei2 0;
BA_ "GenSigTimeoutValue" SG_ 371 ADC_RiWhlRoadHei2 0;
BA_ "Remark" SG_ 371 ADC_RiWhlRoadHei2 "";
BA_ "EventCommandSignal" SG_ 371 ADC_RiWhlRoadHei3 0;
BA_ "GatewayedSignals" SG_ 371 ADC_RiWhlRoadHei3 0;
BA_ "GenSigInactiveValue" SG_ 371 ADC_RiWhlRoadHei3 0;
BA_ "GenSigInvalidValue" SG_ 371 ADC_RiWhlRoadHei3 0;
BA_ "GenSigSendType" SG_ 371 ADC_RiWhlRoadHei3 1;
BA_ "GenSigStartValue" SG_ 371 ADC_RiWhlRoadHei3 0;
BA_ "GenSigTimeoutValue" SG_ 371 ADC_RiWhlRoadHei3 0;
BA_ "Remark" SG_ 371 ADC_RiWhlRoadHei3 "";
BA_ "EventCommandSignal" SG_ 371 ADC_LeWhlLgtDst2 0;
BA_ "GatewayedSignals" SG_ 371 ADC_LeWhlLgtDst2 0;
BA_ "GenSigInactiveValue" SG_ 371 ADC_LeWhlLgtDst2 0;
BA_ "GenSigInvalidValue" SG_ 371 ADC_LeWhlLgtDst2 63;
BA_ "GenSigSendType" SG_ 371 ADC_LeWhlLgtDst2 1;
BA_ "GenSigStartValue" SG_ 371 ADC_LeWhlLgtDst2 63;
BA_ "GenSigTimeoutValue" SG_ 371 ADC_LeWhlLgtDst2 63;
BA_ "Remark" SG_ 371 ADC_LeWhlLgtDst2 "";
BA_ "EventCommandSignal" SG_ 371 ADC_LeWhlLgtDst3 0;
BA_ "GatewayedSignals" SG_ 371 ADC_LeWhlLgtDst3 0;
BA_ "GenSigInactiveValue" SG_ 371 ADC_LeWhlLgtDst3 0;
BA_ "GenSigInvalidValue" SG_ 371 ADC_LeWhlLgtDst3 63;
BA_ "GenSigSendType" SG_ 371 ADC_LeWhlLgtDst3 1;
BA_ "GenSigStartValue" SG_ 371 ADC_LeWhlLgtDst3 63;
BA_ "GenSigTimeoutValue" SG_ 371 ADC_LeWhlLgtDst3 63;
BA_ "Remark" SG_ 371 ADC_LeWhlLgtDst3 "";
BA_ "EventCommandSignal" SG_ 371 ADC_RiWhlLgtDst2 0;
BA_ "GatewayedSignals" SG_ 371 ADC_RiWhlLgtDst2 0;
BA_ "GenSigInactiveValue" SG_ 371 ADC_RiWhlLgtDst2 0;
BA_ "GenSigInvalidValue" SG_ 371 ADC_RiWhlLgtDst2 63;
BA_ "GenSigSendType" SG_ 371 ADC_RiWhlLgtDst2 1;
BA_ "GenSigStartValue" SG_ 371 ADC_RiWhlLgtDst2 63;
BA_ "GenSigTimeoutValue" SG_ 371 ADC_RiWhlLgtDst2 63;
BA_ "Remark" SG_ 371 ADC_RiWhlLgtDst2 "";
BA_ "EventCommandSignal" SG_ 371 ADC_RiWhlLgtDst3 0;
BA_ "GatewayedSignals" SG_ 371 ADC_RiWhlLgtDst3 0;
BA_ "GenSigInactiveValue" SG_ 371 ADC_RiWhlLgtDst3 0;
BA_ "GenSigInvalidValue" SG_ 371 ADC_RiWhlLgtDst3 63;
BA_ "GenSigSendType" SG_ 371 ADC_RiWhlLgtDst3 1;
BA_ "GenSigStartValue" SG_ 371 ADC_RiWhlLgtDst3 63;
BA_ "GenSigTimeoutValue" SG_ 371 ADC_RiWhlLgtDst3 63;
BA_ "Remark" SG_ 371 ADC_RiWhlLgtDst3 "";
BA_ "EventCommandSignal" SG_ 371 ADC_AS_SuspHeiAdj 0;
BA_ "GatewayedSignals" SG_ 371 ADC_AS_SuspHeiAdj 0;
BA_ "GenSigInactiveValue" SG_ 371 ADC_AS_SuspHeiAdj 0;
BA_ "GenSigInvalidValue" SG_ 371 ADC_AS_SuspHeiAdj 0;
BA_ "GenSigSendType" SG_ 371 ADC_AS_SuspHeiAdj 1;
BA_ "GenSigStartValue" SG_ 371 ADC_AS_SuspHeiAdj 0;
BA_ "GenSigTimeoutValue" SG_ 371 ADC_AS_SuspHeiAdj 0;
BA_ "Remark" SG_ 371 ADC_AS_SuspHeiAdj "";
BA_ "EventCommandSignal" SG_ 371 ADC_AS_SuspHeiAdjVld 0;
BA_ "GatewayedSignals" SG_ 371 ADC_AS_SuspHeiAdjVld 0;
BA_ "GenSigInactiveValue" SG_ 371 ADC_AS_SuspHeiAdjVld 0;
BA_ "GenSigInvalidValue" SG_ 371 ADC_AS_SuspHeiAdjVld 0;
BA_ "GenSigSendType" SG_ 371 ADC_AS_SuspHeiAdjVld 1;
BA_ "GenSigStartValue" SG_ 371 ADC_AS_SuspHeiAdjVld 0;
BA_ "GenSigTimeoutValue" SG_ 371 ADC_AS_SuspHeiAdjVld 0;
BA_ "Remark" SG_ 371 ADC_AS_SuspHeiAdjVld "";
BA_ "EventCommandSignal" SG_ 371 ADC_AS_SusStfnAdj 0;
BA_ "GatewayedSignals" SG_ 371 ADC_AS_SusStfnAdj 0;
BA_ "GenSigInactiveValue" SG_ 371 ADC_AS_SusStfnAdj 0;
BA_ "GenSigInvalidValue" SG_ 371 ADC_AS_SusStfnAdj 0;
BA_ "GenSigSendType" SG_ 371 ADC_AS_SusStfnAdj 1;
BA_ "GenSigStartValue" SG_ 371 ADC_AS_SusStfnAdj 0;
BA_ "GenSigTimeoutValue" SG_ 371 ADC_AS_SusStfnAdj 0;
BA_ "Remark" SG_ 371 ADC_AS_SusStfnAdj "";
BA_ "EventCommandSignal" SG_ 371 ADC_AS_SusStfnAdjVld 0;
BA_ "GatewayedSignals" SG_ 371 ADC_AS_SusStfnAdjVld 0;
BA_ "GenSigInactiveValue" SG_ 371 ADC_AS_SusStfnAdjVld 0;
BA_ "GenSigInvalidValue" SG_ 371 ADC_AS_SusStfnAdjVld 0;
BA_ "GenSigSendType" SG_ 371 ADC_AS_SusStfnAdjVld 1;
BA_ "GenSigStartValue" SG_ 371 ADC_AS_SusStfnAdjVld 0;
BA_ "GenSigTimeoutValue" SG_ 371 ADC_AS_SusStfnAdjVld 0;
BA_ "Remark" SG_ 371 ADC_AS_SusStfnAdjVld "";
BA_ "EventCommandSignal" SG_ 371 ADC_CDCModReq 0;
BA_ "GatewayedSignals" SG_ 371 ADC_CDCModReq 0;
BA_ "GenSigInactiveValue" SG_ 371 ADC_CDCModReq 0;
BA_ "GenSigInvalidValue" SG_ 371 ADC_CDCModReq 0;
BA_ "GenSigSendType" SG_ 371 ADC_CDCModReq 1;
BA_ "GenSigStartValue" SG_ 371 ADC_CDCModReq 0;
BA_ "GenSigTimeoutValue" SG_ 371 ADC_CDCModReq 0;
BA_ "Remark" SG_ 371 ADC_CDCModReq "";
BA_ "EventCommandSignal" SG_ 371 ADC_CDCModReqVld 0;
BA_ "GatewayedSignals" SG_ 371 ADC_CDCModReqVld 0;
BA_ "GenSigInactiveValue" SG_ 371 ADC_CDCModReqVld 0;
BA_ "GenSigInvalidValue" SG_ 371 ADC_CDCModReqVld 0;
BA_ "GenSigSendType" SG_ 371 ADC_CDCModReqVld 1;
BA_ "GenSigStartValue" SG_ 371 ADC_CDCModReqVld 0;
BA_ "GenSigTimeoutValue" SG_ 371 ADC_CDCModReqVld 0;
BA_ "Remark" SG_ 371 ADC_CDCModReqVld "";
BA_ "EventCommandSignal" SG_ 371 ADC_UrgentSteerFlg 0;
BA_ "GatewayedSignals" SG_ 371 ADC_UrgentSteerFlg 0;
BA_ "GenSigInactiveValue" SG_ 371 ADC_UrgentSteerFlg 0;
BA_ "GenSigInvalidValue" SG_ 371 ADC_UrgentSteerFlg 0;
BA_ "GenSigSendType" SG_ 371 ADC_UrgentSteerFlg 1;
BA_ "GenSigStartValue" SG_ 371 ADC_UrgentSteerFlg 0;
BA_ "GenSigTimeoutValue" SG_ 371 ADC_UrgentSteerFlg 0;
BA_ "Remark" SG_ 371 ADC_UrgentSteerFlg "";
BA_ "EventCommandSignal" SG_ 371 ADC_OneMotorCtrlEna 0;
BA_ "GatewayedSignals" SG_ 371 ADC_OneMotorCtrlEna 0;
BA_ "GenSigInactiveValue" SG_ 371 ADC_OneMotorCtrlEna 0;
BA_ "GenSigInvalidValue" SG_ 371 ADC_OneMotorCtrlEna 0;
BA_ "GenSigSendType" SG_ 371 ADC_OneMotorCtrlEna 1;
BA_ "GenSigStartValue" SG_ 371 ADC_OneMotorCtrlEna 0;
BA_ "GenSigTimeoutValue" SG_ 371 ADC_OneMotorCtrlEna 0;
BA_ "Remark" SG_ 371 ADC_OneMotorCtrlEna "";
BA_ "EventCommandSignal" SG_ 371 ADC_MotorCtrlTqWhlRL 0;
BA_ "GatewayedSignals" SG_ 371 ADC_MotorCtrlTqWhlRL 0;
BA_ "GenSigInactiveValue" SG_ 371 ADC_MotorCtrlTqWhlRL 0;
BA_ "GenSigInvalidValue" SG_ 371 ADC_MotorCtrlTqWhlRL 0;
BA_ "GenSigSendType" SG_ 371 ADC_MotorCtrlTqWhlRL 1;
BA_ "GenSigStartValue" SG_ 371 ADC_MotorCtrlTqWhlRL 0;
BA_ "GenSigTimeoutValue" SG_ 371 ADC_MotorCtrlTqWhlRL 0;
BA_ "Remark" SG_ 371 ADC_MotorCtrlTqWhlRL "";
BA_ "EventCommandSignal" SG_ 371 ADC_MotorCtrlTqWhlRR 0;
BA_ "GatewayedSignals" SG_ 371 ADC_MotorCtrlTqWhlRR 0;
BA_ "GenSigInactiveValue" SG_ 371 ADC_MotorCtrlTqWhlRR 0;
BA_ "GenSigInvalidValue" SG_ 371 ADC_MotorCtrlTqWhlRR 0;
BA_ "GenSigSendType" SG_ 371 ADC_MotorCtrlTqWhlRR 1;
BA_ "GenSigStartValue" SG_ 371 ADC_MotorCtrlTqWhlRR 0;
BA_ "GenSigTimeoutValue" SG_ 371 ADC_MotorCtrlTqWhlRR 0;
BA_ "Remark" SG_ 371 ADC_MotorCtrlTqWhlRR "";
BA_ "EventCommandSignal" SG_ 371 ADC_SteerGainLevelTqCtrl 0;
BA_ "GatewayedSignals" SG_ 371 ADC_SteerGainLevelTqCtrl 0;
BA_ "GenSigInactiveValue" SG_ 371 ADC_SteerGainLevelTqCtrl 0;
BA_ "GenSigInvalidValue" SG_ 371 ADC_SteerGainLevelTqCtrl 0;
BA_ "GenSigSendType" SG_ 371 ADC_SteerGainLevelTqCtrl 1;
BA_ "GenSigStartValue" SG_ 371 ADC_SteerGainLevelTqCtrl 0;
BA_ "GenSigTimeoutValue" SG_ 371 ADC_SteerGainLevelTqCtrl 100;
BA_ "Remark" SG_ 371 ADC_SteerGainLevelTqCtrl "";
BA_ "EventCommandSignal" SG_ 371 ADC_MotorCtrlTqWhlFR 0;
BA_ "GatewayedSignals" SG_ 371 ADC_MotorCtrlTqWhlFR 0;
BA_ "GenSigInactiveValue" SG_ 371 ADC_MotorCtrlTqWhlFR 0;
BA_ "GenSigInvalidValue" SG_ 371 ADC_MotorCtrlTqWhlFR 0;
BA_ "GenSigSendType" SG_ 371 ADC_MotorCtrlTqWhlFR 1;
BA_ "GenSigStartValue" SG_ 371 ADC_MotorCtrlTqWhlFR 0;
BA_ "GenSigTimeoutValue" SG_ 371 ADC_MotorCtrlTqWhlFR 0;
BA_ "Remark" SG_ 371 ADC_MotorCtrlTqWhlFR "";
BA_ "EventCommandSignal" SG_ 371 ADC_MotorCtrlTqWhlFL 0;
BA_ "GatewayedSignals" SG_ 371 ADC_MotorCtrlTqWhlFL 0;
BA_ "GenSigInactiveValue" SG_ 371 ADC_MotorCtrlTqWhlFL 0;
BA_ "GenSigInvalidValue" SG_ 371 ADC_MotorCtrlTqWhlFL 0;
BA_ "GenSigSendType" SG_ 371 ADC_MotorCtrlTqWhlFL 1;
BA_ "GenSigStartValue" SG_ 371 ADC_MotorCtrlTqWhlFL 0;
BA_ "GenSigTimeoutValue" SG_ 371 ADC_MotorCtrlTqWhlFL 0;
BA_ "Remark" SG_ 371 ADC_MotorCtrlTqWhlFL "";
BA_ "EventCommandSignal" SG_ 371 Reserved1 0;
BA_ "GatewayedSignals" SG_ 371 Reserved1 0;
BA_ "GenSigInactiveValue" SG_ 371 Reserved1 0;
BA_ "GenSigInvalidValue" SG_ 371 Reserved1 0;
BA_ "GenSigSendType" SG_ 371 Reserved1 1;
BA_ "GenSigStartValue" SG_ 371 Reserved1 0;
BA_ "GenSigTimeoutValue" SG_ 371 Reserved1 0;
BA_ "Remark" SG_ 371 Reserved1 "";
VAL_ 389 ADC_AngReqSt_A_B1 0 "Inhibited" 1 "Ready" 2 "Active" 3 "Failed"  ;
VAL_ 389 ADC_AngReqFunction_B1 0 "No request" 1 "Request by LKAS" 2 "Request by PAS" 3 "Reserved"  ;
VAL_ 389 ADC_BrakeLightReq_B1 0 "No Request" 1 "turn on" 2 "turn off"  ;
VAL_ 389 ADC_AssistParaSwitchReq_B1 0 "No request" 1 "Request"  ;
VAL_ 389 ADC_SteerGainReq_B1 0 "No request" 1 "Request"  ;
VAL_ 389 ADC_StrgWhlVibrWarnLevel_B1 0 "No request" 1 "Request level 1" 2 "Request level 2" 3 "Request level 3"  ;
VAL_ 389 ADC_ActTrqReqEnable_B1 0 "Disable" 1 "Enable"  ;
VAL_ 389 ADC_EvsSteerReq_B1 0 "No request" 1 "Request"  ;
VAL_ 389 ADC_StrgWhlVibrWarnReq_B1 0 "No request" 1 "Request"  ;
VAL_ 389 ADC_DrvTarTqMod2EPB_B 0 "Override mode" 1 "Inhibit mode" 2 "reserved" 3 "reserved"  ;
VAL_ 389 ADC_LongCtrlTypReq_B1 0 "Comfort Mode" 1 "Emergency Mode"  ;
VAL_ 389 ADC_AEBFaultSt_B1 0 "Not fault" 1 "Fault"  ;
VAL_ 389 ADC_AEBOffSt_B1 0 "On" 1 "Off"  ;
VAL_ 389 ADC_AEBInterventionSt_B1 0 "No intervention" 1 "Intervention"  ;
VAL_ 389 ADC_AEBDecelCtrlReq_B1 0 "No request" 1 "Request"  ;
VAL_ 389 ADC_AEBLVehHoldReq_B1 0 "No request" 1 "Request"  ;
VAL_ 389 ADC_ABAReq_B1 0 "No request" 1 "Request"  ;
VAL_ 389 ADC_ABALevel_B1 0 "Level 0" 1 "Level 1" 2 "Level 2" 3 "Level 3"  ;
VAL_ 389 ADC_AWBReq_B1 0 "No request" 1 "Request"  ;
VAL_ 389 ADC_ABPReq_B1 0 "No request" 1 "Request"  ;
VAL_ 389 ADC_AWBLevel_B1 0 "No level" 1 "Level 1" 2 "Level 2" 3 "Level 3" 4 "Level 4" 5 "Not used" 6 "Not used" 7 "Not used"  ;
VAL_ 389 ADC_AEBTarCalss_B1 0 "Not dectected" 1 "Car" 2 "Pedestrian" 3 "Two wheels" 4 "Motorcycle" 5 "Truck" 6 "Unknown" 7 "Reserve"  ;
VAL_ 389 ADC_AEBTarDetSensor_B1 0 "Invalid" 1 "Not Fusion" 2 "Not used" 3 "Fusion"  ;
VAL_ 389 ADC_TurnLightReq_B1 0 "No Request" 1 "turn off" 2 "turn on left turn lamp" 3 "turn on right turn lamp" 4 "turn on Hazard Lamp" 5 "turn on RCW Hazard Lamp(4HZ)"  ;
VAL_ 389 ADC_EpbModReq_B1 0 "No request" 1 "lock" 2 "release" 3 "reserved"  ;
VAL_ 389 ADC_EpbModReqEna_B1 0 "disable" 1 "enable"  ;
VAL_ 389 ADC_PAAPwrModeReq_B1 0 "No Request" 1 "Power On Request (PTready)"  ;
VAL_ 389 ADC_PAAGrarLvlReq_B1 0 "No Request" 1 "Park" 2 "Reversed" 3 "Neutral" 4 "Drive" 5 "Reversed" 6 "Reversed" 7 "Reversed"  ;
VAL_ 389 ADC_PAAGrarLvlReqEnable_B1 0 "No request" 1 "Gear shift request"  ;
VAL_ 389 ADC_ActTrqReqVD_B1 0 "invalid" 1 "valid"  ;
VAL_ 389 ADC_BrkTarTqEna_B1 0 "disable" 1 "enable"  ;
VAL_ 389 ADC_BrkTarTqMod_B1 0 "no request" 1 "Cruise function" 2 "Parking function" 3 "Reserved"  ;
VAL_ 389 ADC_EpbModReqVld_B1 0 "Invalid" 1 "Valid"  ;
VAL_ 389 ADC_RWUEna_B1 0 "disable" 1 "enable"  ;
VAL_ 389 ADC_BrkOffEnable_B1 0 "Enable" 1 "Disable"  ;
VAL_ 389 ADC_BrkHoldReq_B1 0 "No request" 1 "Not active" 2 "Active" 3 "Reserved"  ;
VAL_ 389 ADC_AngReqAvl_B1 0 "Not available" 1 "Available"  ;
VAL_ 389 ADC_TarGearReqVld_B1 0 "Invalid" 1 "Valid"  ;
VAL_ 389 ADC_FctSts_B1 0 "Off" 1 "On"  ;
VAL_ 389 ADC_BrkTarTqVld_B1 0 "Invalid" 1 "Valid"  ;
VAL_ 389 ADC_AebBrkTarTqVld_B1 0 "Invalid" 1 "Valid"  ;
VAL_ 389 ADC_AebBrkTarTqEna_B1 0 "disable" 1 "enable"  ;
VAL_ 389 ADC_ElecBrkFnSwitch_B1 0 "ON" 1 "OFF"  ;
VAL_ 389 ADC_RedundantSwt_B1 0 "Without Redundant" 1 "With Redundant"  ;
VAL_ 389 ADC_ImmediateStopEna_B1 0 "Not Permitted" 1 "Permitted"  ;
VAL_ 389 ADC_RWUVld_B1 0 "Invalid" 1 "Valid"  ;
VAL_ 389 ADC_DriverPresent_B1 0 "Undefined" 1 "Driver  Not Present" 2 "Driver  Present" 3 "Failure"  ;
VAL_ 389 ADC_AD_NetMode_B 0 "Main Net" 1 "Main and Sub Net" 2 "Reserved" 3 "Reserved"  ;
VAL_ 389 ADC_ChrgPwrMode_B 0 "Normal" 1 "Emergent"  ;
VAL_ 389 ADC_FcsActiveStatus_B 0 "No Active" 1 "Active"  ;
VAL_ 389 ADC_DriverSeatBeltPretightenReq_B 0 "Not Request" 1 "Request"  ;
VAL_ 389 ADC_SteerVibrAvl_B 0 "Not available" 1 "Available"  ;
VAL_ 389 ADC_VehSpdVD_B 0 "Not Valid" 1 "Valid"  ;
VAL_ 389 ADC_DriverSeatBeltVibrWarnReq_B 0 "No Request" 1 "Mode 1" 2 "Mode 2" 3 "Mode 3" 4 "Reserved" 5 "Reserved" 6 "Reserved" 7 "Reserved"  ;
VAL_ 389 ADC_RasAngReqAvl_B1 0 "Not available" 1 "Available" 2 "Reserved" 3 "Reserved"  ;
VAL_ 389 ADC_RasAngReqSt_A_B1 0 "No Active" 1 "Ready" 2 "Active" 3 "Failed"  ;
VAL_ 389 ADC_RasModReq_B1 0 "Normal" 1 "Emergency" 2 "Reserved" 3 "Reserved"  ;
VAL_ 361 ADC_AngReqSt_A_B1 0 "Inhibited" 1 "Ready" 2 "Active" 3 "Failed"  ;
VAL_ 361 ADC_AngReqFunction_B1 0 "No request" 1 "Request by LKAS" 2 "Request by PAS" 3 "Reserved"  ;
VAL_ 361 ADC_BrakeLightReq_B1 0 "No Request" 1 "turn on" 2 "turn off"  ;
VAL_ 361 ADC_AssistParaSwitchReq_B1 0 "No request" 1 "Request"  ;
VAL_ 361 ADC_AngReqRdntReq_A_B1 0 "No request" 1 "Request"  ;
VAL_ 361 ADC_SteerGainReq_B1 0 "No request" 1 "Request"  ;
VAL_ 361 ADC_StrgWhlVibrWarnLevel_B1 0 "No request" 1 "Request level 1" 2 "Request level 2" 3 "Request level 3"  ;
VAL_ 361 ADC_ActTrqReqEnable_B1 0 "Disable" 1 "Enable"  ;
VAL_ 361 ADC_VLCSt_B1 0 "VLC not working" 1 "VLC Override possible" 2 "VLC Override impossible" 3 "Reserve"  ;
VAL_ 361 ADC_EvsSteerReq_B1 0 "No request" 1 "Request"  ;
VAL_ 361 ADC_StrgWhlVibrWarnReq_B1 0 "No request" 1 "Request"  ;
VAL_ 361 ADC_ADASLongCtrlFuncMode_B1 0 "Cruise" 1 "APA" 2 "Reserve" 3 "Reserve" 4 "Reserve" 5 "Reserve" 6 "Reserve" 7 "Reserve"  ;
VAL_ 361 ADC_LongCtrlAvailability_B1 0 "Not available" 1 "Available"  ;
VAL_ 361 ADC_LongCtrlModeForBrkSys_B1 0 "Off mode" 1 "L2 Active" 2 "L2++ Active" 3 "Not used" 4 "Not used" 5 "Not used" 6 "Not used" 7 "Not used"  ;
VAL_ 361 ADC_LongCtrlTargetAxReq_B1 0 "No request" 1 "Request"  ;
VAL_ 361 ADC_LongCtrlTypReq_B1 0 "Comfort Mode" 1 "Emergency Mode"  ;
VAL_ 361 ADC_LongCtrlDecToStopReq_B1 0 "No request" 1 "Request"  ;
VAL_ 361 ADC_LongCtrlDriveOff_B1 0 "No request" 1 "Request"  ;
VAL_ 361 ADC_LongctrlSecureReq_B1 0 "NoRequest" 1 "Request"  ;
VAL_ 361 ADC_ShifttoAVHReq_B1 0 "Not active" 1 "Active"  ;
VAL_ 361 ADC_TrkTargt0St_B1 0 "not dectected" 1 "dectected"  ;
VAL_ 361 ADC_AS_pauseReq_B1 0 "No request" 1 "request"  ;
VAL_ 361 ADC_AS_calibrationReq_B1 0 "Invalid" 1 "Request to Very high level" 2 "Request to High level" 3 "Request to Normal level" 4 "Request to Low level" 5 "Request to Very low level"  ;
VAL_ 361 ADC_AS_exitcurrentlevelReq_B1 0 "No request" 1 "request"  ;
VAL_ 361 ADC_AS_ReqToadjust_B1 0 "Invalid" 1 "PAS Request to Very high level" 2 "PAS Request to High level" 3 "PAS Request to Normal level" 4 "PAS Request to Low level" 5 "PAS Request to Very low level"  ;
VAL_ 361 ADC_AS_UnsafelevelunableReq_B1 0 "No request" 1 "request"  ;
VAL_ 361 ADC_AEBFaultSt_B1 0 "Not fault" 1 "Fault"  ;
VAL_ 361 ADC_AEBOffSt_B1 0 "On" 1 "Off"  ;
VAL_ 361 ADC_AEBInterventionSt_B1 0 "No intervention" 1 "Intervention"  ;
VAL_ 361 ADC_AEBDecelCtrlReq_B1 0 "No request" 1 "Request"  ;
VAL_ 361 ADC_AEBLVehHoldReq_B1 0 "No request" 1 "Request"  ;
VAL_ 361 ADC_ABAReq_B1 0 "No request" 1 "Request"  ;
VAL_ 361 ADC_ABALevel_B1 0 "Level 0" 1 "Level 1" 2 "Level 2" 3 "Level 3"  ;
VAL_ 361 ADC_AWBReq_B1 0 "No request" 1 "Request"  ;
VAL_ 361 ADC_ABPReq_B1 0 "No request" 1 "Request"  ;
VAL_ 361 ADC_AWBLevel_B1 0 "No level" 1 "Level 1" 2 "Level 2" 3 "Level 3" 4 "Level 4" 5 "Not used" 6 "Not used" 7 "Not used"  ;
VAL_ 361 ADC_AEBTarCalss_B1 0 "Not dectected" 1 "Car" 2 "Pedestrian" 3 "Two wheels" 4 "Motorcycle" 5 "Truck" 6 "Unknown" 7 "Reserve"  ;
VAL_ 361 ADC_AEBTarDetSensor_B1 0 "Invalid" 1 "Not Fusion" 2 "Not used" 3 "Fusion"  ;
VAL_ 361 ADC_TurnLightReq_B1 0 "No Request" 1 "turn off" 2 "turn on left turn lamp" 3 "turn on right turn lamp" 4 "turn on Hazard Lamp" 5 "turn on RCW Hazard Lamp(4HZ)"  ;
VAL_ 361 ADC_PAA2ESPAxReqEnable_B1 0 "Flase" 1 "True"  ;
VAL_ 361 ADC_PAA2ESPBrakeFunctionMode_B1 0 "None" 1 "APA" 2 "RPA" 3 "AVP" 4 "Dynamic AVP"  ;
VAL_ 361 ADC_PAA2ESPEpbReq_B1 0 "None" 1 "ReleaseReq" 2 "ApplyReq"  ;
VAL_ 361 ADC_PAA2ESPEpbReqSt_B1 0 "No request" 1 "Request"  ;
VAL_ 361 ADC_FcsActiveStatus_B 0 "No Active" 1 "Active"  ;
VAL_ 361 ADC_EpbModReq_B1 0 "No request" 1 "lock" 2 "release" 3 "reserved"  ;
VAL_ 361 ADC_ESPSwitchReq_B1 0 "Not Request" 1 "Request"  ;
VAL_ 361 ADC_EpbModReqEna_B1 0 "disable" 1 "enable"  ;
VAL_ 361 ADC_PAA2EPBBrakeFunctionMode_B1 0 "Not active" 1 "Active"  ;
VAL_ 361 ADC_PAA2ESPApEmgyBrkReq_B1 0 "Flase" 1 "True"  ;
VAL_ 361 ADC_PAA2ESPComfBrakeReq_B1 0 "ComfBrakeReq_NoReq" 1 "ComfBrakeReq_Type1" 2 "ComfBrakeReq_Type2"  ;
VAL_ 361 ADC_PAA2ESPApDriveOffReq_B1 0 "Flase" 1 "True"  ;
VAL_ 361 ADC_PAA2ESPApStandstillReq_B1 0 "Flase" 1 "True"  ;
VAL_ 361 ADC_PAA2ESPApPrefillReq_B1 0 "Flase" 1 "True"  ;
VAL_ 361 ADC_EPBReq_B1 0 "Not Request" 1 "Request"  ;
VAL_ 361 ADC_VehTorqLimitEnable_B1 0 "Not enable" 1 "Enable"  ;
VAL_ 361 ADC_VehTorqReqEnable_B1 0 "Not enable" 1 "Enable"  ;
VAL_ 361 ADC_PAAPwrModeReq_B1 0 "No Request" 1 "Power On Request (PTready)"  ;
VAL_ 361 ADC_PAAGrarLvlReq_B1 0 "No Request" 1 "Park" 2 "Reversed" 3 "Neutral" 4 "Drive" 5 "Reversed" 6 "Reversed" 7 "Reversed"  ;
VAL_ 361 ADC_PAAGrarLvlReqEnable_B1 0 "No request" 1 "Gear shift request"  ;
VAL_ 361 ADC_ActTrqReqVD_B1 0 "invalid" 1 "valid"  ;
VAL_ 361 ADC_RCTBBrkReq_B1 0 "No request" 1 "Request"  ;
VAL_ 361 ADC_BrkTarTqEna_B1 0 "disable" 1 "enable"  ;
VAL_ 361 ADC_BrkTarTqMod_B1 0 "no request" 1 "Cruise function" 2 "Parking function" 3 "Reserved"  ;
VAL_ 361 ADC_EpbModReqVld_B1 0 "Invalid" 1 "Valid"  ;
VAL_ 361 ADC_RWUEna_B1 0 "disable" 1 "enable"  ;
VAL_ 361 ADC_BrkHoldReq_B1 0 "No request" 1 "Not active" 2 "Active" 3 "Reserved"  ;
VAL_ 361 ADC_AngReqAvl_B1 0 "Not available" 1 "Available"  ;
VAL_ 361 ADC_TarGearReqVld_B1 0 "Invalid" 1 "Valid"  ;
VAL_ 361 ADC_FctSts_B1 0 "Off" 1 "On"  ;
VAL_ 361 ADC_BrkTarTqVld_B1 0 "Invalid" 1 "Valid"  ;
VAL_ 361 ADC_AebBrkTarTqVld_B1 0 "Invalid" 1 "Valid"  ;
VAL_ 361 ADC_AebBrkTarTqEna_B1 0 "disable" 1 "enable"  ;
VAL_ 361 ADC_ElecBrkFnSwitch_B1 0 "ON" 1 "OFF"  ;
VAL_ 361 ADC_RWUVld_B1 0 "Invalid" 1 "Valid"  ;
VAL_ 361 ADC_DriverPresent_B1 0 "Undefined" 1 "Driver  Not Present" 2 "Driver  Present" 3 "Failure"  ;
VAL_ 371 ADC_MotCtrlTar 0 "FL" 1 "RL" 2 "FL+RL" 3 "RL+RR" 4 "reserved" 5 "reserved" 6 "reserved" 7 "reserved"  ;
VAL_ 371 ADC_MotTarMod 0 "Torque mode" 1 "Speed mode" 2 "SV mode" 3 "Reserved"  ;
VAL_ 371 ADC_SteerTqSt 0 "No request" 1 "Ready" 2 "Active" 3 "Reserved"  ;
VAL_ 371 ADC_DrvTarTqMod 0 "Override mode" 1 "Inhibit mode" 2 "reserved" 3 "reserved"  ;
VAL_ 371 ADC_TqEvsSteerReq 0 "Normal" 1 "Emergency"  ;
VAL_ 371 ADC_SteerTqAvl 0 "Not available" 1 "Available"  ;
VAL_ 371 ADC_RapidRespEna 0 "Disable" 1 "Enable"  ;
VAL_ 371 ADC_LimTqEnable 0 "Disable" 1 "Enable"  ;
VAL_ 371 ADC_MotSpdCtrlEna 0 "Disable" 1 "Enable"  ;
VAL_ 371 ADC_TqUnloadEna 0 "Disable" 1 "Enable"  ;
VAL_ 371 ADC_MotTarSpdSvValid 0 "Invalid" 1 "Valid"  ;
VAL_ 371 ADC_DycEscTarTqVld 0 "Invalid" 1 "Valid"  ;
VAL_ 371 ADC_DycEscTarTqEna 0 "disable" 1 "enable"  ;
VAL_ 371 ADC_RoadTyp 0 "Flat road" 1 "Bumpy road" 2 "Gravel road" 3 "Reserved" 4 "Reserved" 5 "Reserved" 6 "Reserved" 7 "Invalid"  ;
VAL_ 371 ADC_RiWhlRoadFeature 0 "No Object" 1 "Speed Bump" 2 "Manhole cover" 3 "High-speed vibration zone" 4 "Continuous Speed Bumps" 5 "Bridge joint" 6 "Cement joint" 7 "Pit" 8 "Others" 15 "Invalid"  ;
VAL_ 371 ADC_SuspensionStatus 0 "No request" 1 "Auto_Disable" 2 "Manual_Disable" 3 "Disable" 4 "Reserved" 5 "Reserved" 6 "Reserved" 7 "Reserved"  ;
VAL_ 371 ADC_LeWhlRoadSts 0 "Unknown" 1 "flat" 2 "concave" 3 "convex"  ;
VAL_ 371 ADC_LeWhlRoadFeature 0 "No Object" 1 "Speed Bump" 2 "Manhole cover" 3 "High-speed vibration zone" 4 "Continuous Speed Bumps" 5 "Bridge joint" 6 "Cement joint" 7 "Pit" 8 "Others" 15 "Invalid"  ;
VAL_ 371 ADC_RiWhlRoadSts 0 "Unknown" 1 "flat" 2 "concave" 3 "convex"  ;
VAL_ 371 ADC_CDCCtrlEnable 0 "disable" 1 "enable"  ;
VAL_ 371 ADC_RoadInfoAvl 0 "Not Available" 1 "Available"  ;
VAL_ 371 ADC_RoadFeatureDetFalutSts 0 "No error" 1 "Error"  ;
VAL_ 371 ADC_RoadFeatureDetWorkSts 0 "Invalid" 1 "Valid" 2 "Inhibit" 3 "Reserve"  ;
VAL_ 371 ADC_LeWhlRoadFeature2 0 "No Object" 1 "Speed Bump" 2 "Manhole cover" 3 "High-speed vibration zone" 4 "Continuous Speed Bumps" 5 "Bridge joint" 6 "Cement joint" 7 "Pit" 8 "Others" 15 "Invalid"  ;
VAL_ 371 ADC_LeWhlRoadFeature3 0 "No Object" 1 "Speed Bump" 2 "Manhole cover" 3 "High-speed vibration zone" 4 "Continuous Speed Bumps" 5 "Bridge joint" 6 "Cement joint" 7 "Pit" 8 "Others" 15 "Invalid"  ;
VAL_ 371 ADC_RiWhlRoadFeature2 0 "No Object" 1 "Speed Bump" 2 "Manhole cover" 3 "High-speed vibration zone" 4 "Continuous Speed Bumps" 5 "Bridge joint" 6 "Cement joint" 7 "Pit" 8 "Others" 15 "Invalid"  ;
VAL_ 371 ADC_RiWhlRoadFeature3 0 "No Object" 1 "Speed Bump" 2 "Manhole cover" 3 "High-speed vibration zone" 4 "Continuous Speed Bumps" 5 "Bridge joint" 6 "Cement joint" 7 "Pit" 8 "Others" 15 "Invalid"  ;
VAL_ 371 ADC_LeWhlRoadHei2 0 "Default" 1 "<-10cm" 2 "-10~-5cm" 3 "-5~0cm" 4 "0~5cm" 5 "5~10cm" 6 "＞10cm" 7 "Invalid"  ;
VAL_ 371 ADC_LeWhlRoadHei3 0 "Default" 1 "<-10cm" 2 "-10~-5cm" 3 "-5~0cm" 4 "0~5cm" 5 "5~10cm" 6 "＞10cm" 7 "Invalid"  ;
VAL_ 371 ADC_RiWhlRoadHei2 0 "Default" 1 "<-10cm" 2 "-10~-5cm" 3 "-5~0cm" 4 "0~5cm" 5 "5~10cm" 6 "＞10cm" 7 "Invalid"  ;
VAL_ 371 ADC_RiWhlRoadHei3 0 "Default" 1 "<-10cm" 2 "-10~-5cm" 3 "-5~0cm" 4 "0~5cm" 5 "5~10cm" 6 "＞10cm" 7 "Invalid"  ;
VAL_ 371 ADC_LeWhlLgtDst2 63 "Invalid"  ;
VAL_ 371 ADC_LeWhlLgtDst3 63 "Invalid"  ;
VAL_ 371 ADC_RiWhlLgtDst2 63 "Invalid"  ;
VAL_ 371 ADC_RiWhlLgtDst3 63 "Invalid"  ;
VAL_ 371 ADC_AS_SuspHeiAdj 0 "Invalid" 1 "PAS Request to Very high level" 2 "PAS Request to High level" 3 "PAS Request to Normal level" 4 "PAS Request to Low level" 5 "PAS Request to Very low level" 6 "Reserve" 7 "Reserve"  ;
VAL_ 371 ADC_AS_SuspHeiAdjVld 0 "Invalid" 1 "Valid"  ;
VAL_ 371 ADC_AS_SusStfnAdj 0 "No request" 1 "Soft" 2 "Hard"  ;
VAL_ 371 ADC_AS_SusStfnAdjVld 0 "Invalid" 1 "Valid"  ;
VAL_ 371 ADC_CDCModReq 0 "No request" 1 "comfort（low）" 2 "comfort（middle）" 3 "comfort（high）" 4 "sport（low）" 5 "sport（middle）" 6 "sport（high）" 7 "reserve"  ;
VAL_ 371 ADC_CDCModReqVld 0 "Invalid" 1 "Valid"  ;
VAL_ 371 ADC_UrgentSteerFlg 0 "Disable" 1 "Enable"  ;
VAL_ 371 ADC_OneMotorCtrlEna 0 "Disable（Total Drive Torque）" 1 "Enable（One Wheel Drive Torque）" 2 "Reserved" 3 "Reserved"  ;
