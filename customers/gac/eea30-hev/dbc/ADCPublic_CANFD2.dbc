VERSION "Version"

NS_ :

BS_:

BU_: Tester CCU IBCS EPB EPS ADC CCURT1 CCURT2 ZCUF ZCUL ZCUR ZCUT EMS IDM DCDC DCDCI IPS NIDU DCU2 OBC OPC LPC CPC EMCM GCU DCU IPU BMS EOP EVCC DCDC2 EDL SRS ECS RBM ICM IID IDC AMP WHUD ARHUD IMR FIMR CD INU IFC FAPA RRR RLR PAS PCS SCMF SCMR SCMRL SCMRR MFS DRM FCP RCP LBMSAD AVAS DLPFL FBLCM FLISD FLLCM FRLCM RLLCMA RLLCMB RRLCMA RRLCMB RLISD DLPML DLPMR TRM PSDL PSDR FLDCM FRDCM HVSPRL HVSPRR RFR SBM WCM ETC TBOX2 TBOX RLBMS EBU FLPDM RLPDM FRPDM RRPDM FLOAR FROAR RLOAR RROAR EOSL EOSR EOST PRBU RT2_C3 OTAWL IDUR PHUDD RAS CBM PLGM TMC LPC2 SAS RCICP SCMRM SCMT SLMRL SLMRR IDU RRISD DSASBM LBMS RT1_C0 RT1_C1

BO_ 728 CCU_ECS_1: 64 CCU
 SG_ ECS_1_CRC : 7|16@0+ (1,0) [0|65535] ""  ADC
 SG_ ECS_1_Counter : 23|8@0+ (1,0) [0|255] ""  ADC
 SG_ CDC_ADCCtrlAvl : 38|1@0+ (1,0) [0|1] ""  ADC
 SG_ CDC_ADCCtrlRespSts : 39|1@0+ (1,0) [0|1] ""  ADC
 SG_ CDC_ADCModState : 287|3@0+ (1,0) [0|7] ""  ADC

BO_ 459 CCU_ECS_2: 64 CCU
 SG_ ECS_2_CRC : 7|16@0+ (1,0) [0|65535] ""  ADC
 SG_ ECS_2_Counter : 23|8@0+ (1,0) [0|255] ""  ADC
 SG_ AS_SuspHeightFL : 31|12@0+ (0.1,-150) [-150|150] "mm"  ADC,FLOAR,FROAR,RLOAR,RROAR
 SG_ AS_SuspHeightFR : 35|12@0+ (0.1,-150) [-150|150] "mm"  ADC,FLOAR,FROAR,RLOAR,RROAR
 SG_ AS_SuspHeightRL : 55|12@0+ (0.1,-150) [-150|150] "mm"  ADC,FLOAR,FROAR,RLOAR,RROAR
 SG_ AS_SuspHeightRR : 59|12@0+ (0.1,-150) [-150|150] "mm"  ADC,FLOAR,FROAR,RLOAR,RROAR
 SG_ AS_SuspHeightFLVD : 72|1@0+ (1,0) [0|1] ""  ADC,FLOAR,FROAR,RLOAR,RROAR
 SG_ AS_SuspHeightFRVD : 73|1@0+ (1,0) [0|1] ""  ADC,FLOAR,FROAR,RLOAR,RROAR
 SG_ AS_SuspHeightRLVD : 74|1@0+ (1,0) [0|1] ""  ADC,FLOAR,FROAR,RLOAR,RROAR
 SG_ AS_SuspHeightRRVD : 75|1@0+ (1,0) [0|1] ""  ADC,FLOAR,FROAR,RLOAR,RROAR
 SG_ AS_SuspHeightSensorFLSt : 76|1@0+ (1,0) [0|1] ""  ADC
 SG_ AS_SuspHeightSensorFRSt : 77|1@0+ (1,0) [0|1] ""  ADC
 SG_ AS_SuspHeightSensorRLSt : 78|1@0+ (1,0) [0|1] ""  ADC
 SG_ AS_SuspHeightSensoRRSt : 79|1@0+ (1,0) [0|1] ""  ADC
 SG_ AS_MaintanceModeSt : 97|2@0+ (1,0) [0|3] ""  ADC
 SG_ ECS_AVDCReqModeAvailable : 113|1@0+ (1,0) [0|1] ""  ADC
 SG_ ECS_AVDCReqMode : 116|3@0+ (1,0) [0|7] ""  ADC
 SG_ AS_FrontAxleSuspSt : 112|2@0+ (1,0) [0|3] ""  ADC
 SG_ AS_RearAxleSuspSt : 126|2@0+ (1,0) [0|3] ""  ADC
 SG_ AS_HeightWarningSt : 124|3@0+ (1,0) [0|7] ""  ADC
 SG_ AS_CurrentLevel : 131|4@0+ (1,0) [0|15] ""  ADC
 SG_ AS_ASMode : 138|3@0+ (1,0) [0|7] ""  ADC
 SG_ AS_SysFaultSt : 141|3@0+ (1,0) [0|7] ""  ADC
 SG_ AS_SysOperationSt : 159|4@0+ (1,0) [0|15] ""  ADC
 SG_ AS_ADCStfnCtrlAvl : 151|1@0+ (1,0) [0|1] ""  ADC
 SG_ AS_ADCStfnState : 146|3@0+ (1,0) [0|7] ""  ADC

BO_ 905 CCU_IDC_ICM_1: 64 CCU
 SG_ ICM_SetIACCSt : 27|1@0+ (1,0) [0|1] ""  ADC,IFC,FAPA
 SG_ ICM_TotalOdometer : 35|20@0+ (1,0) [0|999999] "km"  ZCUF,ZCUL,ZCUR,ZCUT,EMS,NIDU,DCU2,IDUR,GCU,DCU,IPU,ECS,EPS,EPB,IBCS,ADC,IFC,FAPA,RRR,RLR,PCS,EBU
 SG_ ICM_VehInsSpd : 103|8@0+ (1,0) [0|254] "km/h"  ADC,IFC,FAPA,RRR,RLR
 SG_ ICM_TotalOdometer_accurate : 151|24@0+ (0.1,0) [0|999999.9] "km"  EMS,BMS,SRS,ADC,DSASBM,TBOX
 SG_ ICM_VehInsSpd_accurate : 272|11@0+ (0.1,0) [0|204.6] "km/h"  ECS,ADC,IFC,FAPA,RRR,RLR
 SG_ ICM_FuelAvaibleDriveDistance : 311|11@0+ (1,0) [0|2046] "km"  ADC,FAPA
 SG_ ICM_TotalAvaibleDriveDistance : 316|11@0+ (1,0) [0|2046] "km"  ADC,FAPA

BO_ 161 CCU_IDC_1: 64 CCU
 SG_ ACU_FaceID_Delete : 119|4@0+ (1,0) [0|15] ""  ADC,FAPA
 SG_ ACU_RegisterTriger : 115|4@0+ (1,0) [0|15] ""  ADC,FAPA
 SG_ ACU_VerifyTriger : 127|4@0+ (1,0) [0|15] ""  ADC,FAPA
 SG_ ACU_FaceIDQuit : 123|1@0+ (1,0) [0|1] ""  ADC,FAPA
 SG_ ACU_FaceIDSwitch : 122|2@0+ (1,0) [0|3] ""  ADC,FAPA
 SG_ ACU_AVAS_SwitchCfgReq : 273|2@0+ (1,0) [0|3] ""  ZCUF,ZCUL,ADC,FAPA,AVAS

BO_ 913 CCU_GwMsg_L3: 16 CCU
 SG_ CCU_GwMsg_L3_CRC : 7|16@0+ (1,0) [0|65535] ""  ADC,FAPA
 SG_ CCU_GwMsg_L3_Counter : 23|8@0+ (1,0) [0|255] ""  ADC,FAPA
 SG_ IL_PADS_LightbarSt : 31|4@0+ (1,0) [0|15] "/"  ADC,FAPA
 SG_ IL_PADS_LightbarErrSt : 27|1@0+ (1,0) [0|1] "/"  ADC,FAPA
 SG_ UINM_PADS_L3SWSt : 26|2@0+ (1,0) [0|3] ""  ADC,FAPA
 SG_ UINM_PADS_L3SWStVD : 24|1@0+ (1,0) [0|1] ""  ADC,FAPA
 SG_ UINM_PADS_L3SWStuckSt : 39|1@0+ (1,0) [0|1] ""  ADC,FAPA

BO_ 904 CCU_GwMsg_4: 64 CCU
 SG_ CCU_GwMsg_4_CRC : 7|16@0+ (1,0) [0|65535] ""  ADC,FAPA
 SG_ CCU_GwMsg_4_Counter : 23|8@0+ (1,0) [0|255] ""  ADC,FAPA
 SG_ HVAC_RearDefrostSt : 24|1@0+ (1,0) [0|1] ""  ADC,IFC,FAPA
 SG_ HVAC_WindExitMode : 27|3@0+ (1,0) [0|7] ""  ADC,IFC,FAPA
 SG_ HVAC_CorrectedExterTemp : 39|8@0+ (0.5,-40) [-40|87.5] "°C"  ADC,IFC,FAPA,PAS
 SG_ HVAC_CorrectedExterTempVD : 28|1@0+ (1,0) [0|1] ""  ADC,IFC,FAPA,PAS
 SG_ HVAC_CorrectedCabinTemp : 47|8@0+ (0.5,-40) [-40|87.5] "°C"  ADC,IFC,FAPA
 SG_ HVAC_CorrectedCabinTempVD : 29|1@0+ (1,0) [0|1] ""  ADC,IFC,FAPA
 SG_ WW_FwpFaultSt : 30|1@0+ (1,0) [0|1] ""  ADC,IFC,FAPA
 SG_ WW_RwpFaultSt : 31|1@0+ (1,0) [0|1] ""  ADC,IFC,FAPA
 SG_ WW_FwshFaultSt : 48|1@0+ (1,0) [0|1] ""  ADC,IFC,FAPA
 SG_ WW_RwshFaultSt : 49|1@0+ (1,0) [0|1] ""  ADC,IFC,FAPA
 SG_ WW_FwpAutoModeSt : 50|1@0+ (1,0) [0|1] ""  ADC,IFC,FAPA
 SG_ WW_RainFallLevel : 55|4@0+ (1,0) [0|15] ""  ADC,IFC,FAPA
 SG_ RLS_LightOnReq : 51|1@0+ (1,0) [0|1] ""  ADC,IFC,FAPA
 SG_ RLS_LampOnReqValid : 60|1@0+ (1,0) [0|1] ""  ADC,IFC,FAPA
 SG_ RLS_WiperSpd : 59|4@0+ (1,0) [0|15] ""  ADC,IFC,FAPA
 SG_ RLS_AMBBrightness : 69|14@0+ (6,0) [0|98286] "Lux"  ADC,IFC,FAPA
 SG_ RLS_FWBrightness : 87|14@0+ (6,0) [0|98286] ""  ADC,IFC,FAPA
 SG_ RLS_RainfallLevel : 103|4@0+ (1,0) [0|15] ""  ADC,IFC,FAPA
 SG_ RLS_RSErr : 88|1@0+ (1,0) [0|1] ""  ADC,IFC,FAPA
 SG_ RLS_LSErr : 89|1@0+ (1,0) [0|1] ""  ADC,IFC,FAPA
 SG_ PM_AUTHPstState : 70|1@0+ (1,0) [0|1] ""  ADC,IFC,FAPA
 SG_ CCU_FuncReq_SentryMod : 71|1@0+ (1,0) [0|1] ""  ADC,IFC,FAPA
 SG_ RLS_WindShieldHum : 111|8@0+ (0.5,-0.5) [0|100] "%"  ADC,IFC,FAPA
 SG_ RLS_WindShieldTem : 119|8@0+ (0.5,-40) [-40|86.5] "℃"  ADC,IFC,FAPA
 SG_ RLS_DewPoint : 127|8@0+ (0.5,-40) [-40|86.5] "℃"  ADC,IFC,FAPA
 SG_ CCU_ModeSuppressSts : 62|2@0+ (1,0) [0|2] ""  ADC,IFC,FAPA
 SG_ RLS_HUTErr : 63|1@0+ (1,0) [0|1] ""  ADC,IFC,FAPA
 SG_ SR_SunroofCurrentPst : 135|8@0+ (0.5,0) [0|255] "%"  ADC,IFC,FAPA
 SG_ EL_LeftBSDIndicatorSt : 136|1@0+ (1,0) [0|1] ""  ADC,IFC,FAPA,RRR,RLR
 SG_ UINM_HazardLightSwSt : 137|1@0+ (1,0) [0|1] ""  ADC,IFC,FAPA,RRR,RLR
 SG_ EL_MLTurnLightSt : 139|2@0+ (1,0) [0|3] ""  ADC,IFC,FAPA
 SG_ EL_MLTurnLightFaultSt : 140|1@0+ (1,0) [0|1] ""  ADC,IFC,FAPA
 SG_ EL_LeftBSDIndicatorFaultSt : 141|1@0+ (1,0) [0|1] ""  ADC,IFC,FAPA,RRR,RLR
 SG_ ZCUL_FrtWindshildHeatSt : 143|2@0+ (1,0) [0|3] ""  ADC,IFC,FAPA
 SG_ ACU_PCS_SVM_MODCmd : 96|1@0+ (1,0) [0|1] ""  ADC,IFC,FAPA
 SG_ ACU_HeadLightVirtualSwSt : 99|3@0+ (1,0) [0|7] ""  ADC,IFC,FAPA
 SG_ ACU_FrontFogLightVirtualSwSt : 144|1@0+ (1,0) [0|1] ""  ADC,IFC,FAPA
 SG_ ACU_RearFogLightVirtualSwSt : 145|1@0+ (1,0) [0|1] ""  ADC,IFC,FAPA
 SG_ ACU_Account_Uid : 151|4@0+ (1,0) [0|15] ""  ADC,IFC,FAPA
 SG_ ACU_IHBC_SwitchReq : 147|2@0+ (1,0) [0|3] ""  ADC,IFC,FAPA
 SG_ ACU_NDASwitchReq : 153|2@0+ (1,0) [0|3] ""  ADC,IFC,FAPA
 SG_ ACU_NDALCConSwitchReq : 155|2@0+ (1,0) [0|3] ""  ADC,IFC,FAPA
 SG_ ACU_NDALCStySwitchReq : 157|2@0+ (1,0) [0|3] ""  ADC,IFC,FAPA
 SG_ ACU_ADASWarnTypeSwitch : 159|2@0+ (1,0) [0|3] ""  ADC,IFC,FAPA
 SG_ ACU_iACC_StyleConfirmSwitchReq : 177|2@0+ (1,0) [0|3] ""  ADC,IFC,FAPA
 SG_ ACU_IFC_SpeedLimit : 167|8@0+ (1,0) [0|255] "km/h"  ADC,IFC,FAPA
 SG_ ACU_IFC_ISDRestOfdis : 175|8@0+ (1,0) [0|70] "km"  ADC,IFC,FAPA
 SG_ ACU_IFC_SpeedLimitUnit : 183|2@0+ (1,0) [0|3] ""  ADC,IFC,FAPA
 SG_ ACU_ThemeType : 196|1@0+ (1,0) [0|1] ""  ADC,IFC,FAPA,PCS
 SG_ ACU_IFC_SpeedLimtType : 187|4@0+ (1,0) [0|15] ""  ADC,IFC,FAPA
 SG_ ACU_IFC_RoadType : 191|4@0+ (1,0) [0|15] ""  ADC,IFC,FAPA
 SG_ ACU_IFC_ZoneCode : 199|3@0+ (1,0) [0|7] ""  ADC,IFC,FAPA
 SG_ ACU_IFC_NaviSt : 195|2@0+ (1,0) [0|3] ""  ADC,IFC,FAPA
 SG_ ACU_IFC_NaviCorp : 207|3@0+ (1,0) [0|7] ""  ADC,IFC,FAPA
 SG_ ACU_IFC_NaviNewIconDis : 204|5@0+ (0.1,0) [0|2] "km"  ADC,IFC,FAPA
 SG_ ACU_IFC_OfframpSt : 192|1@0+ (1,0) [0|1] ""  ADC,IFC,FAPA
 SG_ ACU_IFC_NaviNewIcon : 211|4@0+ (1,0) [0|15] ""  ADC,IFC,FAPA
 SG_ ACU_IFC_SLCAheadDis : 223|8@0+ (5,0) [0|1250] "m"  ADC,IFC,FAPA
 SG_ ACU_DVR_Switch : 193|1@0+ (1,0) [0|1] ""  ADC,IFC,FAPA
 SG_ ACU_IFC_OfframpDis : 231|8@0+ (10,0) [0|2000] "m"  ADC,IFC,FAPA
 SG_ SSW_FLSeatSlideCurrentPst : 239|8@0+ (0.5,0) [0|100] "%"  ADC,FAPA
 SG_ SSW_FLSeatHeightCurrentPst : 247|8@0+ (0.5,0) [0|100] "%"  ADC,FAPA
 SG_ SSW_FLSeatBackrestCurrentPst : 255|8@0+ (0.5,0) [0|100] "%"  ADC,FAPA
 SG_ DrvrSideMotResp : 263|4@0+ (1,0) [0|15] ""  ADC,IFC,FAPA
 SG_ EL_LeftLowBeamSt : 256|1@0+ (1,0) [0|1] ""  ADC,IFC,FAPA
 SG_ EL_LeftLowBeamFaultSt : 257|1@0+ (1,0) [0|1] ""  ADC,IFC,FAPA
 SG_ EL_RightLowBeamSt : 258|1@0+ (1,0) [0|1] ""  ADC,IFC,FAPA
 SG_ EL_RightLowBeamFaultSt : 259|1@0+ (1,0) [0|1] ""  ADC,IFC,FAPA
 SG_ WW_FWPMotorSt : 271|3@0+ (1,0) [0|7] ""  ADC,IFC,FAPA
 SG_ EL_MLADASLightSt : 181|2@0+ (1,0) [0|3] ""  ADC,IFC
 SG_ EL_FLTurnLightSt : 268|2@0+ (1,0) [0|3] ""  ADC,IFC,FAPA
 SG_ EL_FLTurnLightFaultSt : 266|1@0+ (1,0) [0|1] ""  ADC,IFC,FAPA
 SG_ EL_FRTurnLightSt : 265|2@0+ (1,0) [0|3] ""  ADC,IFC,FAPA
 SG_ EL_FRTurnLightFaultSt : 279|1@0+ (1,0) [0|1] ""  ADC,IFC,FAPA
 SG_ EL_SideBrkLightSt : 278|1@0+ (1,0) [0|1] ""  ADC,IFC,FAPA
 SG_ EL_SideBrkLightFaultSt : 277|1@0+ (1,0) [0|1] ""  ADC,IFC,FAPA
 SG_ EL_CHMSLSt : 276|1@0+ (1,0) [0|1] ""  ADC,IFC,FAPA
 SG_ EL_CHMSLFaultSt : 275|1@0+ (1,0) [0|1] ""  ADC,IFC,FAPA
 SG_ EL_RLTurnLightSt : 274|2@0+ (1,0) [0|3] ""  ADC,IFC,FAPA
 SG_ EL_RLTurnLightFaultSt : 272|1@0+ (1,0) [0|1] ""  ADC,IFC,FAPA,PCS
 SG_ EL_RRTurnLightSt : 287|2@0+ (1,0) [0|3] ""  ADC,IFC,FAPA
 SG_ EL_RRTurnLightFaultSt : 285|1@0+ (1,0) [0|1] ""  ADC,IFC,FAPA,PCS
 SG_ IPDS_BAT1PowerSt : 280|1@0+ (1,0) [0|1] ""  ADC,FAPA
 SG_ IPDS_BAT2PowerSt : 299|1@0+ (1,0) [0|1] ""  ADC,FAPA
 SG_ IPDS_DCDC2PowerSt : 311|1@0+ (1,0) [0|1] ""  ADC,FAPA
 SG_ IPDS_GridIsoPowerSt : 310|1@0+ (1,0) [0|1] ""  ADC,FAPA
 SG_ IPS_DCDCModeSt : 298|3@0+ (1,0) [0|7] ""  ADC,IFC,FAPA
 SG_ IPDS_FRRadarPowerSup : 309|2@0+ (1,0) [0|3] ""  ADC,IFC,FAPA
 SG_ LBMS_SOFVD : 293|1@0+ (1,0) [0|1] ""  ADC,FAPA
 SG_ LBMS_SOFEN : 295|2@0+ (1,0) [0|3] ""  ADC,FAPA
 SG_ LBMSAD_SOFVD : 290|1@0+ (1,0) [0|1] ""  ADC,FAPA
 SG_ LBMSAD_SOFEN : 292|2@0+ (1,0) [0|3] ""  ADC,FAPA
 SG_ IPDS_FLRadarPowerSup : 307|2@0+ (1,0) [0|3] ""  ADC,IFC,FAPA
 SG_ IPDS_FrontRadarPowerSup : 305|2@0+ (1,0) [0|3] ""  ADC,IFC,FAPA
 SG_ IPDS_HDMapPowerSup : 319|2@0+ (1,0) [0|3] ""  ADC,IFC,FAPA
 SG_ IPDS_RearRadarPowerSup : 317|2@0+ (1,0) [0|3] ""  ADC,IFC,FAPA

BO_ 909 CCU_ZCU_1: 64 CCU
 SG_ LCK_HoodAjarSt : 37|1@0+ (1,0) [0|1] ""  OTAWL,ZCUR,EMS,ECS,ICM,IID,IDC,PHUDD,AMP,ADC,IFC,FAPA,RRR,RLR,PCS
 SG_ LCK_FrontLeftDoorAjarSt : 36|1@0+ (1,0) [0|1] ""  OTAWL,ZCUF,ZCUR,ZCUT,EPB,IBCS,ICM,IID,IDC,PHUDD,AMP,IMR,FIMR,ADC,IFC,FAPA,RRR,RLR,DLPML,DLPMR,PLGM,PRBU
 SG_ LCK_FrontRightDoorAjarSt : 35|1@0+ (1,0) [0|1] ""  ZCUT,IBCS,ICM,IID,IDC,PHUDD,AMP,IMR,FIMR,ADC,IFC,FAPA,RRR,RLR,DLPML,DLPMR,PLGM,PRBU
 SG_ LCK_RearLeftDoorAjarSt : 34|1@0+ (1,0) [0|1] ""  OTAWL,ZCUL,ZCUR,ECS,IBCS,ICM,IID,IDC,PHUDD,AMP,IMR,FIMR,ADC,IFC,FAPA,RRR,RLR,PCS,DLPML,DLPMR,PLGM,PRBU
 SG_ LCK_RearRightDoorAjarSt : 33|1@0+ (1,0) [0|1] ""  OTAWL,ZCUL,ZCUR,ECS,IBCS,ICM,IID,IDC,AMP,IMR,FIMR,ADC,IFC,FAPA,RRR,RLR,PCS,DLPML,DLPMR,PLGM,PRBU
 SG_ LCK_TrunkAjarSt : 32|1@0+ (1,0) [0|1] ""  OTAWL,ZCUF,ZCUL,ZCUR,ECS,ICM,IID,IDC,AMP,IMR,FIMR,ADC,IFC,FAPA,RRR,RLR,PCS
 SG_ LCK_FrontLeftDoorLockSt : 47|1@0+ (1,0) [0|1] ""  OTAWL,ZCUR,CBM,ICM,IDC,ADC,IFC,FAPA,RRR,RLR,LBMS,FLPDM,RLPDM,FRPDM,RRPDM,PRBU
 SG_ LCK_FrontRightDoorLockSt : 46|1@0+ (1,0) [0|1] ""  CBM,ICM,IDC,ADC,IFC,FAPA,RRR,RLR,LBMS,FLPDM,RLPDM,FRPDM,RRPDM,PRBU
 SG_ LCK_RearLeftDoorLockSt : 45|1@0+ (1,0) [0|1] ""  OTAWL,ZCUL,ZCUR,ECS,CBM,ICM,IDC,ADC,IFC,FAPA,RRR,RLR,LBMS,FLPDM,RLPDM,FRPDM,RRPDM,PRBU
 SG_ LCK_RearRightDoorLockSt : 44|1@0+ (1,0) [0|1] ""  OTAWL,ZCUL,ZCUR,ECS,CBM,ICM,IDC,ADC,IFC,FAPA,RRR,RLR,LBMS,FLPDM,RLPDM,FRPDM,RRPDM,PRBU
 SG_ LCK_RearLeftChildSaftyLockSt : 43|1@0+ (1,0) [0|1] ""  ZCUL,ZCUR,CBM,ICM,IDC,ADC,IFC,FAPA,RRR,RLR,LBMS,RLPDM,RRPDM
 SG_ LCK_RearRightChildSaftyLockSt : 42|1@0+ (1,0) [0|1] ""  ZCUL,ZCUR,CBM,ICM,IDC,ADC,IFC,FAPA,RRR,RLR,LBMS,RLPDM,RRPDM
 SG_ EMS_EngStForPHEV : 79|3@0+ (1,0) [0|7] ""  IDC,ADC,FAPA
 SG_ WCM_Reminder : 103|1@0+ (1,0) [0|1] ""  ADC,FAPA
 SG_ WCM_ChargingSt : 89|2@0+ (1,0) [0|3] ""  ADC,FAPA
 SG_ LCK_FrontLeftDoorHandlePosition : 135|8@0+ (1,0) [0|255] ""  ICM,IDC,ADC,FAPA
 SG_ LCK_FrontRightDoorHandlePosition : 143|8@0+ (1,0) [0|255] ""  ICM,IDC,ADC,FAPA
 SG_ LCK_RearLeftDoorHandlePosition : 151|8@0+ (1,0) [0|255] ""  ZCUL,ZCUR,ICM,IDC,ADC,FAPA
 SG_ LCK_RearRightDoorHandlePosition : 159|8@0+ (1,0) [0|255] ""  ZCUL,ZCUR,ICM,IDC,ADC,FAPA
 SG_ WW_RWPMotorSt : 226|3@0+ (1,0) [0|7] ""  ADC,IFC,FAPA
 SG_ LCK_FillerCapASt : 239|1@0+ (1,0) [0|1] ""  ZCUL,ZCUR,EMS,ICM,IDC,ADC,FAPA
 SG_ LCK_FillerCapBSt : 238|1@0+ (1,0) [0|1] ""  ZCUL,ZCUR,EMS,ICM,IDC,ADC,FAPA
 SG_ AVAS_ActivatedSt : 231|3@0+ (1,0) [0|7] ""  ADC,FAPA
 SG_ MR_LeftMirrorFoldUnfoldSt : 233|2@0+ (1,0) [0|3] ""  ADC,IFC,FAPA,RRR,RLR,PCS,DLPML,DLPMR
 SG_ SBM_SwapHvBattModeSt : 247|4@0+ (1,0) [0|15] ""  ADC,FAPA
 SG_ SBM_SwapStaDiagCode : 243|4@0+ (1,0) [0|15] ""  ADC,FAPA
 SG_ SBM_SwapVehDiagCode : 255|4@0+ (1,0) [0|15] ""  ADC,FAPA
 SG_ SBM_SwapHvBattModeFaultSt : 251|3@0+ (1,0) [0|7] ""  ADC,FAPA
 SG_ IPDS_HDMapPowerSt : 271|1@0+ (1,0) [0|1] ""  ADC,IFC,FAPA
 SG_ IPDS_KL15L1PowerSt : 270|1@0+ (1,0) [0|1] ""  IBCS,ADC,IFC,FAPA,RRR,RLR
 SG_ IPDS_SRSECUPowerSt : 269|1@0+ (1,0) [0|1] ""  EPS,IBCS,ADC,IFC,FAPA
 SG_ IPDS_HODPowerSt : 268|1@0+ (1,0) [0|1] ""  ADC,IFC,FAPA
 SG_ KAE_BLEOption : 265|1@0+ (1,0) [0|1] ""  OTAWL,ADC,FAPA
 SG_ KAE_UWBOption : 264|1@0+ (1,0) [0|1] ""  OTAWL,ADC,FAPA
 SG_ PWL_WinCurrentPos_FLWinPst : 470|8@0+ (0.5,0) [0|100] "%"  ZCUT,ADC,FAPA,PLGM
 SG_ UINM_FrontLeftPowerReleaseReq : 456|1@0+ (1,0) [0|1] ""  ADC,FAPA
 SG_ UINM_FrontLeftPowerReleaseFaultSt : 457|1@0+ (1,0) [0|1] ""  ADC,FAPA
 SG_ UINM_FrontRightPowerReleaseReq : 458|1@0+ (1,0) [0|1] ""  ADC,FAPA
 SG_ UINM_FrontRightPowerReleaseFaultSt : 459|1@0+ (1,0) [0|1] ""  ADC,FAPA
 SG_ UINM_RearLeftPowerReleaseFaultSt : 460|1@0+ (1,0) [0|1] ""  ADC,FAPA
 SG_ UINM_RearLeftPowerReleaseReq : 461|1@0+ (1,0) [0|1] ""  ADC,FAPA
 SG_ UINM_RearRightPowerReleaseFaultSt : 462|1@0+ (1,0) [0|1] ""  ADC,FAPA
 SG_ UINM_RearRightPowerReleaseReq : 471|1@0+ (1,0) [0|1] ""  ADC,FAPA
 SG_ BMS_BattSOCAccurate : 478|14@0+ (0.01,0) [0|100] "%"  ADC,FAPA
 SG_ PWL_WinCurrentPos_RRWinPst : 503|8@0+ (0.5,0) [0|100] "％"  IDC,RCICP,AMP,IMR,FIMR,ADC,FAPA,PLGM
 SG_ PWL_WinCurrentPos_RLWinPst : 511|8@0+ (0.5,0) [0|100] "％"  IDC,RCICP,AMP,IMR,FIMR,ADC,FAPA,PLGM
 SG_ ACEleclocksSt : 282|3@0+ (1,0) [0|7] ""  ADC,FAPA
 SG_ DSASBM_MotResp : 375|4@0+ (1,0) [0|15] ""  ADC,FAPA
 SG_ FLISD_InteractLightSt : 382|5@0+ (1,0) [0|31] ""  ADC,IFC

BO_ 430 CCU_SRS_1: 64 CCU
 SG_ SRS_1_CRC_1 : 7|16@0+ (1,0) [0|65535] ""  ZCUF,ZCUL,ZCUR,ZCUT,EMS,EPB,ADC,IFC,FAPA,IDU,PSDL,PSDR,TBOX2,TBOX,FLPDM,RLPDM,FRPDM,RRPDM
 SG_ SRS_1_Counter_1 : 23|8@0+ (1,0) [0|255] ""  ZCUF,ZCUL,ZCUR,ZCUT,EMS,EPB,ADC,IFC,FAPA,IDU,PSDL,PSDR,TBOX2,TBOX,FLPDM,RLPDM,FRPDM,RRPDM
 SG_ SRS_CrashOutputSt : 31|8@0+ (1,0) [0|160] ""  ZCUF,ZCUL,ZCUR,ZCUT,EMS,ADC,IFC,FAPA,IDU,PSDL,PSDR,TBOX2,TBOX,FLPDM,RLPDM,FRPDM,RRPDM
 SG_ SRS_Front_CrashOutputSt : 39|1@0+ (1,0) [0|1] ""  ZCUF,ZCUL,ZCUR,ADC,IFC,FAPA,PSDL,PSDR,TBOX2,TBOX,FLPDM,RLPDM,FRPDM,RRPDM
 SG_ SRS_DriverSide_CrashOutputSt : 38|1@0+ (1,0) [0|1] ""  ZCUF,ZCUL,ZCUR,ADC,IFC,FAPA,PSDL,PSDR,TBOX2,TBOX,FLPDM,RLPDM,FRPDM,RRPDM
 SG_ SRS_PassengerSide_CrashOutputSt : 37|1@0+ (1,0) [0|1] ""  ZCUF,ZCUL,ZCUR,ADC,IFC,FAPA,PSDL,PSDR,TBOX2,TBOX,FLPDM,RLPDM,FRPDM,RRPDM
 SG_ SRS_Rear_CrashOutputSt : 36|1@0+ (1,0) [0|1] ""  ZCUF,ZCUL,ZCUR,ADC,IFC,FAPA,PSDL,PSDR,TBOX2,TBOX,FLPDM,RLPDM,FRPDM,RRPDM
 SG_ SRS_RolloverCrashOutputSt : 35|1@0+ (1,0) [0|1] ""  ZCUF,ZCUL,ZCUR,ADC,IFC,FAPA,PSDL,PSDR,TBOX2,TBOX,FLPDM,RLPDM,FRPDM,RRPDM
 SG_ SRS_NearCrashOutputSt : 34|1@0+ (1,0) [0|1] ""  ZCUF,ZCUL,ZCUR,ADC,IFC,FAPA,PSDL,PSDR,TBOX2,TBOX,FLPDM,RLPDM,FRPDM,RRPDM
 SG_ SRS_1_CRC_2 : 111|16@0+ (1,0) [0|65535] ""  ZCUF,ZCUL,ZCUR,ZCUT,EPS,ADC,IFC,FAPA,RRR,RLR
 SG_ SRS_1_Counter_2 : 127|8@0+ (1,0) [0|255] ""  ZCUF,ZCUL,ZCUR,ZCUT,EPS,ADC,IFC,FAPA,RRR,RLR
 SG_ SRS_YawSnsCalibSt : 135|1@0+ (1,0) [0|1] ""  ZCUF,ZCUL,ZCUR,ADC,IFC,FAPA,RRR,RLR
 SG_ SRS_VehLongAccelVD : 134|2@0+ (1,0) [0|3] ""  ZCUF,ZCUL,ZCUR,ZCUT,EPS,EPB,ADC,IFC,FAPA,RRR,RLR,PCS
 SG_ SRS_VehLatrlAccelVD : 132|2@0+ (1,0) [0|3] ""  ZCUF,ZCUL,ZCUR,EPS,ADC,IFC,FAPA,RRR,RLR,PCS
 SG_ SRS_YawRateVD : 130|2@0+ (1,0) [0|3] ""  ZCUF,ZCUL,ZCUR,EPS,ADC,IFC,FAPA,RRR,RLR,PCS
 SG_ SRS_VehLongAccel : 143|12@0+ (0.001,-2) [-2|2] "g"  ZCUF,ZCUL,ZCUR,ZCUT,EPS,EPB,ADC,IFC,FAPA,RRR,RLR,PCS
 SG_ SRS_VehLatrlAccel : 147|12@0+ (0.001,-2) [-2|2] "g"  ZCUF,ZCUL,ZCUR,EPS,ADC,IFC,FAPA,RRR,RLR,PCS
 SG_ SRS_YawRate : 167|16@0+ (0.01,-180) [-180|180] "deg/s"  ZCUF,ZCUL,ZCUR,EPS,ADC,IFC,FAPA,RRR,RLR,PCS

CM_ SG_ 728 ECS_1_CRC "E2E Profile 5 CRC";
CM_ SG_ 728 ECS_1_Counter "E2E Profile 5 Counter";
CM_ SG_ 728 CDC_ADCCtrlAvl "CDC control available signal";
CM_ SG_ 728 CDC_ADCCtrlRespSts "CDC control response signal";
CM_ SG_ 728 CDC_ADCModState "CDC current damped state feedback";
CM_ SG_ 459 ECS_2_CRC "E2E Profile 5 CRC";
CM_ SG_ 459 ECS_2_Counter "E2E Profile 5 Counter";
CM_ SG_ 459 AS_SuspHeightFL "Height of front left wheel";
CM_ SG_ 459 AS_SuspHeightFR "Height of front right wheel";
CM_ SG_ 459 AS_SuspHeightRL "Height of rear left wheel";
CM_ SG_ 459 AS_SuspHeightRR "Height of rear right wheel";
CM_ SG_ 459 AS_SuspHeightFLVD "Height of front left wheel validity";
CM_ SG_ 459 AS_SuspHeightFRVD "Height of front right wheel validity";
CM_ SG_ 459 AS_SuspHeightRLVD "Height of rear left wheel validity";
CM_ SG_ 459 AS_SuspHeightRRVD "Height of rear right wheel validity";
CM_ SG_ 459 AS_SuspHeightSensorFLSt "Front left suspension height sensor fault status";
CM_ SG_ 459 AS_SuspHeightSensorFRSt "Front right suspension height sensor fault status";
CM_ SG_ 459 AS_SuspHeightSensorRLSt "Rear left suspension height sensor fault status";
CM_ SG_ 459 AS_SuspHeightSensoRRSt "Rear right suspension height sensor fault status";
CM_ SG_ 459 AS_MaintanceModeSt "Air spring maintance mode status";
CM_ SG_ 459 ECS_AVDCReqMode "Electronic control suspension internal mode for AVDC电子控制悬架AVDC执行状态";
CM_ SG_ 459 AS_FrontAxleSuspSt "Height adjustment of the front axle";
CM_ SG_ 459 AS_RearAxleSuspSt "Height adjustment status of rear axle";
CM_ SG_ 459 AS_HeightWarningSt "Vehicle height warning";
CM_ SG_ 459 AS_CurrentLevel "Vehicle current height level";
CM_ SG_ 459 AS_ASMode "Air spring opreation mode";
CM_ SG_ 459 AS_SysFaultSt "Air Spring system fault";
CM_ SG_ 459 AS_SysOperationSt "Air Spring operation status";
CM_ SG_ 459 AS_ADCStfnCtrlAvl "Available signals for suspension stiffness control";
CM_ SG_ 459 AS_ADCStfnState "Suspension stiffness state feedback signal";
CM_ SG_ 905 ICM_SetIACCSt "ICM set IACC status";
CM_ SG_ 905 ICM_TotalOdometer "Total odometer";
CM_ SG_ 905 ICM_VehInsSpd "Vehicle instantaneous speed";
CM_ SG_ 905 ICM_TotalOdometer_accurate "ODO value as accuracy of 0.1 km";
CM_ SG_ 905 ICM_VehInsSpd_accurate "Vehicle instantaneous speed";
CM_ SG_ 905 ICM_FuelAvaibleDriveDistance "The available driving distance according to the fuel";
CM_ SG_ 905 ICM_TotalAvaibleDriveDistance "The available driving distance according to the total";
CM_ SG_ 161 ACU_FaceID_Delete "Delete_FaceID";
CM_ SG_ 161 ACU_RegisterTriger "FaceID register triger";
CM_ SG_ 161 ACU_VerifyTriger "FaceID verify triger";
CM_ SG_ 161 ACU_FaceIDQuit "FaceID quit triger";
CM_ SG_ 161 ACU_FaceIDSwitch "FaceID switch triger";
CM_ SG_ 161 ACU_AVAS_SwitchCfgReq "AVAS switch configuration require";
CM_ SG_ 913 CCU_GwMsg_L3_CRC "E2E Profile 5 CRC";
CM_ SG_ 913 CCU_GwMsg_L3_Counter "E2E Profile 5 Counter";
CM_ SG_ 913 IL_PADS_LightbarSt "Steering wheel ambient light bar current status";
CM_ SG_ 913 IL_PADS_LightbarErrSt "Steering wheel ambient light bar error feedback";
CM_ SG_ 913 UINM_PADS_L3SWSt "Indicates PADS's L3 swtich state";
CM_ SG_ 913 UINM_PADS_L3SWStVD "Indicates PADS's L3 swtich state Validity";
CM_ SG_ 913 UINM_PADS_L3SWStuckSt "Indicates PADS's IDC MODE swtich stuck state";
CM_ SG_ 904 CCU_GwMsg_4_CRC "E2E Profile 5 CRC";
CM_ SG_ 904 CCU_GwMsg_4_Counter "E2E Profile 5 Counter";
CM_ SG_ 904 HVAC_RearDefrostSt "Rear window and mirror heater activation status";
CM_ SG_ 904 HVAC_WindExitMode "The wind exit mode";
CM_ SG_ 904 HVAC_CorrectedExterTemp "Corrected External temperature";
CM_ SG_ 904 HVAC_CorrectedExterTempVD "External temperature valid data";
CM_ SG_ 904 HVAC_CorrectedCabinTemp "Corrected cabin temperature";
CM_ SG_ 904 HVAC_CorrectedCabinTempVD "Signal CorrectedCabinTemp validity";
CM_ SG_ 904 WW_FwpFaultSt "Front Wiper Fault state";
CM_ SG_ 904 WW_RwpFaultSt "Rear Wiper Fault state";
CM_ SG_ 904 WW_FwshFaultSt "Front Washer Fault state";
CM_ SG_ 904 WW_RwshFaultSt "Rear Washer Fault state";
CM_ SG_ 904 WW_FwpAutoModeSt "Front Wiper Auto Mode state";
CM_ SG_ 904 WW_RainFallLevel "Rain Fall Level";
CM_ SG_ 904 RLS_LightOnReq "Switch on/off low beam request";
CM_ SG_ 904 RLS_LampOnReqValid "Lamp On Request signal valid";
CM_ SG_ 904 RLS_WiperSpd "Wiper speed mode";
CM_ SG_ 904 RLS_AMBBrightness "Ambient Light Brightness";
CM_ SG_ 904 RLS_FWBrightness "Forward Light Brightness";
CM_ SG_ 904 RLS_RainfallLevel "Rain level";
CM_ SG_ 904 RLS_RSErr "Error status rain sensor";
CM_ SG_ 904 RLS_LSErr "Error status light sensor";
CM_ SG_ 904 PM_AUTHPstState "位置授权开关状态";
CM_ SG_ 904 CCU_FuncReq_SentryMod "Sentry Mode Wake SOC of MDC";
CM_ SG_ 904 RLS_WindShieldHum "Data windshield humidity";
CM_ SG_ 904 RLS_WindShieldTem "Temperature of the windscreen in ℃";
CM_ SG_ 904 RLS_DewPoint "Dew Temperature of the windscreen in ℃";
CM_ SG_ 904 CCU_ModeSuppressSts "Sentry Mode Suppress Status";
CM_ SG_ 904 RLS_HUTErr "HT sensor status";
CM_ SG_ 904 SR_SunroofCurrentPst "Sunroof current Position";
CM_ SG_ 904 EL_LeftBSDIndicatorSt "Left BSD indicator status";
CM_ SG_ 904 UINM_HazardLightSwSt "Hazard light switch status";
CM_ SG_ 904 EL_MLTurnLightSt "Middle left turn light status";
CM_ SG_ 904 EL_MLTurnLightFaultSt "Middle left turn light fault status";
CM_ SG_ 904 EL_LeftBSDIndicatorFaultSt "Left BSD indicator fault status";
CM_ SG_ 904 ZCUL_FrtWindshildHeatSt "Front windshield heating status";
CM_ SG_ 904 ACU_PCS_SVM_MODCmd "Panorama function setting option MOD function switch";
CM_ SG_ 904 ACU_HeadLightVirtualSwSt "HeadLight virtual switch status";
CM_ SG_ 904 ACU_FrontFogLightVirtualSwSt "Front fog light virtual switch status";
CM_ SG_ 904 ACU_RearFogLightVirtualSwSt "Rear fog light virtual switch status";
CM_ SG_ 904 ACU_Account_Uid "Account_Uid";
CM_ SG_ 904 ACU_IHBC_SwitchReq "IHBC(Intelligent High Beam Control) switch signal";
CM_ SG_ 904 ACU_NDASwitchReq "NDA main switch request";
CM_ SG_ 904 ACU_NDALCConSwitchReq "NDA lane change driver confirm switch request";
CM_ SG_ 904 ACU_NDALCStySwitchReq "NDA lane change style switch request";
CM_ SG_ 904 ACU_ADASWarnTypeSwitch "ADAS warning type switch signal";
CM_ SG_ 904 ACU_iACC_StyleConfirmSwitchReq "iACC Style confirm switch";
CM_ SG_ 904 ACU_IFC_SpeedLimit "Speed limit value from navigation map dataand GPS location.";
CM_ SG_ 904 ACU_IFC_ISDRestOfdis "Interval speed detection rest of distacne.Once navigation jduge vehicle run in aninterval speed detection area of road, thissignal begin to send specific value,otherwise keep sending 0x0.";
CM_ SG_ 904 ACU_IFC_SpeedLimitUnit "Speed limit unit ";
CM_ SG_ 904 ACU_ThemeType "AVNT theme type";
CM_ SG_ 904 ACU_IFC_SpeedLimtType "speed limit type from navigation map dataand GPS location.";
CM_ SG_ 904 ACU_IFC_RoadType "Road type from navigation map data andGPS location.";
CM_ SG_ 904 ACU_IFC_ZoneCode "Zone code ";
CM_ SG_ 904 ACU_IFC_NaviSt "Navigation state ";
CM_ SG_ 904 ACU_IFC_NaviCorp "the working navigation map corporation ";
CM_ SG_ 904 ACU_IFC_NaviNewIconDis "the remain distances of navigation newIcon ";
CM_ SG_ 904 ACU_IFC_OfframpSt "The front is off-ramp or not whennavigation";
CM_ SG_ 904 ACU_IFC_NaviNewIcon "indication the navigation newIcon ";
CM_ SG_ 904 ACU_IFC_SLCAheadDis "speed limit camera ahead distacne. Oncenavigation jduge there is a speed limitcamera ahead that the vehicle will pass by,this signal begin to send specific value,otherwise keep sending 0x0.";
CM_ SG_ 904 ACU_DVR_Switch "DVR Function Switch";
CM_ SG_ 904 ACU_IFC_OfframpDis "The distance to front off-ramp ";
CM_ SG_ 904 SSW_FLSeatSlideCurrentPst "Front Left Seat Slide Current  Position Percentage";
CM_ SG_ 904 SSW_FLSeatHeightCurrentPst "Front Left Seat Height Current  Position Percentage ";
CM_ SG_ 904 SSW_FLSeatBackrestCurrentPst "Front Left Seat Backrest Current  Position Percentage ";
CM_ SG_ 904 DrvrSideMotResp "Driver Side Seat Belt Motor Response";
CM_ SG_ 904 EL_LeftLowBeamSt "Left low beam status";
CM_ SG_ 904 EL_LeftLowBeamFaultSt "Left low beam fault status";
CM_ SG_ 904 EL_RightLowBeamSt "Right low beam status";
CM_ SG_ 904 EL_RightLowBeamFaultSt "Right low beam fault status";
CM_ SG_ 904 WW_FWPMotorSt "FrontWiper Motor status";
CM_ SG_ 904 EL_MLADASLightSt "Middle left ADAS light status";
CM_ SG_ 904 EL_FLTurnLightSt "Front left turn light status";
CM_ SG_ 904 EL_FLTurnLightFaultSt "Front left turn light fault status";
CM_ SG_ 904 EL_FRTurnLightSt "Front right turn light status";
CM_ SG_ 904 EL_FRTurnLightFaultSt "Front right turn light fault status";
CM_ SG_ 904 EL_SideBrkLightSt "Side brake light status";
CM_ SG_ 904 EL_SideBrkLightFaultSt "Side brake light fault status";
CM_ SG_ 904 EL_CHMSLSt "Centre high mounted stop lamp status";
CM_ SG_ 904 EL_CHMSLFaultSt "Centre high mounted stop lamp fault status";
CM_ SG_ 904 EL_RLTurnLightSt "Rear left turn light status";
CM_ SG_ 904 EL_RLTurnLightFaultSt "Rear left turn light fault status";
CM_ SG_ 904 EL_RRTurnLightSt "Rear right turn light status";
CM_ SG_ 904 EL_RRTurnLightFaultSt "Rear right turn light fault status";
CM_ SG_ 904 IPDS_BAT1PowerSt "BAT1 power  state";
CM_ SG_ 904 IPDS_BAT2PowerSt "BAT2 power  state";
CM_ SG_ 904 IPDS_DCDC2PowerSt "DCDC2 power  state";
CM_ SG_ 904 IPDS_GridIsoPowerSt "Grid Isolation Power State";
CM_ SG_ 904 IPS_DCDCModeSt "mode status of DCDC";
CM_ SG_ 904 IPDS_FRRadarPowerSup "FRR radar power supply";
CM_ SG_ 904 LBMS_SOFVD "LBMS Validity of SOF";
CM_ SG_ 904 LBMS_SOFEN "LBMS  State of Function Enable";
CM_ SG_ 904 LBMSAD_SOFVD "LBMSAD Validity of SOF";
CM_ SG_ 904 LBMSAD_SOFEN "LBMSAD  State of Function Enable";
CM_ SG_ 904 IPDS_FLRadarPowerSup "FLR radar power supply";
CM_ SG_ 904 IPDS_FrontRadarPowerSup "Front radar power supply";
CM_ SG_ 904 IPDS_HDMapPowerSup "HD map power supply";
CM_ SG_ 904 IPDS_RearRadarPowerSup "Rear radar power supply";
CM_ SG_ 909 LCK_HoodAjarSt "HoodAjarSt";
CM_ SG_ 909 LCK_FrontLeftDoorAjarSt "FrontLeftDoorAjarSt";
CM_ SG_ 909 LCK_FrontRightDoorAjarSt "FrontRightDoorAjarSt";
CM_ SG_ 909 LCK_RearLeftDoorAjarSt "RearLeftDoorAjarSt";
CM_ SG_ 909 LCK_RearRightDoorAjarSt "RearRightDoorAjarSt";
CM_ SG_ 909 LCK_TrunkAjarSt "TrunkAjarSt";
CM_ SG_ 909 LCK_FrontLeftDoorLockSt "FrontLeftDoorLockSt";
CM_ SG_ 909 LCK_FrontRightDoorLockSt "FrontRightDoorLockSt";
CM_ SG_ 909 LCK_RearLeftDoorLockSt "RearLeftDoorLockSt";
CM_ SG_ 909 LCK_RearRightDoorLockSt "RearRightDoorLockSt";
CM_ SG_ 909 LCK_RearLeftChildSaftyLockSt "RearLeftChildSaftyLockSt";
CM_ SG_ 909 LCK_RearRightChildSaftyLockSt "RearRightChildSaftyLockSt";
CM_ SG_ 909 EMS_EngStForPHEV "Engine running status for PHEV";
CM_ SG_ 909 WCM_Reminder "Reminder the Phone lft";
CM_ SG_ 909 WCM_ChargingSt "Changing is ongoing or stopped";
CM_ SG_ 909 LCK_FrontLeftDoorHandlePosition "FrontLeftDoorHandlePosition";
CM_ SG_ 909 LCK_FrontRightDoorHandlePosition "FrontRightDoorHandlePosition";
CM_ SG_ 909 LCK_RearLeftDoorHandlePosition "RearLeftDoorHandlePosition";
CM_ SG_ 909 LCK_RearRightDoorHandlePosition "RearRightDoorHandlePosition";
CM_ SG_ 909 WW_RWPMotorSt "RearWiper Motor status";
CM_ SG_ 909 LCK_FillerCapASt "FillerCapASt";
CM_ SG_ 909 LCK_FillerCapBSt "FillerCapBSt";
CM_ SG_ 909 AVAS_ActivatedSt "AVAS activated status";
CM_ SG_ 909 MR_LeftMirrorFoldUnfoldSt "Left Mirror Fold Unfold Status";
CM_ SG_ 909 SBM_SwapHvBattModeSt "Swap station mode statue";
CM_ SG_ 909 SBM_SwapStaDiagCode "Swap station erroe";
CM_ SG_ 909 SBM_SwapVehDiagCode "vehicl erroe in swap station";
CM_ SG_ 909 SBM_SwapHvBattModeFaultSt "Swap station mode fault statue";
CM_ SG_ 909 IPDS_HDMapPowerSt "HD map power state";
CM_ SG_ 909 IPDS_KL15L1PowerSt "KL15 L1 power state";
CM_ SG_ 909 IPDS_SRSECUPowerSt "SRS ECU power state";
CM_ SG_ 909 IPDS_HODPowerSt "HOD power state";
CM_ SG_ 909 KAE_BLEOption "BLEOption";
CM_ SG_ 909 KAE_UWBOption "UWB Option";
CM_ SG_ 909 PWL_WinCurrentPos_FLWinPst "Window Current Position Front left Window";
CM_ SG_ 909 UINM_FrontLeftPowerReleaseReq "FrontLeftPowerReleaseReq";
CM_ SG_ 909 UINM_FrontLeftPowerReleaseFaultSt "Front Left Power Release Swtich fault state";
CM_ SG_ 909 UINM_FrontRightPowerReleaseReq "FrontRightPowerReleaseReq";
CM_ SG_ 909 UINM_FrontRightPowerReleaseFaultSt "Front Right Power Release Swtich fault state";
CM_ SG_ 909 UINM_RearLeftPowerReleaseFaultSt "RearLeftPowerReleaseReq";
CM_ SG_ 909 UINM_RearLeftPowerReleaseReq "RearLeftPowerReleaseReq";
CM_ SG_ 909 UINM_RearRightPowerReleaseFaultSt "RearRightPowerReleaseReq";
CM_ SG_ 909 UINM_RearRightPowerReleaseReq "RearRightPowerReleaseReq";
CM_ SG_ 909 BMS_BattSOCAccurate "Accurate SOC Value sent to other contoller";
CM_ SG_ 909 PWL_WinCurrentPos_RRWinPst "Rear Right Window Current Position";
CM_ SG_ 909 PWL_WinCurrentPos_RLWinPst "Rear Left Window Current Position";
CM_ SG_ 909 ACEleclocksSt "AC gun electronic lock status feedback";
CM_ SG_ 909 DSASBM_MotResp "Driver Side Active Seat Belt Motor Response";
CM_ SG_ 909 FLISD_InteractLightSt "Front left Intelligent signal display Interact light status";
CM_ SG_ 430 SRS_1_CRC_1 "E2E Profile 5 CRC";
CM_ SG_ 430 SRS_1_Counter_1 "E2E Profile 5 Counter";
CM_ SG_ 430 SRS_CrashOutputSt "To inform there's crash event happened in last 2 seconds.After 2 seconds, the signal will turn to 0(crash here means any one of the 5 status defined below)";
CM_ SG_ 430 SRS_Front_CrashOutputSt "To inform there's front crash event happened in last 2 seconds. After 2 seconds, the signal will turn to 0.";
CM_ SG_ 430 SRS_DriverSide_CrashOutputSt "To inform there's driver side crash event happened in last 2 seconds. After 2 seconds, the signal will turn to 0.(Driver side is the left side for the left-hand-drive vehicle, the right side for the right-hand-drive one. )";
CM_ SG_ 430 SRS_PassengerSide_CrashOutputSt "To inform there's passenger side crash event happened in last 2 seconds. After 2 seconds, the signal will turn to 0.(Passenger side is the right side for the left-hand-drive vehicle, the left side for the right-hand-drive one. )";
CM_ SG_ 430 SRS_Rear_CrashOutputSt "To inform there's rear crash event happened in last 2 seconds. After 2 seconds, the signal will turn to 0.";
CM_ SG_ 430 SRS_RolloverCrashOutputSt "To inform there's rollover crash event happened in last 2 seconds. After 2 seconds, the signal will turn to 0.";
CM_ SG_ 430 SRS_NearCrashOutputSt "To inform there's near crash event happened in last 2 seconds.After 2 seconds, the signal will turn to 0";
CM_ SG_ 430 SRS_1_CRC_2 "E2E Profile 5 CRC";
CM_ SG_ 430 SRS_1_Counter_2 "E2E Profile 5 Counter";
CM_ SG_ 430 SRS_YawSnsCalibSt "To indicates  yaw sensor calibration state";
CM_ SG_ 430 SRS_VehLongAccelVD "To indicate vehicle longitudinal acceleration valid state";
CM_ SG_ 430 SRS_VehLatrlAccelVD "To indicate vehicle lateral acceleration valid state";
CM_ SG_ 430 SRS_YawRateVD "To indicate yaw rate valid state";
CM_ SG_ 430 SRS_VehLongAccel "To indicate vehicle longitudinal acceleration";
CM_ SG_ 430 SRS_VehLatrlAccel "To indicate vehicle lateral acceleration";
CM_ SG_ 430 SRS_YawRate "To indicate vehicle yaw rate";

BA_DEF_ BO_  "GenMsgCycleTime" INT 0 0;
BA_DEF_ BO_  "GenMsgCycleTimeFast" INT 0 0;
BA_DEF_ BO_  "GenMsgSendType" ENUM  "Periodic","Event","IfActive","POE","PA","FixedPeriodic","Event","EnabledPeriodic","NotUsed","NotUsed","EventPeriodic","NotUsed","NotUsed","NoMsgSendType";
BA_DEF_ BO_  "VFrameFormat" ENUM  "StandardCAN","ExtendedCAN","reserved","reserved","reserved","reserved","reserved","reserved","reserved","reserved","reserved","reserved","reserved","reserved","StandardCAN_FD","ExtendedCAN_FD";
BA_DEF_ BO_  "CANFD_BRS" ENUM  "0","1";
BA_DEF_ SG_  "EventCommandSignal" ENUM  "No","Yes";
BA_DEF_ SG_  "GatewayedSignals" ENUM  "No","Yes";
BA_DEF_ SG_  "GenSigInactiveValue" HEX 0 0;
BA_DEF_ SG_  "GenSigInvalidValue" HEX 0 0;
BA_DEF_ SG_  "GenSigSendType" ENUM  "Trigger","Passive","Cyclic","OnWrite","OnWriteWithRepetition","OnChange","OnChangeWithRepetition","IfActive","IfActiveWithRepetition","NoSigSendType";
BA_DEF_ SG_  "GenSigStartValue" HEX 0 0;
BA_DEF_ SG_  "GenSigTimeoutValue" HEX 0 0;
BA_DEF_ SG_  "Remark" STRING ;
BA_ "GenMsgCycleTime" BO_ 728 100;
BA_ "GenMsgCycleTimeFast" BO_ 728 0;
BA_ "GenMsgSendType" BO_ 728 0;
BA_ "VFrameFormat" BO_ 728 14;
BA_ "CANFD_BRS" BO_ 728 1;
BA_ "GenMsgCycleTime" BO_ 728 100;
BA_ "GenMsgCycleTimeFast" BO_ 728 0;
BA_ "GenMsgSendType" BO_ 728 0;
BA_ "VFrameFormat" BO_ 728 14;
BA_ "CANFD_BRS" BO_ 728 1;
BA_ "GenMsgCycleTime" BO_ 728 100;
BA_ "GenMsgCycleTimeFast" BO_ 728 0;
BA_ "GenMsgSendType" BO_ 728 0;
BA_ "VFrameFormat" BO_ 728 14;
BA_ "CANFD_BRS" BO_ 728 1;
BA_ "GenMsgCycleTime" BO_ 728 100;
BA_ "GenMsgCycleTimeFast" BO_ 728 0;
BA_ "GenMsgSendType" BO_ 728 0;
BA_ "VFrameFormat" BO_ 728 14;
BA_ "CANFD_BRS" BO_ 728 1;
BA_ "GenMsgCycleTime" BO_ 728 100;
BA_ "GenMsgCycleTimeFast" BO_ 728 0;
BA_ "GenMsgSendType" BO_ 728 0;
BA_ "VFrameFormat" BO_ 728 14;
BA_ "CANFD_BRS" BO_ 728 1;
BA_ "GenMsgCycleTime" BO_ 459 20;
BA_ "GenMsgCycleTimeFast" BO_ 459 0;
BA_ "GenMsgSendType" BO_ 459 0;
BA_ "VFrameFormat" BO_ 459 14;
BA_ "CANFD_BRS" BO_ 459 1;
BA_ "GenMsgCycleTime" BO_ 459 20;
BA_ "GenMsgCycleTimeFast" BO_ 459 0;
BA_ "GenMsgSendType" BO_ 459 0;
BA_ "VFrameFormat" BO_ 459 14;
BA_ "CANFD_BRS" BO_ 459 1;
BA_ "GenMsgCycleTime" BO_ 459 20;
BA_ "GenMsgCycleTimeFast" BO_ 459 0;
BA_ "GenMsgSendType" BO_ 459 0;
BA_ "VFrameFormat" BO_ 459 14;
BA_ "CANFD_BRS" BO_ 459 1;
BA_ "GenMsgCycleTime" BO_ 459 20;
BA_ "GenMsgCycleTimeFast" BO_ 459 0;
BA_ "GenMsgSendType" BO_ 459 0;
BA_ "VFrameFormat" BO_ 459 14;
BA_ "CANFD_BRS" BO_ 459 1;
BA_ "GenMsgCycleTime" BO_ 459 20;
BA_ "GenMsgCycleTimeFast" BO_ 459 0;
BA_ "GenMsgSendType" BO_ 459 0;
BA_ "VFrameFormat" BO_ 459 14;
BA_ "CANFD_BRS" BO_ 459 1;
BA_ "GenMsgCycleTime" BO_ 459 20;
BA_ "GenMsgCycleTimeFast" BO_ 459 0;
BA_ "GenMsgSendType" BO_ 459 0;
BA_ "VFrameFormat" BO_ 459 14;
BA_ "CANFD_BRS" BO_ 459 1;
BA_ "GenMsgCycleTime" BO_ 459 20;
BA_ "GenMsgCycleTimeFast" BO_ 459 0;
BA_ "GenMsgSendType" BO_ 459 0;
BA_ "VFrameFormat" BO_ 459 14;
BA_ "CANFD_BRS" BO_ 459 1;
BA_ "GenMsgCycleTime" BO_ 459 20;
BA_ "GenMsgCycleTimeFast" BO_ 459 0;
BA_ "GenMsgSendType" BO_ 459 0;
BA_ "VFrameFormat" BO_ 459 14;
BA_ "CANFD_BRS" BO_ 459 1;
BA_ "GenMsgCycleTime" BO_ 459 20;
BA_ "GenMsgCycleTimeFast" BO_ 459 0;
BA_ "GenMsgSendType" BO_ 459 0;
BA_ "VFrameFormat" BO_ 459 14;
BA_ "CANFD_BRS" BO_ 459 1;
BA_ "GenMsgCycleTime" BO_ 459 20;
BA_ "GenMsgCycleTimeFast" BO_ 459 0;
BA_ "GenMsgSendType" BO_ 459 0;
BA_ "VFrameFormat" BO_ 459 14;
BA_ "CANFD_BRS" BO_ 459 1;
BA_ "GenMsgCycleTime" BO_ 459 20;
BA_ "GenMsgCycleTimeFast" BO_ 459 0;
BA_ "GenMsgSendType" BO_ 459 0;
BA_ "VFrameFormat" BO_ 459 14;
BA_ "CANFD_BRS" BO_ 459 1;
BA_ "GenMsgCycleTime" BO_ 459 20;
BA_ "GenMsgCycleTimeFast" BO_ 459 0;
BA_ "GenMsgSendType" BO_ 459 0;
BA_ "VFrameFormat" BO_ 459 14;
BA_ "CANFD_BRS" BO_ 459 1;
BA_ "GenMsgCycleTime" BO_ 459 20;
BA_ "GenMsgCycleTimeFast" BO_ 459 0;
BA_ "GenMsgSendType" BO_ 459 0;
BA_ "VFrameFormat" BO_ 459 14;
BA_ "CANFD_BRS" BO_ 459 1;
BA_ "GenMsgCycleTime" BO_ 459 20;
BA_ "GenMsgCycleTimeFast" BO_ 459 0;
BA_ "GenMsgSendType" BO_ 459 0;
BA_ "VFrameFormat" BO_ 459 14;
BA_ "CANFD_BRS" BO_ 459 1;
BA_ "GenMsgCycleTime" BO_ 459 20;
BA_ "GenMsgCycleTimeFast" BO_ 459 0;
BA_ "GenMsgSendType" BO_ 459 0;
BA_ "VFrameFormat" BO_ 459 14;
BA_ "CANFD_BRS" BO_ 459 1;
BA_ "GenMsgCycleTime" BO_ 459 20;
BA_ "GenMsgCycleTimeFast" BO_ 459 0;
BA_ "GenMsgSendType" BO_ 459 0;
BA_ "VFrameFormat" BO_ 459 14;
BA_ "CANFD_BRS" BO_ 459 1;
BA_ "GenMsgCycleTime" BO_ 459 20;
BA_ "GenMsgCycleTimeFast" BO_ 459 0;
BA_ "GenMsgSendType" BO_ 459 0;
BA_ "VFrameFormat" BO_ 459 14;
BA_ "CANFD_BRS" BO_ 459 1;
BA_ "GenMsgCycleTime" BO_ 459 20;
BA_ "GenMsgCycleTimeFast" BO_ 459 0;
BA_ "GenMsgSendType" BO_ 459 0;
BA_ "VFrameFormat" BO_ 459 14;
BA_ "CANFD_BRS" BO_ 459 1;
BA_ "GenMsgCycleTime" BO_ 459 20;
BA_ "GenMsgCycleTimeFast" BO_ 459 0;
BA_ "GenMsgSendType" BO_ 459 0;
BA_ "VFrameFormat" BO_ 459 14;
BA_ "CANFD_BRS" BO_ 459 1;
BA_ "GenMsgCycleTime" BO_ 459 20;
BA_ "GenMsgCycleTimeFast" BO_ 459 0;
BA_ "GenMsgSendType" BO_ 459 0;
BA_ "VFrameFormat" BO_ 459 14;
BA_ "CANFD_BRS" BO_ 459 1;
BA_ "GenMsgCycleTime" BO_ 459 20;
BA_ "GenMsgCycleTimeFast" BO_ 459 0;
BA_ "GenMsgSendType" BO_ 459 0;
BA_ "VFrameFormat" BO_ 459 14;
BA_ "CANFD_BRS" BO_ 459 1;
BA_ "GenMsgCycleTime" BO_ 459 20;
BA_ "GenMsgCycleTimeFast" BO_ 459 0;
BA_ "GenMsgSendType" BO_ 459 0;
BA_ "VFrameFormat" BO_ 459 14;
BA_ "CANFD_BRS" BO_ 459 1;
BA_ "GenMsgCycleTime" BO_ 459 20;
BA_ "GenMsgCycleTimeFast" BO_ 459 0;
BA_ "GenMsgSendType" BO_ 459 0;
BA_ "VFrameFormat" BO_ 459 14;
BA_ "CANFD_BRS" BO_ 459 1;
BA_ "GenMsgCycleTime" BO_ 459 20;
BA_ "GenMsgCycleTimeFast" BO_ 459 0;
BA_ "GenMsgSendType" BO_ 459 0;
BA_ "VFrameFormat" BO_ 459 14;
BA_ "CANFD_BRS" BO_ 459 1;
BA_ "GenMsgCycleTime" BO_ 459 20;
BA_ "GenMsgCycleTimeFast" BO_ 459 0;
BA_ "GenMsgSendType" BO_ 459 0;
BA_ "VFrameFormat" BO_ 459 14;
BA_ "CANFD_BRS" BO_ 459 1;
BA_ "GenMsgCycleTime" BO_ 459 20;
BA_ "GenMsgCycleTimeFast" BO_ 459 0;
BA_ "GenMsgSendType" BO_ 459 0;
BA_ "VFrameFormat" BO_ 459 14;
BA_ "CANFD_BRS" BO_ 459 1;
BA_ "GenMsgCycleTime" BO_ 905 100;
BA_ "GenMsgCycleTimeFast" BO_ 905 0;
BA_ "GenMsgSendType" BO_ 905 0;
BA_ "VFrameFormat" BO_ 905 14;
BA_ "CANFD_BRS" BO_ 905 1;
BA_ "GenMsgCycleTime" BO_ 905 100;
BA_ "GenMsgCycleTimeFast" BO_ 905 0;
BA_ "GenMsgSendType" BO_ 905 0;
BA_ "VFrameFormat" BO_ 905 14;
BA_ "CANFD_BRS" BO_ 905 1;
BA_ "GenMsgCycleTime" BO_ 905 100;
BA_ "GenMsgCycleTimeFast" BO_ 905 0;
BA_ "GenMsgSendType" BO_ 905 0;
BA_ "VFrameFormat" BO_ 905 14;
BA_ "CANFD_BRS" BO_ 905 1;
BA_ "GenMsgCycleTime" BO_ 905 100;
BA_ "GenMsgCycleTimeFast" BO_ 905 0;
BA_ "GenMsgSendType" BO_ 905 0;
BA_ "VFrameFormat" BO_ 905 14;
BA_ "CANFD_BRS" BO_ 905 1;
BA_ "GenMsgCycleTime" BO_ 905 100;
BA_ "GenMsgCycleTimeFast" BO_ 905 0;
BA_ "GenMsgSendType" BO_ 905 0;
BA_ "VFrameFormat" BO_ 905 14;
BA_ "CANFD_BRS" BO_ 905 1;
BA_ "GenMsgCycleTime" BO_ 905 100;
BA_ "GenMsgCycleTimeFast" BO_ 905 0;
BA_ "GenMsgSendType" BO_ 905 0;
BA_ "VFrameFormat" BO_ 905 14;
BA_ "CANFD_BRS" BO_ 905 1;
BA_ "GenMsgCycleTime" BO_ 905 100;
BA_ "GenMsgCycleTimeFast" BO_ 905 0;
BA_ "GenMsgSendType" BO_ 905 0;
BA_ "VFrameFormat" BO_ 905 14;
BA_ "CANFD_BRS" BO_ 905 1;
BA_ "GenMsgCycleTime" BO_ 161 0;
BA_ "GenMsgCycleTimeFast" BO_ 161 0;
BA_ "GenMsgSendType" BO_ 161 1;
BA_ "VFrameFormat" BO_ 161 14;
BA_ "CANFD_BRS" BO_ 161 1;
BA_ "GenMsgCycleTime" BO_ 161 0;
BA_ "GenMsgCycleTimeFast" BO_ 161 0;
BA_ "GenMsgSendType" BO_ 161 1;
BA_ "VFrameFormat" BO_ 161 14;
BA_ "CANFD_BRS" BO_ 161 1;
BA_ "GenMsgCycleTime" BO_ 161 0;
BA_ "GenMsgCycleTimeFast" BO_ 161 0;
BA_ "GenMsgSendType" BO_ 161 1;
BA_ "VFrameFormat" BO_ 161 14;
BA_ "CANFD_BRS" BO_ 161 1;
BA_ "GenMsgCycleTime" BO_ 161 0;
BA_ "GenMsgCycleTimeFast" BO_ 161 0;
BA_ "GenMsgSendType" BO_ 161 1;
BA_ "VFrameFormat" BO_ 161 14;
BA_ "CANFD_BRS" BO_ 161 1;
BA_ "GenMsgCycleTime" BO_ 161 0;
BA_ "GenMsgCycleTimeFast" BO_ 161 0;
BA_ "GenMsgSendType" BO_ 161 1;
BA_ "VFrameFormat" BO_ 161 14;
BA_ "CANFD_BRS" BO_ 161 1;
BA_ "GenMsgCycleTime" BO_ 161 0;
BA_ "GenMsgCycleTimeFast" BO_ 161 0;
BA_ "GenMsgSendType" BO_ 161 1;
BA_ "VFrameFormat" BO_ 161 14;
BA_ "CANFD_BRS" BO_ 161 1;
BA_ "GenMsgCycleTime" BO_ 913 60;
BA_ "GenMsgCycleTimeFast" BO_ 913 0;
BA_ "GenMsgSendType" BO_ 913 0;
BA_ "VFrameFormat" BO_ 913 14;
BA_ "CANFD_BRS" BO_ 913 1;
BA_ "GenMsgCycleTime" BO_ 913 60;
BA_ "GenMsgCycleTimeFast" BO_ 913 0;
BA_ "GenMsgSendType" BO_ 913 0;
BA_ "VFrameFormat" BO_ 913 14;
BA_ "CANFD_BRS" BO_ 913 1;
BA_ "GenMsgCycleTime" BO_ 913 60;
BA_ "GenMsgCycleTimeFast" BO_ 913 0;
BA_ "GenMsgSendType" BO_ 913 0;
BA_ "VFrameFormat" BO_ 913 14;
BA_ "CANFD_BRS" BO_ 913 1;
BA_ "GenMsgCycleTime" BO_ 913 60;
BA_ "GenMsgCycleTimeFast" BO_ 913 0;
BA_ "GenMsgSendType" BO_ 913 0;
BA_ "VFrameFormat" BO_ 913 14;
BA_ "CANFD_BRS" BO_ 913 1;
BA_ "GenMsgCycleTime" BO_ 913 60;
BA_ "GenMsgCycleTimeFast" BO_ 913 0;
BA_ "GenMsgSendType" BO_ 913 0;
BA_ "VFrameFormat" BO_ 913 14;
BA_ "CANFD_BRS" BO_ 913 1;
BA_ "GenMsgCycleTime" BO_ 913 60;
BA_ "GenMsgCycleTimeFast" BO_ 913 0;
BA_ "GenMsgSendType" BO_ 913 0;
BA_ "VFrameFormat" BO_ 913 14;
BA_ "CANFD_BRS" BO_ 913 1;
BA_ "GenMsgCycleTime" BO_ 913 60;
BA_ "GenMsgCycleTimeFast" BO_ 913 0;
BA_ "GenMsgSendType" BO_ 913 0;
BA_ "VFrameFormat" BO_ 913 14;
BA_ "CANFD_BRS" BO_ 913 1;
BA_ "GenMsgCycleTime" BO_ 904 100;
BA_ "GenMsgCycleTimeFast" BO_ 904 0;
BA_ "GenMsgSendType" BO_ 904 0;
BA_ "VFrameFormat" BO_ 904 14;
BA_ "CANFD_BRS" BO_ 904 1;
BA_ "GenMsgCycleTime" BO_ 904 100;
BA_ "GenMsgCycleTimeFast" BO_ 904 0;
BA_ "GenMsgSendType" BO_ 904 0;
BA_ "VFrameFormat" BO_ 904 14;
BA_ "CANFD_BRS" BO_ 904 1;
BA_ "GenMsgCycleTime" BO_ 904 100;
BA_ "GenMsgCycleTimeFast" BO_ 904 0;
BA_ "GenMsgSendType" BO_ 904 0;
BA_ "VFrameFormat" BO_ 904 14;
BA_ "CANFD_BRS" BO_ 904 1;
BA_ "GenMsgCycleTime" BO_ 904 100;
BA_ "GenMsgCycleTimeFast" BO_ 904 0;
BA_ "GenMsgSendType" BO_ 904 0;
BA_ "VFrameFormat" BO_ 904 14;
BA_ "CANFD_BRS" BO_ 904 1;
BA_ "GenMsgCycleTime" BO_ 904 100;
BA_ "GenMsgCycleTimeFast" BO_ 904 0;
BA_ "GenMsgSendType" BO_ 904 0;
BA_ "VFrameFormat" BO_ 904 14;
BA_ "CANFD_BRS" BO_ 904 1;
BA_ "GenMsgCycleTime" BO_ 904 100;
BA_ "GenMsgCycleTimeFast" BO_ 904 0;
BA_ "GenMsgSendType" BO_ 904 0;
BA_ "VFrameFormat" BO_ 904 14;
BA_ "CANFD_BRS" BO_ 904 1;
BA_ "GenMsgCycleTime" BO_ 904 100;
BA_ "GenMsgCycleTimeFast" BO_ 904 0;
BA_ "GenMsgSendType" BO_ 904 0;
BA_ "VFrameFormat" BO_ 904 14;
BA_ "CANFD_BRS" BO_ 904 1;
BA_ "GenMsgCycleTime" BO_ 904 100;
BA_ "GenMsgCycleTimeFast" BO_ 904 0;
BA_ "GenMsgSendType" BO_ 904 0;
BA_ "VFrameFormat" BO_ 904 14;
BA_ "CANFD_BRS" BO_ 904 1;
BA_ "GenMsgCycleTime" BO_ 904 100;
BA_ "GenMsgCycleTimeFast" BO_ 904 0;
BA_ "GenMsgSendType" BO_ 904 0;
BA_ "VFrameFormat" BO_ 904 14;
BA_ "CANFD_BRS" BO_ 904 1;
BA_ "GenMsgCycleTime" BO_ 904 100;
BA_ "GenMsgCycleTimeFast" BO_ 904 0;
BA_ "GenMsgSendType" BO_ 904 0;
BA_ "VFrameFormat" BO_ 904 14;
BA_ "CANFD_BRS" BO_ 904 1;
BA_ "GenMsgCycleTime" BO_ 904 100;
BA_ "GenMsgCycleTimeFast" BO_ 904 0;
BA_ "GenMsgSendType" BO_ 904 0;
BA_ "VFrameFormat" BO_ 904 14;
BA_ "CANFD_BRS" BO_ 904 1;
BA_ "GenMsgCycleTime" BO_ 904 100;
BA_ "GenMsgCycleTimeFast" BO_ 904 0;
BA_ "GenMsgSendType" BO_ 904 0;
BA_ "VFrameFormat" BO_ 904 14;
BA_ "CANFD_BRS" BO_ 904 1;
BA_ "GenMsgCycleTime" BO_ 904 100;
BA_ "GenMsgCycleTimeFast" BO_ 904 0;
BA_ "GenMsgSendType" BO_ 904 0;
BA_ "VFrameFormat" BO_ 904 14;
BA_ "CANFD_BRS" BO_ 904 1;
BA_ "GenMsgCycleTime" BO_ 904 100;
BA_ "GenMsgCycleTimeFast" BO_ 904 0;
BA_ "GenMsgSendType" BO_ 904 0;
BA_ "VFrameFormat" BO_ 904 14;
BA_ "CANFD_BRS" BO_ 904 1;
BA_ "GenMsgCycleTime" BO_ 904 100;
BA_ "GenMsgCycleTimeFast" BO_ 904 0;
BA_ "GenMsgSendType" BO_ 904 0;
BA_ "VFrameFormat" BO_ 904 14;
BA_ "CANFD_BRS" BO_ 904 1;
BA_ "GenMsgCycleTime" BO_ 904 100;
BA_ "GenMsgCycleTimeFast" BO_ 904 0;
BA_ "GenMsgSendType" BO_ 904 0;
BA_ "VFrameFormat" BO_ 904 14;
BA_ "CANFD_BRS" BO_ 904 1;
BA_ "GenMsgCycleTime" BO_ 904 100;
BA_ "GenMsgCycleTimeFast" BO_ 904 0;
BA_ "GenMsgSendType" BO_ 904 0;
BA_ "VFrameFormat" BO_ 904 14;
BA_ "CANFD_BRS" BO_ 904 1;
BA_ "GenMsgCycleTime" BO_ 904 100;
BA_ "GenMsgCycleTimeFast" BO_ 904 0;
BA_ "GenMsgSendType" BO_ 904 0;
BA_ "VFrameFormat" BO_ 904 14;
BA_ "CANFD_BRS" BO_ 904 1;
BA_ "GenMsgCycleTime" BO_ 904 100;
BA_ "GenMsgCycleTimeFast" BO_ 904 0;
BA_ "GenMsgSendType" BO_ 904 0;
BA_ "VFrameFormat" BO_ 904 14;
BA_ "CANFD_BRS" BO_ 904 1;
BA_ "GenMsgCycleTime" BO_ 904 100;
BA_ "GenMsgCycleTimeFast" BO_ 904 0;
BA_ "GenMsgSendType" BO_ 904 0;
BA_ "VFrameFormat" BO_ 904 14;
BA_ "CANFD_BRS" BO_ 904 1;
BA_ "GenMsgCycleTime" BO_ 904 100;
BA_ "GenMsgCycleTimeFast" BO_ 904 0;
BA_ "GenMsgSendType" BO_ 904 0;
BA_ "VFrameFormat" BO_ 904 14;
BA_ "CANFD_BRS" BO_ 904 1;
BA_ "GenMsgCycleTime" BO_ 904 100;
BA_ "GenMsgCycleTimeFast" BO_ 904 0;
BA_ "GenMsgSendType" BO_ 904 0;
BA_ "VFrameFormat" BO_ 904 14;
BA_ "CANFD_BRS" BO_ 904 1;
BA_ "GenMsgCycleTime" BO_ 904 100;
BA_ "GenMsgCycleTimeFast" BO_ 904 0;
BA_ "GenMsgSendType" BO_ 904 0;
BA_ "VFrameFormat" BO_ 904 14;
BA_ "CANFD_BRS" BO_ 904 1;
BA_ "GenMsgCycleTime" BO_ 904 100;
BA_ "GenMsgCycleTimeFast" BO_ 904 0;
BA_ "GenMsgSendType" BO_ 904 0;
BA_ "VFrameFormat" BO_ 904 14;
BA_ "CANFD_BRS" BO_ 904 1;
BA_ "GenMsgCycleTime" BO_ 904 100;
BA_ "GenMsgCycleTimeFast" BO_ 904 0;
BA_ "GenMsgSendType" BO_ 904 0;
BA_ "VFrameFormat" BO_ 904 14;
BA_ "CANFD_BRS" BO_ 904 1;
BA_ "GenMsgCycleTime" BO_ 904 100;
BA_ "GenMsgCycleTimeFast" BO_ 904 0;
BA_ "GenMsgSendType" BO_ 904 0;
BA_ "VFrameFormat" BO_ 904 14;
BA_ "CANFD_BRS" BO_ 904 1;
BA_ "GenMsgCycleTime" BO_ 904 100;
BA_ "GenMsgCycleTimeFast" BO_ 904 0;
BA_ "GenMsgSendType" BO_ 904 0;
BA_ "VFrameFormat" BO_ 904 14;
BA_ "CANFD_BRS" BO_ 904 1;
BA_ "GenMsgCycleTime" BO_ 904 100;
BA_ "GenMsgCycleTimeFast" BO_ 904 0;
BA_ "GenMsgSendType" BO_ 904 0;
BA_ "VFrameFormat" BO_ 904 14;
BA_ "CANFD_BRS" BO_ 904 1;
BA_ "GenMsgCycleTime" BO_ 904 100;
BA_ "GenMsgCycleTimeFast" BO_ 904 0;
BA_ "GenMsgSendType" BO_ 904 0;
BA_ "VFrameFormat" BO_ 904 14;
BA_ "CANFD_BRS" BO_ 904 1;
BA_ "GenMsgCycleTime" BO_ 904 100;
BA_ "GenMsgCycleTimeFast" BO_ 904 0;
BA_ "GenMsgSendType" BO_ 904 0;
BA_ "VFrameFormat" BO_ 904 14;
BA_ "CANFD_BRS" BO_ 904 1;
BA_ "GenMsgCycleTime" BO_ 904 100;
BA_ "GenMsgCycleTimeFast" BO_ 904 0;
BA_ "GenMsgSendType" BO_ 904 0;
BA_ "VFrameFormat" BO_ 904 14;
BA_ "CANFD_BRS" BO_ 904 1;
BA_ "GenMsgCycleTime" BO_ 904 100;
BA_ "GenMsgCycleTimeFast" BO_ 904 0;
BA_ "GenMsgSendType" BO_ 904 0;
BA_ "VFrameFormat" BO_ 904 14;
BA_ "CANFD_BRS" BO_ 904 1;
BA_ "GenMsgCycleTime" BO_ 904 100;
BA_ "GenMsgCycleTimeFast" BO_ 904 0;
BA_ "GenMsgSendType" BO_ 904 0;
BA_ "VFrameFormat" BO_ 904 14;
BA_ "CANFD_BRS" BO_ 904 1;
BA_ "GenMsgCycleTime" BO_ 904 100;
BA_ "GenMsgCycleTimeFast" BO_ 904 0;
BA_ "GenMsgSendType" BO_ 904 0;
BA_ "VFrameFormat" BO_ 904 14;
BA_ "CANFD_BRS" BO_ 904 1;
BA_ "GenMsgCycleTime" BO_ 904 100;
BA_ "GenMsgCycleTimeFast" BO_ 904 0;
BA_ "GenMsgSendType" BO_ 904 0;
BA_ "VFrameFormat" BO_ 904 14;
BA_ "CANFD_BRS" BO_ 904 1;
BA_ "GenMsgCycleTime" BO_ 904 100;
BA_ "GenMsgCycleTimeFast" BO_ 904 0;
BA_ "GenMsgSendType" BO_ 904 0;
BA_ "VFrameFormat" BO_ 904 14;
BA_ "CANFD_BRS" BO_ 904 1;
BA_ "GenMsgCycleTime" BO_ 904 100;
BA_ "GenMsgCycleTimeFast" BO_ 904 0;
BA_ "GenMsgSendType" BO_ 904 0;
BA_ "VFrameFormat" BO_ 904 14;
BA_ "CANFD_BRS" BO_ 904 1;
BA_ "GenMsgCycleTime" BO_ 904 100;
BA_ "GenMsgCycleTimeFast" BO_ 904 0;
BA_ "GenMsgSendType" BO_ 904 0;
BA_ "VFrameFormat" BO_ 904 14;
BA_ "CANFD_BRS" BO_ 904 1;
BA_ "GenMsgCycleTime" BO_ 904 100;
BA_ "GenMsgCycleTimeFast" BO_ 904 0;
BA_ "GenMsgSendType" BO_ 904 0;
BA_ "VFrameFormat" BO_ 904 14;
BA_ "CANFD_BRS" BO_ 904 1;
BA_ "GenMsgCycleTime" BO_ 904 100;
BA_ "GenMsgCycleTimeFast" BO_ 904 0;
BA_ "GenMsgSendType" BO_ 904 0;
BA_ "VFrameFormat" BO_ 904 14;
BA_ "CANFD_BRS" BO_ 904 1;
BA_ "GenMsgCycleTime" BO_ 904 100;
BA_ "GenMsgCycleTimeFast" BO_ 904 0;
BA_ "GenMsgSendType" BO_ 904 0;
BA_ "VFrameFormat" BO_ 904 14;
BA_ "CANFD_BRS" BO_ 904 1;
BA_ "GenMsgCycleTime" BO_ 904 100;
BA_ "GenMsgCycleTimeFast" BO_ 904 0;
BA_ "GenMsgSendType" BO_ 904 0;
BA_ "VFrameFormat" BO_ 904 14;
BA_ "CANFD_BRS" BO_ 904 1;
BA_ "GenMsgCycleTime" BO_ 904 100;
BA_ "GenMsgCycleTimeFast" BO_ 904 0;
BA_ "GenMsgSendType" BO_ 904 0;
BA_ "VFrameFormat" BO_ 904 14;
BA_ "CANFD_BRS" BO_ 904 1;
BA_ "GenMsgCycleTime" BO_ 904 100;
BA_ "GenMsgCycleTimeFast" BO_ 904 0;
BA_ "GenMsgSendType" BO_ 904 0;
BA_ "VFrameFormat" BO_ 904 14;
BA_ "CANFD_BRS" BO_ 904 1;
BA_ "GenMsgCycleTime" BO_ 904 100;
BA_ "GenMsgCycleTimeFast" BO_ 904 0;
BA_ "GenMsgSendType" BO_ 904 0;
BA_ "VFrameFormat" BO_ 904 14;
BA_ "CANFD_BRS" BO_ 904 1;
BA_ "GenMsgCycleTime" BO_ 904 100;
BA_ "GenMsgCycleTimeFast" BO_ 904 0;
BA_ "GenMsgSendType" BO_ 904 0;
BA_ "VFrameFormat" BO_ 904 14;
BA_ "CANFD_BRS" BO_ 904 1;
BA_ "GenMsgCycleTime" BO_ 904 100;
BA_ "GenMsgCycleTimeFast" BO_ 904 0;
BA_ "GenMsgSendType" BO_ 904 0;
BA_ "VFrameFormat" BO_ 904 14;
BA_ "CANFD_BRS" BO_ 904 1;
BA_ "GenMsgCycleTime" BO_ 904 100;
BA_ "GenMsgCycleTimeFast" BO_ 904 0;
BA_ "GenMsgSendType" BO_ 904 0;
BA_ "VFrameFormat" BO_ 904 14;
BA_ "CANFD_BRS" BO_ 904 1;
BA_ "GenMsgCycleTime" BO_ 904 100;
BA_ "GenMsgCycleTimeFast" BO_ 904 0;
BA_ "GenMsgSendType" BO_ 904 0;
BA_ "VFrameFormat" BO_ 904 14;
BA_ "CANFD_BRS" BO_ 904 1;
BA_ "GenMsgCycleTime" BO_ 904 100;
BA_ "GenMsgCycleTimeFast" BO_ 904 0;
BA_ "GenMsgSendType" BO_ 904 0;
BA_ "VFrameFormat" BO_ 904 14;
BA_ "CANFD_BRS" BO_ 904 1;
BA_ "GenMsgCycleTime" BO_ 904 100;
BA_ "GenMsgCycleTimeFast" BO_ 904 0;
BA_ "GenMsgSendType" BO_ 904 0;
BA_ "VFrameFormat" BO_ 904 14;
BA_ "CANFD_BRS" BO_ 904 1;
BA_ "GenMsgCycleTime" BO_ 904 100;
BA_ "GenMsgCycleTimeFast" BO_ 904 0;
BA_ "GenMsgSendType" BO_ 904 0;
BA_ "VFrameFormat" BO_ 904 14;
BA_ "CANFD_BRS" BO_ 904 1;
BA_ "GenMsgCycleTime" BO_ 904 100;
BA_ "GenMsgCycleTimeFast" BO_ 904 0;
BA_ "GenMsgSendType" BO_ 904 0;
BA_ "VFrameFormat" BO_ 904 14;
BA_ "CANFD_BRS" BO_ 904 1;
BA_ "GenMsgCycleTime" BO_ 904 100;
BA_ "GenMsgCycleTimeFast" BO_ 904 0;
BA_ "GenMsgSendType" BO_ 904 0;
BA_ "VFrameFormat" BO_ 904 14;
BA_ "CANFD_BRS" BO_ 904 1;
BA_ "GenMsgCycleTime" BO_ 904 100;
BA_ "GenMsgCycleTimeFast" BO_ 904 0;
BA_ "GenMsgSendType" BO_ 904 0;
BA_ "VFrameFormat" BO_ 904 14;
BA_ "CANFD_BRS" BO_ 904 1;
BA_ "GenMsgCycleTime" BO_ 904 100;
BA_ "GenMsgCycleTimeFast" BO_ 904 0;
BA_ "GenMsgSendType" BO_ 904 0;
BA_ "VFrameFormat" BO_ 904 14;
BA_ "CANFD_BRS" BO_ 904 1;
BA_ "GenMsgCycleTime" BO_ 904 100;
BA_ "GenMsgCycleTimeFast" BO_ 904 0;
BA_ "GenMsgSendType" BO_ 904 0;
BA_ "VFrameFormat" BO_ 904 14;
BA_ "CANFD_BRS" BO_ 904 1;
BA_ "GenMsgCycleTime" BO_ 904 100;
BA_ "GenMsgCycleTimeFast" BO_ 904 0;
BA_ "GenMsgSendType" BO_ 904 0;
BA_ "VFrameFormat" BO_ 904 14;
BA_ "CANFD_BRS" BO_ 904 1;
BA_ "GenMsgCycleTime" BO_ 904 100;
BA_ "GenMsgCycleTimeFast" BO_ 904 0;
BA_ "GenMsgSendType" BO_ 904 0;
BA_ "VFrameFormat" BO_ 904 14;
BA_ "CANFD_BRS" BO_ 904 1;
BA_ "GenMsgCycleTime" BO_ 904 100;
BA_ "GenMsgCycleTimeFast" BO_ 904 0;
BA_ "GenMsgSendType" BO_ 904 0;
BA_ "VFrameFormat" BO_ 904 14;
BA_ "CANFD_BRS" BO_ 904 1;
BA_ "GenMsgCycleTime" BO_ 904 100;
BA_ "GenMsgCycleTimeFast" BO_ 904 0;
BA_ "GenMsgSendType" BO_ 904 0;
BA_ "VFrameFormat" BO_ 904 14;
BA_ "CANFD_BRS" BO_ 904 1;
BA_ "GenMsgCycleTime" BO_ 904 100;
BA_ "GenMsgCycleTimeFast" BO_ 904 0;
BA_ "GenMsgSendType" BO_ 904 0;
BA_ "VFrameFormat" BO_ 904 14;
BA_ "CANFD_BRS" BO_ 904 1;
BA_ "GenMsgCycleTime" BO_ 904 100;
BA_ "GenMsgCycleTimeFast" BO_ 904 0;
BA_ "GenMsgSendType" BO_ 904 0;
BA_ "VFrameFormat" BO_ 904 14;
BA_ "CANFD_BRS" BO_ 904 1;
BA_ "GenMsgCycleTime" BO_ 904 100;
BA_ "GenMsgCycleTimeFast" BO_ 904 0;
BA_ "GenMsgSendType" BO_ 904 0;
BA_ "VFrameFormat" BO_ 904 14;
BA_ "CANFD_BRS" BO_ 904 1;
BA_ "GenMsgCycleTime" BO_ 904 100;
BA_ "GenMsgCycleTimeFast" BO_ 904 0;
BA_ "GenMsgSendType" BO_ 904 0;
BA_ "VFrameFormat" BO_ 904 14;
BA_ "CANFD_BRS" BO_ 904 1;
BA_ "GenMsgCycleTime" BO_ 904 100;
BA_ "GenMsgCycleTimeFast" BO_ 904 0;
BA_ "GenMsgSendType" BO_ 904 0;
BA_ "VFrameFormat" BO_ 904 14;
BA_ "CANFD_BRS" BO_ 904 1;
BA_ "GenMsgCycleTime" BO_ 904 100;
BA_ "GenMsgCycleTimeFast" BO_ 904 0;
BA_ "GenMsgSendType" BO_ 904 0;
BA_ "VFrameFormat" BO_ 904 14;
BA_ "CANFD_BRS" BO_ 904 1;
BA_ "GenMsgCycleTime" BO_ 904 100;
BA_ "GenMsgCycleTimeFast" BO_ 904 0;
BA_ "GenMsgSendType" BO_ 904 0;
BA_ "VFrameFormat" BO_ 904 14;
BA_ "CANFD_BRS" BO_ 904 1;
BA_ "GenMsgCycleTime" BO_ 904 100;
BA_ "GenMsgCycleTimeFast" BO_ 904 0;
BA_ "GenMsgSendType" BO_ 904 0;
BA_ "VFrameFormat" BO_ 904 14;
BA_ "CANFD_BRS" BO_ 904 1;
BA_ "GenMsgCycleTime" BO_ 904 100;
BA_ "GenMsgCycleTimeFast" BO_ 904 0;
BA_ "GenMsgSendType" BO_ 904 0;
BA_ "VFrameFormat" BO_ 904 14;
BA_ "CANFD_BRS" BO_ 904 1;
BA_ "GenMsgCycleTime" BO_ 904 100;
BA_ "GenMsgCycleTimeFast" BO_ 904 0;
BA_ "GenMsgSendType" BO_ 904 0;
BA_ "VFrameFormat" BO_ 904 14;
BA_ "CANFD_BRS" BO_ 904 1;
BA_ "GenMsgCycleTime" BO_ 904 100;
BA_ "GenMsgCycleTimeFast" BO_ 904 0;
BA_ "GenMsgSendType" BO_ 904 0;
BA_ "VFrameFormat" BO_ 904 14;
BA_ "CANFD_BRS" BO_ 904 1;
BA_ "GenMsgCycleTime" BO_ 904 100;
BA_ "GenMsgCycleTimeFast" BO_ 904 0;
BA_ "GenMsgSendType" BO_ 904 0;
BA_ "VFrameFormat" BO_ 904 14;
BA_ "CANFD_BRS" BO_ 904 1;
BA_ "GenMsgCycleTime" BO_ 904 100;
BA_ "GenMsgCycleTimeFast" BO_ 904 0;
BA_ "GenMsgSendType" BO_ 904 0;
BA_ "VFrameFormat" BO_ 904 14;
BA_ "CANFD_BRS" BO_ 904 1;
BA_ "GenMsgCycleTime" BO_ 904 100;
BA_ "GenMsgCycleTimeFast" BO_ 904 0;
BA_ "GenMsgSendType" BO_ 904 0;
BA_ "VFrameFormat" BO_ 904 14;
BA_ "CANFD_BRS" BO_ 904 1;
BA_ "GenMsgCycleTime" BO_ 904 100;
BA_ "GenMsgCycleTimeFast" BO_ 904 0;
BA_ "GenMsgSendType" BO_ 904 0;
BA_ "VFrameFormat" BO_ 904 14;
BA_ "CANFD_BRS" BO_ 904 1;
BA_ "GenMsgCycleTime" BO_ 904 100;
BA_ "GenMsgCycleTimeFast" BO_ 904 0;
BA_ "GenMsgSendType" BO_ 904 0;
BA_ "VFrameFormat" BO_ 904 14;
BA_ "CANFD_BRS" BO_ 904 1;
BA_ "GenMsgCycleTime" BO_ 904 100;
BA_ "GenMsgCycleTimeFast" BO_ 904 0;
BA_ "GenMsgSendType" BO_ 904 0;
BA_ "VFrameFormat" BO_ 904 14;
BA_ "CANFD_BRS" BO_ 904 1;
BA_ "GenMsgCycleTime" BO_ 904 100;
BA_ "GenMsgCycleTimeFast" BO_ 904 0;
BA_ "GenMsgSendType" BO_ 904 0;
BA_ "VFrameFormat" BO_ 904 14;
BA_ "CANFD_BRS" BO_ 904 1;
BA_ "GenMsgCycleTime" BO_ 904 100;
BA_ "GenMsgCycleTimeFast" BO_ 904 0;
BA_ "GenMsgSendType" BO_ 904 0;
BA_ "VFrameFormat" BO_ 904 14;
BA_ "CANFD_BRS" BO_ 904 1;
BA_ "GenMsgCycleTime" BO_ 904 100;
BA_ "GenMsgCycleTimeFast" BO_ 904 0;
BA_ "GenMsgSendType" BO_ 904 0;
BA_ "VFrameFormat" BO_ 904 14;
BA_ "CANFD_BRS" BO_ 904 1;
BA_ "GenMsgCycleTime" BO_ 904 100;
BA_ "GenMsgCycleTimeFast" BO_ 904 0;
BA_ "GenMsgSendType" BO_ 904 0;
BA_ "VFrameFormat" BO_ 904 14;
BA_ "CANFD_BRS" BO_ 904 1;
BA_ "GenMsgCycleTime" BO_ 904 100;
BA_ "GenMsgCycleTimeFast" BO_ 904 0;
BA_ "GenMsgSendType" BO_ 904 0;
BA_ "VFrameFormat" BO_ 904 14;
BA_ "CANFD_BRS" BO_ 904 1;
BA_ "GenMsgCycleTime" BO_ 904 100;
BA_ "GenMsgCycleTimeFast" BO_ 904 0;
BA_ "GenMsgSendType" BO_ 904 0;
BA_ "VFrameFormat" BO_ 904 14;
BA_ "CANFD_BRS" BO_ 904 1;
BA_ "GenMsgCycleTime" BO_ 904 100;
BA_ "GenMsgCycleTimeFast" BO_ 904 0;
BA_ "GenMsgSendType" BO_ 904 0;
BA_ "VFrameFormat" BO_ 904 14;
BA_ "CANFD_BRS" BO_ 904 1;
BA_ "GenMsgCycleTime" BO_ 904 100;
BA_ "GenMsgCycleTimeFast" BO_ 904 0;
BA_ "GenMsgSendType" BO_ 904 0;
BA_ "VFrameFormat" BO_ 904 14;
BA_ "CANFD_BRS" BO_ 904 1;
BA_ "GenMsgCycleTime" BO_ 904 100;
BA_ "GenMsgCycleTimeFast" BO_ 904 0;
BA_ "GenMsgSendType" BO_ 904 0;
BA_ "VFrameFormat" BO_ 904 14;
BA_ "CANFD_BRS" BO_ 904 1;
BA_ "GenMsgCycleTime" BO_ 904 100;
BA_ "GenMsgCycleTimeFast" BO_ 904 0;
BA_ "GenMsgSendType" BO_ 904 0;
BA_ "VFrameFormat" BO_ 904 14;
BA_ "CANFD_BRS" BO_ 904 1;
BA_ "GenMsgCycleTime" BO_ 904 100;
BA_ "GenMsgCycleTimeFast" BO_ 904 0;
BA_ "GenMsgSendType" BO_ 904 0;
BA_ "VFrameFormat" BO_ 904 14;
BA_ "CANFD_BRS" BO_ 904 1;
BA_ "GenMsgCycleTime" BO_ 904 100;
BA_ "GenMsgCycleTimeFast" BO_ 904 0;
BA_ "GenMsgSendType" BO_ 904 0;
BA_ "VFrameFormat" BO_ 904 14;
BA_ "CANFD_BRS" BO_ 904 1;
BA_ "GenMsgCycleTime" BO_ 904 100;
BA_ "GenMsgCycleTimeFast" BO_ 904 0;
BA_ "GenMsgSendType" BO_ 904 0;
BA_ "VFrameFormat" BO_ 904 14;
BA_ "CANFD_BRS" BO_ 904 1;
BA_ "GenMsgCycleTime" BO_ 904 100;
BA_ "GenMsgCycleTimeFast" BO_ 904 0;
BA_ "GenMsgSendType" BO_ 904 0;
BA_ "VFrameFormat" BO_ 904 14;
BA_ "CANFD_BRS" BO_ 904 1;
BA_ "GenMsgCycleTime" BO_ 904 100;
BA_ "GenMsgCycleTimeFast" BO_ 904 0;
BA_ "GenMsgSendType" BO_ 904 0;
BA_ "VFrameFormat" BO_ 904 14;
BA_ "CANFD_BRS" BO_ 904 1;
BA_ "GenMsgCycleTime" BO_ 904 100;
BA_ "GenMsgCycleTimeFast" BO_ 904 0;
BA_ "GenMsgSendType" BO_ 904 0;
BA_ "VFrameFormat" BO_ 904 14;
BA_ "CANFD_BRS" BO_ 904 1;
BA_ "GenMsgCycleTime" BO_ 904 100;
BA_ "GenMsgCycleTimeFast" BO_ 904 0;
BA_ "GenMsgSendType" BO_ 904 0;
BA_ "VFrameFormat" BO_ 904 14;
BA_ "CANFD_BRS" BO_ 904 1;
BA_ "GenMsgCycleTime" BO_ 904 100;
BA_ "GenMsgCycleTimeFast" BO_ 904 0;
BA_ "GenMsgSendType" BO_ 904 0;
BA_ "VFrameFormat" BO_ 904 14;
BA_ "CANFD_BRS" BO_ 904 1;
BA_ "GenMsgCycleTime" BO_ 904 100;
BA_ "GenMsgCycleTimeFast" BO_ 904 0;
BA_ "GenMsgSendType" BO_ 904 0;
BA_ "VFrameFormat" BO_ 904 14;
BA_ "CANFD_BRS" BO_ 904 1;
BA_ "GenMsgCycleTime" BO_ 904 100;
BA_ "GenMsgCycleTimeFast" BO_ 904 0;
BA_ "GenMsgSendType" BO_ 904 0;
BA_ "VFrameFormat" BO_ 904 14;
BA_ "CANFD_BRS" BO_ 904 1;
BA_ "GenMsgCycleTime" BO_ 909 100;
BA_ "GenMsgCycleTimeFast" BO_ 909 0;
BA_ "GenMsgSendType" BO_ 909 0;
BA_ "VFrameFormat" BO_ 909 14;
BA_ "CANFD_BRS" BO_ 909 1;
BA_ "GenMsgCycleTime" BO_ 909 100;
BA_ "GenMsgCycleTimeFast" BO_ 909 0;
BA_ "GenMsgSendType" BO_ 909 0;
BA_ "VFrameFormat" BO_ 909 14;
BA_ "CANFD_BRS" BO_ 909 1;
BA_ "GenMsgCycleTime" BO_ 909 100;
BA_ "GenMsgCycleTimeFast" BO_ 909 0;
BA_ "GenMsgSendType" BO_ 909 0;
BA_ "VFrameFormat" BO_ 909 14;
BA_ "CANFD_BRS" BO_ 909 1;
BA_ "GenMsgCycleTime" BO_ 909 100;
BA_ "GenMsgCycleTimeFast" BO_ 909 0;
BA_ "GenMsgSendType" BO_ 909 0;
BA_ "VFrameFormat" BO_ 909 14;
BA_ "CANFD_BRS" BO_ 909 1;
BA_ "GenMsgCycleTime" BO_ 909 100;
BA_ "GenMsgCycleTimeFast" BO_ 909 0;
BA_ "GenMsgSendType" BO_ 909 0;
BA_ "VFrameFormat" BO_ 909 14;
BA_ "CANFD_BRS" BO_ 909 1;
BA_ "GenMsgCycleTime" BO_ 909 100;
BA_ "GenMsgCycleTimeFast" BO_ 909 0;
BA_ "GenMsgSendType" BO_ 909 0;
BA_ "VFrameFormat" BO_ 909 14;
BA_ "CANFD_BRS" BO_ 909 1;
BA_ "GenMsgCycleTime" BO_ 909 100;
BA_ "GenMsgCycleTimeFast" BO_ 909 0;
BA_ "GenMsgSendType" BO_ 909 0;
BA_ "VFrameFormat" BO_ 909 14;
BA_ "CANFD_BRS" BO_ 909 1;
BA_ "GenMsgCycleTime" BO_ 909 100;
BA_ "GenMsgCycleTimeFast" BO_ 909 0;
BA_ "GenMsgSendType" BO_ 909 0;
BA_ "VFrameFormat" BO_ 909 14;
BA_ "CANFD_BRS" BO_ 909 1;
BA_ "GenMsgCycleTime" BO_ 909 100;
BA_ "GenMsgCycleTimeFast" BO_ 909 0;
BA_ "GenMsgSendType" BO_ 909 0;
BA_ "VFrameFormat" BO_ 909 14;
BA_ "CANFD_BRS" BO_ 909 1;
BA_ "GenMsgCycleTime" BO_ 909 100;
BA_ "GenMsgCycleTimeFast" BO_ 909 0;
BA_ "GenMsgSendType" BO_ 909 0;
BA_ "VFrameFormat" BO_ 909 14;
BA_ "CANFD_BRS" BO_ 909 1;
BA_ "GenMsgCycleTime" BO_ 909 100;
BA_ "GenMsgCycleTimeFast" BO_ 909 0;
BA_ "GenMsgSendType" BO_ 909 0;
BA_ "VFrameFormat" BO_ 909 14;
BA_ "CANFD_BRS" BO_ 909 1;
BA_ "GenMsgCycleTime" BO_ 909 100;
BA_ "GenMsgCycleTimeFast" BO_ 909 0;
BA_ "GenMsgSendType" BO_ 909 0;
BA_ "VFrameFormat" BO_ 909 14;
BA_ "CANFD_BRS" BO_ 909 1;
BA_ "GenMsgCycleTime" BO_ 909 100;
BA_ "GenMsgCycleTimeFast" BO_ 909 0;
BA_ "GenMsgSendType" BO_ 909 0;
BA_ "VFrameFormat" BO_ 909 14;
BA_ "CANFD_BRS" BO_ 909 1;
BA_ "GenMsgCycleTime" BO_ 909 100;
BA_ "GenMsgCycleTimeFast" BO_ 909 0;
BA_ "GenMsgSendType" BO_ 909 0;
BA_ "VFrameFormat" BO_ 909 14;
BA_ "CANFD_BRS" BO_ 909 1;
BA_ "GenMsgCycleTime" BO_ 909 100;
BA_ "GenMsgCycleTimeFast" BO_ 909 0;
BA_ "GenMsgSendType" BO_ 909 0;
BA_ "VFrameFormat" BO_ 909 14;
BA_ "CANFD_BRS" BO_ 909 1;
BA_ "GenMsgCycleTime" BO_ 909 100;
BA_ "GenMsgCycleTimeFast" BO_ 909 0;
BA_ "GenMsgSendType" BO_ 909 0;
BA_ "VFrameFormat" BO_ 909 14;
BA_ "CANFD_BRS" BO_ 909 1;
BA_ "GenMsgCycleTime" BO_ 909 100;
BA_ "GenMsgCycleTimeFast" BO_ 909 0;
BA_ "GenMsgSendType" BO_ 909 0;
BA_ "VFrameFormat" BO_ 909 14;
BA_ "CANFD_BRS" BO_ 909 1;
BA_ "GenMsgCycleTime" BO_ 909 100;
BA_ "GenMsgCycleTimeFast" BO_ 909 0;
BA_ "GenMsgSendType" BO_ 909 0;
BA_ "VFrameFormat" BO_ 909 14;
BA_ "CANFD_BRS" BO_ 909 1;
BA_ "GenMsgCycleTime" BO_ 909 100;
BA_ "GenMsgCycleTimeFast" BO_ 909 0;
BA_ "GenMsgSendType" BO_ 909 0;
BA_ "VFrameFormat" BO_ 909 14;
BA_ "CANFD_BRS" BO_ 909 1;
BA_ "GenMsgCycleTime" BO_ 909 100;
BA_ "GenMsgCycleTimeFast" BO_ 909 0;
BA_ "GenMsgSendType" BO_ 909 0;
BA_ "VFrameFormat" BO_ 909 14;
BA_ "CANFD_BRS" BO_ 909 1;
BA_ "GenMsgCycleTime" BO_ 909 100;
BA_ "GenMsgCycleTimeFast" BO_ 909 0;
BA_ "GenMsgSendType" BO_ 909 0;
BA_ "VFrameFormat" BO_ 909 14;
BA_ "CANFD_BRS" BO_ 909 1;
BA_ "GenMsgCycleTime" BO_ 909 100;
BA_ "GenMsgCycleTimeFast" BO_ 909 0;
BA_ "GenMsgSendType" BO_ 909 0;
BA_ "VFrameFormat" BO_ 909 14;
BA_ "CANFD_BRS" BO_ 909 1;
BA_ "GenMsgCycleTime" BO_ 909 100;
BA_ "GenMsgCycleTimeFast" BO_ 909 0;
BA_ "GenMsgSendType" BO_ 909 0;
BA_ "VFrameFormat" BO_ 909 14;
BA_ "CANFD_BRS" BO_ 909 1;
BA_ "GenMsgCycleTime" BO_ 909 100;
BA_ "GenMsgCycleTimeFast" BO_ 909 0;
BA_ "GenMsgSendType" BO_ 909 0;
BA_ "VFrameFormat" BO_ 909 14;
BA_ "CANFD_BRS" BO_ 909 1;
BA_ "GenMsgCycleTime" BO_ 909 100;
BA_ "GenMsgCycleTimeFast" BO_ 909 0;
BA_ "GenMsgSendType" BO_ 909 0;
BA_ "VFrameFormat" BO_ 909 14;
BA_ "CANFD_BRS" BO_ 909 1;
BA_ "GenMsgCycleTime" BO_ 909 100;
BA_ "GenMsgCycleTimeFast" BO_ 909 0;
BA_ "GenMsgSendType" BO_ 909 0;
BA_ "VFrameFormat" BO_ 909 14;
BA_ "CANFD_BRS" BO_ 909 1;
BA_ "GenMsgCycleTime" BO_ 909 100;
BA_ "GenMsgCycleTimeFast" BO_ 909 0;
BA_ "GenMsgSendType" BO_ 909 0;
BA_ "VFrameFormat" BO_ 909 14;
BA_ "CANFD_BRS" BO_ 909 1;
BA_ "GenMsgCycleTime" BO_ 909 100;
BA_ "GenMsgCycleTimeFast" BO_ 909 0;
BA_ "GenMsgSendType" BO_ 909 0;
BA_ "VFrameFormat" BO_ 909 14;
BA_ "CANFD_BRS" BO_ 909 1;
BA_ "GenMsgCycleTime" BO_ 909 100;
BA_ "GenMsgCycleTimeFast" BO_ 909 0;
BA_ "GenMsgSendType" BO_ 909 0;
BA_ "VFrameFormat" BO_ 909 14;
BA_ "CANFD_BRS" BO_ 909 1;
BA_ "GenMsgCycleTime" BO_ 909 100;
BA_ "GenMsgCycleTimeFast" BO_ 909 0;
BA_ "GenMsgSendType" BO_ 909 0;
BA_ "VFrameFormat" BO_ 909 14;
BA_ "CANFD_BRS" BO_ 909 1;
BA_ "GenMsgCycleTime" BO_ 909 100;
BA_ "GenMsgCycleTimeFast" BO_ 909 0;
BA_ "GenMsgSendType" BO_ 909 0;
BA_ "VFrameFormat" BO_ 909 14;
BA_ "CANFD_BRS" BO_ 909 1;
BA_ "GenMsgCycleTime" BO_ 909 100;
BA_ "GenMsgCycleTimeFast" BO_ 909 0;
BA_ "GenMsgSendType" BO_ 909 0;
BA_ "VFrameFormat" BO_ 909 14;
BA_ "CANFD_BRS" BO_ 909 1;
BA_ "GenMsgCycleTime" BO_ 909 100;
BA_ "GenMsgCycleTimeFast" BO_ 909 0;
BA_ "GenMsgSendType" BO_ 909 0;
BA_ "VFrameFormat" BO_ 909 14;
BA_ "CANFD_BRS" BO_ 909 1;
BA_ "GenMsgCycleTime" BO_ 909 100;
BA_ "GenMsgCycleTimeFast" BO_ 909 0;
BA_ "GenMsgSendType" BO_ 909 0;
BA_ "VFrameFormat" BO_ 909 14;
BA_ "CANFD_BRS" BO_ 909 1;
BA_ "GenMsgCycleTime" BO_ 909 100;
BA_ "GenMsgCycleTimeFast" BO_ 909 0;
BA_ "GenMsgSendType" BO_ 909 0;
BA_ "VFrameFormat" BO_ 909 14;
BA_ "CANFD_BRS" BO_ 909 1;
BA_ "GenMsgCycleTime" BO_ 909 100;
BA_ "GenMsgCycleTimeFast" BO_ 909 0;
BA_ "GenMsgSendType" BO_ 909 0;
BA_ "VFrameFormat" BO_ 909 14;
BA_ "CANFD_BRS" BO_ 909 1;
BA_ "GenMsgCycleTime" BO_ 909 100;
BA_ "GenMsgCycleTimeFast" BO_ 909 0;
BA_ "GenMsgSendType" BO_ 909 0;
BA_ "VFrameFormat" BO_ 909 14;
BA_ "CANFD_BRS" BO_ 909 1;
BA_ "GenMsgCycleTime" BO_ 909 100;
BA_ "GenMsgCycleTimeFast" BO_ 909 0;
BA_ "GenMsgSendType" BO_ 909 0;
BA_ "VFrameFormat" BO_ 909 14;
BA_ "CANFD_BRS" BO_ 909 1;
BA_ "GenMsgCycleTime" BO_ 909 100;
BA_ "GenMsgCycleTimeFast" BO_ 909 0;
BA_ "GenMsgSendType" BO_ 909 0;
BA_ "VFrameFormat" BO_ 909 14;
BA_ "CANFD_BRS" BO_ 909 1;
BA_ "GenMsgCycleTime" BO_ 909 100;
BA_ "GenMsgCycleTimeFast" BO_ 909 0;
BA_ "GenMsgSendType" BO_ 909 0;
BA_ "VFrameFormat" BO_ 909 14;
BA_ "CANFD_BRS" BO_ 909 1;
BA_ "GenMsgCycleTime" BO_ 909 100;
BA_ "GenMsgCycleTimeFast" BO_ 909 0;
BA_ "GenMsgSendType" BO_ 909 0;
BA_ "VFrameFormat" BO_ 909 14;
BA_ "CANFD_BRS" BO_ 909 1;
BA_ "GenMsgCycleTime" BO_ 909 100;
BA_ "GenMsgCycleTimeFast" BO_ 909 0;
BA_ "GenMsgSendType" BO_ 909 0;
BA_ "VFrameFormat" BO_ 909 14;
BA_ "CANFD_BRS" BO_ 909 1;
BA_ "GenMsgCycleTime" BO_ 909 100;
BA_ "GenMsgCycleTimeFast" BO_ 909 0;
BA_ "GenMsgSendType" BO_ 909 0;
BA_ "VFrameFormat" BO_ 909 14;
BA_ "CANFD_BRS" BO_ 909 1;
BA_ "GenMsgCycleTime" BO_ 909 100;
BA_ "GenMsgCycleTimeFast" BO_ 909 0;
BA_ "GenMsgSendType" BO_ 909 0;
BA_ "VFrameFormat" BO_ 909 14;
BA_ "CANFD_BRS" BO_ 909 1;
BA_ "GenMsgCycleTime" BO_ 909 100;
BA_ "GenMsgCycleTimeFast" BO_ 909 0;
BA_ "GenMsgSendType" BO_ 909 0;
BA_ "VFrameFormat" BO_ 909 14;
BA_ "CANFD_BRS" BO_ 909 1;
BA_ "GenMsgCycleTime" BO_ 909 100;
BA_ "GenMsgCycleTimeFast" BO_ 909 0;
BA_ "GenMsgSendType" BO_ 909 0;
BA_ "VFrameFormat" BO_ 909 14;
BA_ "CANFD_BRS" BO_ 909 1;
BA_ "GenMsgCycleTime" BO_ 909 100;
BA_ "GenMsgCycleTimeFast" BO_ 909 0;
BA_ "GenMsgSendType" BO_ 909 0;
BA_ "VFrameFormat" BO_ 909 14;
BA_ "CANFD_BRS" BO_ 909 1;
BA_ "GenMsgCycleTime" BO_ 909 100;
BA_ "GenMsgCycleTimeFast" BO_ 909 0;
BA_ "GenMsgSendType" BO_ 909 0;
BA_ "VFrameFormat" BO_ 909 14;
BA_ "CANFD_BRS" BO_ 909 1;
BA_ "GenMsgCycleTime" BO_ 909 100;
BA_ "GenMsgCycleTimeFast" BO_ 909 0;
BA_ "GenMsgSendType" BO_ 909 0;
BA_ "VFrameFormat" BO_ 909 14;
BA_ "CANFD_BRS" BO_ 909 1;
BA_ "GenMsgCycleTime" BO_ 430 10;
BA_ "GenMsgCycleTimeFast" BO_ 430 0;
BA_ "GenMsgSendType" BO_ 430 0;
BA_ "VFrameFormat" BO_ 430 14;
BA_ "CANFD_BRS" BO_ 430 1;
BA_ "GenMsgCycleTime" BO_ 430 10;
BA_ "GenMsgCycleTimeFast" BO_ 430 0;
BA_ "GenMsgSendType" BO_ 430 0;
BA_ "VFrameFormat" BO_ 430 14;
BA_ "CANFD_BRS" BO_ 430 1;
BA_ "GenMsgCycleTime" BO_ 430 10;
BA_ "GenMsgCycleTimeFast" BO_ 430 0;
BA_ "GenMsgSendType" BO_ 430 0;
BA_ "VFrameFormat" BO_ 430 14;
BA_ "CANFD_BRS" BO_ 430 1;
BA_ "GenMsgCycleTime" BO_ 430 10;
BA_ "GenMsgCycleTimeFast" BO_ 430 0;
BA_ "GenMsgSendType" BO_ 430 0;
BA_ "VFrameFormat" BO_ 430 14;
BA_ "CANFD_BRS" BO_ 430 1;
BA_ "GenMsgCycleTime" BO_ 430 10;
BA_ "GenMsgCycleTimeFast" BO_ 430 0;
BA_ "GenMsgSendType" BO_ 430 0;
BA_ "VFrameFormat" BO_ 430 14;
BA_ "CANFD_BRS" BO_ 430 1;
BA_ "GenMsgCycleTime" BO_ 430 10;
BA_ "GenMsgCycleTimeFast" BO_ 430 0;
BA_ "GenMsgSendType" BO_ 430 0;
BA_ "VFrameFormat" BO_ 430 14;
BA_ "CANFD_BRS" BO_ 430 1;
BA_ "GenMsgCycleTime" BO_ 430 10;
BA_ "GenMsgCycleTimeFast" BO_ 430 0;
BA_ "GenMsgSendType" BO_ 430 0;
BA_ "VFrameFormat" BO_ 430 14;
BA_ "CANFD_BRS" BO_ 430 1;
BA_ "GenMsgCycleTime" BO_ 430 10;
BA_ "GenMsgCycleTimeFast" BO_ 430 0;
BA_ "GenMsgSendType" BO_ 430 0;
BA_ "VFrameFormat" BO_ 430 14;
BA_ "CANFD_BRS" BO_ 430 1;
BA_ "GenMsgCycleTime" BO_ 430 10;
BA_ "GenMsgCycleTimeFast" BO_ 430 0;
BA_ "GenMsgSendType" BO_ 430 0;
BA_ "VFrameFormat" BO_ 430 14;
BA_ "CANFD_BRS" BO_ 430 1;
BA_ "GenMsgCycleTime" BO_ 430 10;
BA_ "GenMsgCycleTimeFast" BO_ 430 0;
BA_ "GenMsgSendType" BO_ 430 0;
BA_ "VFrameFormat" BO_ 430 14;
BA_ "CANFD_BRS" BO_ 430 1;
BA_ "GenMsgCycleTime" BO_ 430 10;
BA_ "GenMsgCycleTimeFast" BO_ 430 0;
BA_ "GenMsgSendType" BO_ 430 0;
BA_ "VFrameFormat" BO_ 430 14;
BA_ "CANFD_BRS" BO_ 430 1;
BA_ "GenMsgCycleTime" BO_ 430 10;
BA_ "GenMsgCycleTimeFast" BO_ 430 0;
BA_ "GenMsgSendType" BO_ 430 0;
BA_ "VFrameFormat" BO_ 430 14;
BA_ "CANFD_BRS" BO_ 430 1;
BA_ "GenMsgCycleTime" BO_ 430 10;
BA_ "GenMsgCycleTimeFast" BO_ 430 0;
BA_ "GenMsgSendType" BO_ 430 0;
BA_ "VFrameFormat" BO_ 430 14;
BA_ "CANFD_BRS" BO_ 430 1;
BA_ "GenMsgCycleTime" BO_ 430 10;
BA_ "GenMsgCycleTimeFast" BO_ 430 0;
BA_ "GenMsgSendType" BO_ 430 0;
BA_ "VFrameFormat" BO_ 430 14;
BA_ "CANFD_BRS" BO_ 430 1;
BA_ "GenMsgCycleTime" BO_ 430 10;
BA_ "GenMsgCycleTimeFast" BO_ 430 0;
BA_ "GenMsgSendType" BO_ 430 0;
BA_ "VFrameFormat" BO_ 430 14;
BA_ "CANFD_BRS" BO_ 430 1;
BA_ "GenMsgCycleTime" BO_ 430 10;
BA_ "GenMsgCycleTimeFast" BO_ 430 0;
BA_ "GenMsgSendType" BO_ 430 0;
BA_ "VFrameFormat" BO_ 430 14;
BA_ "CANFD_BRS" BO_ 430 1;
BA_ "GenMsgCycleTime" BO_ 430 10;
BA_ "GenMsgCycleTimeFast" BO_ 430 0;
BA_ "GenMsgSendType" BO_ 430 0;
BA_ "VFrameFormat" BO_ 430 14;
BA_ "CANFD_BRS" BO_ 430 1;
BA_ "GenMsgCycleTime" BO_ 430 10;
BA_ "GenMsgCycleTimeFast" BO_ 430 0;
BA_ "GenMsgSendType" BO_ 430 0;
BA_ "VFrameFormat" BO_ 430 14;
BA_ "CANFD_BRS" BO_ 430 1;
BA_ "EventCommandSignal" SG_ 728 ECS_1_CRC 0;
BA_ "GatewayedSignals" SG_ 728 ECS_1_CRC 0;
BA_ "GenSigInactiveValue" SG_ 728 ECS_1_CRC 0;
BA_ "GenSigInvalidValue" SG_ 728 ECS_1_CRC 0;
BA_ "GenSigSendType" SG_ 728 ECS_1_CRC 1;
BA_ "GenSigStartValue" SG_ 728 ECS_1_CRC 0;
BA_ "GenSigTimeoutValue" SG_ 728 ECS_1_CRC 0;
BA_ "Remark" SG_ 728 ECS_1_CRC "";
BA_ "EventCommandSignal" SG_ 728 ECS_1_Counter 0;
BA_ "GatewayedSignals" SG_ 728 ECS_1_Counter 0;
BA_ "GenSigInactiveValue" SG_ 728 ECS_1_Counter 0;
BA_ "GenSigInvalidValue" SG_ 728 ECS_1_Counter 0;
BA_ "GenSigSendType" SG_ 728 ECS_1_Counter 1;
BA_ "GenSigStartValue" SG_ 728 ECS_1_Counter 0;
BA_ "GenSigTimeoutValue" SG_ 728 ECS_1_Counter 0;
BA_ "Remark" SG_ 728 ECS_1_Counter "";
BA_ "EventCommandSignal" SG_ 728 CDC_ADCCtrlAvl 0;
BA_ "GatewayedSignals" SG_ 728 CDC_ADCCtrlAvl 0;
BA_ "GenSigInactiveValue" SG_ 728 CDC_ADCCtrlAvl 0;
BA_ "GenSigInvalidValue" SG_ 728 CDC_ADCCtrlAvl 0;
BA_ "GenSigSendType" SG_ 728 CDC_ADCCtrlAvl 1;
BA_ "GenSigStartValue" SG_ 728 CDC_ADCCtrlAvl 0;
BA_ "GenSigTimeoutValue" SG_ 728 CDC_ADCCtrlAvl 0;
BA_ "Remark" SG_ 728 CDC_ADCCtrlAvl "";
BA_ "EventCommandSignal" SG_ 728 CDC_ADCCtrlRespSts 0;
BA_ "GatewayedSignals" SG_ 728 CDC_ADCCtrlRespSts 0;
BA_ "GenSigInactiveValue" SG_ 728 CDC_ADCCtrlRespSts 0;
BA_ "GenSigInvalidValue" SG_ 728 CDC_ADCCtrlRespSts 0;
BA_ "GenSigSendType" SG_ 728 CDC_ADCCtrlRespSts 1;
BA_ "GenSigStartValue" SG_ 728 CDC_ADCCtrlRespSts 0;
BA_ "GenSigTimeoutValue" SG_ 728 CDC_ADCCtrlRespSts 0;
BA_ "Remark" SG_ 728 CDC_ADCCtrlRespSts "";
BA_ "EventCommandSignal" SG_ 728 CDC_ADCModState 0;
BA_ "GatewayedSignals" SG_ 728 CDC_ADCModState 0;
BA_ "GenSigInactiveValue" SG_ 728 CDC_ADCModState 0;
BA_ "GenSigInvalidValue" SG_ 728 CDC_ADCModState 0;
BA_ "GenSigSendType" SG_ 728 CDC_ADCModState 1;
BA_ "GenSigStartValue" SG_ 728 CDC_ADCModState 0;
BA_ "GenSigTimeoutValue" SG_ 728 CDC_ADCModState 0;
BA_ "Remark" SG_ 728 CDC_ADCModState "";
BA_ "EventCommandSignal" SG_ 459 ECS_2_CRC 0;
BA_ "GatewayedSignals" SG_ 459 ECS_2_CRC 0;
BA_ "GenSigInactiveValue" SG_ 459 ECS_2_CRC 0;
BA_ "GenSigInvalidValue" SG_ 459 ECS_2_CRC 0;
BA_ "GenSigSendType" SG_ 459 ECS_2_CRC 1;
BA_ "GenSigStartValue" SG_ 459 ECS_2_CRC 0;
BA_ "GenSigTimeoutValue" SG_ 459 ECS_2_CRC 0;
BA_ "Remark" SG_ 459 ECS_2_CRC "";
BA_ "EventCommandSignal" SG_ 459 ECS_2_Counter 0;
BA_ "GatewayedSignals" SG_ 459 ECS_2_Counter 0;
BA_ "GenSigInactiveValue" SG_ 459 ECS_2_Counter 0;
BA_ "GenSigInvalidValue" SG_ 459 ECS_2_Counter 0;
BA_ "GenSigSendType" SG_ 459 ECS_2_Counter 1;
BA_ "GenSigStartValue" SG_ 459 ECS_2_Counter 0;
BA_ "GenSigTimeoutValue" SG_ 459 ECS_2_Counter 0;
BA_ "Remark" SG_ 459 ECS_2_Counter "";
BA_ "EventCommandSignal" SG_ 459 AS_SuspHeightFL 0;
BA_ "GatewayedSignals" SG_ 459 AS_SuspHeightFL 0;
BA_ "GenSigInactiveValue" SG_ 459 AS_SuspHeightFL 0;
BA_ "GenSigInvalidValue" SG_ 459 AS_SuspHeightFL 4095;
BA_ "GenSigSendType" SG_ 459 AS_SuspHeightFL 1;
BA_ "GenSigStartValue" SG_ 459 AS_SuspHeightFL 0;
BA_ "GenSigTimeoutValue" SG_ 459 AS_SuspHeightFL 1500;
BA_ "Remark" SG_ 459 AS_SuspHeightFL "";
BA_ "EventCommandSignal" SG_ 459 AS_SuspHeightFR 0;
BA_ "GatewayedSignals" SG_ 459 AS_SuspHeightFR 0;
BA_ "GenSigInactiveValue" SG_ 459 AS_SuspHeightFR 0;
BA_ "GenSigInvalidValue" SG_ 459 AS_SuspHeightFR 4095;
BA_ "GenSigSendType" SG_ 459 AS_SuspHeightFR 1;
BA_ "GenSigStartValue" SG_ 459 AS_SuspHeightFR 0;
BA_ "GenSigTimeoutValue" SG_ 459 AS_SuspHeightFR 1500;
BA_ "Remark" SG_ 459 AS_SuspHeightFR "";
BA_ "EventCommandSignal" SG_ 459 AS_SuspHeightRL 0;
BA_ "GatewayedSignals" SG_ 459 AS_SuspHeightRL 0;
BA_ "GenSigInactiveValue" SG_ 459 AS_SuspHeightRL 0;
BA_ "GenSigInvalidValue" SG_ 459 AS_SuspHeightRL 4095;
BA_ "GenSigSendType" SG_ 459 AS_SuspHeightRL 1;
BA_ "GenSigStartValue" SG_ 459 AS_SuspHeightRL 0;
BA_ "GenSigTimeoutValue" SG_ 459 AS_SuspHeightRL 1500;
BA_ "Remark" SG_ 459 AS_SuspHeightRL "";
BA_ "EventCommandSignal" SG_ 459 AS_SuspHeightRR 0;
BA_ "GatewayedSignals" SG_ 459 AS_SuspHeightRR 0;
BA_ "GenSigInactiveValue" SG_ 459 AS_SuspHeightRR 0;
BA_ "GenSigInvalidValue" SG_ 459 AS_SuspHeightRR 4095;
BA_ "GenSigSendType" SG_ 459 AS_SuspHeightRR 1;
BA_ "GenSigStartValue" SG_ 459 AS_SuspHeightRR 0;
BA_ "GenSigTimeoutValue" SG_ 459 AS_SuspHeightRR 1500;
BA_ "Remark" SG_ 459 AS_SuspHeightRR "";
BA_ "EventCommandSignal" SG_ 459 AS_SuspHeightFLVD 0;
BA_ "GatewayedSignals" SG_ 459 AS_SuspHeightFLVD 0;
BA_ "GenSigInactiveValue" SG_ 459 AS_SuspHeightFLVD 0;
BA_ "GenSigInvalidValue" SG_ 459 AS_SuspHeightFLVD 0;
BA_ "GenSigSendType" SG_ 459 AS_SuspHeightFLVD 1;
BA_ "GenSigStartValue" SG_ 459 AS_SuspHeightFLVD 1;
BA_ "GenSigTimeoutValue" SG_ 459 AS_SuspHeightFLVD 0;
BA_ "Remark" SG_ 459 AS_SuspHeightFLVD "";
BA_ "EventCommandSignal" SG_ 459 AS_SuspHeightFRVD 0;
BA_ "GatewayedSignals" SG_ 459 AS_SuspHeightFRVD 0;
BA_ "GenSigInactiveValue" SG_ 459 AS_SuspHeightFRVD 0;
BA_ "GenSigInvalidValue" SG_ 459 AS_SuspHeightFRVD 0;
BA_ "GenSigSendType" SG_ 459 AS_SuspHeightFRVD 1;
BA_ "GenSigStartValue" SG_ 459 AS_SuspHeightFRVD 1;
BA_ "GenSigTimeoutValue" SG_ 459 AS_SuspHeightFRVD 0;
BA_ "Remark" SG_ 459 AS_SuspHeightFRVD "";
BA_ "EventCommandSignal" SG_ 459 AS_SuspHeightRLVD 0;
BA_ "GatewayedSignals" SG_ 459 AS_SuspHeightRLVD 0;
BA_ "GenSigInactiveValue" SG_ 459 AS_SuspHeightRLVD 0;
BA_ "GenSigInvalidValue" SG_ 459 AS_SuspHeightRLVD 0;
BA_ "GenSigSendType" SG_ 459 AS_SuspHeightRLVD 1;
BA_ "GenSigStartValue" SG_ 459 AS_SuspHeightRLVD 1;
BA_ "GenSigTimeoutValue" SG_ 459 AS_SuspHeightRLVD 0;
BA_ "Remark" SG_ 459 AS_SuspHeightRLVD "";
BA_ "EventCommandSignal" SG_ 459 AS_SuspHeightRRVD 0;
BA_ "GatewayedSignals" SG_ 459 AS_SuspHeightRRVD 0;
BA_ "GenSigInactiveValue" SG_ 459 AS_SuspHeightRRVD 0;
BA_ "GenSigInvalidValue" SG_ 459 AS_SuspHeightRRVD 0;
BA_ "GenSigSendType" SG_ 459 AS_SuspHeightRRVD 1;
BA_ "GenSigStartValue" SG_ 459 AS_SuspHeightRRVD 1;
BA_ "GenSigTimeoutValue" SG_ 459 AS_SuspHeightRRVD 0;
BA_ "Remark" SG_ 459 AS_SuspHeightRRVD "";
BA_ "EventCommandSignal" SG_ 459 AS_SuspHeightSensorFLSt 0;
BA_ "GatewayedSignals" SG_ 459 AS_SuspHeightSensorFLSt 0;
BA_ "GenSigInactiveValue" SG_ 459 AS_SuspHeightSensorFLSt 0;
BA_ "GenSigInvalidValue" SG_ 459 AS_SuspHeightSensorFLSt 0;
BA_ "GenSigSendType" SG_ 459 AS_SuspHeightSensorFLSt 1;
BA_ "GenSigStartValue" SG_ 459 AS_SuspHeightSensorFLSt 0;
BA_ "GenSigTimeoutValue" SG_ 459 AS_SuspHeightSensorFLSt 1;
BA_ "Remark" SG_ 459 AS_SuspHeightSensorFLSt "";
BA_ "EventCommandSignal" SG_ 459 AS_SuspHeightSensorFRSt 0;
BA_ "GatewayedSignals" SG_ 459 AS_SuspHeightSensorFRSt 0;
BA_ "GenSigInactiveValue" SG_ 459 AS_SuspHeightSensorFRSt 0;
BA_ "GenSigInvalidValue" SG_ 459 AS_SuspHeightSensorFRSt 0;
BA_ "GenSigSendType" SG_ 459 AS_SuspHeightSensorFRSt 1;
BA_ "GenSigStartValue" SG_ 459 AS_SuspHeightSensorFRSt 0;
BA_ "GenSigTimeoutValue" SG_ 459 AS_SuspHeightSensorFRSt 1;
BA_ "Remark" SG_ 459 AS_SuspHeightSensorFRSt "";
BA_ "EventCommandSignal" SG_ 459 AS_SuspHeightSensorRLSt 0;
BA_ "GatewayedSignals" SG_ 459 AS_SuspHeightSensorRLSt 0;
BA_ "GenSigInactiveValue" SG_ 459 AS_SuspHeightSensorRLSt 0;
BA_ "GenSigInvalidValue" SG_ 459 AS_SuspHeightSensorRLSt 0;
BA_ "GenSigSendType" SG_ 459 AS_SuspHeightSensorRLSt 1;
BA_ "GenSigStartValue" SG_ 459 AS_SuspHeightSensorRLSt 0;
BA_ "GenSigTimeoutValue" SG_ 459 AS_SuspHeightSensorRLSt 1;
BA_ "Remark" SG_ 459 AS_SuspHeightSensorRLSt "";
BA_ "EventCommandSignal" SG_ 459 AS_SuspHeightSensoRRSt 0;
BA_ "GatewayedSignals" SG_ 459 AS_SuspHeightSensoRRSt 0;
BA_ "GenSigInactiveValue" SG_ 459 AS_SuspHeightSensoRRSt 0;
BA_ "GenSigInvalidValue" SG_ 459 AS_SuspHeightSensoRRSt 0;
BA_ "GenSigSendType" SG_ 459 AS_SuspHeightSensoRRSt 1;
BA_ "GenSigStartValue" SG_ 459 AS_SuspHeightSensoRRSt 0;
BA_ "GenSigTimeoutValue" SG_ 459 AS_SuspHeightSensoRRSt 1;
BA_ "Remark" SG_ 459 AS_SuspHeightSensoRRSt "";
BA_ "EventCommandSignal" SG_ 459 AS_MaintanceModeSt 0;
BA_ "GatewayedSignals" SG_ 459 AS_MaintanceModeSt 0;
BA_ "GenSigInactiveValue" SG_ 459 AS_MaintanceModeSt 0;
BA_ "GenSigInvalidValue" SG_ 459 AS_MaintanceModeSt 0;
BA_ "GenSigSendType" SG_ 459 AS_MaintanceModeSt 1;
BA_ "GenSigStartValue" SG_ 459 AS_MaintanceModeSt 0;
BA_ "GenSigTimeoutValue" SG_ 459 AS_MaintanceModeSt 0;
BA_ "Remark" SG_ 459 AS_MaintanceModeSt "";
BA_ "EventCommandSignal" SG_ 459 ECS_AVDCReqModeAvailable 0;
BA_ "GatewayedSignals" SG_ 459 ECS_AVDCReqModeAvailable 0;
BA_ "GenSigInactiveValue" SG_ 459 ECS_AVDCReqModeAvailable 0;
BA_ "GenSigInvalidValue" SG_ 459 ECS_AVDCReqModeAvailable 0;
BA_ "GenSigSendType" SG_ 459 ECS_AVDCReqModeAvailable 1;
BA_ "GenSigStartValue" SG_ 459 ECS_AVDCReqModeAvailable 0;
BA_ "GenSigTimeoutValue" SG_ 459 ECS_AVDCReqModeAvailable 0;
BA_ "Remark" SG_ 459 ECS_AVDCReqModeAvailable "";
BA_ "EventCommandSignal" SG_ 459 ECS_AVDCReqMode 0;
BA_ "GatewayedSignals" SG_ 459 ECS_AVDCReqMode 0;
BA_ "GenSigInactiveValue" SG_ 459 ECS_AVDCReqMode 0;
BA_ "GenSigInvalidValue" SG_ 459 ECS_AVDCReqMode 0;
BA_ "GenSigSendType" SG_ 459 ECS_AVDCReqMode 1;
BA_ "GenSigStartValue" SG_ 459 ECS_AVDCReqMode 0;
BA_ "GenSigTimeoutValue" SG_ 459 ECS_AVDCReqMode 0;
BA_ "Remark" SG_ 459 ECS_AVDCReqMode "";
BA_ "EventCommandSignal" SG_ 459 AS_FrontAxleSuspSt 0;
BA_ "GatewayedSignals" SG_ 459 AS_FrontAxleSuspSt 0;
BA_ "GenSigInactiveValue" SG_ 459 AS_FrontAxleSuspSt 0;
BA_ "GenSigInvalidValue" SG_ 459 AS_FrontAxleSuspSt 0;
BA_ "GenSigSendType" SG_ 459 AS_FrontAxleSuspSt 1;
BA_ "GenSigStartValue" SG_ 459 AS_FrontAxleSuspSt 0;
BA_ "GenSigTimeoutValue" SG_ 459 AS_FrontAxleSuspSt 0;
BA_ "Remark" SG_ 459 AS_FrontAxleSuspSt "";
BA_ "EventCommandSignal" SG_ 459 AS_RearAxleSuspSt 0;
BA_ "GatewayedSignals" SG_ 459 AS_RearAxleSuspSt 0;
BA_ "GenSigInactiveValue" SG_ 459 AS_RearAxleSuspSt 0;
BA_ "GenSigInvalidValue" SG_ 459 AS_RearAxleSuspSt 0;
BA_ "GenSigSendType" SG_ 459 AS_RearAxleSuspSt 1;
BA_ "GenSigStartValue" SG_ 459 AS_RearAxleSuspSt 0;
BA_ "GenSigTimeoutValue" SG_ 459 AS_RearAxleSuspSt 0;
BA_ "Remark" SG_ 459 AS_RearAxleSuspSt "";
BA_ "EventCommandSignal" SG_ 459 AS_HeightWarningSt 0;
BA_ "GatewayedSignals" SG_ 459 AS_HeightWarningSt 0;
BA_ "GenSigInactiveValue" SG_ 459 AS_HeightWarningSt 0;
BA_ "GenSigInvalidValue" SG_ 459 AS_HeightWarningSt 0;
BA_ "GenSigSendType" SG_ 459 AS_HeightWarningSt 1;
BA_ "GenSigStartValue" SG_ 459 AS_HeightWarningSt 0;
BA_ "GenSigTimeoutValue" SG_ 459 AS_HeightWarningSt 0;
BA_ "Remark" SG_ 459 AS_HeightWarningSt "";
BA_ "EventCommandSignal" SG_ 459 AS_CurrentLevel 0;
BA_ "GatewayedSignals" SG_ 459 AS_CurrentLevel 0;
BA_ "GenSigInactiveValue" SG_ 459 AS_CurrentLevel 0;
BA_ "GenSigInvalidValue" SG_ 459 AS_CurrentLevel 0;
BA_ "GenSigSendType" SG_ 459 AS_CurrentLevel 1;
BA_ "GenSigStartValue" SG_ 459 AS_CurrentLevel 0;
BA_ "GenSigTimeoutValue" SG_ 459 AS_CurrentLevel 0;
BA_ "Remark" SG_ 459 AS_CurrentLevel "";
BA_ "EventCommandSignal" SG_ 459 AS_ASMode 0;
BA_ "GatewayedSignals" SG_ 459 AS_ASMode 0;
BA_ "GenSigInactiveValue" SG_ 459 AS_ASMode 0;
BA_ "GenSigInvalidValue" SG_ 459 AS_ASMode 0;
BA_ "GenSigSendType" SG_ 459 AS_ASMode 1;
BA_ "GenSigStartValue" SG_ 459 AS_ASMode 0;
BA_ "GenSigTimeoutValue" SG_ 459 AS_ASMode 0;
BA_ "Remark" SG_ 459 AS_ASMode "";
BA_ "EventCommandSignal" SG_ 459 AS_SysFaultSt 0;
BA_ "GatewayedSignals" SG_ 459 AS_SysFaultSt 0;
BA_ "GenSigInactiveValue" SG_ 459 AS_SysFaultSt 0;
BA_ "GenSigInvalidValue" SG_ 459 AS_SysFaultSt 0;
BA_ "GenSigSendType" SG_ 459 AS_SysFaultSt 1;
BA_ "GenSigStartValue" SG_ 459 AS_SysFaultSt 0;
BA_ "GenSigTimeoutValue" SG_ 459 AS_SysFaultSt 2;
BA_ "Remark" SG_ 459 AS_SysFaultSt "";
BA_ "EventCommandSignal" SG_ 459 AS_SysOperationSt 0;
BA_ "GatewayedSignals" SG_ 459 AS_SysOperationSt 0;
BA_ "GenSigInactiveValue" SG_ 459 AS_SysOperationSt 0;
BA_ "GenSigInvalidValue" SG_ 459 AS_SysOperationSt 0;
BA_ "GenSigSendType" SG_ 459 AS_SysOperationSt 1;
BA_ "GenSigStartValue" SG_ 459 AS_SysOperationSt 0;
BA_ "GenSigTimeoutValue" SG_ 459 AS_SysOperationSt 0;
BA_ "Remark" SG_ 459 AS_SysOperationSt "";
BA_ "EventCommandSignal" SG_ 459 AS_ADCStfnCtrlAvl 0;
BA_ "GatewayedSignals" SG_ 459 AS_ADCStfnCtrlAvl 0;
BA_ "GenSigInactiveValue" SG_ 459 AS_ADCStfnCtrlAvl 0;
BA_ "GenSigInvalidValue" SG_ 459 AS_ADCStfnCtrlAvl 0;
BA_ "GenSigSendType" SG_ 459 AS_ADCStfnCtrlAvl 1;
BA_ "GenSigStartValue" SG_ 459 AS_ADCStfnCtrlAvl 0;
BA_ "GenSigTimeoutValue" SG_ 459 AS_ADCStfnCtrlAvl 0;
BA_ "Remark" SG_ 459 AS_ADCStfnCtrlAvl "";
BA_ "EventCommandSignal" SG_ 459 AS_ADCStfnState 0;
BA_ "GatewayedSignals" SG_ 459 AS_ADCStfnState 0;
BA_ "GenSigInactiveValue" SG_ 459 AS_ADCStfnState 0;
BA_ "GenSigInvalidValue" SG_ 459 AS_ADCStfnState 0;
BA_ "GenSigSendType" SG_ 459 AS_ADCStfnState 1;
BA_ "GenSigStartValue" SG_ 459 AS_ADCStfnState 0;
BA_ "GenSigTimeoutValue" SG_ 459 AS_ADCStfnState 0;
BA_ "Remark" SG_ 459 AS_ADCStfnState "";
BA_ "EventCommandSignal" SG_ 905 ICM_SetIACCSt 0;
BA_ "GatewayedSignals" SG_ 905 ICM_SetIACCSt 0;
BA_ "GenSigInactiveValue" SG_ 905 ICM_SetIACCSt 0;
BA_ "GenSigInvalidValue" SG_ 905 ICM_SetIACCSt 0;
BA_ "GenSigSendType" SG_ 905 ICM_SetIACCSt 1;
BA_ "GenSigStartValue" SG_ 905 ICM_SetIACCSt 0;
BA_ "GenSigTimeoutValue" SG_ 905 ICM_SetIACCSt 0;
BA_ "Remark" SG_ 905 ICM_SetIACCSt "";
BA_ "EventCommandSignal" SG_ 905 ICM_TotalOdometer 0;
BA_ "GatewayedSignals" SG_ 905 ICM_TotalOdometer 0;
BA_ "GenSigInactiveValue" SG_ 905 ICM_TotalOdometer 0;
BA_ "GenSigInvalidValue" SG_ 905 ICM_TotalOdometer 0;
BA_ "GenSigSendType" SG_ 905 ICM_TotalOdometer 1;
BA_ "GenSigStartValue" SG_ 905 ICM_TotalOdometer 0;
BA_ "EventCommandSignal" SG_ 905 ICM_VehInsSpd 0;
BA_ "GatewayedSignals" SG_ 905 ICM_VehInsSpd 0;
BA_ "GenSigInactiveValue" SG_ 905 ICM_VehInsSpd 0;
BA_ "GenSigInvalidValue" SG_ 905 ICM_VehInsSpd 255;
BA_ "GenSigSendType" SG_ 905 ICM_VehInsSpd 1;
BA_ "GenSigStartValue" SG_ 905 ICM_VehInsSpd 0;
BA_ "GenSigTimeoutValue" SG_ 905 ICM_VehInsSpd 0;
BA_ "Remark" SG_ 905 ICM_VehInsSpd "";
BA_ "EventCommandSignal" SG_ 905 ICM_TotalOdometer_accurate 0;
BA_ "GatewayedSignals" SG_ 905 ICM_TotalOdometer_accurate 0;
BA_ "GenSigInactiveValue" SG_ 905 ICM_TotalOdometer_accurate 0;
BA_ "GenSigInvalidValue" SG_ 905 ICM_TotalOdometer_accurate 0;
BA_ "GenSigSendType" SG_ 905 ICM_TotalOdometer_accurate 1;
BA_ "GenSigStartValue" SG_ 905 ICM_TotalOdometer_accurate 0;
BA_ "EventCommandSignal" SG_ 905 ICM_VehInsSpd_accurate 0;
BA_ "GatewayedSignals" SG_ 905 ICM_VehInsSpd_accurate 0;
BA_ "GenSigInactiveValue" SG_ 905 ICM_VehInsSpd_accurate 0;
BA_ "GenSigInvalidValue" SG_ 905 ICM_VehInsSpd_accurate 2047;
BA_ "GenSigSendType" SG_ 905 ICM_VehInsSpd_accurate 1;
BA_ "GenSigStartValue" SG_ 905 ICM_VehInsSpd_accurate 0;
BA_ "GenSigTimeoutValue" SG_ 905 ICM_VehInsSpd_accurate 0;
BA_ "Remark" SG_ 905 ICM_VehInsSpd_accurate "";
BA_ "EventCommandSignal" SG_ 905 ICM_FuelAvaibleDriveDistance 0;
BA_ "GatewayedSignals" SG_ 905 ICM_FuelAvaibleDriveDistance 0;
BA_ "GenSigInactiveValue" SG_ 905 ICM_FuelAvaibleDriveDistance 0;
BA_ "GenSigInvalidValue" SG_ 905 ICM_FuelAvaibleDriveDistance 2047;
BA_ "GenSigSendType" SG_ 905 ICM_FuelAvaibleDriveDistance 1;
BA_ "GenSigStartValue" SG_ 905 ICM_FuelAvaibleDriveDistance 0;
BA_ "GenSigTimeoutValue" SG_ 905 ICM_FuelAvaibleDriveDistance 0;
BA_ "Remark" SG_ 905 ICM_FuelAvaibleDriveDistance "";
BA_ "EventCommandSignal" SG_ 905 ICM_TotalAvaibleDriveDistance 0;
BA_ "GatewayedSignals" SG_ 905 ICM_TotalAvaibleDriveDistance 0;
BA_ "GenSigInactiveValue" SG_ 905 ICM_TotalAvaibleDriveDistance 0;
BA_ "GenSigInvalidValue" SG_ 905 ICM_TotalAvaibleDriveDistance 2047;
BA_ "GenSigSendType" SG_ 905 ICM_TotalAvaibleDriveDistance 1;
BA_ "GenSigStartValue" SG_ 905 ICM_TotalAvaibleDriveDistance 0;
BA_ "GenSigTimeoutValue" SG_ 905 ICM_TotalAvaibleDriveDistance 0;
BA_ "Remark" SG_ 905 ICM_TotalAvaibleDriveDistance "";
BA_ "EventCommandSignal" SG_ 161 ACU_FaceID_Delete 1;
BA_ "GatewayedSignals" SG_ 161 ACU_FaceID_Delete 0;
BA_ "GenSigInactiveValue" SG_ 161 ACU_FaceID_Delete 0;
BA_ "GenSigInvalidValue" SG_ 161 ACU_FaceID_Delete 0;
BA_ "GenSigSendType" SG_ 161 ACU_FaceID_Delete 0;
BA_ "GenSigStartValue" SG_ 161 ACU_FaceID_Delete 0;
BA_ "GenSigTimeoutValue" SG_ 161 ACU_FaceID_Delete 0;
BA_ "Remark" SG_ 161 ACU_FaceID_Delete "";
BA_ "EventCommandSignal" SG_ 161 ACU_RegisterTriger 1;
BA_ "GatewayedSignals" SG_ 161 ACU_RegisterTriger 0;
BA_ "GenSigInactiveValue" SG_ 161 ACU_RegisterTriger 0;
BA_ "GenSigInvalidValue" SG_ 161 ACU_RegisterTriger 0;
BA_ "GenSigSendType" SG_ 161 ACU_RegisterTriger 0;
BA_ "GenSigStartValue" SG_ 161 ACU_RegisterTriger 0;
BA_ "GenSigTimeoutValue" SG_ 161 ACU_RegisterTriger 0;
BA_ "Remark" SG_ 161 ACU_RegisterTriger "";
BA_ "EventCommandSignal" SG_ 161 ACU_VerifyTriger 1;
BA_ "GatewayedSignals" SG_ 161 ACU_VerifyTriger 0;
BA_ "GenSigInactiveValue" SG_ 161 ACU_VerifyTriger 0;
BA_ "GenSigInvalidValue" SG_ 161 ACU_VerifyTriger 0;
BA_ "GenSigSendType" SG_ 161 ACU_VerifyTriger 0;
BA_ "GenSigStartValue" SG_ 161 ACU_VerifyTriger 0;
BA_ "GenSigTimeoutValue" SG_ 161 ACU_VerifyTriger 0;
BA_ "Remark" SG_ 161 ACU_VerifyTriger "";
BA_ "EventCommandSignal" SG_ 161 ACU_FaceIDQuit 1;
BA_ "GatewayedSignals" SG_ 161 ACU_FaceIDQuit 0;
BA_ "GenSigInactiveValue" SG_ 161 ACU_FaceIDQuit 0;
BA_ "GenSigInvalidValue" SG_ 161 ACU_FaceIDQuit 0;
BA_ "GenSigSendType" SG_ 161 ACU_FaceIDQuit 0;
BA_ "GenSigStartValue" SG_ 161 ACU_FaceIDQuit 0;
BA_ "GenSigTimeoutValue" SG_ 161 ACU_FaceIDQuit 0;
BA_ "Remark" SG_ 161 ACU_FaceIDQuit "";
BA_ "EventCommandSignal" SG_ 161 ACU_FaceIDSwitch 1;
BA_ "GatewayedSignals" SG_ 161 ACU_FaceIDSwitch 0;
BA_ "GenSigInactiveValue" SG_ 161 ACU_FaceIDSwitch 0;
BA_ "GenSigInvalidValue" SG_ 161 ACU_FaceIDSwitch 0;
BA_ "GenSigSendType" SG_ 161 ACU_FaceIDSwitch 0;
BA_ "GenSigStartValue" SG_ 161 ACU_FaceIDSwitch 0;
BA_ "GenSigTimeoutValue" SG_ 161 ACU_FaceIDSwitch 0;
BA_ "Remark" SG_ 161 ACU_FaceIDSwitch "";
BA_ "EventCommandSignal" SG_ 161 ACU_AVAS_SwitchCfgReq 1;
BA_ "GatewayedSignals" SG_ 161 ACU_AVAS_SwitchCfgReq 0;
BA_ "GenSigInactiveValue" SG_ 161 ACU_AVAS_SwitchCfgReq 0;
BA_ "GenSigInvalidValue" SG_ 161 ACU_AVAS_SwitchCfgReq 0;
BA_ "GenSigSendType" SG_ 161 ACU_AVAS_SwitchCfgReq 0;
BA_ "GenSigStartValue" SG_ 161 ACU_AVAS_SwitchCfgReq 0;
BA_ "GenSigTimeoutValue" SG_ 161 ACU_AVAS_SwitchCfgReq 0;
BA_ "Remark" SG_ 161 ACU_AVAS_SwitchCfgReq "";
BA_ "EventCommandSignal" SG_ 913 CCU_GwMsg_L3_CRC 0;
BA_ "GatewayedSignals" SG_ 913 CCU_GwMsg_L3_CRC 0;
BA_ "GenSigInactiveValue" SG_ 913 CCU_GwMsg_L3_CRC 0;
BA_ "GenSigInvalidValue" SG_ 913 CCU_GwMsg_L3_CRC 0;
BA_ "GenSigSendType" SG_ 913 CCU_GwMsg_L3_CRC 1;
BA_ "GenSigStartValue" SG_ 913 CCU_GwMsg_L3_CRC 0;
BA_ "GenSigTimeoutValue" SG_ 913 CCU_GwMsg_L3_CRC 0;
BA_ "Remark" SG_ 913 CCU_GwMsg_L3_CRC "";
BA_ "EventCommandSignal" SG_ 913 CCU_GwMsg_L3_Counter 0;
BA_ "GatewayedSignals" SG_ 913 CCU_GwMsg_L3_Counter 0;
BA_ "GenSigInactiveValue" SG_ 913 CCU_GwMsg_L3_Counter 0;
BA_ "GenSigInvalidValue" SG_ 913 CCU_GwMsg_L3_Counter 0;
BA_ "GenSigSendType" SG_ 913 CCU_GwMsg_L3_Counter 1;
BA_ "GenSigStartValue" SG_ 913 CCU_GwMsg_L3_Counter 0;
BA_ "GenSigTimeoutValue" SG_ 913 CCU_GwMsg_L3_Counter 0;
BA_ "Remark" SG_ 913 CCU_GwMsg_L3_Counter "";
BA_ "EventCommandSignal" SG_ 913 IL_PADS_LightbarSt 0;
BA_ "GatewayedSignals" SG_ 913 IL_PADS_LightbarSt 0;
BA_ "GenSigInactiveValue" SG_ 913 IL_PADS_LightbarSt 0;
BA_ "GenSigInvalidValue" SG_ 913 IL_PADS_LightbarSt 0;
BA_ "GenSigSendType" SG_ 913 IL_PADS_LightbarSt 1;
BA_ "GenSigStartValue" SG_ 913 IL_PADS_LightbarSt 0;
BA_ "GenSigTimeoutValue" SG_ 913 IL_PADS_LightbarSt 15;
BA_ "Remark" SG_ 913 IL_PADS_LightbarSt "";
BA_ "EventCommandSignal" SG_ 913 IL_PADS_LightbarErrSt 0;
BA_ "GatewayedSignals" SG_ 913 IL_PADS_LightbarErrSt 0;
BA_ "GenSigInactiveValue" SG_ 913 IL_PADS_LightbarErrSt 0;
BA_ "GenSigInvalidValue" SG_ 913 IL_PADS_LightbarErrSt 0;
BA_ "GenSigSendType" SG_ 913 IL_PADS_LightbarErrSt 1;
BA_ "GenSigStartValue" SG_ 913 IL_PADS_LightbarErrSt 0;
BA_ "GenSigTimeoutValue" SG_ 913 IL_PADS_LightbarErrSt 0;
BA_ "Remark" SG_ 913 IL_PADS_LightbarErrSt "";
BA_ "EventCommandSignal" SG_ 913 UINM_PADS_L3SWSt 0;
BA_ "GatewayedSignals" SG_ 913 UINM_PADS_L3SWSt 0;
BA_ "GenSigInactiveValue" SG_ 913 UINM_PADS_L3SWSt 0;
BA_ "GenSigInvalidValue" SG_ 913 UINM_PADS_L3SWSt 0;
BA_ "GenSigSendType" SG_ 913 UINM_PADS_L3SWSt 1;
BA_ "GenSigStartValue" SG_ 913 UINM_PADS_L3SWSt 0;
BA_ "GenSigTimeoutValue" SG_ 913 UINM_PADS_L3SWSt 0;
BA_ "Remark" SG_ 913 UINM_PADS_L3SWSt "";
BA_ "EventCommandSignal" SG_ 913 UINM_PADS_L3SWStVD 0;
BA_ "GatewayedSignals" SG_ 913 UINM_PADS_L3SWStVD 0;
BA_ "GenSigInactiveValue" SG_ 913 UINM_PADS_L3SWStVD 0;
BA_ "GenSigInvalidValue" SG_ 913 UINM_PADS_L3SWStVD 0;
BA_ "GenSigSendType" SG_ 913 UINM_PADS_L3SWStVD 1;
BA_ "GenSigStartValue" SG_ 913 UINM_PADS_L3SWStVD 0;
BA_ "GenSigTimeoutValue" SG_ 913 UINM_PADS_L3SWStVD 0;
BA_ "Remark" SG_ 913 UINM_PADS_L3SWStVD "";
BA_ "EventCommandSignal" SG_ 913 UINM_PADS_L3SWStuckSt 0;
BA_ "GatewayedSignals" SG_ 913 UINM_PADS_L3SWStuckSt 0;
BA_ "GenSigInactiveValue" SG_ 913 UINM_PADS_L3SWStuckSt 0;
BA_ "GenSigInvalidValue" SG_ 913 UINM_PADS_L3SWStuckSt 0;
BA_ "GenSigSendType" SG_ 913 UINM_PADS_L3SWStuckSt 1;
BA_ "GenSigStartValue" SG_ 913 UINM_PADS_L3SWStuckSt 0;
BA_ "GenSigTimeoutValue" SG_ 913 UINM_PADS_L3SWStuckSt 0;
BA_ "Remark" SG_ 913 UINM_PADS_L3SWStuckSt "";
BA_ "EventCommandSignal" SG_ 904 CCU_GwMsg_4_CRC 0;
BA_ "GatewayedSignals" SG_ 904 CCU_GwMsg_4_CRC 0;
BA_ "GenSigInactiveValue" SG_ 904 CCU_GwMsg_4_CRC 0;
BA_ "GenSigInvalidValue" SG_ 904 CCU_GwMsg_4_CRC 0;
BA_ "GenSigSendType" SG_ 904 CCU_GwMsg_4_CRC 1;
BA_ "GenSigStartValue" SG_ 904 CCU_GwMsg_4_CRC 0;
BA_ "GenSigTimeoutValue" SG_ 904 CCU_GwMsg_4_CRC 0;
BA_ "Remark" SG_ 904 CCU_GwMsg_4_CRC "";
BA_ "EventCommandSignal" SG_ 904 CCU_GwMsg_4_Counter 0;
BA_ "GatewayedSignals" SG_ 904 CCU_GwMsg_4_Counter 0;
BA_ "GenSigInactiveValue" SG_ 904 CCU_GwMsg_4_Counter 0;
BA_ "GenSigInvalidValue" SG_ 904 CCU_GwMsg_4_Counter 0;
BA_ "GenSigSendType" SG_ 904 CCU_GwMsg_4_Counter 1;
BA_ "GenSigStartValue" SG_ 904 CCU_GwMsg_4_Counter 0;
BA_ "GenSigTimeoutValue" SG_ 904 CCU_GwMsg_4_Counter 0;
BA_ "Remark" SG_ 904 CCU_GwMsg_4_Counter "";
BA_ "EventCommandSignal" SG_ 904 HVAC_RearDefrostSt 0;
BA_ "GatewayedSignals" SG_ 904 HVAC_RearDefrostSt 0;
BA_ "GenSigInactiveValue" SG_ 904 HVAC_RearDefrostSt 0;
BA_ "GenSigInvalidValue" SG_ 904 HVAC_RearDefrostSt 0;
BA_ "GenSigSendType" SG_ 904 HVAC_RearDefrostSt 1;
BA_ "GenSigStartValue" SG_ 904 HVAC_RearDefrostSt 0;
BA_ "GenSigTimeoutValue" SG_ 904 HVAC_RearDefrostSt 0;
BA_ "Remark" SG_ 904 HVAC_RearDefrostSt "";
BA_ "EventCommandSignal" SG_ 904 HVAC_WindExitMode 0;
BA_ "GatewayedSignals" SG_ 904 HVAC_WindExitMode 0;
BA_ "GenSigInactiveValue" SG_ 904 HVAC_WindExitMode 0;
BA_ "GenSigInvalidValue" SG_ 904 HVAC_WindExitMode 0;
BA_ "GenSigSendType" SG_ 904 HVAC_WindExitMode 1;
BA_ "GenSigStartValue" SG_ 904 HVAC_WindExitMode 0;
BA_ "GenSigTimeoutValue" SG_ 904 HVAC_WindExitMode 0;
BA_ "Remark" SG_ 904 HVAC_WindExitMode "";
BA_ "EventCommandSignal" SG_ 904 HVAC_CorrectedExterTemp 0;
BA_ "GatewayedSignals" SG_ 904 HVAC_CorrectedExterTemp 0;
BA_ "GenSigInactiveValue" SG_ 904 HVAC_CorrectedExterTemp 0;
BA_ "GenSigInvalidValue" SG_ 904 HVAC_CorrectedExterTemp 0;
BA_ "GenSigSendType" SG_ 904 HVAC_CorrectedExterTemp 1;
BA_ "GenSigStartValue" SG_ 904 HVAC_CorrectedExterTemp 120;
BA_ "GenSigTimeoutValue" SG_ 904 HVAC_CorrectedExterTemp 120;
BA_ "Remark" SG_ 904 HVAC_CorrectedExterTemp "";
BA_ "EventCommandSignal" SG_ 904 HVAC_CorrectedExterTempVD 0;
BA_ "GatewayedSignals" SG_ 904 HVAC_CorrectedExterTempVD 0;
BA_ "GenSigInactiveValue" SG_ 904 HVAC_CorrectedExterTempVD 0;
BA_ "GenSigInvalidValue" SG_ 904 HVAC_CorrectedExterTempVD 0;
BA_ "GenSigSendType" SG_ 904 HVAC_CorrectedExterTempVD 1;
BA_ "GenSigStartValue" SG_ 904 HVAC_CorrectedExterTempVD 0;
BA_ "GenSigTimeoutValue" SG_ 904 HVAC_CorrectedExterTempVD 0;
BA_ "Remark" SG_ 904 HVAC_CorrectedExterTempVD "";
BA_ "EventCommandSignal" SG_ 904 HVAC_CorrectedCabinTemp 0;
BA_ "GatewayedSignals" SG_ 904 HVAC_CorrectedCabinTemp 0;
BA_ "GenSigInactiveValue" SG_ 904 HVAC_CorrectedCabinTemp 0;
BA_ "GenSigInvalidValue" SG_ 904 HVAC_CorrectedCabinTemp 0;
BA_ "GenSigSendType" SG_ 904 HVAC_CorrectedCabinTemp 1;
BA_ "GenSigStartValue" SG_ 904 HVAC_CorrectedCabinTemp 120;
BA_ "GenSigTimeoutValue" SG_ 904 HVAC_CorrectedCabinTemp 120;
BA_ "Remark" SG_ 904 HVAC_CorrectedCabinTemp "";
BA_ "EventCommandSignal" SG_ 904 HVAC_CorrectedCabinTempVD 0;
BA_ "GatewayedSignals" SG_ 904 HVAC_CorrectedCabinTempVD 0;
BA_ "GenSigInactiveValue" SG_ 904 HVAC_CorrectedCabinTempVD 0;
BA_ "GenSigInvalidValue" SG_ 904 HVAC_CorrectedCabinTempVD 0;
BA_ "GenSigSendType" SG_ 904 HVAC_CorrectedCabinTempVD 1;
BA_ "GenSigStartValue" SG_ 904 HVAC_CorrectedCabinTempVD 0;
BA_ "GenSigTimeoutValue" SG_ 904 HVAC_CorrectedCabinTempVD 0;
BA_ "Remark" SG_ 904 HVAC_CorrectedCabinTempVD "";
BA_ "EventCommandSignal" SG_ 904 WW_FwpFaultSt 0;
BA_ "GatewayedSignals" SG_ 904 WW_FwpFaultSt 0;
BA_ "GenSigInactiveValue" SG_ 904 WW_FwpFaultSt 0;
BA_ "GenSigInvalidValue" SG_ 904 WW_FwpFaultSt 0;
BA_ "GenSigSendType" SG_ 904 WW_FwpFaultSt 1;
BA_ "GenSigStartValue" SG_ 904 WW_FwpFaultSt 0;
BA_ "GenSigTimeoutValue" SG_ 904 WW_FwpFaultSt 0;
BA_ "Remark" SG_ 904 WW_FwpFaultSt "";
BA_ "EventCommandSignal" SG_ 904 WW_RwpFaultSt 0;
BA_ "GatewayedSignals" SG_ 904 WW_RwpFaultSt 0;
BA_ "GenSigInactiveValue" SG_ 904 WW_RwpFaultSt 0;
BA_ "GenSigInvalidValue" SG_ 904 WW_RwpFaultSt 0;
BA_ "GenSigSendType" SG_ 904 WW_RwpFaultSt 1;
BA_ "GenSigStartValue" SG_ 904 WW_RwpFaultSt 0;
BA_ "GenSigTimeoutValue" SG_ 904 WW_RwpFaultSt 0;
BA_ "Remark" SG_ 904 WW_RwpFaultSt "";
BA_ "EventCommandSignal" SG_ 904 WW_FwshFaultSt 0;
BA_ "GatewayedSignals" SG_ 904 WW_FwshFaultSt 0;
BA_ "GenSigInactiveValue" SG_ 904 WW_FwshFaultSt 0;
BA_ "GenSigInvalidValue" SG_ 904 WW_FwshFaultSt 0;
BA_ "GenSigSendType" SG_ 904 WW_FwshFaultSt 1;
BA_ "GenSigStartValue" SG_ 904 WW_FwshFaultSt 0;
BA_ "GenSigTimeoutValue" SG_ 904 WW_FwshFaultSt 0;
BA_ "Remark" SG_ 904 WW_FwshFaultSt "";
BA_ "EventCommandSignal" SG_ 904 WW_RwshFaultSt 0;
BA_ "GatewayedSignals" SG_ 904 WW_RwshFaultSt 0;
BA_ "GenSigInactiveValue" SG_ 904 WW_RwshFaultSt 0;
BA_ "GenSigInvalidValue" SG_ 904 WW_RwshFaultSt 0;
BA_ "GenSigSendType" SG_ 904 WW_RwshFaultSt 1;
BA_ "GenSigStartValue" SG_ 904 WW_RwshFaultSt 0;
BA_ "GenSigTimeoutValue" SG_ 904 WW_RwshFaultSt 0;
BA_ "Remark" SG_ 904 WW_RwshFaultSt "";
BA_ "EventCommandSignal" SG_ 904 WW_FwpAutoModeSt 0;
BA_ "GatewayedSignals" SG_ 904 WW_FwpAutoModeSt 0;
BA_ "GenSigInactiveValue" SG_ 904 WW_FwpAutoModeSt 0;
BA_ "GenSigInvalidValue" SG_ 904 WW_FwpAutoModeSt 0;
BA_ "GenSigSendType" SG_ 904 WW_FwpAutoModeSt 1;
BA_ "GenSigStartValue" SG_ 904 WW_FwpAutoModeSt 0;
BA_ "GenSigTimeoutValue" SG_ 904 WW_FwpAutoModeSt 0;
BA_ "Remark" SG_ 904 WW_FwpAutoModeSt "";
BA_ "EventCommandSignal" SG_ 904 WW_RainFallLevel 0;
BA_ "GatewayedSignals" SG_ 904 WW_RainFallLevel 0;
BA_ "GenSigInactiveValue" SG_ 904 WW_RainFallLevel 0;
BA_ "GenSigInvalidValue" SG_ 904 WW_RainFallLevel 0;
BA_ "GenSigSendType" SG_ 904 WW_RainFallLevel 1;
BA_ "GenSigStartValue" SG_ 904 WW_RainFallLevel 0;
BA_ "GenSigTimeoutValue" SG_ 904 WW_RainFallLevel 0;
BA_ "Remark" SG_ 904 WW_RainFallLevel "";
BA_ "EventCommandSignal" SG_ 904 RLS_LightOnReq 0;
BA_ "GatewayedSignals" SG_ 904 RLS_LightOnReq 0;
BA_ "GenSigInactiveValue" SG_ 904 RLS_LightOnReq 0;
BA_ "GenSigInvalidValue" SG_ 904 RLS_LightOnReq 0;
BA_ "GenSigSendType" SG_ 904 RLS_LightOnReq 1;
BA_ "GenSigStartValue" SG_ 904 RLS_LightOnReq 0;
BA_ "GenSigTimeoutValue" SG_ 904 RLS_LightOnReq 0;
BA_ "Remark" SG_ 904 RLS_LightOnReq "";
BA_ "EventCommandSignal" SG_ 904 RLS_LampOnReqValid 0;
BA_ "GatewayedSignals" SG_ 904 RLS_LampOnReqValid 0;
BA_ "GenSigInactiveValue" SG_ 904 RLS_LampOnReqValid 0;
BA_ "GenSigInvalidValue" SG_ 904 RLS_LampOnReqValid 0;
BA_ "GenSigSendType" SG_ 904 RLS_LampOnReqValid 1;
BA_ "GenSigStartValue" SG_ 904 RLS_LampOnReqValid 0;
BA_ "GenSigTimeoutValue" SG_ 904 RLS_LampOnReqValid 0;
BA_ "Remark" SG_ 904 RLS_LampOnReqValid "";
BA_ "EventCommandSignal" SG_ 904 RLS_WiperSpd 0;
BA_ "GatewayedSignals" SG_ 904 RLS_WiperSpd 0;
BA_ "GenSigInactiveValue" SG_ 904 RLS_WiperSpd 0;
BA_ "GenSigInvalidValue" SG_ 904 RLS_WiperSpd 0;
BA_ "GenSigSendType" SG_ 904 RLS_WiperSpd 1;
BA_ "GenSigStartValue" SG_ 904 RLS_WiperSpd 0;
BA_ "GenSigTimeoutValue" SG_ 904 RLS_WiperSpd 0;
BA_ "Remark" SG_ 904 RLS_WiperSpd "";
BA_ "EventCommandSignal" SG_ 904 RLS_AMBBrightness 0;
BA_ "GatewayedSignals" SG_ 904 RLS_AMBBrightness 0;
BA_ "GenSigInactiveValue" SG_ 904 RLS_AMBBrightness 0;
BA_ "GenSigInvalidValue" SG_ 904 RLS_AMBBrightness 0;
BA_ "GenSigSendType" SG_ 904 RLS_AMBBrightness 1;
BA_ "GenSigStartValue" SG_ 904 RLS_AMBBrightness 16382;
BA_ "GenSigTimeoutValue" SG_ 904 RLS_AMBBrightness 0;
BA_ "Remark" SG_ 904 RLS_AMBBrightness "";
BA_ "EventCommandSignal" SG_ 904 RLS_FWBrightness 0;
BA_ "GatewayedSignals" SG_ 904 RLS_FWBrightness 0;
BA_ "GenSigInactiveValue" SG_ 904 RLS_FWBrightness 0;
BA_ "GenSigInvalidValue" SG_ 904 RLS_FWBrightness 0;
BA_ "GenSigSendType" SG_ 904 RLS_FWBrightness 1;
BA_ "GenSigStartValue" SG_ 904 RLS_FWBrightness 16382;
BA_ "GenSigTimeoutValue" SG_ 904 RLS_FWBrightness 0;
BA_ "Remark" SG_ 904 RLS_FWBrightness "";
BA_ "EventCommandSignal" SG_ 904 RLS_RainfallLevel 0;
BA_ "GatewayedSignals" SG_ 904 RLS_RainfallLevel 0;
BA_ "GenSigInactiveValue" SG_ 904 RLS_RainfallLevel 0;
BA_ "GenSigInvalidValue" SG_ 904 RLS_RainfallLevel 0;
BA_ "GenSigSendType" SG_ 904 RLS_RainfallLevel 1;
BA_ "GenSigStartValue" SG_ 904 RLS_RainfallLevel 14;
BA_ "GenSigTimeoutValue" SG_ 904 RLS_RainfallLevel 0;
BA_ "Remark" SG_ 904 RLS_RainfallLevel "";
BA_ "EventCommandSignal" SG_ 904 RLS_RSErr 0;
BA_ "GatewayedSignals" SG_ 904 RLS_RSErr 0;
BA_ "GenSigInactiveValue" SG_ 904 RLS_RSErr 0;
BA_ "GenSigInvalidValue" SG_ 904 RLS_RSErr 0;
BA_ "GenSigSendType" SG_ 904 RLS_RSErr 1;
BA_ "GenSigStartValue" SG_ 904 RLS_RSErr 0;
BA_ "GenSigTimeoutValue" SG_ 904 RLS_RSErr 0;
BA_ "Remark" SG_ 904 RLS_RSErr "";
BA_ "EventCommandSignal" SG_ 904 RLS_LSErr 0;
BA_ "GatewayedSignals" SG_ 904 RLS_LSErr 0;
BA_ "GenSigInactiveValue" SG_ 904 RLS_LSErr 0;
BA_ "GenSigInvalidValue" SG_ 904 RLS_LSErr 0;
BA_ "GenSigSendType" SG_ 904 RLS_LSErr 1;
BA_ "GenSigStartValue" SG_ 904 RLS_LSErr 0;
BA_ "GenSigTimeoutValue" SG_ 904 RLS_LSErr 0;
BA_ "Remark" SG_ 904 RLS_LSErr "";
BA_ "EventCommandSignal" SG_ 904 PM_AUTHPstState 0;
BA_ "GatewayedSignals" SG_ 904 PM_AUTHPstState 0;
BA_ "GenSigInactiveValue" SG_ 904 PM_AUTHPstState 0;
BA_ "GenSigInvalidValue" SG_ 904 PM_AUTHPstState 0;
BA_ "GenSigSendType" SG_ 904 PM_AUTHPstState 1;
BA_ "GenSigStartValue" SG_ 904 PM_AUTHPstState 0;
BA_ "GenSigTimeoutValue" SG_ 904 PM_AUTHPstState 0;
BA_ "Remark" SG_ 904 PM_AUTHPstState "";
BA_ "EventCommandSignal" SG_ 904 CCU_FuncReq_SentryMod 0;
BA_ "GatewayedSignals" SG_ 904 CCU_FuncReq_SentryMod 0;
BA_ "GenSigInactiveValue" SG_ 904 CCU_FuncReq_SentryMod 0;
BA_ "GenSigInvalidValue" SG_ 904 CCU_FuncReq_SentryMod 0;
BA_ "GenSigSendType" SG_ 904 CCU_FuncReq_SentryMod 1;
BA_ "GenSigStartValue" SG_ 904 CCU_FuncReq_SentryMod 0;
BA_ "GenSigTimeoutValue" SG_ 904 CCU_FuncReq_SentryMod 0;
BA_ "Remark" SG_ 904 CCU_FuncReq_SentryMod "";
BA_ "EventCommandSignal" SG_ 904 RLS_WindShieldHum 0;
BA_ "GatewayedSignals" SG_ 904 RLS_WindShieldHum 0;
BA_ "GenSigInactiveValue" SG_ 904 RLS_WindShieldHum 0;
BA_ "GenSigInvalidValue" SG_ 904 RLS_WindShieldHum 0;
BA_ "GenSigSendType" SG_ 904 RLS_WindShieldHum 1;
BA_ "GenSigStartValue" SG_ 904 RLS_WindShieldHum 0;
BA_ "GenSigTimeoutValue" SG_ 904 RLS_WindShieldHum 0;
BA_ "Remark" SG_ 904 RLS_WindShieldHum "";
BA_ "EventCommandSignal" SG_ 904 RLS_WindShieldTem 0;
BA_ "GatewayedSignals" SG_ 904 RLS_WindShieldTem 0;
BA_ "GenSigInactiveValue" SG_ 904 RLS_WindShieldTem 0;
BA_ "GenSigInvalidValue" SG_ 904 RLS_WindShieldTem 0;
BA_ "GenSigSendType" SG_ 904 RLS_WindShieldTem 1;
BA_ "GenSigStartValue" SG_ 904 RLS_WindShieldTem 254;
BA_ "GenSigTimeoutValue" SG_ 904 RLS_WindShieldTem 0;
BA_ "Remark" SG_ 904 RLS_WindShieldTem "";
BA_ "EventCommandSignal" SG_ 904 RLS_DewPoint 0;
BA_ "GatewayedSignals" SG_ 904 RLS_DewPoint 0;
BA_ "GenSigInactiveValue" SG_ 904 RLS_DewPoint 0;
BA_ "GenSigInvalidValue" SG_ 904 RLS_DewPoint 0;
BA_ "GenSigSendType" SG_ 904 RLS_DewPoint 1;
BA_ "GenSigStartValue" SG_ 904 RLS_DewPoint 254;
BA_ "GenSigTimeoutValue" SG_ 904 RLS_DewPoint 0;
BA_ "Remark" SG_ 904 RLS_DewPoint "";
BA_ "EventCommandSignal" SG_ 904 CCU_ModeSuppressSts 0;
BA_ "GatewayedSignals" SG_ 904 CCU_ModeSuppressSts 0;
BA_ "GenSigInactiveValue" SG_ 904 CCU_ModeSuppressSts 0;
BA_ "GenSigInvalidValue" SG_ 904 CCU_ModeSuppressSts 0;
BA_ "GenSigSendType" SG_ 904 CCU_ModeSuppressSts 1;
BA_ "GenSigStartValue" SG_ 904 CCU_ModeSuppressSts 0;
BA_ "GenSigTimeoutValue" SG_ 904 CCU_ModeSuppressSts 0;
BA_ "Remark" SG_ 904 CCU_ModeSuppressSts "";
BA_ "EventCommandSignal" SG_ 904 RLS_HUTErr 0;
BA_ "GatewayedSignals" SG_ 904 RLS_HUTErr 0;
BA_ "GenSigInactiveValue" SG_ 904 RLS_HUTErr 0;
BA_ "GenSigInvalidValue" SG_ 904 RLS_HUTErr 0;
BA_ "GenSigSendType" SG_ 904 RLS_HUTErr 1;
BA_ "GenSigStartValue" SG_ 904 RLS_HUTErr 0;
BA_ "GenSigTimeoutValue" SG_ 904 RLS_HUTErr 0;
BA_ "Remark" SG_ 904 RLS_HUTErr "";
BA_ "EventCommandSignal" SG_ 904 SR_SunroofCurrentPst 0;
BA_ "GatewayedSignals" SG_ 904 SR_SunroofCurrentPst 0;
BA_ "GenSigInactiveValue" SG_ 904 SR_SunroofCurrentPst 0;
BA_ "GenSigInvalidValue" SG_ 904 SR_SunroofCurrentPst 0;
BA_ "GenSigSendType" SG_ 904 SR_SunroofCurrentPst 1;
BA_ "GenSigStartValue" SG_ 904 SR_SunroofCurrentPst 255;
BA_ "GenSigTimeoutValue" SG_ 904 SR_SunroofCurrentPst 0;
BA_ "Remark" SG_ 904 SR_SunroofCurrentPst "";
BA_ "EventCommandSignal" SG_ 904 EL_LeftBSDIndicatorSt 0;
BA_ "GatewayedSignals" SG_ 904 EL_LeftBSDIndicatorSt 0;
BA_ "GenSigInactiveValue" SG_ 904 EL_LeftBSDIndicatorSt 0;
BA_ "GenSigInvalidValue" SG_ 904 EL_LeftBSDIndicatorSt 0;
BA_ "GenSigSendType" SG_ 904 EL_LeftBSDIndicatorSt 1;
BA_ "GenSigStartValue" SG_ 904 EL_LeftBSDIndicatorSt 0;
BA_ "GenSigTimeoutValue" SG_ 904 EL_LeftBSDIndicatorSt 0;
BA_ "Remark" SG_ 904 EL_LeftBSDIndicatorSt "";
BA_ "EventCommandSignal" SG_ 904 UINM_HazardLightSwSt 0;
BA_ "GatewayedSignals" SG_ 904 UINM_HazardLightSwSt 0;
BA_ "GenSigInactiveValue" SG_ 904 UINM_HazardLightSwSt 0;
BA_ "GenSigInvalidValue" SG_ 904 UINM_HazardLightSwSt 0;
BA_ "GenSigSendType" SG_ 904 UINM_HazardLightSwSt 1;
BA_ "GenSigStartValue" SG_ 904 UINM_HazardLightSwSt 0;
BA_ "GenSigTimeoutValue" SG_ 904 UINM_HazardLightSwSt 0;
BA_ "Remark" SG_ 904 UINM_HazardLightSwSt "";
BA_ "EventCommandSignal" SG_ 904 EL_MLTurnLightSt 0;
BA_ "GatewayedSignals" SG_ 904 EL_MLTurnLightSt 0;
BA_ "GenSigInactiveValue" SG_ 904 EL_MLTurnLightSt 0;
BA_ "GenSigInvalidValue" SG_ 904 EL_MLTurnLightSt 0;
BA_ "GenSigSendType" SG_ 904 EL_MLTurnLightSt 1;
BA_ "GenSigStartValue" SG_ 904 EL_MLTurnLightSt 0;
BA_ "GenSigTimeoutValue" SG_ 904 EL_MLTurnLightSt 0;
BA_ "Remark" SG_ 904 EL_MLTurnLightSt "";
BA_ "EventCommandSignal" SG_ 904 EL_MLTurnLightFaultSt 0;
BA_ "GatewayedSignals" SG_ 904 EL_MLTurnLightFaultSt 0;
BA_ "GenSigInactiveValue" SG_ 904 EL_MLTurnLightFaultSt 0;
BA_ "GenSigInvalidValue" SG_ 904 EL_MLTurnLightFaultSt 0;
BA_ "GenSigSendType" SG_ 904 EL_MLTurnLightFaultSt 1;
BA_ "GenSigStartValue" SG_ 904 EL_MLTurnLightFaultSt 0;
BA_ "GenSigTimeoutValue" SG_ 904 EL_MLTurnLightFaultSt 0;
BA_ "Remark" SG_ 904 EL_MLTurnLightFaultSt "";
BA_ "EventCommandSignal" SG_ 904 EL_LeftBSDIndicatorFaultSt 0;
BA_ "GatewayedSignals" SG_ 904 EL_LeftBSDIndicatorFaultSt 0;
BA_ "GenSigInactiveValue" SG_ 904 EL_LeftBSDIndicatorFaultSt 0;
BA_ "GenSigInvalidValue" SG_ 904 EL_LeftBSDIndicatorFaultSt 0;
BA_ "GenSigSendType" SG_ 904 EL_LeftBSDIndicatorFaultSt 1;
BA_ "GenSigStartValue" SG_ 904 EL_LeftBSDIndicatorFaultSt 0;
BA_ "GenSigTimeoutValue" SG_ 904 EL_LeftBSDIndicatorFaultSt 0;
BA_ "Remark" SG_ 904 EL_LeftBSDIndicatorFaultSt "";
BA_ "EventCommandSignal" SG_ 904 ZCUL_FrtWindshildHeatSt 0;
BA_ "GatewayedSignals" SG_ 904 ZCUL_FrtWindshildHeatSt 0;
BA_ "GenSigInactiveValue" SG_ 904 ZCUL_FrtWindshildHeatSt 0;
BA_ "GenSigInvalidValue" SG_ 904 ZCUL_FrtWindshildHeatSt 0;
BA_ "GenSigSendType" SG_ 904 ZCUL_FrtWindshildHeatSt 1;
BA_ "GenSigStartValue" SG_ 904 ZCUL_FrtWindshildHeatSt 0;
BA_ "GenSigTimeoutValue" SG_ 904 ZCUL_FrtWindshildHeatSt 0;
BA_ "Remark" SG_ 904 ZCUL_FrtWindshildHeatSt "";
BA_ "EventCommandSignal" SG_ 904 ACU_PCS_SVM_MODCmd 0;
BA_ "GatewayedSignals" SG_ 904 ACU_PCS_SVM_MODCmd 0;
BA_ "GenSigInactiveValue" SG_ 904 ACU_PCS_SVM_MODCmd 0;
BA_ "GenSigInvalidValue" SG_ 904 ACU_PCS_SVM_MODCmd 0;
BA_ "GenSigSendType" SG_ 904 ACU_PCS_SVM_MODCmd 1;
BA_ "GenSigStartValue" SG_ 904 ACU_PCS_SVM_MODCmd 0;
BA_ "GenSigTimeoutValue" SG_ 904 ACU_PCS_SVM_MODCmd 0;
BA_ "Remark" SG_ 904 ACU_PCS_SVM_MODCmd "";
BA_ "EventCommandSignal" SG_ 904 ACU_HeadLightVirtualSwSt 0;
BA_ "GatewayedSignals" SG_ 904 ACU_HeadLightVirtualSwSt 0;
BA_ "GenSigInactiveValue" SG_ 904 ACU_HeadLightVirtualSwSt 0;
BA_ "GenSigInvalidValue" SG_ 904 ACU_HeadLightVirtualSwSt 0;
BA_ "GenSigSendType" SG_ 904 ACU_HeadLightVirtualSwSt 1;
BA_ "GenSigStartValue" SG_ 904 ACU_HeadLightVirtualSwSt 0;
BA_ "GenSigTimeoutValue" SG_ 904 ACU_HeadLightVirtualSwSt 0;
BA_ "Remark" SG_ 904 ACU_HeadLightVirtualSwSt "";
BA_ "EventCommandSignal" SG_ 904 ACU_FrontFogLightVirtualSwSt 0;
BA_ "GatewayedSignals" SG_ 904 ACU_FrontFogLightVirtualSwSt 0;
BA_ "GenSigInactiveValue" SG_ 904 ACU_FrontFogLightVirtualSwSt 0;
BA_ "GenSigInvalidValue" SG_ 904 ACU_FrontFogLightVirtualSwSt 0;
BA_ "GenSigSendType" SG_ 904 ACU_FrontFogLightVirtualSwSt 1;
BA_ "GenSigStartValue" SG_ 904 ACU_FrontFogLightVirtualSwSt 0;
BA_ "GenSigTimeoutValue" SG_ 904 ACU_FrontFogLightVirtualSwSt 0;
BA_ "Remark" SG_ 904 ACU_FrontFogLightVirtualSwSt "";
BA_ "EventCommandSignal" SG_ 904 ACU_RearFogLightVirtualSwSt 0;
BA_ "GatewayedSignals" SG_ 904 ACU_RearFogLightVirtualSwSt 0;
BA_ "GenSigInactiveValue" SG_ 904 ACU_RearFogLightVirtualSwSt 0;
BA_ "GenSigInvalidValue" SG_ 904 ACU_RearFogLightVirtualSwSt 0;
BA_ "GenSigSendType" SG_ 904 ACU_RearFogLightVirtualSwSt 1;
BA_ "GenSigStartValue" SG_ 904 ACU_RearFogLightVirtualSwSt 0;
BA_ "GenSigTimeoutValue" SG_ 904 ACU_RearFogLightVirtualSwSt 0;
BA_ "Remark" SG_ 904 ACU_RearFogLightVirtualSwSt "";
BA_ "EventCommandSignal" SG_ 904 ACU_Account_Uid 0;
BA_ "GatewayedSignals" SG_ 904 ACU_Account_Uid 0;
BA_ "GenSigInactiveValue" SG_ 904 ACU_Account_Uid 0;
BA_ "GenSigInvalidValue" SG_ 904 ACU_Account_Uid 0;
BA_ "GenSigSendType" SG_ 904 ACU_Account_Uid 1;
BA_ "GenSigStartValue" SG_ 904 ACU_Account_Uid 0;
BA_ "GenSigTimeoutValue" SG_ 904 ACU_Account_Uid 0;
BA_ "Remark" SG_ 904 ACU_Account_Uid "";
BA_ "EventCommandSignal" SG_ 904 ACU_IHBC_SwitchReq 0;
BA_ "GatewayedSignals" SG_ 904 ACU_IHBC_SwitchReq 0;
BA_ "GenSigInactiveValue" SG_ 904 ACU_IHBC_SwitchReq 0;
BA_ "GenSigInvalidValue" SG_ 904 ACU_IHBC_SwitchReq 0;
BA_ "GenSigSendType" SG_ 904 ACU_IHBC_SwitchReq 1;
BA_ "GenSigStartValue" SG_ 904 ACU_IHBC_SwitchReq 0;
BA_ "GenSigTimeoutValue" SG_ 904 ACU_IHBC_SwitchReq 0;
BA_ "Remark" SG_ 904 ACU_IHBC_SwitchReq "";
BA_ "EventCommandSignal" SG_ 904 ACU_NDASwitchReq 0;
BA_ "GatewayedSignals" SG_ 904 ACU_NDASwitchReq 0;
BA_ "GenSigInactiveValue" SG_ 904 ACU_NDASwitchReq 0;
BA_ "GenSigInvalidValue" SG_ 904 ACU_NDASwitchReq 0;
BA_ "GenSigSendType" SG_ 904 ACU_NDASwitchReq 1;
BA_ "GenSigStartValue" SG_ 904 ACU_NDASwitchReq 0;
BA_ "GenSigTimeoutValue" SG_ 904 ACU_NDASwitchReq 0;
BA_ "Remark" SG_ 904 ACU_NDASwitchReq "";
BA_ "EventCommandSignal" SG_ 904 ACU_NDALCConSwitchReq 0;
BA_ "GatewayedSignals" SG_ 904 ACU_NDALCConSwitchReq 0;
BA_ "GenSigInactiveValue" SG_ 904 ACU_NDALCConSwitchReq 0;
BA_ "GenSigInvalidValue" SG_ 904 ACU_NDALCConSwitchReq 0;
BA_ "GenSigSendType" SG_ 904 ACU_NDALCConSwitchReq 1;
BA_ "GenSigStartValue" SG_ 904 ACU_NDALCConSwitchReq 0;
BA_ "GenSigTimeoutValue" SG_ 904 ACU_NDALCConSwitchReq 0;
BA_ "Remark" SG_ 904 ACU_NDALCConSwitchReq "";
BA_ "EventCommandSignal" SG_ 904 ACU_NDALCStySwitchReq 0;
BA_ "GatewayedSignals" SG_ 904 ACU_NDALCStySwitchReq 0;
BA_ "GenSigInactiveValue" SG_ 904 ACU_NDALCStySwitchReq 0;
BA_ "GenSigInvalidValue" SG_ 904 ACU_NDALCStySwitchReq 0;
BA_ "GenSigSendType" SG_ 904 ACU_NDALCStySwitchReq 1;
BA_ "GenSigStartValue" SG_ 904 ACU_NDALCStySwitchReq 0;
BA_ "GenSigTimeoutValue" SG_ 904 ACU_NDALCStySwitchReq 0;
BA_ "Remark" SG_ 904 ACU_NDALCStySwitchReq "";
BA_ "EventCommandSignal" SG_ 904 ACU_ADASWarnTypeSwitch 0;
BA_ "GatewayedSignals" SG_ 904 ACU_ADASWarnTypeSwitch 0;
BA_ "GenSigInactiveValue" SG_ 904 ACU_ADASWarnTypeSwitch 0;
BA_ "GenSigInvalidValue" SG_ 904 ACU_ADASWarnTypeSwitch 0;
BA_ "GenSigSendType" SG_ 904 ACU_ADASWarnTypeSwitch 1;
BA_ "GenSigStartValue" SG_ 904 ACU_ADASWarnTypeSwitch 0;
BA_ "GenSigTimeoutValue" SG_ 904 ACU_ADASWarnTypeSwitch 0;
BA_ "Remark" SG_ 904 ACU_ADASWarnTypeSwitch "";
BA_ "EventCommandSignal" SG_ 904 ACU_iACC_StyleConfirmSwitchReq 0;
BA_ "GatewayedSignals" SG_ 904 ACU_iACC_StyleConfirmSwitchReq 0;
BA_ "GenSigInactiveValue" SG_ 904 ACU_iACC_StyleConfirmSwitchReq 0;
BA_ "GenSigInvalidValue" SG_ 904 ACU_iACC_StyleConfirmSwitchReq 0;
BA_ "GenSigSendType" SG_ 904 ACU_iACC_StyleConfirmSwitchReq 1;
BA_ "GenSigStartValue" SG_ 904 ACU_iACC_StyleConfirmSwitchReq 3;
BA_ "GenSigTimeoutValue" SG_ 904 ACU_iACC_StyleConfirmSwitchReq 0;
BA_ "Remark" SG_ 904 ACU_iACC_StyleConfirmSwitchReq "";
BA_ "EventCommandSignal" SG_ 904 ACU_IFC_SpeedLimit 0;
BA_ "GatewayedSignals" SG_ 904 ACU_IFC_SpeedLimit 0;
BA_ "GenSigInactiveValue" SG_ 904 ACU_IFC_SpeedLimit 0;
BA_ "GenSigInvalidValue" SG_ 904 ACU_IFC_SpeedLimit 0;
BA_ "GenSigSendType" SG_ 904 ACU_IFC_SpeedLimit 1;
BA_ "GenSigStartValue" SG_ 904 ACU_IFC_SpeedLimit 0;
BA_ "GenSigTimeoutValue" SG_ 904 ACU_IFC_SpeedLimit 0;
BA_ "Remark" SG_ 904 ACU_IFC_SpeedLimit "";
BA_ "EventCommandSignal" SG_ 904 ACU_IFC_ISDRestOfdis 0;
BA_ "GatewayedSignals" SG_ 904 ACU_IFC_ISDRestOfdis 0;
BA_ "GenSigInactiveValue" SG_ 904 ACU_IFC_ISDRestOfdis 0;
BA_ "GenSigInvalidValue" SG_ 904 ACU_IFC_ISDRestOfdis 0;
BA_ "GenSigSendType" SG_ 904 ACU_IFC_ISDRestOfdis 1;
BA_ "GenSigStartValue" SG_ 904 ACU_IFC_ISDRestOfdis 0;
BA_ "GenSigTimeoutValue" SG_ 904 ACU_IFC_ISDRestOfdis 0;
BA_ "Remark" SG_ 904 ACU_IFC_ISDRestOfdis "";
BA_ "EventCommandSignal" SG_ 904 ACU_IFC_SpeedLimitUnit 0;
BA_ "GatewayedSignals" SG_ 904 ACU_IFC_SpeedLimitUnit 0;
BA_ "GenSigInactiveValue" SG_ 904 ACU_IFC_SpeedLimitUnit 0;
BA_ "GenSigInvalidValue" SG_ 904 ACU_IFC_SpeedLimitUnit 0;
BA_ "GenSigSendType" SG_ 904 ACU_IFC_SpeedLimitUnit 1;
BA_ "GenSigStartValue" SG_ 904 ACU_IFC_SpeedLimitUnit 0;
BA_ "GenSigTimeoutValue" SG_ 904 ACU_IFC_SpeedLimitUnit 1;
BA_ "Remark" SG_ 904 ACU_IFC_SpeedLimitUnit "";
BA_ "EventCommandSignal" SG_ 904 ACU_ThemeType 0;
BA_ "GatewayedSignals" SG_ 904 ACU_ThemeType 0;
BA_ "GenSigInactiveValue" SG_ 904 ACU_ThemeType 0;
BA_ "GenSigInvalidValue" SG_ 904 ACU_ThemeType 0;
BA_ "GenSigSendType" SG_ 904 ACU_ThemeType 1;
BA_ "GenSigStartValue" SG_ 904 ACU_ThemeType 0;
BA_ "GenSigTimeoutValue" SG_ 904 ACU_ThemeType 0;
BA_ "Remark" SG_ 904 ACU_ThemeType "";
BA_ "EventCommandSignal" SG_ 904 ACU_IFC_SpeedLimtType 0;
BA_ "GatewayedSignals" SG_ 904 ACU_IFC_SpeedLimtType 0;
BA_ "GenSigInactiveValue" SG_ 904 ACU_IFC_SpeedLimtType 0;
BA_ "GenSigInvalidValue" SG_ 904 ACU_IFC_SpeedLimtType 0;
BA_ "GenSigSendType" SG_ 904 ACU_IFC_SpeedLimtType 1;
BA_ "GenSigStartValue" SG_ 904 ACU_IFC_SpeedLimtType 0;
BA_ "GenSigTimeoutValue" SG_ 904 ACU_IFC_SpeedLimtType 0;
BA_ "Remark" SG_ 904 ACU_IFC_SpeedLimtType "";
BA_ "EventCommandSignal" SG_ 904 ACU_IFC_RoadType 0;
BA_ "GatewayedSignals" SG_ 904 ACU_IFC_RoadType 0;
BA_ "GenSigInactiveValue" SG_ 904 ACU_IFC_RoadType 0;
BA_ "GenSigInvalidValue" SG_ 904 ACU_IFC_RoadType 0;
BA_ "GenSigSendType" SG_ 904 ACU_IFC_RoadType 1;
BA_ "GenSigStartValue" SG_ 904 ACU_IFC_RoadType 0;
BA_ "GenSigTimeoutValue" SG_ 904 ACU_IFC_RoadType 0;
BA_ "Remark" SG_ 904 ACU_IFC_RoadType "";
BA_ "EventCommandSignal" SG_ 904 ACU_IFC_ZoneCode 0;
BA_ "GatewayedSignals" SG_ 904 ACU_IFC_ZoneCode 0;
BA_ "GenSigInactiveValue" SG_ 904 ACU_IFC_ZoneCode 0;
BA_ "GenSigInvalidValue" SG_ 904 ACU_IFC_ZoneCode 0;
BA_ "GenSigSendType" SG_ 904 ACU_IFC_ZoneCode 1;
BA_ "GenSigStartValue" SG_ 904 ACU_IFC_ZoneCode 0;
BA_ "GenSigTimeoutValue" SG_ 904 ACU_IFC_ZoneCode 1;
BA_ "Remark" SG_ 904 ACU_IFC_ZoneCode "";
BA_ "EventCommandSignal" SG_ 904 ACU_IFC_NaviSt 0;
BA_ "GatewayedSignals" SG_ 904 ACU_IFC_NaviSt 0;
BA_ "GenSigInactiveValue" SG_ 904 ACU_IFC_NaviSt 0;
BA_ "GenSigInvalidValue" SG_ 904 ACU_IFC_NaviSt 0;
BA_ "GenSigSendType" SG_ 904 ACU_IFC_NaviSt 1;
BA_ "GenSigStartValue" SG_ 904 ACU_IFC_NaviSt 0;
BA_ "GenSigTimeoutValue" SG_ 904 ACU_IFC_NaviSt 0;
BA_ "Remark" SG_ 904 ACU_IFC_NaviSt "";
BA_ "EventCommandSignal" SG_ 904 ACU_IFC_NaviCorp 0;
BA_ "GatewayedSignals" SG_ 904 ACU_IFC_NaviCorp 0;
BA_ "GenSigInactiveValue" SG_ 904 ACU_IFC_NaviCorp 0;
BA_ "GenSigInvalidValue" SG_ 904 ACU_IFC_NaviCorp 0;
BA_ "GenSigSendType" SG_ 904 ACU_IFC_NaviCorp 1;
BA_ "GenSigStartValue" SG_ 904 ACU_IFC_NaviCorp 0;
BA_ "GenSigTimeoutValue" SG_ 904 ACU_IFC_NaviCorp 0;
BA_ "Remark" SG_ 904 ACU_IFC_NaviCorp "";
BA_ "EventCommandSignal" SG_ 904 ACU_IFC_NaviNewIconDis 0;
BA_ "GatewayedSignals" SG_ 904 ACU_IFC_NaviNewIconDis 0;
BA_ "GenSigInactiveValue" SG_ 904 ACU_IFC_NaviNewIconDis 0;
BA_ "GenSigInvalidValue" SG_ 904 ACU_IFC_NaviNewIconDis 0;
BA_ "GenSigSendType" SG_ 904 ACU_IFC_NaviNewIconDis 1;
BA_ "GenSigStartValue" SG_ 904 ACU_IFC_NaviNewIconDis 0;
BA_ "GenSigTimeoutValue" SG_ 904 ACU_IFC_NaviNewIconDis 0;
BA_ "Remark" SG_ 904 ACU_IFC_NaviNewIconDis "";
BA_ "EventCommandSignal" SG_ 904 ACU_IFC_OfframpSt 0;
BA_ "GatewayedSignals" SG_ 904 ACU_IFC_OfframpSt 0;
BA_ "GenSigInactiveValue" SG_ 904 ACU_IFC_OfframpSt 0;
BA_ "GenSigInvalidValue" SG_ 904 ACU_IFC_OfframpSt 0;
BA_ "GenSigSendType" SG_ 904 ACU_IFC_OfframpSt 1;
BA_ "GenSigStartValue" SG_ 904 ACU_IFC_OfframpSt 0;
BA_ "GenSigTimeoutValue" SG_ 904 ACU_IFC_OfframpSt 0;
BA_ "Remark" SG_ 904 ACU_IFC_OfframpSt "";
BA_ "EventCommandSignal" SG_ 904 ACU_IFC_NaviNewIcon 0;
BA_ "GatewayedSignals" SG_ 904 ACU_IFC_NaviNewIcon 0;
BA_ "GenSigInactiveValue" SG_ 904 ACU_IFC_NaviNewIcon 0;
BA_ "GenSigInvalidValue" SG_ 904 ACU_IFC_NaviNewIcon 0;
BA_ "GenSigSendType" SG_ 904 ACU_IFC_NaviNewIcon 1;
BA_ "GenSigStartValue" SG_ 904 ACU_IFC_NaviNewIcon 0;
BA_ "GenSigTimeoutValue" SG_ 904 ACU_IFC_NaviNewIcon 0;
BA_ "Remark" SG_ 904 ACU_IFC_NaviNewIcon "";
BA_ "EventCommandSignal" SG_ 904 ACU_IFC_SLCAheadDis 0;
BA_ "GatewayedSignals" SG_ 904 ACU_IFC_SLCAheadDis 0;
BA_ "GenSigInactiveValue" SG_ 904 ACU_IFC_SLCAheadDis 0;
BA_ "GenSigInvalidValue" SG_ 904 ACU_IFC_SLCAheadDis 0;
BA_ "GenSigSendType" SG_ 904 ACU_IFC_SLCAheadDis 1;
BA_ "GenSigStartValue" SG_ 904 ACU_IFC_SLCAheadDis 0;
BA_ "GenSigTimeoutValue" SG_ 904 ACU_IFC_SLCAheadDis 0;
BA_ "Remark" SG_ 904 ACU_IFC_SLCAheadDis "";
BA_ "EventCommandSignal" SG_ 904 ACU_DVR_Switch 0;
BA_ "GatewayedSignals" SG_ 904 ACU_DVR_Switch 0;
BA_ "GenSigInactiveValue" SG_ 904 ACU_DVR_Switch 0;
BA_ "GenSigInvalidValue" SG_ 904 ACU_DVR_Switch 0;
BA_ "GenSigSendType" SG_ 904 ACU_DVR_Switch 1;
BA_ "GenSigStartValue" SG_ 904 ACU_DVR_Switch 0;
BA_ "GenSigTimeoutValue" SG_ 904 ACU_DVR_Switch 0;
BA_ "Remark" SG_ 904 ACU_DVR_Switch "";
BA_ "EventCommandSignal" SG_ 904 ACU_IFC_OfframpDis 0;
BA_ "GatewayedSignals" SG_ 904 ACU_IFC_OfframpDis 0;
BA_ "GenSigInactiveValue" SG_ 904 ACU_IFC_OfframpDis 0;
BA_ "GenSigInvalidValue" SG_ 904 ACU_IFC_OfframpDis 0;
BA_ "GenSigSendType" SG_ 904 ACU_IFC_OfframpDis 1;
BA_ "GenSigStartValue" SG_ 904 ACU_IFC_OfframpDis 254;
BA_ "GenSigTimeoutValue" SG_ 904 ACU_IFC_OfframpDis 254;
BA_ "Remark" SG_ 904 ACU_IFC_OfframpDis "";
BA_ "EventCommandSignal" SG_ 904 SSW_FLSeatSlideCurrentPst 0;
BA_ "GatewayedSignals" SG_ 904 SSW_FLSeatSlideCurrentPst 0;
BA_ "GenSigInactiveValue" SG_ 904 SSW_FLSeatSlideCurrentPst 0;
BA_ "GenSigInvalidValue" SG_ 904 SSW_FLSeatSlideCurrentPst 0;
BA_ "GenSigSendType" SG_ 904 SSW_FLSeatSlideCurrentPst 1;
BA_ "GenSigStartValue" SG_ 904 SSW_FLSeatSlideCurrentPst 255;
BA_ "GenSigTimeoutValue" SG_ 904 SSW_FLSeatSlideCurrentPst 0;
BA_ "Remark" SG_ 904 SSW_FLSeatSlideCurrentPst "";
BA_ "EventCommandSignal" SG_ 904 SSW_FLSeatHeightCurrentPst 0;
BA_ "GatewayedSignals" SG_ 904 SSW_FLSeatHeightCurrentPst 0;
BA_ "GenSigInactiveValue" SG_ 904 SSW_FLSeatHeightCurrentPst 0;
BA_ "GenSigInvalidValue" SG_ 904 SSW_FLSeatHeightCurrentPst 0;
BA_ "GenSigSendType" SG_ 904 SSW_FLSeatHeightCurrentPst 1;
BA_ "GenSigStartValue" SG_ 904 SSW_FLSeatHeightCurrentPst 255;
BA_ "GenSigTimeoutValue" SG_ 904 SSW_FLSeatHeightCurrentPst 0;
BA_ "Remark" SG_ 904 SSW_FLSeatHeightCurrentPst "";
BA_ "EventCommandSignal" SG_ 904 SSW_FLSeatBackrestCurrentPst 0;
BA_ "GatewayedSignals" SG_ 904 SSW_FLSeatBackrestCurrentPst 0;
BA_ "GenSigInactiveValue" SG_ 904 SSW_FLSeatBackrestCurrentPst 0;
BA_ "GenSigInvalidValue" SG_ 904 SSW_FLSeatBackrestCurrentPst 0;
BA_ "GenSigSendType" SG_ 904 SSW_FLSeatBackrestCurrentPst 1;
BA_ "GenSigStartValue" SG_ 904 SSW_FLSeatBackrestCurrentPst 255;
BA_ "GenSigTimeoutValue" SG_ 904 SSW_FLSeatBackrestCurrentPst 0;
BA_ "Remark" SG_ 904 SSW_FLSeatBackrestCurrentPst "";
BA_ "EventCommandSignal" SG_ 904 DrvrSideMotResp 0;
BA_ "GatewayedSignals" SG_ 904 DrvrSideMotResp 0;
BA_ "GenSigInactiveValue" SG_ 904 DrvrSideMotResp 0;
BA_ "GenSigInvalidValue" SG_ 904 DrvrSideMotResp 0;
BA_ "GenSigSendType" SG_ 904 DrvrSideMotResp 1;
BA_ "GenSigStartValue" SG_ 904 DrvrSideMotResp 0;
BA_ "GenSigTimeoutValue" SG_ 904 DrvrSideMotResp 15;
BA_ "Remark" SG_ 904 DrvrSideMotResp "";
BA_ "EventCommandSignal" SG_ 904 EL_LeftLowBeamSt 0;
BA_ "GatewayedSignals" SG_ 904 EL_LeftLowBeamSt 0;
BA_ "GenSigInactiveValue" SG_ 904 EL_LeftLowBeamSt 0;
BA_ "GenSigInvalidValue" SG_ 904 EL_LeftLowBeamSt 0;
BA_ "GenSigSendType" SG_ 904 EL_LeftLowBeamSt 1;
BA_ "GenSigStartValue" SG_ 904 EL_LeftLowBeamSt 0;
BA_ "GenSigTimeoutValue" SG_ 904 EL_LeftLowBeamSt 0;
BA_ "Remark" SG_ 904 EL_LeftLowBeamSt "";
BA_ "EventCommandSignal" SG_ 904 EL_LeftLowBeamFaultSt 0;
BA_ "GatewayedSignals" SG_ 904 EL_LeftLowBeamFaultSt 0;
BA_ "GenSigInactiveValue" SG_ 904 EL_LeftLowBeamFaultSt 0;
BA_ "GenSigInvalidValue" SG_ 904 EL_LeftLowBeamFaultSt 0;
BA_ "GenSigSendType" SG_ 904 EL_LeftLowBeamFaultSt 1;
BA_ "GenSigStartValue" SG_ 904 EL_LeftLowBeamFaultSt 0;
BA_ "GenSigTimeoutValue" SG_ 904 EL_LeftLowBeamFaultSt 0;
BA_ "Remark" SG_ 904 EL_LeftLowBeamFaultSt "";
BA_ "EventCommandSignal" SG_ 904 EL_RightLowBeamSt 0;
BA_ "GatewayedSignals" SG_ 904 EL_RightLowBeamSt 0;
BA_ "GenSigInactiveValue" SG_ 904 EL_RightLowBeamSt 0;
BA_ "GenSigInvalidValue" SG_ 904 EL_RightLowBeamSt 0;
BA_ "GenSigSendType" SG_ 904 EL_RightLowBeamSt 1;
BA_ "GenSigStartValue" SG_ 904 EL_RightLowBeamSt 0;
BA_ "GenSigTimeoutValue" SG_ 904 EL_RightLowBeamSt 0;
BA_ "Remark" SG_ 904 EL_RightLowBeamSt "";
BA_ "EventCommandSignal" SG_ 904 EL_RightLowBeamFaultSt 0;
BA_ "GatewayedSignals" SG_ 904 EL_RightLowBeamFaultSt 0;
BA_ "GenSigInactiveValue" SG_ 904 EL_RightLowBeamFaultSt 0;
BA_ "GenSigInvalidValue" SG_ 904 EL_RightLowBeamFaultSt 0;
BA_ "GenSigSendType" SG_ 904 EL_RightLowBeamFaultSt 1;
BA_ "GenSigStartValue" SG_ 904 EL_RightLowBeamFaultSt 0;
BA_ "GenSigTimeoutValue" SG_ 904 EL_RightLowBeamFaultSt 0;
BA_ "Remark" SG_ 904 EL_RightLowBeamFaultSt "";
BA_ "EventCommandSignal" SG_ 904 WW_FWPMotorSt 0;
BA_ "GatewayedSignals" SG_ 904 WW_FWPMotorSt 0;
BA_ "GenSigInactiveValue" SG_ 904 WW_FWPMotorSt 0;
BA_ "GenSigInvalidValue" SG_ 904 WW_FWPMotorSt 0;
BA_ "GenSigSendType" SG_ 904 WW_FWPMotorSt 1;
BA_ "GenSigStartValue" SG_ 904 WW_FWPMotorSt 0;
BA_ "GenSigTimeoutValue" SG_ 904 WW_FWPMotorSt 0;
BA_ "Remark" SG_ 904 WW_FWPMotorSt "";
BA_ "EventCommandSignal" SG_ 904 EL_MLADASLightSt 0;
BA_ "GatewayedSignals" SG_ 904 EL_MLADASLightSt 0;
BA_ "GenSigInactiveValue" SG_ 904 EL_MLADASLightSt 0;
BA_ "GenSigInvalidValue" SG_ 904 EL_MLADASLightSt 0;
BA_ "GenSigSendType" SG_ 904 EL_MLADASLightSt 1;
BA_ "GenSigStartValue" SG_ 904 EL_MLADASLightSt 0;
BA_ "GenSigTimeoutValue" SG_ 904 EL_MLADASLightSt 0;
BA_ "Remark" SG_ 904 EL_MLADASLightSt "";
BA_ "EventCommandSignal" SG_ 904 EL_FLTurnLightSt 0;
BA_ "GatewayedSignals" SG_ 904 EL_FLTurnLightSt 0;
BA_ "GenSigInactiveValue" SG_ 904 EL_FLTurnLightSt 0;
BA_ "GenSigInvalidValue" SG_ 904 EL_FLTurnLightSt 0;
BA_ "GenSigSendType" SG_ 904 EL_FLTurnLightSt 1;
BA_ "GenSigStartValue" SG_ 904 EL_FLTurnLightSt 0;
BA_ "GenSigTimeoutValue" SG_ 904 EL_FLTurnLightSt 0;
BA_ "Remark" SG_ 904 EL_FLTurnLightSt "";
BA_ "EventCommandSignal" SG_ 904 EL_FLTurnLightFaultSt 0;
BA_ "GatewayedSignals" SG_ 904 EL_FLTurnLightFaultSt 0;
BA_ "GenSigInactiveValue" SG_ 904 EL_FLTurnLightFaultSt 0;
BA_ "GenSigInvalidValue" SG_ 904 EL_FLTurnLightFaultSt 0;
BA_ "GenSigSendType" SG_ 904 EL_FLTurnLightFaultSt 1;
BA_ "GenSigStartValue" SG_ 904 EL_FLTurnLightFaultSt 0;
BA_ "GenSigTimeoutValue" SG_ 904 EL_FLTurnLightFaultSt 0;
BA_ "Remark" SG_ 904 EL_FLTurnLightFaultSt "";
BA_ "EventCommandSignal" SG_ 904 EL_FRTurnLightSt 0;
BA_ "GatewayedSignals" SG_ 904 EL_FRTurnLightSt 0;
BA_ "GenSigInactiveValue" SG_ 904 EL_FRTurnLightSt 0;
BA_ "GenSigInvalidValue" SG_ 904 EL_FRTurnLightSt 0;
BA_ "GenSigSendType" SG_ 904 EL_FRTurnLightSt 1;
BA_ "GenSigStartValue" SG_ 904 EL_FRTurnLightSt 0;
BA_ "GenSigTimeoutValue" SG_ 904 EL_FRTurnLightSt 0;
BA_ "Remark" SG_ 904 EL_FRTurnLightSt "";
BA_ "EventCommandSignal" SG_ 904 EL_FRTurnLightFaultSt 0;
BA_ "GatewayedSignals" SG_ 904 EL_FRTurnLightFaultSt 0;
BA_ "GenSigInactiveValue" SG_ 904 EL_FRTurnLightFaultSt 0;
BA_ "GenSigInvalidValue" SG_ 904 EL_FRTurnLightFaultSt 0;
BA_ "GenSigSendType" SG_ 904 EL_FRTurnLightFaultSt 1;
BA_ "GenSigStartValue" SG_ 904 EL_FRTurnLightFaultSt 0;
BA_ "GenSigTimeoutValue" SG_ 904 EL_FRTurnLightFaultSt 0;
BA_ "Remark" SG_ 904 EL_FRTurnLightFaultSt "";
BA_ "EventCommandSignal" SG_ 904 EL_SideBrkLightSt 0;
BA_ "GatewayedSignals" SG_ 904 EL_SideBrkLightSt 0;
BA_ "GenSigInactiveValue" SG_ 904 EL_SideBrkLightSt 0;
BA_ "GenSigInvalidValue" SG_ 904 EL_SideBrkLightSt 0;
BA_ "GenSigSendType" SG_ 904 EL_SideBrkLightSt 1;
BA_ "GenSigStartValue" SG_ 904 EL_SideBrkLightSt 0;
BA_ "GenSigTimeoutValue" SG_ 904 EL_SideBrkLightSt 0;
BA_ "Remark" SG_ 904 EL_SideBrkLightSt "";
BA_ "EventCommandSignal" SG_ 904 EL_SideBrkLightFaultSt 0;
BA_ "GatewayedSignals" SG_ 904 EL_SideBrkLightFaultSt 0;
BA_ "GenSigInactiveValue" SG_ 904 EL_SideBrkLightFaultSt 0;
BA_ "GenSigInvalidValue" SG_ 904 EL_SideBrkLightFaultSt 0;
BA_ "GenSigSendType" SG_ 904 EL_SideBrkLightFaultSt 1;
BA_ "GenSigStartValue" SG_ 904 EL_SideBrkLightFaultSt 0;
BA_ "GenSigTimeoutValue" SG_ 904 EL_SideBrkLightFaultSt 0;
BA_ "Remark" SG_ 904 EL_SideBrkLightFaultSt "";
BA_ "EventCommandSignal" SG_ 904 EL_CHMSLSt 0;
BA_ "GatewayedSignals" SG_ 904 EL_CHMSLSt 0;
BA_ "GenSigInactiveValue" SG_ 904 EL_CHMSLSt 0;
BA_ "GenSigInvalidValue" SG_ 904 EL_CHMSLSt 0;
BA_ "GenSigSendType" SG_ 904 EL_CHMSLSt 1;
BA_ "GenSigStartValue" SG_ 904 EL_CHMSLSt 0;
BA_ "GenSigTimeoutValue" SG_ 904 EL_CHMSLSt 0;
BA_ "Remark" SG_ 904 EL_CHMSLSt "";
BA_ "EventCommandSignal" SG_ 904 EL_CHMSLFaultSt 0;
BA_ "GatewayedSignals" SG_ 904 EL_CHMSLFaultSt 0;
BA_ "GenSigInactiveValue" SG_ 904 EL_CHMSLFaultSt 0;
BA_ "GenSigInvalidValue" SG_ 904 EL_CHMSLFaultSt 0;
BA_ "GenSigSendType" SG_ 904 EL_CHMSLFaultSt 1;
BA_ "GenSigStartValue" SG_ 904 EL_CHMSLFaultSt 0;
BA_ "GenSigTimeoutValue" SG_ 904 EL_CHMSLFaultSt 0;
BA_ "Remark" SG_ 904 EL_CHMSLFaultSt "";
BA_ "EventCommandSignal" SG_ 904 EL_RLTurnLightSt 0;
BA_ "GatewayedSignals" SG_ 904 EL_RLTurnLightSt 0;
BA_ "GenSigInactiveValue" SG_ 904 EL_RLTurnLightSt 0;
BA_ "GenSigInvalidValue" SG_ 904 EL_RLTurnLightSt 0;
BA_ "GenSigSendType" SG_ 904 EL_RLTurnLightSt 1;
BA_ "GenSigStartValue" SG_ 904 EL_RLTurnLightSt 0;
BA_ "GenSigTimeoutValue" SG_ 904 EL_RLTurnLightSt 0;
BA_ "Remark" SG_ 904 EL_RLTurnLightSt "";
BA_ "EventCommandSignal" SG_ 904 EL_RLTurnLightFaultSt 0;
BA_ "GatewayedSignals" SG_ 904 EL_RLTurnLightFaultSt 0;
BA_ "GenSigInactiveValue" SG_ 904 EL_RLTurnLightFaultSt 0;
BA_ "GenSigInvalidValue" SG_ 904 EL_RLTurnLightFaultSt 0;
BA_ "GenSigSendType" SG_ 904 EL_RLTurnLightFaultSt 1;
BA_ "GenSigStartValue" SG_ 904 EL_RLTurnLightFaultSt 0;
BA_ "GenSigTimeoutValue" SG_ 904 EL_RLTurnLightFaultSt 0;
BA_ "Remark" SG_ 904 EL_RLTurnLightFaultSt "";
BA_ "EventCommandSignal" SG_ 904 EL_RRTurnLightSt 0;
BA_ "GatewayedSignals" SG_ 904 EL_RRTurnLightSt 0;
BA_ "GenSigInactiveValue" SG_ 904 EL_RRTurnLightSt 0;
BA_ "GenSigInvalidValue" SG_ 904 EL_RRTurnLightSt 0;
BA_ "GenSigSendType" SG_ 904 EL_RRTurnLightSt 1;
BA_ "GenSigStartValue" SG_ 904 EL_RRTurnLightSt 0;
BA_ "GenSigTimeoutValue" SG_ 904 EL_RRTurnLightSt 0;
BA_ "Remark" SG_ 904 EL_RRTurnLightSt "";
BA_ "EventCommandSignal" SG_ 904 EL_RRTurnLightFaultSt 0;
BA_ "GatewayedSignals" SG_ 904 EL_RRTurnLightFaultSt 0;
BA_ "GenSigInactiveValue" SG_ 904 EL_RRTurnLightFaultSt 0;
BA_ "GenSigInvalidValue" SG_ 904 EL_RRTurnLightFaultSt 0;
BA_ "GenSigSendType" SG_ 904 EL_RRTurnLightFaultSt 1;
BA_ "GenSigStartValue" SG_ 904 EL_RRTurnLightFaultSt 0;
BA_ "GenSigTimeoutValue" SG_ 904 EL_RRTurnLightFaultSt 0;
BA_ "Remark" SG_ 904 EL_RRTurnLightFaultSt "";
BA_ "EventCommandSignal" SG_ 904 IPDS_BAT1PowerSt 0;
BA_ "GatewayedSignals" SG_ 904 IPDS_BAT1PowerSt 0;
BA_ "GenSigInactiveValue" SG_ 904 IPDS_BAT1PowerSt 0;
BA_ "GenSigInvalidValue" SG_ 904 IPDS_BAT1PowerSt 0;
BA_ "GenSigSendType" SG_ 904 IPDS_BAT1PowerSt 1;
BA_ "GenSigStartValue" SG_ 904 IPDS_BAT1PowerSt 1;
BA_ "GenSigTimeoutValue" SG_ 904 IPDS_BAT1PowerSt 0;
BA_ "Remark" SG_ 904 IPDS_BAT1PowerSt "";
BA_ "EventCommandSignal" SG_ 904 IPDS_BAT2PowerSt 0;
BA_ "GatewayedSignals" SG_ 904 IPDS_BAT2PowerSt 0;
BA_ "GenSigInactiveValue" SG_ 904 IPDS_BAT2PowerSt 0;
BA_ "GenSigInvalidValue" SG_ 904 IPDS_BAT2PowerSt 0;
BA_ "GenSigSendType" SG_ 904 IPDS_BAT2PowerSt 1;
BA_ "GenSigStartValue" SG_ 904 IPDS_BAT2PowerSt 1;
BA_ "GenSigTimeoutValue" SG_ 904 IPDS_BAT2PowerSt 0;
BA_ "Remark" SG_ 904 IPDS_BAT2PowerSt "";
BA_ "EventCommandSignal" SG_ 904 IPDS_DCDC2PowerSt 0;
BA_ "GatewayedSignals" SG_ 904 IPDS_DCDC2PowerSt 0;
BA_ "GenSigInactiveValue" SG_ 904 IPDS_DCDC2PowerSt 0;
BA_ "GenSigInvalidValue" SG_ 904 IPDS_DCDC2PowerSt 0;
BA_ "GenSigSendType" SG_ 904 IPDS_DCDC2PowerSt 1;
BA_ "GenSigStartValue" SG_ 904 IPDS_DCDC2PowerSt 1;
BA_ "GenSigTimeoutValue" SG_ 904 IPDS_DCDC2PowerSt 0;
BA_ "Remark" SG_ 904 IPDS_DCDC2PowerSt "";
BA_ "EventCommandSignal" SG_ 904 IPDS_GridIsoPowerSt 0;
BA_ "GatewayedSignals" SG_ 904 IPDS_GridIsoPowerSt 0;
BA_ "GenSigInactiveValue" SG_ 904 IPDS_GridIsoPowerSt 0;
BA_ "GenSigInvalidValue" SG_ 904 IPDS_GridIsoPowerSt 0;
BA_ "GenSigSendType" SG_ 904 IPDS_GridIsoPowerSt 1;
BA_ "GenSigStartValue" SG_ 904 IPDS_GridIsoPowerSt 1;
BA_ "GenSigTimeoutValue" SG_ 904 IPDS_GridIsoPowerSt 1;
BA_ "Remark" SG_ 904 IPDS_GridIsoPowerSt "";
BA_ "EventCommandSignal" SG_ 904 IPS_DCDCModeSt 0;
BA_ "GatewayedSignals" SG_ 904 IPS_DCDCModeSt 0;
BA_ "GenSigInactiveValue" SG_ 904 IPS_DCDCModeSt 0;
BA_ "GenSigInvalidValue" SG_ 904 IPS_DCDCModeSt 0;
BA_ "GenSigSendType" SG_ 904 IPS_DCDCModeSt 1;
BA_ "GenSigStartValue" SG_ 904 IPS_DCDCModeSt 0;
BA_ "GenSigTimeoutValue" SG_ 904 IPS_DCDCModeSt 0;
BA_ "Remark" SG_ 904 IPS_DCDCModeSt "";
BA_ "EventCommandSignal" SG_ 904 IPDS_FRRadarPowerSup 0;
BA_ "GatewayedSignals" SG_ 904 IPDS_FRRadarPowerSup 0;
BA_ "GenSigInactiveValue" SG_ 904 IPDS_FRRadarPowerSup 0;
BA_ "GenSigInvalidValue" SG_ 904 IPDS_FRRadarPowerSup 0;
BA_ "GenSigSendType" SG_ 904 IPDS_FRRadarPowerSup 1;
BA_ "GenSigStartValue" SG_ 904 IPDS_FRRadarPowerSup 3;
BA_ "GenSigTimeoutValue" SG_ 904 IPDS_FRRadarPowerSup 0;
BA_ "Remark" SG_ 904 IPDS_FRRadarPowerSup "";
BA_ "EventCommandSignal" SG_ 904 LBMS_SOFVD 0;
BA_ "GatewayedSignals" SG_ 904 LBMS_SOFVD 0;
BA_ "GenSigInactiveValue" SG_ 904 LBMS_SOFVD 0;
BA_ "GenSigInvalidValue" SG_ 904 LBMS_SOFVD 0;
BA_ "GenSigSendType" SG_ 904 LBMS_SOFVD 1;
BA_ "GenSigStartValue" SG_ 904 LBMS_SOFVD 0;
BA_ "GenSigTimeoutValue" SG_ 904 LBMS_SOFVD 0;
BA_ "Remark" SG_ 904 LBMS_SOFVD "";
BA_ "EventCommandSignal" SG_ 904 LBMS_SOFEN 0;
BA_ "GatewayedSignals" SG_ 904 LBMS_SOFEN 0;
BA_ "GenSigInactiveValue" SG_ 904 LBMS_SOFEN 0;
BA_ "GenSigInvalidValue" SG_ 904 LBMS_SOFEN 0;
BA_ "GenSigSendType" SG_ 904 LBMS_SOFEN 1;
BA_ "GenSigStartValue" SG_ 904 LBMS_SOFEN 0;
BA_ "GenSigTimeoutValue" SG_ 904 LBMS_SOFEN 0;
BA_ "Remark" SG_ 904 LBMS_SOFEN "";
BA_ "EventCommandSignal" SG_ 904 LBMSAD_SOFVD 0;
BA_ "GatewayedSignals" SG_ 904 LBMSAD_SOFVD 0;
BA_ "GenSigInactiveValue" SG_ 904 LBMSAD_SOFVD 0;
BA_ "GenSigInvalidValue" SG_ 904 LBMSAD_SOFVD 0;
BA_ "GenSigSendType" SG_ 904 LBMSAD_SOFVD 1;
BA_ "GenSigStartValue" SG_ 904 LBMSAD_SOFVD 0;
BA_ "GenSigTimeoutValue" SG_ 904 LBMSAD_SOFVD 0;
BA_ "Remark" SG_ 904 LBMSAD_SOFVD "";
BA_ "EventCommandSignal" SG_ 904 LBMSAD_SOFEN 0;
BA_ "GatewayedSignals" SG_ 904 LBMSAD_SOFEN 0;
BA_ "GenSigInactiveValue" SG_ 904 LBMSAD_SOFEN 0;
BA_ "GenSigInvalidValue" SG_ 904 LBMSAD_SOFEN 0;
BA_ "GenSigSendType" SG_ 904 LBMSAD_SOFEN 1;
BA_ "GenSigStartValue" SG_ 904 LBMSAD_SOFEN 0;
BA_ "GenSigTimeoutValue" SG_ 904 LBMSAD_SOFEN 0;
BA_ "Remark" SG_ 904 LBMSAD_SOFEN "";
BA_ "EventCommandSignal" SG_ 904 IPDS_FLRadarPowerSup 0;
BA_ "GatewayedSignals" SG_ 904 IPDS_FLRadarPowerSup 0;
BA_ "GenSigInactiveValue" SG_ 904 IPDS_FLRadarPowerSup 0;
BA_ "GenSigInvalidValue" SG_ 904 IPDS_FLRadarPowerSup 0;
BA_ "GenSigSendType" SG_ 904 IPDS_FLRadarPowerSup 1;
BA_ "GenSigStartValue" SG_ 904 IPDS_FLRadarPowerSup 3;
BA_ "GenSigTimeoutValue" SG_ 904 IPDS_FLRadarPowerSup 0;
BA_ "Remark" SG_ 904 IPDS_FLRadarPowerSup "";
BA_ "EventCommandSignal" SG_ 904 IPDS_FrontRadarPowerSup 0;
BA_ "GatewayedSignals" SG_ 904 IPDS_FrontRadarPowerSup 0;
BA_ "GenSigInactiveValue" SG_ 904 IPDS_FrontRadarPowerSup 0;
BA_ "GenSigInvalidValue" SG_ 904 IPDS_FrontRadarPowerSup 0;
BA_ "GenSigSendType" SG_ 904 IPDS_FrontRadarPowerSup 1;
BA_ "GenSigStartValue" SG_ 904 IPDS_FrontRadarPowerSup 3;
BA_ "GenSigTimeoutValue" SG_ 904 IPDS_FrontRadarPowerSup 0;
BA_ "Remark" SG_ 904 IPDS_FrontRadarPowerSup "";
BA_ "EventCommandSignal" SG_ 904 IPDS_HDMapPowerSup 0;
BA_ "GatewayedSignals" SG_ 904 IPDS_HDMapPowerSup 0;
BA_ "GenSigInactiveValue" SG_ 904 IPDS_HDMapPowerSup 0;
BA_ "GenSigInvalidValue" SG_ 904 IPDS_HDMapPowerSup 0;
BA_ "GenSigSendType" SG_ 904 IPDS_HDMapPowerSup 1;
BA_ "GenSigStartValue" SG_ 904 IPDS_HDMapPowerSup 3;
BA_ "GenSigTimeoutValue" SG_ 904 IPDS_HDMapPowerSup 0;
BA_ "Remark" SG_ 904 IPDS_HDMapPowerSup "";
BA_ "EventCommandSignal" SG_ 904 IPDS_RearRadarPowerSup 0;
BA_ "GatewayedSignals" SG_ 904 IPDS_RearRadarPowerSup 0;
BA_ "GenSigInactiveValue" SG_ 904 IPDS_RearRadarPowerSup 0;
BA_ "GenSigInvalidValue" SG_ 904 IPDS_RearRadarPowerSup 0;
BA_ "GenSigSendType" SG_ 904 IPDS_RearRadarPowerSup 1;
BA_ "GenSigStartValue" SG_ 904 IPDS_RearRadarPowerSup 3;
BA_ "GenSigTimeoutValue" SG_ 904 IPDS_RearRadarPowerSup 0;
BA_ "Remark" SG_ 904 IPDS_RearRadarPowerSup "";
BA_ "EventCommandSignal" SG_ 909 LCK_HoodAjarSt 0;
BA_ "GatewayedSignals" SG_ 909 LCK_HoodAjarSt 0;
BA_ "GenSigInactiveValue" SG_ 909 LCK_HoodAjarSt 0;
BA_ "GenSigInvalidValue" SG_ 909 LCK_HoodAjarSt 0;
BA_ "GenSigSendType" SG_ 909 LCK_HoodAjarSt 0;
BA_ "GenSigStartValue" SG_ 909 LCK_HoodAjarSt 0;
BA_ "GenSigTimeoutValue" SG_ 909 LCK_HoodAjarSt 0;
BA_ "Remark" SG_ 909 LCK_HoodAjarSt "";
BA_ "EventCommandSignal" SG_ 909 LCK_FrontLeftDoorAjarSt 0;
BA_ "GatewayedSignals" SG_ 909 LCK_FrontLeftDoorAjarSt 0;
BA_ "GenSigInactiveValue" SG_ 909 LCK_FrontLeftDoorAjarSt 0;
BA_ "GenSigInvalidValue" SG_ 909 LCK_FrontLeftDoorAjarSt 0;
BA_ "GenSigSendType" SG_ 909 LCK_FrontLeftDoorAjarSt 0;
BA_ "GenSigStartValue" SG_ 909 LCK_FrontLeftDoorAjarSt 0;
BA_ "GenSigTimeoutValue" SG_ 909 LCK_FrontLeftDoorAjarSt 0;
BA_ "Remark" SG_ 909 LCK_FrontLeftDoorAjarSt "";
BA_ "EventCommandSignal" SG_ 909 LCK_FrontRightDoorAjarSt 0;
BA_ "GatewayedSignals" SG_ 909 LCK_FrontRightDoorAjarSt 0;
BA_ "GenSigInactiveValue" SG_ 909 LCK_FrontRightDoorAjarSt 0;
BA_ "GenSigInvalidValue" SG_ 909 LCK_FrontRightDoorAjarSt 0;
BA_ "GenSigSendType" SG_ 909 LCK_FrontRightDoorAjarSt 0;
BA_ "GenSigStartValue" SG_ 909 LCK_FrontRightDoorAjarSt 0;
BA_ "GenSigTimeoutValue" SG_ 909 LCK_FrontRightDoorAjarSt 0;
BA_ "Remark" SG_ 909 LCK_FrontRightDoorAjarSt "";
BA_ "EventCommandSignal" SG_ 909 LCK_RearLeftDoorAjarSt 0;
BA_ "GatewayedSignals" SG_ 909 LCK_RearLeftDoorAjarSt 0;
BA_ "GenSigInactiveValue" SG_ 909 LCK_RearLeftDoorAjarSt 0;
BA_ "GenSigInvalidValue" SG_ 909 LCK_RearLeftDoorAjarSt 0;
BA_ "GenSigSendType" SG_ 909 LCK_RearLeftDoorAjarSt 0;
BA_ "GenSigStartValue" SG_ 909 LCK_RearLeftDoorAjarSt 0;
BA_ "GenSigTimeoutValue" SG_ 909 LCK_RearLeftDoorAjarSt 0;
BA_ "Remark" SG_ 909 LCK_RearLeftDoorAjarSt "";
BA_ "EventCommandSignal" SG_ 909 LCK_RearRightDoorAjarSt 0;
BA_ "GatewayedSignals" SG_ 909 LCK_RearRightDoorAjarSt 0;
BA_ "GenSigInactiveValue" SG_ 909 LCK_RearRightDoorAjarSt 0;
BA_ "GenSigInvalidValue" SG_ 909 LCK_RearRightDoorAjarSt 0;
BA_ "GenSigSendType" SG_ 909 LCK_RearRightDoorAjarSt 0;
BA_ "GenSigStartValue" SG_ 909 LCK_RearRightDoorAjarSt 0;
BA_ "GenSigTimeoutValue" SG_ 909 LCK_RearRightDoorAjarSt 0;
BA_ "Remark" SG_ 909 LCK_RearRightDoorAjarSt "";
BA_ "EventCommandSignal" SG_ 909 LCK_TrunkAjarSt 0;
BA_ "GatewayedSignals" SG_ 909 LCK_TrunkAjarSt 0;
BA_ "GenSigInactiveValue" SG_ 909 LCK_TrunkAjarSt 0;
BA_ "GenSigInvalidValue" SG_ 909 LCK_TrunkAjarSt 0;
BA_ "GenSigSendType" SG_ 909 LCK_TrunkAjarSt 0;
BA_ "GenSigStartValue" SG_ 909 LCK_TrunkAjarSt 0;
BA_ "GenSigTimeoutValue" SG_ 909 LCK_TrunkAjarSt 0;
BA_ "Remark" SG_ 909 LCK_TrunkAjarSt "";
BA_ "EventCommandSignal" SG_ 909 LCK_FrontLeftDoorLockSt 0;
BA_ "GatewayedSignals" SG_ 909 LCK_FrontLeftDoorLockSt 0;
BA_ "GenSigInactiveValue" SG_ 909 LCK_FrontLeftDoorLockSt 0;
BA_ "GenSigInvalidValue" SG_ 909 LCK_FrontLeftDoorLockSt 0;
BA_ "GenSigSendType" SG_ 909 LCK_FrontLeftDoorLockSt 0;
BA_ "GenSigStartValue" SG_ 909 LCK_FrontLeftDoorLockSt 0;
BA_ "GenSigTimeoutValue" SG_ 909 LCK_FrontLeftDoorLockSt 0;
BA_ "Remark" SG_ 909 LCK_FrontLeftDoorLockSt "";
BA_ "EventCommandSignal" SG_ 909 LCK_FrontRightDoorLockSt 0;
BA_ "GatewayedSignals" SG_ 909 LCK_FrontRightDoorLockSt 0;
BA_ "GenSigInactiveValue" SG_ 909 LCK_FrontRightDoorLockSt 0;
BA_ "GenSigInvalidValue" SG_ 909 LCK_FrontRightDoorLockSt 0;
BA_ "GenSigSendType" SG_ 909 LCK_FrontRightDoorLockSt 0;
BA_ "GenSigStartValue" SG_ 909 LCK_FrontRightDoorLockSt 0;
BA_ "GenSigTimeoutValue" SG_ 909 LCK_FrontRightDoorLockSt 0;
BA_ "Remark" SG_ 909 LCK_FrontRightDoorLockSt "";
BA_ "EventCommandSignal" SG_ 909 LCK_RearLeftDoorLockSt 0;
BA_ "GatewayedSignals" SG_ 909 LCK_RearLeftDoorLockSt 0;
BA_ "GenSigInactiveValue" SG_ 909 LCK_RearLeftDoorLockSt 0;
BA_ "GenSigInvalidValue" SG_ 909 LCK_RearLeftDoorLockSt 0;
BA_ "GenSigSendType" SG_ 909 LCK_RearLeftDoorLockSt 0;
BA_ "GenSigStartValue" SG_ 909 LCK_RearLeftDoorLockSt 0;
BA_ "GenSigTimeoutValue" SG_ 909 LCK_RearLeftDoorLockSt 0;
BA_ "Remark" SG_ 909 LCK_RearLeftDoorLockSt "";
BA_ "EventCommandSignal" SG_ 909 LCK_RearRightDoorLockSt 0;
BA_ "GatewayedSignals" SG_ 909 LCK_RearRightDoorLockSt 0;
BA_ "GenSigInactiveValue" SG_ 909 LCK_RearRightDoorLockSt 0;
BA_ "GenSigInvalidValue" SG_ 909 LCK_RearRightDoorLockSt 0;
BA_ "GenSigSendType" SG_ 909 LCK_RearRightDoorLockSt 0;
BA_ "GenSigStartValue" SG_ 909 LCK_RearRightDoorLockSt 0;
BA_ "GenSigTimeoutValue" SG_ 909 LCK_RearRightDoorLockSt 0;
BA_ "Remark" SG_ 909 LCK_RearRightDoorLockSt "";
BA_ "EventCommandSignal" SG_ 909 LCK_RearLeftChildSaftyLockSt 0;
BA_ "GatewayedSignals" SG_ 909 LCK_RearLeftChildSaftyLockSt 0;
BA_ "GenSigInactiveValue" SG_ 909 LCK_RearLeftChildSaftyLockSt 0;
BA_ "GenSigInvalidValue" SG_ 909 LCK_RearLeftChildSaftyLockSt 0;
BA_ "GenSigSendType" SG_ 909 LCK_RearLeftChildSaftyLockSt 0;
BA_ "GenSigStartValue" SG_ 909 LCK_RearLeftChildSaftyLockSt 0;
BA_ "GenSigTimeoutValue" SG_ 909 LCK_RearLeftChildSaftyLockSt 0;
BA_ "Remark" SG_ 909 LCK_RearLeftChildSaftyLockSt "";
BA_ "EventCommandSignal" SG_ 909 LCK_RearRightChildSaftyLockSt 0;
BA_ "GatewayedSignals" SG_ 909 LCK_RearRightChildSaftyLockSt 0;
BA_ "GenSigInactiveValue" SG_ 909 LCK_RearRightChildSaftyLockSt 0;
BA_ "GenSigInvalidValue" SG_ 909 LCK_RearRightChildSaftyLockSt 0;
BA_ "GenSigSendType" SG_ 909 LCK_RearRightChildSaftyLockSt 0;
BA_ "GenSigStartValue" SG_ 909 LCK_RearRightChildSaftyLockSt 0;
BA_ "GenSigTimeoutValue" SG_ 909 LCK_RearRightChildSaftyLockSt 0;
BA_ "Remark" SG_ 909 LCK_RearRightChildSaftyLockSt "";
BA_ "EventCommandSignal" SG_ 909 EMS_EngStForPHEV 0;
BA_ "GatewayedSignals" SG_ 909 EMS_EngStForPHEV 0;
BA_ "GenSigInactiveValue" SG_ 909 EMS_EngStForPHEV 0;
BA_ "GenSigInvalidValue" SG_ 909 EMS_EngStForPHEV 0;
BA_ "GenSigSendType" SG_ 909 EMS_EngStForPHEV 1;
BA_ "GenSigStartValue" SG_ 909 EMS_EngStForPHEV 0;
BA_ "GenSigTimeoutValue" SG_ 909 EMS_EngStForPHEV 0;
BA_ "Remark" SG_ 909 EMS_EngStForPHEV "";
BA_ "EventCommandSignal" SG_ 909 WCM_Reminder 0;
BA_ "GatewayedSignals" SG_ 909 WCM_Reminder 0;
BA_ "GenSigInactiveValue" SG_ 909 WCM_Reminder 0;
BA_ "GenSigInvalidValue" SG_ 909 WCM_Reminder 0;
BA_ "GenSigSendType" SG_ 909 WCM_Reminder 1;
BA_ "GenSigStartValue" SG_ 909 WCM_Reminder 0;
BA_ "GenSigTimeoutValue" SG_ 909 WCM_Reminder 0;
BA_ "Remark" SG_ 909 WCM_Reminder "";
BA_ "EventCommandSignal" SG_ 909 WCM_ChargingSt 0;
BA_ "GatewayedSignals" SG_ 909 WCM_ChargingSt 0;
BA_ "GenSigInactiveValue" SG_ 909 WCM_ChargingSt 0;
BA_ "GenSigInvalidValue" SG_ 909 WCM_ChargingSt 0;
BA_ "GenSigSendType" SG_ 909 WCM_ChargingSt 1;
BA_ "GenSigStartValue" SG_ 909 WCM_ChargingSt 0;
BA_ "GenSigTimeoutValue" SG_ 909 WCM_ChargingSt 0;
BA_ "Remark" SG_ 909 WCM_ChargingSt "";
BA_ "EventCommandSignal" SG_ 909 LCK_FrontLeftDoorHandlePosition 0;
BA_ "GatewayedSignals" SG_ 909 LCK_FrontLeftDoorHandlePosition 0;
BA_ "GenSigInactiveValue" SG_ 909 LCK_FrontLeftDoorHandlePosition 0;
BA_ "GenSigInvalidValue" SG_ 909 LCK_FrontLeftDoorHandlePosition 255;
BA_ "GenSigSendType" SG_ 909 LCK_FrontLeftDoorHandlePosition 0;
BA_ "GenSigStartValue" SG_ 909 LCK_FrontLeftDoorHandlePosition 0;
BA_ "GenSigTimeoutValue" SG_ 909 LCK_FrontLeftDoorHandlePosition 0;
BA_ "Remark" SG_ 909 LCK_FrontLeftDoorHandlePosition "";
BA_ "EventCommandSignal" SG_ 909 LCK_FrontRightDoorHandlePosition 0;
BA_ "GatewayedSignals" SG_ 909 LCK_FrontRightDoorHandlePosition 0;
BA_ "GenSigInactiveValue" SG_ 909 LCK_FrontRightDoorHandlePosition 0;
BA_ "GenSigInvalidValue" SG_ 909 LCK_FrontRightDoorHandlePosition 255;
BA_ "GenSigSendType" SG_ 909 LCK_FrontRightDoorHandlePosition 0;
BA_ "GenSigStartValue" SG_ 909 LCK_FrontRightDoorHandlePosition 0;
BA_ "GenSigTimeoutValue" SG_ 909 LCK_FrontRightDoorHandlePosition 0;
BA_ "Remark" SG_ 909 LCK_FrontRightDoorHandlePosition "";
BA_ "EventCommandSignal" SG_ 909 LCK_RearLeftDoorHandlePosition 0;
BA_ "GatewayedSignals" SG_ 909 LCK_RearLeftDoorHandlePosition 0;
BA_ "GenSigInactiveValue" SG_ 909 LCK_RearLeftDoorHandlePosition 0;
BA_ "GenSigInvalidValue" SG_ 909 LCK_RearLeftDoorHandlePosition 255;
BA_ "GenSigSendType" SG_ 909 LCK_RearLeftDoorHandlePosition 0;
BA_ "GenSigStartValue" SG_ 909 LCK_RearLeftDoorHandlePosition 0;
BA_ "GenSigTimeoutValue" SG_ 909 LCK_RearLeftDoorHandlePosition 0;
BA_ "Remark" SG_ 909 LCK_RearLeftDoorHandlePosition "";
BA_ "EventCommandSignal" SG_ 909 LCK_RearRightDoorHandlePosition 0;
BA_ "GatewayedSignals" SG_ 909 LCK_RearRightDoorHandlePosition 0;
BA_ "GenSigInactiveValue" SG_ 909 LCK_RearRightDoorHandlePosition 0;
BA_ "GenSigInvalidValue" SG_ 909 LCK_RearRightDoorHandlePosition 255;
BA_ "GenSigSendType" SG_ 909 LCK_RearRightDoorHandlePosition 0;
BA_ "GenSigStartValue" SG_ 909 LCK_RearRightDoorHandlePosition 0;
BA_ "GenSigTimeoutValue" SG_ 909 LCK_RearRightDoorHandlePosition 0;
BA_ "Remark" SG_ 909 LCK_RearRightDoorHandlePosition "";
BA_ "EventCommandSignal" SG_ 909 WW_RWPMotorSt 0;
BA_ "GatewayedSignals" SG_ 909 WW_RWPMotorSt 0;
BA_ "GenSigInactiveValue" SG_ 909 WW_RWPMotorSt 0;
BA_ "GenSigInvalidValue" SG_ 909 WW_RWPMotorSt 0;
BA_ "GenSigSendType" SG_ 909 WW_RWPMotorSt 1;
BA_ "GenSigStartValue" SG_ 909 WW_RWPMotorSt 0;
BA_ "GenSigTimeoutValue" SG_ 909 WW_RWPMotorSt 0;
BA_ "Remark" SG_ 909 WW_RWPMotorSt "";
BA_ "EventCommandSignal" SG_ 909 LCK_FillerCapASt 0;
BA_ "GatewayedSignals" SG_ 909 LCK_FillerCapASt 0;
BA_ "GenSigInactiveValue" SG_ 909 LCK_FillerCapASt 0;
BA_ "GenSigInvalidValue" SG_ 909 LCK_FillerCapASt 0;
BA_ "GenSigSendType" SG_ 909 LCK_FillerCapASt 0;
BA_ "GenSigStartValue" SG_ 909 LCK_FillerCapASt 0;
BA_ "GenSigTimeoutValue" SG_ 909 LCK_FillerCapASt 0;
BA_ "Remark" SG_ 909 LCK_FillerCapASt "";
BA_ "EventCommandSignal" SG_ 909 LCK_FillerCapBSt 0;
BA_ "GatewayedSignals" SG_ 909 LCK_FillerCapBSt 0;
BA_ "GenSigInactiveValue" SG_ 909 LCK_FillerCapBSt 0;
BA_ "GenSigInvalidValue" SG_ 909 LCK_FillerCapBSt 0;
BA_ "GenSigSendType" SG_ 909 LCK_FillerCapBSt 0;
BA_ "GenSigStartValue" SG_ 909 LCK_FillerCapBSt 0;
BA_ "GenSigTimeoutValue" SG_ 909 LCK_FillerCapBSt 0;
BA_ "Remark" SG_ 909 LCK_FillerCapBSt "";
BA_ "EventCommandSignal" SG_ 909 AVAS_ActivatedSt 0;
BA_ "GatewayedSignals" SG_ 909 AVAS_ActivatedSt 0;
BA_ "GenSigInactiveValue" SG_ 909 AVAS_ActivatedSt 0;
BA_ "GenSigInvalidValue" SG_ 909 AVAS_ActivatedSt 0;
BA_ "GenSigSendType" SG_ 909 AVAS_ActivatedSt 1;
BA_ "GenSigStartValue" SG_ 909 AVAS_ActivatedSt 0;
BA_ "GenSigTimeoutValue" SG_ 909 AVAS_ActivatedSt 0;
BA_ "Remark" SG_ 909 AVAS_ActivatedSt "";
BA_ "EventCommandSignal" SG_ 909 MR_LeftMirrorFoldUnfoldSt 0;
BA_ "GatewayedSignals" SG_ 909 MR_LeftMirrorFoldUnfoldSt 0;
BA_ "GenSigInactiveValue" SG_ 909 MR_LeftMirrorFoldUnfoldSt 0;
BA_ "GenSigInvalidValue" SG_ 909 MR_LeftMirrorFoldUnfoldSt 0;
BA_ "GenSigSendType" SG_ 909 MR_LeftMirrorFoldUnfoldSt 1;
BA_ "GenSigStartValue" SG_ 909 MR_LeftMirrorFoldUnfoldSt 0;
BA_ "GenSigTimeoutValue" SG_ 909 MR_LeftMirrorFoldUnfoldSt 0;
BA_ "Remark" SG_ 909 MR_LeftMirrorFoldUnfoldSt "";
BA_ "EventCommandSignal" SG_ 909 SBM_SwapHvBattModeSt 0;
BA_ "GatewayedSignals" SG_ 909 SBM_SwapHvBattModeSt 0;
BA_ "GenSigInactiveValue" SG_ 909 SBM_SwapHvBattModeSt 0;
BA_ "GenSigInvalidValue" SG_ 909 SBM_SwapHvBattModeSt 0;
BA_ "GenSigSendType" SG_ 909 SBM_SwapHvBattModeSt 1;
BA_ "GenSigStartValue" SG_ 909 SBM_SwapHvBattModeSt 0;
BA_ "GenSigTimeoutValue" SG_ 909 SBM_SwapHvBattModeSt 0;
BA_ "Remark" SG_ 909 SBM_SwapHvBattModeSt "";
BA_ "EventCommandSignal" SG_ 909 SBM_SwapStaDiagCode 0;
BA_ "GatewayedSignals" SG_ 909 SBM_SwapStaDiagCode 0;
BA_ "GenSigInactiveValue" SG_ 909 SBM_SwapStaDiagCode 0;
BA_ "GenSigInvalidValue" SG_ 909 SBM_SwapStaDiagCode 0;
BA_ "GenSigSendType" SG_ 909 SBM_SwapStaDiagCode 1;
BA_ "GenSigStartValue" SG_ 909 SBM_SwapStaDiagCode 0;
BA_ "GenSigTimeoutValue" SG_ 909 SBM_SwapStaDiagCode 0;
BA_ "Remark" SG_ 909 SBM_SwapStaDiagCode "";
BA_ "EventCommandSignal" SG_ 909 SBM_SwapVehDiagCode 0;
BA_ "GatewayedSignals" SG_ 909 SBM_SwapVehDiagCode 0;
BA_ "GenSigInactiveValue" SG_ 909 SBM_SwapVehDiagCode 0;
BA_ "GenSigInvalidValue" SG_ 909 SBM_SwapVehDiagCode 0;
BA_ "GenSigSendType" SG_ 909 SBM_SwapVehDiagCode 1;
BA_ "GenSigStartValue" SG_ 909 SBM_SwapVehDiagCode 0;
BA_ "GenSigTimeoutValue" SG_ 909 SBM_SwapVehDiagCode 0;
BA_ "Remark" SG_ 909 SBM_SwapVehDiagCode "";
BA_ "EventCommandSignal" SG_ 909 SBM_SwapHvBattModeFaultSt 0;
BA_ "GatewayedSignals" SG_ 909 SBM_SwapHvBattModeFaultSt 0;
BA_ "GenSigInactiveValue" SG_ 909 SBM_SwapHvBattModeFaultSt 0;
BA_ "GenSigInvalidValue" SG_ 909 SBM_SwapHvBattModeFaultSt 0;
BA_ "GenSigSendType" SG_ 909 SBM_SwapHvBattModeFaultSt 1;
BA_ "GenSigStartValue" SG_ 909 SBM_SwapHvBattModeFaultSt 0;
BA_ "GenSigTimeoutValue" SG_ 909 SBM_SwapHvBattModeFaultSt 0;
BA_ "Remark" SG_ 909 SBM_SwapHvBattModeFaultSt "";
BA_ "EventCommandSignal" SG_ 909 IPDS_HDMapPowerSt 0;
BA_ "GatewayedSignals" SG_ 909 IPDS_HDMapPowerSt 0;
BA_ "GenSigInactiveValue" SG_ 909 IPDS_HDMapPowerSt 0;
BA_ "GenSigInvalidValue" SG_ 909 IPDS_HDMapPowerSt 0;
BA_ "GenSigSendType" SG_ 909 IPDS_HDMapPowerSt 1;
BA_ "GenSigStartValue" SG_ 909 IPDS_HDMapPowerSt 0;
BA_ "GenSigTimeoutValue" SG_ 909 IPDS_HDMapPowerSt 0;
BA_ "Remark" SG_ 909 IPDS_HDMapPowerSt "";
BA_ "EventCommandSignal" SG_ 909 IPDS_KL15L1PowerSt 0;
BA_ "GatewayedSignals" SG_ 909 IPDS_KL15L1PowerSt 0;
BA_ "GenSigInactiveValue" SG_ 909 IPDS_KL15L1PowerSt 0;
BA_ "GenSigInvalidValue" SG_ 909 IPDS_KL15L1PowerSt 0;
BA_ "GenSigSendType" SG_ 909 IPDS_KL15L1PowerSt 1;
BA_ "GenSigStartValue" SG_ 909 IPDS_KL15L1PowerSt 0;
BA_ "GenSigTimeoutValue" SG_ 909 IPDS_KL15L1PowerSt 0;
BA_ "Remark" SG_ 909 IPDS_KL15L1PowerSt "";
BA_ "EventCommandSignal" SG_ 909 IPDS_SRSECUPowerSt 0;
BA_ "GatewayedSignals" SG_ 909 IPDS_SRSECUPowerSt 0;
BA_ "GenSigInactiveValue" SG_ 909 IPDS_SRSECUPowerSt 0;
BA_ "GenSigInvalidValue" SG_ 909 IPDS_SRSECUPowerSt 0;
BA_ "GenSigSendType" SG_ 909 IPDS_SRSECUPowerSt 1;
BA_ "GenSigStartValue" SG_ 909 IPDS_SRSECUPowerSt 0;
BA_ "GenSigTimeoutValue" SG_ 909 IPDS_SRSECUPowerSt 0;
BA_ "Remark" SG_ 909 IPDS_SRSECUPowerSt "";
BA_ "EventCommandSignal" SG_ 909 IPDS_HODPowerSt 0;
BA_ "GatewayedSignals" SG_ 909 IPDS_HODPowerSt 0;
BA_ "GenSigInactiveValue" SG_ 909 IPDS_HODPowerSt 0;
BA_ "GenSigInvalidValue" SG_ 909 IPDS_HODPowerSt 0;
BA_ "GenSigSendType" SG_ 909 IPDS_HODPowerSt 1;
BA_ "GenSigStartValue" SG_ 909 IPDS_HODPowerSt 0;
BA_ "GenSigTimeoutValue" SG_ 909 IPDS_HODPowerSt 0;
BA_ "Remark" SG_ 909 IPDS_HODPowerSt "";
BA_ "EventCommandSignal" SG_ 909 KAE_BLEOption 0;
BA_ "GatewayedSignals" SG_ 909 KAE_BLEOption 0;
BA_ "GenSigInactiveValue" SG_ 909 KAE_BLEOption 0;
BA_ "GenSigInvalidValue" SG_ 909 KAE_BLEOption 0;
BA_ "GenSigSendType" SG_ 909 KAE_BLEOption 1;
BA_ "GenSigStartValue" SG_ 909 KAE_BLEOption 0;
BA_ "GenSigTimeoutValue" SG_ 909 KAE_BLEOption 0;
BA_ "Remark" SG_ 909 KAE_BLEOption "";
BA_ "EventCommandSignal" SG_ 909 KAE_UWBOption 0;
BA_ "GatewayedSignals" SG_ 909 KAE_UWBOption 0;
BA_ "GenSigInactiveValue" SG_ 909 KAE_UWBOption 0;
BA_ "GenSigInvalidValue" SG_ 909 KAE_UWBOption 0;
BA_ "GenSigSendType" SG_ 909 KAE_UWBOption 1;
BA_ "GenSigStartValue" SG_ 909 KAE_UWBOption 0;
BA_ "GenSigTimeoutValue" SG_ 909 KAE_UWBOption 0;
BA_ "Remark" SG_ 909 KAE_UWBOption "";
BA_ "EventCommandSignal" SG_ 909 PWL_WinCurrentPos_FLWinPst 0;
BA_ "GatewayedSignals" SG_ 909 PWL_WinCurrentPos_FLWinPst 0;
BA_ "GenSigInactiveValue" SG_ 909 PWL_WinCurrentPos_FLWinPst 0;
BA_ "GenSigInvalidValue" SG_ 909 PWL_WinCurrentPos_FLWinPst 0;
BA_ "GenSigSendType" SG_ 909 PWL_WinCurrentPos_FLWinPst 1;
BA_ "GenSigStartValue" SG_ 909 PWL_WinCurrentPos_FLWinPst 255;
BA_ "GenSigTimeoutValue" SG_ 909 PWL_WinCurrentPos_FLWinPst 0;
BA_ "Remark" SG_ 909 PWL_WinCurrentPos_FLWinPst "";
BA_ "EventCommandSignal" SG_ 909 UINM_FrontLeftPowerReleaseReq 0;
BA_ "GatewayedSignals" SG_ 909 UINM_FrontLeftPowerReleaseReq 0;
BA_ "GenSigInactiveValue" SG_ 909 UINM_FrontLeftPowerReleaseReq 0;
BA_ "GenSigInvalidValue" SG_ 909 UINM_FrontLeftPowerReleaseReq 0;
BA_ "GenSigSendType" SG_ 909 UINM_FrontLeftPowerReleaseReq 1;
BA_ "GenSigStartValue" SG_ 909 UINM_FrontLeftPowerReleaseReq 0;
BA_ "GenSigTimeoutValue" SG_ 909 UINM_FrontLeftPowerReleaseReq 0;
BA_ "Remark" SG_ 909 UINM_FrontLeftPowerReleaseReq "";
BA_ "EventCommandSignal" SG_ 909 UINM_FrontLeftPowerReleaseFaultSt 0;
BA_ "GatewayedSignals" SG_ 909 UINM_FrontLeftPowerReleaseFaultSt 0;
BA_ "GenSigInactiveValue" SG_ 909 UINM_FrontLeftPowerReleaseFaultSt 0;
BA_ "GenSigInvalidValue" SG_ 909 UINM_FrontLeftPowerReleaseFaultSt 0;
BA_ "GenSigSendType" SG_ 909 UINM_FrontLeftPowerReleaseFaultSt 1;
BA_ "GenSigStartValue" SG_ 909 UINM_FrontLeftPowerReleaseFaultSt 0;
BA_ "GenSigTimeoutValue" SG_ 909 UINM_FrontLeftPowerReleaseFaultSt 0;
BA_ "Remark" SG_ 909 UINM_FrontLeftPowerReleaseFaultSt "";
BA_ "EventCommandSignal" SG_ 909 UINM_FrontRightPowerReleaseReq 0;
BA_ "GatewayedSignals" SG_ 909 UINM_FrontRightPowerReleaseReq 0;
BA_ "GenSigInactiveValue" SG_ 909 UINM_FrontRightPowerReleaseReq 0;
BA_ "GenSigInvalidValue" SG_ 909 UINM_FrontRightPowerReleaseReq 0;
BA_ "GenSigSendType" SG_ 909 UINM_FrontRightPowerReleaseReq 1;
BA_ "GenSigStartValue" SG_ 909 UINM_FrontRightPowerReleaseReq 0;
BA_ "GenSigTimeoutValue" SG_ 909 UINM_FrontRightPowerReleaseReq 0;
BA_ "Remark" SG_ 909 UINM_FrontRightPowerReleaseReq "";
BA_ "EventCommandSignal" SG_ 909 UINM_FrontRightPowerReleaseFaultSt 0;
BA_ "GatewayedSignals" SG_ 909 UINM_FrontRightPowerReleaseFaultSt 0;
BA_ "GenSigInactiveValue" SG_ 909 UINM_FrontRightPowerReleaseFaultSt 0;
BA_ "GenSigInvalidValue" SG_ 909 UINM_FrontRightPowerReleaseFaultSt 0;
BA_ "GenSigSendType" SG_ 909 UINM_FrontRightPowerReleaseFaultSt 1;
BA_ "GenSigStartValue" SG_ 909 UINM_FrontRightPowerReleaseFaultSt 0;
BA_ "GenSigTimeoutValue" SG_ 909 UINM_FrontRightPowerReleaseFaultSt 0;
BA_ "Remark" SG_ 909 UINM_FrontRightPowerReleaseFaultSt "";
BA_ "EventCommandSignal" SG_ 909 UINM_RearLeftPowerReleaseFaultSt 0;
BA_ "GatewayedSignals" SG_ 909 UINM_RearLeftPowerReleaseFaultSt 0;
BA_ "GenSigInactiveValue" SG_ 909 UINM_RearLeftPowerReleaseFaultSt 0;
BA_ "GenSigInvalidValue" SG_ 909 UINM_RearLeftPowerReleaseFaultSt 0;
BA_ "GenSigSendType" SG_ 909 UINM_RearLeftPowerReleaseFaultSt 1;
BA_ "GenSigStartValue" SG_ 909 UINM_RearLeftPowerReleaseFaultSt 0;
BA_ "GenSigTimeoutValue" SG_ 909 UINM_RearLeftPowerReleaseFaultSt 0;
BA_ "Remark" SG_ 909 UINM_RearLeftPowerReleaseFaultSt "";
BA_ "EventCommandSignal" SG_ 909 UINM_RearLeftPowerReleaseReq 0;
BA_ "GatewayedSignals" SG_ 909 UINM_RearLeftPowerReleaseReq 0;
BA_ "GenSigInactiveValue" SG_ 909 UINM_RearLeftPowerReleaseReq 0;
BA_ "GenSigInvalidValue" SG_ 909 UINM_RearLeftPowerReleaseReq 0;
BA_ "GenSigSendType" SG_ 909 UINM_RearLeftPowerReleaseReq 1;
BA_ "GenSigStartValue" SG_ 909 UINM_RearLeftPowerReleaseReq 0;
BA_ "GenSigTimeoutValue" SG_ 909 UINM_RearLeftPowerReleaseReq 0;
BA_ "Remark" SG_ 909 UINM_RearLeftPowerReleaseReq "";
BA_ "EventCommandSignal" SG_ 909 UINM_RearRightPowerReleaseFaultSt 0;
BA_ "GatewayedSignals" SG_ 909 UINM_RearRightPowerReleaseFaultSt 0;
BA_ "GenSigInactiveValue" SG_ 909 UINM_RearRightPowerReleaseFaultSt 0;
BA_ "GenSigInvalidValue" SG_ 909 UINM_RearRightPowerReleaseFaultSt 0;
BA_ "GenSigSendType" SG_ 909 UINM_RearRightPowerReleaseFaultSt 1;
BA_ "GenSigStartValue" SG_ 909 UINM_RearRightPowerReleaseFaultSt 0;
BA_ "GenSigTimeoutValue" SG_ 909 UINM_RearRightPowerReleaseFaultSt 0;
BA_ "Remark" SG_ 909 UINM_RearRightPowerReleaseFaultSt "";
BA_ "EventCommandSignal" SG_ 909 UINM_RearRightPowerReleaseReq 0;
BA_ "GatewayedSignals" SG_ 909 UINM_RearRightPowerReleaseReq 0;
BA_ "GenSigInactiveValue" SG_ 909 UINM_RearRightPowerReleaseReq 0;
BA_ "GenSigInvalidValue" SG_ 909 UINM_RearRightPowerReleaseReq 0;
BA_ "GenSigSendType" SG_ 909 UINM_RearRightPowerReleaseReq 1;
BA_ "GenSigStartValue" SG_ 909 UINM_RearRightPowerReleaseReq 0;
BA_ "GenSigTimeoutValue" SG_ 909 UINM_RearRightPowerReleaseReq 0;
BA_ "Remark" SG_ 909 UINM_RearRightPowerReleaseReq "";
BA_ "EventCommandSignal" SG_ 909 BMS_BattSOCAccurate 0;
BA_ "GatewayedSignals" SG_ 909 BMS_BattSOCAccurate 0;
BA_ "GenSigInactiveValue" SG_ 909 BMS_BattSOCAccurate 0;
BA_ "GenSigInvalidValue" SG_ 909 BMS_BattSOCAccurate 0;
BA_ "GenSigSendType" SG_ 909 BMS_BattSOCAccurate 1;
BA_ "GenSigStartValue" SG_ 909 BMS_BattSOCAccurate 5550;
BA_ "GenSigTimeoutValue" SG_ 909 BMS_BattSOCAccurate 0;
BA_ "Remark" SG_ 909 BMS_BattSOCAccurate "";
BA_ "EventCommandSignal" SG_ 909 PWL_WinCurrentPos_RRWinPst 0;
BA_ "GatewayedSignals" SG_ 909 PWL_WinCurrentPos_RRWinPst 0;
BA_ "GenSigInactiveValue" SG_ 909 PWL_WinCurrentPos_RRWinPst 0;
BA_ "GenSigInvalidValue" SG_ 909 PWL_WinCurrentPos_RRWinPst 0;
BA_ "GenSigSendType" SG_ 909 PWL_WinCurrentPos_RRWinPst 1;
BA_ "GenSigStartValue" SG_ 909 PWL_WinCurrentPos_RRWinPst 255;
BA_ "GenSigTimeoutValue" SG_ 909 PWL_WinCurrentPos_RRWinPst 0;
BA_ "Remark" SG_ 909 PWL_WinCurrentPos_RRWinPst "";
BA_ "EventCommandSignal" SG_ 909 PWL_WinCurrentPos_RLWinPst 0;
BA_ "GatewayedSignals" SG_ 909 PWL_WinCurrentPos_RLWinPst 0;
BA_ "GenSigInactiveValue" SG_ 909 PWL_WinCurrentPos_RLWinPst 0;
BA_ "GenSigInvalidValue" SG_ 909 PWL_WinCurrentPos_RLWinPst 0;
BA_ "GenSigSendType" SG_ 909 PWL_WinCurrentPos_RLWinPst 1;
BA_ "GenSigStartValue" SG_ 909 PWL_WinCurrentPos_RLWinPst 255;
BA_ "GenSigTimeoutValue" SG_ 909 PWL_WinCurrentPos_RLWinPst 0;
BA_ "Remark" SG_ 909 PWL_WinCurrentPos_RLWinPst "";
BA_ "EventCommandSignal" SG_ 909 ACEleclocksSt 0;
BA_ "GatewayedSignals" SG_ 909 ACEleclocksSt 0;
BA_ "GenSigInactiveValue" SG_ 909 ACEleclocksSt 0;
BA_ "GenSigInvalidValue" SG_ 909 ACEleclocksSt 0;
BA_ "GenSigSendType" SG_ 909 ACEleclocksSt 1;
BA_ "GenSigStartValue" SG_ 909 ACEleclocksSt 0;
BA_ "GenSigTimeoutValue" SG_ 909 ACEleclocksSt 0;
BA_ "Remark" SG_ 909 ACEleclocksSt "";
BA_ "EventCommandSignal" SG_ 909 DSASBM_MotResp 0;
BA_ "GatewayedSignals" SG_ 909 DSASBM_MotResp 0;
BA_ "GenSigInactiveValue" SG_ 909 DSASBM_MotResp 0;
BA_ "GenSigInvalidValue" SG_ 909 DSASBM_MotResp 0;
BA_ "GenSigSendType" SG_ 909 DSASBM_MotResp 1;
BA_ "GenSigStartValue" SG_ 909 DSASBM_MotResp 0;
BA_ "GenSigTimeoutValue" SG_ 909 DSASBM_MotResp 0;
BA_ "Remark" SG_ 909 DSASBM_MotResp "";
BA_ "EventCommandSignal" SG_ 909 FLISD_InteractLightSt 0;
BA_ "GatewayedSignals" SG_ 909 FLISD_InteractLightSt 0;
BA_ "GenSigInactiveValue" SG_ 909 FLISD_InteractLightSt 0;
BA_ "GenSigInvalidValue" SG_ 909 FLISD_InteractLightSt 0;
BA_ "GenSigSendType" SG_ 909 FLISD_InteractLightSt 1;
BA_ "GenSigStartValue" SG_ 909 FLISD_InteractLightSt 0;
BA_ "GenSigTimeoutValue" SG_ 909 FLISD_InteractLightSt 0;
BA_ "Remark" SG_ 909 FLISD_InteractLightSt "";
BA_ "EventCommandSignal" SG_ 430 SRS_1_CRC_1 0;
BA_ "GatewayedSignals" SG_ 430 SRS_1_CRC_1 0;
BA_ "GenSigInactiveValue" SG_ 430 SRS_1_CRC_1 0;
BA_ "GenSigInvalidValue" SG_ 430 SRS_1_CRC_1 0;
BA_ "GenSigSendType" SG_ 430 SRS_1_CRC_1 1;
BA_ "GenSigStartValue" SG_ 430 SRS_1_CRC_1 0;
BA_ "GenSigTimeoutValue" SG_ 430 SRS_1_CRC_1 0;
BA_ "Remark" SG_ 430 SRS_1_CRC_1 "";
BA_ "EventCommandSignal" SG_ 430 SRS_1_Counter_1 0;
BA_ "GatewayedSignals" SG_ 430 SRS_1_Counter_1 0;
BA_ "GenSigInactiveValue" SG_ 430 SRS_1_Counter_1 0;
BA_ "GenSigInvalidValue" SG_ 430 SRS_1_Counter_1 0;
BA_ "GenSigSendType" SG_ 430 SRS_1_Counter_1 1;
BA_ "GenSigStartValue" SG_ 430 SRS_1_Counter_1 0;
BA_ "GenSigTimeoutValue" SG_ 430 SRS_1_Counter_1 0;
BA_ "Remark" SG_ 430 SRS_1_Counter_1 "";
BA_ "EventCommandSignal" SG_ 430 SRS_CrashOutputSt 0;
BA_ "GatewayedSignals" SG_ 430 SRS_CrashOutputSt 0;
BA_ "GenSigInactiveValue" SG_ 430 SRS_CrashOutputSt 0;
BA_ "GenSigInvalidValue" SG_ 430 SRS_CrashOutputSt 0;
BA_ "GenSigSendType" SG_ 430 SRS_CrashOutputSt 1;
BA_ "GenSigStartValue" SG_ 430 SRS_CrashOutputSt 0;
BA_ "GenSigTimeoutValue" SG_ 430 SRS_CrashOutputSt 0;
BA_ "Remark" SG_ 430 SRS_CrashOutputSt "";
BA_ "EventCommandSignal" SG_ 430 SRS_Front_CrashOutputSt 0;
BA_ "GatewayedSignals" SG_ 430 SRS_Front_CrashOutputSt 0;
BA_ "GenSigInactiveValue" SG_ 430 SRS_Front_CrashOutputSt 0;
BA_ "GenSigInvalidValue" SG_ 430 SRS_Front_CrashOutputSt 0;
BA_ "GenSigSendType" SG_ 430 SRS_Front_CrashOutputSt 1;
BA_ "GenSigStartValue" SG_ 430 SRS_Front_CrashOutputSt 0;
BA_ "GenSigTimeoutValue" SG_ 430 SRS_Front_CrashOutputSt 0;
BA_ "Remark" SG_ 430 SRS_Front_CrashOutputSt "";
BA_ "EventCommandSignal" SG_ 430 SRS_DriverSide_CrashOutputSt 0;
BA_ "GatewayedSignals" SG_ 430 SRS_DriverSide_CrashOutputSt 0;
BA_ "GenSigInactiveValue" SG_ 430 SRS_DriverSide_CrashOutputSt 0;
BA_ "GenSigInvalidValue" SG_ 430 SRS_DriverSide_CrashOutputSt 0;
BA_ "GenSigSendType" SG_ 430 SRS_DriverSide_CrashOutputSt 1;
BA_ "GenSigStartValue" SG_ 430 SRS_DriverSide_CrashOutputSt 0;
BA_ "GenSigTimeoutValue" SG_ 430 SRS_DriverSide_CrashOutputSt 0;
BA_ "Remark" SG_ 430 SRS_DriverSide_CrashOutputSt "";
BA_ "EventCommandSignal" SG_ 430 SRS_PassengerSide_CrashOutputSt 0;
BA_ "GatewayedSignals" SG_ 430 SRS_PassengerSide_CrashOutputSt 0;
BA_ "GenSigInactiveValue" SG_ 430 SRS_PassengerSide_CrashOutputSt 0;
BA_ "GenSigInvalidValue" SG_ 430 SRS_PassengerSide_CrashOutputSt 0;
BA_ "GenSigSendType" SG_ 430 SRS_PassengerSide_CrashOutputSt 1;
BA_ "GenSigStartValue" SG_ 430 SRS_PassengerSide_CrashOutputSt 0;
BA_ "GenSigTimeoutValue" SG_ 430 SRS_PassengerSide_CrashOutputSt 0;
BA_ "Remark" SG_ 430 SRS_PassengerSide_CrashOutputSt "";
BA_ "EventCommandSignal" SG_ 430 SRS_Rear_CrashOutputSt 0;
BA_ "GatewayedSignals" SG_ 430 SRS_Rear_CrashOutputSt 0;
BA_ "GenSigInactiveValue" SG_ 430 SRS_Rear_CrashOutputSt 0;
BA_ "GenSigInvalidValue" SG_ 430 SRS_Rear_CrashOutputSt 0;
BA_ "GenSigSendType" SG_ 430 SRS_Rear_CrashOutputSt 1;
BA_ "GenSigStartValue" SG_ 430 SRS_Rear_CrashOutputSt 0;
BA_ "GenSigTimeoutValue" SG_ 430 SRS_Rear_CrashOutputSt 0;
BA_ "Remark" SG_ 430 SRS_Rear_CrashOutputSt "";
BA_ "EventCommandSignal" SG_ 430 SRS_RolloverCrashOutputSt 0;
BA_ "GatewayedSignals" SG_ 430 SRS_RolloverCrashOutputSt 0;
BA_ "GenSigInactiveValue" SG_ 430 SRS_RolloverCrashOutputSt 0;
BA_ "GenSigInvalidValue" SG_ 430 SRS_RolloverCrashOutputSt 0;
BA_ "GenSigSendType" SG_ 430 SRS_RolloverCrashOutputSt 1;
BA_ "GenSigStartValue" SG_ 430 SRS_RolloverCrashOutputSt 0;
BA_ "GenSigTimeoutValue" SG_ 430 SRS_RolloverCrashOutputSt 0;
BA_ "Remark" SG_ 430 SRS_RolloverCrashOutputSt "";
BA_ "EventCommandSignal" SG_ 430 SRS_NearCrashOutputSt 0;
BA_ "GatewayedSignals" SG_ 430 SRS_NearCrashOutputSt 0;
BA_ "GenSigInactiveValue" SG_ 430 SRS_NearCrashOutputSt 0;
BA_ "GenSigInvalidValue" SG_ 430 SRS_NearCrashOutputSt 0;
BA_ "GenSigSendType" SG_ 430 SRS_NearCrashOutputSt 1;
BA_ "GenSigStartValue" SG_ 430 SRS_NearCrashOutputSt 0;
BA_ "GenSigTimeoutValue" SG_ 430 SRS_NearCrashOutputSt 0;
BA_ "Remark" SG_ 430 SRS_NearCrashOutputSt "";
BA_ "EventCommandSignal" SG_ 430 SRS_1_CRC_2 0;
BA_ "GatewayedSignals" SG_ 430 SRS_1_CRC_2 0;
BA_ "GenSigInactiveValue" SG_ 430 SRS_1_CRC_2 0;
BA_ "GenSigInvalidValue" SG_ 430 SRS_1_CRC_2 0;
BA_ "GenSigSendType" SG_ 430 SRS_1_CRC_2 1;
BA_ "GenSigStartValue" SG_ 430 SRS_1_CRC_2 0;
BA_ "GenSigTimeoutValue" SG_ 430 SRS_1_CRC_2 0;
BA_ "Remark" SG_ 430 SRS_1_CRC_2 "";
BA_ "EventCommandSignal" SG_ 430 SRS_1_Counter_2 0;
BA_ "GatewayedSignals" SG_ 430 SRS_1_Counter_2 0;
BA_ "GenSigInactiveValue" SG_ 430 SRS_1_Counter_2 0;
BA_ "GenSigInvalidValue" SG_ 430 SRS_1_Counter_2 0;
BA_ "GenSigSendType" SG_ 430 SRS_1_Counter_2 1;
BA_ "GenSigStartValue" SG_ 430 SRS_1_Counter_2 0;
BA_ "GenSigTimeoutValue" SG_ 430 SRS_1_Counter_2 0;
BA_ "Remark" SG_ 430 SRS_1_Counter_2 "";
BA_ "EventCommandSignal" SG_ 430 SRS_YawSnsCalibSt 0;
BA_ "GatewayedSignals" SG_ 430 SRS_YawSnsCalibSt 0;
BA_ "GenSigInactiveValue" SG_ 430 SRS_YawSnsCalibSt 0;
BA_ "GenSigInvalidValue" SG_ 430 SRS_YawSnsCalibSt 0;
BA_ "GenSigSendType" SG_ 430 SRS_YawSnsCalibSt 1;
BA_ "GenSigStartValue" SG_ 430 SRS_YawSnsCalibSt 0;
BA_ "GenSigTimeoutValue" SG_ 430 SRS_YawSnsCalibSt 0;
BA_ "Remark" SG_ 430 SRS_YawSnsCalibSt "";
BA_ "EventCommandSignal" SG_ 430 SRS_VehLongAccelVD 0;
BA_ "GatewayedSignals" SG_ 430 SRS_VehLongAccelVD 0;
BA_ "GenSigInactiveValue" SG_ 430 SRS_VehLongAccelVD 0;
BA_ "GenSigInvalidValue" SG_ 430 SRS_VehLongAccelVD 0;
BA_ "GenSigSendType" SG_ 430 SRS_VehLongAccelVD 1;
BA_ "GenSigStartValue" SG_ 430 SRS_VehLongAccelVD 0;
BA_ "GenSigTimeoutValue" SG_ 430 SRS_VehLongAccelVD 2;
BA_ "Remark" SG_ 430 SRS_VehLongAccelVD "";
BA_ "EventCommandSignal" SG_ 430 SRS_VehLatrlAccelVD 0;
BA_ "GatewayedSignals" SG_ 430 SRS_VehLatrlAccelVD 0;
BA_ "GenSigInactiveValue" SG_ 430 SRS_VehLatrlAccelVD 0;
BA_ "GenSigInvalidValue" SG_ 430 SRS_VehLatrlAccelVD 0;
BA_ "GenSigSendType" SG_ 430 SRS_VehLatrlAccelVD 1;
BA_ "GenSigStartValue" SG_ 430 SRS_VehLatrlAccelVD 0;
BA_ "GenSigTimeoutValue" SG_ 430 SRS_VehLatrlAccelVD 2;
BA_ "Remark" SG_ 430 SRS_VehLatrlAccelVD "";
BA_ "EventCommandSignal" SG_ 430 SRS_YawRateVD 0;
BA_ "GatewayedSignals" SG_ 430 SRS_YawRateVD 0;
BA_ "GenSigInactiveValue" SG_ 430 SRS_YawRateVD 0;
BA_ "GenSigInvalidValue" SG_ 430 SRS_YawRateVD 0;
BA_ "GenSigSendType" SG_ 430 SRS_YawRateVD 1;
BA_ "GenSigStartValue" SG_ 430 SRS_YawRateVD 0;
BA_ "GenSigTimeoutValue" SG_ 430 SRS_YawRateVD 2;
BA_ "Remark" SG_ 430 SRS_YawRateVD "";
BA_ "EventCommandSignal" SG_ 430 SRS_VehLongAccel 0;
BA_ "GatewayedSignals" SG_ 430 SRS_VehLongAccel 0;
BA_ "GenSigInactiveValue" SG_ 430 SRS_VehLongAccel 0;
BA_ "GenSigInvalidValue" SG_ 430 SRS_VehLongAccel 0;
BA_ "GenSigSendType" SG_ 430 SRS_VehLongAccel 1;
BA_ "GenSigStartValue" SG_ 430 SRS_VehLongAccel 2000;
BA_ "GenSigTimeoutValue" SG_ 430 SRS_VehLongAccel 2000;
BA_ "Remark" SG_ 430 SRS_VehLongAccel "";
BA_ "EventCommandSignal" SG_ 430 SRS_VehLatrlAccel 0;
BA_ "GatewayedSignals" SG_ 430 SRS_VehLatrlAccel 0;
BA_ "GenSigInactiveValue" SG_ 430 SRS_VehLatrlAccel 0;
BA_ "GenSigInvalidValue" SG_ 430 SRS_VehLatrlAccel 0;
BA_ "GenSigSendType" SG_ 430 SRS_VehLatrlAccel 1;
BA_ "GenSigStartValue" SG_ 430 SRS_VehLatrlAccel 2000;
BA_ "GenSigTimeoutValue" SG_ 430 SRS_VehLatrlAccel 2000;
BA_ "Remark" SG_ 430 SRS_VehLatrlAccel "";
BA_ "EventCommandSignal" SG_ 430 SRS_YawRate 0;
BA_ "GatewayedSignals" SG_ 430 SRS_YawRate 0;
BA_ "GenSigInactiveValue" SG_ 430 SRS_YawRate 0;
BA_ "GenSigInvalidValue" SG_ 430 SRS_YawRate 0;
BA_ "GenSigSendType" SG_ 430 SRS_YawRate 1;
BA_ "GenSigStartValue" SG_ 430 SRS_YawRate 18000;
BA_ "GenSigTimeoutValue" SG_ 430 SRS_YawRate 18000;
BA_ "Remark" SG_ 430 SRS_YawRate "";
VAL_ 728 CDC_ADCCtrlAvl 0 "Not available" 1 "Available"  ;
VAL_ 728 CDC_ADCCtrlRespSts 0 "No active" 1 "Active"  ;
VAL_ 728 CDC_ADCModState 0 "Initializing" 1 "comfort（low）" 2 "comfort（middle）" 3 "comfort（high）" 4 "sport（low）" 5 "sport（middle）" 6 "sport（high）" 7 "reserve"  ;
VAL_ 459 AS_SuspHeightFLVD 0 "Invalid" 1 "Valid"  ;
VAL_ 459 AS_SuspHeightFRVD 0 "Invalid" 1 "Valid"  ;
VAL_ 459 AS_SuspHeightRLVD 0 "Invalid" 1 "Valid"  ;
VAL_ 459 AS_SuspHeightRRVD 0 "Invalid" 1 "Valid"  ;
VAL_ 459 AS_SuspHeightSensorFLSt 0 "No fault" 1 "Fault"  ;
VAL_ 459 AS_SuspHeightSensorFRSt 0 "No fault" 1 "Fault"  ;
VAL_ 459 AS_SuspHeightSensorRLSt 0 "No fault" 1 "Fault"  ;
VAL_ 459 AS_SuspHeightSensoRRSt 0 "No fault" 1 "Fault"  ;
VAL_ 459 AS_MaintanceModeSt 0 "Disabled" 1 "Inactive" 2 "User activation" 3 "Automatically  activation"  ;
VAL_ 459 ECS_AVDCReqModeAvailable 0 "not available" 1 "available"  ;
VAL_ 459 ECS_AVDCReqMode 0 "inactive" 1 "Small Control" 2 "Middle Control(reserved)" 3 "Big Control"  ;
VAL_ 459 AS_FrontAxleSuspSt 0 "Standby" 1 "Up" 2 "Down" 3 "Reserved"  ;
VAL_ 459 AS_RearAxleSuspSt 0 "Standby" 1 "Up" 2 "Down" 3 "Reserved"  ;
VAL_ 459 AS_HeightWarningSt 0 "Initializing" 1 "Normal" 2 "Too High" 3 "Too Low" 4 "Invalid"  ;
VAL_ 459 AS_CurrentLevel 0 "Invalid" 1 "Very high level" 2 "Between very high and high level" 3 "High level" 4 "Between high and normal level" 5 "Normal level" 6 "Between normal and low level" 7 "Low level" 8 "Between low and very low level" 9 "Very low level" 10 "Between previous level to easy-loading level" 11 "Easy-loading  level" 12 "Between previous level to showrom level" 13 "Showrom level" 14 "Reserved" 15 "Reserved"  ;
VAL_ 459 AS_ASMode 0 "Invalid" 1 "Very high base level (not used)" 2 "High level" 3 "Normal level" 4 "Low level" 5 "Very low  base level (not used)" 6 "Reserved" 7 "Reserved"  ;
VAL_ 459 AS_SysFaultSt 0 "No error" 1 "Fault Level1 (minor)" 2 "Fault Level 2 (seriously)" 3 "Fault Level 3 (Very seriously)" 4 "Reserved" 5 "Reserved" 6 "Reserved" 7 "Reserved"  ;
VAL_ 459 AS_SysOperationSt 0 "Invalid" 1 "Lifting" 2 "Lowering" 3 "Holding (current level" 4 "Prohibit adjusting (sub-function or external request prohibit adjusting or low pressure)" 5 "Shut down (overheating without enough pressure and system fault)" 6 "Easy-loading adjusting" 7 "Showrom adjusting" 8 "Reserved" 9 "Reserved" 10 "Reserved" 11 "Reserved" 12 "Reserved" 13 "Reserved" 14 "Reserved" 15 "Reserved"  ;
VAL_ 459 AS_ADCStfnCtrlAvl 0 "Not available" 1 "Available"  ;
VAL_ 459 AS_ADCStfnState 0 "Initializing" 1 "Soft" 2 "Hard"  ;
VAL_ 905 ICM_SetIACCSt 0 "Not active" 1 "Active"  ;
VAL_ 161 ACU_FaceID_Delete 0 "Default" 1 "Delete AUID1" 2 "Delete AUID2" 3 "Delete AUID3" 4 "Delete AUID4" 5 "Delete AUID5" 6 "Delete AUID6" 7 "Delete AUID7" 8 "Delete AUID8" 9 "Reserved" 10 "Reserved" 11 "Reserved" 12 "Reserved" 13 "Reserved" 14 "Reserved" 15 "Reserved"  ;
VAL_ 161 ACU_RegisterTriger 0 "Default" 1 "Register AUID1" 2 "Register AUID2" 3 "Register AUID3" 4 "Register AUID4" 5 "Register AUID5" 6 "Register AUID6" 7 "Register AUID7" 8 "Register AUID8" 9 "Reserved" 10 "Reserved" 11 "Reserved" 12 "Reserved" 13 "Reserved" 14 "Reserved" 15 "Reserved"  ;
VAL_ 161 ACU_VerifyTriger 0 "Default" 1 "Verify AUID1" 2 "Verify AUID2" 3 "Verify AUID3" 4 "Verify AUID4" 5 "Verify AUID5" 6 "Verify AUID6" 7 "Verify AUID7" 8 "Verify AUID8" 9 "Reserved" 10 "Reserved" 11 "Reserved" 12 "Reserved" 13 "Reserved" 14 "Reserved" 15 "Reserved"  ;
VAL_ 161 ACU_FaceIDQuit 0 "No command" 1 "Quit request"  ;
VAL_ 161 ACU_FaceIDSwitch 0 "No command" 1 "Off" 2 "On" 3 "Not used"  ;
VAL_ 161 ACU_AVAS_SwitchCfgReq 0 "No command" 1 "OFF" 2 "ON" 3 "Not used"  ;
VAL_ 913 IL_PADS_LightbarSt 0 "Off;" 1 "White;" 2 "Blue;" 3 "Orange;" 4 "Red;" 5 "Reserved;" 6 "Reserved;" 7 "Reserved;" 8 "Reserved;" 9 "Reserved;" 10 "Reserved;" 11 "Reserved;" 12 "Reserved;" 13 "Reserved;" 14 "Reserved;" 15 "Invalid;"  ;
VAL_ 913 IL_PADS_LightbarErrSt 0 "No Error;" 1 "Error;"  ;
VAL_ 913 UINM_PADS_L3SWSt 0 "Not Perssed;" 1 "Short Pressed;" 2 "Long Pressed;" 3 "Reserved;"  ;
VAL_ 913 UINM_PADS_L3SWStVD 0 "Not Valid;" 1 "Valid;"  ;
VAL_ 913 UINM_PADS_L3SWStuckSt 0 "Normal ;" 1 "Stuck;"  ;
VAL_ 904 HVAC_RearDefrostSt 0 "Not acitve" 1 "Active"  ;
VAL_ 904 HVAC_WindExitMode 0 "Invalid" 1 "Face" 2 "Face/Foot" 3 "Foot" 4 "Foot/Defrost" 5 "Defrost" 6 "Face/DEF" 7 "Face/Foot/DEF"  ;
VAL_ 904 HVAC_CorrectedExterTempVD 0 "Not valid" 1 "Valid"  ;
VAL_ 904 HVAC_CorrectedCabinTempVD 0 "Not valid" 1 "Valid"  ;
VAL_ 904 WW_FwpFaultSt 0 "Not fault" 1 "Fault"  ;
VAL_ 904 WW_RwpFaultSt 0 "Not fault" 1 "Fault"  ;
VAL_ 904 WW_FwshFaultSt 0 "Not fault" 1 "Fault"  ;
VAL_ 904 WW_RwshFaultSt 0 "Not fault" 1 "Fault"  ;
VAL_ 904 WW_FwpAutoModeSt 0 "False" 1 "True"  ;
VAL_ 904 WW_RainFallLevel 0 "No Rain" 1 "Level 1" 2 "Level 2" 3 "Level 3" 4 "Level 4" 5 "Level 5" 6 "Level 6" 7 "Level 7" 8 "Level 8" 9 "Level 9" 10 "Level 10" 11 "Level 11" 12 "Level 12" 13 "Level 13" 14 "Init value" 15 "Invalid value"  ;
VAL_ 904 RLS_LightOnReq 0 "Light Off" 1 "Light On"  ;
VAL_ 904 RLS_LampOnReqValid 0 "Valid value" 1 "Invalid value"  ;
VAL_ 904 RLS_WiperSpd 0 "Switch Off" 1 "Low speed/speed 1" 2 "speed 2" 3 "speed 3" 4 "speed 4" 5 "speed 5" 6 "speed 6" 7 "speed 7" 8 "speed 8" 9 "speed 9" 10 "speed 10" 11 "speed 11" 12 "speed 12" 13 "speed 13" 14 "High speed/speed 14" 15 "Invalid"  ;
VAL_ 904 RLS_RainfallLevel 0 "No Rain" 1 "Level 1" 2 "Level 2" 3 "Level 3" 4 "Level 4" 5 "Level 5" 6 "Level 6" 7 "Level 7" 8 "Level 8" 9 "Level 9" 10 "Level 10" 11 "Level 11" 12 "Level 12" 13 "Level 13" 14 "Init value" 15 "Invalid value"  ;
VAL_ 904 RLS_RSErr 0 "No Error" 1 "Error"  ;
VAL_ 904 RLS_LSErr 0 "No Error" 1 "Error"  ;
VAL_ 904 PM_AUTHPstState 0 "Disable" 1 "Enable"  ;
VAL_ 904 CCU_FuncReq_SentryMod 0 "OFF" 1 "SentryModeWake"  ;
VAL_ 904 CCU_ModeSuppressSts 0 "OFF" 1 "ON" 2 "UNKNOWN"  ;
VAL_ 904 RLS_HUTErr 0 "HUT sensor normal" 1 "HUT sensor error"  ;
VAL_ 904 SR_SunroofCurrentPst 255 "Undefined Sunroof position"  ;
VAL_ 904 EL_LeftBSDIndicatorSt 0 "OFF" 1 "ON"  ;
VAL_ 904 UINM_HazardLightSwSt 0 "No Request" 1 "Request"  ;
VAL_ 904 EL_MLTurnLightSt 0 "Not active" 1 "OFF" 2 "ON" 3 "Not used"  ;
VAL_ 904 EL_MLTurnLightFaultSt 0 "Not fault" 1 "Fault"  ;
VAL_ 904 EL_LeftBSDIndicatorFaultSt 0 "Not fault" 1 "Fault"  ;
VAL_ 904 ZCUL_FrtWindshildHeatSt 0 "No" 1 "Heating" 2 "Fault" 3 "reserve"  ;
VAL_ 904 ACU_PCS_SVM_MODCmd 0 "Disable" 1 "Enalbe"  ;
VAL_ 904 ACU_HeadLightVirtualSwSt 0 "NotActive" 1 "PositionLight" 2 "LowBeam" 3 "AutoLight"  ;
VAL_ 904 ACU_FrontFogLightVirtualSwSt 0 "Not Active" 1 "Active"  ;
VAL_ 904 ACU_RearFogLightVirtualSwSt 0 "Not Active" 1 "Active"  ;
VAL_ 904 ACU_Account_Uid 0 "No command" 1 "account 0" 2 "account 1" 3 "account 2" 4 "account 3" 5 "account 4" 6 "account 5" 7 "account 6" 8 "account 7" 9 "account 8" 10 "Not used" 11 "Not used" 12 "Not used" 13 "Not used" 14 "Not used" 15 "Not used"  ;
VAL_ 904 ACU_IHBC_SwitchReq 0 "No command" 1 "Not active" 2 "Active" 3 "Not used"  ;
VAL_ 904 ACU_NDASwitchReq 0 "No command" 1 "Not active" 2 "Active" 3 "Not used"  ;
VAL_ 904 ACU_NDALCConSwitchReq 0 "No command" 1 "Need confirm" 2 "No need confirm" 3 "Not used"  ;
VAL_ 904 ACU_NDALCStySwitchReq 0 "No command" 1 "Standard" 2 "Radical" 3 "Not used"  ;
VAL_ 904 ACU_ADASWarnTypeSwitch 0 "No command" 1 "Sound" 2 "Voice" 3 "Seat vibration"  ;
VAL_ 904 ACU_iACC_StyleConfirmSwitchReq 0 "No Command" 1 "Need confirm" 2 "No need confirm" 3 "OFF"  ;
VAL_ 904 ACU_IFC_ISDRestOfdis 0 "not in ISD" 251 "over 70km"  ;
VAL_ 904 ACU_IFC_SpeedLimitUnit 0 "Not used" 1 "Km/h" 2 "Miles/h" 3 "Not used"  ;
VAL_ 904 ACU_ThemeType 0 "Day mode" 1 "Night mode"  ;
VAL_ 904 ACU_IFC_SpeedLimtType 0 "Not specific" 1 "Speed limit camera detection" 2 "Interval speed detectionlimit"  ;
VAL_ 904 ACU_IFC_RoadType 0 "unknown" 1 "High way" 2 "National road" 3 "Provincial road" 4 "County road" 5 "Village road" 6 "City express way" 7 "Major urban road" 8 "Secondary urban road" 9 "Normal urban road" 10 "Non-Navigation Road" 11 "Ramp" 12 "Reserve" 13 "Reserve" 14 "Reserve" 15 "Reserve"  ;
VAL_ 904 ACU_IFC_ZoneCode 0 "Not used" 1 "China"  ;
VAL_ 904 ACU_IFC_NaviSt 0 "Unknown" 1 "Cruise" 2 "Navigate" 3 "Failure"  ;
VAL_ 904 ACU_IFC_NaviCorp 0 "unknown" 1 "Gaode Map" 2 "Tescent Map" 3 "Baidu Map" 4 "Ruitu Map"  ;
VAL_ 904 ACU_IFC_NaviNewIconDis 0 "no newIcon ahead" 21 "over 2.0km"  ;
VAL_ 904 ACU_IFC_OfframpSt 0 "Not off-ramp" 1 "Off-ramp"  ;
VAL_ 904 ACU_IFC_NaviNewIcon 0 "unknown" 1 "left" 2 "right" 3 "left front" 4 "right front" 5 "left rear" 6 "right rear" 7 "left u-turn" 8 "right u-turn" 9 "go straight" 10 "roundabout entrance" 11 "roundabout exit" 12 "service area" 13 "toll station" 14 "tunnel" 15 "not used"  ;
VAL_ 904 ACU_IFC_SLCAheadDis 251 "over 1.25km"  ;
VAL_ 904 ACU_DVR_Switch 0 "Off" 1 "On"  ;
VAL_ 904 ACU_IFC_OfframpDis 254 "over 2km"  ;
VAL_ 904 DrvrSideMotResp 0 "No Action" 1 "Executing Retraction Assistance" 2 "Executing Clearance Removal 1" 3 "Executing Clearance Removal 2" 4 "Executing Dynamic Support 1" 5 "Executing Dynamic Support 2" 6 "Executing Pre-crash Protection" 7 "Executing Vibration Warning 1" 8 "Executing Vibration Warning 2" 9 "Reserved" 10 "Retraction Assistance Completed" 11 "Clearance Removal Completed" 12 "Executing Dynamic Support 3" 13 "Executing Dynamic Support 4" 14 "Executing Vibration Notification" 15 "Timeout"  ;
VAL_ 904 EL_LeftLowBeamSt 0 "OFF" 1 "ON"  ;
VAL_ 904 EL_LeftLowBeamFaultSt 0 "Not fault" 1 "Fault"  ;
VAL_ 904 EL_RightLowBeamSt 0 "OFF" 1 "ON"  ;
VAL_ 904 EL_RightLowBeamFaultSt 0 "Not fault" 1 "Fault"  ;
VAL_ 904 WW_FWPMotorSt 0 "Off" 1 "Reserve" 2 "Stall protection" 3 "Failure" 4 "Low speed" 5 "High speed" 6 "Hard stopped" 7 "Interval delaying"  ;
VAL_ 904 EL_MLADASLightSt 0 "Off" 1 "On" 2 "Fault" 3 "Not used"  ;
VAL_ 904 EL_FLTurnLightSt 0 "Not active" 1 "OFF" 2 "ON" 3 "Not used"  ;
VAL_ 904 EL_FLTurnLightFaultSt 0 "Not fault" 1 "Fault"  ;
VAL_ 904 EL_FRTurnLightSt 0 "Not active" 1 "OFF" 2 "ON" 3 "Not used"  ;
VAL_ 904 EL_FRTurnLightFaultSt 0 "Not fault" 1 "Fault"  ;
VAL_ 904 EL_SideBrkLightSt 0 "OFF" 1 "ON"  ;
VAL_ 904 EL_SideBrkLightFaultSt 0 "Not fault" 1 "Fault"  ;
VAL_ 904 EL_CHMSLSt 0 "OFF" 1 "ON"  ;
VAL_ 904 EL_CHMSLFaultSt 0 "Not fault" 1 "Fault"  ;
VAL_ 904 EL_RLTurnLightSt 0 "Not active" 1 "OFF" 2 "ON" 3 "Not used"  ;
VAL_ 904 EL_RLTurnLightFaultSt 0 "Not fault" 1 "Fault"  ;
VAL_ 904 EL_RRTurnLightSt 0 "Not active" 1 "OFF" 2 "ON" 3 "Not used"  ;
VAL_ 904 EL_RRTurnLightFaultSt 0 "Not fault" 1 "Fault"  ;
VAL_ 904 IPDS_BAT1PowerSt 0 "Not Active" 1 "Active"  ;
VAL_ 904 IPDS_BAT2PowerSt 0 "Not Active" 1 "Active"  ;
VAL_ 904 IPDS_DCDC2PowerSt 0 "Not Active" 1 "Active"  ;
VAL_ 904 IPDS_GridIsoPowerSt 0 "Not Active" 1 "Active"  ;
VAL_ 904 IPS_DCDCModeSt 7 "Failure;" 3 "Active - Buck Mode;" 2 "Connected (HV is active);" 1 "Disconnected;" 0 "Init;"  ;
VAL_ 904 IPDS_FRRadarPowerSup 0 "Not Active" 1 "Active" 2 "PreOFF" 3 "Invalid"  ;
VAL_ 904 LBMS_SOFVD 0 "Invalid" 1 "Valid"  ;
VAL_ 904 LBMS_SOFEN 0 "Keep to the side parking False,Original lane parking False" 1 "Keep to the side parking True,Original lane parking False" 2 "Keep to the side parking False,Original lane parking True" 3 "Keep to the side parking True,Original lane parking True"  ;
VAL_ 904 LBMSAD_SOFVD 0 "Invalid" 1 "Valid"  ;
VAL_ 904 LBMSAD_SOFEN 0 "Keep to the side parking False,Original lane parking False" 1 "Keep to the side parking True,Original lane parking False" 2 "Keep to the side parking False,Original lane parking True" 3 "Keep to the side parking True,Original lane parking True"  ;
VAL_ 904 IPDS_FLRadarPowerSup 0 "Not Active" 1 "Active" 2 "PreOFF" 3 "Invalid"  ;
VAL_ 904 IPDS_FrontRadarPowerSup 0 "Not Active" 1 "Active" 2 "PreOFF" 3 "Invalid"  ;
VAL_ 904 IPDS_HDMapPowerSup 0 "Not Active" 1 "Active" 2 "PreOFF" 3 "Invalid"  ;
VAL_ 904 IPDS_RearRadarPowerSup 0 "Not Active" 1 "Active" 2 "PreOFF" 3 "Invalid"  ;
VAL_ 909 LCK_HoodAjarSt 0 "Closed" 1 "Opened"  ;
VAL_ 909 LCK_FrontLeftDoorAjarSt 0 "Closed" 1 "Opened"  ;
VAL_ 909 LCK_FrontRightDoorAjarSt 0 "Closed" 1 "Opened"  ;
VAL_ 909 LCK_RearLeftDoorAjarSt 0 "Closed" 1 "Opened"  ;
VAL_ 909 LCK_RearRightDoorAjarSt 0 "Closed" 1 "Opened"  ;
VAL_ 909 LCK_TrunkAjarSt 0 "Closed" 1 "Opened"  ;
VAL_ 909 LCK_FrontLeftDoorLockSt 0 "Locked" 1 "Unlocked"  ;
VAL_ 909 LCK_FrontRightDoorLockSt 0 "Locked" 1 "Unlocked"  ;
VAL_ 909 LCK_RearLeftDoorLockSt 0 "Locked" 1 "Unlocked"  ;
VAL_ 909 LCK_RearRightDoorLockSt 0 "Locked" 1 "Unlocked"  ;
VAL_ 909 LCK_RearLeftChildSaftyLockSt 0 "Locked" 1 "Unlocked"  ;
VAL_ 909 LCK_RearRightChildSaftyLockSt 0 "Locked" 1 "Unlocked"  ;
VAL_ 909 EMS_EngStForPHEV 0 "Standby" 1 "Ready" 2 "Cranking" 3 "Running" 4 "Stopping" 5 "Stopped" 6 "Aotostopping"  ;
VAL_ 909 WCM_Reminder 0 "No warning" 1 "Phone left in car"  ;
VAL_ 909 WCM_ChargingSt 0 "Standby" 1 "Charging" 2 "Charging completed (available when Rx support)" 3 "Not standby"  ;
VAL_ 909 LCK_FrontLeftDoorHandlePosition 0 "FullyClosed" 100 "FullyOpened" 254 "Uninitialized" 255 "Unknown"  ;
VAL_ 909 LCK_FrontRightDoorHandlePosition 0 "FullyClosed" 100 "FullyOpened" 254 "Uninitialized" 255 "Unknown"  ;
VAL_ 909 LCK_RearLeftDoorHandlePosition 0 "FullyClosed" 100 "FullyOpened" 254 "Uninitialized" 255 "Unknown"  ;
VAL_ 909 LCK_RearRightDoorHandlePosition 0 "FullyClosed" 100 "FullyOpened" 254 "Uninitialized" 255 "Unknown"  ;
VAL_ 909 WW_RWPMotorSt 0 "Off" 1 "Reserve" 2 "Stall protection" 3 "Failure" 4 "Low speed" 5 "High speed" 6 "Hard stopped" 7 "Interval delaying"  ;
VAL_ 909 LCK_FillerCapASt 0 "Closed" 1 "Opened"  ;
VAL_ 909 LCK_FillerCapBSt 0 "Closed" 1 "Opened"  ;
VAL_ 909 AVAS_ActivatedSt 0 "OFF" 1 "ON" 2 "Sound_AVAS" 3 "Sound_UnLock" 4 "Sound_Lock"  ;
VAL_ 909 MR_LeftMirrorFoldUnfoldSt 0 "Unknown" 1 "Mirror fold" 2 "Mirror unfold" 3 "Reserved"  ;
VAL_ 909 SBM_SwapHvBattModeSt 0 "default" 1 "Station open the door for veichle go in" 2 "Station find Vehicle stop OK" 3 "Station prepare to swap" 4 "Station begin to swap" 5 "Station finish assembling" 6 "Station complete to swap" 7 "Station pause swapping" 8 "Station open the door for veichle go out"  ;
VAL_ 909 SBM_SwapStaDiagCode 0 "Normal" 1 "Fault,BT cominication error" 2 "Fault,SWAP station error" 3 "Fault,vehile error"  ;
VAL_ 909 SBM_SwapHvBattModeFaultSt 0 "default" 1 "Normal" 2 "Error,can recovery" 3 "Error,can not recover"  ;
VAL_ 909 IPDS_HDMapPowerSt 0 "Not Active" 1 "Active"  ;
VAL_ 909 IPDS_KL15L1PowerSt 0 "Not Active" 1 "Active"  ;
VAL_ 909 IPDS_SRSECUPowerSt 0 "Not Active" 1 "Active"  ;
VAL_ 909 IPDS_HODPowerSt 0 "Not Active" 1 "Active"  ;
VAL_ 909 KAE_BLEOption 0 "Not active" 1 "Active"  ;
VAL_ 909 KAE_UWBOption 0 "Not active" 1 "Active"  ;
VAL_ 909 PWL_WinCurrentPos_FLWinPst 255 "Undefined window position"  ;
VAL_ 909 UINM_FrontLeftPowerReleaseReq 0 "NoReq" 1 "Release"  ;
VAL_ 909 UINM_FrontLeftPowerReleaseFaultSt 0 "noraml" 1 "fault"  ;
VAL_ 909 UINM_FrontRightPowerReleaseReq 0 "NoReq" 1 "Release"  ;
VAL_ 909 UINM_FrontRightPowerReleaseFaultSt 0 "noraml" 1 "fault"  ;
VAL_ 909 UINM_RearLeftPowerReleaseFaultSt 0 "noraml" 1 "fault"  ;
VAL_ 909 UINM_RearLeftPowerReleaseReq 0 "NoReq" 1 "Release"  ;
VAL_ 909 UINM_RearRightPowerReleaseFaultSt 0 "noraml" 1 "fault"  ;
VAL_ 909 UINM_RearRightPowerReleaseReq 0 "NoReq" 1 "Release"  ;
VAL_ 909 PWL_WinCurrentPos_RRWinPst 255 "Undefined window position"  ;
VAL_ 909 PWL_WinCurrentPos_RLWinPst 255 "Undefined window position"  ;
VAL_ 909 ACEleclocksSt 0 "init" 1 "Uncloked" 2 "Locked" 3 "Error,bosh open" 4 "Error,bosh close"  ;
VAL_ 909 DSASBM_MotResp 0 "No Action" 1 "Executing Retraction Assistance" 2 "Executing Clearance Removal 1" 3 "Executing Clearance Removal 2" 4 "Executing Dynamic Support 1" 5 "Executing Dynamic Support 2" 6 "Executing Pre-crash Protection" 7 "Executing Vibration Warning 1" 8 "Executing Vibration Warning 2" 9 "Reserved" 10 "Retraction Assistance Completed" 11 "Clearance Removal Completed" 12 "Executing Dynamic Support 3" 13 "Executing Dynamic Support 4" 14 "Executing Vibration Notification" 15 "Reserved"  ;
VAL_ 909 FLISD_InteractLightSt 0 "norequest" 1 "Mode1准备中" 2 "Mode2行驶方向向左" 3 "Mode3行驶方向向右" 4 "Mode4行驶方向向前" 5 "Mode5起步" 6 "Mode6泊车等待中" 7 "Mode7礼让车辆" 8 "Mode8礼让行人" 9 "Mode9避让障碍物" 10 "Mode10靠边临停" 11 "Mode11已泊入车位" 12 "Mode12已泊出，请上车" 13 "Mode13已到达上车点，请上车" 14 "Mode14已退出，等待接管(告警等级1)" 15 "Mode15已退出，等待接管(告警等级2)" 16 "Mode16功能异常，注意安全" 17 "Mode17 泊车暂停，请及时接管" 18 "Mode18 保持车距" 19 "Mode19 请让我通行" 20 "Mode20 感谢" 21 "Mode21 前方堵车" 22 "reserved" 23 "reserved" 24 "reserved" 25 "reserved" 26 "reserved" 27 "reserved" 28 "reserved" 29 "reserved" 30 "reserved" 31 "reserved"  ;
VAL_ 430 SRS_CrashOutputSt 0 "No crash,"  ;
VAL_ 430 SRS_Front_CrashOutputSt 0 "No crash,"  ;
VAL_ 430 SRS_DriverSide_CrashOutputSt 0 "No crash,"  ;
VAL_ 430 SRS_PassengerSide_CrashOutputSt 0 "No crash,"  ;
VAL_ 430 SRS_Rear_CrashOutputSt 0 "No crash,"  ;
VAL_ 430 SRS_RolloverCrashOutputSt 0 "No crash,"  ;
VAL_ 430 SRS_NearCrashOutputSt 0 "No crash," 1 "(transition lasts for 2sec)"  ;
VAL_ 430 SRS_YawSnsCalibSt 0 "Sensor Not Calibrated" 1 "Sensor Calibrated"  ;
VAL_ 430 SRS_VehLongAccelVD 0 "Initializing" 1 "Valid" 2 "Invalid" 3 "Reserved"  ;
VAL_ 430 SRS_VehLatrlAccelVD 0 "Initializing" 1 "Valid" 2 "Invalid" 3 "Reserved"  ;
VAL_ 430 SRS_YawRateVD 0 "Initializing" 1 "Valid" 2 "Invalid" 3 "Reserved"  ;
