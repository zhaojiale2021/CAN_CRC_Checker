VERSION ""

NS_ :

BS_:

BU_: ADC10 Tester

BO_ 1136 ADAS_AD1: 16 ADC10
 SG_ Sync_SyncTime : 39|32@0+ (1,0) [0|4294967295] "NoUnit" Vector__XXX
 SG_ Sync_OVS : 25|2@0+ (1,0) [0|3] "NoUnit" Vector__XXX
 SG_ Sync_SGW : 26|1@0+ (1,0) [0|1] "NoUnit" Vector__XXX
 SG_ Sync_Resd : 31|5@0+ (1,0) [0|31] "NoUnit" Vector__XXX
 SG_ Sync_Counter : 19|4@0+ (1,0) [0|15] "NoUnit" Vector__XXX
 SG_ Sync_TimeDomain : 23|4@0+ (1,0) [0|15] "NoUnit" Vector__XXX
 SG_ Sync_CRC : 15|8@0+ (1,0) [0|255] "NoUnit" Vector__XXX
 SG_ Sync_Type : 7|8@0+ (1,0) [0|255] "NoUnit" Vector__XXX

CM_ SG_ 1136 Sync_SyncTime "/";
CM_ SG_ 1136 Sync_OVS "/";
CM_ SG_ 1136 Sync_SGW "/";
CM_ SG_ 1136 Sync_Resd "/";
CM_ SG_ 1136 Sync_Counter "/";
CM_ SG_ 1136 Sync_TimeDomain "/";
CM_ SG_ 1136 Sync_CRC "/";
CM_ SG_ 1136 Sync_Type "/";
BA_DEF_ BO_  "GenMsgILSupport" ENUM  "No","Yes";
BA_DEF_ BO_  "VFrameFormat" ENUM  "StandardCAN","ExtendedCAN","reserved","reserved","reserved","reserved","reserved","reserved","reserved","reserved","reserved","reserved","reserved","reserved","StandardCAN_FD","ExtendedCAN_FD";
BA_DEF_ SG_  "GenSigSendType" ENUM  "Cyclic","OnWrite","OnWriteWithRepetition","OnChange","OnChangeWithRepetition","IfActive","IfActiveWithRepetition","NoSigSendType","CyclicAndSpontanX","NotUsed","Event","CE";
BA_DEF_ SG_  "IsMonitor" ENUM  "*","Monitor";
BA_DEF_  "DBName" STRING ;
BA_DEF_  "BusType" STRING ;
BA_DEF_  "Manufacturer" STRING ;
BA_DEF_ SG_  "UnitConversionFactor" FLOAT -100 100;
BA_DEF_ SG_  "SigInvalidSetFlag" ENUM  "*","Yes";
BA_DEF_ SG_  "Internal_type" ENUM  "*","UB","UW","UL","SB","SW","SL";
BA_DEF_ BO_  "GenMsgSendType" ENUM  "Cyclic","Event","CE","NotUsed","NotUsed","NotUsed","NotUsed","NotUsed","NoMsgSendType","IfActive","IfActiveWithRepetition","CyclicAndSpontanX";
BA_DEF_ BO_  "MsgType" ENUM  "Normal","NM","Diag","";
BA_DEF_ BO_  "GenMsgCycleTime" INT 0 65535;
BA_DEF_DEF_  "GenMsgILSupport" "Yes";
BA_DEF_DEF_  "VFrameFormat" "StandardCAN";
BA_DEF_DEF_  "GenSigSendType" "Cyclic";
BA_DEF_DEF_  "IsMonitor" "*";
BA_DEF_DEF_  "DBName" "";
BA_DEF_DEF_  "BusType" "";
BA_DEF_DEF_  "Manufacturer" "Vector";
BA_DEF_DEF_  "UnitConversionFactor" 1;
BA_DEF_DEF_  "SigInvalidSetFlag" "*";
BA_DEF_DEF_  "Internal_type" "*";
BA_DEF_DEF_  "GenMsgSendType" "Cyclic";
BA_DEF_DEF_  "MsgType" "";
BA_DEF_DEF_  "GenMsgCycleTime" 0;
BA_ "DBName" "CAN_PR1";
BA_ "BusType" "CAN FD";
BA_ "GenMsgILSupport" BO_ 1136 0;
BA_ "VFrameFormat" BO_ 1136 14;
BA_ "MsgType" BO_ 1136 0;
BA_ "GenMsgCycleTime" BO_ 1136 500;
VAL_ 1136 Sync_SyncTime 0 "Valid_value" ;
VAL_ 1136 Sync_OVS 0 "Valid_value" ;
VAL_ 1136 Sync_SGW 0 "Valid_value" ;
VAL_ 1136 Sync_Resd 0 "Valid_value" ;
VAL_ 1136 Sync_Counter 0 "Valid_value" ;
VAL_ 1136 Sync_TimeDomain 0 "Valid_value" ;
VAL_ 1136 Sync_CRC 0 "Valid_value" ;
VAL_ 1136 Sync_Type 0 "Valid_value" ;
