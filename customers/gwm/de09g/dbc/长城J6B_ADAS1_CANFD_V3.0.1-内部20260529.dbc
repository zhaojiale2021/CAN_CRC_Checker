VERSION ""

NS_ :

BS_:

BU_: GW ZCU_L ADC10 Tester

BO_ 1125 IDC_Sync_Req: 16 ADC10
 SG_ IDC_Sync_Req : 7|128@0+ (1,0) [0|0] "" Vector__XXX

BO_ 347 HAP_FD1: 64 ADC10
 SG_ MAC_Check_HAP_FD1 : 471|48@0+ (1,0) [0|281474976710655] "NoUnit" Vector__XXX
 SG_ FreshnessValue_HAP_FD1 : 455|16@0+ (1,0) [0|65535] "NoUnit" Vector__XXX
 SG_ RWSModReq : 439|3@0+ (1,0) [0|7] "NoUnit" Vector__XXX
 SG_ APA_ModFlag : 404|2@0+ (1,0) [0|3] "NoUnit" Vector__XXX
 SG_ RWSAngReqVld : 405|1@0+ (1,0) [0|1] "NoUnit" Vector__XXX
 SG_ RWSAngReq : 399|8@0+ (0.1,-10.1) [-10|10] "Deg" Vector__XXX
 SG_ RollingCounter_HAP3 : 379|4@0+ (1,0) [0|14] "NoUnit" Vector__XXX
 SG_ SlotConfirmBtn_Ena : 375|2@0+ (1,0) [0|3] "NoUnit" Vector__XXX
 SG_ AnticlockwiseBtn_Ena : 361|2@0+ (1,0) [0|3] "NoUnit" Vector__XXX
 SG_ ClockwiseBtn_Ena : 363|2@0+ (1,0) [0|3] "NoUnit" Vector__XXX
 SG_ VerticalSlotBtn_Ena : 365|2@0+ (1,0) [0|3] "NoUnit" Vector__XXX
 SG_ ParallelSlotBtn_Ena : 367|2@0+ (1,0) [0|3] "NoUnit" Vector__XXX
 SG_ PAVP_FuncSts : 353|2@0+ (1,0) [0|3] "NoUnit" Vector__XXX
 SG_ PAVP_TextDis2 : 359|6@0+ (1,0) [0|63] "NoUnit" Vector__XXX
 SG_ HAVP_FuncSts : 345|2@0+ (1,0) [0|3] "NoUnit" Vector__XXX
 SG_ PAVP_TextDis : 351|6@0+ (1,0) [0|63] "NoUnit" Vector__XXX
 SG_ HAVP_SelfParLotEnding_Ena : 339|2@0+ (1,0) [0|3] "NoUnit" Vector__XXX
 SG_ PAVP_Status : 343|4@0+ (1,0) [0|15] "NoUnit" Vector__XXX
 SG_ HAVP_StopBtn_Ena : 329|2@0+ (1,0) [0|3] "NoUnit" Vector__XXX
 SG_ HAVP_StartBtn_Ena : 331|2@0+ (1,0) [0|3] "NoUnit" Vector__XXX
 SG_ HAVP_WorkSts : 335|4@0+ (1,0) [0|15] "NoUnit" Vector__XXX
 SG_ Checksum_HAP3 : 327|8@0+ (1,0) [0|255] "NoUnit" Vector__XXX
 SG_ RollingCounter_HAP1 : 315|4@0+ (1,0) [0|14] "NoUnit" Vector__XXX
 SG_ AVP_T_BOX_WorkSts : 317|2@0+ (1,0) [0|3] "NoUnit" Vector__XXX
 SG_ AVP_SunroofCloseReq : 319|2@0+ (1,0) [0|3] "NoUnit" Vector__XXX
 SG_ RmtCtrlSts : 305|1@0+ (1,0) [0|1] "NoUnit" Vector__XXX
 SG_ AVP_CenCtrllockReq : 307|2@0+ (1,0) [0|3] "NoUnit" Vector__XXX
 SG_ AVP_WindLockReq : 309|2@0+ (1,0) [0|3] "NoUnit" Vector__XXX
 SG_ AVP_PowerModeReq : 311|2@0+ (1,0) [0|3] "NoUnit" Vector__XXX
 SG_ AVP_FWshrReq : 297|2@0+ (1,0) [0|3] "NoUnit" Vector__XXX
 SG_ AVP_FWiperReq : 300|3@0+ (1,0) [0|7] "NoUnit" Vector__XXX
 SG_ AVP_HornReq : 302|2@0+ (1,0) [0|3] "NoUnit" Vector__XXX
 SG_ AVP_RFogLightReq : 303|1@0+ (1,0) [0|1] "NoUnit" Vector__XXX
 SG_ AVP_FFogLightReq : 288|1@0+ (1,0) [0|1] "NoUnit" Vector__XXX
 SG_ AVP_DippedBeamReq : 290|2@0+ (1,0) [0|3] "NoUnit" Vector__XXX
 SG_ AVP_HiBeamtReq : 292|2@0+ (1,0) [0|3] "NoUnit" Vector__XXX
 SG_ P2P_PrkgDirectSts : 293|1@0+ (1,0) [0|1] "NoUnit" Vector__XXX
 SG_ APS_MovgDirc : 295|2@0+ (1,0) [0|3] "NoUnit" Vector__XXX
 SG_ TailVertPrkgOutVald : 280|1@0+ (1,0) [0|1] "NoUnit" Vector__XXX
 SG_ HeadVertPrkgOutVald : 281|1@0+ (1,0) [0|1] "NoUnit" Vector__XXX
 SG_ RParaPrkgOutVald : 282|1@0+ (1,0) [0|1] "NoUnit" Vector__XXX
 SG_ LParaPrkgOutVald : 283|1@0+ (1,0) [0|1] "NoUnit" Vector__XXX
 SG_ RmtPrkgReq : 284|1@0+ (1,0) [0|1] "NoUnit" Vector__XXX
 SG_ P2P_Pah2Avail : 285|1@0+ (1,0) [0|1] "NoUnit" Vector__XXX
 SG_ P2P_SelfDetSts : 287|2@0+ (1,0) [0|3] "NoUnit" Vector__XXX
 SG_ P2P_Pah1Avail : 272|1@0+ (1,0) [0|1] "NoUnit" Vector__XXX
 SG_ P2P_SelfDetErrCode : 276|4@0+ (1,0) [0|15] "NoUnit" Vector__XXX
 SG_ HAP_SwtDispCtrlCmd : 279|3@0+ (1,0) [0|7] "NoUnit" Vector__XXX
 SG_ P2P_PahDelSts : 265|2@0+ (1,0) [0|3] "NoUnit" Vector__XXX
 SG_ HAP_PrkgModCurrSts : 269|4@0+ (1,0) [0|15] "NoUnit" Vector__XXX
 SG_ APS_PASSwtReq : 271|2@0+ (1,0) [0|3] "NoUnit" Vector__XXX
 SG_ Checksum_HAP1 : 263|8@0+ (1,0) [0|255] "NoUnit" Vector__XXX
 SG_ RollingCounter_AVP1 : 251|4@0+ (1,0) [0|14] "NoUnit" Vector__XXX
 SG_ DrvDirCllsnWarnTrqCtrlFlg : 254|3@0+ (1,0) [0|7] "NoUnit" Vector__XXX
 SG_ DrvDirMstRskObstclCllsnTim : 247|6@0+ (0.1,-0.1) [0|6.1] "s" Vector__XXX
 SG_ AVP_ESP_LSMNudgeReq : 232|1@0+ (1,0) [0|1] "NoUnit" Vector__XXX
 SG_ AVP_ESP_LSMVehSecReq : 233|1@0+ (1,0) [0|1] "NoUnit" Vector__XXX
 SG_ AVP_ESP_LSMComfBrakeReq : 235|2@0+ (1,0) [0|3] "NoUnit" Vector__XXX
 SG_ AVP_ESP_LSMVehDirRq : 237|2@0+ (1,0) [0|3] "NoUnit" Vector__XXX
 SG_ AVP_ESP_LSMSubMTLong : 239|2@0+ (1,0) [0|3] "NoUnit" Vector__XXX
 SG_ AVP_ESP_LSMPrefill : 224|1@0+ (1,0) [0|1] "NoUnit" Vector__XXX
 SG_ AVP_ESP_LSMSubMTLevel : 226|2@0+ (1,0) [0|3] "NoUnit" Vector__XXX
 SG_ AVP_ESP_SafeDrvrHandoverReq : 227|1@0+ (1,0) [0|1] "NoUnit" Vector__XXX
 SG_ AVP_ESP_LSMvMaxRq : 223|11@0+ (0.1,0) [0|20] "kph" Vector__XXX
 SG_ AVP_ESP_LSMSubMTReq : 209|2@0+ (1,0) [0|3] "NoUnit" Vector__XXX
 SG_ AVP_ESP_DriverPresenceExternal : 210|1@0+ (1,0) [0|1] "NoUnit" Vector__XXX
 SG_ AVP_ESP_LSMDistToStop : 207|12@0+ (1,0) [0|4095] "cm" Vector__XXX
 SG_ Checksum_AVP1 : 199|8@0+ (1,0) [0|255] "NoUnit" Vector__XXX
 SG_ RollingCounter_APS4 : 187|4@0+ (1,0) [0|14] "NoUnit" Vector__XXX
 SG_ RHeadVertPrkgOutVald : 188|1@0+ (1,0) [0|1] "NoUnit" Vector__XXX
 SG_ LHeadVertPrkgOutVald : 189|1@0+ (1,0) [0|1] "NoUnit" Vector__XXX
 SG_ RTailVertPrkgOutVald : 190|1@0+ (1,0) [0|1] "NoUnit" Vector__XXX
 SG_ LTailVertPrkgOutVald : 191|1@0+ (1,0) [0|1] "NoUnit" Vector__XXX
 SG_ MEB_BrkgReqValue : 183|8@0+ (0.05,-10) [-10|0] "MtrPerSecSq" Vector__XXX
 SG_ MEB_AVHReq : 168|1@0+ (1,0) [0|1] "NoUnit" Vector__XXX
 SG_ PrkMod : 171|2@0+ (1,0) [0|3] "NoUnit" Vector__XXX
 SG_ APS_ESP_BrkDistance : 167|12@0+ (1,0) [0|4095] "cm" Vector__XXX
 SG_ APS_ESP_SpdLimn : 159|8@0+ (0.1,0) [0|25.5] "kph" Vector__XXX
 SG_ APS_WorkSts : 146|3@0+ (1,0) [0|7] "NoUnit" Vector__XXX
 SG_ MEB_BrkgReq : 147|1@0+ (1,0) [0|1] "NoUnit" Vector__XXX
 SG_ MEBErrSts : 148|1@0+ (1,0) [0|1] "NoUnit" Vector__XXX
 SG_ APS_BrkModSts : 151|3@0+ (1,0) [0|7] "NoUnit" Vector__XXX
 SG_ APS_BrkCategory : 137|2@0+ (1,0) [0|3] "NoUnit" Vector__XXX
 SG_ APS_ESP_TgtGearReq : 140|3@0+ (1,0) [0|7] "NoUnit" Vector__XXX
 SG_ APS_BrkFctnMod : 143|3@0+ (1,0) [0|7] "NoUnit" Vector__XXX
 SG_ Checksum_APS4 : 135|8@0+ (1,0) [0|255] "NoUnit" Vector__XXX
 SG_ RollingCounter_APS1 : 123|4@0+ (1,0) [0|14] "NoUnit" Vector__XXX
 SG_ OutdPrkgSts : 113|2@0+ (1,0) [0|3] "NoUnit" Vector__XXX
 SG_ TurnLightsCmd : 115|2@0+ (1,0) [0|3] "NoUnit" Vector__XXX
 SG_ APS_PrkgMod : 117|2@0+ (1,0) [0|3] "NoUnit" Vector__XXX
 SG_ APS_PrkgTyp : 119|2@0+ (1,0) [0|3] "NoUnit" Vector__XXX
 SG_ APS_SwtSts : 104|1@0+ (1,0) [0|1] "NoUnit" Vector__XXX
 SG_ APS_ProcBar : 111|7@0+ (1,0) [0|100] "Perc" Vector__XXX
 SG_ APS_TextDisp : 103|8@0+ (1,0) [0|255] "NoUnit" Vector__XXX
 SG_ APS_ReqEPSTgtAng : 87|15@0+ (0.1,0) [-1638.3|1638.3] "Deg" Vector__XXX
 SG_ APS_ReqCtrlEPS : 72|1@0+ (1,0) [0|1] "NoUnit" Vector__XXX
 SG_ APS_ReqEPSTgtAngValid : 73|1@0+ (1,0) [0|1] "NoUnit" Vector__XXX
 SG_ APS_SlotDisp : 76|3@0+ (1,0) [0|7] "NoUnit" Vector__XXX
 SG_ APS_SysSoundIndcn : 79|3@0+ (1,0) [0|7] "NoUnit" Vector__XXX
 SG_ Checksum_APS1 : 71|8@0+ (1,0) [0|255] "NoUnit" Vector__XXX
 SG_ RollingCounter_APA1 : 59|4@0+ (1,0) [0|14] "NoUnit" Vector__XXX
 SG_ APA_BrkFctnMod : 63|3@0+ (1,0) [0|7] "NoUnit" Vector__XXX
 SG_ APA_ApStandstillReq : 48|1@0+ (1,0) [0|1] "NoUnit" Vector__XXX
 SG_ APA_ApDriveOffReq : 49|1@0+ (1,0) [0|1] "NoUnit" Vector__XXX
 SG_ APA_ApEmgyBrkReq : 50|1@0+ (1,0) [0|1] "NoUnit" Vector__XXX
 SG_ APA_AxReqEna : 53|1@0+ (1,0) [0|1] "NoUnit" Vector__XXX
 SG_ APA_ApbReq : 41|2@0+ (1,0) [0|3] "NoUnit" Vector__XXX
 SG_ APA_DistoStop : 35|10@0+ (1,0) [0|1023] "cm" Vector__XXX
 SG_ APA_AxReq : 31|12@0+ (0.01,-10) [-10|6] "MtrPerSecSq" Vector__XXX
 SG_ Checksum_APA1 : 7|8@0+ (1,0) [0|255] "NoUnit" Vector__XXX

BO_ 628 HAP_FD2: 64 ADC10
 SG_ SlopViewFuncReq : 167|2@0+ (1,0) [0|3] "NoUnit" Vector__XXX
 SG_ SlopViewSts : 153|2@0+ (1,0) [0|3] "NoUnit" Vector__XXX
 SG_ AutoAVMmodSts : 155|2@0+ (1,0) [0|3] "NoUnit" Vector__XXX
 SG_ WheWarning : 159|4@0+ (1,0) [0|15] "NoUnit" Vector__XXX
 SG_ ParkSlotDispR3 : 150|1@0+ (1,0) [0|1] "NoUnit" Vector__XXX
 SG_ ParkSlotDispR2 : 151|1@0+ (1,0) [0|1] "NoUnit" Vector__XXX
 SG_ ParkSlotDispR1 : 136|1@0+ (1,0) [0|1] "NoUnit" Vector__XXX
 SG_ ParkSlotDispL3 : 137|1@0+ (1,0) [0|1] "NoUnit" Vector__XXX
 SG_ ParkSlotDispL2 : 138|1@0+ (1,0) [0|1] "NoUnit" Vector__XXX
 SG_ ParkSlotDispL1 : 139|1@0+ (1,0) [0|1] "NoUnit" Vector__XXX
 SG_ HAP_Hmi_Index : 143|4@0+ (1,0) [0|15] "NoUnit" Vector__XXX
 SG_ DVRWorkSts : 126|2@0+ (1,0) [0|3] "NoUnit" Vector__XXX
 SG_ HAP_DispCmd : 127|1@0+ (1,0) [0|1] "NoUnit" Vector__XXX
 SG_ AVM_3DAngSts : 104|9@0+ (1,-1) [0|360] "Deg" Vector__XXX
 SG_ OvlOpFailSts : 105|1@0+ (1,0) [0|1] "NoUnit" Vector__XXX
 SG_ TraOvlSts : 106|1@0+ (1,0) [0|1] "NoUnit" Vector__XXX
 SG_ EolNotCmpltd : 107|1@0+ (1,0) [0|1] "NoUnit" Vector__XXX
 SG_ FrntCamInpFailSts : 108|1@0+ (1,0) [0|1] "NoUnit" Vector__XXX
 SG_ RearCamInpFailSts : 109|1@0+ (1,0) [0|1] "NoUnit" Vector__XXX
 SG_ LeCamInpFailSts : 110|1@0+ (1,0) [0|1] "NoUnit" Vector__XXX
 SG_ RiCamInpFailSts : 111|1@0+ (1,0) [0|1] "NoUnit" Vector__XXX
 SG_ CurrCalResultSts : 96|1@0+ (1,0) [0|1] "NoUnit" Vector__XXX
 SG_ LaneCalFltSts : 99|3@0+ (1,0) [0|7] "NoUnit" Vector__XXX
 SG_ LaneCalSts : 101|2@0+ (1,0) [0|3] "NoUnit" Vector__XXX
 SG_ CarMdlTrsprcySts : 103|2@0+ (1,0) [0|3] "NoUnit" Vector__XXX
 SG_ MdlColrSts : 91|4@0+ (1,0) [0|15] "NoUnit" Vector__XXX
 SG_ RadarDispSts : 93|2@0+ (1,0) [0|3] "NoUnit" Vector__XXX
 SG_ GuidOvlSts : 95|2@0+ (1,0) [0|3] "NoUnit" Vector__XXX
 SG_ WheelVieSts : 82|2@0+ (1,0) [0|3] "NoUnit" Vector__XXX
 SG_ AutoAVMSwtSet_Sts : 83|1@0+ (1,0) [0|1] "NoUnit" Vector__XXX
 SG_ AutoViewChgFuncSts : 84|1@0+ (1,0) [0|1] "NoUnit" Vector__XXX
 SG_ CarMdlDispSts : 85|1@0+ (1,0) [0|1] "NoUnit" Vector__XXX
 SG_ MOD_AlarmSts : 86|1@0+ (1,0) [0|1] "NoUnit" Vector__XXX
 SG_ MOD_WorkSts : 87|1@0+ (1,0) [0|1] "NoUnit" Vector__XXX
 SG_ SigViewIndcn : 77|6@0+ (1,0) [0|63] "NoUnit" Vector__XXX
 SG_ AVM_CurrSts : 79|2@0+ (1,0) [0|3] "NoUnit" Vector__XXX

BO_ 664 HAP_FD3: 64 ADC10
 SG_ MAC_Check_HAP_FD3 : 471|48@0+ (1,0) [0|281474976710655] "NoUnit" Vector__XXX
 SG_ FreshnessValue_HAP_FD3 : 455|16@0+ (1,0) [0|65535] "NoUnit" Vector__XXX
 SG_ RiCamDirtySts : 444|1@0+ (1,0) [0|1] "NoUnit" Vector__XXX
 SG_ LeCamDirtySts : 445|1@0+ (1,0) [0|1] "NoUnit" Vector__XXX
 SG_ RearCamDirtySts : 446|1@0+ (1,0) [0|1] "NoUnit" Vector__XXX
 SG_ FrntCamDirtySts : 447|1@0+ (1,0) [0|1] "NoUnit" Vector__XXX
 SG_ DVRCamDirtySts : 432|1@0+ (1,0) [0|1] "NoUnit" Vector__XXX
 SG_ SteerWheelsilentSts : 399|2@0+ (1,0) [0|3] "NoUnit" Vector__XXX
 SG_ VLAPSpdSetVal : 348|5@0+ (1,-1) [0|30] "NoUnit" Vector__XXX
 SG_ PrkgFuncStsLmp : 328|5@0+ (1,0) [0|31] "NoUnit" Vector__XXX
 SG_ AVPworkSts : 332|4@0+ (1,0) [0|15] "NoUnit" Vector__XXX
 SG_ ShldKeyDoorHndlReqVld : 333|1@0+ (1,0) [0|1] "NoUnit" Vector__XXX
 SG_ ShldKeyDoorHndlReq : 335|2@0+ (1,0) [0|3] "NoUnit" Vector__XXX
 SG_ OneclickClsIntellgntDrvgSts : 317|2@0+ (1,0) [0|3] "NoUnit" Vector__XXX
 SG_ RmtPrkRadShieldSts : 319|2@0+ (1,0) [0|3] "NoUnit" Vector__XXX
 SG_ APS_Coordinate_Y : 298|11@0+ (2,-2000) [-2000|2000] "cm" Vector__XXX
 SG_ APS_Coordinate_X : 291|9@0+ (4,-1000) [-1000|1000] "cm" Vector__XXX
 SG_ APS_Coordinate_Angle : 284|9@0+ (1,0) [0|359] "Deg" Vector__XXX
 SG_ RmtPrkgSts : 285|1@0+ (1,0) [0|1] "NoUnit" Vector__XXX
 SG_ RmtPrkgFinishReq : 287|2@0+ (1,0) [0|3] "NoUnit" Vector__XXX
 SG_ OrvmCtrlCmd : 273|2@0+ (1,0) [0|3] "NoUnit" Vector__XXX
 SG_ HAP_TextIconDispCtrl : 275|2@0+ (1,0) [0|3] "NoUnit" Vector__XXX
 SG_ APA_MenuDispCtrlCmd : 279|4@0+ (1,0) [0|15] "NoUnit" Vector__XXX
 SG_ FADS_FuncSts : 265|2@0+ (1,0) [0|3] "NoUnit" Vector__XXX
 SG_ RADS_FuncSts : 267|2@0+ (1,0) [0|3] "NoUnit" Vector__XXX
 SG_ APA_FuncSts : 271|2@0+ (1,0) [0|3] "NoUnit" Vector__XXX
 SG_ FPAS_NearBrrdstn : 242|7@0+ (1,0) [0|100] "NoUnit" Vector__XXX
 SG_ ModifInquiPopReq : 245|2@0+ (1,0) [0|3] "NoUnit" Vector__XXX
 SG_ FPAS_SoundIndcn : 247|2@0+ (1,0) [0|3] "NoUnit" Vector__XXX
 SG_ FPAS_AutoModSts : 232|1@0+ (1,0) [0|1] "NoUnit" Vector__XXX
 SG_ FPAS_DispCmd : 233|1@0+ (1,0) [0|1] "NoUnit" Vector__XXX
 SG_ FPAS_WorkSts : 235|2@0+ (1,0) [0|3] "NoUnit" Vector__XXX
 SG_ FPAS_FRCornrSnsrFailSts : 236|1@0+ (1,0) [0|1] "NoUnit" Vector__XXX
 SG_ FPAS_FRMiddlSnsrFailSts : 237|1@0+ (1,0) [0|1] "NoUnit" Vector__XXX
 SG_ FPAS_FLMiddlSnsrFailSts : 238|1@0+ (1,0) [0|1] "NoUnit" Vector__XXX
 SG_ FPAS_FLCornrSnsrFailSts : 239|1@0+ (1,0) [0|1] "NoUnit" Vector__XXX
 SG_ FPAS_ObjFRCornrAr2 : 227|4@0+ (1,0) [0|15] "NoUnit" Vector__XXX
 SG_ FPAS_ObjFRCornrAr1 : 231|4@0+ (1,0) [0|15] "NoUnit" Vector__XXX
 SG_ FPAS_ObjFRMidlAr2 : 219|4@0+ (1,0) [0|15] "NoUnit" Vector__XXX
 SG_ FPAS_ObjFRMidlAr1 : 223|4@0+ (1,0) [0|15] "NoUnit" Vector__XXX
 SG_ FPAS_ObjFLMidlAr2 : 211|4@0+ (1,0) [0|15] "NoUnit" Vector__XXX
 SG_ FPAS_ObjFLMidlAr1 : 215|4@0+ (1,0) [0|15] "NoUnit" Vector__XXX
 SG_ FPAS_ObjFLCornrAr2 : 203|4@0+ (1,0) [0|15] "NoUnit" Vector__XXX
 SG_ FPAS_ObjFLCornrAr1 : 207|4@0+ (1,0) [0|15] "NoUnit" Vector__XXX
 SG_ RCTA_DispSwtSts : 176|1@0+ (1,0) [0|1] "NoUnit" Vector__XXX
 SG_ AutoPrkOutSwtSts : 177|1@0+ (1,0) [0|1] "NoUnit" Vector__XXX
 SG_ MEB_EnableSts : 178|1@0+ (1,0) [0|1] "NoUnit" Vector__XXX
 SG_ MEBWorkSts : 180|2@0+ (1,0) [0|3] "NoUnit" Vector__XXX
 SG_ RPAS_SoundIndcn : 183|2@0+ (1,0) [0|3] "NoUnit" Vector__XXX
 SG_ CamFolwSwtSts : 168|1@0+ (1,0) [0|1] "NoUnit" Vector__XXX
 SG_ APA_BacgrdWorkSts : 169|1@0+ (1,0) [0|1] "NoUnit" Vector__XXX
 SG_ RPAS_WorkSts : 171|2@0+ (1,0) [0|3] "NoUnit" Vector__XXX
 SG_ RPAS_RRCornrSnsrFailSts : 172|1@0+ (1,0) [0|1] "NoUnit" Vector__XXX
 SG_ RPAS_RRMiddlSnsrFailSts : 173|1@0+ (1,0) [0|1] "NoUnit" Vector__XXX
 SG_ RPAS_RLMiddlSnsrFailSts : 174|1@0+ (1,0) [0|1] "NoUnit" Vector__XXX
 SG_ RPAS_RLCornrSnsrFailSts : 175|1@0+ (1,0) [0|1] "NoUnit" Vector__XXX
 SG_ RPAS_ObjRLCornrAr2 : 163|4@0+ (1,0) [0|15] "NoUnit" Vector__XXX
 SG_ RPAS_ObjRLCornrAr1 : 167|4@0+ (1,0) [0|15] "NoUnit" Vector__XXX
 SG_ RPAS_ObjRLMidlAr2 : 155|4@0+ (1,0) [0|15] "NoUnit" Vector__XXX
 SG_ RPAS_ObjRLMidlAr1 : 159|4@0+ (1,0) [0|15] "NoUnit" Vector__XXX
 SG_ RPAS_ObjRRMidlAr2 : 147|4@0+ (1,0) [0|15] "NoUnit" Vector__XXX
 SG_ RPAS_ObjRRMidlAr1 : 151|4@0+ (1,0) [0|15] "NoUnit" Vector__XXX
 SG_ RPAS_ObjRRCornrAr2 : 139|4@0+ (1,0) [0|15] "NoUnit" Vector__XXX
 SG_ RPAS_ObjRRCornrAr1 : 143|4@0+ (1,0) [0|15] "NoUnit" Vector__XXX
 SG_ OneclickClsIntellgntDrvgTextDisp : 127|2@0+ (1,0) [0|3] "NoUnit" Vector__XXX
 SG_ SDWActiveSts : 112|1@0+ (1,0) [0|1] "NoUnit" Vector__XXX
 SG_ SDW_SoundIndcn : 115|2@0+ (1,0) [0|3] "NoUnit" Vector__XXX
 SG_ APS_RLSideSnsrFailSts : 116|1@0+ (1,0) [0|1] "NoUnit" Vector__XXX
 SG_ APS_RRSideSnsrFailSts : 117|1@0+ (1,0) [0|1] "NoUnit" Vector__XXX
 SG_ APS_FLSideSnsrFailSts : 118|1@0+ (1,0) [0|1] "NoUnit" Vector__XXX
 SG_ APS_FRSideSnsrFailSts : 119|1@0+ (1,0) [0|1] "NoUnit" Vector__XXX
 SG_ APS_ObjLeSideAr5 : 107|4@0+ (1,0) [0|15] "NoUnit" Vector__XXX
 SG_ APS_ObjLeSideAr4 : 111|4@0+ (1,0) [0|15] "NoUnit" Vector__XXX
 SG_ APS_ObjLeSideAr3 : 99|4@0+ (1,0) [0|15] "NoUnit" Vector__XXX
 SG_ APS_ObjLeSideAr2 : 103|4@0+ (1,0) [0|15] "NoUnit" Vector__XXX
 SG_ APS_ObjLeSideAr1 : 91|4@0+ (1,0) [0|15] "NoUnit" Vector__XXX
 SG_ APS_ObjRiSideAr5 : 95|4@0+ (1,0) [0|15] "NoUnit" Vector__XXX
 SG_ APS_ObjRiSideAr4 : 83|4@0+ (1,0) [0|15] "NoUnit" Vector__XXX
 SG_ APS_ObjRiSideAr3 : 87|4@0+ (1,0) [0|15] "NoUnit" Vector__XXX
 SG_ APS_ObjRiSideAr2 : 75|4@0+ (1,0) [0|15] "NoUnit" Vector__XXX
 SG_ APS_ObjRiSideAr1 : 79|4@0+ (1,0) [0|15] "NoUnit" Vector__XXX
 SG_ AntiMsstpngObstclDetnFailSts : 44|3@0+ (1,0) [0|7] "NoUnit" Vector__XXX
 SG_ ObstclDetnFailSts : 47|3@0+ (1,0) [0|7] "NoUnit" Vector__XXX
 SG_ ResTraDistanceOfCurTra : 38|7@0+ (0.1,0) [0|10] "m" Vector__XXX
 SG_ P2P_ProcBar : 31|7@0+ (1,0) [0|100] "NoUnit" Vector__XXX
 SG_ HAVP_ProcRa : 23|7@0+ (1,0) [0|100] "NoUnit" Vector__XXX
 SG_ RPAS_NearBrrdstn : 15|8@0+ (1,0) [0|150] "NoUnit" Vector__XXX

BO_ 667 HAP_FD7: 64 ADC10
 SG_ HAVP_LrngDst : 375|10@0+ (1,0) [0|1000] "m" Vector__XXX
 SG_ PAVP_ScFail_info : 367|5@0+ (1,0) [0|31] "NoUnit" Vector__XXX
 SG_ HAVP_ScFail_info : 351|5@0+ (1,0) [0|31] "NoUnit" Vector__XXX
 SG_ UnPrkgSpaReasons : 341|6@0+ (1,0) [0|63] "NoUnit" Vector__XXX

BO_ 299 IFC_FD1: 64 ADC10
 SG_ MAC_Check_IFC_FD1 : 471|48@0+ (1,0) [0|281474976710655] "NoUnit" Vector__XXX
 SG_ FreshnessValue_IFC_FD1 : 455|16@0+ (1,0) [0|65535] "NoUnit" Vector__XXX
 SG_ LCP_State : 231|3@0+ (1,0) [0|7] "NoUnit" Vector__XXX
 SG_ NavOptSpdLim : 222|5@0+ (1,0) [0|31] "NoUnit" Vector__XXX
 SG_ VisOptSpdLim : 211|5@0+ (1,0) [0|31] "NoUnit" Vector__XXX
 SG_ LKA_State : 214|3@0+ (1,0) [0|7] "NoUnit" Vector__XXX
 SG_ LDW_State : 201|3@0+ (1,0) [0|7] "NoUnit" Vector__XXX
 SG_ AES_State : 204|3@0+ (1,0) [0|7] "NoUnit" Vector__XXX
 SG_ ESS_State : 207|3@0+ (1,0) [0|7] "NoUnit" Vector__XXX
 SG_ RollingCounter_IFC2 : 187|4@0+ (1,0) [0|14] "NoUnit" Vector__XXX
 SG_ StrgTrqCoeff : 182|7@0+ (0.01,-0.01) [0|1] "NoUnit" Vector__XXX
 SG_ IFCFuncAngCmdReqFlag : 175|3@0+ (1,0) [0|7] "NoUnit" Vector__XXX
 SG_ IFCAngCmdReqProtnValue : 159|14@0+ (1,0) [0|16383] "NoUnit" Vector__XXX
 SG_ IFCAngCmdReqValue : 143|14@0+ (0.1,-780) [-780|780] "Deg" Vector__XXX
 SG_ Checksum_IFC2 : 135|8@0+ (1,0) [0|255] "NoUnit" Vector__XXX
 SG_ RollingCounter_IFC1 : 123|4@0+ (1,0) [0|14] "NoUnit" Vector__XXX
 SG_ IFCFuncTrqCmdReqFlag : 127|3@0+ (1,0) [0|7] "NoUnit" Vector__XXX
 SG_ IFCVibrationWarning : 105|2@0+ (1,0) [0|3] "NoUnit" Vector__XXX
 SG_ DrvgRWSAngReqVld : 108|1@0+ (1,0) [0|1] "NoUnit" Vector__XXX
 SG_ IFCTrqOvlCmdReqValue : 103|11@0+ (0.01,-10.23) [-10.23|10.24] "Nm" Vector__XXX
 SG_ DrvgRWSAngReq : 95|8@0+ (0.1,-10.1) [-10|10] "Deg" Vector__XXX
 SG_ DrvgRWSModReq : 81|2@0+ (1,0) [0|3] "NoUnit" Vector__XXX
 SG_ IFCTrqOvlCmdProtnValue : 79|14@0+ (1,0) [0|16383] "NoUnit" Vector__XXX
 SG_ Checksum_IFC1 : 71|8@0+ (1,0) [0|255] "NoUnit" Vector__XXX

BO_ 323 ACC_FD1: 64 ADC10
 SG_ MAC_Check_ACC_FD1 : 471|48@0+ (1,0) [0|281474976710655] "NoUnit" Vector__XXX
 SG_ FreshnessValue_ACC_FD1 : 455|16@0+ (1,0) [0|65535] "NoUnit" Vector__XXX
 SG_ RollingCounter_ACC14 : 379|4@0+ (1,0) [0|14] "NoUnit" Vector__XXX
 SG_ VehRollRate : 367|16@0+ (0.01,-300.01) [-300|300] "DegPerSec" Vector__XXX
 SG_ VehPitchRate : 351|16@0+ (0.01,-300.01) [-300|300] "DegPerSec" Vector__XXX
 SG_ InrlMeasUnitFailrSts : 337|2@0+ (1,0) [0|3] "NoUnit" Vector__XXX
 SG_ VehVerAccel : 335|14@0+ (0.01,-80.01) [-80|80] "MtrPerSecSq" Vector__XXX
 SG_ Checksum_ACC14 : 327|8@0+ (1,0) [0|255] "NoUnit" Vector__XXX
 SG_ RollingCounter_ACC12 : 315|4@0+ (1,0) [0|14] "NoUnit" Vector__XXX
 SG_ DrvgPrkgFuncActvnSts : 308|2@0+ (1,0) [0|3] "NoUnit" Vector__XXX
 SG_ FxTgtGearEna : 310|2@0+ (1,0) [0|3] "NoUnit" Vector__XXX
 SG_ FxTgtGearReqVld : 311|1@0+ (1,0) [0|1] "NoUnit" Vector__XXX
 SG_ TotRefTrq : 295|16@0+ (1,-32769) [-32768|32766] "Nm" Vector__XXX
 SG_ FxTgtGearReq : 282|3@0+ (1,0) [0|7] "NoUnit" Vector__XXX
 SG_ FxTgtTrqMod : 284|2@0+ (1,0) [0|3] "NoUnit" Vector__XXX
 SG_ FxTgtTrqEna : 286|2@0+ (1,0) [0|3] "NoUnit" Vector__XXX
 SG_ FxTgtTrqVld : 287|1@0+ (1,0) [0|1] "NoUnit" Vector__XXX
 SG_ FxTgtTrq : 271|16@0+ (1,-32769) [-32768|32766] "Nm" Vector__XXX
 SG_ Checksum_ACC12 : 263|8@0+ (1,0) [0|255] "NoUnit" Vector__XXX
 SG_ RollingCounter_ACC10 : 251|4@0+ (1,0) [0|14] "NoUnit" Vector__XXX
 SG_ Longctrl_WheelTrqReqActive : 239|1@0+ (1,0) [0|1] "NoUnit" Vector__XXX
 SG_ Longctrl_WheelTrqReq : 223|16@0+ (0.5,-16384) [-16384|16383.5] "Nm" Vector__XXX
 SG_ Checksum_ACC10 : 199|8@0+ (1,0) [0|255] "NoUnit" Vector__XXX
 SG_ RollingCounter_ACC2 : 187|4@0+ (1,0) [0|14] "NoUnit" Vector__XXX
 SG_ ACC_CRInterface : 191|1@0+ (1,0) [0|1] "NoUnit" Vector__XXX
 SG_ IDC_L2_HADFuncCmdReqFlag : 163|3@0+ (1,0) [0|7] "NoUnit" Vector__XXX
 SG_ Checksum_ACC2 : 135|8@0+ (1,0) [0|255] "NoUnit" Vector__XXX
 SG_ RollingCounter_ACC1 : 123|4@0+ (1,0) [0|14] "NoUnit" Vector__XXX
 SG_ ActualTargetSpeed : 119|8@0+ (1,0) [0|254] "kph" Vector__XXX
 SG_ Longctrl_Decel_ReqValue : 111|8@0+ (0.05,-7) [-7|5.75] "MtrPerSecSq" Vector__XXX
 SG_ InterceptionDmd : 96|1@0+ (1,0) [0|1] "NoUnit" Vector__XXX
 SG_ Longctrl_ParkShiftReq : 99|2@0+ (1,0) [0|3] "NoUnit" Vector__XXX
 SG_ Longctrl_DecelToStopReq : 101|1@0+ (1,0) [0|1] "NoUnit" Vector__XXX
 SG_ Longctrl_Decel_Req : 72|1@0+ (1,0) [0|1] "NoUnit" Vector__XXX
 SG_ Longctrl_ModSts : 77|4@0+ (1,0) [0|15] "NoUnit" Vector__XXX
 SG_ Longctrl_DrvOFF_Req : 78|1@0+ (1,0) [0|1] "NoUnit" Vector__XXX
 SG_ Longctrl_VehHldReq : 79|1@0+ (1,0) [0|1] "NoUnit" Vector__XXX
 SG_ Checksum_ACC1 : 71|8@0+ (1,0) [0|255] "NoUnit" Vector__XXX
 SG_ RollingCounter_ACC11 : 59|4@0+ (1,0) [0|14] "NoUnit" Vector__XXX
 SG_ Longctrl_AccelOvrdActnReq : 49|1@0+ (1,0) [0|1] "NoUnit" Vector__XXX
 SG_ Longctrl_TgtGearReqVld : 12|1@0+ (1,0) [0|1] "NoUnit" Vector__XXX
 SG_ Longctrl_TgtGearReq : 15|3@0+ (1,0) [0|7] "NoUnit" Vector__XXX
 SG_ Checksum_ACC11 : 7|8@0+ (1,0) [0|255] "NoUnit" Vector__XXX

BO_ 395 AEB_FD1: 64 ADC10
 SG_ RAEB_Warn : 413|3@0+ (1,0) [0|7] "NoUnit" Vector__XXX
 SG_ RAEB_State : 400|3@0+ (1,0) [0|7] "NoUnit" Vector__XXX
 SG_ EBA_State : 403|3@0+ (1,0) [0|7] "NoUnit" Vector__XXX
 SG_ AEB_State : 406|3@0+ (1,0) [0|7] "NoUnit" Vector__XXX
 SG_ AWB_State : 393|3@0+ (1,0) [0|7] "NoUnit" Vector__XXX
 SG_ FCW_State : 396|3@0+ (1,0) [0|7] "NoUnit" Vector__XXX
 SG_ DW_State : 399|3@0+ (1,0) [0|7] "NoUnit" Vector__XXX
 SG_ RollingCounter_AEB6 : 187|4@0+ (1,0) [0|14] "NoUnit" Vector__XXX
 SG_ ExcpADASBrkgHldReq : 173|2@0+ (1,0) [0|3] "NoUnit" Vector__XXX
 SG_ DrvPrsnt : 175|2@0+ (1,0) [0|3] "NoUnit" Vector__XXX
 SG_ BrkgHldReq : 161|2@0+ (1,0) [0|3] "NoUnit" Vector__XXX
 SG_ BrkgSwtReq : 163|2@0+ (1,0) [0|3] "NoUnit" Vector__XXX
 SG_ EPBModEna : 165|2@0+ (1,0) [0|3] "NoUnit" Vector__XXX
 SG_ EPBModReq : 167|2@0+ (1,0) [0|3] "NoUnit" Vector__XXX
 SG_ EPBModReqVld : 152|1@0+ (1,0) [0|1] "NoUnit" Vector__XXX
 SG_ BrkgTgtTyp : 154|2@0+ (1,0) [0|3] "NoUnit" Vector__XXX
 SG_ BrkgTgtTrqMod : 156|2@0+ (1,0) [0|3] "NoUnit" Vector__XXX
 SG_ BrkgTgtTrqEna : 158|2@0+ (1,0) [0|3] "NoUnit" Vector__XXX
 SG_ BrkgTgtTrqVld : 159|1@0+ (1,0) [0|1] "NoUnit" Vector__XXX
 SG_ BrkgTgtTrq : 143|16@0+ (1,-1) [0|65534] "Nm" Vector__XXX
 SG_ Checksum_AEB6 : 135|8@0+ (1,0) [0|255] "NoUnit" Vector__XXX
 SG_ RollingCounter_AEB1 : 123|4@0+ (1,0) [0|14] "NoUnit" Vector__XXX
 SG_ IntellgntAsscRoadTyp : 119|4@0+ (1,0) [0|15] "" Vector__XXX
 SG_ AEB_ObjSty : 111|3@0+ (1,0) [0|7] "NoUnit" Vector__XXX
 SG_ AEB_BrkReqFunc : 99|3@0+ (1,0) [0|7] "NoUnit" Vector__XXX
 SG_ AEB_AWB_Level : 103|4@0+ (1,0) [0|15] "NoUnit" Vector__XXX
 SG_ AEB_TgtDecel_ReqValue : 87|16@0+ (0.000488,-16) [-16|15.980592] "MtrPerSecSq" Vector__XXX
 SG_ AEB_ABP_Req : 72|1@0+ (1,0) [0|1] "NoUnit" Vector__XXX
 SG_ AEB_AWB_Req : 73|1@0+ (1,0) [0|1] "NoUnit" Vector__XXX
 SG_ AEB_TgtDecel_Req : 74|1@0+ (1,0) [0|1] "NoUnit" Vector__XXX
 SG_ AEB_VehHldReq : 75|1@0+ (1,0) [0|1] "NoUnit" Vector__XXX
 SG_ EBA_TgtDecel_Req : 76|1@0+ (1,0) [0|1] "NoUnit" Vector__XXX
 SG_ AEB_ABA_Req : 77|1@0+ (1,0) [0|1] "NoUnit" Vector__XXX
 SG_ AEB_ABA_Level : 79|2@0+ (1,0) [0|3] "NoUnit" Vector__XXX
 SG_ Checksum_AEB1 : 71|8@0+ (1,0) [0|255] "NoUnit" Vector__XXX
 SG_ AEB_Flag_VSI : 60|1@0+ (1,0) [0|1] "NoUnit" Vector__XXX
 SG_ ADAS_ErrSts : 31|3@0+ (1,0) [0|7] "NoUnit" Vector__XXX
 SG_ RelTgtObjVel_X : 23|8@0+ (0.167,0) [0|42] "mps" Vector__XXX
 SG_ TimeToCllsn : 15|8@0+ (0.004,0) [0|1] "s" Vector__XXX

BO_ 415 IFC_FD5: 64 ADC10
 SG_ IFC_Line_special02_CurvChange : 431|20@0+ (5E-008,-0.024) [-0.024|0.024] "PerMtrSq" Vector__XXX
 SG_ ACC_RiTgtObjBarDisp_03 : 418|3@0+ (1,0) [0|7] "NoUnit" Vector__XXX
 SG_ TargetPathC0 : 415|13@0+ (0.01,-30) [-30|30.01] "m" Vector__XXX
 SG_ TargetPathC2 : 399|15@0+ (1.6E-005,-0.25) [-0.25|0.25] "PerMtr" Vector__XXX
 SG_ IFC_Roadedge02_Type : 383|4@0+ (1,0) [0|15] "NoUnit" Vector__XXX
 SG_ IFC_Roadedge02_CurvChange : 355|20@0+ (5E-008,-0.024) [-0.024|0.024] "PerMtrSq" Vector__XXX
 SG_ IFC_Roadedge02_Curv : 338|15@0+ (1.6E-005,-0.25) [-0.25|0.25] "PerMtr" Vector__XXX
 SG_ IFC_Roadedge02_Dy : 335|13@0+ (0.01,-30) [-30|30] "m" Vector__XXX
 SG_ IFC_Roadedge01_Type : 319|4@0+ (1,0) [0|15] "NoUnit" Vector__XXX
 SG_ IFC_Roadedge01_CurvChange : 291|20@0+ (5E-008,-0.024) [-0.024|0.024] "PerMtrSq" Vector__XXX
 SG_ IFC_Roadedge01_Curv : 274|15@0+ (1.6E-005,-0.25) [-0.25|0.25] "PerMtr" Vector__XXX
 SG_ IFC_Roadedge01_Dy : 271|13@0+ (0.01,-30) [-30|30] "m" Vector__XXX
 SG_ IFC_Line04_Type : 255|4@0+ (1,0) [0|15] "NoUnit" Vector__XXX
 SG_ IFC_Line04_CurvChange : 227|20@0+ (5E-008,-0.024) [-0.024|0.024] "PerMtrSq" Vector__XXX
 SG_ IFC_Line04_Curv : 210|15@0+ (1.6E-005,-0.25) [-0.25|0.25] "PerMtr" Vector__XXX
 SG_ IFC_Line04_Dy : 207|13@0+ (0.01,-30) [-30|30] "m" Vector__XXX
 SG_ IFC_Line03_Type : 191|4@0+ (1,0) [0|15] "NoUnit" Vector__XXX
 SG_ IFC_Line03_CurvChange : 163|20@0+ (5E-008,-0.024) [-0.024|0.024] "PerMtrSq" Vector__XXX
 SG_ IFC_Line03_Curv : 146|15@0+ (1.6E-005,-0.25) [-0.25|0.25] "PerMtr" Vector__XXX
 SG_ IFC_Line03_Dy : 143|13@0+ (0.01,-30) [-30|30] "m" Vector__XXX
 SG_ IFC_Line02_Type : 127|4@0+ (1,0) [0|15] "NoUnit" Vector__XXX
 SG_ IFC_Line02_CurvChange : 99|20@0+ (5E-008,-0.024) [-0.024|0.024] "PerMtrSq" Vector__XXX
 SG_ IFC_Line02_Curv : 82|15@0+ (1.6E-005,-0.25) [-0.25|0.25] "PerMtr" Vector__XXX
 SG_ IFC_Line02_Dy : 79|13@0+ (0.01,-30) [-30|30] "m" Vector__XXX
 SG_ IFC_Line01_Type : 63|4@0+ (1,0) [0|15] "NoUnit" Vector__XXX
 SG_ IFC_Line01_CurvChange : 35|20@0+ (5E-008,-0.024) [-0.024|0.024] "PerMtrSq" Vector__XXX
 SG_ IFC_Line01_Curv : 18|15@0+ (1.6E-005,-0.25) [-0.25|0.25] "PerMtr" Vector__XXX
 SG_ IFC_Line01_Dy : 15|13@0+ (0.01,-30) [-30|30] "m" Vector__XXX

BO_ 546 IFC_FD6: 64 ADC10
 SG_ RollingCounter_IFC_HCM9 : 443|4@0+ (1,0) [0|14] "NoUnit" Vector__XXX
 SG_ IFC_Line_special02_DxEnd : 430|15@0+ (0.01,0) [0|200.01] "m" Vector__XXX
 SG_ IFC_Line_special02_DxStart : 415|15@0+ (0.01,0) [0|200.01] "m" Vector__XXX
 SG_ TargetPositionDx : 393|9@0+ (0.5,0) [0|250] "m" Vector__XXX
 SG_ CameraSts : 395|2@0+ (1,0) [0|3] "NoUnit" Vector__XXX
 SG_ TrafficStyle : 397|2@0+ (1,0) [0|3] "NoUnit" Vector__XXX
 SG_ RoadIllumDetd : 398|1@0+ (1,0) [0|1] "NoUnit" Vector__XXX
 SG_ AmbLight : 399|1@0+ (1,0) [0|1] "NoUnit" Vector__XXX
 SG_ Checksum_IFC_HCM9 : 391|8@0+ (1,0) [0|255] "NoUnit" Vector__XXX
 SG_ RollingCounter_IFC_HCM8 : 379|4@0+ (1,0) [0|14] "NoUnit" Vector__XXX
 SG_ Spots8VehObjClassn : 382|3@0+ (1,0) [0|7] "NoUnit" Vector__XXX
 SG_ Spots8TrackingInfo : 383|1@0+ (1,0) [0|1] "NoUnit" Vector__XXX
 SG_ Spot8VertAng : 375|8@0+ (0.125,-5) [-5|26.875] "NoUnit" Vector__XXX
 SG_ Spots8HozLeAngSpd : 367|8@0+ (0.125,-16) [-16|15.875] "DegPerSec" Vector__XXX
 SG_ Spots8Distance : 344|9@0+ (1,0) [0|510] "m" Vector__XXX
 SG_ Spots8Typ : 346|2@0+ (1,0) [0|3] "NoUnit" Vector__XXX
 SG_ Spots8Valid : 347|1@0+ (1,0) [0|1] "NoUnit" Vector__XXX
 SG_ Spots8HozlPosnRiAng : 341|10@0+ (0.08,-40) [-40|40] "Deg" Vector__XXX
 SG_ Spots8HozlPosnLeAng : 335|10@0+ (0.08,-40) [-40|40] "Deg" Vector__XXX
 SG_ Checksum_IFC_HCM8 : 327|8@0+ (1,0) [0|255] "NoUnit" Vector__XXX
 SG_ IFC_Roadedge02_HeadingAngle : 296|9@0+ (0.01,-2) [-2|2] "rad" Vector__XXX
 SG_ IFC_Roadedge02_DxEnd : 295|15@0+ (0.01,0) [0|200] "m" Vector__XXX
 SG_ IFC_Roadedge02_DxStart : 278|15@0+ (0.01,0) [0|200] "m" Vector__XXX
 SG_ IFC_Roadedge01_HeadingAngle : 271|9@0+ (0.01,-2) [-2|2] "rad" Vector__XXX
 SG_ IFC_Roadedge01_DxEnd : 239|15@0+ (0.01,0) [0|200] "m" Vector__XXX
 SG_ IFC_Roadedge01_DxStart : 223|15@0+ (0.01,0) [0|200] "m" Vector__XXX
 SG_ IFC_Line04_DxEnd : 207|15@0+ (0.01,0) [0|200] "m" Vector__XXX
 SG_ IFC_Line04_HeadingAngle : 168|9@0+ (0.01,-2) [-2|2] "rad" Vector__XXX
 SG_ IFC_Line04_DxStart : 167|15@0+ (0.01,0) [0|200] "m" Vector__XXX
 SG_ IFC_Line03_HeadingAngle : 144|9@0+ (0.01,-2) [-2|2] "rad" Vector__XXX
 SG_ IFC_Line03_DxEnd : 143|15@0+ (0.01,0) [0|200] "m" Vector__XXX
 SG_ IFC_Line03_DxStart : 111|15@0+ (0.01,0) [0|200] "m" Vector__XXX
 SG_ IFC_Line02_DxEnd : 95|15@0+ (0.01,0) [0|200] "m" Vector__XXX
 SG_ IFC_Line02_DxStart : 79|15@0+ (0.01,0) [0|200] "m" Vector__XXX
 SG_ IFC_Line02_HeadingAngle : 40|9@0+ (0.01,-2) [-2|2] "rad" Vector__XXX
 SG_ IFC_Line01_HeadingAngle : 33|9@0+ (0.01,-2) [-2|2] "rad" Vector__XXX
 SG_ IFC_Line01_DxEnd : 16|15@0+ (0.01,0) [0|200] "m" Vector__XXX
 SG_ IFC_Line01_DxStart : 15|15@0+ (0.01,0) [0|200] "m" Vector__XXX

BO_ 551 AEB_FD2: 64 ADC10
 SG_ MAC_Check_AEB_FD2 : 471|48@0+ (1,0) [0|281474976710655] "NoUnit" Vector__XXX
 SG_ FreshnessValue_AEB_FD2 : 455|16@0+ (1,0) [0|65535] "NoUnit" Vector__XXX
 SG_ RollingCounter_AEB5 : 379|4@0+ (1,0) [0|14] "NoUnit" Vector__XXX
 SG_ AEBObjDyActvSafety : 375|11@0+ (0.125,-128.125) [-128|127.75] "m" Vector__XXX
 SG_ AEBObjDxActvSafety : 355|12@0+ (0.0625,-0.0625) [0|255.875] "m" Vector__XXX
 SG_ AEBObjVxActvSafety : 351|12@0+ (0.0625,-128.0625) [-128|127] "mps" Vector__XXX
 SG_ TimeToCllsnActvSafety : 343|8@0+ (0.004,-0.004) [0|1] "s" Vector__XXX
 SG_ AEBTgtDecelReqActvSafety : 329|1@0+ (1,0) [0|1] "NoUnit" Vector__XXX
 SG_ ADAS_ErrStsActvSafety : 332|3@0+ (1,0) [0|7] "NoUnit" Vector__XXX
 SG_ AEBObjStyActvSafety : 335|3@0+ (1,0) [0|7] "NoUnit" Vector__XXX
 SG_ Checksum_AEB5 : 327|8@0+ (1,0) [0|255] "NoUnit" Vector__XXX
 SG_ FeatPt_Dx : 297|9@0+ (0.5,0) [0|150] "m" Vector__XXX
 SG_ ACC_RiTgt_03_Heading : 303|6@0+ (0.05,-1.5) [-1.5|1.5] "rad" Vector__XXX
 SG_ ACC_RiTgt_03_fusion : 291|1@0+ (1,0) [0|1] "NoUnit" Vector__XXX
 SG_ ACC_RiTgt_03_Typ : 294|3@0+ (1,0) [0|7] "NoUnit" Vector__XXX
 SG_ ACC_RiTgt_03_Dx : 287|9@0+ (0.5,-50) [-50|150] "m" Vector__XXX
 SG_ ACC_RiTgt_03_Dy : 279|8@0+ (0.1,-8) [-8|7] "m" Vector__XXX
 SG_ ACC_RiTargrt_03_Detn : 265|2@0+ (1,0) [0|3] "NoUnit" Vector__XXX
 SG_ ACC_LeTgt_03_Heading : 271|6@0+ (0.05,-1.5) [-1.5|1.5] "rad" Vector__XXX
 SG_ ACC_LeTgt_03_fusion : 252|1@0+ (1,0) [0|1] "NoUnit" Vector__XXX
 SG_ ACC_LeTgt_03_Typ : 255|3@0+ (1,0) [0|7] "NoUnit" Vector__XXX
 SG_ ACC_LeTgt_03_Dy : 247|8@0+ (0.1,-8) [-8|8] "m" Vector__XXX
 SG_ ACC_LeTargrt_03_Detn : 233|2@0+ (1,0) [0|3] "NoUnit" Vector__XXX
 SG_ ACC_PotentialTgt_02_Heading : 239|6@0+ (0.05,-1.5) [-1.5|1.5] "rad" Vector__XXX
 SG_ ACC_LeTgt_03_Dx : 216|9@0+ (0.5,-50) [-50|150] "m" Vector__XXX
 SG_ ACC_PotentialTgt_02_fusion : 217|1@0+ (1,0) [0|1] "NoUnit" Vector__XXX
 SG_ ACC_PotentialTgt_02_Typ : 220|3@0+ (1,0) [0|7] "NoUnit" Vector__XXX
 SG_ ACC_PotentialTgt_02_Detn : 222|2@0+ (1,0) [0|3] "NoUnit" Vector__XXX
 SG_ ACC_PotentialTgt_02_Dx : 215|9@0+ (0.5,0) [0|150] "m" Vector__XXX
 SG_ ACC_PotentialTgt_02_Dy : 207|8@0+ (0.1,-8) [-8|8] "m" Vector__XXX
 SG_ RiRoad_Mark_Length : 183|8@0+ (0.1,0) [0|10] "m" Vector__XXX
 SG_ RiRoad_Mark_Width : 175|8@0+ (0.1,0) [0|4] "m" Vector__XXX
 SG_ LeRoad_Mark_Length : 167|8@0+ (0.1,0) [0|10] "m" Vector__XXX
 SG_ AEB_JABrkTrig : 159|2@0+ (1,0) [0|3] "NoUnit" Vector__XXX
 SG_ AEB_JA_Warn : 145|2@0+ (1,0) [0|3] "NoUnit" Vector__XXX
 SG_ AEB_JAFuncSts : 147|2@0+ (1,0) [0|3] "NoUnit" Vector__XXX
 SG_ FCW_Warn : 149|2@0+ (1,0) [0|3] "NoUnit" Vector__XXX
 SG_ FCW_AEB_PedFctSts : 151|2@0+ (1,0) [0|3] "NoUnit" Vector__XXX
 SG_ FCW_AEB_VehFctSts : 138|2@0+ (1,0) [0|3] "NoUnit" Vector__XXX
 SG_ AEB_PedTrig : 142|1@0+ (1,0) [0|1] "NoUnit" Vector__XXX
 SG_ AEB_VehTrig : 143|1@0+ (1,0) [0|1] "NoUnit" Vector__XXX
 SG_ IntellgntAsscLmpReq : 127|2@0+ (1,0) [0|3] "NoUnit" Vector__XXX
 SG_ LeRoad_Mark_Width : 119|8@0+ (0.1,0) [0|4] "m" Vector__XXX
 SG_ Road_Mark_Length : 111|8@0+ (0.1,0) [0|10] "m" Vector__XXX
 SG_ Road_Mark_Width : 103|8@0+ (0.1,0) [0|4] "m" Vector__XXX
 SG_ TargetPositionDy : 84|13@0+ (0.01,-30) [-30|30.01] "m" Vector__XXX
 SG_ UNP_SwtResp : 85|1@0+ (1,0) [0|1] "NoUnit" Vector__XXX
 SG_ IntellgntcurveResp : 74|1@0+ (1,0) [0|1] "NoUnit" Vector__XXX
 SG_ AEB_JA_Resp : 75|1@0+ (1,0) [0|1] "NoUnit" Vector__XXX
 SG_ FCW_Snvty : 77|2@0+ (1,0) [0|3] "NoUnit" Vector__XXX
 SG_ AEB_VehResp : 78|1@0+ (1,0) [0|1] "NoUnit" Vector__XXX
 SG_ AEB_PedResp : 79|1@0+ (1,0) [0|1] "NoUnit" Vector__XXX
 SG_ FeatPt_Dy : 51|8@0+ (0.1,-8) [-8|8] "m" Vector__XXX
 SG_ TargetPathC3 : 39|20@0+ (5E-008,-0.024) [-0.024|0.024] "PerMtrSq" Vector__XXX
 SG_ IFC_Line_special02_Dy : 15|13@0+ (0.01,-30) [-30|30.01] "m" Vector__XXX

BO_ 573 IFC_FD2: 64 ADC10
 SG_ MAC_Check_IFC_FD2 : 471|48@0+ (1,0) [0|281474976710655] "NoUnit" Vector__XXX
 SG_ FreshnessValue_IFC_FD2 : 455|16@0+ (1,0) [0|65535] "NoUnit" Vector__XXX
 SG_ SceneModSts : 447|3@0+ (1,0) [0|7] "NoUnit" Vector__XXX
 SG_ IFC_Line_special02_Curv : 431|15@0+ (1.6E-005,-0.25) [-0.25|0.25] "PerMtr" Vector__XXX
 SG_ IFC_Line_special01_DxEnd : 414|15@0+ (0.01,0) [0|200.01] "m" Vector__XXX
 SG_ IFC_Line_special01_DxStart : 399|15@0+ (0.01,0) [0|200.01] "m" Vector__XXX
 SG_ ACC_LeTgtObjBarDisp_03 : 383|3@0+ (1,0) [0|7] "NoUnit" Vector__XXX
 SG_ TargetPathC1 : 360|9@0+ (0.01,-2) [-2|2.01] "rad" Vector__XXX
 SG_ ACC_RiTgtObjBarDisp_02 : 363|3@0+ (1,0) [0|7] "NoUnit" Vector__XXX
 SG_ IFC_Line_special01_CurvChange : 351|20@0+ (5E-008,-0.024) [-0.024|0.024] "PerMtrSq" Vector__XXX
 SG_ IFC_Line_special01_Curv : 335|15@0+ (1.6E-005,-0.25) [-0.25|0.25] "PerMtr" Vector__XXX
 SG_ ACC_LeTgtObjBarDisp_02 : 318|3@0+ (1,0) [0|7] "NoUnit" Vector__XXX
 SG_ SidePrkgSts : 304|2@0+ (1,0) [0|3] "NoUnit" Vector__XXX
 SG_ HandsoffModSts : 306|2@0+ (1,0) [0|3] "NoUnit" Vector__XXX
 SG_ HandsoffTimSts : 308|2@0+ (1,0) [0|3] "NoUnit" Vector__XXX
 SG_ ACC_TgtObjBarDisp_03 : 311|3@0+ (1,0) [0|7] "NoUnit" Vector__XXX
 SG_ ACC_TgtObjBarDisp_02 : 298|3@0+ (1,0) [0|7] "NoUnit" Vector__XXX
 SG_ IFC_Line_special01_Dy : 295|13@0+ (0.01,-30) [-30|30.01] "m" Vector__XXX
 SG_ IFC_NextRiLane_dy : 275|12@0+ (0.00390625,-8) [-8|7.9921875] "NoUnit" Vector__XXX
 SG_ IFC_NextLeLane_dy : 271|12@0+ (0.00390625,-8) [-8|7.9921875] "NoUnit" Vector__XXX
 SG_ SmarFrontviewcamSts : 255|3@0+ (1,0) [0|7] "NoUnit" Vector__XXX
 SG_ IFC_RiLane_dy : 235|12@0+ (0.00390625,-8) [-8|7.9921875] "NoUnit" Vector__XXX
 SG_ IFC_LeLane_dy : 231|12@0+ (0.00390625,-8) [-8|7.9921875] "NoUnit" Vector__XXX
 SG_ IFC_NextRiLaneTyp : 218|3@0+ (1,0) [0|7] "NoUnit" Vector__XXX
 SG_ IFC_NextLeLaneTyp : 221|3@0+ (1,0) [0|7] "NoUnit" Vector__XXX
 SG_ IFC_RiLaneTyp : 208|3@0+ (1,0) [0|7] "NoUnit" Vector__XXX
 SG_ IFC_LeLaneTyp : 211|3@0+ (1,0) [0|7] "NoUnit" Vector__XXX
 SG_ IFC_LaneCurve : 207|12@0+ (1.5E-005,-0.030705) [-0.030705|0.030705] "NoUnit" Vector__XXX
 SG_ ESSintervention : 189|2@0+ (1,0) [0|3] "NoUnit" Vector__XXX
 SG_ AESintervention : 191|2@0+ (1,0) [0|3] "NoUnit" Vector__XXX
 SG_ IFC_Line_special02_Type : 179|4@0+ (1,0) [0|15] "NoUnit" Vector__XXX
 SG_ IFC_Line_special01_Type : 183|4@0+ (1,0) [0|15] "NoUnit" Vector__XXX
 SG_ IFC_Line_special02_HeadingAngle : 161|9@0+ (0.01,-2) [-2|2.01] "rad" Vector__XXX
 SG_ LCKStsIndcr : 163|2@0+ (1,0) [0|3] "NoUnit" Vector__XXX
 SG_ IntelligentEvaActSts : 165|2@0+ (1,0) [0|3] "NoUnit" Vector__XXX
 SG_ ELKActSts : 167|2@0+ (1,0) [0|3] "NoUnit" Vector__XXX
 SG_ CameraBlockageSts : 152|1@0+ (1,0) [0|1] "NoUnit" Vector__XXX
 SG_ IFCCalibrationSts : 154|2@0+ (1,0) [0|3] "NoUnit" Vector__XXX
 SG_ IFC_Handsoffwarn : 157|3@0+ (1,0) [0|7] "NoUnit" Vector__XXX
 SG_ LSSErrSts : 144|3@0+ (1,0) [0|7] "NoUnit" Vector__XXX
 SG_ TJA_FollowSts : 146|2@0+ (1,0) [0|3] "NoUnit" Vector__XXX
 SG_ LaneAvailability : 148|2@0+ (1,0) [0|3] "NoUnit" Vector__XXX
 SG_ ELKMainState : 151|3@0+ (1,0) [0|7] "NoUnit" Vector__XXX
 SG_ LSSFuncSts : 138|3@0+ (1,0) [0|7] "NoUnit" Vector__XXX
 SG_ LSSIntervention : 141|3@0+ (1,0) [0|7] "NoUnit" Vector__XXX
 SG_ LDW_LKAWarn : 143|2@0+ (1,0) [0|3] "NoUnit" Vector__XXX
 SG_ LCP_Warn : 125|2@0+ (1,0) [0|3] "NoUnit" Vector__XXX
 SG_ IFC_Line_special01_HeadingAngle : 118|9@0+ (0.01,-2) [-2|2.01] "rad" Vector__XXX
 SG_ RiRoad_Mark_Dy : 110|8@0+ (0.1,-8) [-8|8] "m" Vector__XXX
 SG_ RiRoad_Mark_Dx : 103|9@0+ (0.5,0) [0|150] "m" Vector__XXX
 SG_ RiRoad_Mark_Typ : 91|4@0+ (1,0) [0|15] "NoUnit" Vector__XXX
 SG_ ESSErrSts : 92|1@0+ (1,0) [0|1] "NoUnit" Vector__XXX
 SG_ AESErrSts : 93|1@0+ (1,0) [0|1] "NoUnit" Vector__XXX
 SG_ ESSSts : 95|2@0+ (1,0) [0|3] "NoUnit" Vector__XXX
 SG_ AESSts : 81|2@0+ (1,0) [0|3] "NoUnit" Vector__XXX
 SG_ IntelligentEvaResp : 82|1@0+ (1,0) [0|1] "NoUnit" Vector__XXX
 SG_ LSSResp : 83|1@0+ (1,0) [0|1] "NoUnit" Vector__XXX
 SG_ LSSWarnFormResp : 85|2@0+ (1,0) [0|3] "NoUnit" Vector__XXX
 SG_ ESS_VehResp : 86|1@0+ (1,0) [0|1] "NoUnit" Vector__XXX
 SG_ ESS_PedResp : 87|1@0+ (1,0) [0|1] "NoUnit" Vector__XXX
 SG_ IFCHUTInterface : 72|1@0+ (1,0) [0|1] "NoUnit" Vector__XXX
 SG_ LDW_LKA_Snvty : 74|2@0+ (1,0) [0|3] "NoUnit" Vector__XXX
 SG_ AESResp : 75|1@0+ (1,0) [0|1] "NoUnit" Vector__XXX
 SG_ ELKResp : 76|1@0+ (1,0) [0|1] "NoUnit" Vector__XXX
 SG_ LCKResp : 77|1@0+ (1,0) [0|1] "NoUnit" Vector__XXX
 SG_ LKAResp : 78|1@0+ (1,0) [0|1] "NoUnit" Vector__XXX
 SG_ LDWResp : 79|1@0+ (1,0) [0|1] "NoUnit" Vector__XXX
 SG_ LeRoad_Mark_Typ : 63|4@0+ (1,0) [0|15] "NoUnit" Vector__XXX
 SG_ LeRoad_Mark_Dy : 55|8@0+ (0.1,-8) [-8|8] "m" Vector__XXX
 SG_ Road_Mark_Dy : 47|8@0+ (0.1,-8) [-8|8] "m" Vector__XXX
 SG_ LeRoad_Mark_Dx : 24|9@0+ (0.5,0) [0|150] "m" Vector__XXX
 SG_ Road_Mark_Dx : 17|9@0+ (0.5,0) [0|150] "m" Vector__XXX
 SG_ Road_Mark_Typ : 21|4@0+ (1,0) [0|15] "NoUnit" Vector__XXX
 SG_ HWA_Text_Lib : 11|6@0+ (1,0) [0|63] "NoUnit" Vector__XXX
 SG_ IFC_FeatPt_Type : 15|4@0+ (1,0) [0|15] "NoUnit" Vector__XXX

BO_ 576 IFC_FD4: 64 ADC10
 SG_ RollingCounter_IFC_HCM7 : 443|4@0+ (1,0) [0|14] "NoUnit" Vector__XXX
 SG_ Spots7VehObjClassn : 446|3@0+ (1,0) [0|7] "NoUnit" Vector__XXX
 SG_ Spots7TrackingInfo : 447|1@0+ (1,0) [0|1] "NoUnit" Vector__XXX
 SG_ Spot7VertAng : 439|8@0+ (0.125,-5) [-5|26.875] "NoUnit" Vector__XXX
 SG_ Spots7HozLeAngSpd : 431|8@0+ (0.125,-16) [-16|15.875] "DegPerSec" Vector__XXX
 SG_ Spots7Distance : 408|9@0+ (1,0) [0|510] "m" Vector__XXX
 SG_ Spots7Typ : 410|2@0+ (1,0) [0|3] "NoUnit" Vector__XXX
 SG_ Spots7Valid : 411|1@0+ (1,0) [0|1] "NoUnit" Vector__XXX
 SG_ Spots7HozlPosnRiAng : 405|10@0+ (0.08,-40) [-40|40] "Deg" Vector__XXX
 SG_ Spots7HozlPosnLeAng : 399|10@0+ (0.08,-40) [-40|40] "Deg" Vector__XXX
 SG_ Checksum_IFC_HCM7 : 391|8@0+ (1,0) [0|255] "NoUnit" Vector__XXX
 SG_ RollingCounter_IFC_HCM6 : 379|4@0+ (1,0) [0|14] "NoUnit" Vector__XXX
 SG_ Spots6VehObjClassn : 382|3@0+ (1,0) [0|7] "NoUnit" Vector__XXX
 SG_ Spots6TrackingInfo : 383|1@0+ (1,0) [0|1] "NoUnit" Vector__XXX
 SG_ Spot6VertAng : 375|8@0+ (0.125,-5) [-5|26.875] "NoUnit" Vector__XXX
 SG_ Spots6HozLeAngSpd : 367|8@0+ (0.125,-16) [-16|15.875] "DegPerSec" Vector__XXX
 SG_ Spots6Distance : 344|9@0+ (1,0) [0|510] "m" Vector__XXX
 SG_ Spots6Typ : 346|2@0+ (1,0) [0|3] "NoUnit" Vector__XXX
 SG_ Spots6Valid : 347|1@0+ (1,0) [0|1] "NoUnit" Vector__XXX
 SG_ Spots6HozlPosnRiAng : 341|10@0+ (0.08,-40) [-40|40] "Deg" Vector__XXX
 SG_ Spots6HozlPosnLeAng : 335|10@0+ (0.08,-40) [-40|40] "Deg" Vector__XXX
 SG_ Checksum_IFC_HCM6 : 327|8@0+ (1,0) [0|255] "NoUnit" Vector__XXX
 SG_ RollingCounter_IFC_HCM5 : 315|4@0+ (1,0) [0|14] "NoUnit" Vector__XXX
 SG_ Spots5VehObjClassn : 318|3@0+ (1,0) [0|7] "NoUnit" Vector__XXX
 SG_ Spots5TrackingInfo : 319|1@0+ (1,0) [0|1] "NoUnit" Vector__XXX
 SG_ Spot5VertAng : 311|8@0+ (0.125,-5) [-5|26.875] "NoUnit" Vector__XXX
 SG_ Spots5HozLeAngSpd : 303|8@0+ (0.125,-16) [-16|15.875] "DegPerSec" Vector__XXX
 SG_ Spots5Distance : 280|9@0+ (1,0) [0|510] "m" Vector__XXX
 SG_ Spots5Typ : 282|2@0+ (1,0) [0|3] "NoUnit" Vector__XXX
 SG_ Spots5Valid : 283|1@0+ (1,0) [0|1] "NoUnit" Vector__XXX
 SG_ Spots5HozlPosnRiAng : 277|10@0+ (0.08,-40) [-40|40] "Deg" Vector__XXX
 SG_ Spots5HozlPosnLeAng : 271|10@0+ (0.08,-40) [-40|40] "Deg" Vector__XXX
 SG_ Checksum_IFC_HCM5 : 263|8@0+ (1,0) [0|255] "NoUnit" Vector__XXX
 SG_ RollingCounter_IFC_HCM4 : 251|4@0+ (1,0) [0|14] "NoUnit" Vector__XXX
 SG_ Spots4VehObjClassn : 254|3@0+ (1,0) [0|7] "NoUnit" Vector__XXX
 SG_ Spots4TrackingInfo : 255|1@0+ (1,0) [0|1] "NoUnit" Vector__XXX
 SG_ Spot4VertAng : 247|8@0+ (0.125,-5) [-5|26.875] "NoUnit" Vector__XXX
 SG_ Spots4HozLeAngSpd : 239|8@0+ (0.125,-16) [-16|15.875] "DegPerSec" Vector__XXX
 SG_ Spots4Distance : 216|9@0+ (1,0) [0|510] "m" Vector__XXX
 SG_ Spots4Typ : 218|2@0+ (1,0) [0|3] "NoUnit" Vector__XXX
 SG_ Spots4Valid : 219|1@0+ (1,0) [0|1] "NoUnit" Vector__XXX
 SG_ Spots4HozlPosnRiAng : 213|10@0+ (0.08,-40) [-40|40] "Deg" Vector__XXX
 SG_ Spots4HozlPosnLeAng : 207|10@0+ (0.08,-40) [-40|40] "Deg" Vector__XXX
 SG_ Checksum_IFC_HCM4 : 199|8@0+ (1,0) [0|255] "NoUnit" Vector__XXX
 SG_ RollingCounter_IFC_HCM3 : 187|4@0+ (1,0) [0|14] "NoUnit" Vector__XXX
 SG_ Spots3VehObjClassn : 190|3@0+ (1,0) [0|7] "NoUnit" Vector__XXX
 SG_ Spots3TrackingInfo : 191|1@0+ (1,0) [0|1] "NoUnit" Vector__XXX
 SG_ Spot3VertAng : 183|8@0+ (0.125,-5) [-5|26.875] "NoUnit" Vector__XXX
 SG_ Spots3HozLeAngSpd : 175|8@0+ (0.125,-16) [-16|15.875] "DegPerSec" Vector__XXX
 SG_ Spots3Distance : 152|9@0+ (1,0) [0|510] "m" Vector__XXX
 SG_ Spots3Typ : 154|2@0+ (1,0) [0|3] "NoUnit" Vector__XXX
 SG_ Spots3Valid : 155|1@0+ (1,0) [0|1] "NoUnit" Vector__XXX
 SG_ Spots3HozlPosnRiAng : 149|10@0+ (0.08,-40) [-40|40] "Deg" Vector__XXX
 SG_ Spots3HozlPosnLeAng : 143|10@0+ (0.08,-40) [-40|40] "Deg" Vector__XXX
 SG_ Checksum_IFC_HCM3 : 135|8@0+ (1,0) [0|255] "NoUnit" Vector__XXX
 SG_ RollingCounter_IFC_HCM2 : 123|4@0+ (1,0) [0|14] "NoUnit" Vector__XXX
 SG_ Spots2VehObjClassn : 126|3@0+ (1,0) [0|7] "NoUnit" Vector__XXX
 SG_ Spots2TrackingInfo : 127|1@0+ (1,0) [0|1] "NoUnit" Vector__XXX
 SG_ Spot2VertAng : 119|8@0+ (0.125,-5) [-5|26.875] "NoUnit" Vector__XXX
 SG_ Spots2HozLeAngSpd : 111|8@0+ (0.125,-16) [-16|15.875] "DegPerSec" Vector__XXX
 SG_ Spots2Distance : 88|9@0+ (1,0) [0|510] "m" Vector__XXX
 SG_ Spots2Typ : 90|2@0+ (1,0) [0|3] "NoUnit" Vector__XXX
 SG_ Spots2Valid : 91|1@0+ (1,0) [0|1] "NoUnit" Vector__XXX
 SG_ Spots2HozlPosnRiAng : 85|10@0+ (0.08,-40) [-40|40] "Deg" Vector__XXX
 SG_ Spots2HozlPosnLeAng : 79|10@0+ (0.08,-40) [-40|40] "Deg" Vector__XXX
 SG_ Checksum_IFC_HCM2 : 71|8@0+ (1,0) [0|255] "NoUnit" Vector__XXX
 SG_ RollingCounter_IFC_HCM1 : 59|4@0+ (1,0) [0|14] "NoUnit" Vector__XXX
 SG_ Spots1VehObjClassn : 62|3@0+ (1,0) [0|7] "NoUnit" Vector__XXX
 SG_ Spots1TrackingInfo : 63|1@0+ (1,0) [0|1] "NoUnit" Vector__XXX
 SG_ Spot1VertAng : 55|8@0+ (0.125,-5) [-5|26.875] "NoUnit" Vector__XXX
 SG_ Spots1HozLeAngSpd : 47|8@0+ (0.125,-16) [-16|15.875] "DegPerSec" Vector__XXX
 SG_ Spots1Distance : 24|9@0+ (1,0) [0|510] "m" Vector__XXX
 SG_ Spots1Typ : 26|2@0+ (1,0) [0|3] "NoUnit" Vector__XXX
 SG_ Spots1Valid : 27|1@0+ (1,0) [0|1] "NoUnit" Vector__XXX
 SG_ Spots1HozlPosnRiAng : 21|10@0+ (0.08,-40) [-40|40] "Deg" Vector__XXX
 SG_ Spots1HozlPosnLeAng : 15|10@0+ (0.08,-40) [-40|40] "Deg" Vector__XXX
 SG_ Checksum_IFC_HCM1 : 7|8@0+ (1,0) [0|255] "NoUnit" Vector__XXX

BO_ 683 ACC_FD2: 64 ADC10
 SG_ MAC_Check_ACC_FD2 : 471|48@0+ (1,0) [0|281474976710655] "NoUnit" Vector__XXX
 SG_ FreshnessValue_ACC_FD2 : 455|16@0+ (1,0) [0|65535] "NoUnit" Vector__XXX
 SG_ OvertakingLightModSts : 445|2@0+ (1,0) [0|3] "NoUnit" Vector__XXX
 SG_ StartReminderEnaSts : 447|2@0+ (1,0) [0|3] "NoUnit" Vector__XXX
 SG_ DeviateSpdFixdValResp : 437|6@0+ (1,-1) [-1|39] "NoUnit" Vector__XXX
 SG_ HWA_FaststSwtResp : 439|2@0+ (1,0) [0|3] "NoUnit" Vector__XXX
 SG_ TargetCutoutPro : 429|6@0+ (0.02,0) [0|1] "NoUnit" Vector__XXX
 SG_ TargetCutinPro : 419|6@0+ (0.02,0) [0|1] "NoUnit" Vector__XXX
 SG_ ACC_PotentialTgtHeading : 409|6@0+ (0.05,-1.5) [-1.5|1.5] "rad" Vector__XXX
 SG_ ACC_RiTgtHeading : 415|6@0+ (0.05,-1.5) [-1.5|1.5] "rad" Vector__XXX
 SG_ ACC_PotentialTgtfusion : 400|1@0+ (1,0) [0|1] "NoUnit" Vector__XXX
 SG_ ACC_RiTgtfusion : 401|1@0+ (1,0) [0|1] "NoUnit" Vector__XXX
 SG_ ACC_LeTgtHeading : 407|6@0+ (0.05,-1.5) [-1.5|1.5] "rad" Vector__XXX
 SG_ ACC_LeTgtfusion : 392|1@0+ (1,0) [0|1] "NoUnit" Vector__XXX
 SG_ ACC_RlvTgtHeading : 398|6@0+ (0.05,-1.5) [-1.5|1.5] "rad" Vector__XXX
 SG_ ACC_RlvTgtfusion : 399|1@0+ (1,0) [0|1] "NoUnit" Vector__XXX
 SG_ RollingCounter_ACC7 : 379|4@0+ (1,0) [0|14] "NoUnit" Vector__XXX
 SG_ ACCSts : 380|1@0+ (1,0) [0|1] "NoUnit" Vector__XXX
 SG_ Request_driveoff : 383|3@0+ (1,0) [0|7] "NoUnit" Vector__XXX
 SG_ ACC_RiTgtTyp : 374|3@0+ (1,0) [0|7] "NoUnit" Vector__XXX
 SG_ ACC_RiTgtDx : 367|9@0+ (0.5,0) [0|150] "m" Vector__XXX
 SG_ ACC_RiTgtDy : 359|8@0+ (0.1,-8) [-8|8] "m" Vector__XXX
 SG_ ACC_RiTargrtDetn : 345|2@0+ (1,0) [0|3] "NoUnit" Vector__XXX
 SG_ ACC_LeTargrtDection : 347|2@0+ (1,0) [0|3] "NoUnit" Vector__XXX
 SG_ ACC_LeTgtTyp : 350|3@0+ (1,0) [0|7] "NoUnit" Vector__XXX
 SG_ ACC_LeTgtDx : 343|9@0+ (0.5,0) [0|150] "m" Vector__XXX
 SG_ ACC_LeTgtDy : 335|8@0+ (0.1,-8) [-8|8] "m" Vector__XXX
 SG_ Checksum_ACC7 : 327|8@0+ (1,0) [0|255] "NoUnit" Vector__XXX
 SG_ RollingCounter_ACC6 : 315|4@0+ (1,0) [0|14] "NoUnit" Vector__XXX
 SG_ IntelligentCurveAct : 319|1@0+ (1,0) [0|1] "NoUnit" Vector__XXX
 SG_ ACC_PotentialTgtTyp : 307|3@0+ (1,0) [0|7] "NoUnit" Vector__XXX
 SG_ ACC_PotentialTgtDetn : 309|2@0+ (1,0) [0|3] "NoUnit" Vector__XXX
 SG_ ACC_RlvTgtDx : 303|9@0+ (0.5,0) [0|150] "m" Vector__XXX
 SG_ ACC_RlvTgtDy : 295|8@0+ (0.1,-8) [-8|8] "m" Vector__XXX
 SG_ ACC_RlvTgtTyp : 282|3@0+ (1,0) [0|7] "NoUnit" Vector__XXX
 SG_ ACC_EgoStatus : 284|2@0+ (1,0) [0|3] "NoUnit" Vector__XXX
 SG_ ACC_RlvTgtDetn : 286|2@0+ (1,0) [0|3] "NoUnit" Vector__XXX
 SG_ ACC_PotentialTgtDx : 279|9@0+ (0.5,0) [0|150] "m" Vector__XXX
 SG_ ACC_PotentialTgtDy : 271|8@0+ (0.1,-8) [-8|8] "m" Vector__XXX
 SG_ Checksum_ACC6 : 263|8@0+ (1,0) [0|255] "NoUnit" Vector__XXX
 SG_ RollingCounter_ACC8 : 251|4@0+ (1,0) [0|14] "NoUnit" Vector__XXX
 SG_ SceneModCfmPop : 242|3@0+ (1,0) [0|7] "NoUnit" Vector__XXX
 SG_ TextSceneBrocast : 239|8@0+ (1,0) [0|255] "NoUnit" Vector__XXX
 SG_ PassETCEnaSts : 225|2@0+ (1,0) [0|3] "NoUnit" Vector__XXX
 SG_ DeviateSpdPreResp : 231|6@0+ (1,-1) [-1|39] "Perc" Vector__XXX
 SG_ HWA_Warning : 217|2@0+ (1,0) [0|3] "NoUnit" Vector__XXX
 SG_ HAVP_RecReq : 220|3@0+ (1,0) [0|7] "NoUnit" Vector__XXX
 SG_ HWA_LaneChangeReq : 223|3@0+ (1,0) [0|7] "NoUnit" Vector__XXX
 SG_ ADAS_DriverInloop_Monitor : 211|3@0+ (1,0) [0|7] "NoUnit" Vector__XXX
 SG_ HWA_LaneChange : 213|2@0+ (1,0) [0|3] "NoUnit" Vector__XXX
 SG_ DeviateSpdModSwtResp : 215|2@0+ (1,0) [0|3] "NoUnit" Vector__XXX
 SG_ HWA_InterSysInfoDisp : 203|4@0+ (1,0) [0|15] "NoUnit" Vector__XXX
 SG_ HWA_ModDisp : 207|4@0+ (1,0) [0|15] "NoUnit" Vector__XXX
 SG_ Checksum_ACC8 : 199|8@0+ (1,0) [0|255] "NoUnit" Vector__XXX
 SG_ RollingCounter_ACC4 : 187|4@0+ (1,0) [0|14] "NoUnit" Vector__XXX
 SG_ CruChar_InterSysInfoDisp : 191|4@0+ (1,0) [0|15] "NoUnit" Vector__XXX
 SG_ ACC_SpdSetValue : 183|8@0+ (1,0) [0|254] "kphORmph" Vector__XXX
 SG_ ACC_TimeGapSet : 170|3@0+ (1,0) [0|7] "NoUnit" Vector__XXX
 SG_ ISL_InterSysInfoDisp : 172|2@0+ (1,0) [0|3] "NoUnit" Vector__XXX
 SG_ TJA_ICA_ModDisp : 175|3@0+ (1,0) [0|7] "NoUnit" Vector__XXX
 SG_ TJA_ICA_InterSysInfoDisp : 163|3@0+ (1,0) [0|7] "NoUnit" Vector__XXX
 SG_ CruCha_ModDisp : 167|4@0+ (1,0) [0|15] "NoUnit" Vector__XXX
 SG_ TJA_ACC_SelSts : 154|3@0+ (1,0) [0|7] "NoUnit" Vector__XXX
 SG_ Longctrl_HazActv : 156|2@0+ (1,0) [0|3] "NoUnit" Vector__XXX
 SG_ ACC_TgtObjBarDisp : 159|3@0+ (1,0) [0|7] "NoUnit" Vector__XXX
 SG_ ACCReqAVM : 144|1@0+ (1,0) [0|1] "NoUnit" Vector__XXX
 SG_ ACC_FctSts : 146|2@0+ (1,0) [0|3] "NoUnit" Vector__XXX
 SG_ ACC_ModDisp : 151|5@0+ (1,0) [0|31] "NoUnit" Vector__XXX
 SG_ ACC_InterSysInfoDisp : 141|5@0+ (1,0) [0|31] "NoUnit" Vector__XXX
 SG_ ACC_TakeOverReq : 142|1@0+ (1,0) [0|1] "NoUnit" Vector__XXX
 SG_ ACC_ObjDetecte : 143|1@0+ (1,0) [0|1] "NoUnit" Vector__XXX
 SG_ Checksum_ACC4 : 135|8@0+ (1,0) [0|255] "NoUnit" Vector__XXX
 SG_ RollingCounter_ACC3 : 123|4@0+ (1,0) [0|14] "NoUnit" Vector__XXX
 SG_ ALC_InterSysInfoDisp : 127|2@0+ (1,0) [0|3] "NoUnit" Vector__XXX
 SG_ NOAExitTim : 107|6@0+ (1,-1) [0|60] "s" Vector__XXX
 SG_ PrkgSpaTPrkgSpaSts : 111|4@0+ (1,0) [0|15] "NoUnit" Vector__XXX
 SG_ VertHeiRmd : 81|2@0+ (1,0) [0|3] "NoUnit" Vector__XXX
 SG_ IntellgntAsscLmpEnaResp : 87|2@0+ (1,0) [0|3] "NoUnit" Vector__XXX
 SG_ ALC_Resp : 73|1@0+ (1,0) [0|1] "NoUnit" Vector__XXX
 SG_ HWA_SnvtySet_Resp : 76|2@0+ (1,0) [0|3] "NoUnit" Vector__XXX
 SG_ HWA_Resp : 77|1@0+ (1,0) [0|1] "NoUnit" Vector__XXX
 SG_ ISL_Resp : 79|1@0+ (1,0) [0|1] "NoUnit" Vector__XXX
 SG_ Checksum_ACC3 : 71|8@0+ (1,0) [0|255] "NoUnit" Vector__XXX
 SG_ ACC_RiTgt_02_Typ : 63|3@0+ (1,0) [0|7] "NoUnit" Vector__XXX
 SG_ ACC_RiTgt_02_Dy : 55|7@0+ (0.1,0) [0|8.1] "m" Vector__XXX
 SG_ LowPowerEgyMngmntModResp : 41|2@0+ (1,0) [0|3] "NoUnit" Vector__XXX
 SG_ ACC_RiTgtObjBarDisp : 44|3@0+ (1,0) [0|7] "NoUnit" Vector__XXX
 SG_ ACC_LeTgtObjBarDisp : 47|3@0+ (1,0) [0|7] "NoUnit" Vector__XXX
 SG_ ACC_RiTgt_02_Dx : 24|9@0+ (0.5,0) [0|150] "m" Vector__XXX
 SG_ ACC_RiTargrt_02_Detn : 26|2@0+ (1,0) [0|3] "NoUnit" Vector__XXX
 SG_ ACC_LeTargrt_02_Detn : 28|2@0+ (1,0) [0|3] "NoUnit" Vector__XXX
 SG_ ACC_LeTgt_02_Typ : 31|3@0+ (1,0) [0|7] "NoUnit" Vector__XXX
 SG_ ACC_LeTgt_02_Dx : 8|9@0+ (0.5,0) [0|150] "m" Vector__XXX
 SG_ ACC_LeTgt_02_Dy : 15|7@0+ (0.1,-8) [-8|0.1] "m" Vector__XXX

BO_ 692 ACC_FD3: 64 ADC10
 SG_ AEB_RiCyclistTyp : 435|3@0+ (1,0) [0|7] "NoUnit" Vector__XXX
 SG_ AEB_RiCyclistDx : 428|9@0+ (0.5,0) [0|150] "m" Vector__XXX
 SG_ AEB_RiCyclistDetn : 430|2@0+ (1,0) [0|3] "NoUnit" Vector__XXX
 SG_ AEB_LeCyclistDx : 423|9@0+ (0.5,0) [0|150] "m" Vector__XXX
 SG_ AEB_LeCyclistTyp : 411|3@0+ (1,0) [0|7] "NoUnit" Vector__XXX
 SG_ AEB_LeCyclistDetn : 413|2@0+ (1,0) [0|3] "NoUnit" Vector__XXX
 SG_ AEB_RiPedDx : 406|9@0+ (0.5,0) [0|150] "m" Vector__XXX
 SG_ AEB_LePedDx : 399|9@0+ (0.5,0) [0|150] "m" Vector__XXX
 SG_ NOH_SysInfoDisplay : 383|4@0+ (1,0) [0|15] "NoUnit" Vector__XXX
 SG_ NOH_Swt_Resp : 368|1@0+ (1,0) [0|1] "NoUnit" Vector__XXX
 SG_ NOH_Act_Resp : 369|1@0+ (1,0) [0|1] "NoUnit" Vector__XXX
 SG_ FCWAEB_crossingTTC : 375|6@0+ (0.1,0) [0.1|6.3] "s" Vector__XXX
 SG_ FCWAEB_longTTC : 365|6@0+ (0.1,0) [0.1|6.3] "s" Vector__XXX
 SG_ NOH_Sts : 355|4@0+ (1,0) [0|15] "NoUnit" Vector__XXX
 SG_ NOH_DistToExit : 351|12@0+ (1,0) [0|4095] "m" Vector__XXX
 SG_ JAPedObjAx : 335|10@0+ (0.03125,-16) [-16|15.96875] "MtrPerSecSq" Vector__XXX
 SG_ JAPedObjAy : 301|10@0+ (0.03125,-16) [-16|15.96875] "MtrPerSecSq" Vector__XXX
 SG_ JAPedObjVy : 295|10@0+ (0.125,-64) [-64|63.875] "mps" Vector__XXX
 SG_ JAPedObjCntAlive : 275|12@0+ (17,0) [0|65535] "NoUnit" Vector__XXX
 SG_ JAPedObjVx : 271|12@0+ (0.0625,-128) [-128|127] "mps" Vector__XXX
 SG_ LgtFolwDistanceSts : 255|3@0+ (1,0) [0|7] "NoUnit" Vector__XXX
 SG_ NOAFuncSts : 241|2@0+ (1,0) [0|3] "NoUnit" Vector__XXX
 SG_ FCWAEB_JATTC : 247|6@0+ (0.1,0) [0.1|6.3] "s" Vector__XXX
 SG_ JAPedObjDx : 228|12@0+ (0.0625,0) [0|255.9375] "m" Vector__XXX
 SG_ JAPedObjDy : 223|11@0+ (0.125,-128) [-128|127.875] "m" Vector__XXX
 SG_ JAPedObjObstcl : 213|5@0+ (0.03125,0) [0|0.96875] "Perc" Vector__XXX
 SG_ AEBJAObjAy : 207|10@0+ (0.03125,-16) [-16|15.96875] "MtrPerSecSq" Vector__XXX
 SG_ JAPedObjState : 191|3@0+ (1,0) [0|7] "NoUnit" Vector__XXX
 SG_ AEBJAObjAx : 169|10@0+ (0.03125,-16) [-16|15.96875] "MtrPerSecSq" Vector__XXX
 SG_ AEBJAObjVy : 163|10@0+ (0.125,-64) [-64|63.875] "mps" Vector__XXX
 SG_ AEBJAObjObstcl : 152|5@0+ (0.03125,0) [0|0.96875] "Perc" Vector__XXX
 SG_ AEBJAObjDy : 147|11@0+ (0.125,-128) [-128|127.875] "m" Vector__XXX
 SG_ AEBJAObjCntAlive : 143|12@0+ (17,0) [0|65535] "NoUnit" Vector__XXX
 SG_ AEBJAObjState : 127|3@0+ (1,0) [0|7] "NoUnit" Vector__XXX
 SG_ JAPedObjID : 119|8@0+ (1,0) [0|254] "NoUnit" Vector__XXX
 SG_ AEBJAObjDx : 99|12@0+ (0.0625,0) [0|255.9375] "m" Vector__XXX
 SG_ AEBJAObjVx : 95|12@0+ (0.0625,-128) [-128|127] "mps" Vector__XXX
 SG_ JAPedObjVideoCfmd : 80|1@0+ (1,0) [0|1] "NoUnit" Vector__XXX
 SG_ AEBJAObjVideoCfmd : 81|1@0+ (1,0) [0|1] "NoUnit" Vector__XXX
 SG_ AEBJAObjExist : 87|6@0+ (0.015625,0) [0|0.984375] "Perc" Vector__XXX
 SG_ AEBJAObjID : 79|8@0+ (1,0) [0|254] "NoUnit" Vector__XXX
 SG_ AEB_RiCyclist_collisionprob : 60|1@0+ (1,0) [0|1] "NoUnit" Vector__XXX
 SG_ AEB_LeCyclist_collisionprob : 61|1@0+ (1,0) [0|1] "NoUnit" Vector__XXX
 SG_ AEB_RiPed_collisionprob : 62|1@0+ (1,0) [0|1] "NoUnit" Vector__XXX
 SG_ AEB_LePed_collisionprob : 63|1@0+ (1,0) [0|1] "NoUnit" Vector__XXX
 SG_ AEB_RiPedDetn : 49|2@0+ (1,0) [0|3] "NoUnit" Vector__XXX
 SG_ AEB_RiPedTyp : 52|3@0+ (1,0) [0|7] "NoUnit" Vector__XXX
 SG_ AEB_LePedTyp : 55|3@0+ (1,0) [0|7] "NoUnit" Vector__XXX
 SG_ AEB_LePedDetn : 41|2@0+ (1,0) [0|3] "NoUnit" Vector__XXX
 SG_ JAPedObjExist : 47|6@0+ (0.015625,0) [0|0.984375] "Perc" Vector__XXX
 SG_ AEB_RiCyclistDy : 39|8@0+ (0.1,-8) [-8|8] "m" Vector__XXX
 SG_ AEB_LeCyclistDy : 31|8@0+ (0.1,-8) [-8|8] "m" Vector__XXX
 SG_ AEB_RiPedDy : 23|8@0+ (0.1,-8) [-8|8] "m" Vector__XXX
 SG_ AEB_LePedDy : 15|8@0+ (0.1,-8) [-8|8] "m" Vector__XXX

BO_ 696 ACC_FD4: 64 ADC10
 SG_ ACC_DataRecReq : 511|8@0+ (1,0) [0|255] "NoUnit" Vector__XXX
 SG_ AEBObjDrvby : 502|5@0+ (1,0) [0|20] "NoUnit" Vector__XXX
 SG_ AEBObjOverlap : 491|5@0+ (1,0) [0|20] "NoUnit" Vector__XXX
 SG_ DrvrSts : 494|3@0+ (1,0) [0|7] "NoUnit" Vector__XXX
 SG_ MapDataValid : 495|1@0+ (1,0) [0|1] "NoUnit" Vector__XXX
 SG_ PedObjState : 482|3@0+ (1,0) [0|7] "NoUnit" Vector__XXX
 SG_ ACC_SOSReq : 484|2@0+ (1,0) [0|3] "NoUnit" Vector__XXX
 SG_ RadarDrvrAttentive : 473|1@0+ (1,0) [0|1] "NoUnit" Vector__XXX
 SG_ BrdgDst : 479|6@0+ (10,0) [0|600] "m" Vector__XXX
 SG_ DrvgOnRiLane : 465|2@0+ (1,0) [0|3] "NoUnit" Vector__XXX
 SG_ TunnelDst : 471|6@0+ (10,0) [0|600] "m" Vector__XXX
 SG_ NavSpdLimUnit : 457|2@0+ (1,0) [0|3] "NoUnit" Vector__XXX
 SG_ CurveDst : 463|6@0+ (10,0) [0|600] "m" Vector__XXX
 SG_ SpdLimit : 455|8@0+ (1,0) [0|255] "NoUnit" Vector__XXX
 SG_ RampDst : 445|6@0+ (10,0) [0|600] "m" Vector__XXX
 SG_ RoadCrvtFar : 439|10@0+ (0.00032,-0.16352) [-0.16352|0.16352] "NoUnit" Vector__XXX
 SG_ SpdLimitDst : 429|6@0+ (10,0) [0|600] "m" Vector__XXX
 SG_ RoadCrvt : 423|10@0+ (0.00032,-0.16352) [-0.16352|0.16352] "NoUnit" Vector__XXX
 SG_ DrvgOnHiWay : 409|2@0+ (1,0) [0|3] "NoUnit" Vector__XXX
 SG_ HandsoffDetd : 411|2@0+ (1,0) [0|3] "NoUnit" Vector__XXX
 SG_ RadarHorMisalign : 407|12@0+ (0.0001,-0.2048) [-0.2048|0.2047] "rad" Vector__XXX
 SG_ ACCTgtObjCntAlive : 387|12@0+ (1,0) [0|3855] "NoUnit" Vector__XXX
 SG_ ACCTgtObjVideoCfmd : 388|1@0+ (1,0) [0|1] "NoUnit" Vector__XXX
 SG_ ACCTgtObjState : 391|3@0+ (1,0) [0|7] "NoUnit" Vector__XXX
 SG_ ACCTgtObjAy : 369|10@0+ (0.03125,-16) [-16|15.96875] "MtrPerSecSq" Vector__XXX
 SG_ ACCTgtObjAx : 363|10@0+ (0.03125,-16) [-16|15.96875] "MtrPerSecSq" Vector__XXX
 SG_ ACCTgtObjVx : 359|12@0+ (0.0625,-128) [-128|127] "mps" Vector__XXX
 SG_ ACCTgtObjVy : 337|10@0+ (0.125,-64) [-64|63.875] "mps" Vector__XXX
 SG_ ACCTgtObjExist : 343|6@0+ (0.015625,0) [0|0.984375] "Perc" Vector__XXX
 SG_ ACCTgtObjDy : 322|11@0+ (0.125,-128) [-128|127.875] "m" Vector__XXX
 SG_ ACCTgtObjObstcl : 327|5@0+ (0.03125,0) [0|0.96875] "Perc" Vector__XXX
 SG_ ACCTgtObjID : 319|8@0+ (1,0) [0|254] "NoUnit" Vector__XXX
 SG_ PedObjAx : 297|10@0+ (0.03125,-16) [-16|15.96875] "MtrPerSecSq" Vector__XXX
 SG_ PedObjCntAlive : 293|12@0+ (1,0) [0|3855] "NoUnit" Vector__XXX
 SG_ PedObjAy : 287|10@0+ (0.03125,-16) [-16|15.96875] "MtrPerSecSq" Vector__XXX
 SG_ ACCTgtObjDx : 267|12@0+ (0.0625,0) [0|255.9375] "m" Vector__XXX
 SG_ PedObjVideoCfmd : 269|1@0+ (1,0) [0|1] "NoUnit" Vector__XXX
 SG_ PedObjVy : 263|10@0+ (0.125,-64) [-64|63.875] "mps" Vector__XXX
 SG_ PedObjVx : 243|12@0+ (0.0625,-128) [-128|127] "mps" Vector__XXX
 SG_ PedObjDx : 239|12@0+ (0.0625,0) [0|255.9375] "m" Vector__XXX
 SG_ PedObjDy : 218|11@0+ (0.125,-128) [-128|127.875] "m" Vector__XXX
 SG_ PedObjObstcl : 223|5@0+ (0.03125,0) [0|0.96875] "Perc" Vector__XXX
 SG_ PedObjID : 215|8@0+ (1,0) [0|254] "NoUnit" Vector__XXX
 SG_ PedObjExist : 205|6@0+ (0.015625,0) [0|0.984375] "Perc" Vector__XXX
 SG_ CyclistObjAy : 199|10@0+ (0.03125,-16) [-16|15.96875] "MtrPerSecSq" Vector__XXX
 SG_ CyclistObjAx : 177|10@0+ (0.03125,-16) [-16|15.96875] "MtrPerSecSq" Vector__XXX
 SG_ CyclistObjVideoCfmd : 178|1@0+ (1,0) [0|1] "NoUnit" Vector__XXX
 SG_ CyclistObjState : 181|3@0+ (1,0) [0|7] "NoUnit" Vector__XXX
 SG_ CyclistObjVy : 175|10@0+ (0.125,-64) [-64|63.875] "mps" Vector__XXX
 SG_ CyclistObjCntAlive : 155|12@0+ (1,0) [0|3855] "NoUnit" Vector__XXX
 SG_ CyclistObjVx : 151|12@0+ (0.0625,-128) [-128|127] "mps" Vector__XXX
 SG_ CyclistObjDy : 130|11@0+ (0.125,-128) [-128|127.875] "m" Vector__XXX
 SG_ CyclistObjObstcl : 135|5@0+ (0.03125,0) [0|0.96875] "Perc" Vector__XXX
 SG_ CyclistObjID : 127|8@0+ (1,0) [0|254] "NoUnit" Vector__XXX
 SG_ CyclistObjDx : 107|12@0+ (0.0625,0) [0|255.9375] "m" Vector__XXX
 SG_ AEBObjAy : 101|10@0+ (0.03125,-16) [-16|15.96875] "MtrPerSecSq" Vector__XXX
 SG_ AEBObjAx : 95|10@0+ (0.03125,-16) [-16|15.96875] "MtrPerSecSq" Vector__XXX
 SG_ CyclistObjExist : 85|6@0+ (0.015625,0) [0|0.984375] "Perc" Vector__XXX
 SG_ AEBObjVy : 79|10@0+ (0.125,-64) [-64|63.875] "mps" Vector__XXX
 SG_ AEBObjObstcl : 68|5@0+ (0.03125,0) [0|0.96875] "Perc" Vector__XXX
 SG_ AEBObjState : 71|3@0+ (1,0) [0|7] "NoUnit" Vector__XXX
 SG_ AEBObjDy : 50|11@0+ (0.125,-128) [-128|127.875] "m" Vector__XXX
 SG_ AEBObjCntAlive : 47|12@0+ (1,0) [0|3855] "NoUnit" Vector__XXX
 SG_ AEBObjDx : 27|12@0+ (0.0625,0) [0|255.9375] "m" Vector__XXX
 SG_ AEBObjVx : 23|12@0+ (0.0625,-128) [-128|127] "mps" Vector__XXX
 SG_ AEBObjVideoCfmd : 9|1@0+ (1,0) [0|1] "NoUnit" Vector__XXX
 SG_ AEBObjExist : 15|6@0+ (0.015625,0) [0|0.984375] "Perc" Vector__XXX
 SG_ AEBObjID : 7|8@0+ (1,0) [0|254] "NoUnit" Vector__XXX

CM_ SG_ 347 PAVP_Status "B";
CM_ SG_ 347 HAVP_WorkSts "B";
CM_ SG_ 347 DrvDirCllsnWarnTrqCtrlFlg "/";
CM_ SG_ 347 DrvDirMstRskObstclCllsnTim "/";
CM_ SG_ 628 SlopViewFuncReq "/";
CM_ SG_ 628 SlopViewSts "/";
CM_ SG_ 664 ObstclDetnFailSts "/";
CM_ SG_ 395 IntellgntAsscRoadTyp "/";
CM_ SG_ 551 RollingCounter_AEB5 "QM";
CM_ SG_ 551 AEBObjDyActvSafety "QM";
CM_ SG_ 551 AEBObjDxActvSafety "QM";
CM_ SG_ 551 AEBObjVxActvSafety "QM";
CM_ SG_ 551 TimeToCllsnActvSafety "QM";
CM_ SG_ 551 AEBTgtDecelReqActvSafety "QM";
CM_ SG_ 551 ADAS_ErrStsActvSafety "QM";
CM_ SG_ 551 AEBObjStyActvSafety "QM";
CM_ SG_ 551 Checksum_AEB5 "QM";
CM_ SG_ 551 IntellgntcurveResp "/";
CM_ SG_ 683 NOAExitTim "/";
CM_ SG_ 683 VertHeiRmd "/";
BA_DEF_ BO_  "GenMsgILSupport" ENUM  "No","Yes";
BA_DEF_ BO_  "VFrameFormat" ENUM  "StandardCAN","ExtendedCAN","reserved","reserved","reserved","reserved","reserved","reserved","reserved","reserved","reserved","reserved","reserved","reserved","StandardCAN_FD","ExtendedCAN_FD";
BA_DEF_ BO_  "DiagState" ENUM  "No","Yes";
BA_DEF_ BO_  "DiagRequest" ENUM  "No","Yes";
BA_DEF_ BO_  "DiagResponse" ENUM  "No","Yes";
BA_DEF_ BO_  "NmAsrMessage" ENUM  "No","Yes";
BA_DEF_ SG_  "GenSigSendType" ENUM  "Cyclic","OnWrite","OnWriteWithRepetition","OnChange","OnChangeWithRepetition","IfActive","IfActiveWithRepetition","NoSigSendType","CyclicAndSpontanX","NotUsed","Event","CE";
BA_DEF_ SG_  "IsMonitor" ENUM  "*","Monitor";
BA_DEF_ SG_  "NormValue" STRING ;
BA_DEF_  "DBName" STRING ;
BA_DEF_  "BusType" STRING ;
BA_DEF_  "Manufacturer" STRING ;
BA_DEF_ SG_  "UnitConversionFactor" FLOAT -100 100;
BA_DEF_ SG_  "SigInvalidSetFlag" ENUM  "*","Yes";
BA_DEF_ SG_  "Internal_type" ENUM  "*","UB","UW","UL","SB","SW","SL";
BA_DEF_ SG_  "IsCrcSignal" ENUM  "No","Yes";
BA_DEF_ SG_  "IsRcSignal" ENUM  "No","Yes";
BA_DEF_ BO_  "GenMsgSendType" ENUM  "Cyclic","Event","CE","NotUsed","NotUsed","NotUsed","NotUsed","NotUsed","NoMsgSendType","IfActive","IfActiveWithRepetition","CyclicAndSpontanX";
BA_DEF_ SG_  "GenSigStartValue" INT 0 2147483647;
BA_DEF_ BO_  "MsgType" ENUM  "Normal","NM","Diag","vector_leerstring";
BA_DEF_ BU_  "NmAsrNode" ENUM  "No","Yes";
BA_DEF_ BU_  "NmAsrCanMsgReducedTime" INT 1 65535;
BA_DEF_  "NmType" STRING ;
BA_DEF_  "NmAsrMessageCount" INT 1 256;
BA_DEF_  "NmAsrBaseAddress" HEX 0 2047;
BA_DEF_  "NmAsrTimeoutTime" INT 1 65535;
BA_DEF_  "NmAsrWaitBusSleepTime" INT 1 65535;
BA_DEF_  "NmAsrCanMsgCycleTime" INT 1 65535;
BA_DEF_  "NmAsrRepeatMessageTime" INT 1 65535;
BA_DEF_ BO_  "GenMsgCycleTime" INT 0 65535;
BA_DEF_DEF_  "GenMsgILSupport" "Yes";
BA_DEF_DEF_  "VFrameFormat" "StandardCAN";
BA_DEF_DEF_  "DiagState" "No";
BA_DEF_DEF_  "DiagRequest" "No";
BA_DEF_DEF_  "DiagResponse" "No";
BA_DEF_DEF_  "NmAsrMessage" "No";
BA_DEF_DEF_  "GenSigSendType" "Cyclic";
BA_DEF_DEF_  "IsMonitor" "*";
BA_DEF_DEF_  "NormValue" "";
BA_DEF_DEF_  "DBName" "";
BA_DEF_DEF_  "BusType" "";
BA_DEF_DEF_  "Manufacturer" "Vector";
BA_DEF_DEF_  "UnitConversionFactor" 1;
BA_DEF_DEF_  "SigInvalidSetFlag" "*";
BA_DEF_DEF_  "Internal_type" "*";
BA_DEF_DEF_  "IsCrcSignal" "No";
BA_DEF_DEF_  "IsRcSignal" "No";
BA_DEF_DEF_  "GenMsgSendType" "Cyclic";
BA_DEF_DEF_  "GenSigStartValue" 0;
BA_DEF_DEF_  "MsgType" "";
BA_DEF_DEF_  "NmAsrNode" "No";
BA_DEF_DEF_  "NmAsrCanMsgReducedTime" 50;
BA_DEF_DEF_  "NmType" "NmAsr";
BA_DEF_DEF_  "NmAsrMessageCount" 64;
BA_DEF_DEF_  "NmAsrBaseAddress" 1024;
BA_DEF_DEF_  "NmAsrTimeoutTime" 1000;
BA_DEF_DEF_  "NmAsrWaitBusSleepTime" 750;
BA_DEF_DEF_  "NmAsrCanMsgCycleTime" 100;
BA_DEF_DEF_  "NmAsrRepeatMessageTime" 400;
BA_DEF_DEF_  "GenMsgCycleTime" 0;
BA_ "BusType" "CAN FD";
BA_ "DBName" "CANA";
BA_ "NmAsrNode" BU_ ADC10 1;
BA_ "MsgType" BO_ 1125 0;
BA_ "GenMsgSendType" BO_ 1125 8;
BA_ "VFrameFormat" BO_ 1125 14;
BA_ "GenMsgCycleTime" BO_ 347 20;
BA_ "MsgType" BO_ 347 0;
BA_ "VFrameFormat" BO_ 347 14;
BA_ "GenMsgCycleTime" BO_ 628 50;
BA_ "MsgType" BO_ 628 0;
BA_ "VFrameFormat" BO_ 628 14;
BA_ "GenMsgCycleTime" BO_ 664 100;
BA_ "MsgType" BO_ 664 0;
BA_ "VFrameFormat" BO_ 664 14;
BA_ "GenMsgCycleTime" BO_ 667 100;
BA_ "MsgType" BO_ 667 0;
BA_ "VFrameFormat" BO_ 667 14;
BA_ "GenMsgCycleTime" BO_ 299 20;
BA_ "MsgType" BO_ 299 0;
BA_ "VFrameFormat" BO_ 299 14;
BA_ "GenMsgCycleTime" BO_ 323 20;
BA_ "MsgType" BO_ 323 0;
BA_ "VFrameFormat" BO_ 323 14;
BA_ "GenMsgCycleTime" BO_ 395 20;
BA_ "MsgType" BO_ 395 0;
BA_ "VFrameFormat" BO_ 395 14;
BA_ "GenMsgCycleTime" BO_ 415 50;
BA_ "MsgType" BO_ 415 0;
BA_ "VFrameFormat" BO_ 415 14;
BA_ "GenMsgCycleTime" BO_ 546 50;
BA_ "MsgType" BO_ 546 0;
BA_ "VFrameFormat" BO_ 546 14;
BA_ "GenMsgCycleTime" BO_ 551 50;
BA_ "MsgType" BO_ 551 0;
BA_ "VFrameFormat" BO_ 551 14;
BA_ "GenMsgCycleTime" BO_ 573 50;
BA_ "MsgType" BO_ 573 0;
BA_ "VFrameFormat" BO_ 573 14;
BA_ "GenMsgCycleTime" BO_ 576 50;
BA_ "MsgType" BO_ 576 0;
BA_ "VFrameFormat" BO_ 576 14;
BA_ "GenMsgCycleTime" BO_ 683 100;
BA_ "MsgType" BO_ 683 0;
BA_ "VFrameFormat" BO_ 683 14;
BA_ "GenMsgCycleTime" BO_ 692 100;
BA_ "MsgType" BO_ 692 0;
BA_ "VFrameFormat" BO_ 692 14;
BA_ "GenMsgCycleTime" BO_ 696 100;
BA_ "MsgType" BO_ 696 0;
BA_ "VFrameFormat" BO_ 696 14;
BA_ "GenSigSendType" SG_ 1125 IDC_Sync_Req 1;
BA_ "IsRcSignal" SG_ 347 RollingCounter_HAP3 1;
BA_ "GenSigStartValue" SG_ 347 PAVP_FuncSts 1;
BA_ "GenSigStartValue" SG_ 347 HAVP_FuncSts 2;
BA_ "IsCrcSignal" SG_ 347 Checksum_HAP3 1;
BA_ "IsRcSignal" SG_ 347 RollingCounter_HAP1 1;
BA_ "IsCrcSignal" SG_ 347 Checksum_HAP1 1;
BA_ "IsRcSignal" SG_ 347 RollingCounter_AVP1 1;
BA_ "IsCrcSignal" SG_ 347 Checksum_AVP1 1;
BA_ "IsRcSignal" SG_ 347 RollingCounter_APS4 1;
BA_ "GenSigStartValue" SG_ 347 MEB_BrkgReqValue 200;
BA_ "IsCrcSignal" SG_ 347 Checksum_APS4 1;
BA_ "IsRcSignal" SG_ 347 RollingCounter_APS1 1;
BA_ "GenSigStartValue" SG_ 347 APS_ProcBar 127;
BA_ "IsCrcSignal" SG_ 347 Checksum_APS1 1;
BA_ "IsRcSignal" SG_ 347 RollingCounter_APA1 1;
BA_ "IsCrcSignal" SG_ 347 Checksum_APA1 1;
BA_ "GenSigStartValue" SG_ 664 FPAS_NearBrrdstn 127;
BA_ "GenSigStartValue" SG_ 664 ResTraDistanceOfCurTra 126;
BA_ "GenSigStartValue" SG_ 664 P2P_ProcBar 127;
BA_ "GenSigStartValue" SG_ 664 HAVP_ProcRa 127;
BA_ "GenSigStartValue" SG_ 664 RPAS_NearBrrdstn 255;
BA_ "GenSigStartValue" SG_ 667 HAVP_LrngDst 1023;
BA_ "IsRcSignal" SG_ 299 RollingCounter_IFC2 1;
BA_ "GenSigStartValue" SG_ 299 IFCAngCmdReqProtnValue 7169;
BA_ "GenSigStartValue" SG_ 299 IFCAngCmdReqValue 7800;
BA_ "IsCrcSignal" SG_ 299 Checksum_IFC2 1;
BA_ "IsRcSignal" SG_ 299 RollingCounter_IFC1 1;
BA_ "GenSigStartValue" SG_ 299 IFCTrqOvlCmdReqValue 1023;
BA_ "GenSigStartValue" SG_ 299 IFCTrqOvlCmdProtnValue 7169;
BA_ "IsCrcSignal" SG_ 299 Checksum_IFC1 1;
BA_ "IsRcSignal" SG_ 323 RollingCounter_ACC14 1;
BA_ "IsCrcSignal" SG_ 323 Checksum_ACC14 1;
BA_ "IsRcSignal" SG_ 323 RollingCounter_ACC12 1;
BA_ "IsCrcSignal" SG_ 323 Checksum_ACC12 1;
BA_ "IsRcSignal" SG_ 323 RollingCounter_ACC10 1;
BA_ "IsCrcSignal" SG_ 323 Checksum_ACC10 1;
BA_ "IsRcSignal" SG_ 323 RollingCounter_ACC2 1;
BA_ "IsCrcSignal" SG_ 323 Checksum_ACC2 1;
BA_ "IsRcSignal" SG_ 323 RollingCounter_ACC1 1;
BA_ "GenSigStartValue" SG_ 323 Longctrl_ModSts 1;
BA_ "IsCrcSignal" SG_ 323 Checksum_ACC1 1;
BA_ "IsRcSignal" SG_ 323 RollingCounter_ACC11 1;
BA_ "IsCrcSignal" SG_ 323 Checksum_ACC11 1;
BA_ "IsRcSignal" SG_ 395 RollingCounter_AEB6 1;
BA_ "IsCrcSignal" SG_ 395 Checksum_AEB6 1;
BA_ "IsRcSignal" SG_ 395 RollingCounter_AEB1 1;
BA_ "IsCrcSignal" SG_ 395 Checksum_AEB1 1;
BA_ "GenSigStartValue" SG_ 395 TimeToCllsn 250;
BA_ "GenSigStartValue" SG_ 415 IFC_Line_special02_CurvChange 480000;
BA_ "GenSigStartValue" SG_ 415 TargetPathC0 2825;
BA_ "GenSigStartValue" SG_ 415 TargetPathC2 15625;
BA_ "GenSigStartValue" SG_ 415 IFC_Roadedge02_CurvChange 480000;
BA_ "GenSigStartValue" SG_ 415 IFC_Roadedge02_Curv 15625;
BA_ "GenSigStartValue" SG_ 415 IFC_Roadedge02_Dy 2825;
BA_ "GenSigStartValue" SG_ 415 IFC_Roadedge01_CurvChange 480000;
BA_ "GenSigStartValue" SG_ 415 IFC_Roadedge01_Curv 15625;
BA_ "GenSigStartValue" SG_ 415 IFC_Roadedge01_Dy 2825;
BA_ "GenSigStartValue" SG_ 415 IFC_Line04_CurvChange 480000;
BA_ "GenSigStartValue" SG_ 415 IFC_Line04_Curv 15625;
BA_ "GenSigStartValue" SG_ 415 IFC_Line04_Dy 2825;
BA_ "GenSigStartValue" SG_ 415 IFC_Line03_CurvChange 480000;
BA_ "GenSigStartValue" SG_ 415 IFC_Line03_Curv 15625;
BA_ "GenSigStartValue" SG_ 415 IFC_Line03_Dy 2825;
BA_ "GenSigStartValue" SG_ 415 IFC_Line02_CurvChange 480000;
BA_ "GenSigStartValue" SG_ 415 IFC_Line02_Curv 15625;
BA_ "GenSigStartValue" SG_ 415 IFC_Line02_Dy 2825;
BA_ "GenSigStartValue" SG_ 415 IFC_Line01_CurvChange 480000;
BA_ "GenSigStartValue" SG_ 415 IFC_Line01_Curv 15625;
BA_ "GenSigStartValue" SG_ 415 IFC_Line01_Dy 2825;
BA_ "IsRcSignal" SG_ 546 RollingCounter_IFC_HCM9 1;
BA_ "IsCrcSignal" SG_ 546 Checksum_IFC_HCM9 1;
BA_ "IsRcSignal" SG_ 546 RollingCounter_IFC_HCM8 1;
BA_ "IsCrcSignal" SG_ 546 Checksum_IFC_HCM8 1;
BA_ "GenSigStartValue" SG_ 546 IFC_Roadedge02_HeadingAngle 200;
BA_ "GenSigStartValue" SG_ 546 IFC_Roadedge01_HeadingAngle 200;
BA_ "GenSigStartValue" SG_ 546 IFC_Line04_HeadingAngle 200;
BA_ "GenSigStartValue" SG_ 546 IFC_Line03_HeadingAngle 200;
BA_ "GenSigStartValue" SG_ 546 IFC_Line02_HeadingAngle 200;
BA_ "GenSigStartValue" SG_ 546 IFC_Line01_HeadingAngle 200;
BA_ "IsRcSignal" SG_ 551 RollingCounter_AEB5 1;
BA_ "IsCrcSignal" SG_ 551 Checksum_AEB5 1;
BA_ "GenSigStartValue" SG_ 551 ACC_RiTgt_03_Heading 30;
BA_ "GenSigStartValue" SG_ 551 ACC_LeTgt_03_Heading 30;
BA_ "GenSigStartValue" SG_ 551 ACC_PotentialTgt_02_Heading 30;
BA_ "GenSigStartValue" SG_ 551 TargetPositionDy 2825;
BA_ "GenSigStartValue" SG_ 551 AEB_JA_Resp 1;
BA_ "GenSigStartValue" SG_ 551 AEB_VehResp 1;
BA_ "GenSigStartValue" SG_ 551 AEB_PedResp 1;
BA_ "GenSigStartValue" SG_ 551 TargetPathC3 480000;
BA_ "GenSigStartValue" SG_ 551 IFC_Line_special02_Dy 2825;
BA_ "GenSigStartValue" SG_ 573 IFC_Line_special02_Curv 15625;
BA_ "GenSigStartValue" SG_ 573 TargetPathC1 201;
BA_ "GenSigStartValue" SG_ 573 IFC_Line_special01_CurvChange 480000;
BA_ "GenSigStartValue" SG_ 573 IFC_Line_special01_Curv 15625;
BA_ "GenSigStartValue" SG_ 573 HandsoffTimSts 1;
BA_ "GenSigStartValue" SG_ 573 IFC_Line_special01_Dy 2825;
BA_ "GenSigStartValue" SG_ 573 IFC_NextRiLane_dy 2496;
BA_ "GenSigStartValue" SG_ 573 IFC_NextLeLane_dy 2496;
BA_ "GenSigStartValue" SG_ 573 IFC_RiLane_dy 2496;
BA_ "GenSigStartValue" SG_ 573 IFC_LeLane_dy 2496;
BA_ "GenSigStartValue" SG_ 573 IFC_LaneCurve 2047;
BA_ "GenSigStartValue" SG_ 573 IFC_Line_special02_HeadingAngle 201;
BA_ "GenSigStartValue" SG_ 573 IFC_Line_special01_HeadingAngle 201;
BA_ "IsRcSignal" SG_ 576 RollingCounter_IFC_HCM7 1;
BA_ "IsCrcSignal" SG_ 576 Checksum_IFC_HCM7 1;
BA_ "IsRcSignal" SG_ 576 RollingCounter_IFC_HCM6 1;
BA_ "IsCrcSignal" SG_ 576 Checksum_IFC_HCM6 1;
BA_ "IsRcSignal" SG_ 576 RollingCounter_IFC_HCM5 1;
BA_ "IsCrcSignal" SG_ 576 Checksum_IFC_HCM5 1;
BA_ "IsRcSignal" SG_ 576 RollingCounter_IFC_HCM4 1;
BA_ "IsCrcSignal" SG_ 576 Checksum_IFC_HCM4 1;
BA_ "IsRcSignal" SG_ 576 RollingCounter_IFC_HCM3 1;
BA_ "IsCrcSignal" SG_ 576 Checksum_IFC_HCM3 1;
BA_ "IsRcSignal" SG_ 576 RollingCounter_IFC_HCM2 1;
BA_ "IsCrcSignal" SG_ 576 Checksum_IFC_HCM2 1;
BA_ "IsRcSignal" SG_ 576 RollingCounter_IFC_HCM1 1;
BA_ "IsCrcSignal" SG_ 576 Checksum_IFC_HCM1 1;
BA_ "GenSigStartValue" SG_ 683 ACC_PotentialTgtHeading 30;
BA_ "GenSigStartValue" SG_ 683 ACC_RiTgtHeading 30;
BA_ "GenSigStartValue" SG_ 683 ACC_LeTgtHeading 30;
BA_ "GenSigStartValue" SG_ 683 ACC_RlvTgtHeading 30;
BA_ "IsRcSignal" SG_ 683 RollingCounter_ACC7 1;
BA_ "IsCrcSignal" SG_ 683 Checksum_ACC7 1;
BA_ "IsRcSignal" SG_ 683 RollingCounter_ACC6 1;
BA_ "IsCrcSignal" SG_ 683 Checksum_ACC6 1;
BA_ "IsRcSignal" SG_ 683 RollingCounter_ACC8 1;
BA_ "IsCrcSignal" SG_ 683 Checksum_ACC8 1;
BA_ "IsRcSignal" SG_ 683 RollingCounter_ACC4 1;
BA_ "GenSigStartValue" SG_ 683 ACC_SpdSetValue 255;
BA_ "GenSigStartValue" SG_ 683 TJA_ICA_ModDisp 1;
BA_ "GenSigStartValue" SG_ 683 ACC_ModDisp 1;
BA_ "IsCrcSignal" SG_ 683 Checksum_ACC4 1;
BA_ "IsRcSignal" SG_ 683 RollingCounter_ACC3 1;
BA_ "IsCrcSignal" SG_ 683 Checksum_ACC3 1;
BA_ "GenSigStartValue" SG_ 692 JAPedObjID 255;
BA_ "GenSigStartValue" SG_ 692 AEBJAObjID 255;
BA_ "GenSigStartValue" SG_ 696 BrdgDst 63;
BA_ "GenSigStartValue" SG_ 696 TunnelDst 63;
BA_ "GenSigStartValue" SG_ 696 CurveDst 63;
BA_ "GenSigStartValue" SG_ 696 SpdLimit 254;
BA_ "GenSigStartValue" SG_ 696 RampDst 63;
BA_ "GenSigStartValue" SG_ 696 RoadCrvtFar 511;
BA_ "GenSigStartValue" SG_ 696 SpdLimitDst 63;
BA_ "GenSigStartValue" SG_ 696 RoadCrvt 511;
BA_ "GenSigStartValue" SG_ 696 ACCTgtObjID 255;
BA_ "GenSigStartValue" SG_ 696 PedObjID 255;
BA_ "GenSigStartValue" SG_ 696 CyclistObjID 255;
BA_ "GenSigStartValue" SG_ 696 AEBObjID 255;
VAL_ 347 RWSModReq 0 "No_Request" 1 "Adas_Request" ;
VAL_ 347 APA_ModFlag 0 "No_Action" 1 "EPS_only" 2 "EPS_and_RWS" ;
VAL_ 347 RWSAngReqVld 0 "Invalid" 1 "Valid" ;
VAL_ 347 RWSAngReq 0 "Initial_Value" ;
VAL_ 347 RollingCounter_HAP3 15 "Invalid_value" ;
VAL_ 347 SlotConfirmBtn_Ena 0 "No_Display" 1 "Disable" 2 "Enable" 3 "Active" ;
VAL_ 347 AnticlockwiseBtn_Ena 0 "No_Display" 1 "Disable" 2 "Enable" 3 "Active" ;
VAL_ 347 ClockwiseBtn_Ena 0 "No_Display" 1 "Disable" 2 "Enable" 3 "Active" ;
VAL_ 347 VerticalSlotBtn_Ena 0 "No_Display" 1 "Disable" 2 "Enable" 3 "Active" ;
VAL_ 347 ParallelSlotBtn_Ena 0 "No_Display" 1 "Disable" 2 "Enable" 3 "Active" ;
VAL_ 347 PAVP_FuncSts 0 "PAVP_Function_standby" 1 "PAVP_Function_disable" ;
VAL_ 347 PAVP_TextDis2 0 "No_tex" 1 "Drop_off_area_picture_request" 2 "Path_list_showing_request" 3 "Find_a_slot_do_you_want_to_start_parking_or_RPA" 4 "Do_you_want_to_start_parking" 5 "Which_slots_do_you_want_to_park_and_start_parking" 6 "Which_slots_do_you_want_to_park_and_start_parking_no_RPA" 7 "Which_slots_do_you_want_to_park" 8 "Do_you_want_to_start_parking_or_RPA" 33 "Please_watch_out_for_scratches" 34 "The_space_is_tiqht_folding_the _side_mirrors" ;
VAL_ 347 HAVP_FuncSts 0 "HAVP_Function_standby" 1 "HAVP_Function_active" 2 "HAVP_Function_disable" ;
VAL_ 347 PAVP_TextDis 0 "No_tex" 1 "Selfchecking" 2 "AVP_unavailable" 3 "Map_update_failed" 4 "Wrong_position" 5 "Req_Close_Door_all_doors" 6 "Req_Close_Hood_door" 7 "Req_Close_Trunk_door" 8 "Req_Gear_P_EPB" 9 "Path_download_failed" 10 "Power_off_failed" 11 "Pick_up_location" 12 "Drop_off_area" 13 "No_parking_lot" 14 "Parking_in_inprocess" 15 "Parking_in_complete" 16 "Task_failed" 17 "Parking_out_in_process" 18 "Cruising" 19 "Parking_out_complete" 20 "Req_Quit_System_failure" 21 "Req_Suspend_User_Req" 22 "Req_Quit_EPS_failure" 23 "Req_Quit_ESP_failure" 24 "Req_Abort_Terminate_Button_Pressed_HMI_Cancel_RD_Cancel" 25 "Req_Abort_Steering_Wheel_Intervention" 26 "Req_Abort_Gear_Intervention" 27 "Req_Abort_EPB_Intervention" 28 "Req_Abort_Function_Activation" 32 "Req_Abort_Parking_Timeout" 33 "Req_Abort_Speed_high" 34 "Req_Abort_Parking_Too_Many_Times" 35 "Req_Abort_Hood_Open" 36 "Req_Abort_Trunk_Open" 37 "Req_Abort_Door_Open" 38 "Req_Abort_Deficient_Space" 39 "Req_Abort_Network_Disconnection" 40 "Req_Abort_Path_Invalid" 41 "Req_Abort_Parking_Lot_Invalid" 42 "Req_Abort_Rear_Mirror_Fold" 43 "Req_Abort_ODD_Dissatisfied" 44 "Req_Abort_Suspend_Too_Many_Times" 45 "Req_Abort_Suspend_Timeout" 46 "Req_Abort_Tire_Pressure" 47 "Req_Abort_TBOX_Err" 48 "Network_fault" 49 "No_parking_area" ;
VAL_ 347 HAVP_SelfParLotEnding_Ena 0 "No_Display" 1 "Disable" 2 "Enable" 3 "Active" ;
VAL_ 347 PAVP_Status 0 "OFF" 1 "Standby" 2 "Position" 3 "Preactive" 4 "Restore_Cruising" 5 "Summon_Crusing" 6 "Parking" 7 "Outing" 8 "Completed" 9 "Suspend" 10 "Abort" 11 "Failure" 12 "Disable" ;
VAL_ 347 HAVP_StopBtn_Ena 0 "No_Display" 1 "Disable" 2 "Enable" 3 "Active" ;
VAL_ 347 HAVP_StartBtn_Ena 0 "No_Display" 1 "Disable" 2 "Enable" 3 "Active" ;
VAL_ 347 HAVP_WorkSts 0 "OFF" 1 "Standby" 2 "VLAP_Roaming" 3 "VLAP_Parking" 4 "VLAP_Pause" 5 "Summon Crusing" 6 "Parking" 7 "Outing" 8 "Completed" 9 "Suspend" 10 "Abort" 11 "Failure" 12 "Disable" 13 "Study" ;
VAL_ 347 RollingCounter_HAP1 15 "Invalid_value" ;
VAL_ 347 AVP_T_BOX_WorkSts 0 "OFF" 1 "HAVP_ON" 2 "PAVP_ON" 3 "Failure" ;
VAL_ 347 AVP_SunroofCloseReq 0 "No_Request" 1 "Request_To_Close" 2 "Request_To_Open" ;
VAL_ 347 RmtCtrlSts 0 "OFF" 1 "ON" ;
VAL_ 347 AVP_CenCtrllockReq 0 "No_Request" 1 "Lock" 2 "Unlock" ;
VAL_ 347 AVP_WindLockReq 0 "No_Request" 1 "Request_To_Close" 2 "Request_To_Open" ;
VAL_ 347 AVP_PowerModeReq 0 "No_Request" 1 "Power_OFF_Request" 2 "Power_On_Request" ;
VAL_ 347 AVP_FWshrReq 0 "No_Request" 1 "Wiper_Wash" 2 "Wash_In_Auto_Mode" 3 "OFF" ;
VAL_ 347 AVP_FWiperReq 0 "No_Request" 1 "Wiper_Auto_Or_Intermittent" 2 "Low_Speed" 3 "High_Speed" 4 "Wiper_Off" 7 "Error" ;
VAL_ 347 AVP_HornReq 0 "No_Request" 1 "Turn_OFF" 2 "Turn_ON" ;
VAL_ 347 AVP_RFogLightReq 0 "Turn_OFF" 1 "Turn_ON" ;
VAL_ 347 AVP_FFogLightReq 0 "Turn_OFF" 1 "Turn_ON" ;
VAL_ 347 AVP_DippedBeamReq 0 "No_request" 1 "Turn_OFF" 2 "Turn_ON" ;
VAL_ 347 AVP_HiBeamtReq 0 "No_request" 1 "Turn_OFF" 2 "Turn_ON" ;
VAL_ 347 P2P_PrkgDirectSts 0 "P2P_Park_in" 1 "P2P_Summon" ;
VAL_ 347 APS_MovgDirc 0 "No_Display" 1 "Moving_forward" 2 "Moving_backward" ;
VAL_ 347 TailVertPrkgOutVald 0 "Valid" 1 "Invalid" ;
VAL_ 347 HeadVertPrkgOutVald 0 "Valid" 1 "Invalid" ;
VAL_ 347 RParaPrkgOutVald 0 "Valid" 1 "Invalid" ;
VAL_ 347 LParaPrkgOutVald 0 "Valid" 1 "Invalid" ;
VAL_ 347 RmtPrkgReq 0 "No_Request" 1 "Request_To_Parking_In" ;
VAL_ 347 P2P_Pah2Avail 0 "Not_avalible" 1 "Avalible" ;
VAL_ 347 P2P_SelfDetSts 0 "No_Action" 1 "Detecting" 2 "Successed" 3 "Failed" ;
VAL_ 347 P2P_Pah1Avail 0 "Not_avalible" 1 "Avalible" ;
VAL_ 347 P2P_SelfDetErrCode 0 "No_Error" 1 "HAP_Error" 2 "Tyre_pressure_error" 3 "Door_open" 4 "Trunk_open" 5 "Vehicle_moving" 6 "Environment_error" 7 "Camera_is_smudgy" 8 "Seat_belt_not_fastened" 9 "Mirror_is_folded" 10 "Associated_system_error" ;
VAL_ 347 HAP_SwtDispCtrlCmd 0 "No_Display" 1 "Park_out_direction_Select_menu" 2 "Continue_park_menu" 3 "Study_finish_button" 4 "Continue_RADS_menu" 5 "RDAS_active_distance_arrow_steering" 6 "Continue_FADS_menu" ;
VAL_ 347 P2P_PahDelSts 0 "No_Action" 1 "Detecting" 2 "Successed" 3 "Failed" ;
VAL_ 347 HAP_PrkgModCurrSts 0 "No_Display" 1 "Left_parallel_park_in" 2 "Right_parallel_park_in" 3 "Left_vert_park_in" 4 "Right_vert_park_in" 5 "Left_Tshape_park_in" 6 "Right_Tshape_park_in" 7 "Left_parallel_park_out" 8 "Right_parallel_park_out" 9 "Front_vert_park_out" 10 "Rear_vert_park_out" 11 "P2P_Summon" 12 "Left_front_vert_park_out" 13 "Right_front_vert_park_out" 14 "Left_rear_vert_park_out" 15 "Right_rear_vert_park_out" ;
VAL_ 347 APS_PASSwtReq 0 "NO_Request" 1 "Request_To_Close" 2 "Request_To_Open" ;
VAL_ 347 RollingCounter_AVP1 15 "Invalid_value" ;
VAL_ 347 DrvDirCllsnWarnTrqCtrlFlg 0 "Initial_Value" 1 "Not_Active" 2 "ADC_Limit_Torque" 3 "ADC_Clear_Torque" 4 "ADC_Only_Warning" 5 "HAP_PAS_Clear_Torque" ;
VAL_ 347 DrvDirMstRskObstclCllsnTim 0 "Initial_Value" 63 "Invalid_Value" ;
VAL_ 347 AVP_ESP_LSMNudgeReq 0 "No_Request" 1 "Requested" ;
VAL_ 347 AVP_ESP_LSMVehSecReq 0 "No_Request" 1 "Requested" ;
VAL_ 347 AVP_ESP_LSMComfBrakeReq 0 "ComfBrakeReq_NoReq" 1 "ComfBrakeReq_Type1" 2 "ComfBrakeReq_Type2" ;
VAL_ 347 AVP_ESP_LSMVehDirRq 0 "DirReq_None" 1 "DirReq_Forward" 2 "DirReq_Backward" ;
VAL_ 347 AVP_ESP_LSMSubMTLong 0 "MTLong_None" 1 "MTLong_Comfort" 2 "MTLong_Emergency" 3 "MTLong_Reserved" ;
VAL_ 347 AVP_ESP_LSMPrefill 0 "No_Request" 1 "Requested" ;
VAL_ 347 AVP_ESP_LSMSubMTLevel 0 "MTLevel_None" 1 "MTLevel_12" 2 "MTLevel_23" 3 "MTLevel_Reserved" ;
VAL_ 347 AVP_ESP_SafeDrvrHandoverReq 0 "No_Request" 1 "Requested" ;
VAL_ 347 AVP_ESP_LSMSubMTReq 0 "MTReq_None" 1 "MTReq_Drive" 2 "MTReq_LSM" ;
VAL_ 347 AVP_ESP_DriverPresenceExternal 0 "False" 1 "True" ;
VAL_ 347 RollingCounter_APS4 15 "Invalid_value" ;
VAL_ 347 RHeadVertPrkgOutVald 0 "Valid" 1 "Invalid" ;
VAL_ 347 LHeadVertPrkgOutVald 0 "Valid" 1 "Invalid" ;
VAL_ 347 RTailVertPrkgOutVald 0 "Valid" 1 "Invalid" ;
VAL_ 347 LTailVertPrkgOutVald 0 "Valid" 1 "Invalid" ;
VAL_ 347 MEB_AVHReq 0 "No_Request" 1 "Request" ;
VAL_ 347 PrkMod 0 "No_Action" 1 "Head_parking_in" 2 "Tail_parking_in" ;
VAL_ 347 APS_WorkSts 0 "Disable" 1 "Standby" 2 "Searching" 3 "Guidance" 4 "Failed" 5 "Wait_For_Engine_Restart" ;
VAL_ 347 MEB_BrkgReq 0 "No_Request" 1 "Request" ;
VAL_ 347 MEBErrSts 0 "No_Error" 1 "Error" ;
VAL_ 347 APS_BrkModSts 0 "ParkAssist_Int" 1 "ParkAssist_Standby" 2 "ParkAssist_Active" 3 "ParkAssist_ManeuverFinished" 4 "ParkAssist_Suspend_Reserved" 5 "ParkAssist_Abort" ;
VAL_ 347 APS_BrkCategory 0 "ParkAssist_Idle" 1 "ParkAssist_Comfort" 2 "ParkAssist_Emergency" ;
VAL_ 347 APS_ESP_TgtGearReq 0 "No_request" 1 "P" 2 "R" 3 "N" 4 "D" 5 "D_Dynamic" 6 "R_Dynamic" ;
VAL_ 347 APS_BrkFctnMod 0 "ParkAssist_NoSignal" 1 "parkAssist_RemotePark" 3 "ParkAssist_AutomaticPark" ;
VAL_ 347 RollingCounter_APS1 15 "Invalid_value" ;
VAL_ 347 OutdPrkgSts 0 "Initial_value" 1 "OFF" 2 "ON" ;
VAL_ 347 TurnLightsCmd 0 "No_Request" 1 "LeftLight_On" 2 "RightLight_On" 3 "HazardLight_ON" ;
VAL_ 347 APS_PrkgMod 0 "None" 1 "Parking_In" 2 "Parking_Out" ;
VAL_ 347 APS_PrkgTyp 0 "None" 1 "Parallel_Parking" 2 "Vertical_Parking" ;
VAL_ 347 APS_SwtSts 0 "No_Press" 1 "Press" ;
VAL_ 347 APS_ProcBar 127 "No_Display" ;
VAL_ 347 APS_TextDisp 0 "No_Request" 1 "Wrong_gear_position_to_start_parking" 2 "Turn_D_to_search_for_slot" 3 "Please_close_the_trunk" 4 "Please_close_the_door" 5 "Please_fasten_the_seat_belt" 6 "Please_unfold_the_Mirror" 7 "Speed_is_too_high_need_Less_than_23km_h" 8 "System_error_Parking_sys_exits" 9 "control_unit_error_parking_sys_exits" 10 "Please_brake" 11 "please_select_parking_mode" 12 "please_select_internal_parking" 13 "please_select_Slot_and_parking_mode" 14 "please_select_Slot_and_internal_parking" 15 "Please_keep_braking" 16 "Hands_off_the_steering_wheel" 17 "Release_the_brake_parking_start" 18 "Auto_parking_be_ready_to_brake" 19 "parking_suspended_close_trunk" 20 "parking_suspended_close_door" 21 "parking_suspended_fasten_seat_belt" 22 "Obstacles_Detected" 23 "brake_recovered_confirm_to_continue" 24 "Parking_quited" 25 "parking_finished" 26 "interfered_by_driver_parking_quited" 27 "too_many_parking_times_parking_sys_exits" 28 "Parking_time_too_long_Parking_sys_exits" 29 "Too_Small_Slot_Parking_sys_exits" 30 "Please_Clean_the_Camera" 31 "Select_the_parking_mode_APA3" 32 "Searching_the_right_slot" 33 "Searching_the_left_slot" 34 "Please_turn_D_to_search_for_parking_slot" 35 "Speed_is_too_high_need_Less_than_30km_h" 36 "Speed_is_too_high_sys_exits" 37 "Select_parking_type" 38 "Long_press_switch_2s_to_enter_auto_parking" 39 "Parking_suspended_Please_release_the_gas_pedal" 40 "Please_brake_And_long_press_switch_2s_to_continue_auto_parking" 41 "Parking_is_not_available" 42 "Please_select_the_parking_direction_by_turning_the_turn_switch" 43 "Please_brake_And_long_press_switch_2s_to_enter_POC_left" 44 "Parking_sys_exits" 45 "Parking_suspended_fold_the_Mirror" 46 "Too_Small_Slot_Please_select_another_direction" 47 "Driving_Mode_not_supported" 48 "Path_is_smooth" 49 "Please_select_park_out" 50 "Please_select_park_out_direction" 51 "Please_get_off_the_car_with_keys_to_start_remote_parking" 52 "Please_confirm_to_start_parking" 53 "Remote_Parking_in_exit" 54 "Parking_suspended_Remote_connection_error" 55 "System_error_Parking_sys_can_not_start" 56 "Control_unit_error_Parking_sys_can_not_start" 57 "Please_Turn_P_and_Apply_EPB_Remote_parking_sys_not_Running" 58 "Select_Remote_parking_out_type" 59 "Please_brake_And_long_press_switch_2s_to_enter_POC_Right" 60 "Please_release_switch_to_en-ter_guidance" 61 "Slope_over_system_exits" 62 "Please_select_Summon_Path" 63 "Slot_found" 64 "Path_study_begin_please_drive_the_car" 65 "Path_studying" 66 "Confirm_study_finished" 67 "Path_studying_failed_caused_by_Path_too_long" 68 "Path_studying_failed_caused_by_Speed_too_high" 69 "Path_studying_failed_caused_by_communication_error" 70 "Path_studying_failed_caused_by_Path_error" 71 "Path_studying_failed_caused_by_learn_time_too_long" 72 "Path_studying_failed_caused_by_internal_error" 73 "Path_studying_failed_caused_by_Path_too_short" 74 "Path_studying_failed_caused_by_Path_backward_too_long" 75 "Path_studying_failed_caused_by_shift_gear_too_many_times" 76 "Speed_is_too_high_need_Less_than_5km_h" 77 "Speed_is_too_high_need_Less_than_10km_h" 78 "Speed_is_too_high_need_Less_than_15km_h" 79 "Parking_out_is_available" 80 "Path_saving" 81 "Path_saving_Succeed" 82 "Path_saving_failed_caused_by_Path_too_short" 83 "Path_saving_failed_caused_by_communication_error" 84 "Path_saving_failed_caused_by_Path_error" 85 "Path_saving_failed_caused_by_Path_error_limit_storage_room" 86 "Path_saving_failed_caused_by_internal_error" 87 "Please_stop_if_you_need_to_park" 88 "Please_release_the_accelerator_pedal" 89 "Vehicles_can_be_taken_over_in_advance" 90 "You_have_taken_over_the_vehicle" 91 "Taken_over_the_vehicle_sys_exit" 92 "Not_Available_in_Valet_mode" 93 "Take_over_feedback" 94 "Narrow_slot_switched_to_head-in_parking" 95 "Narrow_slot_switched_to_reverse_parking" 96 "Please_drive_to_path_start_point" 97 "Path_matche_please_stop" 98 "Please_select_play_back_mode" 99 "Path_match_failed_caused_by_communication_error" 100 "Path_match_failed_caused_by_path_error" 101 "Path_match_failed_caused_by_long_time_no_action" 102 "Path_match_failed_caused_by_internal_error" 103 "The_maximun_path_length_is_about_to_be_exceeded" 104 "Auto_parking_be_ready_to_break" 105 "Map_data_abnormal_system_exit" 106 "Trailer_hitch_open_sys_unavailable" 107 "Differential_lock_open_sys_unavailable" 108 "Trailer_hitch_open_sys_exit" 109 "Differential_lock_open_sys_exit" 110 "Switched_to_head-in_parking" 111 "Switched_to_reverse_parking" 112 "No_save_distance_RADS_sys_esits" 113 "RADS_running_be_ready_to_brake" 114 "Near_the_bourn" 115 "Arrive_at_the_bourn" 116 "Release_the_brake" 117 "Trunk_open_RADS_sys_exits" 118 "Door_open_RADS_sys_exits" 119 "Seat_belt_drop_RADS_sys_exits" 120 "Mirror_fold_RADS_sys_exits" 121 "Obstacles_Detected_RADS_sys_exits" 122 "No_continue_driving_Parking_quited" 123 "Please_turn_to_R" 124 "Release_the_brake_Driving_assistance_start" 125 "Please_turn_to_D" 126 "RADS_suspended__Please_release_the_break_pedal" 127 "RADS_recovered__confirm_to_continue" 128 "FADS_running_be_ready_to_brake" 129 "Trunk_open_FADS_sys_exits" 130 "Door_open_FADS_sys_exits" 131 "Seat_belt_drop_FADS_sys_exits" 132 "Mirror_fold_FADS_sys_exits" 133 "Obstacles_Detected_FADS_sys_exits" 134 "Vehicle_can_not_move_FADS_sys_exits" 135 "Remote_control_straight_Search" 136 "Over_limit_search_distance" 137 "Please_select_suitable_parking_slot_icon" 138 "Please_drag_the_parking_slot_to_suitable_place_and_adjust_the_angle" 139 "Move_over_25m_system_exits" 140 "Move_over_5m_system_exits" 141 "Parking_suspended_Please_release_the_break_pedal" 142 "RADS_suspended_Detecte_obstacles" 143 "FADS_suspended_Detecte_obstacles" 144 "FADS_recovered_confirm_to_continue" 145 "Front_camera_dirty_Please_Clean_the_Camera" 146 "Rear_camera_dirty_Please_Clean_the_Camera" 147 "Left_camera_dirty_Please_Clean_the_Camera" 148 "Right_camera_dirty_Please_Clean_the_Camera" 149 "DVR_camera_dirty_Please_Clean_the_Camera" 150 "FADS_suspended_Please_release_the_break_pedal" 151 "Please_close_cabin_cover" 152 "Please_pull_out_the_charging_gun" 153 "Would_you_like_to_park_in" 154 "You_can_select_slot_and_park_it" 155 "Pay_attention_to_the_risk_of_scratches" 156 "Detecting_parking_space" 157 "Please_ready" 158 "Guide_successful_Please_start_charging" 159 "Wireless_charging_guidance_positioning" 160 "Wireless_charging_aligned_parking_complete" 161 "Parking_suspended_pedestrian_detected" 162 "Parking_suspended_vehicle_detected" 163 "Parking_continues" 164 "Parking_out_completed_please_take_over_vehicle" 165 "Environment_cannot_be_parked" 166 "Put_on_the_P_pull_up_EPB_close_door_for_remote_parking" 167 "Connection_abnormal_parking_cannot_be_started" 168 "Remote_parking_be_ready_to_stop" 169 "Select_parking_out_mode" 170 "Parking_suspended_close_cabin_cover" 171 "RADS_Suspended_loosen_accelerator_pedal" 172 "RADS_Suspended_close_cabin_cover" 173 "Steering_wheel_intervention_RADS_exits" 174 "EPB_intervention_RADS_exits" 175 "Gear_intervention_RADS_exits" 176 "Speed_too_high_RADS_exits" 177 "Time_out_RADS_exits" 178 "Too_many_times_RADS_exits" 179 "Trunk_open_RADS_sys_suspend" 180 "Door_open_RADS_sys_suspend" 181 "Seat_belt_drop_RADS_sys_suspend" 182 "Mirror_fold_RADS_sys_suspend" 183 "Obstacles_Detected" 184 "Detected_Obstacles" 185 "Avoid_nearby_obstacles" 186 "RADS_exit" 187 "Slot_small_use_RPA" 188 "Camera_fault_sys_exits" 189 "Camera_block_sys_exits" 190 "Slope_over_sys_unavailable" 191 "Other_assisit_activate_sys_exits" 192 "USS_system_failure_sys_unavailable" 193 "Parking_system_failure_sys_unavailable" 194 "Speed_is_too_high_sys_unavailable" 195 "Control_unit_error_sys_unavailable" 196 "AVM_not_calibrated_sys_unavailable" 197 "Camera_Failure_sys_unavailable" 198 "Other_auxiliary_driving_functions_are_activated_sys_unavailable" 199 "Active_security_feature_activation_sys_unavailable" 200 "Camera_dirty_sys_unavailable" 201 "Camera_is_blocked_sys_unavailable" 202 "Driving_Mode_not_supported_sys_unavailable" 203 "Path_is_unobstructed_sys_unavailable" 204 "Single_call_exceeds_the_limit_distance" 205 "Encounter_obstacles_laterally_Parking_suspension" 206 "Parking_system_failure__please_take_over_the_vehicle_in_time" 207 "Trunk_open_FADS_sys_suspend" 208 "System_exit_please_take_over_the_vehicle" 209 "Door_open_FADS_sys_suspend" 210 "Seat_belt_drop_FADS_sys_suspend" 211 "Mirror_fold_FADS_sys_suspend" 212 "FADS_exit" 213 "FADS_Suspended_loosen_accelerator_pedal" 214 "Speed_too_high_FADS_exits" 215 "Slope_exceeding_limit_Please_leave_the_ramp" 216 "Vehicle_not_ready_parking_system_exit" 217 "Suspension_mode_not_supported_sys_unavailable" 218 "Sys_unavailable" 219 "Parking_has_not_started_please_be_aware_of_the_slip_drive" 220 "Trajectory_planning" 221 "Trajectory_planning_failed" 222 "Looking_for_a_parking_space" 223 "Park_at_the_rear_of_the_car_click_Start_Parking" 224 "Park_at_the_front_of_the_car_click_Start_Parking" 225 "Can't_park_in_park_and_exit" 226 "Remote_parking_is_not_available" 227 "The_rear_of_the_car_is_parked_and_Slot_small_use_RPA" 228 "The_front_of_the_car_is_parked__and_Slot_small_use_RPA" 229 "The_mirrors_are_folded_be_aware_of_your_surroundings" 230 "Suspension_mode_not_supported_sys_unavailable" 231 "No_driving_trajectory_The_system_is_temporarily_unavailable" 232 "Lidar_Failure_sys_unavailable" 233 "Lidar_obstruction_sys_unavailable" 234 "Lidar_obstruction_sys_exits" 235 "Lidar_abnormal_sys_exits" 236 "USS_failure_sys_exits" 237 "Unable_park_out_sys_exit" 238 "Please_press_the_brake_and_select_the_parking_direction" 239 "Unmanned_parking_process" 240 "Unmanned_parking_is_suspended" 241 "Press_the_brakes_and_adjust_the_parking_position" 242 "The_rearview_mirror_is_about_to_be_folded" 243 "Unmanned_parking_is_success" 244 "Unmanned_parking_abnormal_sys_exit" ;
VAL_ 347 APS_ReqCtrlEPS 0 "No_Request" 1 "Request" ;
VAL_ 347 APS_ReqEPSTgtAngValid 0 "Invalid" 1 "Valid" ;
VAL_ 347 APS_SlotDisp 0 "No_Parking_Slot" 1 "Left_Parallel_Parking_Slot" 2 "Left_Vertical_Parking_Slot" 3 "Left_T_shape_Parking_Slot" 4 "Right_Parallel_Parking_Slot" 5 "Right_Vertical_Parking_Slot" 6 "Right_T_shape_Parking_Slot" ;
VAL_ 347 APS_SysSoundIndcn 0 "No_sound" 1 "parking_unavailable" 2 "parking_found" 3 "parking_suspend" 4 "parking_start" 5 "HAVP_AVP_ready" 6 "HAVP_AVP_finish" 7 "HAVP_AVP_route_finish" ;
VAL_ 347 RollingCounter_APA1 15 "Invalid_value" ;
VAL_ 347 APA_BrkFctnMod 0 "None" 1 "APA" 2 "RPA" 3 "AVP" 4 "MEB" 5 "Request_barke_compensation" 6 "Request_hold_brake" ;
VAL_ 347 APA_ApStandstillReq 0 "Flase" 1 "True" ;
VAL_ 347 APA_ApDriveOffReq 0 "Flase" 1 "True" ;
VAL_ 347 APA_ApEmgyBrkReq 0 "Flase" 1 "True" ;
VAL_ 347 APA_AxReqEna 0 "Flase" 1 "True" ;
VAL_ 347 APA_ApbReq 0 "None" 1 "ReleaseReq" 2 "ApplyReq" ;
VAL_ 628 SlopViewFuncReq 0 "Initial_Value" 1 "OFF" 2 "ON" ;
VAL_ 628 SlopViewSts 0 "Initial_Value" 1 "OFF" 2 "ON" ;
VAL_ 628 AutoAVMmodSts 0 "Initial_Value" 1 "Half_screen" 2 "Full_screen" ;
VAL_ 628 WheWarning 0 "No_warning" 1 "Left_front_warning" 2 "Left_rear_waring" 3 "Right_front_waring" 4 "Right_rear_waring" 5 "Front_warning" 6 "Rear_warning" 7 "Left_warning" 8 "Right_waring" 9 "Front_left_rear_right_warning" 10 "Left_rear_front_right_warning" 11 "Excluding_right_rear_warning" 12 "Excluding_right_front_warning" 13 "Excluding_left_front_warning" 14 "Excluding_left_rear_warning" 15 "All_warning" ;
VAL_ 628 ParkSlotDispR3 0 "No_valid" 1 "Valid" ;
VAL_ 628 ParkSlotDispR2 0 "No_valid" 1 "Valid" ;
VAL_ 628 ParkSlotDispR1 0 "No_valid" 1 "Valid" ;
VAL_ 628 ParkSlotDispL3 0 "No_valid" 1 "Valid" ;
VAL_ 628 ParkSlotDispL2 0 "No_valid" 1 "Valid" ;
VAL_ 628 ParkSlotDispL1 0 "No_valid" 1 "Valid" ;
VAL_ 628 HAP_Hmi_Index 1 "Main_Screen" 2 "EOL_Test" 3 "P2P_Screen" 4 "Assist_Screen" 5 "HAVP_Screen" 6 "PAVP_Screen" 7 "RADS_Screen" 8 "FADS_Screen" ;
VAL_ 628 DVRWorkSts 0 "DVR_Standby" 1 "DVR_Active" 2 "DVR_InterFailed" 3 "DVR_NetFailed" ;
VAL_ 628 HAP_DispCmd 0 "OFF" 1 "ON" ;
VAL_ 628 AVM_3DAngSts 0 "Not_Active" 1 "Valid_values" 511 "Invalid" ;
VAL_ 628 OvlOpFailSts 0 "No_failure" 1 "Failure" ;
VAL_ 628 TraOvlSts 0 "OFF" 1 "ON" ;
VAL_ 628 EolNotCmpltd 0 "Ccompleted" 1 "No_Completed" ;
VAL_ 628 FrntCamInpFailSts 0 "No_Failure" 1 "Failure" ;
VAL_ 628 RearCamInpFailSts 0 "No_failure" 1 "Failure" ;
VAL_ 628 LeCamInpFailSts 0 "No_failure" 1 "Failure" ;
VAL_ 628 RiCamInpFailSts 0 "No_Failure" 1 "Failure" ;
VAL_ 628 CurrCalResultSts 0 "Use_Factory_Calibration_Result" 1 "Use_Lane_Calibration_Result" ;
VAL_ 628 LaneCalFltSts 0 "No_fault" 1 "Front_view_Calibration_abnormal" 2 "Rear_view_Calibration_abnormal" 3 "left_view_Calibration_abnormal" 4 "Right_view_Calibration_abnormal" 5 "Calibration_data_storage_failed" ;
VAL_ 628 LaneCalSts 0 "No_Commands" 1 "In_Calibration_process" 2 "Calibration_success" 3 "Calibration_failure" ;
VAL_ 628 CarMdlTrsprcySts 0 "Opaque" 1 "Translucent" 2 "Completely_Transparent" 3 "Failure" ;
VAL_ 628 MdlColrSts 0 "Silvery" 1 "Red" 2 "Gray" 3 "White" 4 "Black" 5 "Brown" 6 "Blue" 7 "Orange" 8 "Green" 9 "Gold" 10 "Purple" ;
VAL_ 628 RadarDispSts 0 "Both_Around_View_and_Single_View_Radar_Display" 1 "Only_Around_View_Radar_Display" 2 "Only_Single_View_Radar_Display" 3 "No_Radar_Display" ;
VAL_ 628 GuidOvlSts 0 "Around_View_and_Single_View" 1 "Only_Around_View" 2 "Only_Single_View" 3 "No_Guidance" ;
VAL_ 628 WheelVieSts 0 "Initial_value" 1 "Two_wheel_mode" 2 "Four_wheel_mode" 3 "Reversed" ;
VAL_ 628 AutoAVMSwtSet_Sts 0 "OFF" 1 "ON" ;
VAL_ 628 AutoViewChgFuncSts 0 "OFF" 1 "ON" ;
VAL_ 628 CarMdlDispSts 0 "_2D_Mode" 1 "_3D_Mode" ;
VAL_ 628 MOD_AlarmSts 0 "OFF" 1 "ON" ;
VAL_ 628 MOD_WorkSts 0 "OFF" 1 "ON" ;
VAL_ 628 SigViewIndcn 0 "No_Commands" 1 "Front_to_Center_View" 2 "Rear_to_Center_View" 3 "Left_to_Center_View" 4 "Right_to_Center_View" 5 "Left_Front_to_Center_View" 6 "Right_Front_to_Center_View" 7 "Left_Rear_to_Center_View" 8 "Right_Rear_to_Center_View" 9 "Front_View" 10 "Rear_View" 11 "Left_View" 12 "Right_View" 13 "Left_Turn_3D_View" 14 "Right_Turn_3D_View" 15 "Front_Overlook_View" 16 "Rear_Overlook_View" 17 "Front_180_Deg_View" 18 "Rear_180_Deg_View" 19 "Front_Wheel_View" 20 "Rear_Wheel_View" 21 "Front_Wash_View" 22 "Rear_Wash_View" 23 "Free_3D_View" 24 "LeftRight_View" 25 "Engine_Room_View" 26 "CCO_View" 27 "Wireless_Charging_View" 63 "3D_Car_Model_Round_View" ;
VAL_ 628 AVM_CurrSts 0 "OFF" 1 "ON" 2 "AVM_No_Video" 3 "Initialling" ;
VAL_ 664 RiCamDirtySts 0 "Normal" 1 "Abnormal" ;
VAL_ 664 LeCamDirtySts 0 "Normal" 1 "Abnormal" ;
VAL_ 664 RearCamDirtySts 0 "Normal" 1 "Abnormal" ;
VAL_ 664 FrntCamDirtySts 0 "Normal" 1 "Abnormal" ;
VAL_ 664 DVRCamDirtySts 0 "Normal" 1 "Abnormal" ;
VAL_ 664 SteerWheelsilentSts 0 "Initial_value" 1 "OFF" 2 "ON" ;
VAL_ 664 VLAPSpdSetVal 0 "Initial_value" 1 "Vaild value" ;
VAL_ 664 PrkgFuncStsLmp 0 "Initial_value" 1 "VLAP_Passive" 2 "VLAP_Roaming_Standby" 3 "VLAP_Crusing_Standby" 4 "VLAP_Roaming_Active" 5 "VLAP_Crusing_Active" 6 "VLAP_Crusing_Override" 7 "HAVP_Standby" 8 "HAVP_Active" 9 "HAVP_Override" 10 "APA_Standby" 11 "APA_Active" 12 "RADS_Standby" 13 "RADS_Active" ;
VAL_ 664 AVPworkSts 0 "Initial_Value" 1 "Idle" 2 "Checking" 3 "Standby" 4 "Routing" 5 "Routing_pass" 6 "APA_OUT" 7 "Cruising" 8 "APA_IN" 9 "Suspend" 10 "Fault" ;
VAL_ 664 ShldKeyDoorHndlReqVld 0 "Invalid" 1 "Valid" ;
VAL_ 664 ShldKeyDoorHndlReq 0 "Initial_Value" 1 "Shield_key_and_door_handle_operation" ;
VAL_ 664 OneclickClsIntellgntDrvgSts 0 "Initial_value" 1 "OFF" 2 "ON" ;
VAL_ 664 RmtPrkRadShieldSts 0 "No_shielding" 1 "Bilateral_ultrasonic_radar_shielding" 2 "All_ultrasonic_radar_shielding" ;
VAL_ 664 APS_Coordinate_Y 2047 "Invalid_value" ;
VAL_ 664 APS_Coordinate_X 511 "Invalid_value" ;
VAL_ 664 APS_Coordinate_Angle 511 "Invalid_value" ;
VAL_ 664 RmtPrkgSts 0 "No_Action" 1 "In_Processing" ;
VAL_ 664 RmtPrkgFinishReq 0 "No_Request" 1 "Park_In_Finish" 2 "Park_Out_Finish" 3 "Park_Error_Exit" ;
VAL_ 664 OrvmCtrlCmd 0 "No_request" 1 "Request_to_Fold" 2 "Request_to_Unfold" ;
VAL_ 664 HAP_TextIconDispCtrl 0 "No_Display" 1 "Display_According_to_text_info" 2 "Display_parking_mode" ;
VAL_ 664 APA_MenuDispCtrlCmd 0 "No_Disp_avm_menu" 1 "Park_in_indicate_menu" 2 "Park_in_select_slot_menu" 3 "Park_in_mode_select_menu" 4 "Park_in_process" 5 "Remote_park_in_process" 6 "Park_out_confirm_menu" 7 "Park_out_process" 8 "Park_in_indicate_menu_NoRPA" 9 "Park_in_select_slot_menu_NoRPA" 10 "Park_in_mode_select_menu_NoRPA" 11 "Park_out_indicate_menu" 12 "User_Defined_Parking_Slot_Menu" 13 "Park_in_RemoteSearchingSlot_menu" 14 "PAVP_screen_section_A" ;
VAL_ 664 FADS_FuncSts 0 "FADS_Function_standby" 1 "FADS_Function_active" 2 "FADS_Function_disable" ;
VAL_ 664 RADS_FuncSts 0 "Reverse_Asist_Function_standby" 1 "Reverse_Asist_Function_active" 2 "Reverse_Asist_Function_disable" 3 "RADS_Coming_soon" ;
VAL_ 664 APA_FuncSts 0 "APA_Function_standby" 1 "APA_Function_active" 2 "APA_Function_disable" 3 "APA_Coming_soon" ;
VAL_ 664 FPAS_NearBrrdstn 127 "No_Display" ;
VAL_ 664 ModifInquiPopReq 0 "Initial_value" 1 "No_display" 2 "Modification_Inquiry" ;
VAL_ 664 FPAS_SoundIndcn 0 "Tone_zero_No_warning" 1 "Tone_one_Long_beep" 2 "Tone_two_two_third_Hz" 3 "Tone_three_3Hz" ;
VAL_ 664 FPAS_AutoModSts 0 "Not_available" 1 "Available" ;
VAL_ 664 FPAS_DispCmd 0 "OFF" 1 "ON" ;
VAL_ 664 FPAS_WorkSts 0 "Disable" 1 "Enable" 2 "Active" 3 "Failed" ;
VAL_ 664 FPAS_FRCornrSnsrFailSts 0 "No_failure" 1 "Failure" ;
VAL_ 664 FPAS_FRMiddlSnsrFailSts 0 "No_failure" 1 "Failure" ;
VAL_ 664 FPAS_FLMiddlSnsrFailSts 0 "No_failure" 1 "Failure" ;
VAL_ 664 FPAS_FLCornrSnsrFailSts 0 "No_failure" 1 "Failure" ;
VAL_ 664 FPAS_ObjFRCornrAr2 0 "No_object" 1 "Object_in_zone_1_0_10cm" 2 "Object_in_zone_2_11_20cm" 3 "Object_in_zone_3_21_30cm" 4 "Object_in_zone_4_31_40cm" 5 "Object_in_zone_5_41_50cm" 6 "Object_in_zone_6_51_60cm" ;
VAL_ 664 FPAS_ObjFRCornrAr1 0 "No_object" 1 "Object_in_zone_1_0_10cm" 2 "Object_in_zone_2_11_20cm" 3 "Object_in_zone_3_21_30cm" 4 "Object_in_zone_4_31_40cm" 5 "Object_in_zone_5_41_50cm" 6 "Object_in_zone_6_51_60cm" ;
VAL_ 664 FPAS_ObjFRMidlAr2 0 "No_object" 1 "Object_in_zone_1_0_10cm" 2 "Object_in_zone_2_11_20cm" 3 "Object_in_zone_3_21_30cm" 4 "Object_in_zone_4_31_40cm" 5 "Object_in_zone_5_41_50cm" 6 "Object_in_zone_6_51_60cm" 7 "Object_in_zone_7_61_70cm" 8 "Object_in_zone_8_71_80cm" 9 "Object_in_zone_9_81_90cm" 10 "Object_in_zone_10_91_100cm" ;
VAL_ 664 FPAS_ObjFRMidlAr1 0 "No_object" 1 "Object_in_zone_1_0_10cm" 2 "Object_in_zone_2_11_20cm" 3 "Object_in_zone_3_21_30cm" 4 "Object_in_zone_4_31_40cm" 5 "Object_in_zone_5_41_50cm" 6 "Object_in_zone_6_51_60cm" 7 "Object_in_zone_7_61_70cm" 8 "Object_in_zone_8_71_80cm" 9 "Object_in_zone_9_81_90cm" 10 "Object_in_zone_10_91_100cm" ;
VAL_ 664 FPAS_ObjFLMidlAr2 0 "No_object" 1 "Object_in_zone_1_0_10cm" 2 "Object_in_zone_2_11_20cm" 3 "Object_in_zone_3_21_30cm" 4 "Object_in_zone_4_31_40cm" 5 "Object_in_zone_5_41_50cm" 6 "Object_in_zone_6_51_60cm" 7 "Object_in_zone_7_61_70cm" 8 "Object_in_zone_8_71_80cm" 9 "Object_in_zone_9_81_90cm" 10 "Object_in_zone_10_91_100cm" ;
VAL_ 664 FPAS_ObjFLMidlAr1 0 "No_object" 1 "Object_in_zone_1_0_10cm" 2 "Object_in_zone_2_11_20cm" 3 "Object_in_zone_3_21_30cm" 4 "Object_in_zone_4_31_40cm" 5 "Object_in_zone_5_41_50cm" 6 "Object_in_zone_6_51_60cm" 7 "Object_in_zone_7_61_70cm" 8 "Object_in_zone_8_71_80cm" 9 "Object_in_zone_9_81_90cm" 10 "Object_in_zone_10_91_100cm" ;
VAL_ 664 FPAS_ObjFLCornrAr2 0 "No_object" 1 "Object_in_zone_1_0_10cm" 2 "Object_in_zone_2_11_20cm" 3 "Object_in_zone_3_21_30cm" 4 "Object_in_zone_4_31_40cm" 5 "Object_in_zone_5_41_50cm" 6 "Object_in_zone_6_51_60cm" ;
VAL_ 664 FPAS_ObjFLCornrAr1 0 "No_object" 1 "Object_in_zone_1_0_10cm" 2 "Object_in_zone_2_11_20cm" 3 "Object_in_zone_3_21_30cm" 4 "Object_in_zone_4_31_40cm" 5 "Object_in_zone_5_41_50cm" 6 "Object_in_zone_6_51_60cm" ;
VAL_ 664 RCTA_DispSwtSts 0 "OFF" 1 "ON" ;
VAL_ 664 AutoPrkOutSwtSts 0 "OFF" 1 "ON" ;
VAL_ 664 MEB_EnableSts 0 "Disable" 1 "Enable" ;
VAL_ 664 MEBWorkSts 0 "OFF" 1 "Enable" 2 "Active" 3 "Failed" ;
VAL_ 664 RPAS_SoundIndcn 0 "Tone_Zero_No_Warning" 1 "Tone_One_Long_Beep" 2 "Tone_Two_Three_Seconds_Hz" 3 "Tone_Three_3Hz" ;
VAL_ 664 CamFolwSwtSts 0 "OFF" 1 "ON" ;
VAL_ 664 APA_BacgrdWorkSts 0 "Not_active" 1 "Active" ;
VAL_ 664 RPAS_WorkSts 0 "Disable" 1 "Enable" 2 "Active" 3 "Failed" ;
VAL_ 664 RPAS_RRCornrSnsrFailSts 0 "No_Failure" 1 "Failure" ;
VAL_ 664 RPAS_RRMiddlSnsrFailSts 0 "No_Failure" 1 "Failure" ;
VAL_ 664 RPAS_RLMiddlSnsrFailSts 0 "No_Failure" 1 "Failure" ;
VAL_ 664 RPAS_RLCornrSnsrFailSts 0 "No_Failure" 1 "Failure" ;
VAL_ 664 RPAS_ObjRLCornrAr2 0 "No_object" 1 "Object_in_zone_1_0_10cm" 2 "Object_in_zone_2_11_20cm" 3 "Object_in_zone_3_21_30cm" 4 "Object_in_zone_4_31_40cm" 5 "Object_in_zone_5_41_50cm" 6 "Object_in_zone_6_51_60cm" 7 "Object_in_zone_7_61_70cm" 8 "Object_in_zone_8_71_80cm" 9 "Object_in_zone_9_81_90cm" 10 "Object_in_zone_10_91_100cm" 11 "Object_in_zone_11_101_110cm" 12 "Object_in_zone_12_111_120cm" ;
VAL_ 664 RPAS_ObjRLCornrAr1 0 "No_object" 1 "Object_in_zone_1_0_10cm" 2 "Object_in_zone_2_11_20cm" 3 "Object_in_zone_3_21_30cm" 4 "Object_in_zone_4_31_40cm" 5 "Object_in_zone_5_41_50cm" 6 "Object_in_zone_6_51_60cm" 7 "Object_in_zone_7_61_70cm" 8 "Object_in_zone_8_71_80cm" 9 "Object_in_zone_9_81_90cm" 10 "Object_in_zone_10_91_100cm" 11 "Object_in_zone_11_101_110cm" 12 "Object_in_zone_12_111_120cm" ;
VAL_ 664 RPAS_ObjRLMidlAr2 0 "No_object" 1 "Object_In_Zone1_0_10cm" 2 "Object_In_Zone2_11_20cm" 3 "Object_In_Zone3_21_30cm" 4 "Object_In_Zone4_31_40cm" 5 "Object_In_Zone5_41_50cm" 6 "Object_In_Zone6_51_60cm" 7 "Object_In_Zone7_61_70cm" 8 "Object_In_Zone8_71_80cm" 9 "Object_In_Zone9_81_90cm" 10 "Object_In_Zone10_91_100cm" 11 "Object_In_Zone11_101_110cm" 12 "Object_In_Zone12_111_120cm" 13 "Object_In_Zone13_121_130cm" 14 "Object_In_Zone14_131_140cm" 15 "Object_In_Zone15_141_150cm" ;
VAL_ 664 RPAS_ObjRLMidlAr1 0 "No_Object" 1 "Object_In_Zone1_0_10cm" 2 "Object_In_Zone2_11_20cm" 3 "Object_In_Zone3_21_30cm" 4 "Object_In_Zone4_31_40cm" 5 "Object_In_Zone5_41_50cm" 6 "Object_In_Zone6_51_60cm" 7 "Object_In_Zone7_61_70cm" 8 "Object_In_Zone8_71_80cm" 9 "Object_In_Zone9_81_90cm" 10 "Object_In_Zone10_91_100cm" 11 "Object_In_Zone11_101_110cm" 12 "Object_In_Zone12_111_120cm" 13 "Object_In_Zone13_121_130cm" 14 "Object_In_Zone14_131_140cm" 15 "Object_In_Zone15_141_150cm" ;
VAL_ 664 RPAS_ObjRRMidlAr2 0 "No_Object" 1 "Object_In_Zone1_0_10cm" 2 "Object_In_Zone2_11_20cm" 3 "Object_In_Zone3_21_30cm" 4 "Object_In_Zone4_31_40cm" 5 "Object_In_Zone5_41_50cm" 6 "Object_In_Zone6_51_60cm" 7 "Object_In_Zone7_61_70cm" 8 "Object_In_Zone8_71_80cm" 9 "Object_In_Zone9_81_90cm" 10 "Object_In_Zone10_91_100cm" 11 "Object_In_Zone11_101_110cm" 12 "Object_In_Zone12_111_120cm" 13 "Object_In_Zone13_121_130cm" 14 "Object_In_Zone14_131_140cm" 15 "Object_In_Zone15_141_150cm" ;
VAL_ 664 RPAS_ObjRRMidlAr1 0 "No_Object" 1 "Object_In_Zone1_0_10cm" 2 "Object_In_Zone2_11_20cm" 3 "Object_In_Zone3_21_30cm" 4 "Object_In_Zone4_31_40cm" 5 "Object_In_Zone5_41_50cm" 6 "Object_In_Zone6_51_60cm" 7 "Object_In_Zone7_61_70cm" 8 "Object_In_Zone8_71_80cm" 9 "Object_In_Zone9_81_90cm" 10 "Object_In_Zone10_91_100cm" 11 "Object_In_Zone11_101_110cm" 12 "Object_In_Zone12_111_120cm" 13 "Object_In_Zone13_121_130cm" 14 "Object_In_Zone14_131_140cm" 15 "Object_In_Zone15_141_150cm" ;
VAL_ 664 RPAS_ObjRRCornrAr2 0 "No_object" 1 "Object_in_zone_1_0_10cm" 2 "Object_in_zone_2_11_20cm" 3 "Object_in_zone_3_21_30cm" 4 "Object_in_zone_4_31_40cm" 5 "Object_in_zone_5_41_50cm" 6 "Object_in_zone_6_51_60cm" 7 "Object_in_zone_7_61_70cm" 8 "Object_in_zone_8_71_80cm" 9 "Object_in_zone_9_81_90cm" 10 "Object_in_zone_10_91_100cm" 11 "Object_in_zone_11_101_110cm" 12 "Object_in_zone_12_111_120cm" ;
VAL_ 664 RPAS_ObjRRCornrAr1 0 "No_object" 1 "Object_in_zone_1_0_10cm" 2 "Object_in_zone_2_11_20cm" 3 "Object_in_zone_3_21_30cm" 4 "Object_in_zone_4_31_40cm" 5 "Object_in_zone_5_41_50cm" 6 "Object_in_zone_6_51_60cm" 7 "Object_in_zone_7_61_70cm" 8 "Object_in_zone_8_71_80cm" 9 "Object_in_zone_9_81_90cm" 10 "Object_in_zone_10_91_100cm" 11 "Object_in_zone_11_101_110cm" 12 "Object_in_zone_12_111_120cm" ;
VAL_ 664 OneclickClsIntellgntDrvgTextDisp 0 "Initial_value" 1 "ADAS_forbidden" 2 "Parking_forbidden" ;
VAL_ 664 SDWActiveSts 0 "Not_active" 1 "Active" ;
VAL_ 664 SDW_SoundIndcn 0 "Tone0_No_warning" 1 "Tone1_Long_beep" 2 "Tone2_two_third_Hz" 3 "Tone3_3Hz" ;
VAL_ 664 APS_RLSideSnsrFailSts 0 "No_Failure" 1 "Failure" ;
VAL_ 664 APS_RRSideSnsrFailSts 0 "No_Failure" 1 "Failure" ;
VAL_ 664 APS_FLSideSnsrFailSts 0 "No_failure" 1 "Failure" ;
VAL_ 664 APS_FRSideSnsrFailSts 0 "No_failure" 1 "Failure" ;
VAL_ 664 APS_ObjLeSideAr5 0 "No_Object" 1 "Object_In_Zone_1_0_10cm" 2 "Object_In_Zone_2_11_20cm" 3 "Object_In_Zone_3_21_30cm" 4 "Object_In_Zone_4_31_40cm" 5 "Object_In_Zone_5_41_50cm" 6 "Object_In_Zone_6_51_60cm" ;
VAL_ 664 APS_ObjLeSideAr4 0 "No_Object" 1 "Object_In_Zone_1_0_10cm" 2 "Object_In_Zone_2_11_20cm" 3 "Object_In_Zone_3_21_30cm" 4 "Object_In_Zone_4_31_40cm" 5 "Object_In_Zone_5_41_50cm" 6 "Object_In_Zone_6_51_60cm" ;
VAL_ 664 APS_ObjLeSideAr3 0 "No_Object" 1 "Object_In_Zone_1_0_10cm" 2 "Object_In_Zone_2_11_20cm" 3 "Object_In_Zone_3_21_30cm" 4 "Object_In_Zone_4_31_40cm" 5 "Object_In_Zone_5_41_50cm" 6 "Object_In_Zone_6_51_60cm" ;
VAL_ 664 APS_ObjLeSideAr2 0 "No_Object" 1 "Object_In_Zone_1_0_10cm" 2 "Object_In_Zone_2_11_20cm" 3 "Object_In_Zone_3_21_30cm" 4 "Object_In_Zone_4_31_40cm" 5 "Object_In_Zone_5_41_50cm" 6 "Object_In_Zone_6_51_60cm" ;
VAL_ 664 APS_ObjLeSideAr1 0 "No_Object" 1 "Object_In_Zone_1_0_10cm" 2 "Object_In_Zone_2_11_20cm" 3 "Object_In_Zone_3_21_30cm" 4 "Object_In_Zone_4_31_40cm" 5 "Object_In_Zone_5_41_50cm" 6 "Object_In_Zone_6_51_60cm" ;
VAL_ 664 APS_ObjRiSideAr5 0 "No_Object" 1 "Object_In_Zone_1_0_10cm" 2 "Object_In_Zone_2_11_20cm" 3 "Object_In_Zone_3_21_30cm" 4 "Object_In_Zone_4_31_40cm" 5 "Object_In_Zone_5_41_50cm" 6 "Object_In_Zone_6_51_60cm" ;
VAL_ 664 APS_ObjRiSideAr4 0 "No_Object" 1 "Object_In_Zone_1_0_10cm" 2 "Object_In_Zone_2_11_20cm" 3 "Object_In_Zone_3_21_30cm" 4 "Object_In_Zone_4_31_40cm" 5 "Object_In_Zone_5_41_50cm" 6 "Object_In_Zone_6_51_60cm" ;
VAL_ 664 APS_ObjRiSideAr3 0 "No_Object" 1 "Object_In_Zone_1_0_10cm" 2 "Object_In_Zone_2_11_20cm" 3 "Object_In_Zone_3_21_30cm" 4 "Object_In_Zone_4_31_40cm" 5 "Object_In_Zone_5_41_50cm" 6 "Object_In_Zone_6_51_60cm" ;
VAL_ 664 APS_ObjRiSideAr2 0 "No_Object" 1 "Object_In_Zone_1_0_10cm" 2 "Object_In_Zone_2_11_20cm" 3 "Object_In_Zone_3_21_30cm" 4 "Object_In_Zone_4_31_40cm" 5 "Object_In_Zone_5_41_50cm" 6 "Object_In_Zone_6_51_60cm" ;
VAL_ 664 APS_ObjRiSideAr1 0 "No_Object" 1 "Object_In_Zone_1_0_10cm" 2 "Object_In_Zone_2_11_20cm" 3 "Object_In_Zone_3_21_30cm" 4 "Object_In_Zone_4_31_40cm" 5 "Object_In_Zone_5_41_50cm" 6 "Object_In_Zone_6_51_60cm" ;
VAL_ 664 AntiMsstpngObstclDetnFailSts 0 "Initial_Value" 1 "All_No_Failure" 2 "Only_Front_Direction_Failure" 3 "Only_Rear_Direction_Failure" 4 "All_Failure" ;
VAL_ 664 ObstclDetnFailSts 0 "Initial_Value" 1 "All_No_Failure" 2 "Only_Front_Direction_Failure" 3 "Only_Rear_Direction_Failure" 4 "All_Failure" ;
VAL_ 664 ResTraDistanceOfCurTra 0 "Valid_value" 126 "No_request" 127 "Invalid" ;
VAL_ 664 P2P_ProcBar 127 "No_Display" ;
VAL_ 664 HAVP_ProcRa 127 "No_Display" ;
VAL_ 664 RPAS_NearBrrdstn 255 "No_Display" ;
VAL_ 667 HAVP_LrngDst 1023 "No_Display" ;
VAL_ 667 PAVP_ScFail_info 0 "Idle" 1 "Camera_fault" 2 "Ultrasonic_fault" 3 "AVP_HW_fault" 4 "AVP_SW_fault" 5 "AVP_Eth1_connection_fault" 6 "AVP_Eth2_connection_fault" 7 "Chasis_Powertrain_ECU_fault" ;
VAL_ 667 HAVP_ScFail_info 0 "Idle" 1 "Front_Wide_Camera_Fault" 2 "Around_View_Camera_Fault" 3 "Ultrasonic_Fault" 4 "Controller_HW_Fault" 5 "Controller_SW_Fault" ;
VAL_ 667 UnPrkgSpaReasons 0 "Initial_value" 1 "The_environment_is_dark" 2 "Slot_narrow" 3 "Passage_narrow" 4 "Far_from_the_slot" 5 "Ground_lock_is_opened" 6 "Slot_is_occupied" 7 "Wheelstopper_invade" 8 "Truck_invade" 9 "Vehicle_invade" 10 "Cone_barrel_invade" 11 "Pedestrian_invade" 12 "Pillar_invade" 13 "Bushes_invade" 14 "Tree_invade" 15 "Fire_fighting_facilities_invade" 16 "Charging_equipment_invade" 17 "Unknown" 18 "Vehicles_can_be_taken_over_in_advance" 19 "You_have_taken_over_the_vehicle" 20 "Obstacles_near_the_vehicle_please_step_back_and_try_again" ;
VAL_ 299 LCP_State 0 "Initial_value" 1 "OFF" 2 "Standby" 3 "Active" 4 "Passive" 5 "Fault" ;
VAL_ 299 NavOptSpdLim 0 "No_Display" 1 "SPL_5" 2 "SPL_10" 3 "SPL_15" 4 "SPL_20" 5 "SPL_25" 6 "SPL_30" 7 "SPL_35" 8 "SPL_40" 9 "SPL_45" 10 "SPL_50" 11 "SPL_55" 12 "SPL_60" 13 "SPL_65" 14 "SPL_70" 15 "SPL_75" 16 "SPL_80" 17 "SPL_85" 18 "SPL_90" 19 "SPL_95" 20 "SPL_100" 21 "SPL_105" 22 "SPL_110" 23 "SPL_115" 24 "SPL_120" 25 "SPL_125" 26 "SPL_130" 27 "SPL_135" 28 "SPL_140" 29 "SPL_145" 30 "SPL_150" 31 "Invalid" ;
VAL_ 299 VisOptSpdLim 0 "No_Display" 1 "SPL_5" 2 "SPL_10" 3 "SPL_15" 4 "SPL_20" 5 "SPL_25" 6 "SPL_30" 7 "SPL_35" 8 "SPL_40" 9 "SPL_45" 10 "SPL_50" 11 "SPL_55" 12 "SPL_60" 13 "SPL_65" 14 "SPL_70" 15 "SPL_75" 16 "SPL_80" 17 "SPL_85" 18 "SPL_90" 19 "SPL_95" 20 "SPL_100" 21 "SPL_105" 22 "SPL_110" 23 "SPL_115" 24 "SPL_120" 25 "SPL_125" 26 "SPL_130" 27 "SPL_135" 28 "SPL_140" 29 "SPL_145" 30 "SPL_150" 31 "Invalid" ;
VAL_ 299 LKA_State 0 "Initial_value" 1 "OFF" 2 "Standby" 3 "Active" 4 "Passive" 5 "Fault" ;
VAL_ 299 LDW_State 0 "Initial_value" 1 "OFF" 2 "Standby" 3 "Active" 4 "Passive" 5 "Fault" ;
VAL_ 299 AES_State 0 "Initial_value" 1 "OFF" 2 "Standby" 3 "Active" 4 "Passive" 5 "Fault" ;
VAL_ 299 ESS_State 0 "Initial_value" 1 "OFF" 2 "Standby" 3 "Active" 4 "Passive" 5 "Fault" ;
VAL_ 299 RollingCounter_IFC2 15 "Invalid_value" ;
VAL_ 299 StrgTrqCoeff 0 "Initial_Value" ;
VAL_ 299 IFCFuncAngCmdReqFlag 0 "No_Request" 1 "LKA_Req" 2 "ESS_Req" 3 "APA_Req" 4 "APA_Req_SBW" ;
VAL_ 299 RollingCounter_IFC1 15 "Invalid_value" ;
VAL_ 299 IFCFuncTrqCmdReqFlag 0 "No_Request" 1 "LKA_Request" 2 "ESS_Request" ;
VAL_ 299 IFCVibrationWarning 0 "No_Request" 1 "LeveL_1" ;
VAL_ 299 DrvgRWSAngReqVld 0 "Invalid" 1 "Valid" ;
VAL_ 299 DrvgRWSAngReq 0 "Initial_Value" 1 "Valid_values" ;
VAL_ 299 DrvgRWSModReq 0 "Initial_Value" 1 "No_Request" 2 "Drvg_Request" ;
VAL_ 323 RollingCounter_ACC14 0 "Valid_value" 15 "Invalid_value" ;
VAL_ 323 VehRollRate 0 "Initial_Value" 1 "Valid_Value" ;
VAL_ 323 VehPitchRate 0 "Initial_Value" 1 "Valid_Value" ;
VAL_ 323 InrlMeasUnitFailrSts 0 "Initial_Value" 1 "Normal" 2 "Abnormal" ;
VAL_ 323 VehVerAccel 0 "Initial_Value" 1 "Valid_Value" ;
VAL_ 323 Checksum_ACC14 0 "Valid_value" ;
VAL_ 323 RollingCounter_ACC12 15 "Invalid_value" ;
VAL_ 323 DrvgPrkgFuncActvnSts 0 "Initial_value" 1 "OFF" 2 "ON" ;
VAL_ 323 FxTgtGearEna 0 "Initial_value" 1 "Disable" 2 "Enable" ;
VAL_ 323 FxTgtGearReqVld 0 "Invalid" 1 "Valid" ;
VAL_ 323 TotRefTrq 0 "Initial_value" ;
VAL_ 323 FxTgtGearReq 0 "No_request" 1 "P" 2 "R" 3 "N" 4 "D" ;
VAL_ 323 FxTgtTrqMod 0 "Initial_value" 1 "Throttle_override_mode" 2 "Throttle_inhibite_mode" ;
VAL_ 323 FxTgtTrqEna 0 "Initial_value" 1 "Disable" 2 "Enable" ;
VAL_ 323 FxTgtTrqVld 0 "Invalid" 1 "Valid" ;
VAL_ 323 FxTgtTrq 0 "Initial_value" ;
VAL_ 323 RollingCounter_ACC10 15 "Invalid_value" ;
VAL_ 323 Longctrl_WheelTrqReqActive 0 "Not_active" 1 "Active" ;
VAL_ 323 RollingCounter_ACC2 15 "Invalid_value" ;
VAL_ 323 ACC_CRInterface 0 "No_Response" 1 "Response" ;
VAL_ 323 IDC_L2_HADFuncCmdReqFlag 0 "No_Request" 1 "LKA_Req" 2 "ESS_Req" 4 "HWP_Req" 5 "Override" 6 "Failure" ;
VAL_ 323 RollingCounter_ACC1 15 "Invalid_value" ;
VAL_ 323 ActualTargetSpeed 255 "Invalid_value" ;
VAL_ 323 InterceptionDmd 0 "No_Demand" 1 "Demand" ;
VAL_ 323 Longctrl_ParkShiftReq 0 "No_request" 1 "Request_park_Shift" 2 "Invalid" ;
VAL_ 323 Longctrl_DecelToStopReq 0 "No_Request" 1 "Request" ;
VAL_ 323 Longctrl_Decel_Req 0 "No_Request" 1 "Request" ;
VAL_ 323 Longctrl_ModSts 0 "OFF_mode" 1 "Passive_mode_Reject" 2 "Passive_mode_Stand_by" 3 "Active_Control_mode" 4 "Brake_only_mode" 5 "Override" 6 "Standstill" 7 "Failure_mode_Longctrl" 9 "Shut_off" ;
VAL_ 323 Longctrl_DrvOFF_Req 0 "No_Request" 1 "Request" ;
VAL_ 323 Longctrl_VehHldReq 0 "No_Request" 1 "Request" ;
VAL_ 323 RollingCounter_ACC11 15 "Invalid_value" ;
VAL_ 323 Longctrl_AccelOvrdActnReq 0 "No_Action" 1 "Action" ;
VAL_ 323 Longctrl_TgtGearReqVld 0 "Invalid" 1 "Valid" ;
VAL_ 323 Longctrl_TgtGearReq 0 "No_request" 1 "P" 2 "R" 3 "N" 4 "D" ;
VAL_ 395 RAEB_Warn 0 "Initial_Value" 1 "Vehicle_triggering" 2 "Pedestrian_triggering" ;
VAL_ 395 RAEB_State 0 "Initial_value" 1 "Off" 2 "Standby" 3 "Active" 4 "Passive" 5 "Fault" 6 "Hold" 7 "EBA_Active" ;
VAL_ 395 EBA_State 0 "Initial_value" 1 "OFF" 2 "Standby" 3 "Active" 4 "Passive" 5 "Fault" ;
VAL_ 395 AEB_State 0 "Initial_value" 1 "OFF" 2 "Standby" 3 "Active" 4 "Passive" 5 "Fault" 6 "Hold" 7 "EBA_Active" ;
VAL_ 395 AWB_State 0 "Initial_value" 1 "OFF" 2 "Standby" 3 "Active" 4 "Passive" 5 "Fault" ;
VAL_ 395 FCW_State 0 "Initial_value" 1 "OFF" 2 "Standby" 3 "Active" 4 "Passive" 5 "Fault" ;
VAL_ 395 DW_State 0 "Initial_value" 1 "OFF" 2 "Standby" 3 "Active" 4 "Passive" 5 "Fault" ;
VAL_ 395 RollingCounter_AEB6 15 "Invalid_value" ;
VAL_ 395 ExcpADASBrkgHldReq 0 "Initial_value" 1 "No_request" 2 "Request_brake" 3 "Request_hold" ;
VAL_ 395 DrvPrsnt 0 "Initial_value" 1 "With_driver" 2 "Without_driver" ;
VAL_ 395 BrkgHldReq 0 "No_request" 1 "AVH_off" 2 "AVH_active" 3 "AVH_standy" ;
VAL_ 395 BrkgSwtReq 0 "Initial_value" 1 "ON" 2 "OFF" ;
VAL_ 395 EPBModEna 0 "Initial_value" 1 "Disable" 2 "Enable" ;
VAL_ 395 EPBModReq 0 "No_request" 1 "Lock" 2 "Release" ;
VAL_ 395 EPBModReqVld 0 "Invalid" 1 "Valid" ;
VAL_ 395 BrkgTgtTyp 0 "Initial_value" 1 "Comfort" 2 "Emergency" ;
VAL_ 395 BrkgTgtTrqMod 0 "No_request" 1 "ACC" 2 "APA" ;
VAL_ 395 BrkgTgtTrqEna 0 "Initial_value" 1 "Disable" 2 "Enable" ;
VAL_ 395 BrkgTgtTrqVld 0 "Invalid" 1 "Valid" ;
VAL_ 395 BrkgTgtTrq 0 "Initial_value" ;
VAL_ 395 RollingCounter_AEB1 15 "Invalid_value" ;
VAL_ 395 IntellgntAsscRoadTyp 0 "Initial_value" 1 "Normal" 2 "Snow_covered_road" 3 "Ice_covered_road" 4 "Muddy_covered_road" 5 "Sand_covered_road" 6 "Dirt_covered_road" 7 "Asphalt_covered_road" 8 "Cement_covered_road" 9 "Pitted_covered_road" 15 "Invalid_Value" ;
VAL_ 395 AEB_ObjSty 0 "No_Object" 1 "Vehicle" 2 "Pedestrian" 3 "Cyclist" 4 "Unknown" 5 "Speed_drop_increase" ;
VAL_ 395 AEB_BrkReqFunc 0 "No_Request" 1 "AEB_V" 2 "AEB_VRU" 3 "AEB_JA" 5 "AEB_FCTB" ;
VAL_ 395 AEB_AWB_Level 0 "No_level" 1 "Level_1" 2 "Level_2" 3 "Level_3" 4 "Level_4" ;
VAL_ 395 AEB_TgtDecel_ReqValue 0 "Valid_value" 65535 "Invalid" ;
VAL_ 395 AEB_ABP_Req 0 "No_Request" 1 "Request" ;
VAL_ 395 AEB_AWB_Req 0 "No_Request" 1 "Request" ;
VAL_ 395 AEB_TgtDecel_Req 0 "No_Request" 1 "Request" ;
VAL_ 395 AEB_VehHldReq 0 "No_Request" 1 "Request" ;
VAL_ 395 EBA_TgtDecel_Req 0 "No_Request" 1 "Request" ;
VAL_ 395 AEB_ABA_Req 0 "No_Request" 1 "Request" ;
VAL_ 395 AEB_ABA_Level 0 "Level_0" 1 "Level_1" 2 "Level_2" 3 "Level_3" ;
VAL_ 395 AEB_Flag_VSI 0 "No_Request" 1 "Request" ;
VAL_ 395 ADAS_ErrSts 0 "System_Initializing" 1 "No_Error" 2 "Blindness" 3 "Misalignment" 4 "Failure" ;
VAL_ 415 ACC_RiTgtObjBarDisp_03 0 "No_Display" 1 "Distance_1_one_bar" 2 "Distance_2_two_bars" 3 "Distance_3_three_bars" 4 "Distance_4_four_bars" ;
VAL_ 415 IFC_Roadedge02_Type 0 "Undecided" 1 "Solid" 2 "Dashed" 3 "Double_solid_dashed" 4 "Double_dashed_solid" 5 "Double_solid_solid" 6 "Double_dashed_dashed" 7 "Botts" 8 "Deceleration" 9 "Hov_lane" 10 "Road_edge" 11 "Elevated_structure" 12 "Curb" 13 "Cones_poles" ;
VAL_ 415 IFC_Roadedge01_Type 0 "Undecided" 1 "Solid" 2 "Dashed" 3 "Double_solid_dashed" 4 "Double_dashed_solid" 5 "Double_solid_solid" 6 "Double_dashed_dashed" 7 "Botts" 8 "Deceleration" 9 "Hov_lane" 10 "Road_edge" 11 "Elevated_structure" 12 "Curb" 13 "Cones_poles" ;
VAL_ 415 IFC_Line04_Type 0 "Undecided" 1 "Solid" 2 "Dashed" 3 "Double_solid_dashed" 4 "Double_dashed_solid" 5 "Double_solid_solid" 6 "Double_dashed_dashed" 7 "Botts" 8 "Deceleration" 9 "Hov_lane" 10 "Road_edge" 11 "Elevated_structure" 12 "Curb" 13 "Cones_poles" ;
VAL_ 415 IFC_Line03_Type 0 "Undecided" 1 "Solid" 2 "Dashed" 3 "Double_solid_dashed" 4 "Double_dashed_solid" 5 "Double_solid_solid" 6 "Double_dashed_dashed" 7 "Botts" 8 "Deceleration" 9 "Hov_lane" 10 "Road_edge" 11 "Elevated_structure" 12 "Curb" 13 "Cones_poles" ;
VAL_ 415 IFC_Line02_Type 0 "Undecided" 1 "Solid" 2 "Dashed" 3 "Double_solid_dashed" 4 "Double_dashed_solid" 5 "Double_solid_solid" 6 "Double_dashed_dashed" 7 "Botts" 8 "Deceleration" 9 "Hov_lane" 10 "Road_edge" 11 "Elevated_structure" 12 "Curb" 13 "Cones_poles" ;
VAL_ 415 IFC_Line01_Type 0 "Undecided" 1 "Solid" 2 "Dashed" 3 "Double_Solid_Dashed" 4 "Double_Dashed_Solid" 5 "Double_Solid_Solid" 6 "Double_Dashed_Dashed" 7 "Botts" 8 "Deceleration" 9 "Hov_Lane" 10 "Road_Edge" 11 "Elevated_Structure" 12 "Curb" 13 "Cones_Poles" ;
VAL_ 546 RollingCounter_IFC_HCM9 15 "Invalid_value" ;
VAL_ 546 CameraSts 0 "Not_Available_for_ADB" 1 "Available_for_ADB" 2 "Camera_Fault" ;
VAL_ 546 TrafficStyle 0 "Unknow" 1 "RightHandTraffic" 2 "LeftHandTraffic" 3 "Not_available" ;
VAL_ 546 RoadIllumDetd 0 "Road_Illumination_Not_Detected" 1 "Road_Illumination_Detected" ;
VAL_ 546 AmbLight 0 "Not_Active_for_HighBeam" 1 "Active_for_HighBeam" ;
VAL_ 546 RollingCounter_IFC_HCM8 15 "Invalid_value" ;
VAL_ 546 Spots8VehObjClassn 0 "No_Vehicle" 1 "Car" 2 "Truck" 3 "Bus" 4 "BikeOrMotoBike" 5 "Pedestrain" 6 "Mixed" 7 "Unknow" ;
VAL_ 546 Spots8TrackingInfo 0 "Not_Tracking" 1 "Tracking" ;
VAL_ 546 Spots8Distance 511 "NotAvailable" ;
VAL_ 546 Spots8Typ 0 "Unknown" 1 "Oncoming_object" 2 "Preceding_object" 3 "Reflective_object" ;
VAL_ 546 Spots8Valid 0 "Invalid" 1 "Valid" ;
VAL_ 546 Spots8HozlPosnRiAng 1023 "NotAvailable" ;
VAL_ 546 Spots8HozlPosnLeAng 1023 "NotAvailable" ;
VAL_ 551 RollingCounter_AEB5 15 "Invalid_value" ;
VAL_ 551 AEBObjDyActvSafety 0 "Initial_Value" ;
VAL_ 551 AEBObjDxActvSafety 0 "Initial_Value" ;
VAL_ 551 AEBObjVxActvSafety 0 "Initial_Value" ;
VAL_ 551 TimeToCllsnActvSafety 0 "Initial_Value" ;
VAL_ 551 AEBTgtDecelReqActvSafety 0 "No_Request" 1 "Request" ;
VAL_ 551 ADAS_ErrStsActvSafety 0 "Initial_Value" 1 "System_Initializing" 2 "No_error" 3 "Blindness" 4 "Misalignment" 5 "Failure" ;
VAL_ 551 AEBObjStyActvSafety 0 "Initial_Value" 1 "Unknow" 2 "Sedan" 3 "Truck" 4 "Motorcycle" 5 "Pedestrian" 6 "Bicycle" ;
VAL_ 551 ACC_RiTgt_03_fusion 0 "No_fusion" 1 "Fusion" ;
VAL_ 551 ACC_RiTgt_03_Typ 0 "Unkown" 1 "Sedan" 2 "Truck" 3 "Motorcycle" 4 "Pedestrian" 5 "Bicycle" 6 "Traffic_cone" 7 "Obstacle" ;
VAL_ 551 ACC_RiTargrt_03_Detn 0 "Not_dectected" 1 "Dectected" 3 "Invalid" ;
VAL_ 551 ACC_LeTgt_03_fusion 0 "No_fusion" 1 "Fusion" ;
VAL_ 551 ACC_LeTgt_03_Typ 0 "Unkown" 1 "Sedan" 2 "Truck" 3 "Motorcycle" 4 "Pedestrian" 5 "Bicycle" 6 "Traffic_cone" 7 "Obstacle" ;
VAL_ 551 ACC_LeTargrt_03_Detn 0 "Not_dectected" 1 "Dectected" 3 "Invalid" ;
VAL_ 551 ACC_PotentialTgt_02_fusion 0 "No_fusion" 1 "Fusion" ;
VAL_ 551 ACC_PotentialTgt_02_Typ 0 "Unkown" 1 "Sedan" 2 "Truck" 3 "Motorcycle" 4 "Pedestrian" 5 "Bicycle" 6 "Traffic_cone" 7 "Obstacle" ;
VAL_ 551 ACC_PotentialTgt_02_Detn 0 "Not_dectected" 1 "Dectected" 3 "Invalid" ;
VAL_ 551 AEB_JABrkTrig 0 "Not_tirggered" 1 "AEB_JA_Function_Triggered_for_vehicle" 2 "AEB_JA_Function_Triggered_for_pedestrian" 3 "Reverse" ;
VAL_ 551 AEB_JA_Warn 0 "No_warning" 1 "Warning_for_vehicle" 2 "Warning_for_pedestrian" 3 "Reverse" ;
VAL_ 551 AEB_JAFuncSts 0 "No_Display" 1 "Error" 2 "FCW_AEB_JA_temporarily_unavailable" 3 "FCW_AEB_JA_Performance_degradation" ;
VAL_ 551 FCW_Warn 0 "No_warning" 1 "Latent_warning" 2 "Warning_Level_1" 3 "Warning_Level_2" ;
VAL_ 551 FCW_AEB_PedFctSts 0 "No_Display" 1 "Error" 2 "FCW_AEB_P_temporarily_unavailable" 3 "FCW_AEB_P_Performance_degradation" ;
VAL_ 551 FCW_AEB_VehFctSts 0 "No_Display" 1 "Error" 2 "FCW_AEB_V_temporarily_unavailable" 3 "FCW_AEB_V_Performance_degradation" ;
VAL_ 551 AEB_PedTrig 0 "Not_tirggered" 1 "Triggered" ;
VAL_ 551 AEB_VehTrig 0 "Not_tirggered" 1 "Triggered" ;
VAL_ 551 IntellgntAsscLmpReq 0 "Initial_value" 1 "Off" 2 "Breathe" 3 "Always_Bright" ;
VAL_ 551 UNP_SwtResp 0 "OFF" 1 "ON" ;
VAL_ 551 IntellgntcurveResp 0 "OFF" 1 "ON" ;
VAL_ 551 AEB_JA_Resp 0 "OFF" 1 "ON" ;
VAL_ 551 FCW_Snvty 0 "Normal" 1 "High_sensitivity" 2 "Low_sensitivity" ;
VAL_ 551 AEB_VehResp 0 "OFF" 1 "ON" ;
VAL_ 551 AEB_PedResp 0 "OFF" 1 "ON" ;
VAL_ 573 SceneModSts 0 "Initial_value" 1 "Rainy_Mode" 2 "Snowy_Mode" 3 "Foggy_Mode" ;
VAL_ 573 ACC_LeTgtObjBarDisp_03 0 "No_Display" 1 "Distance_1_one_bar" 2 "Distance_2_two_bars" 3 "Distance_3_three_bars" 4 "Distance_4_four_bars" ;
VAL_ 573 ACC_RiTgtObjBarDisp_02 0 "No_Display" 1 "Distance_1_one_bar" 2 "Distance_2_two_bars" 3 "Distance_3_three_bars" 4 "Distance_4_four_bars" ;
VAL_ 573 ACC_LeTgtObjBarDisp_02 0 "No_Display" 1 "Distance_1_one_bar" 2 "Distance_2_two_bars" 3 "Distance_3_three_bars" 4 "Distance_4_four_bars" ;
VAL_ 573 SidePrkgSts 0 "Initial_value" 1 "OFF" 2 "ON" 3 "Resvered" ;
VAL_ 573 HandsoffModSts 0 "Initial_value" 1 "HandsOff" 2 "Attention_And_HandsOff" ;
VAL_ 573 HandsoffTimSts 0 "Initial" 1 "Handsoff_time_is_normal" 2 "Handsoff_time_is_long" ;
VAL_ 573 ACC_TgtObjBarDisp_03 0 "No_Display" 1 "Distance_1_one_bar" 2 "Distance_2_two_bars" 3 "Distance_3_three_bars" 4 "Distance_4_four_bars" ;
VAL_ 573 ACC_TgtObjBarDisp_02 0 "No_Display" 1 "Distance_1_one_bar" 2 "Distance_2_two_bars" 3 "Distance_3_three_bars" 4 "Distance_4_four_bars" ;
VAL_ 573 IFC_NextRiLane_dy 4095 "Invalid_value" ;
VAL_ 573 IFC_NextLeLane_dy 4095 "Invalid_value" ;
VAL_ 573 SmarFrontviewcamSts 0 "Initial_value" 1 "Available" 2 "Unavailable" 3 "Soc_off" ;
VAL_ 573 IFC_RiLane_dy 4095 "Invalid_value" ;
VAL_ 573 IFC_LeLane_dy 4095 "Invalid_value" ;
VAL_ 573 IFC_NextRiLaneTyp 0 "No_Display" 1 "Solid_lane" 2 "Dashed_lane" 3 "Rode_edge" ;
VAL_ 573 IFC_NextLeLaneTyp 0 "No_Display" 1 "Solid_lane" 2 "Dashed_lane" 3 "Rode_edge" ;
VAL_ 573 IFC_RiLaneTyp 0 "No_Display" 1 "Solid_lane" 2 "Dashed_lane" 3 "Rode_edge" ;
VAL_ 573 IFC_LeLaneTyp 0 "No_Display" 1 "Solid_Lane" 2 "Dashed_Lane" 3 "Rode_Edge" ;
VAL_ 573 ESSintervention 0 "No_intervention" 1 "Left_intervention" 2 "Right_intervention" ;
VAL_ 573 AESintervention 0 "No_intervention" 1 "Left_intervention" 2 "Right_intervention" ;
VAL_ 573 IFC_Line_special02_Type 0 "Undecided" 1 "Solid" 2 "Dashed" 3 "Double_solid_dashed" 4 "Double_dashed_solid" 5 "Double_solid_solid" 6 "Double_dashed_dashed" 7 "Botts" 8 "Deceleration" 9 "Hov_lane" 10 "Road_edge" 11 "Elevated_structure" 12 "Curb" 13 "Cones_poles" ;
VAL_ 573 IFC_Line_special01_Type 0 "Undecided" 1 "Solid" 2 "Dashed" 3 "Double_solid_dashed" 4 "Double_dashed_solid" 5 "Double_solid_solid" 6 "Double_dashed_dashed" 7 "Botts" 8 "Deceleration" 9 "Hov_lane" 10 "Road_edge" 11 "Elevated_structure" 12 "Curb" 13 "Cones_poles" ;
VAL_ 573 LCKStsIndcr 0 "No_indicator" 1 "Active_indicator" 2 "Passive_indicator" ;
VAL_ 573 IntelligentEvaActSts 0 "Inactive" 1 "Left_Eva" 2 "Right_Eva" 3 "IntelligentDetour" ;
VAL_ 573 ELKActSts 0 "Inactive" 1 "Left_Active" 2 "Right_active" ;
VAL_ 573 CameraBlockageSts 0 "Camera_Not_Blocked" 1 "Camera_Blocked" ;
VAL_ 573 IFCCalibrationSts 0 "Calibration_Success" 1 "Calibration_In_Process" 2 "Calibration_Failed" ;
VAL_ 573 IFC_Handsoffwarn 0 "No_Warning" 1 "Level1_Warning" 2 "Level2_Warning" 3 "Level3_Warning" 4 "Level4_Warning" 5 "Level5_Warning" 6 "LKA_warning" 7 "Level6_Warning" ;
VAL_ 573 LSSErrSts 0 "No_Error" 1 "LDW_error" 2 "LKA_error" 3 "LCK_error" 4 "ELK_error" 5 "ESS_error" 6 "LSS_temporarily_unavailable" ;
VAL_ 573 TJA_FollowSts 0 "No_Follow" 1 "Follow_Vehicle" ;
VAL_ 573 LaneAvailability 0 "Not_Avaliable" 1 "Left_Lane_Marker_Available" 2 "Right_Lane_Marker_Available" 3 "Both_Lane_Markers_Available" ;
VAL_ 573 ELKMainState 0 "ELK_OFF" 1 "ELK_Standby" 2 "ELK_Enable" 3 "ELK_Road_Edge_Active" 4 "ELK_Oncoming_Active_Oncoming" 5 "ELK_Overtaking_Active_Overtaking" 6 "ELK_Failure" ;
VAL_ 573 LSSFuncSts 0 "OFF" 1 "LDW_on" 2 "LKA_on" 3 "LCK_ON" ;
VAL_ 573 LSSIntervention 0 "No_warning_and_Intervention" 1 "Left_warning" 2 "Right_warning" 3 "Left_Intervention" 4 "Right_Intervention" 5 "Both_Intervention" 6 "Left_warn_only_reminder" 7 "Right_warn_only_reminder" ;
VAL_ 573 LDW_LKAWarn 0 "No_LDW_LKA_warning" 1 "LDW_LKA_left_warning" 2 "LDW_LKA_right_warning" ;
VAL_ 573 LCP_Warn 0 "Initial_value" 1 "Left_Warn" 2 "Right_Warn" 3 "Error" ;
VAL_ 573 RiRoad_Mark_Typ 0 "Default" 1 "ARROW_STRAIGHT" 2 "ARROW_RIGHT" 3 "ARROW_LEFT" 4 "ARROW_STRAIGHT_RIGHT" 5 "ARROW_STRAIGHT_LEFT" 6 "ARROW_STRAIGHT_LEFT_RIGHT" 7 "ARROW_LEFT_RIGHT" 8 "U_TURN_LEFT" 9 "U_TURN_RIGHT" 10 "DIAMOND" 11 "BUS" ;
VAL_ 573 ESSErrSts 0 "No_Error" 1 "Error" ;
VAL_ 573 AESErrSts 0 "No_Error" 1 "Error" ;
VAL_ 573 ESSSts 0 "OFF" 1 "ON" ;
VAL_ 573 AESSts 0 "OFF" 1 "ON" ;
VAL_ 573 IntelligentEvaResp 0 "OFF" 1 "ON" ;
VAL_ 573 LSSResp 0 "OFF" 1 "ON" ;
VAL_ 573 LSSWarnFormResp 0 "Voice" 1 "Haptic" 2 "Voice_Haptic" ;
VAL_ 573 ESS_VehResp 0 "OFF" 1 "ON" ;
VAL_ 573 ESS_PedResp 0 "OFF" 1 "ON" ;
VAL_ 573 IFCHUTInterface 0 "No_Response" 1 "Response" ;
VAL_ 573 LDW_LKA_Snvty 0 "Normal" 1 "High_sensitivity" 2 "Low_sensitivity" ;
VAL_ 573 AESResp 0 "OFF" 1 "ON" ;
VAL_ 573 ELKResp 0 "OFF" 1 "ON" ;
VAL_ 573 LCKResp 0 "OFF" 1 "ON" ;
VAL_ 573 LKAResp 0 "OFF" 1 "ON" ;
VAL_ 573 LDWResp 0 "OFF" 1 "ON" ;
VAL_ 573 LeRoad_Mark_Typ 0 "Default" 1 "ARROW_STRAIGHT" 2 "ARROW_RIGHT" 3 "ARROW_LEFT" 4 "ARROW_STRAIGHT_RIGHT" 5 "ARROW_STRAIGHT_LEFT" 6 "ARROW_STRAIGHT_LEFT_RIGHT" 7 "ARROW_LEFT_RIGHT" 8 "U_TURN_LEFT" 9 "U_TURN_RIGHT" 10 "DIAMOND" 11 "BUS" ;
VAL_ 573 Road_Mark_Typ 0 "Default" 1 "ARROW_STRAIGHT" 2 "ARROW_RIGHT" 3 "ARROW_LEFT" 4 "ARROW_STRAIGHT_RIGHT" 5 "ARROW_STRAIGHT_LEFT" 6 "ARROW_STRAIGHT_LEFT_RIGHT" 7 "ARROW_LEFT_RIGHT" 8 "U_TURN_LEFT" 9 "U_TURN_RIGHT" 10 "DIAMOND" 11 "BUS" ;
VAL_ 573 HWA_Text_Lib 0 "Default" 1 "Cancel_for_long_override" 2 "Cancel_for_lat_override" 3 "Avoid_obstacle" 4 "ISL" 5 "Start_confirm" 6 "Follow_confirm" 7 "Long_override" 8 "Over_speed" 9 "LC_not_cancel" 10 "Adverse_weather" 11 "System_fault" 12 "NOH_fault" 13 "NOH_standby" 14 "NOH_degrade" 15 "Ddverse_weather2" 17 "Function_inhibit" 18 "Pilot_fail" 19 "Avoid_obstacle2" 20 "Auto_spd" 21 "NOH_inhibit" 22 "Restart_to_activate_ALC" 23 "4s_store_to_debug_ALC" 24 "Attention_to_surrounding" 25 "Turn_off_signal" 26 "Speed_is_too_high_to_support_intelligent_cruise" 27 "U_turn_warning" 28 "Roundabout_warning" 29 "Manually_switch_route" 30 "Too_late_to_change_lane" 31 "Off_the_planed_route" 32 "Speeding" 33 "TJA_is_suspend" 34 "Exiting_soon" 35 "Navigation_Left_Lane_Change" 36 "Navigation_Right_Lane_Change" 37 "Transit_Lane" 38 "Left_Lane_Change_Due_Barrier" 39 "Right_Lane_Change_Due_Barrier" 40 "Stay_Away_From_The_Cart" 41 "Abouchement" 42 "Function_About_To_Exit" 43 "Passing_Direction" 44 "Red_Light_Running_Risk" 45 "Road_Pattern_Left_Change" 46 "Construction_ahead_move_slowly" 47 "Departing_Pedestrian" 48 "Stay_away_from_construction" 49 "Cut_In_Car" 50 "Extremity_Land_Change" 51 "Land_Change_Due_To_Special_Lane" 52 "Special_Lane" 53 "TJA_ICA_Resumed" 54 "Change_Lanes_On_Solid_Lines" 55 "Unable_To_Turn" 56 "Attention_Electronic_Eye" 57 "Attention_To_Road_Switching" 58 "Short_Distance" 59 "Driving_Mode" 60 "Safety_Belt" 61 "Lane_Error" 62 "Through_Gate" 63 "Urban_Access_Road" ;
VAL_ 573 IFC_FeatPt_Type 0 "No_Display" 1 "Main_road" 2 "Road_split" 3 "Lane_end" 4 "Crossing" 5 "T_junction" 6 "Roundabout" 10 "Guide_line" 11 "Waiting_area" ;
VAL_ 576 RollingCounter_IFC_HCM7 15 "Invalid_value" ;
VAL_ 576 Spots7VehObjClassn 0 "No_Vehicle" 1 "Car" 2 "Truck" 3 "Bus" 4 "BikeOrMotoBike" 5 "Pedestrain" 6 "Mixed" 7 "Unknow" ;
VAL_ 576 Spots7TrackingInfo 0 "Not_Tracking" 1 "Tracking" ;
VAL_ 576 Spots7Distance 511 "NotAvailable" ;
VAL_ 576 Spots7Typ 0 "Unknown" 1 "Oncoming_object" 2 "Preceding_object" 3 "Reflective_object" ;
VAL_ 576 Spots7Valid 0 "Invalid" 1 "Valid" ;
VAL_ 576 Spots7HozlPosnRiAng 1023 "NotAvailable" ;
VAL_ 576 Spots7HozlPosnLeAng 1023 "NotAvailable" ;
VAL_ 576 RollingCounter_IFC_HCM6 15 "Invalid_value" ;
VAL_ 576 Spots6VehObjClassn 0 "No_Vehicle" 1 "Car" 2 "Truck" 3 "Bus" 4 "BikeOrMotoBike" 5 "Pedestrain" 6 "Mixed" 7 "Unknow" ;
VAL_ 576 Spots6TrackingInfo 0 "Not_Tracking" 1 "Tracking" ;
VAL_ 576 Spots6Distance 511 "NotAvailable" ;
VAL_ 576 Spots6Typ 0 "Unknown" 1 "Oncoming_object" 2 "Preceding_object" 3 "Reflective_object" ;
VAL_ 576 Spots6Valid 0 "Invalid" 1 "Valid" ;
VAL_ 576 Spots6HozlPosnRiAng 1023 "NotAvailable" ;
VAL_ 576 Spots6HozlPosnLeAng 1023 "NotAvailable" ;
VAL_ 576 RollingCounter_IFC_HCM5 15 "Invalid_value" ;
VAL_ 576 Spots5VehObjClassn 0 "No_Vehicle" 1 "Car" 2 "Truck" 3 "Bus" 4 "BikeOrMotoBike" 5 "Pedestrain" 6 "Mixed" 7 "Unknow" ;
VAL_ 576 Spots5TrackingInfo 0 "Not_Tracking" 1 "Tracking" ;
VAL_ 576 Spots5Distance 511 "NotAvailable" ;
VAL_ 576 Spots5Typ 0 "Unknown" 1 "Oncoming_object" 2 "Preceding_object" 3 "Reflective_object" ;
VAL_ 576 Spots5Valid 0 "Invalid" 1 "Valid" ;
VAL_ 576 Spots5HozlPosnRiAng 1023 "NotAvailable" ;
VAL_ 576 Spots5HozlPosnLeAng 1023 "NotAvailable" ;
VAL_ 576 RollingCounter_IFC_HCM4 15 "Invalid_value" ;
VAL_ 576 Spots4VehObjClassn 0 "No_Vehicle" 1 "Car" 2 "Truck" 3 "Bus" 4 "BikeOrMotoBike" 5 "Pedestrain" 6 "Mixed" 7 "Unknow" ;
VAL_ 576 Spots4TrackingInfo 0 "Not_Tracking" 1 "Tracking" ;
VAL_ 576 Spots4Distance 511 "NotAvailable" ;
VAL_ 576 Spots4Typ 0 "Unknown" 1 "Oncoming_object" 2 "Preceding_object" 3 "Reflective_object" ;
VAL_ 576 Spots4Valid 0 "Invalid" 1 "Valid" ;
VAL_ 576 Spots4HozlPosnRiAng 1023 "NotAvailable" ;
VAL_ 576 Spots4HozlPosnLeAng 1023 "NotAvailable" ;
VAL_ 576 RollingCounter_IFC_HCM3 15 "Invalid_value" ;
VAL_ 576 Spots3VehObjClassn 0 "No_Vehicle" 1 "Car" 2 "Truck" 3 "Bus" 4 "BikeOrMotoBike" 5 "Pedestrain" 6 "Mixed" 7 "Unknow" ;
VAL_ 576 Spots3TrackingInfo 0 "Not_Tracking" 1 "Tracking" ;
VAL_ 576 Spots3Distance 511 "NotAvailable" ;
VAL_ 576 Spots3Typ 0 "Unknown" 1 "Oncoming_object" 2 "Preceding_object" 3 "Reflective_object" ;
VAL_ 576 Spots3Valid 0 "Invalid" 1 "Valid" ;
VAL_ 576 Spots3HozlPosnRiAng 1023 "NotAvailable" ;
VAL_ 576 Spots3HozlPosnLeAng 1023 "NotAvailable" ;
VAL_ 576 RollingCounter_IFC_HCM2 15 "Invalid_value" ;
VAL_ 576 Spots2VehObjClassn 0 "No_Vehicle" 1 "Car" 2 "Truck" 3 "Bus" 4 "BikeOrMotoBike" 5 "Pedestrain" 6 "Mixed" 7 "Unknow" ;
VAL_ 576 Spots2TrackingInfo 0 "Not_Tracking" 1 "Tracking" ;
VAL_ 576 Spots2Distance 511 "NotAvailable" ;
VAL_ 576 Spots2Typ 0 "Unknown" 1 "Oncoming_object" 2 "Preceding_object" 3 "Reflective_object" ;
VAL_ 576 Spots2Valid 0 "Invalid" 1 "Valid" ;
VAL_ 576 Spots2HozlPosnRiAng 1023 "NotAvailable" ;
VAL_ 576 Spots2HozlPosnLeAng 1023 "NotAvailable" ;
VAL_ 576 RollingCounter_IFC_HCM1 15 "Invalid_value" ;
VAL_ 576 Spots1VehObjClassn 0 "No_Vehicle" 1 "Car" 2 "Truck" 3 "Bus" 4 "BikeOrMotoBike" 5 "Pedestrain" 6 "Mixed" 7 "Unknow" ;
VAL_ 576 Spots1TrackingInfo 0 "Not_Tracking" 1 "Tracking" ;
VAL_ 576 Spots1Distance 511 "NotAvailable" ;
VAL_ 576 Spots1Typ 0 "Unknown" 1 "Oncoming_object" 2 "Preceding_object" 3 "Reflective_object" ;
VAL_ 576 Spots1Valid 0 "Invalid" 1 "Valid" ;
VAL_ 576 Spots1HozlPosnRiAng 1023 "NotAvailable" ;
VAL_ 576 Spots1HozlPosnLeAng 1023 "NotAvailable" ;
VAL_ 683 OvertakingLightModSts 0 "Initial_value" 1 "OFF" 2 "Auto_beam" 3 "Auto_beam_whistle" ;
VAL_ 683 StartReminderEnaSts 0 "Initial_value" 1 "OFF" 2 "ON" ;
VAL_ 683 DeviateSpdFixdValResp 0 "Valid_values" 63 "Invalid" ;
VAL_ 683 HWA_FaststSwtResp 0 "Initial_value" 1 "OFF" 2 "ON" 3 "Resvered" ;
VAL_ 683 ACC_PotentialTgtfusion 0 "No_Fusion" 1 "Fusion" ;
VAL_ 683 ACC_RiTgtfusion 0 "No_Fusion" 1 "Fusion" ;
VAL_ 683 ACC_LeTgtfusion 0 "No_Fusion" 1 "Fusion" ;
VAL_ 683 ACC_RlvTgtfusion 0 "No_Fusion" 1 "Fusion" ;
VAL_ 683 RollingCounter_ACC7 15 "Invalid_value" ;
VAL_ 683 ACCSts 0 "Deactive" 1 "Active" ;
VAL_ 683 Request_driveoff 0 "No_Request" 1 "The_Front_Car_Has_Started" 2 "The_Front_Car_Has_Started_Please_Pay_Attention_To_The_Road_Environment_Ahead" 3 "The_Front_Car_Has_Started_Please_Keep_Your_Attention" 4 "The_Front_Car_Has_Started_Please_Take_Over_The_Car" 5 "Please_pressed_the_accelerator" 6 "Slow_To_A_Stop" 7 "Slow_Down_Following_Car" ;
VAL_ 683 ACC_RiTgtTyp 0 "Unkown" 1 "Sedan" 2 "Truck" 3 "Motorcycle" 4 "Pedestrian" 5 "Bicycle" 6 "Traffic_cone" 7 "Obstacle" ;
VAL_ 683 ACC_RiTargrtDetn 0 "Not_Dectected" 1 "Dectected" 3 "Invalid" ;
VAL_ 683 ACC_LeTargrtDection 0 "Not_Dectected" 1 "Dectected" 3 "Invalid" ;
VAL_ 683 ACC_LeTgtTyp 0 "Unkown" 1 "Sedan" 2 "Truck" 3 "Motorcycle" 4 "Pedestrian" 5 "Bicycle" 6 "Traffic_cone" 7 "Obstacle" ;
VAL_ 683 RollingCounter_ACC6 15 "Invalid_value" ;
VAL_ 683 IntelligentCurveAct 0 "Inactive" 1 "Active" ;
VAL_ 683 ACC_PotentialTgtTyp 0 "Unkown" 1 "Sedan" 2 "Truck" 3 "Motorcycle" 4 "Pedestrian" 5 "Bicycle" 6 "Traffic_cone" 7 "Obstacle" ;
VAL_ 683 ACC_PotentialTgtDetn 0 "Not_Dectected" 1 "Dectected" 3 "Invalid" ;
VAL_ 683 ACC_RlvTgtTyp 0 "Unkown" 1 "Sedan" 2 "Truck" 3 "Motorcycle" 4 "Pedestrian" 5 "Bicycle" 6 "Traffic_cone" 7 "Obstacle" ;
VAL_ 683 ACC_EgoStatus 0 "No_Display" 1 "Override" 2 "Deceleration" 3 "Assisted_Driving_Reduction" ;
VAL_ 683 ACC_RlvTgtDetn 0 "Not_Dectected" 1 "Dectected" 3 "Invalid" ;
VAL_ 683 RollingCounter_ACC8 15 "Invalid_value" ;
VAL_ 683 SceneModCfmPop 0 "Initial_value" 1 "Severe_weather" ;
VAL_ 683 TextSceneBrocast 0 "Initial_value" 1 "NOA_commute_mode" 2 "NOA_comfortable_mode" 3 "NOA_traffic_jam_mode" 4 "Enter_toll_station" 5 "Export_through_ETC" 6 "Through_ETC_entrance" 7 "Through_toll_station" 8 "Pass_failed" 9 "Near_window" 10 "Take_card" 11 "Pay" 12 "Turn_by_the_way" 13 "Leave_bus_lane" 14 "Left_bus_lane_no" 15 "Approaching_special_lane" 16 "Left_bus_lane_yes" 17 "Right_bus_lane_yes" 18 "Remaining_meters" 19 "PrkgSpaTPrkgSpa_Exit" 20 "PrkgSpaTPrkgSpa_Active" 21 "Downgrade_To_NOA" 22 "PrkgSpaTPrkgSpa_Restore" 23 "Take_Over_PrkgSpaTPrkgSpa" 24 "Speed_too_high_exit_PrkgSpaTPrkgSpa" 25 "Yaw_PrkgSpaTPrkgSpa_Exit" 26 "Low_consumption_pilot_not_active" 27 "Empirical_Speed_Limit" 28 "Go_Straight_And_Wait" 29 "Deviate_The_Main_Road" 30 "Deviate_The_Side_Road" 31 "Deviate_The_Bridge" 32 "Deviate_Under_The_Bridge" 33 "Restricted_Driving" 34 "Not_Available_in_Valet_Mode" 35 "Parkingon_TheRight_Side" 36 "Unsatisfie_Denvironment" 37 "Temporary_stop" 38 "Unable_to_stop" 39 "Rainy_Day_Active" 40 "Driver_seat_belt_unfastened" 41 "passenger_seat_belt_unfastened" 42 "DrivingMode_not_met" 43 "Complex_environment" 44 "Step_on_the_Gas" 45 "Find_a_parking_spot_ahead" 46 "Unable_to_stop_at_target" 47 "The_vehicle_is_reversing" 48 "To_reduce_speed_for_defense" 49 "Pull_over_at_the_destination" 50 "Rainy_Day_Quit" 51 "Attention_to_the_navigation_E2E" 52 "Unable_to_dock_E2E" 53 "Snowy_Day_Quit" 54 "Snowy_Day_Active" 55 "Unavailable_lidar_obstructed" 56 "Unavailable_camera_obstructed" 57 "Unavailable_Sensor_obstructed" 58 "foggy_Day_Quit" 59 "foggy_Day_active" 60 "Speed_Alert" 61 "MRM_Punishment" 62 "Disqualification" 63 "Please_complete_the_newbie_task_first" 64 "Unable_to_activate_RNOA_due_to_other_limitation" 65 "RNOA_active_control_is_cancelled" 66 "RNOA_temporarily_unavailable" 67 "Switched_to_RNOA" 68 "RNOA_is_active" 69 "Route_deviation_Switched_to_RNOA" 70 "Pay_attention_Red" 71 "Pay_attention_Yellow" 72 "Pay_attention_Green" 73 "Exam_incomplete" ;
VAL_ 683 PassETCEnaSts 0 "Initial_value" 1 "Disable" 2 "Enable" 3 "ETC_unbound" ;
VAL_ 683 DeviateSpdPreResp 0 "Valid_values" 63 "Invalid" ;
VAL_ 683 HWA_Warning 0 "No_Warning" 1 "Warning_Level1" 2 "Warning_Level2" 3 "Warning_Level3" ;
VAL_ 683 HAVP_RecReq 0 "OFF" 1 "Event_type_APA" 2 "Event_type_SVP" 3 "Event_type_HAVP" 4 "Event_type_RPA" 5 "Event_type_MEB" ;
VAL_ 683 HWA_LaneChangeReq 0 "No_Display" 1 "Left_Satisfied" 2 "Right_Satisfied" 3 "Left_Not_Satisfied" 4 "Right_Not_Satisfied" 5 "Left_solid_line" 6 "Right_solid_line" ;
VAL_ 683 ADAS_DriverInloop_Monitor 0 "No_Display" 1 "HOD_Level_1" 2 "HOD_Level_2" 3 "DAM_Warning" ;
VAL_ 683 HWA_LaneChange 0 "No_Display" 1 "Left" 2 "Right" 3 "Return" ;
VAL_ 683 DeviateSpdModSwtResp 0 "Initial_value" 1 "Fixed_value" 2 "Percentage" 3 "Resvered" ;
VAL_ 683 HWA_InterSysInfoDisp 0 "No_Display" 1 "Left_Overtaking" 2 "Right_Overtaking" 3 "Turn_off_the_turn_light" 4 "Rainmode_activated" 5 "Overtime_for_lane_change" 6 "Lane_change_is_cancelled" 7 "Rainmode_deactivated" 8 "Speed_is_too_low_to_support_lane_change" 9 "HWA_need_to_restart_the_engine" 10 "Take_over_request" 11 "Please_Keep_Attention" 12 "To_cross_the_tunnel_please_take_over_in_time" 13 "Have_a_branch_road_ahead_Please_take_over_in_time" 14 "Sharp_bend_ahead,_Please_take_over_in_time" 15 "Speed_is_too_high_to_support_lane_change" ;
VAL_ 683 HWA_ModDisp 0 "OFF" 1 "Safstop" 2 "Passive" 3 "Ready" 4 "Active" 5 "Override" 6 "Slow_Retreat" 7 "Standstill" 8 "Long_override" 9 "Degrade" 15 "Fault" ;
VAL_ 683 RollingCounter_ACC4 15 "Invalid_value" ;
VAL_ 683 CruChar_InterSysInfoDisp 0 "No_Display" 1 "Unable_to_activate_CruiseChauffer_due_to_other_limitation" 2 "CruiseChauffer_active_control_is_cancelled" 3 "CruiseChauffer_temporarily_unavailable" 4 "Take_over_request" 5 "Current_IGN_Cycle_Function_Inhibit" 6 "Please_Keep_Attention" 7 "To_cross_the_tunnel_please_take_over_in_time" 8 "Have_a_branch_road_ahead_Please_take_over_in_time" 9 "Hands_off_warning" ;
VAL_ 683 ACC_SpdSetValue 255 "No_Display" ;
VAL_ 683 ACC_TimeGapSet 0 "No_Display" 1 "TimeGap_1_1s" 2 "TimeGap_2_one_point_four_s" 3 "TimeGap_3_one_point_eight_s" 4 "TimeGap_4_two_point_one_s" ;
VAL_ 683 ISL_InterSysInfoDisp 0 "No_Display" 1 "Speed_Limit_Confirm_Request" 2 "Speed_Limit_Take_Over_Request" 3 "Reduce_speed_on_a_curve" ;
VAL_ 683 TJA_ICA_ModDisp 0 "OFF_mode" 1 "Passive_mode" 2 "Active_mode" 3 "Ready_mode" 4 "Failure" 5 "Recoverable_mode" ;
VAL_ 683 TJA_ICA_InterSysInfoDisp 0 "No_Display" 1 "Unable_to_activate_TJA_ICA_due_to_other_limitation" 2 "TJA_ICA_active_control_is_cancelled" 3 "TJA_ICA_temporarily_unavailable_" 4 "Current_IGN_Cycle_Function_Inhibit" 5 "TJA_is_active" 6 "Restart_or_P_gear_to_activate" ;
VAL_ 683 CruCha_ModDisp 0 "OFF_mode" 1 "Idle_mode" 2 "Ready_mode" 3 "Active" 5 "Warning_Level_1" 6 "Warning_Level_2" 7 "Warning_Level_3" 9 "Failure" ;
VAL_ 683 TJA_ACC_SelSts 0 "OFF" 1 "ACC_selected" 2 "TJA_ICA_selected" 3 "Off_selected" 4 "ACC_on" 5 "TJA_ICA_on" ;
VAL_ 683 Longctrl_HazActv 0 "Not_active" 1 "AEB_active" 2 "Safestop_active" ;
VAL_ 683 ACC_TgtObjBarDisp 0 "No_Display" 1 "Distance_1_one_bar" 2 "Distance_2_two_bars" 3 "Distance_3_three_bars" 4 "Distance_4_four_bars" ;
VAL_ 683 ACCReqAVM 0 "No_Request" 1 "Request" ;
VAL_ 683 ACC_FctSts 0 "Fuction_Not_Available" 1 "Fuction_Available" 2 "Performance_Degradation" ;
VAL_ 683 ACC_ModDisp 0 "OFF_Mode" 1 "Passive_Mode" 2 "StandBy_Mode" 3 "Active_Control_Mode" 4 "Brake_Only_Mode" 5 "Override" 7 "ACC_and_PEBS_Failure_mode" 8 "ACC_Failure_mode" ;
VAL_ 683 ACC_InterSysInfoDisp 0 "No_display" 1 "Unable_to_activate_ACC_due_to_speed_not_achive" 2 "ACC_active_control_is_cancelled" 3 "Distraction_abort" 4 "ACC_close_due_to_ASL_open" 5 "Unable_to_activate_ACC_due_to_other_limitation" 6 "ASL_close_due_to_ACC_open" 7 "ACC_temporary_unavailable" 8 "ACC_is_active" 9 "Blindness" 10 "ACC_forbidden_due_to_ASL_Active" 11 "ACC_setspeed_has_been_changed_to_ISL" 12 "Setspeed_reach_upper_limit" 13 "Setspedd_reach_lower_limit" 14 "Unable_to_activate_TJA_or_ICA_due_to_DMS_UnA" 15 "Unable_to_activate_ACC_due_to_LowPower" 16 "Sensor_Occlusion" 17 "High_Speed" 18 "Close_Park" 19 "Bad_Weather" 20 "Switching_ACC" 21 "Lidar_Occlusion" 22 "Engine_Roomcover" 23 "Trunk" 24 "Esp_Switch" 25 "Hazard_Warning_Light" 26 "Trailer_Mode" 27 "Snow_Pattern" 28 "Mud_Model" 29 "Sandy_Land_Model" 30 "Noa_Switch" 31 "Navigation_Route" ;
VAL_ 683 ACC_TakeOverReq 0 "No_TakeOver_request" 1 "Valid_TakeOver_request" ;
VAL_ 683 ACC_ObjDetecte 0 "No_Object" 1 "Target_Object_Detected" ;
VAL_ 683 RollingCounter_ACC3 15 "Invalid_value" ;
VAL_ 683 ALC_InterSysInfoDisp 0 "No_Display" 1 "Automatic_lane_change_function_failure" ;
VAL_ 683 NOAExitTim 0 "Initial_Value" 1 "Valid_Value" ;
VAL_ 683 PrkgSpaTPrkgSpaSts 0 "Initial_value" 1 "Passive" 2 "Standby" 3 "Active" 4 "Override" 5 "Go_to_the_terminal_parking" ;
VAL_ 683 VertHeiRmd 0 "Initial_value" 1 "Low" 2 "High" ;
VAL_ 683 IntellgntAsscLmpEnaResp 0 "Initial_value" 1 "Off" 2 "Full_bright" 3 "Olny_Parking_on" ;
VAL_ 683 ALC_Resp 0 "OFF" 1 "ON" ;
VAL_ 683 HWA_SnvtySet_Resp 0 "Normal" 1 "High_Sensitivity" 2 "Low_Sensitivity" 3 "Max_Sensitivity" ;
VAL_ 683 HWA_Resp 0 "OFF" 1 "ON" ;
VAL_ 683 ISL_Resp 0 "OFF" 1 "ON" ;
VAL_ 683 ACC_RiTgt_02_Typ 0 "Unkown" 1 "Sedan" 2 "Truck" 3 "Motorcycle" 4 "Pedestrian" 5 "Bicycle" 6 "Traffic_cone" 7 "Obstacle" ;
VAL_ 683 ACC_RiTgt_02_Dy 0 "Valid_values" ;
VAL_ 683 LowPowerEgyMngmntModResp 0 "OFF" 1 "ON" ;
VAL_ 683 ACC_RiTgtObjBarDisp 0 "No_Display" 1 "Distance_1_one_bar" 2 "Distance_2_two_bars" 3 "Distance_3_three_bars" 4 "Distance_4_four_bars" ;
VAL_ 683 ACC_LeTgtObjBarDisp 0 "No_Display" 1 "Distance_1_one_bar" 2 "Distance_2_two_bars" 3 "Distance_3_three_bars" 4 "Distance_4_four_bars" ;
VAL_ 683 ACC_RiTargrt_02_Detn 0 "Not_Dectected" 1 "Dectected" 3 "Invalid" ;
VAL_ 683 ACC_LeTargrt_02_Detn 0 "Not_Dectected" 1 "Dectected" 3 "Invalid" ;
VAL_ 683 ACC_LeTgt_02_Typ 0 "Unkown" 1 "Sedan" 2 "Truck" 3 "Motorcycle" 4 "Pedestrian" 5 "Bicycle" 6 "Traffic_cone" 7 "Obstacle" ;
VAL_ 683 ACC_LeTgt_02_Dy 0 "Valid_values" ;
VAL_ 692 AEB_RiCyclistTyp 0 "Unkown" 1 "Sedan" 2 "Truck" 3 "Motorcycle" 4 "Pedestrian" 5 "Bicycle" 7 "Invalid" ;
VAL_ 692 AEB_RiCyclistDetn 0 "Not_dectected" 1 "Dectected" 3 "Invalid" ;
VAL_ 692 AEB_LeCyclistTyp 0 "Unkown" 1 "Sedan" 2 "Truck" 3 "Motorcycle" 4 "Pedestrian" 5 "Bicycle" 7 "Invalid" ;
VAL_ 692 AEB_LeCyclistDetn 0 "Not_dectected" 1 "Dectected" 3 "Invalid" ;
VAL_ 692 NOH_SysInfoDisplay 0 "Default" 1 "In_NOH_GeoFence" 2 "NOH_is_activated" 3 "Please_confirm_L_lane_change" 4 "Please_confirm_R_lane_change" 5 "To_overtake_from_left" 6 "To_overtake_from_right" 7 "Lane_change_waiting" 8 "To_merge_in_mainroad" 9 "NOH_to_be_deactivated" 10 "NOH_cancelled" 11 "NOH_deactivated" 12 "Cruise_speed_has_been_set_by_NOH" 13 "Speed_is_too_high_to_support_NOH" 14 "To_merge_in_fast_route" 15 "To_merge_in_ramp" ;
VAL_ 692 NOH_Swt_Resp 0 "OFF" 1 "ON" ;
VAL_ 692 NOH_Act_Resp 0 "Deactivate" 1 "Activate" ;
VAL_ 692 FCWAEB_crossingTTC 0 "No_Display" ;
VAL_ 692 FCWAEB_longTTC 0 "No_Display" ;
VAL_ 692 NOH_Sts 0 "OFF" 1 "Passive" 2 "Standby" 3 "Active" 4 "Override" 5 "Slow_retreat" 6 "Standstill" 7 "Inhibit" 8 "Urban_active" 9 "Urban_override" 10 "Urban_slow_retreat" 11 "Urban_standstill" 12 "No_Display" 15 "Fail" ;
VAL_ 692 LgtFolwDistanceSts 0 "Initial_value" 1 "Tight_gap" 2 "Proper_gap" 3 "Large_gap" ;
VAL_ 692 NOAFuncSts 0 "Initial_value" 1 "OFF" 2 "ON" ;
VAL_ 692 FCWAEB_JATTC 0 "No_Display" ;
VAL_ 692 JAPedObjState 0 "UNDEFINED" 1 "PRECEDING" 2 "STATIONARY" 3 "STOPPED" 4 "ONCOMING" ;
VAL_ 692 AEBJAObjState 0 "UNDEFINED" 1 "PRECEDING" 2 "STATIONARY" 3 "STOPPED" 4 "ONCOMING" ;
VAL_ 692 JAPedObjID 255 "No_Object" ;
VAL_ 692 JAPedObjVideoCfmd 0 "No_Fusion" 1 "Fusion" ;
VAL_ 692 AEBJAObjVideoCfmd 0 "No_Fusion" 1 "Fusion" ;
VAL_ 692 AEBJAObjID 255 "No_Object" ;
VAL_ 692 AEB_RiCyclist_collisionprob 0 "No_collisionprob" 1 "Collisionprob" ;
VAL_ 692 AEB_LeCyclist_collisionprob 0 "No_collisionprob" 1 "Collisionprob" ;
VAL_ 692 AEB_RiPed_collisionprob 0 "No_collisionprob" 1 "Collisionprob" ;
VAL_ 692 AEB_LePed_collisionprob 0 "No_collisionprob" 1 "Collisionprob" ;
VAL_ 692 AEB_RiPedDetn 0 "Not_dectected" 1 "Dectected" 3 "Invalid" ;
VAL_ 692 AEB_RiPedTyp 0 "Unkown" 1 "Sedan" 2 "Truck" 3 "Motorcycle" 4 "Pedestrian" 5 "Bicycle" 7 "Invalid" ;
VAL_ 692 AEB_LePedTyp 0 "Unkown" 1 "Sedan" 2 "Truck" 3 "Motorcycle" 4 "Pedestrian" 5 "Bicycle" 7 "Invalid" ;
VAL_ 692 AEB_LePedDetn 0 "Not_dectected" 1 "Dectected" 3 "Invalid" ;
VAL_ 696 ACC_DataRecReq 0 "No_Demand" 1 "Scenario01" 2 "Scenario02" 3 "Scenario03" 4 "Scenario04" 5 "Scenario05" 6 "Scenario06" 7 "Scenario07" 8 "Scenario08" 9 "Scenario09" 10 "Scenario10" 11 "Scenario11" 12 "Scenario12" 13 "Scenario13" 14 "Scenario14" 15 "Scenario15" 16 "Scenario16" 17 "Scenario17" 18 "Scenario18" 19 "Scenario19" 20 "Scenario20" 21 "Scenario21" 22 "Scenario22" 23 "Scenario23" 24 "Scenario24" 25 "Scenario25" 26 "Scenario26" 27 "Scenario27" 28 "Scenario28" 29 "Scenario29" 30 "Scenario30" 31 "Scenario31" 32 "Scenario32" 33 "Scenario33" 34 "Scenario34" 35 "Scenario35" 36 "Scenario36" 37 "Scenario37" 38 "Scenario38" 39 "Scenario39" 40 "Scenario40" 41 "Scenario41" 42 "Scenario42" 43 "Scenario43" 44 "Scenario44" 45 "Scenario45" 46 "Scenario46" 47 "Scenario47" 48 "Scenario48" 49 "Scenario49" 50 "Scenario50" ;
VAL_ 696 AEBObjDrvby 31 "Invalid" ;
VAL_ 696 AEBObjOverlap 31 "Invalid" ;
VAL_ 696 DrvrSts 0 "Good" 1 "Unbelievable" 2 "Low" 3 "Middle" 4 "High_Level1" 5 "High_Level2" ;
VAL_ 696 MapDataValid 0 "Valid" 1 "Invalid" ;
VAL_ 696 PedObjState 0 "UNDEFINED" 1 "PRECEDING" 2 "STATIONARY" 3 "STOPPED" ;
VAL_ 696 ACC_SOSReq 0 "No_Request" 1 "Request" 3 "Invalid" ;
VAL_ 696 RadarDrvrAttentive 0 "Inattentive" 1 "Attentive" ;
VAL_ 696 BrdgDst 61 "Out_of_Range" 63 "Unknown" ;
VAL_ 696 DrvgOnRiLane 0 "Unknown" 1 "On_right_most_lane" 2 "Not_on_right_most_lane" ;
VAL_ 696 TunnelDst 61 "Out_of_Range" 63 "Unknown" ;
VAL_ 696 NavSpdLimUnit 0 "Unknown" 1 "KMH" 2 "MPH" ;
VAL_ 696 CurveDst 61 "Out_of_Range" 63 "Unknown" ;
VAL_ 696 SpdLimit 0 "No_SPL" 1 "SPL_5" 2 "SPL_10" 3 "SPL_15" 4 "SPL_20" 5 "SPL_25" 6 "SPL_30" 7 "SPL_35" 8 "SPL_40" 9 "SPL_45" 10 "SPL_50" 11 "SPL_55" 12 "SPL_60" 13 "SPL_65" 14 "SPL_70" 15 "SPL_75" 16 "SPL_80" 17 "SPL_85" 18 "SPL_90" 19 "SPL_95" 20 "SPL_100" 21 "SPL_105" 22 "SPL_110" 23 "SPL_115" 24 "SPL_120" 25 "SPL_125" 26 "SPL_130" 27 "SPL_135" 28 "SPL_140" 29 "SPL_145" 30 "SPL_150" 63 "Invalid" ;
VAL_ 696 RampDst 61 "Out_of_Range" 63 "Unknown" ;
VAL_ 696 RoadCrvtFar 511 "Straightaway" 1023 "Unknown" ;
VAL_ 696 SpdLimitDst 61 "Out_of_Range" 63 "Unknown" ;
VAL_ 696 RoadCrvt 511 "Straightaway" 1023 "Unknown" ;
VAL_ 696 DrvgOnHiWay 0 "Unknown" 1 "On_Hignway" 2 "Not_on_hgh_way" ;
VAL_ 696 HandsoffDetd 0 "Unknown" 1 "Hands_Off" 2 "Not_Hands_Off" ;
VAL_ 696 ACCTgtObjVideoCfmd 0 "No_Fusion" 1 "Fusion" ;
VAL_ 696 ACCTgtObjState 0 "UNDEFINED" 1 "PRECEDING" 2 "STATIONARY" 3 "STOPPED" ;
VAL_ 696 ACCTgtObjID 255 "No_Object" ;
VAL_ 696 PedObjAx 0 "Valid Value" ;
VAL_ 696 PedObjVideoCfmd 0 "No_Fusion" 1 "Fusion" ;
VAL_ 696 PedObjDy 0 "Valid Value" ;
VAL_ 696 PedObjID 255 "No_Object" ;
VAL_ 696 CyclistObjVideoCfmd 0 "No_Fusion" 1 "Fusion" ;
VAL_ 696 CyclistObjState 0 "UNDEFINED" 1 "PRECEDING" 2 "STATIONARY" 3 "STOPPED" ;
VAL_ 696 CyclistObjID 255 "No_Object" ;
VAL_ 696 AEBObjState 0 "UNDEFINED" 1 "PRECEDING" 2 "STATIONARY" 3 "STOPPED" ;
VAL_ 696 AEBObjVideoCfmd 0 "No_Fusion" 1 "Fusion" ;
VAL_ 696 AEBObjID 255 "No_Object" ;
