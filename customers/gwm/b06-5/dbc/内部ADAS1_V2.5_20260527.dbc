VERSION ""

NS_ :

BS_:

BU_: CEM20 GW IDM Tester

BO_ 810 ACC_FD6: 64 IDM
 SG_ SmtLSideViewCamSts : 31|2@0+ (1,0) [0|3] "" Vector__XXX
 SG_ SmtRSideViewCamSts : 17|2@0+ (1,0) [0|3] "" Vector__XXX
 SG_ SmarRearviewcamSts : 19|2@0+ (1,0) [0|3] "" Vector__XXX
 SG_ HumanDrvWarnInfoDisp : 23|4@0+ (1,0) [0|15] "NoUnit" Vector__XXX
 SG_ DrvImpairmAsscSts : 12|2@0+ (1,0) [0|3] "NoUnit" Vector__XXX

BO_ 299 IFC_FD1: 64 IDM
 SG_ MAC_Check_IFC_FD1 : 471|48@0+ (1,0) [0|281474976710655] "" Vector__XXX
 SG_ FreshnessValue_IFC_FD1 : 455|16@0+ (1,0) [0|65535] "" Vector__XXX
 SG_ LCP_State : 231|3@0+ (1,0) [0|7] "NoUnit" Vector__XXX
 SG_ NavOptSpdLim : 222|5@0+ (1,0) [0|31] "NoUnit" Vector__XXX
 SG_ VisOptSpdLim : 211|5@0+ (1,0) [0|31] "NoUnit" Vector__XXX
 SG_ LKA_State : 214|3@0+ (1,0) [0|7] "NoUnit" Vector__XXX
 SG_ LDW_State : 201|3@0+ (1,0) [0|7] "NoUnit" Vector__XXX
 SG_ AES_State : 204|3@0+ (1,0) [0|7] "NoUnit" Vector__XXX
 SG_ ESS_State : 207|3@0+ (1,0) [0|7] "NoUnit" Vector__XXX
 SG_ RollingCounter_IFC2 : 187|4@0+ (1,0) [0|15] "" Vector__XXX
 SG_ StrgTrqCoeff : 182|7@0+ (0.01,-0.01) [0|1] "NoUnit" Vector__XXX
 SG_ IFCFuncAngCmdReqFlag : 175|3@0+ (1,0) [0|7] "" Vector__XXX
 SG_ IFCAngCmdReqProtnValue : 159|14@0+ (1,0) [0|16383] "" Vector__XXX
 SG_ IFCAngCmdReqValue : 143|14@0+ (0.1,-780) [-780|780] "°" Vector__XXX
 SG_ Checksum_IFC2 : 135|8@0+ (1,0) [0|255] "" Vector__XXX
 SG_ RollingCounter_IFC1 : 123|4@0+ (1,0) [0|15] "" Vector__XXX
 SG_ IFCFuncTrqCmdReqFlag : 127|3@0+ (1,0) [0|7] "" Vector__XXX
 SG_ IFCVibrationWarning : 105|2@0+ (1,0) [0|3] "" Vector__XXX
 SG_ IFCTrqOvlCmdReqValue : 103|11@0+ (0.01,-10.23) [-10.23|10.24] "Nm" Vector__XXX
 SG_ IFCTrqOvlCmdProtnValue : 79|14@0+ (1,0) [0|16383] "" Vector__XXX
 SG_ Checksum_IFC1 : 71|8@0+ (1,0) [0|255] "" Vector__XXX

BO_ 323 ACC_FD1: 64 IDM
 SG_ MAC_Check_ACC_FD1 : 471|48@0+ (1,0) [0|281474976710655] "" Vector__XXX
 SG_ FreshnessValue_ACC_FD1 : 455|16@0+ (1,0) [0|65535] "" Vector__XXX
 SG_ RollingCounter_ACC14 : 379|4@0+ (1,0) [0|15] "NoUnit" Vector__XXX
 SG_ VehRollRate : 367|16@0+ (0.01,-300.01) [-300|300] "DegPerSec" Vector__XXX
 SG_ VehPitchRate : 351|16@0+ (0.01,-300.01) [-300|300] "DegPerSec" Vector__XXX
 SG_ InrlMeasUnitFailrSts : 337|2@0+ (1,0) [0|3] "NoUnit" Vector__XXX
 SG_ VehVerAccel : 335|14@0+ (0.01,-80.01) [-80|80] "MtrPerSecSq" Vector__XXX
 SG_ Checksum_ACC14 : 327|8@0+ (1,0) [0|255] "NoUnit" Vector__XXX
 SG_ RollingCounter_ACC12 : 315|4@0+ (1,0) [0|15] "NoUnit" Vector__XXX
 SG_ DrvgPrkgFuncActvnSts : 308|2@0+ (1,0) [0|3] "NoUnit" Vector__XXX
 SG_ FxTgtGearEna : 310|2@0+ (1,0) [0|3] "NoUnit" Vector__XXX
 SG_ FxTgtGearReqVld : 311|1@0+ (1,0) [0|1] "NoUnit" Vector__XXX
 SG_ TotRefTrq : 295|16@0+ (1,-32769) [-32768|32766] "Nm" Vector__XXX
 SG_ FxTgtGearReq : 282|3@0+ (1,0) [0|7] "NoUnit" Vector__XXX
 SG_ FxTgtTrqMod : 284|2@0+ (1,0) [0|3] "NoUnit" Vector__XXX
 SG_ FxTgtTrqEna : 286|2@0+ (1,0) [0|3] "NoUnit" Vector__XXX
 SG_ FxTgtTrqVld : 287|1@0+ (1,0) [0|1] "NoUnit" Vector__XXX
 SG_ FxTgtTrq : 271|16@0+ (1,-32769) [-32768|32766] "Nm" Vector__XXX
 SG_ Checksum_ACC12 : 263|8@0+ (1,0) [0|255] "NoUnit" Vector__XXX
 SG_ RollingCounter_ACC10 : 251|4@0+ (1,0) [0|15] "" Vector__XXX
 SG_ AEBFrwdObstclDetnFailSts : 253|2@0+ (1,0) [0|3] "NoUnit" Vector__XXX
 SG_ AEBMstRskObstclPreCllsnTim : 238|6@0+ (0.1,-0.1) [0|6.1] "s" Vector__XXX
 SG_ Longctrl_WheelTrqReqActive : 239|1@0+ (1,0) [0|1] "" Vector__XXX
 SG_ Longctrl_WheelTrqReq : 223|16@0+ (0.5,-16384) [-16384|16383.5] "NM" Vector__XXX
 SG_ Checksum_ACC10 : 199|8@0+ (1,0) [0|255] "" Vector__XXX
 SG_ RollingCounter_ACC2 : 187|4@0+ (1,0) [0|15] "NoUnit" Vector__XXX
 SG_ ACC_CRInterface : 191|1@0+ (1,0) [0|1] "" Vector__XXX
 SG_ IDC_L2_HADFuncCmdReqFlag : 163|3@0+ (1,0) [0|7] "NoUnit" Vector__XXX
 SG_ Checksum_ACC2 : 135|8@0+ (1,0) [0|255] "NoUnit" Vector__XXX
 SG_ RollingCounter_ACC1 : 123|4@0+ (1,0) [0|15] "" Vector__XXX
 SG_ ActualTargetSpeed : 119|8@0+ (1,0) [0|254] "kph/mph" Vector__XXX
 SG_ Longctrl_Decel_ReqValue : 111|8@0+ (0.05,-7) [-7|5.75] "m/s^2" Vector__XXX
 SG_ InterceptionDmd : 96|1@0+ (1,0) [0|1] "NoUnit" Vector__XXX
 SG_ Longctrl_ParkShiftReq : 99|2@0+ (1,0) [0|3] "" Vector__XXX
 SG_ Longctrl_DecelToStopReq : 101|1@0+ (1,0) [0|1] "" Vector__XXX
 SG_ Longctrl_Decel_Req : 72|1@0+ (1,0) [0|1] "" Vector__XXX
 SG_ Longctrl_ModSts : 77|4@0+ (1,0) [0|15] "" Vector__XXX
 SG_ Longctrl_DrvOFF_Req : 78|1@0+ (1,0) [0|1] "" Vector__XXX
 SG_ Longctrl_VehHldReq : 79|1@0+ (1,0) [0|1] "" Vector__XXX
 SG_ Checksum_ACC1 : 71|8@0+ (1,0) [0|255] "" Vector__XXX
 SG_ RollingCounter_ACC11 : 59|4@0+ (1,0) [0|15] "NoUnit" Vector__XXX
 SG_ Longctrl_AccelOvrdActnReq : 49|1@0+ (1,0) [0|1] "NoUnit" Vector__XXX
 SG_ HWP_MotTypeReqMode_L2 : 55|2@0+ (1,0) [0|3] "NoUnit" Vector__XXX
 SG_ Longctrl_TgtGearReqVld : 12|1@0+ (1,0) [0|1] "NoUnit" Vector__XXX
 SG_ Longctrl_TgtGearReq : 15|3@0+ (1,0) [0|7] "NoUnit" Vector__XXX
 SG_ Checksum_ACC11 : 7|8@0+ (1,0) [0|255] "NoUnit" Vector__XXX

BO_ 347 HAP_FD1: 64 IDM
 SG_ MAC_Check_HAP_FD1 : 471|48@0+ (1,0) [0|281474976710655] "" Vector__XXX
 SG_ FreshnessValue_HAP_FD1 : 455|16@0+ (1,0) [0|65535] "" Vector__XXX
 SG_ RollingCounter_APA7 : 443|4@0+ (1,0) [0|15] "NoUnit" Vector__XXX
 SG_ RWSModReq : 439|3@0+ (1,0) [0|7] "NoUnit" Vector__XXX
 SG_ APA_PxReqVld : 425|1@0+ (1,0) [0|1] "NoUnit" Vector__XXX
 SG_ APA_FxReqVld : 426|1@0+ (1,0) [0|1] "NoUnit" Vector__XXX
 SG_ APA_FxReq : 423|13@0+ (1,0) [0|8191] "NM" Vector__XXX
 SG_ APA_PxReq : 402|11@0+ (0.1,0) [0|204.7] "bar" Vector__XXX
 SG_ APA_ModFlag : 404|2@0+ (1,0) [0|3] "NoUnit" Vector__XXX
 SG_ RWSAngReqVld : 405|1@0+ (1,0) [0|1] "NoUnit" Vector__XXX
 SG_ RWSAngReq : 399|8@0+ (0.1,-10.1) [-10|10] "Deg" Vector__XXX
 SG_ Checksum_APA7 : 391|8@0+ (1,0) [0|255] "NoUnit" Vector__XXX
 SG_ RollingCounter_HAP3 : 379|4@0+ (1,0) [0|15] "NoUnit" Vector__XXX
 SG_ SlotConfirmBtn_Ena : 375|2@0+ (1,0) [0|3] "" Vector__XXX
 SG_ AnticlockwiseBtn_Ena : 361|2@0+ (1,0) [0|3] "" Vector__XXX
 SG_ ClockwiseBtn_Ena : 363|2@0+ (1,0) [0|3] "" Vector__XXX
 SG_ VerticalSlotBtn_Ena : 365|2@0+ (1,0) [0|3] "" Vector__XXX
 SG_ ParallelSlotBtn_Ena : 367|2@0+ (1,0) [0|3] "" Vector__XXX
 SG_ PAVP_FuncSts : 353|2@0+ (1,0) [0|3] "NoUnit" Vector__XXX
 SG_ PAVP_TextDis2 : 359|6@0+ (1,0) [0|63] "" Vector__XXX
 SG_ HAVP_FuncSts : 345|2@0+ (1,0) [0|3] "NoUnit" Vector__XXX
 SG_ PAVP_TextDis : 351|6@0+ (1,0) [0|63] "" Vector__XXX
 SG_ HAVP_SelfParLotEnding_Ena : 339|2@0+ (1,0) [0|3] "" Vector__XXX
 SG_ PAVP_Status : 343|4@0+ (1,0) [0|15] "" Vector__XXX
 SG_ HAVP_StopBtn_Ena : 329|2@0+ (1,0) [0|3] "" Vector__XXX
 SG_ HAVP_StartBtn_Ena : 331|2@0+ (1,0) [0|3] "" Vector__XXX
 SG_ HAVP_WorkSts : 335|4@0+ (1,0) [0|15] "" Vector__XXX
 SG_ Checksum_HAP3 : 327|8@0+ (1,0) [0|255] "NoUnit" Vector__XXX
 SG_ RollingCounter_HAP1 : 315|4@0+ (1,0) [0|15] "" Vector__XXX
 SG_ AVP_T_BOX_WorkSts : 317|2@0+ (1,0) [0|3] "" Vector__XXX
 SG_ AVP_SunroofCloseReq : 319|2@0+ (1,0) [0|3] "" Vector__XXX
 SG_ RmtCtrlSts : 305|1@0+ (1,0) [0|1] "" Vector__XXX
 SG_ AVP_CenCtrllockReq : 307|2@0+ (1,0) [0|3] "" Vector__XXX
 SG_ AVP_WindLockReq : 309|2@0+ (1,0) [0|3] "" Vector__XXX
 SG_ AVP_PowerModeReq : 311|2@0+ (1,0) [0|3] "" Vector__XXX
 SG_ AVP_FWshrReq : 297|2@0+ (1,0) [0|3] "" Vector__XXX
 SG_ AVP_FWiperReq : 300|3@0+ (1,0) [0|7] "" Vector__XXX
 SG_ AVP_HornReq : 302|2@0+ (1,0) [0|3] "" Vector__XXX
 SG_ AVP_RFogLightReq : 303|1@0+ (1,0) [0|1] "NoUnit" Vector__XXX
 SG_ AVP_FFogLightReq : 288|1@0+ (1,0) [0|1] "NoUnit" Vector__XXX
 SG_ AVP_DippedBeamReq : 290|2@0+ (1,0) [0|3] "" Vector__XXX
 SG_ AVP_HiBeamtReq : 292|2@0+ (1,0) [0|3] "" Vector__XXX
 SG_ P2P_PrkgDirectSts : 293|1@0+ (1,0) [0|1] "" Vector__XXX
 SG_ APS_MovgDirc : 295|2@0+ (1,0) [0|3] "" Vector__XXX
 SG_ TailVertPrkgOutVald : 280|1@0+ (1,0) [0|1] "" Vector__XXX
 SG_ HeadVertPrkgOutVald : 281|1@0+ (1,0) [0|1] "" Vector__XXX
 SG_ RParaPrkgOutVald : 282|1@0+ (1,0) [0|1] "" Vector__XXX
 SG_ LParaPrkgOutVald : 283|1@0+ (1,0) [0|1] "" Vector__XXX
 SG_ RmtPrkgReq : 284|1@0+ (1,0) [0|1] "" Vector__XXX
 SG_ P2P_Pah2Avail : 285|1@0+ (1,0) [0|1] "" Vector__XXX
 SG_ P2P_SelfDetSts : 287|2@0+ (1,0) [0|3] "" Vector__XXX
 SG_ P2P_Pah1Avail : 272|1@0+ (1,0) [0|1] "" Vector__XXX
 SG_ P2P_SelfDetErrCode : 276|4@0+ (1,0) [0|15] "" Vector__XXX
 SG_ HAP_SwtDispCtrlCmd : 279|3@0+ (1,0) [0|7] "" Vector__XXX
 SG_ P2P_PahDelSts : 265|2@0+ (1,0) [0|3] "" Vector__XXX
 SG_ HAP_PrkgModCurrSts : 269|4@0+ (1,0) [0|15] "" Vector__XXX
 SG_ APS_PASSwtReq : 271|2@0+ (1,0) [0|3] "" Vector__XXX
 SG_ Checksum_HAP1 : 263|8@0+ (1,0) [0|255] "" Vector__XXX
 SG_ RollingCounter_AVP1 : 251|4@0+ (1,0) [0|15] "NoUnit" Vector__XXX
 SG_ DrvDirCllsnWarnTrqCtrlFlg : 254|3@0+ (1,0) [0|7] "NoUnit" Vector__XXX
 SG_ DrvDirMstRskObstclCllsnTim : 247|6@0+ (0.1,-0.1) [0|6.1] "s" Vector__XXX
 SG_ AVP_ESP_LSMNudgeReq : 232|1@0+ (1,0) [0|1] "NoUnit" Vector__XXX
 SG_ AVP_ESP_LSMVehSecReq : 233|1@0+ (1,0) [0|1] "NoUnit" Vector__XXX
 SG_ AVP_ESP_LSMComfBrakeReq : 235|2@0+ (1,0) [0|3] "NoUnit" Vector__XXX
 SG_ AVP_ESP_LSMVehDirRq : 237|2@0+ (1,0) [0|3] "NoUnit" Vector__XXX
 SG_ AVP_ESP_LSMSubMTLong : 239|2@0+ (1,0) [0|3] "NoUnit" Vector__XXX
 SG_ AVP_ESP_LSMPrefill : 224|1@0+ (1,0) [0|1] "NoUnit" Vector__XXX
 SG_ AVP_ESP_LSMSubMTLevel : 226|2@0+ (1,0) [0|3] "" Vector__XXX
 SG_ AVP_ESP_SafeDrvrHandoverReq : 227|1@0+ (1,0) [0|1] "NoUnit" Vector__XXX
 SG_ AVP_ESP_LSMvMaxRq : 223|11@0+ (0.1,0) [0|20] "kph" Vector__XXX
 SG_ AVP_ESP_LSMSubMTReq : 209|2@0+ (1,0) [0|3] "NoUnit" Vector__XXX
 SG_ AVP_ESP_DriverPresenceExternal : 210|1@0+ (1,0) [0|1] "NoUnit" Vector__XXX
 SG_ AVP_ESP_LSMDistToStop : 207|12@0+ (1,0) [0|4095] "cm" Vector__XXX
 SG_ Checksum_AVP1 : 199|8@0+ (1,0) [0|255] "NoUnit" Vector__XXX
 SG_ RollingCounter_APS4 : 187|4@0+ (1,0) [0|15] "" Vector__XXX
 SG_ RHeadVertPrkgOutVald : 188|1@0+ (1,0) [0|1] "NoUnit" Vector__XXX
 SG_ LHeadVertPrkgOutVald : 189|1@0+ (1,0) [0|1] "NoUnit" Vector__XXX
 SG_ RTailVertPrkgOutVald : 190|1@0+ (1,0) [0|1] "NoUnit" Vector__XXX
 SG_ LTailVertPrkgOutVald : 191|1@0+ (1,0) [0|1] "NoUnit" Vector__XXX
 SG_ MEB_BrkgReqValue : 183|8@0+ (0.05,-10) [-10|0] "m/s^2" Vector__XXX
 SG_ MEB_AVHReq : 168|1@0+ (1,0) [0|1] "" Vector__XXX
 SG_ PrkMod : 171|2@0+ (1,0) [0|3] "NoUnit" Vector__XXX
 SG_ APS_ESP_BrkDistance : 167|12@0+ (1,0) [0|4095] "cm" Vector__XXX
 SG_ APS_ESP_SpdLimn : 159|8@0+ (0.1,0) [0|25.5] "kmh" Vector__XXX
 SG_ APS_WorkSts : 146|3@0+ (1,0) [0|7] "" Vector__XXX
 SG_ MEB_BrkgReq : 147|1@0+ (1,0) [0|1] "" Vector__XXX
 SG_ MEBErrSts : 148|1@0+ (1,0) [0|1] "" Vector__XXX
 SG_ APS_BrkModSts : 151|3@0+ (1,0) [0|7] "" Vector__XXX
 SG_ APS_BrkCategory : 137|2@0+ (1,0) [0|3] "" Vector__XXX
 SG_ APS_ESP_TgtGearReq : 140|3@0+ (1,0) [0|7] "" Vector__XXX
 SG_ APS_BrkFctnMod : 143|3@0+ (1,0) [0|7] "" Vector__XXX
 SG_ Checksum_APS4 : 135|8@0+ (1,0) [0|255] "" Vector__XXX
 SG_ RollingCounter_APS1 : 123|4@0+ (1,0) [0|15] "" Vector__XXX
 SG_ OutdPrkgSts : 113|2@0+ (1,0) [0|3] "NoUnit" Vector__XXX
 SG_ TurnLightsCmd : 115|2@0+ (1,0) [0|3] "" Vector__XXX
 SG_ APS_PrkgMod : 117|2@0+ (1,0) [0|3] "" Vector__XXX
 SG_ APS_PrkgTyp : 119|2@0+ (1,0) [0|3] "" Vector__XXX
 SG_ APS_SwtSts : 104|1@0+ (1,0) [0|1] "" Vector__XXX
 SG_ APS_ProcBar : 111|7@0+ (1,0) [0|100] "%" Vector__XXX
 SG_ APS_TextDisp : 103|8@0+ (1,0) [0|255] "" Vector__XXX
 SG_ APS_ReqEPSTgtAng : 87|15@0+ (0.1,0) [-1638.3|1638.3] "deg" Vector__XXX
 SG_ APS_ReqCtrlEPS : 72|1@0+ (1,0) [0|1] "" Vector__XXX
 SG_ APS_ReqEPSTgtAngValid : 73|1@0+ (1,0) [0|1] "" Vector__XXX
 SG_ APS_SlotDisp : 76|3@0+ (1,0) [0|7] "" Vector__XXX
 SG_ APS_SysSoundIndcn : 79|3@0+ (1,0) [0|7] "" Vector__XXX
 SG_ Checksum_APS1 : 71|8@0+ (1,0) [0|255] "" Vector__XXX
 SG_ RollingCounter_APA1 : 59|4@0+ (1,0) [0|15] "" Vector__XXX
 SG_ APA_BrkFctnMod : 63|3@0+ (1,0) [0|7] "" Vector__XXX
 SG_ APA_ApStandstillReq : 48|1@0+ (1,0) [0|1] "" Vector__XXX
 SG_ APA_ApDriveOffReq : 49|1@0+ (1,0) [0|1] "" Vector__XXX
 SG_ APA_ApEmgyBrkReq : 50|1@0+ (1,0) [0|1] "" Vector__XXX
 SG_ APA_AxReqEna : 53|1@0+ (1,0) [0|1] "" Vector__XXX
 SG_ APA_ApbReq : 41|2@0+ (1,0) [0|3] "" Vector__XXX
 SG_ APA_DistoStop : 35|10@0+ (1,0) [0|1023] "cm" Vector__XXX
 SG_ APA_AxReq : 31|12@0+ (0.01,-10) [-10|6] "m/s2" Vector__XXX
 SG_ Checksum_APA1 : 7|8@0+ (1,0) [0|255] "" Vector__XXX

BO_ 350 CR_FD1: 64 IDM
 SG_ FCTB_State : 104|3@0+ (1,0) [0|7] "NoUnit" Vector__XXX
 SG_ FCTA_B_TTC : 110|6@0+ (0.1,0) [0.1|6.3] "s" Vector__XXX
 SG_ FCTB_ABP_Req : 111|1@0+ (1,0) [0|1] "" Vector__XXX
 SG_ CR_BrkgReqVal : 95|16@0+ (0.000488,-16) [-16|15.980592] "m/s2" Vector__XXX
 SG_ FCTB_ABA_Req : 80|1@0+ (1,0) [0|1] "" Vector__XXX
 SG_ FCTB_ABA_Level : 82|2@0+ (1,0) [0|3] "" Vector__XXX
 SG_ FCTBTrig : 83|1@0+ (1,0) [0|1] "" Vector__XXX
 SG_ CR_BrkgReq : 85|1@0+ (1,0) [0|1] "" Vector__XXX
 SG_ CR_BliSts : 86|1@0+ (1,0) [0|1] "" Vector__XXX
 SG_ CR_ErrSts : 87|1@0+ (1,0) [0|1] "" Vector__XXX
 SG_ FCTA_State : 74|3@0+ (1,0) [0|7] "NoUnit" Vector__XXX
 SG_ FCTA_Warn : 75|1@0+ (1,0) [0|1] "" Vector__XXX
 SG_ FCTA_B_FuncSts : 77|2@0+ (1,0) [0|3] "" Vector__XXX
 SG_ CR_FCTB_Resp : 78|1@0+ (1,0) [0|1] "" Vector__XXX
 SG_ CR_FCTA_Resp : 79|1@0+ (1,0) [0|1] "" Vector__XXX

BO_ 415 IFC_FD5: 64 IDM
 SG_ IFC_Line_special02_CurvChange : 431|20@0+ (5e-08,-0.024) [-0.024|0.024] "PerMtrSq" Vector__XXX
 SG_ ACC_RiTgtObjBarDisp_03 : 418|3@0+ (1,0) [0|7] "NoUnit" Vector__XXX
 SG_ TargetPathC0 : 415|13@0+ (0.01,-30) [-30|30.01] "m" Vector__XXX
 SG_ TargetPathC2 : 399|15@0+ (1.6e-05,-0.25) [-0.25|0.25] "PerMtr" Vector__XXX
 SG_ IFC_Roadedge02_Type : 383|4@0+ (1,0) [0|15] "" Vector__XXX
 SG_ IFC_Roadedge02_CurvChange : 355|20@0+ (5e-08,-0.024) [-0.024|0.024] "1/(m*m)" Vector__XXX
 SG_ IFC_Roadedge02_Curv : 338|15@0+ (1.6e-05,-0.25) [-0.25|0.25] "1/m" Vector__XXX
 SG_ IFC_Roadedge02_Dy : 335|13@0+ (0.01,-30) [-30|30] "m" Vector__XXX
 SG_ IFC_Roadedge01_Type : 319|4@0+ (1,0) [0|15] "" Vector__XXX
 SG_ IFC_Roadedge01_CurvChange : 291|20@0+ (5e-08,-0.024) [-0.024|0.024] "1/(m*m)" Vector__XXX
 SG_ IFC_Roadedge01_Curv : 274|15@0+ (1.6e-05,-0.25) [-0.25|0.25] "1/m" Vector__XXX
 SG_ IFC_Roadedge01_Dy : 271|13@0+ (0.01,-30) [-30|30] "m" Vector__XXX
 SG_ IFC_Line04_Type : 255|4@0+ (1,0) [0|15] "" Vector__XXX
 SG_ IFC_Line04_CurvChange : 227|20@0+ (5e-08,-0.024) [-0.024|0.024] "1/(m*m)" Vector__XXX
 SG_ IFC_Line04_Curv : 210|15@0+ (1.6e-05,-0.25) [-0.25|0.25] "1/m" Vector__XXX
 SG_ IFC_Line04_Dy : 207|13@0+ (0.01,-30) [-30|30] "m" Vector__XXX
 SG_ IFC_Line03_Type : 191|4@0+ (1,0) [0|15] "" Vector__XXX
 SG_ IFC_Line03_CurvChange : 163|20@0+ (5e-08,-0.024) [-0.024|0.024] "1/(m*m)" Vector__XXX
 SG_ IFC_Line03_Curv : 146|15@0+ (1.6e-05,-0.25) [-0.25|0.25] "1/m" Vector__XXX
 SG_ IFC_Line03_Dy : 143|13@0+ (0.01,-30) [-30|30] "m" Vector__XXX
 SG_ IFC_Line02_Type : 127|4@0+ (1,0) [0|15] "" Vector__XXX
 SG_ IFC_Line02_CurvChange : 99|20@0+ (5e-08,-0.024) [-0.024|0.024] "1/(m*m)" Vector__XXX
 SG_ IFC_Line02_Curv : 82|15@0+ (1.6e-05,-0.25) [-0.25|0.25] "1/m" Vector__XXX
 SG_ IFC_Line02_Dy : 79|13@0+ (0.01,-30) [-30|30] "m" Vector__XXX
 SG_ IFC_Line01_Type : 63|4@0+ (1,0) [0|15] "" Vector__XXX
 SG_ IFC_Line01_CurvChange : 35|20@0+ (5e-08,-0.024) [-0.024|0.024] "1/(m*m)" Vector__XXX
 SG_ IFC_Line01_Curv : 18|15@0+ (1.6e-05,-0.25) [-0.25|0.25] "1/m" Vector__XXX
 SG_ IFC_Line01_Dy : 15|13@0+ (0.01,-30) [-30|30] "m" Vector__XXX

BO_ 546 IFC_FD6: 64 IDM
 SG_ RollingCounter_IFC_HCM9 : 443|4@0+ (1,0) [0|15] "NoUnit" Vector__XXX
 SG_ IFC_Line_special02_DxEnd : 430|15@0+ (0.01,0) [0|200.01] "m" Vector__XXX
 SG_ IFC_Line_special02_DxStart : 415|15@0+ (0.01,0) [0|200.01] "m" Vector__XXX
 SG_ TargetPositionDx : 393|9@0+ (0.5,0) [0|250] "m" Vector__XXX
 SG_ CameraSts : 395|2@0+ (1,0) [0|3] "NoUnit" Vector__XXX
 SG_ TrafficStyle : 397|2@0+ (1,0) [0|3] "NoUnit" Vector__XXX
 SG_ RoadIllumDetd : 398|1@0+ (1,0) [0|1] "NoUnit" Vector__XXX
 SG_ AmbLight : 399|1@0+ (1,0) [0|1] "NoUnit" Vector__XXX
 SG_ Checksum_IFC_HCM9 : 391|8@0+ (1,0) [0|255] "NoUnit" Vector__XXX
 SG_ RollingCounter_IFC_HCM8 : 379|4@0+ (1,0) [0|15] "NoUnit" Vector__XXX
 SG_ Spots8VehObjClassn : 382|3@0+ (1,0) [0|7] "NoUnit" Vector__XXX
 SG_ Spots8TrackingInfo : 383|1@0+ (1,0) [0|1] "NoUnit" Vector__XXX
 SG_ Spot8VertAng : 375|8@0+ (0.125,-5) [-5|26.875] "NoUnit" Vector__XXX
 SG_ Spots8HozLeAngSpd : 367|8@0+ (0.125,-16) [-16|15.875] "DegPerSec" Vector__XXX
 SG_ Spots8Distance : 344|9@0+ (1,0) [0|510] "m" Vector__XXX
 SG_ Spots8Typ : 346|2@0+ (1,0) [0|3] "NoUnit" Vector__XXX
 SG_ Spots8Valid : 347|1@0+ (1,0) [0|1] "NoUnit" Vector__XXX
 SG_ Spots8HozlPosnRiAng : 341|10@0+ (0.08,-40) [-40|40] "Deg" Vector__XXX
 SG_ Spots8HozlPosnLeAng : 335|10@0+ (0.08,-40) [-40|40] "Deg" Vector__XXX
 SG_ Checksum_IFC_HCM8 : 327|8@0+ (1,0) [0|255] "NoUnit" Vector__XXX
 SG_ IFC_Roadedge02_HeadingAngle : 296|9@0+ (0.01,-2) [-2|2] "rad" Vector__XXX
 SG_ IFC_Roadedge02_DxEnd : 295|15@0+ (0.01,0) [0|200] "m" Vector__XXX
 SG_ IFC_Roadedge02_DxStart : 278|15@0+ (0.01,0) [0|200] "m" Vector__XXX
 SG_ IFC_Roadedge01_HeadingAngle : 271|9@0+ (0.01,-2) [-2|2] "rad" Vector__XXX
 SG_ IFC_Roadedge01_DxEnd : 239|15@0+ (0.01,0) [0|200] "m" Vector__XXX
 SG_ IFC_Roadedge01_DxStart : 223|15@0+ (0.01,0) [0|200] "m" Vector__XXX
 SG_ IFC_Line04_DxEnd : 207|15@0+ (0.01,0) [0|200] "m" Vector__XXX
 SG_ IFC_Line04_HeadingAngle : 168|9@0+ (0.01,-2) [-2|2] "rad" Vector__XXX
 SG_ IFC_Line04_DxStart : 167|15@0+ (0.01,0) [0|200] "m" Vector__XXX
 SG_ IFC_Line03_HeadingAngle : 144|9@0+ (0.01,-2) [-2|2] "rad" Vector__XXX
 SG_ IFC_Line03_DxEnd : 143|15@0+ (0.01,0) [0|200] "m" Vector__XXX
 SG_ IFC_Line03_DxStart : 111|15@0+ (0.01,0) [0|200] "m" Vector__XXX
 SG_ IFC_Line02_DxEnd : 95|15@0+ (0.01,0) [0|200] "m" Vector__XXX
 SG_ IFC_Line02_DxStart : 79|15@0+ (0.01,0) [0|200] "m" Vector__XXX
 SG_ IFC_Line02_HeadingAngle : 40|9@0+ (0.01,-2) [-2|2] "rad" Vector__XXX
 SG_ IFC_Line01_HeadingAngle : 33|9@0+ (0.01,-2) [-2|2] "rad" Vector__XXX
 SG_ IFC_Line01_DxEnd : 16|15@0+ (0.01,0) [0|200] "m" Vector__XXX
 SG_ IFC_Line01_DxStart : 15|15@0+ (0.01,0) [0|200] "m" Vector__XXX

BO_ 551 AEB_FD2: 64 IDM
 SG_ MAC_Check_AEB_FD2 : 471|48@0+ (1,0) [0|281474976710655] "" Vector__XXX
 SG_ FreshnessValue_AEB_FD2 : 455|16@0+ (1,0) [0|65535] "" Vector__XXX
 SG_ MOD_SwtResp : 401|2@0+ (1,0) [0|3] "NoUnit" Vector__XXX
 SG_ MOD_DispSts : 405|4@0+ (1,0) [0|15] "NoUnit" Vector__XXX
 SG_ MOD_Text_Lib : 394|5@0+ (1,0) [0|31] "NoUnit" Vector__XXX
 SG_ MOD_InterSysInfoDisp : 399|5@0+ (1,0) [0|31] "NoUnit" Vector__XXX
 SG_ RollingCounter_AEB5 : 379|4@0+ (1,0) [0|14] "NoUnit" Vector__XXX
 SG_ AEBObjDyActvSafety : 375|11@0+ (0.125,-128.125) [-128|127.75] "m" Vector__XXX
 SG_ AEBObjDxActvSafety : 355|12@0+ (0.0625,-0.0625) [0|255.875] "m" Vector__XXX
 SG_ AEBObjVxActvSafety : 351|12@0+ (0.0625,-128.0625) [-128|127] "mps" Vector__XXX
 SG_ TimeToCllsnActvSafety : 343|8@0+ (0.004,-0.004) [0|1] "s" Vector__XXX
 SG_ AEBTgtDecelReqActvSafety : 329|1@0+ (1,0) [0|1] "NoUnit" Vector__XXX
 SG_ ADAS_ErrStsActvSafety : 332|3@0+ (1,0) [0|7] "NoUnit" Vector__XXX
 SG_ AEBObjStyActvSafety : 335|3@0+ (1,0) [0|7] "NoUnit" Vector__XXX
 SG_ Checksum_AEB5 : 327|8@0+ (1,0) [0|255] "NoUnit" Vector__XXX
 SG_ FeatPt_Dx : 297|9@0+ (0.5,0) [0|150] "m" Vector__XXX
 SG_ ACC_RiTgt_03_Heading : 303|6@0+ (0.05,-1.5) [-1.5|1.5] "rad" Vector__XXX
 SG_ ACC_RiTgt_03_fusion : 291|1@0+ (1,0) [0|1] "" Vector__XXX
 SG_ ACC_RiTgt_03_Typ : 294|3@0+ (1,0) [0|7] "" Vector__XXX
 SG_ ACC_RiTgt_03_Dx : 287|9@0+ (0.5,-50) [-50|150] "m" Vector__XXX
 SG_ ACC_RiTgt_03_Dy : 279|8@0+ (0.1,-8) [-8|7] "m" Vector__XXX
 SG_ ACC_RiTargrt_03_Detn : 265|2@0+ (1,0) [0|3] "" Vector__XXX
 SG_ ACC_LeTgt_03_Heading : 271|6@0+ (0.05,-1.5) [-1.5|1.5] "rad" Vector__XXX
 SG_ ACC_LeTgt_03_fusion : 252|1@0+ (1,0) [0|1] "" Vector__XXX
 SG_ ACC_LeTgt_03_Typ : 255|3@0+ (1,0) [0|7] "" Vector__XXX
 SG_ ACC_LeTgt_03_Dy : 247|8@0+ (0.1,-8) [-8|8] "m" Vector__XXX
 SG_ ACC_LeTargrt_03_Detn : 233|2@0+ (1,0) [0|3] "" Vector__XXX
 SG_ ACC_PotentialTgt_02_Heading : 239|6@0+ (0.05,-1.5) [-1.5|1.5] "rad" Vector__XXX
 SG_ ACC_LeTgt_03_Dx : 216|9@0+ (0.5,-50) [-50|150] "m" Vector__XXX
 SG_ ACC_PotentialTgt_02_fusion : 217|1@0+ (1,0) [0|1] "" Vector__XXX
 SG_ ACC_PotentialTgt_02_Typ : 220|3@0+ (1,0) [0|7] "" Vector__XXX
 SG_ ACC_PotentialTgt_02_Detn : 222|2@0+ (1,0) [0|3] "" Vector__XXX
 SG_ ACC_PotentialTgt_02_Dx : 215|9@0+ (0.5,0) [0|150] "m" Vector__XXX
 SG_ ACC_PotentialTgt_02_Dy : 207|8@0+ (0.1,-8) [-8|8] "m" Vector__XXX
 SG_ RiRoad_Mark_Length : 183|8@0+ (0.1,0) [0|10] "m" Vector__XXX
 SG_ RiRoad_Mark_Width : 175|8@0+ (0.1,0) [0|4] "m" Vector__XXX
 SG_ LeRoad_Mark_Length : 167|8@0+ (0.1,0) [0|10] "m" Vector__XXX
 SG_ AEB_JABrkTrig : 159|2@0+ (1,0) [0|3] "" Vector__XXX
 SG_ AEB_JA_Warn : 145|2@0+ (1,0) [0|3] "" Vector__XXX
 SG_ AEB_JAFuncSts : 147|2@0+ (1,0) [0|3] "" Vector__XXX
 SG_ FCW_Warn : 149|2@0+ (1,0) [0|3] "" Vector__XXX
 SG_ FCW_AEB_PedFctSts : 151|2@0+ (1,0) [0|3] "" Vector__XXX
 SG_ FCW_AEB_VehFctSts : 138|2@0+ (1,0) [0|3] "" Vector__XXX
 SG_ AEB_PedTrig : 142|1@0+ (1,0) [0|1] "" Vector__XXX
 SG_ AEB_VehTrig : 143|1@0+ (1,0) [0|1] "" Vector__XXX
 SG_ IntellgntAsscLmpReq : 127|2@0+ (1,0) [0|3] "NoUnit" Vector__XXX
 SG_ LeRoad_Mark_Width : 119|8@0+ (0.1,0) [0|4] "m" Vector__XXX
 SG_ Road_Mark_Length : 111|8@0+ (0.1,0) [0|10] "m" Vector__XXX
 SG_ Road_Mark_Width : 103|8@0+ (0.1,0) [0|4] "m" Vector__XXX
 SG_ TargetPositionDy : 84|13@0+ (0.01,-30) [-30|30.01] "m" Vector__XXX
 SG_ UNP_SwtResp : 85|1@0+ (1,0) [0|1] "NoUnit" Vector__XXX
 SG_ IntellgntcurveResp : 74|1@0+ (1,0) [0|1] "" Vector__XXX
 SG_ AEB_JA_Resp : 75|1@0+ (1,0) [0|1] "" Vector__XXX
 SG_ FCW_Snvty : 77|2@0+ (1,0) [0|3] "" Vector__XXX
 SG_ AEB_VehResp : 78|1@0+ (1,0) [0|1] "" Vector__XXX
 SG_ AEB_PedResp : 79|1@0+ (1,0) [0|1] "" Vector__XXX
 SG_ FeatPt_Dy : 51|8@0+ (0.1,-8) [-8|8] "m" Vector__XXX
 SG_ TargetPathC3 : 39|20@0+ (5e-08,-0.024) [-0.024|0.024] "PerMtrSq" Vector__XXX
 SG_ IFC_Line_special02_Dy : 15|13@0+ (0.01,-30) [-30|30.01] "m" Vector__XXX

BO_ 628 HAP_FD2: 64 IDM
 SG_ SlopViewFuncReq : 167|2@0+ (1,0) [0|3] "NoUnit" Vector__XXX
 SG_ SlopViewSts : 153|2@0+ (1,0) [0|3] "NoUnit" Vector__XXX
 SG_ AutoAVMmodSts : 155|2@0+ (1,0) [0|3] "NoUnit" Vector__XXX
 SG_ WheWarning : 159|4@0+ (1,0) [0|15] "NoUnit" Vector__XXX
 SG_ ParkSlotDispR3 : 150|1@0+ (1,0) [0|1] "NoUnit" Vector__XXX
 SG_ ParkSlotDispR2 : 151|1@0+ (1,0) [0|1] "NoUnit" Vector__XXX
 SG_ ParkSlotDispR1 : 136|1@0+ (1,0) [0|1] "NoUnit" Vector__XXX
 SG_ ParkSlotDispL3 : 137|1@0+ (1,0) [0|1] "NoUnit" Vector__XXX
 SG_ ParkSlotDispL2 : 138|1@0+ (1,0) [0|1] "NoUnit" Vector__XXX
 SG_ ParkSlotDispL1 : 139|1@0+ (1,0) [0|1] "NoUnit" Vector__XXX
 SG_ HAP_Hmi_Index : 143|4@0+ (1,0) [0|15] "" Vector__XXX
 SG_ DVRWorkSts : 126|2@0+ (1,0) [0|3] "" Vector__XXX
 SG_ HAP_DispCmd : 127|1@0+ (1,0) [0|1] "" Vector__XXX
 SG_ AVM_3DAngSts : 104|9@0+ (1,-1) [0|360] "deg" Vector__XXX
 SG_ OvlOpFailSts : 105|1@0+ (1,0) [0|1] "" Vector__XXX
 SG_ TraOvlSts : 106|1@0+ (1,0) [0|1] "NoUnit" Vector__XXX
 SG_ EolNotCmpltd : 107|1@0+ (1,0) [0|1] "" Vector__XXX
 SG_ FrntCamInpFailSts : 108|1@0+ (1,0) [0|1] "" Vector__XXX
 SG_ RearCamInpFailSts : 109|1@0+ (1,0) [0|1] "" Vector__XXX
 SG_ LeCamInpFailSts : 110|1@0+ (1,0) [0|1] "" Vector__XXX
 SG_ RiCamInpFailSts : 111|1@0+ (1,0) [0|1] "" Vector__XXX
 SG_ CurrCalResultSts : 96|1@0+ (1,0) [0|1] "" Vector__XXX
 SG_ LaneCalFltSts : 99|3@0+ (1,0) [0|7] "" Vector__XXX
 SG_ LaneCalSts : 101|2@0+ (1,0) [0|3] "" Vector__XXX
 SG_ CarMdlTrsprcySts : 103|2@0+ (1,0) [0|3] "" Vector__XXX
 SG_ MdlColrSts : 91|4@0+ (1,0) [0|15] "" Vector__XXX
 SG_ RadarDispSts : 93|2@0+ (1,0) [0|3] "" Vector__XXX
 SG_ GuidOvlSts : 95|2@0+ (1,0) [0|3] "" Vector__XXX
 SG_ WheelVieSts : 82|2@0+ (1,0) [0|3] "NoUnit" Vector__XXX
 SG_ AutoAVMSwtSet_Sts : 83|1@0+ (1,0) [0|1] "" Vector__XXX
 SG_ AutoViewChgFuncSts : 84|1@0+ (1,0) [0|1] "" Vector__XXX
 SG_ CarMdlDispSts : 85|1@0+ (1,0) [0|1] "" Vector__XXX
 SG_ MOD_AlarmSts : 86|1@0+ (1,0) [0|1] "" Vector__XXX
 SG_ MOD_WorkSts : 87|1@0+ (1,0) [0|1] "" Vector__XXX
 SG_ SigViewIndcn : 77|6@0+ (1,0) [0|63] "" Vector__XXX
 SG_ AVM_CurrSts : 79|2@0+ (1,0) [0|3] "" Vector__XXX

BO_ 664 HAP_FD3: 64 IDM
 SG_ MAC_Check_HAP_FD3 : 471|48@0+ (1,0) [0|281474976710655] "" Vector__XXX
 SG_ FreshnessValue_HAP_FD3 : 455|16@0+ (1,0) [0|65535] "" Vector__XXX
 SG_ RiCamDirtySts : 444|1@0+ (1,0) [0|1] "NoUnit" Vector__XXX
 SG_ LeCamDirtySts : 445|1@0+ (1,0) [0|1] "" Vector__XXX
 SG_ RearCamDirtySts : 446|1@0+ (1,0) [0|1] "NoUnit" Vector__XXX
 SG_ FrntCamDirtySts : 447|1@0+ (1,0) [0|1] "" Vector__XXX
 SG_ DVRCamDirtySts : 432|1@0+ (1,0) [0|1] "NoUnit" Vector__XXX
 SG_ SteerWheelsilentSts : 399|2@0+ (1,0) [0|3] "NoUnit" Vector__XXX
 SG_ VLAPSpdSetVal : 348|5@0+ (1,-1) [0|30] "NoUnit" Vector__XXX
 SG_ UssEPSLrngSts : 339|2@0+ (1,0) [0|3] "NoUnit" Vector__XXX
 SG_ PrkgFuncStsLmp : 328|5@0+ (1,0) [0|31] "NoUnit" Vector__XXX
 SG_ AVPworkSts : 332|4@0+ (1,0) [0|15] "NoUnit" Vector__XXX
 SG_ ShldKeyDoorHndlReqVld : 333|1@0+ (1,0) [0|1] "NoUnit" Vector__XXX
 SG_ ShldKeyDoorHndlReq : 335|2@0+ (1,0) [0|3] "NoUnit" Vector__XXX
 SG_ OneclickClsIntellgntDrvgSts : 317|2@0+ (1,0) [0|3] "NoUnit" Vector__XXX
 SG_ RmtPrkRadShieldSts : 319|2@0+ (1,0) [0|3] "NoUnit" Vector__XXX
 SG_ APS_Coordinate_Y : 298|11@0+ (2,-2000) [-2000|2000] "cm" Vector__XXX
 SG_ APS_Coordinate_X : 291|9@0+ (4,-1000) [-1000|1000] "cm" Vector__XXX
 SG_ APS_Coordinate_Angle : 284|9@0+ (1,0) [0|359] "deg" Vector__XXX
 SG_ RmtPrkgSts : 285|1@0+ (1,0) [0|1] "" Vector__XXX
 SG_ RmtPrkgFinishReq : 287|2@0+ (1,0) [0|3] "" Vector__XXX
 SG_ OrvmCtrlCmd : 273|2@0+ (1,0) [0|3] "" Vector__XXX
 SG_ HAP_TextIconDispCtrl : 275|2@0+ (1,0) [0|3] "" Vector__XXX
 SG_ APA_MenuDispCtrlCmd : 279|4@0+ (1,0) [0|15] "" Vector__XXX
 SG_ FADS_FuncSts : 265|2@0+ (1,0) [0|3] "" Vector__XXX
 SG_ RADS_FuncSts : 267|2@0+ (1,0) [0|3] "" Vector__XXX
 SG_ APA_FuncSts : 271|2@0+ (1,0) [0|3] "" Vector__XXX
 SG_ FPAS_NearBrrdstn : 242|7@0+ (1,0) [0|100] "" Vector__XXX
 SG_ ModifInquiPopReq : 245|2@0+ (1,0) [0|3] "NoUnit" Vector__XXX
 SG_ FPAS_SoundIndcn : 247|2@0+ (1,0) [0|3] "" Vector__XXX
 SG_ FPAS_AutoModSts : 232|1@0+ (1,0) [0|1] "" Vector__XXX
 SG_ FPAS_DispCmd : 233|1@0+ (1,0) [0|1] "" Vector__XXX
 SG_ FPAS_WorkSts : 235|2@0+ (1,0) [0|3] "" Vector__XXX
 SG_ FPAS_FRCornrSnsrFailSts : 236|1@0+ (1,0) [0|1] "" Vector__XXX
 SG_ FPAS_FRMiddlSnsrFailSts : 237|1@0+ (1,0) [0|1] "" Vector__XXX
 SG_ FPAS_FLMiddlSnsrFailSts : 238|1@0+ (1,0) [0|1] "" Vector__XXX
 SG_ FPAS_FLCornrSnsrFailSts : 239|1@0+ (1,0) [0|1] "" Vector__XXX
 SG_ FPAS_ObjFRCornrAr2 : 227|4@0+ (1,0) [0|15] "" Vector__XXX
 SG_ FPAS_ObjFRCornrAr1 : 231|4@0+ (1,0) [0|15] "" Vector__XXX
 SG_ FPAS_ObjFRMidlAr2 : 219|4@0+ (1,0) [0|15] "" Vector__XXX
 SG_ FPAS_ObjFRMidlAr1 : 223|4@0+ (1,0) [0|15] "" Vector__XXX
 SG_ FPAS_ObjFLMidlAr2 : 211|4@0+ (1,0) [0|15] "" Vector__XXX
 SG_ FPAS_ObjFLMidlAr1 : 215|4@0+ (1,0) [0|15] "" Vector__XXX
 SG_ FPAS_ObjFLCornrAr2 : 203|4@0+ (1,0) [0|15] "" Vector__XXX
 SG_ FPAS_ObjFLCornrAr1 : 207|4@0+ (1,0) [0|15] "" Vector__XXX
 SG_ RCTA_DispSwtSts : 176|1@0+ (1,0) [0|1] "NoUnit" Vector__XXX
 SG_ AutoPrkOutSwtSts : 177|1@0+ (1,0) [0|1] "NoUnit" Vector__XXX
 SG_ MEB_EnableSts : 178|1@0+ (1,0) [0|1] "" Vector__XXX
 SG_ MEBWorkSts : 180|2@0+ (1,0) [0|3] "" Vector__XXX
 SG_ RPAS_SoundIndcn : 183|2@0+ (1,0) [0|3] "" Vector__XXX
 SG_ CamFolwSwtSts : 168|1@0+ (1,0) [0|1] "NoUnit" Vector__XXX
 SG_ APA_BacgrdWorkSts : 169|1@0+ (1,0) [0|1] "NoUnit" Vector__XXX
 SG_ RPAS_WorkSts : 171|2@0+ (1,0) [0|3] "" Vector__XXX
 SG_ RPAS_RRCornrSnsrFailSts : 172|1@0+ (1,0) [0|1] "" Vector__XXX
 SG_ RPAS_RRMiddlSnsrFailSts : 173|1@0+ (1,0) [0|1] "" Vector__XXX
 SG_ RPAS_RLMiddlSnsrFailSts : 174|1@0+ (1,0) [0|1] "" Vector__XXX
 SG_ RPAS_RLCornrSnsrFailSts : 175|1@0+ (1,0) [0|1] "" Vector__XXX
 SG_ RPAS_ObjRLCornrAr2 : 163|4@0+ (1,0) [0|15] "" Vector__XXX
 SG_ RPAS_ObjRLCornrAr1 : 167|4@0+ (1,0) [0|15] "" Vector__XXX
 SG_ RPAS_ObjRLMidlAr2 : 155|4@0+ (1,0) [0|15] "" Vector__XXX
 SG_ RPAS_ObjRLMidlAr1 : 159|4@0+ (1,0) [0|15] "" Vector__XXX
 SG_ RPAS_ObjRRMidlAr2 : 147|4@0+ (1,0) [0|15] "" Vector__XXX
 SG_ RPAS_ObjRRMidlAr1 : 151|4@0+ (1,0) [0|15] "" Vector__XXX
 SG_ RPAS_ObjRRCornrAr2 : 139|4@0+ (1,0) [0|15] "" Vector__XXX
 SG_ RPAS_ObjRRCornrAr1 : 143|4@0+ (1,0) [0|15] "" Vector__XXX
 SG_ OneclickClsIntellgntDrvgTextDisp : 127|2@0+ (1,0) [0|3] "NoUnit" Vector__XXX
 SG_ SDWActiveSts : 112|1@0+ (1,0) [0|1] "" Vector__XXX
 SG_ SDW_SoundIndcn : 115|2@0+ (1,0) [0|3] "" Vector__XXX
 SG_ APS_RLSideSnsrFailSts : 116|1@0+ (1,0) [0|1] "" Vector__XXX
 SG_ APS_RRSideSnsrFailSts : 117|1@0+ (1,0) [0|1] "" Vector__XXX
 SG_ APS_FLSideSnsrFailSts : 118|1@0+ (1,0) [0|1] "" Vector__XXX
 SG_ APS_FRSideSnsrFailSts : 119|1@0+ (1,0) [0|1] "" Vector__XXX
 SG_ APS_ObjLeSideAr5 : 107|4@0+ (1,0) [0|15] "" Vector__XXX
 SG_ APS_ObjLeSideAr4 : 111|4@0+ (1,0) [0|15] "" Vector__XXX
 SG_ APS_ObjLeSideAr3 : 99|4@0+ (1,0) [0|15] "" Vector__XXX
 SG_ APS_ObjLeSideAr2 : 103|4@0+ (1,0) [0|15] "" Vector__XXX
 SG_ APS_ObjLeSideAr1 : 91|4@0+ (1,0) [0|15] "" Vector__XXX
 SG_ APS_ObjRiSideAr5 : 95|4@0+ (1,0) [0|15] "" Vector__XXX
 SG_ APS_ObjRiSideAr4 : 83|4@0+ (1,0) [0|15] "" Vector__XXX
 SG_ APS_ObjRiSideAr3 : 87|4@0+ (1,0) [0|15] "" Vector__XXX
 SG_ APS_ObjRiSideAr2 : 75|4@0+ (1,0) [0|15] "" Vector__XXX
 SG_ APS_ObjRiSideAr1 : 79|4@0+ (1,0) [0|15] "" Vector__XXX
 SG_ AntiMsstpngObstclDetnFailSts : 44|3@0+ (1,0) [0|7] "NoUnit" Vector__XXX
 SG_ ObstclDetnFailSts : 47|3@0+ (1,0) [0|7] "NoUnit" Vector__XXX
 SG_ ResTraDistanceOfCurTra : 38|7@0+ (0.1,0) [0|10] "m" Vector__XXX
 SG_ P2P_ProcBar : 31|7@0+ (1,0) [0|100] "" Vector__XXX
 SG_ HAVP_ProcRa : 23|7@0+ (1,0) [0|100] "" Vector__XXX
 SG_ RPAS_NearBrrdstn : 15|8@0+ (1,0) [0|150] "" Vector__XXX

BO_ 683 ACC_FD2: 64 IDM
 SG_ MAC_Check_ACC_FD2 : 471|48@0+ (1,0) [0|281474976710655] "" Vector__XXX
 SG_ FreshnessValue_ACC_FD2 : 455|16@0+ (1,0) [0|65535] "" Vector__XXX
 SG_ OvertakingLightModSts : 445|2@0+ (1,0) [0|3] "NoUnit" Vector__XXX
 SG_ StartReminderEnaSts : 447|2@0+ (1,0) [0|3] "NoUnit" Vector__XXX
 SG_ DeviateSpdFixdValResp : 437|6@0+ (1,-1) [-1|39] "NoUnit" Vector__XXX
 SG_ HWA_FaststSwtResp : 439|2@0+ (1,0) [0|3] "NoUnit" Vector__XXX
 SG_ TargetCutoutPro : 429|6@0+ (0.02,0) [0|1] "" Vector__XXX
 SG_ TargetCutinPro : 419|6@0+ (0.02,0) [0|1] "" Vector__XXX
 SG_ ACC_PotentialTgtHeading : 409|6@0+ (0.05,-1.5) [-1.5|1.5] "rad" Vector__XXX
 SG_ ACC_RiTgtHeading : 415|6@0+ (0.05,-1.5) [-1.5|1.5] "rad" Vector__XXX
 SG_ ACC_PotentialTgtfusion : 400|1@0+ (1,0) [0|1] "" Vector__XXX
 SG_ ACC_RiTgtfusion : 401|1@0+ (1,0) [0|1] "" Vector__XXX
 SG_ ACC_LeTgtHeading : 407|6@0+ (0.05,-1.5) [-1.5|1.5] "rad" Vector__XXX
 SG_ ACC_LeTgtfusion : 392|1@0+ (1,0) [0|1] "" Vector__XXX
 SG_ ACC_RlvTgtHeading : 398|6@0+ (0.05,-1.5) [-1.5|1.5] "rad" Vector__XXX
 SG_ ACC_RlvTgtfusion : 399|1@0+ (1,0) [0|1] "" Vector__XXX
 SG_ RollingCounter_ACC7 : 379|4@0+ (1,0) [0|15] "" Vector__XXX
 SG_ ACCSts : 380|1@0+ (1,0) [0|1] "" Vector__XXX
 SG_ Request_driveoff : 383|3@0+ (1,0) [0|7] "" Vector__XXX
 SG_ ACC_RiTgtTyp : 374|3@0+ (1,0) [0|7] "" Vector__XXX
 SG_ ACC_RiTgtDx : 367|9@0+ (0.5,0) [0|150] "m" Vector__XXX
 SG_ ACC_RiTgtDy : 359|8@0+ (0.1,-8) [-8|8] "m" Vector__XXX
 SG_ ACC_RiTargrtDetn : 345|2@0+ (1,0) [0|3] "" Vector__XXX
 SG_ ACC_LeTargrtDection : 347|2@0+ (1,0) [0|3] "" Vector__XXX
 SG_ ACC_LeTgtTyp : 350|3@0+ (1,0) [0|7] "" Vector__XXX
 SG_ ACC_LeTgtDx : 343|9@0+ (0.5,0) [0|150] "m" Vector__XXX
 SG_ ACC_LeTgtDy : 335|8@0+ (0.1,-8) [-8|8] "m" Vector__XXX
 SG_ Checksum_ACC7 : 327|8@0+ (1,0) [0|255] "" Vector__XXX
 SG_ RollingCounter_ACC6 : 315|4@0+ (1,0) [0|15] "" Vector__XXX
 SG_ IntelligentCurveAct : 319|1@0+ (1,0) [0|1] "" Vector__XXX
 SG_ ACC_PotentialTgtTyp : 307|3@0+ (1,0) [0|7] "" Vector__XXX
 SG_ ACC_PotentialTgtDetn : 309|2@0+ (1,0) [0|3] "" Vector__XXX
 SG_ ACC_RlvTgtDx : 303|9@0+ (0.5,0) [0|150] "m" Vector__XXX
 SG_ ACC_RlvTgtDy : 295|8@0+ (0.1,-8) [-8|8] "m" Vector__XXX
 SG_ ACC_RlvTgtTyp : 282|3@0+ (1,0) [0|7] "" Vector__XXX
 SG_ ACC_EgoStatus : 284|2@0+ (1,0) [0|3] "" Vector__XXX
 SG_ ACC_RlvTgtDetn : 286|2@0+ (1,0) [0|3] "" Vector__XXX
 SG_ ACC_PotentialTgtDx : 279|9@0+ (0.5,0) [0|150] "m" Vector__XXX
 SG_ ACC_PotentialTgtDy : 271|8@0+ (0.1,-8) [-8|8] "m" Vector__XXX
 SG_ Checksum_ACC6 : 263|8@0+ (1,0) [0|255] "" Vector__XXX
 SG_ RollingCounter_ACC8 : 251|4@0+ (1,0) [0|15] "" Vector__XXX
 SG_ SceneModCfmPop : 242|3@0+ (1,0) [0|7] "NoUnit" Vector__XXX
 SG_ TextSceneBrocast : 239|8@0+ (1,0) [0|255] "NoUnit" Vector__XXX
 SG_ PassETCEnaSts : 225|2@0+ (1,0) [0|3] "NoUnit" Vector__XXX
 SG_ DeviateSpdPreResp : 231|6@0+ (1,-1) [-1|39] "Perc" Vector__XXX
 SG_ HWA_warning : 217|2@0+ (1,0) [0|3] "" Vector__XXX
 SG_ HAVP_RecReq : 220|3@0+ (1,0) [0|7] "NoUnit" Vector__XXX
 SG_ HWA_LaneChangeReq : 223|3@0+ (1,0) [0|7] "" Vector__XXX
 SG_ ADAS_DriverInloop_Monitor : 211|3@0+ (1,0) [0|7] "" Vector__XXX
 SG_ HWA_LaneChange : 213|2@0+ (1,0) [0|3] "" Vector__XXX
 SG_ DeviateSpdModSwtResp : 215|2@0+ (1,0) [0|3] "NoUnit" Vector__XXX
 SG_ HWA_InterSysInfoDisp : 203|4@0+ (1,0) [0|15] "" Vector__XXX
 SG_ HWA_ModDisp : 207|4@0+ (1,0) [0|15] "" Vector__XXX
 SG_ Checksum_ACC8 : 199|8@0+ (1,0) [0|255] "" Vector__XXX
 SG_ RollingCounter_ACC4 : 187|4@0+ (1,0) [0|15] "" Vector__XXX
 SG_ CruChar_InterSysInfoDisp : 191|4@0+ (1,0) [0|15] "" Vector__XXX
 SG_ ACC_SpdSetValue : 183|8@0+ (1,0) [0|254] "kph/mph" Vector__XXX
 SG_ ACC_TimeGapSet : 170|3@0+ (1,0) [0|7] "" Vector__XXX
 SG_ ISL_InterSysInfoDisp : 172|2@0+ (1,0) [0|3] "" Vector__XXX
 SG_ TJA_ICA_ModDisp : 175|3@0+ (1,0) [0|7] "" Vector__XXX
 SG_ TJA_ICA_InterSysInfoDisp : 163|3@0+ (1,0) [0|7] "" Vector__XXX
 SG_ CruCha_ModDisp : 167|4@0+ (1,0) [0|15] "" Vector__XXX
 SG_ TJA_ACC_SelSts : 154|3@0+ (1,0) [0|7] "" Vector__XXX
 SG_ Longctrl_HazActv : 156|2@0+ (1,0) [0|3] "" Vector__XXX
 SG_ ACC_TgtObjBarDisp : 159|3@0+ (1,0) [0|7] "" Vector__XXX
 SG_ ACCReqAVM : 144|1@0+ (1,0) [0|1] "" Vector__XXX
 SG_ ACC_FctSts : 146|2@0+ (1,0) [0|3] "" Vector__XXX
 SG_ ACC_ModDisp : 151|5@0+ (1,0) [0|31] "" Vector__XXX
 SG_ ACC_InterSysInfoDisp : 141|5@0+ (1,0) [0|31] "" Vector__XXX
 SG_ ACC_TakeOverReq : 142|1@0+ (1,0) [0|1] "" Vector__XXX
 SG_ ACC_ObjDetecte : 143|1@0+ (1,0) [0|1] "" Vector__XXX
 SG_ Checksum_ACC4 : 135|8@0+ (1,0) [0|255] "" Vector__XXX
 SG_ RollingCounter_ACC3 : 123|4@0+ (1,0) [0|15] "" Vector__XXX
 SG_ ALC_InterSysInfoDisp : 127|2@0+ (1,0) [0|3] "" Vector__XXX
 SG_ IntellgntAsscEnaSts : 117|2@0+ (1,0) [0|3] "NoUnit" Vector__XXX
 SG_ NOAExitTim : 107|6@0+ (1,-1) [0|60] "s" Vector__XXX
 SG_ PrkgSpaTPrkgSpaSts : 111|4@0+ (1,0) [0|15] "NoUnit" Vector__XXX
 SG_ VertHeiRmd : 81|2@0+ (1,0) [0|3] "NoUnit" Vector__XXX
 SG_ IntellgntAsscLmpEnaResp : 87|2@0+ (1,0) [0|3] "NoUnit" Vector__XXX
 SG_ ALC_Resp : 73|1@0+ (1,0) [0|1] "" Vector__XXX
 SG_ HWA_SnvtySet_Resp : 76|2@0+ (1,0) [0|3] "" Vector__XXX
 SG_ HWA_Resp : 77|1@0+ (1,0) [0|1] "" Vector__XXX
 SG_ ISL_Resp : 79|1@0+ (1,0) [0|1] "" Vector__XXX
 SG_ Checksum_ACC3 : 71|8@0+ (1,0) [0|255] "" Vector__XXX
 SG_ ACC_RiTgt_02_Typ : 63|3@0+ (1,0) [0|7] "" Vector__XXX
 SG_ ACC_RiTgt_02_Dy : 55|7@0+ (0.1,0) [0|8.1] "m" Vector__XXX
 SG_ LowPowerEgyMngmntModResp : 41|2@0+ (1,0) [0|3] "" Vector__XXX
 SG_ ACC_RiTgtObjBarDisp : 44|3@0+ (1,0) [0|7] "" Vector__XXX
 SG_ ACC_LeTgtObjBarDisp : 47|3@0+ (1,0) [0|7] "" Vector__XXX
 SG_ ACC_RiTgt_02_Dx : 24|9@0+ (0.5,0) [0|150] "m" Vector__XXX
 SG_ ACC_RiTargrt_02_Detn : 26|2@0+ (1,0) [0|3] "" Vector__XXX
 SG_ ACC_LeTargrt_02_Detn : 28|2@0+ (1,0) [0|3] "" Vector__XXX
 SG_ ACC_LeTgt_02_Typ : 31|3@0+ (1,0) [0|7] "" Vector__XXX
 SG_ ACC_LeTgt_02_Dx : 8|9@0+ (0.5,0) [0|150] "m" Vector__XXX
 SG_ ACC_LeTgt_02_Dy : 15|7@0+ (0.1,-8) [-8|0.1] "m" Vector__XXX

BO_ 692 ACC_FD3: 64 IDM
 SG_ AEB_RiCyclistTyp : 435|3@0+ (1,0) [0|7] "" Vector__XXX
 SG_ AEB_RiCyclistDx : 428|9@0+ (0.5,0) [0|150] "m" Vector__XXX
 SG_ AEB_RiCyclistDetn : 430|2@0+ (1,0) [0|3] "" Vector__XXX
 SG_ AEB_LeCyclistDx : 423|9@0+ (0.5,0) [0|150] "m" Vector__XXX
 SG_ AEB_LeCyclistTyp : 411|3@0+ (1,0) [0|7] "" Vector__XXX
 SG_ AEB_LeCyclistDetn : 413|2@0+ (1,0) [0|3] "" Vector__XXX
 SG_ AEB_RiPedDx : 406|9@0+ (0.5,0) [0|150] "m" Vector__XXX
 SG_ AEB_LePedDx : 399|9@0+ (0.5,0) [0|150] "m" Vector__XXX
 SG_ NOH_SysInfoDisplay : 383|4@0+ (1,0) [0|15] "" Vector__XXX
 SG_ NOH_Swt_Resp : 368|1@0+ (1,0) [0|1] "" Vector__XXX
 SG_ NOH_Act_Resp : 369|1@0+ (1,0) [0|1] "" Vector__XXX
 SG_ FCWAEB_crossingTTC : 375|6@0+ (0.1,0) [0.1|6.3] "s" Vector__XXX
 SG_ FCWAEB_longTTC : 365|6@0+ (0.1,0) [0.1|6.3] "s" Vector__XXX
 SG_ NOH_Sts : 355|4@0+ (1,0) [0|15] "" Vector__XXX
 SG_ NOH_DistToExit : 351|12@0+ (1,0) [0|4095] "m" Vector__XXX
 SG_ JAPedObjAx : 335|10@0+ (0.03125,-16) [-16|15.96875] "m/s2" Vector__XXX
 SG_ JAPedObjAy : 301|10@0+ (0.03125,-16) [-16|15.96875] "m/s2" Vector__XXX
 SG_ JAPedObjVy : 295|10@0+ (0.125,-64) [-64|63.875] "m/s" Vector__XXX
 SG_ JAPedObjCntAlive : 275|12@0+ (17,0) [0|65535] "" Vector__XXX
 SG_ JAPedObjVx : 271|12@0+ (0.0625,-128) [-128|127] "m/s" Vector__XXX
 SG_ LgtFolwDistanceSts : 255|3@0+ (1,0) [0|7] "NoUnit" Vector__XXX
 SG_ NOAFuncSts : 241|2@0+ (1,0) [0|3] "NoUnit" Vector__XXX
 SG_ FCWAEB_JATTC : 247|6@0+ (0.1,0) [0.1|6.3] "s" Vector__XXX
 SG_ JAPedObjDx : 228|12@0+ (0.0625,0) [0|255.9375] "m" Vector__XXX
 SG_ JAPedObjDy : 223|11@0+ (0.125,-128) [-128|127.875] "m" Vector__XXX
 SG_ JAPedObjObstcl : 213|5@0+ (0.03125,0) [0|0.96875] "%" Vector__XXX
 SG_ AEBJAObjAy : 207|10@0+ (0.03125,-16) [-16|15.96875] "m/s2" Vector__XXX
 SG_ JAPedObjState : 191|3@0+ (1,0) [0|7] "" Vector__XXX
 SG_ AEBJAObjAx : 169|10@0+ (0.03125,-16) [-16|15.96875] "m/s2" Vector__XXX
 SG_ AEBJAObjVy : 163|10@0+ (0.125,-64) [-64|63.875] "m/s" Vector__XXX
 SG_ AEBJAObjObstcl : 152|5@0+ (0.03125,0) [0|0.96875] "%" Vector__XXX
 SG_ AEBJAObjDy : 147|11@0+ (0.125,-128) [-128|127.875] "m" Vector__XXX
 SG_ AEBJAObjCntAlive : 143|12@0+ (17,0) [0|65535] "" Vector__XXX
 SG_ AEBJAObjState : 127|3@0+ (1,0) [0|7] "" Vector__XXX
 SG_ JAPedObjID : 119|8@0+ (1,0) [0|254] "" Vector__XXX
 SG_ AEBJAObjDx : 99|12@0+ (0.0625,0) [0|255.9375] "m" Vector__XXX
 SG_ AEBJAObjVx : 95|12@0+ (0.0625,-128) [-128|127] "m/s" Vector__XXX
 SG_ JAPedObjVideoCfmd : 80|1@0+ (1,0) [0|1] "" Vector__XXX
 SG_ AEBJAObjVideoCfmd : 81|1@0+ (1,0) [0|1] "" Vector__XXX
 SG_ AEBJAObjExist : 87|6@0+ (0.015625,0) [0|0.984375] "%" Vector__XXX
 SG_ AEBJAObjID : 79|8@0+ (1,0) [0|254] "" Vector__XXX
 SG_ AEB_RiCyclist_collisionprob : 60|1@0+ (1,0) [0|1] "" Vector__XXX
 SG_ AEB_LeCyclist_collisionprob : 61|1@0+ (1,0) [0|1] "" Vector__XXX
 SG_ AEB_RiPed_collisionprob : 62|1@0+ (1,0) [0|1] "" Vector__XXX
 SG_ AEB_LePed_collisionprob : 63|1@0+ (1,0) [0|1] "" Vector__XXX
 SG_ AEB_RiPedDetn : 49|2@0+ (1,0) [0|3] "" Vector__XXX
 SG_ AEB_RiPedTyp : 52|3@0+ (1,0) [0|7] "" Vector__XXX
 SG_ AEB_LePedTyp : 55|3@0+ (1,0) [0|7] "" Vector__XXX
 SG_ AEB_LePedDetn : 41|2@0+ (1,0) [0|3] "" Vector__XXX
 SG_ JAPedObjExist : 47|6@0+ (0.015625,0) [0|0.984375] "%" Vector__XXX
 SG_ AEB_RiCyclistDy : 39|8@0+ (0.1,-8) [-8|8] "m" Vector__XXX
 SG_ AEB_LeCyclistDy : 31|8@0+ (0.1,-8) [-8|8] "m" Vector__XXX
 SG_ AEB_RiPedDy : 23|8@0+ (0.1,-8) [-8|8] "m" Vector__XXX
 SG_ AEB_LePedDy : 15|8@0+ (0.1,-8) [-8|8] "m" Vector__XXX

BO_ 696 ACC_FD4: 64 IDM
 SG_ ACC_DataRecReq : 511|8@0+ (1,0) [0|255] "" Vector__XXX
 SG_ AEBObjDrvby : 502|5@0+ (1,0) [0|20] "" Vector__XXX
 SG_ AEBObjOverlap : 491|5@0+ (1,0) [0|20] "" Vector__XXX
 SG_ DrvrSts : 494|3@0+ (1,0) [0|7] "" Vector__XXX
 SG_ MapDataValid : 495|1@0+ (1,0) [0|1] "" Vector__XXX
 SG_ PedObjState : 482|3@0+ (1,0) [0|7] "" Vector__XXX
 SG_ ACC_SOSReq : 484|2@0+ (1,0) [0|3] "" Vector__XXX
 SG_ RadarDrvrAttentive : 473|1@0+ (1,0) [0|1] "" Vector__XXX
 SG_ BrdgDst : 479|6@0+ (10,0) [0|600] "m" Vector__XXX
 SG_ DrvgOnRiLane : 465|2@0+ (1,0) [0|3] "" Vector__XXX
 SG_ TunnelDst : 471|6@0+ (10,0) [0|600] "m" Vector__XXX
 SG_ NavSpdLimUnit : 457|2@0+ (1,0) [0|3] "" Vector__XXX
 SG_ CurveDst : 463|6@0+ (10,0) [0|600] "m" Vector__XXX
 SG_ SpdLimit : 455|8@0+ (1,0) [0|255] "" Vector__XXX
 SG_ RampDst : 445|6@0+ (10,0) [0|600] "m" Vector__XXX
 SG_ RoadCrvtFar : 439|10@0+ (0.00032,-0.16352) [-0.16352|0.16352] "" Vector__XXX
 SG_ SpdLimitDst : 429|6@0+ (10,0) [0|600] "m" Vector__XXX
 SG_ RoadCrvt : 423|10@0+ (0.00032,-0.16352) [-0.16352|0.16352] "" Vector__XXX
 SG_ DrvgOnHiWay : 409|2@0+ (1,0) [0|3] "" Vector__XXX
 SG_ HandsoffDetd : 411|2@0+ (1,0) [0|3] "" Vector__XXX
 SG_ RadarHorMisalign : 407|12@0+ (0.0001,-0.2048) [-0.2048|0.2047] "rad" Vector__XXX
 SG_ ACCTgtObjCntAlive : 387|12@0+ (1,0) [0|3855] "" Vector__XXX
 SG_ ACCTgtObjVideoCfmd : 388|1@0+ (1,0) [0|1] "" Vector__XXX
 SG_ ACCTgtObjState : 391|3@0+ (1,0) [0|7] "" Vector__XXX
 SG_ ACCTgtObjAy : 369|10@0+ (0.03125,-16) [-16|15.96875] "m/s2" Vector__XXX
 SG_ ACCTgtObjAx : 363|10@0+ (0.03125,-16) [-16|15.96875] "m/s2" Vector__XXX
 SG_ ACCTgtObjVx : 359|12@0+ (0.0625,-128) [-128|127] "m/s" Vector__XXX
 SG_ ACCTgtObjVy : 337|10@0+ (0.125,-64) [-64|63.875] "m/s" Vector__XXX
 SG_ ACCTgtObjExist : 343|6@0+ (0.015625,0) [0|0.984375] "%" Vector__XXX
 SG_ ACCTgtObjDy : 322|11@0+ (0.125,-128) [-128|127.875] "m" Vector__XXX
 SG_ ACCTgtObjObstcl : 327|5@0+ (0.03125,0) [0|0.96875] "%" Vector__XXX
 SG_ ACCTgtObjID : 319|8@0+ (1,0) [0|254] "" Vector__XXX
 SG_ PedObjAx : 297|10@0+ (0.03125,-16) [-16|15.96875] "m/s2" Vector__XXX
 SG_ PedObjCntAlive : 293|12@0+ (1,0) [0|3855] "" Vector__XXX
 SG_ PedObjAy : 287|10@0+ (0.03125,-16) [-16|15.96875] "m/s2" Vector__XXX
 SG_ ACCTgtObjDx : 267|12@0+ (0.0625,0) [0|255.9375] "m" Vector__XXX
 SG_ PedObjVideoCfmd : 269|1@0+ (1,0) [0|1] "" Vector__XXX
 SG_ PedObjVy : 263|10@0+ (0.125,-64) [-64|63.875] "m/s" Vector__XXX
 SG_ PedObjVx : 243|12@0+ (0.0625,-128) [-128|127] "m/s" Vector__XXX
 SG_ PedObjDx : 239|12@0+ (0.0625,0) [0|255.9375] "m" Vector__XXX
 SG_ PedObjDy : 218|11@0+ (0.125,-128) [-128|127.875] "m" Vector__XXX
 SG_ PedObjObstcl : 223|5@0+ (0.03125,0) [0|0.96875] "%" Vector__XXX
 SG_ PedObjID : 215|8@0+ (1,0) [0|254] "" Vector__XXX
 SG_ PedObjExist : 205|6@0+ (0.015625,0) [0|0.984375] "%" Vector__XXX
 SG_ CyclistObjAy : 199|10@0+ (0.03125,-16) [-16|15.96875] "m/s2" Vector__XXX
 SG_ CyclistObjAx : 177|10@0+ (0.03125,-16) [-16|15.96875] "m/s2" Vector__XXX
 SG_ CyclistObjVideoCfmd : 178|1@0+ (1,0) [0|1] "" Vector__XXX
 SG_ CyclistObjState : 181|3@0+ (1,0) [0|7] "" Vector__XXX
 SG_ CyclistObjVy : 175|10@0+ (0.125,-64) [-64|63.875] "m/s" Vector__XXX
 SG_ CyclistObjCntAlive : 155|12@0+ (1,0) [0|3855] "" Vector__XXX
 SG_ CyclistObjVx : 151|12@0+ (0.0625,-128) [-128|127] "m/s" Vector__XXX
 SG_ CyclistObjDy : 130|11@0+ (0.125,-128) [-128|127.875] "m" Vector__XXX
 SG_ CyclistObjObstcl : 135|5@0+ (0.03125,0) [0|0.96875] "%" Vector__XXX
 SG_ CyclistObjID : 127|8@0+ (1,0) [0|254] "" Vector__XXX
 SG_ CyclistObjDx : 107|12@0+ (0.0625,0) [0|255.9375] "m" Vector__XXX
 SG_ AEBObjAy : 101|10@0+ (0.03125,-16) [-16|15.96875] "m/s2" Vector__XXX
 SG_ AEBObjAx : 95|10@0+ (0.03125,-16) [-16|15.96875] "m/s2" Vector__XXX
 SG_ CyclistObjExist : 85|6@0+ (0.015625,0) [0|0.984375] "%" Vector__XXX
 SG_ AEBObjVy : 79|10@0+ (0.125,-64) [-64|63.875] "m/s" Vector__XXX
 SG_ AEBObjObstcl : 68|5@0+ (0.03125,0) [0|0.96875] "%" Vector__XXX
 SG_ AEBObjState : 71|3@0+ (1,0) [0|7] "" Vector__XXX
 SG_ AEBObjDy : 50|11@0+ (0.125,-128) [-128|127.875] "m" Vector__XXX
 SG_ AEBObjCntAlive : 47|12@0+ (1,0) [0|3855] "" Vector__XXX
 SG_ AEBObjDx : 27|12@0+ (0.0625,0) [0|255.9375] "m" Vector__XXX
 SG_ AEBObjVx : 23|12@0+ (0.0625,-128) [-128|127] "m/s" Vector__XXX
 SG_ AEBObjVideoCfmd : 9|1@0+ (1,0) [0|1] "" Vector__XXX
 SG_ AEBObjExist : 15|6@0+ (0.015625,0) [0|0.984375] "%" Vector__XXX
 SG_ AEBObjID : 7|8@0+ (1,0) [0|254] "" Vector__XXX

CM_ SG_ 810 SmtLSideViewCamSts "/";
CM_ SG_ 810 SmtRSideViewCamSts "/";
CM_ SG_ 810 SmarRearviewcamSts "/";
CM_ SG_ 323 AEBFrwdObstclDetnFailSts "/";
CM_ SG_ 323 AEBMstRskObstclPreCllsnTim "/";
CM_ SG_ 347 PAVP_Status "B";
CM_ SG_ 347 HAVP_WorkSts "B";
CM_ SG_ 347 DrvDirCllsnWarnTrqCtrlFlg "/";
CM_ SG_ 347 DrvDirMstRskObstclCllsnTim "/";
CM_ SG_ 551 RollingCounter_AEB5 "QM";
CM_ SG_ 551 AEBObjDyActvSafety "QM";
CM_ SG_ 551 AEBObjDxActvSafety "QM";
CM_ SG_ 551 AEBObjVxActvSafety "QM";
CM_ SG_ 551 TimeToCllsnActvSafety "QM";
CM_ SG_ 551 AEBTgtDecelReqActvSafety "QM";
CM_ SG_ 551 ADAS_ErrStsActvSafety "QM";
CM_ SG_ 551 AEBObjStyActvSafety "QM";
CM_ SG_ 551 Checksum_AEB5 "QM";
CM_ SG_ 551 ACC_RiTgt_03_fusion "新增信号";
CM_ SG_ 551 ACC_LeTgt_03_fusion "新增信号";
CM_ SG_ 551 ACC_PotentialTgt_02_fusion "新增信号";
CM_ SG_ 551 IntellgntcurveResp "/";
CM_ SG_ 664 ObstclDetnFailSts "/";
CM_ SG_ 683 HAVP_RecReq "DVR工作开关状态";
CM_ SG_ 683 IntellgntAsscEnaSts "/";
CM_ SG_ 683 NOAExitTim "/";
BA_DEF_ BO_  "GenMsgILSupport" ENUM  "No","Yes";
BA_DEF_ BO_  "VFrameFormat" ENUM  "StandardCAN","ExtendedCAN","reserved","reserved","reserved","reserved","reserved","reserved","reserved","reserved","reserved","reserved","reserved","reserved","StandardCAN_FD","ExtendedCAN_FD";
BA_DEF_ BO_  "DiagState" ENUM  "No","Yes";
BA_DEF_ BO_  "DiagRequest" ENUM  "No","Yes";
BA_DEF_ BO_  "DiagResponse" ENUM  "No","Yes";
BA_DEF_ BO_  "NmAsrMessage" ENUM  "No","Yes";
BA_DEF_ SG_  "GenSigSendType" ENUM  "Cyclic","OnWrite","OnWriteWithRepetition","OnChange","OnChangeWithRepetition","IfActive","IfActiveWithRepetition","NoSigSendType","CyclicAndSpontanX","NotUsed","Event","CE";
BA_DEF_ SG_  "IsMonitor" ENUM  "*","Monitor";
BA_DEF_  "DBName" STRING ;
BA_DEF_  "BusType" STRING ;
BA_DEF_  "Manufacturer" STRING ;
BA_DEF_ SG_  "UnitConversionFactor" FLOAT -100 100;
BA_DEF_ SG_  "SigInvalidSetFlag" ENUM  "*","Yes";
BA_DEF_ SG_  "Internal_type" ENUM  "*","UB","UW","UL","SB","SW","SL";
BA_DEF_ SG_  "IsCrcSignal" ENUM  "No","Yes";
BA_DEF_ SG_  "IsRcSignal" ENUM  "No","Yes";
BA_DEF_ BO_  "GenMsgSendType" ENUM  "Cyclic","Event","CE","NotUsed","NotUsed","NotUsed","NotUsed","NotUsed","NoMsgSendType","IfActive","IfActiveWithRepetition","CyclicAndSpontanX";
BA_DEF_ SG_  "GenSigStartValue" INT 0 2147483647;
BA_DEF_ SG_  "GenSigInactiveValue" INT 0 2147483647;
BA_DEF_ BO_  "MsgType" ENUM  "Normal","NM","Diag","";
BA_DEF_ BU_  "NmAsrNode" ENUM  "No","Yes";
BA_DEF_ BU_  "NmAsrCanMsgReducedTime" INT 1 65535;
BA_DEF_  "NmType" STRING ;
BA_DEF_  "NmAsrMessageCount" INT 1 256;
BA_DEF_  "NmAsrBaseAddress" HEX 0 2047;
BA_DEF_  "NmAsrTimeoutTime" INT 1 65535;
BA_DEF_  "NmAsrWaitBusSleepTime" INT 1 65535;
BA_DEF_  "NmAsrCanMsgCycleTime" INT 1 65535;
BA_DEF_  "NmAsrRepeatMessageTime" INT 1 65535;
BA_DEF_ BO_  "GenMsgCycleTime" INT 0 65535;
BA_DEF_DEF_  "GenMsgILSupport" "Yes";
BA_DEF_DEF_  "VFrameFormat" "StandardCAN";
BA_DEF_DEF_  "DiagState" "No";
BA_DEF_DEF_  "DiagRequest" "No";
BA_DEF_DEF_  "DiagResponse" "No";
BA_DEF_DEF_  "NmAsrMessage" "No";
BA_DEF_DEF_  "GenSigSendType" "Cyclic";
BA_DEF_DEF_  "IsMonitor" "*";
BA_DEF_DEF_  "DBName" "";
BA_DEF_DEF_  "BusType" "";
BA_DEF_DEF_  "Manufacturer" "Vector";
BA_DEF_DEF_  "UnitConversionFactor" 1;
BA_DEF_DEF_  "SigInvalidSetFlag" "*";
BA_DEF_DEF_  "Internal_type" "*";
BA_DEF_DEF_  "IsCrcSignal" "No";
BA_DEF_DEF_  "IsRcSignal" "No";
BA_DEF_DEF_  "GenMsgSendType" "Cyclic";
BA_DEF_DEF_  "GenSigStartValue" 0;
BA_DEF_DEF_  "GenSigInactiveValue" 0;
BA_DEF_DEF_  "MsgType" "";
BA_DEF_DEF_  "NmAsrNode" "No";
BA_DEF_DEF_  "NmAsrCanMsgReducedTime" 50;
BA_DEF_DEF_  "NmType" "NmAsr";
BA_DEF_DEF_  "NmAsrMessageCount" 64;
BA_DEF_DEF_  "NmAsrBaseAddress" 1024;
BA_DEF_DEF_  "NmAsrTimeoutTime" 1000;
BA_DEF_DEF_  "NmAsrWaitBusSleepTime" 750;
BA_DEF_DEF_  "NmAsrCanMsgCycleTime" 100;
BA_DEF_DEF_  "NmAsrRepeatMessageTime" 400;
BA_DEF_DEF_  "GenMsgCycleTime" 0;
BA_ "DBName" "CANA";
BA_ "BusType" "CAN FD";
BA_ "NmAsrNode" BU_ IDM 1;
BA_ "VFrameFormat" BO_ 810 14;
BA_ "MsgType" BO_ 810 0;
BA_ "GenMsgCycleTime" BO_ 810 200;
BA_ "VFrameFormat" BO_ 299 14;
BA_ "MsgType" BO_ 299 0;
BA_ "GenMsgCycleTime" BO_ 299 20;
BA_ "GenSigInactiveValue" SG_ 299 NavOptSpdLim 31;
BA_ "GenSigInactiveValue" SG_ 299 VisOptSpdLim 31;
BA_ "GenSigInactiveValue" SG_ 299 RollingCounter_IFC2 15;
BA_ "IsRcSignal" SG_ 299 RollingCounter_IFC2 1;
BA_ "GenSigStartValue" SG_ 299 IFCAngCmdReqProtnValue 7169;
BA_ "GenSigStartValue" SG_ 299 IFCAngCmdReqValue 7800;
BA_ "IsCrcSignal" SG_ 299 Checksum_IFC2 1;
BA_ "GenSigInactiveValue" SG_ 299 RollingCounter_IFC1 15;
BA_ "IsRcSignal" SG_ 299 RollingCounter_IFC1 1;
BA_ "GenSigStartValue" SG_ 299 IFCTrqOvlCmdReqValue 1023;
BA_ "GenSigStartValue" SG_ 299 IFCTrqOvlCmdProtnValue 7169;
BA_ "IsCrcSignal" SG_ 299 Checksum_IFC1 1;
BA_ "VFrameFormat" BO_ 323 14;
BA_ "MsgType" BO_ 323 0;
BA_ "GenMsgCycleTime" BO_ 323 20;
BA_ "GenSigInactiveValue" SG_ 323 RollingCounter_ACC14 15;
BA_ "IsRcSignal" SG_ 323 RollingCounter_ACC14 1;
BA_ "IsCrcSignal" SG_ 323 Checksum_ACC14 1;
BA_ "GenSigInactiveValue" SG_ 323 RollingCounter_ACC12 15;
BA_ "IsRcSignal" SG_ 323 RollingCounter_ACC12 1;
BA_ "IsCrcSignal" SG_ 323 Checksum_ACC12 1;
BA_ "GenSigInactiveValue" SG_ 323 RollingCounter_ACC10 15;
BA_ "IsRcSignal" SG_ 323 RollingCounter_ACC10 1;
BA_ "GenSigInactiveValue" SG_ 323 AEBFrwdObstclDetnFailSts 1;
BA_ "GenSigInactiveValue" SG_ 323 AEBMstRskObstclPreCllsnTim 63;
BA_ "IsCrcSignal" SG_ 323 Checksum_ACC10 1;
BA_ "GenSigInactiveValue" SG_ 323 RollingCounter_ACC2 15;
BA_ "IsRcSignal" SG_ 323 RollingCounter_ACC2 1;
BA_ "GenSigInactiveValue" SG_ 323 IDC_L2_HADFuncCmdReqFlag 6;
BA_ "IsCrcSignal" SG_ 323 Checksum_ACC2 1;
BA_ "GenSigInactiveValue" SG_ 323 RollingCounter_ACC1 15;
BA_ "IsRcSignal" SG_ 323 RollingCounter_ACC1 1;
BA_ "GenSigInactiveValue" SG_ 323 ActualTargetSpeed 255;
BA_ "GenSigInactiveValue" SG_ 323 Longctrl_ParkShiftReq 2;
BA_ "GenSigInactiveValue" SG_ 323 Longctrl_ModSts 7;
BA_ "IsCrcSignal" SG_ 323 Checksum_ACC1 1;
BA_ "GenSigInactiveValue" SG_ 323 RollingCounter_ACC11 15;
BA_ "IsRcSignal" SG_ 323 RollingCounter_ACC11 1;
BA_ "IsCrcSignal" SG_ 323 Checksum_ACC11 1;
BA_ "VFrameFormat" BO_ 347 14;
BA_ "MsgType" BO_ 347 0;
BA_ "GenMsgCycleTime" BO_ 347 20;
BA_ "GenSigInactiveValue" SG_ 347 RollingCounter_APA7 15;
BA_ "IsRcSignal" SG_ 347 RollingCounter_APA7 1;
BA_ "IsCrcSignal" SG_ 347 Checksum_APA7 1;
BA_ "GenSigInactiveValue" SG_ 347 RollingCounter_HAP3 15;
BA_ "IsRcSignal" SG_ 347 RollingCounter_HAP3 1;
BA_ "GenSigStartValue" SG_ 347 PAVP_FuncSts 1;
BA_ "GenSigStartValue" SG_ 347 HAVP_FuncSts 2;
BA_ "GenSigInactiveValue" SG_ 347 PAVP_TextDis 3;
BA_ "GenSigInactiveValue" SG_ 347 PAVP_Status 11;
BA_ "GenSigInactiveValue" SG_ 347 HAVP_WorkSts 11;
BA_ "IsCrcSignal" SG_ 347 Checksum_HAP3 1;
BA_ "GenSigInactiveValue" SG_ 347 RollingCounter_HAP1 15;
BA_ "IsRcSignal" SG_ 347 RollingCounter_HAP1 1;
BA_ "GenSigInactiveValue" SG_ 347 AVP_T_BOX_WorkSts 3;
BA_ "GenSigInactiveValue" SG_ 347 AVP_FWiperReq 7;
BA_ "GenSigInactiveValue" SG_ 347 TailVertPrkgOutVald 1;
BA_ "GenSigInactiveValue" SG_ 347 HeadVertPrkgOutVald 1;
BA_ "GenSigInactiveValue" SG_ 347 RParaPrkgOutVald 1;
BA_ "GenSigInactiveValue" SG_ 347 LParaPrkgOutVald 1;
BA_ "GenSigInactiveValue" SG_ 347 P2P_SelfDetSts 3;
BA_ "GenSigInactiveValue" SG_ 347 P2P_SelfDetErrCode 1;
BA_ "GenSigInactiveValue" SG_ 347 P2P_PahDelSts 3;
BA_ "IsCrcSignal" SG_ 347 Checksum_HAP1 1;
BA_ "GenSigInactiveValue" SG_ 347 RollingCounter_AVP1 15;
BA_ "IsRcSignal" SG_ 347 RollingCounter_AVP1 1;
BA_ "GenSigInactiveValue" SG_ 347 DrvDirMstRskObstclCllsnTim 63;
BA_ "IsCrcSignal" SG_ 347 Checksum_AVP1 1;
BA_ "GenSigInactiveValue" SG_ 347 RollingCounter_APS4 15;
BA_ "IsRcSignal" SG_ 347 RollingCounter_APS4 1;
BA_ "GenSigInactiveValue" SG_ 347 RHeadVertPrkgOutVald 1;
BA_ "GenSigInactiveValue" SG_ 347 LHeadVertPrkgOutVald 1;
BA_ "GenSigInactiveValue" SG_ 347 RTailVertPrkgOutVald 1;
BA_ "GenSigInactiveValue" SG_ 347 LTailVertPrkgOutVald 1;
BA_ "GenSigStartValue" SG_ 347 MEB_BrkgReqValue 200;
BA_ "GenSigInactiveValue" SG_ 347 APS_WorkSts 4;
BA_ "GenSigInactiveValue" SG_ 347 MEBErrSts 1;
BA_ "IsCrcSignal" SG_ 347 Checksum_APS4 1;
BA_ "GenSigInactiveValue" SG_ 347 RollingCounter_APS1 15;
BA_ "IsRcSignal" SG_ 347 RollingCounter_APS1 1;
BA_ "GenSigStartValue" SG_ 347 APS_ProcBar 127;
BA_ "GenSigInactiveValue" SG_ 347 APS_TextDisp 8;
BA_ "IsCrcSignal" SG_ 347 Checksum_APS1 1;
BA_ "GenSigInactiveValue" SG_ 347 RollingCounter_APA1 15;
BA_ "IsRcSignal" SG_ 347 RollingCounter_APA1 1;
BA_ "IsCrcSignal" SG_ 347 Checksum_APA1 1;
BA_ "VFrameFormat" BO_ 350 14;
BA_ "MsgType" BO_ 350 0;
BA_ "GenMsgCycleTime" BO_ 350 20;
BA_ "GenSigInactiveValue" SG_ 350 CR_BrkgReqVal 65535;
BA_ "GenSigInactiveValue" SG_ 350 CR_ErrSts 1;
BA_ "GenSigInactiveValue" SG_ 350 FCTA_B_FuncSts 1;
BA_ "VFrameFormat" BO_ 415 14;
BA_ "MsgType" BO_ 415 0;
BA_ "GenMsgCycleTime" BO_ 415 50;
BA_ "GenSigStartValue" SG_ 415 IFC_Line_special02_CurvChange 480000;
BA_ "GenSigStartValue" SG_ 415 TargetPathC0 2825;
BA_ "GenSigStartValue" SG_ 415 TargetPathC2 15625;
BA_ "GenSigStartValue" SG_ 415 IFC_Roadedge02_CurvChange 480000;
BA_ "GenSigStartValue" SG_ 415 IFC_Roadedge02_Curv 15625;
BA_ "GenSigStartValue" SG_ 415 IFC_Roadedge02_Dy 2825;
BA_ "GenSigStartValue" SG_ 415 IFC_Roadedge01_CurvChange 480000;
BA_ "GenSigStartValue" SG_ 415 IFC_Roadedge01_Curv 15625;
BA_ "GenSigStartValue" SG_ 415 IFC_Roadedge01_Dy 2825;
BA_ "GenSigStartValue" SG_ 415 IFC_Line04_CurvChange 480000;
BA_ "GenSigStartValue" SG_ 415 IFC_Line04_Curv 15625;
BA_ "GenSigStartValue" SG_ 415 IFC_Line04_Dy 2825;
BA_ "GenSigStartValue" SG_ 415 IFC_Line03_CurvChange 480000;
BA_ "GenSigStartValue" SG_ 415 IFC_Line03_Curv 15625;
BA_ "GenSigStartValue" SG_ 415 IFC_Line03_Dy 2825;
BA_ "GenSigStartValue" SG_ 415 IFC_Line02_CurvChange 480000;
BA_ "GenSigStartValue" SG_ 415 IFC_Line02_Curv 15625;
BA_ "GenSigStartValue" SG_ 415 IFC_Line02_Dy 2825;
BA_ "GenSigStartValue" SG_ 415 IFC_Line01_CurvChange 480000;
BA_ "GenSigStartValue" SG_ 415 IFC_Line01_Curv 15625;
BA_ "GenSigStartValue" SG_ 415 IFC_Line01_Dy 2825;
BA_ "VFrameFormat" BO_ 546 14;
BA_ "MsgType" BO_ 546 0;
BA_ "GenMsgCycleTime" BO_ 546 50;
BA_ "GenSigInactiveValue" SG_ 546 RollingCounter_IFC_HCM9 15;
BA_ "IsRcSignal" SG_ 546 RollingCounter_IFC_HCM9 1;
BA_ "IsCrcSignal" SG_ 546 Checksum_IFC_HCM9 1;
BA_ "GenSigInactiveValue" SG_ 546 RollingCounter_IFC_HCM8 15;
BA_ "IsRcSignal" SG_ 546 RollingCounter_IFC_HCM8 1;
BA_ "IsCrcSignal" SG_ 546 Checksum_IFC_HCM8 1;
BA_ "GenSigStartValue" SG_ 546 IFC_Roadedge02_HeadingAngle 200;
BA_ "GenSigStartValue" SG_ 546 IFC_Roadedge01_HeadingAngle 200;
BA_ "GenSigStartValue" SG_ 546 IFC_Line04_HeadingAngle 200;
BA_ "GenSigStartValue" SG_ 546 IFC_Line03_HeadingAngle 200;
BA_ "GenSigStartValue" SG_ 546 IFC_Line02_HeadingAngle 200;
BA_ "GenSigStartValue" SG_ 546 IFC_Line01_HeadingAngle 200;
BA_ "VFrameFormat" BO_ 551 14;
BA_ "MsgType" BO_ 551 0;
BA_ "GenMsgCycleTime" BO_ 551 50;
BA_ "GenSigInactiveValue" SG_ 551 RollingCounter_AEB5 15;
BA_ "IsRcSignal" SG_ 551 RollingCounter_AEB5 1;
BA_ "GenSigInactiveValue" SG_ 551 ADAS_ErrStsActvSafety 2;
BA_ "IsCrcSignal" SG_ 551 Checksum_AEB5 1;
BA_ "GenSigStartValue" SG_ 551 ACC_RiTgt_03_Heading 30;
BA_ "GenSigInactiveValue" SG_ 551 ACC_RiTargrt_03_Detn 3;
BA_ "GenSigStartValue" SG_ 551 ACC_LeTgt_03_Heading 30;
BA_ "GenSigInactiveValue" SG_ 551 ACC_LeTargrt_03_Detn 3;
BA_ "GenSigStartValue" SG_ 551 ACC_PotentialTgt_02_Heading 30;
BA_ "GenSigInactiveValue" SG_ 551 ACC_PotentialTgt_02_Detn 3;
BA_ "GenSigInactiveValue" SG_ 551 AEB_JAFuncSts 1;
BA_ "GenSigInactiveValue" SG_ 551 FCW_AEB_PedFctSts 1;
BA_ "GenSigInactiveValue" SG_ 551 FCW_AEB_VehFctSts 1;
BA_ "GenSigStartValue" SG_ 551 TargetPositionDy 2825;
BA_ "GenSigStartValue" SG_ 551 AEB_JA_Resp 1;
BA_ "GenSigStartValue" SG_ 551 AEB_VehResp 1;
BA_ "GenSigStartValue" SG_ 551 AEB_PedResp 1;
BA_ "GenSigStartValue" SG_ 551 TargetPathC3 480000;
BA_ "GenSigStartValue" SG_ 551 IFC_Line_special02_Dy 2825;
BA_ "VFrameFormat" BO_ 628 14;
BA_ "MsgType" BO_ 628 0;
BA_ "GenMsgCycleTime" BO_ 628 50;
BA_ "GenSigInactiveValue" SG_ 628 DVRWorkSts 2;
BA_ "GenSigInactiveValue" SG_ 628 AVM_3DAngSts 511;
BA_ "GenSigInactiveValue" SG_ 628 OvlOpFailSts 1;
BA_ "GenSigInactiveValue" SG_ 628 FrntCamInpFailSts 1;
BA_ "GenSigInactiveValue" SG_ 628 RearCamInpFailSts 1;
BA_ "GenSigInactiveValue" SG_ 628 LeCamInpFailSts 1;
BA_ "GenSigInactiveValue" SG_ 628 RiCamInpFailSts 1;
BA_ "GenSigInactiveValue" SG_ 628 LaneCalFltSts 5;
BA_ "GenSigInactiveValue" SG_ 628 LaneCalSts 3;
BA_ "GenSigInactiveValue" SG_ 628 CarMdlTrsprcySts 3;
BA_ "VFrameFormat" BO_ 664 14;
BA_ "MsgType" BO_ 664 0;
BA_ "GenMsgCycleTime" BO_ 664 100;
BA_ "GenSigInactiveValue" SG_ 664 APS_Coordinate_Y 2001;
BA_ "GenSigInactiveValue" SG_ 664 APS_Coordinate_X 501;
BA_ "GenSigInactiveValue" SG_ 664 APS_Coordinate_Angle 360;
BA_ "GenSigInactiveValue" SG_ 664 RmtPrkgFinishReq 3;
BA_ "GenSigStartValue" SG_ 664 FPAS_NearBrrdstn 127;
BA_ "GenSigInactiveValue" SG_ 664 FPAS_WorkSts 3;
BA_ "GenSigInactiveValue" SG_ 664 FPAS_FRCornrSnsrFailSts 1;
BA_ "GenSigInactiveValue" SG_ 664 FPAS_FRMiddlSnsrFailSts 1;
BA_ "GenSigInactiveValue" SG_ 664 FPAS_FLMiddlSnsrFailSts 1;
BA_ "GenSigInactiveValue" SG_ 664 FPAS_FLCornrSnsrFailSts 1;
BA_ "GenSigInactiveValue" SG_ 664 MEBWorkSts 3;
BA_ "GenSigInactiveValue" SG_ 664 RPAS_WorkSts 3;
BA_ "GenSigInactiveValue" SG_ 664 RPAS_RRCornrSnsrFailSts 1;
BA_ "GenSigInactiveValue" SG_ 664 RPAS_RRMiddlSnsrFailSts 1;
BA_ "GenSigInactiveValue" SG_ 664 RPAS_RLMiddlSnsrFailSts 1;
BA_ "GenSigInactiveValue" SG_ 664 RPAS_RLCornrSnsrFailSts 1;
BA_ "GenSigInactiveValue" SG_ 664 APS_RLSideSnsrFailSts 1;
BA_ "GenSigInactiveValue" SG_ 664 APS_RRSideSnsrFailSts 1;
BA_ "GenSigInactiveValue" SG_ 664 APS_FLSideSnsrFailSts 1;
BA_ "GenSigInactiveValue" SG_ 664 APS_FRSideSnsrFailSts 1;
BA_ "GenSigInactiveValue" SG_ 664 AntiMsstpngObstclDetnFailSts 1;
BA_ "GenSigInactiveValue" SG_ 664 ObstclDetnFailSts 1;
BA_ "GenSigStartValue" SG_ 664 ResTraDistanceOfCurTra 126;
BA_ "GenSigInactiveValue" SG_ 664 ResTraDistanceOfCurTra 127;
BA_ "GenSigStartValue" SG_ 664 P2P_ProcBar 127;
BA_ "GenSigStartValue" SG_ 664 HAVP_ProcRa 127;
BA_ "GenSigStartValue" SG_ 664 RPAS_NearBrrdstn 255;
BA_ "VFrameFormat" BO_ 683 14;
BA_ "MsgType" BO_ 683 0;
BA_ "GenMsgCycleTime" BO_ 683 100;
BA_ "GenSigInactiveValue" SG_ 683 DeviateSpdFixdValResp 63;
BA_ "GenSigStartValue" SG_ 683 ACC_PotentialTgtHeading 30;
BA_ "GenSigStartValue" SG_ 683 ACC_RiTgtHeading 30;
BA_ "GenSigStartValue" SG_ 683 ACC_LeTgtHeading 30;
BA_ "GenSigStartValue" SG_ 683 ACC_RlvTgtHeading 30;
BA_ "GenSigInactiveValue" SG_ 683 RollingCounter_ACC7 15;
BA_ "IsRcSignal" SG_ 683 RollingCounter_ACC7 1;
BA_ "GenSigInactiveValue" SG_ 683 ACC_RiTargrtDetn 3;
BA_ "GenSigInactiveValue" SG_ 683 ACC_LeTargrtDection 3;
BA_ "IsCrcSignal" SG_ 683 Checksum_ACC7 1;
BA_ "GenSigInactiveValue" SG_ 683 RollingCounter_ACC6 15;
BA_ "IsRcSignal" SG_ 683 RollingCounter_ACC6 1;
BA_ "GenSigInactiveValue" SG_ 683 ACC_PotentialTgtDetn 3;
BA_ "GenSigInactiveValue" SG_ 683 ACC_RlvTgtDetn 3;
BA_ "IsCrcSignal" SG_ 683 Checksum_ACC6 1;
BA_ "GenSigInactiveValue" SG_ 683 RollingCounter_ACC8 15;
BA_ "IsRcSignal" SG_ 683 RollingCounter_ACC8 1;
BA_ "GenSigInactiveValue" SG_ 683 TextSceneBrocast 8;
BA_ "GenSigInactiveValue" SG_ 683 DeviateSpdPreResp 63;
BA_ "IsCrcSignal" SG_ 683 Checksum_ACC8 1;
BA_ "GenSigInactiveValue" SG_ 683 RollingCounter_ACC4 15;
BA_ "IsRcSignal" SG_ 683 RollingCounter_ACC4 1;
BA_ "GenSigStartValue" SG_ 683 ACC_SpdSetValue 255;
BA_ "GenSigInactiveValue" SG_ 683 TJA_ICA_ModDisp 4;
BA_ "GenSigInactiveValue" SG_ 683 CruCha_ModDisp 9;
BA_ "GenSigInactiveValue" SG_ 683 ACC_ModDisp 7;
BA_ "IsCrcSignal" SG_ 683 Checksum_ACC4 1;
BA_ "GenSigInactiveValue" SG_ 683 RollingCounter_ACC3 15;
BA_ "IsRcSignal" SG_ 683 RollingCounter_ACC3 1;
BA_ "GenSigInactiveValue" SG_ 683 ALC_InterSysInfoDisp 1;
BA_ "IsCrcSignal" SG_ 683 Checksum_ACC3 1;
BA_ "GenSigInactiveValue" SG_ 683 ACC_RiTargrt_02_Detn 3;
BA_ "GenSigInactiveValue" SG_ 683 ACC_LeTargrt_02_Detn 3;
BA_ "VFrameFormat" BO_ 692 14;
BA_ "MsgType" BO_ 692 0;
BA_ "GenMsgCycleTime" BO_ 692 100;
BA_ "GenSigInactiveValue" SG_ 692 AEB_RiCyclistTyp 7;
BA_ "GenSigInactiveValue" SG_ 692 AEB_RiCyclistDetn 3;
BA_ "GenSigInactiveValue" SG_ 692 AEB_LeCyclistTyp 7;
BA_ "GenSigInactiveValue" SG_ 692 AEB_LeCyclistDetn 3;
BA_ "GenSigStartValue" SG_ 692 JAPedObjID 255;
BA_ "GenSigStartValue" SG_ 692 AEBJAObjID 255;
BA_ "GenSigInactiveValue" SG_ 692 AEB_RiPedDetn 3;
BA_ "GenSigInactiveValue" SG_ 692 AEB_RiPedTyp 7;
BA_ "GenSigInactiveValue" SG_ 692 AEB_LePedTyp 7;
BA_ "GenSigInactiveValue" SG_ 692 AEB_LePedDetn 3;
BA_ "VFrameFormat" BO_ 696 14;
BA_ "MsgType" BO_ 696 0;
BA_ "GenMsgCycleTime" BO_ 696 100;
BA_ "GenSigInactiveValue" SG_ 696 AEBObjDrvby 31;
BA_ "GenSigInactiveValue" SG_ 696 AEBObjOverlap 31;
BA_ "GenSigInactiveValue" SG_ 696 MapDataValid 1;
BA_ "GenSigInactiveValue" SG_ 696 ACC_SOSReq 3;
BA_ "GenSigStartValue" SG_ 696 BrdgDst 63;
BA_ "GenSigStartValue" SG_ 696 TunnelDst 63;
BA_ "GenSigStartValue" SG_ 696 CurveDst 63;
BA_ "GenSigStartValue" SG_ 696 SpdLimit 254;
BA_ "GenSigInactiveValue" SG_ 696 SpdLimit 63;
BA_ "GenSigStartValue" SG_ 696 RampDst 63;
BA_ "GenSigStartValue" SG_ 696 RoadCrvtFar 511;
BA_ "GenSigStartValue" SG_ 696 SpdLimitDst 63;
BA_ "GenSigStartValue" SG_ 696 RoadCrvt 511;
BA_ "GenSigStartValue" SG_ 696 ACCTgtObjID 255;
BA_ "GenSigStartValue" SG_ 696 PedObjID 255;
BA_ "GenSigStartValue" SG_ 696 CyclistObjID 255;
BA_ "GenSigStartValue" SG_ 696 AEBObjID 255;
VAL_ 810 SmtLSideViewCamSts 0 "Initial_value" 1 "Available" 2 "Unavailable" 3 "Soc_off" ;
VAL_ 810 SmtRSideViewCamSts 0 "Initial_value" 1 "Available" 2 "Unavailable" 3 "Soc_off" ;
VAL_ 810 SmarRearviewcamSts 0 "Initial_value" 1 "Available" 2 "Unavailable" 3 "Soc_off" ;
VAL_ 810 HumanDrvWarnInfoDisp 0 "Initial_value" 1 "MRM_actived_manual_driving" ;
VAL_ 810 DrvImpairmAsscSts 0 "Initial_value" 1 "OFF" 2 "ON" ;
VAL_ 299 LCP_State 0 "Initial_value" 1 "OFF" 2 "Standby" 3 "Active" 4 "Passive" 5 "Fault" ;
VAL_ 299 NavOptSpdLim 0 "No_Display" 1 "SPL_5" 2 "SPL_10" 3 "SPL_15" 4 "SPL_20" 5 "SPL_25" 6 "SPL_30" 7 "SPL_35" 8 "SPL_40" 9 "SPL_45" 10 "SPL_50" 11 "SPL_55" 12 "SPL_60" 13 "SPL_65" 14 "SPL_70" 15 "SPL_75" 16 "SPL_80" 17 "SPL_85" 18 "SPL_90" 19 "SPL_95" 20 "SPL_100" 21 "SPL_105" 22 "SPL_110" 23 "SPL_115" 24 "SPL_120" 25 "SPL_125" 26 "SPL_130" 27 "SPL_135" 28 "SPL_140" 29 "SPL_145" 30 "SPL_150" 31 "Invalid" ;
VAL_ 299 VisOptSpdLim 0 "No_Display" 1 "SPL_5" 2 "SPL_10" 3 "SPL_15" 4 "SPL_20" 5 "SPL_25" 6 "SPL_30" 7 "SPL_35" 8 "SPL_40" 9 "SPL_45" 10 "SPL_50" 11 "SPL_55" 12 "SPL_60" 13 "SPL_65" 14 "SPL_70" 15 "SPL_75" 16 "SPL_80" 17 "SPL_85" 18 "SPL_90" 19 "SPL_95" 20 "SPL_100" 21 "SPL_105" 22 "SPL_110" 23 "SPL_115" 24 "SPL_120" 25 "SPL_125" 26 "SPL_130" 27 "SPL_135" 28 "SPL_140" 29 "SPL_145" 30 "SPL_150" 31 "Invalid" ;
VAL_ 299 LKA_State 0 "Initial_value" 1 "OFF" 2 "Standby" 3 "Active" 4 "Passive" 5 "Fault" 6 "Reserved" ;
VAL_ 299 LDW_State 0 "Initial_value" 1 "OFF" 2 "Standby" 3 "Active" 4 "Passive" 5 "Fault" 6 "Reserved" ;
VAL_ 299 AES_State 0 "Initial_value" 1 "OFF" 2 "Standby" 3 "Active" 4 "Passive" 5 "Fault" 6 "Reserved" ;
VAL_ 299 ESS_State 0 "Initial_value" 1 "OFF" 2 "Standby" 3 "Active" 4 "Passive" 5 "Fault" 6 "Reserved" ;
VAL_ 299 RollingCounter_IFC2 0 "Valid value" 15 "Invalid value" ;
VAL_ 299 StrgTrqCoeff 0 "Initial_Value" ;
VAL_ 299 IFCFuncAngCmdReqFlag 0 "No_Request" 1 "LKA_Req" 2 "ESS_Req" 3 "APA_Req" 4 "APA_Req_SBW" ;
VAL_ 299 IFCAngCmdReqProtnValue 0 "Valid value" ;
VAL_ 299 IFCAngCmdReqValue 0 "Valid value" 15601 "reserved" ;
VAL_ 299 Checksum_IFC2 0 "Valid value" ;
VAL_ 299 RollingCounter_IFC1 0 "Valid value" 15 "Invalid value" ;
VAL_ 299 IFCFuncTrqCmdReqFlag 0 "No Request" 1 "LKA Request" 2 "ESS Request" 3 "Reserved" ;
VAL_ 299 IFCVibrationWarning 0 "No Request" 1 "LeveL 1" 2 "Reserved" ;
VAL_ 299 IFCTrqOvlCmdReqValue 0 "Valid value" ;
VAL_ 299 IFCTrqOvlCmdProtnValue 0 "Valid value" ;
VAL_ 299 Checksum_IFC1 0 "Valid value" ;
VAL_ 323 RollingCounter_ACC14 0 "Valid_value" 15 "Invalid_value" ;
VAL_ 323 VehRollRate 0 "Initial_Value" 1 "Valid_Value" ;
VAL_ 323 VehPitchRate 0 "Initial_Value" 1 "Valid_Value" ;
VAL_ 323 InrlMeasUnitFailrSts 0 "Initial_Value" 1 "Normal" 2 "Abnormal" ;
VAL_ 323 VehVerAccel 0 "Initial_Value" 1 "Valid_Value" ;
VAL_ 323 Checksum_ACC14 0 "Valid_value" ;
VAL_ 323 RollingCounter_ACC12 0 "Valid value" 15 "Invalid value" ;
VAL_ 323 DrvgPrkgFuncActvnSts 0 "Initial_value" 1 "OFF" 2 "ON" ;
VAL_ 323 FxTgtGearEna 0 "Initial_value" 1 "Disable" 2 "Enable" ;
VAL_ 323 FxTgtGearReqVld 0 "Invalid" 1 "Valid" ;
VAL_ 323 TotRefTrq 0 "Initial_value" ;
VAL_ 323 FxTgtGearReq 0 "No_request" 1 "P" 2 "R" 3 "N" 4 "D" ;
VAL_ 323 FxTgtTrqMod 0 "Initial_value" 1 "Throttle_override_mode" 2 "Throttle_inhibite_mode" ;
VAL_ 323 FxTgtTrqEna 0 "Initial_value" 1 "Disable" 2 "Enable" ;
VAL_ 323 FxTgtTrqVld 0 "Invalid" 1 "Valid" ;
VAL_ 323 FxTgtTrq 0 "Initial_value" ;
VAL_ 323 Checksum_ACC12 0 "Valid value" ;
VAL_ 323 RollingCounter_ACC10 0 "Valid value" 15 "Invalid value" ;
VAL_ 323 AEBFrwdObstclDetnFailSts 0 "Initial_Value" 1 "No_Failure" 2 "Failure" ;
VAL_ 323 AEBMstRskObstclPreCllsnTim 0 "Initial_Value" 63 "Invalid_Value" ;
VAL_ 323 Longctrl_WheelTrqReqActive 0 "Not active" 1 "Active" ;
VAL_ 323 Longctrl_WheelTrqReq 0 "Valid value" ;
VAL_ 323 Checksum_ACC10 0 "Valid value" ;
VAL_ 323 RollingCounter_ACC2 0 "Valid value" 15 "Invalid value" ;
VAL_ 323 ACC_CRInterface 0 "No Response" 1 "Response" ;
VAL_ 323 IDC_L2_HADFuncCmdReqFlag 0 "No Request" 1 "LKA Req" 2 "ESS Req" 3 "Reserved" 4 "HWP Req" 5 "Override" 6 "Failure" 7 "Reserved" ;
VAL_ 323 Checksum_ACC2 0 "Valid value" ;
VAL_ 323 RollingCounter_ACC1 0 "Valid value" 15 "Invalid value" ;
VAL_ 323 ActualTargetSpeed 0 "Valid value" 255 "Invalid value" ;
VAL_ 323 Longctrl_Decel_ReqValue 0 "Valid value" ;
VAL_ 323 InterceptionDmd 0 "No_Demand" 1 "Demand" ;
VAL_ 323 Longctrl_ParkShiftReq 0 "No request" 1 "Request park Shift" 2 "Invalid" 3 "Reserved" ;
VAL_ 323 Longctrl_DecelToStopReq 0 "No Request" 1 "Request" ;
VAL_ 323 Longctrl_Decel_Req 0 "No Request" 1 "Request" ;
VAL_ 323 Longctrl_ModSts 0 "OFF mode" 1 "Passive mode(Reject)" 2 "Passive mode(Stand-by)" 3 "Active-Control mode" 4 "Brake-only mode" 5 "Override" 6 "Standstill" 7 "Failure mode Longctrl" 8 "Reserved" 9 "Shut off" 10 "Reserved" ;
VAL_ 323 Longctrl_DrvOFF_Req 0 "No Request" 1 "Request" ;
VAL_ 323 Longctrl_VehHldReq 0 "No Request" 1 "Request" ;
VAL_ 323 Checksum_ACC1 0 "Valid value" ;
VAL_ 323 RollingCounter_ACC11 0 "Valid_value" 15 "Invalid_value" ;
VAL_ 323 Longctrl_AccelOvrdActnReq 0 "No_Action" 1 "Action" ;
VAL_ 323 HWP_MotTypeReqMode_L2 0 "None" 1 "Drv L12" 2 "Drv L3" 3 "Reserved" ;
VAL_ 323 Longctrl_TgtGearReqVld 0 "Invalid" 1 "Valid" ;
VAL_ 323 Longctrl_TgtGearReq 0 "No_request" 1 "P" 2 "R" 3 "N" 4 "D" 5 "Reserved" ;
VAL_ 323 Checksum_ACC11 0 "Valid_value" ;
VAL_ 347 RollingCounter_APA7 0 "Valid value" 15 "Invalid value" ;
VAL_ 347 RWSModReq 0 "No_Request" 1 "Adas_Request" ;
VAL_ 347 APA_PxReqVld 0 "Invalid_value" 1 "Valid_value" ;
VAL_ 347 APA_FxReqVld 0 "Invalid_value" 1 "Valid_value" ;
VAL_ 347 APA_FxReq 0 "Valid value" ;
VAL_ 347 APA_PxReq 0 "Valid value" ;
VAL_ 347 APA_ModFlag 0 "No_Action" 1 "EPS_only" 2 "EPS_and_RWS" ;
VAL_ 347 RWSAngReqVld 0 "Invalid" 1 "Valid" ;
VAL_ 347 RWSAngReq 0 "Initial_Value" ;
VAL_ 347 Checksum_APA7 0 "Valid value" ;
VAL_ 347 RollingCounter_HAP3 0 "Valid_value" 15 "Invalid_value" ;
VAL_ 347 SlotConfirmBtn_Ena 0 "No Display" 1 "Disable" 2 "Enable" 3 "Active" ;
VAL_ 347 AnticlockwiseBtn_Ena 0 "No Display" 1 "Disable" 2 "Enable" 3 "Active" ;
VAL_ 347 ClockwiseBtn_Ena 0 "No Display" 1 "Disable" 2 "Enable" 3 "Active" ;
VAL_ 347 VerticalSlotBtn_Ena 0 "No Display" 1 "Disable" 2 "Enable" 3 "Active" ;
VAL_ 347 ParallelSlotBtn_Ena 0 "No Display" 1 "Disable" 2 "Enable" 3 "Active" ;
VAL_ 347 PAVP_FuncSts 0 "PAVP_Function_standby" 1 "PAVP_Function_disable" 2 "Reserved" ;
VAL_ 347 PAVP_TextDis2 0 "No_tex" 1 "Drop_off_area_picture_request" 2 "Path_list_showing_request" 3 "Find_a_slot_do_you_want_to_start_parking_or_RPA" 4 "Do_you_want_to_start_parking" 5 "Which_slots_do_you_want_to_park_and_start_parking" 6 "Which_slots_do_you_want_to_park_and_start_parking_no_RPA" 7 "Which_slots_do_you_want_to_park" 8 "Do_you_want_to_start_parking_or_RPA" 33 "Please_watch_out_for_scratches" 34 "The_space_is_tiqht_folding_the _side_mirrors" ;
VAL_ 347 HAVP_FuncSts 0 "HAVP_Function_standby" 1 "HAVP_Function_active" 2 "HAVP_Function_disable" 3 "Reserved" ;
VAL_ 347 PAVP_TextDis 0 "No text" 1 "Selfchecking" 2 "AVP unavailable" 3 "Map update failed" 4 "Wrong position" 5 "Req_Close_Door_all doors" 6 "Req_Close_Hood_door" 7 "Req_Close_Trunk_door" 8 "Req_Gear_P_EPB" 9 "Path download failed" 10 "Power off failed" 11 "Pick-up location" 12 "Drop-off area" 13 "No parking lot" 14 "Parking in inprocess" 15 "Parking in complete" 16 "Task failed" 17 "Parking out in process" 18 "Cruising" 19 "Parking out complete" 20 "Req_Quit_System failure" 21 "Req_Suspend_User Req" 22 "Req_Quit_EPS failure" 23 "Req_Quit_ESP failure" 24 "Req_Abort_Terminate_Button_Pressed_HMI_Cancel_RD_Cancel" 25 "Req_Abort_Steering Wheel Intervention" 26 "Req_Abort_Gear Intervention" 27 "Req_Abort_EPB Intervention" 28 "Req_Abort_Function Activation" 29 "Reserved" 32 "Req_Abort_Parking Timeout" 33 "Req_Abort_Speed high" 34 "Req_Abort_Parking Too Many Times" 35 "Req_Abort_Hood Open" 36 "Req_Abort_Trunk Open" 37 "Req_Abort_Door Open" 38 "Req_Abort_Deficient Space" 39 "Req_Abort_Network Disconnection" 40 "Req_Abort_Path Invalid" 41 "Req_Abort_Parking Lot Invalid" 42 "Req_Abort_Rear Mirror Fold" 43 "Req_Abort_ODD Dissatisfied" 44 "Req_Abort_Suspend Too Many Times" 45 "Req_Abort_Suspend Timeout" 46 "Req_Abort_Tire Pressure" 47 "Req_Abort_TBOX Err" 48 "Network fault" 49 "No parking area" 50 "ParkingList screen" 51 "Reserved" ;
VAL_ 347 HAVP_SelfParLotEnding_Ena 0 "No Display" 1 "Disable" 2 "Enable" 3 "Active" ;
VAL_ 347 PAVP_Status 0 "Off" 1 "Standby" 2 "Position" 3 "Preactive" 4 "Restore Cruising" 5 "Summon Crusing" 6 "Parking" 7 "Outing" 8 "Completed" 9 "Suspend" 10 "Abort" 11 "Failure" 12 "Disable" 13 "Reserved" ;
VAL_ 347 HAVP_StopBtn_Ena 0 "No Display" 1 "Disable" 2 "Enable" 3 "Active" ;
VAL_ 347 HAVP_StartBtn_Ena 0 "No Display" 1 "Disable" 2 "Enable" 3 "Active" ;
VAL_ 347 HAVP_WorkSts 0 "Off" 1 "Standby" 2 "VLAP_Roaming" 3 "VLAP_Parking" 4 "VLAP_Pause" 5 "Summon Crusing" 6 "Parking" 7 "Outing" 8 "Completed" 9 "Suspend" 10 "Abort" 11 "Failure" 12 "Disable" 13 "Study" 14 "Reserved" ;
VAL_ 347 Checksum_HAP3 0 "Valid_value" ;
VAL_ 347 RollingCounter_HAP1 0 "Valid value" 15 "Invalid value" ;
VAL_ 347 AVP_T_BOX_WorkSts 0 "OFF" 1 "HAVP ON" 2 "PAVP ON" 3 "Failure" ;
VAL_ 347 AVP_SunroofCloseReq 0 "No request" 1 "Request to close" 2 "Request to open" 3 "Reserved" ;
VAL_ 347 RmtCtrlSts 0 "OFF" 1 "ON" ;
VAL_ 347 AVP_CenCtrllockReq 0 "No Request" 1 "lock" 2 "unlock" 3 "Reserved" ;
VAL_ 347 AVP_WindLockReq 0 "No request" 1 "Request to close" 2 "Request to open" 3 "Reserved" ;
VAL_ 347 AVP_PowerModeReq 0 "No Request" 1 "Power Off Request" 2 "Power On Request" 3 "Reserved" ;
VAL_ 347 AVP_FWshrReq 0 "No Request" 1 "Wiper Wash" 2 "Wash in Auto Mode" 3 "OFF" ;
VAL_ 347 AVP_FWiperReq 0 "No Request" 1 "Wiper Auto Or Intermittent" 2 "Low Speed" 3 "High Speed" 4 "Wiper Off" 5 "Reserved" 7 "Error" ;
VAL_ 347 AVP_HornReq 0 "No request" 1 "Turn OFF" 2 "Turn ON" 3 "Reserved" ;
VAL_ 347 AVP_RFogLightReq 0 "Turn_OFF" 1 "Turn_ON" ;
VAL_ 347 AVP_FFogLightReq 0 "Turn_OFF" 1 "Turn_ON" ;
VAL_ 347 AVP_DippedBeamReq 0 "No request" 1 "Turn OFF" 2 "Turn ON" 3 "Reserved" ;
VAL_ 347 AVP_HiBeamtReq 0 "No request" 1 "Turn OFF" 2 "Turn ON" 3 "Reserved" ;
VAL_ 347 P2P_PrkgDirectSts 0 "P2P Park in" 1 "P2P Summon" ;
VAL_ 347 APS_MovgDirc 0 "No Display" 1 "Moving forward" 2 "Moving backward" 3 "Reserved" ;
VAL_ 347 TailVertPrkgOutVald 0 "valid" 1 "Invalid" ;
VAL_ 347 HeadVertPrkgOutVald 0 "valid" 1 "Invalid" ;
VAL_ 347 RParaPrkgOutVald 0 "valid" 1 "Invalid" ;
VAL_ 347 LParaPrkgOutVald 0 "valid" 1 "Invalid" ;
VAL_ 347 RmtPrkgReq 0 "No Request" 1 "Request to parking in" ;
VAL_ 347 P2P_Pah2Avail 0 "Not avalible" 1 "Avalible" ;
VAL_ 347 P2P_SelfDetSts 0 "No Action" 1 "Detecting" 2 "Successed" 3 "Failed" ;
VAL_ 347 P2P_Pah1Avail 0 "Not avalible" 1 "Avalible" ;
VAL_ 347 P2P_SelfDetErrCode 0 "No Error" 1 "HAP Error" 2 "tyre pressure error" 3 "door open" 4 "trunk open" 5 "vehicle moving" 6 "environment error" 7 "Camera is smudgy" 8 "Seat belt not fastened" 9 "Mirror is folded" 10 "Associated system error" 11 "reserved" ;
VAL_ 347 HAP_SwtDispCtrlCmd 0 "No_display" 1 "Park_out_direction_Select_menu" 2 "Continue_park_menu" 3 "Study_finish_button" 4 "Continue_RADS_menu" 5 "RDAS_active_distance_arrow_steering" 6 "Continue_FADS_menu" 7 "Reserved" ;
VAL_ 347 P2P_PahDelSts 0 "No Action" 1 "detecting" 2 "successed" 3 "failed" ;
VAL_ 347 HAP_PrkgModCurrSts 0 "No_display" 1 "Left_parallel_park_in" 2 "Right_parallel_park_in" 3 "Left_vert_park_in" 4 "Right_vert_park_in" 5 "Left_Tshape_park_in" 6 "Right_Tshape_park_in" 7 "Left_parallel_park_out" 8 "Right_parallel_park_out" 9 "Front_vert_park_out" 10 "Rear_vert_park_out" 11 "P2P_Summon" 12 "left_front_vert_park_out" 13 "right_front_vert_park_out" 14 "left_rear_vert_park_out" 15 "right_rear_vert_park_out" ;
VAL_ 347 APS_PASSwtReq 0 "NO request" 1 "Request to close" 2 "Request to open" 3 "Reserved" ;
VAL_ 347 Checksum_HAP1 0 "Valid Value" ;
VAL_ 347 RollingCounter_AVP1 0 "Valid_value" 15 "Invalid_value" ;
VAL_ 347 DrvDirCllsnWarnTrqCtrlFlg 0 "Initial_Value" 1 "Not_Active" 2 "ADC_Limit_Torque" 3 "ADC_Clear_Torque" 4 "ADC_Only_Warning" 5 "HAP_PAS_Clear_Torque" ;
VAL_ 347 DrvDirMstRskObstclCllsnTim 0 "Initial_Value" 1 "Valid_values" 63 "Invalid_Value" ;
VAL_ 347 AVP_ESP_LSMNudgeReq 0 "No Request" 1 "Requested" ;
VAL_ 347 AVP_ESP_LSMVehSecReq 0 "No Request" 1 "Requested" ;
VAL_ 347 AVP_ESP_LSMComfBrakeReq 0 "ComfBrakeReq_NoReq" 1 "ComfBrakeReq_Type1" 2 "ComfBrakeReq_Type2" 3 "Reserved" ;
VAL_ 347 AVP_ESP_LSMVehDirRq 0 "DirReq_None" 1 "DirReq_Forward" 2 "DirReq_Backward" 3 "Reserved" ;
VAL_ 347 AVP_ESP_LSMSubMTLong 0 "MTLong_None" 1 "MTLong_Comfort" 2 "MTLong_Emergency" 3 "MTLong_Reserved" ;
VAL_ 347 AVP_ESP_LSMPrefill 0 "No Request" 1 "Requested" ;
VAL_ 347 AVP_ESP_LSMSubMTLevel 0 "MTLevel_None" 1 "MTLevel_12" 2 "MTLevel_23" 3 "MTLevel_Reserved" ;
VAL_ 347 AVP_ESP_SafeDrvrHandoverReq 0 "No Request" 1 "Requested" ;
VAL_ 347 AVP_ESP_LSMvMaxRq 0 "Valid value" 201 "Reserved" ;
VAL_ 347 AVP_ESP_LSMSubMTReq 0 "MTReq_None" 1 "MTReq_Drive" 2 "MTReq_LSM" 3 "Reserved" ;
VAL_ 347 AVP_ESP_DriverPresenceExternal 0 "False" 1 "True" ;
VAL_ 347 AVP_ESP_LSMDistToStop 0 "Valid value" ;
VAL_ 347 Checksum_AVP1 0 "Valid_Value" ;
VAL_ 347 RollingCounter_APS4 0 "Valid value" 15 "Invalid value" ;
VAL_ 347 RHeadVertPrkgOutVald 0 "Valid" 1 "Invalid" ;
VAL_ 347 LHeadVertPrkgOutVald 0 "Valid" 1 "Invalid" ;
VAL_ 347 RTailVertPrkgOutVald 0 "Valid" 1 "Invalid" ;
VAL_ 347 LTailVertPrkgOutVald 0 "Valid" 1 "Invalid" ;
VAL_ 347 MEB_BrkgReqValue 0 "Valid value" 201 "Reserved" ;
VAL_ 347 MEB_AVHReq 0 "No Request" 1 "Request" ;
VAL_ 347 PrkMod 0 "No_Action" 1 "Head_parking_in" 2 "Tail_parking_in" 3 "Reserved" ;
VAL_ 347 APS_ESP_BrkDistance 0 "Valid value" ;
VAL_ 347 APS_ESP_SpdLimn 0 "Valid Value" ;
VAL_ 347 APS_WorkSts 0 "Disable" 1 "Standby" 2 "Searching" 3 "Guidance" 4 "Failed" 5 "Wait for Engine restart" 6 "Reserved" ;
VAL_ 347 MEB_BrkgReq 0 "No Request" 1 "Request" ;
VAL_ 347 MEBErrSts 0 "No Error" 1 "Error" ;
VAL_ 347 APS_BrkModSts 0 "ParkAssist_Int" 1 "ParkAssist_Standby" 2 "ParkAssist_Active" 3 "ParkAssist_ManeuverFinished" 4 "ParkAssist_Suspend (Reserved)" 5 "ParkAssist_Abort" 6 "Reserved" ;
VAL_ 347 APS_BrkCategory 0 "ParkAssist_Idle" 1 "ParkAssist_Comfort" 2 "ParkAssist_Emergency" 3 "Reserved" ;
VAL_ 347 APS_ESP_TgtGearReq 0 "No_request" 1 "P" 2 "R" 3 "N" 4 "D" 5 "D_Dynamic" 6 "R_Dynamic" ;
VAL_ 347 APS_BrkFctnMod 0 "ParkAssist_NoSignal" 1 "parkAssist_RemotePark" 2 "Reserved" 3 "ParkAssist_AutomaticPark" 4 "Reserved" ;
VAL_ 347 Checksum_APS4 0 "Valid Value" ;
VAL_ 347 RollingCounter_APS1 0 "Valid value" 15 "Invalid value" ;
VAL_ 347 OutdPrkgSts 0 "Initial_value" 1 "OFF" 2 "ON" ;
VAL_ 347 TurnLightsCmd 0 "No Request" 1 "LeftLight On" 2 "RightLight On" 3 "hazardLight ON" ;
VAL_ 347 APS_PrkgMod 0 "None" 1 "Parking in" 2 "Parking out" 3 "Reserved" ;
VAL_ 347 APS_PrkgTyp 0 "None" 1 "Parallel parking" 2 "Vertical parking" 3 "Reserved" ;
VAL_ 347 APS_SwtSts 0 "no press" 1 "press" ;
VAL_ 347 APS_ProcBar 0 "Valid_values" 127 "No_Display" ;
VAL_ 347 APS_TextDisp 0 "No_Request" 1 "Wrong_gear_position_to_start_parking" 2 "Turn_D_to_search_for_slot" 3 "Please_close_the_trunk" 4 "Please_close_the_door" 5 "Please_fasten_the_seat_belt" 6 "Please_unfold_the_Mirror" 7 "Speed_is_too_high_need_Less_than_23km_h" 8 "System_error_Parking_sys_exits" 9 "control_unit_error_parking_sys_exits" 10 "Please_brake" 11 "please_select_parking_mode" 12 "please_select_internal_parking" 13 "please_select_Slot_and_parking_mode" 14 "please_select_Slot_and_internal_parking" 15 "Please_keep_braking" 16 "Hands_off_the_steering_wheel" 17 "Release_the_brake_parking_start" 18 "Auto_parking_be_ready_to_brake" 19 "parking_suspended_close_trunk" 20 "parking_suspended_close_door" 21 "parking_suspended_fasten_seat_belt" 22 "Obstacles_Detected" 23 "brake_recovered_confirm_to_continue" 24 "Parking_quited" 25 "parking_finished" 26 "interfered_by_driver_parking_quited" 27 "too_many_parking_times_parking_sys_exits" 28 "Parking_time_too_long_Parking_sys_exits" 29 "Too_Small_Slot_Parking_sys_exits" 30 "Please_Clean_the_Camera" 31 "Select_the_parking_mode_APA3" 32 "Searching_the_right_slot" 33 "Searching_the_left_slot" 34 "Please_turn_D_to_search_for_parking_slot" 35 "Speed_is_too_high_need_Less_than_30km_h" 36 "Speed_is_too_high_sys_exits" 37 "Select_parking_type" 38 "Long_press_switch_2s_to_enter_auto_parking" 39 "Parking_suspended_Please_release_the_gas_pedal" 40 "Please_brake_And_long_press_switch_2s_to_continue_auto_parking" 41 "Parking_is_not_available" 42 "Please_select_the_parking_direction_by_turning_the_turn_switch" 43 "Please_brake_And_long_press_switch_2s_to_enter_POC_left" 44 "Parking_sys_exits" 45 "Parking_suspended_fold_the_Mirror" 46 "Too_Small_Slot_Please_select_another_direction" 47 "Driving_Mode_not_supported" 48 "Path_is_smooth" 49 "Please_select_park_out" 50 "Please_select_park_out_direction" 51 "Please_get_off_the_car_with_keys_to_start_remote_parking" 52 "Please_confirm_to_start_parking" 53 "Remote_Parking_in_exit" 54 "Parking_suspended_Remote_connection_error" 55 "System_error_Parking_sys_can_not_start" 56 "Control_unit_error_Parking_sys_can_not_start" 57 "Please_Turn_P_and_Apply_EPB_Remote_parking_sys_not_Running" 58 "Select_Remote_parking_out_type" 59 "Please_brake_And_long_press_switch_2s_to_enter_POC_Right" 60 "Please_release_switch_to_en-ter_guidance" 61 "Slope_over_system_exits" 62 "Please_select_Summon_Path" 63 "Slot_found" 64 "Path_study_begin_please_drive_the_car" 65 "Path_studying" 66 "Confirm_study_finished" 67 "Path_studying_failed_caused_by_Path_too_long" 68 "Path_studying_failed_caused_by_Speed_too_high" 69 "Path_studying_failed_caused_by_communication_error" 70 "Path_studying_failed_caused_by_Path_error" 71 "Path_studying_failed_caused_by_learn_time_too_long" 72 "Path_studying_failed_caused_by_internal_error" 73 "Path_studying_failed_caused_by_Path_too_short" 74 "Path_studying_failed_caused_by_Path_backward_too_long" 75 "Path_studying_failed_caused_by_shift_gear_too_many_times" 76 "Speed_is_too_high_need_Less_than_5km_h" 77 "Speed_is_too_high_need_Less_than_10km_h" 78 "Speed_is_too_high_need_Less_than_15km_h" 79 "Parking_out_is_available" 80 "Path_saving" 81 "Path_saving_Succeed" 82 "Path_saving_failed_caused_by_Path_too_short" 83 "Path_saving_failed_caused_by_communication_error" 84 "Path_saving_failed_caused_by_Path_error" 85 "Path_saving_failed_caused_by_Path_error_limit_storage_room" 86 "Path_saving_failed_caused_by_internal_error" 87 "Please_stop_if_you_need_to_park" 88 "Please_release_the_accelerator_pedal" 89 "Vehicles_can_be_taken_over_in_advance" 90 "You_have_taken_over_the_vehicle" 91 "Taken_over_the_vehicle_sys_exit" 92 "Not_Available_in_Valet_mode" 93 "Take_over_feedback" 94 "Narrow_slot_switched_to_head-in_parking" 95 "Narrow_slot_switched_to_reverse_parking" 96 "Please_drive_to_path_start_point" 97 "Path_matche_please_stop" 98 "Please_select_play_back_mode" 99 "Path_match_failed_caused_by_communication_error" 100 "Path_match_failed_caused_by_path_error" 101 "Path_match_failed_caused_by_long_time_no_action" 102 "Path_match_failed_caused_by_internal_error" 103 "The_maximun_path_length_is_about_to_be_exceeded" 104 "Auto_parking_be_ready_to_break" 105 "Map_data_abnormal_system_exit" 106 "Trailer_hitch_open_sys_unavailable" 107 "Differential_lock_open_sys_unavailable" 108 "Trailer_hitch_open_sys_exit" 109 "Differential_lock_open_sys_exit" 110 "Switched_to_head-in_parking" 111 "Switched_to_reverse_parking" 112 "No_save_distance_RADS_sys_esits" 113 "RADS_running_be_ready_to_brake" 114 "Near_the_bourn" 115 "Arrive_at_the_bourn" 116 "Release_the_brake" 117 "Trunk_open_RADS_sys_exits" 118 "Door_open_RADS_sys_exits" 119 "Seat_belt_drop_RADS_sys_exits" 120 "Mirror_fold_RADS_sys_exits" 121 "Obstacles_Detected_RADS_sys_exits" 122 "No_continue_driving_Parking_quited" 123 "Please_turn_to_R" 124 "Release_the_brake_Driving_assistance_start" 125 "Please_turn_to_D" 126 "RADS_suspended__Please_release_the_break_pedal" 127 "RADS_recovered__confirm_to_continue" 128 "FADS_running_be_ready_to_brake" 129 "Trunk_open_FADS_sys_exits" 130 "Door_open_FADS_sys_exits" 131 "Seat_belt_drop_FADS_sys_exits" 132 "Mirror_fold_FADS_sys_exits" 133 "Obstacles_Detected_FADS_sys_exits" 134 "Vehicle_can_not_move_FADS_sys_exits" 135 "Remote_control_straight_Search" 136 "Over_limit_search_distance" 137 "Please_select_suitable_parking_slot_icon" 138 "Please_drag_the_parking_slot_to_suitable_place_and_adjust_the_angle" 139 "Move_over_25m_system_exits" 140 "Move_over_5m_system_exits" 141 "Parking_suspended_Please_release_the_break_pedal" 142 "RADS_suspended_Detecte_obstacles" 143 "FADS_suspended_Detecte_obstacles" 144 "FADS_recovered_confirm_to_continue" 145 "Front_camera_dirty_Please_Clean_the_Camera" 146 "Rear_camera_dirty_Please_Clean_the_Camera" 147 "Left_camera_dirty_Please_Clean_the_Camera" 148 "Right_camera_dirty_Please_Clean_the_Camera" 149 "DVR_camera_dirty_Please_Clean_the_Camera" 150 "FADS_suspended_Please_release_the_break_pedal" 151 "Please_close_cabin_cover" 152 "Please_pull_out_the_charging_gun" 153 "Would_you_like_to_park_in" 154 "You_can_select_slot_and_park_it" 155 "Pay_attention_to_the_risk_of_scratches" 156 "Detecting_parking_space" 157 "Please_ready" 158 "Guide_successful_Please_start_charging" 159 "Wireless_charging_guidance_positioning" 160 "Wireless_charging_aligned_parking_complete" 161 "Parking_suspended_pedestrian_detected" 162 "Parking_suspended_vehicle_detected" 163 "Parking_continues" 164 "Parking_out_completed_please_take_over_vehicle" 165 "Environment_cannot_be_parked" 166 "Put_on_the_P_pull_up_EPB_close_door_for_remote_parking" 167 "Connection_abnormal_parking_cannot_be_started" 168 "Remote_parking_be_ready_to_stop" 169 "Select_parking_out_mode" 170 "Parking_suspended_close_cabin_cover" 171 "RADS_Suspended_loosen_accelerator_pedal" 172 "RADS_Suspended_close_cabin_cover" 173 "Steering_wheel_intervention_RADS_exits" 174 "EPB_intervention_RADS_exits" 175 "Gear_intervention_RADS_exits" 176 "Speed_too_high_RADS_exits" 177 "Time_out_RADS_exits" 178 "Too_many_times_RADS_exits" 179 "Trunk_open_RADS_sys_suspend" 180 "Door_open_RADS_sys_suspend" 181 "Seat_belt_drop_RADS_sys_suspend" 182 "Mirror_fold_RADS_sys_suspend" 183 "Obstacles_Detected" 184 "Detected_Obstacles" 185 "Avoid_nearby_obstacles" 186 "RADS_exit" 187 "Slot_small_use_RPA" 188 "Camera_fault_sys_exits" 189 "Camera_block_sys_exits" 190 "Slope_over_sys_unavailable" 191 "Other_assisit_activate_sys_exits" 192 "USS_system_failure_sys_unavailable" 193 "Parking_system_failure_sys_unavailable" 194 "Speed_is_too_high_sys_unavailable" 195 "Control_unit_error_sys_unavailable" 196 "AVM_not_calibrated_sys_unavailable" 197 "Camera_Failure_sys_unavailable" 198 "Other_auxiliary_driving_functions_are_activated_sys_unavailable" 199 "Active_security_feature_activation_sys_unavailable" 200 "Camera_dirty_sys_unavailable" 201 "Camera_is_blocked_sys_unavailable" 202 "Driving_Mode_not_supported_sys_unavailable" 203 "Path_is_unobstructed_sys_unavailable" 204 "Single_call_exceeds_the_limit_distance" 205 "Encounter_obstacles_laterally_Parking_suspension" 206 "Parking_system_failure__please_take_over_the_vehicle_in_time" 207 "Trunk_open_FADS_sys_suspend" 208 "System_exit_please_take_over_the_vehicle" 209 "Door_open_FADS_sys_suspend" 210 "Seat_belt_drop_FADS_sys_suspend" 211 "Mirror_fold_FADS_sys_suspend" 212 "FADS_exit" 213 "FADS_Suspended_loosen_accelerator_pedal" 214 "Speed_too_high_FADS_exits" 215 "Slope_exceeding_limit_Please_leave_the_ramp" 216 "Vehicle_not_ready_parking_system_exit" 217 "Suspension_mode_not_supported_sys_unavailable" 218 "Sys_unavailable" 219 "Parking_has_not_started_please_be_aware_of_the_slip_drive" 220 "Trajectory_planning" 221 "Trajectory_planning_failed" 222 "Looking_for_a_parking_space" 223 "Park_at_the_rear_of_the_car_click_Start_Parking" 224 "Park_at_the_front_of_the_car_click_Start_Parking" 225 "Can't_park_in_park_and_exit" 226 "Remote_parking_is_not_available" 227 "The_rear_of_the_car_is_parked_and_Slot_small_use_RPA" 228 "The_front_of_the_car_is_parked__and_Slot_small_use_RPA" 229 "The_mirrors_are_folded_be_aware_of_your_surroundings" 230 "Suspension_mode_not_supported_sys_unavailable" 231 "No_driving_trajectory_The_system_is_temporarily_unavailable" 232 "Lidar_Failure_sys_unavailable" 233 "Lidar_obstruction_sys_unavailable" 234 "Lidar_obstruction_sys_exits" 235 "Lidar_abnormal_sys_exits" 236 "USS_failure_sys_exits" 237 "Unable_park_out_sys_exit" 238 "Please_press_the_brake_and_select_the_parking_direction" 239 "Unmanned_parking_process" 240 "Unmanned_parking_is_suspended" 241 "Press_the_brakes_and_adjust_the_parking_position" 242 "The_rearview_mirror_is_about_to_be_folded" 243 "Unmanned_parking_is_success" 244 "Unmanned_parking_abnormal_sys_exit" ;
VAL_ 347 APS_ReqEPSTgtAng 0 "Valid value" ;
VAL_ 347 APS_ReqCtrlEPS 0 "No request" 1 "Request" ;
VAL_ 347 APS_ReqEPSTgtAngValid 0 "Invalid" 1 "Valid" ;
VAL_ 347 APS_SlotDisp 0 "No parking slot" 1 "Left parallel parking slot" 2 "Left vertical parking slot" 3 "Left T-shape parking slot" 4 "Right parallel parking slot" 5 "Right vertical parking slot" 6 "Right T-shape parking slot" 7 "Reserved" ;
VAL_ 347 APS_SysSoundIndcn 0 "No_sound" 1 "parking_unavailable" 2 "parking_found" 3 "parking_suspend" 4 "parking_start" 5 "HAVP_AVP_ready" 6 "HAVP_AVP_finish" 7 "HAVP_AVP_route_finish" ;
VAL_ 347 Checksum_APS1 0 "Valid Value" ;
VAL_ 347 RollingCounter_APA1 0 "Valid value" 15 "Invalid value" ;
VAL_ 347 APA_BrkFctnMod 0 "None" 1 "APA" 2 "RPA" 3 "AVP" 4 "MEB" 5 "Request_brake_compensation" 6 "Request_hold_brake" ;
VAL_ 347 APA_ApStandstillReq 0 "Flase" 1 "True" ;
VAL_ 347 APA_ApDriveOffReq 0 "Flase" 1 "True" ;
VAL_ 347 APA_ApEmgyBrkReq 0 "Flase" 1 "True" ;
VAL_ 347 APA_AxReqEna 0 "Flase" 1 "True" ;
VAL_ 347 APA_ApbReq 0 "None" 1 "ReleaseReq" 2 "ApplyReq" ;
VAL_ 347 APA_DistoStop 0 "Valid value" ;
VAL_ 347 APA_AxReq 0 "Valid value" 1601 "Reserved" ;
VAL_ 347 Checksum_APA1 0 "Valid value" ;
VAL_ 350 FCTB_State 0 "Initial_value" 1 "OFF" 2 "Standby" 3 "Active" 4 "Passive" 5 "Fault" 6 "Hold" 7 "Reserved" ;
VAL_ 350 FCTA_B_TTC 0 "No Display" 1 "valid value" ;
VAL_ 350 FCTB_ABP_Req 0 "No Request" 1 "Request" ;
VAL_ 350 CR_BrkgReqVal 0 "Valid value" 65535 "Invalid" ;
VAL_ 350 FCTB_ABA_Req 0 "No Request" 1 "Request" ;
VAL_ 350 FCTB_ABA_Level 0 "Level 0" 1 "Level 1" 2 "Level 2" 3 "Level 3" ;
VAL_ 350 FCTBTrig 0 "Not tirggered" 1 "tirggered" ;
VAL_ 350 CR_BrkgReq 0 "No Request" 1 "Request" ;
VAL_ 350 CR_BliSts 0 "No Blindness" 1 "Blindness" ;
VAL_ 350 CR_ErrSts 0 "No Error" 1 "Error" ;
VAL_ 350 FCTA_State 0 "Initial_value" 1 "OFF" 2 "Standby" 3 "Active" 4 "Passive" 5 "Fault" 6 "Reserved" ;
VAL_ 350 FCTA_Warn 0 "No warning" 1 "Warning" ;
VAL_ 350 FCTA_B_FuncSts 0 "No display" 1 "error" 2 "FCTA_B temporarily unavailable" 3 "FCTA_B Performance degradation" ;
VAL_ 350 CR_FCTB_Resp 0 "OFF" 1 "ON" ;
VAL_ 350 CR_FCTA_Resp 0 "OFF" 1 "ON" ;
VAL_ 415 IFC_Line_special02_CurvChange 0 "Valid_value" 960001 "Reversed" ;
VAL_ 415 ACC_RiTgtObjBarDisp_03 0 "No_display" 1 "Distance_1_one_bar" 2 "Distance_2_two_bars" 3 "Distance_3_three_bars" 4 "Distance_4_four_bars" 5 "Resvered" ;
VAL_ 415 TargetPathC0 0 "Valid_value" 6002 "Reversed" ;
VAL_ 415 TargetPathC2 0 "Valid_value" 31251 "Reversed" ;
VAL_ 415 IFC_Roadedge02_Type 0 "undecided" 1 "solid" 2 "dashed" 3 "double solid dashed" 4 "double dashed solid" 5 "double solid solid" 6 "double dashed dashed" 7 "botts" 8 "deceleration" 9 "hov_lane" 10 "road edge" 11 "elevated_structure" 12 "curb" 13 "cones_poles" ;
VAL_ 415 IFC_Roadedge02_CurvChange 0 "valid value" 960001 "reversed" ;
VAL_ 415 IFC_Roadedge02_Curv 0 "valid value" 31251 "reversed" ;
VAL_ 415 IFC_Roadedge02_Dy 0 "valid value" 6002 "reversed" ;
VAL_ 415 IFC_Roadedge01_Type 0 "undecided" 1 "solid" 2 "dashed" 3 "double solid dashed" 4 "double dashed solid" 5 "double solid solid" 6 "double dashed dashed" 7 "botts" 8 "deceleration" 9 "hov_lane" 10 "road edge" 11 "elevated_structure" 12 "curb" 13 "cones_poles" ;
VAL_ 415 IFC_Roadedge01_CurvChange 0 "0xEA601-0xFFFFF reversed" ;
VAL_ 415 IFC_Roadedge01_Curv 0 "valid value" 31251 "reversed" ;
VAL_ 415 IFC_Roadedge01_Dy 0 "valid value" 6002 "reversed" ;
VAL_ 415 IFC_Line04_Type 0 "undecided" 1 "solid" 2 "dashed" 3 "double solid dashed" 4 "double dashed solid" 5 "double solid solid" 6 "double dashed dashed" 7 "botts" 8 "deceleration" 9 "hov_lane" 10 "road edge" 11 "elevated_structure" 12 "curb" 13 "cones_poles" ;
VAL_ 415 IFC_Line04_CurvChange 0 "valid value" 960001 "reversed" ;
VAL_ 415 IFC_Line04_Curv 0 "valid value" 31251 "reversed" ;
VAL_ 415 IFC_Line04_Dy 0 "valid value" 6002 "reversed" ;
VAL_ 415 IFC_Line03_Type 0 "undecided" 1 "solid" 2 "dashed" 3 "double solid dashed" 4 "double dashed solid" 5 "double solid solid" 6 "double dashed dashed" 7 "botts" 8 "deceleration" 9 "hov_lane" 10 "road edge" 11 "elevated_structure" 12 "curb" 13 "cones_poles" ;
VAL_ 415 IFC_Line03_CurvChange 0 "valid value" 960001 "reversed" ;
VAL_ 415 IFC_Line03_Curv 0 "valid value" 31251 "reversed" ;
VAL_ 415 IFC_Line03_Dy 0 "valid value" 6002 "reversed" ;
VAL_ 415 IFC_Line02_Type 0 "undecided" 1 "solid" 2 "dashed" 3 "double solid dashed" 4 "double dashed solid" 5 "double solid solid" 6 "double dashed dashed" 7 "botts" 8 "deceleration" 9 "hov_lane" 10 "road edge" 11 "elevated_structure" 12 "curb" 13 "cones_poles" ;
VAL_ 415 IFC_Line02_CurvChange 0 "Valid value" 960001 "Reversed" ;
VAL_ 415 IFC_Line02_Curv 0 "Valid value" 31251 "Reversed" ;
VAL_ 415 IFC_Line02_Dy 0 "Valid value" 6002 "Reversed" ;
VAL_ 415 IFC_Line01_Type 0 "undecided" 1 "solid" 2 "dashed" 3 "double solid dashed" 4 "double dashed solid" 5 "double solid solid" 6 "double dashed dashed" 7 "botts" 8 "deceleration" 9 "hov_lane" 10 "road edge" 11 "elevated_structure" 12 "curb" 13 "cones_poles" ;
VAL_ 415 IFC_Line01_CurvChange 0 "Valid value" 960001 "Reversed" ;
VAL_ 415 IFC_Line01_Curv 0 "Valid value" 31251 "Reversed" ;
VAL_ 415 IFC_Line01_Dy 0 "Valid value" 6002 "Reversed" ;
VAL_ 546 RollingCounter_IFC_HCM9 0 "Valid_value" 15 "Invalid_value" ;
VAL_ 546 IFC_Line_special02_DxEnd 0 "Valid_value" 20002 "Reversed" ;
VAL_ 546 IFC_Line_special02_DxStart 0 "Valid_value" 20002 "Reversed" ;
VAL_ 546 TargetPositionDx 0 "Valid_value" 501 "Reserved" ;
VAL_ 546 CameraSts 0 "Not_Available_for_ADB" 1 "Available_for_ADB" 2 "Camera_Fault" 3 "reserved" ;
VAL_ 546 TrafficStyle 0 "Unknow" 1 "RightHandTraffic" 2 "LeftHandTraffic" 3 "Not_available" ;
VAL_ 546 RoadIllumDetd 0 "Road_illumination_Not_detected" 1 "Road_illumination_detected" ;
VAL_ 546 AmbLight 0 "Not_Active_for_HighBeam" 1 "Active_for_HighBeam" ;
VAL_ 546 Checksum_IFC_HCM9 0 "Valid_values" ;
VAL_ 546 RollingCounter_IFC_HCM8 0 "Valid_value" 15 "Invalid_value" ;
VAL_ 546 Spots8VehObjClassn 0 "No_Vehicle" 1 "Car" 2 "Truck" 3 "Bus" 4 "BikeOrMotoBike" 5 "Pedestrain" 6 "Mixed" 7 "Unknow" ;
VAL_ 546 Spots8TrackingInfo 0 "Not_Tracking" 1 "Tracking" ;
VAL_ 546 Spot8VertAng 0 "Valid_Values" ;
VAL_ 546 Spots8HozLeAngSpd 0 "Valid_Values" ;
VAL_ 546 Spots8Distance 0 "valid_value" 511 "NotAvailable" ;
VAL_ 546 Spots8Typ 0 "Unknown" 1 "Oncoming_object" 2 "Preceding_object" 3 "Reflective_object" ;
VAL_ 546 Spots8Valid 0 "Invalid" 1 "Valid" ;
VAL_ 546 Spots8HozlPosnRiAng 0 "valid_value" 1001 "Reserved" 1023 "NotAvailable" ;
VAL_ 546 Spots8HozlPosnLeAng 0 "valid_value" 1001 "Reserved" 1023 "NotAvailable" ;
VAL_ 546 Checksum_IFC_HCM8 0 "Valid_values" ;
VAL_ 546 IFC_Roadedge02_HeadingAngle 0 "valid value" 402 "reversed" ;
VAL_ 546 IFC_Roadedge02_DxEnd 0 "valid value" 20002 "reversed" ;
VAL_ 546 IFC_Roadedge02_DxStart 0 "valid value" 20002 "reversed" ;
VAL_ 546 IFC_Roadedge01_HeadingAngle 0 "valid value" 402 "reversed" ;
VAL_ 546 IFC_Roadedge01_DxEnd 0 "valid value" 20002 "reversed" ;
VAL_ 546 IFC_Roadedge01_DxStart 0 "valid value" 20002 "reversed" ;
VAL_ 546 IFC_Line04_DxEnd 0 "valid value" 20002 "reversed" ;
VAL_ 546 IFC_Line04_HeadingAngle 0 "valid value" 402 "reversed" ;
VAL_ 546 IFC_Line04_DxStart 0 "valid value" 20002 "reversed" ;
VAL_ 546 IFC_Line03_HeadingAngle 0 "valid value" 402 "reversed" ;
VAL_ 546 IFC_Line03_DxEnd 0 "valid value" 20002 "reversed" ;
VAL_ 546 IFC_Line03_DxStart 0 "valid value" 20002 "reversed" ;
VAL_ 546 IFC_Line02_DxEnd 0 "valid value" 20002 "reversed" ;
VAL_ 546 IFC_Line02_DxStart 0 "valid value" 20002 "reversed" ;
VAL_ 546 IFC_Line02_HeadingAngle 0 "valid value" 402 "reversed" ;
VAL_ 546 IFC_Line01_HeadingAngle 0 "valid value" 402 "reversed" ;
VAL_ 546 IFC_Line01_DxEnd 0 "valid value" 20002 "reversed" ;
VAL_ 546 IFC_Line01_DxStart 0 "valid value" 20002 "reversed" ;
VAL_ 551 MOD_SwtResp 0 "Initial_value" 1 "OFF" 2 "ON" 3 "Resvered" ;
VAL_ 551 MOD_DispSts 0 "Initial_value" 1 "OFF" 2 "Passive" 3 "Standby" 4 "Active" 5 "Override" 6 "Slow_retreat" 7 "Standstill" 8 "Inhibit" 9 "Reserved" 15 "Fail" ;
VAL_ 551 MOD_Text_Lib 0 "No_display" 1 "Drawing_fail_due_bad_weather" 2 "Drawing_fail_due_path_many" 3 "Drawing_fail_due_system_fail" 4 "Start_to_learn_Drawing" 5 "Speed_quick" 6 "Drawing_stop_due_path_short" 7 "Please_finish_due_Too_long_path" 8 "Autosave_due_to_Too_long_path" 9 "Drawing_stop" 10 "Drawing_quit" 11 "Drawing_fail" 12 "Drawing_fail_due_path_repetition" 13 "Drawing_succeed" 14 "Drawing_fail_due_too_fast" 15 "Drawing_fail_due_gps_fail" 16 "Drawing_fail_due_front_camera_occlusion" 17 "Drawing_fail_due_surround_camera_occlusion" 18 "Drawing_fail_due_rear_camera_occlusion" 19 "Drawing_fail_due_door_open" 20 "Drawing_fail_due_engine_roomcover" 21 "Drawing_fail_due_trunk" 22 "Drawing_fail_due_associated_system_fail" 23 "Autosave" 24 "Autosave_due_too_fast" 25 "Autosave_due_gps_fail" 26 "Autosave_due_front_camera_occlusion" 27 "Autosave_due_surround_camera_occlusion" 28 "Autosave_due_rear_camera_occlusion" 29 "Autosave_due_door_open" 30 "Autosave_due_engine_roomcover" 31 "Autosave_due_trunk_open" ;
VAL_ 551 MOD_InterSysInfoDisp 0 "No_display" 1 "MOD_APP_no_start" 2 "NOactiva_MOD_due_to_Inhibition" 3 "Location_fail" 4 "Positioning" 5 "MOD_active_control_is_cancelled" 6 "MOD_is_active" 7 "Please_note_the_directions" 8 "MOD_is_available" 9 "Please_help_me" 10 "MOD_to_be_deactivated" 11 "MOD resumed" 12 "Off_route" 13 "Autosave_due_system_fail" 14 "Autosave_due_associated_system_fail" 15 "Drawing_fail_due_amap_lose" 16 "Autosave_due_amap_lose" 17 "Drawing_fail_due_mirror_fold" 18 "Drawing_fail_due_seatbelt_open" 19 "Autosave_due_mirror_fold" 20 "Autosave_due_seatbelt_open" ;
VAL_ 551 RollingCounter_AEB5 15 "Invalid_value" ;
VAL_ 551 AEBObjDyActvSafety 0 "Initial_Value" ;
VAL_ 551 AEBObjDxActvSafety 0 "Initial_Value" ;
VAL_ 551 AEBObjVxActvSafety 0 "Initial_Value" ;
VAL_ 551 TimeToCllsnActvSafety 0 "Initial_Value" ;
VAL_ 551 AEBTgtDecelReqActvSafety 0 "No_Request" 1 "Request" ;
VAL_ 551 ADAS_ErrStsActvSafety 0 "Initial_Value" 1 "System_Initializing" 2 "No_error" 3 "Blindness" 4 "Misalignment" 5 "Failure" ;
VAL_ 551 AEBObjStyActvSafety 0 "Initial_Value" 1 "Unknow" 2 "Sedan" 3 "Truck" 4 "Motorcycle" 5 "Pedestrian" 6 "Bicycle" ;
VAL_ 551 FeatPt_Dx 0 "Validvalue0_150m" 301 "Reserved" ;
VAL_ 551 ACC_RiTgt_03_Heading 0 "Valid_value" 976 "Reserved" ;
VAL_ 551 ACC_RiTgt_03_fusion 0 "No_fusion" 1 "Fusion" ;
VAL_ 551 ACC_RiTgt_03_Typ 0 "Unkown" 1 "Sedan" 2 "Truck" 3 "Motorcycle" 4 "Pedestrian" 5 "Bicycle" 6 "Traffic_cone" 7 "Obstacle" ;
VAL_ 551 ACC_RiTgt_03_Dx 0 "Valid_value" 6416 "Reserved" ;
VAL_ 551 ACC_RiTgt_03_Dy 0 "Valid_value" 2576 "Reserved" ;
VAL_ 551 ACC_RiTargrt_03_Detn 0 "Not_dectected" 1 "Dectected" 2 "Reserved" 3 "Invalid" ;
VAL_ 551 ACC_LeTgt_03_Heading 0 "valid_value" 976 "Reserved" ;
VAL_ 551 ACC_LeTgt_03_fusion 0 "No_fusion" 1 "Fusion" ;
VAL_ 551 ACC_LeTgt_03_Typ 0 "Unkown" 1 "Sedan" 2 "Truck" 3 "Motorcycle" 4 "Pedestrian" 5 "Bicycle" 6 "Traffic_cone" 7 "Obstacle" ;
VAL_ 551 ACC_LeTgt_03_Dy 0 "Valid_value" 2576 "Reserved" ;
VAL_ 551 ACC_LeTargrt_03_Detn 0 "Not_dectected" 1 "Dectected" 2 "Reserved" 3 "Invalid" ;
VAL_ 551 ACC_PotentialTgt_02_Heading 0 "Valid_value" 976 "Reserved" ;
VAL_ 551 ACC_LeTgt_03_Dx 0 "Valid_value" 6416 "Reserved" ;
VAL_ 551 ACC_PotentialTgt_02_fusion 0 "No_fusion" 1 "Fusion" ;
VAL_ 551 ACC_PotentialTgt_02_Typ 0 "Unkown" 1 "Sedan" 2 "Truck" 3 "Motorcycle" 4 "Pedestrian" 5 "Bicycle" 6 "Traffic_cone" 7 "Obstacle" ;
VAL_ 551 ACC_PotentialTgt_02_Detn 0 "Not_dectected" 1 "Dectected" 2 "Reserved" 3 "Invalid" ;
VAL_ 551 ACC_PotentialTgt_02_Dx 0 "Valid_value" 301 "Reserved" ;
VAL_ 551 ACC_PotentialTgt_02_Dy 0 "Valid_value" 161 "Reserved" ;
VAL_ 551 RiRoad_Mark_Length 0 "Valid_value" 101 "Reserved" ;
VAL_ 551 RiRoad_Mark_Width 0 "Valid_value" 41 "Reserved" ;
VAL_ 551 LeRoad_Mark_Length 0 "Valid_value" 101 "Reserved" ;
VAL_ 551 AEB_JABrkTrig 0 "Not tirggered" 1 "AEB_JA Function Triggered for vehicle" 2 "AEB_JA Function Triggered for pedestrian" 3 "reverse" ;
VAL_ 551 AEB_JA_Warn 0 "No warning" 1 "Warning  for vehicle" 2 "Warning for pedestrian" 3 "reverse" ;
VAL_ 551 AEB_JAFuncSts 0 "No display" 1 "error" 2 "FCW/AEB_JA temporarily unavailable" 3 "FCW/AEB_JA Performance degradation" ;
VAL_ 551 FCW_Warn 0 "No warning" 1 "Latent warning" 2 "warning Level 1" 3 "warning Level 2" ;
VAL_ 551 FCW_AEB_PedFctSts 0 "No display" 1 "error" 2 "FCW/AEB_P temporarily unavailable" 3 "FCW/AEB_P Performance degradation" ;
VAL_ 551 FCW_AEB_VehFctSts 0 "No display" 1 "error" 2 "FCW/AEB_V temporarily unavailable" 3 "FCW/AEB_V Performance degradation" ;
VAL_ 551 AEB_PedTrig 0 "not tirggered" 1 "triggered" ;
VAL_ 551 AEB_VehTrig 0 "not tirggered" 1 "triggered" ;
VAL_ 551 IntellgntAsscLmpReq 0 "Initial_value" 1 "Off" 2 "Breathe" 3 "Always_Bright" ;
VAL_ 551 LeRoad_Mark_Width 0 "Valid_value" 41 "Reserved" ;
VAL_ 551 Road_Mark_Length 0 "Valid_value" 101 "Reserved" ;
VAL_ 551 Road_Mark_Width 0 "Valid_value" 41 "Reserved" ;
VAL_ 551 TargetPositionDy 0 "Valid_value" 6002 "Reversed" ;
VAL_ 551 UNP_SwtResp 0 "OFF" 1 "ON" ;
VAL_ 551 IntellgntcurveResp 0 "OFF" 1 "ON" ;
VAL_ 551 AEB_JA_Resp 0 "OFF" 1 "ON" ;
VAL_ 551 FCW_Snvty 0 "Normal" 1 "High sensitivity" 2 "Low sensitivity" 3 "Reserved" ;
VAL_ 551 AEB_VehResp 0 "OFF" 1 "ON" ;
VAL_ 551 AEB_PedResp 0 "OFF" 1 "ON" ;
VAL_ 551 FeatPt_Dy 0 "Validvalue_8_8m" 161 "Reserved" ;
VAL_ 551 TargetPathC3 0 "Valid_value" 960001 "Reversed" ;
VAL_ 551 IFC_Line_special02_Dy 0 "Valid_value" 6002 "Reversed" ;
VAL_ 628 SlopViewFuncReq 0 "Initial_Value" 1 "OFF" 2 "ON" ;
VAL_ 628 SlopViewSts 0 "Initial_Value" 1 "OFF" 2 "ON" ;
VAL_ 628 AutoAVMmodSts 0 "Initial_Value" 1 "Half_screen" 2 "Full_screen" ;
VAL_ 628 WheWarning 0 "No_warning" 1 "Left_front_warning" 2 "Left_rear_waring" 3 "Right_front_waring" 4 "Right_rear_waring" 5 "Front_warning" 6 "Rear_warning" 7 "Left_warning" 8 "Right_waring" 9 "Front left _rear right_warning" 10 "Left rear_front right_warning" 11 "Excluding_right rear _warning" 12 "Excluding_right front_warning" 13 "Excluding_left front_warning" 14 "Excluding_left rear_warning" 15 "All_warning" ;
VAL_ 628 ParkSlotDispR3 0 "No_valid" 1 "Valid" ;
VAL_ 628 ParkSlotDispR2 0 "No_valid" 1 "Valid" ;
VAL_ 628 ParkSlotDispR1 0 "No_valid" 1 "Valid" ;
VAL_ 628 ParkSlotDispL3 0 "No_valid" 1 "Valid" ;
VAL_ 628 ParkSlotDispL2 0 "No_valid" 1 "Valid" ;
VAL_ 628 ParkSlotDispL1 0 "No_valid" 1 "Valid" ;
VAL_ 628 HAP_Hmi_Index 0 "Reserved" 1 "Main Screen" 2 "EOL/Test" 3 "P2P Screen" 4 "Assist Screen" 5 "HAVP Screen" 6 "PAVP Screen" 7 "RADS_Screen" 8 "FADS_Screen" 9 "Reserved" ;
VAL_ 628 DVRWorkSts 0 "DVR_Standby" 1 "DVR_Active" 2 "DVR_InterFailed" 3 "DVR_NetFailed" ;
VAL_ 628 HAP_DispCmd 0 "OFF" 1 "ON" ;
VAL_ 628 AVM_3DAngSts 0 "Not_Active" 1 "Valid_values" 511 "Invalid" ;
VAL_ 628 OvlOpFailSts 0 "no failure" 1 "failure" ;
VAL_ 628 TraOvlSts 0 "OFF" 1 "ON" ;
VAL_ 628 EolNotCmpltd 0 "Ccompleted" 1 "No completed" ;
VAL_ 628 FrntCamInpFailSts 0 "no failure" 1 "failure" ;
VAL_ 628 RearCamInpFailSts 0 "no failure" 1 "failure" ;
VAL_ 628 LeCamInpFailSts 0 "no failure" 1 "failure" ;
VAL_ 628 RiCamInpFailSts 0 "no failure" 1 "failure" ;
VAL_ 628 CurrCalResultSts 0 "Use Factory Calibration Result" 1 "Use Lane Calibration Result" ;
VAL_ 628 LaneCalFltSts 0 "No fault" 1 "Front view Calibration abnormal" 2 "Rear view Calibration abnormal" 3 "left view Calibration abnormal" 4 "Right view Calibration abnormal" 5 "Calibration data storage failed" 6 "Reserved" ;
VAL_ 628 LaneCalSts 0 "No Commands" 1 "In Calibration process" 2 "Calibration success" 3 "Calibration failure" ;
VAL_ 628 CarMdlTrsprcySts 0 "Opaque" 1 "Translucent" 2 "Completely transparent" 3 "Failure" ;
VAL_ 628 MdlColrSts 0 "Silvery" 1 "Red" 2 "Gray" 3 "White" 4 "Black" 5 "Brown" 6 "Blue" 7 "Orange" 8 "Green" 9 "Gold" 10 "Purple" 11 "Reserved" ;
VAL_ 628 RadarDispSts 0 "Both Around View and Single View Radar Display" 1 "Only Around View Radar Display" 2 "Only Single View Radar Display" 3 "No Radar Display" ;
VAL_ 628 GuidOvlSts 0 "Around View and Single View" 1 "Only Around View" 2 "Only Single View" 3 "No Guidance" ;
VAL_ 628 WheelVieSts 0 "Initial_value" 1 "Two_wheel_mode" 2 "Four_wheel_mode" 3 "Reversed" ;
VAL_ 628 AutoAVMSwtSet_Sts 0 "Off" 1 "ON" ;
VAL_ 628 AutoViewChgFuncSts 0 "Off" 1 "ON" ;
VAL_ 628 CarMdlDispSts 0 "2D mode" 1 "3D mode" ;
VAL_ 628 MOD_AlarmSts 0 "OFF" 1 "ON" ;
VAL_ 628 MOD_WorkSts 0 "OFF" 1 "ON" ;
VAL_ 628 SigViewIndcn 0 "No Commands" 1 "Front to Center View" 2 "Rear to Center View" 3 "Left to Center View" 4 "Right to Center View" 5 "Left Front to Center View" 6 "Right Front to Center View" 7 "Left Rear to Center View" 8 "Right Rear to Center View" 9 "Front View" 10 "Rear View" 11 "Left View" 12 "Right View" 13 "Left Turn 3D View" 14 "Right Turn 3D View" 15 "Front Overlook View" 16 "Rear Overlook View" 17 "Front 180 Deg View" 18 "Rear 180 Deg View" 19 "Front Wheel View" 20 "Rear Wheel View" 21 "Front Wash View" 22 "Rear Wash View" 23 "Free_3D View" 24 "LeftRight View" 25 "Engine Room View" 26 "CCO View" 27 "Wireless_Charging_View" 28 "Wheel_Warning_View" 29 "Vertical_View" 30 "Rear_Single_View" 31 "Front_Single_View" 32 "Reserved" 63 "3D Car Model Round View" ;
VAL_ 628 AVM_CurrSts 0 "OFF" 1 "ON" 2 "AVM no video（雷达模式）" 3 "Initialling" ;
VAL_ 664 RiCamDirtySts 0 "Normal" 1 "Abnormal" ;
VAL_ 664 LeCamDirtySts 0 "Normal" 1 "Abnormal" ;
VAL_ 664 RearCamDirtySts 0 "Normal" 1 "Abnormal" ;
VAL_ 664 FrntCamDirtySts 0 "Normal" 1 "Abnormal" ;
VAL_ 664 DVRCamDirtySts 0 "Normal" 1 "Abnormal" ;
VAL_ 664 SteerWheelsilentSts 0 "Initial_value" 1 "OFF" 2 "ON" ;
VAL_ 664 VLAPSpdSetVal 0 "Initial_value" 1 "Vaild value" ;
VAL_ 664 UssEPSLrngSts 0 "Initial_value" 1 "No_Display" 2 "EPS_Learning" ;
VAL_ 664 PrkgFuncStsLmp 0 "Initial_value" 1 "VLAP_Passive" 2 "VLAP_Roaming_Standby" 3 "VLAP_Crusing_Standby" 4 "VLAP_Roaming_Active" 5 "VLAP_Crusing_Active" 6 "VLAP_Crusing_Override" 7 "HAVP_Standby" 8 "HAVP_Active" 9 "HAVP_Override" 10 "APA_Standby" 11 "APA_Active" 12 "RADS_Standby" 13 "RADS_Active" ;
VAL_ 664 AVPworkSts 0 "Initial_Value" 1 "Idle" 2 "Checking" 3 "Standby" 4 "Routing" 5 "Routing_pass" 6 "APA_OUT" 7 "Cruising" 8 "APA_IN" 9 "Suspend" 10 "Fault" ;
VAL_ 664 ShldKeyDoorHndlReqVld 0 "Invalid" 1 "Valid" ;
VAL_ 664 ShldKeyDoorHndlReq 0 "Initial_Value" 1 "Shield_key_and_door_handle_operation" ;
VAL_ 664 OneclickClsIntellgntDrvgSts 0 "Initial_value" 1 "OFF" 2 "ON" ;
VAL_ 664 RmtPrkRadShieldSts 0 "No_shielding" 1 "Bilateral_ultrasonic_radar_shielding" 2 "All_ultrasonic_radar_shielding" 3 "Reserved" ;
VAL_ 664 APS_Coordinate_Y 0 "Valid value" 2001 "Invalid value" ;
VAL_ 664 APS_Coordinate_X 0 "Valid value" 501 "Invalid value" ;
VAL_ 664 APS_Coordinate_Angle 0 "Valid value" 360 "Invalid value" ;
VAL_ 664 RmtPrkgSts 0 "No action" 1 "In processing" ;
VAL_ 664 RmtPrkgFinishReq 0 "No Request" 1 "Park in finish" 2 "Park out finish" 3 "Park error exit" ;
VAL_ 664 OrvmCtrlCmd 0 "NO request" 1 "Request to Fold" 2 "Request to Unfold" 3 "Reserved" ;
VAL_ 664 HAP_TextIconDispCtrl 0 "No display" 1 "Display according to text info" 2 "Display parking mode" 3 "Reserved" ;
VAL_ 664 APA_MenuDispCtrlCmd 0 "No_Disp_avm_menu" 1 "park_in_indicate_menu" 2 "park_in_select_slot_menu" 3 "park_in_mode_select_menu" 4 "park_in_process" 5 "remote_park_in_process" 6 "park_out_confirm_menu" 7 "park_out_process" 8 "park_in_indicate_menu_NoRPA" 9 "park_in_select_slot_menu_NoRPA" 10 "park_in_mode_select_menu_NoRPA" 11 "park_out _indicate_menu" 12 "User_Defined_Parking_Slot_Menu" 13 "park_in_RemoteSearchingSlot_menu" 14 "PAVP_screen_section_A" 15 "Reversed" ;
VAL_ 664 FADS_FuncSts 0 "FADS Function standby" 1 "FADS Function active" 2 "FADS Function disable" 3 "FADS Coming soon" ;
VAL_ 664 RADS_FuncSts 0 "Reverse Asist Function standby" 1 "Reverse Asist Function active" 2 "Reverse Asist Function disable" 3 "RADS Coming soon" ;
VAL_ 664 APA_FuncSts 0 "APA Function standby" 1 "APA Function active" 2 "APA Function disable" 3 "APA Coming soon" ;
VAL_ 664 FPAS_NearBrrdstn 0 "Valid value" 101 "Reserved" 127 "No Display" ;
VAL_ 664 ModifInquiPopReq 0 "Initial_value" 1 "No_display" 2 "Modification_Inquiry" ;
VAL_ 664 FPAS_SoundIndcn 0 "Tone zero  No warning" 1 "Tone one  Long beep" 2 "Tone two 1.5 Hz" 3 "Tone three 3Hz" ;
VAL_ 664 FPAS_AutoModSts 0 "Not available" 1 "available" ;
VAL_ 664 FPAS_DispCmd 0 "OFF" 1 "ON" ;
VAL_ 664 FPAS_WorkSts 0 "Disable" 1 "Enable" 2 "Active" 3 "Failed" ;
VAL_ 664 FPAS_FRCornrSnsrFailSts 0 "no failure" 1 "failure" ;
VAL_ 664 FPAS_FRMiddlSnsrFailSts 0 "no failure" 1 "failure" ;
VAL_ 664 FPAS_FLMiddlSnsrFailSts 0 "no failure" 1 "failure" ;
VAL_ 664 FPAS_FLCornrSnsrFailSts 0 "no failure" 1 "failure" ;
VAL_ 664 FPAS_ObjFRCornrAr2 0 "No object" 1 "Object in zone 1, 0~10cm" 2 "Object in zone 2, 11~20cm" 3 "Object in zone 3, 21~30cm" 4 "Object in zone 4, 31~40cm" 5 "Object in zone 5, 41~50cm" 6 "Object in zone 6, 51~60cm" 7 "Reserved" ;
VAL_ 664 FPAS_ObjFRCornrAr1 0 "No object" 1 "Object in zone 1, 0~10cm" 2 "Object in zone 2, 11~20cm" 3 "Object in zone 3, 21~30cm" 4 "Object in zone 4, 31~40cm" 5 "Object in zone 5, 41~50cm" 6 "Object in zone 6, 51~60cm" 7 "Reserved" ;
VAL_ 664 FPAS_ObjFRMidlAr2 0 "No object" 1 "Object in zone 1, 0~10cm" 2 "Object in zone 2, 11~20cm" 3 "Object in zone 3, 21~30cm" 4 "Object in zone 4, 31~40cm" 5 "Object in zone 5, 41~50cm" 6 "Object in zone 6, 51~60cm" 7 "Object in zone 7, 61~70cm" 8 "Object in zone 8, 71~80cm" 9 "Object in zone 9, 81~90cm" 10 "Object in zone 10, 91~100cm" 11 "Reserved" ;
VAL_ 664 FPAS_ObjFRMidlAr1 0 "No object" 1 "Object in zone 1, 0~10cm" 2 "Object in zone 2, 11~20cm" 3 "Object in zone 3, 21~30cm" 4 "Object in zone 4, 31~40cm" 5 "Object in zone 5, 41~50cm" 6 "Object in zone 6, 51~60cm" 7 "Object in zone 7, 61~70cm" 8 "Object in zone 8, 71~80cm" 9 "Object in zone 9, 81~90cm" 10 "Object in zone 10, 91~100cm" 11 "Reserved" ;
VAL_ 664 FPAS_ObjFLMidlAr2 0 "No object" 1 "Object in zone 1, 0~10cm" 2 "Object in zone 2, 11~20cm" 3 "Object in zone 3, 21~30cm" 4 "Object in zone 4, 31~40cm" 5 "Object in zone 5, 41~50cm" 6 "Object in zone 6, 51~60cm" 7 "Object in zone 7, 61~70cm" 8 "Object in zone 8, 71~80cm" 9 "Object in zone 9, 81~90cm" 10 "Object in zone 10, 91~100cm" 11 "Reserved" ;
VAL_ 664 FPAS_ObjFLMidlAr1 0 "No object" 1 "Object in zone 1, 0~10cm" 2 "Object in zone 2, 11~20cm" 3 "Object in zone 3, 21~30cm" 4 "Object in zone 4, 31~40cm" 5 "Object in zone 5, 41~50cm" 6 "Object in zone 6, 51~60cm" 7 "Object in zone 7, 61~70cm" 8 "Object in zone 8, 71~80cm" 9 "Object in zone 9, 81~90cm" 10 "Object in zone 10, 91~100cm" 11 "Reserved" ;
VAL_ 664 FPAS_ObjFLCornrAr2 0 "No object" 1 "Object in zone 1, 0~10cm" 2 "Object in zone 2, 11~20cm" 3 "Object in zone 3, 21~30cm" 4 "Object in zone 4, 31~40cm" 5 "Object in zone 5, 41~50cm" 6 "Object in zone 6, 51~60cm" 7 "Reserved" ;
VAL_ 664 FPAS_ObjFLCornrAr1 0 "No object" 1 "Object in zone 1, 0~10cm" 2 "Object in zone 2, 11~20cm" 3 "Object in zone 3, 21~30cm" 4 "Object in zone 4, 31~40cm" 5 "Object in zone 5, 41~50cm" 6 "Object in zone 6, 51~60cm" 7 "Reserved" ;
VAL_ 664 RCTA_DispSwtSts 0 "OFF" 1 "ON" ;
VAL_ 664 AutoPrkOutSwtSts 0 "OFF" 1 "ON" ;
VAL_ 664 MEB_EnableSts 0 "Disable" 1 "Enable" ;
VAL_ 664 MEBWorkSts 0 "Off" 1 "Enable" 2 "Active" 3 "Failed" ;
VAL_ 664 RPAS_SoundIndcn 0 "Tone zero No warning" 1 "Tone one  Long beep" 2 "Tone two 1.5 Hz" 3 "Tone three  3Hz" ;
VAL_ 664 CamFolwSwtSts 0 "OFF" 1 "ON" ;
VAL_ 664 APA_BacgrdWorkSts 0 "Not_active" 1 "Active" ;
VAL_ 664 RPAS_WorkSts 0 "Disable" 1 "Enable" 2 "Active" 3 "Failed" ;
VAL_ 664 RPAS_RRCornrSnsrFailSts 0 "no failure" 1 "failure" ;
VAL_ 664 RPAS_RRMiddlSnsrFailSts 0 "no failure" 1 "failure" ;
VAL_ 664 RPAS_RLMiddlSnsrFailSts 0 "no failure" 1 "failure" ;
VAL_ 664 RPAS_RLCornrSnsrFailSts 0 "no failure" 1 "failure" ;
VAL_ 664 RPAS_ObjRLCornrAr2 0 "No object" 1 "Object in zone 1, 0~10cm" 2 "Object in zone 2, 11~20cm" 3 "Object in zone 3, 21~30cm" 4 "Object in zone 4, 31~40cm" 5 "Object in zone 5, 41~50cm" 6 "Object in zone 6, 51~60cm" 7 "Object in zone 7, 61~70cm" 8 "Object in zone 8, 71~80cm" 9 "Object in zone 9, 81~90cm" 10 "Object in zone 10, 91~100cm" 11 "Object in zone 11, 101~110cm" 12 "Object in zone 12, 111~120cm" 13 "Reserved" ;
VAL_ 664 RPAS_ObjRLCornrAr1 0 "No object" 1 "Object in zone 1, 0~10cm" 2 "Object in zone 2, 11~20cm" 3 "Object in zone 3, 21~30cm" 4 "Object in zone 4, 31~40cm" 5 "Object in zone 5, 41~50cm" 6 "Object in zone 6, 51~60cm" 7 "Object in zone 7, 61~70cm" 8 "Object in zone 8, 71~80cm" 9 "Object in zone 9, 81~90cm" 10 "Object in zone 10, 91~100cm" 11 "Object in zone 11, 101~110cm" 12 "Object in zone 12, 111~120cm" 13 "Reserved" ;
VAL_ 664 RPAS_ObjRLMidlAr2 0 "No object" 1 "Object in zone 1, 0~10cm" 2 "Object in zone 2, 11~20cm" 3 "Object in zone 3, 21~30cm" 4 "Object in zone 4, 31~40cm" 5 "Object in zone 5, 41~50cm" 6 "Object in zone 6, 51~60cm" 7 "Object in zone 7, 61~70cm" 8 "Object in zone 8, 71~80cm" 9 "Object in zone 9, 81~90cm" 10 "Object in zone 10, 91~100cm" 11 "Object in zone 11, 101~110cm" 12 "Object in zone 12, 111~120cm" 13 "Object in zone 13, 121~130cm" 14 "Object in zone 14, 131~140cm" 15 "Object in zone 15, 141~150cm" ;
VAL_ 664 RPAS_ObjRLMidlAr1 0 "No object" 1 "Object in zone 1, 0~10cm" 2 "Object in zone 2, 11~20cm" 3 "Object in zone 3, 21~30cm" 4 "Object in zone 4, 31~40cm" 5 "Object in zone 5, 41~50cm" 6 "Object in zone 6, 51~60cm" 7 "Object in zone 7, 61~70cm" 8 "Object in zone 8, 71~80cm" 9 "Object in zone 9, 81~90cm" 10 "Object in zone 10, 91~100cm" 11 "Object in zone 11, 101~110cm" 12 "Object in zone 12, 111~120cm" 13 "Object in zone 13, 121~130cm" 14 "Object in zone 14, 131~140cm" 15 "Object in zone 15, 141~150cm" ;
VAL_ 664 RPAS_ObjRRMidlAr2 0 "No object" 1 "Object in zone 1, 0~10cm" 2 "Object in zone 2, 11~20cm" 3 "Object in zone 3, 21~30cm" 4 "Object in zone 4, 31~40cm" 5 "Object in zone 5, 41~50cm" 6 "Object in zone 6, 51~60cm" 7 "Object in zone 7, 61~70cm" 8 "Object in zone 8, 71~80cm" 9 "Object in zone 9, 81~90cm" 10 "Object in zone 10, 91~100cm" 11 "Object in zone 11, 101~110cm" 12 "Object in zone 12, 111~120cm" 13 "Object in zone 13, 121~130cm" 14 "Object in zone 14, 131~140cm" 15 "Object in zone 15, 141~150cm" ;
VAL_ 664 RPAS_ObjRRMidlAr1 0 "No object" 1 "Object in zone 1, 0~10cm" 2 "Object in zone 2, 11~20cm" 3 "Object in zone 3, 21~30cm" 4 "Object in zone 4, 31~40cm" 5 "Object in zone 5, 41~50cm" 6 "Object in zone 6, 51~60cm" 7 "Object in zone 7, 61~70cm" 8 "Object in zone 8, 71~80cm" 9 "Object in zone 9, 81~90cm" 10 "Object in zone 10, 91~100cm" 11 "Object in zone 11, 101~110cm" 12 "Object in zone 12, 111~120cm" 13 "Object in zone 13, 121~130cm" 14 "Object in zone 14, 131~140cm" 15 "Object in zone 15, 141~150cm" ;
VAL_ 664 RPAS_ObjRRCornrAr2 0 "No object" 1 "Object in zone 1, 0~10cm" 2 "Object in zone 2, 11~20cm" 3 "Object in zone 3, 21~30cm" 4 "Object in zone 4, 31~40cm" 5 "Object in zone 5, 41~50cm" 6 "Object in zone 6, 51~60cm" 7 "Object in zone 7, 61~70cm" 8 "Object in zone 8, 71~80cm" 9 "Object in zone 9, 81~90cm" 10 "Object in zone 10, 91~100cm" 11 "Object in zone 11, 101~110cm" 12 "Object in zone 12, 111~120cm" 13 "Reserved" ;
VAL_ 664 RPAS_ObjRRCornrAr1 0 "No object" 1 "Object in zone 1, 0~10cm" 2 "Object in zone 2, 11~20cm" 3 "Object in zone 3, 21~30cm" 4 "Object in zone 4, 31~40cm" 5 "Object in zone 5, 41~50cm" 6 "Object in zone 6, 51~60cm" 7 "Object in zone 7, 61~70cm" 8 "Object in zone 8, 71~80cm" 9 "Object in zone 9, 81~90cm" 10 "Object in zone 10, 91~100cm" 11 "Object in zone 11, 101~110cm" 12 "Object in zone 12, 111~120cm" 13 "Reserved" ;
VAL_ 664 OneclickClsIntellgntDrvgTextDisp 0 "Initial_value" 1 "ADAS_forbidden" 2 "Parking_forbidden" ;
VAL_ 664 SDWActiveSts 0 "Not active" 1 "Active" ;
VAL_ 664 SDW_SoundIndcn 0 "Tone 0 - No warning" 1 "Tone 1 - Long beep" 2 "Tone 2 - 1.5 Hz" 3 "Tone 3 - 3Hz" ;
VAL_ 664 APS_RLSideSnsrFailSts 0 "no failure" 1 "failure" ;
VAL_ 664 APS_RRSideSnsrFailSts 0 "no failure" 1 "failure" ;
VAL_ 664 APS_FLSideSnsrFailSts 0 "no failure" 1 "failure" ;
VAL_ 664 APS_FRSideSnsrFailSts 0 "no failure" 1 "failure" ;
VAL_ 664 APS_ObjLeSideAr5 0 "No object" 1 "Object in zone 1, 0~10cm" 2 "Object in zone 2, 11~20cm" 3 "Object in zone 3, 21~30cm" 4 "Object in zone 4, 31~40cm" 5 "Object in zone 5, 41~50cm" 6 "Object in zone 6, 51~60cm" 7 "Reserved" ;
VAL_ 664 APS_ObjLeSideAr4 0 "No object" 1 "Object in zone 1, 0~10cm" 2 "Object in zone 2, 11~20cm" 3 "Object in zone 3, 21~30cm" 4 "Object in zone 4, 31~40cm" 5 "Object in zone 5, 41~50cm" 6 "Object in zone 6, 51~60cm" 7 "Reserved" ;
VAL_ 664 APS_ObjLeSideAr3 0 "No object" 1 "Object in zone 1, 0~10cm" 2 "Object in zone 2, 11~20cm" 3 "Object in zone 3, 21~30cm" 4 "Object in zone 4, 31~40cm" 5 "Object in zone 5, 41~50cm" 6 "Object in zone 6, 51~60cm" 7 "Reserved" ;
VAL_ 664 APS_ObjLeSideAr2 0 "No object" 1 "Object in zone 1, 0~10cm" 2 "Object in zone 2, 11~20cm" 3 "Object in zone 3, 21~30cm" 4 "Object in zone 4, 31~40cm" 5 "Object in zone 5, 41~50cm" 6 "Object in zone 6, 51~60cm" 7 "Reserved" ;
VAL_ 664 APS_ObjLeSideAr1 0 "No object" 1 "Object in zone 1, 0~10cm" 2 "Object in zone 2, 11~20cm" 3 "Object in zone 3, 21~30cm" 4 "Object in zone 4, 31~40cm" 5 "Object in zone 5, 41~50cm" 6 "Object in zone 6, 51~60cm" 7 "Reserved" ;
VAL_ 664 APS_ObjRiSideAr5 0 "No object" 1 "Object in zone 1, 0~10cm" 2 "Object in zone 2, 11~20cm" 3 "Object in zone 3, 21~30cm" 4 "Object in zone 4, 31~40cm" 5 "Object in zone 5, 41~50cm" 6 "Object in zone 6, 51~60cm" 7 "Reserved" ;
VAL_ 664 APS_ObjRiSideAr4 0 "No object" 1 "Object in zone 1, 0~10cm" 2 "Object in zone 2, 11~20cm" 3 "Object in zone 3, 21~30cm" 4 "Object in zone 4, 31~40cm" 5 "Object in zone 5, 41~50cm" 6 "Object in zone 6, 51~60cm" 7 "Reserved" ;
VAL_ 664 APS_ObjRiSideAr3 0 "No object" 1 "Object in zone 1, 0~10cm" 2 "Object in zone 2, 11~20cm" 3 "Object in zone 3, 21~30cm" 4 "Object in zone 4, 31~40cm" 5 "Object in zone 5, 41~50cm" 6 "Object in zone 6, 51~60cm" 7 "Reserved" ;
VAL_ 664 APS_ObjRiSideAr2 0 "No object" 1 "Object in zone 1, 0~10cm" 2 "Object in zone 2, 11~20cm" 3 "Object in zone 3, 21~30cm" 4 "Object in zone 4, 31~40cm" 5 "Object in zone 5, 41~50cm" 6 "Object in zone 6, 51~60cm" 7 "Reserved" ;
VAL_ 664 APS_ObjRiSideAr1 0 "No object" 1 "Object in zone 1, 0~10cm" 2 "Object in zone 2, 11~20cm" 3 "Object in zone 3, 21~30cm" 4 "Object in zone 4, 31~40cm" 5 "Object in zone 5, 41~50cm" 6 "Object in zone 6, 51~60cm" 7 "Reserved" ;
VAL_ 664 AntiMsstpngObstclDetnFailSts 0 "Initial_Value" 1 "All_No_Failure" 2 "Only_Front_Direction_Failure" 3 "Only_Rear_Direction_Failure" 4 "All_Failure" ;
VAL_ 664 ObstclDetnFailSts 0 "Initial_Value" 1 "All_No_Failure" 2 "Only_Front_Direction_Failure" 3 "Only_Rear_Direction_Failure" 4 "All_Failure" ;
VAL_ 664 ResTraDistanceOfCurTra 0 "Valid_value" 126 "No_request" 127 "Invalid" ;
VAL_ 664 P2P_ProcBar 0 "Valid_values" 127 "No_Display" ;
VAL_ 664 HAVP_ProcRa 0 "Valid_values" 127 "No_Display" ;
VAL_ 664 RPAS_NearBrrdstn 0 "Valid value" 151 "Reserved" 255 "No Display" ;
VAL_ 683 OvertakingLightModSts 0 "Initial_value" 1 "OFF" 2 "Auto_beam" 3 "Auto_beam_whistle" ;
VAL_ 683 StartReminderEnaSts 0 "Initial_value" 1 "OFF" 2 "ON" ;
VAL_ 683 DeviateSpdFixdValResp 0 "Valid_values" 63 "Invalid" ;
VAL_ 683 HWA_FaststSwtResp 0 "Initial_value" 1 "OFF" 2 "ON" 3 "Resvered" ;
VAL_ 683 TargetCutoutPro 0 "valid value" 50 "Reserved" ;
VAL_ 683 TargetCutinPro 0 "valid value" 50 "Reserved" ;
VAL_ 683 ACC_PotentialTgtHeading 0 "valid value" 61 "Reserved" ;
VAL_ 683 ACC_RiTgtHeading 0 "valid value" 61 "Reserved" ;
VAL_ 683 ACC_PotentialTgtfusion 0 "no fusion" 1 "fusion" ;
VAL_ 683 ACC_RiTgtfusion 0 "no fusion" 1 "fusion" ;
VAL_ 683 ACC_LeTgtHeading 0 "valid value" 61 "Reserved" ;
VAL_ 683 ACC_LeTgtfusion 0 "no fusion" 1 "fusion" ;
VAL_ 683 ACC_RlvTgtHeading 0 "valid value" 61 "Reserved" ;
VAL_ 683 ACC_RlvTgtfusion 0 "no fusion" 1 "fusion" ;
VAL_ 683 RollingCounter_ACC7 0 "Valid value" 15 "Invalid value" ;
VAL_ 683 ACCSts 0 "Deactive" 1 "Active" ;
VAL_ 683 Request_driveoff 0 "no request" 1 "The front car has started" 2 "The front car has started,Please pay attention to the road environment ahead" 3 "The front car has started,please keep your attention" 4 "The front car has started,please take over the car" 5 "Please pressed the accelerator" 6 "Slow_To_A_Stop" 7 "Slow_Down_Following_Car" ;
VAL_ 683 ACC_RiTgtTyp 0 "Unkown" 1 "Sedan" 2 "Truck" 3 "Motorcycle" 4 "Pedestrian" 5 "Bicycle" 6 "Traffic cone" 7 "Obstacle" ;
VAL_ 683 ACC_RiTgtDx 0 "Valid value" 301 "Reserved" ;
VAL_ 683 ACC_RiTgtDy 0 "Valid value" 161 "Reserved" ;
VAL_ 683 ACC_RiTargrtDetn 0 "Not dectected" 1 "Dectected" 2 "Reserved" 3 "Invalid" ;
VAL_ 683 ACC_LeTargrtDection 0 "Not dectected" 1 "Dectected" 2 "Reserved" 3 "Invalid" ;
VAL_ 683 ACC_LeTgtTyp 0 "Unkown" 1 "Sedan" 2 "Truck" 3 "Motorcycle" 4 "Pedestrian" 5 "Bicycle" 6 "Traffic cone" 7 "Obstacle" ;
VAL_ 683 ACC_LeTgtDx 0 "Valid value" 301 "Reserved" ;
VAL_ 683 ACC_LeTgtDy 0 "Valid value" 161 "Reserved" ;
VAL_ 683 Checksum_ACC7 0 "Valid value" ;
VAL_ 683 RollingCounter_ACC6 0 "Valid value" 15 "Invalid value" ;
VAL_ 683 IntelligentCurveAct 0 "inactive" 1 "active" ;
VAL_ 683 ACC_PotentialTgtTyp 0 "Unkown" 1 "Sedan" 2 "Truck" 3 "Motorcycle" 4 "Pedestrian" 5 "Bicycle" 6 "Traffic cone" 7 "Obstacle" ;
VAL_ 683 ACC_PotentialTgtDetn 0 "Not dectected" 1 "Dectected" 2 "Reserved" 3 "Invalid" ;
VAL_ 683 ACC_RlvTgtDx 0 "Valid value" 301 "Reserved" ;
VAL_ 683 ACC_RlvTgtDy 0 "Valid value" 161 "Reserved" ;
VAL_ 683 ACC_RlvTgtTyp 0 "Unkown" 1 "Sedan" 2 "Truck" 3 "Motorcycle" 4 "Pedestrian" 5 "Bicycle" 6 "Traffic cone" 7 "Obstacle" ;
VAL_ 683 ACC_EgoStatus 0 "No Display" 1 "Override" 2 "Deceleration" 3 "Assisted_Driving_Reduction" ;
VAL_ 683 ACC_RlvTgtDetn 0 "Not dectected" 1 "Dectected" 2 "Reserved" 3 "Invalid" ;
VAL_ 683 ACC_PotentialTgtDx 0 "Valid value" 301 "Reserved" ;
VAL_ 683 ACC_PotentialTgtDy 0 "Valid value" 161 "Reserved" ;
VAL_ 683 Checksum_ACC6 0 "Valid value" ;
VAL_ 683 RollingCounter_ACC8 0 "Valid value" 15 "Invalid value" ;
VAL_ 683 SceneModCfmPop 0 "Initial_value" 1 "Severe_weather" ;
VAL_ 683 TextSceneBrocast 0 "Initial_value" 1 "NOA_commute_mode" 2 "NOA_comfortable_mode" 3 "NOA_traffic_jam_mode" 4 "Enter_toll_station" 5 "Export_through_ETC" 6 "Through_ETC_entrance" 7 "Through_toll_station" 8 "Pass_failed" 9 "Near_window" 10 "Take_card" 11 "Pay" 12 "Turn_by_the_way" 13 "Leave_bus_lane" 14 "Left_bus_lane_no" 15 "Approaching_special_lane" 16 "Left_bus_lane_yes" 17 "Right_bus_lane_yes" 18 "Remaining_meters" 19 "PrkgSpaTPrkgSpa_Exit" 20 "PrkgSpaTPrkgSpa_Active" 21 "Downgrade_To_NOA" 22 "PrkgSpaTPrkgSpa_Restore" 23 "Take_Over_PrkgSpaTPrkgSpa" 24 "Speed_too_high_exit_PrkgSpaTPrkgSpa" 25 "Yaw_PrkgSpaTPrkgSpa_Exit" 26 "Low_consumption_pilot_not_active" 27 "Empirical_Speed_Limit" 28 "Go_Straight_And_Wait" 29 "Deviate_The_Main_Road" 30 "Deviate_The_Side_Road" 31 "Deviate_The_Bridge" 32 "Deviate_Under_The_Bridge" 33 "Restricted_Driving" 34 "Not_Available_in_Valet_Mode" 35 "Parkingon_TheRight_Side" 36 "Unsatisfie_Denvironment" 37 "Temporary_stop" 38 "Unable_to_stop" 39 "Rainy_Day_Active" 40 "Driver_seat_belt_unfastened" 41 "passenger_seat_belt_unfastened" 42 "DrivingMode_not_met" 43 "Complex_environment" 44 "Step_on_the_Gas" 45 "Find_a_parking_spot_ahead" 46 "Unable_to_stop_at_target" 47 "The_vehicle_is_reversing" 48 "To_reduce_speed_for_defense" 49 "Pull_over_at_the_destination" 50 "Rainy_Day_Quit" 51 "Attention_to_the_navigation_E2E" 52 "Unable_to_dock_E2E" 53 "Snowy_Day_Quit" 54 "Snowy_Day_Active" 55 "Unavailable_lidar_obstructed" 56 "Unavailable_camera_obstructed" 57 "Unavailable_Sensor_obstructed" 58 "foggy_Day_Quit" 59 "foggy_Day_active" 60 "Speed_Alert" 61 "MRM_Punishment" 62 "Disqualification" 63 "Please_complete_the_newbie_task_first" 64 "Unable_to_activate_RNOA_due_to_other_limitation" 65 "RNOA_active_control_is_cancelled" 66 "RNOA_temporarily_unavailable" 67 "Switched_to_RNOA" 68 "RNOA_is_active" 69 "Route_deviation_Switched_to_RNOA" 70 "Pay_attention_Red" 71 "Pay_attention_Yellow" 72 "Pay_attention_Green" 73 "Exam_incomplete" ;
VAL_ 683 PassETCEnaSts 0 "Initial_value" 1 "Disable" 2 "Enable" 3 "ETC_unbound" ;
VAL_ 683 DeviateSpdPreResp 0 "Valid_values" 63 "Invalid" ;
VAL_ 683 HWA_warning 0 "No Warning" 1 "Warning Level 1" 2 "Warning Level 2" 3 "Warning Level 3" ;
VAL_ 683 HAVP_RecReq 0 "Off" 1 "Event_type_APA" 2 "Event_type_SVP" 3 "Event_type_HAVP" 4 "Event_type_RPA" 5 "Event_type_MEB" 6 "Reserved" ;
VAL_ 683 HWA_LaneChangeReq 0 "No display" 1 "left satisfied" 2 "right satisfied" 3 "left not satisfied" 4 "right not satisfied" 5 "left solid line" 6 "right solid line" 7 "reserved" ;
VAL_ 683 ADAS_DriverInloop_Monitor 0 "No Display" 1 "HOD Level 1" 2 "HOD Level 2" 3 "DAM Warning" 4 "Resvered" ;
VAL_ 683 HWA_LaneChange 0 "No display" 1 "left" 2 "right" 3 "return" ;
VAL_ 683 DeviateSpdModSwtResp 0 "Initial_value" 1 "Fixed_value" 2 "Percentage" 3 "Resvered" ;
VAL_ 683 HWA_InterSysInfoDisp 0 "No display" 1 "Left Overtaking" 2 "Right Overtaking" 3 "Turn off the turn light" 4 "Rainmode activated" 5 "Overtime for lane change" 6 "lane change is cancelled" 7 "Rainmode deactivated" 8 "Speed is too low to support lane change" 9 "HWA need to restart the engine" 10 "Take over request" 11 "Please Keep Attention" 12 "To cross the tunnel, please take over in time" 13 "Have a branch road ahead Please take over in time" 14 "Sharp bend ahead Please take over in time" 15 "Speed is too high to support lane change" ;
VAL_ 683 HWA_ModDisp 0 "OFF" 1 "Safstop" 2 "Passive" 3 "Ready" 4 "Active" 5 "Override" 6 "Slow retreat" 7 "Standstill" 8 "Long_override" 9 "Degrade" 10 "Reserved" 15 "Fault" ;
VAL_ 683 Checksum_ACC8 0 "Valid value" ;
VAL_ 683 RollingCounter_ACC4 0 "Valid value" 15 "Invalid value" ;
VAL_ 683 CruChar_InterSysInfoDisp 0 "No display" 1 "Unable to activate CruiseChauffer due to other limitation" 2 "CruiseChauffer active control is cancelled" 3 "CruiseChauffer temporarily unavailable" 4 "Take over request" 5 "Current IGN Cycle Function Inhibit" 6 "Please Keep Attention" 7 "To cross the tunnel, please take over  in time" 8 "Have a branch road ahead. Please take over in time" 9 "Hands off warning" 10 "Reserved" ;
VAL_ 683 ACC_SpdSetValue 0 "Valid value" 255 "No display" ;
VAL_ 683 ACC_TimeGapSet 0 "No_Display" 1 "TimeGap_1_1s" 2 "TimeGap_2_one_point_four_s" 3 "TimeGap_3_one_point_eight_s" 4 "TimeGap_4_two_point_one_s" ;
VAL_ 683 ISL_InterSysInfoDisp 0 "No display" 1 "Speed Limit Confirm Request" 2 "Speed Limit Take Over Request" 3 "Reduce speed on a curve" ;
VAL_ 683 TJA_ICA_ModDisp 0 "OFF mode" 1 "Passive mode" 2 "Active mode" 3 "Ready mode" 4 "Failure" 5 "Recoverable mode" 6 "Reserved" ;
VAL_ 683 TJA_ICA_InterSysInfoDisp 0 "No display" 1 "Unable to activate TJA/ICA due to other limitation" 2 "TJA/ICA active control is cancelled" 3 "TJA/ICA   temporarily unavailable" 4 "Current IGN Cycle Function Inhibit" 5 "TJA is active" 6 "Restart or P gear to activate" 7 "TJA_is_recovered" ;
VAL_ 683 CruCha_ModDisp 0 "OFF mode" 1 "Idle mode" 2 "Ready mode" 3 "Active" 4 "Reserved" 5 "Warning Level 1" 6 "Warning Level 2" 7 "Warning Level 3" 8 "Reserved" 9 "Failure" 10 "Reserved" ;
VAL_ 683 TJA_ACC_SelSts 0 "off" 1 "ACC selected" 2 "TJA/ICA selected" 3 "Off selected" 4 "ACC on" 5 "TJA/ICA on" 6 "Reserved" ;
VAL_ 683 Longctrl_HazActv 0 "Not active" 1 "AEB active" 2 "Safestop active" 3 "Reserved" ;
VAL_ 683 ACC_TgtObjBarDisp 0 "No display" 1 "Distance_1 one bar" 2 "Distance_2 two bars" 3 "Distance_3 three bars" 4 "Distance_4 four bars" 5 "Resvered" ;
VAL_ 683 ACCReqAVM 0 "No Request" 1 "Request" ;
VAL_ 683 ACC_FctSts 0 "Fuction Not  Available" 1 "Fuction Available" 2 "Performance degradation" 3 "Reserved" ;
VAL_ 683 ACC_ModDisp 0 "OFF Mode" 1 "Passive Mode" 2 "StandBy Mode" 3 "Active-Control Mode" 4 "Brake-Only Mode" 5 "Override" 6 "Reserved" 7 "ACC and PEBS Failure mode" 8 "ACC Failure mode" 9 "Reserved" ;
VAL_ 683 ACC_InterSysInfoDisp 0 "No_display" 1 "Unable_to_activate_ACC_due_to_speed_not_achive" 2 "ACC_active_control_is_cancelled" 3 "Distraction_abort" 4 "ACC_close_due_to_ASL_open" 5 "Unable_to_activate_ACC_due_to_other_limitation" 6 "ASL_close_due_to_ACC_open" 7 "ACC_temporary_unavailable" 8 "ACC_is_active" 9 "Blindness" 10 "ACC_forbidden_due_to_ASL_Active" 11 "ACC_setspeed_has_been_changed_to_ISL" 12 "Setspeed_reach_upper_limit" 13 "Setspedd_reach_lower_limit" 14 "Unable_to_activate_TJA_or_ICA_due_to_DMS_UnA" 15 "Unable_to_activate_ACC_due_to_LowPower" 16 "Sensor_Occlusion" 17 "High_Speed" 18 "Close_Park" 19 "Bad_Weather" 20 "Switching_ACC" 21 "Lidar_Occlusion" 22 "Engine_Roomcover" 23 "Trunk" 24 "Esp_Switch" 25 "Hazard_Warning_Light" 26 "Trailer_Mode" 27 "Snow_Pattern" 28 "Mud_Model" 29 "Sandy_Land_Model" 30 "Noa_Switch" 31 "Navigation_Route" ;
VAL_ 683 ACC_TakeOverReq 0 "No TakeOver request" 1 "Valid TakeOver request" ;
VAL_ 683 ACC_ObjDetecte 0 "No object" 1 "Target object detected" ;
VAL_ 683 Checksum_ACC4 0 "Valid value" ;
VAL_ 683 RollingCounter_ACC3 0 "Valid value" 15 "Invalid value" ;
VAL_ 683 ALC_InterSysInfoDisp 0 "No display" 1 "Automatic lane change function failure" 2 "Reserve" ;
VAL_ 683 IntellgntAsscEnaSts 0 "Initial_value" 1 "Disable" 2 "Enable" ;
VAL_ 683 NOAExitTim 0 "Initial_Value" 1 "Valid_Value" ;
VAL_ 683 PrkgSpaTPrkgSpaSts 0 "Initial_value" 1 "Passive" 2 "Standby" 3 "Active" 4 "Override" 5 "Go_to_the_terminal_parking" ;
VAL_ 683 VertHeiRmd 0 "Initial_value" 1 "Low" 2 "High" ;
VAL_ 683 IntellgntAsscLmpEnaResp 0 "Initial_value" 1 "Off" 2 "Full_bright" 3 "Olny_Parking_on" ;
VAL_ 683 ALC_Resp 0 "OFF" 1 "ON" ;
VAL_ 683 HWA_SnvtySet_Resp 0 "Normal" 1 "High_Sensitivity" 2 "Low_Sensitivity" 3 "Max_Sensitivity" ;
VAL_ 683 HWA_Resp 0 "OFF" 1 "ON" ;
VAL_ 683 ISL_Resp 0 "OFF" 1 "ON" ;
VAL_ 683 Checksum_ACC3 0 "Valid value" ;
VAL_ 683 ACC_RiTgt_02_Typ 0 "Unkown" 1 "Sedan" 2 "Truck" 3 "Motorcycle" 4 "Pedestrian" 5 "Bicycle" 6 "Traffic cone" 7 "Obstacle" ;
VAL_ 683 ACC_RiTgt_02_Dy 0 "Valid_values" ;
VAL_ 683 LowPowerEgyMngmntModResp 0 "OFF" 1 "ON" ;
VAL_ 683 ACC_RiTgtObjBarDisp 0 "No display" 1 "Distance_1 one bar" 2 "Distance_2 two bars" 3 "Distance_3 three bars" 4 "Distance_4 four bars" 5 "Resvered" ;
VAL_ 683 ACC_LeTgtObjBarDisp 0 "No display" 1 "Distance_1 one bar" 2 "Distance_2 two bars" 3 "Distance_3 three bars" 4 "Distance_4 four bars" 5 "Resvered" ;
VAL_ 683 ACC_RiTgt_02_Dx 0 "Valid value" 301 "Reserved" ;
VAL_ 683 ACC_RiTargrt_02_Detn 0 "Not dectected" 1 "Dectected" 2 "Reserved" 3 "Invalid" ;
VAL_ 683 ACC_LeTargrt_02_Detn 0 "Not dectected" 1 "Dectected" 2 "Reserved" 3 "Invalid" ;
VAL_ 683 ACC_LeTgt_02_Typ 0 "Unkown" 1 "Sedan" 2 "Truck" 3 "Motorcycle" 4 "Pedestrian" 5 "Bicycle" 6 "Traffic cone" 7 "Obstacle" ;
VAL_ 683 ACC_LeTgt_02_Dx 0 "Valid value" 301 "Reserved" ;
VAL_ 683 ACC_LeTgt_02_Dy 0 "Valid_values" ;
VAL_ 692 AEB_RiCyclistTyp 0 "Unkown" 1 "Sedan" 2 "Truck" 3 "Motorcycle" 4 "Pedestrian" 5 "Bicycle" 6 "Reserved" 7 "Invalid" ;
VAL_ 692 AEB_RiCyclistDx 0 "Valid value" 301 "Reserved" ;
VAL_ 692 AEB_RiCyclistDetn 0 "Not dectected" 1 "Dectected" 2 "Reserved" 3 "Invalid" ;
VAL_ 692 AEB_LeCyclistDx 0 "Valid value" 301 "Reserved" ;
VAL_ 692 AEB_LeCyclistTyp 0 "Unkown" 1 "Sedan" 2 "Truck" 3 "Motorcycle" 4 "Pedestrian" 5 "Bicycle" 6 "Reserved" 7 "Invalid" ;
VAL_ 692 AEB_LeCyclistDetn 0 "Not dectected" 1 "Dectected" 2 "Reserved" 3 "Invalid" ;
VAL_ 692 AEB_RiPedDx 0 "Valid value" 301 "Reserved" ;
VAL_ 692 AEB_LePedDx 0 "Valid value" 301 "Reserved" ;
VAL_ 692 NOH_SysInfoDisplay 0 "Default" 1 "In NOH GeoFence" 2 "NOH is activated" 3 "Please confirm L lane change" 4 "Please confirm R lane change" 5 "To overtake from left" 6 "To overtake from right" 7 "Lane change waiting" 8 "To merge in mainroad" 9 "NOH to be deactivated" 10 "NOH cancelled" 11 "NOH deactivated" 12 "Cruise speed has been set by NOH" 13 "Speed is too high to support NOH" 14 "To merge in fast route" 15 "To merge in ramp" ;
VAL_ 692 NOH_Swt_Resp 0 "OFF" 1 "ON" ;
VAL_ 692 NOH_Act_Resp 0 "Deactivate" 1 "Activate" ;
VAL_ 692 FCWAEB_crossingTTC 0 "No Display" 1 "valid value" ;
VAL_ 692 FCWAEB_longTTC 0 "No Display" 1 "valid value" ;
VAL_ 692 NOH_Sts 0 "OFF" 1 "Passive" 2 "Standby" 3 "Active" 4 "Override" 5 "Slow retreat" 6 "Standstill" 7 "Inhibit" 8 "Urban_active" 9 "Urban_override" 10 "Urban_slow_retreat" 11 "Urban_standstill" 12 "No_display" 13 "reserved" 15 "Fail" ;
VAL_ 692 NOH_DistToExit 0 "Valid value" ;
VAL_ 692 JAPedObjAx 0 "Valid Value" ;
VAL_ 692 JAPedObjAy 0 "Valid Value" ;
VAL_ 692 JAPedObjVy 0 "Valid Value" ;
VAL_ 692 JAPedObjCntAlive 0 "Valid Value" 3856 "Reserved" ;
VAL_ 692 JAPedObjVx 0 "Valid Value" 4081 "Reserved" ;
VAL_ 692 LgtFolwDistanceSts 0 "Initial_value" 1 "Tight_gap" 2 "Proper_gap" 3 "Large_gap" ;
VAL_ 692 NOAFuncSts 0 "Initial_value" 1 "OFF" 2 "ON" ;
VAL_ 692 FCWAEB_JATTC 0 "No Display" 1 "valid value" ;
VAL_ 692 JAPedObjDx 0 "Valid Value" ;
VAL_ 692 JAPedObjDy 0 "Valid Value" ;
VAL_ 692 JAPedObjObstcl 0 "Valid Value" ;
VAL_ 692 AEBJAObjAy 0 "Valid Value" ;
VAL_ 692 JAPedObjState 0 "UNDEFINED" 1 "PRECEDING" 2 "STATIONARY" 3 "STOPPED" 4 "ONCOMING" 5 "Reserved" ;
VAL_ 692 AEBJAObjAx 0 "Valid Value" ;
VAL_ 692 AEBJAObjVy 0 "Valid Value" ;
VAL_ 692 AEBJAObjObstcl 0 "Valid Value" ;
VAL_ 692 AEBJAObjDy 0 "Valid Value" ;
VAL_ 692 AEBJAObjCntAlive 0 "Valid Value" 3856 "Reserved" ;
VAL_ 692 AEBJAObjState 0 "UNDEFINED" 1 "PRECEDING" 2 "STATIONARY" 3 "STOPPED" 4 "ONCOMING" 5 "Reserved" ;
VAL_ 692 JAPedObjID 0 "Valid Value" 255 "No Object" ;
VAL_ 692 AEBJAObjDx 0 "Valid Value" ;
VAL_ 692 AEBJAObjVx 0 "Valid Value" 4081 "Reserved" ;
VAL_ 692 JAPedObjVideoCfmd 0 "No Fusion" 1 "Fusion" ;
VAL_ 692 AEBJAObjVideoCfmd 0 "No Fusion" 1 "Fusion" ;
VAL_ 692 AEBJAObjExist 0 "Valid Value" ;
VAL_ 692 AEBJAObjID 0 "Valid Value" 255 "No Object" ;
VAL_ 692 AEB_RiCyclist_collisionprob 0 "no collisionprob" 1 "collisionprob" ;
VAL_ 692 AEB_LeCyclist_collisionprob 0 "no collisionprob" 1 "collisionprob" ;
VAL_ 692 AEB_RiPed_collisionprob 0 "no collisionprob" 1 "collisionprob" ;
VAL_ 692 AEB_LePed_collisionprob 0 "no collisionprob" 1 "collisionprob" ;
VAL_ 692 AEB_RiPedDetn 0 "Not dectected" 1 "Dectected" 2 "Reserved" 3 "Invalid" ;
VAL_ 692 AEB_RiPedTyp 0 "Unkown" 1 "Sedan" 2 "Truck" 3 "Motorcycle" 4 "Pedestrian" 5 "Bicycle" 6 "Reserved" 7 "Invalid" ;
VAL_ 692 AEB_LePedTyp 0 "Unkown" 1 "Sedan" 2 "Truck" 3 "Motorcycle" 4 "Pedestrian" 5 "Bicycle" 6 "Reserved" 7 "Invalid" ;
VAL_ 692 AEB_LePedDetn 0 "Not dectected" 1 "Dectected" 2 "Reserved" 3 "Invalid" ;
VAL_ 692 JAPedObjExist 0 "Valid Value" ;
VAL_ 692 AEB_RiCyclistDy 0 "Valid value" 161 "Reserved" ;
VAL_ 692 AEB_LeCyclistDy 0 "Valid value" 161 "Reserved" ;
VAL_ 692 AEB_RiPedDy 0 "Valid value" 161 "Reserved" ;
VAL_ 692 AEB_LePedDy 0 "Valid value" 161 "Reserved" ;
VAL_ 696 ACC_DataRecReq 0 "No Demand" 1 "Scenario01" 2 "Scenario02" 3 "Scenario03" 4 "Scenario04" 5 "Scenario05" 6 "Scenario06" 7 "Scenario07" 8 "Scenario08" 9 "Scenario09" 10 "Scenario10" 11 "Scenario11" 12 "Scenario12" 13 "Scenario13" 14 "Scenario14" 15 "Scenario15" 16 "Scenario16" 17 "Scenario17" 18 "Scenario18" 19 "Scenario19" 20 "Scenario20" 21 "Scenario21" 22 "Scenario22" 23 "Scenario23" 24 "Scenario24" 25 "Scenario25" 26 "Scenario26" 27 "Scenario27" 28 "Scenario28" 29 "Scenario29" 30 "Scenario30" 31 "Scenario31" 32 "Scenario32" 33 "Scenario33" 34 "Scenario34" 35 "Scenario35" 36 "Scenario36" 37 "Scenario37" 38 "Scenario38" 39 "Scenario39" 40 "Scenario40" 41 "Scenario41" 42 "Scenario42" 43 "Scenario43" 44 "Scenario44" 45 "Scenario45" 46 "Scenario46" 47 "Scenario47" 48 "Scenario48" 49 "Scenario49" 50 "Scenario50" 51 "Reserved" ;
VAL_ 696 AEBObjDrvby 0 "Valid" 31 "invalid" ;
VAL_ 696 AEBObjOverlap 0 "Valid" 31 "invalid" ;
VAL_ 696 DrvrSts 0 "Good" 1 "Unbelievable" 2 "Low" 3 "Middle" 4 "High Level 1" 5 "High Level 2" 6 "Reserved" ;
VAL_ 696 MapDataValid 0 "Valid" 1 "Invalid" ;
VAL_ 696 PedObjState 0 "UNDEFINED" 1 "PRECEDING" 2 "STATIONARY" 3 "STOPPED" 4 "Reserved" ;
VAL_ 696 ACC_SOSReq 0 "No Request" 1 "Request" 2 "Reserved" 3 "Invalid" ;
VAL_ 696 RadarDrvrAttentive 0 "Inattentive" 1 "Attentive" ;
VAL_ 696 BrdgDst 0 "Valid Value" 61 "Out of Range" 62 "Reserved" 63 "Unknown" ;
VAL_ 696 DrvgOnRiLane 0 "Unknown" 1 "On right most lane" 2 "Not on right most lane" 3 "Reserved" ;
VAL_ 696 TunnelDst 0 "Valid Value" 61 "Out of Range" 62 "Reserved" 63 "Unknown" ;
VAL_ 696 NavSpdLimUnit 0 "Unknown" 1 "KMH" 2 "MPH" 3 "Reserved" ;
VAL_ 696 CurveDst 0 "Valid Value" 61 "Out of Range" 62 "Reserved" 63 "Unknown" ;
VAL_ 696 SpdLimit 0 "No SPL" 1 "SPL 5" 2 "SPL 10" 3 "SPL 15" 4 "SPL 20" 5 "SPL 25" 6 "SPL 30" 7 "SPL 35" 8 "SPL 40" 9 "SPL 45" 10 "SPL 50" 11 "SPL 55" 12 "SPL 60" 13 "SPL 65" 14 "SPL 70" 15 "SPL 75" 16 "SPL 80" 17 "SPL 85" 18 "SPL 90" 19 "SPL 95" 20 "SPL 100" 21 "SPL 105" 22 "SPL 110" 23 "SPL 115" 24 "SPL 120" 25 "SPL 125" 26 "SPL 130" 27 "SPL 135" 28 "SPL 140" 29 "SPL 145" 30 "SPL 150" 31 "Reserved" 63 "Invalid" ;
VAL_ 696 RampDst 0 "Valid Value" 61 "Out of Range" 62 "Reserved" 63 "Unknown" ;
VAL_ 696 RoadCrvtFar 0 "Valid Value(Left bend)" 511 "Straightaway" 512 "Valid Value((Reft bend))" 1022 "Reserved" 1023 "Unknown" ;
VAL_ 696 SpdLimitDst 0 "Valid Value" 61 "Out of Range" 62 "Reserved" 63 "Unknown" ;
VAL_ 696 RoadCrvt 0 "Valid Value(Left bend)" 511 "Straightaway" 512 "Valid Value((Reft bend))" 1022 "Reserved" 1023 "Unknown" ;
VAL_ 696 DrvgOnHiWay 0 "Unknown" 1 "On Hignway" 2 "Not on hgh way" 3 "Reserved" ;
VAL_ 696 HandsoffDetd 0 "Unknown" 1 "Hands off" 2 "Not hands off" 3 "Reserved" ;
VAL_ 696 RadarHorMisalign 0 "Valid Value" ;
VAL_ 696 ACCTgtObjCntAlive 0 "Valid Value" 3856 "Reserved" ;
VAL_ 696 ACCTgtObjVideoCfmd 0 "No Fusion" 1 "Fusion" ;
VAL_ 696 ACCTgtObjState 0 "UNDEFINED" 1 "PRECEDING" 2 "STATIONARY" 3 "STOPPED" 4 "Reserved" ;
VAL_ 696 ACCTgtObjAy 0 "Valid Value" ;
VAL_ 696 ACCTgtObjAx 0 "Valid Value" ;
VAL_ 696 ACCTgtObjVx 0 "Valid Value" 4081 "Reserved" ;
VAL_ 696 ACCTgtObjVy 0 "Valid Value" ;
VAL_ 696 ACCTgtObjExist 0 "Valid Value" ;
VAL_ 696 ACCTgtObjDy 0 "Valid Value" ;
VAL_ 696 ACCTgtObjObstcl 0 "Valid Value" ;
VAL_ 696 ACCTgtObjID 0 "Valid Value" 255 "No Object" ;
VAL_ 696 PedObjAx 0 "Valid Value" ;
VAL_ 696 PedObjCntAlive 0 "Valid Value" 3856 "Reserved" ;
VAL_ 696 PedObjAy 0 "Valid Value" ;
VAL_ 696 ACCTgtObjDx 0 "Valid Value" ;
VAL_ 696 PedObjVideoCfmd 0 "No Fusion" 1 "Fusion" ;
VAL_ 696 PedObjVy 0 "Valid Value" ;
VAL_ 696 PedObjVx 0 "Valid Value" 4081 "Reserved" ;
VAL_ 696 PedObjDx 0 "Valid Value" ;
VAL_ 696 PedObjDy 0 "Valid Value" ;
VAL_ 696 PedObjObstcl 0 "Valid Value" ;
VAL_ 696 PedObjID 0 "Valid Value" 255 "No Object" ;
VAL_ 696 PedObjExist 0 "Valid Value" ;
VAL_ 696 CyclistObjAy 0 "Valid Value" ;
VAL_ 696 CyclistObjAx 0 "Valid Value" ;
VAL_ 696 CyclistObjVideoCfmd 0 "No Fusion" 1 "Fusion" ;
VAL_ 696 CyclistObjState 0 "UNDEFINED" 1 "PRECEDING" 2 "STATIONARY" 3 "STOPPED" 4 "Reserved" ;
VAL_ 696 CyclistObjVy 0 "Valid Value" ;
VAL_ 696 CyclistObjCntAlive 0 "Valid Value" 3856 "Reserved" ;
VAL_ 696 CyclistObjVx 0 "Valid Value" 4081 "Reserved" ;
VAL_ 696 CyclistObjDy 0 "Valid Value" ;
VAL_ 696 CyclistObjObstcl 0 "Valid Value" ;
VAL_ 696 CyclistObjID 0 "Valid Value" 255 "No Object" ;
VAL_ 696 CyclistObjDx 0 "Valid Value" ;
VAL_ 696 AEBObjAy 0 "Valid Value" ;
VAL_ 696 AEBObjAx 0 "Valid Value" ;
VAL_ 696 CyclistObjExist 0 "Valid Value" ;
VAL_ 696 AEBObjVy 0 "Valid Value" ;
VAL_ 696 AEBObjObstcl 0 "Valid Value" ;
VAL_ 696 AEBObjState 0 "UNDEFINED" 1 "PRECEDING" 2 "STATIONARY" 3 "STOPPED" 4 "Reserved" ;
VAL_ 696 AEBObjDy 0 "Valid Value" ;
VAL_ 696 AEBObjCntAlive 0 "Valid Value" 3856 "Reserved" ;
VAL_ 696 AEBObjDx 0 "Valid Value" ;
VAL_ 696 AEBObjVx 0 "Valid Value" 4081 "Reserved" ;
VAL_ 696 AEBObjVideoCfmd 0 "No Fusion" 1 "Fusion" ;
VAL_ 696 AEBObjExist 0 "Valid Value" ;
VAL_ 696 AEBObjID 0 "Valid Value" 255 "No Object" ;
