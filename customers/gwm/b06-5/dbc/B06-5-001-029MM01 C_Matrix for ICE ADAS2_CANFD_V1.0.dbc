VERSION ""

NS_ :

BS_:

BU_: IDM CR_RL CR_RR Tester

BO_ 1429 RSDS_R_SGU6: 64 CR_RR
 SG_ RSDS_R_SGU6_RollingCounter8 : 507|4@0+ (1,0) [0|15] ""  IDM
 SG_ RSDS_R_SGU6_BlockCounter : 511|4@0+ (1,0) [0|15] ""  IDM
 SG_ RSDS_R_HWATargetValidity_12 : 496|1@0+ (1,0) [0|1] ""  IDM
 SG_ RSDS_R_ObjRefPoint_12 : 499|3@0+ (1,0) [0|8] ""  IDM
 SG_ RSDS_R_ObjRCS_12 : 493|10@0+ (0.125,-50) [-50|70] "dBm2"  IDM
 SG_ RSDS_R_ObjYawrate_12 : 473|12@0+ (0.002,-3.14) [-3.14|3.14] "rad/s"  IDM
 SG_ RSDS_R_ObjHeading_12 : 469|12@0+ (0.002,-3.14) [-3.14|3.14] "rad"  IDM
 SG_ RSDS_R_ObjLength_12 : 463|10@0+ (0.05,0) [0|20] "m"  IDM
 SG_ RSDS_R_SGU6_Checksum8 : 455|8@0+ (1,0) [0|255] ""  IDM
 SG_ RSDS_R_SGU6_RollingCounter7 : 443|4@0+ (1,0) [0|15] ""  IDM
 SG_ RSDS_R_ObjMotionDirection_12 : 447|3@0+ (1,0) [0|7] ""  IDM
 SG_ RSDS_R_ObjAge_12 : 439|8@0+ (1,0) [0|255] ""  IDM
 SG_ RSDS_R_ObjWidth_12 : 417|10@0+ (0.01,0) [0|5] "m"  IDM
 SG_ RSDS_R_ObjRAccelYStd_12 : 423|6@0+ (0.0625,0) [0|3.9375] "mps2"  IDM
 SG_ RSDS_R_ObjRAccelXStd_12 : 413|6@0+ (0.0625,0) [0|3.9375] "mps2"  IDM
 SG_ RSDS_R_ObjRelVelYStd_12 : 403|6@0+ (0.0625,0) [0|3.9375] "mps"  IDM
 SG_ RSDS_R_ObjRelVelXStd_12 : 393|6@0+ (0.0625,0) [0|3.9375] "mps"  IDM
 SG_ RSDS_R_ObjDistYStd_12 : 399|6@0+ (0.1,0) [0|6] "m"  IDM
 SG_ RSDS_R_SGU6_Checksum7 : 391|8@0+ (1,0) [0|255] ""  IDM
 SG_ RSDS_R_SGU6_RollingCounter6 : 379|4@0+ (1,0) [0|15] ""  IDM
 SG_ RSDS_R_ObjMotionType_12 : 383|3@0+ (1,0) [0|7] ""  IDM
 SG_ RSDS_R_ObjMeasured_12 : 369|2@0+ (1,0) [0|3] ""  IDM
 SG_ RSDS_R_ObjRelAccelY_12 : 363|10@0+ (0.03125,-16) [-16|15.96875] "mps2"  IDM
 SG_ RSDS_R_ObjRelAccelX_12 : 357|10@0+ (0.03125,-16) [-16|15.96875] "mps2"  IDM
 SG_ RSDS_R_ObjRelVelY_12 : 338|13@0+ (0.0312,-128) [-128|126.9976] "mps"  IDM
 SG_ RSDS_R_ObjRelVelX_12 : 335|13@0+ (0.0312,-128) [-128|126.9976] "mps"  IDM
 SG_ RSDS_R_SGU6_Checksum6 : 327|8@0+ (1,0) [0|255] ""  IDM
 SG_ RSDS_R_SGU6_RollingCounter5 : 315|4@0+ (1,0) [0|15] ""  IDM
 SG_ RSDS_R_ObjType_12 : 319|4@0+ (1,0) [0|15] ""  IDM
 SG_ RSDS_R_ObjDistXStd_12 : 310|6@0+ (0.1,0) [0|6] "m"  IDM
 SG_ RSDS_R_ObjDistY_12 : 289|11@0+ (0.125,-128) [-128|127.875] "m"  IDM
 SG_ RSDS_R_ObjDistX_12 : 285|12@0+ (0.0625,-128) [-128|127.9375] "m"  IDM
 SG_ RSDS_R_ObjObstacleProb_12 : 274|5@0+ (0.03326,0) [0|1] ""  IDM
 SG_ RSDS_R_ObjExistProb_12 : 279|5@0+ (0.03326,0) [0|1] ""  IDM
 SG_ RSDS_R_ObjID_12 : 271|8@0+ (1,0) [0|255] ""  IDM
 SG_ RSDS_R_SGU6_Checksum5 : 263|8@0+ (1,0) [0|255] ""  IDM
 SG_ RSDS_R_SGU6_RollingCounter4 : 251|4@0+ (1,0) [0|15] ""  IDM
 SG_ RSDS_R_HWATargetValidity_11 : 240|1@0+ (1,0) [0|1] ""  IDM
 SG_ RSDS_R_ObjRefPoint_11 : 243|3@0+ (1,0) [0|8] ""  IDM
 SG_ RSDS_R_ObjRCS_11 : 237|10@0+ (0.125,-50) [-50|70] "dBm2"  IDM
 SG_ RSDS_R_ObjYawrate_11 : 217|12@0+ (0.002,-3.14) [-3.14|3.14] "rad/s"  IDM
 SG_ RSDS_R_ObjHeading_11 : 213|12@0+ (0.002,-3.14) [-3.14|3.14] "rad"  IDM
 SG_ RSDS_R_ObjLength_11 : 207|10@0+ (0.05,0) [0|20] "m"  IDM
 SG_ RSDS_R_SGU6_Checksum4 : 199|8@0+ (1,0) [0|255] ""  IDM
 SG_ RSDS_R_SGU6_RollingCounter3 : 187|4@0+ (1,0) [0|15] ""  IDM
 SG_ RSDS_R_ObjMotionDirection_11 : 191|3@0+ (1,0) [0|7] ""  IDM
 SG_ RSDS_R_ObjAge_11 : 183|8@0+ (1,0) [0|255] ""  IDM
 SG_ RSDS_R_ObjWidth_11 : 161|10@0+ (0.01,0) [0|5] "m"  IDM
 SG_ RSDS_R_ObjRAccelYStd_11 : 167|6@0+ (0.0625,0) [0|3.9375] "mps2"  IDM
 SG_ RSDS_R_ObjRAccelXStd_11 : 157|6@0+ (0.0625,0) [0|3.9375] "mps2"  IDM
 SG_ RSDS_R_ObjRelVelYStd_11 : 147|6@0+ (0.0625,0) [0|3.9375] "mps"  IDM
 SG_ RSDS_R_ObjRelVelXStd_11 : 137|6@0+ (0.0625,0) [0|3.9375] "mps"  IDM
 SG_ RSDS_R_ObjDistYStd_11 : 143|6@0+ (0.1,0) [0|6] "m"  IDM
 SG_ RSDS_R_SGU6_Checksum3 : 135|8@0+ (1,0) [0|255] ""  IDM
 SG_ RSDS_R_SGU6_RollingCounter2 : 123|4@0+ (1,0) [0|15] ""  IDM
 SG_ RSDS_R_ObjMotionType_11 : 127|3@0+ (1,0) [0|7] ""  IDM
 SG_ RSDS_R_ObjMeasured_11 : 113|2@0+ (1,0) [0|3] ""  IDM
 SG_ RSDS_R_ObjRelAccelY_11 : 107|10@0+ (0.03125,-16) [-16|15.96875] "mps2"  IDM
 SG_ RSDS_R_ObjRelAccelX_11 : 101|10@0+ (0.03125,-16) [-16|15.96875] "mps2"  IDM
 SG_ RSDS_R_ObjRelVelY_11 : 82|13@0+ (0.0312,-128) [-128|126.9976] "mps"  IDM
 SG_ RSDS_R_ObjRelVelX_11 : 79|13@0+ (0.0312,-128) [-128|126.9976] "mps"  IDM
 SG_ RSDS_R_SGU6_Checksum2 : 71|8@0+ (1,0) [0|255] ""  IDM
 SG_ RSDS_R_SGU6_RollingCounter1 : 59|4@0+ (1,0) [0|15] ""  IDM
 SG_ RSDS_R_ObjType_11 : 63|4@0+ (1,0) [0|15] ""  IDM
 SG_ RSDS_R_ObjDistXStd_11 : 54|6@0+ (0.1,0) [0|6] "m"  IDM
 SG_ RSDS_R_ObjDistY_11 : 33|11@0+ (0.125,-128) [-128|127.875] "m"  IDM
 SG_ RSDS_R_ObjDistX_11 : 29|12@0+ (0.0625,-128) [-128|127.9375] "m"  IDM
 SG_ RSDS_R_ObjObstacleProb_11 : 18|5@0+ (0.03326,0) [0|1] ""  IDM
 SG_ RSDS_R_ObjExistProb_11 : 23|5@0+ (0.03326,0) [0|1] ""  IDM
 SG_ RSDS_R_ObjID_11 : 15|8@0+ (1,0) [0|255] ""  IDM
 SG_ RSDS_R_SGU6_Checksum1 : 7|8@0+ (1,0) [0|255] ""  IDM

BO_ 1430 RSDS_R_SGU7: 64 CR_RR
 SG_ RSDS_R_SGU7_RollingCounter8 : 507|4@0+ (1,0) [0|15] ""  IDM
 SG_ RSDS_R_SGU7_BlockCounter : 511|4@0+ (1,0) [0|15] ""  IDM
 SG_ RSDS_R_HWATargetValidity_14 : 496|1@0+ (1,0) [0|1] ""  IDM
 SG_ RSDS_R_ObjRefPoint_14 : 499|3@0+ (1,0) [0|8] ""  IDM
 SG_ RSDS_R_ObjRCS_14 : 493|10@0+ (0.125,-50) [-50|70] "dBm2"  IDM
 SG_ RSDS_R_ObjYawrate_14 : 473|12@0+ (0.002,-3.14) [-3.14|3.14] "rad/s"  IDM
 SG_ RSDS_R_ObjHeading_14 : 469|12@0+ (0.002,-3.14) [-3.14|3.14] "rad"  IDM
 SG_ RSDS_R_ObjLength_14 : 463|10@0+ (0.05,0) [0|20] "m"  IDM
 SG_ RSDS_R_SGU7_Checksum8 : 455|8@0+ (1,0) [0|255] ""  IDM
 SG_ RSDS_R_SGU7_RollingCounter7 : 443|4@0+ (1,0) [0|15] ""  IDM
 SG_ RSDS_R_ObjMotionDirection_14 : 447|3@0+ (1,0) [0|7] ""  IDM
 SG_ RSDS_R_ObjAge_14 : 439|8@0+ (1,0) [0|255] ""  IDM
 SG_ RSDS_R_ObjWidth_14 : 417|10@0+ (0.01,0) [0|5] "m"  IDM
 SG_ RSDS_R_ObjRAccelYStd_14 : 423|6@0+ (0.0625,0) [0|3.9375] "mps2"  IDM
 SG_ RSDS_R_ObjRAccelXStd_14 : 413|6@0+ (0.0625,0) [0|3.9375] "mps2"  IDM
 SG_ RSDS_R_ObjRelVelYStd_14 : 403|6@0+ (0.0625,0) [0|3.9375] "mps"  IDM
 SG_ RSDS_R_ObjRelVelXStd_14 : 393|6@0+ (0.0625,0) [0|3.9375] "mps"  IDM
 SG_ RSDS_R_ObjDistYStd_14 : 399|6@0+ (0.1,0) [0|6] "m"  IDM
 SG_ RSDS_R_SGU7_Checksum7 : 391|8@0+ (1,0) [0|255] ""  IDM
 SG_ RSDS_R_SGU7_RollingCounter6 : 379|4@0+ (1,0) [0|15] ""  IDM
 SG_ RSDS_R_ObjMotionType_14 : 383|3@0+ (1,0) [0|7] ""  IDM
 SG_ RSDS_R_ObjMeasured_14 : 369|2@0+ (1,0) [0|3] ""  IDM
 SG_ RSDS_R_ObjRelAccelY_14 : 363|10@0+ (0.03125,-16) [-16|15.96875] "mps2"  IDM
 SG_ RSDS_R_ObjRelAccelX_14 : 357|10@0+ (0.03125,-16) [-16|15.96875] "mps2"  IDM
 SG_ RSDS_R_ObjRelVelY_14 : 338|13@0+ (0.0312,-128) [-128|126.9976] "mps"  IDM
 SG_ RSDS_R_ObjRelVelX_14 : 335|13@0+ (0.0312,-128) [-128|126.9976] "mps"  IDM
 SG_ RSDS_R_SGU7_Checksum6 : 327|8@0+ (1,0) [0|255] ""  IDM
 SG_ RSDS_R_SGU7_RollingCounter5 : 315|4@0+ (1,0) [0|15] ""  IDM
 SG_ RSDS_R_ObjType_14 : 319|4@0+ (1,0) [0|15] ""  IDM
 SG_ RSDS_R_ObjDistXStd_14 : 310|6@0+ (0.1,0) [0|6] "m"  IDM
 SG_ RSDS_R_ObjDistY_14 : 289|11@0+ (0.125,-128) [-128|127.875] "m"  IDM
 SG_ RSDS_R_ObjDistX_14 : 285|12@0+ (0.0625,-128) [-128|127.9375] "m"  IDM
 SG_ RSDS_R_ObjObstacleProb_14 : 274|5@0+ (0.03326,0) [0|1] ""  IDM
 SG_ RSDS_R_ObjExistProb_14 : 279|5@0+ (0.03326,0) [0|1] ""  IDM
 SG_ RSDS_R_ObjID_14 : 271|8@0+ (1,0) [0|255] ""  IDM
 SG_ RSDS_R_SGU7_Checksum5 : 263|8@0+ (1,0) [0|255] ""  IDM
 SG_ RSDS_R_SGU7_RollingCounter4 : 251|4@0+ (1,0) [0|15] ""  IDM
 SG_ RSDS_R_HWATargetValidity_13 : 240|1@0+ (1,0) [0|1] ""  IDM
 SG_ RSDS_R_ObjRefPoint_13 : 243|3@0+ (1,0) [0|8] ""  IDM
 SG_ RSDS_R_ObjRCS_13 : 237|10@0+ (0.125,-50) [-50|70] "dBm2"  IDM
 SG_ RSDS_R_ObjYawrate_13 : 217|12@0+ (0.002,-3.14) [-3.14|3.14] "rad/s"  IDM
 SG_ RSDS_R_ObjHeading_13 : 213|12@0+ (0.002,-3.14) [-3.14|3.14] "rad"  IDM
 SG_ RSDS_R_ObjLength_13 : 207|10@0+ (0.05,0) [0|20] "m"  IDM
 SG_ RSDS_R_SGU7_Checksum4 : 199|8@0+ (1,0) [0|255] ""  IDM
 SG_ RSDS_R_SGU7_RollingCounter3 : 187|4@0+ (1,0) [0|15] ""  IDM
 SG_ RSDS_R_ObjMotionDirection_13 : 191|3@0+ (1,0) [0|7] ""  IDM
 SG_ RSDS_R_ObjAge_13 : 183|8@0+ (1,0) [0|255] ""  IDM
 SG_ RSDS_R_ObjWidth_13 : 161|10@0+ (0.01,0) [0|5] "m"  IDM
 SG_ RSDS_R_ObjRAccelYStd_13 : 167|6@0+ (0.0625,0) [0|3.9375] "mps2"  IDM
 SG_ RSDS_R_ObjRAccelXStd_13 : 157|6@0+ (0.0625,0) [0|3.9375] "mps2"  IDM
 SG_ RSDS_R_ObjRelVelYStd_13 : 147|6@0+ (0.0625,0) [0|3.9375] "mps"  IDM
 SG_ RSDS_R_ObjRelVelXStd_13 : 137|6@0+ (0.0625,0) [0|3.9375] "mps"  IDM
 SG_ RSDS_R_ObjDistYStd_13 : 143|6@0+ (0.1,0) [0|6] "m"  IDM
 SG_ RSDS_R_SGU7_Checksum3 : 135|8@0+ (1,0) [0|255] ""  IDM
 SG_ RSDS_R_SGU7_RollingCounter2 : 123|4@0+ (1,0) [0|15] ""  IDM
 SG_ RSDS_R_ObjMotionType_13 : 127|3@0+ (1,0) [0|7] ""  IDM
 SG_ RSDS_R_ObjMeasured_13 : 113|2@0+ (1,0) [0|3] ""  IDM
 SG_ RSDS_R_ObjRelAccelY_13 : 107|10@0+ (0.03125,-16) [-16|15.96875] "mps2"  IDM
 SG_ RSDS_R_ObjRelAccelX_13 : 101|10@0+ (0.03125,-16) [-16|15.96875] "mps2"  IDM
 SG_ RSDS_R_ObjRelVelY_13 : 82|13@0+ (0.0312,-128) [-128|126.9976] "mps"  IDM
 SG_ RSDS_R_ObjRelVelX_13 : 79|13@0+ (0.0312,-128) [-128|126.9976] "mps"  IDM
 SG_ RSDS_R_SGU7_Checksum2 : 71|8@0+ (1,0) [0|255] ""  IDM
 SG_ RSDS_R_SGU7_RollingCounter1 : 59|4@0+ (1,0) [0|15] ""  IDM
 SG_ RSDS_R_ObjType_13 : 63|4@0+ (1,0) [0|15] ""  IDM
 SG_ RSDS_R_ObjDistXStd_13 : 54|6@0+ (0.1,0) [0|6] "m"  IDM
 SG_ RSDS_R_ObjDistY_13 : 33|11@0+ (0.125,-128) [-128|127.875] "m"  IDM
 SG_ RSDS_R_ObjDistX_13 : 29|12@0+ (0.0625,-128) [-128|127.9375] "m"  IDM
 SG_ RSDS_R_ObjObstacleProb_13 : 18|5@0+ (0.03326,0) [0|1] ""  IDM
 SG_ RSDS_R_ObjExistProb_13 : 23|5@0+ (0.03326,0) [0|1] ""  IDM
 SG_ RSDS_R_ObjID_13 : 15|8@0+ (1,0) [0|255] ""  IDM
 SG_ RSDS_R_SGU7_Checksum1 : 7|8@0+ (1,0) [0|255] ""  IDM

BO_ 1431 RSDS_R_SGU8: 64 CR_RR
 SG_ RSDS_R_SGU8_RollingCounter8 : 507|4@0+ (1,0) [0|15] ""  IDM
 SG_ RSDS_R_SGU8_BlockCounter : 511|4@0+ (1,0) [0|15] ""  IDM
 SG_ RSDS_R_HWATargetValidity_16 : 496|1@0+ (1,0) [0|1] ""  IDM
 SG_ RSDS_R_ObjRefPoint_16 : 499|3@0+ (1,0) [0|8] ""  IDM
 SG_ RSDS_R_ObjRCS_16 : 493|10@0+ (0.125,-50) [-50|70] "dBm2"  IDM
 SG_ RSDS_R_ObjYawrate_16 : 473|12@0+ (0.002,-3.14) [-3.14|3.14] "rad/s"  IDM
 SG_ RSDS_R_ObjHeading_16 : 469|12@0+ (0.002,-3.14) [-3.14|3.14] "rad"  IDM
 SG_ RSDS_R_ObjLength_16 : 463|10@0+ (0.05,0) [0|20] "m"  IDM
 SG_ RSDS_R_SGU8_Checksum8 : 455|8@0+ (1,0) [0|255] ""  IDM
 SG_ RSDS_R_SGU8_RollingCounter7 : 443|4@0+ (1,0) [0|15] ""  IDM
 SG_ RSDS_R_ObjMotionDirection_16 : 447|3@0+ (1,0) [0|7] ""  IDM
 SG_ RSDS_R_ObjAge_16 : 439|8@0+ (1,0) [0|255] ""  IDM
 SG_ RSDS_R_ObjWidth_16 : 417|10@0+ (0.01,0) [0|5] "m"  IDM
 SG_ RSDS_R_ObjRAccelYStd_16 : 423|6@0+ (0.0625,0) [0|3.9375] "mps2"  IDM
 SG_ RSDS_R_ObjRAccelXStd_16 : 413|6@0+ (0.0625,0) [0|3.9375] "mps2"  IDM
 SG_ RSDS_R_ObjRelVelYStd_16 : 403|6@0+ (0.0625,0) [0|3.9375] "mps"  IDM
 SG_ RSDS_R_ObjRelVelXStd_16 : 393|6@0+ (0.0625,0) [0|3.9375] "mps"  IDM
 SG_ RSDS_R_ObjDistYStd_16 : 399|6@0+ (0.1,0) [0|6] "m"  IDM
 SG_ RSDS_R_SGU8_Checksum7 : 391|8@0+ (1,0) [0|255] ""  IDM
 SG_ RSDS_R_SGU8_RollingCounter6 : 379|4@0+ (1,0) [0|15] ""  IDM
 SG_ RSDS_R_ObjMotionType_16 : 383|3@0+ (1,0) [0|7] ""  IDM
 SG_ RSDS_R_ObjMeasured_16 : 369|2@0+ (1,0) [0|3] ""  IDM
 SG_ RSDS_R_ObjRelAccelY_16 : 363|10@0+ (0.03125,-16) [-16|15.96875] "mps2"  IDM
 SG_ RSDS_R_ObjRelAccelX_16 : 357|10@0+ (0.03125,-16) [-16|15.96875] "mps2"  IDM
 SG_ RSDS_R_ObjRelVelY_16 : 338|13@0+ (0.0312,-128) [-128|126.9976] "mps"  IDM
 SG_ RSDS_R_ObjRelVelX_16 : 335|13@0+ (0.0312,-128) [-128|126.9976] "mps"  IDM
 SG_ RSDS_R_SGU8_Checksum6 : 327|8@0+ (1,0) [0|255] ""  IDM
 SG_ RSDS_R_SGU8_RollingCounter5 : 315|4@0+ (1,0) [0|15] ""  IDM
 SG_ RSDS_R_ObjType_16 : 319|4@0+ (1,0) [0|15] ""  IDM
 SG_ RSDS_R_ObjDistXStd_16 : 310|6@0+ (0.1,0) [0|6] "m"  IDM
 SG_ RSDS_R_ObjDistY_16 : 289|11@0+ (0.125,-128) [-128|127.875] "m"  IDM
 SG_ RSDS_R_ObjDistX_16 : 285|12@0+ (0.0625,-128) [-128|127.9375] "m"  IDM
 SG_ RSDS_R_ObjObstacleProb_16 : 274|5@0+ (0.03326,0) [0|1] ""  IDM
 SG_ RSDS_R_ObjExistProb_16 : 279|5@0+ (0.03326,0) [0|1] ""  IDM
 SG_ RSDS_R_ObjID_16 : 271|8@0+ (1,0) [0|255] ""  IDM
 SG_ RSDS_R_SGU8_Checksum5 : 263|8@0+ (1,0) [0|255] ""  IDM
 SG_ RSDS_R_SGU8_RollingCounter4 : 251|4@0+ (1,0) [0|15] ""  IDM
 SG_ RSDS_R_HWATargetValidity_15 : 240|1@0+ (1,0) [0|1] ""  IDM
 SG_ RSDS_R_ObjRefPoint_15 : 243|3@0+ (1,0) [0|8] ""  IDM
 SG_ RSDS_R_ObjRCS_15 : 237|10@0+ (0.125,-50) [-50|70] "dBm2"  IDM
 SG_ RSDS_R_ObjYawrate_15 : 217|12@0+ (0.002,-3.14) [-3.14|3.14] "rad/s"  IDM
 SG_ RSDS_R_ObjHeading_15 : 213|12@0+ (0.002,-3.14) [-3.14|3.14] "rad"  IDM
 SG_ RSDS_R_ObjLength_15 : 207|10@0+ (0.05,0) [0|20] "m"  IDM
 SG_ RSDS_R_SGU8_Checksum4 : 199|8@0+ (1,0) [0|255] ""  IDM
 SG_ RSDS_R_SGU8_RollingCounter3 : 187|4@0+ (1,0) [0|15] ""  IDM
 SG_ RSDS_R_ObjMotionDirection_15 : 191|3@0+ (1,0) [0|7] ""  IDM
 SG_ RSDS_R_ObjAge_15 : 183|8@0+ (1,0) [0|255] ""  IDM
 SG_ RSDS_R_ObjWidth_15 : 161|10@0+ (0.01,0) [0|5] "m"  IDM
 SG_ RSDS_R_ObjRAccelYStd_15 : 167|6@0+ (0.0625,0) [0|3.9375] "mps2"  IDM
 SG_ RSDS_R_ObjRAccelXStd_15 : 157|6@0+ (0.0625,0) [0|3.9375] "mps2"  IDM
 SG_ RSDS_R_ObjRelVelYStd_15 : 147|6@0+ (0.0625,0) [0|3.9375] "mps"  IDM
 SG_ RSDS_R_ObjRelVelXStd_15 : 137|6@0+ (0.0625,0) [0|3.9375] "mps"  IDM
 SG_ RSDS_R_ObjDistYStd_15 : 143|6@0+ (0.1,0) [0|6] "m"  IDM
 SG_ RSDS_R_SGU8_Checksum3 : 135|8@0+ (1,0) [0|255] ""  IDM
 SG_ RSDS_R_SGU8_RollingCounter2 : 123|4@0+ (1,0) [0|15] ""  IDM
 SG_ RSDS_R_ObjMotionType_15 : 127|3@0+ (1,0) [0|7] ""  IDM
 SG_ RSDS_R_ObjMeasured_15 : 113|2@0+ (1,0) [0|3] ""  IDM
 SG_ RSDS_R_ObjRelAccelY_15 : 107|10@0+ (0.03125,-16) [-16|15.96875] "mps2"  IDM
 SG_ RSDS_R_ObjRelAccelX_15 : 101|10@0+ (0.03125,-16) [-16|15.96875] "mps2"  IDM
 SG_ RSDS_R_ObjRelVelY_15 : 82|13@0+ (0.0312,-128) [-128|126.9976] "mps"  IDM
 SG_ RSDS_R_ObjRelVelX_15 : 79|13@0+ (0.0312,-128) [-128|126.9976] "mps"  IDM
 SG_ RSDS_R_SGU8_Checksum2 : 71|8@0+ (1,0) [0|255] ""  IDM
 SG_ RSDS_R_SGU8_RollingCounter1 : 59|4@0+ (1,0) [0|15] ""  IDM
 SG_ RSDS_R_ObjType_15 : 63|4@0+ (1,0) [0|15] ""  IDM
 SG_ RSDS_R_ObjDistXStd_15 : 54|6@0+ (0.1,0) [0|6] "m"  IDM
 SG_ RSDS_R_ObjDistY_15 : 33|11@0+ (0.125,-128) [-128|127.875] "m"  IDM
 SG_ RSDS_R_ObjDistX_15 : 29|12@0+ (0.0625,-128) [-128|127.9375] "m"  IDM
 SG_ RSDS_R_ObjObstacleProb_15 : 18|5@0+ (0.03326,0) [0|1] ""  IDM
 SG_ RSDS_R_ObjExistProb_15 : 23|5@0+ (0.03326,0) [0|1] ""  IDM
 SG_ RSDS_R_ObjID_15 : 15|8@0+ (1,0) [0|255] ""  IDM
 SG_ RSDS_R_SGU8_Checksum1 : 7|8@0+ (1,0) [0|255] ""  IDM

BO_ 1432 RSDS_R_SGU9: 64 CR_RR
 SG_ RSDS_R_SGU9_RollingCounter8 : 507|4@0+ (1,0) [0|14] "NoUnit"  IDM
 SG_ RSDS_R_SGU9_BlockCounter : 511|4@0+ (1,0) [0|15] "NoUnit"  IDM
 SG_ RSDS_R_HWATargetValidity_18 : 496|1@0+ (1,0) [0|1] "NoUnit"  IDM
 SG_ RSDS_R_ObjRefPoint_18 : 499|3@0+ (1,0) [0|7] "NoUnit"  IDM
 SG_ RSDS_R_ObjRCS_18 : 493|10@0+ (0.125,-50) [-50|70] "dBsm"  IDM
 SG_ RSDS_R_ObjYawrate_18 : 473|12@0+ (0.002,-3.14) [-3.14|5.05] "radPerSec"  IDM
 SG_ RSDS_R_ObjHeading_18 : 469|12@0+ (0.002,-3.14) [-3.14|5.05] "rad"  IDM
 SG_ RSDS_R_ObjLength_18 : 463|10@0+ (0.05,0) [0|20] "m"  IDM
 SG_ RSDS_R_SGU9_Checksum8 : 455|8@0+ (1,0) [0|255] "NoUnit"  IDM
 SG_ RSDS_R_SGU9_RollingCounter7 : 443|4@0+ (1,0) [0|14] "NoUnit"  IDM
 SG_ RSDS_R_ObjMotionDirection_18 : 447|3@0+ (1,0) [0|7] "NoUnit"  IDM
 SG_ RSDS_R_ObjAge_18 : 439|8@0+ (1,0) [0|255] "NoUnit"  IDM
 SG_ RSDS_R_ObjWidth_18 : 417|10@0+ (0.01,0) [0|5] "m"  IDM
 SG_ RSDS_R_ObjRAccelYStd_18 : 423|6@0+ (0.0625,0) [0|3.9375] "MtrPerSecSq"  IDM
 SG_ RSDS_R_ObjRAccelXStd_18 : 413|6@0+ (0.0625,0) [0|3.9375] "MtrPerSecSq"  IDM
 SG_ RSDS_R_ObjRelVelYStd_18 : 403|6@0+ (0.0625,0) [0|3.9375] "mps"  IDM
 SG_ RSDS_R_ObjRelVelXStd_18 : 393|6@0+ (0.0625,0) [0|3.9375] "mps"  IDM
 SG_ RSDS_R_ObjDistYStd_18 : 399|6@0+ (0.1,0) [0|6.3] "m"  IDM
 SG_ RSDS_R_SGU9_Checksum7 : 391|8@0+ (1,0) [0|255] "NoUnit"  IDM
 SG_ RSDS_R_SGU9_RollingCounter6 : 379|4@0+ (1,0) [0|14] "NoUnit"  IDM
 SG_ RSDS_R_ObjMotionType_18 : 383|3@0+ (1,0) [0|7] "NoUnit"  IDM
 SG_ RSDS_R_ObjMeasured_18 : 369|2@0+ (1,0) [0|3] "NoUnit"  IDM
 SG_ RSDS_R_ObjRelAccelY_18 : 363|10@0+ (0.03125,-16) [-16|15.96875] "MtrPerSecSq"  IDM
 SG_ RSDS_R_ObjRelAccelX_18 : 357|10@0+ (0.03125,-16) [-16|15.96875] "MtrPerSecSq"  IDM
 SG_ RSDS_R_ObjRelVelY_18 : 338|13@0+ (0.0312,-128) [-128|126.9976] "mps"  IDM
 SG_ RSDS_R_ObjRelVelX_18 : 335|13@0+ (0.0312,-128) [-128|126.9976] "mps"  IDM
 SG_ RSDS_R_SGU9_Checksum6 : 327|8@0+ (1,0) [0|255] "NoUnit"  IDM
 SG_ RSDS_R_SGU9_RollingCounter5 : 315|4@0+ (1,0) [0|14] "NoUnit"  IDM
 SG_ RSDS_R_ObjType_18 : 319|4@0+ (1,0) [0|15] "NoUnit"  IDM
 SG_ RSDS_R_ObjDistXStd_18 : 310|6@0+ (0.1,0) [0|6.3] "m"  IDM
 SG_ RSDS_R_ObjDistY_18 : 289|11@0+ (0.125,-128) [-128|127.875] "m"  IDM
 SG_ RSDS_R_ObjDistX_18 : 285|12@0+ (0.0625,-128) [-128|126.9375] "m"  IDM
 SG_ RSDS_R_ObjObstacleProb_18 : 274|5@0+ (0.03326,0) [0|1.03106] "NoUnit"  IDM
 SG_ RSDS_R_ObjExistProb_18 : 279|5@0+ (0.03326,0) [0|1.03106] "NoUnit"  IDM
 SG_ RSDS_R_ObjID_18 : 271|8@0+ (1,0) [0|255] "NoUnit"  IDM
 SG_ RSDS_R_SGU9_Checksum5 : 263|8@0+ (1,0) [0|255] "NoUnit"  IDM
 SG_ RSDS_R_SGU9_RollingCounter4 : 251|4@0+ (1,0) [0|14] "NoUnit"  IDM
 SG_ RSDS_R_HWATargetValidity_17 : 240|1@0+ (1,0) [0|1] "NoUnit"  IDM
 SG_ RSDS_R_ObjRefPoint_17 : 243|3@0+ (1,0) [0|7] "NoUnit"  IDM
 SG_ RSDS_R_ObjRCS_17 : 237|10@0+ (0.125,-50) [-50|70] "dBsm"  IDM
 SG_ RSDS_R_ObjYawrate_17 : 217|12@0+ (0.002,-3.14) [-3.14|5.05] "radPerSec"  IDM
 SG_ RSDS_R_ObjHeading_17 : 213|12@0+ (0.002,-3.14) [-3.14|5.05] "rad"  IDM
 SG_ RSDS_R_ObjLength_17 : 207|10@0+ (0.05,0) [0|20] "m"  IDM
 SG_ RSDS_R_SGU9_Checksum4 : 199|8@0+ (1,0) [0|255] "NoUnit"  IDM
 SG_ RSDS_R_SGU9_RollingCounter3 : 187|4@0+ (1,0) [0|14] "NoUnit"  IDM
 SG_ RSDS_R_ObjMotionDirection_17 : 191|3@0+ (1,0) [0|7] "NoUnit"  IDM
 SG_ RSDS_R_ObjAge_17 : 183|8@0+ (1,0) [0|255] "NoUnit"  IDM
 SG_ RSDS_R_ObjWidth_17 : 161|10@0+ (0.01,0) [0|5] "m"  IDM
 SG_ RSDS_R_ObjRAccelYStd_17 : 167|6@0+ (0.0625,0) [0|3.9375] "MtrPerSecSq"  IDM
 SG_ RSDS_R_ObjRAccelXStd_17 : 157|6@0+ (0.0625,0) [0|3.9375] "MtrPerSecSq"  IDM
 SG_ RSDS_R_ObjRelVelYStd_17 : 147|6@0+ (0.0625,0) [0|3.9375] "mps"  IDM
 SG_ RSDS_R_ObjRelVelXStd_17 : 137|6@0+ (0.0625,0) [0|3.9375] "mps"  IDM
 SG_ RSDS_R_ObjDistYStd_17 : 143|6@0+ (0.1,0) [0|6.3] "m"  IDM
 SG_ RSDS_R_SGU9_Checksum3 : 135|8@0+ (1,0) [0|255] "NoUnit"  IDM
 SG_ RSDS_R_SGU9_RollingCounter2 : 123|4@0+ (1,0) [0|14] "NoUnit"  IDM
 SG_ RSDS_R_ObjMotionType_17 : 127|3@0+ (1,0) [0|7] "NoUnit"  IDM
 SG_ RSDS_R_ObjMeasured_17 : 113|2@0+ (1,0) [0|3] "NoUnit"  IDM
 SG_ RSDS_R_ObjRelAccelY_17 : 107|10@0+ (0.03125,-16) [-16|15.96875] "MtrPerSecSq"  IDM
 SG_ RSDS_R_ObjRelAccelX_17 : 101|10@0+ (0.03125,-16) [-16|15.96875] "MtrPerSecSq"  IDM
 SG_ RSDS_R_ObjRelVelY_17 : 82|13@0+ (0.0312,-128) [-128|126.9976] "mps"  IDM
 SG_ RSDS_R_ObjRelVelX_17 : 79|13@0+ (0.0312,-128) [-128|126.9976] "mps"  IDM
 SG_ RSDS_R_SGU9_Checksum2 : 71|8@0+ (1,0) [0|255] "NoUnit"  IDM
 SG_ RSDS_R_SGU9_RollingCounter1 : 59|4@0+ (1,0) [0|14] "NoUnit"  IDM
 SG_ RSDS_R_ObjType_17 : 63|4@0+ (1,0) [0|15] "NoUnit"  IDM
 SG_ RSDS_R_ObjDistXStd_17 : 54|6@0+ (0.1,0) [0|6.3] "m"  IDM
 SG_ RSDS_R_ObjDistY_17 : 33|11@0+ (0.125,-128) [-128|127.875] "m"  IDM
 SG_ RSDS_R_ObjDistX_17 : 29|12@0+ (0.0625,-128) [-128|126.9375] "m"  IDM
 SG_ RSDS_R_ObjObstacleProb_17 : 18|5@0+ (0.03326,0) [0|1.03106] "NoUnit"  IDM
 SG_ RSDS_R_ObjExistProb_17 : 23|5@0+ (0.03326,0) [0|1.03106] "NoUnit"  IDM
 SG_ RSDS_R_ObjID_17 : 15|8@0+ (1,0) [0|255] "NoUnit"  IDM
 SG_ RSDS_R_SGU9_Checksum1 : 7|8@0+ (1,0) [0|255] "NoUnit"  IDM

BO_ 1433 RSDS_R_SGU10: 64 CR_RR
 SG_ RSDS_R_SGU10_RollingCounter8 : 507|4@0+ (1,0) [0|14] "NoUnit"  IDM
 SG_ RSDS_R_SGU10_BlockCounter : 511|4@0+ (1,0) [0|15] "NoUnit"  IDM
 SG_ RSDS_R_HWATargetValidity_20 : 496|1@0+ (1,0) [0|1] "NoUnit"  IDM
 SG_ RSDS_R_ObjRefPoint_20 : 499|3@0+ (1,0) [0|7] "NoUnit"  IDM
 SG_ RSDS_R_ObjRCS_20 : 493|10@0+ (0.125,-50) [-50|70] "dBsm"  IDM
 SG_ RSDS_R_ObjYawrate_20 : 473|12@0+ (0.002,-3.14) [-3.14|5.05] "radPerSec"  IDM
 SG_ RSDS_R_ObjHeading_20 : 469|12@0+ (0.002,-3.14) [-3.14|5.05] "rad"  IDM
 SG_ RSDS_R_ObjLength_20 : 463|10@0+ (0.05,0) [0|20] "m"  IDM
 SG_ RSDS_R_SGU10_Checksum8 : 455|8@0+ (1,0) [0|255] "NoUnit"  IDM
 SG_ RSDS_R_SGU10_RollingCounter7 : 443|4@0+ (1,0) [0|14] "NoUnit"  IDM
 SG_ RSDS_R_ObjMotionDirection_20 : 447|3@0+ (1,0) [0|7] "NoUnit"  IDM
 SG_ RSDS_R_ObjAge_20 : 439|8@0+ (1,0) [0|255] "NoUnit"  IDM
 SG_ RSDS_R_ObjWidth_20 : 417|10@0+ (0.01,0) [0|5] "m"  IDM
 SG_ RSDS_R_ObjRAccelYStd_20 : 423|6@0+ (0.0625,0) [0|3.9375] "MtrPerSecSq"  IDM
 SG_ RSDS_R_ObjRAccelXStd_20 : 413|6@0+ (0.0625,0) [0|3.9375] "MtrPerSecSq"  IDM
 SG_ RSDS_R_ObjRelVelYStd_20 : 403|6@0+ (0.0625,0) [0|3.9375] "mps"  IDM
 SG_ RSDS_R_ObjRelVelXStd_20 : 393|6@0+ (0.0625,0) [0|3.9375] "mps"  IDM
 SG_ RSDS_R_ObjDistYStd_20 : 399|6@0+ (0.1,0) [0|6.3] "m"  IDM
 SG_ RSDS_R_SGU10_Checksum7 : 391|8@0+ (1,0) [0|255] "NoUnit"  IDM
 SG_ RSDS_R_SGU10_RollingCounter6 : 379|4@0+ (1,0) [0|14] "NoUnit"  IDM
 SG_ RSDS_R_ObjMotionType_20 : 383|3@0+ (1,0) [0|7] "NoUnit"  IDM
 SG_ RSDS_R_ObjMeasured_20 : 369|2@0+ (1,0) [0|3] "NoUnit"  IDM
 SG_ RSDS_R_ObjRelAccelY_20 : 363|10@0+ (0.03125,-16) [-16|15.96875] "MtrPerSecSq"  IDM
 SG_ RSDS_R_ObjRelAccelX_20 : 357|10@0+ (0.03125,-16) [-16|15.96875] "MtrPerSecSq"  IDM
 SG_ RSDS_R_ObjRelVelY_20 : 338|13@0+ (0.0312,-128) [-128|126.9976] "mps"  IDM
 SG_ RSDS_R_ObjRelVelX_20 : 335|13@0+ (0.0312,-128) [-128|126.9976] "mps"  IDM
 SG_ RSDS_R_SGU10_Checksum6 : 327|8@0+ (1,0) [0|255] "NoUnit"  IDM
 SG_ RSDS_R_SGU10_RollingCounter5 : 315|4@0+ (1,0) [0|14] "NoUnit"  IDM
 SG_ RSDS_R_ObjType_20 : 319|4@0+ (1,0) [0|15] "NoUnit"  IDM
 SG_ RSDS_R_ObjDistXStd_20 : 310|6@0+ (0.1,0) [0|6.3] "m"  IDM
 SG_ RSDS_R_ObjDistY_20 : 289|11@0+ (0.125,-128) [-128|127.875] "m"  IDM
 SG_ RSDS_R_ObjDistX_20 : 285|12@0+ (0.0625,-128) [-128|126.9375] "m"  IDM
 SG_ RSDS_R_ObjObstacleProb_20 : 274|5@0+ (0.03326,0) [0|1.03106] "NoUnit"  IDM
 SG_ RSDS_R_ObjExistProb_20 : 279|5@0+ (0.03326,0) [0|1.03106] "NoUnit"  IDM
 SG_ RSDS_R_ObjID_20 : 271|8@0+ (1,0) [0|255] "NoUnit"  IDM
 SG_ RSDS_R_SGU10_Checksum5 : 263|8@0+ (1,0) [0|255] "NoUnit"  IDM
 SG_ RSDS_R_SGU10_RollingCounter4 : 251|4@0+ (1,0) [0|14] "NoUnit"  IDM
 SG_ RSDS_R_HWATargetValidity_19 : 240|1@0+ (1,0) [0|1] "NoUnit"  IDM
 SG_ RSDS_R_ObjRefPoint_19 : 243|3@0+ (1,0) [0|7] "NoUnit"  IDM
 SG_ RSDS_R_ObjRCS_19 : 237|10@0+ (0.125,-50) [-50|70] "dBsm"  IDM
 SG_ RSDS_R_ObjYawrate_19 : 217|12@0+ (0.002,-3.14) [-3.14|5.05] "radPerSec"  IDM
 SG_ RSDS_R_ObjHeading_19 : 213|12@0+ (0.002,-3.14) [-3.14|5.05] "rad"  IDM
 SG_ RSDS_R_ObjLength_19 : 207|10@0+ (0.05,0) [0|20] "m"  IDM
 SG_ RSDS_R_SGU10_Checksum4 : 199|8@0+ (1,0) [0|255] "NoUnit"  IDM
 SG_ RSDS_R_SGU10_RollingCounter3 : 187|4@0+ (1,0) [0|14] "NoUnit"  IDM
 SG_ RSDS_R_ObjMotionDirection_19 : 191|3@0+ (1,0) [0|7] "NoUnit"  IDM
 SG_ RSDS_R_ObjAge_19 : 183|8@0+ (1,0) [0|255] "NoUnit"  IDM
 SG_ RSDS_R_ObjWidth_19 : 161|10@0+ (0.01,0) [0|5] "m"  IDM
 SG_ RSDS_R_ObjRAccelYStd_19 : 167|6@0+ (0.0625,0) [0|3.9375] "MtrPerSecSq"  IDM
 SG_ RSDS_R_ObjRAccelXStd_19 : 157|6@0+ (0.0625,0) [0|3.9375] "MtrPerSecSq"  IDM
 SG_ RSDS_R_ObjRelVelYStd_19 : 147|6@0+ (0.0625,0) [0|3.9375] "mps"  IDM
 SG_ RSDS_R_ObjRelVelXStd_19 : 137|6@0+ (0.0625,0) [0|3.9375] "mps"  IDM
 SG_ RSDS_R_ObjDistYStd_19 : 143|6@0+ (0.1,0) [0|6.3] "m"  IDM
 SG_ RSDS_R_SGU10_Checksum3 : 135|8@0+ (1,0) [0|255] "NoUnit"  IDM
 SG_ RSDS_R_SGU10_RollingCounter2 : 123|4@0+ (1,0) [0|14] "NoUnit"  IDM
 SG_ RSDS_R_ObjMotionType_19 : 127|3@0+ (1,0) [0|7] "NoUnit"  IDM
 SG_ RSDS_R_ObjMeasured_19 : 113|2@0+ (1,0) [0|3] "NoUnit"  IDM
 SG_ RSDS_R_ObjRelAccelY_19 : 107|10@0+ (0.03125,-16) [-16|15.96875] "MtrPerSecSq"  IDM
 SG_ RSDS_R_ObjRelAccelX_19 : 101|10@0+ (0.03125,-16) [-16|15.96875] "MtrPerSecSq"  IDM
 SG_ RSDS_R_ObjRelVelY_19 : 82|13@0+ (0.0312,-128) [-128|126.9976] "mps"  IDM
 SG_ RSDS_R_ObjRelVelX_19 : 79|13@0+ (0.0312,-128) [-128|126.9976] "mps"  IDM
 SG_ RSDS_R_SGU10_Checksum2 : 71|8@0+ (1,0) [0|255] "NoUnit"  IDM
 SG_ RSDS_R_SGU10_RollingCounter1 : 59|4@0+ (1,0) [0|14] "NoUnit"  IDM
 SG_ RSDS_R_ObjType_19 : 63|4@0+ (1,0) [0|15] "NoUnit"  IDM
 SG_ RSDS_R_ObjDistXStd_19 : 54|6@0+ (0.1,0) [0|6.3] "m"  IDM
 SG_ RSDS_R_ObjDistY_19 : 33|11@0+ (0.125,-128) [-128|127.875] "m"  IDM
 SG_ RSDS_R_ObjDistX_19 : 29|12@0+ (0.0625,-128) [-128|126.9375] "m"  IDM
 SG_ RSDS_R_ObjObstacleProb_19 : 18|5@0+ (0.03326,0) [0|1.03106] "NoUnit"  IDM
 SG_ RSDS_R_ObjExistProb_19 : 23|5@0+ (0.03326,0) [0|1.03106] "NoUnit"  IDM
 SG_ RSDS_R_ObjID_19 : 15|8@0+ (1,0) [0|255] "NoUnit"  IDM
 SG_ RSDS_R_SGU10_Checksum1 : 7|8@0+ (1,0) [0|255] "NoUnit"  IDM

BO_ 1434 RSDS_R_SGU11: 64 CR_RR
 SG_ RSDS_R_SGU11_RollingCounter8 : 507|4@0+ (1,0) [0|14] "NoUnit"  IDM
 SG_ RSDS_R_SGU11_BlockCounter : 511|4@0+ (1,0) [0|15] "NoUnit"  IDM
 SG_ RSDS_R_HWATargetValidity_22 : 496|1@0+ (1,0) [0|1] "NoUnit"  IDM
 SG_ RSDS_R_ObjRefPoint_22 : 499|3@0+ (1,0) [0|7] "NoUnit"  IDM
 SG_ RSDS_R_ObjRCS_22 : 493|10@0+ (0.125,-50) [-50|70] "dBsm"  IDM
 SG_ RSDS_R_ObjYawrate_22 : 473|12@0+ (0.002,-3.14) [-3.14|5.05] "radPerSec"  IDM
 SG_ RSDS_R_ObjHeading_22 : 469|12@0+ (0.002,-3.14) [-3.14|5.05] "rad"  IDM
 SG_ RSDS_R_ObjLength_22 : 463|10@0+ (0.05,0) [0|20] "m"  IDM
 SG_ RSDS_R_SGU11_Checksum8 : 455|8@0+ (1,0) [0|255] "NoUnit"  IDM
 SG_ RSDS_R_SGU11_RollingCounter7 : 443|4@0+ (1,0) [0|14] "NoUnit"  IDM
 SG_ RSDS_R_ObjMotionDirection_22 : 447|3@0+ (1,0) [0|7] "NoUnit"  IDM
 SG_ RSDS_R_ObjAge_22 : 439|8@0+ (1,0) [0|255] "NoUnit"  IDM
 SG_ RSDS_R_ObjWidth_22 : 417|10@0+ (0.01,0) [0|5] "m"  IDM
 SG_ RSDS_R_ObjRAccelYStd_22 : 423|6@0+ (0.0625,0) [0|3.9375] "MtrPerSecSq"  IDM
 SG_ RSDS_R_ObjRAccelXStd_22 : 413|6@0+ (0.0625,0) [0|3.9375] "MtrPerSecSq"  IDM
 SG_ RSDS_R_ObjRelVelYStd_22 : 403|6@0+ (0.0625,0) [0|3.9375] "mps"  IDM
 SG_ RSDS_R_ObjRelVelXStd_22 : 393|6@0+ (0.0625,0) [0|3.9375] "mps"  IDM
 SG_ RSDS_R_ObjDistYStd_22 : 399|6@0+ (0.1,0) [0|6.3] "m"  IDM
 SG_ RSDS_R_SGU11_Checksum7 : 391|8@0+ (1,0) [0|255] "NoUnit"  IDM
 SG_ RSDS_R_SGU11_RollingCounter6 : 379|4@0+ (1,0) [0|14] "NoUnit"  IDM
 SG_ RSDS_R_ObjMotionType_22 : 383|3@0+ (1,0) [0|7] "NoUnit"  IDM
 SG_ RSDS_R_ObjMeasured_22 : 369|2@0+ (1,0) [0|3] "NoUnit"  IDM
 SG_ RSDS_R_ObjRelAccelY_22 : 363|10@0+ (0.03125,-16) [-16|15.96875] "MtrPerSecSq"  IDM
 SG_ RSDS_R_ObjRelAccelX_22 : 357|10@0+ (0.03125,-16) [-16|15.96875] "MtrPerSecSq"  IDM
 SG_ RSDS_R_ObjRelVelY_22 : 338|13@0+ (0.0312,-128) [-128|126.9976] "mps"  IDM
 SG_ RSDS_R_ObjRelVelX_22 : 335|13@0+ (0.0312,-128) [-128|126.9976] "mps"  IDM
 SG_ RSDS_R_SGU11_Checksum6 : 327|8@0+ (1,0) [0|255] "NoUnit"  IDM
 SG_ RSDS_R_SGU11_RollingCounter5 : 315|4@0+ (1,0) [0|14] "NoUnit"  IDM
 SG_ RSDS_R_ObjType_22 : 319|4@0+ (1,0) [0|15] "NoUnit"  IDM
 SG_ RSDS_R_ObjDistXStd_22 : 310|6@0+ (0.1,0) [0|6.3] "m"  IDM
 SG_ RSDS_R_ObjDistY_22 : 289|11@0+ (0.125,-128) [-128|127.875] "m"  IDM
 SG_ RSDS_R_ObjDistX_22 : 285|12@0+ (0.0625,-128) [-128|126.9375] "m"  IDM
 SG_ RSDS_R_ObjObstacleProb_22 : 274|5@0+ (0.03326,0) [0|1.03106] "NoUnit"  IDM
 SG_ RSDS_R_ObjExistProb_22 : 279|5@0+ (0.03326,0) [0|1.03106] "NoUnit"  IDM
 SG_ RSDS_R_ObjID_22 : 271|8@0+ (1,0) [0|255] "NoUnit"  IDM
 SG_ RSDS_R_SGU11_Checksum5 : 263|8@0+ (1,0) [0|255] "NoUnit"  IDM
 SG_ RSDS_R_SGU11_RollingCounter4 : 251|4@0+ (1,0) [0|14] "NoUnit"  IDM
 SG_ RSDS_R_HWATargetValidity_21 : 240|1@0+ (1,0) [0|1] "NoUnit"  IDM
 SG_ RSDS_R_ObjRefPoint_21 : 243|3@0+ (1,0) [0|7] "NoUnit"  IDM
 SG_ RSDS_R_ObjRCS_21 : 237|10@0+ (0.125,-50) [-50|70] "dBsm"  IDM
 SG_ RSDS_R_ObjYawrate_21 : 217|12@0+ (0.002,-3.14) [-3.14|5.05] "radPerSec"  IDM
 SG_ RSDS_R_ObjHeading_21 : 213|12@0+ (0.002,-3.14) [-3.14|5.05] "rad"  IDM
 SG_ RSDS_R_ObjLength_21 : 207|10@0+ (0.05,0) [0|20] "m"  IDM
 SG_ RSDS_R_SGU11_Checksum4 : 199|8@0+ (1,0) [0|255] "NoUnit"  IDM
 SG_ RSDS_R_SGU11_RollingCounter3 : 187|4@0+ (1,0) [0|14] "NoUnit"  IDM
 SG_ RSDS_R_ObjMotionDirection_21 : 191|3@0+ (1,0) [0|7] "NoUnit"  IDM
 SG_ RSDS_R_ObjAge_21 : 183|8@0+ (1,0) [0|255] "NoUnit"  IDM
 SG_ RSDS_R_ObjWidth_21 : 161|10@0+ (0.01,0) [0|5] "m"  IDM
 SG_ RSDS_R_ObjRAccelYStd_21 : 167|6@0+ (0.0625,0) [0|3.9375] "MtrPerSecSq"  IDM
 SG_ RSDS_R_ObjRAccelXStd_21 : 157|6@0+ (0.0625,0) [0|3.9375] "MtrPerSecSq"  IDM
 SG_ RSDS_R_ObjRelVelYStd_21 : 147|6@0+ (0.0625,0) [0|3.9375] "mps"  IDM
 SG_ RSDS_R_ObjRelVelXStd_21 : 137|6@0+ (0.0625,0) [0|3.9375] "mps"  IDM
 SG_ RSDS_R_ObjDistYStd_21 : 143|6@0+ (0.1,0) [0|6.3] "m"  IDM
 SG_ RSDS_R_SGU11_Checksum3 : 135|8@0+ (1,0) [0|255] "NoUnit"  IDM
 SG_ RSDS_R_SGU11_RollingCounter2 : 123|4@0+ (1,0) [0|14] "NoUnit"  IDM
 SG_ RSDS_R_ObjMotionType_21 : 127|3@0+ (1,0) [0|7] "NoUnit"  IDM
 SG_ RSDS_R_ObjMeasured_21 : 113|2@0+ (1,0) [0|3] "NoUnit"  IDM
 SG_ RSDS_R_ObjRelAccelY_21 : 107|10@0+ (0.03125,-16) [-16|15.96875] "MtrPerSecSq"  IDM
 SG_ RSDS_R_ObjRelAccelX_21 : 101|10@0+ (0.03125,-16) [-16|15.96875] "MtrPerSecSq"  IDM
 SG_ RSDS_R_ObjRelVelY_21 : 82|13@0+ (0.0312,-128) [-128|126.9976] "mps"  IDM
 SG_ RSDS_R_ObjRelVelX_21 : 79|13@0+ (0.0312,-128) [-128|126.9976] "mps"  IDM
 SG_ RSDS_R_SGU11_Checksum2 : 71|8@0+ (1,0) [0|255] "NoUnit"  IDM
 SG_ RSDS_R_SGU11_RollingCounter1 : 59|4@0+ (1,0) [0|14] "NoUnit"  IDM
 SG_ RSDS_R_ObjType_21 : 63|4@0+ (1,0) [0|15] "NoUnit"  IDM
 SG_ RSDS_R_ObjDistXStd_21 : 54|6@0+ (0.1,0) [0|6.3] "m"  IDM
 SG_ RSDS_R_ObjDistY_21 : 33|11@0+ (0.125,-128) [-128|127.875] "m"  IDM
 SG_ RSDS_R_ObjDistX_21 : 29|12@0+ (0.0625,-128) [-128|126.9375] "m"  IDM
 SG_ RSDS_R_ObjObstacleProb_21 : 18|5@0+ (0.03326,0) [0|1.03106] "NoUnit"  IDM
 SG_ RSDS_R_ObjExistProb_21 : 23|5@0+ (0.03326,0) [0|1.03106] "NoUnit"  IDM
 SG_ RSDS_R_ObjID_21 : 15|8@0+ (1,0) [0|255] "NoUnit"  IDM
 SG_ RSDS_R_SGU11_Checksum1 : 7|8@0+ (1,0) [0|255] "NoUnit"  IDM

BO_ 1435 RSDS_R_SGU12: 64 CR_RR
 SG_ RSDS_R_SGU12_RollingCounter8 : 507|4@0+ (1,0) [0|14] "NoUnit"  IDM
 SG_ RSDS_R_SGU12_BlockCounter : 511|4@0+ (1,0) [0|15] "NoUnit"  IDM
 SG_ RSDS_R_HWATargetValidity_24 : 496|1@0+ (1,0) [0|1] "NoUnit"  IDM
 SG_ RSDS_R_ObjRefPoint_24 : 499|3@0+ (1,0) [0|7] "NoUnit"  IDM
 SG_ RSDS_R_ObjRCS_24 : 493|10@0+ (0.125,-50) [-50|70] "dBsm"  IDM
 SG_ RSDS_R_ObjYawrate_24 : 473|12@0+ (0.002,-3.14) [-3.14|5.05] "radPerSec"  IDM
 SG_ RSDS_R_ObjHeading_24 : 469|12@0+ (0.002,-3.14) [-3.14|5.05] "rad"  IDM
 SG_ RSDS_R_ObjLength_24 : 463|10@0+ (0.05,0) [0|20] "m"  IDM
 SG_ RSDS_R_SGU12_Checksum8 : 455|8@0+ (1,0) [0|255] "NoUnit"  IDM
 SG_ RSDS_R_SGU12_RollingCounter7 : 443|4@0+ (1,0) [0|14] "NoUnit"  IDM
 SG_ RSDS_R_ObjMotionDirection_24 : 447|3@0+ (1,0) [0|7] "NoUnit"  IDM
 SG_ RSDS_R_ObjAge_24 : 439|8@0+ (1,0) [0|255] "NoUnit"  IDM
 SG_ RSDS_R_ObjWidth_24 : 417|10@0+ (0.01,0) [0|5] "m"  IDM
 SG_ RSDS_R_ObjRAccelYStd_24 : 423|6@0+ (0.0625,0) [0|3.9375] "MtrPerSecSq"  IDM
 SG_ RSDS_R_ObjRAccelXStd_24 : 413|6@0+ (0.0625,0) [0|3.9375] "MtrPerSecSq"  IDM
 SG_ RSDS_R_ObjRelVelYStd_24 : 403|6@0+ (0.0625,0) [0|3.9375] "mps"  IDM
 SG_ RSDS_R_ObjRelVelXStd_24 : 393|6@0+ (0.0625,0) [0|3.9375] "mps"  IDM
 SG_ RSDS_R_ObjDistYStd_24 : 399|6@0+ (0.1,0) [0|6.3] "m"  IDM
 SG_ RSDS_R_SGU12_Checksum7 : 391|8@0+ (1,0) [0|255] "NoUnit"  IDM
 SG_ RSDS_R_SGU12_RollingCounter6 : 379|4@0+ (1,0) [0|14] "NoUnit"  IDM
 SG_ RSDS_R_ObjMotionType_24 : 383|3@0+ (1,0) [0|7] "NoUnit"  IDM
 SG_ RSDS_R_ObjMeasured_24 : 369|2@0+ (1,0) [0|3] "NoUnit"  IDM
 SG_ RSDS_R_ObjRelAccelY_24 : 363|10@0+ (0.03125,-16) [-16|15.96875] "MtrPerSecSq"  IDM
 SG_ RSDS_R_ObjRelAccelX_24 : 357|10@0+ (0.03125,-16) [-16|15.96875] "MtrPerSecSq"  IDM
 SG_ RSDS_R_ObjRelVelY_24 : 338|13@0+ (0.0312,-128) [-128|126.9976] "mps"  IDM
 SG_ RSDS_R_ObjRelVelX_24 : 335|13@0+ (0.0312,-128) [-128|126.9976] "mps"  IDM
 SG_ RSDS_R_SGU12_Checksum6 : 327|8@0+ (1,0) [0|255] "NoUnit"  IDM
 SG_ RSDS_R_SGU12_RollingCounter5 : 315|4@0+ (1,0) [0|14] "NoUnit"  IDM
 SG_ RSDS_R_ObjType_24 : 319|4@0+ (1,0) [0|15] "NoUnit"  IDM
 SG_ RSDS_R_ObjDistXStd_24 : 310|6@0+ (0.1,0) [0|6.3] "m"  IDM
 SG_ RSDS_R_ObjDistY_24 : 289|11@0+ (0.125,-128) [-128|127.875] "m"  IDM
 SG_ RSDS_R_ObjDistX_24 : 285|12@0+ (0.0625,-128) [-128|126.9375] "m"  IDM
 SG_ RSDS_R_ObjObstacleProb_24 : 274|5@0+ (0.03326,0) [0|1.03106] "NoUnit"  IDM
 SG_ RSDS_R_ObjExistProb_24 : 279|5@0+ (0.03326,0) [0|1.03106] "NoUnit"  IDM
 SG_ RSDS_R_ObjID_24 : 271|8@0+ (1,0) [0|255] "NoUnit"  IDM
 SG_ RSDS_R_SGU12_Checksum5 : 263|8@0+ (1,0) [0|255] "NoUnit"  IDM
 SG_ RSDS_R_SGU12_RollingCounter4 : 251|4@0+ (1,0) [0|14] "NoUnit"  IDM
 SG_ RSDS_R_HWATargetValidity_23 : 240|1@0+ (1,0) [0|1] "NoUnit"  IDM
 SG_ RSDS_R_ObjRefPoint_23 : 243|3@0+ (1,0) [0|7] "NoUnit"  IDM
 SG_ RSDS_R_ObjRCS_23 : 237|10@0+ (0.125,-50) [-50|70] "dBsm"  IDM
 SG_ RSDS_R_ObjYawrate_23 : 217|12@0+ (0.002,-3.14) [-3.14|5.05] "radPerSec"  IDM
 SG_ RSDS_R_ObjHeading_23 : 213|12@0+ (0.002,-3.14) [-3.14|5.05] "rad"  IDM
 SG_ RSDS_R_ObjLength_23 : 207|10@0+ (0.05,0) [0|20] "m"  IDM
 SG_ RSDS_R_SGU12_Checksum4 : 199|8@0+ (1,0) [0|255] "NoUnit"  IDM
 SG_ RSDS_R_SGU12_RollingCounter3 : 187|4@0+ (1,0) [0|14] "NoUnit"  IDM
 SG_ RSDS_R_ObjMotionDirection_23 : 191|3@0+ (1,0) [0|7] "NoUnit"  IDM
 SG_ RSDS_R_ObjAge_23 : 183|8@0+ (1,0) [0|255] "NoUnit"  IDM
 SG_ RSDS_R_ObjWidth_23 : 161|10@0+ (0.01,0) [0|5] "m"  IDM
 SG_ RSDS_R_ObjRAccelYStd_23 : 167|6@0+ (0.0625,0) [0|3.9375] "MtrPerSecSq"  IDM
 SG_ RSDS_R_ObjRAccelXStd_23 : 157|6@0+ (0.0625,0) [0|3.9375] "MtrPerSecSq"  IDM
 SG_ RSDS_R_ObjRelVelYStd_23 : 147|6@0+ (0.0625,0) [0|3.9375] "mps"  IDM
 SG_ RSDS_R_ObjRelVelXStd_23 : 137|6@0+ (0.0625,0) [0|3.9375] "mps"  IDM
 SG_ RSDS_R_ObjDistYStd_23 : 143|6@0+ (0.1,0) [0|6.3] "m"  IDM
 SG_ RSDS_R_SGU12_Checksum3 : 135|8@0+ (1,0) [0|255] "NoUnit"  IDM
 SG_ RSDS_R_SGU12_RollingCounter2 : 123|4@0+ (1,0) [0|14] "NoUnit"  IDM
 SG_ RSDS_R_ObjMotionType_23 : 127|3@0+ (1,0) [0|7] "NoUnit"  IDM
 SG_ RSDS_R_ObjMeasured_23 : 113|2@0+ (1,0) [0|3] "NoUnit"  IDM
 SG_ RSDS_R_ObjRelAccelY_23 : 107|10@0+ (0.03125,-16) [-16|15.96875] "MtrPerSecSq"  IDM
 SG_ RSDS_R_ObjRelAccelX_23 : 101|10@0+ (0.03125,-16) [-16|15.96875] "MtrPerSecSq"  IDM
 SG_ RSDS_R_ObjRelVelY_23 : 82|13@0+ (0.0312,-128) [-128|126.9976] "mps"  IDM
 SG_ RSDS_R_ObjRelVelX_23 : 79|13@0+ (0.0312,-128) [-128|126.9976] "mps"  IDM
 SG_ RSDS_R_SGU12_Checksum2 : 71|8@0+ (1,0) [0|255] "NoUnit"  IDM
 SG_ RSDS_R_SGU12_RollingCounter1 : 59|4@0+ (1,0) [0|14] "NoUnit"  IDM
 SG_ RSDS_R_ObjType_23 : 63|4@0+ (1,0) [0|15] "NoUnit"  IDM
 SG_ RSDS_R_ObjDistXStd_23 : 54|6@0+ (0.1,0) [0|6.3] "m"  IDM
 SG_ RSDS_R_ObjDistY_23 : 33|11@0+ (0.125,-128) [-128|127.875] "m"  IDM
 SG_ RSDS_R_ObjDistX_23 : 29|12@0+ (0.0625,-128) [-128|126.9375] "m"  IDM
 SG_ RSDS_R_ObjObstacleProb_23 : 18|5@0+ (0.03326,0) [0|1.03106] "NoUnit"  IDM
 SG_ RSDS_R_ObjExistProb_23 : 23|5@0+ (0.03326,0) [0|1.03106] "NoUnit"  IDM
 SG_ RSDS_R_ObjID_23 : 15|8@0+ (1,0) [0|255] "NoUnit"  IDM
 SG_ RSDS_R_SGU12_Checksum1 : 7|8@0+ (1,0) [0|255] "NoUnit"  IDM

BO_ 1436 RSDS_R_SGU13: 64 CR_RR
 SG_ RSDS_R_SGU13_RollingCounter8 : 507|4@0+ (1,0) [0|14] "NoUnit"  IDM
 SG_ RSDS_R_SGU13_BlockCounter : 511|4@0+ (1,0) [0|15] "NoUnit"  IDM
 SG_ RSDS_R_HWATargetValidity_26 : 496|1@0+ (1,0) [0|1] "NoUnit"  IDM
 SG_ RSDS_R_ObjRefPoint_26 : 499|3@0+ (1,0) [0|7] "NoUnit"  IDM
 SG_ RSDS_R_ObjRCS_26 : 493|10@0+ (0.125,-50) [-50|70] "dBsm"  IDM
 SG_ RSDS_R_ObjYawrate_26 : 473|12@0+ (0.002,-3.14) [-3.14|5.05] "radPerSec"  IDM
 SG_ RSDS_R_ObjHeading_26 : 469|12@0+ (0.002,-3.14) [-3.14|5.05] "rad"  IDM
 SG_ RSDS_R_ObjLength_26 : 463|10@0+ (0.05,0) [0|20] "m"  IDM
 SG_ RSDS_R_SGU13_Checksum8 : 455|8@0+ (1,0) [0|255] "NoUnit"  IDM
 SG_ RSDS_R_SGU13_RollingCounter7 : 443|4@0+ (1,0) [0|14] "NoUnit"  IDM
 SG_ RSDS_R_ObjMotionDirection_26 : 447|3@0+ (1,0) [0|7] "NoUnit"  IDM
 SG_ RSDS_R_ObjAge_26 : 439|8@0+ (1,0) [0|255] "NoUnit"  IDM
 SG_ RSDS_R_ObjWidth_26 : 417|10@0+ (0.01,0) [0|5] "m"  IDM
 SG_ RSDS_R_ObjRAccelYStd_26 : 423|6@0+ (0.0625,0) [0|3.9375] "MtrPerSecSq"  IDM
 SG_ RSDS_R_ObjRAccelXStd_26 : 413|6@0+ (0.0625,0) [0|3.9375] "MtrPerSecSq"  IDM
 SG_ RSDS_R_ObjRelVelYStd_26 : 403|6@0+ (0.0625,0) [0|3.9375] "mps"  IDM
 SG_ RSDS_R_ObjRelVelXStd_26 : 393|6@0+ (0.0625,0) [0|3.9375] "mps"  IDM
 SG_ RSDS_R_ObjDistYStd_26 : 399|6@0+ (0.1,0) [0|6.3] "m"  IDM
 SG_ RSDS_R_SGU13_Checksum7 : 391|8@0+ (1,0) [0|255] "NoUnit"  IDM
 SG_ RSDS_R_SGU13_RollingCounter6 : 379|4@0+ (1,0) [0|14] "NoUnit"  IDM
 SG_ RSDS_R_ObjMotionType_26 : 383|3@0+ (1,0) [0|7] "NoUnit"  IDM
 SG_ RSDS_R_ObjMeasured_26 : 369|2@0+ (1,0) [0|3] "NoUnit"  IDM
 SG_ RSDS_R_ObjRelAccelY_26 : 363|10@0+ (0.03125,-16) [-16|15.96875] "MtrPerSecSq"  IDM
 SG_ RSDS_R_ObjRelAccelX_26 : 357|10@0+ (0.03125,-16) [-16|15.96875] "MtrPerSecSq"  IDM
 SG_ RSDS_R_ObjRelVelY_26 : 338|13@0+ (0.0312,-128) [-128|126.9976] "mps"  IDM
 SG_ RSDS_R_ObjRelVelX_26 : 335|13@0+ (0.0312,-128) [-128|126.9976] "mps"  IDM
 SG_ RSDS_R_SGU13_Checksum6 : 327|8@0+ (1,0) [0|255] "NoUnit"  IDM
 SG_ RSDS_R_SGU13_RollingCounter5 : 315|4@0+ (1,0) [0|14] "NoUnit"  IDM
 SG_ RSDS_R_ObjType_26 : 319|4@0+ (1,0) [0|15] "NoUnit"  IDM
 SG_ RSDS_R_ObjDistXStd_26 : 310|6@0+ (0.1,0) [0|6.3] "m"  IDM
 SG_ RSDS_R_ObjDistY_26 : 289|11@0+ (0.125,-128) [-128|127.875] "m"  IDM
 SG_ RSDS_R_ObjDistX_26 : 285|12@0+ (0.0625,-128) [-128|126.9375] "m"  IDM
 SG_ RSDS_R_ObjObstacleProb_26 : 274|5@0+ (0.03326,0) [0|1.03106] "NoUnit"  IDM
 SG_ RSDS_R_ObjExistProb_26 : 279|5@0+ (0.03326,0) [0|1.03106] "NoUnit"  IDM
 SG_ RSDS_R_ObjID_26 : 271|8@0+ (1,0) [0|255] "NoUnit"  IDM
 SG_ RSDS_R_SGU13_Checksum5 : 263|8@0+ (1,0) [0|255] "NoUnit"  IDM
 SG_ RSDS_R_SGU13_RollingCounter4 : 251|4@0+ (1,0) [0|14] "NoUnit"  IDM
 SG_ RSDS_R_HWATargetValidity_25 : 240|1@0+ (1,0) [0|1] "NoUnit"  IDM
 SG_ RSDS_R_ObjRefPoint_25 : 243|3@0+ (1,0) [0|7] "NoUnit"  IDM
 SG_ RSDS_R_ObjRCS_25 : 237|10@0+ (0.125,-50) [-50|70] "dBsm"  IDM
 SG_ RSDS_R_ObjYawrate_25 : 217|12@0+ (0.002,-3.14) [-3.14|5.05] "radPerSec"  IDM
 SG_ RSDS_R_ObjHeading_25 : 213|12@0+ (0.002,-3.14) [-3.14|5.05] "rad"  IDM
 SG_ RSDS_R_ObjLength_25 : 207|10@0+ (0.05,0) [0|20] "m"  IDM
 SG_ RSDS_R_SGU13_Checksum4 : 199|8@0+ (1,0) [0|255] "NoUnit"  IDM
 SG_ RSDS_R_SGU13_RollingCounter3 : 187|4@0+ (1,0) [0|14] "NoUnit"  IDM
 SG_ RSDS_R_ObjMotionDirection_25 : 191|3@0+ (1,0) [0|7] "NoUnit"  IDM
 SG_ RSDS_R_ObjAge_25 : 183|8@0+ (1,0) [0|255] "NoUnit"  IDM
 SG_ RSDS_R_ObjWidth_25 : 161|10@0+ (0.01,0) [0|5] "m"  IDM
 SG_ RSDS_R_ObjRAccelYStd_25 : 167|6@0+ (0.0625,0) [0|3.9375] "MtrPerSecSq"  IDM
 SG_ RSDS_R_ObjRAccelXStd_25 : 157|6@0+ (0.0625,0) [0|3.9375] "MtrPerSecSq"  IDM
 SG_ RSDS_R_ObjRelVelYStd_25 : 147|6@0+ (0.0625,0) [0|3.9375] "mps"  IDM
 SG_ RSDS_R_ObjRelVelXStd_25 : 137|6@0+ (0.0625,0) [0|3.9375] "mps"  IDM
 SG_ RSDS_R_ObjDistYStd_25 : 143|6@0+ (0.1,0) [0|6.3] "m"  IDM
 SG_ RSDS_R_SGU13_Checksum3 : 135|8@0+ (1,0) [0|255] "NoUnit"  IDM
 SG_ RSDS_R_SGU13_RollingCounter2 : 123|4@0+ (1,0) [0|14] "NoUnit"  IDM
 SG_ RSDS_R_ObjMotionType_25 : 127|3@0+ (1,0) [0|7] "NoUnit"  IDM
 SG_ RSDS_R_ObjMeasured_25 : 113|2@0+ (1,0) [0|3] "NoUnit"  IDM
 SG_ RSDS_R_ObjRelAccelY_25 : 107|10@0+ (0.03125,-16) [-16|15.96875] "MtrPerSecSq"  IDM
 SG_ RSDS_R_ObjRelAccelX_25 : 101|10@0+ (0.03125,-16) [-16|15.96875] "MtrPerSecSq"  IDM
 SG_ RSDS_R_ObjRelVelY_25 : 82|13@0+ (0.0312,-128) [-128|126.9976] "mps"  IDM
 SG_ RSDS_R_ObjRelVelX_25 : 79|13@0+ (0.0312,-128) [-128|126.9976] "mps"  IDM
 SG_ RSDS_R_SGU13_Checksum2 : 71|8@0+ (1,0) [0|255] "NoUnit"  IDM
 SG_ RSDS_R_SGU13_RollingCounter1 : 59|4@0+ (1,0) [0|14] "NoUnit"  IDM
 SG_ RSDS_R_ObjType_25 : 63|4@0+ (1,0) [0|15] "NoUnit"  IDM
 SG_ RSDS_R_ObjDistXStd_25 : 54|6@0+ (0.1,0) [0|6.3] "m"  IDM
 SG_ RSDS_R_ObjDistY_25 : 33|11@0+ (0.125,-128) [-128|127.875] "m"  IDM
 SG_ RSDS_R_ObjDistX_25 : 29|12@0+ (0.0625,-128) [-128|126.9375] "m"  IDM
 SG_ RSDS_R_ObjObstacleProb_25 : 18|5@0+ (0.03326,0) [0|1.03106] "NoUnit"  IDM
 SG_ RSDS_R_ObjExistProb_25 : 23|5@0+ (0.03326,0) [0|1.03106] "NoUnit"  IDM
 SG_ RSDS_R_ObjID_25 : 15|8@0+ (1,0) [0|255] "NoUnit"  IDM
 SG_ RSDS_R_SGU13_Checksum1 : 7|8@0+ (1,0) [0|255] "NoUnit"  IDM

BO_ 1437 RSDS_R_SGU14: 64 CR_RR
 SG_ RSDS_R_SGU14_RollingCounter8 : 507|4@0+ (1,0) [0|14] "NoUnit"  IDM
 SG_ RSDS_R_SGU14_BlockCounter : 511|4@0+ (1,0) [0|15] "NoUnit"  IDM
 SG_ RSDS_R_HWATargetValidity_28 : 496|1@0+ (1,0) [0|1] "NoUnit"  IDM
 SG_ RSDS_R_ObjRefPoint_28 : 499|3@0+ (1,0) [0|7] "NoUnit"  IDM
 SG_ RSDS_R_ObjRCS_28 : 493|10@0+ (0.125,-50) [-50|70] "dBsm"  IDM
 SG_ RSDS_R_ObjYawrate_28 : 473|12@0+ (0.002,-3.14) [-3.14|5.05] "radPerSec"  IDM
 SG_ RSDS_R_ObjHeading_28 : 469|12@0+ (0.002,-3.14) [-3.14|5.05] "rad"  IDM
 SG_ RSDS_R_ObjLength_28 : 463|10@0+ (0.05,0) [0|20] "m"  IDM
 SG_ RSDS_R_SGU14_Checksum8 : 455|8@0+ (1,0) [0|255] "NoUnit"  IDM
 SG_ RSDS_R_SGU14_RollingCounter7 : 443|4@0+ (1,0) [0|14] "NoUnit"  IDM
 SG_ RSDS_R_ObjMotionDirection_28 : 447|3@0+ (1,0) [0|7] "NoUnit"  IDM
 SG_ RSDS_R_ObjAge_28 : 439|8@0+ (1,0) [0|255] "NoUnit"  IDM
 SG_ RSDS_R_ObjWidth_28 : 417|10@0+ (0.01,0) [0|5] "m"  IDM
 SG_ RSDS_R_ObjRAccelYStd_28 : 423|6@0+ (0.0625,0) [0|3.9375] "MtrPerSecSq"  IDM
 SG_ RSDS_R_ObjRAccelXStd_28 : 413|6@0+ (0.0625,0) [0|3.9375] "MtrPerSecSq"  IDM
 SG_ RSDS_R_ObjRelVelYStd_28 : 403|6@0+ (0.0625,0) [0|3.9375] "mps"  IDM
 SG_ RSDS_R_ObjRelVelXStd_28 : 393|6@0+ (0.0625,0) [0|3.9375] "mps"  IDM
 SG_ RSDS_R_ObjDistYStd_28 : 399|6@0+ (0.1,0) [0|6.3] "m"  IDM
 SG_ RSDS_R_SGU14_Checksum7 : 391|8@0+ (1,0) [0|255] "NoUnit"  IDM
 SG_ RSDS_R_SGU14_RollingCounter6 : 379|4@0+ (1,0) [0|14] "NoUnit"  IDM
 SG_ RSDS_R_ObjMotionType_28 : 383|3@0+ (1,0) [0|7] "NoUnit"  IDM
 SG_ RSDS_R_ObjMeasured_28 : 369|2@0+ (1,0) [0|3] "NoUnit"  IDM
 SG_ RSDS_R_ObjRelAccelY_28 : 363|10@0+ (0.03125,-16) [-16|15.96875] "MtrPerSecSq"  IDM
 SG_ RSDS_R_ObjRelAccelX_28 : 357|10@0+ (0.03125,-16) [-16|15.96875] "MtrPerSecSq"  IDM
 SG_ RSDS_R_ObjRelVelY_28 : 338|13@0+ (0.0312,-128) [-128|126.9976] "mps"  IDM
 SG_ RSDS_R_ObjRelVelX_28 : 335|13@0+ (0.0312,-128) [-128|126.9976] "mps"  IDM
 SG_ RSDS_R_SGU14_Checksum6 : 327|8@0+ (1,0) [0|255] "NoUnit"  IDM
 SG_ RSDS_R_SGU14_RollingCounter5 : 315|4@0+ (1,0) [0|14] "NoUnit"  IDM
 SG_ RSDS_R_ObjType_28 : 319|4@0+ (1,0) [0|15] "NoUnit"  IDM
 SG_ RSDS_R_ObjDistXStd_28 : 310|6@0+ (0.1,0) [0|6.3] "m"  IDM
 SG_ RSDS_R_ObjDistY_28 : 289|11@0+ (0.125,-128) [-128|127.875] "m"  IDM
 SG_ RSDS_R_ObjDistX_28 : 285|12@0+ (0.0625,-128) [-128|126.9375] "m"  IDM
 SG_ RSDS_R_ObjObstacleProb_28 : 274|5@0+ (0.03326,0) [0|1.03106] "NoUnit"  IDM
 SG_ RSDS_R_ObjExistProb_28 : 279|5@0+ (0.03326,0) [0|1.03106] "NoUnit"  IDM
 SG_ RSDS_R_ObjID_28 : 271|8@0+ (1,0) [0|255] "NoUnit"  IDM
 SG_ RSDS_R_SGU14_Checksum5 : 263|8@0+ (1,0) [0|255] "NoUnit"  IDM
 SG_ RSDS_R_SGU14_RollingCounter4 : 251|4@0+ (1,0) [0|14] "NoUnit"  IDM
 SG_ RSDS_R_HWATargetValidity_27 : 240|1@0+ (1,0) [0|1] "NoUnit"  IDM
 SG_ RSDS_R_ObjRefPoint_27 : 243|3@0+ (1,0) [0|7] "NoUnit"  IDM
 SG_ RSDS_R_ObjRCS_27 : 237|10@0+ (0.125,-50) [-50|70] "dBsm"  IDM
 SG_ RSDS_R_ObjYawrate_27 : 217|12@0+ (0.002,-3.14) [-3.14|5.05] "radPerSec"  IDM
 SG_ RSDS_R_ObjHeading_27 : 213|12@0+ (0.002,-3.14) [-3.14|5.05] "rad"  IDM
 SG_ RSDS_R_ObjLength_27 : 207|10@0+ (0.05,0) [0|20] "m"  IDM
 SG_ RSDS_R_SGU14_Checksum4 : 199|8@0+ (1,0) [0|255] "NoUnit"  IDM
 SG_ RSDS_R_SGU14_RollingCounter3 : 187|4@0+ (1,0) [0|14] "NoUnit"  IDM
 SG_ RSDS_R_ObjMotionDirection_27 : 191|3@0+ (1,0) [0|7] "NoUnit"  IDM
 SG_ RSDS_R_ObjAge_27 : 183|8@0+ (1,0) [0|255] "NoUnit"  IDM
 SG_ RSDS_R_ObjWidth_27 : 161|10@0+ (0.01,0) [0|5] "m"  IDM
 SG_ RSDS_R_ObjRAccelYStd_27 : 167|6@0+ (0.0625,0) [0|3.9375] "MtrPerSecSq"  IDM
 SG_ RSDS_R_ObjRAccelXStd_27 : 157|6@0+ (0.0625,0) [0|3.9375] "MtrPerSecSq"  IDM
 SG_ RSDS_R_ObjRelVelYStd_27 : 147|6@0+ (0.0625,0) [0|3.9375] "mps"  IDM
 SG_ RSDS_R_ObjRelVelXStd_27 : 137|6@0+ (0.0625,0) [0|3.9375] "mps"  IDM
 SG_ RSDS_R_ObjDistYStd_27 : 143|6@0+ (0.1,0) [0|6.3] "m"  IDM
 SG_ RSDS_R_SGU14_Checksum3 : 135|8@0+ (1,0) [0|255] "NoUnit"  IDM
 SG_ RSDS_R_SGU14_RollingCounter2 : 123|4@0+ (1,0) [0|14] "NoUnit"  IDM
 SG_ RSDS_R_ObjMotionType_27 : 127|3@0+ (1,0) [0|7] "NoUnit"  IDM
 SG_ RSDS_R_ObjMeasured_27 : 113|2@0+ (1,0) [0|3] "NoUnit"  IDM
 SG_ RSDS_R_ObjRelAccelY_27 : 107|10@0+ (0.03125,-16) [-16|15.96875] "MtrPerSecSq"  IDM
 SG_ RSDS_R_ObjRelAccelX_27 : 101|10@0+ (0.03125,-16) [-16|15.96875] "MtrPerSecSq"  IDM
 SG_ RSDS_R_ObjRelVelY_27 : 82|13@0+ (0.0312,-128) [-128|126.9976] "mps"  IDM
 SG_ RSDS_R_ObjRelVelX_27 : 79|13@0+ (0.0312,-128) [-128|126.9976] "mps"  IDM
 SG_ RSDS_R_SGU14_Checksum2 : 71|8@0+ (1,0) [0|255] "NoUnit"  IDM
 SG_ RSDS_R_SGU14_RollingCounter1 : 59|4@0+ (1,0) [0|14] "NoUnit"  IDM
 SG_ RSDS_R_ObjType_27 : 63|4@0+ (1,0) [0|15] "NoUnit"  IDM
 SG_ RSDS_R_ObjDistXStd_27 : 54|6@0+ (0.1,0) [0|6.3] "m"  IDM
 SG_ RSDS_R_ObjDistY_27 : 33|11@0+ (0.125,-128) [-128|127.875] "m"  IDM
 SG_ RSDS_R_ObjDistX_27 : 29|12@0+ (0.0625,-128) [-128|126.9375] "m"  IDM
 SG_ RSDS_R_ObjObstacleProb_27 : 18|5@0+ (0.03326,0) [0|1.03106] "NoUnit"  IDM
 SG_ RSDS_R_ObjExistProb_27 : 23|5@0+ (0.03326,0) [0|1.03106] "NoUnit"  IDM
 SG_ RSDS_R_ObjID_27 : 15|8@0+ (1,0) [0|255] "NoUnit"  IDM
 SG_ RSDS_R_SGU14_Checksum1 : 7|8@0+ (1,0) [0|255] "NoUnit"  IDM

BO_ 1438 RSDS_R_SGU15: 64 CR_RR
 SG_ RSDS_R_SGU15_RollingCounter8 : 507|4@0+ (1,0) [0|14] "NoUnit"  IDM
 SG_ RSDS_R_SGU15_BlockCounter : 511|4@0+ (1,0) [0|15] "NoUnit"  IDM
 SG_ RSDS_R_HWATargetValidity_30 : 496|1@0+ (1,0) [0|1] "NoUnit"  IDM
 SG_ RSDS_R_ObjRefPoint_30 : 499|3@0+ (1,0) [0|7] "NoUnit"  IDM
 SG_ RSDS_R_ObjRCS_30 : 493|10@0+ (0.125,-50) [-50|70] "dBsm"  IDM
 SG_ RSDS_R_ObjYawrate_30 : 473|12@0+ (0.002,-3.14) [-3.14|5.05] "radPerSec"  IDM
 SG_ RSDS_R_ObjHeading_30 : 469|12@0+ (0.002,-3.14) [-3.14|5.05] "rad"  IDM
 SG_ RSDS_R_ObjLength_30 : 463|10@0+ (0.05,0) [0|20] "m"  IDM
 SG_ RSDS_R_SGU15_Checksum8 : 455|8@0+ (1,0) [0|255] "NoUnit"  IDM
 SG_ RSDS_R_SGU15_RollingCounter7 : 443|4@0+ (1,0) [0|14] "NoUnit"  IDM
 SG_ RSDS_R_ObjMotionDirection_30 : 447|3@0+ (1,0) [0|7] "NoUnit"  IDM
 SG_ RSDS_R_ObjAge_30 : 439|8@0+ (1,0) [0|255] "NoUnit"  IDM
 SG_ RSDS_R_ObjWidth_30 : 417|10@0+ (0.01,0) [0|5] "m"  IDM
 SG_ RSDS_R_ObjRAccelYStd_30 : 423|6@0+ (0.0625,0) [0|3.9375] "MtrPerSecSq"  IDM
 SG_ RSDS_R_ObjRAccelXStd_30 : 413|6@0+ (0.0625,0) [0|3.9375] "MtrPerSecSq"  IDM
 SG_ RSDS_R_ObjRelVelYStd_30 : 403|6@0+ (0.0625,0) [0|3.9375] "mps"  IDM
 SG_ RSDS_R_ObjRelVelXStd_30 : 393|6@0+ (0.0625,0) [0|3.9375] "mps"  IDM
 SG_ RSDS_R_ObjDistYStd_30 : 399|6@0+ (0.1,0) [0|6.3] "m"  IDM
 SG_ RSDS_R_SGU15_Checksum7 : 391|8@0+ (1,0) [0|255] "NoUnit"  IDM
 SG_ RSDS_R_SGU15_RollingCounter6 : 379|4@0+ (1,0) [0|14] "NoUnit"  IDM
 SG_ RSDS_R_ObjMotionType_30 : 383|3@0+ (1,0) [0|7] "NoUnit"  IDM
 SG_ RSDS_R_ObjMeasured_30 : 369|2@0+ (1,0) [0|3] "NoUnit"  IDM
 SG_ RSDS_R_ObjRelAccelY_30 : 363|10@0+ (0.03125,-16) [-16|15.96875] "MtrPerSecSq"  IDM
 SG_ RSDS_R_ObjRelAccelX_30 : 357|10@0+ (0.03125,-16) [-16|15.96875] "MtrPerSecSq"  IDM
 SG_ RSDS_R_ObjRelVelY_30 : 338|13@0+ (0.0312,-128) [-128|126.9976] "mps"  IDM
 SG_ RSDS_R_ObjRelVelX_30 : 335|13@0+ (0.0312,-128) [-128|126.9976] "mps"  IDM
 SG_ RSDS_R_SGU15_Checksum6 : 327|8@0+ (1,0) [0|255] "NoUnit"  IDM
 SG_ RSDS_R_SGU15_RollingCounter5 : 315|4@0+ (1,0) [0|14] "NoUnit"  IDM
 SG_ RSDS_R_ObjType_30 : 319|4@0+ (1,0) [0|15] "NoUnit"  IDM
 SG_ RSDS_R_ObjDistXStd_30 : 310|6@0+ (0.1,0) [0|6.3] "m"  IDM
 SG_ RSDS_R_ObjDistY_30 : 289|11@0+ (0.125,-128) [-128|127.875] "m"  IDM
 SG_ RSDS_R_ObjDistX_30 : 285|12@0+ (0.0625,-128) [-128|126.9375] "m"  IDM
 SG_ RSDS_R_ObjObstacleProb_30 : 274|5@0+ (0.03326,0) [0|1.03106] "NoUnit"  IDM
 SG_ RSDS_R_ObjExistProb_30 : 279|5@0+ (0.03326,0) [0|1.03106] "NoUnit"  IDM
 SG_ RSDS_R_ObjID_30 : 271|8@0+ (1,0) [0|255] "NoUnit"  IDM
 SG_ RSDS_R_SGU15_Checksum5 : 263|8@0+ (1,0) [0|255] "NoUnit"  IDM
 SG_ RSDS_R_SGU15_RollingCounter4 : 251|4@0+ (1,0) [0|14] "NoUnit"  IDM
 SG_ RSDS_R_HWATargetValidity_29 : 240|1@0+ (1,0) [0|1] "NoUnit"  IDM
 SG_ RSDS_R_ObjRefPoint_29 : 243|3@0+ (1,0) [0|7] "NoUnit"  IDM
 SG_ RSDS_R_ObjRCS_29 : 237|10@0+ (0.125,-50) [-50|70] "dBsm"  IDM
 SG_ RSDS_R_ObjYawrate_29 : 217|12@0+ (0.002,-3.14) [-3.14|5.05] "radPerSec"  IDM
 SG_ RSDS_R_ObjHeading_29 : 213|12@0+ (0.002,-3.14) [-3.14|5.05] "rad"  IDM
 SG_ RSDS_R_ObjLength_29 : 207|10@0+ (0.05,0) [0|20] "m"  IDM
 SG_ RSDS_R_SGU15_Checksum4 : 199|8@0+ (1,0) [0|255] "NoUnit"  IDM
 SG_ RSDS_R_SGU15_RollingCounter3 : 187|4@0+ (1,0) [0|14] "NoUnit"  IDM
 SG_ RSDS_R_ObjMotionDirection_29 : 191|3@0+ (1,0) [0|7] "NoUnit"  IDM
 SG_ RSDS_R_ObjAge_29 : 183|8@0+ (1,0) [0|255] "NoUnit"  IDM
 SG_ RSDS_R_ObjWidth_29 : 161|10@0+ (0.01,0) [0|5] "m"  IDM
 SG_ RSDS_R_ObjRAccelYStd_29 : 167|6@0+ (0.0625,0) [0|3.9375] "MtrPerSecSq"  IDM
 SG_ RSDS_R_ObjRAccelXStd_29 : 157|6@0+ (0.0625,0) [0|3.9375] "MtrPerSecSq"  IDM
 SG_ RSDS_R_ObjRelVelYStd_29 : 147|6@0+ (0.0625,0) [0|3.9375] "mps"  IDM
 SG_ RSDS_R_ObjRelVelXStd_29 : 137|6@0+ (0.0625,0) [0|3.9375] "mps"  IDM
 SG_ RSDS_R_ObjDistYStd_29 : 143|6@0+ (0.1,0) [0|6.3] "m"  IDM
 SG_ RSDS_R_SGU15_Checksum3 : 135|8@0+ (1,0) [0|255] "NoUnit"  IDM
 SG_ RSDS_R_SGU15_RollingCounter2 : 123|4@0+ (1,0) [0|14] "NoUnit"  IDM
 SG_ RSDS_R_ObjMotionType_29 : 127|3@0+ (1,0) [0|7] "NoUnit"  IDM
 SG_ RSDS_R_ObjMeasured_29 : 113|2@0+ (1,0) [0|3] "NoUnit"  IDM
 SG_ RSDS_R_ObjRelAccelY_29 : 107|10@0+ (0.03125,-16) [-16|15.96875] "MtrPerSecSq"  IDM
 SG_ RSDS_R_ObjRelAccelX_29 : 101|10@0+ (0.03125,-16) [-16|15.96875] "MtrPerSecSq"  IDM
 SG_ RSDS_R_ObjRelVelY_29 : 82|13@0+ (0.0312,-128) [-128|126.9976] "mps"  IDM
 SG_ RSDS_R_ObjRelVelX_29 : 79|13@0+ (0.0312,-128) [-128|126.9976] "mps"  IDM
 SG_ RSDS_R_SGU15_Checksum2 : 71|8@0+ (1,0) [0|255] "NoUnit"  IDM
 SG_ RSDS_R_SGU15_RollingCounter1 : 59|4@0+ (1,0) [0|14] "NoUnit"  IDM
 SG_ RSDS_R_ObjType_29 : 63|4@0+ (1,0) [0|15] "NoUnit"  IDM
 SG_ RSDS_R_ObjDistXStd_29 : 54|6@0+ (0.1,0) [0|6.3] "m"  IDM
 SG_ RSDS_R_ObjDistY_29 : 33|11@0+ (0.125,-128) [-128|127.875] "m"  IDM
 SG_ RSDS_R_ObjDistX_29 : 29|12@0+ (0.0625,-128) [-128|126.9375] "m"  IDM
 SG_ RSDS_R_ObjObstacleProb_29 : 18|5@0+ (0.03326,0) [0|1.03106] "NoUnit"  IDM
 SG_ RSDS_R_ObjExistProb_29 : 23|5@0+ (0.03326,0) [0|1.03106] "NoUnit"  IDM
 SG_ RSDS_R_ObjID_29 : 15|8@0+ (1,0) [0|255] "NoUnit"  IDM
 SG_ RSDS_R_SGU15_Checksum1 : 7|8@0+ (1,0) [0|255] "NoUnit"  IDM

BO_ 1439 RSDS_R_SGU16: 64 CR_RR
 SG_ RSDS_R_SGU16_RollingCounter8 : 507|4@0+ (1,0) [0|14] "NoUnit"  IDM
 SG_ RSDS_R_SGU16_BlockCounter : 511|4@0+ (1,0) [0|15] "NoUnit"  IDM
 SG_ RSDS_R_HWATargetValidity_32 : 496|1@0+ (1,0) [0|1] "NoUnit"  IDM
 SG_ RSDS_R_ObjRefPoint_32 : 499|3@0+ (1,0) [0|7] "NoUnit"  IDM
 SG_ RSDS_R_ObjRCS_32 : 493|10@0+ (0.125,-50) [-50|70] "dBsm"  IDM
 SG_ RSDS_R_ObjYawrate_32 : 473|12@0+ (0.002,-3.14) [-3.14|5.05] "radPerSec"  IDM
 SG_ RSDS_R_ObjHeading_32 : 469|12@0+ (0.002,-3.14) [-3.14|5.05] "rad"  IDM
 SG_ RSDS_R_ObjLength_32 : 463|10@0+ (0.05,0) [0|20] "m"  IDM
 SG_ RSDS_R_SGU16_Checksum8 : 455|8@0+ (1,0) [0|255] "NoUnit"  IDM
 SG_ RSDS_R_SGU16_RollingCounter7 : 443|4@0+ (1,0) [0|14] "NoUnit"  IDM
 SG_ RSDS_R_ObjMotionDirection_32 : 447|3@0+ (1,0) [0|7] "NoUnit"  IDM
 SG_ RSDS_R_ObjAge_32 : 439|8@0+ (1,0) [0|255] "NoUnit"  IDM
 SG_ RSDS_R_ObjWidth_32 : 417|10@0+ (0.01,0) [0|5] "m"  IDM
 SG_ RSDS_R_ObjRAccelYStd_32 : 423|6@0+ (0.0625,0) [0|3.9375] "MtrPerSecSq"  IDM
 SG_ RSDS_R_ObjRAccelXStd_32 : 413|6@0+ (0.0625,0) [0|3.9375] "MtrPerSecSq"  IDM
 SG_ RSDS_R_ObjRelVelYStd_32 : 403|6@0+ (0.0625,0) [0|3.9375] "mps"  IDM
 SG_ RSDS_R_ObjRelVelXStd_32 : 393|6@0+ (0.0625,0) [0|3.9375] "mps"  IDM
 SG_ RSDS_R_ObjDistYStd_32 : 399|6@0+ (0.1,0) [0|6.3] "m"  IDM
 SG_ RSDS_R_SGU16_Checksum7 : 391|8@0+ (1,0) [0|255] "NoUnit"  IDM
 SG_ RSDS_R_SGU16_RollingCounter6 : 379|4@0+ (1,0) [0|14] "NoUnit"  IDM
 SG_ RSDS_R_ObjMotionType_32 : 383|3@0+ (1,0) [0|7] "NoUnit"  IDM
 SG_ RSDS_R_ObjMeasured_32 : 369|2@0+ (1,0) [0|3] "NoUnit"  IDM
 SG_ RSDS_R_ObjRelAccelY_32 : 363|10@0+ (0.03125,-16) [-16|15.96875] "MtrPerSecSq"  IDM
 SG_ RSDS_R_ObjRelAccelX_32 : 357|10@0+ (0.03125,-16) [-16|15.96875] "MtrPerSecSq"  IDM
 SG_ RSDS_R_ObjRelVelY_32 : 338|13@0+ (0.0312,-128) [-128|126.9976] "mps"  IDM
 SG_ RSDS_R_ObjRelVelX_32 : 335|13@0+ (0.0312,-128) [-128|126.9976] "mps"  IDM
 SG_ RSDS_R_SGU16_Checksum6 : 327|8@0+ (1,0) [0|255] "NoUnit"  IDM
 SG_ RSDS_R_SGU16_RollingCounter5 : 315|4@0+ (1,0) [0|14] "NoUnit"  IDM
 SG_ RSDS_R_ObjType_32 : 319|4@0+ (1,0) [0|15] "NoUnit"  IDM
 SG_ RSDS_R_ObjDistXStd_32 : 310|6@0+ (0.1,0) [0|6.3] "m"  IDM
 SG_ RSDS_R_ObjDistY_32 : 289|11@0+ (0.125,-128) [-128|127.875] "m"  IDM
 SG_ RSDS_R_ObjDistX_32 : 285|12@0+ (0.0625,-128) [-128|126.9375] "m"  IDM
 SG_ RSDS_R_ObjObstacleProb_32 : 274|5@0+ (0.03326,0) [0|1.03106] "NoUnit"  IDM
 SG_ RSDS_R_ObjExistProb_32 : 279|5@0+ (0.03326,0) [0|1.03106] "NoUnit"  IDM
 SG_ RSDS_R_ObjID_32 : 271|8@0+ (1,0) [0|255] "NoUnit"  IDM
 SG_ RSDS_R_SGU16_Checksum5 : 263|8@0+ (1,0) [0|255] "NoUnit"  IDM
 SG_ RSDS_R_SGU16_RollingCounter4 : 251|4@0+ (1,0) [0|14] "NoUnit"  IDM
 SG_ RSDS_R_HWATargetValidity_31 : 240|1@0+ (1,0) [0|1] "NoUnit"  IDM
 SG_ RSDS_R_ObjRefPoint_31 : 243|3@0+ (1,0) [0|7] "NoUnit"  IDM
 SG_ RSDS_R_ObjRCS_31 : 237|10@0+ (0.125,-50) [-50|70] "dBsm"  IDM
 SG_ RSDS_R_ObjYawrate_31 : 217|12@0+ (0.002,-3.14) [-3.14|5.05] "radPerSec"  IDM
 SG_ RSDS_R_ObjHeading_31 : 213|12@0+ (0.002,-3.14) [-3.14|5.05] "rad"  IDM
 SG_ RSDS_R_ObjLength_31 : 207|10@0+ (0.05,0) [0|20] "m"  IDM
 SG_ RSDS_R_SGU16_Checksum4 : 199|8@0+ (1,0) [0|255] "NoUnit"  IDM
 SG_ RSDS_R_SGU16_RollingCounter3 : 187|4@0+ (1,0) [0|14] "NoUnit"  IDM
 SG_ RSDS_R_ObjMotionDirection_31 : 191|3@0+ (1,0) [0|7] "NoUnit"  IDM
 SG_ RSDS_R_ObjAge_31 : 183|8@0+ (1,0) [0|255] "NoUnit"  IDM
 SG_ RSDS_R_ObjWidth_31 : 161|10@0+ (0.01,0) [0|5] "m"  IDM
 SG_ RSDS_R_ObjRAccelYStd_31 : 167|6@0+ (0.0625,0) [0|3.9375] "MtrPerSecSq"  IDM
 SG_ RSDS_R_ObjRAccelXStd_31 : 157|6@0+ (0.0625,0) [0|3.9375] "MtrPerSecSq"  IDM
 SG_ RSDS_R_ObjRelVelYStd_31 : 147|6@0+ (0.0625,0) [0|3.9375] "mps"  IDM
 SG_ RSDS_R_ObjRelVelXStd_31 : 137|6@0+ (0.0625,0) [0|3.9375] "mps"  IDM
 SG_ RSDS_R_ObjDistYStd_31 : 143|6@0+ (0.1,0) [0|6.3] "m"  IDM
 SG_ RSDS_R_SGU16_Checksum3 : 135|8@0+ (1,0) [0|255] "NoUnit"  IDM
 SG_ RSDS_R_SGU16_RollingCounter2 : 123|4@0+ (1,0) [0|14] "NoUnit"  IDM
 SG_ RSDS_R_ObjMotionType_31 : 127|3@0+ (1,0) [0|7] "NoUnit"  IDM
 SG_ RSDS_R_ObjMeasured_31 : 113|2@0+ (1,0) [0|3] "NoUnit"  IDM
 SG_ RSDS_R_ObjRelAccelY_31 : 107|10@0+ (0.03125,-16) [-16|15.96875] "MtrPerSecSq"  IDM
 SG_ RSDS_R_ObjRelAccelX_31 : 101|10@0+ (0.03125,-16) [-16|15.96875] "MtrPerSecSq"  IDM
 SG_ RSDS_R_ObjRelVelY_31 : 82|13@0+ (0.0312,-128) [-128|126.9976] "mps"  IDM
 SG_ RSDS_R_ObjRelVelX_31 : 79|13@0+ (0.0312,-128) [-128|126.9976] "mps"  IDM
 SG_ RSDS_R_SGU16_Checksum2 : 71|8@0+ (1,0) [0|255] "NoUnit"  IDM
 SG_ RSDS_R_SGU16_RollingCounter1 : 59|4@0+ (1,0) [0|14] "NoUnit"  IDM
 SG_ RSDS_R_ObjType_31 : 63|4@0+ (1,0) [0|15] "NoUnit"  IDM
 SG_ RSDS_R_ObjDistXStd_31 : 54|6@0+ (0.1,0) [0|6.3] "m"  IDM
 SG_ RSDS_R_ObjDistY_31 : 33|11@0+ (0.125,-128) [-128|127.875] "m"  IDM
 SG_ RSDS_R_ObjDistX_31 : 29|12@0+ (0.0625,-128) [-128|126.9375] "m"  IDM
 SG_ RSDS_R_ObjObstacleProb_31 : 18|5@0+ (0.03326,0) [0|1.03106] "NoUnit"  IDM
 SG_ RSDS_R_ObjExistProb_31 : 23|5@0+ (0.03326,0) [0|1.03106] "NoUnit"  IDM
 SG_ RSDS_R_ObjID_31 : 15|8@0+ (1,0) [0|255] "NoUnit"  IDM
 SG_ RSDS_R_SGU16_Checksum1 : 7|8@0+ (1,0) [0|255] "NoUnit"  IDM

BO_ 1487 RSDS_R_SGU_HEAD: 32 CR_RR
 SG_ RSDS_R_SGU_HEAD_RollingCounter4 : 251|4@0+ (1,0) [0|15] ""  IDM
 SG_ RSDS_R_SGU_HEAD_BlockCounter : 255|4@0+ (1,0) [0|15] ""  IDM
 SG_ RSDS_R_ObjAziAngleCalib : 236|13@0+ (0.0009,-2) [-2|2] "rad"  IDM
 SG_ RSDS_R_Guardrail_dxStart : 219|15@0+ (0.01,-160) [-160|160] "m"  IDM
 SG_ RSDS_R_GuardrailC3 : 207|20@0+ (1E-008,-0.004) [-0.004|0.004] "INV(m2)"  IDM
 SG_ RSDS_R_SGU_HEAD_Checksum4 : 199|8@0+ (1,0) [0|255] ""  IDM
 SG_ RSDS_R_SGU_HEAD_RollingCounter3 : 187|4@0+ (1,0) [0|15] ""  IDM
 SG_ RSDS_R_GuardrailC2 : 175|16@0+ (5E-006,-0.125) [-0.125|0.125] "INV(m)"  IDM
 SG_ RSDS_R_GuardrailC1 : 159|13@0+ (0.0009,-2) [-2|2] "rad"  IDM
 SG_ RSDS_R_GuardrailC0 : 143|13@0+ (0.01,-30) [-30|30] "m"  IDM
 SG_ RSDS_R_SGU_HEAD_Checksum3 : 135|8@0+ (1,0) [0|255] ""  IDM
 SG_ RSDS_R_SGU_HEAD_RollingCounter2 : 123|4@0+ (1,0) [0|15] ""  IDM
 SG_ RSDS_R_hdr_AutosarTimeStamp : 79|42@0+ (1,0) [0|4398046511103] "ms"  IDM
 SG_ RSDS_R_SGU_HEAD_Checksum2 : 71|8@0+ (1,0) [0|255] ""  IDM
 SG_ RSDS_R_SGU_HEAD_RollingCounter1 : 59|4@0+ (1,0) [0|15] ""  IDM
 SG_ RSDS_R_hdr_ErrorStatus : 63|4@0+ (1,0) [0|15] ""  IDM
 SG_ RSDS_R_Guardrail_dxEnd : 47|15@0+ (0.01,-160) [-160|160] "m"  IDM
 SG_ RSDS_R_GuardrailConfidence : 39|7@0+ (0.01,0) [0|1] ""  IDM
 SG_ RSDS_R_ObjDetected : 29|6@0+ (1,0) [0|63] ""  IDM
 SG_ RSDS_R_BLIND : 31|2@0+ (1,0) [0|3] ""  IDM
 SG_ RSDS_R_hdr_TimeStampStatus : 23|8@0+ (1,0) [0|255] ""  IDM
 SG_ RSDS_R_hdr_TimeStamp : 15|8@0+ (1,0) [0|255] "ms"  IDM
 SG_ RSDS_R_SGU_HEAD_Checksum1 : 7|8@0+ (1,0) [0|255] ""  IDM

BO_ 1967 RSDS_R_Phy_Resp: 8 CR_RR
 SG_ RSDS_R_Phy_Resp : 7|64@0+ (1,0) [0|1.84467440737096E+019] ""  IDM

BO_ 367 RSDS_FD1: 64 IDM
 SG_ RSDS_ObjRelAccelY_Ri : 427|10@0+ (0.03125,-16) [-16|15.9688] "MtrPerSecSq" Vector__XXX
 SG_ RSDS_ObjRelAccelX_Ri : 421|10@0+ (0.03125,-16) [-16|15.9688] "MtrPerSecSq" Vector__XXX
 SG_ RSDS_ObjRelAccelX_Le : 415|10@0+ (0.03125,-16) [-16|15.9688] "MtrPerSecSq" Vector__XXX
 SG_ RSDS_ObjRAccelYStd_Ri : 405|5@0+ (0.375,0) [0|11.625] "MtrPerSecSq" Vector__XXX
 SG_ RSDS_ObjRAccelXStd_Ri : 394|5@0+ (0.375,0) [0|11.625] "MtrPerSecSq" Vector__XXX
 SG_ RSDS_ObjRelVelYStd_Ri : 399|5@0+ (0.375,0) [0|11.625] "mps" Vector__XXX
 SG_ RSDS_ObjRelVelXStd_Ri : 375|5@0+ (0.375,0) [0|11.625] "mps" Vector__XXX
 SG_ RSDS_ObjDistYStd_Ri : 364|5@0+ (0.375,0) [0|11.625] "m" Vector__XXX
 SG_ RSDS_ObjDistXStd_Ri : 353|5@0+ (0.375,0) [0|11.625] "m" Vector__XXX
 SG_ RSDS_ObjRAccelYStd_Le : 358|5@0+ (0.375,0) [0|11.625] "MtrPerSecSq" Vector__XXX
 SG_ RSDS_ObjRAccelXStd_Le : 347|5@0+ (0.375,0) [0|11.625] "MtrPerSecSq" Vector__XXX
 SG_ RSDS_ObjRelVelYStd_Le : 336|5@0+ (0.375,0) [0|11.625] "mps" Vector__XXX
 SG_ RSDS_ObjRelVelXStd_Le : 341|5@0+ (0.375,0) [0|11.625] "mps" Vector__XXX
 SG_ RSDS_ObjDistYStd_Le : 330|5@0+ (0.375,0) [0|11.625] "m" Vector__XXX
 SG_ RSDS_ObjDistXStd_Le : 335|5@0+ (0.375,0) [0|11.625] "m" Vector__XXX
 SG_ RollingCounter_RSDS_R_5 : 315|4@0+ (1,0) [0|15] "NoUnit" Vector__XXX
 SG_ ObjTTCRi : 308|7@0+ (0.1,0) [0|12.7] "s" Vector__XXX
 SG_ ObjLatSpdCurvRi : 299|7@0+ (0.1,-6.4) [-6.4|6.3] "mps" Vector__XXX
 SG_ ObjLgtSpdCurvRi : 293|10@0+ (0.1,-10) [-10|92.3] "mps" Vector__XXX
 SG_ ObjLatPosnCurvRi : 285|8@0+ (0.1,-12.8) [-12.8|12.7] "m" Vector__XXX
 SG_ ObjLgtPosnCurvRi : 279|10@0+ (0.1,-92.3) [-92.3|10] "m" Vector__XXX
 SG_ ObjIDRi : 269|6@0+ (1,0) [0|63] "NoUnit" Vector__XXX
 SG_ RiTarSts : 271|2@0+ (1,0) [0|3] "NoUnit" Vector__XXX
 SG_ Checksum_RSDS_R_5 : 263|8@0+ (1,0) [0|255] "NoUnit" Vector__XXX
 SG_ RollingCounter_RSDS_R_4 : 251|4@0+ (1,0) [0|15] "NoUnit" Vector__XXX
 SG_ ObjStsRi : 217|2@0+ (1,0) [0|3] "NoUnit" Vector__XXX
 SG_ ZoneIndRi : 219|2@0+ (1,0) [0|3] "NoUnit" Vector__XXX
 SG_ ObjStatyRi : 220|1@0+ (1,0) [0|1] "NoUnit" Vector__XXX
 SG_ ObjWidthRi : 223|3@0+ (0.5,0) [0|3.5] "m" Vector__XXX
 SG_ ObjRinRi : 211|4@0+ (1,0) [0|15] "m" Vector__XXX
 SG_ ObjStsLe : 213|2@0+ (1,0) [0|3] "NoUnit" Vector__XXX
 SG_ ZoneIndLe : 215|2@0+ (1,0) [0|3] "NoUnit" Vector__XXX
 SG_ ObjStatyLe : 200|1@0+ (1,0) [0|1] "NoUnit" Vector__XXX
 SG_ ObjWidthLe : 203|3@0+ (0.5,0) [0|3.5] "m" Vector__XXX
 SG_ ObjLenLe : 207|4@0+ (1,0) [0|15] "m" Vector__XXX
 SG_ Checksum_RSDS_R_4 : 199|8@0+ (1,0) [0|255] "NoUnit" Vector__XXX
 SG_ RollingCounter_RSDS_R_3 : 187|4@0+ (1,0) [0|15] "NoUnit" Vector__XXX
 SG_ ObjTTCLe : 180|7@0+ (0.1,0) [0|12.7] "s" Vector__XXX
 SG_ ObjLatSpdCurvLe : 171|7@0+ (0.1,-6.4) [-6.4|6.3] "mps" Vector__XXX
 SG_ ObjLgtSpdCurvLe : 165|10@0+ (0.1,-10) [-10|92.3] "mps" Vector__XXX
 SG_ ObjLatPosnCurvLe : 157|8@0+ (0.1,-12.8) [-12.8|12.7] "m" Vector__XXX
 SG_ ObjLgtPosnCurvLe : 151|10@0+ (0.1,-92.3) [-92.3|10] "m" Vector__XXX
 SG_ ObjIDLe : 141|6@0+ (1,0) [0|63] "NoUnit" Vector__XXX
 SG_ LeTarSts : 143|2@0+ (1,0) [0|3] "NoUnit" Vector__XXX
 SG_ Checksum_RSDS_R_3 : 135|8@0+ (1,0) [0|255] "NoUnit" Vector__XXX
 SG_ RollingCounter_RSDS_R_2 : 123|4@0+ (1,0) [0|15] "NoUnit" Vector__XXX
 SG_ RCTA_warningReqLeft : 124|1@0+ (1,0) [0|1] "NoUnit" Vector__XXX
 SG_ RCTA_warningReqRight : 125|1@0+ (1,0) [0|1] "NoUnit" Vector__XXX
 SG_ RSDS_CTA_Actv : 126|1@0+ (1,0) [0|1] "NoUnit" Vector__XXX
 SG_ RSDS_RCTABrkResp : 127|1@0+ (1,0) [0|1] "NoUnit" Vector__XXX
 SG_ RSDS_RCTAResp : 112|1@0+ (1,0) [0|1] "NoUnit" Vector__XXX
 SG_ RSDS_RCWResp : 113|1@0+ (1,0) [0|1] "NoUnit" Vector__XXX
 SG_ RSDS_DOWResp : 114|1@0+ (1,0) [0|1] "NoUnit" Vector__XXX
 SG_ RSDS_LCAResp : 115|1@0+ (1,0) [0|1] "NoUnit" Vector__XXX
 SG_ RSDS_TrailerSts : 116|1@0+ (1,0) [0|1] "NoUnit" Vector__XXX
 SG_ RSDS_BliSts : 117|1@0+ (1,0) [0|1] "NoUnit" Vector__XXX
 SG_ RSDS_BrkgTrig : 118|1@0+ (1,0) [0|1] "NoUnit" Vector__XXX
 SG_ RSDS_ErrSts : 119|1@0+ (1,0) [0|1] "NoUnit" Vector__XXX
 SG_ RSDS_RCW_Trigger : 105|2@0+ (1,0) [0|3] "NoUnit" Vector__XXX
 SG_ DOW_warningReqleft : 89|2@0+ (1,0) [0|3] "NoUnit" Vector__XXX
 SG_ DOW_warningReqRight : 91|2@0+ (1,0) [0|3] "NoUnit" Vector__XXX
 SG_ BSD_LCA_warningReqleft : 93|2@0+ (1,0) [0|3] "NoUnit" Vector__XXX
 SG_ BSD_LCA_warningReqRight : 95|2@0+ (1,0) [0|3] "NoUnit" Vector__XXX
 SG_ RSDS_IPSoundReq : 81|2@0+ (1,0) [0|3] "NoUnit" Vector__XXX
 SG_ RSDS_LEDLightReqRight : 83|2@0+ (1,0) [0|3] "NoUnit" Vector__XXX
 SG_ RSDS_LEDLightReqLeft : 85|2@0+ (1,0) [0|3] "NoUnit" Vector__XXX
 SG_ RSDS_BrkgReqVal : 77|8@0+ (0.05,-10) [-10|2.75] "MtrPerSecSq" Vector__XXX
 SG_ RSDS_BrkgReq : 78|1@0+ (1,0) [0|1] "NoUnit" Vector__XXX
 SG_ RSDS_Brk_ErrSts : 79|1@0+ (1,0) [0|1] "NoUnit" Vector__XXX
 SG_ Checksum_RSDS_R_2 : 71|8@0+ (1,0) [0|255] "NoUnit" Vector__XXX
 SG_ RCTB_State : 38|3@0+ (1,0) [0|7] "NoUnit" Vector__XXX
 SG_ RCTA_State : 25|3@0+ (1,0) [0|7] "NoUnit" Vector__XXX
 SG_ RCW_State : 28|3@0+ (1,0) [0|7] "NoUnit" Vector__XXX
 SG_ DOW_State : 31|3@0+ (1,0) [0|7] "NoUnit" Vector__XXX
 SG_ LCA_State : 18|3@0+ (1,0) [0|7] "NoUnit" Vector__XXX
 SG_ BSD_State : 21|3@0+ (1,0) [0|7] "NoUnit" Vector__XXX
 SG_ RSDS_ObjRelAccelY_Le : 15|10@0+ (0.03125,-16) [-16|15.9688] "MtrPerSecSq" Vector__XXX

BO_ 778 RSDS_FD2: 64 IDM
 SG_ RCTB_MidTgt_02_Vy : 356|9@0+ (0.5,-127.5) [-127|128] "kph" Vector__XXX
 SG_ RCW_MidTgt_01_Vy : 349|9@0+ (0.5,-127.5) [-127|128] "kph" Vector__XXX
 SG_ RCTA_RiTgt_02_Vy : 342|9@0+ (0.5,-127.5) [-127|128] "kph" Vector__XXX
 SG_ LCA_RiTgt_01_Vy : 335|9@0+ (0.5,-127.5) [-127|128] "kph" Vector__XXX
 SG_ RCTA_LeTgt_02_Vy : 296|9@0+ (0.5,-127.5) [-127|128] "kph" Vector__XXX
 SG_ LCA_LeTgt_01_Vy : 289|9@0+ (0.5,-127.5) [-127|128] "kph" Vector__XXX
 SG_ RCTB_MidTgt_02_Type : 292|3@0+ (1,0) [0|7] "NoUnit" Vector__XXX
 SG_ RCTB_MidTgt_02_Vx : 285|9@0+ (0.5,-127.5) [-127|128] "kph" Vector__XXX
 SG_ RCW_MidTgt_01_Vx : 278|9@0+ (0.5,-127.5) [-127|128] "kph" Vector__XXX
 SG_ RCTA_RiTgt_02_Vx : 271|9@0+ (0.5,-127.5) [-127|128] "kph" Vector__XXX
 SG_ LCA_RiTgt_01_Vx : 246|9@0+ (0.5,-127.5) [-127|128] "kph" Vector__XXX
 SG_ RCTA_LeTgt_02_Vx : 239|9@0+ (0.5,-127.5) [-127|128] "kph" Vector__XXX
 SG_ LCA_LeTgt_01_Vx : 216|9@0+ (0.5,-127.5) [-127|128] "kph" Vector__XXX
 SG_ RCW_MidTgt_01_Type : 219|3@0+ (1,0) [0|7] "NoUnit" Vector__XXX
 SG_ RCTA_RiTgt_02_Type : 222|3@0+ (1,0) [0|7] "NoUnit" Vector__XXX
 SG_ RSDS_MidTgt_02_dy : 215|9@0+ (0.1,-25.1) [-25|25] "m" Vector__XXX
 SG_ RSDS_MidTgt_02_dx : 207|8@0+ (0.1,-15.1) [-15|10] "m" Vector__XXX
 SG_ LCA_RiTgt_01_Type : 190|3@0+ (1,0) [0|7] "NoUnit" Vector__XXX
 SG_ RCTA_LeTgt_02_Type : 179|3@0+ (1,0) [0|7] "NoUnit" Vector__XXX
 SG_ RSDS_MidTgt_02 : 180|1@0+ (1,0) [0|1] "NoUnit" Vector__XXX
 SG_ RSDS_MidTgt_01_dy : 171|7@0+ (0.1,-4) [-4|4] "m" Vector__XXX
 SG_ RSDS_MidTgt_01_dx : 165|10@0+ (0.1,-90) [-90|5] "m" Vector__XXX
 SG_ RSDS_MidTgt_01 : 166|1@0+ (1,0) [0|1] "NoUnit" Vector__XXX
 SG_ RSDS_RiTgt_02_dy : 159|9@0+ (0.1,-45.1) [-45|5] "m" Vector__XXX
 SG_ RSDS_RiTgt_02_dx : 151|8@0+ (0.1,-15.1) [-15|10] "m" Vector__XXX
 SG_ RSDS_RiTgt_02 : 136|1@0+ (1,0) [0|1] "NoUnit" Vector__XXX
 SG_ RSDS_RiTgt_01_dy : 143|7@0+ (0.1,-8) [-8|0] "m" Vector__XXX
 SG_ LCA_LeTgt_01_Type : 126|3@0+ (1,0) [0|7] "NoUnit" Vector__XXX
 SG_ RSDS_RiTgt_01_dx : 106|10@0+ (0.1,-90) [-90|5] "m" Vector__XXX
 SG_ RSDS_RiTgt_01 : 107|1@0+ (1,0) [0|1] "NoUnit" Vector__XXX
 SG_ RSDS_LeTgt_02_dy : 100|9@0+ (0.1,-5.1) [-5|45] "m" Vector__XXX
 SG_ RSDS_LeTgt_02_dx : 92|8@0+ (0.1,-15.1) [-15|10] "m" Vector__XXX
 SG_ RSDS_LeTgt_02 : 93|1@0+ (1,0) [0|1] "NoUnit" Vector__XXX
 SG_ RSDS_LeTgt_01_dx : 87|10@0+ (0.1,-90) [-90|5] "m" Vector__XXX
 SG_ RSDS_LeTgt_01_dy : 78|7@0+ (0.1,0) [0|8] "m" Vector__XXX
 SG_ RSDS_LeTgt_01 : 79|1@0+ (1,0) [0|1] "NoUnit" Vector__XXX
 SG_ RCW_TTC : 29|6@0+ (0.1,0) [0|6.3] "s" Vector__XXX
 SG_ BSD_LCA_Right_TTC : 19|6@0+ (0.1,0) [0|6.3] "s" Vector__XXX
 SG_ BSD_LCA_Left_TTC : 9|6@0+ (0.1,0) [0|6.3] "s" Vector__XXX
 SG_ RCTA_B_TTC : 15|6@0+ (0.1,0) [0|6.3] "s" Vector__XXX

CM_ SG_ 1429 RSDS_R_SGU6_RollingCounter8 "/";
CM_ SG_ 1429 RSDS_R_SGU6_BlockCounter "/";
CM_ SG_ 1429 RSDS_R_HWATargetValidity_12 "/";
CM_ SG_ 1429 RSDS_R_ObjRefPoint_12 "/";
CM_ SG_ 1429 RSDS_R_ObjRCS_12 "/";
CM_ SG_ 1429 RSDS_R_ObjYawrate_12 "/";
CM_ SG_ 1429 RSDS_R_ObjHeading_12 "/";
CM_ SG_ 1429 RSDS_R_ObjLength_12 "/";
CM_ SG_ 1429 RSDS_R_SGU6_Checksum8 "/";
CM_ SG_ 1429 RSDS_R_SGU6_RollingCounter7 "/";
CM_ SG_ 1429 RSDS_R_ObjMotionDirection_12 "/";
CM_ SG_ 1429 RSDS_R_ObjAge_12 "/";
CM_ SG_ 1429 RSDS_R_ObjWidth_12 "/";
CM_ SG_ 1429 RSDS_R_ObjRAccelYStd_12 "/";
CM_ SG_ 1429 RSDS_R_ObjRAccelXStd_12 "/";
CM_ SG_ 1429 RSDS_R_ObjRelVelYStd_12 "/";
CM_ SG_ 1429 RSDS_R_ObjRelVelXStd_12 "/";
CM_ SG_ 1429 RSDS_R_ObjDistYStd_12 "/";
CM_ SG_ 1429 RSDS_R_SGU6_Checksum7 "/";
CM_ SG_ 1429 RSDS_R_SGU6_RollingCounter6 "/";
CM_ SG_ 1429 RSDS_R_ObjMotionType_12 "/";
CM_ SG_ 1429 RSDS_R_ObjMeasured_12 "/";
CM_ SG_ 1429 RSDS_R_ObjRelAccelY_12 "/";
CM_ SG_ 1429 RSDS_R_ObjRelAccelX_12 "/";
CM_ SG_ 1429 RSDS_R_ObjRelVelY_12 "/";
CM_ SG_ 1429 RSDS_R_ObjRelVelX_12 "/";
CM_ SG_ 1429 RSDS_R_SGU6_Checksum6 "/";
CM_ SG_ 1429 RSDS_R_SGU6_RollingCounter5 "/";
CM_ SG_ 1429 RSDS_R_ObjType_12 "/";
CM_ SG_ 1429 RSDS_R_ObjDistXStd_12 "/";
CM_ SG_ 1429 RSDS_R_ObjDistY_12 "/";
CM_ SG_ 1429 RSDS_R_ObjDistX_12 "/";
CM_ SG_ 1429 RSDS_R_ObjObstacleProb_12 "/";
CM_ SG_ 1429 RSDS_R_ObjExistProb_12 "/";
CM_ SG_ 1429 RSDS_R_ObjID_12 "/";
CM_ SG_ 1429 RSDS_R_SGU6_Checksum5 "/";
CM_ SG_ 1429 RSDS_R_SGU6_RollingCounter4 "/";
CM_ SG_ 1429 RSDS_R_HWATargetValidity_11 "/";
CM_ SG_ 1429 RSDS_R_ObjRefPoint_11 "/";
CM_ SG_ 1429 RSDS_R_ObjRCS_11 "/";
CM_ SG_ 1429 RSDS_R_ObjYawrate_11 "/";
CM_ SG_ 1429 RSDS_R_ObjHeading_11 "/";
CM_ SG_ 1429 RSDS_R_ObjLength_11 "/";
CM_ SG_ 1429 RSDS_R_SGU6_Checksum4 "/";
CM_ SG_ 1429 RSDS_R_SGU6_RollingCounter3 "/";
CM_ SG_ 1429 RSDS_R_ObjMotionDirection_11 "/";
CM_ SG_ 1429 RSDS_R_ObjAge_11 "/";
CM_ SG_ 1429 RSDS_R_ObjWidth_11 "/";
CM_ SG_ 1429 RSDS_R_ObjRAccelYStd_11 "/";
CM_ SG_ 1429 RSDS_R_ObjRAccelXStd_11 "/";
CM_ SG_ 1429 RSDS_R_ObjRelVelYStd_11 "/";
CM_ SG_ 1429 RSDS_R_ObjRelVelXStd_11 "/";
CM_ SG_ 1429 RSDS_R_ObjDistYStd_11 "/";
CM_ SG_ 1429 RSDS_R_SGU6_Checksum3 "/";
CM_ SG_ 1429 RSDS_R_SGU6_RollingCounter2 "/";
CM_ SG_ 1429 RSDS_R_ObjMotionType_11 "/";
CM_ SG_ 1429 RSDS_R_ObjMeasured_11 "/";
CM_ SG_ 1429 RSDS_R_ObjRelAccelY_11 "/";
CM_ SG_ 1429 RSDS_R_ObjRelAccelX_11 "/";
CM_ SG_ 1429 RSDS_R_ObjRelVelY_11 "/";
CM_ SG_ 1429 RSDS_R_ObjRelVelX_11 "/";
CM_ SG_ 1429 RSDS_R_SGU6_Checksum2 "/";
CM_ SG_ 1429 RSDS_R_SGU6_RollingCounter1 "/";
CM_ SG_ 1429 RSDS_R_ObjType_11 "/";
CM_ SG_ 1429 RSDS_R_ObjDistXStd_11 "/";
CM_ SG_ 1429 RSDS_R_ObjDistY_11 "/";
CM_ SG_ 1429 RSDS_R_ObjDistX_11 "/";
CM_ SG_ 1429 RSDS_R_ObjObstacleProb_11 "/";
CM_ SG_ 1429 RSDS_R_ObjExistProb_11 "/";
CM_ SG_ 1429 RSDS_R_ObjID_11 "/";
CM_ SG_ 1429 RSDS_R_SGU6_Checksum1 "/";
CM_ SG_ 1430 RSDS_R_SGU7_RollingCounter8 "/";
CM_ SG_ 1430 RSDS_R_SGU7_BlockCounter "/";
CM_ SG_ 1430 RSDS_R_HWATargetValidity_14 "/";
CM_ SG_ 1430 RSDS_R_ObjRefPoint_14 "/";
CM_ SG_ 1430 RSDS_R_ObjRCS_14 "/";
CM_ SG_ 1430 RSDS_R_ObjYawrate_14 "/";
CM_ SG_ 1430 RSDS_R_ObjHeading_14 "/";
CM_ SG_ 1430 RSDS_R_ObjLength_14 "/";
CM_ SG_ 1430 RSDS_R_SGU7_Checksum8 "/";
CM_ SG_ 1430 RSDS_R_SGU7_RollingCounter7 "/";
CM_ SG_ 1430 RSDS_R_ObjMotionDirection_14 "/";
CM_ SG_ 1430 RSDS_R_ObjAge_14 "/";
CM_ SG_ 1430 RSDS_R_ObjWidth_14 "/";
CM_ SG_ 1430 RSDS_R_ObjRAccelYStd_14 "/";
CM_ SG_ 1430 RSDS_R_ObjRAccelXStd_14 "/";
CM_ SG_ 1430 RSDS_R_ObjRelVelYStd_14 "/";
CM_ SG_ 1430 RSDS_R_ObjRelVelXStd_14 "/";
CM_ SG_ 1430 RSDS_R_ObjDistYStd_14 "/";
CM_ SG_ 1430 RSDS_R_SGU7_Checksum7 "/";
CM_ SG_ 1430 RSDS_R_SGU7_RollingCounter6 "/";
CM_ SG_ 1430 RSDS_R_ObjMotionType_14 "/";
CM_ SG_ 1430 RSDS_R_ObjMeasured_14 "/";
CM_ SG_ 1430 RSDS_R_ObjRelAccelY_14 "/";
CM_ SG_ 1430 RSDS_R_ObjRelAccelX_14 "/";
CM_ SG_ 1430 RSDS_R_ObjRelVelY_14 "/";
CM_ SG_ 1430 RSDS_R_ObjRelVelX_14 "/";
CM_ SG_ 1430 RSDS_R_SGU7_Checksum6 "/";
CM_ SG_ 1430 RSDS_R_SGU7_RollingCounter5 "/";
CM_ SG_ 1430 RSDS_R_ObjType_14 "/";
CM_ SG_ 1430 RSDS_R_ObjDistXStd_14 "/";
CM_ SG_ 1430 RSDS_R_ObjDistY_14 "/";
CM_ SG_ 1430 RSDS_R_ObjDistX_14 "/";
CM_ SG_ 1430 RSDS_R_ObjObstacleProb_14 "/";
CM_ SG_ 1430 RSDS_R_ObjExistProb_14 "/";
CM_ SG_ 1430 RSDS_R_ObjID_14 "/";
CM_ SG_ 1430 RSDS_R_SGU7_Checksum5 "/";
CM_ SG_ 1430 RSDS_R_SGU7_RollingCounter4 "/";
CM_ SG_ 1430 RSDS_R_HWATargetValidity_13 "/";
CM_ SG_ 1430 RSDS_R_ObjRefPoint_13 "/";
CM_ SG_ 1430 RSDS_R_ObjRCS_13 "/";
CM_ SG_ 1430 RSDS_R_ObjYawrate_13 "/";
CM_ SG_ 1430 RSDS_R_ObjHeading_13 "/";
CM_ SG_ 1430 RSDS_R_ObjLength_13 "/";
CM_ SG_ 1430 RSDS_R_SGU7_Checksum4 "/";
CM_ SG_ 1430 RSDS_R_SGU7_RollingCounter3 "/";
CM_ SG_ 1430 RSDS_R_ObjMotionDirection_13 "/";
CM_ SG_ 1430 RSDS_R_ObjAge_13 "/";
CM_ SG_ 1430 RSDS_R_ObjWidth_13 "/";
CM_ SG_ 1430 RSDS_R_ObjRAccelYStd_13 "/";
CM_ SG_ 1430 RSDS_R_ObjRAccelXStd_13 "/";
CM_ SG_ 1430 RSDS_R_ObjRelVelYStd_13 "/";
CM_ SG_ 1430 RSDS_R_ObjRelVelXStd_13 "/";
CM_ SG_ 1430 RSDS_R_ObjDistYStd_13 "/";
CM_ SG_ 1430 RSDS_R_SGU7_Checksum3 "/";
CM_ SG_ 1430 RSDS_R_SGU7_RollingCounter2 "/";
CM_ SG_ 1430 RSDS_R_ObjMotionType_13 "/";
CM_ SG_ 1430 RSDS_R_ObjMeasured_13 "/";
CM_ SG_ 1430 RSDS_R_ObjRelAccelY_13 "/";
CM_ SG_ 1430 RSDS_R_ObjRelAccelX_13 "/";
CM_ SG_ 1430 RSDS_R_ObjRelVelY_13 "/";
CM_ SG_ 1430 RSDS_R_ObjRelVelX_13 "/";
CM_ SG_ 1430 RSDS_R_SGU7_Checksum2 "/";
CM_ SG_ 1430 RSDS_R_SGU7_RollingCounter1 "/";
CM_ SG_ 1430 RSDS_R_ObjType_13 "/";
CM_ SG_ 1430 RSDS_R_ObjDistXStd_13 "/";
CM_ SG_ 1430 RSDS_R_ObjDistY_13 "/";
CM_ SG_ 1430 RSDS_R_ObjDistX_13 "/";
CM_ SG_ 1430 RSDS_R_ObjObstacleProb_13 "/";
CM_ SG_ 1430 RSDS_R_ObjExistProb_13 "/";
CM_ SG_ 1430 RSDS_R_ObjID_13 "/";
CM_ SG_ 1430 RSDS_R_SGU7_Checksum1 "/";
CM_ SG_ 1431 RSDS_R_SGU8_RollingCounter8 "/";
CM_ SG_ 1431 RSDS_R_SGU8_BlockCounter "/";
CM_ SG_ 1431 RSDS_R_HWATargetValidity_16 "/";
CM_ SG_ 1431 RSDS_R_ObjRefPoint_16 "/";
CM_ SG_ 1431 RSDS_R_ObjRCS_16 "/";
CM_ SG_ 1431 RSDS_R_ObjYawrate_16 "/";
CM_ SG_ 1431 RSDS_R_ObjHeading_16 "/";
CM_ SG_ 1431 RSDS_R_ObjLength_16 "/";
CM_ SG_ 1431 RSDS_R_SGU8_Checksum8 "/";
CM_ SG_ 1431 RSDS_R_SGU8_RollingCounter7 "/";
CM_ SG_ 1431 RSDS_R_ObjMotionDirection_16 "/";
CM_ SG_ 1431 RSDS_R_ObjAge_16 "/";
CM_ SG_ 1431 RSDS_R_ObjWidth_16 "/";
CM_ SG_ 1431 RSDS_R_ObjRAccelYStd_16 "/";
CM_ SG_ 1431 RSDS_R_ObjRAccelXStd_16 "/";
CM_ SG_ 1431 RSDS_R_ObjRelVelYStd_16 "/";
CM_ SG_ 1431 RSDS_R_ObjRelVelXStd_16 "/";
CM_ SG_ 1431 RSDS_R_ObjDistYStd_16 "/";
CM_ SG_ 1431 RSDS_R_SGU8_Checksum7 "/";
CM_ SG_ 1431 RSDS_R_SGU8_RollingCounter6 "/";
CM_ SG_ 1431 RSDS_R_ObjMotionType_16 "/";
CM_ SG_ 1431 RSDS_R_ObjMeasured_16 "/";
CM_ SG_ 1431 RSDS_R_ObjRelAccelY_16 "/";
CM_ SG_ 1431 RSDS_R_ObjRelAccelX_16 "/";
CM_ SG_ 1431 RSDS_R_ObjRelVelY_16 "/";
CM_ SG_ 1431 RSDS_R_ObjRelVelX_16 "/";
CM_ SG_ 1431 RSDS_R_SGU8_Checksum6 "/";
CM_ SG_ 1431 RSDS_R_SGU8_RollingCounter5 "/";
CM_ SG_ 1431 RSDS_R_ObjType_16 "/";
CM_ SG_ 1431 RSDS_R_ObjDistXStd_16 "/";
CM_ SG_ 1431 RSDS_R_ObjDistY_16 "/";
CM_ SG_ 1431 RSDS_R_ObjDistX_16 "/";
CM_ SG_ 1431 RSDS_R_ObjObstacleProb_16 "/";
CM_ SG_ 1431 RSDS_R_ObjExistProb_16 "/";
CM_ SG_ 1431 RSDS_R_ObjID_16 "/";
CM_ SG_ 1431 RSDS_R_SGU8_Checksum5 "/";
CM_ SG_ 1431 RSDS_R_SGU8_RollingCounter4 "/";
CM_ SG_ 1431 RSDS_R_HWATargetValidity_15 "/";
CM_ SG_ 1431 RSDS_R_ObjRefPoint_15 "/";
CM_ SG_ 1431 RSDS_R_ObjRCS_15 "/";
CM_ SG_ 1431 RSDS_R_ObjYawrate_15 "/";
CM_ SG_ 1431 RSDS_R_ObjHeading_15 "/";
CM_ SG_ 1431 RSDS_R_ObjLength_15 "/";
CM_ SG_ 1431 RSDS_R_SGU8_Checksum4 "/";
CM_ SG_ 1431 RSDS_R_SGU8_RollingCounter3 "/";
CM_ SG_ 1431 RSDS_R_ObjMotionDirection_15 "/";
CM_ SG_ 1431 RSDS_R_ObjAge_15 "/";
CM_ SG_ 1431 RSDS_R_ObjWidth_15 "/";
CM_ SG_ 1431 RSDS_R_ObjRAccelYStd_15 "/";
CM_ SG_ 1431 RSDS_R_ObjRAccelXStd_15 "/";
CM_ SG_ 1431 RSDS_R_ObjRelVelYStd_15 "/";
CM_ SG_ 1431 RSDS_R_ObjRelVelXStd_15 "/";
CM_ SG_ 1431 RSDS_R_ObjDistYStd_15 "/";
CM_ SG_ 1431 RSDS_R_SGU8_Checksum3 "/";
CM_ SG_ 1431 RSDS_R_SGU8_RollingCounter2 "/";
CM_ SG_ 1431 RSDS_R_ObjMotionType_15 "/";
CM_ SG_ 1431 RSDS_R_ObjMeasured_15 "/";
CM_ SG_ 1431 RSDS_R_ObjRelAccelY_15 "/";
CM_ SG_ 1431 RSDS_R_ObjRelAccelX_15 "/";
CM_ SG_ 1431 RSDS_R_ObjRelVelY_15 "/";
CM_ SG_ 1431 RSDS_R_ObjRelVelX_15 "/";
CM_ SG_ 1431 RSDS_R_SGU8_Checksum2 "/";
CM_ SG_ 1431 RSDS_R_SGU8_RollingCounter1 "/";
CM_ SG_ 1431 RSDS_R_ObjType_15 "/";
CM_ SG_ 1431 RSDS_R_ObjDistXStd_15 "/";
CM_ SG_ 1431 RSDS_R_ObjDistY_15 "/";
CM_ SG_ 1431 RSDS_R_ObjDistX_15 "/";
CM_ SG_ 1431 RSDS_R_ObjObstacleProb_15 "/";
CM_ SG_ 1431 RSDS_R_ObjExistProb_15 "/";
CM_ SG_ 1431 RSDS_R_ObjID_15 "/";
CM_ SG_ 1431 RSDS_R_SGU8_Checksum1 "/";
CM_ SG_ 1487 RSDS_R_SGU_HEAD_RollingCounter4 "/";
CM_ SG_ 1487 RSDS_R_SGU_HEAD_BlockCounter "/";
CM_ SG_ 1487 RSDS_R_ObjAziAngleCalib "/";
CM_ SG_ 1487 RSDS_R_Guardrail_dxStart "/";
CM_ SG_ 1487 RSDS_R_GuardrailC3 "/";
CM_ SG_ 1487 RSDS_R_SGU_HEAD_Checksum4 "/";
CM_ SG_ 1487 RSDS_R_SGU_HEAD_RollingCounter3 "/";
CM_ SG_ 1487 RSDS_R_GuardrailC2 "/";
CM_ SG_ 1487 RSDS_R_GuardrailC1 "/";
CM_ SG_ 1487 RSDS_R_GuardrailC0 "/";
CM_ SG_ 1487 RSDS_R_SGU_HEAD_Checksum3 "/";
CM_ SG_ 1487 RSDS_R_SGU_HEAD_RollingCounter2 "/";
CM_ SG_ 1487 RSDS_R_hdr_AutosarTimeStamp "/";
CM_ SG_ 1487 RSDS_R_SGU_HEAD_Checksum2 "/";
CM_ SG_ 1487 RSDS_R_SGU_HEAD_RollingCounter1 "/";
CM_ SG_ 1487 RSDS_R_hdr_ErrorStatus "/";
CM_ SG_ 1487 RSDS_R_Guardrail_dxEnd "/";
CM_ SG_ 1487 RSDS_R_GuardrailConfidence "/";
CM_ SG_ 1487 RSDS_R_ObjDetected "/";
CM_ SG_ 1487 RSDS_R_BLIND "/";
CM_ SG_ 1487 RSDS_R_hdr_TimeStampStatus "/";
CM_ SG_ 1487 RSDS_R_hdr_TimeStamp "/";
CM_ SG_ 1487 RSDS_R_SGU_HEAD_Checksum1 "/";
BA_DEF_ BO_  "GenMsgILSupport" ENUM  "No","Yes";
BA_DEF_ BO_  "VFrameFormat" ENUM  "StandardCAN","ExtendedCAN","reserved","reserved","reserved","reserved","reserved","reserved","reserved","reserved","reserved","reserved","reserved","reserved","StandardCAN_FD","ExtendedCAN_FD";
BA_DEF_ SG_  "GenSigSendType" ENUM  "Cyclic","OnWrite","OnWriteWithRepetition","OnChange","OnChangeWithRepetition","IfActive","IfActiveWithRepetition","NoSigSendType","CyclicAndSpontanX","NotUsed","Event","CE";
BA_DEF_ SG_  "IsMonitor" ENUM  "*","Monitor";
BA_DEF_ SG_  "UnitConversionFactor" FLOAT -100 100;
BA_DEF_ SG_  "SigInvalidSetFlag" ENUM  "*","Yes";
BA_DEF_ SG_  "Internal_type" ENUM  "*","UB","UW","UL","SB","SW","SL";
BA_DEF_ SG_  "IsCrcSignal" ENUM  "No","Yes";
BA_DEF_ SG_  "IsRcSignal" ENUM  "No","Yes";
BA_DEF_ BO_  "GenMsgSendType" ENUM  "Cyclic","Event","CE","NotUsed","NotUsed","NotUsed","NotUsed","NotUsed","NoMsgSendType","IfActive","IfActiveWithRepetition","CyclicAndSpontanX";
BA_DEF_ SG_  "GenSigStartValue" INT 0 2147483647;
BA_DEF_ BO_  "MsgType" ENUM  "Normal","NM","Diag","vector_leerstring";
BA_DEF_ BO_  "GenMsgCycleTime" INT 0 65535;
BA_DEF_DEF_  "GenMsgILSupport" "Yes";
BA_DEF_DEF_  "VFrameFormat" "StandardCAN";
BA_DEF_DEF_  "GenSigSendType" "Cyclic";
BA_DEF_DEF_  "IsMonitor" "*";
BA_DEF_DEF_  "UnitConversionFactor" 1;
BA_DEF_DEF_  "SigInvalidSetFlag" "*";
BA_DEF_DEF_  "Internal_type" "*";
BA_DEF_DEF_  "IsCrcSignal" "No";
BA_DEF_DEF_  "IsRcSignal" "No";
BA_DEF_DEF_  "GenMsgSendType" "Cyclic";
BA_DEF_DEF_  "GenSigStartValue" 0;
BA_DEF_DEF_  "MsgType" "";
BA_DEF_DEF_  "GenMsgCycleTime" 0;
BA_ "GenMsgSendType" BO_ 1429 1;
BA_ "MsgType" BO_ 1429 0;
BA_ "VFrameFormat" BO_ 1429 14;
BA_ "GenMsgSendType" BO_ 1430 1;
BA_ "MsgType" BO_ 1430 0;
BA_ "VFrameFormat" BO_ 1430 14;
BA_ "GenMsgSendType" BO_ 1431 1;
BA_ "MsgType" BO_ 1431 0;
BA_ "VFrameFormat" BO_ 1431 14;
BA_ "GenMsgSendType" BO_ 1432 1;
BA_ "MsgType" BO_ 1432 0;
BA_ "VFrameFormat" BO_ 1432 14;
BA_ "GenMsgSendType" BO_ 1433 1;
BA_ "MsgType" BO_ 1433 0;
BA_ "VFrameFormat" BO_ 1433 14;
BA_ "GenMsgSendType" BO_ 1434 1;
BA_ "MsgType" BO_ 1434 0;
BA_ "VFrameFormat" BO_ 1434 14;
BA_ "GenMsgSendType" BO_ 1435 1;
BA_ "MsgType" BO_ 1435 0;
BA_ "VFrameFormat" BO_ 1435 14;
BA_ "GenMsgSendType" BO_ 1436 1;
BA_ "MsgType" BO_ 1436 0;
BA_ "VFrameFormat" BO_ 1436 14;
BA_ "GenMsgSendType" BO_ 1437 1;
BA_ "MsgType" BO_ 1437 0;
BA_ "VFrameFormat" BO_ 1437 14;
BA_ "GenMsgSendType" BO_ 1438 1;
BA_ "MsgType" BO_ 1438 0;
BA_ "VFrameFormat" BO_ 1438 14;
BA_ "GenMsgSendType" BO_ 1439 1;
BA_ "MsgType" BO_ 1439 0;
BA_ "VFrameFormat" BO_ 1439 14;
BA_ "GenMsgSendType" BO_ 1487 1;
BA_ "MsgType" BO_ 1487 0;
BA_ "VFrameFormat" BO_ 1487 14;
BA_ "GenMsgSendType" BO_ 1967 1;
BA_ "MsgType" BO_ 1967 0;
BA_ "MsgType" BO_ 367 0;
BA_ "GenMsgCycleTime" BO_ 367 20;
BA_ "VFrameFormat" BO_ 367 14;
BA_ "MsgType" BO_ 778 0;
BA_ "GenMsgCycleTime" BO_ 778 200;
BA_ "VFrameFormat" BO_ 778 14;
BA_ "GenSigSendType" SG_ 1429 RSDS_R_SGU6_RollingCounter8 9;
BA_ "IsRcSignal" SG_ 1429 RSDS_R_SGU6_RollingCounter8 1;
BA_ "GenSigSendType" SG_ 1429 RSDS_R_SGU6_BlockCounter 9;
BA_ "GenSigSendType" SG_ 1429 RSDS_R_HWATargetValidity_12 9;
BA_ "GenSigSendType" SG_ 1429 RSDS_R_ObjRefPoint_12 9;
BA_ "GenSigStartValue" SG_ 1429 RSDS_R_ObjRCS_12 400;
BA_ "GenSigSendType" SG_ 1429 RSDS_R_ObjRCS_12 9;
BA_ "GenSigSendType" SG_ 1429 RSDS_R_ObjYawrate_12 9;
BA_ "GenSigSendType" SG_ 1429 RSDS_R_ObjHeading_12 9;
BA_ "GenSigSendType" SG_ 1429 RSDS_R_ObjLength_12 9;
BA_ "GenSigSendType" SG_ 1429 RSDS_R_SGU6_Checksum8 9;
BA_ "IsCrcSignal" SG_ 1429 RSDS_R_SGU6_Checksum8 1;
BA_ "GenSigSendType" SG_ 1429 RSDS_R_SGU6_RollingCounter7 9;
BA_ "IsRcSignal" SG_ 1429 RSDS_R_SGU6_RollingCounter7 1;
BA_ "GenSigSendType" SG_ 1429 RSDS_R_ObjMotionDirection_12 9;
BA_ "GenSigSendType" SG_ 1429 RSDS_R_ObjAge_12 9;
BA_ "GenSigSendType" SG_ 1429 RSDS_R_ObjWidth_12 9;
BA_ "GenSigSendType" SG_ 1429 RSDS_R_ObjRAccelYStd_12 9;
BA_ "GenSigSendType" SG_ 1429 RSDS_R_ObjRAccelXStd_12 9;
BA_ "GenSigSendType" SG_ 1429 RSDS_R_ObjRelVelYStd_12 9;
BA_ "GenSigSendType" SG_ 1429 RSDS_R_ObjRelVelXStd_12 9;
BA_ "GenSigSendType" SG_ 1429 RSDS_R_ObjDistYStd_12 9;
BA_ "GenSigSendType" SG_ 1429 RSDS_R_SGU6_Checksum7 9;
BA_ "IsCrcSignal" SG_ 1429 RSDS_R_SGU6_Checksum7 1;
BA_ "GenSigSendType" SG_ 1429 RSDS_R_SGU6_RollingCounter6 9;
BA_ "IsRcSignal" SG_ 1429 RSDS_R_SGU6_RollingCounter6 1;
BA_ "GenSigSendType" SG_ 1429 RSDS_R_ObjMotionType_12 9;
BA_ "GenSigStartValue" SG_ 1429 RSDS_R_ObjMeasured_12 1;
BA_ "GenSigSendType" SG_ 1429 RSDS_R_ObjMeasured_12 9;
BA_ "GenSigStartValue" SG_ 1429 RSDS_R_ObjRelAccelY_12 512;
BA_ "GenSigSendType" SG_ 1429 RSDS_R_ObjRelAccelY_12 9;
BA_ "GenSigStartValue" SG_ 1429 RSDS_R_ObjRelAccelX_12 512;
BA_ "GenSigSendType" SG_ 1429 RSDS_R_ObjRelAccelX_12 9;
BA_ "GenSigStartValue" SG_ 1429 RSDS_R_ObjRelVelY_12 4102;
BA_ "GenSigSendType" SG_ 1429 RSDS_R_ObjRelVelY_12 9;
BA_ "GenSigStartValue" SG_ 1429 RSDS_R_ObjRelVelX_12 4102;
BA_ "GenSigSendType" SG_ 1429 RSDS_R_ObjRelVelX_12 9;
BA_ "GenSigSendType" SG_ 1429 RSDS_R_SGU6_Checksum6 9;
BA_ "IsCrcSignal" SG_ 1429 RSDS_R_SGU6_Checksum6 1;
BA_ "GenSigSendType" SG_ 1429 RSDS_R_SGU6_RollingCounter5 9;
BA_ "IsRcSignal" SG_ 1429 RSDS_R_SGU6_RollingCounter5 1;
BA_ "GenSigSendType" SG_ 1429 RSDS_R_ObjType_12 9;
BA_ "GenSigSendType" SG_ 1429 RSDS_R_ObjDistXStd_12 9;
BA_ "GenSigStartValue" SG_ 1429 RSDS_R_ObjDistY_12 1024;
BA_ "GenSigSendType" SG_ 1429 RSDS_R_ObjDistY_12 9;
BA_ "GenSigSendType" SG_ 1429 RSDS_R_ObjDistX_12 9;
BA_ "GenSigSendType" SG_ 1429 RSDS_R_ObjObstacleProb_12 9;
BA_ "GenSigSendType" SG_ 1429 RSDS_R_ObjExistProb_12 9;
BA_ "GenSigSendType" SG_ 1429 RSDS_R_ObjID_12 9;
BA_ "GenSigSendType" SG_ 1429 RSDS_R_SGU6_Checksum5 9;
BA_ "IsCrcSignal" SG_ 1429 RSDS_R_SGU6_Checksum5 1;
BA_ "GenSigSendType" SG_ 1429 RSDS_R_SGU6_RollingCounter4 9;
BA_ "IsRcSignal" SG_ 1429 RSDS_R_SGU6_RollingCounter4 1;
BA_ "GenSigSendType" SG_ 1429 RSDS_R_HWATargetValidity_11 9;
BA_ "GenSigSendType" SG_ 1429 RSDS_R_ObjRefPoint_11 9;
BA_ "GenSigStartValue" SG_ 1429 RSDS_R_ObjRCS_11 400;
BA_ "GenSigSendType" SG_ 1429 RSDS_R_ObjRCS_11 9;
BA_ "GenSigSendType" SG_ 1429 RSDS_R_ObjYawrate_11 9;
BA_ "GenSigSendType" SG_ 1429 RSDS_R_ObjHeading_11 9;
BA_ "GenSigSendType" SG_ 1429 RSDS_R_ObjLength_11 9;
BA_ "GenSigSendType" SG_ 1429 RSDS_R_SGU6_Checksum4 9;
BA_ "IsCrcSignal" SG_ 1429 RSDS_R_SGU6_Checksum4 1;
BA_ "GenSigSendType" SG_ 1429 RSDS_R_SGU6_RollingCounter3 9;
BA_ "IsRcSignal" SG_ 1429 RSDS_R_SGU6_RollingCounter3 1;
BA_ "GenSigSendType" SG_ 1429 RSDS_R_ObjMotionDirection_11 9;
BA_ "GenSigSendType" SG_ 1429 RSDS_R_ObjAge_11 9;
BA_ "GenSigSendType" SG_ 1429 RSDS_R_ObjWidth_11 9;
BA_ "GenSigSendType" SG_ 1429 RSDS_R_ObjRAccelYStd_11 9;
BA_ "GenSigSendType" SG_ 1429 RSDS_R_ObjRAccelXStd_11 9;
BA_ "GenSigSendType" SG_ 1429 RSDS_R_ObjRelVelYStd_11 9;
BA_ "GenSigSendType" SG_ 1429 RSDS_R_ObjRelVelXStd_11 9;
BA_ "GenSigSendType" SG_ 1429 RSDS_R_ObjDistYStd_11 9;
BA_ "GenSigSendType" SG_ 1429 RSDS_R_SGU6_Checksum3 9;
BA_ "IsCrcSignal" SG_ 1429 RSDS_R_SGU6_Checksum3 1;
BA_ "GenSigSendType" SG_ 1429 RSDS_R_SGU6_RollingCounter2 9;
BA_ "IsRcSignal" SG_ 1429 RSDS_R_SGU6_RollingCounter2 1;
BA_ "GenSigSendType" SG_ 1429 RSDS_R_ObjMotionType_11 9;
BA_ "GenSigStartValue" SG_ 1429 RSDS_R_ObjMeasured_11 1;
BA_ "GenSigSendType" SG_ 1429 RSDS_R_ObjMeasured_11 9;
BA_ "GenSigStartValue" SG_ 1429 RSDS_R_ObjRelAccelY_11 512;
BA_ "GenSigSendType" SG_ 1429 RSDS_R_ObjRelAccelY_11 9;
BA_ "GenSigStartValue" SG_ 1429 RSDS_R_ObjRelAccelX_11 512;
BA_ "GenSigSendType" SG_ 1429 RSDS_R_ObjRelAccelX_11 9;
BA_ "GenSigStartValue" SG_ 1429 RSDS_R_ObjRelVelY_11 4102;
BA_ "GenSigSendType" SG_ 1429 RSDS_R_ObjRelVelY_11 9;
BA_ "GenSigStartValue" SG_ 1429 RSDS_R_ObjRelVelX_11 4102;
BA_ "GenSigSendType" SG_ 1429 RSDS_R_ObjRelVelX_11 9;
BA_ "GenSigSendType" SG_ 1429 RSDS_R_SGU6_Checksum2 9;
BA_ "IsCrcSignal" SG_ 1429 RSDS_R_SGU6_Checksum2 1;
BA_ "GenSigSendType" SG_ 1429 RSDS_R_SGU6_RollingCounter1 9;
BA_ "IsRcSignal" SG_ 1429 RSDS_R_SGU6_RollingCounter1 1;
BA_ "GenSigSendType" SG_ 1429 RSDS_R_ObjType_11 9;
BA_ "GenSigSendType" SG_ 1429 RSDS_R_ObjDistXStd_11 9;
BA_ "GenSigStartValue" SG_ 1429 RSDS_R_ObjDistY_11 1024;
BA_ "GenSigSendType" SG_ 1429 RSDS_R_ObjDistY_11 9;
BA_ "GenSigSendType" SG_ 1429 RSDS_R_ObjDistX_11 9;
BA_ "GenSigSendType" SG_ 1429 RSDS_R_ObjObstacleProb_11 9;
BA_ "GenSigSendType" SG_ 1429 RSDS_R_ObjExistProb_11 9;
BA_ "GenSigSendType" SG_ 1429 RSDS_R_ObjID_11 9;
BA_ "GenSigSendType" SG_ 1429 RSDS_R_SGU6_Checksum1 9;
BA_ "IsCrcSignal" SG_ 1429 RSDS_R_SGU6_Checksum1 1;
BA_ "GenSigSendType" SG_ 1430 RSDS_R_SGU7_RollingCounter8 9;
BA_ "IsRcSignal" SG_ 1430 RSDS_R_SGU7_RollingCounter8 1;
BA_ "GenSigSendType" SG_ 1430 RSDS_R_SGU7_BlockCounter 9;
BA_ "GenSigSendType" SG_ 1430 RSDS_R_HWATargetValidity_14 9;
BA_ "GenSigSendType" SG_ 1430 RSDS_R_ObjRefPoint_14 9;
BA_ "GenSigStartValue" SG_ 1430 RSDS_R_ObjRCS_14 400;
BA_ "GenSigSendType" SG_ 1430 RSDS_R_ObjRCS_14 9;
BA_ "GenSigSendType" SG_ 1430 RSDS_R_ObjYawrate_14 9;
BA_ "GenSigSendType" SG_ 1430 RSDS_R_ObjHeading_14 9;
BA_ "GenSigSendType" SG_ 1430 RSDS_R_ObjLength_14 9;
BA_ "GenSigSendType" SG_ 1430 RSDS_R_SGU7_Checksum8 9;
BA_ "IsCrcSignal" SG_ 1430 RSDS_R_SGU7_Checksum8 1;
BA_ "GenSigSendType" SG_ 1430 RSDS_R_SGU7_RollingCounter7 9;
BA_ "IsRcSignal" SG_ 1430 RSDS_R_SGU7_RollingCounter7 1;
BA_ "GenSigSendType" SG_ 1430 RSDS_R_ObjMotionDirection_14 9;
BA_ "GenSigSendType" SG_ 1430 RSDS_R_ObjAge_14 9;
BA_ "GenSigSendType" SG_ 1430 RSDS_R_ObjWidth_14 9;
BA_ "GenSigSendType" SG_ 1430 RSDS_R_ObjRAccelYStd_14 9;
BA_ "GenSigSendType" SG_ 1430 RSDS_R_ObjRAccelXStd_14 9;
BA_ "GenSigSendType" SG_ 1430 RSDS_R_ObjRelVelYStd_14 9;
BA_ "GenSigSendType" SG_ 1430 RSDS_R_ObjRelVelXStd_14 9;
BA_ "GenSigSendType" SG_ 1430 RSDS_R_ObjDistYStd_14 9;
BA_ "GenSigSendType" SG_ 1430 RSDS_R_SGU7_Checksum7 9;
BA_ "IsCrcSignal" SG_ 1430 RSDS_R_SGU7_Checksum7 1;
BA_ "GenSigSendType" SG_ 1430 RSDS_R_SGU7_RollingCounter6 9;
BA_ "IsRcSignal" SG_ 1430 RSDS_R_SGU7_RollingCounter6 1;
BA_ "GenSigSendType" SG_ 1430 RSDS_R_ObjMotionType_14 9;
BA_ "GenSigStartValue" SG_ 1430 RSDS_R_ObjMeasured_14 1;
BA_ "GenSigSendType" SG_ 1430 RSDS_R_ObjMeasured_14 9;
BA_ "GenSigStartValue" SG_ 1430 RSDS_R_ObjRelAccelY_14 512;
BA_ "GenSigSendType" SG_ 1430 RSDS_R_ObjRelAccelY_14 9;
BA_ "GenSigStartValue" SG_ 1430 RSDS_R_ObjRelAccelX_14 512;
BA_ "GenSigSendType" SG_ 1430 RSDS_R_ObjRelAccelX_14 9;
BA_ "GenSigStartValue" SG_ 1430 RSDS_R_ObjRelVelY_14 4102;
BA_ "GenSigSendType" SG_ 1430 RSDS_R_ObjRelVelY_14 9;
BA_ "GenSigStartValue" SG_ 1430 RSDS_R_ObjRelVelX_14 4102;
BA_ "GenSigSendType" SG_ 1430 RSDS_R_ObjRelVelX_14 9;
BA_ "GenSigSendType" SG_ 1430 RSDS_R_SGU7_Checksum6 9;
BA_ "IsCrcSignal" SG_ 1430 RSDS_R_SGU7_Checksum6 1;
BA_ "GenSigSendType" SG_ 1430 RSDS_R_SGU7_RollingCounter5 9;
BA_ "IsRcSignal" SG_ 1430 RSDS_R_SGU7_RollingCounter5 1;
BA_ "GenSigSendType" SG_ 1430 RSDS_R_ObjType_14 9;
BA_ "GenSigSendType" SG_ 1430 RSDS_R_ObjDistXStd_14 9;
BA_ "GenSigStartValue" SG_ 1430 RSDS_R_ObjDistY_14 1024;
BA_ "GenSigSendType" SG_ 1430 RSDS_R_ObjDistY_14 9;
BA_ "GenSigSendType" SG_ 1430 RSDS_R_ObjDistX_14 9;
BA_ "GenSigSendType" SG_ 1430 RSDS_R_ObjObstacleProb_14 9;
BA_ "GenSigSendType" SG_ 1430 RSDS_R_ObjExistProb_14 9;
BA_ "GenSigSendType" SG_ 1430 RSDS_R_ObjID_14 9;
BA_ "GenSigSendType" SG_ 1430 RSDS_R_SGU7_Checksum5 9;
BA_ "IsCrcSignal" SG_ 1430 RSDS_R_SGU7_Checksum5 1;
BA_ "GenSigSendType" SG_ 1430 RSDS_R_SGU7_RollingCounter4 9;
BA_ "IsRcSignal" SG_ 1430 RSDS_R_SGU7_RollingCounter4 1;
BA_ "GenSigSendType" SG_ 1430 RSDS_R_HWATargetValidity_13 9;
BA_ "GenSigSendType" SG_ 1430 RSDS_R_ObjRefPoint_13 9;
BA_ "GenSigStartValue" SG_ 1430 RSDS_R_ObjRCS_13 400;
BA_ "GenSigSendType" SG_ 1430 RSDS_R_ObjRCS_13 9;
BA_ "GenSigSendType" SG_ 1430 RSDS_R_ObjYawrate_13 9;
BA_ "GenSigSendType" SG_ 1430 RSDS_R_ObjHeading_13 9;
BA_ "GenSigSendType" SG_ 1430 RSDS_R_ObjLength_13 9;
BA_ "GenSigSendType" SG_ 1430 RSDS_R_SGU7_Checksum4 9;
BA_ "IsCrcSignal" SG_ 1430 RSDS_R_SGU7_Checksum4 1;
BA_ "GenSigSendType" SG_ 1430 RSDS_R_SGU7_RollingCounter3 9;
BA_ "IsRcSignal" SG_ 1430 RSDS_R_SGU7_RollingCounter3 1;
BA_ "GenSigSendType" SG_ 1430 RSDS_R_ObjMotionDirection_13 9;
BA_ "GenSigSendType" SG_ 1430 RSDS_R_ObjAge_13 9;
BA_ "GenSigSendType" SG_ 1430 RSDS_R_ObjWidth_13 9;
BA_ "GenSigSendType" SG_ 1430 RSDS_R_ObjRAccelYStd_13 9;
BA_ "GenSigSendType" SG_ 1430 RSDS_R_ObjRAccelXStd_13 9;
BA_ "GenSigSendType" SG_ 1430 RSDS_R_ObjRelVelYStd_13 9;
BA_ "GenSigSendType" SG_ 1430 RSDS_R_ObjRelVelXStd_13 9;
BA_ "GenSigSendType" SG_ 1430 RSDS_R_ObjDistYStd_13 9;
BA_ "GenSigSendType" SG_ 1430 RSDS_R_SGU7_Checksum3 9;
BA_ "IsCrcSignal" SG_ 1430 RSDS_R_SGU7_Checksum3 1;
BA_ "GenSigSendType" SG_ 1430 RSDS_R_SGU7_RollingCounter2 9;
BA_ "IsRcSignal" SG_ 1430 RSDS_R_SGU7_RollingCounter2 1;
BA_ "GenSigSendType" SG_ 1430 RSDS_R_ObjMotionType_13 9;
BA_ "GenSigStartValue" SG_ 1430 RSDS_R_ObjMeasured_13 1;
BA_ "GenSigSendType" SG_ 1430 RSDS_R_ObjMeasured_13 9;
BA_ "GenSigStartValue" SG_ 1430 RSDS_R_ObjRelAccelY_13 512;
BA_ "GenSigSendType" SG_ 1430 RSDS_R_ObjRelAccelY_13 9;
BA_ "GenSigStartValue" SG_ 1430 RSDS_R_ObjRelAccelX_13 512;
BA_ "GenSigSendType" SG_ 1430 RSDS_R_ObjRelAccelX_13 9;
BA_ "GenSigStartValue" SG_ 1430 RSDS_R_ObjRelVelY_13 4102;
BA_ "GenSigSendType" SG_ 1430 RSDS_R_ObjRelVelY_13 9;
BA_ "GenSigStartValue" SG_ 1430 RSDS_R_ObjRelVelX_13 4102;
BA_ "GenSigSendType" SG_ 1430 RSDS_R_ObjRelVelX_13 9;
BA_ "GenSigSendType" SG_ 1430 RSDS_R_SGU7_Checksum2 9;
BA_ "IsCrcSignal" SG_ 1430 RSDS_R_SGU7_Checksum2 1;
BA_ "GenSigSendType" SG_ 1430 RSDS_R_SGU7_RollingCounter1 9;
BA_ "IsRcSignal" SG_ 1430 RSDS_R_SGU7_RollingCounter1 1;
BA_ "GenSigSendType" SG_ 1430 RSDS_R_ObjType_13 9;
BA_ "GenSigSendType" SG_ 1430 RSDS_R_ObjDistXStd_13 9;
BA_ "GenSigStartValue" SG_ 1430 RSDS_R_ObjDistY_13 1024;
BA_ "GenSigSendType" SG_ 1430 RSDS_R_ObjDistY_13 9;
BA_ "GenSigSendType" SG_ 1430 RSDS_R_ObjDistX_13 9;
BA_ "GenSigSendType" SG_ 1430 RSDS_R_ObjObstacleProb_13 9;
BA_ "GenSigSendType" SG_ 1430 RSDS_R_ObjExistProb_13 9;
BA_ "GenSigSendType" SG_ 1430 RSDS_R_ObjID_13 9;
BA_ "GenSigSendType" SG_ 1430 RSDS_R_SGU7_Checksum1 9;
BA_ "IsCrcSignal" SG_ 1430 RSDS_R_SGU7_Checksum1 1;
BA_ "GenSigSendType" SG_ 1431 RSDS_R_SGU8_RollingCounter8 9;
BA_ "IsRcSignal" SG_ 1431 RSDS_R_SGU8_RollingCounter8 1;
BA_ "GenSigSendType" SG_ 1431 RSDS_R_SGU8_BlockCounter 9;
BA_ "GenSigSendType" SG_ 1431 RSDS_R_HWATargetValidity_16 9;
BA_ "GenSigSendType" SG_ 1431 RSDS_R_ObjRefPoint_16 9;
BA_ "GenSigStartValue" SG_ 1431 RSDS_R_ObjRCS_16 400;
BA_ "GenSigSendType" SG_ 1431 RSDS_R_ObjRCS_16 9;
BA_ "GenSigSendType" SG_ 1431 RSDS_R_ObjYawrate_16 9;
BA_ "GenSigSendType" SG_ 1431 RSDS_R_ObjHeading_16 9;
BA_ "GenSigSendType" SG_ 1431 RSDS_R_ObjLength_16 9;
BA_ "GenSigSendType" SG_ 1431 RSDS_R_SGU8_Checksum8 9;
BA_ "IsCrcSignal" SG_ 1431 RSDS_R_SGU8_Checksum8 1;
BA_ "GenSigSendType" SG_ 1431 RSDS_R_SGU8_RollingCounter7 9;
BA_ "IsRcSignal" SG_ 1431 RSDS_R_SGU8_RollingCounter7 1;
BA_ "GenSigSendType" SG_ 1431 RSDS_R_ObjMotionDirection_16 9;
BA_ "GenSigSendType" SG_ 1431 RSDS_R_ObjAge_16 9;
BA_ "GenSigSendType" SG_ 1431 RSDS_R_ObjWidth_16 9;
BA_ "GenSigSendType" SG_ 1431 RSDS_R_ObjRAccelYStd_16 9;
BA_ "GenSigSendType" SG_ 1431 RSDS_R_ObjRAccelXStd_16 9;
BA_ "GenSigSendType" SG_ 1431 RSDS_R_ObjRelVelYStd_16 9;
BA_ "GenSigSendType" SG_ 1431 RSDS_R_ObjRelVelXStd_16 9;
BA_ "GenSigSendType" SG_ 1431 RSDS_R_ObjDistYStd_16 9;
BA_ "GenSigSendType" SG_ 1431 RSDS_R_SGU8_Checksum7 9;
BA_ "IsCrcSignal" SG_ 1431 RSDS_R_SGU8_Checksum7 1;
BA_ "GenSigSendType" SG_ 1431 RSDS_R_SGU8_RollingCounter6 9;
BA_ "IsRcSignal" SG_ 1431 RSDS_R_SGU8_RollingCounter6 1;
BA_ "GenSigSendType" SG_ 1431 RSDS_R_ObjMotionType_16 9;
BA_ "GenSigStartValue" SG_ 1431 RSDS_R_ObjMeasured_16 1;
BA_ "GenSigSendType" SG_ 1431 RSDS_R_ObjMeasured_16 9;
BA_ "GenSigStartValue" SG_ 1431 RSDS_R_ObjRelAccelY_16 512;
BA_ "GenSigSendType" SG_ 1431 RSDS_R_ObjRelAccelY_16 9;
BA_ "GenSigStartValue" SG_ 1431 RSDS_R_ObjRelAccelX_16 512;
BA_ "GenSigSendType" SG_ 1431 RSDS_R_ObjRelAccelX_16 9;
BA_ "GenSigStartValue" SG_ 1431 RSDS_R_ObjRelVelY_16 4102;
BA_ "GenSigSendType" SG_ 1431 RSDS_R_ObjRelVelY_16 9;
BA_ "GenSigStartValue" SG_ 1431 RSDS_R_ObjRelVelX_16 4102;
BA_ "GenSigSendType" SG_ 1431 RSDS_R_ObjRelVelX_16 9;
BA_ "GenSigSendType" SG_ 1431 RSDS_R_SGU8_Checksum6 9;
BA_ "IsCrcSignal" SG_ 1431 RSDS_R_SGU8_Checksum6 1;
BA_ "GenSigSendType" SG_ 1431 RSDS_R_SGU8_RollingCounter5 9;
BA_ "IsRcSignal" SG_ 1431 RSDS_R_SGU8_RollingCounter5 1;
BA_ "GenSigSendType" SG_ 1431 RSDS_R_ObjType_16 9;
BA_ "GenSigSendType" SG_ 1431 RSDS_R_ObjDistXStd_16 9;
BA_ "GenSigStartValue" SG_ 1431 RSDS_R_ObjDistY_16 1024;
BA_ "GenSigSendType" SG_ 1431 RSDS_R_ObjDistY_16 9;
BA_ "GenSigSendType" SG_ 1431 RSDS_R_ObjDistX_16 9;
BA_ "GenSigSendType" SG_ 1431 RSDS_R_ObjObstacleProb_16 9;
BA_ "GenSigSendType" SG_ 1431 RSDS_R_ObjExistProb_16 9;
BA_ "GenSigSendType" SG_ 1431 RSDS_R_ObjID_16 9;
BA_ "GenSigSendType" SG_ 1431 RSDS_R_SGU8_Checksum5 9;
BA_ "IsCrcSignal" SG_ 1431 RSDS_R_SGU8_Checksum5 1;
BA_ "GenSigSendType" SG_ 1431 RSDS_R_SGU8_RollingCounter4 9;
BA_ "IsRcSignal" SG_ 1431 RSDS_R_SGU8_RollingCounter4 1;
BA_ "GenSigSendType" SG_ 1431 RSDS_R_HWATargetValidity_15 9;
BA_ "GenSigSendType" SG_ 1431 RSDS_R_ObjRefPoint_15 9;
BA_ "GenSigStartValue" SG_ 1431 RSDS_R_ObjRCS_15 400;
BA_ "GenSigSendType" SG_ 1431 RSDS_R_ObjRCS_15 9;
BA_ "GenSigSendType" SG_ 1431 RSDS_R_ObjYawrate_15 9;
BA_ "GenSigSendType" SG_ 1431 RSDS_R_ObjHeading_15 9;
BA_ "GenSigSendType" SG_ 1431 RSDS_R_ObjLength_15 9;
BA_ "GenSigSendType" SG_ 1431 RSDS_R_SGU8_Checksum4 9;
BA_ "IsCrcSignal" SG_ 1431 RSDS_R_SGU8_Checksum4 1;
BA_ "GenSigSendType" SG_ 1431 RSDS_R_SGU8_RollingCounter3 9;
BA_ "IsRcSignal" SG_ 1431 RSDS_R_SGU8_RollingCounter3 1;
BA_ "GenSigSendType" SG_ 1431 RSDS_R_ObjMotionDirection_15 9;
BA_ "GenSigSendType" SG_ 1431 RSDS_R_ObjAge_15 9;
BA_ "GenSigSendType" SG_ 1431 RSDS_R_ObjWidth_15 9;
BA_ "GenSigSendType" SG_ 1431 RSDS_R_ObjRAccelYStd_15 9;
BA_ "GenSigSendType" SG_ 1431 RSDS_R_ObjRAccelXStd_15 9;
BA_ "GenSigSendType" SG_ 1431 RSDS_R_ObjRelVelYStd_15 9;
BA_ "GenSigSendType" SG_ 1431 RSDS_R_ObjRelVelXStd_15 9;
BA_ "GenSigSendType" SG_ 1431 RSDS_R_ObjDistYStd_15 9;
BA_ "GenSigSendType" SG_ 1431 RSDS_R_SGU8_Checksum3 9;
BA_ "IsCrcSignal" SG_ 1431 RSDS_R_SGU8_Checksum3 1;
BA_ "GenSigSendType" SG_ 1431 RSDS_R_SGU8_RollingCounter2 9;
BA_ "IsRcSignal" SG_ 1431 RSDS_R_SGU8_RollingCounter2 1;
BA_ "GenSigSendType" SG_ 1431 RSDS_R_ObjMotionType_15 9;
BA_ "GenSigStartValue" SG_ 1431 RSDS_R_ObjMeasured_15 1;
BA_ "GenSigSendType" SG_ 1431 RSDS_R_ObjMeasured_15 9;
BA_ "GenSigStartValue" SG_ 1431 RSDS_R_ObjRelAccelY_15 512;
BA_ "GenSigSendType" SG_ 1431 RSDS_R_ObjRelAccelY_15 9;
BA_ "GenSigStartValue" SG_ 1431 RSDS_R_ObjRelAccelX_15 512;
BA_ "GenSigSendType" SG_ 1431 RSDS_R_ObjRelAccelX_15 9;
BA_ "GenSigStartValue" SG_ 1431 RSDS_R_ObjRelVelY_15 4102;
BA_ "GenSigSendType" SG_ 1431 RSDS_R_ObjRelVelY_15 9;
BA_ "GenSigStartValue" SG_ 1431 RSDS_R_ObjRelVelX_15 4102;
BA_ "GenSigSendType" SG_ 1431 RSDS_R_ObjRelVelX_15 9;
BA_ "GenSigSendType" SG_ 1431 RSDS_R_SGU8_Checksum2 9;
BA_ "IsCrcSignal" SG_ 1431 RSDS_R_SGU8_Checksum2 1;
BA_ "GenSigSendType" SG_ 1431 RSDS_R_SGU8_RollingCounter1 9;
BA_ "IsRcSignal" SG_ 1431 RSDS_R_SGU8_RollingCounter1 1;
BA_ "GenSigSendType" SG_ 1431 RSDS_R_ObjType_15 9;
BA_ "GenSigSendType" SG_ 1431 RSDS_R_ObjDistXStd_15 9;
BA_ "GenSigStartValue" SG_ 1431 RSDS_R_ObjDistY_15 1024;
BA_ "GenSigSendType" SG_ 1431 RSDS_R_ObjDistY_15 9;
BA_ "GenSigSendType" SG_ 1431 RSDS_R_ObjDistX_15 9;
BA_ "GenSigSendType" SG_ 1431 RSDS_R_ObjObstacleProb_15 9;
BA_ "GenSigSendType" SG_ 1431 RSDS_R_ObjExistProb_15 9;
BA_ "GenSigSendType" SG_ 1431 RSDS_R_ObjID_15 9;
BA_ "GenSigSendType" SG_ 1431 RSDS_R_SGU8_Checksum1 9;
BA_ "IsCrcSignal" SG_ 1431 RSDS_R_SGU8_Checksum1 1;
BA_ "GenSigSendType" SG_ 1432 RSDS_R_SGU9_RollingCounter8 9;
BA_ "IsRcSignal" SG_ 1432 RSDS_R_SGU9_RollingCounter8 1;
BA_ "GenSigSendType" SG_ 1432 RSDS_R_SGU9_BlockCounter 9;
BA_ "GenSigSendType" SG_ 1432 RSDS_R_HWATargetValidity_18 9;
BA_ "GenSigSendType" SG_ 1432 RSDS_R_ObjRefPoint_18 9;
BA_ "GenSigStartValue" SG_ 1432 RSDS_R_ObjRCS_18 400;
BA_ "GenSigSendType" SG_ 1432 RSDS_R_ObjRCS_18 9;
BA_ "GenSigSendType" SG_ 1432 RSDS_R_ObjYawrate_18 9;
BA_ "GenSigSendType" SG_ 1432 RSDS_R_ObjHeading_18 9;
BA_ "GenSigSendType" SG_ 1432 RSDS_R_ObjLength_18 9;
BA_ "GenSigSendType" SG_ 1432 RSDS_R_SGU9_Checksum8 9;
BA_ "IsCrcSignal" SG_ 1432 RSDS_R_SGU9_Checksum8 1;
BA_ "GenSigSendType" SG_ 1432 RSDS_R_SGU9_RollingCounter7 9;
BA_ "IsRcSignal" SG_ 1432 RSDS_R_SGU9_RollingCounter7 1;
BA_ "GenSigSendType" SG_ 1432 RSDS_R_ObjMotionDirection_18 9;
BA_ "GenSigSendType" SG_ 1432 RSDS_R_ObjAge_18 9;
BA_ "GenSigSendType" SG_ 1432 RSDS_R_ObjWidth_18 9;
BA_ "GenSigSendType" SG_ 1432 RSDS_R_ObjRAccelYStd_18 9;
BA_ "GenSigSendType" SG_ 1432 RSDS_R_ObjRAccelXStd_18 9;
BA_ "GenSigSendType" SG_ 1432 RSDS_R_ObjRelVelYStd_18 9;
BA_ "GenSigSendType" SG_ 1432 RSDS_R_ObjRelVelXStd_18 9;
BA_ "GenSigSendType" SG_ 1432 RSDS_R_ObjDistYStd_18 9;
BA_ "GenSigSendType" SG_ 1432 RSDS_R_SGU9_Checksum7 9;
BA_ "IsCrcSignal" SG_ 1432 RSDS_R_SGU9_Checksum7 1;
BA_ "GenSigSendType" SG_ 1432 RSDS_R_SGU9_RollingCounter6 9;
BA_ "IsRcSignal" SG_ 1432 RSDS_R_SGU9_RollingCounter6 1;
BA_ "GenSigSendType" SG_ 1432 RSDS_R_ObjMotionType_18 9;
BA_ "GenSigStartValue" SG_ 1432 RSDS_R_ObjMeasured_18 1;
BA_ "GenSigSendType" SG_ 1432 RSDS_R_ObjMeasured_18 9;
BA_ "GenSigStartValue" SG_ 1432 RSDS_R_ObjRelAccelY_18 512;
BA_ "GenSigSendType" SG_ 1432 RSDS_R_ObjRelAccelY_18 9;
BA_ "GenSigStartValue" SG_ 1432 RSDS_R_ObjRelAccelX_18 512;
BA_ "GenSigSendType" SG_ 1432 RSDS_R_ObjRelAccelX_18 9;
BA_ "GenSigStartValue" SG_ 1432 RSDS_R_ObjRelVelY_18 4102;
BA_ "GenSigSendType" SG_ 1432 RSDS_R_ObjRelVelY_18 9;
BA_ "GenSigStartValue" SG_ 1432 RSDS_R_ObjRelVelX_18 4102;
BA_ "GenSigSendType" SG_ 1432 RSDS_R_ObjRelVelX_18 9;
BA_ "GenSigSendType" SG_ 1432 RSDS_R_SGU9_Checksum6 9;
BA_ "IsCrcSignal" SG_ 1432 RSDS_R_SGU9_Checksum6 1;
BA_ "GenSigSendType" SG_ 1432 RSDS_R_SGU9_RollingCounter5 9;
BA_ "IsRcSignal" SG_ 1432 RSDS_R_SGU9_RollingCounter5 1;
BA_ "GenSigSendType" SG_ 1432 RSDS_R_ObjType_18 9;
BA_ "GenSigSendType" SG_ 1432 RSDS_R_ObjDistXStd_18 9;
BA_ "GenSigStartValue" SG_ 1432 RSDS_R_ObjDistY_18 1024;
BA_ "GenSigSendType" SG_ 1432 RSDS_R_ObjDistY_18 9;
BA_ "GenSigSendType" SG_ 1432 RSDS_R_ObjDistX_18 9;
BA_ "GenSigSendType" SG_ 1432 RSDS_R_ObjObstacleProb_18 9;
BA_ "GenSigSendType" SG_ 1432 RSDS_R_ObjExistProb_18 9;
BA_ "GenSigSendType" SG_ 1432 RSDS_R_ObjID_18 9;
BA_ "GenSigSendType" SG_ 1432 RSDS_R_SGU9_Checksum5 9;
BA_ "IsCrcSignal" SG_ 1432 RSDS_R_SGU9_Checksum5 1;
BA_ "GenSigSendType" SG_ 1432 RSDS_R_SGU9_RollingCounter4 9;
BA_ "IsRcSignal" SG_ 1432 RSDS_R_SGU9_RollingCounter4 1;
BA_ "GenSigSendType" SG_ 1432 RSDS_R_HWATargetValidity_17 9;
BA_ "GenSigSendType" SG_ 1432 RSDS_R_ObjRefPoint_17 9;
BA_ "GenSigStartValue" SG_ 1432 RSDS_R_ObjRCS_17 400;
BA_ "GenSigSendType" SG_ 1432 RSDS_R_ObjRCS_17 9;
BA_ "GenSigSendType" SG_ 1432 RSDS_R_ObjYawrate_17 9;
BA_ "GenSigSendType" SG_ 1432 RSDS_R_ObjHeading_17 9;
BA_ "GenSigSendType" SG_ 1432 RSDS_R_ObjLength_17 9;
BA_ "GenSigSendType" SG_ 1432 RSDS_R_SGU9_Checksum4 9;
BA_ "IsCrcSignal" SG_ 1432 RSDS_R_SGU9_Checksum4 1;
BA_ "GenSigSendType" SG_ 1432 RSDS_R_SGU9_RollingCounter3 9;
BA_ "IsRcSignal" SG_ 1432 RSDS_R_SGU9_RollingCounter3 1;
BA_ "GenSigSendType" SG_ 1432 RSDS_R_ObjMotionDirection_17 9;
BA_ "GenSigSendType" SG_ 1432 RSDS_R_ObjAge_17 9;
BA_ "GenSigSendType" SG_ 1432 RSDS_R_ObjWidth_17 9;
BA_ "GenSigSendType" SG_ 1432 RSDS_R_ObjRAccelYStd_17 9;
BA_ "GenSigSendType" SG_ 1432 RSDS_R_ObjRAccelXStd_17 9;
BA_ "GenSigSendType" SG_ 1432 RSDS_R_ObjRelVelYStd_17 9;
BA_ "GenSigSendType" SG_ 1432 RSDS_R_ObjRelVelXStd_17 9;
BA_ "GenSigSendType" SG_ 1432 RSDS_R_ObjDistYStd_17 9;
BA_ "GenSigSendType" SG_ 1432 RSDS_R_SGU9_Checksum3 9;
BA_ "IsCrcSignal" SG_ 1432 RSDS_R_SGU9_Checksum3 1;
BA_ "GenSigSendType" SG_ 1432 RSDS_R_SGU9_RollingCounter2 9;
BA_ "IsRcSignal" SG_ 1432 RSDS_R_SGU9_RollingCounter2 1;
BA_ "GenSigSendType" SG_ 1432 RSDS_R_ObjMotionType_17 9;
BA_ "GenSigStartValue" SG_ 1432 RSDS_R_ObjMeasured_17 1;
BA_ "GenSigSendType" SG_ 1432 RSDS_R_ObjMeasured_17 9;
BA_ "GenSigStartValue" SG_ 1432 RSDS_R_ObjRelAccelY_17 512;
BA_ "GenSigSendType" SG_ 1432 RSDS_R_ObjRelAccelY_17 9;
BA_ "GenSigStartValue" SG_ 1432 RSDS_R_ObjRelAccelX_17 512;
BA_ "GenSigSendType" SG_ 1432 RSDS_R_ObjRelAccelX_17 9;
BA_ "GenSigStartValue" SG_ 1432 RSDS_R_ObjRelVelY_17 4102;
BA_ "GenSigSendType" SG_ 1432 RSDS_R_ObjRelVelY_17 9;
BA_ "GenSigStartValue" SG_ 1432 RSDS_R_ObjRelVelX_17 4102;
BA_ "GenSigSendType" SG_ 1432 RSDS_R_ObjRelVelX_17 9;
BA_ "GenSigSendType" SG_ 1432 RSDS_R_SGU9_Checksum2 9;
BA_ "IsCrcSignal" SG_ 1432 RSDS_R_SGU9_Checksum2 1;
BA_ "GenSigSendType" SG_ 1432 RSDS_R_SGU9_RollingCounter1 9;
BA_ "IsRcSignal" SG_ 1432 RSDS_R_SGU9_RollingCounter1 1;
BA_ "GenSigSendType" SG_ 1432 RSDS_R_ObjType_17 9;
BA_ "GenSigSendType" SG_ 1432 RSDS_R_ObjDistXStd_17 9;
BA_ "GenSigStartValue" SG_ 1432 RSDS_R_ObjDistY_17 1024;
BA_ "GenSigSendType" SG_ 1432 RSDS_R_ObjDistY_17 9;
BA_ "GenSigSendType" SG_ 1432 RSDS_R_ObjDistX_17 9;
BA_ "GenSigSendType" SG_ 1432 RSDS_R_ObjObstacleProb_17 9;
BA_ "GenSigSendType" SG_ 1432 RSDS_R_ObjExistProb_17 9;
BA_ "GenSigSendType" SG_ 1432 RSDS_R_ObjID_17 9;
BA_ "GenSigSendType" SG_ 1432 RSDS_R_SGU9_Checksum1 9;
BA_ "IsCrcSignal" SG_ 1432 RSDS_R_SGU9_Checksum1 1;
BA_ "GenSigSendType" SG_ 1433 RSDS_R_SGU10_RollingCounter8 9;
BA_ "IsRcSignal" SG_ 1433 RSDS_R_SGU10_RollingCounter8 1;
BA_ "GenSigSendType" SG_ 1433 RSDS_R_SGU10_BlockCounter 9;
BA_ "GenSigSendType" SG_ 1433 RSDS_R_HWATargetValidity_20 9;
BA_ "GenSigSendType" SG_ 1433 RSDS_R_ObjRefPoint_20 9;
BA_ "GenSigStartValue" SG_ 1433 RSDS_R_ObjRCS_20 400;
BA_ "GenSigSendType" SG_ 1433 RSDS_R_ObjRCS_20 9;
BA_ "GenSigSendType" SG_ 1433 RSDS_R_ObjYawrate_20 9;
BA_ "GenSigSendType" SG_ 1433 RSDS_R_ObjHeading_20 9;
BA_ "GenSigSendType" SG_ 1433 RSDS_R_ObjLength_20 9;
BA_ "GenSigSendType" SG_ 1433 RSDS_R_SGU10_Checksum8 9;
BA_ "IsCrcSignal" SG_ 1433 RSDS_R_SGU10_Checksum8 1;
BA_ "GenSigSendType" SG_ 1433 RSDS_R_SGU10_RollingCounter7 9;
BA_ "IsRcSignal" SG_ 1433 RSDS_R_SGU10_RollingCounter7 1;
BA_ "GenSigSendType" SG_ 1433 RSDS_R_ObjMotionDirection_20 9;
BA_ "GenSigSendType" SG_ 1433 RSDS_R_ObjAge_20 9;
BA_ "GenSigSendType" SG_ 1433 RSDS_R_ObjWidth_20 9;
BA_ "GenSigSendType" SG_ 1433 RSDS_R_ObjRAccelYStd_20 9;
BA_ "GenSigSendType" SG_ 1433 RSDS_R_ObjRAccelXStd_20 9;
BA_ "GenSigSendType" SG_ 1433 RSDS_R_ObjRelVelYStd_20 9;
BA_ "GenSigSendType" SG_ 1433 RSDS_R_ObjRelVelXStd_20 9;
BA_ "GenSigSendType" SG_ 1433 RSDS_R_ObjDistYStd_20 9;
BA_ "GenSigSendType" SG_ 1433 RSDS_R_SGU10_Checksum7 9;
BA_ "IsCrcSignal" SG_ 1433 RSDS_R_SGU10_Checksum7 1;
BA_ "GenSigSendType" SG_ 1433 RSDS_R_SGU10_RollingCounter6 9;
BA_ "IsRcSignal" SG_ 1433 RSDS_R_SGU10_RollingCounter6 1;
BA_ "GenSigSendType" SG_ 1433 RSDS_R_ObjMotionType_20 9;
BA_ "GenSigStartValue" SG_ 1433 RSDS_R_ObjMeasured_20 1;
BA_ "GenSigSendType" SG_ 1433 RSDS_R_ObjMeasured_20 9;
BA_ "GenSigStartValue" SG_ 1433 RSDS_R_ObjRelAccelY_20 512;
BA_ "GenSigSendType" SG_ 1433 RSDS_R_ObjRelAccelY_20 9;
BA_ "GenSigStartValue" SG_ 1433 RSDS_R_ObjRelAccelX_20 512;
BA_ "GenSigSendType" SG_ 1433 RSDS_R_ObjRelAccelX_20 9;
BA_ "GenSigStartValue" SG_ 1433 RSDS_R_ObjRelVelY_20 4102;
BA_ "GenSigSendType" SG_ 1433 RSDS_R_ObjRelVelY_20 9;
BA_ "GenSigStartValue" SG_ 1433 RSDS_R_ObjRelVelX_20 4102;
BA_ "GenSigSendType" SG_ 1433 RSDS_R_ObjRelVelX_20 9;
BA_ "GenSigSendType" SG_ 1433 RSDS_R_SGU10_Checksum6 9;
BA_ "IsCrcSignal" SG_ 1433 RSDS_R_SGU10_Checksum6 1;
BA_ "GenSigSendType" SG_ 1433 RSDS_R_SGU10_RollingCounter5 9;
BA_ "IsRcSignal" SG_ 1433 RSDS_R_SGU10_RollingCounter5 1;
BA_ "GenSigSendType" SG_ 1433 RSDS_R_ObjType_20 9;
BA_ "GenSigSendType" SG_ 1433 RSDS_R_ObjDistXStd_20 9;
BA_ "GenSigStartValue" SG_ 1433 RSDS_R_ObjDistY_20 1024;
BA_ "GenSigSendType" SG_ 1433 RSDS_R_ObjDistY_20 9;
BA_ "GenSigSendType" SG_ 1433 RSDS_R_ObjDistX_20 9;
BA_ "GenSigSendType" SG_ 1433 RSDS_R_ObjObstacleProb_20 9;
BA_ "GenSigSendType" SG_ 1433 RSDS_R_ObjExistProb_20 9;
BA_ "GenSigSendType" SG_ 1433 RSDS_R_ObjID_20 9;
BA_ "GenSigSendType" SG_ 1433 RSDS_R_SGU10_Checksum5 9;
BA_ "IsCrcSignal" SG_ 1433 RSDS_R_SGU10_Checksum5 1;
BA_ "GenSigSendType" SG_ 1433 RSDS_R_SGU10_RollingCounter4 9;
BA_ "IsRcSignal" SG_ 1433 RSDS_R_SGU10_RollingCounter4 1;
BA_ "GenSigSendType" SG_ 1433 RSDS_R_HWATargetValidity_19 9;
BA_ "GenSigSendType" SG_ 1433 RSDS_R_ObjRefPoint_19 9;
BA_ "GenSigStartValue" SG_ 1433 RSDS_R_ObjRCS_19 400;
BA_ "GenSigSendType" SG_ 1433 RSDS_R_ObjRCS_19 9;
BA_ "GenSigSendType" SG_ 1433 RSDS_R_ObjYawrate_19 9;
BA_ "GenSigSendType" SG_ 1433 RSDS_R_ObjHeading_19 9;
BA_ "GenSigSendType" SG_ 1433 RSDS_R_ObjLength_19 9;
BA_ "GenSigSendType" SG_ 1433 RSDS_R_SGU10_Checksum4 9;
BA_ "IsCrcSignal" SG_ 1433 RSDS_R_SGU10_Checksum4 1;
BA_ "GenSigSendType" SG_ 1433 RSDS_R_SGU10_RollingCounter3 9;
BA_ "IsRcSignal" SG_ 1433 RSDS_R_SGU10_RollingCounter3 1;
BA_ "GenSigSendType" SG_ 1433 RSDS_R_ObjMotionDirection_19 9;
BA_ "GenSigSendType" SG_ 1433 RSDS_R_ObjAge_19 9;
BA_ "GenSigSendType" SG_ 1433 RSDS_R_ObjWidth_19 9;
BA_ "GenSigSendType" SG_ 1433 RSDS_R_ObjRAccelYStd_19 9;
BA_ "GenSigSendType" SG_ 1433 RSDS_R_ObjRAccelXStd_19 9;
BA_ "GenSigSendType" SG_ 1433 RSDS_R_ObjRelVelYStd_19 9;
BA_ "GenSigSendType" SG_ 1433 RSDS_R_ObjRelVelXStd_19 9;
BA_ "GenSigSendType" SG_ 1433 RSDS_R_ObjDistYStd_19 9;
BA_ "GenSigSendType" SG_ 1433 RSDS_R_SGU10_Checksum3 9;
BA_ "IsCrcSignal" SG_ 1433 RSDS_R_SGU10_Checksum3 1;
BA_ "GenSigSendType" SG_ 1433 RSDS_R_SGU10_RollingCounter2 9;
BA_ "IsRcSignal" SG_ 1433 RSDS_R_SGU10_RollingCounter2 1;
BA_ "GenSigSendType" SG_ 1433 RSDS_R_ObjMotionType_19 9;
BA_ "GenSigStartValue" SG_ 1433 RSDS_R_ObjMeasured_19 1;
BA_ "GenSigSendType" SG_ 1433 RSDS_R_ObjMeasured_19 9;
BA_ "GenSigStartValue" SG_ 1433 RSDS_R_ObjRelAccelY_19 512;
BA_ "GenSigSendType" SG_ 1433 RSDS_R_ObjRelAccelY_19 9;
BA_ "GenSigStartValue" SG_ 1433 RSDS_R_ObjRelAccelX_19 512;
BA_ "GenSigSendType" SG_ 1433 RSDS_R_ObjRelAccelX_19 9;
BA_ "GenSigStartValue" SG_ 1433 RSDS_R_ObjRelVelY_19 4102;
BA_ "GenSigSendType" SG_ 1433 RSDS_R_ObjRelVelY_19 9;
BA_ "GenSigStartValue" SG_ 1433 RSDS_R_ObjRelVelX_19 4102;
BA_ "GenSigSendType" SG_ 1433 RSDS_R_ObjRelVelX_19 9;
BA_ "GenSigSendType" SG_ 1433 RSDS_R_SGU10_Checksum2 9;
BA_ "IsCrcSignal" SG_ 1433 RSDS_R_SGU10_Checksum2 1;
BA_ "GenSigSendType" SG_ 1433 RSDS_R_SGU10_RollingCounter1 9;
BA_ "IsRcSignal" SG_ 1433 RSDS_R_SGU10_RollingCounter1 1;
BA_ "GenSigSendType" SG_ 1433 RSDS_R_ObjType_19 9;
BA_ "GenSigSendType" SG_ 1433 RSDS_R_ObjDistXStd_19 9;
BA_ "GenSigStartValue" SG_ 1433 RSDS_R_ObjDistY_19 1024;
BA_ "GenSigSendType" SG_ 1433 RSDS_R_ObjDistY_19 9;
BA_ "GenSigSendType" SG_ 1433 RSDS_R_ObjDistX_19 9;
BA_ "GenSigSendType" SG_ 1433 RSDS_R_ObjObstacleProb_19 9;
BA_ "GenSigSendType" SG_ 1433 RSDS_R_ObjExistProb_19 9;
BA_ "GenSigSendType" SG_ 1433 RSDS_R_ObjID_19 9;
BA_ "GenSigSendType" SG_ 1433 RSDS_R_SGU10_Checksum1 9;
BA_ "IsCrcSignal" SG_ 1433 RSDS_R_SGU10_Checksum1 1;
BA_ "GenSigSendType" SG_ 1434 RSDS_R_SGU11_RollingCounter8 9;
BA_ "IsRcSignal" SG_ 1434 RSDS_R_SGU11_RollingCounter8 1;
BA_ "GenSigSendType" SG_ 1434 RSDS_R_SGU11_BlockCounter 9;
BA_ "GenSigSendType" SG_ 1434 RSDS_R_HWATargetValidity_22 9;
BA_ "GenSigSendType" SG_ 1434 RSDS_R_ObjRefPoint_22 9;
BA_ "GenSigStartValue" SG_ 1434 RSDS_R_ObjRCS_22 400;
BA_ "GenSigSendType" SG_ 1434 RSDS_R_ObjRCS_22 9;
BA_ "GenSigSendType" SG_ 1434 RSDS_R_ObjYawrate_22 9;
BA_ "GenSigSendType" SG_ 1434 RSDS_R_ObjHeading_22 9;
BA_ "GenSigSendType" SG_ 1434 RSDS_R_ObjLength_22 9;
BA_ "GenSigSendType" SG_ 1434 RSDS_R_SGU11_Checksum8 9;
BA_ "IsCrcSignal" SG_ 1434 RSDS_R_SGU11_Checksum8 1;
BA_ "GenSigSendType" SG_ 1434 RSDS_R_SGU11_RollingCounter7 9;
BA_ "IsRcSignal" SG_ 1434 RSDS_R_SGU11_RollingCounter7 1;
BA_ "GenSigSendType" SG_ 1434 RSDS_R_ObjMotionDirection_22 9;
BA_ "GenSigSendType" SG_ 1434 RSDS_R_ObjAge_22 9;
BA_ "GenSigSendType" SG_ 1434 RSDS_R_ObjWidth_22 9;
BA_ "GenSigSendType" SG_ 1434 RSDS_R_ObjRAccelYStd_22 9;
BA_ "GenSigSendType" SG_ 1434 RSDS_R_ObjRAccelXStd_22 9;
BA_ "GenSigSendType" SG_ 1434 RSDS_R_ObjRelVelYStd_22 9;
BA_ "GenSigSendType" SG_ 1434 RSDS_R_ObjRelVelXStd_22 9;
BA_ "GenSigSendType" SG_ 1434 RSDS_R_ObjDistYStd_22 9;
BA_ "GenSigSendType" SG_ 1434 RSDS_R_SGU11_Checksum7 9;
BA_ "IsCrcSignal" SG_ 1434 RSDS_R_SGU11_Checksum7 1;
BA_ "GenSigSendType" SG_ 1434 RSDS_R_SGU11_RollingCounter6 9;
BA_ "IsRcSignal" SG_ 1434 RSDS_R_SGU11_RollingCounter6 1;
BA_ "GenSigSendType" SG_ 1434 RSDS_R_ObjMotionType_22 9;
BA_ "GenSigStartValue" SG_ 1434 RSDS_R_ObjMeasured_22 1;
BA_ "GenSigSendType" SG_ 1434 RSDS_R_ObjMeasured_22 9;
BA_ "GenSigStartValue" SG_ 1434 RSDS_R_ObjRelAccelY_22 512;
BA_ "GenSigSendType" SG_ 1434 RSDS_R_ObjRelAccelY_22 9;
BA_ "GenSigStartValue" SG_ 1434 RSDS_R_ObjRelAccelX_22 512;
BA_ "GenSigSendType" SG_ 1434 RSDS_R_ObjRelAccelX_22 9;
BA_ "GenSigStartValue" SG_ 1434 RSDS_R_ObjRelVelY_22 4102;
BA_ "GenSigSendType" SG_ 1434 RSDS_R_ObjRelVelY_22 9;
BA_ "GenSigStartValue" SG_ 1434 RSDS_R_ObjRelVelX_22 4102;
BA_ "GenSigSendType" SG_ 1434 RSDS_R_ObjRelVelX_22 9;
BA_ "GenSigSendType" SG_ 1434 RSDS_R_SGU11_Checksum6 9;
BA_ "IsCrcSignal" SG_ 1434 RSDS_R_SGU11_Checksum6 1;
BA_ "GenSigSendType" SG_ 1434 RSDS_R_SGU11_RollingCounter5 9;
BA_ "IsRcSignal" SG_ 1434 RSDS_R_SGU11_RollingCounter5 1;
BA_ "GenSigSendType" SG_ 1434 RSDS_R_ObjType_22 9;
BA_ "GenSigSendType" SG_ 1434 RSDS_R_ObjDistXStd_22 9;
BA_ "GenSigStartValue" SG_ 1434 RSDS_R_ObjDistY_22 1024;
BA_ "GenSigSendType" SG_ 1434 RSDS_R_ObjDistY_22 9;
BA_ "GenSigSendType" SG_ 1434 RSDS_R_ObjDistX_22 9;
BA_ "GenSigSendType" SG_ 1434 RSDS_R_ObjObstacleProb_22 9;
BA_ "GenSigSendType" SG_ 1434 RSDS_R_ObjExistProb_22 9;
BA_ "GenSigSendType" SG_ 1434 RSDS_R_ObjID_22 9;
BA_ "GenSigSendType" SG_ 1434 RSDS_R_SGU11_Checksum5 9;
BA_ "IsCrcSignal" SG_ 1434 RSDS_R_SGU11_Checksum5 1;
BA_ "GenSigSendType" SG_ 1434 RSDS_R_SGU11_RollingCounter4 9;
BA_ "IsRcSignal" SG_ 1434 RSDS_R_SGU11_RollingCounter4 1;
BA_ "GenSigSendType" SG_ 1434 RSDS_R_HWATargetValidity_21 9;
BA_ "GenSigSendType" SG_ 1434 RSDS_R_ObjRefPoint_21 9;
BA_ "GenSigStartValue" SG_ 1434 RSDS_R_ObjRCS_21 400;
BA_ "GenSigSendType" SG_ 1434 RSDS_R_ObjRCS_21 9;
BA_ "GenSigSendType" SG_ 1434 RSDS_R_ObjYawrate_21 9;
BA_ "GenSigSendType" SG_ 1434 RSDS_R_ObjHeading_21 9;
BA_ "GenSigSendType" SG_ 1434 RSDS_R_ObjLength_21 9;
BA_ "GenSigSendType" SG_ 1434 RSDS_R_SGU11_Checksum4 9;
BA_ "IsCrcSignal" SG_ 1434 RSDS_R_SGU11_Checksum4 1;
BA_ "GenSigSendType" SG_ 1434 RSDS_R_SGU11_RollingCounter3 9;
BA_ "IsRcSignal" SG_ 1434 RSDS_R_SGU11_RollingCounter3 1;
BA_ "GenSigSendType" SG_ 1434 RSDS_R_ObjMotionDirection_21 9;
BA_ "GenSigSendType" SG_ 1434 RSDS_R_ObjAge_21 9;
BA_ "GenSigSendType" SG_ 1434 RSDS_R_ObjWidth_21 9;
BA_ "GenSigSendType" SG_ 1434 RSDS_R_ObjRAccelYStd_21 9;
BA_ "GenSigSendType" SG_ 1434 RSDS_R_ObjRAccelXStd_21 9;
BA_ "GenSigSendType" SG_ 1434 RSDS_R_ObjRelVelYStd_21 9;
BA_ "GenSigSendType" SG_ 1434 RSDS_R_ObjRelVelXStd_21 9;
BA_ "GenSigSendType" SG_ 1434 RSDS_R_ObjDistYStd_21 9;
BA_ "GenSigSendType" SG_ 1434 RSDS_R_SGU11_Checksum3 9;
BA_ "IsCrcSignal" SG_ 1434 RSDS_R_SGU11_Checksum3 1;
BA_ "GenSigSendType" SG_ 1434 RSDS_R_SGU11_RollingCounter2 9;
BA_ "IsRcSignal" SG_ 1434 RSDS_R_SGU11_RollingCounter2 1;
BA_ "GenSigSendType" SG_ 1434 RSDS_R_ObjMotionType_21 9;
BA_ "GenSigStartValue" SG_ 1434 RSDS_R_ObjMeasured_21 1;
BA_ "GenSigSendType" SG_ 1434 RSDS_R_ObjMeasured_21 9;
BA_ "GenSigStartValue" SG_ 1434 RSDS_R_ObjRelAccelY_21 512;
BA_ "GenSigSendType" SG_ 1434 RSDS_R_ObjRelAccelY_21 9;
BA_ "GenSigStartValue" SG_ 1434 RSDS_R_ObjRelAccelX_21 512;
BA_ "GenSigSendType" SG_ 1434 RSDS_R_ObjRelAccelX_21 9;
BA_ "GenSigStartValue" SG_ 1434 RSDS_R_ObjRelVelY_21 4102;
BA_ "GenSigSendType" SG_ 1434 RSDS_R_ObjRelVelY_21 9;
BA_ "GenSigStartValue" SG_ 1434 RSDS_R_ObjRelVelX_21 4102;
BA_ "GenSigSendType" SG_ 1434 RSDS_R_ObjRelVelX_21 9;
BA_ "GenSigSendType" SG_ 1434 RSDS_R_SGU11_Checksum2 9;
BA_ "IsCrcSignal" SG_ 1434 RSDS_R_SGU11_Checksum2 1;
BA_ "GenSigSendType" SG_ 1434 RSDS_R_SGU11_RollingCounter1 9;
BA_ "IsRcSignal" SG_ 1434 RSDS_R_SGU11_RollingCounter1 1;
BA_ "GenSigSendType" SG_ 1434 RSDS_R_ObjType_21 9;
BA_ "GenSigSendType" SG_ 1434 RSDS_R_ObjDistXStd_21 9;
BA_ "GenSigStartValue" SG_ 1434 RSDS_R_ObjDistY_21 1024;
BA_ "GenSigSendType" SG_ 1434 RSDS_R_ObjDistY_21 9;
BA_ "GenSigSendType" SG_ 1434 RSDS_R_ObjDistX_21 9;
BA_ "GenSigSendType" SG_ 1434 RSDS_R_ObjObstacleProb_21 9;
BA_ "GenSigSendType" SG_ 1434 RSDS_R_ObjExistProb_21 9;
BA_ "GenSigSendType" SG_ 1434 RSDS_R_ObjID_21 9;
BA_ "GenSigSendType" SG_ 1434 RSDS_R_SGU11_Checksum1 9;
BA_ "IsCrcSignal" SG_ 1434 RSDS_R_SGU11_Checksum1 1;
BA_ "GenSigSendType" SG_ 1435 RSDS_R_SGU12_RollingCounter8 9;
BA_ "IsRcSignal" SG_ 1435 RSDS_R_SGU12_RollingCounter8 1;
BA_ "GenSigSendType" SG_ 1435 RSDS_R_SGU12_BlockCounter 9;
BA_ "GenSigSendType" SG_ 1435 RSDS_R_HWATargetValidity_24 9;
BA_ "GenSigSendType" SG_ 1435 RSDS_R_ObjRefPoint_24 9;
BA_ "GenSigStartValue" SG_ 1435 RSDS_R_ObjRCS_24 400;
BA_ "GenSigSendType" SG_ 1435 RSDS_R_ObjRCS_24 9;
BA_ "GenSigSendType" SG_ 1435 RSDS_R_ObjYawrate_24 9;
BA_ "GenSigSendType" SG_ 1435 RSDS_R_ObjHeading_24 9;
BA_ "GenSigSendType" SG_ 1435 RSDS_R_ObjLength_24 9;
BA_ "GenSigSendType" SG_ 1435 RSDS_R_SGU12_Checksum8 9;
BA_ "IsCrcSignal" SG_ 1435 RSDS_R_SGU12_Checksum8 1;
BA_ "GenSigSendType" SG_ 1435 RSDS_R_SGU12_RollingCounter7 9;
BA_ "IsRcSignal" SG_ 1435 RSDS_R_SGU12_RollingCounter7 1;
BA_ "GenSigSendType" SG_ 1435 RSDS_R_ObjMotionDirection_24 9;
BA_ "GenSigSendType" SG_ 1435 RSDS_R_ObjAge_24 9;
BA_ "GenSigSendType" SG_ 1435 RSDS_R_ObjWidth_24 9;
BA_ "GenSigSendType" SG_ 1435 RSDS_R_ObjRAccelYStd_24 9;
BA_ "GenSigSendType" SG_ 1435 RSDS_R_ObjRAccelXStd_24 9;
BA_ "GenSigSendType" SG_ 1435 RSDS_R_ObjRelVelYStd_24 9;
BA_ "GenSigSendType" SG_ 1435 RSDS_R_ObjRelVelXStd_24 9;
BA_ "GenSigSendType" SG_ 1435 RSDS_R_ObjDistYStd_24 9;
BA_ "GenSigSendType" SG_ 1435 RSDS_R_SGU12_Checksum7 9;
BA_ "IsCrcSignal" SG_ 1435 RSDS_R_SGU12_Checksum7 1;
BA_ "GenSigSendType" SG_ 1435 RSDS_R_SGU12_RollingCounter6 9;
BA_ "IsRcSignal" SG_ 1435 RSDS_R_SGU12_RollingCounter6 1;
BA_ "GenSigSendType" SG_ 1435 RSDS_R_ObjMotionType_24 9;
BA_ "GenSigStartValue" SG_ 1435 RSDS_R_ObjMeasured_24 1;
BA_ "GenSigSendType" SG_ 1435 RSDS_R_ObjMeasured_24 9;
BA_ "GenSigStartValue" SG_ 1435 RSDS_R_ObjRelAccelY_24 512;
BA_ "GenSigSendType" SG_ 1435 RSDS_R_ObjRelAccelY_24 9;
BA_ "GenSigStartValue" SG_ 1435 RSDS_R_ObjRelAccelX_24 512;
BA_ "GenSigSendType" SG_ 1435 RSDS_R_ObjRelAccelX_24 9;
BA_ "GenSigStartValue" SG_ 1435 RSDS_R_ObjRelVelY_24 4102;
BA_ "GenSigSendType" SG_ 1435 RSDS_R_ObjRelVelY_24 9;
BA_ "GenSigStartValue" SG_ 1435 RSDS_R_ObjRelVelX_24 4102;
BA_ "GenSigSendType" SG_ 1435 RSDS_R_ObjRelVelX_24 9;
BA_ "GenSigSendType" SG_ 1435 RSDS_R_SGU12_Checksum6 9;
BA_ "IsCrcSignal" SG_ 1435 RSDS_R_SGU12_Checksum6 1;
BA_ "GenSigSendType" SG_ 1435 RSDS_R_SGU12_RollingCounter5 9;
BA_ "IsRcSignal" SG_ 1435 RSDS_R_SGU12_RollingCounter5 1;
BA_ "GenSigSendType" SG_ 1435 RSDS_R_ObjType_24 9;
BA_ "GenSigSendType" SG_ 1435 RSDS_R_ObjDistXStd_24 9;
BA_ "GenSigStartValue" SG_ 1435 RSDS_R_ObjDistY_24 1024;
BA_ "GenSigSendType" SG_ 1435 RSDS_R_ObjDistY_24 9;
BA_ "GenSigSendType" SG_ 1435 RSDS_R_ObjDistX_24 9;
BA_ "GenSigSendType" SG_ 1435 RSDS_R_ObjObstacleProb_24 9;
BA_ "GenSigSendType" SG_ 1435 RSDS_R_ObjExistProb_24 9;
BA_ "GenSigSendType" SG_ 1435 RSDS_R_ObjID_24 9;
BA_ "GenSigSendType" SG_ 1435 RSDS_R_SGU12_Checksum5 9;
BA_ "IsCrcSignal" SG_ 1435 RSDS_R_SGU12_Checksum5 1;
BA_ "GenSigSendType" SG_ 1435 RSDS_R_SGU12_RollingCounter4 9;
BA_ "IsRcSignal" SG_ 1435 RSDS_R_SGU12_RollingCounter4 1;
BA_ "GenSigSendType" SG_ 1435 RSDS_R_HWATargetValidity_23 9;
BA_ "GenSigSendType" SG_ 1435 RSDS_R_ObjRefPoint_23 9;
BA_ "GenSigStartValue" SG_ 1435 RSDS_R_ObjRCS_23 400;
BA_ "GenSigSendType" SG_ 1435 RSDS_R_ObjRCS_23 9;
BA_ "GenSigSendType" SG_ 1435 RSDS_R_ObjYawrate_23 9;
BA_ "GenSigSendType" SG_ 1435 RSDS_R_ObjHeading_23 9;
BA_ "GenSigSendType" SG_ 1435 RSDS_R_ObjLength_23 9;
BA_ "GenSigSendType" SG_ 1435 RSDS_R_SGU12_Checksum4 9;
BA_ "IsCrcSignal" SG_ 1435 RSDS_R_SGU12_Checksum4 1;
BA_ "GenSigSendType" SG_ 1435 RSDS_R_SGU12_RollingCounter3 9;
BA_ "IsRcSignal" SG_ 1435 RSDS_R_SGU12_RollingCounter3 1;
BA_ "GenSigSendType" SG_ 1435 RSDS_R_ObjMotionDirection_23 9;
BA_ "GenSigSendType" SG_ 1435 RSDS_R_ObjAge_23 9;
BA_ "GenSigSendType" SG_ 1435 RSDS_R_ObjWidth_23 9;
BA_ "GenSigSendType" SG_ 1435 RSDS_R_ObjRAccelYStd_23 9;
BA_ "GenSigSendType" SG_ 1435 RSDS_R_ObjRAccelXStd_23 9;
BA_ "GenSigSendType" SG_ 1435 RSDS_R_ObjRelVelYStd_23 9;
BA_ "GenSigSendType" SG_ 1435 RSDS_R_ObjRelVelXStd_23 9;
BA_ "GenSigSendType" SG_ 1435 RSDS_R_ObjDistYStd_23 9;
BA_ "GenSigSendType" SG_ 1435 RSDS_R_SGU12_Checksum3 9;
BA_ "IsCrcSignal" SG_ 1435 RSDS_R_SGU12_Checksum3 1;
BA_ "GenSigSendType" SG_ 1435 RSDS_R_SGU12_RollingCounter2 9;
BA_ "IsRcSignal" SG_ 1435 RSDS_R_SGU12_RollingCounter2 1;
BA_ "GenSigSendType" SG_ 1435 RSDS_R_ObjMotionType_23 9;
BA_ "GenSigStartValue" SG_ 1435 RSDS_R_ObjMeasured_23 1;
BA_ "GenSigSendType" SG_ 1435 RSDS_R_ObjMeasured_23 9;
BA_ "GenSigStartValue" SG_ 1435 RSDS_R_ObjRelAccelY_23 512;
BA_ "GenSigSendType" SG_ 1435 RSDS_R_ObjRelAccelY_23 9;
BA_ "GenSigStartValue" SG_ 1435 RSDS_R_ObjRelAccelX_23 512;
BA_ "GenSigSendType" SG_ 1435 RSDS_R_ObjRelAccelX_23 9;
BA_ "GenSigStartValue" SG_ 1435 RSDS_R_ObjRelVelY_23 4102;
BA_ "GenSigSendType" SG_ 1435 RSDS_R_ObjRelVelY_23 9;
BA_ "GenSigStartValue" SG_ 1435 RSDS_R_ObjRelVelX_23 4102;
BA_ "GenSigSendType" SG_ 1435 RSDS_R_ObjRelVelX_23 9;
BA_ "GenSigSendType" SG_ 1435 RSDS_R_SGU12_Checksum2 9;
BA_ "IsCrcSignal" SG_ 1435 RSDS_R_SGU12_Checksum2 1;
BA_ "GenSigSendType" SG_ 1435 RSDS_R_SGU12_RollingCounter1 9;
BA_ "IsRcSignal" SG_ 1435 RSDS_R_SGU12_RollingCounter1 1;
BA_ "GenSigSendType" SG_ 1435 RSDS_R_ObjType_23 9;
BA_ "GenSigSendType" SG_ 1435 RSDS_R_ObjDistXStd_23 9;
BA_ "GenSigStartValue" SG_ 1435 RSDS_R_ObjDistY_23 1024;
BA_ "GenSigSendType" SG_ 1435 RSDS_R_ObjDistY_23 9;
BA_ "GenSigSendType" SG_ 1435 RSDS_R_ObjDistX_23 9;
BA_ "GenSigSendType" SG_ 1435 RSDS_R_ObjObstacleProb_23 9;
BA_ "GenSigSendType" SG_ 1435 RSDS_R_ObjExistProb_23 9;
BA_ "GenSigSendType" SG_ 1435 RSDS_R_ObjID_23 9;
BA_ "GenSigSendType" SG_ 1435 RSDS_R_SGU12_Checksum1 9;
BA_ "IsCrcSignal" SG_ 1435 RSDS_R_SGU12_Checksum1 1;
BA_ "GenSigSendType" SG_ 1436 RSDS_R_SGU13_RollingCounter8 9;
BA_ "IsRcSignal" SG_ 1436 RSDS_R_SGU13_RollingCounter8 1;
BA_ "GenSigSendType" SG_ 1436 RSDS_R_SGU13_BlockCounter 9;
BA_ "GenSigSendType" SG_ 1436 RSDS_R_HWATargetValidity_26 9;
BA_ "GenSigSendType" SG_ 1436 RSDS_R_ObjRefPoint_26 9;
BA_ "GenSigStartValue" SG_ 1436 RSDS_R_ObjRCS_26 400;
BA_ "GenSigSendType" SG_ 1436 RSDS_R_ObjRCS_26 9;
BA_ "GenSigSendType" SG_ 1436 RSDS_R_ObjYawrate_26 9;
BA_ "GenSigSendType" SG_ 1436 RSDS_R_ObjHeading_26 9;
BA_ "GenSigSendType" SG_ 1436 RSDS_R_ObjLength_26 9;
BA_ "GenSigSendType" SG_ 1436 RSDS_R_SGU13_Checksum8 9;
BA_ "IsCrcSignal" SG_ 1436 RSDS_R_SGU13_Checksum8 1;
BA_ "GenSigSendType" SG_ 1436 RSDS_R_SGU13_RollingCounter7 9;
BA_ "IsRcSignal" SG_ 1436 RSDS_R_SGU13_RollingCounter7 1;
BA_ "GenSigSendType" SG_ 1436 RSDS_R_ObjMotionDirection_26 9;
BA_ "GenSigSendType" SG_ 1436 RSDS_R_ObjAge_26 9;
BA_ "GenSigSendType" SG_ 1436 RSDS_R_ObjWidth_26 9;
BA_ "GenSigSendType" SG_ 1436 RSDS_R_ObjRAccelYStd_26 9;
BA_ "GenSigSendType" SG_ 1436 RSDS_R_ObjRAccelXStd_26 9;
BA_ "GenSigSendType" SG_ 1436 RSDS_R_ObjRelVelYStd_26 9;
BA_ "GenSigSendType" SG_ 1436 RSDS_R_ObjRelVelXStd_26 9;
BA_ "GenSigSendType" SG_ 1436 RSDS_R_ObjDistYStd_26 9;
BA_ "GenSigSendType" SG_ 1436 RSDS_R_SGU13_Checksum7 9;
BA_ "IsCrcSignal" SG_ 1436 RSDS_R_SGU13_Checksum7 1;
BA_ "GenSigSendType" SG_ 1436 RSDS_R_SGU13_RollingCounter6 9;
BA_ "IsRcSignal" SG_ 1436 RSDS_R_SGU13_RollingCounter6 1;
BA_ "GenSigSendType" SG_ 1436 RSDS_R_ObjMotionType_26 9;
BA_ "GenSigStartValue" SG_ 1436 RSDS_R_ObjMeasured_26 1;
BA_ "GenSigSendType" SG_ 1436 RSDS_R_ObjMeasured_26 9;
BA_ "GenSigStartValue" SG_ 1436 RSDS_R_ObjRelAccelY_26 512;
BA_ "GenSigSendType" SG_ 1436 RSDS_R_ObjRelAccelY_26 9;
BA_ "GenSigStartValue" SG_ 1436 RSDS_R_ObjRelAccelX_26 512;
BA_ "GenSigSendType" SG_ 1436 RSDS_R_ObjRelAccelX_26 9;
BA_ "GenSigStartValue" SG_ 1436 RSDS_R_ObjRelVelY_26 4102;
BA_ "GenSigSendType" SG_ 1436 RSDS_R_ObjRelVelY_26 9;
BA_ "GenSigStartValue" SG_ 1436 RSDS_R_ObjRelVelX_26 4102;
BA_ "GenSigSendType" SG_ 1436 RSDS_R_ObjRelVelX_26 9;
BA_ "GenSigSendType" SG_ 1436 RSDS_R_SGU13_Checksum6 9;
BA_ "IsCrcSignal" SG_ 1436 RSDS_R_SGU13_Checksum6 1;
BA_ "GenSigSendType" SG_ 1436 RSDS_R_SGU13_RollingCounter5 9;
BA_ "IsRcSignal" SG_ 1436 RSDS_R_SGU13_RollingCounter5 1;
BA_ "GenSigSendType" SG_ 1436 RSDS_R_ObjType_26 9;
BA_ "GenSigSendType" SG_ 1436 RSDS_R_ObjDistXStd_26 9;
BA_ "GenSigStartValue" SG_ 1436 RSDS_R_ObjDistY_26 1024;
BA_ "GenSigSendType" SG_ 1436 RSDS_R_ObjDistY_26 9;
BA_ "GenSigSendType" SG_ 1436 RSDS_R_ObjDistX_26 9;
BA_ "GenSigSendType" SG_ 1436 RSDS_R_ObjObstacleProb_26 9;
BA_ "GenSigSendType" SG_ 1436 RSDS_R_ObjExistProb_26 9;
BA_ "GenSigSendType" SG_ 1436 RSDS_R_ObjID_26 9;
BA_ "GenSigSendType" SG_ 1436 RSDS_R_SGU13_Checksum5 9;
BA_ "IsCrcSignal" SG_ 1436 RSDS_R_SGU13_Checksum5 1;
BA_ "GenSigSendType" SG_ 1436 RSDS_R_SGU13_RollingCounter4 9;
BA_ "IsRcSignal" SG_ 1436 RSDS_R_SGU13_RollingCounter4 1;
BA_ "GenSigSendType" SG_ 1436 RSDS_R_HWATargetValidity_25 9;
BA_ "GenSigSendType" SG_ 1436 RSDS_R_ObjRefPoint_25 9;
BA_ "GenSigStartValue" SG_ 1436 RSDS_R_ObjRCS_25 400;
BA_ "GenSigSendType" SG_ 1436 RSDS_R_ObjRCS_25 9;
BA_ "GenSigSendType" SG_ 1436 RSDS_R_ObjYawrate_25 9;
BA_ "GenSigSendType" SG_ 1436 RSDS_R_ObjHeading_25 9;
BA_ "GenSigSendType" SG_ 1436 RSDS_R_ObjLength_25 9;
BA_ "GenSigSendType" SG_ 1436 RSDS_R_SGU13_Checksum4 9;
BA_ "IsCrcSignal" SG_ 1436 RSDS_R_SGU13_Checksum4 1;
BA_ "GenSigSendType" SG_ 1436 RSDS_R_SGU13_RollingCounter3 9;
BA_ "IsRcSignal" SG_ 1436 RSDS_R_SGU13_RollingCounter3 1;
BA_ "GenSigSendType" SG_ 1436 RSDS_R_ObjMotionDirection_25 9;
BA_ "GenSigSendType" SG_ 1436 RSDS_R_ObjAge_25 9;
BA_ "GenSigSendType" SG_ 1436 RSDS_R_ObjWidth_25 9;
BA_ "GenSigSendType" SG_ 1436 RSDS_R_ObjRAccelYStd_25 9;
BA_ "GenSigSendType" SG_ 1436 RSDS_R_ObjRAccelXStd_25 9;
BA_ "GenSigSendType" SG_ 1436 RSDS_R_ObjRelVelYStd_25 9;
BA_ "GenSigSendType" SG_ 1436 RSDS_R_ObjRelVelXStd_25 9;
BA_ "GenSigSendType" SG_ 1436 RSDS_R_ObjDistYStd_25 9;
BA_ "GenSigSendType" SG_ 1436 RSDS_R_SGU13_Checksum3 9;
BA_ "IsCrcSignal" SG_ 1436 RSDS_R_SGU13_Checksum3 1;
BA_ "GenSigSendType" SG_ 1436 RSDS_R_SGU13_RollingCounter2 9;
BA_ "IsRcSignal" SG_ 1436 RSDS_R_SGU13_RollingCounter2 1;
BA_ "GenSigSendType" SG_ 1436 RSDS_R_ObjMotionType_25 9;
BA_ "GenSigStartValue" SG_ 1436 RSDS_R_ObjMeasured_25 1;
BA_ "GenSigSendType" SG_ 1436 RSDS_R_ObjMeasured_25 9;
BA_ "GenSigStartValue" SG_ 1436 RSDS_R_ObjRelAccelY_25 512;
BA_ "GenSigSendType" SG_ 1436 RSDS_R_ObjRelAccelY_25 9;
BA_ "GenSigStartValue" SG_ 1436 RSDS_R_ObjRelAccelX_25 512;
BA_ "GenSigSendType" SG_ 1436 RSDS_R_ObjRelAccelX_25 9;
BA_ "GenSigStartValue" SG_ 1436 RSDS_R_ObjRelVelY_25 4102;
BA_ "GenSigSendType" SG_ 1436 RSDS_R_ObjRelVelY_25 9;
BA_ "GenSigStartValue" SG_ 1436 RSDS_R_ObjRelVelX_25 4102;
BA_ "GenSigSendType" SG_ 1436 RSDS_R_ObjRelVelX_25 9;
BA_ "GenSigSendType" SG_ 1436 RSDS_R_SGU13_Checksum2 9;
BA_ "IsCrcSignal" SG_ 1436 RSDS_R_SGU13_Checksum2 1;
BA_ "GenSigSendType" SG_ 1436 RSDS_R_SGU13_RollingCounter1 9;
BA_ "IsRcSignal" SG_ 1436 RSDS_R_SGU13_RollingCounter1 1;
BA_ "GenSigSendType" SG_ 1436 RSDS_R_ObjType_25 9;
BA_ "GenSigSendType" SG_ 1436 RSDS_R_ObjDistXStd_25 9;
BA_ "GenSigStartValue" SG_ 1436 RSDS_R_ObjDistY_25 1024;
BA_ "GenSigSendType" SG_ 1436 RSDS_R_ObjDistY_25 9;
BA_ "GenSigSendType" SG_ 1436 RSDS_R_ObjDistX_25 9;
BA_ "GenSigSendType" SG_ 1436 RSDS_R_ObjObstacleProb_25 9;
BA_ "GenSigSendType" SG_ 1436 RSDS_R_ObjExistProb_25 9;
BA_ "GenSigSendType" SG_ 1436 RSDS_R_ObjID_25 9;
BA_ "GenSigSendType" SG_ 1436 RSDS_R_SGU13_Checksum1 9;
BA_ "IsCrcSignal" SG_ 1436 RSDS_R_SGU13_Checksum1 1;
BA_ "GenSigSendType" SG_ 1437 RSDS_R_SGU14_RollingCounter8 9;
BA_ "IsRcSignal" SG_ 1437 RSDS_R_SGU14_RollingCounter8 1;
BA_ "GenSigSendType" SG_ 1437 RSDS_R_SGU14_BlockCounter 9;
BA_ "GenSigSendType" SG_ 1437 RSDS_R_HWATargetValidity_28 9;
BA_ "GenSigSendType" SG_ 1437 RSDS_R_ObjRefPoint_28 9;
BA_ "GenSigStartValue" SG_ 1437 RSDS_R_ObjRCS_28 400;
BA_ "GenSigSendType" SG_ 1437 RSDS_R_ObjRCS_28 9;
BA_ "GenSigSendType" SG_ 1437 RSDS_R_ObjYawrate_28 9;
BA_ "GenSigSendType" SG_ 1437 RSDS_R_ObjHeading_28 9;
BA_ "GenSigSendType" SG_ 1437 RSDS_R_ObjLength_28 9;
BA_ "GenSigSendType" SG_ 1437 RSDS_R_SGU14_Checksum8 9;
BA_ "IsCrcSignal" SG_ 1437 RSDS_R_SGU14_Checksum8 1;
BA_ "GenSigSendType" SG_ 1437 RSDS_R_SGU14_RollingCounter7 9;
BA_ "IsRcSignal" SG_ 1437 RSDS_R_SGU14_RollingCounter7 1;
BA_ "GenSigSendType" SG_ 1437 RSDS_R_ObjMotionDirection_28 9;
BA_ "GenSigSendType" SG_ 1437 RSDS_R_ObjAge_28 9;
BA_ "GenSigSendType" SG_ 1437 RSDS_R_ObjWidth_28 9;
BA_ "GenSigSendType" SG_ 1437 RSDS_R_ObjRAccelYStd_28 9;
BA_ "GenSigSendType" SG_ 1437 RSDS_R_ObjRAccelXStd_28 9;
BA_ "GenSigSendType" SG_ 1437 RSDS_R_ObjRelVelYStd_28 9;
BA_ "GenSigSendType" SG_ 1437 RSDS_R_ObjRelVelXStd_28 9;
BA_ "GenSigSendType" SG_ 1437 RSDS_R_ObjDistYStd_28 9;
BA_ "GenSigSendType" SG_ 1437 RSDS_R_SGU14_Checksum7 9;
BA_ "IsCrcSignal" SG_ 1437 RSDS_R_SGU14_Checksum7 1;
BA_ "GenSigSendType" SG_ 1437 RSDS_R_SGU14_RollingCounter6 9;
BA_ "IsRcSignal" SG_ 1437 RSDS_R_SGU14_RollingCounter6 1;
BA_ "GenSigSendType" SG_ 1437 RSDS_R_ObjMotionType_28 9;
BA_ "GenSigStartValue" SG_ 1437 RSDS_R_ObjMeasured_28 1;
BA_ "GenSigSendType" SG_ 1437 RSDS_R_ObjMeasured_28 9;
BA_ "GenSigStartValue" SG_ 1437 RSDS_R_ObjRelAccelY_28 512;
BA_ "GenSigSendType" SG_ 1437 RSDS_R_ObjRelAccelY_28 9;
BA_ "GenSigStartValue" SG_ 1437 RSDS_R_ObjRelAccelX_28 512;
BA_ "GenSigSendType" SG_ 1437 RSDS_R_ObjRelAccelX_28 9;
BA_ "GenSigStartValue" SG_ 1437 RSDS_R_ObjRelVelY_28 4102;
BA_ "GenSigSendType" SG_ 1437 RSDS_R_ObjRelVelY_28 9;
BA_ "GenSigStartValue" SG_ 1437 RSDS_R_ObjRelVelX_28 4102;
BA_ "GenSigSendType" SG_ 1437 RSDS_R_ObjRelVelX_28 9;
BA_ "GenSigSendType" SG_ 1437 RSDS_R_SGU14_Checksum6 9;
BA_ "IsCrcSignal" SG_ 1437 RSDS_R_SGU14_Checksum6 1;
BA_ "GenSigSendType" SG_ 1437 RSDS_R_SGU14_RollingCounter5 9;
BA_ "IsRcSignal" SG_ 1437 RSDS_R_SGU14_RollingCounter5 1;
BA_ "GenSigSendType" SG_ 1437 RSDS_R_ObjType_28 9;
BA_ "GenSigSendType" SG_ 1437 RSDS_R_ObjDistXStd_28 9;
BA_ "GenSigStartValue" SG_ 1437 RSDS_R_ObjDistY_28 1024;
BA_ "GenSigSendType" SG_ 1437 RSDS_R_ObjDistY_28 9;
BA_ "GenSigSendType" SG_ 1437 RSDS_R_ObjDistX_28 9;
BA_ "GenSigSendType" SG_ 1437 RSDS_R_ObjObstacleProb_28 9;
BA_ "GenSigSendType" SG_ 1437 RSDS_R_ObjExistProb_28 9;
BA_ "GenSigSendType" SG_ 1437 RSDS_R_ObjID_28 9;
BA_ "GenSigSendType" SG_ 1437 RSDS_R_SGU14_Checksum5 9;
BA_ "IsCrcSignal" SG_ 1437 RSDS_R_SGU14_Checksum5 1;
BA_ "GenSigSendType" SG_ 1437 RSDS_R_SGU14_RollingCounter4 9;
BA_ "IsRcSignal" SG_ 1437 RSDS_R_SGU14_RollingCounter4 1;
BA_ "GenSigSendType" SG_ 1437 RSDS_R_HWATargetValidity_27 9;
BA_ "GenSigSendType" SG_ 1437 RSDS_R_ObjRefPoint_27 9;
BA_ "GenSigStartValue" SG_ 1437 RSDS_R_ObjRCS_27 400;
BA_ "GenSigSendType" SG_ 1437 RSDS_R_ObjRCS_27 9;
BA_ "GenSigSendType" SG_ 1437 RSDS_R_ObjYawrate_27 9;
BA_ "GenSigSendType" SG_ 1437 RSDS_R_ObjHeading_27 9;
BA_ "GenSigSendType" SG_ 1437 RSDS_R_ObjLength_27 9;
BA_ "GenSigSendType" SG_ 1437 RSDS_R_SGU14_Checksum4 9;
BA_ "IsCrcSignal" SG_ 1437 RSDS_R_SGU14_Checksum4 1;
BA_ "GenSigSendType" SG_ 1437 RSDS_R_SGU14_RollingCounter3 9;
BA_ "IsRcSignal" SG_ 1437 RSDS_R_SGU14_RollingCounter3 1;
BA_ "GenSigSendType" SG_ 1437 RSDS_R_ObjMotionDirection_27 9;
BA_ "GenSigSendType" SG_ 1437 RSDS_R_ObjAge_27 9;
BA_ "GenSigSendType" SG_ 1437 RSDS_R_ObjWidth_27 9;
BA_ "GenSigSendType" SG_ 1437 RSDS_R_ObjRAccelYStd_27 9;
BA_ "GenSigSendType" SG_ 1437 RSDS_R_ObjRAccelXStd_27 9;
BA_ "GenSigSendType" SG_ 1437 RSDS_R_ObjRelVelYStd_27 9;
BA_ "GenSigSendType" SG_ 1437 RSDS_R_ObjRelVelXStd_27 9;
BA_ "GenSigSendType" SG_ 1437 RSDS_R_ObjDistYStd_27 9;
BA_ "GenSigSendType" SG_ 1437 RSDS_R_SGU14_Checksum3 9;
BA_ "IsCrcSignal" SG_ 1437 RSDS_R_SGU14_Checksum3 1;
BA_ "GenSigSendType" SG_ 1437 RSDS_R_SGU14_RollingCounter2 9;
BA_ "IsRcSignal" SG_ 1437 RSDS_R_SGU14_RollingCounter2 1;
BA_ "GenSigSendType" SG_ 1437 RSDS_R_ObjMotionType_27 9;
BA_ "GenSigStartValue" SG_ 1437 RSDS_R_ObjMeasured_27 1;
BA_ "GenSigSendType" SG_ 1437 RSDS_R_ObjMeasured_27 9;
BA_ "GenSigStartValue" SG_ 1437 RSDS_R_ObjRelAccelY_27 512;
BA_ "GenSigSendType" SG_ 1437 RSDS_R_ObjRelAccelY_27 9;
BA_ "GenSigStartValue" SG_ 1437 RSDS_R_ObjRelAccelX_27 512;
BA_ "GenSigSendType" SG_ 1437 RSDS_R_ObjRelAccelX_27 9;
BA_ "GenSigStartValue" SG_ 1437 RSDS_R_ObjRelVelY_27 4102;
BA_ "GenSigSendType" SG_ 1437 RSDS_R_ObjRelVelY_27 9;
BA_ "GenSigStartValue" SG_ 1437 RSDS_R_ObjRelVelX_27 4102;
BA_ "GenSigSendType" SG_ 1437 RSDS_R_ObjRelVelX_27 9;
BA_ "GenSigSendType" SG_ 1437 RSDS_R_SGU14_Checksum2 9;
BA_ "IsCrcSignal" SG_ 1437 RSDS_R_SGU14_Checksum2 1;
BA_ "GenSigSendType" SG_ 1437 RSDS_R_SGU14_RollingCounter1 9;
BA_ "IsRcSignal" SG_ 1437 RSDS_R_SGU14_RollingCounter1 1;
BA_ "GenSigSendType" SG_ 1437 RSDS_R_ObjType_27 9;
BA_ "GenSigSendType" SG_ 1437 RSDS_R_ObjDistXStd_27 9;
BA_ "GenSigStartValue" SG_ 1437 RSDS_R_ObjDistY_27 1024;
BA_ "GenSigSendType" SG_ 1437 RSDS_R_ObjDistY_27 9;
BA_ "GenSigSendType" SG_ 1437 RSDS_R_ObjDistX_27 9;
BA_ "GenSigSendType" SG_ 1437 RSDS_R_ObjObstacleProb_27 9;
BA_ "GenSigSendType" SG_ 1437 RSDS_R_ObjExistProb_27 9;
BA_ "GenSigSendType" SG_ 1437 RSDS_R_ObjID_27 9;
BA_ "GenSigSendType" SG_ 1437 RSDS_R_SGU14_Checksum1 9;
BA_ "IsCrcSignal" SG_ 1437 RSDS_R_SGU14_Checksum1 1;
BA_ "GenSigSendType" SG_ 1438 RSDS_R_SGU15_RollingCounter8 9;
BA_ "IsRcSignal" SG_ 1438 RSDS_R_SGU15_RollingCounter8 1;
BA_ "GenSigSendType" SG_ 1438 RSDS_R_SGU15_BlockCounter 9;
BA_ "GenSigSendType" SG_ 1438 RSDS_R_HWATargetValidity_30 9;
BA_ "GenSigSendType" SG_ 1438 RSDS_R_ObjRefPoint_30 9;
BA_ "GenSigStartValue" SG_ 1438 RSDS_R_ObjRCS_30 400;
BA_ "GenSigSendType" SG_ 1438 RSDS_R_ObjRCS_30 9;
BA_ "GenSigSendType" SG_ 1438 RSDS_R_ObjYawrate_30 9;
BA_ "GenSigSendType" SG_ 1438 RSDS_R_ObjHeading_30 9;
BA_ "GenSigSendType" SG_ 1438 RSDS_R_ObjLength_30 9;
BA_ "GenSigSendType" SG_ 1438 RSDS_R_SGU15_Checksum8 9;
BA_ "IsCrcSignal" SG_ 1438 RSDS_R_SGU15_Checksum8 1;
BA_ "GenSigSendType" SG_ 1438 RSDS_R_SGU15_RollingCounter7 9;
BA_ "IsRcSignal" SG_ 1438 RSDS_R_SGU15_RollingCounter7 1;
BA_ "GenSigSendType" SG_ 1438 RSDS_R_ObjMotionDirection_30 9;
BA_ "GenSigSendType" SG_ 1438 RSDS_R_ObjAge_30 9;
BA_ "GenSigSendType" SG_ 1438 RSDS_R_ObjWidth_30 9;
BA_ "GenSigSendType" SG_ 1438 RSDS_R_ObjRAccelYStd_30 9;
BA_ "GenSigSendType" SG_ 1438 RSDS_R_ObjRAccelXStd_30 9;
BA_ "GenSigSendType" SG_ 1438 RSDS_R_ObjRelVelYStd_30 9;
BA_ "GenSigSendType" SG_ 1438 RSDS_R_ObjRelVelXStd_30 9;
BA_ "GenSigSendType" SG_ 1438 RSDS_R_ObjDistYStd_30 9;
BA_ "GenSigSendType" SG_ 1438 RSDS_R_SGU15_Checksum7 9;
BA_ "IsCrcSignal" SG_ 1438 RSDS_R_SGU15_Checksum7 1;
BA_ "GenSigSendType" SG_ 1438 RSDS_R_SGU15_RollingCounter6 9;
BA_ "IsRcSignal" SG_ 1438 RSDS_R_SGU15_RollingCounter6 1;
BA_ "GenSigSendType" SG_ 1438 RSDS_R_ObjMotionType_30 9;
BA_ "GenSigStartValue" SG_ 1438 RSDS_R_ObjMeasured_30 1;
BA_ "GenSigSendType" SG_ 1438 RSDS_R_ObjMeasured_30 9;
BA_ "GenSigStartValue" SG_ 1438 RSDS_R_ObjRelAccelY_30 512;
BA_ "GenSigSendType" SG_ 1438 RSDS_R_ObjRelAccelY_30 9;
BA_ "GenSigStartValue" SG_ 1438 RSDS_R_ObjRelAccelX_30 512;
BA_ "GenSigSendType" SG_ 1438 RSDS_R_ObjRelAccelX_30 9;
BA_ "GenSigStartValue" SG_ 1438 RSDS_R_ObjRelVelY_30 4102;
BA_ "GenSigSendType" SG_ 1438 RSDS_R_ObjRelVelY_30 9;
BA_ "GenSigStartValue" SG_ 1438 RSDS_R_ObjRelVelX_30 4102;
BA_ "GenSigSendType" SG_ 1438 RSDS_R_ObjRelVelX_30 9;
BA_ "GenSigSendType" SG_ 1438 RSDS_R_SGU15_Checksum6 9;
BA_ "IsCrcSignal" SG_ 1438 RSDS_R_SGU15_Checksum6 1;
BA_ "GenSigSendType" SG_ 1438 RSDS_R_SGU15_RollingCounter5 9;
BA_ "IsRcSignal" SG_ 1438 RSDS_R_SGU15_RollingCounter5 1;
BA_ "GenSigSendType" SG_ 1438 RSDS_R_ObjType_30 9;
BA_ "GenSigSendType" SG_ 1438 RSDS_R_ObjDistXStd_30 9;
BA_ "GenSigStartValue" SG_ 1438 RSDS_R_ObjDistY_30 1024;
BA_ "GenSigSendType" SG_ 1438 RSDS_R_ObjDistY_30 9;
BA_ "GenSigSendType" SG_ 1438 RSDS_R_ObjDistX_30 9;
BA_ "GenSigSendType" SG_ 1438 RSDS_R_ObjObstacleProb_30 9;
BA_ "GenSigSendType" SG_ 1438 RSDS_R_ObjExistProb_30 9;
BA_ "GenSigSendType" SG_ 1438 RSDS_R_ObjID_30 9;
BA_ "GenSigSendType" SG_ 1438 RSDS_R_SGU15_Checksum5 9;
BA_ "IsCrcSignal" SG_ 1438 RSDS_R_SGU15_Checksum5 1;
BA_ "GenSigSendType" SG_ 1438 RSDS_R_SGU15_RollingCounter4 9;
BA_ "IsRcSignal" SG_ 1438 RSDS_R_SGU15_RollingCounter4 1;
BA_ "GenSigSendType" SG_ 1438 RSDS_R_HWATargetValidity_29 9;
BA_ "GenSigSendType" SG_ 1438 RSDS_R_ObjRefPoint_29 9;
BA_ "GenSigStartValue" SG_ 1438 RSDS_R_ObjRCS_29 400;
BA_ "GenSigSendType" SG_ 1438 RSDS_R_ObjRCS_29 9;
BA_ "GenSigSendType" SG_ 1438 RSDS_R_ObjYawrate_29 9;
BA_ "GenSigSendType" SG_ 1438 RSDS_R_ObjHeading_29 9;
BA_ "GenSigSendType" SG_ 1438 RSDS_R_ObjLength_29 9;
BA_ "GenSigSendType" SG_ 1438 RSDS_R_SGU15_Checksum4 9;
BA_ "IsCrcSignal" SG_ 1438 RSDS_R_SGU15_Checksum4 1;
BA_ "GenSigSendType" SG_ 1438 RSDS_R_SGU15_RollingCounter3 9;
BA_ "IsRcSignal" SG_ 1438 RSDS_R_SGU15_RollingCounter3 1;
BA_ "GenSigSendType" SG_ 1438 RSDS_R_ObjMotionDirection_29 9;
BA_ "GenSigSendType" SG_ 1438 RSDS_R_ObjAge_29 9;
BA_ "GenSigSendType" SG_ 1438 RSDS_R_ObjWidth_29 9;
BA_ "GenSigSendType" SG_ 1438 RSDS_R_ObjRAccelYStd_29 9;
BA_ "GenSigSendType" SG_ 1438 RSDS_R_ObjRAccelXStd_29 9;
BA_ "GenSigSendType" SG_ 1438 RSDS_R_ObjRelVelYStd_29 9;
BA_ "GenSigSendType" SG_ 1438 RSDS_R_ObjRelVelXStd_29 9;
BA_ "GenSigSendType" SG_ 1438 RSDS_R_ObjDistYStd_29 9;
BA_ "GenSigSendType" SG_ 1438 RSDS_R_SGU15_Checksum3 9;
BA_ "IsCrcSignal" SG_ 1438 RSDS_R_SGU15_Checksum3 1;
BA_ "GenSigSendType" SG_ 1438 RSDS_R_SGU15_RollingCounter2 9;
BA_ "IsRcSignal" SG_ 1438 RSDS_R_SGU15_RollingCounter2 1;
BA_ "GenSigSendType" SG_ 1438 RSDS_R_ObjMotionType_29 9;
BA_ "GenSigStartValue" SG_ 1438 RSDS_R_ObjMeasured_29 1;
BA_ "GenSigSendType" SG_ 1438 RSDS_R_ObjMeasured_29 9;
BA_ "GenSigStartValue" SG_ 1438 RSDS_R_ObjRelAccelY_29 512;
BA_ "GenSigSendType" SG_ 1438 RSDS_R_ObjRelAccelY_29 9;
BA_ "GenSigStartValue" SG_ 1438 RSDS_R_ObjRelAccelX_29 512;
BA_ "GenSigSendType" SG_ 1438 RSDS_R_ObjRelAccelX_29 9;
BA_ "GenSigStartValue" SG_ 1438 RSDS_R_ObjRelVelY_29 4102;
BA_ "GenSigSendType" SG_ 1438 RSDS_R_ObjRelVelY_29 9;
BA_ "GenSigStartValue" SG_ 1438 RSDS_R_ObjRelVelX_29 4102;
BA_ "GenSigSendType" SG_ 1438 RSDS_R_ObjRelVelX_29 9;
BA_ "GenSigSendType" SG_ 1438 RSDS_R_SGU15_Checksum2 9;
BA_ "IsCrcSignal" SG_ 1438 RSDS_R_SGU15_Checksum2 1;
BA_ "GenSigSendType" SG_ 1438 RSDS_R_SGU15_RollingCounter1 9;
BA_ "IsRcSignal" SG_ 1438 RSDS_R_SGU15_RollingCounter1 1;
BA_ "GenSigSendType" SG_ 1438 RSDS_R_ObjType_29 9;
BA_ "GenSigSendType" SG_ 1438 RSDS_R_ObjDistXStd_29 9;
BA_ "GenSigStartValue" SG_ 1438 RSDS_R_ObjDistY_29 1024;
BA_ "GenSigSendType" SG_ 1438 RSDS_R_ObjDistY_29 9;
BA_ "GenSigSendType" SG_ 1438 RSDS_R_ObjDistX_29 9;
BA_ "GenSigSendType" SG_ 1438 RSDS_R_ObjObstacleProb_29 9;
BA_ "GenSigSendType" SG_ 1438 RSDS_R_ObjExistProb_29 9;
BA_ "GenSigSendType" SG_ 1438 RSDS_R_ObjID_29 9;
BA_ "GenSigSendType" SG_ 1438 RSDS_R_SGU15_Checksum1 9;
BA_ "IsCrcSignal" SG_ 1438 RSDS_R_SGU15_Checksum1 1;
BA_ "GenSigSendType" SG_ 1439 RSDS_R_SGU16_RollingCounter8 9;
BA_ "IsRcSignal" SG_ 1439 RSDS_R_SGU16_RollingCounter8 1;
BA_ "GenSigSendType" SG_ 1439 RSDS_R_SGU16_BlockCounter 9;
BA_ "GenSigSendType" SG_ 1439 RSDS_R_HWATargetValidity_32 9;
BA_ "GenSigSendType" SG_ 1439 RSDS_R_ObjRefPoint_32 9;
BA_ "GenSigStartValue" SG_ 1439 RSDS_R_ObjRCS_32 400;
BA_ "GenSigSendType" SG_ 1439 RSDS_R_ObjRCS_32 9;
BA_ "GenSigSendType" SG_ 1439 RSDS_R_ObjYawrate_32 9;
BA_ "GenSigSendType" SG_ 1439 RSDS_R_ObjHeading_32 9;
BA_ "GenSigSendType" SG_ 1439 RSDS_R_ObjLength_32 9;
BA_ "GenSigSendType" SG_ 1439 RSDS_R_SGU16_Checksum8 9;
BA_ "IsCrcSignal" SG_ 1439 RSDS_R_SGU16_Checksum8 1;
BA_ "GenSigSendType" SG_ 1439 RSDS_R_SGU16_RollingCounter7 9;
BA_ "IsRcSignal" SG_ 1439 RSDS_R_SGU16_RollingCounter7 1;
BA_ "GenSigSendType" SG_ 1439 RSDS_R_ObjMotionDirection_32 9;
BA_ "GenSigSendType" SG_ 1439 RSDS_R_ObjAge_32 9;
BA_ "GenSigSendType" SG_ 1439 RSDS_R_ObjWidth_32 9;
BA_ "GenSigSendType" SG_ 1439 RSDS_R_ObjRAccelYStd_32 9;
BA_ "GenSigSendType" SG_ 1439 RSDS_R_ObjRAccelXStd_32 9;
BA_ "GenSigSendType" SG_ 1439 RSDS_R_ObjRelVelYStd_32 9;
BA_ "GenSigSendType" SG_ 1439 RSDS_R_ObjRelVelXStd_32 9;
BA_ "GenSigSendType" SG_ 1439 RSDS_R_ObjDistYStd_32 9;
BA_ "GenSigSendType" SG_ 1439 RSDS_R_SGU16_Checksum7 9;
BA_ "IsCrcSignal" SG_ 1439 RSDS_R_SGU16_Checksum7 1;
BA_ "GenSigSendType" SG_ 1439 RSDS_R_SGU16_RollingCounter6 9;
BA_ "IsRcSignal" SG_ 1439 RSDS_R_SGU16_RollingCounter6 1;
BA_ "GenSigSendType" SG_ 1439 RSDS_R_ObjMotionType_32 9;
BA_ "GenSigStartValue" SG_ 1439 RSDS_R_ObjMeasured_32 1;
BA_ "GenSigSendType" SG_ 1439 RSDS_R_ObjMeasured_32 9;
BA_ "GenSigStartValue" SG_ 1439 RSDS_R_ObjRelAccelY_32 512;
BA_ "GenSigSendType" SG_ 1439 RSDS_R_ObjRelAccelY_32 9;
BA_ "GenSigStartValue" SG_ 1439 RSDS_R_ObjRelAccelX_32 512;
BA_ "GenSigSendType" SG_ 1439 RSDS_R_ObjRelAccelX_32 9;
BA_ "GenSigStartValue" SG_ 1439 RSDS_R_ObjRelVelY_32 4102;
BA_ "GenSigSendType" SG_ 1439 RSDS_R_ObjRelVelY_32 9;
BA_ "GenSigStartValue" SG_ 1439 RSDS_R_ObjRelVelX_32 4102;
BA_ "GenSigSendType" SG_ 1439 RSDS_R_ObjRelVelX_32 9;
BA_ "GenSigSendType" SG_ 1439 RSDS_R_SGU16_Checksum6 9;
BA_ "IsCrcSignal" SG_ 1439 RSDS_R_SGU16_Checksum6 1;
BA_ "GenSigSendType" SG_ 1439 RSDS_R_SGU16_RollingCounter5 9;
BA_ "IsRcSignal" SG_ 1439 RSDS_R_SGU16_RollingCounter5 1;
BA_ "GenSigSendType" SG_ 1439 RSDS_R_ObjType_32 9;
BA_ "GenSigSendType" SG_ 1439 RSDS_R_ObjDistXStd_32 9;
BA_ "GenSigStartValue" SG_ 1439 RSDS_R_ObjDistY_32 1024;
BA_ "GenSigSendType" SG_ 1439 RSDS_R_ObjDistY_32 9;
BA_ "GenSigSendType" SG_ 1439 RSDS_R_ObjDistX_32 9;
BA_ "GenSigSendType" SG_ 1439 RSDS_R_ObjObstacleProb_32 9;
BA_ "GenSigSendType" SG_ 1439 RSDS_R_ObjExistProb_32 9;
BA_ "GenSigSendType" SG_ 1439 RSDS_R_ObjID_32 9;
BA_ "GenSigSendType" SG_ 1439 RSDS_R_SGU16_Checksum5 9;
BA_ "IsCrcSignal" SG_ 1439 RSDS_R_SGU16_Checksum5 1;
BA_ "GenSigSendType" SG_ 1439 RSDS_R_SGU16_RollingCounter4 9;
BA_ "IsRcSignal" SG_ 1439 RSDS_R_SGU16_RollingCounter4 1;
BA_ "GenSigSendType" SG_ 1439 RSDS_R_HWATargetValidity_31 9;
BA_ "GenSigSendType" SG_ 1439 RSDS_R_ObjRefPoint_31 9;
BA_ "GenSigStartValue" SG_ 1439 RSDS_R_ObjRCS_31 400;
BA_ "GenSigSendType" SG_ 1439 RSDS_R_ObjRCS_31 9;
BA_ "GenSigSendType" SG_ 1439 RSDS_R_ObjYawrate_31 9;
BA_ "GenSigSendType" SG_ 1439 RSDS_R_ObjHeading_31 9;
BA_ "GenSigSendType" SG_ 1439 RSDS_R_ObjLength_31 9;
BA_ "GenSigSendType" SG_ 1439 RSDS_R_SGU16_Checksum4 9;
BA_ "IsCrcSignal" SG_ 1439 RSDS_R_SGU16_Checksum4 1;
BA_ "GenSigSendType" SG_ 1439 RSDS_R_SGU16_RollingCounter3 9;
BA_ "IsRcSignal" SG_ 1439 RSDS_R_SGU16_RollingCounter3 1;
BA_ "GenSigSendType" SG_ 1439 RSDS_R_ObjMotionDirection_31 9;
BA_ "GenSigSendType" SG_ 1439 RSDS_R_ObjAge_31 9;
BA_ "GenSigSendType" SG_ 1439 RSDS_R_ObjWidth_31 9;
BA_ "GenSigSendType" SG_ 1439 RSDS_R_ObjRAccelYStd_31 9;
BA_ "GenSigSendType" SG_ 1439 RSDS_R_ObjRAccelXStd_31 9;
BA_ "GenSigSendType" SG_ 1439 RSDS_R_ObjRelVelYStd_31 9;
BA_ "GenSigSendType" SG_ 1439 RSDS_R_ObjRelVelXStd_31 9;
BA_ "GenSigSendType" SG_ 1439 RSDS_R_ObjDistYStd_31 9;
BA_ "GenSigSendType" SG_ 1439 RSDS_R_SGU16_Checksum3 9;
BA_ "IsCrcSignal" SG_ 1439 RSDS_R_SGU16_Checksum3 1;
BA_ "GenSigSendType" SG_ 1439 RSDS_R_SGU16_RollingCounter2 9;
BA_ "IsRcSignal" SG_ 1439 RSDS_R_SGU16_RollingCounter2 1;
BA_ "GenSigSendType" SG_ 1439 RSDS_R_ObjMotionType_31 9;
BA_ "GenSigStartValue" SG_ 1439 RSDS_R_ObjMeasured_31 1;
BA_ "GenSigSendType" SG_ 1439 RSDS_R_ObjMeasured_31 9;
BA_ "GenSigStartValue" SG_ 1439 RSDS_R_ObjRelAccelY_31 512;
BA_ "GenSigSendType" SG_ 1439 RSDS_R_ObjRelAccelY_31 9;
BA_ "GenSigStartValue" SG_ 1439 RSDS_R_ObjRelAccelX_31 512;
BA_ "GenSigSendType" SG_ 1439 RSDS_R_ObjRelAccelX_31 9;
BA_ "GenSigStartValue" SG_ 1439 RSDS_R_ObjRelVelY_31 4102;
BA_ "GenSigSendType" SG_ 1439 RSDS_R_ObjRelVelY_31 9;
BA_ "GenSigStartValue" SG_ 1439 RSDS_R_ObjRelVelX_31 4102;
BA_ "GenSigSendType" SG_ 1439 RSDS_R_ObjRelVelX_31 9;
BA_ "GenSigSendType" SG_ 1439 RSDS_R_SGU16_Checksum2 9;
BA_ "IsCrcSignal" SG_ 1439 RSDS_R_SGU16_Checksum2 1;
BA_ "GenSigSendType" SG_ 1439 RSDS_R_SGU16_RollingCounter1 9;
BA_ "IsRcSignal" SG_ 1439 RSDS_R_SGU16_RollingCounter1 1;
BA_ "GenSigSendType" SG_ 1439 RSDS_R_ObjType_31 9;
BA_ "GenSigSendType" SG_ 1439 RSDS_R_ObjDistXStd_31 9;
BA_ "GenSigStartValue" SG_ 1439 RSDS_R_ObjDistY_31 1024;
BA_ "GenSigSendType" SG_ 1439 RSDS_R_ObjDistY_31 9;
BA_ "GenSigSendType" SG_ 1439 RSDS_R_ObjDistX_31 9;
BA_ "GenSigSendType" SG_ 1439 RSDS_R_ObjObstacleProb_31 9;
BA_ "GenSigSendType" SG_ 1439 RSDS_R_ObjExistProb_31 9;
BA_ "GenSigSendType" SG_ 1439 RSDS_R_ObjID_31 9;
BA_ "GenSigSendType" SG_ 1439 RSDS_R_SGU16_Checksum1 9;
BA_ "IsCrcSignal" SG_ 1439 RSDS_R_SGU16_Checksum1 1;
BA_ "GenSigSendType" SG_ 1487 RSDS_R_SGU_HEAD_RollingCounter4 9;
BA_ "IsRcSignal" SG_ 1487 RSDS_R_SGU_HEAD_RollingCounter4 1;
BA_ "GenSigSendType" SG_ 1487 RSDS_R_SGU_HEAD_BlockCounter 9;
BA_ "GenSigSendType" SG_ 1487 RSDS_R_ObjAziAngleCalib 9;
BA_ "GenSigSendType" SG_ 1487 RSDS_R_Guardrail_dxStart 9;
BA_ "GenSigSendType" SG_ 1487 RSDS_R_GuardrailC3 9;
BA_ "GenSigSendType" SG_ 1487 RSDS_R_SGU_HEAD_Checksum4 9;
BA_ "IsCrcSignal" SG_ 1487 RSDS_R_SGU_HEAD_Checksum4 1;
BA_ "GenSigSendType" SG_ 1487 RSDS_R_SGU_HEAD_RollingCounter3 9;
BA_ "IsRcSignal" SG_ 1487 RSDS_R_SGU_HEAD_RollingCounter3 1;
BA_ "GenSigSendType" SG_ 1487 RSDS_R_GuardrailC2 9;
BA_ "GenSigSendType" SG_ 1487 RSDS_R_GuardrailC1 9;
BA_ "GenSigSendType" SG_ 1487 RSDS_R_GuardrailC0 9;
BA_ "GenSigSendType" SG_ 1487 RSDS_R_SGU_HEAD_Checksum3 9;
BA_ "IsCrcSignal" SG_ 1487 RSDS_R_SGU_HEAD_Checksum3 1;
BA_ "GenSigSendType" SG_ 1487 RSDS_R_SGU_HEAD_RollingCounter2 9;
BA_ "IsRcSignal" SG_ 1487 RSDS_R_SGU_HEAD_RollingCounter2 1;
BA_ "GenSigSendType" SG_ 1487 RSDS_R_hdr_AutosarTimeStamp 9;
BA_ "GenSigSendType" SG_ 1487 RSDS_R_SGU_HEAD_Checksum2 9;
BA_ "IsCrcSignal" SG_ 1487 RSDS_R_SGU_HEAD_Checksum2 1;
BA_ "GenSigSendType" SG_ 1487 RSDS_R_SGU_HEAD_RollingCounter1 9;
BA_ "IsRcSignal" SG_ 1487 RSDS_R_SGU_HEAD_RollingCounter1 1;
BA_ "GenSigSendType" SG_ 1487 RSDS_R_hdr_ErrorStatus 9;
BA_ "GenSigSendType" SG_ 1487 RSDS_R_Guardrail_dxEnd 9;
BA_ "GenSigSendType" SG_ 1487 RSDS_R_GuardrailConfidence 9;
BA_ "GenSigSendType" SG_ 1487 RSDS_R_ObjDetected 9;
BA_ "GenSigSendType" SG_ 1487 RSDS_R_BLIND 9;
BA_ "GenSigSendType" SG_ 1487 RSDS_R_hdr_TimeStampStatus 9;
BA_ "GenSigSendType" SG_ 1487 RSDS_R_hdr_TimeStamp 9;
BA_ "GenSigSendType" SG_ 1487 RSDS_R_SGU_HEAD_Checksum1 9;
BA_ "IsCrcSignal" SG_ 1487 RSDS_R_SGU_HEAD_Checksum1 1;
BA_ "GenSigSendType" SG_ 1967 RSDS_R_Phy_Resp 9;
BA_ "GenSigStartValue" SG_ 367 RSDS_ObjRelAccelY_Ri 512;
BA_ "GenSigStartValue" SG_ 367 RSDS_ObjRelAccelX_Ri 512;
BA_ "GenSigStartValue" SG_ 367 RSDS_ObjRelAccelX_Le 512;
BA_ "IsRcSignal" SG_ 367 RollingCounter_RSDS_R_5 1;
BA_ "GenSigStartValue" SG_ 367 ObjTTCRi 127;
BA_ "GenSigStartValue" SG_ 367 ObjLatSpdCurvRi 64;
BA_ "GenSigStartValue" SG_ 367 ObjLatPosnCurvRi 128;
BA_ "GenSigStartValue" SG_ 367 RiTarSts 2;
BA_ "IsCrcSignal" SG_ 367 Checksum_RSDS_R_5 1;
BA_ "IsRcSignal" SG_ 367 RollingCounter_RSDS_R_4 1;
BA_ "IsCrcSignal" SG_ 367 Checksum_RSDS_R_4 1;
BA_ "IsRcSignal" SG_ 367 RollingCounter_RSDS_R_3 1;
BA_ "GenSigStartValue" SG_ 367 ObjTTCLe 127;
BA_ "GenSigStartValue" SG_ 367 ObjLatSpdCurvLe 64;
BA_ "GenSigStartValue" SG_ 367 ObjLatPosnCurvLe 128;
BA_ "GenSigStartValue" SG_ 367 LeTarSts 2;
BA_ "IsCrcSignal" SG_ 367 Checksum_RSDS_R_3 1;
BA_ "IsRcSignal" SG_ 367 RollingCounter_RSDS_R_2 1;
BA_ "GenSigStartValue" SG_ 367 RSDS_BrkgReqVal 200;
BA_ "IsCrcSignal" SG_ 367 Checksum_RSDS_R_2 1;
BA_ "GenSigStartValue" SG_ 367 RSDS_ObjRelAccelY_Le 512;
VAL_ 1429 RSDS_R_SGU6_RollingCounter8 0 "Valid_value" 15 "Invalid_value" ;
VAL_ 1429 RSDS_R_SGU6_BlockCounter 0 "Valid_value" ;
VAL_ 1429 RSDS_R_HWATargetValidity_12 0 "NOT_HWA_Target" 1 "HWA_Target" ;
VAL_ 1429 RSDS_R_ObjRefPoint_12 0 "Rear" 1 "Rear_left" 2 "Left" 3 "Front_left" 4 "Front" 5 "Front_Right" 6 "Right" 7 "Rear_right" ;
VAL_ 1429 RSDS_R_ObjRCS_12 0 "Valid_values" ;
VAL_ 1429 RSDS_R_ObjYawrate_12 0 "Valid_values" 4446 "Reserved" ;
VAL_ 1429 RSDS_R_ObjHeading_12 0 "Valid_values" 4446 "Reserved" ;
VAL_ 1429 RSDS_R_ObjLength_12 0 "Valid_values" 401 "Reserved" ;
VAL_ 1429 RSDS_R_SGU6_Checksum8 0 "Valid_value" ;
VAL_ 1429 RSDS_R_SGU6_RollingCounter7 0 "Valid_value" 15 "Invalid_value" ;
VAL_ 1429 RSDS_R_ObjMotionDirection_12 0 "Init" 1 "Inverse_direction" 2 "Same_direction" 3 "cross" 4 "reserved" 5 "reserved" 6 "reserved" 7 "reserved" ;
VAL_ 1429 RSDS_R_ObjAge_12 0 "Valid_values" ;
VAL_ 1429 RSDS_R_ObjWidth_12 0 "Valid_values" 501 "Reserved" ;
VAL_ 1429 RSDS_R_ObjRAccelYStd_12 0 "Valid_values" ;
VAL_ 1429 RSDS_R_ObjRAccelXStd_12 0 "Valid_values" ;
VAL_ 1429 RSDS_R_ObjRelVelYStd_12 0 "Valid_values" ;
VAL_ 1429 RSDS_R_ObjRelVelXStd_12 0 "Valid_values" ;
VAL_ 1429 RSDS_R_ObjDistYStd_12 0 "Valid_values" ;
VAL_ 1429 RSDS_R_SGU6_Checksum7 0 "Valid_value" ;
VAL_ 1429 RSDS_R_SGU6_RollingCounter6 0 "Valid_value" 15 "Invalid_value" ;
VAL_ 1429 RSDS_R_ObjMotionType_12 0 "int" 1 "unknown" 2 "Drive" 3 "Stopped" 4 "Stand" 5 "reserved" 6 "reserved" 7 "reserved" ;
VAL_ 1429 RSDS_R_ObjMeasured_12 0 "Init" 1 "Measured" 2 "Predicted" 3 "Reserved" ;
VAL_ 1429 RSDS_R_ObjRelAccelY_12 0 "Valid_values" ;
VAL_ 1429 RSDS_R_ObjRelAccelX_12 0 "Valid_values" ;
VAL_ 1429 RSDS_R_ObjRelVelY_12 0 "Valid_values" 8174 "Reserved" ;
VAL_ 1429 RSDS_R_ObjRelVelX_12 0 "Valid_values" 8174 "Reserved" ;
VAL_ 1429 RSDS_R_SGU6_Checksum6 0 "Valid_value" ;
VAL_ 1429 RSDS_R_SGU6_RollingCounter5 0 "Valid_value" 15 "Invalid_value" ;
VAL_ 1429 RSDS_R_ObjType_12 0 "Unknown" 1 "Truck" 2 "Car" 3 "Pedestrian" 4 "Cyclist" 5 "Reserved" ;
VAL_ 1429 RSDS_R_ObjDistXStd_12 0 "Valid_values" ;
VAL_ 1429 RSDS_R_ObjDistY_12 0 "Valid_values" ;
VAL_ 1429 RSDS_R_ObjDistX_12 0 "Valid_values" 4080 "Reserved" ;
VAL_ 1429 RSDS_R_ObjObstacleProb_12 0 "Valid_values" ;
VAL_ 1429 RSDS_R_ObjExistProb_12 0 "Valid_values" ;
VAL_ 1429 RSDS_R_ObjID_12 0 "Valid_values" ;
VAL_ 1429 RSDS_R_SGU6_Checksum5 0 "Valid_value" ;
VAL_ 1429 RSDS_R_SGU6_RollingCounter4 0 "Valid_value" 15 "Invalid_value" ;
VAL_ 1429 RSDS_R_HWATargetValidity_11 0 "NOT_HWA_Target" 1 "HWA_Target" ;
VAL_ 1429 RSDS_R_ObjRefPoint_11 0 "Rear" 1 "Rear_left" 2 "Left" 3 "Front_left" 4 "Front" 5 "Front_Right" 6 "Right" 7 "Rear_right" ;
VAL_ 1429 RSDS_R_ObjRCS_11 0 "Valid_values" ;
VAL_ 1429 RSDS_R_ObjYawrate_11 0 "Valid_values" 4446 "Reserved" ;
VAL_ 1429 RSDS_R_ObjHeading_11 0 "Valid_values" 4446 "Reserved" ;
VAL_ 1429 RSDS_R_ObjLength_11 0 "Valid_values" 401 "Reserved" ;
VAL_ 1429 RSDS_R_SGU6_Checksum4 0 "Valid_value" ;
VAL_ 1429 RSDS_R_SGU6_RollingCounter3 0 "Valid_value" 15 "Invalid_value" ;
VAL_ 1429 RSDS_R_ObjMotionDirection_11 0 "Init" 1 "Inverse_direction" 2 "Same__direction" 3 "cross" 4 "reserved" 5 "reserved" 6 "reserved" 7 "reserved" ;
VAL_ 1429 RSDS_R_ObjAge_11 0 "Valid_values" ;
VAL_ 1429 RSDS_R_ObjWidth_11 0 "Valid_values" 501 "Reserved" ;
VAL_ 1429 RSDS_R_ObjRAccelYStd_11 0 "Valid_values" ;
VAL_ 1429 RSDS_R_ObjRAccelXStd_11 0 "Valid_values" ;
VAL_ 1429 RSDS_R_ObjRelVelYStd_11 0 "Valid_values" ;
VAL_ 1429 RSDS_R_ObjRelVelXStd_11 0 "Valid_values" ;
VAL_ 1429 RSDS_R_ObjDistYStd_11 0 "Valid_values" ;
VAL_ 1429 RSDS_R_SGU6_Checksum3 0 "Valid_value" ;
VAL_ 1429 RSDS_R_SGU6_RollingCounter2 0 "Valid_value" 15 "Invalid_value" ;
VAL_ 1429 RSDS_R_ObjMotionType_11 0 "int" 1 "unknown" 2 "Drive" 3 "Stopped" 4 "Stand" 5 "reserved" 6 "reserved" 7 "reserved" ;
VAL_ 1429 RSDS_R_ObjMeasured_11 0 "Init" 1 "Measured" 2 "Predicted" 3 "Reserved" ;
VAL_ 1429 RSDS_R_ObjRelAccelY_11 0 "Valid_values" ;
VAL_ 1429 RSDS_R_ObjRelAccelX_11 0 "Valid_values" ;
VAL_ 1429 RSDS_R_ObjRelVelY_11 0 "Valid_values" 8174 "Reserved" ;
VAL_ 1429 RSDS_R_ObjRelVelX_11 0 "Valid_values" 8174 "Reserved" ;
VAL_ 1429 RSDS_R_SGU6_Checksum2 0 "Valid_value" ;
VAL_ 1429 RSDS_R_SGU6_RollingCounter1 0 "Valid_value" 15 "Invalid_value" ;
VAL_ 1429 RSDS_R_ObjType_11 0 "Unknown" 1 "Truck" 2 "Car" 3 "Pedestrian" 4 "Cyclist" 5 "Reserved" ;
VAL_ 1429 RSDS_R_ObjDistXStd_11 0 "Valid_values" ;
VAL_ 1429 RSDS_R_ObjDistY_11 0 "Valid_values" ;
VAL_ 1429 RSDS_R_ObjDistX_11 0 "Valid_values" 4080 "Reserved" ;
VAL_ 1429 RSDS_R_ObjObstacleProb_11 0 "Valid_values" ;
VAL_ 1429 RSDS_R_ObjExistProb_11 0 "Valid_values" ;
VAL_ 1429 RSDS_R_ObjID_11 0 "Valid_values" ;
VAL_ 1429 RSDS_R_SGU6_Checksum1 0 "Valid_value" ;
VAL_ 1430 RSDS_R_SGU7_RollingCounter8 0 "Valid_value" 15 "Invalid_value" ;
VAL_ 1430 RSDS_R_SGU7_BlockCounter 0 "Valid_value" ;
VAL_ 1430 RSDS_R_HWATargetValidity_14 0 "NOT_HWA_Target" 1 "HWA_Target" ;
VAL_ 1430 RSDS_R_ObjRefPoint_14 0 "Rear" 1 "Rear_left" 2 "Left" 3 "Front_left" 4 "Front" 5 "Front_Right" 6 "Right" 7 "Rear_right" ;
VAL_ 1430 RSDS_R_ObjRCS_14 0 "Valid_values" ;
VAL_ 1430 RSDS_R_ObjYawrate_14 0 "Valid_values" 4446 "Reserved" ;
VAL_ 1430 RSDS_R_ObjHeading_14 0 "Valid_values" 4446 "Reserved" ;
VAL_ 1430 RSDS_R_ObjLength_14 0 "Valid_values" 401 "Reserved" ;
VAL_ 1430 RSDS_R_SGU7_Checksum8 0 "Valid_value" ;
VAL_ 1430 RSDS_R_SGU7_RollingCounter7 0 "Valid_value" 15 "Invalid_value" ;
VAL_ 1430 RSDS_R_ObjMotionDirection_14 0 "Init" 1 "Inverse_direction" 2 "Same__direction" 3 "cross" 4 "reserved" 5 "reserved" 6 "reserved" 7 "reserved" ;
VAL_ 1430 RSDS_R_ObjAge_14 0 "Valid_values" ;
VAL_ 1430 RSDS_R_ObjWidth_14 0 "Valid_values" 501 "Reserved" ;
VAL_ 1430 RSDS_R_ObjRAccelYStd_14 0 "Valid_values" ;
VAL_ 1430 RSDS_R_ObjRAccelXStd_14 0 "Valid_values" ;
VAL_ 1430 RSDS_R_ObjRelVelYStd_14 0 "Valid_values" ;
VAL_ 1430 RSDS_R_ObjRelVelXStd_14 0 "Valid_values" ;
VAL_ 1430 RSDS_R_ObjDistYStd_14 0 "Valid_values" ;
VAL_ 1430 RSDS_R_SGU7_Checksum7 0 "Valid_value" ;
VAL_ 1430 RSDS_R_SGU7_RollingCounter6 0 "Valid_value" 15 "Invalid_value" ;
VAL_ 1430 RSDS_R_ObjMotionType_14 0 "int" 1 "unknown" 2 "Drive" 3 "Stopped" 4 "Stand" 5 "reserved" 6 "reserved" 7 "reserved" ;
VAL_ 1430 RSDS_R_ObjMeasured_14 0 "Init" 1 "Measured" 2 "Predicted" 3 "Reserved" ;
VAL_ 1430 RSDS_R_ObjRelAccelY_14 0 "Valid_values" ;
VAL_ 1430 RSDS_R_ObjRelAccelX_14 0 "Valid_values" ;
VAL_ 1430 RSDS_R_ObjRelVelY_14 0 "Valid_values" 8174 "Reserved" ;
VAL_ 1430 RSDS_R_ObjRelVelX_14 0 "Valid_values" 8174 "Reserved" ;
VAL_ 1430 RSDS_R_SGU7_Checksum6 0 "Valid_value" ;
VAL_ 1430 RSDS_R_SGU7_RollingCounter5 0 "Valid_value" 15 "Invalid_value" ;
VAL_ 1430 RSDS_R_ObjType_14 0 "Unknown" 1 "Truck" 2 "Car" 3 "Pedestrian" 4 "Cyclist" 5 "Reserved" ;
VAL_ 1430 RSDS_R_ObjDistXStd_14 0 "Valid_values" ;
VAL_ 1430 RSDS_R_ObjDistY_14 0 "Valid_values" ;
VAL_ 1430 RSDS_R_ObjDistX_14 0 "Valid_values" 4080 "Reserved" ;
VAL_ 1430 RSDS_R_ObjObstacleProb_14 0 "Valid_values" ;
VAL_ 1430 RSDS_R_ObjExistProb_14 0 "Valid_values" ;
VAL_ 1430 RSDS_R_ObjID_14 0 "Valid_values" ;
VAL_ 1430 RSDS_R_SGU7_Checksum5 0 "Valid_value" ;
VAL_ 1430 RSDS_R_SGU7_RollingCounter4 0 "Valid_value" 15 "Invalid_value" ;
VAL_ 1430 RSDS_R_HWATargetValidity_13 0 "NOT_HWA_Target" 1 "HWA_Target" ;
VAL_ 1430 RSDS_R_ObjRefPoint_13 0 "Rear" 1 "Rear_left" 2 "Left" 3 "Front_left" 4 "Front" 5 "Front_Right" 6 "Right" 7 "Rear_right" ;
VAL_ 1430 RSDS_R_ObjRCS_13 0 "Valid_values" ;
VAL_ 1430 RSDS_R_ObjYawrate_13 0 "Valid_values" 4446 "Reserved" ;
VAL_ 1430 RSDS_R_ObjHeading_13 0 "Valid_values" 4446 "Reserved" ;
VAL_ 1430 RSDS_R_ObjLength_13 0 "Valid_values" 401 "Reserved" ;
VAL_ 1430 RSDS_R_SGU7_Checksum4 0 "Valid_value" ;
VAL_ 1430 RSDS_R_SGU7_RollingCounter3 0 "Valid_value" 15 "Invalid_value" ;
VAL_ 1430 RSDS_R_ObjMotionDirection_13 0 "Init" 1 "Inverse_direction" 2 "Same__direction" 3 "cross" 4 "reserved" 5 "reserved" 6 "reserved" 7 "reserved" ;
VAL_ 1430 RSDS_R_ObjAge_13 0 "Valid_values" ;
VAL_ 1430 RSDS_R_ObjWidth_13 0 "Valid_values" 501 "Reserved" ;
VAL_ 1430 RSDS_R_ObjRAccelYStd_13 0 "Valid_values" ;
VAL_ 1430 RSDS_R_ObjRAccelXStd_13 0 "Valid_values" ;
VAL_ 1430 RSDS_R_ObjRelVelYStd_13 0 "Valid_values" ;
VAL_ 1430 RSDS_R_ObjRelVelXStd_13 0 "Valid_values" ;
VAL_ 1430 RSDS_R_ObjDistYStd_13 0 "Valid_values" ;
VAL_ 1430 RSDS_R_SGU7_Checksum3 0 "Valid_value" ;
VAL_ 1430 RSDS_R_SGU7_RollingCounter2 0 "Valid_value" 15 "Invalid_value" ;
VAL_ 1430 RSDS_R_ObjMotionType_13 0 "int" 1 "unknown" 2 "Drive" 3 "Stopped" 4 "Stand" 5 "reserved" 6 "reserved" 7 "reserved" ;
VAL_ 1430 RSDS_R_ObjMeasured_13 0 "Init" 1 "Measured" 2 "Predicted" 3 "Reserved" ;
VAL_ 1430 RSDS_R_ObjRelAccelY_13 0 "Valid_values" ;
VAL_ 1430 RSDS_R_ObjRelAccelX_13 0 "Valid_values" ;
VAL_ 1430 RSDS_R_ObjRelVelY_13 0 "Valid_values" 8174 "Reserved" ;
VAL_ 1430 RSDS_R_ObjRelVelX_13 0 "Valid_values" 8174 "Reserved" ;
VAL_ 1430 RSDS_R_SGU7_Checksum2 0 "Valid_value" ;
VAL_ 1430 RSDS_R_SGU7_RollingCounter1 0 "Valid_value" 15 "Invalid_value" ;
VAL_ 1430 RSDS_R_ObjType_13 0 "Unknown" 1 "Truck" 2 "Car" 3 "Pedestrian" 4 "Cyclist" 5 "Reserved" ;
VAL_ 1430 RSDS_R_ObjDistXStd_13 0 "Valid_values" ;
VAL_ 1430 RSDS_R_ObjDistY_13 0 "Valid_values" ;
VAL_ 1430 RSDS_R_ObjDistX_13 0 "Valid_values" 4080 "Reserved" ;
VAL_ 1430 RSDS_R_ObjObstacleProb_13 0 "Valid_values" ;
VAL_ 1430 RSDS_R_ObjExistProb_13 0 "Valid_values" ;
VAL_ 1430 RSDS_R_ObjID_13 0 "Valid_values" ;
VAL_ 1430 RSDS_R_SGU7_Checksum1 0 "Valid_value" ;
VAL_ 1431 RSDS_R_SGU8_RollingCounter8 0 "Valid_value" 15 "Invalid_value" ;
VAL_ 1431 RSDS_R_SGU8_BlockCounter 0 "Valid_value" ;
VAL_ 1431 RSDS_R_HWATargetValidity_16 0 "NOT_HWA_Target" 1 "HWA_Target" ;
VAL_ 1431 RSDS_R_ObjRefPoint_16 0 "Rear" 1 "Rear_left" 2 "Left" 3 "Front_left" 4 "Front" 5 "Front_Right" 6 "Right" 7 "Rear_right" ;
VAL_ 1431 RSDS_R_ObjRCS_16 0 "Valid_values" ;
VAL_ 1431 RSDS_R_ObjYawrate_16 0 "Valid_values" 4446 "Reserved" ;
VAL_ 1431 RSDS_R_ObjHeading_16 0 "Valid_values" 4446 "Reserved" ;
VAL_ 1431 RSDS_R_ObjLength_16 0 "Valid_values" 401 "Reserved" ;
VAL_ 1431 RSDS_R_SGU8_Checksum8 0 "Valid_value" ;
VAL_ 1431 RSDS_R_SGU8_RollingCounter7 0 "Valid_value" 15 "Invalid_value" ;
VAL_ 1431 RSDS_R_ObjMotionDirection_16 0 "Init" 1 "Inverse_direction" 2 "Same__direction" 3 "cross" 4 "reserved" 5 "reserved" 6 "reserved" 7 "reserved" ;
VAL_ 1431 RSDS_R_ObjAge_16 0 "Valid_values" ;
VAL_ 1431 RSDS_R_ObjWidth_16 0 "Valid_values" 501 "Reserved" ;
VAL_ 1431 RSDS_R_ObjRAccelYStd_16 0 "Valid_values" ;
VAL_ 1431 RSDS_R_ObjRAccelXStd_16 0 "Valid_values" ;
VAL_ 1431 RSDS_R_ObjRelVelYStd_16 0 "Valid_values" ;
VAL_ 1431 RSDS_R_ObjRelVelXStd_16 0 "Valid_values" ;
VAL_ 1431 RSDS_R_ObjDistYStd_16 0 "Valid_values" ;
VAL_ 1431 RSDS_R_SGU8_Checksum7 0 "Valid_value" ;
VAL_ 1431 RSDS_R_SGU8_RollingCounter6 0 "Valid_value" 15 "Invalid_value" ;
VAL_ 1431 RSDS_R_ObjMotionType_16 0 "int" 1 "unknown" 2 "Drive" 3 "Stopped" 4 "Stand" 5 "reserved" 6 "reserved" 7 "reserved" ;
VAL_ 1431 RSDS_R_ObjMeasured_16 0 "Init" 1 "Measured" 2 "Predicted" 3 "Reserved" ;
VAL_ 1431 RSDS_R_ObjRelAccelY_16 0 "Valid_values" ;
VAL_ 1431 RSDS_R_ObjRelAccelX_16 0 "Valid_values" ;
VAL_ 1431 RSDS_R_ObjRelVelY_16 0 "Valid_values" 8174 "Reserved" ;
VAL_ 1431 RSDS_R_ObjRelVelX_16 0 "Valid_values" 8174 "Reserved" ;
VAL_ 1431 RSDS_R_SGU8_Checksum6 0 "Valid_value" ;
VAL_ 1431 RSDS_R_SGU8_RollingCounter5 0 "Valid_value" 15 "Invalid_value" ;
VAL_ 1431 RSDS_R_ObjType_16 0 "Unknown" 1 "Truck" 2 "Car" 3 "Pedestrian" 4 "Cyclist" 5 "Reserved" ;
VAL_ 1431 RSDS_R_ObjDistXStd_16 0 "Valid_values" ;
VAL_ 1431 RSDS_R_ObjDistY_16 0 "Valid_values" ;
VAL_ 1431 RSDS_R_ObjDistX_16 0 "Valid_values" 4080 "Reserved" ;
VAL_ 1431 RSDS_R_ObjObstacleProb_16 0 "Valid_values" ;
VAL_ 1431 RSDS_R_ObjExistProb_16 0 "Valid_values" ;
VAL_ 1431 RSDS_R_ObjID_16 0 "Valid_values" ;
VAL_ 1431 RSDS_R_SGU8_Checksum5 0 "Valid_value" ;
VAL_ 1431 RSDS_R_SGU8_RollingCounter4 0 "Valid_value" 15 "Invalid_value" ;
VAL_ 1431 RSDS_R_HWATargetValidity_15 0 "NOT_HWA_Target" 1 "HWA_Target" ;
VAL_ 1431 RSDS_R_ObjRefPoint_15 0 "Rear" 1 "Rear_left" 2 "Left" 3 "Front_left" 4 "Front" 5 "Front_Right" 6 "Right" 7 "Rear_right" ;
VAL_ 1431 RSDS_R_ObjRCS_15 0 "Valid_values" ;
VAL_ 1431 RSDS_R_ObjYawrate_15 0 "Valid_values" 4446 "Reserved" ;
VAL_ 1431 RSDS_R_ObjHeading_15 0 "Valid_values" 4446 "Reserved" ;
VAL_ 1431 RSDS_R_ObjLength_15 0 "Valid_values" 401 "Reserved" ;
VAL_ 1431 RSDS_R_SGU8_Checksum4 0 "Valid_value" ;
VAL_ 1431 RSDS_R_SGU8_RollingCounter3 0 "Valid_value" 15 "Invalid_value" ;
VAL_ 1431 RSDS_R_ObjMotionDirection_15 0 "Init" 1 "Inverse_direction" 2 "Same__direction" 3 "cross" 4 "reserved" 5 "reserved" 6 "reserved" 7 "reserved" ;
VAL_ 1431 RSDS_R_ObjAge_15 0 "Valid_values" ;
VAL_ 1431 RSDS_R_ObjWidth_15 0 "Valid_values" 501 "Reserved" ;
VAL_ 1431 RSDS_R_ObjRAccelYStd_15 0 "Valid_values" ;
VAL_ 1431 RSDS_R_ObjRAccelXStd_15 0 "Valid_values" ;
VAL_ 1431 RSDS_R_ObjRelVelYStd_15 0 "Valid_values" ;
VAL_ 1431 RSDS_R_ObjRelVelXStd_15 0 "Valid_values" ;
VAL_ 1431 RSDS_R_ObjDistYStd_15 0 "Valid_values" ;
VAL_ 1431 RSDS_R_SGU8_Checksum3 0 "Valid_value" ;
VAL_ 1431 RSDS_R_SGU8_RollingCounter2 0 "Valid_value" 15 "Invalid_value" ;
VAL_ 1431 RSDS_R_ObjMotionType_15 0 "int" 1 "unknown" 2 "Drive" 3 "Stopped" 4 "Stand" 5 "reserved" 6 "reserved" 7 "reserved" ;
VAL_ 1431 RSDS_R_ObjMeasured_15 0 "Init" 1 "Measured" 2 "Predicted" 3 "Reserved" ;
VAL_ 1431 RSDS_R_ObjRelAccelY_15 0 "Valid_values" ;
VAL_ 1431 RSDS_R_ObjRelAccelX_15 0 "Valid_values" ;
VAL_ 1431 RSDS_R_ObjRelVelY_15 0 "Valid_values" 8174 "Reserved" ;
VAL_ 1431 RSDS_R_ObjRelVelX_15 0 "Valid_values" 8174 "Reserved" ;
VAL_ 1431 RSDS_R_SGU8_Checksum2 0 "Valid_value" ;
VAL_ 1431 RSDS_R_SGU8_RollingCounter1 0 "Valid_value" 15 "Invalid_value" ;
VAL_ 1431 RSDS_R_ObjType_15 0 "Unknown" 1 "Truck" 2 "Car" 3 "Pedestrian" 4 "Cyclist" 5 "Reserved" ;
VAL_ 1431 RSDS_R_ObjDistXStd_15 0 "Valid_values" ;
VAL_ 1431 RSDS_R_ObjDistY_15 0 "Valid_values" ;
VAL_ 1431 RSDS_R_ObjDistX_15 0 "Valid_values" 4080 "Reserved" ;
VAL_ 1431 RSDS_R_ObjObstacleProb_15 0 "Valid_values" ;
VAL_ 1431 RSDS_R_ObjExistProb_15 0 "Valid_values" ;
VAL_ 1431 RSDS_R_ObjID_15 0 "Valid_values" ;
VAL_ 1431 RSDS_R_SGU8_Checksum1 0 "Valid_value" ;
VAL_ 1432 RSDS_R_SGU9_RollingCounter8 15 "InValid_value" ;
VAL_ 1432 RSDS_R_HWATargetValidity_18 0 "NOT_HWA_Target" 1 "HWA_Target" ;
VAL_ 1432 RSDS_R_ObjRefPoint_18 0 "Rear" 1 "Rear_left" 2 "Left" 3 "Front_left" 4 "Front" 5 "Front_Right" 6 "Right" 7 "Rear_right" ;
VAL_ 1432 RSDS_R_SGU9_RollingCounter7 15 "InValid_value" ;
VAL_ 1432 RSDS_R_ObjMotionDirection_18 0 "Initial_Value" 1 "Inverse_direction" 2 "Same_direction" 3 "Cross" ;
VAL_ 1432 RSDS_R_SGU9_RollingCounter6 15 "InValid_value" ;
VAL_ 1432 RSDS_R_ObjMotionType_18 0 "Initial_Value" 1 "Unknown" 2 "Drive" 3 "Stopped" 4 "Stand" ;
VAL_ 1432 RSDS_R_ObjMeasured_18 0 "Initial_Value" 1 "Measured" 2 "Predicted" ;
VAL_ 1432 RSDS_R_SGU9_RollingCounter5 15 "InValid_value" ;
VAL_ 1432 RSDS_R_ObjType_18 0 "Unknown" 1 "Truck" 2 "Car" 3 "Pedestrian" 4 "Cyclist" ;
VAL_ 1432 RSDS_R_SGU9_RollingCounter4 15 "InValid_value" ;
VAL_ 1432 RSDS_R_HWATargetValidity_17 0 "NOT_HWA_Target" 1 "HWA_Target" ;
VAL_ 1432 RSDS_R_ObjRefPoint_17 0 "Rear" 1 "Rear_left" 2 "Left" 3 "Front_left" 4 "Front" 5 "Front_Right" 6 "Right" 7 "Rear_right" ;
VAL_ 1432 RSDS_R_SGU9_RollingCounter3 15 "InValid_value" ;
VAL_ 1432 RSDS_R_ObjMotionDirection_17 0 "Initial_Value" 1 "Inverse_direction" 2 "Same_direction" 3 "Cross" ;
VAL_ 1432 RSDS_R_SGU9_RollingCounter2 15 "InValid_value" ;
VAL_ 1432 RSDS_R_ObjMotionType_17 0 "Initial_Value" 1 "Unknown" 2 "Drive" 3 "Stopped" 4 "Stand" ;
VAL_ 1432 RSDS_R_ObjMeasured_17 0 "Initial_Value" 1 "Measured" 2 "Predicted" ;
VAL_ 1432 RSDS_R_SGU9_RollingCounter1 15 "InValid_value" ;
VAL_ 1432 RSDS_R_ObjType_17 0 "Unknown" 1 "Truck" 2 "Car" 3 "Pedestrian" 4 "Cyclist" ;
VAL_ 1433 RSDS_R_SGU10_RollingCounter8 15 "InValid_value" ;
VAL_ 1433 RSDS_R_HWATargetValidity_20 0 "NOT_HWA_Target" 1 "HWA_Target" ;
VAL_ 1433 RSDS_R_ObjRefPoint_20 0 "Rear" 1 "Rear_left" 2 "Left" 3 "Front_left" 4 "Front" 5 "Front_Right" 6 "Right" 7 "Rear_right" ;
VAL_ 1433 RSDS_R_SGU10_RollingCounter7 15 "InValid_value" ;
VAL_ 1433 RSDS_R_ObjMotionDirection_20 0 "Initial_Value" 1 "Inverse_direction" 2 "Same_direction" 3 "Cross" ;
VAL_ 1433 RSDS_R_SGU10_RollingCounter6 15 "InValid_value" ;
VAL_ 1433 RSDS_R_ObjMotionType_20 0 "Initial_Value" 1 "Unknown" 2 "Drive" 3 "Stopped" 4 "Stand" ;
VAL_ 1433 RSDS_R_ObjMeasured_20 0 "Initial_Value" 1 "Measured" 2 "Predicted" ;
VAL_ 1433 RSDS_R_SGU10_RollingCounter5 15 "InValid_value" ;
VAL_ 1433 RSDS_R_ObjType_20 0 "Unknown" 1 "Truck" 2 "Car" 3 "Pedestrian" 4 "Cyclist" ;
VAL_ 1433 RSDS_R_SGU10_RollingCounter4 15 "InValid_value" ;
VAL_ 1433 RSDS_R_HWATargetValidity_19 0 "NOT_HWA_Target" 1 "HWA_Target" ;
VAL_ 1433 RSDS_R_ObjRefPoint_19 0 "Rear" 1 "Rear_left" 2 "Left" 3 "Front_left" 4 "Front" 5 "Front_Right" 6 "Right" 7 "Rear_right" ;
VAL_ 1433 RSDS_R_SGU10_RollingCounter3 15 "InValid_value" ;
VAL_ 1433 RSDS_R_ObjMotionDirection_19 0 "Initial_Value" 1 "Inverse_direction" 2 "Same_direction" 3 "Cross" ;
VAL_ 1433 RSDS_R_SGU10_RollingCounter2 15 "InValid_value" ;
VAL_ 1433 RSDS_R_ObjMotionType_19 0 "Initial_Value" 1 "Unknown" 2 "Drive" 3 "Stopped" 4 "Stand" ;
VAL_ 1433 RSDS_R_ObjMeasured_19 0 "Initial_Value" 1 "Measured" 2 "Predicted" ;
VAL_ 1433 RSDS_R_SGU10_RollingCounter1 15 "InValid_value" ;
VAL_ 1433 RSDS_R_ObjType_19 0 "Unknown" 1 "Truck" 2 "Car" 3 "Pedestrian" 4 "Cyclist" ;
VAL_ 1434 RSDS_R_SGU11_RollingCounter8 15 "InValid_value" ;
VAL_ 1434 RSDS_R_HWATargetValidity_22 0 "NOT_HWA_Target" 1 "HWA_Target" ;
VAL_ 1434 RSDS_R_ObjRefPoint_22 0 "Rear" 1 "Rear_left" 2 "Left" 3 "Front_left" 4 "Front" 5 "Front_Right" 6 "Right" 7 "Rear_right" ;
VAL_ 1434 RSDS_R_SGU11_RollingCounter7 15 "InValid_value" ;
VAL_ 1434 RSDS_R_ObjMotionDirection_22 0 "Initial_Value" 1 "Inverse_direction" 2 "Same_direction" 3 "Cross" ;
VAL_ 1434 RSDS_R_SGU11_RollingCounter6 15 "InValid_value" ;
VAL_ 1434 RSDS_R_ObjMotionType_22 0 "Initial_Value" 1 "Unknown" 2 "Drive" 3 "Stopped" 4 "Stand" ;
VAL_ 1434 RSDS_R_ObjMeasured_22 0 "Initial_Value" 1 "Measured" 2 "Predicted" ;
VAL_ 1434 RSDS_R_SGU11_RollingCounter5 15 "InValid_value" ;
VAL_ 1434 RSDS_R_ObjType_22 0 "Unknown" 1 "Truck" 2 "Car" 3 "Pedestrian" 4 "Cyclist" ;
VAL_ 1434 RSDS_R_SGU11_RollingCounter4 15 "InValid_value" ;
VAL_ 1434 RSDS_R_HWATargetValidity_21 0 "NOT_HWA_Target" 1 "HWA_Target" ;
VAL_ 1434 RSDS_R_ObjRefPoint_21 0 "Rear" 1 "Rear_left" 2 "Left" 3 "Front_left" 4 "Front" 5 "Front_Right" 6 "Right" 7 "Rear_right" ;
VAL_ 1434 RSDS_R_SGU11_RollingCounter3 15 "InValid_value" ;
VAL_ 1434 RSDS_R_ObjMotionDirection_21 0 "Initial_Value" 1 "Inverse_direction" 2 "Same_direction" 3 "Cross" ;
VAL_ 1434 RSDS_R_SGU11_RollingCounter2 15 "InValid_value" ;
VAL_ 1434 RSDS_R_ObjMotionType_21 0 "Initial_Value" 1 "Unknown" 2 "Drive" 3 "Stopped" 4 "Stand" ;
VAL_ 1434 RSDS_R_ObjMeasured_21 0 "Initial_Value" 1 "Measured" 2 "Predicted" ;
VAL_ 1434 RSDS_R_SGU11_RollingCounter1 15 "InValid_value" ;
VAL_ 1434 RSDS_R_ObjType_21 0 "Unknown" 1 "Truck" 2 "Car" 3 "Pedestrian" 4 "Cyclist" ;
VAL_ 1435 RSDS_R_SGU12_RollingCounter8 15 "InValid_value" ;
VAL_ 1435 RSDS_R_HWATargetValidity_24 0 "NOT_HWA_Target" 1 "HWA_Target" ;
VAL_ 1435 RSDS_R_ObjRefPoint_24 0 "Rear" 1 "Rear_left" 2 "Left" 3 "Front_left" 4 "Front" 5 "Front_Right" 6 "Right" 7 "Rear_right" ;
VAL_ 1435 RSDS_R_SGU12_RollingCounter7 15 "InValid_value" ;
VAL_ 1435 RSDS_R_ObjMotionDirection_24 0 "Initial_Value" 1 "Inverse_direction" 2 "Same_direction" 3 "Cross" ;
VAL_ 1435 RSDS_R_SGU12_RollingCounter6 15 "InValid_value" ;
VAL_ 1435 RSDS_R_ObjMotionType_24 0 "Initial_Value" 1 "Unknown" 2 "Drive" 3 "Stopped" 4 "Stand" ;
VAL_ 1435 RSDS_R_ObjMeasured_24 0 "Initial_Value" 1 "Measured" 2 "Predicted" ;
VAL_ 1435 RSDS_R_SGU12_RollingCounter5 15 "InValid_value" ;
VAL_ 1435 RSDS_R_ObjType_24 0 "Unknown" 1 "Truck" 2 "Car" 3 "Pedestrian" 4 "Cyclist" ;
VAL_ 1435 RSDS_R_SGU12_RollingCounter4 15 "InValid_value" ;
VAL_ 1435 RSDS_R_HWATargetValidity_23 0 "NOT_HWA_Target" 1 "HWA_Target" ;
VAL_ 1435 RSDS_R_ObjRefPoint_23 0 "Rear" 1 "Rear_left" 2 "Left" 3 "Front_left" 4 "Front" 5 "Front_Right" 6 "Right" 7 "Rear_right" ;
VAL_ 1435 RSDS_R_SGU12_RollingCounter3 15 "InValid_value" ;
VAL_ 1435 RSDS_R_ObjMotionDirection_23 0 "Initial_Value" 1 "Inverse_direction" 2 "Same_direction" 3 "Cross" ;
VAL_ 1435 RSDS_R_SGU12_RollingCounter2 15 "InValid_value" ;
VAL_ 1435 RSDS_R_ObjMotionType_23 0 "Initial_Value" 1 "Unknown" 2 "Drive" 3 "Stopped" 4 "Stand" ;
VAL_ 1435 RSDS_R_ObjMeasured_23 0 "Initial_Value" 1 "Measured" 2 "Predicted" ;
VAL_ 1435 RSDS_R_SGU12_RollingCounter1 15 "InValid_value" ;
VAL_ 1435 RSDS_R_ObjType_23 0 "Unknown" 1 "Truck" 2 "Car" 3 "Pedestrian" 4 "Cyclist" ;
VAL_ 1436 RSDS_R_SGU13_RollingCounter8 15 "InValid_value" ;
VAL_ 1436 RSDS_R_HWATargetValidity_26 0 "NOT_HWA_Target" 1 "HWA_Target" ;
VAL_ 1436 RSDS_R_ObjRefPoint_26 0 "Rear" 1 "Rear_left" 2 "Left" 3 "Front_left" 4 "Front" 5 "Front_Right" 6 "Right" 7 "Rear_right" ;
VAL_ 1436 RSDS_R_SGU13_RollingCounter7 15 "InValid_value" ;
VAL_ 1436 RSDS_R_ObjMotionDirection_26 0 "Initial_Value" 1 "Inverse_direction" 2 "Same_direction" 3 "Cross" ;
VAL_ 1436 RSDS_R_SGU13_RollingCounter6 15 "InValid_value" ;
VAL_ 1436 RSDS_R_ObjMotionType_26 0 "Initial_Value" 1 "Unknown" 2 "Drive" 3 "Stopped" 4 "Stand" ;
VAL_ 1436 RSDS_R_ObjMeasured_26 0 "Initial_Value" 1 "Measured" 2 "Predicted" ;
VAL_ 1436 RSDS_R_SGU13_RollingCounter5 15 "InValid_value" ;
VAL_ 1436 RSDS_R_ObjType_26 0 "Unknown" 1 "Truck" 2 "Car" 3 "Pedestrian" 4 "Cyclist" ;
VAL_ 1436 RSDS_R_SGU13_RollingCounter4 15 "InValid_value" ;
VAL_ 1436 RSDS_R_HWATargetValidity_25 0 "NOT_HWA_Target" 1 "HWA_Target" ;
VAL_ 1436 RSDS_R_ObjRefPoint_25 0 "Rear" 1 "Rear_left" 2 "Left" 3 "Front_left" 4 "Front" 5 "Front_Right" 6 "Right" 7 "Rear_right" ;
VAL_ 1436 RSDS_R_SGU13_RollingCounter3 15 "InValid_value" ;
VAL_ 1436 RSDS_R_ObjMotionDirection_25 0 "Initial_Value" 1 "Inverse_direction" 2 "Same_direction" 3 "Cross" ;
VAL_ 1436 RSDS_R_SGU13_RollingCounter2 15 "InValid_value" ;
VAL_ 1436 RSDS_R_ObjMotionType_25 0 "Initial_Value" 1 "Unknown" 2 "Drive" 3 "Stopped" 4 "Stand" ;
VAL_ 1436 RSDS_R_ObjMeasured_25 0 "Initial_Value" 1 "Measured" 2 "Predicted" ;
VAL_ 1436 RSDS_R_SGU13_RollingCounter1 15 "InValid_value" ;
VAL_ 1436 RSDS_R_ObjType_25 0 "Unknown" 1 "Truck" 2 "Car" 3 "Pedestrian" 4 "Cyclist" ;
VAL_ 1437 RSDS_R_SGU14_RollingCounter8 15 "InValid_value" ;
VAL_ 1437 RSDS_R_HWATargetValidity_28 0 "NOT_HWA_Target" 1 "HWA_Target" ;
VAL_ 1437 RSDS_R_ObjRefPoint_28 0 "Rear" 1 "Rear_left" 2 "Left" 3 "Front_left" 4 "Front" 5 "Front_Right" 6 "Right" 7 "Rear_right" ;
VAL_ 1437 RSDS_R_SGU14_RollingCounter7 15 "InValid_value" ;
VAL_ 1437 RSDS_R_ObjMotionDirection_28 0 "Initial_Value" 1 "Inverse_direction" 2 "Same_direction" 3 "Cross" ;
VAL_ 1437 RSDS_R_SGU14_RollingCounter6 15 "InValid_value" ;
VAL_ 1437 RSDS_R_ObjMotionType_28 0 "Initial_Value" 1 "Unknown" 2 "Drive" 3 "Stopped" 4 "Stand" ;
VAL_ 1437 RSDS_R_ObjMeasured_28 0 "Initial_Value" 1 "Measured" 2 "Predicted" ;
VAL_ 1437 RSDS_R_SGU14_RollingCounter5 15 "InValid_value" ;
VAL_ 1437 RSDS_R_ObjType_28 0 "Unknown" 1 "Truck" 2 "Car" 3 "Pedestrian" 4 "Cyclist" ;
VAL_ 1437 RSDS_R_SGU14_RollingCounter4 15 "InValid_value" ;
VAL_ 1437 RSDS_R_HWATargetValidity_27 0 "NOT_HWA_Target" 1 "HWA_Target" ;
VAL_ 1437 RSDS_R_ObjRefPoint_27 0 "Rear" 1 "Rear_left" 2 "Left" 3 "Front_left" 4 "Front" 5 "Front_Right" 6 "Right" 7 "Rear_right" ;
VAL_ 1437 RSDS_R_SGU14_RollingCounter3 15 "InValid_value" ;
VAL_ 1437 RSDS_R_ObjMotionDirection_27 0 "Initial_Value" 1 "Inverse_direction" 2 "Same_direction" 3 "Cross" ;
VAL_ 1437 RSDS_R_SGU14_RollingCounter2 15 "InValid_value" ;
VAL_ 1437 RSDS_R_ObjMotionType_27 0 "Initial_Value" 1 "Unknown" 2 "Drive" 3 "Stopped" 4 "Stand" ;
VAL_ 1437 RSDS_R_ObjMeasured_27 0 "Initial_Value" 1 "Measured" 2 "Predicted" ;
VAL_ 1437 RSDS_R_SGU14_RollingCounter1 15 "InValid_value" ;
VAL_ 1437 RSDS_R_ObjType_27 0 "Unknown" 1 "Truck" 2 "Car" 3 "Pedestrian" 4 "Cyclist" ;
VAL_ 1438 RSDS_R_SGU15_RollingCounter8 15 "InValid_value" ;
VAL_ 1438 RSDS_R_HWATargetValidity_30 0 "NOT_HWA_Target" 1 "HWA_Target" ;
VAL_ 1438 RSDS_R_ObjRefPoint_30 0 "Rear" 1 "Rear_left" 2 "Left" 3 "Front_left" 4 "Front" 5 "Front_Right" 6 "Right" 7 "Rear_right" ;
VAL_ 1438 RSDS_R_SGU15_RollingCounter7 15 "InValid_value" ;
VAL_ 1438 RSDS_R_ObjMotionDirection_30 0 "Initial_Value" 1 "Inverse_direction" 2 "Same_direction" 3 "Cross" ;
VAL_ 1438 RSDS_R_SGU15_RollingCounter6 15 "InValid_value" ;
VAL_ 1438 RSDS_R_ObjMotionType_30 0 "Initial_Value" 1 "Unknown" 2 "Drive" 3 "Stopped" 4 "Stand" ;
VAL_ 1438 RSDS_R_ObjMeasured_30 0 "Initial_Value" 1 "Measured" 2 "Predicted" ;
VAL_ 1438 RSDS_R_SGU15_RollingCounter5 15 "InValid_value" ;
VAL_ 1438 RSDS_R_ObjType_30 0 "Unknown" 1 "Truck" 2 "Car" 3 "Pedestrian" 4 "Cyclist" ;
VAL_ 1438 RSDS_R_SGU15_RollingCounter4 15 "InValid_value" ;
VAL_ 1438 RSDS_R_HWATargetValidity_29 0 "NOT_HWA_Target" 1 "HWA_Target" ;
VAL_ 1438 RSDS_R_ObjRefPoint_29 0 "Rear" 1 "Rear_left" 2 "Left" 3 "Front_left" 4 "Front" 5 "Front_Right" 6 "Right" 7 "Rear_right" ;
VAL_ 1438 RSDS_R_SGU15_RollingCounter3 15 "InValid_value" ;
VAL_ 1438 RSDS_R_ObjMotionDirection_29 0 "Initial_Value" 1 "Inverse_direction" 2 "Same_direction" 3 "Cross" ;
VAL_ 1438 RSDS_R_SGU15_RollingCounter2 15 "InValid_value" ;
VAL_ 1438 RSDS_R_ObjMotionType_29 0 "Initial_Value" 1 "Unknown" 2 "Drive" 3 "Stopped" 4 "Stand" ;
VAL_ 1438 RSDS_R_ObjMeasured_29 0 "Initial_Value" 1 "Measured" 2 "Predicted" ;
VAL_ 1438 RSDS_R_SGU15_RollingCounter1 15 "InValid_value" ;
VAL_ 1438 RSDS_R_ObjType_29 0 "Unknown" 1 "Truck" 2 "Car" 3 "Pedestrian" 4 "Cyclist" ;
VAL_ 1439 RSDS_R_SGU16_RollingCounter8 15 "InValid_value" ;
VAL_ 1439 RSDS_R_HWATargetValidity_32 0 "NOT_HWA_Target" 1 "HWA_Target" ;
VAL_ 1439 RSDS_R_ObjRefPoint_32 0 "Rear" 1 "Rear_left" 2 "Left" 3 "Front_left" 4 "Front" 5 "Front_Right" 6 "Right" 7 "Rear_right" ;
VAL_ 1439 RSDS_R_SGU16_RollingCounter7 15 "InValid_value" ;
VAL_ 1439 RSDS_R_ObjMotionDirection_32 0 "Initial_Value" 1 "Inverse_direction" 2 "Same_direction" 3 "Cross" ;
VAL_ 1439 RSDS_R_SGU16_RollingCounter6 15 "InValid_value" ;
VAL_ 1439 RSDS_R_ObjMotionType_32 0 "Initial_Value" 1 "Unknown" 2 "Drive" 3 "Stopped" 4 "Stand" ;
VAL_ 1439 RSDS_R_ObjMeasured_32 0 "Initial_Value" 1 "Measured" 2 "Predicted" ;
VAL_ 1439 RSDS_R_SGU16_RollingCounter5 15 "InValid_value" ;
VAL_ 1439 RSDS_R_ObjType_32 0 "Unknown" 1 "Truck" 2 "Car" 3 "Pedestrian" 4 "Cyclist" ;
VAL_ 1439 RSDS_R_SGU16_RollingCounter4 15 "InValid_value" ;
VAL_ 1439 RSDS_R_HWATargetValidity_31 0 "NOT_HWA_Target" 1 "HWA_Target" ;
VAL_ 1439 RSDS_R_ObjRefPoint_31 0 "Rear" 1 "Rear_left" 2 "Left" 3 "Front_left" 4 "Front" 5 "Front_Right" 6 "Right" 7 "Rear_right" ;
VAL_ 1439 RSDS_R_SGU16_RollingCounter3 15 "InValid_value" ;
VAL_ 1439 RSDS_R_ObjMotionDirection_31 0 "Initial_Value" 1 "Inverse_direction" 2 "Same_direction" 3 "Cross" ;
VAL_ 1439 RSDS_R_SGU16_RollingCounter2 15 "InValid_value" ;
VAL_ 1439 RSDS_R_ObjMotionType_31 0 "Initial_Value" 1 "Unknown" 2 "Drive" 3 "Stopped" 4 "Stand" ;
VAL_ 1439 RSDS_R_ObjMeasured_31 0 "Initial_Value" 1 "Measured" 2 "Predicted" ;
VAL_ 1439 RSDS_R_SGU16_RollingCounter1 15 "InValid_value" ;
VAL_ 1439 RSDS_R_ObjType_31 0 "Unknown" 1 "Truck" 2 "Car" 3 "Pedestrian" 4 "Cyclist" ;
VAL_ 1487 RSDS_R_SGU_HEAD_RollingCounter4 0 "Valid_value" 15 "Invalid_value" ;
VAL_ 1487 RSDS_R_SGU_HEAD_BlockCounter 0 "Valid_values" ;
VAL_ 1487 RSDS_R_ObjAziAngleCalib 0 "Valid_values" ;
VAL_ 1487 RSDS_R_Guardrail_dxStart 0 "Valid_values" 32001 "Reserved" ;
VAL_ 1487 RSDS_R_GuardrailC3 0 "Valid_values" 800001 "Reserved" ;
VAL_ 1487 RSDS_R_SGU_HEAD_Checksum4 0 "Valid_value" ;
VAL_ 1487 RSDS_R_SGU_HEAD_RollingCounter3 0 "Valid_value" 15 "Invalid_value" ;
VAL_ 1487 RSDS_R_GuardrailC2 0 "Valid_values" 50000 "Reserved" ;
VAL_ 1487 RSDS_R_GuardrailC1 0 "Valid_values" 4446 "Reserved" ;
VAL_ 1487 RSDS_R_GuardrailC0 0 "Valid_values" 6001 "Reserved" ;
VAL_ 1487 RSDS_R_SGU_HEAD_Checksum3 0 "Valid_value" ;
VAL_ 1487 RSDS_R_SGU_HEAD_RollingCounter2 0 "Valid_value" 15 "Invalid_value" ;
VAL_ 1487 RSDS_R_hdr_AutosarTimeStamp 0 "Valid_values" ;
VAL_ 1487 RSDS_R_SGU_HEAD_Checksum2 0 "Valid_value" ;
VAL_ 1487 RSDS_R_SGU_HEAD_RollingCounter1 0 "Valid_value" 15 "Invalid_value" ;
VAL_ 1487 RSDS_R_hdr_ErrorStatus 0 "No_error" 1 "Not_Defined" 2 "misalignment_elevation" 3 "misalignment_azimuth" 4 "temporary_failure" 5 "permanent_failure" 6 "Voltage_error" 7 "Production_mode" 8 "EOL_error" 9 "Calibration_parameter_error" 10 "Reserved" ;
VAL_ 1487 RSDS_R_Guardrail_dxEnd 0 "Valid_values" 32001 "Reserved" ;
VAL_ 1487 RSDS_R_GuardrailConfidence 0 "Valid_values" 101 "Reserved" ;
VAL_ 1487 RSDS_R_ObjDetected 0 "Valid_values" ;
VAL_ 1487 RSDS_R_BLIND 0 "No_Blindness" 1 "Blindness" 2 "Reserved" 3 "Reserved" ;
VAL_ 1487 RSDS_R_hdr_TimeStampStatus 0 "Valid_value" ;
VAL_ 1487 RSDS_R_hdr_TimeStamp 0 "Valid_value" ;
VAL_ 1487 RSDS_R_SGU_HEAD_Checksum1 0 "Valid_value" ;
VAL_ 367 RSDS_ObjRelAccelY_Ri 0 "Valid_values" ;
VAL_ 367 RSDS_ObjRelAccelX_Ri 0 "Valid_values" ;
VAL_ 367 RSDS_ObjRelAccelX_Le 0 "Valid_values" ;
VAL_ 367 RSDS_ObjRAccelYStd_Ri 0 "valid_value" ;
VAL_ 367 RSDS_ObjRAccelXStd_Ri 0 "valid_value" ;
VAL_ 367 RSDS_ObjRelVelYStd_Ri 0 "valid_value" ;
VAL_ 367 RSDS_ObjRelVelXStd_Ri 0 "valid_value" ;
VAL_ 367 RSDS_ObjDistYStd_Ri 0 "valid_value" ;
VAL_ 367 RSDS_ObjDistXStd_Ri 0 "valid_value" ;
VAL_ 367 RSDS_ObjRAccelYStd_Le 0 "valid_value" ;
VAL_ 367 RSDS_ObjRAccelXStd_Le 0 "valid_value" ;
VAL_ 367 RSDS_ObjRelVelYStd_Le 0 "valid_value" ;
VAL_ 367 RSDS_ObjRelVelXStd_Le 0 "valid_value" ;
VAL_ 367 RSDS_ObjDistYStd_Le 0 "valid_value" ;
VAL_ 367 RSDS_ObjDistXStd_Le 0 "valid_value" ;
VAL_ 367 RollingCounter_RSDS_R_5 0 "Valid_value" 15 "Invalid_value" ;
VAL_ 367 ObjTTCRi 0 "Valid_value" ;
VAL_ 367 ObjLatSpdCurvRi 0 "Valid_value" ;
VAL_ 367 ObjLgtSpdCurvRi 0 "Valid_value" ;
VAL_ 367 ObjLatPosnCurvRi 0 "Valid_value" ;
VAL_ 367 ObjLgtPosnCurvRi 0 "Valid_value" ;
VAL_ 367 ObjIDRi 0 "Valid_value" ;
VAL_ 367 RiTarSts 0 "Target_Invalid" 1 "Target_Valid" 2 "No_target" 3 "Reserved" ;
VAL_ 367 Checksum_RSDS_R_5 0 "Valid_value" ;
VAL_ 367 RollingCounter_RSDS_R_4 0 "Valid_value" 15 "Invalid_value" ;
VAL_ 367 ObjStsRi 0 "Invalid" 1 "New" 2 "Mature" 3 "Coasted" ;
VAL_ 367 ZoneIndRi 0 "No_Object_in_the_Zone" 1 "Object_in_BSW_Zone" 2 "Object_in_CVW_Zone" 3 "Object_in_the_Shared_Zone" ;
VAL_ 367 ObjStatyRi 0 "Stationary" 1 "Not_Stationary" ;
VAL_ 367 ObjWidthRi 0 "Valid_value" ;
VAL_ 367 ObjRinRi 0 "Valid_value" ;
VAL_ 367 ObjStsLe 0 "Invalid" 1 "New–¬ƒø±Í" 2 "Mature≥… Ïƒø±Í" 3 "Coastedª¨––µƒ" ;
VAL_ 367 ZoneIndLe 0 "No_Object_in_the_Zone" 1 "Object_in_BSW_Zone" 2 "Object_in_CVW_Zone" 3 "Object_in_the_Shared_Zone" ;
VAL_ 367 ObjStatyLe 0 "Stationary" 1 "Not_Stationary" ;
VAL_ 367 ObjWidthLe 0 "Valid_value" ;
VAL_ 367 ObjLenLe 0 "Valid_value" ;
VAL_ 367 Checksum_RSDS_R_4 0 "Valid_value" ;
VAL_ 367 RollingCounter_RSDS_R_3 0 "Valid_value" 15 "Invalid_value" ;
VAL_ 367 ObjTTCLe 0 "Valid_value" ;
VAL_ 367 ObjLatSpdCurvLe 0 "Valid_value" ;
VAL_ 367 ObjLgtSpdCurvLe 0 "Valid_value" ;
VAL_ 367 ObjLatPosnCurvLe 0 "Valid_value" ;
VAL_ 367 ObjLgtPosnCurvLe 0 "Valid_value" ;
VAL_ 367 ObjIDLe 0 "Valid_value" ;
VAL_ 367 LeTarSts 0 "Target_Invalid" 1 "Target_Valid" 2 "No_target" 3 "Reserved" ;
VAL_ 367 Checksum_RSDS_R_3 0 "Valid_value" ;
VAL_ 367 RollingCounter_RSDS_R_2 0 "Valid_value" 15 "Invalid_value" ;
VAL_ 367 RCTA_warningReqLeft 0 "No_warning" 1 "Warning_level_2" ;
VAL_ 367 RCTA_warningReqRight 0 "No_warning" 1 "Warning_level_2" ;
VAL_ 367 RSDS_CTA_Actv 0 "Not_active" 1 "Active" ;
VAL_ 367 RSDS_RCTABrkResp 0 "OFF" 1 "ON" ;
VAL_ 367 RSDS_RCTAResp 0 "OFF" 1 "ON" ;
VAL_ 367 RSDS_RCWResp 0 "OFF" 1 "ON" ;
VAL_ 367 RSDS_DOWResp 0 "OFF" 1 "ON" ;
VAL_ 367 RSDS_LCAResp 0 "OFF" 1 "ON" ;
VAL_ 367 RSDS_TrailerSts 0 "None" 1 "Trailer" ;
VAL_ 367 RSDS_BliSts 0 "No_Blindness" 1 "Blindness" ;
VAL_ 367 RSDS_BrkgTrig 0 "Not_tirggered" 1 "Triggered" ;
VAL_ 367 RSDS_ErrSts 0 "No_Error" 1 "Error" ;
VAL_ 367 RSDS_RCW_Trigger 0 "No_warning" 1 "RCW_level_1" 2 "RCW_level_2" 3 "Reserved" ;
VAL_ 367 DOW_warningReqleft 0 "No_warning" 1 "Warning_level_1" 2 "Warning_level_2" 3 "Reserved" ;
VAL_ 367 DOW_warningReqRight 0 "No_warning" 1 "Warning_level_1" 2 "Warning_level_2" 3 "Reserved" ;
VAL_ 367 BSD_LCA_warningReqleft 0 "No_warning" 1 "Warning_level_1" 2 "Warning_level_2" 3 "Reserved" ;
VAL_ 367 BSD_LCA_warningReqRight 0 "No_warning" 1 "Warning_level_1" 2 "Warning_level_2" 3 "Reserved" ;
VAL_ 367 RSDS_IPSoundReq 0 "No_warning" 1 "Warning_level_1£®2Hz…˘“Ù£©" 2 "Warning_level_2£®4Hz…˘“Ù£©" 3 "Warning_level_3£®≥£œÏ£©" ;
VAL_ 367 RSDS_LEDLightReqRight 0 "No_warning" 1 "Warning_level_1£®LED_≥£¡¡£©" 2 "Warning_level_2£®LED_2Hz…¡À∏£©" 3 "Warning_level_3£®LED_4Hz…¡À∏£©" ;
VAL_ 367 RSDS_LEDLightReqLeft 0 "No_warning" 1 "Warning_level_1£®LED_≥£¡¡£©" 2 "Warning_level_2£®LED_2Hz…¡À∏£©" 3 "Warning_level_3£®LED_4Hz…¡À∏£©" ;
VAL_ 367 RSDS_BrkgReqVal 0 "Valid_value" ;
VAL_ 367 RSDS_BrkgReq 0 "No_Request" 1 "Request" ;
VAL_ 367 RSDS_Brk_ErrSts 0 "No_error" 1 "Error" ;
VAL_ 367 Checksum_RSDS_R_2 0 "Valid_value" ;
VAL_ 367 RCTB_State 0 "Initial_value" 1 "OFF" 2 "Standby" 3 "Active" 4 "Passive" 5 "Fault" 6 "Hold" 7 "Reserved" ;
VAL_ 367 RCTA_State 0 "Initial_value" 1 "OFF" 2 "Standby" 3 "Active" 4 "Passive" 5 "Fault" 6 "Reserved" ;
VAL_ 367 RCW_State 0 "Initial_value" 1 "OFF" 2 "Standby" 3 "Active" 4 "Passive" 5 "Fault" 6 "Reserved" ;
VAL_ 367 DOW_State 0 "Initial_value" 1 "OFF" 2 "Standby" 3 "Active" 4 "Passive" 5 "Fault" 6 "Reserved" ;
VAL_ 367 LCA_State 0 "Initial_value" 1 "OFF" 2 "Standby" 3 "Active" 4 "Passive" 5 "Fault" 6 "Reserved" ;
VAL_ 367 BSD_State 0 "Initial_value" 1 "OFF" 2 "Standby" 3 "Active" 4 "Passive" 5 "Fault" 6 "Reserved" ;
VAL_ 367 RSDS_ObjRelAccelY_Le 0 "Valid_values" ;
VAL_ 778 RCTB_MidTgt_02_Vy 0 "Initial_value" ;
VAL_ 778 RCW_MidTgt_01_Vy 0 "Initial_value" ;
VAL_ 778 RCTA_RiTgt_02_Vy 0 "Initial_value" ;
VAL_ 778 LCA_RiTgt_01_Vy 0 "Initial_value" ;
VAL_ 778 RCTA_LeTgt_02_Vy 0 "Initial_value" ;
VAL_ 778 LCA_LeTgt_01_Vy 0 "Initial_value" ;
VAL_ 778 RCTB_MidTgt_02_Type 0 "Initial_value" 1 "Unknown" 2 "Pedestrian" 3 "Two_wheelers" 4 "Car" 5 "Truck" ;
VAL_ 778 RCTB_MidTgt_02_Vx 0 "Initial_value" ;
VAL_ 778 RCW_MidTgt_01_Vx 0 "Initial_value" ;
VAL_ 778 RCTA_RiTgt_02_Vx 0 "Initial_value" ;
VAL_ 778 LCA_RiTgt_01_Vx 0 "Initial_value" ;
VAL_ 778 RCTA_LeTgt_02_Vx 0 "Initial_value" ;
VAL_ 778 LCA_LeTgt_01_Vx 0 "Initial_value" ;
VAL_ 778 RCW_MidTgt_01_Type 0 "Initial_value" 1 "Unknown" 2 "Pedestrian" 3 "Two_wheelers" 4 "Car" 5 "Truck" ;
VAL_ 778 RCTA_RiTgt_02_Type 0 "Initial_value" 1 "Unknown" 2 "Pedestrian" 3 "Two_wheelers" 4 "Car" 5 "Truck" ;
VAL_ 778 RSDS_MidTgt_02_dy 0 "Initial_value" 1 "Valid_Value" 502 "Reserved" ;
VAL_ 778 RSDS_MidTgt_02_dx 0 "Initial_value" 1 "Valid_Value" 252 "Reserved" ;
VAL_ 778 LCA_RiTgt_01_Type 0 "Initial_value" 1 "Unknown" 2 "Pedestrian" 3 "Two_wheelers" 4 "Car" 5 "Truck" ;
VAL_ 778 RCTA_LeTgt_02_Type 0 "Initial_value" 1 "Unknown" 2 "Pedestrian" 3 "Two_wheelers" 4 "Car" 5 "Truck" ;
VAL_ 778 RSDS_MidTgt_02 0 "No_target" 1 "target_detected" ;
VAL_ 778 RSDS_MidTgt_01_dy 0 "Valid_Value" 81 "Reserved" ;
VAL_ 778 RSDS_MidTgt_01_dx 0 "Valid_Value" 951 "Reserved" ;
VAL_ 778 RSDS_MidTgt_01 0 "No_target" 1 "target_detected" ;
VAL_ 778 RSDS_RiTgt_02_dy 0 "Initial_value" 1 "Valid_Value" 502 "Reserved" ;
VAL_ 778 RSDS_RiTgt_02_dx 0 "Initial_value" 1 "Valid_Value" 252 "Reserved" ;
VAL_ 778 RSDS_RiTgt_02 0 "No_target" 1 "target_detected" ;
VAL_ 778 RSDS_RiTgt_01_dy 0 "Valid_Value" 81 "Reserved" ;
VAL_ 778 LCA_LeTgt_01_Type 0 "Initial_value" 1 "Unknown" 2 "Pedestrian" 3 "Two_wheelers" 4 "Car" 5 "Truck" ;
VAL_ 778 RSDS_RiTgt_01_dx 0 "Valid_Value" 951 "Reserved" ;
VAL_ 778 RSDS_RiTgt_01 0 "No_target" 1 "target_detected" ;
VAL_ 778 RSDS_LeTgt_02_dy 0 "Initial_value" 1 "Valid_Value" 502 "Reserved" ;
VAL_ 778 RSDS_LeTgt_02_dx 0 "Initial_value" 1 "Valid_Value" 252 "Reserved" ;
VAL_ 778 RSDS_LeTgt_02 0 "No_target" 1 "target_detected" ;
VAL_ 778 RSDS_LeTgt_01_dx 0 "Valid_Value" 951 "Reserved" ;
VAL_ 778 RSDS_LeTgt_01_dy 0 "Valid_Value" 81 "Reserved" ;
VAL_ 778 RSDS_LeTgt_01 0 "No_target" 1 "target_detected" ;
VAL_ 778 RCW_TTC 0 "No_Display" 1 "valid_value" ;
VAL_ 778 BSD_LCA_Right_TTC 0 "No_Display" 1 "valid_value" ;
VAL_ 778 BSD_LCA_Left_TTC 0 "No_Display" 1 "valid_value" ;
VAL_ 778 RCTA_B_TTC 0 "No_Display" 1 "valid_value" ;
