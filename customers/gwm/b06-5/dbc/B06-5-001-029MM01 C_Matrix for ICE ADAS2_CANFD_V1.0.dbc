VERSION ""

NS_ :

BS_:

BU_: IDM CR_RL CR_RR Tester

BO_ 1136 ADAS_AD1: 16 IDM
 SG_ Sync_SyncTime : 39|32@0+ (1,0) [0|4294967295] "" Vector__XXX
 SG_ Sync_OVS : 25|2@0+ (1,0) [0|3] "" Vector__XXX
 SG_ Sync_SGW : 26|1@0+ (1,0) [0|1] "" Vector__XXX
 SG_ Sync_Resd : 31|5@0+ (1,0) [0|31] "" Vector__XXX
 SG_ Sync_Counter : 19|4@0+ (1,0) [0|15] "" Vector__XXX
 SG_ Sync_TimeDomain : 23|4@0+ (1,0) [0|15] "" Vector__XXX
 SG_ Sync_CRC : 15|8@0+ (1,0) [0|255] "" Vector__XXX
 SG_ Sync_Type : 7|8@0+ (1,0) [0|255] "" Vector__XXX

BO_ 1408 RSDS_L_SGU1: 64 CR_RL
 SG_ RSDS_L_SGU1_RollingCounter8 : 507|4@0+ (1,0) [0|15] ""  IDM
 SG_ RSDS_L_SGU1_BlockCounter : 511|4@0+ (1,0) [0|15] ""  IDM
 SG_ RSDS_L_HWATargetValidity_2 : 496|1@0+ (1,0) [0|1] ""  IDM
 SG_ RSDS_L_ObjRefPoint_2 : 499|3@0+ (1,0) [0|8] ""  IDM
 SG_ RSDS_L_ObjRCS_2 : 493|10@0+ (0.125,-50) [-50|70] "dBm2"  IDM
 SG_ RSDS_L_ObjYawrate_2 : 473|12@0+ (0.002,-3.14) [-3.14|3.14] "rad/s"  IDM
 SG_ RSDS_L_ObjHeading_2 : 469|12@0+ (0.002,-3.14) [-3.14|3.14] "rad"  IDM
 SG_ RSDS_L_ObjLength_2 : 463|10@0+ (0.05,0) [0|20] "m"  IDM
 SG_ RSDS_L_SGU1_Checksum8 : 455|8@0+ (1,0) [0|255] ""  IDM
 SG_ RSDS_L_SGU1_RollingCounter7 : 443|4@0+ (1,0) [0|15] ""  IDM
 SG_ RSDS_L_ObjMotionDirection_2 : 447|3@0+ (1,0) [0|7] ""  IDM
 SG_ RSDS_L_ObjAge_2 : 439|8@0+ (1,0) [0|255] ""  IDM
 SG_ RSDS_L_ObjWidth_2 : 417|10@0+ (0.01,0) [0|5] "m"  IDM
 SG_ RSDS_L_ObjRAccelYStd_2 : 423|6@0+ (0.0625,0) [0|3.9375] "mps2"  IDM
 SG_ RSDS_L_ObjRAccelXStd_2 : 413|6@0+ (0.0625,0) [0|3.9375] "mps2"  IDM
 SG_ RSDS_L_ObjRelVelYStd_2 : 403|6@0+ (0.0625,0) [0|3.9375] "mps"  IDM
 SG_ RSDS_L_ObjRelVelXStd_2 : 393|6@0+ (0.0625,0) [0|3.9375] "mps"  IDM
 SG_ RSDS_L_ObjDistYStd_2 : 399|6@0+ (0.1,0) [0|6] "m"  IDM
 SG_ RSDS_L_SGU1_Checksum7 : 391|8@0+ (1,0) [0|255] ""  IDM
 SG_ RSDS_L_SGU1_RollingCounter6 : 379|4@0+ (1,0) [0|15] ""  IDM
 SG_ RSDS_L_ObjMotionType_2 : 383|3@0+ (1,0) [0|7] ""  IDM
 SG_ RSDS_L_ObjMeasured_2 : 369|2@0+ (1,0) [0|3] ""  IDM
 SG_ RSDS_L_ObjRelAccelY_2 : 363|10@0+ (0.03125,-16) [-16|15.96875] "mps2"  IDM
 SG_ RSDS_L_ObjRelAccelX_2 : 357|10@0+ (0.03125,-16) [-16|15.96875] "mps2"  IDM
 SG_ RSDS_L_ObjRelVelY_2 : 338|13@0+ (0.0312,-128) [-128|126.9976] "mps"  IDM
 SG_ RSDS_L_ObjRelVelX_2 : 335|13@0+ (0.0312,-128) [-128|126.9976] "mps"  IDM
 SG_ RSDS_L_SGU1_Checksum6 : 327|8@0+ (1,0) [0|255] ""  IDM
 SG_ RSDS_L_SGU1_RollingCounter5 : 315|4@0+ (1,0) [0|15] ""  IDM
 SG_ RSDS_L_ObjType_2 : 319|4@0+ (1,0) [0|15] ""  IDM
 SG_ RSDS_L_ObjDistXStd_2 : 310|6@0+ (0.1,0) [0|6] "m"  IDM
 SG_ RSDS_L_ObjDistY_2 : 289|11@0+ (0.125,-128) [-128|127.875] "m"  IDM
 SG_ RSDS_L_ObjDistX_2 : 285|12@0+ (0.0625,-128) [-128|127.9375] "m"  IDM
 SG_ RSDS_L_ObjObstacleProb_2 : 274|5@0+ (0.03326,0) [0|1] ""  IDM
 SG_ RSDS_L_ObjExistProb_2 : 279|5@0+ (0.03326,0) [0|1] ""  IDM
 SG_ RSDS_L_ObjID_2 : 271|8@0+ (1,0) [0|255] ""  IDM
 SG_ RSDS_L_SGU1_Checksum5 : 263|8@0+ (1,0) [0|255] ""  IDM
 SG_ RSDS_L_SGU1_RollingCounter4 : 251|4@0+ (1,0) [0|15] ""  IDM
 SG_ RSDS_L_HWATargetValidity_1 : 240|1@0+ (1,0) [0|1] ""  IDM
 SG_ RSDS_L_ObjRefPoint_1 : 243|3@0+ (1,0) [0|8] ""  IDM
 SG_ RSDS_L_ObjRCS_1 : 237|10@0+ (0.125,-50) [-50|70] "dBm2"  IDM
 SG_ RSDS_L_ObjYawrate_1 : 217|12@0+ (0.002,-3.14) [-3.14|3.14] "rad/s"  IDM
 SG_ RSDS_L_ObjHeading_1 : 213|12@0+ (0.002,-3.14) [-3.14|3.14] "rad"  IDM
 SG_ RSDS_L_ObjLength_1 : 207|10@0+ (0.05,0) [0|20] "m"  IDM
 SG_ RSDS_L_SGU1_Checksum4 : 199|8@0+ (1,0) [0|255] ""  IDM
 SG_ RSDS_L_SGU1_RollingCounter3 : 187|4@0+ (1,0) [0|15] ""  IDM
 SG_ RSDS_L_ObjMotionDirection_1 : 191|3@0+ (1,0) [0|7] ""  IDM
 SG_ RSDS_L_ObjAge_1 : 183|8@0+ (1,0) [0|255] ""  IDM
 SG_ RSDS_L_ObjWidth_1 : 161|10@0+ (0.01,0) [0|5] "m"  IDM
 SG_ RSDS_L_ObjRAccelYStd_1 : 167|6@0+ (0.0625,0) [0|3.9375] "mps2"  IDM
 SG_ RSDS_L_ObjRAccelXStd_1 : 157|6@0+ (0.0625,0) [0|3.9375] "mps2"  IDM
 SG_ RSDS_L_ObjRelVelYStd_1 : 147|6@0+ (0.0625,0) [0|3.9375] "mps"  IDM
 SG_ RSDS_L_ObjRelVelXStd_1 : 137|6@0+ (0.0625,0) [0|3.9375] "mps"  IDM
 SG_ RSDS_L_ObjDistYStd_1 : 143|6@0+ (0.1,0) [0|6] "m"  IDM
 SG_ RSDS_L_SGU1_Checksum3 : 135|8@0+ (1,0) [0|255] ""  IDM
 SG_ RSDS_L_SGU1_RollingCounter2 : 123|4@0+ (1,0) [0|15] ""  IDM
 SG_ RSDS_L_ObjMotionType_1 : 127|3@0+ (1,0) [0|7] ""  IDM
 SG_ RSDS_L_ObjMeasured_1 : 113|2@0+ (1,0) [0|3] ""  IDM
 SG_ RSDS_L_ObjRelAccelY_1 : 107|10@0+ (0.03125,-16) [-16|15.96875] "mps2"  IDM
 SG_ RSDS_L_ObjRelAccelX_1 : 101|10@0+ (0.03125,-16) [-16|15.96875] "mps2"  IDM
 SG_ RSDS_L_ObjRelVelY_1 : 82|13@0+ (0.0312,-128) [-128|126.9976] "mps"  IDM
 SG_ RSDS_L_ObjRelVelX_1 : 79|13@0+ (0.0312,-128) [-128|126.9976] "mps"  IDM
 SG_ RSDS_L_SGU1_Checksum2 : 71|8@0+ (1,0) [0|255] ""  IDM
 SG_ RSDS_L_SGU1_RollingCounter1 : 59|4@0+ (1,0) [0|15] ""  IDM
 SG_ RSDS_L_ObjType_1 : 63|4@0+ (1,0) [0|15] ""  IDM
 SG_ RSDS_L_ObjDistXStd_1 : 54|6@0+ (0.1,0) [0|6] "m"  IDM
 SG_ RSDS_L_ObjDistY_1 : 33|11@0+ (0.125,-128) [-128|127.875] "m"  IDM
 SG_ RSDS_L_ObjDistX_1 : 29|12@0+ (0.0625,-128) [-128|127.9375] "m"  IDM
 SG_ RSDS_L_ObjObstacleProb_1 : 18|5@0+ (0.03326,0) [0|1] ""  IDM
 SG_ RSDS_L_ObjExistProb_1 : 23|5@0+ (0.03326,0) [0|1] ""  IDM
 SG_ RSDS_L_ObjID_1 : 15|8@0+ (1,0) [0|255] ""  IDM
 SG_ RSDS_L_SGU1_Checksum1 : 7|8@0+ (1,0) [0|255] ""  IDM

BO_ 1409 RSDS_L_SGU2: 64 CR_RL
 SG_ RSDS_L_SGU2_RollingCounter8 : 507|4@0+ (1,0) [0|15] ""  IDM
 SG_ RSDS_L_SGU2_BlockCounter : 511|4@0+ (1,0) [0|15] ""  IDM
 SG_ RSDS_L_HWATargetValidity_4 : 496|1@0+ (1,0) [0|1] ""  IDM
 SG_ RSDS_L_ObjRefPoint_4 : 499|3@0+ (1,0) [0|8] ""  IDM
 SG_ RSDS_L_ObjRCS_4 : 493|10@0+ (0.125,-50) [-50|70] "dBm2"  IDM
 SG_ RSDS_L_ObjYawrate_4 : 473|12@0+ (0.002,-3.14) [-3.14|3.14] "rad/s"  IDM
 SG_ RSDS_L_ObjHeading_4 : 469|12@0+ (0.002,-3.14) [-3.14|3.14] "rad"  IDM
 SG_ RSDS_L_ObjLength_4 : 463|10@0+ (0.05,0) [0|20] "m"  IDM
 SG_ RSDS_L_SGU2_Checksum8 : 455|8@0+ (1,0) [0|255] ""  IDM
 SG_ RSDS_L_SGU2_RollingCounter7 : 443|4@0+ (1,0) [0|15] ""  IDM
 SG_ RSDS_L_ObjMotionDirection_4 : 447|3@0+ (1,0) [0|7] ""  IDM
 SG_ RSDS_L_ObjAge_4 : 439|8@0+ (1,0) [0|255] ""  IDM
 SG_ RSDS_L_ObjWidth_4 : 417|10@0+ (0.01,0) [0|5] "m"  IDM
 SG_ RSDS_L_ObjRAccelYStd_4 : 423|6@0+ (0.0625,0) [0|3.9375] "mps2"  IDM
 SG_ RSDS_L_ObjRAccelXStd_4 : 413|6@0+ (0.0625,0) [0|3.9375] "mps2"  IDM
 SG_ RSDS_L_ObjRelVelYStd_4 : 403|6@0+ (0.0625,0) [0|3.9375] "mps"  IDM
 SG_ RSDS_L_ObjRelVelXStd_4 : 393|6@0+ (0.0625,0) [0|3.9375] "mps"  IDM
 SG_ RSDS_L_ObjDistYStd_4 : 399|6@0+ (0.1,0) [0|6] "m"  IDM
 SG_ RSDS_L_SGU2_Checksum7 : 391|8@0+ (1,0) [0|255] ""  IDM
 SG_ RSDS_L_SGU2_RollingCounter6 : 379|4@0+ (1,0) [0|15] ""  IDM
 SG_ RSDS_L_ObjMotionType_4 : 383|3@0+ (1,0) [0|7] ""  IDM
 SG_ RSDS_L_ObjMeasured_4 : 369|2@0+ (1,0) [0|3] ""  IDM
 SG_ RSDS_L_ObjRelAccelY_4 : 363|10@0+ (0.03125,-16) [-16|15.96875] "mps2"  IDM
 SG_ RSDS_L_ObjRelAccelX_4 : 357|10@0+ (0.03125,-16) [-16|15.96875] "mps2"  IDM
 SG_ RSDS_L_ObjRelVelY_4 : 338|13@0+ (0.0312,-128) [-128|126.9976] "mps"  IDM
 SG_ RSDS_L_ObjRelVelX_4 : 335|13@0+ (0.0312,-128) [-128|126.9976] "mps"  IDM
 SG_ RSDS_L_SGU2_Checksum6 : 327|8@0+ (1,0) [0|255] ""  IDM
 SG_ RSDS_L_SGU2_RollingCounter5 : 315|4@0+ (1,0) [0|15] ""  IDM
 SG_ RSDS_L_ObjType_4 : 319|4@0+ (1,0) [0|15] ""  IDM
 SG_ RSDS_L_ObjDistXStd_4 : 310|6@0+ (0.1,0) [0|6] "m"  IDM
 SG_ RSDS_L_ObjDistY_4 : 289|11@0+ (0.125,-128) [-128|127.875] "m"  IDM
 SG_ RSDS_L_ObjDistX_4 : 285|12@0+ (0.0625,-128) [-128|127.9375] "m"  IDM
 SG_ RSDS_L_ObjObstacleProb_4 : 274|5@0+ (0.03326,0) [0|1] ""  IDM
 SG_ RSDS_L_ObjExistProb_4 : 279|5@0+ (0.03326,0) [0|1] ""  IDM
 SG_ RSDS_L_ObjID_4 : 271|8@0+ (1,0) [0|255] ""  IDM
 SG_ RSDS_L_SGU2_Checksum5 : 263|8@0+ (1,0) [0|255] ""  IDM
 SG_ RSDS_L_SGU2_RollingCounter4 : 251|4@0+ (1,0) [0|15] ""  IDM
 SG_ RSDS_L_HWATargetValidity_3 : 240|1@0+ (1,0) [0|1] ""  IDM
 SG_ RSDS_L_ObjRefPoint_3 : 243|3@0+ (1,0) [0|8] ""  IDM
 SG_ RSDS_L_ObjRCS_3 : 237|10@0+ (0.125,-50) [-50|70] "dBm2"  IDM
 SG_ RSDS_L_ObjYawrate_3 : 217|12@0+ (0.002,-3.14) [-3.14|3.14] "rad/s"  IDM
 SG_ RSDS_L_ObjHeading_3 : 213|12@0+ (0.002,-3.14) [-3.14|3.14] "rad"  IDM
 SG_ RSDS_L_ObjLength_3 : 207|10@0+ (0.05,0) [0|20] "m"  IDM
 SG_ RSDS_L_SGU2_Checksum4 : 199|8@0+ (1,0) [0|255] ""  IDM
 SG_ RSDS_L_SGU2_RollingCounter3 : 187|4@0+ (1,0) [0|15] ""  IDM
 SG_ RSDS_L_ObjMotionDirection_3 : 191|3@0+ (1,0) [0|7] ""  IDM
 SG_ RSDS_L_ObjAge_3 : 183|8@0+ (1,0) [0|255] ""  IDM
 SG_ RSDS_L_ObjWidth_3 : 161|10@0+ (0.01,0) [0|5] "m"  IDM
 SG_ RSDS_L_ObjRAccelYStd_3 : 167|6@0+ (0.0625,0) [0|3.9375] "mps2"  IDM
 SG_ RSDS_L_ObjRAccelXStd_3 : 157|6@0+ (0.0625,0) [0|3.9375] "mps2"  IDM
 SG_ RSDS_L_ObjRelVelYStd_3 : 147|6@0+ (0.0625,0) [0|3.9375] "mps"  IDM
 SG_ RSDS_L_ObjRelVelXStd_3 : 137|6@0+ (0.0625,0) [0|3.9375] "mps"  IDM
 SG_ RSDS_L_ObjDistYStd_3 : 143|6@0+ (0.1,0) [0|6] "m"  IDM
 SG_ RSDS_L_SGU2_Checksum3 : 135|8@0+ (1,0) [0|255] ""  IDM
 SG_ RSDS_L_SGU2_RollingCounter2 : 123|4@0+ (1,0) [0|15] ""  IDM
 SG_ RSDS_L_ObjMotionType_3 : 127|3@0+ (1,0) [0|7] ""  IDM
 SG_ RSDS_L_ObjMeasured_3 : 113|2@0+ (1,0) [0|3] ""  IDM
 SG_ RSDS_L_ObjRelAccelY_3 : 107|10@0+ (0.03125,-16) [-16|15.96875] "mps2"  IDM
 SG_ RSDS_L_ObjRelAccelX_3 : 101|10@0+ (0.03125,-16) [-16|15.96875] "mps2"  IDM
 SG_ RSDS_L_ObjRelVelY_3 : 82|13@0+ (0.0312,-128) [-128|126.9976] "mps"  IDM
 SG_ RSDS_L_ObjRelVelX_3 : 79|13@0+ (0.0312,-128) [-128|126.9976] "mps"  IDM
 SG_ RSDS_L_SGU2_Checksum2 : 71|8@0+ (1,0) [0|255] ""  IDM
 SG_ RSDS_L_SGU2_RollingCounter1 : 59|4@0+ (1,0) [0|15] ""  IDM
 SG_ RSDS_L_ObjType_3 : 63|4@0+ (1,0) [0|15] ""  IDM
 SG_ RSDS_L_ObjDistXStd_3 : 54|6@0+ (0.1,0) [0|6] "m"  IDM
 SG_ RSDS_L_ObjDistY_3 : 33|11@0+ (0.125,-128) [-128|127.875] "m"  IDM
 SG_ RSDS_L_ObjDistX_3 : 29|12@0+ (0.0625,-128) [-128|127.9375] "m"  IDM
 SG_ RSDS_L_ObjObstacleProb_3 : 18|5@0+ (0.03326,0) [0|1] ""  IDM
 SG_ RSDS_L_ObjExistProb_3 : 23|5@0+ (0.03326,0) [0|1] ""  IDM
 SG_ RSDS_L_ObjID_3 : 15|8@0+ (1,0) [0|255] ""  IDM
 SG_ RSDS_L_SGU2_Checksum1 : 7|8@0+ (1,0) [0|255] ""  IDM

BO_ 1410 RSDS_L_SGU3: 64 CR_RL
 SG_ RSDS_L_SGU3_RollingCounter8 : 507|4@0+ (1,0) [0|15] ""  IDM
 SG_ RSDS_L_SGU3_BlockCounter : 511|4@0+ (1,0) [0|15] ""  IDM
 SG_ RSDS_L_HWATargetValidity_6 : 496|1@0+ (1,0) [0|1] ""  IDM
 SG_ RSDS_L_ObjRefPoint_6 : 499|3@0+ (1,0) [0|8] ""  IDM
 SG_ RSDS_L_ObjRCS_6 : 493|10@0+ (0.125,-50) [-50|70] "dBm2"  IDM
 SG_ RSDS_L_ObjYawrate_6 : 473|12@0+ (0.002,-3.14) [-3.14|3.14] "rad/s"  IDM
 SG_ RSDS_L_ObjHeading_6 : 469|12@0+ (0.002,-3.14) [-3.14|3.14] "rad"  IDM
 SG_ RSDS_L_ObjLength_6 : 463|10@0+ (0.05,0) [0|20] "m"  IDM
 SG_ RSDS_L_SGU3_Checksum8 : 455|8@0+ (1,0) [0|255] ""  IDM
 SG_ RSDS_L_SGU3_RollingCounter7 : 443|4@0+ (1,0) [0|15] ""  IDM
 SG_ RSDS_L_ObjMotionDirection_6 : 447|3@0+ (1,0) [0|7] ""  IDM
 SG_ RSDS_L_ObjAge_6 : 439|8@0+ (1,0) [0|255] ""  IDM
 SG_ RSDS_L_ObjWidth_6 : 417|10@0+ (0.01,0) [0|5] "m"  IDM
 SG_ RSDS_L_ObjRAccelYStd_6 : 423|6@0+ (0.0625,0) [0|3.9375] "mps2"  IDM
 SG_ RSDS_L_ObjRAccelXStd_6 : 413|6@0+ (0.0625,0) [0|3.9375] "mps2"  IDM
 SG_ RSDS_L_ObjRelVelYStd_6 : 403|6@0+ (0.0625,0) [0|3.9375] "mps"  IDM
 SG_ RSDS_L_ObjRelVelXStd_6 : 393|6@0+ (0.0625,0) [0|3.9375] "mps"  IDM
 SG_ RSDS_L_ObjDistYStd_6 : 399|6@0+ (0.1,0) [0|6] "m"  IDM
 SG_ RSDS_L_SGU3_Checksum7 : 391|8@0+ (1,0) [0|255] ""  IDM
 SG_ RSDS_L_SGU3_RollingCounter6 : 379|4@0+ (1,0) [0|15] ""  IDM
 SG_ RSDS_L_ObjMotionType_6 : 383|3@0+ (1,0) [0|7] ""  IDM
 SG_ RSDS_L_ObjMeasured_6 : 369|2@0+ (1,0) [0|3] ""  IDM
 SG_ RSDS_L_ObjRelAccelY_6 : 363|10@0+ (0.03125,-16) [-16|15.96875] "mps2"  IDM
 SG_ RSDS_L_ObjRelAccelX_6 : 357|10@0+ (0.03125,-16) [-16|15.96875] "mps2"  IDM
 SG_ RSDS_L_ObjRelVelY_6 : 338|13@0+ (0.0312,-128) [-128|126.9976] "mps"  IDM
 SG_ RSDS_L_ObjRelVelX_6 : 335|13@0+ (0.0312,-128) [-128|126.9976] "mps"  IDM
 SG_ RSDS_L_SGU3_Checksum6 : 327|8@0+ (1,0) [0|255] ""  IDM
 SG_ RSDS_L_SGU3_RollingCounter5 : 315|4@0+ (1,0) [0|15] ""  IDM
 SG_ RSDS_L_ObjType_6 : 319|4@0+ (1,0) [0|15] ""  IDM
 SG_ RSDS_L_ObjDistXStd_6 : 310|6@0+ (0.1,0) [0|6] "m"  IDM
 SG_ RSDS_L_ObjDistY_6 : 289|11@0+ (0.125,-128) [-128|127.875] "m"  IDM
 SG_ RSDS_L_ObjDistX_6 : 285|12@0+ (0.0625,-128) [-128|127.9375] "m"  IDM
 SG_ RSDS_L_ObjObstacleProb_6 : 274|5@0+ (0.03326,0) [0|1] ""  IDM
 SG_ RSDS_L_ObjExistProb_6 : 279|5@0+ (0.03326,0) [0|1] ""  IDM
 SG_ RSDS_L_ObjID_6 : 271|8@0+ (1,0) [0|255] ""  IDM
 SG_ RSDS_L_SGU3_Checksum5 : 263|8@0+ (1,0) [0|255] ""  IDM
 SG_ RSDS_L_SGU3_RollingCounter4 : 251|4@0+ (1,0) [0|15] ""  IDM
 SG_ RSDS_L_HWATargetValidity_5 : 240|1@0+ (1,0) [0|1] ""  IDM
 SG_ RSDS_L_ObjRefPoint_5 : 243|3@0+ (1,0) [0|8] ""  IDM
 SG_ RSDS_L_ObjRCS_5 : 237|10@0+ (0.125,-50) [-50|70] "dBm2"  IDM
 SG_ RSDS_L_ObjYawrate_5 : 217|12@0+ (0.002,-3.14) [-3.14|3.14] "rad/s"  IDM
 SG_ RSDS_L_ObjHeading_5 : 213|12@0+ (0.002,-3.14) [-3.14|3.14] "rad"  IDM
 SG_ RSDS_L_ObjLength_5 : 207|10@0+ (0.05,0) [0|20] "m"  IDM
 SG_ RSDS_L_SGU3_Checksum4 : 199|8@0+ (1,0) [0|255] ""  IDM
 SG_ RSDS_L_SGU3_RollingCounter3 : 187|4@0+ (1,0) [0|15] ""  IDM
 SG_ RSDS_L_ObjMotionDirection_5 : 191|3@0+ (1,0) [0|7] ""  IDM
 SG_ RSDS_L_ObjAge_5 : 183|8@0+ (1,0) [0|255] ""  IDM
 SG_ RSDS_L_ObjWidth_5 : 161|10@0+ (0.01,0) [0|5] "m"  IDM
 SG_ RSDS_L_ObjRAccelYStd_5 : 167|6@0+ (0.0625,0) [0|3.9375] "mps2"  IDM
 SG_ RSDS_L_ObjRAccelXStd_5 : 157|6@0+ (0.0625,0) [0|3.9375] "mps2"  IDM
 SG_ RSDS_L_ObjRelVelYStd_5 : 147|6@0+ (0.0625,0) [0|3.9375] "mps"  IDM
 SG_ RSDS_L_ObjRelVelXStd_5 : 137|6@0+ (0.0625,0) [0|3.9375] "mps"  IDM
 SG_ RSDS_L_ObjDistYStd_5 : 143|6@0+ (0.1,0) [0|6] "m"  IDM
 SG_ RSDS_L_SGU3_Checksum3 : 135|8@0+ (1,0) [0|255] ""  IDM
 SG_ RSDS_L_SGU3_RollingCounter2 : 123|4@0+ (1,0) [0|15] ""  IDM
 SG_ RSDS_L_ObjMotionType_5 : 127|3@0+ (1,0) [0|7] ""  IDM
 SG_ RSDS_L_ObjMeasured_5 : 113|2@0+ (1,0) [0|3] ""  IDM
 SG_ RSDS_L_ObjRelAccelY_5 : 107|10@0+ (0.03125,-16) [-16|15.96875] "mps2"  IDM
 SG_ RSDS_L_ObjRelAccelX_5 : 101|10@0+ (0.03125,-16) [-16|15.96875] "mps2"  IDM
 SG_ RSDS_L_ObjRelVelY_5 : 82|13@0+ (0.0312,-128) [-128|126.9976] "mps"  IDM
 SG_ RSDS_L_ObjRelVelX_5 : 79|13@0+ (0.0312,-128) [-128|126.9976] "mps"  IDM
 SG_ RSDS_L_SGU3_Checksum2 : 71|8@0+ (1,0) [0|255] ""  IDM
 SG_ RSDS_L_SGU3_RollingCounter1 : 59|4@0+ (1,0) [0|15] ""  IDM
 SG_ RSDS_L_ObjType_5 : 63|4@0+ (1,0) [0|15] ""  IDM
 SG_ RSDS_L_ObjDistXStd_5 : 54|6@0+ (0.1,0) [0|6] "m"  IDM
 SG_ RSDS_L_ObjDistY_5 : 33|11@0+ (0.125,-128) [-128|127.875] "m"  IDM
 SG_ RSDS_L_ObjDistX_5 : 29|12@0+ (0.0625,-128) [-128|127.9375] "m"  IDM
 SG_ RSDS_L_ObjObstacleProb_5 : 18|5@0+ (0.03326,0) [0|1] ""  IDM
 SG_ RSDS_L_ObjExistProb_5 : 23|5@0+ (0.03326,0) [0|1] ""  IDM
 SG_ RSDS_L_ObjID_5 : 15|8@0+ (1,0) [0|255] ""  IDM
 SG_ RSDS_L_SGU3_Checksum1 : 7|8@0+ (1,0) [0|255] ""  IDM

BO_ 1411 RSDS_L_SGU4: 64 CR_RL
 SG_ RSDS_L_SGU4_RollingCounter8 : 507|4@0+ (1,0) [0|15] ""  IDM
 SG_ RSDS_L_SGU4_BlockCounter : 511|4@0+ (1,0) [0|15] ""  IDM
 SG_ RSDS_L_HWATargetValidity_8 : 496|1@0+ (1,0) [0|1] ""  IDM
 SG_ RSDS_L_ObjRefPoint_8 : 499|3@0+ (1,0) [0|8] ""  IDM
 SG_ RSDS_L_ObjRCS_8 : 493|10@0+ (0.125,-50) [-50|70] "dBm2"  IDM
 SG_ RSDS_L_ObjYawrate_8 : 473|12@0+ (0.002,-3.14) [-3.14|3.14] "rad/s"  IDM
 SG_ RSDS_L_ObjHeading_8 : 469|12@0+ (0.002,-3.14) [-3.14|3.14] "rad"  IDM
 SG_ RSDS_L_ObjLength_8 : 463|10@0+ (0.05,0) [0|20] "m"  IDM
 SG_ RSDS_L_SGU4_Checksum8 : 455|8@0+ (1,0) [0|255] ""  IDM
 SG_ RSDS_L_SGU4_RollingCounter7 : 443|4@0+ (1,0) [0|15] ""  IDM
 SG_ RSDS_L_ObjMotionDirection_8 : 447|3@0+ (1,0) [0|7] ""  IDM
 SG_ RSDS_L_ObjAge_8 : 439|8@0+ (1,0) [0|255] ""  IDM
 SG_ RSDS_L_ObjWidth_8 : 417|10@0+ (0.01,0) [0|5] "m"  IDM
 SG_ RSDS_L_ObjRAccelYStd_8 : 423|6@0+ (0.0625,0) [0|3.9375] "mps2"  IDM
 SG_ RSDS_L_ObjRAccelXStd_8 : 413|6@0+ (0.0625,0) [0|3.9375] "mps2"  IDM
 SG_ RSDS_L_ObjRelVelYStd_8 : 403|6@0+ (0.0625,0) [0|3.9375] "mps"  IDM
 SG_ RSDS_L_ObjRelVelXStd_8 : 393|6@0+ (0.0625,0) [0|3.9375] "mps"  IDM
 SG_ RSDS_L_ObjDistYStd_8 : 399|6@0+ (0.1,0) [0|6] "m"  IDM
 SG_ RSDS_L_SGU4_Checksum7 : 391|8@0+ (1,0) [0|255] ""  IDM
 SG_ RSDS_L_SGU4_RollingCounter6 : 379|4@0+ (1,0) [0|15] ""  IDM
 SG_ RSDS_L_ObjMotionType_8 : 383|3@0+ (1,0) [0|7] ""  IDM
 SG_ RSDS_L_ObjMeasured_8 : 369|2@0+ (1,0) [0|3] ""  IDM
 SG_ RSDS_L_ObjRelAccelY_8 : 363|10@0+ (0.03125,-16) [-16|15.96875] "mps2"  IDM
 SG_ RSDS_L_ObjRelAccelX_8 : 357|10@0+ (0.03125,-16) [-16|15.96875] "mps2"  IDM
 SG_ RSDS_L_ObjRelVelY_8 : 338|13@0+ (0.0312,-128) [-128|126.9976] "mps"  IDM
 SG_ RSDS_L_ObjRelVelX_8 : 335|13@0+ (0.0312,-128) [-128|126.9976] "mps"  IDM
 SG_ RSDS_L_SGU4_Checksum6 : 327|8@0+ (1,0) [0|255] ""  IDM
 SG_ RSDS_L_SGU4_RollingCounter5 : 315|4@0+ (1,0) [0|15] ""  IDM
 SG_ RSDS_L_ObjType_8 : 319|4@0+ (1,0) [0|15] ""  IDM
 SG_ RSDS_L_ObjDistXStd_8 : 310|6@0+ (0.1,0) [0|6] "m"  IDM
 SG_ RSDS_L_ObjDistY_8 : 289|11@0+ (0.125,-128) [-128|127.875] "m"  IDM
 SG_ RSDS_L_ObjDistX_8 : 285|12@0+ (0.0625,-128) [-128|127.9375] "m"  IDM
 SG_ RSDS_L_ObjObstacleProb_8 : 274|5@0+ (0.03326,0) [0|1] ""  IDM
 SG_ RSDS_L_ObjExistProb_8 : 279|5@0+ (0.03326,0) [0|1] ""  IDM
 SG_ RSDS_L_ObjID_8 : 271|8@0+ (1,0) [0|255] ""  IDM
 SG_ RSDS_L_SGU4_Checksum5 : 263|8@0+ (1,0) [0|255] ""  IDM
 SG_ RSDS_L_SGU4_RollingCounter4 : 251|4@0+ (1,0) [0|15] ""  IDM
 SG_ RSDS_L_HWATargetValidity_7 : 240|1@0+ (1,0) [0|1] ""  IDM
 SG_ RSDS_L_ObjRefPoint_7 : 243|3@0+ (1,0) [0|8] ""  IDM
 SG_ RSDS_L_ObjRCS_7 : 237|10@0+ (0.125,-50) [-50|70] "dBm2"  IDM
 SG_ RSDS_L_ObjYawrate_7 : 217|12@0+ (0.002,-3.14) [-3.14|3.14] "rad/s"  IDM
 SG_ RSDS_L_ObjHeading_7 : 213|12@0+ (0.002,-3.14) [-3.14|3.14] "rad"  IDM
 SG_ RSDS_L_ObjLength_7 : 207|10@0+ (0.05,0) [0|20] "m"  IDM
 SG_ RSDS_L_SGU4_Checksum4 : 199|8@0+ (1,0) [0|255] ""  IDM
 SG_ RSDS_L_SGU4_RollingCounter3 : 187|4@0+ (1,0) [0|15] ""  IDM
 SG_ RSDS_L_ObjMotionDirection_7 : 191|3@0+ (1,0) [0|7] ""  IDM
 SG_ RSDS_L_ObjAge_7 : 183|8@0+ (1,0) [0|255] ""  IDM
 SG_ RSDS_L_ObjWidth_7 : 161|10@0+ (0.01,0) [0|5] "m"  IDM
 SG_ RSDS_L_ObjRAccelYStd_7 : 167|6@0+ (0.0625,0) [0|3.9375] "mps2"  IDM
 SG_ RSDS_L_ObjRAccelXStd_7 : 157|6@0+ (0.0625,0) [0|3.9375] "mps2"  IDM
 SG_ RSDS_L_ObjRelVelYStd_7 : 147|6@0+ (0.0625,0) [0|3.9375] "mps"  IDM
 SG_ RSDS_L_ObjRelVelXStd_7 : 137|6@0+ (0.0625,0) [0|3.9375] "mps"  IDM
 SG_ RSDS_L_ObjDistYStd_7 : 143|6@0+ (0.1,0) [0|6] "m"  IDM
 SG_ RSDS_L_SGU4_Checksum3 : 135|8@0+ (1,0) [0|255] ""  IDM
 SG_ RSDS_L_SGU4_RollingCounter2 : 123|4@0+ (1,0) [0|15] ""  IDM
 SG_ RSDS_L_ObjMotionType_7 : 127|3@0+ (1,0) [0|7] ""  IDM
 SG_ RSDS_L_ObjMeasured_7 : 113|2@0+ (1,0) [0|3] ""  IDM
 SG_ RSDS_L_ObjRelAccelY_7 : 107|10@0+ (0.03125,-16) [-16|15.96875] "mps2"  IDM
 SG_ RSDS_L_ObjRelAccelX_7 : 101|10@0+ (0.03125,-16) [-16|15.96875] "mps2"  IDM
 SG_ RSDS_L_ObjRelVelY_7 : 82|13@0+ (0.0312,-128) [-128|126.9976] "mps"  IDM
 SG_ RSDS_L_ObjRelVelX_7 : 79|13@0+ (0.0312,-128) [-128|126.9976] "mps"  IDM
 SG_ RSDS_L_SGU4_Checksum2 : 71|8@0+ (1,0) [0|255] ""  IDM
 SG_ RSDS_L_SGU4_RollingCounter1 : 59|4@0+ (1,0) [0|15] ""  IDM
 SG_ RSDS_L_ObjType_7 : 63|4@0+ (1,0) [0|15] ""  IDM
 SG_ RSDS_L_ObjDistXStd_7 : 54|6@0+ (0.1,0) [0|6] "m"  IDM
 SG_ RSDS_L_ObjDistY_7 : 33|11@0+ (0.125,-128) [-128|127.875] "m"  IDM
 SG_ RSDS_L_ObjDistX_7 : 29|12@0+ (0.0625,-128) [-128|127.9375] "m"  IDM
 SG_ RSDS_L_ObjObstacleProb_7 : 18|5@0+ (0.03326,0) [0|1] ""  IDM
 SG_ RSDS_L_ObjExistProb_7 : 23|5@0+ (0.03326,0) [0|1] ""  IDM
 SG_ RSDS_L_ObjID_7 : 15|8@0+ (1,0) [0|255] ""  IDM
 SG_ RSDS_L_SGU4_Checksum1 : 7|8@0+ (1,0) [0|255] ""  IDM

BO_ 1412 RSDS_L_SGU5: 64 CR_RL
 SG_ RSDS_L_SGU5_RollingCounter8 : 507|4@0+ (1,0) [0|15] ""  IDM
 SG_ RSDS_L_SGU5_BlockCounter : 511|4@0+ (1,0) [0|15] ""  IDM
 SG_ RSDS_L_HWATargetValidity_10 : 496|1@0+ (1,0) [0|1] ""  IDM
 SG_ RSDS_L_ObjRefPoint_10 : 499|3@0+ (1,0) [0|8] ""  IDM
 SG_ RSDS_L_ObjRCS_10 : 493|10@0+ (0.125,-50) [-50|70] "dBm2"  IDM
 SG_ RSDS_L_ObjYawrate_10 : 473|12@0+ (0.002,-3.14) [-3.14|3.14] "rad/s"  IDM
 SG_ RSDS_L_ObjHeading_10 : 469|12@0+ (0.002,-3.14) [-3.14|3.14] "rad"  IDM
 SG_ RSDS_L_ObjLength_10 : 463|10@0+ (0.05,0) [0|20] "m"  IDM
 SG_ RSDS_L_SGU5_Checksum8 : 455|8@0+ (1,0) [0|255] ""  IDM
 SG_ RSDS_L_SGU5_RollingCounter7 : 443|4@0+ (1,0) [0|15] ""  IDM
 SG_ RSDS_L_ObjMotionDirection_10 : 447|3@0+ (1,0) [0|7] ""  IDM
 SG_ RSDS_L_ObjAge_10 : 439|8@0+ (1,0) [0|255] ""  IDM
 SG_ RSDS_L_ObjWidth_10 : 417|10@0+ (0.01,0) [0|5] "m"  IDM
 SG_ RSDS_L_ObjRAccelYStd_10 : 423|6@0+ (0.0625,0) [0|3.9375] "mps2"  IDM
 SG_ RSDS_L_ObjRAccelXStd_10 : 413|6@0+ (0.0625,0) [0|3.9375] "mps2"  IDM
 SG_ RSDS_L_ObjRelVelYStd_10 : 403|6@0+ (0.0625,0) [0|3.9375] "mps"  IDM
 SG_ RSDS_L_ObjRelVelXStd_10 : 393|6@0+ (0.0625,0) [0|3.9375] "mps"  IDM
 SG_ RSDS_L_ObjDistYStd_10 : 399|6@0+ (0.1,0) [0|6] "m"  IDM
 SG_ RSDS_L_SGU5_Checksum7 : 391|8@0+ (1,0) [0|255] ""  IDM
 SG_ RSDS_L_SGU5_RollingCounter6 : 379|4@0+ (1,0) [0|15] ""  IDM
 SG_ RSDS_L_ObjMotionType_10 : 383|3@0+ (1,0) [0|7] ""  IDM
 SG_ RSDS_L_ObjMeasured_10 : 369|2@0+ (1,0) [0|3] ""  IDM
 SG_ RSDS_L_ObjRelAccelY_10 : 363|10@0+ (0.03125,-16) [-16|15.96875] "mps2"  IDM
 SG_ RSDS_L_ObjRelAccelX_10 : 357|10@0+ (0.03125,-16) [-16|15.96875] "mps2"  IDM
 SG_ RSDS_L_ObjRelVelY_10 : 338|13@0+ (0.0312,-128) [-128|126.9976] "mps"  IDM
 SG_ RSDS_L_ObjRelVelX_10 : 335|13@0+ (0.0312,-128) [-128|126.9976] "mps"  IDM
 SG_ RSDS_L_SGU5_Checksum6 : 327|8@0+ (1,0) [0|255] ""  IDM
 SG_ RSDS_L_SGU5_RollingCounter5 : 315|4@0+ (1,0) [0|15] ""  IDM
 SG_ RSDS_L_ObjType_10 : 319|4@0+ (1,0) [0|15] ""  IDM
 SG_ RSDS_L_ObjDistXStd_10 : 310|6@0+ (0.1,0) [0|6] "m"  IDM
 SG_ RSDS_L_ObjDistY_10 : 289|11@0+ (0.125,-128) [-128|127.875] "m"  IDM
 SG_ RSDS_L_ObjDistX_10 : 285|12@0+ (0.0625,-128) [-128|127.9375] "m"  IDM
 SG_ RSDS_L_ObjObstacleProb_10 : 274|5@0+ (0.03326,0) [0|1] ""  IDM
 SG_ RSDS_L_ObjExistProb_10 : 279|5@0+ (0.03326,0) [0|1] ""  IDM
 SG_ RSDS_L_ObjID_10 : 271|8@0+ (1,0) [0|255] ""  IDM
 SG_ RSDS_L_SGU5_Checksum5 : 263|8@0+ (1,0) [0|255] ""  IDM
 SG_ RSDS_L_SGU5_RollingCounter4 : 251|4@0+ (1,0) [0|15] ""  IDM
 SG_ RSDS_L_HWATargetValidity_9 : 240|1@0+ (1,0) [0|1] ""  IDM
 SG_ RSDS_L_ObjRefPoint_9 : 243|3@0+ (1,0) [0|8] ""  IDM
 SG_ RSDS_L_ObjRCS_9 : 237|10@0+ (0.125,-50) [-50|70] "dBm2"  IDM
 SG_ RSDS_L_ObjYawrate_9 : 217|12@0+ (0.002,-3.14) [-3.14|3.14] "rad/s"  IDM
 SG_ RSDS_L_ObjHeading_9 : 213|12@0+ (0.002,-3.14) [-3.14|3.14] "rad"  IDM
 SG_ RSDS_L_ObjLength_9 : 207|10@0+ (0.05,0) [0|20] "m"  IDM
 SG_ RSDS_L_SGU5_Checksum4 : 199|8@0+ (1,0) [0|255] ""  IDM
 SG_ RSDS_L_SGU5_RollingCounter3 : 187|4@0+ (1,0) [0|15] ""  IDM
 SG_ RSDS_L_ObjMotionDirection_9 : 191|3@0+ (1,0) [0|7] ""  IDM
 SG_ RSDS_L_ObjAge_9 : 183|8@0+ (1,0) [0|255] ""  IDM
 SG_ RSDS_L_ObjWidth_9 : 161|10@0+ (0.01,0) [0|5] "m"  IDM
 SG_ RSDS_L_ObjRAccelYStd_9 : 167|6@0+ (0.0625,0) [0|3.9375] "mps2"  IDM
 SG_ RSDS_L_ObjRAccelXStd_9 : 157|6@0+ (0.0625,0) [0|3.9375] "mps2"  IDM
 SG_ RSDS_L_ObjRelVelYStd_9 : 147|6@0+ (0.0625,0) [0|3.9375] "mps"  IDM
 SG_ RSDS_L_ObjRelVelXStd_9 : 137|6@0+ (0.0625,0) [0|3.9375] "mps"  IDM
 SG_ RSDS_L_ObjDistYStd_9 : 143|6@0+ (0.1,0) [0|6] "m"  IDM
 SG_ RSDS_L_SGU5_Checksum3 : 135|8@0+ (1,0) [0|255] ""  IDM
 SG_ RSDS_L_SGU5_RollingCounter2 : 123|4@0+ (1,0) [0|15] ""  IDM
 SG_ RSDS_L_ObjMotionType_9 : 127|3@0+ (1,0) [0|7] ""  IDM
 SG_ RSDS_L_ObjMeasured_9 : 113|2@0+ (1,0) [0|3] ""  IDM
 SG_ RSDS_L_ObjRelAccelY_9 : 107|10@0+ (0.03125,-16) [-16|15.96875] "mps2"  IDM
 SG_ RSDS_L_ObjRelAccelX_9 : 101|10@0+ (0.03125,-16) [-16|15.96875] "mps2"  IDM
 SG_ RSDS_L_ObjRelVelY_9 : 82|13@0+ (0.0312,-128) [-128|126.9976] "mps"  IDM
 SG_ RSDS_L_ObjRelVelX_9 : 79|13@0+ (0.0312,-128) [-128|126.9976] "mps"  IDM
 SG_ RSDS_L_SGU5_Checksum2 : 71|8@0+ (1,0) [0|255] ""  IDM
 SG_ RSDS_L_SGU5_RollingCounter1 : 59|4@0+ (1,0) [0|15] ""  IDM
 SG_ RSDS_L_ObjType_9 : 63|4@0+ (1,0) [0|15] ""  IDM
 SG_ RSDS_L_ObjDistXStd_9 : 54|6@0+ (0.1,0) [0|6] "m"  IDM
 SG_ RSDS_L_ObjDistY_9 : 33|11@0+ (0.125,-128) [-128|127.875] "m"  IDM
 SG_ RSDS_L_ObjDistX_9 : 29|12@0+ (0.0625,-128) [-128|127.9375] "m"  IDM
 SG_ RSDS_L_ObjObstacleProb_9 : 18|5@0+ (0.03326,0) [0|1] ""  IDM
 SG_ RSDS_L_ObjExistProb_9 : 23|5@0+ (0.03326,0) [0|1] ""  IDM
 SG_ RSDS_L_ObjID_9 : 15|8@0+ (1,0) [0|255] ""  IDM
 SG_ RSDS_L_SGU5_Checksum1 : 7|8@0+ (1,0) [0|255] ""  IDM

BO_ 1413 RSDS_L_SGU6: 64 CR_RL
 SG_ RSDS_L_SGU6_RollingCounter8 : 507|4@0+ (1,0) [0|15] ""  IDM
 SG_ RSDS_L_SGU6_BlockCounter : 511|4@0+ (1,0) [0|15] ""  IDM
 SG_ RSDS_L_HWATargetValidity_12 : 496|1@0+ (1,0) [0|1] ""  IDM
 SG_ RSDS_L_ObjRefPoint_12 : 499|3@0+ (1,0) [0|8] ""  IDM
 SG_ RSDS_L_ObjRCS_12 : 493|10@0+ (0.125,-50) [-50|70] "dBm2"  IDM
 SG_ RSDS_L_ObjYawrate_12 : 473|12@0+ (0.002,-3.14) [-3.14|3.14] "rad/s"  IDM
 SG_ RSDS_L_ObjHeading_12 : 469|12@0+ (0.002,-3.14) [-3.14|3.14] "rad"  IDM
 SG_ RSDS_L_ObjLength_12 : 463|10@0+ (0.05,0) [0|20] "m"  IDM
 SG_ RSDS_L_SGU6_Checksum8 : 455|8@0+ (1,0) [0|255] ""  IDM
 SG_ RSDS_L_SGU6_RollingCounter7 : 443|4@0+ (1,0) [0|15] ""  IDM
 SG_ RSDS_L_ObjMotionDirection_12 : 447|3@0+ (1,0) [0|7] ""  IDM
 SG_ RSDS_L_ObjAge_12 : 439|8@0+ (1,0) [0|255] ""  IDM
 SG_ RSDS_L_ObjWidth_12 : 417|10@0+ (0.01,0) [0|5] "m"  IDM
 SG_ RSDS_L_ObjRAccelYStd_12 : 423|6@0+ (0.0625,0) [0|3.9375] "mps2"  IDM
 SG_ RSDS_L_ObjRAccelXStd_12 : 413|6@0+ (0.0625,0) [0|3.9375] "mps2"  IDM
 SG_ RSDS_L_ObjRelVelYStd_12 : 403|6@0+ (0.0625,0) [0|3.9375] "mps"  IDM
 SG_ RSDS_L_ObjRelVelXStd_12 : 393|6@0+ (0.0625,0) [0|3.9375] "mps"  IDM
 SG_ RSDS_L_ObjDistYStd_12 : 399|6@0+ (0.1,0) [0|6] "m"  IDM
 SG_ RSDS_L_SGU6_Checksum7 : 391|8@0+ (1,0) [0|255] ""  IDM
 SG_ RSDS_L_SGU6_RollingCounter6 : 379|4@0+ (1,0) [0|15] ""  IDM
 SG_ RSDS_L_ObjMotionType_12 : 383|3@0+ (1,0) [0|7] ""  IDM
 SG_ RSDS_L_ObjMeasured_12 : 369|2@0+ (1,0) [0|3] ""  IDM
 SG_ RSDS_L_ObjRelAccelY_12 : 363|10@0+ (0.03125,-16) [-16|15.96875] "mps2"  IDM
 SG_ RSDS_L_ObjRelAccelX_12 : 357|10@0+ (0.03125,-16) [-16|15.96875] "mps2"  IDM
 SG_ RSDS_L_ObjRelVelY_12 : 338|13@0+ (0.0312,-128) [-128|126.9976] "mps"  IDM
 SG_ RSDS_L_ObjRelVelX_12 : 335|13@0+ (0.0312,-128) [-128|126.9976] "mps"  IDM
 SG_ RSDS_L_SGU6_Checksum6 : 327|8@0+ (1,0) [0|255] ""  IDM
 SG_ RSDS_L_SGU6_RollingCounter5 : 315|4@0+ (1,0) [0|15] ""  IDM
 SG_ RSDS_L_ObjType_12 : 319|4@0+ (1,0) [0|15] ""  IDM
 SG_ RSDS_L_ObjDistXStd_12 : 310|6@0+ (0.1,0) [0|6] "m"  IDM
 SG_ RSDS_L_ObjDistY_12 : 289|11@0+ (0.125,-128) [-128|127.875] "m"  IDM
 SG_ RSDS_L_ObjDistX_12 : 285|12@0+ (0.0625,-128) [-128|127.9375] "m"  IDM
 SG_ RSDS_L_ObjObstacleProb_12 : 274|5@0+ (0.03326,0) [0|1] ""  IDM
 SG_ RSDS_L_ObjExistProb_12 : 279|5@0+ (0.03326,0) [0|1] ""  IDM
 SG_ RSDS_L_ObjID_12 : 271|8@0+ (1,0) [0|255] ""  IDM
 SG_ RSDS_L_SGU6_Checksum5 : 263|8@0+ (1,0) [0|255] ""  IDM
 SG_ RSDS_L_SGU6_RollingCounter4 : 251|4@0+ (1,0) [0|15] ""  IDM
 SG_ RSDS_L_HWATargetValidity_11 : 240|1@0+ (1,0) [0|1] ""  IDM
 SG_ RSDS_L_ObjRefPoint_11 : 243|3@0+ (1,0) [0|8] ""  IDM
 SG_ RSDS_L_ObjRCS_11 : 237|10@0+ (0.125,-50) [-50|70] "dBm2"  IDM
 SG_ RSDS_L_ObjYawrate_11 : 217|12@0+ (0.002,-3.14) [-3.14|3.14] "rad/s"  IDM
 SG_ RSDS_L_ObjHeading_11 : 213|12@0+ (0.002,-3.14) [-3.14|3.14] "rad"  IDM
 SG_ RSDS_L_ObjLength_11 : 207|10@0+ (0.05,0) [0|20] "m"  IDM
 SG_ RSDS_L_SGU6_Checksum4 : 199|8@0+ (1,0) [0|255] ""  IDM
 SG_ RSDS_L_SGU6_RollingCounter3 : 187|4@0+ (1,0) [0|15] ""  IDM
 SG_ RSDS_L_ObjMotionDirection_11 : 191|3@0+ (1,0) [0|7] ""  IDM
 SG_ RSDS_L_ObjAge_11 : 183|8@0+ (1,0) [0|255] ""  IDM
 SG_ RSDS_L_ObjWidth_11 : 161|10@0+ (0.01,0) [0|5] "m"  IDM
 SG_ RSDS_L_ObjRAccelYStd_11 : 167|6@0+ (0.0625,0) [0|3.9375] "mps2"  IDM
 SG_ RSDS_L_ObjRAccelXStd_11 : 157|6@0+ (0.0625,0) [0|3.9375] "mps2"  IDM
 SG_ RSDS_L_ObjRelVelYStd_11 : 147|6@0+ (0.0625,0) [0|3.9375] "mps"  IDM
 SG_ RSDS_L_ObjRelVelXStd_11 : 137|6@0+ (0.0625,0) [0|3.9375] "mps"  IDM
 SG_ RSDS_L_ObjDistYStd_11 : 143|6@0+ (0.1,0) [0|6] "m"  IDM
 SG_ RSDS_L_SGU6_Checksum3 : 135|8@0+ (1,0) [0|255] ""  IDM
 SG_ RSDS_L_SGU6_RollingCounter2 : 123|4@0+ (1,0) [0|15] ""  IDM
 SG_ RSDS_L_ObjMotionType_11 : 127|3@0+ (1,0) [0|7] ""  IDM
 SG_ RSDS_L_ObjMeasured_11 : 113|2@0+ (1,0) [0|3] ""  IDM
 SG_ RSDS_L_ObjRelAccelY_11 : 107|10@0+ (0.03125,-16) [-16|15.96875] "mps2"  IDM
 SG_ RSDS_L_ObjRelAccelX_11 : 101|10@0+ (0.03125,-16) [-16|15.96875] "mps2"  IDM
 SG_ RSDS_L_ObjRelVelY_11 : 82|13@0+ (0.0312,-128) [-128|126.9976] "mps"  IDM
 SG_ RSDS_L_ObjRelVelX_11 : 79|13@0+ (0.0312,-128) [-128|126.9976] "mps"  IDM
 SG_ RSDS_L_SGU6_Checksum2 : 71|8@0+ (1,0) [0|255] ""  IDM
 SG_ RSDS_L_SGU6_RollingCounter1 : 59|4@0+ (1,0) [0|15] ""  IDM
 SG_ RSDS_L_ObjType_11 : 63|4@0+ (1,0) [0|15] ""  IDM
 SG_ RSDS_L_ObjDistXStd_11 : 54|6@0+ (0.1,0) [0|6] "m"  IDM
 SG_ RSDS_L_ObjDistY_11 : 33|11@0+ (0.125,-128) [-128|127.875] "m"  IDM
 SG_ RSDS_L_ObjDistX_11 : 29|12@0+ (0.0625,-128) [-128|127.9375] "m"  IDM
 SG_ RSDS_L_ObjObstacleProb_11 : 18|5@0+ (0.03326,0) [0|1] ""  IDM
 SG_ RSDS_L_ObjExistProb_11 : 23|5@0+ (0.03326,0) [0|1] ""  IDM
 SG_ RSDS_L_ObjID_11 : 15|8@0+ (1,0) [0|255] ""  IDM
 SG_ RSDS_L_SGU6_Checksum1 : 7|8@0+ (1,0) [0|255] ""  IDM

BO_ 1414 RSDS_L_SGU7: 64 CR_RL
 SG_ RSDS_L_SGU7_RollingCounter8 : 507|4@0+ (1,0) [0|15] ""  IDM
 SG_ RSDS_L_SGU7_BlockCounter : 511|4@0+ (1,0) [0|15] ""  IDM
 SG_ RSDS_L_HWATargetValidity_14 : 496|1@0+ (1,0) [0|1] ""  IDM
 SG_ RSDS_L_ObjRefPoint_14 : 499|3@0+ (1,0) [0|8] ""  IDM
 SG_ RSDS_L_ObjRCS_14 : 493|10@0+ (0.125,-50) [-50|70] "dBm2"  IDM
 SG_ RSDS_L_ObjYawrate_14 : 473|12@0+ (0.002,-3.14) [-3.14|3.14] "rad/s"  IDM
 SG_ RSDS_L_ObjHeading_14 : 469|12@0+ (0.002,-3.14) [-3.14|3.14] "rad"  IDM
 SG_ RSDS_L_ObjLength_14 : 463|10@0+ (0.05,0) [0|20] "m"  IDM
 SG_ RSDS_L_SGU7_Checksum8 : 455|8@0+ (1,0) [0|255] ""  IDM
 SG_ RSDS_L_SGU7_RollingCounter7 : 443|4@0+ (1,0) [0|15] ""  IDM
 SG_ RSDS_L_ObjMotionDirection_14 : 447|3@0+ (1,0) [0|7] ""  IDM
 SG_ RSDS_L_ObjAge_14 : 439|8@0+ (1,0) [0|255] ""  IDM
 SG_ RSDS_L_ObjWidth_14 : 417|10@0+ (0.01,0) [0|5] "m"  IDM
 SG_ RSDS_L_ObjRAccelYStd_14 : 423|6@0+ (0.0625,0) [0|3.9375] "mps2"  IDM
 SG_ RSDS_L_ObjRAccelXStd_14 : 413|6@0+ (0.0625,0) [0|3.9375] "mps2"  IDM
 SG_ RSDS_L_ObjRelVelYStd_14 : 403|6@0+ (0.0625,0) [0|3.9375] "mps"  IDM
 SG_ RSDS_L_ObjRelVelXStd_14 : 393|6@0+ (0.0625,0) [0|3.9375] "mps"  IDM
 SG_ RSDS_L_ObjDistYStd_14 : 399|6@0+ (0.1,0) [0|6] "m"  IDM
 SG_ RSDS_L_SGU7_Checksum7 : 391|8@0+ (1,0) [0|255] ""  IDM
 SG_ RSDS_L_SGU7_RollingCounter6 : 379|4@0+ (1,0) [0|15] ""  IDM
 SG_ RSDS_L_ObjMotionType_14 : 383|3@0+ (1,0) [0|7] ""  IDM
 SG_ RSDS_L_ObjMeasured_14 : 369|2@0+ (1,0) [0|3] ""  IDM
 SG_ RSDS_L_ObjRelAccelY_14 : 363|10@0+ (0.03125,-16) [-16|15.96875] "mps2"  IDM
 SG_ RSDS_L_ObjRelAccelX_14 : 357|10@0+ (0.03125,-16) [-16|15.96875] "mps2"  IDM
 SG_ RSDS_L_ObjRelVelY_14 : 338|13@0+ (0.0312,-128) [-128|126.9976] "mps"  IDM
 SG_ RSDS_L_ObjRelVelX_14 : 335|13@0+ (0.0312,-128) [-128|126.9976] "mps"  IDM
 SG_ RSDS_L_SGU7_Checksum6 : 327|8@0+ (1,0) [0|255] ""  IDM
 SG_ RSDS_L_SGU7_RollingCounter5 : 315|4@0+ (1,0) [0|15] ""  IDM
 SG_ RSDS_L_ObjType_14 : 319|4@0+ (1,0) [0|15] ""  IDM
 SG_ RSDS_L_ObjDistXStd_14 : 310|6@0+ (0.1,0) [0|6] "m"  IDM
 SG_ RSDS_L_ObjDistY_14 : 289|11@0+ (0.125,-128) [-128|127.875] "m"  IDM
 SG_ RSDS_L_ObjDistX_14 : 285|12@0+ (0.0625,-128) [-128|127.9375] "m"  IDM
 SG_ RSDS_L_ObjObstacleProb_14 : 274|5@0+ (0.03326,0) [0|1] ""  IDM
 SG_ RSDS_L_ObjExistProb_14 : 279|5@0+ (0.03326,0) [0|1] ""  IDM
 SG_ RSDS_L_ObjID_14 : 271|8@0+ (1,0) [0|255] ""  IDM
 SG_ RSDS_L_SGU7_Checksum5 : 263|8@0+ (1,0) [0|255] ""  IDM
 SG_ RSDS_L_SGU7_RollingCounter4 : 251|4@0+ (1,0) [0|15] ""  IDM
 SG_ RSDS_L_HWATargetValidity_13 : 240|1@0+ (1,0) [0|1] ""  IDM
 SG_ RSDS_L_ObjRefPoint_13 : 243|3@0+ (1,0) [0|8] ""  IDM
 SG_ RSDS_L_ObjRCS_13 : 237|10@0+ (0.125,-50) [-50|70] "dBm2"  IDM
 SG_ RSDS_L_ObjYawrate_13 : 217|12@0+ (0.002,-3.14) [-3.14|3.14] "rad/s"  IDM
 SG_ RSDS_L_ObjHeading_13 : 213|12@0+ (0.002,-3.14) [-3.14|3.14] "rad"  IDM
 SG_ RSDS_L_ObjLength_13 : 207|10@0+ (0.05,0) [0|20] "m"  IDM
 SG_ RSDS_L_SGU7_Checksum4 : 199|8@0+ (1,0) [0|255] ""  IDM
 SG_ RSDS_L_SGU7_RollingCounter3 : 187|4@0+ (1,0) [0|15] ""  IDM
 SG_ RSDS_L_ObjMotionDirection_13 : 191|3@0+ (1,0) [0|7] ""  IDM
 SG_ RSDS_L_ObjAge_13 : 183|8@0+ (1,0) [0|255] ""  IDM
 SG_ RSDS_L_ObjWidth_13 : 161|10@0+ (0.01,0) [0|5] "m"  IDM
 SG_ RSDS_L_ObjRAccelYStd_13 : 167|6@0+ (0.0625,0) [0|3.9375] "mps2"  IDM
 SG_ RSDS_L_ObjRAccelXStd_13 : 157|6@0+ (0.0625,0) [0|3.9375] "mps2"  IDM
 SG_ RSDS_L_ObjRelVelYStd_13 : 147|6@0+ (0.0625,0) [0|3.9375] "mps"  IDM
 SG_ RSDS_L_ObjRelVelXStd_13 : 137|6@0+ (0.0625,0) [0|3.9375] "mps"  IDM
 SG_ RSDS_L_ObjDistYStd_13 : 143|6@0+ (0.1,0) [0|6] "m"  IDM
 SG_ RSDS_L_SGU7_Checksum3 : 135|8@0+ (1,0) [0|255] ""  IDM
 SG_ RSDS_L_SGU7_RollingCounter2 : 123|4@0+ (1,0) [0|15] ""  IDM
 SG_ RSDS_L_ObjMotionType_13 : 127|3@0+ (1,0) [0|7] ""  IDM
 SG_ RSDS_L_ObjMeasured_13 : 113|2@0+ (1,0) [0|3] ""  IDM
 SG_ RSDS_L_ObjRelAccelY_13 : 107|10@0+ (0.03125,-16) [-16|15.96875] "mps2"  IDM
 SG_ RSDS_L_ObjRelAccelX_13 : 101|10@0+ (0.03125,-16) [-16|15.96875] "mps2"  IDM
 SG_ RSDS_L_ObjRelVelY_13 : 82|13@0+ (0.0312,-128) [-128|126.9976] "mps"  IDM
 SG_ RSDS_L_ObjRelVelX_13 : 79|13@0+ (0.0312,-128) [-128|126.9976] "mps"  IDM
 SG_ RSDS_L_SGU7_Checksum2 : 71|8@0+ (1,0) [0|255] ""  IDM
 SG_ RSDS_L_SGU7_RollingCounter1 : 59|4@0+ (1,0) [0|15] ""  IDM
 SG_ RSDS_L_ObjType_13 : 63|4@0+ (1,0) [0|15] ""  IDM
 SG_ RSDS_L_ObjDistXStd_13 : 54|6@0+ (0.1,0) [0|6] "m"  IDM
 SG_ RSDS_L_ObjDistY_13 : 33|11@0+ (0.125,-128) [-128|127.875] "m"  IDM
 SG_ RSDS_L_ObjDistX_13 : 29|12@0+ (0.0625,-128) [-128|127.9375] "m"  IDM
 SG_ RSDS_L_ObjObstacleProb_13 : 18|5@0+ (0.03326,0) [0|1] ""  IDM
 SG_ RSDS_L_ObjExistProb_13 : 23|5@0+ (0.03326,0) [0|1] ""  IDM
 SG_ RSDS_L_ObjID_13 : 15|8@0+ (1,0) [0|255] ""  IDM
 SG_ RSDS_L_SGU7_Checksum1 : 7|8@0+ (1,0) [0|255] ""  IDM

BO_ 1415 RSDS_L_SGU8: 64 CR_RL
 SG_ RSDS_L_SGU8_RollingCounter8 : 507|4@0+ (1,0) [0|15] ""  IDM
 SG_ RSDS_L_SGU8_BlockCounter : 511|4@0+ (1,0) [0|15] ""  IDM
 SG_ RSDS_L_HWATargetValidity_16 : 496|1@0+ (1,0) [0|1] ""  IDM
 SG_ RSDS_L_ObjRefPoint_16 : 499|3@0+ (1,0) [0|8] ""  IDM
 SG_ RSDS_L_ObjRCS_16 : 493|10@0+ (0.125,-50) [-50|70] "dBm2"  IDM
 SG_ RSDS_L_ObjYawrate_16 : 473|12@0+ (0.002,-3.14) [-3.14|3.14] "rad/s"  IDM
 SG_ RSDS_L_ObjHeading_16 : 469|12@0+ (0.002,-3.14) [-3.14|3.14] "rad"  IDM
 SG_ RSDS_L_ObjLength_16 : 463|10@0+ (0.05,0) [0|20] "m"  IDM
 SG_ RSDS_L_SGU8_Checksum8 : 455|8@0+ (1,0) [0|255] ""  IDM
 SG_ RSDS_L_SGU8_RollingCounter7 : 443|4@0+ (1,0) [0|15] ""  IDM
 SG_ RSDS_L_ObjMotionDirection_16 : 447|3@0+ (1,0) [0|7] ""  IDM
 SG_ RSDS_L_ObjAge_16 : 439|8@0+ (1,0) [0|255] ""  IDM
 SG_ RSDS_L_ObjWidth_16 : 417|10@0+ (0.01,0) [0|5] "m"  IDM
 SG_ RSDS_L_ObjRAccelYStd_16 : 423|6@0+ (0.0625,0) [0|3.9375] "mps2"  IDM
 SG_ RSDS_L_ObjRAccelXStd_16 : 413|6@0+ (0.0625,0) [0|3.9375] "mps2"  IDM
 SG_ RSDS_L_ObjRelVelYStd_16 : 403|6@0+ (0.0625,0) [0|3.9375] "mps"  IDM
 SG_ RSDS_L_ObjRelVelXStd_16 : 393|6@0+ (0.0625,0) [0|3.9375] "mps"  IDM
 SG_ RSDS_L_ObjDistYStd_16 : 399|6@0+ (0.1,0) [0|6] "m"  IDM
 SG_ RSDS_L_SGU8_Checksum7 : 391|8@0+ (1,0) [0|255] ""  IDM
 SG_ RSDS_L_SGU8_RollingCounter6 : 379|4@0+ (1,0) [0|15] ""  IDM
 SG_ RSDS_L_ObjMotionType_16 : 383|3@0+ (1,0) [0|7] ""  IDM
 SG_ RSDS_L_ObjMeasured_16 : 369|2@0+ (1,0) [0|3] ""  IDM
 SG_ RSDS_L_ObjRelAccelY_16 : 363|10@0+ (0.03125,-16) [-16|15.96875] "mps2"  IDM
 SG_ RSDS_L_ObjRelAccelX_16 : 357|10@0+ (0.03125,-16) [-16|15.96875] "mps2"  IDM
 SG_ RSDS_L_ObjRelVelY_16 : 338|13@0+ (0.0312,-128) [-128|126.9976] "mps"  IDM
 SG_ RSDS_L_ObjRelVelX_16 : 335|13@0+ (0.0312,-128) [-128|126.9976] "mps"  IDM
 SG_ RSDS_L_SGU8_Checksum6 : 327|8@0+ (1,0) [0|255] ""  IDM
 SG_ RSDS_L_SGU8_RollingCounter5 : 315|4@0+ (1,0) [0|15] ""  IDM
 SG_ RSDS_L_ObjType_16 : 319|4@0+ (1,0) [0|15] ""  IDM
 SG_ RSDS_L_ObjDistXStd_16 : 310|6@0+ (0.1,0) [0|6] "m"  IDM
 SG_ RSDS_L_ObjDistY_16 : 289|11@0+ (0.125,-128) [-128|127.875] "m"  IDM
 SG_ RSDS_L_ObjDistX_16 : 285|12@0+ (0.0625,-128) [-128|127.9375] "m"  IDM
 SG_ RSDS_L_ObjObstacleProb_16 : 274|5@0+ (0.03326,0) [0|1] ""  IDM
 SG_ RSDS_L_ObjExistProb_16 : 279|5@0+ (0.03326,0) [0|1] ""  IDM
 SG_ RSDS_L_ObjID_16 : 271|8@0+ (1,0) [0|255] ""  IDM
 SG_ RSDS_L_SGU8_Checksum5 : 263|8@0+ (1,0) [0|255] ""  IDM
 SG_ RSDS_L_SGU8_RollingCounter4 : 251|4@0+ (1,0) [0|15] ""  IDM
 SG_ RSDS_L_HWATargetValidity_15 : 240|1@0+ (1,0) [0|1] ""  IDM
 SG_ RSDS_L_ObjRefPoint_15 : 243|3@0+ (1,0) [0|8] ""  IDM
 SG_ RSDS_L_ObjRCS_15 : 237|10@0+ (0.125,-50) [-50|70] "dBm2"  IDM
 SG_ RSDS_L_ObjYawrate_15 : 217|12@0+ (0.002,-3.14) [-3.14|3.14] "rad/s"  IDM
 SG_ RSDS_L_ObjHeading_15 : 213|12@0+ (0.002,-3.14) [-3.14|3.14] "rad"  IDM
 SG_ RSDS_L_ObjLength_15 : 207|10@0+ (0.05,0) [0|20] "m"  IDM
 SG_ RSDS_L_SGU8_Checksum4 : 199|8@0+ (1,0) [0|255] ""  IDM
 SG_ RSDS_L_SGU8_RollingCounter3 : 187|4@0+ (1,0) [0|15] ""  IDM
 SG_ RSDS_L_ObjMotionDirection_15 : 191|3@0+ (1,0) [0|7] ""  IDM
 SG_ RSDS_L_ObjAge_15 : 183|8@0+ (1,0) [0|255] ""  IDM
 SG_ RSDS_L_ObjWidth_15 : 161|10@0+ (0.01,0) [0|5] "m"  IDM
 SG_ RSDS_L_ObjRAccelYStd_15 : 167|6@0+ (0.0625,0) [0|3.9375] "mps2"  IDM
 SG_ RSDS_L_ObjRAccelXStd_15 : 157|6@0+ (0.0625,0) [0|3.9375] "mps2"  IDM
 SG_ RSDS_L_ObjRelVelYStd_15 : 147|6@0+ (0.0625,0) [0|3.9375] "mps"  IDM
 SG_ RSDS_L_ObjRelVelXStd_15 : 137|6@0+ (0.0625,0) [0|3.9375] "mps"  IDM
 SG_ RSDS_L_ObjDistYStd_15 : 143|6@0+ (0.1,0) [0|6] "m"  IDM
 SG_ RSDS_L_SGU8_Checksum3 : 135|8@0+ (1,0) [0|255] ""  IDM
 SG_ RSDS_L_SGU8_RollingCounter2 : 123|4@0+ (1,0) [0|15] ""  IDM
 SG_ RSDS_L_ObjMotionType_15 : 127|3@0+ (1,0) [0|7] ""  IDM
 SG_ RSDS_L_ObjMeasured_15 : 113|2@0+ (1,0) [0|3] ""  IDM
 SG_ RSDS_L_ObjRelAccelY_15 : 107|10@0+ (0.03125,-16) [-16|15.96875] "mps2"  IDM
 SG_ RSDS_L_ObjRelAccelX_15 : 101|10@0+ (0.03125,-16) [-16|15.96875] "mps2"  IDM
 SG_ RSDS_L_ObjRelVelY_15 : 82|13@0+ (0.0312,-128) [-128|126.9976] "mps"  IDM
 SG_ RSDS_L_ObjRelVelX_15 : 79|13@0+ (0.0312,-128) [-128|126.9976] "mps"  IDM
 SG_ RSDS_L_SGU8_Checksum2 : 71|8@0+ (1,0) [0|255] ""  IDM
 SG_ RSDS_L_SGU8_RollingCounter1 : 59|4@0+ (1,0) [0|15] ""  IDM
 SG_ RSDS_L_ObjType_15 : 63|4@0+ (1,0) [0|15] ""  IDM
 SG_ RSDS_L_ObjDistXStd_15 : 54|6@0+ (0.1,0) [0|6] "m"  IDM
 SG_ RSDS_L_ObjDistY_15 : 33|11@0+ (0.125,-128) [-128|127.875] "m"  IDM
 SG_ RSDS_L_ObjDistX_15 : 29|12@0+ (0.0625,-128) [-128|127.9375] "m"  IDM
 SG_ RSDS_L_ObjObstacleProb_15 : 18|5@0+ (0.03326,0) [0|1] ""  IDM
 SG_ RSDS_L_ObjExistProb_15 : 23|5@0+ (0.03326,0) [0|1] ""  IDM
 SG_ RSDS_L_ObjID_15 : 15|8@0+ (1,0) [0|255] ""  IDM
 SG_ RSDS_L_SGU8_Checksum1 : 7|8@0+ (1,0) [0|255] ""  IDM

BO_ 1416 RSDS_L_SGU9: 64 CR_RL
 SG_ RSDS_L_SGU9_RollingCounter8 : 507|4@0+ (1,0) [0|14] "NoUnit"  IDM
 SG_ RSDS_L_SGU9_BlockCounter : 511|4@0+ (1,0) [0|15] "NoUnit"  IDM
 SG_ RSDS_L_HWATargetValidity_18 : 496|1@0+ (1,0) [0|1] "NoUnit"  IDM
 SG_ RSDS_L_ObjRefPoint_18 : 499|3@0+ (1,0) [0|7] "NoUnit"  IDM
 SG_ RSDS_L_ObjRCS_18 : 493|10@0+ (0.125,-50) [-50|70] "dBsm"  IDM
 SG_ RSDS_L_ObjYawrate_18 : 473|12@0+ (0.002,-3.14) [-3.14|5.05] "radPerSec"  IDM
 SG_ RSDS_L_ObjHeading_18 : 469|12@0+ (0.002,-3.14) [-3.14|5.05] "rad"  IDM
 SG_ RSDS_L_ObjLength_18 : 463|10@0+ (0.05,0) [0|20] "m"  IDM
 SG_ RSDS_L_SGU9_Checksum8 : 455|8@0+ (1,0) [0|255] "NoUnit"  IDM
 SG_ RSDS_L_SGU9_RollingCounter7 : 443|4@0+ (1,0) [0|14] "NoUnit"  IDM
 SG_ RSDS_L_ObjMotionDirection_18 : 447|3@0+ (1,0) [0|7] "NoUnit"  IDM
 SG_ RSDS_L_ObjAge_18 : 439|8@0+ (1,0) [0|255] "NoUnit"  IDM
 SG_ RSDS_L_ObjWidth_18 : 417|10@0+ (0.01,0) [0|5] "m"  IDM
 SG_ RSDS_L_ObjRAccelYStd_18 : 423|6@0+ (0.0625,0) [0|3.9375] "MtrPerSecSq"  IDM
 SG_ RSDS_L_ObjRAccelXStd_18 : 413|6@0+ (0.0625,0) [0|3.9375] "MtrPerSecSq"  IDM
 SG_ RSDS_L_ObjRelVelYStd_18 : 403|6@0+ (0.0625,0) [0|3.9375] "mps"  IDM
 SG_ RSDS_L_ObjRelVelXStd_18 : 393|6@0+ (0.0625,0) [0|3.9375] "mps"  IDM
 SG_ RSDS_L_ObjDistYStd_18 : 399|6@0+ (0.1,0) [0|6] "m"  IDM
 SG_ RSDS_L_SGU9_Checksum7 : 391|8@0+ (1,0) [0|255] "NoUnit"  IDM
 SG_ RSDS_L_SGU9_RollingCounter6 : 379|4@0+ (1,0) [0|14] "NoUnit"  IDM
 SG_ RSDS_L_ObjMotionType_18 : 383|3@0+ (1,0) [0|7] "NoUnit"  IDM
 SG_ RSDS_L_ObjMeasured_18 : 369|2@0+ (1,0) [0|3] "NoUnit"  IDM
 SG_ RSDS_L_ObjRelAccelY_18 : 363|10@0+ (0.03125,-16) [-16|15.96875] "MtrPerSecSq"  IDM
 SG_ RSDS_L_ObjRelAccelX_18 : 357|10@0+ (0.03125,-16) [-16|15.96875] "MtrPerSecSq"  IDM
 SG_ RSDS_L_ObjRelVelY_18 : 338|13@0+ (0.0312,-128) [-128|126.9976] "mps"  IDM
 SG_ RSDS_L_ObjRelVelX_18 : 335|13@0+ (0.0312,-128) [-128|126.9976] "mps"  IDM
 SG_ RSDS_L_SGU9_Checksum6 : 327|8@0+ (1,0) [0|255] "NoUnit"  IDM
 SG_ RSDS_L_SGU9_RollingCounter5 : 315|4@0+ (1,0) [0|14] "NoUnit"  IDM
 SG_ RSDS_L_ObjType_18 : 319|4@0+ (1,0) [0|15] "NoUnit"  IDM
 SG_ RSDS_L_ObjDistXStd_18 : 310|6@0+ (0.1,0) [0|6] "m"  IDM
 SG_ RSDS_L_ObjDistY_18 : 289|11@0+ (0.125,-128) [-128|127.875] "m"  IDM
 SG_ RSDS_L_ObjDistX_18 : 285|12@0+ (0.0625,-128) [-128|126.9375] "m"  IDM
 SG_ RSDS_L_ObjObstacleProb_18 : 274|5@0+ (0.03326,0) [0|1.03106] "NoUnit"  IDM
 SG_ RSDS_L_ObjExistProb_18 : 279|5@0+ (0.03326,0) [0|1.03106] "NoUnit"  IDM
 SG_ RSDS_L_ObjID_18 : 271|8@0+ (1,0) [0|255] "NoUnit"  IDM
 SG_ RSDS_L_SGU9_Checksum5 : 263|8@0+ (1,0) [0|255] "NoUnit"  IDM
 SG_ RSDS_L_SGU9_RollingCounter4 : 251|4@0+ (1,0) [0|14] "NoUnit"  IDM
 SG_ RSDS_L_HWATargetValidity_17 : 240|1@0+ (1,0) [0|1] "NoUnit"  IDM
 SG_ RSDS_L_ObjRefPoint_17 : 243|3@0+ (1,0) [0|7] "NoUnit"  IDM
 SG_ RSDS_L_ObjRCS_17 : 237|10@0+ (0.125,-50) [-50|70] "dBsm"  IDM
 SG_ RSDS_L_ObjYawrate_17 : 217|12@0+ (0.002,-3.14) [-3.14|5.05] "radPerSec"  IDM
 SG_ RSDS_L_ObjHeading_17 : 213|12@0+ (0.002,-3.14) [-3.14|5.05] "rad"  IDM
 SG_ RSDS_L_ObjLength_17 : 207|10@0+ (0.05,0) [0|20] "m"  IDM
 SG_ RSDS_L_SGU9_Checksum4 : 199|8@0+ (1,0) [0|255] "NoUnit"  IDM
 SG_ RSDS_L_SGU9_RollingCounter3 : 187|4@0+ (1,0) [0|14] "NoUnit"  IDM
 SG_ RSDS_L_ObjMotionDirection_17 : 191|3@0+ (1,0) [0|7] "NoUnit"  IDM
 SG_ RSDS_L_ObjAge_17 : 183|8@0+ (1,0) [0|255] "NoUnit"  IDM
 SG_ RSDS_L_ObjWidth_17 : 161|10@0+ (0.01,0) [0|5] "m"  IDM
 SG_ RSDS_L_ObjRAccelYStd_17 : 167|6@0+ (0.0625,0) [0|3.9375] "MtrPerSecSq"  IDM
 SG_ RSDS_L_ObjRAccelXStd_17 : 157|6@0+ (0.0625,0) [0|3.9375] "MtrPerSecSq"  IDM
 SG_ RSDS_L_ObjRelVelYStd_17 : 147|6@0+ (0.0625,0) [0|3.9375] "mps"  IDM
 SG_ RSDS_L_ObjRelVelXStd_17 : 137|6@0+ (0.0625,0) [0|3.9375] "mps"  IDM
 SG_ RSDS_L_ObjDistYStd_17 : 143|6@0+ (0.1,0) [0|6] "m"  IDM
 SG_ RSDS_L_SGU9_Checksum3 : 135|8@0+ (1,0) [0|255] "NoUnit"  IDM
 SG_ RSDS_L_SGU9_RollingCounter2 : 123|4@0+ (1,0) [0|14] "NoUnit"  IDM
 SG_ RSDS_L_ObjMotionType_17 : 127|3@0+ (1,0) [0|7] "NoUnit"  IDM
 SG_ RSDS_L_ObjMeasured_17 : 113|2@0+ (1,0) [0|3] "NoUnit"  IDM
 SG_ RSDS_L_ObjRelAccelY_17 : 107|10@0+ (0.03125,-16) [-16|15.96875] "MtrPerSecSq"  IDM
 SG_ RSDS_L_ObjRelAccelX_17 : 101|10@0+ (0.03125,-16) [-16|15.96875] "MtrPerSecSq"  IDM
 SG_ RSDS_L_ObjRelVelY_17 : 82|13@0+ (0.0312,-128) [-128|126.9976] "mps"  IDM
 SG_ RSDS_L_ObjRelVelX_17 : 79|13@0+ (0.0312,-128) [-128|126.9976] "mps"  IDM
 SG_ RSDS_L_SGU9_Checksum2 : 71|8@0+ (1,0) [0|255] "NoUnit"  IDM
 SG_ RSDS_L_SGU9_RollingCounter1 : 59|4@0+ (1,0) [0|14] "NoUnit"  IDM
 SG_ RSDS_L_ObjType_17 : 63|4@0+ (1,0) [0|15] "NoUnit"  IDM
 SG_ RSDS_L_ObjDistXStd_17 : 54|6@0+ (0.1,0) [0|6] "m"  IDM
 SG_ RSDS_L_ObjDistY_17 : 33|11@0+ (0.125,-128) [-128|127.875] "m"  IDM
 SG_ RSDS_L_ObjDistX_17 : 29|12@0+ (0.0625,-128) [-128|126.9375] "m"  IDM
 SG_ RSDS_L_ObjObstacleProb_17 : 18|5@0+ (0.03326,0) [0|1.03106] "NoUnit"  IDM
 SG_ RSDS_L_ObjExistProb_17 : 23|5@0+ (0.03326,0) [0|1.03106] "NoUnit"  IDM
 SG_ RSDS_L_ObjID_17 : 15|8@0+ (1,0) [0|255] "NoUnit"  IDM
 SG_ RSDS_L_SGU9_Checksum1 : 7|8@0+ (1,0) [0|255] "NoUnit"  IDM

BO_ 1417 RSDS_L_SGU10: 64 CR_RL
 SG_ RSDS_L_SGU10_RollingCounter8 : 507|4@0+ (1,0) [0|14] "NoUnit"  IDM
 SG_ RSDS_L_SGU10_BlockCounter : 511|4@0+ (1,0) [0|15] "NoUnit"  IDM
 SG_ RSDS_L_HWATargetValidity_20 : 496|1@0+ (1,0) [0|1] "NoUnit"  IDM
 SG_ RSDS_L_ObjRefPoint_20 : 499|3@0+ (1,0) [0|7] "NoUnit"  IDM
 SG_ RSDS_L_ObjRCS_20 : 493|10@0+ (0.125,-50) [-50|70] "dBsm"  IDM
 SG_ RSDS_L_ObjYawrate_20 : 473|12@0+ (0.002,-3.14) [-3.14|5.05] "radPerSec"  IDM
 SG_ RSDS_L_ObjHeading_20 : 469|12@0+ (0.002,-3.14) [-3.14|5.05] "rad"  IDM
 SG_ RSDS_L_ObjLength_20 : 463|10@0+ (0.05,0) [0|20] "m"  IDM
 SG_ RSDS_L_SGU10_Checksum8 : 455|8@0+ (1,0) [0|255] "NoUnit"  IDM
 SG_ RSDS_L_SGU10_RollingCounter7 : 443|4@0+ (1,0) [0|14] "NoUnit"  IDM
 SG_ RSDS_L_ObjMotionDirection_20 : 447|3@0+ (1,0) [0|7] "NoUnit"  IDM
 SG_ RSDS_L_ObjAge_20 : 439|8@0+ (1,0) [0|255] "NoUnit"  IDM
 SG_ RSDS_L_ObjWidth_20 : 417|10@0+ (0.01,0) [0|5] "m"  IDM
 SG_ RSDS_L_ObjRAccelYStd_20 : 423|6@0+ (0.0625,0) [0|3.9375] "MtrPerSecSq"  IDM
 SG_ RSDS_L_ObjRAccelXStd_20 : 413|6@0+ (0.0625,0) [0|3.9375] "MtrPerSecSq"  IDM
 SG_ RSDS_L_ObjRelVelYStd_20 : 403|6@0+ (0.0625,0) [0|3.9375] "mps"  IDM
 SG_ RSDS_L_ObjRelVelXStd_20 : 393|6@0+ (0.0625,0) [0|3.9375] "mps"  IDM
 SG_ RSDS_L_ObjDistYStd_20 : 399|6@0+ (0.1,0) [0|6] "m"  IDM
 SG_ RSDS_L_SGU10_Checksum7 : 391|8@0+ (1,0) [0|255] "NoUnit"  IDM
 SG_ RSDS_L_SGU10_RollingCounter6 : 379|4@0+ (1,0) [0|14] "NoUnit"  IDM
 SG_ RSDS_L_ObjMotionType_20 : 383|3@0+ (1,0) [0|7] "NoUnit"  IDM
 SG_ RSDS_L_ObjMeasured_20 : 369|2@0+ (1,0) [0|3] "NoUnit"  IDM
 SG_ RSDS_L_ObjRelAccelY_20 : 363|10@0+ (0.03125,-16) [-16|15.96875] "MtrPerSecSq"  IDM
 SG_ RSDS_L_ObjRelAccelX_20 : 357|10@0+ (0.03125,-16) [-16|15.96875] "MtrPerSecSq"  IDM
 SG_ RSDS_L_ObjRelVelY_20 : 338|13@0+ (0.0312,-128) [-128|126.9976] "mps"  IDM
 SG_ RSDS_L_ObjRelVelX_20 : 335|13@0+ (0.0312,-128) [-128|126.9976] "mps"  IDM
 SG_ RSDS_L_SGU10_Checksum6 : 327|8@0+ (1,0) [0|255] "NoUnit"  IDM
 SG_ RSDS_L_SGU10_RollingCounter5 : 315|4@0+ (1,0) [0|14] "NoUnit"  IDM
 SG_ RSDS_L_ObjType_20 : 319|4@0+ (1,0) [0|15] "NoUnit"  IDM
 SG_ RSDS_L_ObjDistXStd_20 : 310|6@0+ (0.1,0) [0|6] "m"  IDM
 SG_ RSDS_L_ObjDistY_20 : 289|11@0+ (0.125,-128) [-128|127.875] "m"  IDM
 SG_ RSDS_L_ObjDistX_20 : 285|12@0+ (0.0625,-128) [-128|126.9375] "m"  IDM
 SG_ RSDS_L_ObjObstacleProb_20 : 274|5@0+ (0.03326,0) [0|1.03106] "NoUnit"  IDM
 SG_ RSDS_L_ObjExistProb_20 : 279|5@0+ (0.03326,0) [0|1.03106] "NoUnit"  IDM
 SG_ RSDS_L_ObjID_20 : 271|8@0+ (1,0) [0|255] "NoUnit"  IDM
 SG_ RSDS_L_SGU10_Checksum5 : 263|8@0+ (1,0) [0|255] "NoUnit"  IDM
 SG_ RSDS_L_SGU10_RollingCounter4 : 251|4@0+ (1,0) [0|14] "NoUnit"  IDM
 SG_ RSDS_L_HWATargetValidity_19 : 240|1@0+ (1,0) [0|1] "NoUnit"  IDM
 SG_ RSDS_L_ObjRefPoint_19 : 243|3@0+ (1,0) [0|7] "NoUnit"  IDM
 SG_ RSDS_L_ObjRCS_19 : 237|10@0+ (0.125,-50) [-50|70] "dBsm"  IDM
 SG_ RSDS_L_ObjYawrate_19 : 217|12@0+ (0.002,-3.14) [-3.14|5.05] "radPerSec"  IDM
 SG_ RSDS_L_ObjHeading_19 : 213|12@0+ (0.002,-3.14) [-3.14|5.05] "rad"  IDM
 SG_ RSDS_L_ObjLength_19 : 207|10@0+ (0.05,0) [0|20] "m"  IDM
 SG_ RSDS_L_SGU10_Checksum4 : 199|8@0+ (1,0) [0|255] "NoUnit"  IDM
 SG_ RSDS_L_SGU10_RollingCounter3 : 187|4@0+ (1,0) [0|14] "NoUnit"  IDM
 SG_ RSDS_L_ObjMotionDirection_19 : 191|3@0+ (1,0) [0|7] "NoUnit"  IDM
 SG_ RSDS_L_ObjAge_19 : 183|8@0+ (1,0) [0|255] "NoUnit"  IDM
 SG_ RSDS_L_ObjWidth_19 : 161|10@0+ (0.01,0) [0|5] "m"  IDM
 SG_ RSDS_L_ObjRAccelYStd_19 : 167|6@0+ (0.0625,0) [0|3.9375] "MtrPerSecSq"  IDM
 SG_ RSDS_L_ObjRAccelXStd_19 : 157|6@0+ (0.0625,0) [0|3.9375] "MtrPerSecSq"  IDM
 SG_ RSDS_L_ObjRelVelYStd_19 : 147|6@0+ (0.0625,0) [0|3.9375] "mps"  IDM
 SG_ RSDS_L_ObjRelVelXStd_19 : 137|6@0+ (0.0625,0) [0|3.9375] "mps"  IDM
 SG_ RSDS_L_ObjDistYStd_19 : 143|6@0+ (0.1,0) [0|6] "m"  IDM
 SG_ RSDS_L_SGU10_Checksum3 : 135|8@0+ (1,0) [0|255] "NoUnit"  IDM
 SG_ RSDS_L_SGU10_RollingCounter2 : 123|4@0+ (1,0) [0|14] "NoUnit"  IDM
 SG_ RSDS_L_ObjMotionType_19 : 127|3@0+ (1,0) [0|7] "NoUnit"  IDM
 SG_ RSDS_L_ObjMeasured_19 : 113|2@0+ (1,0) [0|3] "NoUnit"  IDM
 SG_ RSDS_L_ObjRelAccelY_19 : 107|10@0+ (0.03125,-16) [-16|15.96875] "MtrPerSecSq"  IDM
 SG_ RSDS_L_ObjRelAccelX_19 : 101|10@0+ (0.03125,-16) [-16|15.96875] "MtrPerSecSq"  IDM
 SG_ RSDS_L_ObjRelVelY_19 : 82|13@0+ (0.0312,-128) [-128|126.9976] "mps"  IDM
 SG_ RSDS_L_ObjRelVelX_19 : 79|13@0+ (0.0312,-128) [-128|126.9976] "mps"  IDM
 SG_ RSDS_L_SGU10_Checksum2 : 71|8@0+ (1,0) [0|255] "NoUnit"  IDM
 SG_ RSDS_L_SGU10_RollingCounter1 : 59|4@0+ (1,0) [0|14] "NoUnit"  IDM
 SG_ RSDS_L_ObjType_19 : 63|4@0+ (1,0) [0|15] "NoUnit"  IDM
 SG_ RSDS_L_ObjDistXStd_19 : 54|6@0+ (0.1,0) [0|6] "m"  IDM
 SG_ RSDS_L_ObjDistY_19 : 33|11@0+ (0.125,-128) [-128|127.875] "m"  IDM
 SG_ RSDS_L_ObjDistX_19 : 29|12@0+ (0.0625,-128) [-128|126.9375] "m"  IDM
 SG_ RSDS_L_ObjObstacleProb_19 : 18|5@0+ (0.03326,0) [0|1.03106] "NoUnit"  IDM
 SG_ RSDS_L_ObjExistProb_19 : 23|5@0+ (0.03326,0) [0|1.03106] "NoUnit"  IDM
 SG_ RSDS_L_ObjID_19 : 15|8@0+ (1,0) [0|255] "NoUnit"  IDM
 SG_ RSDS_L_SGU10_Checksum1 : 7|8@0+ (1,0) [0|255] "NoUnit"  IDM

CM_ SG_ 1136 Sync_SyncTime "/";
CM_ SG_ 1136 Sync_OVS "/";
CM_ SG_ 1136 Sync_SGW "/";
CM_ SG_ 1136 Sync_Resd "/";
CM_ SG_ 1136 Sync_Counter "/";
CM_ SG_ 1136 Sync_TimeDomain "/";
CM_ SG_ 1136 Sync_CRC "/";
CM_ SG_ 1136 Sync_Type "/";
CM_ SG_ 1408 RSDS_L_SGU1_RollingCounter8 "/";
CM_ SG_ 1408 RSDS_L_SGU1_BlockCounter "/";
CM_ SG_ 1408 RSDS_L_HWATargetValidity_2 "/";
CM_ SG_ 1408 RSDS_L_ObjRefPoint_2 "/";
CM_ SG_ 1408 RSDS_L_ObjRCS_2 "/";
CM_ SG_ 1408 RSDS_L_ObjYawrate_2 "/";
CM_ SG_ 1408 RSDS_L_ObjHeading_2 "/";
CM_ SG_ 1408 RSDS_L_ObjLength_2 "/";
CM_ SG_ 1408 RSDS_L_SGU1_Checksum8 "/";
CM_ SG_ 1408 RSDS_L_SGU1_RollingCounter7 "/";
CM_ SG_ 1408 RSDS_L_ObjMotionDirection_2 "/";
CM_ SG_ 1408 RSDS_L_ObjAge_2 "/";
CM_ SG_ 1408 RSDS_L_ObjWidth_2 "/";
CM_ SG_ 1408 RSDS_L_ObjRAccelYStd_2 "/";
CM_ SG_ 1408 RSDS_L_ObjRAccelXStd_2 "/";
CM_ SG_ 1408 RSDS_L_ObjRelVelYStd_2 "/";
CM_ SG_ 1408 RSDS_L_ObjRelVelXStd_2 "/";
CM_ SG_ 1408 RSDS_L_ObjDistYStd_2 "/";
CM_ SG_ 1408 RSDS_L_SGU1_Checksum7 "/";
CM_ SG_ 1408 RSDS_L_SGU1_RollingCounter6 "/";
CM_ SG_ 1408 RSDS_L_ObjMotionType_2 "/";
CM_ SG_ 1408 RSDS_L_ObjMeasured_2 "/";
CM_ SG_ 1408 RSDS_L_ObjRelAccelY_2 "/";
CM_ SG_ 1408 RSDS_L_ObjRelAccelX_2 "/";
CM_ SG_ 1408 RSDS_L_ObjRelVelY_2 "/";
CM_ SG_ 1408 RSDS_L_ObjRelVelX_2 "/";
CM_ SG_ 1408 RSDS_L_SGU1_Checksum6 "/";
CM_ SG_ 1408 RSDS_L_SGU1_RollingCounter5 "/";
CM_ SG_ 1408 RSDS_L_ObjType_2 "/";
CM_ SG_ 1408 RSDS_L_ObjDistXStd_2 "/";
CM_ SG_ 1408 RSDS_L_ObjDistY_2 "/";
CM_ SG_ 1408 RSDS_L_ObjDistX_2 "/";
CM_ SG_ 1408 RSDS_L_ObjObstacleProb_2 "/";
CM_ SG_ 1408 RSDS_L_ObjExistProb_2 "/";
CM_ SG_ 1408 RSDS_L_ObjID_2 "/";
CM_ SG_ 1408 RSDS_L_SGU1_Checksum5 "/";
CM_ SG_ 1408 RSDS_L_SGU1_RollingCounter4 "/";
CM_ SG_ 1408 RSDS_L_HWATargetValidity_1 "/";
CM_ SG_ 1408 RSDS_L_ObjRefPoint_1 "/";
CM_ SG_ 1408 RSDS_L_ObjRCS_1 "/";
CM_ SG_ 1408 RSDS_L_ObjYawrate_1 "/";
CM_ SG_ 1408 RSDS_L_ObjHeading_1 "/";
CM_ SG_ 1408 RSDS_L_ObjLength_1 "/";
CM_ SG_ 1408 RSDS_L_SGU1_Checksum4 "/";
CM_ SG_ 1408 RSDS_L_SGU1_RollingCounter3 "/";
CM_ SG_ 1408 RSDS_L_ObjMotionDirection_1 "/";
CM_ SG_ 1408 RSDS_L_ObjAge_1 "/";
CM_ SG_ 1408 RSDS_L_ObjWidth_1 "/";
CM_ SG_ 1408 RSDS_L_ObjRAccelYStd_1 "/";
CM_ SG_ 1408 RSDS_L_ObjRAccelXStd_1 "/";
CM_ SG_ 1408 RSDS_L_ObjRelVelYStd_1 "/";
CM_ SG_ 1408 RSDS_L_ObjRelVelXStd_1 "/";
CM_ SG_ 1408 RSDS_L_ObjDistYStd_1 "/";
CM_ SG_ 1408 RSDS_L_SGU1_Checksum3 "/";
CM_ SG_ 1408 RSDS_L_SGU1_RollingCounter2 "/";
CM_ SG_ 1408 RSDS_L_ObjMotionType_1 "/";
CM_ SG_ 1408 RSDS_L_ObjMeasured_1 "/";
CM_ SG_ 1408 RSDS_L_ObjRelAccelY_1 "/";
CM_ SG_ 1408 RSDS_L_ObjRelAccelX_1 "/";
CM_ SG_ 1408 RSDS_L_ObjRelVelY_1 "/";
CM_ SG_ 1408 RSDS_L_ObjRelVelX_1 "/";
CM_ SG_ 1408 RSDS_L_SGU1_Checksum2 "/";
CM_ SG_ 1408 RSDS_L_SGU1_RollingCounter1 "/";
CM_ SG_ 1408 RSDS_L_ObjType_1 "/";
CM_ SG_ 1408 RSDS_L_ObjDistXStd_1 "/";
CM_ SG_ 1408 RSDS_L_ObjDistY_1 "/";
CM_ SG_ 1408 RSDS_L_ObjDistX_1 "/";
CM_ SG_ 1408 RSDS_L_ObjObstacleProb_1 "/";
CM_ SG_ 1408 RSDS_L_ObjExistProb_1 "/";
CM_ SG_ 1408 RSDS_L_ObjID_1 "/";
CM_ SG_ 1408 RSDS_L_SGU1_Checksum1 "/";
CM_ SG_ 1409 RSDS_L_SGU2_RollingCounter8 "/";
CM_ SG_ 1409 RSDS_L_SGU2_BlockCounter "/";
CM_ SG_ 1409 RSDS_L_HWATargetValidity_4 "/";
CM_ SG_ 1409 RSDS_L_ObjRefPoint_4 "/";
CM_ SG_ 1409 RSDS_L_ObjRCS_4 "/";
CM_ SG_ 1409 RSDS_L_ObjYawrate_4 "/";
CM_ SG_ 1409 RSDS_L_ObjHeading_4 "/";
CM_ SG_ 1409 RSDS_L_ObjLength_4 "/";
CM_ SG_ 1409 RSDS_L_SGU2_Checksum8 "/";
CM_ SG_ 1409 RSDS_L_SGU2_RollingCounter7 "/";
CM_ SG_ 1409 RSDS_L_ObjMotionDirection_4 "/";
CM_ SG_ 1409 RSDS_L_ObjAge_4 "/";
CM_ SG_ 1409 RSDS_L_ObjWidth_4 "/";
CM_ SG_ 1409 RSDS_L_ObjRAccelYStd_4 "/";
CM_ SG_ 1409 RSDS_L_ObjRAccelXStd_4 "/";
CM_ SG_ 1409 RSDS_L_ObjRelVelYStd_4 "/";
CM_ SG_ 1409 RSDS_L_ObjRelVelXStd_4 "/";
CM_ SG_ 1409 RSDS_L_ObjDistYStd_4 "/";
CM_ SG_ 1409 RSDS_L_SGU2_Checksum7 "/";
CM_ SG_ 1409 RSDS_L_SGU2_RollingCounter6 "/";
CM_ SG_ 1409 RSDS_L_ObjMotionType_4 "/";
CM_ SG_ 1409 RSDS_L_ObjMeasured_4 "/";
CM_ SG_ 1409 RSDS_L_ObjRelAccelY_4 "/";
CM_ SG_ 1409 RSDS_L_ObjRelAccelX_4 "/";
CM_ SG_ 1409 RSDS_L_ObjRelVelY_4 "/";
CM_ SG_ 1409 RSDS_L_ObjRelVelX_4 "/";
CM_ SG_ 1409 RSDS_L_SGU2_Checksum6 "/";
CM_ SG_ 1409 RSDS_L_SGU2_RollingCounter5 "/";
CM_ SG_ 1409 RSDS_L_ObjType_4 "/";
CM_ SG_ 1409 RSDS_L_ObjDistXStd_4 "/";
CM_ SG_ 1409 RSDS_L_ObjDistY_4 "/";
CM_ SG_ 1409 RSDS_L_ObjDistX_4 "/";
CM_ SG_ 1409 RSDS_L_ObjObstacleProb_4 "/";
CM_ SG_ 1409 RSDS_L_ObjExistProb_4 "/";
CM_ SG_ 1409 RSDS_L_ObjID_4 "/";
CM_ SG_ 1409 RSDS_L_SGU2_Checksum5 "/";
CM_ SG_ 1409 RSDS_L_SGU2_RollingCounter4 "/";
CM_ SG_ 1409 RSDS_L_HWATargetValidity_3 "/";
CM_ SG_ 1409 RSDS_L_ObjRefPoint_3 "/";
CM_ SG_ 1409 RSDS_L_ObjRCS_3 "/";
CM_ SG_ 1409 RSDS_L_ObjYawrate_3 "/";
CM_ SG_ 1409 RSDS_L_ObjHeading_3 "/";
CM_ SG_ 1409 RSDS_L_ObjLength_3 "/";
CM_ SG_ 1409 RSDS_L_SGU2_Checksum4 "/";
CM_ SG_ 1409 RSDS_L_SGU2_RollingCounter3 "/";
CM_ SG_ 1409 RSDS_L_ObjMotionDirection_3 "/";
CM_ SG_ 1409 RSDS_L_ObjAge_3 "/";
CM_ SG_ 1409 RSDS_L_ObjWidth_3 "/";
CM_ SG_ 1409 RSDS_L_ObjRAccelYStd_3 "/";
CM_ SG_ 1409 RSDS_L_ObjRAccelXStd_3 "/";
CM_ SG_ 1409 RSDS_L_ObjRelVelYStd_3 "/";
CM_ SG_ 1409 RSDS_L_ObjRelVelXStd_3 "/";
CM_ SG_ 1409 RSDS_L_ObjDistYStd_3 "/";
CM_ SG_ 1409 RSDS_L_SGU2_Checksum3 "/";
CM_ SG_ 1409 RSDS_L_SGU2_RollingCounter2 "/";
CM_ SG_ 1409 RSDS_L_ObjMotionType_3 "/";
CM_ SG_ 1409 RSDS_L_ObjMeasured_3 "/";
CM_ SG_ 1409 RSDS_L_ObjRelAccelY_3 "/";
CM_ SG_ 1409 RSDS_L_ObjRelAccelX_3 "/";
CM_ SG_ 1409 RSDS_L_ObjRelVelY_3 "/";
CM_ SG_ 1409 RSDS_L_ObjRelVelX_3 "/";
CM_ SG_ 1409 RSDS_L_SGU2_Checksum2 "/";
CM_ SG_ 1409 RSDS_L_SGU2_RollingCounter1 "/";
CM_ SG_ 1409 RSDS_L_ObjType_3 "/";
CM_ SG_ 1409 RSDS_L_ObjDistXStd_3 "/";
CM_ SG_ 1409 RSDS_L_ObjDistY_3 "/";
CM_ SG_ 1409 RSDS_L_ObjDistX_3 "/";
CM_ SG_ 1409 RSDS_L_ObjObstacleProb_3 "/";
CM_ SG_ 1409 RSDS_L_ObjExistProb_3 "/";
CM_ SG_ 1409 RSDS_L_ObjID_3 "/";
CM_ SG_ 1409 RSDS_L_SGU2_Checksum1 "/";
CM_ SG_ 1410 RSDS_L_SGU3_RollingCounter8 "/";
CM_ SG_ 1410 RSDS_L_SGU3_BlockCounter "/";
CM_ SG_ 1410 RSDS_L_HWATargetValidity_6 "/";
CM_ SG_ 1410 RSDS_L_ObjRefPoint_6 "/";
CM_ SG_ 1410 RSDS_L_ObjRCS_6 "/";
CM_ SG_ 1410 RSDS_L_ObjYawrate_6 "/";
CM_ SG_ 1410 RSDS_L_ObjHeading_6 "/";
CM_ SG_ 1410 RSDS_L_ObjLength_6 "/";
CM_ SG_ 1410 RSDS_L_SGU3_Checksum8 "/";
CM_ SG_ 1410 RSDS_L_SGU3_RollingCounter7 "/";
CM_ SG_ 1410 RSDS_L_ObjMotionDirection_6 "/";
CM_ SG_ 1410 RSDS_L_ObjAge_6 "/";
CM_ SG_ 1410 RSDS_L_ObjWidth_6 "/";
CM_ SG_ 1410 RSDS_L_ObjRAccelYStd_6 "/";
CM_ SG_ 1410 RSDS_L_ObjRAccelXStd_6 "/";
CM_ SG_ 1410 RSDS_L_ObjRelVelYStd_6 "/";
CM_ SG_ 1410 RSDS_L_ObjRelVelXStd_6 "/";
CM_ SG_ 1410 RSDS_L_ObjDistYStd_6 "/";
CM_ SG_ 1410 RSDS_L_SGU3_Checksum7 "/";
CM_ SG_ 1410 RSDS_L_SGU3_RollingCounter6 "/";
CM_ SG_ 1410 RSDS_L_ObjMotionType_6 "/";
CM_ SG_ 1410 RSDS_L_ObjMeasured_6 "/";
CM_ SG_ 1410 RSDS_L_ObjRelAccelY_6 "/";
CM_ SG_ 1410 RSDS_L_ObjRelAccelX_6 "/";
CM_ SG_ 1410 RSDS_L_ObjRelVelY_6 "/";
CM_ SG_ 1410 RSDS_L_ObjRelVelX_6 "/";
CM_ SG_ 1410 RSDS_L_SGU3_Checksum6 "/";
CM_ SG_ 1410 RSDS_L_SGU3_RollingCounter5 "/";
CM_ SG_ 1410 RSDS_L_ObjType_6 "/";
CM_ SG_ 1410 RSDS_L_ObjDistXStd_6 "/";
CM_ SG_ 1410 RSDS_L_ObjDistY_6 "/";
CM_ SG_ 1410 RSDS_L_ObjDistX_6 "/";
CM_ SG_ 1410 RSDS_L_ObjObstacleProb_6 "/";
CM_ SG_ 1410 RSDS_L_ObjExistProb_6 "/";
CM_ SG_ 1410 RSDS_L_ObjID_6 "/";
CM_ SG_ 1410 RSDS_L_SGU3_Checksum5 "/";
CM_ SG_ 1410 RSDS_L_SGU3_RollingCounter4 "/";
CM_ SG_ 1410 RSDS_L_HWATargetValidity_5 "/";
CM_ SG_ 1410 RSDS_L_ObjRefPoint_5 "/";
CM_ SG_ 1410 RSDS_L_ObjRCS_5 "/";
CM_ SG_ 1410 RSDS_L_ObjYawrate_5 "/";
CM_ SG_ 1410 RSDS_L_ObjHeading_5 "/";
CM_ SG_ 1410 RSDS_L_ObjLength_5 "/";
CM_ SG_ 1410 RSDS_L_SGU3_Checksum4 "/";
CM_ SG_ 1410 RSDS_L_SGU3_RollingCounter3 "/";
CM_ SG_ 1410 RSDS_L_ObjMotionDirection_5 "/";
CM_ SG_ 1410 RSDS_L_ObjAge_5 "/";
CM_ SG_ 1410 RSDS_L_ObjWidth_5 "/";
CM_ SG_ 1410 RSDS_L_ObjRAccelYStd_5 "/";
CM_ SG_ 1410 RSDS_L_ObjRAccelXStd_5 "/";
CM_ SG_ 1410 RSDS_L_ObjRelVelYStd_5 "/";
CM_ SG_ 1410 RSDS_L_ObjRelVelXStd_5 "/";
CM_ SG_ 1410 RSDS_L_ObjDistYStd_5 "/";
CM_ SG_ 1410 RSDS_L_SGU3_Checksum3 "/";
CM_ SG_ 1410 RSDS_L_SGU3_RollingCounter2 "/";
CM_ SG_ 1410 RSDS_L_ObjMotionType_5 "/";
CM_ SG_ 1410 RSDS_L_ObjMeasured_5 "/";
CM_ SG_ 1410 RSDS_L_ObjRelAccelY_5 "/";
CM_ SG_ 1410 RSDS_L_ObjRelAccelX_5 "/";
CM_ SG_ 1410 RSDS_L_ObjRelVelY_5 "/";
CM_ SG_ 1410 RSDS_L_ObjRelVelX_5 "/";
CM_ SG_ 1410 RSDS_L_SGU3_Checksum2 "/";
CM_ SG_ 1410 RSDS_L_SGU3_RollingCounter1 "/";
CM_ SG_ 1410 RSDS_L_ObjType_5 "/";
CM_ SG_ 1410 RSDS_L_ObjDistXStd_5 "/";
CM_ SG_ 1410 RSDS_L_ObjDistY_5 "/";
CM_ SG_ 1410 RSDS_L_ObjDistX_5 "/";
CM_ SG_ 1410 RSDS_L_ObjObstacleProb_5 "/";
CM_ SG_ 1410 RSDS_L_ObjExistProb_5 "/";
CM_ SG_ 1410 RSDS_L_ObjID_5 "/";
CM_ SG_ 1410 RSDS_L_SGU3_Checksum1 "/";
CM_ SG_ 1411 RSDS_L_SGU4_RollingCounter8 "/";
CM_ SG_ 1411 RSDS_L_SGU4_BlockCounter "/";
CM_ SG_ 1411 RSDS_L_HWATargetValidity_8 "/";
CM_ SG_ 1411 RSDS_L_ObjRefPoint_8 "/";
CM_ SG_ 1411 RSDS_L_ObjRCS_8 "/";
CM_ SG_ 1411 RSDS_L_ObjYawrate_8 "/";
CM_ SG_ 1411 RSDS_L_ObjHeading_8 "/";
CM_ SG_ 1411 RSDS_L_ObjLength_8 "/";
CM_ SG_ 1411 RSDS_L_SGU4_Checksum8 "/";
CM_ SG_ 1411 RSDS_L_SGU4_RollingCounter7 "/";
CM_ SG_ 1411 RSDS_L_ObjMotionDirection_8 "/";
CM_ SG_ 1411 RSDS_L_ObjAge_8 "/";
CM_ SG_ 1411 RSDS_L_ObjWidth_8 "/";
CM_ SG_ 1411 RSDS_L_ObjRAccelYStd_8 "/";
CM_ SG_ 1411 RSDS_L_ObjRAccelXStd_8 "/";
CM_ SG_ 1411 RSDS_L_ObjRelVelYStd_8 "/";
CM_ SG_ 1411 RSDS_L_ObjRelVelXStd_8 "/";
CM_ SG_ 1411 RSDS_L_ObjDistYStd_8 "/";
CM_ SG_ 1411 RSDS_L_SGU4_Checksum7 "/";
CM_ SG_ 1411 RSDS_L_SGU4_RollingCounter6 "/";
CM_ SG_ 1411 RSDS_L_ObjMotionType_8 "/";
CM_ SG_ 1411 RSDS_L_ObjMeasured_8 "/";
CM_ SG_ 1411 RSDS_L_ObjRelAccelY_8 "/";
CM_ SG_ 1411 RSDS_L_ObjRelAccelX_8 "/";
CM_ SG_ 1411 RSDS_L_ObjRelVelY_8 "/";
CM_ SG_ 1411 RSDS_L_ObjRelVelX_8 "/";
CM_ SG_ 1411 RSDS_L_SGU4_Checksum6 "/";
CM_ SG_ 1411 RSDS_L_SGU4_RollingCounter5 "/";
CM_ SG_ 1411 RSDS_L_ObjType_8 "/";
CM_ SG_ 1411 RSDS_L_ObjDistXStd_8 "/";
CM_ SG_ 1411 RSDS_L_ObjDistY_8 "/";
CM_ SG_ 1411 RSDS_L_ObjDistX_8 "/";
CM_ SG_ 1411 RSDS_L_ObjObstacleProb_8 "/";
CM_ SG_ 1411 RSDS_L_ObjExistProb_8 "/";
CM_ SG_ 1411 RSDS_L_ObjID_8 "/";
CM_ SG_ 1411 RSDS_L_SGU4_Checksum5 "/";
CM_ SG_ 1411 RSDS_L_SGU4_RollingCounter4 "/";
CM_ SG_ 1411 RSDS_L_HWATargetValidity_7 "/";
CM_ SG_ 1411 RSDS_L_ObjRefPoint_7 "/";
CM_ SG_ 1411 RSDS_L_ObjRCS_7 "/";
CM_ SG_ 1411 RSDS_L_ObjYawrate_7 "/";
CM_ SG_ 1411 RSDS_L_ObjHeading_7 "/";
CM_ SG_ 1411 RSDS_L_ObjLength_7 "/";
CM_ SG_ 1411 RSDS_L_SGU4_Checksum4 "/";
CM_ SG_ 1411 RSDS_L_SGU4_RollingCounter3 "/";
CM_ SG_ 1411 RSDS_L_ObjMotionDirection_7 "/";
CM_ SG_ 1411 RSDS_L_ObjAge_7 "/";
CM_ SG_ 1411 RSDS_L_ObjWidth_7 "/";
CM_ SG_ 1411 RSDS_L_ObjRAccelYStd_7 "/";
CM_ SG_ 1411 RSDS_L_ObjRAccelXStd_7 "/";
CM_ SG_ 1411 RSDS_L_ObjRelVelYStd_7 "/";
CM_ SG_ 1411 RSDS_L_ObjRelVelXStd_7 "/";
CM_ SG_ 1411 RSDS_L_ObjDistYStd_7 "/";
CM_ SG_ 1411 RSDS_L_SGU4_Checksum3 "/";
CM_ SG_ 1411 RSDS_L_SGU4_RollingCounter2 "/";
CM_ SG_ 1411 RSDS_L_ObjMotionType_7 "/";
CM_ SG_ 1411 RSDS_L_ObjMeasured_7 "/";
CM_ SG_ 1411 RSDS_L_ObjRelAccelY_7 "/";
CM_ SG_ 1411 RSDS_L_ObjRelAccelX_7 "/";
CM_ SG_ 1411 RSDS_L_ObjRelVelY_7 "/";
CM_ SG_ 1411 RSDS_L_ObjRelVelX_7 "/";
CM_ SG_ 1411 RSDS_L_SGU4_Checksum2 "/";
CM_ SG_ 1411 RSDS_L_SGU4_RollingCounter1 "/";
CM_ SG_ 1411 RSDS_L_ObjType_7 "/";
CM_ SG_ 1411 RSDS_L_ObjDistXStd_7 "/";
CM_ SG_ 1411 RSDS_L_ObjDistY_7 "/";
CM_ SG_ 1411 RSDS_L_ObjDistX_7 "/";
CM_ SG_ 1411 RSDS_L_ObjObstacleProb_7 "/";
CM_ SG_ 1411 RSDS_L_ObjExistProb_7 "/";
CM_ SG_ 1411 RSDS_L_ObjID_7 "/";
CM_ SG_ 1411 RSDS_L_SGU4_Checksum1 "/";
CM_ SG_ 1412 RSDS_L_SGU5_RollingCounter8 "/";
CM_ SG_ 1412 RSDS_L_SGU5_BlockCounter "/";
CM_ SG_ 1412 RSDS_L_HWATargetValidity_10 "/";
CM_ SG_ 1412 RSDS_L_ObjRefPoint_10 "/";
CM_ SG_ 1412 RSDS_L_ObjRCS_10 "/";
CM_ SG_ 1412 RSDS_L_ObjYawrate_10 "/";
CM_ SG_ 1412 RSDS_L_ObjHeading_10 "/";
CM_ SG_ 1412 RSDS_L_ObjLength_10 "/";
CM_ SG_ 1412 RSDS_L_SGU5_Checksum8 "/";
CM_ SG_ 1412 RSDS_L_SGU5_RollingCounter7 "/";
CM_ SG_ 1412 RSDS_L_ObjMotionDirection_10 "/";
CM_ SG_ 1412 RSDS_L_ObjAge_10 "/";
CM_ SG_ 1412 RSDS_L_ObjWidth_10 "/";
CM_ SG_ 1412 RSDS_L_ObjRAccelYStd_10 "/";
CM_ SG_ 1412 RSDS_L_ObjRAccelXStd_10 "/";
CM_ SG_ 1412 RSDS_L_ObjRelVelYStd_10 "/";
CM_ SG_ 1412 RSDS_L_ObjRelVelXStd_10 "/";
CM_ SG_ 1412 RSDS_L_ObjDistYStd_10 "/";
CM_ SG_ 1412 RSDS_L_SGU5_Checksum7 "/";
CM_ SG_ 1412 RSDS_L_SGU5_RollingCounter6 "/";
CM_ SG_ 1412 RSDS_L_ObjMotionType_10 "/";
CM_ SG_ 1412 RSDS_L_ObjMeasured_10 "/";
CM_ SG_ 1412 RSDS_L_ObjRelAccelY_10 "/";
CM_ SG_ 1412 RSDS_L_ObjRelAccelX_10 "/";
CM_ SG_ 1412 RSDS_L_ObjRelVelY_10 "/";
CM_ SG_ 1412 RSDS_L_ObjRelVelX_10 "/";
CM_ SG_ 1412 RSDS_L_SGU5_Checksum6 "/";
CM_ SG_ 1412 RSDS_L_SGU5_RollingCounter5 "/";
CM_ SG_ 1412 RSDS_L_ObjType_10 "/";
CM_ SG_ 1412 RSDS_L_ObjDistXStd_10 "/";
CM_ SG_ 1412 RSDS_L_ObjDistY_10 "/";
CM_ SG_ 1412 RSDS_L_ObjDistX_10 "/";
CM_ SG_ 1412 RSDS_L_ObjObstacleProb_10 "/";
CM_ SG_ 1412 RSDS_L_ObjExistProb_10 "/";
CM_ SG_ 1412 RSDS_L_ObjID_10 "/";
CM_ SG_ 1412 RSDS_L_SGU5_Checksum5 "/";
CM_ SG_ 1412 RSDS_L_SGU5_RollingCounter4 "/";
CM_ SG_ 1412 RSDS_L_HWATargetValidity_9 "/";
CM_ SG_ 1412 RSDS_L_ObjRefPoint_9 "/";
CM_ SG_ 1412 RSDS_L_ObjRCS_9 "/";
CM_ SG_ 1412 RSDS_L_ObjYawrate_9 "/";
CM_ SG_ 1412 RSDS_L_ObjHeading_9 "/";
CM_ SG_ 1412 RSDS_L_ObjLength_9 "/";
CM_ SG_ 1412 RSDS_L_SGU5_Checksum4 "/";
CM_ SG_ 1412 RSDS_L_SGU5_RollingCounter3 "/";
CM_ SG_ 1412 RSDS_L_ObjMotionDirection_9 "/";
CM_ SG_ 1412 RSDS_L_ObjAge_9 "/";
CM_ SG_ 1412 RSDS_L_ObjWidth_9 "/";
CM_ SG_ 1412 RSDS_L_ObjRAccelYStd_9 "/";
CM_ SG_ 1412 RSDS_L_ObjRAccelXStd_9 "/";
CM_ SG_ 1412 RSDS_L_ObjRelVelYStd_9 "/";
CM_ SG_ 1412 RSDS_L_ObjRelVelXStd_9 "/";
CM_ SG_ 1412 RSDS_L_ObjDistYStd_9 "/";
CM_ SG_ 1412 RSDS_L_SGU5_Checksum3 "/";
CM_ SG_ 1412 RSDS_L_SGU5_RollingCounter2 "/";
CM_ SG_ 1412 RSDS_L_ObjMotionType_9 "/";
CM_ SG_ 1412 RSDS_L_ObjMeasured_9 "/";
CM_ SG_ 1412 RSDS_L_ObjRelAccelY_9 "/";
CM_ SG_ 1412 RSDS_L_ObjRelAccelX_9 "/";
CM_ SG_ 1412 RSDS_L_ObjRelVelY_9 "/";
CM_ SG_ 1412 RSDS_L_ObjRelVelX_9 "/";
CM_ SG_ 1412 RSDS_L_SGU5_Checksum2 "/";
CM_ SG_ 1412 RSDS_L_SGU5_RollingCounter1 "/";
CM_ SG_ 1412 RSDS_L_ObjType_9 "/";
CM_ SG_ 1412 RSDS_L_ObjDistXStd_9 "/";
CM_ SG_ 1412 RSDS_L_ObjDistY_9 "/";
CM_ SG_ 1412 RSDS_L_ObjDistX_9 "/";
CM_ SG_ 1412 RSDS_L_ObjObstacleProb_9 "/";
CM_ SG_ 1412 RSDS_L_ObjExistProb_9 "/";
CM_ SG_ 1412 RSDS_L_ObjID_9 "/";
CM_ SG_ 1412 RSDS_L_SGU5_Checksum1 "/";
CM_ SG_ 1413 RSDS_L_SGU6_RollingCounter8 "/";
CM_ SG_ 1413 RSDS_L_SGU6_BlockCounter "/";
CM_ SG_ 1413 RSDS_L_HWATargetValidity_12 "/";
CM_ SG_ 1413 RSDS_L_ObjRefPoint_12 "/";
CM_ SG_ 1413 RSDS_L_ObjRCS_12 "/";
CM_ SG_ 1413 RSDS_L_ObjYawrate_12 "/";
CM_ SG_ 1413 RSDS_L_ObjHeading_12 "/";
CM_ SG_ 1413 RSDS_L_ObjLength_12 "/";
CM_ SG_ 1413 RSDS_L_SGU6_Checksum8 "/";
CM_ SG_ 1413 RSDS_L_SGU6_RollingCounter7 "/";
CM_ SG_ 1413 RSDS_L_ObjMotionDirection_12 "/";
CM_ SG_ 1413 RSDS_L_ObjAge_12 "/";
CM_ SG_ 1413 RSDS_L_ObjWidth_12 "/";
CM_ SG_ 1413 RSDS_L_ObjRAccelYStd_12 "/";
CM_ SG_ 1413 RSDS_L_ObjRAccelXStd_12 "/";
CM_ SG_ 1413 RSDS_L_ObjRelVelYStd_12 "/";
CM_ SG_ 1413 RSDS_L_ObjRelVelXStd_12 "/";
CM_ SG_ 1413 RSDS_L_ObjDistYStd_12 "/";
CM_ SG_ 1413 RSDS_L_SGU6_Checksum7 "/";
CM_ SG_ 1413 RSDS_L_SGU6_RollingCounter6 "/";
CM_ SG_ 1413 RSDS_L_ObjMotionType_12 "/";
CM_ SG_ 1413 RSDS_L_ObjMeasured_12 "/";
CM_ SG_ 1413 RSDS_L_ObjRelAccelY_12 "/";
CM_ SG_ 1413 RSDS_L_ObjRelAccelX_12 "/";
CM_ SG_ 1413 RSDS_L_ObjRelVelY_12 "/";
CM_ SG_ 1413 RSDS_L_ObjRelVelX_12 "/";
CM_ SG_ 1413 RSDS_L_SGU6_Checksum6 "/";
CM_ SG_ 1413 RSDS_L_SGU6_RollingCounter5 "/";
CM_ SG_ 1413 RSDS_L_ObjType_12 "/";
CM_ SG_ 1413 RSDS_L_ObjDistXStd_12 "/";
CM_ SG_ 1413 RSDS_L_ObjDistY_12 "/";
CM_ SG_ 1413 RSDS_L_ObjDistX_12 "/";
CM_ SG_ 1413 RSDS_L_ObjObstacleProb_12 "/";
CM_ SG_ 1413 RSDS_L_ObjExistProb_12 "/";
CM_ SG_ 1413 RSDS_L_ObjID_12 "/";
CM_ SG_ 1413 RSDS_L_SGU6_Checksum5 "/";
CM_ SG_ 1413 RSDS_L_SGU6_RollingCounter4 "/";
CM_ SG_ 1413 RSDS_L_HWATargetValidity_11 "/";
CM_ SG_ 1413 RSDS_L_ObjRefPoint_11 "/";
CM_ SG_ 1413 RSDS_L_ObjRCS_11 "/";
CM_ SG_ 1413 RSDS_L_ObjYawrate_11 "/";
CM_ SG_ 1413 RSDS_L_ObjHeading_11 "/";
CM_ SG_ 1413 RSDS_L_ObjLength_11 "/";
CM_ SG_ 1413 RSDS_L_SGU6_Checksum4 "/";
CM_ SG_ 1413 RSDS_L_SGU6_RollingCounter3 "/";
CM_ SG_ 1413 RSDS_L_ObjMotionDirection_11 "/";
CM_ SG_ 1413 RSDS_L_ObjAge_11 "/";
CM_ SG_ 1413 RSDS_L_ObjWidth_11 "/";
CM_ SG_ 1413 RSDS_L_ObjRAccelYStd_11 "/";
CM_ SG_ 1413 RSDS_L_ObjRAccelXStd_11 "/";
CM_ SG_ 1413 RSDS_L_ObjRelVelYStd_11 "/";
CM_ SG_ 1413 RSDS_L_ObjRelVelXStd_11 "/";
CM_ SG_ 1413 RSDS_L_ObjDistYStd_11 "/";
CM_ SG_ 1413 RSDS_L_SGU6_Checksum3 "/";
CM_ SG_ 1413 RSDS_L_SGU6_RollingCounter2 "/";
CM_ SG_ 1413 RSDS_L_ObjMotionType_11 "/";
CM_ SG_ 1413 RSDS_L_ObjMeasured_11 "/";
CM_ SG_ 1413 RSDS_L_ObjRelAccelY_11 "/";
CM_ SG_ 1413 RSDS_L_ObjRelAccelX_11 "/";
CM_ SG_ 1413 RSDS_L_ObjRelVelY_11 "/";
CM_ SG_ 1413 RSDS_L_ObjRelVelX_11 "/";
CM_ SG_ 1413 RSDS_L_SGU6_Checksum2 "/";
CM_ SG_ 1413 RSDS_L_SGU6_RollingCounter1 "/";
CM_ SG_ 1413 RSDS_L_ObjType_11 "/";
CM_ SG_ 1413 RSDS_L_ObjDistXStd_11 "/";
CM_ SG_ 1413 RSDS_L_ObjDistY_11 "/";
CM_ SG_ 1413 RSDS_L_ObjDistX_11 "/";
CM_ SG_ 1413 RSDS_L_ObjObstacleProb_11 "/";
CM_ SG_ 1413 RSDS_L_ObjExistProb_11 "/";
CM_ SG_ 1413 RSDS_L_ObjID_11 "/";
CM_ SG_ 1413 RSDS_L_SGU6_Checksum1 "/";
CM_ SG_ 1414 RSDS_L_SGU7_RollingCounter8 "/";
CM_ SG_ 1414 RSDS_L_SGU7_BlockCounter "/";
CM_ SG_ 1414 RSDS_L_HWATargetValidity_14 "/";
CM_ SG_ 1414 RSDS_L_ObjRefPoint_14 "/";
CM_ SG_ 1414 RSDS_L_ObjRCS_14 "/";
CM_ SG_ 1414 RSDS_L_ObjYawrate_14 "/";
CM_ SG_ 1414 RSDS_L_ObjHeading_14 "/";
CM_ SG_ 1414 RSDS_L_ObjLength_14 "/";
CM_ SG_ 1414 RSDS_L_SGU7_Checksum8 "/";
CM_ SG_ 1414 RSDS_L_SGU7_RollingCounter7 "/";
CM_ SG_ 1414 RSDS_L_ObjMotionDirection_14 "/";
CM_ SG_ 1414 RSDS_L_ObjAge_14 "/";
CM_ SG_ 1414 RSDS_L_ObjWidth_14 "/";
CM_ SG_ 1414 RSDS_L_ObjRAccelYStd_14 "/";
CM_ SG_ 1414 RSDS_L_ObjRAccelXStd_14 "/";
CM_ SG_ 1414 RSDS_L_ObjRelVelYStd_14 "/";
CM_ SG_ 1414 RSDS_L_ObjRelVelXStd_14 "/";
CM_ SG_ 1414 RSDS_L_ObjDistYStd_14 "/";
CM_ SG_ 1414 RSDS_L_SGU7_Checksum7 "/";
CM_ SG_ 1414 RSDS_L_SGU7_RollingCounter6 "/";
CM_ SG_ 1414 RSDS_L_ObjMotionType_14 "/";
CM_ SG_ 1414 RSDS_L_ObjMeasured_14 "/";
CM_ SG_ 1414 RSDS_L_ObjRelAccelY_14 "/";
CM_ SG_ 1414 RSDS_L_ObjRelAccelX_14 "/";
CM_ SG_ 1414 RSDS_L_ObjRelVelY_14 "/";
CM_ SG_ 1414 RSDS_L_ObjRelVelX_14 "/";
CM_ SG_ 1414 RSDS_L_SGU7_Checksum6 "/";
CM_ SG_ 1414 RSDS_L_SGU7_RollingCounter5 "/";
CM_ SG_ 1414 RSDS_L_ObjType_14 "/";
CM_ SG_ 1414 RSDS_L_ObjDistXStd_14 "/";
CM_ SG_ 1414 RSDS_L_ObjDistY_14 "/";
CM_ SG_ 1414 RSDS_L_ObjDistX_14 "/";
CM_ SG_ 1414 RSDS_L_ObjObstacleProb_14 "/";
CM_ SG_ 1414 RSDS_L_ObjExistProb_14 "/";
CM_ SG_ 1414 RSDS_L_ObjID_14 "/";
CM_ SG_ 1414 RSDS_L_SGU7_Checksum5 "/";
CM_ SG_ 1414 RSDS_L_SGU7_RollingCounter4 "/";
CM_ SG_ 1414 RSDS_L_HWATargetValidity_13 "/";
CM_ SG_ 1414 RSDS_L_ObjRefPoint_13 "/";
CM_ SG_ 1414 RSDS_L_ObjRCS_13 "/";
CM_ SG_ 1414 RSDS_L_ObjYawrate_13 "/";
CM_ SG_ 1414 RSDS_L_ObjHeading_13 "/";
CM_ SG_ 1414 RSDS_L_ObjLength_13 "/";
CM_ SG_ 1414 RSDS_L_SGU7_Checksum4 "/";
CM_ SG_ 1414 RSDS_L_SGU7_RollingCounter3 "/";
CM_ SG_ 1414 RSDS_L_ObjMotionDirection_13 "/";
CM_ SG_ 1414 RSDS_L_ObjAge_13 "/";
CM_ SG_ 1414 RSDS_L_ObjWidth_13 "/";
CM_ SG_ 1414 RSDS_L_ObjRAccelYStd_13 "/";
CM_ SG_ 1414 RSDS_L_ObjRAccelXStd_13 "/";
CM_ SG_ 1414 RSDS_L_ObjRelVelYStd_13 "/";
CM_ SG_ 1414 RSDS_L_ObjRelVelXStd_13 "/";
CM_ SG_ 1414 RSDS_L_ObjDistYStd_13 "/";
CM_ SG_ 1414 RSDS_L_SGU7_Checksum3 "/";
CM_ SG_ 1414 RSDS_L_SGU7_RollingCounter2 "/";
CM_ SG_ 1414 RSDS_L_ObjMotionType_13 "/";
CM_ SG_ 1414 RSDS_L_ObjMeasured_13 "/";
CM_ SG_ 1414 RSDS_L_ObjRelAccelY_13 "/";
CM_ SG_ 1414 RSDS_L_ObjRelAccelX_13 "/";
CM_ SG_ 1414 RSDS_L_ObjRelVelY_13 "/";
CM_ SG_ 1414 RSDS_L_ObjRelVelX_13 "/";
CM_ SG_ 1414 RSDS_L_SGU7_Checksum2 "/";
CM_ SG_ 1414 RSDS_L_SGU7_RollingCounter1 "/";
CM_ SG_ 1414 RSDS_L_ObjType_13 "/";
CM_ SG_ 1414 RSDS_L_ObjDistXStd_13 "/";
CM_ SG_ 1414 RSDS_L_ObjDistY_13 "/";
CM_ SG_ 1414 RSDS_L_ObjDistX_13 "/";
CM_ SG_ 1414 RSDS_L_ObjObstacleProb_13 "/";
CM_ SG_ 1414 RSDS_L_ObjExistProb_13 "/";
CM_ SG_ 1414 RSDS_L_ObjID_13 "/";
CM_ SG_ 1414 RSDS_L_SGU7_Checksum1 "/";
CM_ SG_ 1415 RSDS_L_SGU8_RollingCounter8 "/";
CM_ SG_ 1415 RSDS_L_SGU8_BlockCounter "/";
CM_ SG_ 1415 RSDS_L_HWATargetValidity_16 "/";
CM_ SG_ 1415 RSDS_L_ObjRefPoint_16 "/";
CM_ SG_ 1415 RSDS_L_ObjRCS_16 "/";
CM_ SG_ 1415 RSDS_L_ObjYawrate_16 "/";
CM_ SG_ 1415 RSDS_L_ObjHeading_16 "/";
CM_ SG_ 1415 RSDS_L_ObjLength_16 "/";
CM_ SG_ 1415 RSDS_L_SGU8_Checksum8 "/";
CM_ SG_ 1415 RSDS_L_SGU8_RollingCounter7 "/";
CM_ SG_ 1415 RSDS_L_ObjMotionDirection_16 "/";
CM_ SG_ 1415 RSDS_L_ObjAge_16 "/";
CM_ SG_ 1415 RSDS_L_ObjWidth_16 "/";
CM_ SG_ 1415 RSDS_L_ObjRAccelYStd_16 "/";
CM_ SG_ 1415 RSDS_L_ObjRAccelXStd_16 "/";
CM_ SG_ 1415 RSDS_L_ObjRelVelYStd_16 "/";
CM_ SG_ 1415 RSDS_L_ObjRelVelXStd_16 "/";
CM_ SG_ 1415 RSDS_L_ObjDistYStd_16 "/";
CM_ SG_ 1415 RSDS_L_SGU8_Checksum7 "/";
CM_ SG_ 1415 RSDS_L_SGU8_RollingCounter6 "/";
CM_ SG_ 1415 RSDS_L_ObjMotionType_16 "/";
CM_ SG_ 1415 RSDS_L_ObjMeasured_16 "/";
CM_ SG_ 1415 RSDS_L_ObjRelAccelY_16 "/";
CM_ SG_ 1415 RSDS_L_ObjRelAccelX_16 "/";
CM_ SG_ 1415 RSDS_L_ObjRelVelY_16 "/";
CM_ SG_ 1415 RSDS_L_ObjRelVelX_16 "/";
CM_ SG_ 1415 RSDS_L_SGU8_Checksum6 "/";
CM_ SG_ 1415 RSDS_L_SGU8_RollingCounter5 "/";
CM_ SG_ 1415 RSDS_L_ObjType_16 "/";
CM_ SG_ 1415 RSDS_L_ObjDistXStd_16 "/";
CM_ SG_ 1415 RSDS_L_ObjDistY_16 "/";
CM_ SG_ 1415 RSDS_L_ObjDistX_16 "/";
CM_ SG_ 1415 RSDS_L_ObjObstacleProb_16 "/";
CM_ SG_ 1415 RSDS_L_ObjExistProb_16 "/";
CM_ SG_ 1415 RSDS_L_ObjID_16 "/";
CM_ SG_ 1415 RSDS_L_SGU8_Checksum5 "/";
CM_ SG_ 1415 RSDS_L_SGU8_RollingCounter4 "/";
CM_ SG_ 1415 RSDS_L_HWATargetValidity_15 "/";
CM_ SG_ 1415 RSDS_L_ObjRefPoint_15 "/";
CM_ SG_ 1415 RSDS_L_ObjRCS_15 "/";
CM_ SG_ 1415 RSDS_L_ObjYawrate_15 "/";
CM_ SG_ 1415 RSDS_L_ObjHeading_15 "/";
CM_ SG_ 1415 RSDS_L_ObjLength_15 "/";
CM_ SG_ 1415 RSDS_L_SGU8_Checksum4 "/";
CM_ SG_ 1415 RSDS_L_SGU8_RollingCounter3 "/";
CM_ SG_ 1415 RSDS_L_ObjMotionDirection_15 "/";
CM_ SG_ 1415 RSDS_L_ObjAge_15 "/";
CM_ SG_ 1415 RSDS_L_ObjWidth_15 "/";
CM_ SG_ 1415 RSDS_L_ObjRAccelYStd_15 "/";
CM_ SG_ 1415 RSDS_L_ObjRAccelXStd_15 "/";
CM_ SG_ 1415 RSDS_L_ObjRelVelYStd_15 "/";
CM_ SG_ 1415 RSDS_L_ObjRelVelXStd_15 "/";
CM_ SG_ 1415 RSDS_L_ObjDistYStd_15 "/";
CM_ SG_ 1415 RSDS_L_SGU8_Checksum3 "/";
CM_ SG_ 1415 RSDS_L_SGU8_RollingCounter2 "/";
CM_ SG_ 1415 RSDS_L_ObjMotionType_15 "/";
CM_ SG_ 1415 RSDS_L_ObjMeasured_15 "/";
CM_ SG_ 1415 RSDS_L_ObjRelAccelY_15 "/";
CM_ SG_ 1415 RSDS_L_ObjRelAccelX_15 "/";
CM_ SG_ 1415 RSDS_L_ObjRelVelY_15 "/";
CM_ SG_ 1415 RSDS_L_ObjRelVelX_15 "/";
CM_ SG_ 1415 RSDS_L_SGU8_Checksum2 "/";
CM_ SG_ 1415 RSDS_L_SGU8_RollingCounter1 "/";
CM_ SG_ 1415 RSDS_L_ObjType_15 "/";
CM_ SG_ 1415 RSDS_L_ObjDistXStd_15 "/";
CM_ SG_ 1415 RSDS_L_ObjDistY_15 "/";
CM_ SG_ 1415 RSDS_L_ObjDistX_15 "/";
CM_ SG_ 1415 RSDS_L_ObjObstacleProb_15 "/";
CM_ SG_ 1415 RSDS_L_ObjExistProb_15 "/";
CM_ SG_ 1415 RSDS_L_ObjID_15 "/";
CM_ SG_ 1415 RSDS_L_SGU8_Checksum1 "/";
BA_DEF_ BO_  "GenMsgILSupport" ENUM  "No","Yes";
BA_DEF_ BO_  "VFrameFormat" ENUM  "StandardCAN","ExtendedCAN","reserved","reserved","reserved","reserved","reserved","reserved","reserved","reserved","reserved","reserved","reserved","reserved","StandardCAN_FD","ExtendedCAN_FD";
BA_DEF_ SG_  "GenSigSendType" ENUM  "Cyclic","OnWrite","OnWriteWithRepetition","OnChange","OnChangeWithRepetition","IfActive","IfActiveWithRepetition","NoSigSendType","CyclicAndSpontanX","NotUsed","Event","CE";
BA_DEF_ SG_  "IsMonitor" ENUM  "*","Monitor";
BA_DEF_  "DBName" STRING ;
BA_DEF_  "BusType" STRING ;
BA_DEF_  "Manufacturer" STRING ;
BA_DEF_ SG_  "UnitConversionFactor" FLOAT -100 100;
BA_DEF_ SG_  "SigInvalidSetFlag" ENUM  "*","Yes";
BA_DEF_ SG_  "Internal_type" ENUM  "*","UB","UW","UL","SB","SW","SL";
BA_DEF_ SG_  "IsCrcSignal" ENUM  "No","Yes";
BA_DEF_ SG_  "IsRcSignal" ENUM  "No","Yes";
BA_DEF_ BO_  "GenMsgSendType" ENUM  "Cyclic","Event","CE","NotUsed","NotUsed","NotUsed","NotUsed","NotUsed","NoMsgSendType","IfActive","IfActiveWithRepetition","CyclicAndSpontanX";
BA_DEF_ SG_  "GenSigStartValue" INT 0 2147483647;
BA_DEF_ BO_  "MsgType" ENUM  "Normal","NM","Diag","vector_leerstring";
BA_DEF_ BO_  "GenMsgCycleTime" INT 0 65535;
BA_DEF_DEF_  "GenMsgILSupport" "Yes";
BA_DEF_DEF_  "VFrameFormat" "StandardCAN";
BA_DEF_DEF_  "GenSigSendType" "Cyclic";
BA_DEF_DEF_  "IsMonitor" "*";
BA_DEF_DEF_  "DBName" "";
BA_DEF_DEF_  "BusType" "";
BA_DEF_DEF_  "Manufacturer" "Vector";
BA_DEF_DEF_  "UnitConversionFactor" 1;
BA_DEF_DEF_  "SigInvalidSetFlag" "*";
BA_DEF_DEF_  "Internal_type" "*";
BA_DEF_DEF_  "IsCrcSignal" "No";
BA_DEF_DEF_  "IsRcSignal" "No";
BA_DEF_DEF_  "GenMsgSendType" "Cyclic";
BA_DEF_DEF_  "GenSigStartValue" 0;
BA_DEF_DEF_  "MsgType" "";
BA_DEF_DEF_  "GenMsgCycleTime" 0;
BA_ "BusType" "CAN FD";
BA_ "DBName" "CAN_PR1";
BA_ "GenMsgILSupport" BO_ 1136 0;
BA_ "MsgType" BO_ 1136 0;
BA_ "GenMsgCycleTime" BO_ 1136 500;
BA_ "VFrameFormat" BO_ 1136 14;
BA_ "GenMsgSendType" BO_ 1408 1;
BA_ "MsgType" BO_ 1408 0;
BA_ "VFrameFormat" BO_ 1408 14;
BA_ "GenMsgSendType" BO_ 1409 1;
BA_ "MsgType" BO_ 1409 0;
BA_ "VFrameFormat" BO_ 1409 14;
BA_ "GenMsgSendType" BO_ 1410 1;
BA_ "MsgType" BO_ 1410 0;
BA_ "VFrameFormat" BO_ 1410 14;
BA_ "GenMsgSendType" BO_ 1411 1;
BA_ "MsgType" BO_ 1411 0;
BA_ "VFrameFormat" BO_ 1411 14;
BA_ "GenMsgSendType" BO_ 1412 1;
BA_ "MsgType" BO_ 1412 0;
BA_ "VFrameFormat" BO_ 1412 14;
BA_ "GenMsgSendType" BO_ 1413 1;
BA_ "MsgType" BO_ 1413 0;
BA_ "VFrameFormat" BO_ 1413 14;
BA_ "GenMsgSendType" BO_ 1414 1;
BA_ "MsgType" BO_ 1414 0;
BA_ "VFrameFormat" BO_ 1414 14;
BA_ "GenMsgSendType" BO_ 1415 1;
BA_ "MsgType" BO_ 1415 0;
BA_ "VFrameFormat" BO_ 1415 14;
BA_ "GenMsgSendType" BO_ 1416 1;
BA_ "MsgType" BO_ 1416 0;
BA_ "VFrameFormat" BO_ 1416 14;
BA_ "GenMsgSendType" BO_ 1417 1;
BA_ "MsgType" BO_ 1417 0;
BA_ "VFrameFormat" BO_ 1417 14;
BA_ "GenSigSendType" SG_ 1136 Sync_SyncTime 9;
BA_ "GenSigSendType" SG_ 1136 Sync_OVS 9;
BA_ "GenSigSendType" SG_ 1136 Sync_SGW 9;
BA_ "GenSigSendType" SG_ 1136 Sync_Resd 9;
BA_ "GenSigSendType" SG_ 1136 Sync_Counter 9;
BA_ "GenSigSendType" SG_ 1136 Sync_TimeDomain 9;
BA_ "GenSigSendType" SG_ 1136 Sync_CRC 9;
BA_ "GenSigSendType" SG_ 1136 Sync_Type 9;
BA_ "GenSigSendType" SG_ 1408 RSDS_L_SGU1_RollingCounter8 9;
BA_ "IsRcSignal" SG_ 1408 RSDS_L_SGU1_RollingCounter8 1;
BA_ "GenSigSendType" SG_ 1408 RSDS_L_SGU1_BlockCounter 9;
BA_ "GenSigSendType" SG_ 1408 RSDS_L_HWATargetValidity_2 9;
BA_ "GenSigSendType" SG_ 1408 RSDS_L_ObjRefPoint_2 9;
BA_ "GenSigStartValue" SG_ 1408 RSDS_L_ObjRCS_2 400;
BA_ "GenSigSendType" SG_ 1408 RSDS_L_ObjRCS_2 9;
BA_ "GenSigSendType" SG_ 1408 RSDS_L_ObjYawrate_2 9;
BA_ "GenSigSendType" SG_ 1408 RSDS_L_ObjHeading_2 9;
BA_ "GenSigSendType" SG_ 1408 RSDS_L_ObjLength_2 9;
BA_ "GenSigSendType" SG_ 1408 RSDS_L_SGU1_Checksum8 9;
BA_ "IsCrcSignal" SG_ 1408 RSDS_L_SGU1_Checksum8 1;
BA_ "GenSigSendType" SG_ 1408 RSDS_L_SGU1_RollingCounter7 9;
BA_ "IsRcSignal" SG_ 1408 RSDS_L_SGU1_RollingCounter7 1;
BA_ "GenSigSendType" SG_ 1408 RSDS_L_ObjMotionDirection_2 9;
BA_ "GenSigSendType" SG_ 1408 RSDS_L_ObjAge_2 9;
BA_ "GenSigSendType" SG_ 1408 RSDS_L_ObjWidth_2 9;
BA_ "GenSigSendType" SG_ 1408 RSDS_L_ObjRAccelYStd_2 9;
BA_ "GenSigSendType" SG_ 1408 RSDS_L_ObjRAccelXStd_2 9;
BA_ "GenSigSendType" SG_ 1408 RSDS_L_ObjRelVelYStd_2 9;
BA_ "GenSigSendType" SG_ 1408 RSDS_L_ObjRelVelXStd_2 9;
BA_ "GenSigSendType" SG_ 1408 RSDS_L_ObjDistYStd_2 9;
BA_ "GenSigSendType" SG_ 1408 RSDS_L_SGU1_Checksum7 9;
BA_ "IsCrcSignal" SG_ 1408 RSDS_L_SGU1_Checksum7 1;
BA_ "GenSigSendType" SG_ 1408 RSDS_L_SGU1_RollingCounter6 9;
BA_ "IsRcSignal" SG_ 1408 RSDS_L_SGU1_RollingCounter6 1;
BA_ "GenSigSendType" SG_ 1408 RSDS_L_ObjMotionType_2 9;
BA_ "GenSigStartValue" SG_ 1408 RSDS_L_ObjMeasured_2 1;
BA_ "GenSigSendType" SG_ 1408 RSDS_L_ObjMeasured_2 9;
BA_ "GenSigStartValue" SG_ 1408 RSDS_L_ObjRelAccelY_2 512;
BA_ "GenSigSendType" SG_ 1408 RSDS_L_ObjRelAccelY_2 9;
BA_ "GenSigStartValue" SG_ 1408 RSDS_L_ObjRelAccelX_2 512;
BA_ "GenSigSendType" SG_ 1408 RSDS_L_ObjRelAccelX_2 9;
BA_ "GenSigStartValue" SG_ 1408 RSDS_L_ObjRelVelY_2 4102;
BA_ "GenSigSendType" SG_ 1408 RSDS_L_ObjRelVelY_2 9;
BA_ "GenSigStartValue" SG_ 1408 RSDS_L_ObjRelVelX_2 4102;
BA_ "GenSigSendType" SG_ 1408 RSDS_L_ObjRelVelX_2 9;
BA_ "GenSigSendType" SG_ 1408 RSDS_L_SGU1_Checksum6 9;
BA_ "IsCrcSignal" SG_ 1408 RSDS_L_SGU1_Checksum6 1;
BA_ "GenSigSendType" SG_ 1408 RSDS_L_SGU1_RollingCounter5 9;
BA_ "IsRcSignal" SG_ 1408 RSDS_L_SGU1_RollingCounter5 1;
BA_ "GenSigSendType" SG_ 1408 RSDS_L_ObjType_2 9;
BA_ "GenSigSendType" SG_ 1408 RSDS_L_ObjDistXStd_2 9;
BA_ "GenSigStartValue" SG_ 1408 RSDS_L_ObjDistY_2 1024;
BA_ "GenSigSendType" SG_ 1408 RSDS_L_ObjDistY_2 9;
BA_ "GenSigSendType" SG_ 1408 RSDS_L_ObjDistX_2 9;
BA_ "GenSigSendType" SG_ 1408 RSDS_L_ObjObstacleProb_2 9;
BA_ "GenSigSendType" SG_ 1408 RSDS_L_ObjExistProb_2 9;
BA_ "GenSigSendType" SG_ 1408 RSDS_L_ObjID_2 9;
BA_ "GenSigSendType" SG_ 1408 RSDS_L_SGU1_Checksum5 9;
BA_ "IsCrcSignal" SG_ 1408 RSDS_L_SGU1_Checksum5 1;
BA_ "GenSigSendType" SG_ 1408 RSDS_L_SGU1_RollingCounter4 9;
BA_ "IsRcSignal" SG_ 1408 RSDS_L_SGU1_RollingCounter4 1;
BA_ "GenSigSendType" SG_ 1408 RSDS_L_HWATargetValidity_1 9;
BA_ "GenSigSendType" SG_ 1408 RSDS_L_ObjRefPoint_1 9;
BA_ "GenSigStartValue" SG_ 1408 RSDS_L_ObjRCS_1 400;
BA_ "GenSigSendType" SG_ 1408 RSDS_L_ObjRCS_1 9;
BA_ "GenSigSendType" SG_ 1408 RSDS_L_ObjYawrate_1 9;
BA_ "GenSigSendType" SG_ 1408 RSDS_L_ObjHeading_1 9;
BA_ "GenSigSendType" SG_ 1408 RSDS_L_ObjLength_1 9;
BA_ "GenSigSendType" SG_ 1408 RSDS_L_SGU1_Checksum4 9;
BA_ "IsCrcSignal" SG_ 1408 RSDS_L_SGU1_Checksum4 1;
BA_ "GenSigSendType" SG_ 1408 RSDS_L_SGU1_RollingCounter3 9;
BA_ "IsRcSignal" SG_ 1408 RSDS_L_SGU1_RollingCounter3 1;
BA_ "GenSigSendType" SG_ 1408 RSDS_L_ObjMotionDirection_1 9;
BA_ "GenSigSendType" SG_ 1408 RSDS_L_ObjAge_1 9;
BA_ "GenSigSendType" SG_ 1408 RSDS_L_ObjWidth_1 9;
BA_ "GenSigSendType" SG_ 1408 RSDS_L_ObjRAccelYStd_1 9;
BA_ "GenSigSendType" SG_ 1408 RSDS_L_ObjRAccelXStd_1 9;
BA_ "GenSigSendType" SG_ 1408 RSDS_L_ObjRelVelYStd_1 9;
BA_ "GenSigSendType" SG_ 1408 RSDS_L_ObjRelVelXStd_1 9;
BA_ "GenSigSendType" SG_ 1408 RSDS_L_ObjDistYStd_1 9;
BA_ "GenSigSendType" SG_ 1408 RSDS_L_SGU1_Checksum3 9;
BA_ "IsCrcSignal" SG_ 1408 RSDS_L_SGU1_Checksum3 1;
BA_ "GenSigSendType" SG_ 1408 RSDS_L_SGU1_RollingCounter2 9;
BA_ "IsRcSignal" SG_ 1408 RSDS_L_SGU1_RollingCounter2 1;
BA_ "GenSigSendType" SG_ 1408 RSDS_L_ObjMotionType_1 9;
BA_ "GenSigStartValue" SG_ 1408 RSDS_L_ObjMeasured_1 1;
BA_ "GenSigSendType" SG_ 1408 RSDS_L_ObjMeasured_1 9;
BA_ "GenSigStartValue" SG_ 1408 RSDS_L_ObjRelAccelY_1 512;
BA_ "GenSigSendType" SG_ 1408 RSDS_L_ObjRelAccelY_1 9;
BA_ "GenSigStartValue" SG_ 1408 RSDS_L_ObjRelAccelX_1 512;
BA_ "GenSigSendType" SG_ 1408 RSDS_L_ObjRelAccelX_1 9;
BA_ "GenSigStartValue" SG_ 1408 RSDS_L_ObjRelVelY_1 4102;
BA_ "GenSigSendType" SG_ 1408 RSDS_L_ObjRelVelY_1 9;
BA_ "GenSigStartValue" SG_ 1408 RSDS_L_ObjRelVelX_1 4102;
BA_ "GenSigSendType" SG_ 1408 RSDS_L_ObjRelVelX_1 9;
BA_ "GenSigSendType" SG_ 1408 RSDS_L_SGU1_Checksum2 9;
BA_ "IsCrcSignal" SG_ 1408 RSDS_L_SGU1_Checksum2 1;
BA_ "GenSigSendType" SG_ 1408 RSDS_L_SGU1_RollingCounter1 9;
BA_ "IsRcSignal" SG_ 1408 RSDS_L_SGU1_RollingCounter1 1;
BA_ "GenSigSendType" SG_ 1408 RSDS_L_ObjType_1 9;
BA_ "GenSigSendType" SG_ 1408 RSDS_L_ObjDistXStd_1 9;
BA_ "GenSigStartValue" SG_ 1408 RSDS_L_ObjDistY_1 1024;
BA_ "GenSigSendType" SG_ 1408 RSDS_L_ObjDistY_1 9;
BA_ "GenSigSendType" SG_ 1408 RSDS_L_ObjDistX_1 9;
BA_ "GenSigSendType" SG_ 1408 RSDS_L_ObjObstacleProb_1 9;
BA_ "GenSigSendType" SG_ 1408 RSDS_L_ObjExistProb_1 9;
BA_ "GenSigSendType" SG_ 1408 RSDS_L_ObjID_1 9;
BA_ "GenSigSendType" SG_ 1408 RSDS_L_SGU1_Checksum1 9;
BA_ "IsCrcSignal" SG_ 1408 RSDS_L_SGU1_Checksum1 1;
BA_ "GenSigSendType" SG_ 1409 RSDS_L_SGU2_RollingCounter8 9;
BA_ "IsRcSignal" SG_ 1409 RSDS_L_SGU2_RollingCounter8 1;
BA_ "GenSigSendType" SG_ 1409 RSDS_L_SGU2_BlockCounter 9;
BA_ "GenSigSendType" SG_ 1409 RSDS_L_HWATargetValidity_4 9;
BA_ "GenSigSendType" SG_ 1409 RSDS_L_ObjRefPoint_4 9;
BA_ "GenSigStartValue" SG_ 1409 RSDS_L_ObjRCS_4 400;
BA_ "GenSigSendType" SG_ 1409 RSDS_L_ObjRCS_4 9;
BA_ "GenSigSendType" SG_ 1409 RSDS_L_ObjYawrate_4 9;
BA_ "GenSigSendType" SG_ 1409 RSDS_L_ObjHeading_4 9;
BA_ "GenSigSendType" SG_ 1409 RSDS_L_ObjLength_4 9;
BA_ "GenSigSendType" SG_ 1409 RSDS_L_SGU2_Checksum8 9;
BA_ "IsCrcSignal" SG_ 1409 RSDS_L_SGU2_Checksum8 1;
BA_ "GenSigSendType" SG_ 1409 RSDS_L_SGU2_RollingCounter7 9;
BA_ "IsRcSignal" SG_ 1409 RSDS_L_SGU2_RollingCounter7 1;
BA_ "GenSigSendType" SG_ 1409 RSDS_L_ObjMotionDirection_4 9;
BA_ "GenSigSendType" SG_ 1409 RSDS_L_ObjAge_4 9;
BA_ "GenSigSendType" SG_ 1409 RSDS_L_ObjWidth_4 9;
BA_ "GenSigSendType" SG_ 1409 RSDS_L_ObjRAccelYStd_4 9;
BA_ "GenSigSendType" SG_ 1409 RSDS_L_ObjRAccelXStd_4 9;
BA_ "GenSigSendType" SG_ 1409 RSDS_L_ObjRelVelYStd_4 9;
BA_ "GenSigSendType" SG_ 1409 RSDS_L_ObjRelVelXStd_4 9;
BA_ "GenSigSendType" SG_ 1409 RSDS_L_ObjDistYStd_4 9;
BA_ "GenSigSendType" SG_ 1409 RSDS_L_SGU2_Checksum7 9;
BA_ "IsCrcSignal" SG_ 1409 RSDS_L_SGU2_Checksum7 1;
BA_ "GenSigSendType" SG_ 1409 RSDS_L_SGU2_RollingCounter6 9;
BA_ "IsRcSignal" SG_ 1409 RSDS_L_SGU2_RollingCounter6 1;
BA_ "GenSigSendType" SG_ 1409 RSDS_L_ObjMotionType_4 9;
BA_ "GenSigStartValue" SG_ 1409 RSDS_L_ObjMeasured_4 1;
BA_ "GenSigSendType" SG_ 1409 RSDS_L_ObjMeasured_4 9;
BA_ "GenSigStartValue" SG_ 1409 RSDS_L_ObjRelAccelY_4 512;
BA_ "GenSigSendType" SG_ 1409 RSDS_L_ObjRelAccelY_4 9;
BA_ "GenSigStartValue" SG_ 1409 RSDS_L_ObjRelAccelX_4 512;
BA_ "GenSigSendType" SG_ 1409 RSDS_L_ObjRelAccelX_4 9;
BA_ "GenSigStartValue" SG_ 1409 RSDS_L_ObjRelVelY_4 4102;
BA_ "GenSigSendType" SG_ 1409 RSDS_L_ObjRelVelY_4 9;
BA_ "GenSigStartValue" SG_ 1409 RSDS_L_ObjRelVelX_4 4102;
BA_ "GenSigSendType" SG_ 1409 RSDS_L_ObjRelVelX_4 9;
BA_ "GenSigSendType" SG_ 1409 RSDS_L_SGU2_Checksum6 9;
BA_ "IsCrcSignal" SG_ 1409 RSDS_L_SGU2_Checksum6 1;
BA_ "GenSigSendType" SG_ 1409 RSDS_L_SGU2_RollingCounter5 9;
BA_ "IsRcSignal" SG_ 1409 RSDS_L_SGU2_RollingCounter5 1;
BA_ "GenSigSendType" SG_ 1409 RSDS_L_ObjType_4 9;
BA_ "GenSigSendType" SG_ 1409 RSDS_L_ObjDistXStd_4 9;
BA_ "GenSigStartValue" SG_ 1409 RSDS_L_ObjDistY_4 1024;
BA_ "GenSigSendType" SG_ 1409 RSDS_L_ObjDistY_4 9;
BA_ "GenSigSendType" SG_ 1409 RSDS_L_ObjDistX_4 9;
BA_ "GenSigSendType" SG_ 1409 RSDS_L_ObjObstacleProb_4 9;
BA_ "GenSigSendType" SG_ 1409 RSDS_L_ObjExistProb_4 9;
BA_ "GenSigSendType" SG_ 1409 RSDS_L_ObjID_4 9;
BA_ "GenSigSendType" SG_ 1409 RSDS_L_SGU2_Checksum5 9;
BA_ "IsCrcSignal" SG_ 1409 RSDS_L_SGU2_Checksum5 1;
BA_ "GenSigSendType" SG_ 1409 RSDS_L_SGU2_RollingCounter4 9;
BA_ "IsRcSignal" SG_ 1409 RSDS_L_SGU2_RollingCounter4 1;
BA_ "GenSigSendType" SG_ 1409 RSDS_L_HWATargetValidity_3 9;
BA_ "GenSigSendType" SG_ 1409 RSDS_L_ObjRefPoint_3 9;
BA_ "GenSigStartValue" SG_ 1409 RSDS_L_ObjRCS_3 400;
BA_ "GenSigSendType" SG_ 1409 RSDS_L_ObjRCS_3 9;
BA_ "GenSigSendType" SG_ 1409 RSDS_L_ObjYawrate_3 9;
BA_ "GenSigSendType" SG_ 1409 RSDS_L_ObjHeading_3 9;
BA_ "GenSigSendType" SG_ 1409 RSDS_L_ObjLength_3 9;
BA_ "GenSigSendType" SG_ 1409 RSDS_L_SGU2_Checksum4 9;
BA_ "IsCrcSignal" SG_ 1409 RSDS_L_SGU2_Checksum4 1;
BA_ "GenSigSendType" SG_ 1409 RSDS_L_SGU2_RollingCounter3 9;
BA_ "IsRcSignal" SG_ 1409 RSDS_L_SGU2_RollingCounter3 1;
BA_ "GenSigSendType" SG_ 1409 RSDS_L_ObjMotionDirection_3 9;
BA_ "GenSigSendType" SG_ 1409 RSDS_L_ObjAge_3 9;
BA_ "GenSigSendType" SG_ 1409 RSDS_L_ObjWidth_3 9;
BA_ "GenSigSendType" SG_ 1409 RSDS_L_ObjRAccelYStd_3 9;
BA_ "GenSigSendType" SG_ 1409 RSDS_L_ObjRAccelXStd_3 9;
BA_ "GenSigSendType" SG_ 1409 RSDS_L_ObjRelVelYStd_3 9;
BA_ "GenSigSendType" SG_ 1409 RSDS_L_ObjRelVelXStd_3 9;
BA_ "GenSigSendType" SG_ 1409 RSDS_L_ObjDistYStd_3 9;
BA_ "GenSigSendType" SG_ 1409 RSDS_L_SGU2_Checksum3 9;
BA_ "IsCrcSignal" SG_ 1409 RSDS_L_SGU2_Checksum3 1;
BA_ "GenSigSendType" SG_ 1409 RSDS_L_SGU2_RollingCounter2 9;
BA_ "IsRcSignal" SG_ 1409 RSDS_L_SGU2_RollingCounter2 1;
BA_ "GenSigSendType" SG_ 1409 RSDS_L_ObjMotionType_3 9;
BA_ "GenSigStartValue" SG_ 1409 RSDS_L_ObjMeasured_3 1;
BA_ "GenSigSendType" SG_ 1409 RSDS_L_ObjMeasured_3 9;
BA_ "GenSigStartValue" SG_ 1409 RSDS_L_ObjRelAccelY_3 512;
BA_ "GenSigSendType" SG_ 1409 RSDS_L_ObjRelAccelY_3 9;
BA_ "GenSigStartValue" SG_ 1409 RSDS_L_ObjRelAccelX_3 512;
BA_ "GenSigSendType" SG_ 1409 RSDS_L_ObjRelAccelX_3 9;
BA_ "GenSigStartValue" SG_ 1409 RSDS_L_ObjRelVelY_3 4102;
BA_ "GenSigSendType" SG_ 1409 RSDS_L_ObjRelVelY_3 9;
BA_ "GenSigStartValue" SG_ 1409 RSDS_L_ObjRelVelX_3 4102;
BA_ "GenSigSendType" SG_ 1409 RSDS_L_ObjRelVelX_3 9;
BA_ "GenSigSendType" SG_ 1409 RSDS_L_SGU2_Checksum2 9;
BA_ "IsCrcSignal" SG_ 1409 RSDS_L_SGU2_Checksum2 1;
BA_ "GenSigSendType" SG_ 1409 RSDS_L_SGU2_RollingCounter1 9;
BA_ "IsRcSignal" SG_ 1409 RSDS_L_SGU2_RollingCounter1 1;
BA_ "GenSigSendType" SG_ 1409 RSDS_L_ObjType_3 9;
BA_ "GenSigSendType" SG_ 1409 RSDS_L_ObjDistXStd_3 9;
BA_ "GenSigStartValue" SG_ 1409 RSDS_L_ObjDistY_3 1024;
BA_ "GenSigSendType" SG_ 1409 RSDS_L_ObjDistY_3 9;
BA_ "GenSigSendType" SG_ 1409 RSDS_L_ObjDistX_3 9;
BA_ "GenSigSendType" SG_ 1409 RSDS_L_ObjObstacleProb_3 9;
BA_ "GenSigSendType" SG_ 1409 RSDS_L_ObjExistProb_3 9;
BA_ "GenSigSendType" SG_ 1409 RSDS_L_ObjID_3 9;
BA_ "GenSigSendType" SG_ 1409 RSDS_L_SGU2_Checksum1 9;
BA_ "IsCrcSignal" SG_ 1409 RSDS_L_SGU2_Checksum1 1;
BA_ "GenSigSendType" SG_ 1410 RSDS_L_SGU3_RollingCounter8 9;
BA_ "IsRcSignal" SG_ 1410 RSDS_L_SGU3_RollingCounter8 1;
BA_ "GenSigSendType" SG_ 1410 RSDS_L_SGU3_BlockCounter 9;
BA_ "GenSigSendType" SG_ 1410 RSDS_L_HWATargetValidity_6 9;
BA_ "GenSigSendType" SG_ 1410 RSDS_L_ObjRefPoint_6 9;
BA_ "GenSigStartValue" SG_ 1410 RSDS_L_ObjRCS_6 400;
BA_ "GenSigSendType" SG_ 1410 RSDS_L_ObjRCS_6 9;
BA_ "GenSigSendType" SG_ 1410 RSDS_L_ObjYawrate_6 9;
BA_ "GenSigSendType" SG_ 1410 RSDS_L_ObjHeading_6 9;
BA_ "GenSigSendType" SG_ 1410 RSDS_L_ObjLength_6 9;
BA_ "GenSigSendType" SG_ 1410 RSDS_L_SGU3_Checksum8 9;
BA_ "IsCrcSignal" SG_ 1410 RSDS_L_SGU3_Checksum8 1;
BA_ "GenSigSendType" SG_ 1410 RSDS_L_SGU3_RollingCounter7 9;
BA_ "IsRcSignal" SG_ 1410 RSDS_L_SGU3_RollingCounter7 1;
BA_ "GenSigSendType" SG_ 1410 RSDS_L_ObjMotionDirection_6 9;
BA_ "GenSigSendType" SG_ 1410 RSDS_L_ObjAge_6 9;
BA_ "GenSigSendType" SG_ 1410 RSDS_L_ObjWidth_6 9;
BA_ "GenSigSendType" SG_ 1410 RSDS_L_ObjRAccelYStd_6 9;
BA_ "GenSigSendType" SG_ 1410 RSDS_L_ObjRAccelXStd_6 9;
BA_ "GenSigSendType" SG_ 1410 RSDS_L_ObjRelVelYStd_6 9;
BA_ "GenSigSendType" SG_ 1410 RSDS_L_ObjRelVelXStd_6 9;
BA_ "GenSigSendType" SG_ 1410 RSDS_L_ObjDistYStd_6 9;
BA_ "GenSigSendType" SG_ 1410 RSDS_L_SGU3_Checksum7 9;
BA_ "IsCrcSignal" SG_ 1410 RSDS_L_SGU3_Checksum7 1;
BA_ "GenSigSendType" SG_ 1410 RSDS_L_SGU3_RollingCounter6 9;
BA_ "IsRcSignal" SG_ 1410 RSDS_L_SGU3_RollingCounter6 1;
BA_ "GenSigSendType" SG_ 1410 RSDS_L_ObjMotionType_6 9;
BA_ "GenSigStartValue" SG_ 1410 RSDS_L_ObjMeasured_6 1;
BA_ "GenSigSendType" SG_ 1410 RSDS_L_ObjMeasured_6 9;
BA_ "GenSigStartValue" SG_ 1410 RSDS_L_ObjRelAccelY_6 512;
BA_ "GenSigSendType" SG_ 1410 RSDS_L_ObjRelAccelY_6 9;
BA_ "GenSigStartValue" SG_ 1410 RSDS_L_ObjRelAccelX_6 512;
BA_ "GenSigSendType" SG_ 1410 RSDS_L_ObjRelAccelX_6 9;
BA_ "GenSigStartValue" SG_ 1410 RSDS_L_ObjRelVelY_6 4102;
BA_ "GenSigSendType" SG_ 1410 RSDS_L_ObjRelVelY_6 9;
BA_ "GenSigStartValue" SG_ 1410 RSDS_L_ObjRelVelX_6 4102;
BA_ "GenSigSendType" SG_ 1410 RSDS_L_ObjRelVelX_6 9;
BA_ "GenSigSendType" SG_ 1410 RSDS_L_SGU3_Checksum6 9;
BA_ "IsCrcSignal" SG_ 1410 RSDS_L_SGU3_Checksum6 1;
BA_ "GenSigSendType" SG_ 1410 RSDS_L_SGU3_RollingCounter5 9;
BA_ "IsRcSignal" SG_ 1410 RSDS_L_SGU3_RollingCounter5 1;
BA_ "GenSigSendType" SG_ 1410 RSDS_L_ObjType_6 9;
BA_ "GenSigSendType" SG_ 1410 RSDS_L_ObjDistXStd_6 9;
BA_ "GenSigStartValue" SG_ 1410 RSDS_L_ObjDistY_6 1024;
BA_ "GenSigSendType" SG_ 1410 RSDS_L_ObjDistY_6 9;
BA_ "GenSigSendType" SG_ 1410 RSDS_L_ObjDistX_6 9;
BA_ "GenSigSendType" SG_ 1410 RSDS_L_ObjObstacleProb_6 9;
BA_ "GenSigSendType" SG_ 1410 RSDS_L_ObjExistProb_6 9;
BA_ "GenSigSendType" SG_ 1410 RSDS_L_ObjID_6 9;
BA_ "GenSigSendType" SG_ 1410 RSDS_L_SGU3_Checksum5 9;
BA_ "IsCrcSignal" SG_ 1410 RSDS_L_SGU3_Checksum5 1;
BA_ "GenSigSendType" SG_ 1410 RSDS_L_SGU3_RollingCounter4 9;
BA_ "IsRcSignal" SG_ 1410 RSDS_L_SGU3_RollingCounter4 1;
BA_ "GenSigSendType" SG_ 1410 RSDS_L_HWATargetValidity_5 9;
BA_ "GenSigSendType" SG_ 1410 RSDS_L_ObjRefPoint_5 9;
BA_ "GenSigStartValue" SG_ 1410 RSDS_L_ObjRCS_5 400;
BA_ "GenSigSendType" SG_ 1410 RSDS_L_ObjRCS_5 9;
BA_ "GenSigSendType" SG_ 1410 RSDS_L_ObjYawrate_5 9;
BA_ "GenSigSendType" SG_ 1410 RSDS_L_ObjHeading_5 9;
BA_ "GenSigSendType" SG_ 1410 RSDS_L_ObjLength_5 9;
BA_ "GenSigSendType" SG_ 1410 RSDS_L_SGU3_Checksum4 9;
BA_ "IsCrcSignal" SG_ 1410 RSDS_L_SGU3_Checksum4 1;
BA_ "GenSigSendType" SG_ 1410 RSDS_L_SGU3_RollingCounter3 9;
BA_ "IsRcSignal" SG_ 1410 RSDS_L_SGU3_RollingCounter3 1;
BA_ "GenSigSendType" SG_ 1410 RSDS_L_ObjMotionDirection_5 9;
BA_ "GenSigSendType" SG_ 1410 RSDS_L_ObjAge_5 9;
BA_ "GenSigSendType" SG_ 1410 RSDS_L_ObjWidth_5 9;
BA_ "GenSigSendType" SG_ 1410 RSDS_L_ObjRAccelYStd_5 9;
BA_ "GenSigSendType" SG_ 1410 RSDS_L_ObjRAccelXStd_5 9;
BA_ "GenSigSendType" SG_ 1410 RSDS_L_ObjRelVelYStd_5 9;
BA_ "GenSigSendType" SG_ 1410 RSDS_L_ObjRelVelXStd_5 9;
BA_ "GenSigSendType" SG_ 1410 RSDS_L_ObjDistYStd_5 9;
BA_ "GenSigSendType" SG_ 1410 RSDS_L_SGU3_Checksum3 9;
BA_ "IsCrcSignal" SG_ 1410 RSDS_L_SGU3_Checksum3 1;
BA_ "GenSigSendType" SG_ 1410 RSDS_L_SGU3_RollingCounter2 9;
BA_ "IsRcSignal" SG_ 1410 RSDS_L_SGU3_RollingCounter2 1;
BA_ "GenSigSendType" SG_ 1410 RSDS_L_ObjMotionType_5 9;
BA_ "GenSigStartValue" SG_ 1410 RSDS_L_ObjMeasured_5 1;
BA_ "GenSigSendType" SG_ 1410 RSDS_L_ObjMeasured_5 9;
BA_ "GenSigStartValue" SG_ 1410 RSDS_L_ObjRelAccelY_5 512;
BA_ "GenSigSendType" SG_ 1410 RSDS_L_ObjRelAccelY_5 9;
BA_ "GenSigStartValue" SG_ 1410 RSDS_L_ObjRelAccelX_5 512;
BA_ "GenSigSendType" SG_ 1410 RSDS_L_ObjRelAccelX_5 9;
BA_ "GenSigStartValue" SG_ 1410 RSDS_L_ObjRelVelY_5 4102;
BA_ "GenSigSendType" SG_ 1410 RSDS_L_ObjRelVelY_5 9;
BA_ "GenSigStartValue" SG_ 1410 RSDS_L_ObjRelVelX_5 4102;
BA_ "GenSigSendType" SG_ 1410 RSDS_L_ObjRelVelX_5 9;
BA_ "GenSigSendType" SG_ 1410 RSDS_L_SGU3_Checksum2 9;
BA_ "IsCrcSignal" SG_ 1410 RSDS_L_SGU3_Checksum2 1;
BA_ "GenSigSendType" SG_ 1410 RSDS_L_SGU3_RollingCounter1 9;
BA_ "IsRcSignal" SG_ 1410 RSDS_L_SGU3_RollingCounter1 1;
BA_ "GenSigSendType" SG_ 1410 RSDS_L_ObjType_5 9;
BA_ "GenSigSendType" SG_ 1410 RSDS_L_ObjDistXStd_5 9;
BA_ "GenSigStartValue" SG_ 1410 RSDS_L_ObjDistY_5 1024;
BA_ "GenSigSendType" SG_ 1410 RSDS_L_ObjDistY_5 9;
BA_ "GenSigSendType" SG_ 1410 RSDS_L_ObjDistX_5 9;
BA_ "GenSigSendType" SG_ 1410 RSDS_L_ObjObstacleProb_5 9;
BA_ "GenSigSendType" SG_ 1410 RSDS_L_ObjExistProb_5 9;
BA_ "GenSigSendType" SG_ 1410 RSDS_L_ObjID_5 9;
BA_ "GenSigSendType" SG_ 1410 RSDS_L_SGU3_Checksum1 9;
BA_ "IsCrcSignal" SG_ 1410 RSDS_L_SGU3_Checksum1 1;
BA_ "GenSigSendType" SG_ 1411 RSDS_L_SGU4_RollingCounter8 9;
BA_ "IsRcSignal" SG_ 1411 RSDS_L_SGU4_RollingCounter8 1;
BA_ "GenSigSendType" SG_ 1411 RSDS_L_SGU4_BlockCounter 9;
BA_ "GenSigSendType" SG_ 1411 RSDS_L_HWATargetValidity_8 9;
BA_ "GenSigSendType" SG_ 1411 RSDS_L_ObjRefPoint_8 9;
BA_ "GenSigStartValue" SG_ 1411 RSDS_L_ObjRCS_8 400;
BA_ "GenSigSendType" SG_ 1411 RSDS_L_ObjRCS_8 9;
BA_ "GenSigSendType" SG_ 1411 RSDS_L_ObjYawrate_8 9;
BA_ "GenSigSendType" SG_ 1411 RSDS_L_ObjHeading_8 9;
BA_ "GenSigSendType" SG_ 1411 RSDS_L_ObjLength_8 9;
BA_ "GenSigSendType" SG_ 1411 RSDS_L_SGU4_Checksum8 9;
BA_ "IsCrcSignal" SG_ 1411 RSDS_L_SGU4_Checksum8 1;
BA_ "GenSigSendType" SG_ 1411 RSDS_L_SGU4_RollingCounter7 9;
BA_ "IsRcSignal" SG_ 1411 RSDS_L_SGU4_RollingCounter7 1;
BA_ "GenSigSendType" SG_ 1411 RSDS_L_ObjMotionDirection_8 9;
BA_ "GenSigSendType" SG_ 1411 RSDS_L_ObjAge_8 9;
BA_ "GenSigSendType" SG_ 1411 RSDS_L_ObjWidth_8 9;
BA_ "GenSigSendType" SG_ 1411 RSDS_L_ObjRAccelYStd_8 9;
BA_ "GenSigSendType" SG_ 1411 RSDS_L_ObjRAccelXStd_8 9;
BA_ "GenSigSendType" SG_ 1411 RSDS_L_ObjRelVelYStd_8 9;
BA_ "GenSigSendType" SG_ 1411 RSDS_L_ObjRelVelXStd_8 9;
BA_ "GenSigSendType" SG_ 1411 RSDS_L_ObjDistYStd_8 9;
BA_ "GenSigSendType" SG_ 1411 RSDS_L_SGU4_Checksum7 9;
BA_ "IsCrcSignal" SG_ 1411 RSDS_L_SGU4_Checksum7 1;
BA_ "GenSigSendType" SG_ 1411 RSDS_L_SGU4_RollingCounter6 9;
BA_ "IsRcSignal" SG_ 1411 RSDS_L_SGU4_RollingCounter6 1;
BA_ "GenSigSendType" SG_ 1411 RSDS_L_ObjMotionType_8 9;
BA_ "GenSigStartValue" SG_ 1411 RSDS_L_ObjMeasured_8 1;
BA_ "GenSigSendType" SG_ 1411 RSDS_L_ObjMeasured_8 9;
BA_ "GenSigStartValue" SG_ 1411 RSDS_L_ObjRelAccelY_8 512;
BA_ "GenSigSendType" SG_ 1411 RSDS_L_ObjRelAccelY_8 9;
BA_ "GenSigStartValue" SG_ 1411 RSDS_L_ObjRelAccelX_8 512;
BA_ "GenSigSendType" SG_ 1411 RSDS_L_ObjRelAccelX_8 9;
BA_ "GenSigStartValue" SG_ 1411 RSDS_L_ObjRelVelY_8 4102;
BA_ "GenSigSendType" SG_ 1411 RSDS_L_ObjRelVelY_8 9;
BA_ "GenSigStartValue" SG_ 1411 RSDS_L_ObjRelVelX_8 4102;
BA_ "GenSigSendType" SG_ 1411 RSDS_L_ObjRelVelX_8 9;
BA_ "GenSigSendType" SG_ 1411 RSDS_L_SGU4_Checksum6 9;
BA_ "IsCrcSignal" SG_ 1411 RSDS_L_SGU4_Checksum6 1;
BA_ "GenSigSendType" SG_ 1411 RSDS_L_SGU4_RollingCounter5 9;
BA_ "IsRcSignal" SG_ 1411 RSDS_L_SGU4_RollingCounter5 1;
BA_ "GenSigSendType" SG_ 1411 RSDS_L_ObjType_8 9;
BA_ "GenSigSendType" SG_ 1411 RSDS_L_ObjDistXStd_8 9;
BA_ "GenSigStartValue" SG_ 1411 RSDS_L_ObjDistY_8 1024;
BA_ "GenSigSendType" SG_ 1411 RSDS_L_ObjDistY_8 9;
BA_ "GenSigSendType" SG_ 1411 RSDS_L_ObjDistX_8 9;
BA_ "GenSigSendType" SG_ 1411 RSDS_L_ObjObstacleProb_8 9;
BA_ "GenSigSendType" SG_ 1411 RSDS_L_ObjExistProb_8 9;
BA_ "GenSigSendType" SG_ 1411 RSDS_L_ObjID_8 9;
BA_ "GenSigSendType" SG_ 1411 RSDS_L_SGU4_Checksum5 9;
BA_ "IsCrcSignal" SG_ 1411 RSDS_L_SGU4_Checksum5 1;
BA_ "GenSigSendType" SG_ 1411 RSDS_L_SGU4_RollingCounter4 9;
BA_ "IsRcSignal" SG_ 1411 RSDS_L_SGU4_RollingCounter4 1;
BA_ "GenSigSendType" SG_ 1411 RSDS_L_HWATargetValidity_7 9;
BA_ "GenSigSendType" SG_ 1411 RSDS_L_ObjRefPoint_7 9;
BA_ "GenSigStartValue" SG_ 1411 RSDS_L_ObjRCS_7 400;
BA_ "GenSigSendType" SG_ 1411 RSDS_L_ObjRCS_7 9;
BA_ "GenSigSendType" SG_ 1411 RSDS_L_ObjYawrate_7 9;
BA_ "GenSigSendType" SG_ 1411 RSDS_L_ObjHeading_7 9;
BA_ "GenSigSendType" SG_ 1411 RSDS_L_ObjLength_7 9;
BA_ "GenSigSendType" SG_ 1411 RSDS_L_SGU4_Checksum4 9;
BA_ "IsCrcSignal" SG_ 1411 RSDS_L_SGU4_Checksum4 1;
BA_ "GenSigSendType" SG_ 1411 RSDS_L_SGU4_RollingCounter3 9;
BA_ "IsRcSignal" SG_ 1411 RSDS_L_SGU4_RollingCounter3 1;
BA_ "GenSigSendType" SG_ 1411 RSDS_L_ObjMotionDirection_7 9;
BA_ "GenSigSendType" SG_ 1411 RSDS_L_ObjAge_7 9;
BA_ "GenSigSendType" SG_ 1411 RSDS_L_ObjWidth_7 9;
BA_ "GenSigSendType" SG_ 1411 RSDS_L_ObjRAccelYStd_7 9;
BA_ "GenSigSendType" SG_ 1411 RSDS_L_ObjRAccelXStd_7 9;
BA_ "GenSigSendType" SG_ 1411 RSDS_L_ObjRelVelYStd_7 9;
BA_ "GenSigSendType" SG_ 1411 RSDS_L_ObjRelVelXStd_7 9;
BA_ "GenSigSendType" SG_ 1411 RSDS_L_ObjDistYStd_7 9;
BA_ "GenSigSendType" SG_ 1411 RSDS_L_SGU4_Checksum3 9;
BA_ "IsCrcSignal" SG_ 1411 RSDS_L_SGU4_Checksum3 1;
BA_ "GenSigSendType" SG_ 1411 RSDS_L_SGU4_RollingCounter2 9;
BA_ "IsRcSignal" SG_ 1411 RSDS_L_SGU4_RollingCounter2 1;
BA_ "GenSigSendType" SG_ 1411 RSDS_L_ObjMotionType_7 9;
BA_ "GenSigStartValue" SG_ 1411 RSDS_L_ObjMeasured_7 1;
BA_ "GenSigSendType" SG_ 1411 RSDS_L_ObjMeasured_7 9;
BA_ "GenSigStartValue" SG_ 1411 RSDS_L_ObjRelAccelY_7 512;
BA_ "GenSigSendType" SG_ 1411 RSDS_L_ObjRelAccelY_7 9;
BA_ "GenSigStartValue" SG_ 1411 RSDS_L_ObjRelAccelX_7 512;
BA_ "GenSigSendType" SG_ 1411 RSDS_L_ObjRelAccelX_7 9;
BA_ "GenSigStartValue" SG_ 1411 RSDS_L_ObjRelVelY_7 4102;
BA_ "GenSigSendType" SG_ 1411 RSDS_L_ObjRelVelY_7 9;
BA_ "GenSigStartValue" SG_ 1411 RSDS_L_ObjRelVelX_7 4102;
BA_ "GenSigSendType" SG_ 1411 RSDS_L_ObjRelVelX_7 9;
BA_ "GenSigSendType" SG_ 1411 RSDS_L_SGU4_Checksum2 9;
BA_ "IsCrcSignal" SG_ 1411 RSDS_L_SGU4_Checksum2 1;
BA_ "GenSigSendType" SG_ 1411 RSDS_L_SGU4_RollingCounter1 9;
BA_ "IsRcSignal" SG_ 1411 RSDS_L_SGU4_RollingCounter1 1;
BA_ "GenSigSendType" SG_ 1411 RSDS_L_ObjType_7 9;
BA_ "GenSigSendType" SG_ 1411 RSDS_L_ObjDistXStd_7 9;
BA_ "GenSigStartValue" SG_ 1411 RSDS_L_ObjDistY_7 1024;
BA_ "GenSigSendType" SG_ 1411 RSDS_L_ObjDistY_7 9;
BA_ "GenSigSendType" SG_ 1411 RSDS_L_ObjDistX_7 9;
BA_ "GenSigSendType" SG_ 1411 RSDS_L_ObjObstacleProb_7 9;
BA_ "GenSigSendType" SG_ 1411 RSDS_L_ObjExistProb_7 9;
BA_ "GenSigSendType" SG_ 1411 RSDS_L_ObjID_7 9;
BA_ "GenSigSendType" SG_ 1411 RSDS_L_SGU4_Checksum1 9;
BA_ "IsCrcSignal" SG_ 1411 RSDS_L_SGU4_Checksum1 1;
BA_ "GenSigSendType" SG_ 1412 RSDS_L_SGU5_RollingCounter8 9;
BA_ "IsRcSignal" SG_ 1412 RSDS_L_SGU5_RollingCounter8 1;
BA_ "GenSigSendType" SG_ 1412 RSDS_L_SGU5_BlockCounter 9;
BA_ "GenSigSendType" SG_ 1412 RSDS_L_HWATargetValidity_10 9;
BA_ "GenSigSendType" SG_ 1412 RSDS_L_ObjRefPoint_10 9;
BA_ "GenSigStartValue" SG_ 1412 RSDS_L_ObjRCS_10 400;
BA_ "GenSigSendType" SG_ 1412 RSDS_L_ObjRCS_10 9;
BA_ "GenSigSendType" SG_ 1412 RSDS_L_ObjYawrate_10 9;
BA_ "GenSigSendType" SG_ 1412 RSDS_L_ObjHeading_10 9;
BA_ "GenSigSendType" SG_ 1412 RSDS_L_ObjLength_10 9;
BA_ "GenSigSendType" SG_ 1412 RSDS_L_SGU5_Checksum8 9;
BA_ "IsCrcSignal" SG_ 1412 RSDS_L_SGU5_Checksum8 1;
BA_ "GenSigSendType" SG_ 1412 RSDS_L_SGU5_RollingCounter7 9;
BA_ "IsRcSignal" SG_ 1412 RSDS_L_SGU5_RollingCounter7 1;
BA_ "GenSigSendType" SG_ 1412 RSDS_L_ObjMotionDirection_10 9;
BA_ "GenSigSendType" SG_ 1412 RSDS_L_ObjAge_10 9;
BA_ "GenSigSendType" SG_ 1412 RSDS_L_ObjWidth_10 9;
BA_ "GenSigSendType" SG_ 1412 RSDS_L_ObjRAccelYStd_10 9;
BA_ "GenSigSendType" SG_ 1412 RSDS_L_ObjRAccelXStd_10 9;
BA_ "GenSigSendType" SG_ 1412 RSDS_L_ObjRelVelYStd_10 9;
BA_ "GenSigSendType" SG_ 1412 RSDS_L_ObjRelVelXStd_10 9;
BA_ "GenSigSendType" SG_ 1412 RSDS_L_ObjDistYStd_10 9;
BA_ "GenSigSendType" SG_ 1412 RSDS_L_SGU5_Checksum7 9;
BA_ "IsCrcSignal" SG_ 1412 RSDS_L_SGU5_Checksum7 1;
BA_ "GenSigSendType" SG_ 1412 RSDS_L_SGU5_RollingCounter6 9;
BA_ "IsRcSignal" SG_ 1412 RSDS_L_SGU5_RollingCounter6 1;
BA_ "GenSigSendType" SG_ 1412 RSDS_L_ObjMotionType_10 9;
BA_ "GenSigStartValue" SG_ 1412 RSDS_L_ObjMeasured_10 1;
BA_ "GenSigSendType" SG_ 1412 RSDS_L_ObjMeasured_10 9;
BA_ "GenSigStartValue" SG_ 1412 RSDS_L_ObjRelAccelY_10 512;
BA_ "GenSigSendType" SG_ 1412 RSDS_L_ObjRelAccelY_10 9;
BA_ "GenSigStartValue" SG_ 1412 RSDS_L_ObjRelAccelX_10 512;
BA_ "GenSigSendType" SG_ 1412 RSDS_L_ObjRelAccelX_10 9;
BA_ "GenSigStartValue" SG_ 1412 RSDS_L_ObjRelVelY_10 4102;
BA_ "GenSigSendType" SG_ 1412 RSDS_L_ObjRelVelY_10 9;
BA_ "GenSigStartValue" SG_ 1412 RSDS_L_ObjRelVelX_10 4102;
BA_ "GenSigSendType" SG_ 1412 RSDS_L_ObjRelVelX_10 9;
BA_ "GenSigSendType" SG_ 1412 RSDS_L_SGU5_Checksum6 9;
BA_ "IsCrcSignal" SG_ 1412 RSDS_L_SGU5_Checksum6 1;
BA_ "GenSigSendType" SG_ 1412 RSDS_L_SGU5_RollingCounter5 9;
BA_ "IsRcSignal" SG_ 1412 RSDS_L_SGU5_RollingCounter5 1;
BA_ "GenSigSendType" SG_ 1412 RSDS_L_ObjType_10 9;
BA_ "GenSigSendType" SG_ 1412 RSDS_L_ObjDistXStd_10 9;
BA_ "GenSigStartValue" SG_ 1412 RSDS_L_ObjDistY_10 1024;
BA_ "GenSigSendType" SG_ 1412 RSDS_L_ObjDistY_10 9;
BA_ "GenSigSendType" SG_ 1412 RSDS_L_ObjDistX_10 9;
BA_ "GenSigSendType" SG_ 1412 RSDS_L_ObjObstacleProb_10 9;
BA_ "GenSigSendType" SG_ 1412 RSDS_L_ObjExistProb_10 9;
BA_ "GenSigSendType" SG_ 1412 RSDS_L_ObjID_10 9;
BA_ "GenSigSendType" SG_ 1412 RSDS_L_SGU5_Checksum5 9;
BA_ "IsCrcSignal" SG_ 1412 RSDS_L_SGU5_Checksum5 1;
BA_ "GenSigSendType" SG_ 1412 RSDS_L_SGU5_RollingCounter4 9;
BA_ "IsRcSignal" SG_ 1412 RSDS_L_SGU5_RollingCounter4 1;
BA_ "GenSigSendType" SG_ 1412 RSDS_L_HWATargetValidity_9 9;
BA_ "GenSigSendType" SG_ 1412 RSDS_L_ObjRefPoint_9 9;
BA_ "GenSigStartValue" SG_ 1412 RSDS_L_ObjRCS_9 400;
BA_ "GenSigSendType" SG_ 1412 RSDS_L_ObjRCS_9 9;
BA_ "GenSigSendType" SG_ 1412 RSDS_L_ObjYawrate_9 9;
BA_ "GenSigSendType" SG_ 1412 RSDS_L_ObjHeading_9 9;
BA_ "GenSigSendType" SG_ 1412 RSDS_L_ObjLength_9 9;
BA_ "GenSigSendType" SG_ 1412 RSDS_L_SGU5_Checksum4 9;
BA_ "IsCrcSignal" SG_ 1412 RSDS_L_SGU5_Checksum4 1;
BA_ "GenSigSendType" SG_ 1412 RSDS_L_SGU5_RollingCounter3 9;
BA_ "IsRcSignal" SG_ 1412 RSDS_L_SGU5_RollingCounter3 1;
BA_ "GenSigSendType" SG_ 1412 RSDS_L_ObjMotionDirection_9 9;
BA_ "GenSigSendType" SG_ 1412 RSDS_L_ObjAge_9 9;
BA_ "GenSigSendType" SG_ 1412 RSDS_L_ObjWidth_9 9;
BA_ "GenSigSendType" SG_ 1412 RSDS_L_ObjRAccelYStd_9 9;
BA_ "GenSigSendType" SG_ 1412 RSDS_L_ObjRAccelXStd_9 9;
BA_ "GenSigSendType" SG_ 1412 RSDS_L_ObjRelVelYStd_9 9;
BA_ "GenSigSendType" SG_ 1412 RSDS_L_ObjRelVelXStd_9 9;
BA_ "GenSigSendType" SG_ 1412 RSDS_L_ObjDistYStd_9 9;
BA_ "GenSigSendType" SG_ 1412 RSDS_L_SGU5_Checksum3 9;
BA_ "IsCrcSignal" SG_ 1412 RSDS_L_SGU5_Checksum3 1;
BA_ "GenSigSendType" SG_ 1412 RSDS_L_SGU5_RollingCounter2 9;
BA_ "IsRcSignal" SG_ 1412 RSDS_L_SGU5_RollingCounter2 1;
BA_ "GenSigSendType" SG_ 1412 RSDS_L_ObjMotionType_9 9;
BA_ "GenSigStartValue" SG_ 1412 RSDS_L_ObjMeasured_9 1;
BA_ "GenSigSendType" SG_ 1412 RSDS_L_ObjMeasured_9 9;
BA_ "GenSigStartValue" SG_ 1412 RSDS_L_ObjRelAccelY_9 512;
BA_ "GenSigSendType" SG_ 1412 RSDS_L_ObjRelAccelY_9 9;
BA_ "GenSigStartValue" SG_ 1412 RSDS_L_ObjRelAccelX_9 512;
BA_ "GenSigSendType" SG_ 1412 RSDS_L_ObjRelAccelX_9 9;
BA_ "GenSigStartValue" SG_ 1412 RSDS_L_ObjRelVelY_9 4102;
BA_ "GenSigSendType" SG_ 1412 RSDS_L_ObjRelVelY_9 9;
BA_ "GenSigStartValue" SG_ 1412 RSDS_L_ObjRelVelX_9 4102;
BA_ "GenSigSendType" SG_ 1412 RSDS_L_ObjRelVelX_9 9;
BA_ "GenSigSendType" SG_ 1412 RSDS_L_SGU5_Checksum2 9;
BA_ "IsCrcSignal" SG_ 1412 RSDS_L_SGU5_Checksum2 1;
BA_ "GenSigSendType" SG_ 1412 RSDS_L_SGU5_RollingCounter1 9;
BA_ "IsRcSignal" SG_ 1412 RSDS_L_SGU5_RollingCounter1 1;
BA_ "GenSigSendType" SG_ 1412 RSDS_L_ObjType_9 9;
BA_ "GenSigSendType" SG_ 1412 RSDS_L_ObjDistXStd_9 9;
BA_ "GenSigStartValue" SG_ 1412 RSDS_L_ObjDistY_9 1024;
BA_ "GenSigSendType" SG_ 1412 RSDS_L_ObjDistY_9 9;
BA_ "GenSigSendType" SG_ 1412 RSDS_L_ObjDistX_9 9;
BA_ "GenSigSendType" SG_ 1412 RSDS_L_ObjObstacleProb_9 9;
BA_ "GenSigSendType" SG_ 1412 RSDS_L_ObjExistProb_9 9;
BA_ "GenSigSendType" SG_ 1412 RSDS_L_ObjID_9 9;
BA_ "GenSigSendType" SG_ 1412 RSDS_L_SGU5_Checksum1 9;
BA_ "IsCrcSignal" SG_ 1412 RSDS_L_SGU5_Checksum1 1;
BA_ "GenSigSendType" SG_ 1413 RSDS_L_SGU6_RollingCounter8 9;
BA_ "IsRcSignal" SG_ 1413 RSDS_L_SGU6_RollingCounter8 1;
BA_ "GenSigSendType" SG_ 1413 RSDS_L_SGU6_BlockCounter 9;
BA_ "GenSigSendType" SG_ 1413 RSDS_L_HWATargetValidity_12 9;
BA_ "GenSigSendType" SG_ 1413 RSDS_L_ObjRefPoint_12 9;
BA_ "GenSigStartValue" SG_ 1413 RSDS_L_ObjRCS_12 400;
BA_ "GenSigSendType" SG_ 1413 RSDS_L_ObjRCS_12 9;
BA_ "GenSigSendType" SG_ 1413 RSDS_L_ObjYawrate_12 9;
BA_ "GenSigSendType" SG_ 1413 RSDS_L_ObjHeading_12 9;
BA_ "GenSigSendType" SG_ 1413 RSDS_L_ObjLength_12 9;
BA_ "GenSigSendType" SG_ 1413 RSDS_L_SGU6_Checksum8 9;
BA_ "IsCrcSignal" SG_ 1413 RSDS_L_SGU6_Checksum8 1;
BA_ "GenSigSendType" SG_ 1413 RSDS_L_SGU6_RollingCounter7 9;
BA_ "IsRcSignal" SG_ 1413 RSDS_L_SGU6_RollingCounter7 1;
BA_ "GenSigSendType" SG_ 1413 RSDS_L_ObjMotionDirection_12 9;
BA_ "GenSigSendType" SG_ 1413 RSDS_L_ObjAge_12 9;
BA_ "GenSigSendType" SG_ 1413 RSDS_L_ObjWidth_12 9;
BA_ "GenSigSendType" SG_ 1413 RSDS_L_ObjRAccelYStd_12 9;
BA_ "GenSigSendType" SG_ 1413 RSDS_L_ObjRAccelXStd_12 9;
BA_ "GenSigSendType" SG_ 1413 RSDS_L_ObjRelVelYStd_12 9;
BA_ "GenSigSendType" SG_ 1413 RSDS_L_ObjRelVelXStd_12 9;
BA_ "GenSigSendType" SG_ 1413 RSDS_L_ObjDistYStd_12 9;
BA_ "GenSigSendType" SG_ 1413 RSDS_L_SGU6_Checksum7 9;
BA_ "IsCrcSignal" SG_ 1413 RSDS_L_SGU6_Checksum7 1;
BA_ "GenSigSendType" SG_ 1413 RSDS_L_SGU6_RollingCounter6 9;
BA_ "IsRcSignal" SG_ 1413 RSDS_L_SGU6_RollingCounter6 1;
BA_ "GenSigSendType" SG_ 1413 RSDS_L_ObjMotionType_12 9;
BA_ "GenSigStartValue" SG_ 1413 RSDS_L_ObjMeasured_12 1;
BA_ "GenSigSendType" SG_ 1413 RSDS_L_ObjMeasured_12 9;
BA_ "GenSigStartValue" SG_ 1413 RSDS_L_ObjRelAccelY_12 512;
BA_ "GenSigSendType" SG_ 1413 RSDS_L_ObjRelAccelY_12 9;
BA_ "GenSigStartValue" SG_ 1413 RSDS_L_ObjRelAccelX_12 512;
BA_ "GenSigSendType" SG_ 1413 RSDS_L_ObjRelAccelX_12 9;
BA_ "GenSigStartValue" SG_ 1413 RSDS_L_ObjRelVelY_12 4102;
BA_ "GenSigSendType" SG_ 1413 RSDS_L_ObjRelVelY_12 9;
BA_ "GenSigStartValue" SG_ 1413 RSDS_L_ObjRelVelX_12 4102;
BA_ "GenSigSendType" SG_ 1413 RSDS_L_ObjRelVelX_12 9;
BA_ "GenSigSendType" SG_ 1413 RSDS_L_SGU6_Checksum6 9;
BA_ "IsCrcSignal" SG_ 1413 RSDS_L_SGU6_Checksum6 1;
BA_ "GenSigSendType" SG_ 1413 RSDS_L_SGU6_RollingCounter5 9;
BA_ "IsRcSignal" SG_ 1413 RSDS_L_SGU6_RollingCounter5 1;
BA_ "GenSigSendType" SG_ 1413 RSDS_L_ObjType_12 9;
BA_ "GenSigSendType" SG_ 1413 RSDS_L_ObjDistXStd_12 9;
BA_ "GenSigStartValue" SG_ 1413 RSDS_L_ObjDistY_12 1024;
BA_ "GenSigSendType" SG_ 1413 RSDS_L_ObjDistY_12 9;
BA_ "GenSigSendType" SG_ 1413 RSDS_L_ObjDistX_12 9;
BA_ "GenSigSendType" SG_ 1413 RSDS_L_ObjObstacleProb_12 9;
BA_ "GenSigSendType" SG_ 1413 RSDS_L_ObjExistProb_12 9;
BA_ "GenSigSendType" SG_ 1413 RSDS_L_ObjID_12 9;
BA_ "GenSigSendType" SG_ 1413 RSDS_L_SGU6_Checksum5 9;
BA_ "IsCrcSignal" SG_ 1413 RSDS_L_SGU6_Checksum5 1;
BA_ "GenSigSendType" SG_ 1413 RSDS_L_SGU6_RollingCounter4 9;
BA_ "IsRcSignal" SG_ 1413 RSDS_L_SGU6_RollingCounter4 1;
BA_ "GenSigSendType" SG_ 1413 RSDS_L_HWATargetValidity_11 9;
BA_ "GenSigSendType" SG_ 1413 RSDS_L_ObjRefPoint_11 9;
BA_ "GenSigStartValue" SG_ 1413 RSDS_L_ObjRCS_11 400;
BA_ "GenSigSendType" SG_ 1413 RSDS_L_ObjRCS_11 9;
BA_ "GenSigSendType" SG_ 1413 RSDS_L_ObjYawrate_11 9;
BA_ "GenSigSendType" SG_ 1413 RSDS_L_ObjHeading_11 9;
BA_ "GenSigSendType" SG_ 1413 RSDS_L_ObjLength_11 9;
BA_ "GenSigSendType" SG_ 1413 RSDS_L_SGU6_Checksum4 9;
BA_ "IsCrcSignal" SG_ 1413 RSDS_L_SGU6_Checksum4 1;
BA_ "GenSigSendType" SG_ 1413 RSDS_L_SGU6_RollingCounter3 9;
BA_ "IsRcSignal" SG_ 1413 RSDS_L_SGU6_RollingCounter3 1;
BA_ "GenSigSendType" SG_ 1413 RSDS_L_ObjMotionDirection_11 9;
BA_ "GenSigSendType" SG_ 1413 RSDS_L_ObjAge_11 9;
BA_ "GenSigSendType" SG_ 1413 RSDS_L_ObjWidth_11 9;
BA_ "GenSigSendType" SG_ 1413 RSDS_L_ObjRAccelYStd_11 9;
BA_ "GenSigSendType" SG_ 1413 RSDS_L_ObjRAccelXStd_11 9;
BA_ "GenSigSendType" SG_ 1413 RSDS_L_ObjRelVelYStd_11 9;
BA_ "GenSigSendType" SG_ 1413 RSDS_L_ObjRelVelXStd_11 9;
BA_ "GenSigSendType" SG_ 1413 RSDS_L_ObjDistYStd_11 9;
BA_ "GenSigSendType" SG_ 1413 RSDS_L_SGU6_Checksum3 9;
BA_ "IsCrcSignal" SG_ 1413 RSDS_L_SGU6_Checksum3 1;
BA_ "GenSigSendType" SG_ 1413 RSDS_L_SGU6_RollingCounter2 9;
BA_ "IsRcSignal" SG_ 1413 RSDS_L_SGU6_RollingCounter2 1;
BA_ "GenSigSendType" SG_ 1413 RSDS_L_ObjMotionType_11 9;
BA_ "GenSigStartValue" SG_ 1413 RSDS_L_ObjMeasured_11 1;
BA_ "GenSigSendType" SG_ 1413 RSDS_L_ObjMeasured_11 9;
BA_ "GenSigStartValue" SG_ 1413 RSDS_L_ObjRelAccelY_11 512;
BA_ "GenSigSendType" SG_ 1413 RSDS_L_ObjRelAccelY_11 9;
BA_ "GenSigStartValue" SG_ 1413 RSDS_L_ObjRelAccelX_11 512;
BA_ "GenSigSendType" SG_ 1413 RSDS_L_ObjRelAccelX_11 9;
BA_ "GenSigStartValue" SG_ 1413 RSDS_L_ObjRelVelY_11 4102;
BA_ "GenSigSendType" SG_ 1413 RSDS_L_ObjRelVelY_11 9;
BA_ "GenSigStartValue" SG_ 1413 RSDS_L_ObjRelVelX_11 4102;
BA_ "GenSigSendType" SG_ 1413 RSDS_L_ObjRelVelX_11 9;
BA_ "GenSigSendType" SG_ 1413 RSDS_L_SGU6_Checksum2 9;
BA_ "IsCrcSignal" SG_ 1413 RSDS_L_SGU6_Checksum2 1;
BA_ "GenSigSendType" SG_ 1413 RSDS_L_SGU6_RollingCounter1 9;
BA_ "IsRcSignal" SG_ 1413 RSDS_L_SGU6_RollingCounter1 1;
BA_ "GenSigSendType" SG_ 1413 RSDS_L_ObjType_11 9;
BA_ "GenSigSendType" SG_ 1413 RSDS_L_ObjDistXStd_11 9;
BA_ "GenSigStartValue" SG_ 1413 RSDS_L_ObjDistY_11 1024;
BA_ "GenSigSendType" SG_ 1413 RSDS_L_ObjDistY_11 9;
BA_ "GenSigSendType" SG_ 1413 RSDS_L_ObjDistX_11 9;
BA_ "GenSigSendType" SG_ 1413 RSDS_L_ObjObstacleProb_11 9;
BA_ "GenSigSendType" SG_ 1413 RSDS_L_ObjExistProb_11 9;
BA_ "GenSigSendType" SG_ 1413 RSDS_L_ObjID_11 9;
BA_ "GenSigSendType" SG_ 1413 RSDS_L_SGU6_Checksum1 9;
BA_ "IsCrcSignal" SG_ 1413 RSDS_L_SGU6_Checksum1 1;
BA_ "GenSigSendType" SG_ 1414 RSDS_L_SGU7_RollingCounter8 9;
BA_ "IsRcSignal" SG_ 1414 RSDS_L_SGU7_RollingCounter8 1;
BA_ "GenSigSendType" SG_ 1414 RSDS_L_SGU7_BlockCounter 9;
BA_ "GenSigSendType" SG_ 1414 RSDS_L_HWATargetValidity_14 9;
BA_ "GenSigSendType" SG_ 1414 RSDS_L_ObjRefPoint_14 9;
BA_ "GenSigStartValue" SG_ 1414 RSDS_L_ObjRCS_14 400;
BA_ "GenSigSendType" SG_ 1414 RSDS_L_ObjRCS_14 9;
BA_ "GenSigSendType" SG_ 1414 RSDS_L_ObjYawrate_14 9;
BA_ "GenSigSendType" SG_ 1414 RSDS_L_ObjHeading_14 9;
BA_ "GenSigSendType" SG_ 1414 RSDS_L_ObjLength_14 9;
BA_ "GenSigSendType" SG_ 1414 RSDS_L_SGU7_Checksum8 9;
BA_ "IsCrcSignal" SG_ 1414 RSDS_L_SGU7_Checksum8 1;
BA_ "GenSigSendType" SG_ 1414 RSDS_L_SGU7_RollingCounter7 9;
BA_ "IsRcSignal" SG_ 1414 RSDS_L_SGU7_RollingCounter7 1;
BA_ "GenSigSendType" SG_ 1414 RSDS_L_ObjMotionDirection_14 9;
BA_ "GenSigSendType" SG_ 1414 RSDS_L_ObjAge_14 9;
BA_ "GenSigSendType" SG_ 1414 RSDS_L_ObjWidth_14 9;
BA_ "GenSigSendType" SG_ 1414 RSDS_L_ObjRAccelYStd_14 9;
BA_ "GenSigSendType" SG_ 1414 RSDS_L_ObjRAccelXStd_14 9;
BA_ "GenSigSendType" SG_ 1414 RSDS_L_ObjRelVelYStd_14 9;
BA_ "GenSigSendType" SG_ 1414 RSDS_L_ObjRelVelXStd_14 9;
BA_ "GenSigSendType" SG_ 1414 RSDS_L_ObjDistYStd_14 9;
BA_ "GenSigSendType" SG_ 1414 RSDS_L_SGU7_Checksum7 9;
BA_ "IsCrcSignal" SG_ 1414 RSDS_L_SGU7_Checksum7 1;
BA_ "GenSigSendType" SG_ 1414 RSDS_L_SGU7_RollingCounter6 9;
BA_ "IsRcSignal" SG_ 1414 RSDS_L_SGU7_RollingCounter6 1;
BA_ "GenSigSendType" SG_ 1414 RSDS_L_ObjMotionType_14 9;
BA_ "GenSigStartValue" SG_ 1414 RSDS_L_ObjMeasured_14 1;
BA_ "GenSigSendType" SG_ 1414 RSDS_L_ObjMeasured_14 9;
BA_ "GenSigStartValue" SG_ 1414 RSDS_L_ObjRelAccelY_14 512;
BA_ "GenSigSendType" SG_ 1414 RSDS_L_ObjRelAccelY_14 9;
BA_ "GenSigStartValue" SG_ 1414 RSDS_L_ObjRelAccelX_14 512;
BA_ "GenSigSendType" SG_ 1414 RSDS_L_ObjRelAccelX_14 9;
BA_ "GenSigStartValue" SG_ 1414 RSDS_L_ObjRelVelY_14 4102;
BA_ "GenSigSendType" SG_ 1414 RSDS_L_ObjRelVelY_14 9;
BA_ "GenSigStartValue" SG_ 1414 RSDS_L_ObjRelVelX_14 4102;
BA_ "GenSigSendType" SG_ 1414 RSDS_L_ObjRelVelX_14 9;
BA_ "GenSigSendType" SG_ 1414 RSDS_L_SGU7_Checksum6 9;
BA_ "IsCrcSignal" SG_ 1414 RSDS_L_SGU7_Checksum6 1;
BA_ "GenSigSendType" SG_ 1414 RSDS_L_SGU7_RollingCounter5 9;
BA_ "IsRcSignal" SG_ 1414 RSDS_L_SGU7_RollingCounter5 1;
BA_ "GenSigSendType" SG_ 1414 RSDS_L_ObjType_14 9;
BA_ "GenSigSendType" SG_ 1414 RSDS_L_ObjDistXStd_14 9;
BA_ "GenSigStartValue" SG_ 1414 RSDS_L_ObjDistY_14 1024;
BA_ "GenSigSendType" SG_ 1414 RSDS_L_ObjDistY_14 9;
BA_ "GenSigSendType" SG_ 1414 RSDS_L_ObjDistX_14 9;
BA_ "GenSigSendType" SG_ 1414 RSDS_L_ObjObstacleProb_14 9;
BA_ "GenSigSendType" SG_ 1414 RSDS_L_ObjExistProb_14 9;
BA_ "GenSigSendType" SG_ 1414 RSDS_L_ObjID_14 9;
BA_ "GenSigSendType" SG_ 1414 RSDS_L_SGU7_Checksum5 9;
BA_ "IsCrcSignal" SG_ 1414 RSDS_L_SGU7_Checksum5 1;
BA_ "GenSigSendType" SG_ 1414 RSDS_L_SGU7_RollingCounter4 9;
BA_ "IsRcSignal" SG_ 1414 RSDS_L_SGU7_RollingCounter4 1;
BA_ "GenSigSendType" SG_ 1414 RSDS_L_HWATargetValidity_13 9;
BA_ "GenSigSendType" SG_ 1414 RSDS_L_ObjRefPoint_13 9;
BA_ "GenSigStartValue" SG_ 1414 RSDS_L_ObjRCS_13 400;
BA_ "GenSigSendType" SG_ 1414 RSDS_L_ObjRCS_13 9;
BA_ "GenSigSendType" SG_ 1414 RSDS_L_ObjYawrate_13 9;
BA_ "GenSigSendType" SG_ 1414 RSDS_L_ObjHeading_13 9;
BA_ "GenSigSendType" SG_ 1414 RSDS_L_ObjLength_13 9;
BA_ "GenSigSendType" SG_ 1414 RSDS_L_SGU7_Checksum4 9;
BA_ "IsCrcSignal" SG_ 1414 RSDS_L_SGU7_Checksum4 1;
BA_ "GenSigSendType" SG_ 1414 RSDS_L_SGU7_RollingCounter3 9;
BA_ "IsRcSignal" SG_ 1414 RSDS_L_SGU7_RollingCounter3 1;
BA_ "GenSigSendType" SG_ 1414 RSDS_L_ObjMotionDirection_13 9;
BA_ "GenSigSendType" SG_ 1414 RSDS_L_ObjAge_13 9;
BA_ "GenSigSendType" SG_ 1414 RSDS_L_ObjWidth_13 9;
BA_ "GenSigSendType" SG_ 1414 RSDS_L_ObjRAccelYStd_13 9;
BA_ "GenSigSendType" SG_ 1414 RSDS_L_ObjRAccelXStd_13 9;
BA_ "GenSigSendType" SG_ 1414 RSDS_L_ObjRelVelYStd_13 9;
BA_ "GenSigSendType" SG_ 1414 RSDS_L_ObjRelVelXStd_13 9;
BA_ "GenSigSendType" SG_ 1414 RSDS_L_ObjDistYStd_13 9;
BA_ "GenSigSendType" SG_ 1414 RSDS_L_SGU7_Checksum3 9;
BA_ "IsCrcSignal" SG_ 1414 RSDS_L_SGU7_Checksum3 1;
BA_ "GenSigSendType" SG_ 1414 RSDS_L_SGU7_RollingCounter2 9;
BA_ "IsRcSignal" SG_ 1414 RSDS_L_SGU7_RollingCounter2 1;
BA_ "GenSigSendType" SG_ 1414 RSDS_L_ObjMotionType_13 9;
BA_ "GenSigStartValue" SG_ 1414 RSDS_L_ObjMeasured_13 1;
BA_ "GenSigSendType" SG_ 1414 RSDS_L_ObjMeasured_13 9;
BA_ "GenSigStartValue" SG_ 1414 RSDS_L_ObjRelAccelY_13 512;
BA_ "GenSigSendType" SG_ 1414 RSDS_L_ObjRelAccelY_13 9;
BA_ "GenSigStartValue" SG_ 1414 RSDS_L_ObjRelAccelX_13 512;
BA_ "GenSigSendType" SG_ 1414 RSDS_L_ObjRelAccelX_13 9;
BA_ "GenSigStartValue" SG_ 1414 RSDS_L_ObjRelVelY_13 4102;
BA_ "GenSigSendType" SG_ 1414 RSDS_L_ObjRelVelY_13 9;
BA_ "GenSigStartValue" SG_ 1414 RSDS_L_ObjRelVelX_13 4102;
BA_ "GenSigSendType" SG_ 1414 RSDS_L_ObjRelVelX_13 9;
BA_ "GenSigSendType" SG_ 1414 RSDS_L_SGU7_Checksum2 9;
BA_ "IsCrcSignal" SG_ 1414 RSDS_L_SGU7_Checksum2 1;
BA_ "GenSigSendType" SG_ 1414 RSDS_L_SGU7_RollingCounter1 9;
BA_ "IsRcSignal" SG_ 1414 RSDS_L_SGU7_RollingCounter1 1;
BA_ "GenSigSendType" SG_ 1414 RSDS_L_ObjType_13 9;
BA_ "GenSigSendType" SG_ 1414 RSDS_L_ObjDistXStd_13 9;
BA_ "GenSigStartValue" SG_ 1414 RSDS_L_ObjDistY_13 1024;
BA_ "GenSigSendType" SG_ 1414 RSDS_L_ObjDistY_13 9;
BA_ "GenSigSendType" SG_ 1414 RSDS_L_ObjDistX_13 9;
BA_ "GenSigSendType" SG_ 1414 RSDS_L_ObjObstacleProb_13 9;
BA_ "GenSigSendType" SG_ 1414 RSDS_L_ObjExistProb_13 9;
BA_ "GenSigSendType" SG_ 1414 RSDS_L_ObjID_13 9;
BA_ "GenSigSendType" SG_ 1414 RSDS_L_SGU7_Checksum1 9;
BA_ "IsCrcSignal" SG_ 1414 RSDS_L_SGU7_Checksum1 1;
BA_ "GenSigSendType" SG_ 1415 RSDS_L_SGU8_RollingCounter8 9;
BA_ "IsRcSignal" SG_ 1415 RSDS_L_SGU8_RollingCounter8 1;
BA_ "GenSigSendType" SG_ 1415 RSDS_L_SGU8_BlockCounter 9;
BA_ "GenSigSendType" SG_ 1415 RSDS_L_HWATargetValidity_16 9;
BA_ "GenSigSendType" SG_ 1415 RSDS_L_ObjRefPoint_16 9;
BA_ "GenSigStartValue" SG_ 1415 RSDS_L_ObjRCS_16 400;
BA_ "GenSigSendType" SG_ 1415 RSDS_L_ObjRCS_16 9;
BA_ "GenSigSendType" SG_ 1415 RSDS_L_ObjYawrate_16 9;
BA_ "GenSigSendType" SG_ 1415 RSDS_L_ObjHeading_16 9;
BA_ "GenSigSendType" SG_ 1415 RSDS_L_ObjLength_16 9;
BA_ "GenSigSendType" SG_ 1415 RSDS_L_SGU8_Checksum8 9;
BA_ "IsCrcSignal" SG_ 1415 RSDS_L_SGU8_Checksum8 1;
BA_ "GenSigSendType" SG_ 1415 RSDS_L_SGU8_RollingCounter7 9;
BA_ "IsRcSignal" SG_ 1415 RSDS_L_SGU8_RollingCounter7 1;
BA_ "GenSigSendType" SG_ 1415 RSDS_L_ObjMotionDirection_16 9;
BA_ "GenSigSendType" SG_ 1415 RSDS_L_ObjAge_16 9;
BA_ "GenSigSendType" SG_ 1415 RSDS_L_ObjWidth_16 9;
BA_ "GenSigSendType" SG_ 1415 RSDS_L_ObjRAccelYStd_16 9;
BA_ "GenSigSendType" SG_ 1415 RSDS_L_ObjRAccelXStd_16 9;
BA_ "GenSigSendType" SG_ 1415 RSDS_L_ObjRelVelYStd_16 9;
BA_ "GenSigSendType" SG_ 1415 RSDS_L_ObjRelVelXStd_16 9;
BA_ "GenSigSendType" SG_ 1415 RSDS_L_ObjDistYStd_16 9;
BA_ "GenSigSendType" SG_ 1415 RSDS_L_SGU8_Checksum7 9;
BA_ "IsCrcSignal" SG_ 1415 RSDS_L_SGU8_Checksum7 1;
BA_ "GenSigSendType" SG_ 1415 RSDS_L_SGU8_RollingCounter6 9;
BA_ "IsRcSignal" SG_ 1415 RSDS_L_SGU8_RollingCounter6 1;
BA_ "GenSigSendType" SG_ 1415 RSDS_L_ObjMotionType_16 9;
BA_ "GenSigStartValue" SG_ 1415 RSDS_L_ObjMeasured_16 1;
BA_ "GenSigSendType" SG_ 1415 RSDS_L_ObjMeasured_16 9;
BA_ "GenSigStartValue" SG_ 1415 RSDS_L_ObjRelAccelY_16 512;
BA_ "GenSigSendType" SG_ 1415 RSDS_L_ObjRelAccelY_16 9;
BA_ "GenSigStartValue" SG_ 1415 RSDS_L_ObjRelAccelX_16 512;
BA_ "GenSigSendType" SG_ 1415 RSDS_L_ObjRelAccelX_16 9;
BA_ "GenSigStartValue" SG_ 1415 RSDS_L_ObjRelVelY_16 4102;
BA_ "GenSigSendType" SG_ 1415 RSDS_L_ObjRelVelY_16 9;
BA_ "GenSigStartValue" SG_ 1415 RSDS_L_ObjRelVelX_16 4102;
BA_ "GenSigSendType" SG_ 1415 RSDS_L_ObjRelVelX_16 9;
BA_ "GenSigSendType" SG_ 1415 RSDS_L_SGU8_Checksum6 9;
BA_ "IsCrcSignal" SG_ 1415 RSDS_L_SGU8_Checksum6 1;
BA_ "GenSigSendType" SG_ 1415 RSDS_L_SGU8_RollingCounter5 9;
BA_ "IsRcSignal" SG_ 1415 RSDS_L_SGU8_RollingCounter5 1;
BA_ "GenSigSendType" SG_ 1415 RSDS_L_ObjType_16 9;
BA_ "GenSigSendType" SG_ 1415 RSDS_L_ObjDistXStd_16 9;
BA_ "GenSigStartValue" SG_ 1415 RSDS_L_ObjDistY_16 1024;
BA_ "GenSigSendType" SG_ 1415 RSDS_L_ObjDistY_16 9;
BA_ "GenSigSendType" SG_ 1415 RSDS_L_ObjDistX_16 9;
BA_ "GenSigSendType" SG_ 1415 RSDS_L_ObjObstacleProb_16 9;
BA_ "GenSigSendType" SG_ 1415 RSDS_L_ObjExistProb_16 9;
BA_ "GenSigSendType" SG_ 1415 RSDS_L_ObjID_16 9;
BA_ "GenSigSendType" SG_ 1415 RSDS_L_SGU8_Checksum5 9;
BA_ "IsCrcSignal" SG_ 1415 RSDS_L_SGU8_Checksum5 1;
BA_ "GenSigSendType" SG_ 1415 RSDS_L_SGU8_RollingCounter4 9;
BA_ "IsRcSignal" SG_ 1415 RSDS_L_SGU8_RollingCounter4 1;
BA_ "GenSigSendType" SG_ 1415 RSDS_L_HWATargetValidity_15 9;
BA_ "GenSigSendType" SG_ 1415 RSDS_L_ObjRefPoint_15 9;
BA_ "GenSigStartValue" SG_ 1415 RSDS_L_ObjRCS_15 400;
BA_ "GenSigSendType" SG_ 1415 RSDS_L_ObjRCS_15 9;
BA_ "GenSigSendType" SG_ 1415 RSDS_L_ObjYawrate_15 9;
BA_ "GenSigSendType" SG_ 1415 RSDS_L_ObjHeading_15 9;
BA_ "GenSigSendType" SG_ 1415 RSDS_L_ObjLength_15 9;
BA_ "GenSigSendType" SG_ 1415 RSDS_L_SGU8_Checksum4 9;
BA_ "IsCrcSignal" SG_ 1415 RSDS_L_SGU8_Checksum4 1;
BA_ "GenSigSendType" SG_ 1415 RSDS_L_SGU8_RollingCounter3 9;
BA_ "IsRcSignal" SG_ 1415 RSDS_L_SGU8_RollingCounter3 1;
BA_ "GenSigSendType" SG_ 1415 RSDS_L_ObjMotionDirection_15 9;
BA_ "GenSigSendType" SG_ 1415 RSDS_L_ObjAge_15 9;
BA_ "GenSigSendType" SG_ 1415 RSDS_L_ObjWidth_15 9;
BA_ "GenSigSendType" SG_ 1415 RSDS_L_ObjRAccelYStd_15 9;
BA_ "GenSigSendType" SG_ 1415 RSDS_L_ObjRAccelXStd_15 9;
BA_ "GenSigSendType" SG_ 1415 RSDS_L_ObjRelVelYStd_15 9;
BA_ "GenSigSendType" SG_ 1415 RSDS_L_ObjRelVelXStd_15 9;
BA_ "GenSigSendType" SG_ 1415 RSDS_L_ObjDistYStd_15 9;
BA_ "GenSigSendType" SG_ 1415 RSDS_L_SGU8_Checksum3 9;
BA_ "IsCrcSignal" SG_ 1415 RSDS_L_SGU8_Checksum3 1;
BA_ "GenSigSendType" SG_ 1415 RSDS_L_SGU8_RollingCounter2 9;
BA_ "IsRcSignal" SG_ 1415 RSDS_L_SGU8_RollingCounter2 1;
BA_ "GenSigSendType" SG_ 1415 RSDS_L_ObjMotionType_15 9;
BA_ "GenSigStartValue" SG_ 1415 RSDS_L_ObjMeasured_15 1;
BA_ "GenSigSendType" SG_ 1415 RSDS_L_ObjMeasured_15 9;
BA_ "GenSigStartValue" SG_ 1415 RSDS_L_ObjRelAccelY_15 512;
BA_ "GenSigSendType" SG_ 1415 RSDS_L_ObjRelAccelY_15 9;
BA_ "GenSigStartValue" SG_ 1415 RSDS_L_ObjRelAccelX_15 512;
BA_ "GenSigSendType" SG_ 1415 RSDS_L_ObjRelAccelX_15 9;
BA_ "GenSigStartValue" SG_ 1415 RSDS_L_ObjRelVelY_15 4102;
BA_ "GenSigSendType" SG_ 1415 RSDS_L_ObjRelVelY_15 9;
BA_ "GenSigStartValue" SG_ 1415 RSDS_L_ObjRelVelX_15 4102;
BA_ "GenSigSendType" SG_ 1415 RSDS_L_ObjRelVelX_15 9;
BA_ "GenSigSendType" SG_ 1415 RSDS_L_SGU8_Checksum2 9;
BA_ "IsCrcSignal" SG_ 1415 RSDS_L_SGU8_Checksum2 1;
BA_ "GenSigSendType" SG_ 1415 RSDS_L_SGU8_RollingCounter1 9;
BA_ "IsRcSignal" SG_ 1415 RSDS_L_SGU8_RollingCounter1 1;
BA_ "GenSigSendType" SG_ 1415 RSDS_L_ObjType_15 9;
BA_ "GenSigSendType" SG_ 1415 RSDS_L_ObjDistXStd_15 9;
BA_ "GenSigStartValue" SG_ 1415 RSDS_L_ObjDistY_15 1024;
BA_ "GenSigSendType" SG_ 1415 RSDS_L_ObjDistY_15 9;
BA_ "GenSigSendType" SG_ 1415 RSDS_L_ObjDistX_15 9;
BA_ "GenSigSendType" SG_ 1415 RSDS_L_ObjObstacleProb_15 9;
BA_ "GenSigSendType" SG_ 1415 RSDS_L_ObjExistProb_15 9;
BA_ "GenSigSendType" SG_ 1415 RSDS_L_ObjID_15 9;
BA_ "GenSigSendType" SG_ 1415 RSDS_L_SGU8_Checksum1 9;
BA_ "IsCrcSignal" SG_ 1415 RSDS_L_SGU8_Checksum1 1;
BA_ "GenSigSendType" SG_ 1416 RSDS_L_SGU9_RollingCounter8 9;
BA_ "IsRcSignal" SG_ 1416 RSDS_L_SGU9_RollingCounter8 1;
BA_ "GenSigSendType" SG_ 1416 RSDS_L_SGU9_BlockCounter 9;
BA_ "GenSigSendType" SG_ 1416 RSDS_L_HWATargetValidity_18 9;
BA_ "GenSigSendType" SG_ 1416 RSDS_L_ObjRefPoint_18 9;
BA_ "GenSigStartValue" SG_ 1416 RSDS_L_ObjRCS_18 400;
BA_ "GenSigSendType" SG_ 1416 RSDS_L_ObjRCS_18 9;
BA_ "GenSigSendType" SG_ 1416 RSDS_L_ObjYawrate_18 9;
BA_ "GenSigSendType" SG_ 1416 RSDS_L_ObjHeading_18 9;
BA_ "GenSigSendType" SG_ 1416 RSDS_L_ObjLength_18 9;
BA_ "GenSigSendType" SG_ 1416 RSDS_L_SGU9_Checksum8 9;
BA_ "IsCrcSignal" SG_ 1416 RSDS_L_SGU9_Checksum8 1;
BA_ "GenSigSendType" SG_ 1416 RSDS_L_SGU9_RollingCounter7 9;
BA_ "IsRcSignal" SG_ 1416 RSDS_L_SGU9_RollingCounter7 1;
BA_ "GenSigSendType" SG_ 1416 RSDS_L_ObjMotionDirection_18 9;
BA_ "GenSigSendType" SG_ 1416 RSDS_L_ObjAge_18 9;
BA_ "GenSigSendType" SG_ 1416 RSDS_L_ObjWidth_18 9;
BA_ "GenSigSendType" SG_ 1416 RSDS_L_ObjRAccelYStd_18 9;
BA_ "GenSigSendType" SG_ 1416 RSDS_L_ObjRAccelXStd_18 9;
BA_ "GenSigSendType" SG_ 1416 RSDS_L_ObjRelVelYStd_18 9;
BA_ "GenSigSendType" SG_ 1416 RSDS_L_ObjRelVelXStd_18 9;
BA_ "GenSigSendType" SG_ 1416 RSDS_L_ObjDistYStd_18 9;
BA_ "GenSigSendType" SG_ 1416 RSDS_L_SGU9_Checksum7 9;
BA_ "IsCrcSignal" SG_ 1416 RSDS_L_SGU9_Checksum7 1;
BA_ "GenSigSendType" SG_ 1416 RSDS_L_SGU9_RollingCounter6 9;
BA_ "IsRcSignal" SG_ 1416 RSDS_L_SGU9_RollingCounter6 1;
BA_ "GenSigSendType" SG_ 1416 RSDS_L_ObjMotionType_18 9;
BA_ "GenSigStartValue" SG_ 1416 RSDS_L_ObjMeasured_18 1;
BA_ "GenSigSendType" SG_ 1416 RSDS_L_ObjMeasured_18 9;
BA_ "GenSigStartValue" SG_ 1416 RSDS_L_ObjRelAccelY_18 512;
BA_ "GenSigSendType" SG_ 1416 RSDS_L_ObjRelAccelY_18 9;
BA_ "GenSigStartValue" SG_ 1416 RSDS_L_ObjRelAccelX_18 512;
BA_ "GenSigSendType" SG_ 1416 RSDS_L_ObjRelAccelX_18 9;
BA_ "GenSigStartValue" SG_ 1416 RSDS_L_ObjRelVelY_18 4102;
BA_ "GenSigSendType" SG_ 1416 RSDS_L_ObjRelVelY_18 9;
BA_ "GenSigStartValue" SG_ 1416 RSDS_L_ObjRelVelX_18 4102;
BA_ "GenSigSendType" SG_ 1416 RSDS_L_ObjRelVelX_18 9;
BA_ "GenSigSendType" SG_ 1416 RSDS_L_SGU9_Checksum6 9;
BA_ "IsCrcSignal" SG_ 1416 RSDS_L_SGU9_Checksum6 1;
BA_ "GenSigSendType" SG_ 1416 RSDS_L_SGU9_RollingCounter5 9;
BA_ "IsRcSignal" SG_ 1416 RSDS_L_SGU9_RollingCounter5 1;
BA_ "GenSigSendType" SG_ 1416 RSDS_L_ObjType_18 9;
BA_ "GenSigSendType" SG_ 1416 RSDS_L_ObjDistXStd_18 9;
BA_ "GenSigStartValue" SG_ 1416 RSDS_L_ObjDistY_18 1024;
BA_ "GenSigSendType" SG_ 1416 RSDS_L_ObjDistY_18 9;
BA_ "GenSigSendType" SG_ 1416 RSDS_L_ObjDistX_18 9;
BA_ "GenSigSendType" SG_ 1416 RSDS_L_ObjObstacleProb_18 9;
BA_ "GenSigSendType" SG_ 1416 RSDS_L_ObjExistProb_18 9;
BA_ "GenSigSendType" SG_ 1416 RSDS_L_ObjID_18 9;
BA_ "GenSigSendType" SG_ 1416 RSDS_L_SGU9_Checksum5 9;
BA_ "IsCrcSignal" SG_ 1416 RSDS_L_SGU9_Checksum5 1;
BA_ "GenSigSendType" SG_ 1416 RSDS_L_SGU9_RollingCounter4 9;
BA_ "IsRcSignal" SG_ 1416 RSDS_L_SGU9_RollingCounter4 1;
BA_ "GenSigSendType" SG_ 1416 RSDS_L_HWATargetValidity_17 9;
BA_ "GenSigSendType" SG_ 1416 RSDS_L_ObjRefPoint_17 9;
BA_ "GenSigStartValue" SG_ 1416 RSDS_L_ObjRCS_17 400;
BA_ "GenSigSendType" SG_ 1416 RSDS_L_ObjRCS_17 9;
BA_ "GenSigSendType" SG_ 1416 RSDS_L_ObjYawrate_17 9;
BA_ "GenSigSendType" SG_ 1416 RSDS_L_ObjHeading_17 9;
BA_ "GenSigSendType" SG_ 1416 RSDS_L_ObjLength_17 9;
BA_ "GenSigSendType" SG_ 1416 RSDS_L_SGU9_Checksum4 9;
BA_ "IsCrcSignal" SG_ 1416 RSDS_L_SGU9_Checksum4 1;
BA_ "GenSigSendType" SG_ 1416 RSDS_L_SGU9_RollingCounter3 9;
BA_ "IsRcSignal" SG_ 1416 RSDS_L_SGU9_RollingCounter3 1;
BA_ "GenSigSendType" SG_ 1416 RSDS_L_ObjMotionDirection_17 9;
BA_ "GenSigSendType" SG_ 1416 RSDS_L_ObjAge_17 9;
BA_ "GenSigSendType" SG_ 1416 RSDS_L_ObjWidth_17 9;
BA_ "GenSigSendType" SG_ 1416 RSDS_L_ObjRAccelYStd_17 9;
BA_ "GenSigSendType" SG_ 1416 RSDS_L_ObjRAccelXStd_17 9;
BA_ "GenSigSendType" SG_ 1416 RSDS_L_ObjRelVelYStd_17 9;
BA_ "GenSigSendType" SG_ 1416 RSDS_L_ObjRelVelXStd_17 9;
BA_ "GenSigSendType" SG_ 1416 RSDS_L_ObjDistYStd_17 9;
BA_ "GenSigSendType" SG_ 1416 RSDS_L_SGU9_Checksum3 9;
BA_ "IsCrcSignal" SG_ 1416 RSDS_L_SGU9_Checksum3 1;
BA_ "GenSigSendType" SG_ 1416 RSDS_L_SGU9_RollingCounter2 9;
BA_ "IsRcSignal" SG_ 1416 RSDS_L_SGU9_RollingCounter2 1;
BA_ "GenSigSendType" SG_ 1416 RSDS_L_ObjMotionType_17 9;
BA_ "GenSigStartValue" SG_ 1416 RSDS_L_ObjMeasured_17 1;
BA_ "GenSigSendType" SG_ 1416 RSDS_L_ObjMeasured_17 9;
BA_ "GenSigStartValue" SG_ 1416 RSDS_L_ObjRelAccelY_17 512;
BA_ "GenSigSendType" SG_ 1416 RSDS_L_ObjRelAccelY_17 9;
BA_ "GenSigStartValue" SG_ 1416 RSDS_L_ObjRelAccelX_17 512;
BA_ "GenSigSendType" SG_ 1416 RSDS_L_ObjRelAccelX_17 9;
BA_ "GenSigStartValue" SG_ 1416 RSDS_L_ObjRelVelY_17 4102;
BA_ "GenSigSendType" SG_ 1416 RSDS_L_ObjRelVelY_17 9;
BA_ "GenSigStartValue" SG_ 1416 RSDS_L_ObjRelVelX_17 4102;
BA_ "GenSigSendType" SG_ 1416 RSDS_L_ObjRelVelX_17 9;
BA_ "GenSigSendType" SG_ 1416 RSDS_L_SGU9_Checksum2 9;
BA_ "IsCrcSignal" SG_ 1416 RSDS_L_SGU9_Checksum2 1;
BA_ "GenSigSendType" SG_ 1416 RSDS_L_SGU9_RollingCounter1 9;
BA_ "IsRcSignal" SG_ 1416 RSDS_L_SGU9_RollingCounter1 1;
BA_ "GenSigSendType" SG_ 1416 RSDS_L_ObjType_17 9;
BA_ "GenSigSendType" SG_ 1416 RSDS_L_ObjDistXStd_17 9;
BA_ "GenSigStartValue" SG_ 1416 RSDS_L_ObjDistY_17 1024;
BA_ "GenSigSendType" SG_ 1416 RSDS_L_ObjDistY_17 9;
BA_ "GenSigSendType" SG_ 1416 RSDS_L_ObjDistX_17 9;
BA_ "GenSigSendType" SG_ 1416 RSDS_L_ObjObstacleProb_17 9;
BA_ "GenSigSendType" SG_ 1416 RSDS_L_ObjExistProb_17 9;
BA_ "GenSigSendType" SG_ 1416 RSDS_L_ObjID_17 9;
BA_ "GenSigSendType" SG_ 1416 RSDS_L_SGU9_Checksum1 9;
BA_ "IsCrcSignal" SG_ 1416 RSDS_L_SGU9_Checksum1 1;
BA_ "GenSigSendType" SG_ 1417 RSDS_L_SGU10_RollingCounter8 9;
BA_ "IsRcSignal" SG_ 1417 RSDS_L_SGU10_RollingCounter8 1;
BA_ "GenSigSendType" SG_ 1417 RSDS_L_SGU10_BlockCounter 9;
BA_ "GenSigSendType" SG_ 1417 RSDS_L_HWATargetValidity_20 9;
BA_ "GenSigSendType" SG_ 1417 RSDS_L_ObjRefPoint_20 9;
BA_ "GenSigStartValue" SG_ 1417 RSDS_L_ObjRCS_20 400;
BA_ "GenSigSendType" SG_ 1417 RSDS_L_ObjRCS_20 9;
BA_ "GenSigSendType" SG_ 1417 RSDS_L_ObjYawrate_20 9;
BA_ "GenSigSendType" SG_ 1417 RSDS_L_ObjHeading_20 9;
BA_ "GenSigSendType" SG_ 1417 RSDS_L_ObjLength_20 9;
BA_ "GenSigSendType" SG_ 1417 RSDS_L_SGU10_Checksum8 9;
BA_ "IsCrcSignal" SG_ 1417 RSDS_L_SGU10_Checksum8 1;
BA_ "GenSigSendType" SG_ 1417 RSDS_L_SGU10_RollingCounter7 9;
BA_ "IsRcSignal" SG_ 1417 RSDS_L_SGU10_RollingCounter7 1;
BA_ "GenSigSendType" SG_ 1417 RSDS_L_ObjMotionDirection_20 9;
BA_ "GenSigSendType" SG_ 1417 RSDS_L_ObjAge_20 9;
BA_ "GenSigSendType" SG_ 1417 RSDS_L_ObjWidth_20 9;
BA_ "GenSigSendType" SG_ 1417 RSDS_L_ObjRAccelYStd_20 9;
BA_ "GenSigSendType" SG_ 1417 RSDS_L_ObjRAccelXStd_20 9;
BA_ "GenSigSendType" SG_ 1417 RSDS_L_ObjRelVelYStd_20 9;
BA_ "GenSigSendType" SG_ 1417 RSDS_L_ObjRelVelXStd_20 9;
BA_ "GenSigSendType" SG_ 1417 RSDS_L_ObjDistYStd_20 9;
BA_ "GenSigSendType" SG_ 1417 RSDS_L_SGU10_Checksum7 9;
BA_ "IsCrcSignal" SG_ 1417 RSDS_L_SGU10_Checksum7 1;
BA_ "GenSigSendType" SG_ 1417 RSDS_L_SGU10_RollingCounter6 9;
BA_ "IsRcSignal" SG_ 1417 RSDS_L_SGU10_RollingCounter6 1;
BA_ "GenSigSendType" SG_ 1417 RSDS_L_ObjMotionType_20 9;
BA_ "GenSigStartValue" SG_ 1417 RSDS_L_ObjMeasured_20 1;
BA_ "GenSigSendType" SG_ 1417 RSDS_L_ObjMeasured_20 9;
BA_ "GenSigStartValue" SG_ 1417 RSDS_L_ObjRelAccelY_20 512;
BA_ "GenSigSendType" SG_ 1417 RSDS_L_ObjRelAccelY_20 9;
BA_ "GenSigStartValue" SG_ 1417 RSDS_L_ObjRelAccelX_20 512;
BA_ "GenSigSendType" SG_ 1417 RSDS_L_ObjRelAccelX_20 9;
BA_ "GenSigStartValue" SG_ 1417 RSDS_L_ObjRelVelY_20 4102;
BA_ "GenSigSendType" SG_ 1417 RSDS_L_ObjRelVelY_20 9;
BA_ "GenSigStartValue" SG_ 1417 RSDS_L_ObjRelVelX_20 4102;
BA_ "GenSigSendType" SG_ 1417 RSDS_L_ObjRelVelX_20 9;
BA_ "GenSigSendType" SG_ 1417 RSDS_L_SGU10_Checksum6 9;
BA_ "IsCrcSignal" SG_ 1417 RSDS_L_SGU10_Checksum6 1;
BA_ "GenSigSendType" SG_ 1417 RSDS_L_SGU10_RollingCounter5 9;
BA_ "IsRcSignal" SG_ 1417 RSDS_L_SGU10_RollingCounter5 1;
BA_ "GenSigSendType" SG_ 1417 RSDS_L_ObjType_20 9;
BA_ "GenSigSendType" SG_ 1417 RSDS_L_ObjDistXStd_20 9;
BA_ "GenSigStartValue" SG_ 1417 RSDS_L_ObjDistY_20 1024;
BA_ "GenSigSendType" SG_ 1417 RSDS_L_ObjDistY_20 9;
BA_ "GenSigSendType" SG_ 1417 RSDS_L_ObjDistX_20 9;
BA_ "GenSigSendType" SG_ 1417 RSDS_L_ObjObstacleProb_20 9;
BA_ "GenSigSendType" SG_ 1417 RSDS_L_ObjExistProb_20 9;
BA_ "GenSigSendType" SG_ 1417 RSDS_L_ObjID_20 9;
BA_ "GenSigSendType" SG_ 1417 RSDS_L_SGU10_Checksum5 9;
BA_ "IsCrcSignal" SG_ 1417 RSDS_L_SGU10_Checksum5 1;
BA_ "GenSigSendType" SG_ 1417 RSDS_L_SGU10_RollingCounter4 9;
BA_ "IsRcSignal" SG_ 1417 RSDS_L_SGU10_RollingCounter4 1;
BA_ "GenSigSendType" SG_ 1417 RSDS_L_HWATargetValidity_19 9;
BA_ "GenSigSendType" SG_ 1417 RSDS_L_ObjRefPoint_19 9;
BA_ "GenSigStartValue" SG_ 1417 RSDS_L_ObjRCS_19 400;
BA_ "GenSigSendType" SG_ 1417 RSDS_L_ObjRCS_19 9;
BA_ "GenSigSendType" SG_ 1417 RSDS_L_ObjYawrate_19 9;
BA_ "GenSigSendType" SG_ 1417 RSDS_L_ObjHeading_19 9;
BA_ "GenSigSendType" SG_ 1417 RSDS_L_ObjLength_19 9;
BA_ "GenSigSendType" SG_ 1417 RSDS_L_SGU10_Checksum4 9;
BA_ "IsCrcSignal" SG_ 1417 RSDS_L_SGU10_Checksum4 1;
BA_ "GenSigSendType" SG_ 1417 RSDS_L_SGU10_RollingCounter3 9;
BA_ "IsRcSignal" SG_ 1417 RSDS_L_SGU10_RollingCounter3 1;
BA_ "GenSigSendType" SG_ 1417 RSDS_L_ObjMotionDirection_19 9;
BA_ "GenSigSendType" SG_ 1417 RSDS_L_ObjAge_19 9;
BA_ "GenSigSendType" SG_ 1417 RSDS_L_ObjWidth_19 9;
BA_ "GenSigSendType" SG_ 1417 RSDS_L_ObjRAccelYStd_19 9;
BA_ "GenSigSendType" SG_ 1417 RSDS_L_ObjRAccelXStd_19 9;
BA_ "GenSigSendType" SG_ 1417 RSDS_L_ObjRelVelYStd_19 9;
BA_ "GenSigSendType" SG_ 1417 RSDS_L_ObjRelVelXStd_19 9;
BA_ "GenSigSendType" SG_ 1417 RSDS_L_ObjDistYStd_19 9;
BA_ "GenSigSendType" SG_ 1417 RSDS_L_SGU10_Checksum3 9;
BA_ "IsCrcSignal" SG_ 1417 RSDS_L_SGU10_Checksum3 1;
BA_ "GenSigSendType" SG_ 1417 RSDS_L_SGU10_RollingCounter2 9;
BA_ "IsRcSignal" SG_ 1417 RSDS_L_SGU10_RollingCounter2 1;
BA_ "GenSigSendType" SG_ 1417 RSDS_L_ObjMotionType_19 9;
BA_ "GenSigStartValue" SG_ 1417 RSDS_L_ObjMeasured_19 1;
BA_ "GenSigSendType" SG_ 1417 RSDS_L_ObjMeasured_19 9;
BA_ "GenSigStartValue" SG_ 1417 RSDS_L_ObjRelAccelY_19 512;
BA_ "GenSigSendType" SG_ 1417 RSDS_L_ObjRelAccelY_19 9;
BA_ "GenSigStartValue" SG_ 1417 RSDS_L_ObjRelAccelX_19 512;
BA_ "GenSigSendType" SG_ 1417 RSDS_L_ObjRelAccelX_19 9;
BA_ "GenSigStartValue" SG_ 1417 RSDS_L_ObjRelVelY_19 4102;
BA_ "GenSigSendType" SG_ 1417 RSDS_L_ObjRelVelY_19 9;
BA_ "GenSigStartValue" SG_ 1417 RSDS_L_ObjRelVelX_19 4102;
BA_ "GenSigSendType" SG_ 1417 RSDS_L_ObjRelVelX_19 9;
BA_ "GenSigSendType" SG_ 1417 RSDS_L_SGU10_Checksum2 9;
BA_ "IsCrcSignal" SG_ 1417 RSDS_L_SGU10_Checksum2 1;
BA_ "GenSigSendType" SG_ 1417 RSDS_L_SGU10_RollingCounter1 9;
BA_ "IsRcSignal" SG_ 1417 RSDS_L_SGU10_RollingCounter1 1;
BA_ "GenSigSendType" SG_ 1417 RSDS_L_ObjType_19 9;
BA_ "GenSigSendType" SG_ 1417 RSDS_L_ObjDistXStd_19 9;
BA_ "GenSigStartValue" SG_ 1417 RSDS_L_ObjDistY_19 1024;
BA_ "GenSigSendType" SG_ 1417 RSDS_L_ObjDistY_19 9;
BA_ "GenSigSendType" SG_ 1417 RSDS_L_ObjDistX_19 9;
BA_ "GenSigSendType" SG_ 1417 RSDS_L_ObjObstacleProb_19 9;
BA_ "GenSigSendType" SG_ 1417 RSDS_L_ObjExistProb_19 9;
BA_ "GenSigSendType" SG_ 1417 RSDS_L_ObjID_19 9;
BA_ "GenSigSendType" SG_ 1417 RSDS_L_SGU10_Checksum1 9;
BA_ "IsCrcSignal" SG_ 1417 RSDS_L_SGU10_Checksum1 1;
VAL_ 1136 Sync_SyncTime 0 "Valid_value" ;
VAL_ 1136 Sync_OVS 0 "Valid_value" ;
VAL_ 1136 Sync_SGW 0 "Valid_value" ;
VAL_ 1136 Sync_Resd 0 "Valid_value" ;
VAL_ 1136 Sync_Counter 0 "Valid_value" ;
VAL_ 1136 Sync_TimeDomain 0 "Valid_value" ;
VAL_ 1136 Sync_CRC 0 "Valid_value" ;
VAL_ 1136 Sync_Type 0 "Valid_value" ;
VAL_ 1408 RSDS_L_SGU1_RollingCounter8 0 "Valid_value" 15 "Invalid_value" ;
VAL_ 1408 RSDS_L_SGU1_BlockCounter 0 "Valid_value" ;
VAL_ 1408 RSDS_L_HWATargetValidity_2 0 "NOT_HWA_Target" 1 "HWA_Target" ;
VAL_ 1408 RSDS_L_ObjRefPoint_2 0 "Rear" 1 "Rear_left" 2 "Left" 3 "Front_left" 4 "Front" 5 "Front_Right" 6 "Right" 7 "Rear_right" ;
VAL_ 1408 RSDS_L_ObjRCS_2 0 "Valid_values" ;
VAL_ 1408 RSDS_L_ObjYawrate_2 0 "Valid_values" 4446 "Reserved" ;
VAL_ 1408 RSDS_L_ObjHeading_2 0 "Valid_values" 4446 "Reserved" ;
VAL_ 1408 RSDS_L_ObjLength_2 0 "Valid_values" 401 "Reserved" ;
VAL_ 1408 RSDS_L_SGU1_Checksum8 0 "Valid_value" ;
VAL_ 1408 RSDS_L_SGU1_RollingCounter7 0 "Valid_value" 15 "Invalid_value" ;
VAL_ 1408 RSDS_L_ObjMotionDirection_2 0 "Init" 1 "Inverse_direction" 2 "Same__direction" 3 "cross" 4 "reserved" 5 "reserved" 6 "reserved" 7 "reserved" ;
VAL_ 1408 RSDS_L_ObjAge_2 0 "Valid_values" ;
VAL_ 1408 RSDS_L_ObjWidth_2 0 "Valid_values" 501 "Reserved" ;
VAL_ 1408 RSDS_L_ObjRAccelYStd_2 0 "Valid_values" ;
VAL_ 1408 RSDS_L_ObjRAccelXStd_2 0 "Valid_values" ;
VAL_ 1408 RSDS_L_ObjRelVelYStd_2 0 "Valid_values" ;
VAL_ 1408 RSDS_L_ObjRelVelXStd_2 0 "Valid_values" ;
VAL_ 1408 RSDS_L_ObjDistYStd_2 0 "Valid_values" ;
VAL_ 1408 RSDS_L_SGU1_Checksum7 0 "Valid_value" ;
VAL_ 1408 RSDS_L_SGU1_RollingCounter6 0 "Valid_value" 15 "Invalid_value" ;
VAL_ 1408 RSDS_L_ObjMotionType_2 0 "int" 1 "unknown" 2 "Drive" 3 "Stopped" 4 "Stand" 5 "reserved" 6 "reserved" 7 "reserved" ;
VAL_ 1408 RSDS_L_ObjMeasured_2 0 "Init" 1 "Measured" 2 "Predicted" 3 "Reserved" ;
VAL_ 1408 RSDS_L_ObjRelAccelY_2 0 "Valid_values" ;
VAL_ 1408 RSDS_L_ObjRelAccelX_2 0 "Valid_values" ;
VAL_ 1408 RSDS_L_ObjRelVelY_2 0 "Valid_values" 8174 "Reserved" ;
VAL_ 1408 RSDS_L_ObjRelVelX_2 0 "Valid_values" 8174 "Reserved" ;
VAL_ 1408 RSDS_L_SGU1_Checksum6 0 "Valid_value" ;
VAL_ 1408 RSDS_L_SGU1_RollingCounter5 0 "Valid_value" 15 "Invalid_value" ;
VAL_ 1408 RSDS_L_ObjType_2 0 "Unknown" 1 "Truck" 2 "Car" 3 "Pedestrian" 4 "Cyclist" 5 "Reserved" ;
VAL_ 1408 RSDS_L_ObjDistXStd_2 0 "Valid_values" ;
VAL_ 1408 RSDS_L_ObjDistY_2 0 "Valid_values" ;
VAL_ 1408 RSDS_L_ObjDistX_2 0 "Valid_values" 4080 "Reserved" ;
VAL_ 1408 RSDS_L_ObjObstacleProb_2 0 "Valid_values" ;
VAL_ 1408 RSDS_L_ObjExistProb_2 0 "Valid_values" ;
VAL_ 1408 RSDS_L_ObjID_2 0 "Valid_values" ;
VAL_ 1408 RSDS_L_SGU1_Checksum5 0 "Valid_value" ;
VAL_ 1408 RSDS_L_SGU1_RollingCounter4 0 "Valid_value" 15 "Invalid_value" ;
VAL_ 1408 RSDS_L_HWATargetValidity_1 0 "NOT_HWA_Target" 1 "HWA_Target" ;
VAL_ 1408 RSDS_L_ObjRefPoint_1 0 "Rear" 1 "Rear_left" 2 "Left" 3 "Front_left" 4 "Front" 5 "Front_Right" 6 "Right" 7 "Rear_right" ;
VAL_ 1408 RSDS_L_ObjRCS_1 0 "Valid_values" ;
VAL_ 1408 RSDS_L_ObjYawrate_1 0 "Valid_values" 4446 "Reserved" ;
VAL_ 1408 RSDS_L_ObjHeading_1 0 "Valid_values" 4446 "Reserved" ;
VAL_ 1408 RSDS_L_ObjLength_1 0 "Valid_values" 401 "Reserved" ;
VAL_ 1408 RSDS_L_SGU1_Checksum4 0 "Valid_value" ;
VAL_ 1408 RSDS_L_SGU1_RollingCounter3 0 "Valid_value" 15 "Invalid_value" ;
VAL_ 1408 RSDS_L_ObjMotionDirection_1 0 "Init" 1 "Inverse_direction" 2 "Same__direction" 3 "cross" 4 "reserved" 5 "reserved" 6 "reserved" 7 "reserved" ;
VAL_ 1408 RSDS_L_ObjAge_1 0 "Valid_values" ;
VAL_ 1408 RSDS_L_ObjWidth_1 0 "Valid_values" 501 "Reserved" ;
VAL_ 1408 RSDS_L_ObjRAccelYStd_1 0 "Valid_values" ;
VAL_ 1408 RSDS_L_ObjRAccelXStd_1 0 "Valid_values" ;
VAL_ 1408 RSDS_L_ObjRelVelYStd_1 0 "Valid_values" ;
VAL_ 1408 RSDS_L_ObjRelVelXStd_1 0 "Valid_values" ;
VAL_ 1408 RSDS_L_ObjDistYStd_1 0 "Valid_values" ;
VAL_ 1408 RSDS_L_SGU1_Checksum3 0 "Valid_value" ;
VAL_ 1408 RSDS_L_SGU1_RollingCounter2 0 "Valid_value" 15 "Invalid_value" ;
VAL_ 1408 RSDS_L_ObjMotionType_1 0 "int" 1 "unknown" 2 "Drive" 3 "Stopped" 4 "Stand" 5 "reserved" 6 "reserved" 7 "reserved" ;
VAL_ 1408 RSDS_L_ObjMeasured_1 0 "Init" 1 "Measured" 2 "Predicted" 3 "Reserved" ;
VAL_ 1408 RSDS_L_ObjRelAccelY_1 0 "Valid_values" ;
VAL_ 1408 RSDS_L_ObjRelAccelX_1 0 "Valid_values" ;
VAL_ 1408 RSDS_L_ObjRelVelY_1 0 "Valid_values" 8174 "Reserved" ;
VAL_ 1408 RSDS_L_ObjRelVelX_1 0 "Valid_values" 8174 "Reserved" ;
VAL_ 1408 RSDS_L_SGU1_Checksum2 0 "Valid_value" ;
VAL_ 1408 RSDS_L_SGU1_RollingCounter1 0 "Valid_value" 15 "Invalid_value" ;
VAL_ 1408 RSDS_L_ObjType_1 0 "Unknown" 1 "Truck" 2 "Car" 3 "Pedestrian" 4 "Cyclist" 5 "Reserved" ;
VAL_ 1408 RSDS_L_ObjDistXStd_1 0 "Valid_values" ;
VAL_ 1408 RSDS_L_ObjDistY_1 0 "Valid_values" ;
VAL_ 1408 RSDS_L_ObjDistX_1 0 "Valid_values" 4080 "Reserved" ;
VAL_ 1408 RSDS_L_ObjObstacleProb_1 0 "Valid_values" ;
VAL_ 1408 RSDS_L_ObjExistProb_1 0 "Valid_values" ;
VAL_ 1408 RSDS_L_ObjID_1 0 "Valid_values" ;
VAL_ 1408 RSDS_L_SGU1_Checksum1 0 "Valid_value" ;
VAL_ 1409 RSDS_L_SGU2_RollingCounter8 0 "Valid_value" 15 "Invalid_value" ;
VAL_ 1409 RSDS_L_SGU2_BlockCounter 0 "Valid_value" ;
VAL_ 1409 RSDS_L_HWATargetValidity_4 0 "NOT_HWA_Target" 1 "HWA_Target" ;
VAL_ 1409 RSDS_L_ObjRefPoint_4 0 "Rear" 1 "Rear_left" 2 "Left" 3 "Front_left" 4 "Front" 5 "Front_Right" 6 "Right" 7 "Rear_right" ;
VAL_ 1409 RSDS_L_ObjRCS_4 0 "Valid_values" ;
VAL_ 1409 RSDS_L_ObjYawrate_4 0 "Valid_values" 4446 "Reserved" ;
VAL_ 1409 RSDS_L_ObjHeading_4 0 "Valid_values" 4446 "Reserved" ;
VAL_ 1409 RSDS_L_ObjLength_4 0 "Valid_values" 401 "Reserved" ;
VAL_ 1409 RSDS_L_SGU2_Checksum8 0 "Valid_value" ;
VAL_ 1409 RSDS_L_SGU2_RollingCounter7 0 "Valid_value" 15 "Invalid_value" ;
VAL_ 1409 RSDS_L_ObjMotionDirection_4 0 "Init" 1 "Inverse_direction" 2 "Same__direction" 3 "cross" 4 "reserved" 5 "reserved" 6 "reserved" 7 "reserved" ;
VAL_ 1409 RSDS_L_ObjAge_4 0 "Valid_values" ;
VAL_ 1409 RSDS_L_ObjWidth_4 0 "Valid_values" 501 "Reserved" ;
VAL_ 1409 RSDS_L_ObjRAccelYStd_4 0 "Valid_values" ;
VAL_ 1409 RSDS_L_ObjRAccelXStd_4 0 "Valid_values" ;
VAL_ 1409 RSDS_L_ObjRelVelYStd_4 0 "Valid_values" ;
VAL_ 1409 RSDS_L_ObjRelVelXStd_4 0 "Valid_values" ;
VAL_ 1409 RSDS_L_ObjDistYStd_4 0 "Valid_values" ;
VAL_ 1409 RSDS_L_SGU2_Checksum7 0 "Valid_value" ;
VAL_ 1409 RSDS_L_SGU2_RollingCounter6 0 "Valid_value" 15 "Invalid_value" ;
VAL_ 1409 RSDS_L_ObjMotionType_4 0 "int" 1 "unknown" 2 "Drive" 3 "Stopped" 4 "Stand" 5 "reserved" 6 "reserved" 7 "reserved" ;
VAL_ 1409 RSDS_L_ObjMeasured_4 0 "Init" 1 "Measured" 2 "Predicted" 3 "Reserved" ;
VAL_ 1409 RSDS_L_ObjRelAccelY_4 0 "Valid_values" ;
VAL_ 1409 RSDS_L_ObjRelAccelX_4 0 "Valid_values" ;
VAL_ 1409 RSDS_L_ObjRelVelY_4 0 "Valid_values" 8174 "Reserved" ;
VAL_ 1409 RSDS_L_ObjRelVelX_4 0 "Valid_values" 8174 "Reserved" ;
VAL_ 1409 RSDS_L_SGU2_Checksum6 0 "Valid_value" ;
VAL_ 1409 RSDS_L_SGU2_RollingCounter5 0 "Valid_value" 15 "Invalid_value" ;
VAL_ 1409 RSDS_L_ObjType_4 0 "Unknown" 1 "Truck" 2 "Car" 3 "Pedestrian" 4 "Cyclist" 5 "Reserved" ;
VAL_ 1409 RSDS_L_ObjDistXStd_4 0 "Valid_values" ;
VAL_ 1409 RSDS_L_ObjDistY_4 0 "Valid_values" ;
VAL_ 1409 RSDS_L_ObjDistX_4 0 "Valid_values" 4080 "Reserved" ;
VAL_ 1409 RSDS_L_ObjObstacleProb_4 0 "Valid_values" ;
VAL_ 1409 RSDS_L_ObjExistProb_4 0 "Valid_values" ;
VAL_ 1409 RSDS_L_ObjID_4 0 "Valid_values" ;
VAL_ 1409 RSDS_L_SGU2_Checksum5 0 "Valid_value" ;
VAL_ 1409 RSDS_L_SGU2_RollingCounter4 0 "Valid_value" 15 "Invalid_value" ;
VAL_ 1409 RSDS_L_HWATargetValidity_3 0 "NOT_HWA_Target" 1 "HWA_Target" ;
VAL_ 1409 RSDS_L_ObjRefPoint_3 0 "Rear" 1 "Rear_left" 2 "Left" 3 "Front_left" 4 "Front" 5 "Front_Right" 6 "Right" 7 "Rear_right" ;
VAL_ 1409 RSDS_L_ObjRCS_3 0 "Valid_values" ;
VAL_ 1409 RSDS_L_ObjYawrate_3 0 "Valid_values" 4446 "Reserved" ;
VAL_ 1409 RSDS_L_ObjHeading_3 0 "Valid_values" 4446 "Reserved" ;
VAL_ 1409 RSDS_L_ObjLength_3 0 "Valid_values" 401 "Reserved" ;
VAL_ 1409 RSDS_L_SGU2_Checksum4 0 "Valid_value" ;
VAL_ 1409 RSDS_L_SGU2_RollingCounter3 0 "Valid_value" 15 "Invalid_value" ;
VAL_ 1409 RSDS_L_ObjMotionDirection_3 0 "Init" 1 "Inverse_direction" 2 "Same__direction" 3 "cross" 4 "reserved" 5 "reserved" 6 "reserved" 7 "reserved" ;
VAL_ 1409 RSDS_L_ObjAge_3 0 "Valid_values" ;
VAL_ 1409 RSDS_L_ObjWidth_3 0 "Valid_values" 501 "Reserved" ;
VAL_ 1409 RSDS_L_ObjRAccelYStd_3 0 "Valid_values" ;
VAL_ 1409 RSDS_L_ObjRAccelXStd_3 0 "Valid_values" ;
VAL_ 1409 RSDS_L_ObjRelVelYStd_3 0 "Valid_values" ;
VAL_ 1409 RSDS_L_ObjRelVelXStd_3 0 "Valid_values" ;
VAL_ 1409 RSDS_L_ObjDistYStd_3 0 "Valid_values" ;
VAL_ 1409 RSDS_L_SGU2_Checksum3 0 "Valid_value" ;
VAL_ 1409 RSDS_L_SGU2_RollingCounter2 0 "Valid_value" 15 "Invalid_value" ;
VAL_ 1409 RSDS_L_ObjMotionType_3 0 "int" 1 "unknown" 2 "Drive" 3 "Stopped" 4 "Stand" 5 "reserved" 6 "reserved" 7 "reserved" ;
VAL_ 1409 RSDS_L_ObjMeasured_3 0 "Init" 1 "Measured" 2 "Predicted" 3 "Reserved" ;
VAL_ 1409 RSDS_L_ObjRelAccelY_3 0 "Valid_values" ;
VAL_ 1409 RSDS_L_ObjRelAccelX_3 0 "Valid_values" ;
VAL_ 1409 RSDS_L_ObjRelVelY_3 0 "Valid_values" 8174 "Reserved" ;
VAL_ 1409 RSDS_L_ObjRelVelX_3 0 "Valid_values" 8174 "Reserved" ;
VAL_ 1409 RSDS_L_SGU2_Checksum2 0 "Valid_value" ;
VAL_ 1409 RSDS_L_SGU2_RollingCounter1 0 "Valid_value" 15 "Invalid_value" ;
VAL_ 1409 RSDS_L_ObjType_3 0 "Unknown" 1 "Truck" 2 "Car" 3 "Pedestrian" 4 "Cyclist" 5 "Reserved" ;
VAL_ 1409 RSDS_L_ObjDistXStd_3 0 "Valid_values" ;
VAL_ 1409 RSDS_L_ObjDistY_3 0 "Valid_values" ;
VAL_ 1409 RSDS_L_ObjDistX_3 0 "Valid_values" 4080 "Reserved" ;
VAL_ 1409 RSDS_L_ObjObstacleProb_3 0 "Valid_values" ;
VAL_ 1409 RSDS_L_ObjExistProb_3 0 "Valid_values" ;
VAL_ 1409 RSDS_L_ObjID_3 0 "Valid_values" ;
VAL_ 1409 RSDS_L_SGU2_Checksum1 0 "Valid_value" ;
VAL_ 1410 RSDS_L_SGU3_RollingCounter8 0 "Valid_value" 15 "Invalid_value" ;
VAL_ 1410 RSDS_L_SGU3_BlockCounter 0 "Valid_value" ;
VAL_ 1410 RSDS_L_HWATargetValidity_6 0 "NOT_HWA_Target" 1 "HWA_Target" ;
VAL_ 1410 RSDS_L_ObjRefPoint_6 0 "Rear" 1 "Rear_left" 2 "Left" 3 "Front_left" 4 "Front" 5 "Front_Right" 6 "Right" 7 "Rear_right" ;
VAL_ 1410 RSDS_L_ObjRCS_6 0 "Valid_values" ;
VAL_ 1410 RSDS_L_ObjYawrate_6 0 "Valid_values" 4446 "Reserved" ;
VAL_ 1410 RSDS_L_ObjHeading_6 0 "Valid_values" 4446 "Reserved" ;
VAL_ 1410 RSDS_L_ObjLength_6 0 "Valid_values" 401 "Reserved" ;
VAL_ 1410 RSDS_L_SGU3_Checksum8 0 "Valid_value" ;
VAL_ 1410 RSDS_L_SGU3_RollingCounter7 0 "Valid_value" 15 "Invalid_value" ;
VAL_ 1410 RSDS_L_ObjMotionDirection_6 0 "Init" 1 "Inverse_direction" 2 "Same__direction" 3 "cross" 4 "reserved" 5 "reserved" 6 "reserved" 7 "reserved" ;
VAL_ 1410 RSDS_L_ObjAge_6 0 "Valid_values" ;
VAL_ 1410 RSDS_L_ObjWidth_6 0 "Valid_values" 501 "Reserved" ;
VAL_ 1410 RSDS_L_ObjRAccelYStd_6 0 "Valid_values" ;
VAL_ 1410 RSDS_L_ObjRAccelXStd_6 0 "Valid_values" ;
VAL_ 1410 RSDS_L_ObjRelVelYStd_6 0 "Valid_values" ;
VAL_ 1410 RSDS_L_ObjRelVelXStd_6 0 "Valid_values" ;
VAL_ 1410 RSDS_L_ObjDistYStd_6 0 "Valid_values" ;
VAL_ 1410 RSDS_L_SGU3_Checksum7 0 "Valid_value" ;
VAL_ 1410 RSDS_L_SGU3_RollingCounter6 0 "Valid_value" 15 "Invalid_value" ;
VAL_ 1410 RSDS_L_ObjMotionType_6 0 "int" 1 "unknown" 2 "Drive" 3 "Stopped" 4 "Stand" 5 "reserved" 6 "reserved" 7 "reserved" ;
VAL_ 1410 RSDS_L_ObjMeasured_6 0 "Init" 1 "Measured" 2 "Predicted" 3 "Reserved" ;
VAL_ 1410 RSDS_L_ObjRelAccelY_6 0 "Valid_values" ;
VAL_ 1410 RSDS_L_ObjRelAccelX_6 0 "Valid_values" ;
VAL_ 1410 RSDS_L_ObjRelVelY_6 0 "Valid_values" 8174 "Reserved" ;
VAL_ 1410 RSDS_L_ObjRelVelX_6 0 "Valid_values" 8174 "Reserved" ;
VAL_ 1410 RSDS_L_SGU3_Checksum6 0 "Valid_value" ;
VAL_ 1410 RSDS_L_SGU3_RollingCounter5 0 "Valid_value" 15 "Invalid_value" ;
VAL_ 1410 RSDS_L_ObjType_6 0 "Unknown" 1 "Truck" 2 "Car" 3 "Pedestrian" 4 "Cyclist" 5 "Reserved" ;
VAL_ 1410 RSDS_L_ObjDistXStd_6 0 "Valid_values" ;
VAL_ 1410 RSDS_L_ObjDistY_6 0 "Valid_values" ;
VAL_ 1410 RSDS_L_ObjDistX_6 0 "Valid_values" 4080 "Reserved" ;
VAL_ 1410 RSDS_L_ObjObstacleProb_6 0 "Valid_values" ;
VAL_ 1410 RSDS_L_ObjExistProb_6 0 "Valid_values" ;
VAL_ 1410 RSDS_L_ObjID_6 0 "Valid_values" ;
VAL_ 1410 RSDS_L_SGU3_Checksum5 0 "Valid_value" ;
VAL_ 1410 RSDS_L_SGU3_RollingCounter4 0 "Valid_value" 15 "Invalid_value" ;
VAL_ 1410 RSDS_L_HWATargetValidity_5 0 "NOT_HWA_Target" 1 "HWA_Target" ;
VAL_ 1410 RSDS_L_ObjRefPoint_5 0 "Rear" 1 "Rear_left" 2 "Left" 3 "Front_left" 4 "Front" 5 "Front_Right" 6 "Right" 7 "Rear_right" ;
VAL_ 1410 RSDS_L_ObjRCS_5 0 "Valid_values" ;
VAL_ 1410 RSDS_L_ObjYawrate_5 0 "Valid_values" 4446 "Reserved" ;
VAL_ 1410 RSDS_L_ObjHeading_5 0 "Valid_values" 4446 "Reserved" ;
VAL_ 1410 RSDS_L_ObjLength_5 0 "Valid_values" 401 "Reserved" ;
VAL_ 1410 RSDS_L_SGU3_Checksum4 0 "Valid_value" ;
VAL_ 1410 RSDS_L_SGU3_RollingCounter3 0 "Valid_value" 15 "Invalid_value" ;
VAL_ 1410 RSDS_L_ObjMotionDirection_5 0 "Init" 1 "Inverse_direction" 2 "Same_direction" 3 "cross" 4 "reserved" 5 "reserved" 6 "reserved" 7 "reserved" ;
VAL_ 1410 RSDS_L_ObjAge_5 0 "Valid_values" ;
VAL_ 1410 RSDS_L_ObjWidth_5 0 "Valid_values" 501 "Reserved" ;
VAL_ 1410 RSDS_L_ObjRAccelYStd_5 0 "Valid_values" ;
VAL_ 1410 RSDS_L_ObjRAccelXStd_5 0 "Valid_values" ;
VAL_ 1410 RSDS_L_ObjRelVelYStd_5 0 "Valid_values" ;
VAL_ 1410 RSDS_L_ObjRelVelXStd_5 0 "Valid_values" ;
VAL_ 1410 RSDS_L_ObjDistYStd_5 0 "Valid_values" ;
VAL_ 1410 RSDS_L_SGU3_Checksum3 0 "Valid_value" ;
VAL_ 1410 RSDS_L_SGU3_RollingCounter2 0 "Valid_value" 15 "Invalid_value" ;
VAL_ 1410 RSDS_L_ObjMotionType_5 0 "int" 1 "unknown" 2 "Drive" 3 "Stopped" 4 "Stand" 5 "reserved" 6 "reserved" 7 "reserved" ;
VAL_ 1410 RSDS_L_ObjMeasured_5 0 "Init" 1 "Measured" 2 "Predicted" 3 "Reserved" ;
VAL_ 1410 RSDS_L_ObjRelAccelY_5 0 "Valid_values" ;
VAL_ 1410 RSDS_L_ObjRelAccelX_5 0 "Valid_values" ;
VAL_ 1410 RSDS_L_ObjRelVelY_5 0 "Valid_values" 8174 "Reserved" ;
VAL_ 1410 RSDS_L_ObjRelVelX_5 0 "Valid_values" 8174 "Reserved" ;
VAL_ 1410 RSDS_L_SGU3_Checksum2 0 "Valid_value" ;
VAL_ 1410 RSDS_L_SGU3_RollingCounter1 0 "Valid_value" 15 "Invalid_value" ;
VAL_ 1410 RSDS_L_ObjType_5 0 "Unknown" 1 "Truck" 2 "Car" 3 "Pedestrian" 4 "Cyclist" 5 "Reserved" ;
VAL_ 1410 RSDS_L_ObjDistXStd_5 0 "Valid_values" ;
VAL_ 1410 RSDS_L_ObjDistY_5 0 "Valid_values" ;
VAL_ 1410 RSDS_L_ObjDistX_5 0 "Valid_values" 4080 "Reserved" ;
VAL_ 1410 RSDS_L_ObjObstacleProb_5 0 "Valid_values" ;
VAL_ 1410 RSDS_L_ObjExistProb_5 0 "Valid_values" ;
VAL_ 1410 RSDS_L_ObjID_5 0 "Valid_values" ;
VAL_ 1410 RSDS_L_SGU3_Checksum1 0 "Valid_value" ;
VAL_ 1411 RSDS_L_SGU4_RollingCounter8 0 "Valid_value" 15 "Invalid_value" ;
VAL_ 1411 RSDS_L_SGU4_BlockCounter 0 "Valid_value" ;
VAL_ 1411 RSDS_L_HWATargetValidity_8 0 "NOT_HWA_Target" 1 "HWA_Target" ;
VAL_ 1411 RSDS_L_ObjRefPoint_8 0 "Rear" 1 "Rear_left" 2 "Left" 3 "Front_left" 4 "Front" 5 "Front_Right" 6 "Right" 7 "Rear_right" ;
VAL_ 1411 RSDS_L_ObjRCS_8 0 "Valid_values" ;
VAL_ 1411 RSDS_L_ObjYawrate_8 0 "Valid_values" 4446 "Reserved" ;
VAL_ 1411 RSDS_L_ObjHeading_8 0 "Valid_values" 4446 "Reserved" ;
VAL_ 1411 RSDS_L_ObjLength_8 0 "Valid_values" 401 "Reserved" ;
VAL_ 1411 RSDS_L_SGU4_Checksum8 0 "Valid_value" ;
VAL_ 1411 RSDS_L_SGU4_RollingCounter7 0 "Valid_value" 15 "Invalid_value" ;
VAL_ 1411 RSDS_L_ObjMotionDirection_8 0 "Init" 1 "Inverse_direction" 2 "Same__direction" 3 "cross" 4 "reserved" 5 "reserved" 6 "reserved" 7 "reserved" ;
VAL_ 1411 RSDS_L_ObjAge_8 0 "Valid_values" ;
VAL_ 1411 RSDS_L_ObjWidth_8 0 "Valid_values" 501 "Reserved" ;
VAL_ 1411 RSDS_L_ObjRAccelYStd_8 0 "Valid_values" ;
VAL_ 1411 RSDS_L_ObjRAccelXStd_8 0 "Valid_values" ;
VAL_ 1411 RSDS_L_ObjRelVelYStd_8 0 "Valid_values" ;
VAL_ 1411 RSDS_L_ObjRelVelXStd_8 0 "Valid_values" ;
VAL_ 1411 RSDS_L_ObjDistYStd_8 0 "Valid_values" ;
VAL_ 1411 RSDS_L_SGU4_Checksum7 0 "Valid_value" ;
VAL_ 1411 RSDS_L_SGU4_RollingCounter6 0 "Valid_value" 15 "Invalid_value" ;
VAL_ 1411 RSDS_L_ObjMotionType_8 0 "int" 1 "unknown" 2 "Drive" 3 "Stopped" 4 "Stand" 5 "reserved" 6 "reserved" 7 "reserved" ;
VAL_ 1411 RSDS_L_ObjMeasured_8 0 "Init" 1 "Measured" 2 "Predicted" 3 "Reserved" ;
VAL_ 1411 RSDS_L_ObjRelAccelY_8 0 "Valid_values" ;
VAL_ 1411 RSDS_L_ObjRelAccelX_8 0 "Valid_values" ;
VAL_ 1411 RSDS_L_ObjRelVelY_8 0 "Valid_values" 8174 "Reserved" ;
VAL_ 1411 RSDS_L_ObjRelVelX_8 0 "Valid_values" 8174 "Reserved" ;
VAL_ 1411 RSDS_L_SGU4_Checksum6 0 "Valid_value" ;
VAL_ 1411 RSDS_L_SGU4_RollingCounter5 0 "Valid_value" 15 "Invalid_value" ;
VAL_ 1411 RSDS_L_ObjType_8 0 "Unknown" 1 "Truck" 2 "Car" 3 "Pedestrian" 4 "Cyclist" 5 "Reserved" ;
VAL_ 1411 RSDS_L_ObjDistXStd_8 0 "Valid_values" ;
VAL_ 1411 RSDS_L_ObjDistY_8 0 "Valid_values" ;
VAL_ 1411 RSDS_L_ObjDistX_8 0 "Valid_values" 4080 "Reserved" ;
VAL_ 1411 RSDS_L_ObjObstacleProb_8 0 "Valid_values" ;
VAL_ 1411 RSDS_L_ObjExistProb_8 0 "Valid_values" ;
VAL_ 1411 RSDS_L_ObjID_8 0 "Valid_values" ;
VAL_ 1411 RSDS_L_SGU4_Checksum5 0 "Valid_value" ;
VAL_ 1411 RSDS_L_SGU4_RollingCounter4 0 "Valid_value" 15 "Invalid_value" ;
VAL_ 1411 RSDS_L_HWATargetValidity_7 0 "NOT_HWA_Target" 1 "HWA_Target" ;
VAL_ 1411 RSDS_L_ObjRefPoint_7 0 "Rear" 1 "Rear_left" 2 "Left" 3 "Front_left" 4 "Front" 5 "Front_Right" 6 "Right" 7 "Rear_right" ;
VAL_ 1411 RSDS_L_ObjRCS_7 0 "Valid_values" ;
VAL_ 1411 RSDS_L_ObjYawrate_7 0 "Valid_values" 4446 "Reserved" ;
VAL_ 1411 RSDS_L_ObjHeading_7 0 "Valid_values" 4446 "Reserved" ;
VAL_ 1411 RSDS_L_ObjLength_7 0 "Valid_values" 401 "Reserved" ;
VAL_ 1411 RSDS_L_SGU4_Checksum4 0 "Valid_value" ;
VAL_ 1411 RSDS_L_SGU4_RollingCounter3 0 "Valid_value" 15 "Invalid_value" ;
VAL_ 1411 RSDS_L_ObjMotionDirection_7 0 "Init" 1 "Inverse_direction" 2 "Same_direction" 3 "cross" 4 "reserved" 5 "reserved" 6 "reserved" 7 "reserved" ;
VAL_ 1411 RSDS_L_ObjAge_7 0 "Valid_values" ;
VAL_ 1411 RSDS_L_ObjWidth_7 0 "Valid_values" 501 "Reserved" ;
VAL_ 1411 RSDS_L_ObjRAccelYStd_7 0 "Valid_values" ;
VAL_ 1411 RSDS_L_ObjRAccelXStd_7 0 "Valid_values" ;
VAL_ 1411 RSDS_L_ObjRelVelYStd_7 0 "Valid_values" ;
VAL_ 1411 RSDS_L_ObjRelVelXStd_7 0 "Valid_values" ;
VAL_ 1411 RSDS_L_ObjDistYStd_7 0 "Valid_values" ;
VAL_ 1411 RSDS_L_SGU4_Checksum3 0 "Valid_value" ;
VAL_ 1411 RSDS_L_SGU4_RollingCounter2 0 "Valid_value" 15 "Invalid_value" ;
VAL_ 1411 RSDS_L_ObjMotionType_7 0 "int" 1 "unknown" 2 "Drive" 3 "Stopped" 4 "Stand" 5 "reserved" 6 "reserved" 7 "reserved" ;
VAL_ 1411 RSDS_L_ObjMeasured_7 0 "Init" 1 "Measured" 2 "Predicted" 3 "Reserved" ;
VAL_ 1411 RSDS_L_ObjRelAccelY_7 0 "Valid_values" ;
VAL_ 1411 RSDS_L_ObjRelAccelX_7 0 "Valid_values" ;
VAL_ 1411 RSDS_L_ObjRelVelY_7 0 "Valid_values" 8174 "Reserved" ;
VAL_ 1411 RSDS_L_ObjRelVelX_7 0 "Valid_values" 8174 "Reserved" ;
VAL_ 1411 RSDS_L_SGU4_Checksum2 0 "Valid_value" ;
VAL_ 1411 RSDS_L_SGU4_RollingCounter1 0 "Valid_value" 15 "Invalid_value" ;
VAL_ 1411 RSDS_L_ObjType_7 0 "Unknown" 1 "Truck" 2 "Car" 3 "Pedestrian" 4 "Cyclist" 5 "Reserved" ;
VAL_ 1411 RSDS_L_ObjDistXStd_7 0 "Valid_values" ;
VAL_ 1411 RSDS_L_ObjDistY_7 0 "Valid_values" ;
VAL_ 1411 RSDS_L_ObjDistX_7 0 "Valid_values" 4080 "Reserved" ;
VAL_ 1411 RSDS_L_ObjObstacleProb_7 0 "Valid_values" ;
VAL_ 1411 RSDS_L_ObjExistProb_7 0 "Valid_values" ;
VAL_ 1411 RSDS_L_ObjID_7 0 "Valid_values" ;
VAL_ 1411 RSDS_L_SGU4_Checksum1 0 "Valid_value" ;
VAL_ 1412 RSDS_L_SGU5_RollingCounter8 0 "Valid_value" 15 "Invalid_value" ;
VAL_ 1412 RSDS_L_SGU5_BlockCounter 0 "Valid_value" ;
VAL_ 1412 RSDS_L_HWATargetValidity_10 0 "NOT_HWA_Target" 1 "HWA_Target" ;
VAL_ 1412 RSDS_L_ObjRefPoint_10 0 "Rear" 1 "Rear_left" 2 "Left" 3 "Front_left" 4 "Front" 5 "Front_Right" 6 "Right" 7 "Rear_right" ;
VAL_ 1412 RSDS_L_ObjRCS_10 0 "Valid_values" ;
VAL_ 1412 RSDS_L_ObjYawrate_10 0 "Valid_values" 4446 "Reserved" ;
VAL_ 1412 RSDS_L_ObjHeading_10 0 "Valid_values" 4446 "Reserved" ;
VAL_ 1412 RSDS_L_ObjLength_10 0 "Valid_values" 401 "Reserved" ;
VAL_ 1412 RSDS_L_SGU5_Checksum8 0 "Valid_value" ;
VAL_ 1412 RSDS_L_SGU5_RollingCounter7 0 "Valid_value" 15 "Invalid_value" ;
VAL_ 1412 RSDS_L_ObjMotionDirection_10 0 "Init" 1 "Inverse_direction" 2 "Same__direction" 3 "cross" 4 "reserved" 5 "reserved" 6 "reserved" 7 "reserved" ;
VAL_ 1412 RSDS_L_ObjAge_10 0 "Valid_values" ;
VAL_ 1412 RSDS_L_ObjWidth_10 0 "Valid_values" 501 "Reserved" ;
VAL_ 1412 RSDS_L_ObjRAccelYStd_10 0 "Valid_values" ;
VAL_ 1412 RSDS_L_ObjRAccelXStd_10 0 "Valid_values" ;
VAL_ 1412 RSDS_L_ObjRelVelYStd_10 0 "Valid_values" ;
VAL_ 1412 RSDS_L_ObjRelVelXStd_10 0 "Valid_values" ;
VAL_ 1412 RSDS_L_ObjDistYStd_10 0 "Valid_values" ;
VAL_ 1412 RSDS_L_SGU5_Checksum7 0 "Valid_value" ;
VAL_ 1412 RSDS_L_SGU5_RollingCounter6 0 "Valid_value" 15 "Invalid_value" ;
VAL_ 1412 RSDS_L_ObjMotionType_10 0 "int" 1 "unknown" 2 "Drive" 3 "Stopped" 4 "Stand" 5 "reserved" 6 "reserved" 7 "reserved" ;
VAL_ 1412 RSDS_L_ObjMeasured_10 0 "Init" 1 "Measured" 2 "Predicted" 3 "Reserved" ;
VAL_ 1412 RSDS_L_ObjRelAccelY_10 0 "Valid_values" ;
VAL_ 1412 RSDS_L_ObjRelAccelX_10 0 "Valid_values" ;
VAL_ 1412 RSDS_L_ObjRelVelY_10 0 "Valid_values" 8174 "Reserved" ;
VAL_ 1412 RSDS_L_ObjRelVelX_10 0 "Valid_values" 8174 "Reserved" ;
VAL_ 1412 RSDS_L_SGU5_Checksum6 0 "Valid_value" ;
VAL_ 1412 RSDS_L_SGU5_RollingCounter5 0 "Valid_value" 15 "Invalid_value" ;
VAL_ 1412 RSDS_L_ObjType_10 0 "Unknown" 1 "Truck" 2 "Car" 3 "Pedestrian" 4 "Cyclist" 5 "Reserved" ;
VAL_ 1412 RSDS_L_ObjDistXStd_10 0 "Valid_values" ;
VAL_ 1412 RSDS_L_ObjDistY_10 0 "Valid_values" ;
VAL_ 1412 RSDS_L_ObjDistX_10 0 "Valid_values" 4080 "Reserved" ;
VAL_ 1412 RSDS_L_ObjObstacleProb_10 0 "Valid_values" ;
VAL_ 1412 RSDS_L_ObjExistProb_10 0 "Valid_values" ;
VAL_ 1412 RSDS_L_ObjID_10 0 "Valid_values" ;
VAL_ 1412 RSDS_L_SGU5_Checksum5 0 "Valid_value" ;
VAL_ 1412 RSDS_L_SGU5_RollingCounter4 0 "Valid_value" 15 "Invalid_value" ;
VAL_ 1412 RSDS_L_HWATargetValidity_9 0 "NOT_HWA_Target" 1 "HWA_Target" ;
VAL_ 1412 RSDS_L_ObjRefPoint_9 0 "Rear" 1 "Rear_left" 2 "Left" 3 "Front_left" 4 "Front" 5 "Front_Right" 6 "Right" 7 "Rear_right" ;
VAL_ 1412 RSDS_L_ObjRCS_9 0 "Valid_values" ;
VAL_ 1412 RSDS_L_ObjYawrate_9 0 "Valid_values" 4446 "Reserved" ;
VAL_ 1412 RSDS_L_ObjHeading_9 0 "Valid_values" 4446 "Reserved" ;
VAL_ 1412 RSDS_L_ObjLength_9 0 "Valid_values" 401 "Reserved" ;
VAL_ 1412 RSDS_L_SGU5_Checksum4 0 "Valid_value" ;
VAL_ 1412 RSDS_L_SGU5_RollingCounter3 0 "Valid_value" 15 "Invalid_value" ;
VAL_ 1412 RSDS_L_ObjMotionDirection_9 0 "Init" 1 "Inverse_direction" 2 "Same__direction" 3 "cross" 4 "reserved" 5 "reserved" 6 "reserved" 7 "reserved" ;
VAL_ 1412 RSDS_L_ObjAge_9 0 "Valid_values" ;
VAL_ 1412 RSDS_L_ObjWidth_9 0 "Valid_values" 501 "Reserved" ;
VAL_ 1412 RSDS_L_ObjRAccelYStd_9 0 "Valid_values" ;
VAL_ 1412 RSDS_L_ObjRAccelXStd_9 0 "Valid_values" ;
VAL_ 1412 RSDS_L_ObjRelVelYStd_9 0 "Valid_values" ;
VAL_ 1412 RSDS_L_ObjRelVelXStd_9 0 "Valid_values" ;
VAL_ 1412 RSDS_L_ObjDistYStd_9 0 "Valid_values" ;
VAL_ 1412 RSDS_L_SGU5_Checksum3 0 "Valid_value" ;
VAL_ 1412 RSDS_L_SGU5_RollingCounter2 0 "Valid_value" 15 "Invalid_value" ;
VAL_ 1412 RSDS_L_ObjMotionType_9 0 "int" 1 "unknown" 2 "Drive" 3 "Stopped" 4 "Stand" 5 "reserved" 6 "reserved" 7 "reserved" ;
VAL_ 1412 RSDS_L_ObjMeasured_9 0 "Init" 1 "Measured" 2 "Predicted" 3 "Reserved" ;
VAL_ 1412 RSDS_L_ObjRelAccelY_9 0 "Valid_values" ;
VAL_ 1412 RSDS_L_ObjRelAccelX_9 0 "Valid_values" ;
VAL_ 1412 RSDS_L_ObjRelVelY_9 0 "Valid_values" 8174 "Reserved" ;
VAL_ 1412 RSDS_L_ObjRelVelX_9 0 "Valid_values" 8174 "Reserved" ;
VAL_ 1412 RSDS_L_SGU5_Checksum2 0 "Valid_value" ;
VAL_ 1412 RSDS_L_SGU5_RollingCounter1 0 "Valid_value" 15 "Invalid_value" ;
VAL_ 1412 RSDS_L_ObjType_9 0 "Unknown" 1 "Truck" 2 "Car" 3 "Pedestrian" 4 "Cyclist" 5 "Reserved" ;
VAL_ 1412 RSDS_L_ObjDistXStd_9 0 "Valid_values" ;
VAL_ 1412 RSDS_L_ObjDistY_9 0 "Valid_values" ;
VAL_ 1412 RSDS_L_ObjDistX_9 0 "Valid_values" 4080 "Reserved" ;
VAL_ 1412 RSDS_L_ObjObstacleProb_9 0 "Valid_values" ;
VAL_ 1412 RSDS_L_ObjExistProb_9 0 "Valid_values" ;
VAL_ 1412 RSDS_L_ObjID_9 0 "Valid_values" ;
VAL_ 1412 RSDS_L_SGU5_Checksum1 0 "Valid_value" ;
VAL_ 1413 RSDS_L_SGU6_RollingCounter8 0 "Valid_value" 15 "Invalid_value" ;
VAL_ 1413 RSDS_L_SGU6_BlockCounter 0 "Valid_value" ;
VAL_ 1413 RSDS_L_HWATargetValidity_12 0 "NOT_HWA_Target" 1 "HWA_Target" ;
VAL_ 1413 RSDS_L_ObjRefPoint_12 0 "Rear" 1 "Rear_left" 2 "Left" 3 "Front_left" 4 "Front" 5 "Front_Right" 6 "Right" 7 "Rear_right" ;
VAL_ 1413 RSDS_L_ObjRCS_12 0 "Valid_values" ;
VAL_ 1413 RSDS_L_ObjYawrate_12 0 "Valid_values" 4446 "Reserved" ;
VAL_ 1413 RSDS_L_ObjHeading_12 0 "Valid_values" 4446 "Reserved" ;
VAL_ 1413 RSDS_L_ObjLength_12 0 "Valid_values" 401 "Reserved" ;
VAL_ 1413 RSDS_L_SGU6_Checksum8 0 "Valid_value" ;
VAL_ 1413 RSDS_L_SGU6_RollingCounter7 0 "Valid_value" 15 "Invalid_value" ;
VAL_ 1413 RSDS_L_ObjMotionDirection_12 0 "Init" 1 "Inverse_direction" 2 "Same__direction" 3 "cross" 4 "reserved" 5 "reserved" 6 "reserved" 7 "reserved" ;
VAL_ 1413 RSDS_L_ObjAge_12 0 "Valid_values" ;
VAL_ 1413 RSDS_L_ObjWidth_12 0 "Valid_values" 501 "Reserved" ;
VAL_ 1413 RSDS_L_ObjRAccelYStd_12 0 "Valid_values" ;
VAL_ 1413 RSDS_L_ObjRAccelXStd_12 0 "Valid_values" ;
VAL_ 1413 RSDS_L_ObjRelVelYStd_12 0 "Valid_values" ;
VAL_ 1413 RSDS_L_ObjRelVelXStd_12 0 "Valid_values" ;
VAL_ 1413 RSDS_L_ObjDistYStd_12 0 "Valid_values" ;
VAL_ 1413 RSDS_L_SGU6_Checksum7 0 "Valid_value" ;
VAL_ 1413 RSDS_L_SGU6_RollingCounter6 0 "Valid_value" 15 "Invalid_value" ;
VAL_ 1413 RSDS_L_ObjMotionType_12 0 "int" 1 "unknown" 2 "Drive" 3 "Stopped" 4 "Stand" 5 "reserved" 6 "reserved" 7 "reserved" ;
VAL_ 1413 RSDS_L_ObjMeasured_12 0 "Init" 1 "Measured" 2 "Predicted" 3 "Reserved" ;
VAL_ 1413 RSDS_L_ObjRelAccelY_12 0 "Valid_values" ;
VAL_ 1413 RSDS_L_ObjRelAccelX_12 0 "Valid_values" ;
VAL_ 1413 RSDS_L_ObjRelVelY_12 0 "Valid_values" 8174 "Reserved" ;
VAL_ 1413 RSDS_L_ObjRelVelX_12 0 "Valid_values" 8174 "Reserved" ;
VAL_ 1413 RSDS_L_SGU6_Checksum6 0 "Valid_value" ;
VAL_ 1413 RSDS_L_SGU6_RollingCounter5 0 "Valid_value" 15 "Invalid_value" ;
VAL_ 1413 RSDS_L_ObjType_12 0 "Unknown" 1 "Truck" 2 "Car" 3 "Pedestrian" 4 "Cyclist" 5 "Reserved" ;
VAL_ 1413 RSDS_L_ObjDistXStd_12 0 "Valid_values" ;
VAL_ 1413 RSDS_L_ObjDistY_12 0 "Valid_values" ;
VAL_ 1413 RSDS_L_ObjDistX_12 0 "Valid_values" 4080 "Reserved" ;
VAL_ 1413 RSDS_L_ObjObstacleProb_12 0 "Valid_values" ;
VAL_ 1413 RSDS_L_ObjExistProb_12 0 "Valid_values" ;
VAL_ 1413 RSDS_L_ObjID_12 0 "Valid_values" ;
VAL_ 1413 RSDS_L_SGU6_Checksum5 0 "Valid_value" ;
VAL_ 1413 RSDS_L_SGU6_RollingCounter4 0 "Valid_value" 15 "Invalid_value" ;
VAL_ 1413 RSDS_L_HWATargetValidity_11 0 "NOT_HWA_Target" 1 "HWA_Target" ;
VAL_ 1413 RSDS_L_ObjRefPoint_11 0 "Rear" 1 "Rear_left" 2 "Left" 3 "Front_left" 4 "Front" 5 "Front_Right" 6 "Right" 7 "Rear_right" ;
VAL_ 1413 RSDS_L_ObjRCS_11 0 "Valid_values" ;
VAL_ 1413 RSDS_L_ObjYawrate_11 0 "Valid_values" 4446 "Reserved" ;
VAL_ 1413 RSDS_L_ObjHeading_11 0 "Valid_values" 4446 "Reserved" ;
VAL_ 1413 RSDS_L_ObjLength_11 0 "Valid_values" 401 "Reserved" ;
VAL_ 1413 RSDS_L_SGU6_Checksum4 0 "Valid_value" ;
VAL_ 1413 RSDS_L_SGU6_RollingCounter3 0 "Valid_value" 15 "Invalid_value" ;
VAL_ 1413 RSDS_L_ObjMotionDirection_11 0 "Init" 1 "Inverse_direction" 2 "Same__direction" 3 "cross" 4 "reserved" 5 "reserved" 6 "reserved" 7 "reserved" ;
VAL_ 1413 RSDS_L_ObjAge_11 0 "Valid_values" ;
VAL_ 1413 RSDS_L_ObjWidth_11 0 "Valid_values" 501 "Reserved" ;
VAL_ 1413 RSDS_L_ObjRAccelYStd_11 0 "Valid_values" ;
VAL_ 1413 RSDS_L_ObjRAccelXStd_11 0 "Valid_values" ;
VAL_ 1413 RSDS_L_ObjRelVelYStd_11 0 "Valid_values" ;
VAL_ 1413 RSDS_L_ObjRelVelXStd_11 0 "Valid_values" ;
VAL_ 1413 RSDS_L_ObjDistYStd_11 0 "Valid_values" ;
VAL_ 1413 RSDS_L_SGU6_Checksum3 0 "Valid_value" ;
VAL_ 1413 RSDS_L_SGU6_RollingCounter2 0 "Valid_value" 15 "Invalid_value" ;
VAL_ 1413 RSDS_L_ObjMotionType_11 0 "int" 1 "unknown" 2 "Drive" 3 "Stopped" 4 "Stand" 5 "reserved" 6 "reserved" 7 "reserved" ;
VAL_ 1413 RSDS_L_ObjMeasured_11 0 "Init" 1 "Measured" 2 "Predicted" 3 "Reserved" ;
VAL_ 1413 RSDS_L_ObjRelAccelY_11 0 "Valid_values" ;
VAL_ 1413 RSDS_L_ObjRelAccelX_11 0 "Valid_values" ;
VAL_ 1413 RSDS_L_ObjRelVelY_11 0 "Valid_values" 8174 "Reserved" ;
VAL_ 1413 RSDS_L_ObjRelVelX_11 0 "Valid_values" 8174 "Reserved" ;
VAL_ 1413 RSDS_L_SGU6_Checksum2 0 "Valid_value" ;
VAL_ 1413 RSDS_L_SGU6_RollingCounter1 0 "Valid_value" 15 "Invalid_value" ;
VAL_ 1413 RSDS_L_ObjType_11 0 "Unknown" 1 "Truck" 2 "Car" 3 "Pedestrian" 4 "Cyclist" 5 "Reserved" ;
VAL_ 1413 RSDS_L_ObjDistXStd_11 0 "Valid_values" ;
VAL_ 1413 RSDS_L_ObjDistY_11 0 "Valid_values" ;
VAL_ 1413 RSDS_L_ObjDistX_11 0 "Valid_values" 4080 "Reserved" ;
VAL_ 1413 RSDS_L_ObjObstacleProb_11 0 "Valid_values" ;
VAL_ 1413 RSDS_L_ObjExistProb_11 0 "Valid_values" ;
VAL_ 1413 RSDS_L_ObjID_11 0 "Valid_values" ;
VAL_ 1413 RSDS_L_SGU6_Checksum1 0 "Valid_value" ;
VAL_ 1414 RSDS_L_SGU7_RollingCounter8 0 "Valid_value" 15 "Invalid_value" ;
VAL_ 1414 RSDS_L_SGU7_BlockCounter 0 "Valid_value" ;
VAL_ 1414 RSDS_L_HWATargetValidity_14 0 "NOT_HWA_Target" 1 "HWA_Target" ;
VAL_ 1414 RSDS_L_ObjRefPoint_14 0 "Rear" 1 "Rear_left" 2 "Left" 3 "Front_left" 4 "Front" 5 "Front_Right" 6 "Right" 7 "Rear_right" ;
VAL_ 1414 RSDS_L_ObjRCS_14 0 "Valid_values" ;
VAL_ 1414 RSDS_L_ObjYawrate_14 0 "Valid_values" 4446 "Reserved" ;
VAL_ 1414 RSDS_L_ObjHeading_14 0 "Valid_values" 4446 "Reserved" ;
VAL_ 1414 RSDS_L_ObjLength_14 0 "Valid_values" 401 "Reserved" ;
VAL_ 1414 RSDS_L_SGU7_Checksum8 0 "Valid_value" ;
VAL_ 1414 RSDS_L_SGU7_RollingCounter7 0 "Valid_value" 15 "Invalid_value" ;
VAL_ 1414 RSDS_L_ObjMotionDirection_14 0 "Init" 1 "Inverse_direction" 2 "Same__direction" 3 "cross" 4 "reserved" 5 "reserved" 6 "reserved" 7 "reserved" ;
VAL_ 1414 RSDS_L_ObjAge_14 0 "Valid_values" ;
VAL_ 1414 RSDS_L_ObjWidth_14 0 "Valid_values" 501 "Reserved" ;
VAL_ 1414 RSDS_L_ObjRAccelYStd_14 0 "Valid_values" ;
VAL_ 1414 RSDS_L_ObjRAccelXStd_14 0 "Valid_values" ;
VAL_ 1414 RSDS_L_ObjRelVelYStd_14 0 "Valid_values" ;
VAL_ 1414 RSDS_L_ObjRelVelXStd_14 0 "Valid_values" ;
VAL_ 1414 RSDS_L_ObjDistYStd_14 0 "Valid_values" ;
VAL_ 1414 RSDS_L_SGU7_Checksum7 0 "Valid_value" ;
VAL_ 1414 RSDS_L_SGU7_RollingCounter6 0 "Valid_value" 15 "Invalid_value" ;
VAL_ 1414 RSDS_L_ObjMotionType_14 0 "int" 1 "unknown" 2 "Drive" 3 "Stopped" 4 "Stand" 5 "reserved" 6 "reserved" 7 "reserved" ;
VAL_ 1414 RSDS_L_ObjMeasured_14 0 "Init" 1 "Measured" 2 "Predicted" 3 "Reserved" ;
VAL_ 1414 RSDS_L_ObjRelAccelY_14 0 "Valid_values" ;
VAL_ 1414 RSDS_L_ObjRelAccelX_14 0 "Valid_values" ;
VAL_ 1414 RSDS_L_ObjRelVelY_14 0 "Valid_values" 8174 "Reserved" ;
VAL_ 1414 RSDS_L_ObjRelVelX_14 0 "Valid_values" 8174 "Reserved" ;
VAL_ 1414 RSDS_L_SGU7_Checksum6 0 "Valid_value" ;
VAL_ 1414 RSDS_L_SGU7_RollingCounter5 0 "Valid_value" 15 "Invalid_value" ;
VAL_ 1414 RSDS_L_ObjType_14 0 "Unknown" 1 "Truck" 2 "Car" 3 "Pedestrian" 4 "Cyclist" 5 "Reserved" ;
VAL_ 1414 RSDS_L_ObjDistXStd_14 0 "Valid_values" ;
VAL_ 1414 RSDS_L_ObjDistY_14 0 "Valid_values" ;
VAL_ 1414 RSDS_L_ObjDistX_14 0 "Valid_values" 4080 "Reserved" ;
VAL_ 1414 RSDS_L_ObjObstacleProb_14 0 "Valid_values" ;
VAL_ 1414 RSDS_L_ObjExistProb_14 0 "Valid_values" ;
VAL_ 1414 RSDS_L_ObjID_14 0 "Valid_values" ;
VAL_ 1414 RSDS_L_SGU7_Checksum5 0 "Valid_value" ;
VAL_ 1414 RSDS_L_SGU7_RollingCounter4 0 "Valid_value" 15 "Invalid_value" ;
VAL_ 1414 RSDS_L_HWATargetValidity_13 0 "NOT_HWA_Target" 1 "HWA_Target" ;
VAL_ 1414 RSDS_L_ObjRefPoint_13 0 "Rear" 1 "Rear_left" 2 "Left" 3 "Front_left" 4 "Front" 5 "Front_Right" 6 "Right" 7 "Rear_right" ;
VAL_ 1414 RSDS_L_ObjRCS_13 0 "Valid_values" ;
VAL_ 1414 RSDS_L_ObjYawrate_13 0 "Valid_values" 4446 "Reserved" ;
VAL_ 1414 RSDS_L_ObjHeading_13 0 "Valid_values" 4446 "Reserved" ;
VAL_ 1414 RSDS_L_ObjLength_13 0 "Valid_values" 401 "Reserved" ;
VAL_ 1414 RSDS_L_SGU7_Checksum4 0 "Valid_value" ;
VAL_ 1414 RSDS_L_SGU7_RollingCounter3 0 "Valid_value" 15 "Invalid_value" ;
VAL_ 1414 RSDS_L_ObjMotionDirection_13 0 "Init" 1 "Inverse_direction" 2 "Same_direction" 3 "cross" 4 "reserved" 5 "reserved" 6 "reserved" 7 "reserved" ;
VAL_ 1414 RSDS_L_ObjAge_13 0 "Valid_values" ;
VAL_ 1414 RSDS_L_ObjWidth_13 0 "Valid_values" 501 "Reserved" ;
VAL_ 1414 RSDS_L_ObjRAccelYStd_13 0 "Valid_values" ;
VAL_ 1414 RSDS_L_ObjRAccelXStd_13 0 "Valid_values" ;
VAL_ 1414 RSDS_L_ObjRelVelYStd_13 0 "Valid_values" ;
VAL_ 1414 RSDS_L_ObjRelVelXStd_13 0 "Valid_values" ;
VAL_ 1414 RSDS_L_ObjDistYStd_13 0 "Valid_values" ;
VAL_ 1414 RSDS_L_SGU7_Checksum3 0 "Valid_value" ;
VAL_ 1414 RSDS_L_SGU7_RollingCounter2 0 "Valid_value" 15 "Invalid_value" ;
VAL_ 1414 RSDS_L_ObjMotionType_13 0 "int" 1 "unknown" 2 "Drive" 3 "Stopped" 4 "Stand" 5 "reserved" 6 "reserved" 7 "reserved" ;
VAL_ 1414 RSDS_L_ObjMeasured_13 0 "Init" 1 "Measured" 2 "Predicted" 3 "Reserved" ;
VAL_ 1414 RSDS_L_ObjRelAccelY_13 0 "Valid_values" ;
VAL_ 1414 RSDS_L_ObjRelAccelX_13 0 "Valid_values" ;
VAL_ 1414 RSDS_L_ObjRelVelY_13 0 "Valid_values" 8174 "Reserved" ;
VAL_ 1414 RSDS_L_ObjRelVelX_13 0 "Valid_values" 8174 "Reserved" ;
VAL_ 1414 RSDS_L_SGU7_Checksum2 0 "Valid_value" ;
VAL_ 1414 RSDS_L_SGU7_RollingCounter1 0 "Valid_value" 15 "Invalid_value" ;
VAL_ 1414 RSDS_L_ObjType_13 0 "Unknown" 1 "Truck" 2 "Car" 3 "Pedestrian" 4 "Cyclist" 5 "Reserved" ;
VAL_ 1414 RSDS_L_ObjDistXStd_13 0 "Valid_values" ;
VAL_ 1414 RSDS_L_ObjDistY_13 0 "Valid_values" ;
VAL_ 1414 RSDS_L_ObjDistX_13 0 "Valid_values" 4080 "Reserved" ;
VAL_ 1414 RSDS_L_ObjObstacleProb_13 0 "Valid_values" ;
VAL_ 1414 RSDS_L_ObjExistProb_13 0 "Valid_values" ;
VAL_ 1414 RSDS_L_ObjID_13 0 "Valid_values" ;
VAL_ 1414 RSDS_L_SGU7_Checksum1 0 "Valid_value" ;
VAL_ 1415 RSDS_L_SGU8_RollingCounter8 0 "Valid_value" 15 "Invalid_value" ;
VAL_ 1415 RSDS_L_SGU8_BlockCounter 0 "Valid_value" ;
VAL_ 1415 RSDS_L_HWATargetValidity_16 0 "NOT_HWA_Target" 1 "HWA_Target" ;
VAL_ 1415 RSDS_L_ObjRefPoint_16 0 "Rear" 1 "Rear_left" 2 "Left" 3 "Front_left" 4 "Front" 5 "Front_Right" 6 "Right" 7 "Rear_right" ;
VAL_ 1415 RSDS_L_ObjRCS_16 0 "Valid_values" ;
VAL_ 1415 RSDS_L_ObjYawrate_16 0 "Valid_values" 4446 "Reserved" ;
VAL_ 1415 RSDS_L_ObjHeading_16 0 "Valid_values" 4446 "Reserved" ;
VAL_ 1415 RSDS_L_ObjLength_16 0 "Valid_values" 401 "Reserved" ;
VAL_ 1415 RSDS_L_SGU8_Checksum8 0 "Valid_value" ;
VAL_ 1415 RSDS_L_SGU8_RollingCounter7 0 "Valid_value" 15 "Invalid_value" ;
VAL_ 1415 RSDS_L_ObjMotionDirection_16 0 "Init" 1 "Inverse_direction" 2 "Same__direction" 3 "cross" 4 "reserved" 5 "reserved" 6 "reserved" 7 "reserved" ;
VAL_ 1415 RSDS_L_ObjAge_16 0 "Valid_values" ;
VAL_ 1415 RSDS_L_ObjWidth_16 0 "Valid_values" 501 "Reserved" ;
VAL_ 1415 RSDS_L_ObjRAccelYStd_16 0 "Valid_values" ;
VAL_ 1415 RSDS_L_ObjRAccelXStd_16 0 "Valid_values" ;
VAL_ 1415 RSDS_L_ObjRelVelYStd_16 0 "Valid_values" ;
VAL_ 1415 RSDS_L_ObjRelVelXStd_16 0 "Valid_values" ;
VAL_ 1415 RSDS_L_ObjDistYStd_16 0 "Valid_values" ;
VAL_ 1415 RSDS_L_SGU8_Checksum7 0 "Valid_value" ;
VAL_ 1415 RSDS_L_SGU8_RollingCounter6 0 "Valid_value" 15 "Invalid_value" ;
VAL_ 1415 RSDS_L_ObjMotionType_16 0 "int" 1 "unknown" 2 "Drive" 3 "Stopped" 4 "Stand" 5 "reserved" 6 "reserved" 7 "reserved" ;
VAL_ 1415 RSDS_L_ObjMeasured_16 0 "Init" 1 "Measured" 2 "Predicted" 3 "Reserved" ;
VAL_ 1415 RSDS_L_ObjRelAccelY_16 0 "Valid_values" ;
VAL_ 1415 RSDS_L_ObjRelAccelX_16 0 "Valid_values" ;
VAL_ 1415 RSDS_L_ObjRelVelY_16 0 "Valid_values" 8174 "Reserved" ;
VAL_ 1415 RSDS_L_ObjRelVelX_16 0 "Valid_values" 8174 "Reserved" ;
VAL_ 1415 RSDS_L_SGU8_Checksum6 0 "Valid_value" ;
VAL_ 1415 RSDS_L_SGU8_RollingCounter5 0 "Valid_value" 15 "Invalid_value" ;
VAL_ 1415 RSDS_L_ObjType_16 0 "Unknown" 1 "Truck" 2 "Car" 3 "Pedestrian" 4 "Cyclist" 5 "Reserved" ;
VAL_ 1415 RSDS_L_ObjDistXStd_16 0 "Valid_values" ;
VAL_ 1415 RSDS_L_ObjDistY_16 0 "Valid_values" ;
VAL_ 1415 RSDS_L_ObjDistX_16 0 "Valid_values" 4080 "Reserved" ;
VAL_ 1415 RSDS_L_ObjObstacleProb_16 0 "Valid_values" ;
VAL_ 1415 RSDS_L_ObjExistProb_16 0 "Valid_values" ;
VAL_ 1415 RSDS_L_ObjID_16 0 "Valid_values" ;
VAL_ 1415 RSDS_L_SGU8_Checksum5 0 "Valid_value" ;
VAL_ 1415 RSDS_L_SGU8_RollingCounter4 0 "Valid_value" 15 "Invalid_value" ;
VAL_ 1415 RSDS_L_HWATargetValidity_15 0 "NOT_HWA_Target" 1 "HWA_Target" ;
VAL_ 1415 RSDS_L_ObjRefPoint_15 0 "Rear" 1 "Rear_left" 2 "Left" 3 "Front_left" 4 "Front" 5 "Front_Right" 6 "Right" 7 "Rear_right" ;
VAL_ 1415 RSDS_L_ObjRCS_15 0 "Valid_values" ;
VAL_ 1415 RSDS_L_ObjYawrate_15 0 "Valid_values" 4446 "Reserved" ;
VAL_ 1415 RSDS_L_ObjHeading_15 0 "Valid_values" 4446 "Reserved" ;
VAL_ 1415 RSDS_L_ObjLength_15 0 "Valid_values" 401 "Reserved" ;
VAL_ 1415 RSDS_L_SGU8_Checksum4 0 "Valid_value" ;
VAL_ 1415 RSDS_L_SGU8_RollingCounter3 0 "Valid_value" 15 "Invalid_value" ;
VAL_ 1415 RSDS_L_ObjMotionDirection_15 0 "Init" 1 "Inverse_direction" 2 "Same__direction" 3 "cross" 4 "reserved" 5 "reserved" 6 "reserved" 7 "reserved" ;
VAL_ 1415 RSDS_L_ObjAge_15 0 "Valid_values" ;
VAL_ 1415 RSDS_L_ObjWidth_15 0 "Valid_values" 501 "Reserved" ;
VAL_ 1415 RSDS_L_ObjRAccelYStd_15 0 "Valid_values" ;
VAL_ 1415 RSDS_L_ObjRAccelXStd_15 0 "Valid_values" ;
VAL_ 1415 RSDS_L_ObjRelVelYStd_15 0 "Valid_values" ;
VAL_ 1415 RSDS_L_ObjRelVelXStd_15 0 "Valid_values" ;
VAL_ 1415 RSDS_L_ObjDistYStd_15 0 "Valid_values" ;
VAL_ 1415 RSDS_L_SGU8_Checksum3 0 "Valid_value" ;
VAL_ 1415 RSDS_L_SGU8_RollingCounter2 0 "Valid_value" 15 "Invalid_value" ;
VAL_ 1415 RSDS_L_ObjMotionType_15 0 "int" 1 "unknown" 2 "Drive" 3 "Stopped" 4 "Stand" 5 "reserved" 6 "reserved" 7 "reserved" ;
VAL_ 1415 RSDS_L_ObjMeasured_15 0 "Init" 1 "Measured" 2 "Predicted" 3 "Reserved" ;
VAL_ 1415 RSDS_L_ObjRelAccelY_15 0 "Valid_values" ;
VAL_ 1415 RSDS_L_ObjRelAccelX_15 0 "Valid_values" ;
VAL_ 1415 RSDS_L_ObjRelVelY_15 0 "Valid_values" 8174 "Reserved" ;
VAL_ 1415 RSDS_L_ObjRelVelX_15 0 "Valid_values" 8174 "Reserved" ;
VAL_ 1415 RSDS_L_SGU8_Checksum2 0 "Valid_value" ;
VAL_ 1415 RSDS_L_SGU8_RollingCounter1 0 "Valid_value" 15 "Invalid_value" ;
VAL_ 1415 RSDS_L_ObjType_15 0 "Unknown" 1 "Truck" 2 "Car" 3 "Pedestrian" 4 "Cyclist" 5 "Reserved" ;
VAL_ 1415 RSDS_L_ObjDistXStd_15 0 "Valid_values" ;
VAL_ 1415 RSDS_L_ObjDistY_15 0 "Valid_values" ;
VAL_ 1415 RSDS_L_ObjDistX_15 0 "Valid_values" 4080 "Reserved" ;
VAL_ 1415 RSDS_L_ObjObstacleProb_15 0 "Valid_values" ;
VAL_ 1415 RSDS_L_ObjExistProb_15 0 "Valid_values" ;
VAL_ 1415 RSDS_L_ObjID_15 0 "Valid_values" ;
VAL_ 1415 RSDS_L_SGU8_Checksum1 0 "Valid_value" ;
VAL_ 1416 RSDS_L_SGU9_RollingCounter8 15 "InValid_value" ;
VAL_ 1416 RSDS_L_HWATargetValidity_18 0 "NOT_HWA_Target" 1 "HWA_Target" ;
VAL_ 1416 RSDS_L_ObjRefPoint_18 0 "Rear" 1 "Rear_left" 2 "Left" 3 "Front_left" 4 "Front" 5 "Front_Right" 6 "Right" 7 "Rear_right" ;
VAL_ 1416 RSDS_L_SGU9_RollingCounter7 15 "InValid_value" ;
VAL_ 1416 RSDS_L_ObjMotionDirection_18 0 "Initial_Value" 1 "Inverse_direction" 2 "Same_direction" 3 "Cross" ;
VAL_ 1416 RSDS_L_ObjDistYStd_18 0 "Valid_values" ;
VAL_ 1416 RSDS_L_SGU9_RollingCounter6 15 "InValid_value" ;
VAL_ 1416 RSDS_L_ObjMotionType_18 0 "Initial_Value" 1 "Unknown" 2 "Drive" 3 "Stopped" 4 "Stand" ;
VAL_ 1416 RSDS_L_ObjMeasured_18 0 "Initial_Value" 1 "Measured" 2 "Predicted" ;
VAL_ 1416 RSDS_L_SGU9_RollingCounter5 15 "InValid_value" ;
VAL_ 1416 RSDS_L_ObjType_18 0 "Unknown" 1 "Truck" 2 "Car" 3 "Pedestrian" 4 "Cyclist" ;
VAL_ 1416 RSDS_L_ObjDistXStd_18 0 "Valid_values" ;
VAL_ 1416 RSDS_L_SGU9_RollingCounter4 15 "InValid_value" ;
VAL_ 1416 RSDS_L_HWATargetValidity_17 0 "NOT_HWA_Target" 1 "HWA_Target" ;
VAL_ 1416 RSDS_L_ObjRefPoint_17 0 "Rear" 1 "Rear_left" 2 "Left" 3 "Front_left" 4 "Front" 5 "Front_Right" 6 "Right" 7 "Rear_right" ;
VAL_ 1416 RSDS_L_SGU9_RollingCounter3 15 "InValid_value" ;
VAL_ 1416 RSDS_L_ObjMotionDirection_17 0 "Initial_Value" 1 "Inverse_direction" 2 "Same_direction" 3 "Cross" ;
VAL_ 1416 RSDS_L_ObjDistYStd_17 0 "Valid_values" ;
VAL_ 1416 RSDS_L_SGU9_RollingCounter2 15 "InValid_value" ;
VAL_ 1416 RSDS_L_ObjMotionType_17 0 "Initial_Value" 1 "Unknown" 2 "Drive" 3 "Stopped" 4 "Stand" ;
VAL_ 1416 RSDS_L_ObjMeasured_17 0 "Initial_Value" 1 "Measured" 2 "Predicted" ;
VAL_ 1416 RSDS_L_SGU9_RollingCounter1 15 "InValid_value" ;
VAL_ 1416 RSDS_L_ObjType_17 0 "Unknown" 1 "Truck" 2 "Car" 3 "Pedestrian" 4 "Cyclist" ;
VAL_ 1416 RSDS_L_ObjDistXStd_17 0 "Valid_values" ;
VAL_ 1417 RSDS_L_SGU10_RollingCounter8 15 "InValid_value" ;
VAL_ 1417 RSDS_L_HWATargetValidity_20 0 "NOT_HWA_Target" 1 "HWA_Target" ;
VAL_ 1417 RSDS_L_ObjRefPoint_20 0 "Rear" 1 "Rear_left" 2 "Left" 3 "Front_left" 4 "Front" 5 "Front_Right" 6 "Right" 7 "Rear_right" ;
VAL_ 1417 RSDS_L_SGU10_RollingCounter7 15 "InValid_value" ;
VAL_ 1417 RSDS_L_ObjMotionDirection_20 0 "Initial_Value" 1 "Inverse_direction" 2 "Same_direction" 3 "Cross" ;
VAL_ 1417 RSDS_L_ObjDistYStd_20 0 "Valid_values" ;
VAL_ 1417 RSDS_L_SGU10_RollingCounter6 15 "InValid_value" ;
VAL_ 1417 RSDS_L_ObjMotionType_20 0 "Initial_Value" 1 "Unknown" 2 "Drive" 3 "Stopped" 4 "Stand" ;
VAL_ 1417 RSDS_L_ObjMeasured_20 0 "Initial_Value" 1 "Measured" 2 "Predicted" ;
VAL_ 1417 RSDS_L_SGU10_RollingCounter5 15 "InValid_value" ;
VAL_ 1417 RSDS_L_ObjType_20 0 "Unknown" 1 "Truck" 2 "Car" 3 "Pedestrian" 4 "Cyclist" ;
VAL_ 1417 RSDS_L_ObjDistXStd_20 0 "Valid_values" ;
VAL_ 1417 RSDS_L_SGU10_RollingCounter4 15 "InValid_value" ;
VAL_ 1417 RSDS_L_HWATargetValidity_19 0 "NOT_HWA_Target" 1 "HWA_Target" ;
VAL_ 1417 RSDS_L_ObjRefPoint_19 0 "Rear" 1 "Rear_left" 2 "Left" 3 "Front_left" 4 "Front" 5 "Front_Right" 6 "Right" 7 "Rear_right" ;
VAL_ 1417 RSDS_L_SGU10_RollingCounter3 15 "InValid_value" ;
VAL_ 1417 RSDS_L_ObjMotionDirection_19 0 "Initial_Value" 1 "Inverse_direction" 2 "Same_direction" 3 "Cross" ;
VAL_ 1417 RSDS_L_ObjDistYStd_19 0 "Valid_values" ;
VAL_ 1417 RSDS_L_SGU10_RollingCounter2 15 "InValid_value" ;
VAL_ 1417 RSDS_L_ObjMotionType_19 0 "Initial_Value" 1 "Unknown" 2 "Drive" 3 "Stopped" 4 "Stand" ;
VAL_ 1417 RSDS_L_ObjMeasured_19 0 "Initial_Value" 1 "Measured" 2 "Predicted" ;
VAL_ 1417 RSDS_L_SGU10_RollingCounter1 15 "InValid_value" ;
VAL_ 1417 RSDS_L_ObjType_19 0 "Unknown" 1 "Truck" 2 "Car" 3 "Pedestrian" 4 "Cyclist" ;
VAL_ 1417 RSDS_L_ObjDistXStd_19 0 "Valid_values" ;
