VERSION ""

NS_ :

BS_:

BU_: IDM CR_RL CR_RR Tester

BO_ 1418 RSDS_L_SGU11: 64 CR_RL
 SG_ RSDS_L_SGU11_RollingCounter8 : 507|4@0+ (1,0) [0|14] "NoUnit"  IDM
 SG_ RSDS_L_SGU11_BlockCounter : 511|4@0+ (1,0) [0|15] "NoUnit"  IDM
 SG_ RSDS_L_HWATargetValidity_22 : 496|1@0+ (1,0) [0|1] "NoUnit"  IDM
 SG_ RSDS_L_ObjRefPoint_22 : 499|3@0+ (1,0) [0|7] "NoUnit"  IDM
 SG_ RSDS_L_ObjRCS_22 : 493|10@0+ (0.125,-50) [-50|70] "dBsm"  IDM
 SG_ RSDS_L_ObjYawrate_22 : 473|12@0+ (0.002,-3.14) [-3.14|5.05] "radPerSec"  IDM
 SG_ RSDS_L_ObjHeading_22 : 469|12@0+ (0.002,-3.14) [-3.14|5.05] "rad"  IDM
 SG_ RSDS_L_ObjLength_22 : 463|10@0+ (0.05,0) [0|20] "m"  IDM
 SG_ RSDS_L_SGU11_Checksum8 : 455|8@0+ (1,0) [0|255] "NoUnit"  IDM
 SG_ RSDS_L_SGU11_RollingCounter7 : 443|4@0+ (1,0) [0|14] "NoUnit"  IDM
 SG_ RSDS_L_ObjMotionDirection_22 : 447|3@0+ (1,0) [0|7] "NoUnit"  IDM
 SG_ RSDS_L_ObjAge_22 : 439|8@0+ (1,0) [0|255] "NoUnit"  IDM
 SG_ RSDS_L_ObjWidth_22 : 417|10@0+ (0.01,0) [0|5] "m"  IDM
 SG_ RSDS_L_ObjRAccelYStd_22 : 423|6@0+ (0.0625,0) [0|3.9375] "MtrPerSecSq"  IDM
 SG_ RSDS_L_ObjRAccelXStd_22 : 413|6@0+ (0.0625,0) [0|3.9375] "MtrPerSecSq"  IDM
 SG_ RSDS_L_ObjRelVelYStd_22 : 403|6@0+ (0.0625,0) [0|3.9375] "mps"  IDM
 SG_ RSDS_L_ObjRelVelXStd_22 : 393|6@0+ (0.0625,0) [0|3.9375] "mps"  IDM
 SG_ RSDS_L_ObjDistYStd_22 : 399|6@0+ (0.1,0) [0|6] "m"  IDM
 SG_ RSDS_L_SGU11_Checksum7 : 391|8@0+ (1,0) [0|255] "NoUnit"  IDM
 SG_ RSDS_L_SGU11_RollingCounter6 : 379|4@0+ (1,0) [0|14] "NoUnit"  IDM
 SG_ RSDS_L_ObjMotionType_22 : 383|3@0+ (1,0) [0|7] "NoUnit"  IDM
 SG_ RSDS_L_ObjMeasured_22 : 369|2@0+ (1,0) [0|3] "NoUnit"  IDM
 SG_ RSDS_L_ObjRelAccelY_22 : 363|10@0+ (0.03125,-16) [-16|15.96875] "MtrPerSecSq"  IDM
 SG_ RSDS_L_ObjRelAccelX_22 : 357|10@0+ (0.03125,-16) [-16|15.96875] "MtrPerSecSq"  IDM
 SG_ RSDS_L_ObjRelVelY_22 : 338|13@0+ (0.0312,-128) [-128|126.9976] "mps"  IDM
 SG_ RSDS_L_ObjRelVelX_22 : 335|13@0+ (0.0312,-128) [-128|126.9976] "mps"  IDM
 SG_ RSDS_L_SGU11_Checksum6 : 327|8@0+ (1,0) [0|255] "NoUnit"  IDM
 SG_ RSDS_L_SGU11_RollingCounter5 : 315|4@0+ (1,0) [0|14] "NoUnit"  IDM
 SG_ RSDS_L_ObjType_22 : 319|4@0+ (1,0) [0|15] "NoUnit"  IDM
 SG_ RSDS_L_ObjDistXStd_22 : 310|6@0+ (0.1,0) [0|6] "m"  IDM
 SG_ RSDS_L_ObjDistY_22 : 289|11@0+ (0.125,-128) [-128|127.875] "m"  IDM
 SG_ RSDS_L_ObjDistX_22 : 285|12@0+ (0.0625,-128) [-128|126.9375] "m"  IDM
 SG_ RSDS_L_ObjObstacleProb_22 : 274|5@0+ (0.03326,0) [0|1.03106] "NoUnit"  IDM
 SG_ RSDS_L_ObjExistProb_22 : 279|5@0+ (0.03326,0) [0|1.03106] "NoUnit"  IDM
 SG_ RSDS_L_ObjID_22 : 271|8@0+ (1,0) [0|255] "NoUnit"  IDM
 SG_ RSDS_L_SGU11_Checksum5 : 263|8@0+ (1,0) [0|255] "NoUnit"  IDM
 SG_ RSDS_L_SGU11_RollingCounter4 : 251|4@0+ (1,0) [0|14] "NoUnit"  IDM
 SG_ RSDS_L_HWATargetValidity_21 : 240|1@0+ (1,0) [0|1] "NoUnit"  IDM
 SG_ RSDS_L_ObjRefPoint_21 : 243|3@0+ (1,0) [0|7] "NoUnit"  IDM
 SG_ RSDS_L_ObjRCS_21 : 237|10@0+ (0.125,-50) [-50|70] "dBsm"  IDM
 SG_ RSDS_L_ObjYawrate_21 : 217|12@0+ (0.002,-3.14) [-3.14|5.05] "radPerSec"  IDM
 SG_ RSDS_L_ObjHeading_21 : 213|12@0+ (0.002,-3.14) [-3.14|5.05] "rad"  IDM
 SG_ RSDS_L_ObjLength_21 : 207|10@0+ (0.05,0) [0|20] "m"  IDM
 SG_ RSDS_L_SGU11_Checksum4 : 199|8@0+ (1,0) [0|255] "NoUnit"  IDM
 SG_ RSDS_L_SGU11_RollingCounter3 : 187|4@0+ (1,0) [0|14] "NoUnit"  IDM
 SG_ RSDS_L_ObjMotionDirection_21 : 191|3@0+ (1,0) [0|7] "NoUnit"  IDM
 SG_ RSDS_L_ObjAge_21 : 183|8@0+ (1,0) [0|255] "NoUnit"  IDM
 SG_ RSDS_L_ObjWidth_21 : 161|10@0+ (0.01,0) [0|5] "m"  IDM
 SG_ RSDS_L_ObjRAccelYStd_21 : 167|6@0+ (0.0625,0) [0|3.9375] "MtrPerSecSq"  IDM
 SG_ RSDS_L_ObjRAccelXStd_21 : 157|6@0+ (0.0625,0) [0|3.9375] "MtrPerSecSq"  IDM
 SG_ RSDS_L_ObjRelVelYStd_21 : 147|6@0+ (0.0625,0) [0|3.9375] "mps"  IDM
 SG_ RSDS_L_ObjRelVelXStd_21 : 137|6@0+ (0.0625,0) [0|3.9375] "mps"  IDM
 SG_ RSDS_L_ObjDistYStd_21 : 143|6@0+ (0.1,0) [0|6] "m"  IDM
 SG_ RSDS_L_SGU11_Checksum3 : 135|8@0+ (1,0) [0|255] "NoUnit"  IDM
 SG_ RSDS_L_SGU11_RollingCounter2 : 123|4@0+ (1,0) [0|14] "NoUnit"  IDM
 SG_ RSDS_L_ObjMotionType_21 : 127|3@0+ (1,0) [0|7] "NoUnit"  IDM
 SG_ RSDS_L_ObjMeasured_21 : 113|2@0+ (1,0) [0|3] "NoUnit"  IDM
 SG_ RSDS_L_ObjRelAccelY_21 : 107|10@0+ (0.03125,-16) [-16|15.96875] "MtrPerSecSq"  IDM
 SG_ RSDS_L_ObjRelAccelX_21 : 101|10@0+ (0.03125,-16) [-16|15.96875] "MtrPerSecSq"  IDM
 SG_ RSDS_L_ObjRelVelY_21 : 82|13@0+ (0.0312,-128) [-128|126.9976] "mps"  IDM
 SG_ RSDS_L_ObjRelVelX_21 : 79|13@0+ (0.0312,-128) [-128|126.9976] "mps"  IDM
 SG_ RSDS_L_SGU11_Checksum2 : 71|8@0+ (1,0) [0|255] "NoUnit"  IDM
 SG_ RSDS_L_SGU11_RollingCounter1 : 59|4@0+ (1,0) [0|14] "NoUnit"  IDM
 SG_ RSDS_L_ObjType_21 : 63|4@0+ (1,0) [0|15] "NoUnit"  IDM
 SG_ RSDS_L_ObjDistXStd_21 : 54|6@0+ (0.1,0) [0|6] "m"  IDM
 SG_ RSDS_L_ObjDistY_21 : 33|11@0+ (0.125,-128) [-128|127.875] "m"  IDM
 SG_ RSDS_L_ObjDistX_21 : 29|12@0+ (0.0625,-128) [-128|126.9375] "m"  IDM
 SG_ RSDS_L_ObjObstacleProb_21 : 18|5@0+ (0.03326,0) [0|1.03106] "NoUnit"  IDM
 SG_ RSDS_L_ObjExistProb_21 : 23|5@0+ (0.03326,0) [0|1.03106] "NoUnit"  IDM
 SG_ RSDS_L_ObjID_21 : 15|8@0+ (1,0) [0|255] "NoUnit"  IDM
 SG_ RSDS_L_SGU11_Checksum1 : 7|8@0+ (1,0) [0|255] "NoUnit"  IDM

BO_ 1419 RSDS_L_SGU12: 64 CR_RL
 SG_ RSDS_L_SGU12_RollingCounter8 : 507|4@0+ (1,0) [0|14] "NoUnit"  IDM
 SG_ RSDS_L_SGU12_BlockCounter : 511|4@0+ (1,0) [0|15] "NoUnit"  IDM
 SG_ RSDS_L_HWATargetValidity_24 : 496|1@0+ (1,0) [0|1] "NoUnit"  IDM
 SG_ RSDS_L_ObjRefPoint_24 : 499|3@0+ (1,0) [0|7] "NoUnit"  IDM
 SG_ RSDS_L_ObjRCS_24 : 493|10@0+ (0.125,-50) [-50|70] "dBsm"  IDM
 SG_ RSDS_L_ObjYawrate_24 : 473|12@0+ (0.002,-3.14) [-3.14|5.05] "radPerSec"  IDM
 SG_ RSDS_L_ObjHeading_24 : 469|12@0+ (0.002,-3.14) [-3.14|5.05] "rad"  IDM
 SG_ RSDS_L_ObjLength_24 : 463|10@0+ (0.05,0) [0|20] "m"  IDM
 SG_ RSDS_L_SGU12_Checksum8 : 455|8@0+ (1,0) [0|255] "NoUnit"  IDM
 SG_ RSDS_L_SGU12_RollingCounter7 : 443|4@0+ (1,0) [0|14] "NoUnit"  IDM
 SG_ RSDS_L_ObjMotionDirection_24 : 447|3@0+ (1,0) [0|7] "NoUnit"  IDM
 SG_ RSDS_L_ObjAge_24 : 439|8@0+ (1,0) [0|255] "NoUnit"  IDM
 SG_ RSDS_L_ObjWidth_24 : 417|10@0+ (0.01,0) [0|5] "m"  IDM
 SG_ RSDS_L_ObjRAccelYStd_24 : 423|6@0+ (0.0625,0) [0|3.9375] "MtrPerSecSq"  IDM
 SG_ RSDS_L_ObjRAccelXStd_24 : 413|6@0+ (0.0625,0) [0|3.9375] "MtrPerSecSq"  IDM
 SG_ RSDS_L_ObjRelVelYStd_24 : 403|6@0+ (0.0625,0) [0|3.9375] "mps"  IDM
 SG_ RSDS_L_ObjRelVelXStd_24 : 393|6@0+ (0.0625,0) [0|3.9375] "mps"  IDM
 SG_ RSDS_L_ObjDistYStd_24 : 399|6@0+ (0.1,0) [0|6] "m"  IDM
 SG_ RSDS_L_SGU12_Checksum7 : 391|8@0+ (1,0) [0|255] "NoUnit"  IDM
 SG_ RSDS_L_SGU12_RollingCounter6 : 379|4@0+ (1,0) [0|14] "NoUnit"  IDM
 SG_ RSDS_L_ObjMotionType_24 : 383|3@0+ (1,0) [0|7] "NoUnit"  IDM
 SG_ RSDS_L_ObjMeasured_24 : 369|2@0+ (1,0) [0|3] "NoUnit"  IDM
 SG_ RSDS_L_ObjRelAccelY_24 : 363|10@0+ (0.03125,-16) [-16|15.96875] "MtrPerSecSq"  IDM
 SG_ RSDS_L_ObjRelAccelX_24 : 357|10@0+ (0.03125,-16) [-16|15.96875] "MtrPerSecSq"  IDM
 SG_ RSDS_L_ObjRelVelY_24 : 338|13@0+ (0.0312,-128) [-128|126.9976] "mps"  IDM
 SG_ RSDS_L_ObjRelVelX_24 : 335|13@0+ (0.0312,-128) [-128|126.9976] "mps"  IDM
 SG_ RSDS_L_SGU12_Checksum6 : 327|8@0+ (1,0) [0|255] "NoUnit"  IDM
 SG_ RSDS_L_SGU12_RollingCounter5 : 315|4@0+ (1,0) [0|14] "NoUnit"  IDM
 SG_ RSDS_L_ObjType_24 : 319|4@0+ (1,0) [0|15] "NoUnit"  IDM
 SG_ RSDS_L_ObjDistXStd_24 : 310|6@0+ (0.1,0) [0|6] "m"  IDM
 SG_ RSDS_L_ObjDistY_24 : 289|11@0+ (0.125,-128) [-128|127.875] "m"  IDM
 SG_ RSDS_L_ObjDistX_24 : 285|12@0+ (0.0625,-128) [-128|126.9375] "m"  IDM
 SG_ RSDS_L_ObjObstacleProb_24 : 274|5@0+ (0.03326,0) [0|1.03106] "NoUnit"  IDM
 SG_ RSDS_L_ObjExistProb_24 : 279|5@0+ (0.03326,0) [0|1.03106] "NoUnit"  IDM
 SG_ RSDS_L_ObjID_24 : 271|8@0+ (1,0) [0|255] "NoUnit"  IDM
 SG_ RSDS_L_SGU12_Checksum5 : 263|8@0+ (1,0) [0|255] "NoUnit"  IDM
 SG_ RSDS_L_SGU12_RollingCounter4 : 251|4@0+ (1,0) [0|14] "NoUnit"  IDM
 SG_ RSDS_L_HWATargetValidity_23 : 240|1@0+ (1,0) [0|1] "NoUnit"  IDM
 SG_ RSDS_L_ObjRefPoint_23 : 243|3@0+ (1,0) [0|7] "NoUnit"  IDM
 SG_ RSDS_L_ObjRCS_23 : 237|10@0+ (0.125,-50) [-50|70] "dBsm"  IDM
 SG_ RSDS_L_ObjYawrate_23 : 217|12@0+ (0.002,-3.14) [-3.14|5.05] "radPerSec"  IDM
 SG_ RSDS_L_ObjHeading_23 : 213|12@0+ (0.002,-3.14) [-3.14|5.05] "rad"  IDM
 SG_ RSDS_L_ObjLength_23 : 207|10@0+ (0.05,0) [0|20] "m"  IDM
 SG_ RSDS_L_SGU12_Checksum4 : 199|8@0+ (1,0) [0|255] "NoUnit"  IDM
 SG_ RSDS_L_SGU12_RollingCounter3 : 187|4@0+ (1,0) [0|14] "NoUnit"  IDM
 SG_ RSDS_L_ObjMotionDirection_23 : 191|3@0+ (1,0) [0|7] "NoUnit"  IDM
 SG_ RSDS_L_ObjAge_23 : 183|8@0+ (1,0) [0|255] "NoUnit"  IDM
 SG_ RSDS_L_ObjWidth_23 : 161|10@0+ (0.01,0) [0|5] "m"  IDM
 SG_ RSDS_L_ObjRAccelYStd_23 : 167|6@0+ (0.0625,0) [0|3.9375] "MtrPerSecSq"  IDM
 SG_ RSDS_L_ObjRAccelXStd_23 : 157|6@0+ (0.0625,0) [0|3.9375] "MtrPerSecSq"  IDM
 SG_ RSDS_L_ObjRelVelYStd_23 : 147|6@0+ (0.0625,0) [0|3.9375] "mps"  IDM
 SG_ RSDS_L_ObjRelVelXStd_23 : 137|6@0+ (0.0625,0) [0|3.9375] "mps"  IDM
 SG_ RSDS_L_ObjDistYStd_23 : 143|6@0+ (0.1,0) [0|6] "m"  IDM
 SG_ RSDS_L_SGU12_Checksum3 : 135|8@0+ (1,0) [0|255] "NoUnit"  IDM
 SG_ RSDS_L_SGU12_RollingCounter2 : 123|4@0+ (1,0) [0|14] "NoUnit"  IDM
 SG_ RSDS_L_ObjMotionType_23 : 127|3@0+ (1,0) [0|7] "NoUnit"  IDM
 SG_ RSDS_L_ObjMeasured_23 : 113|2@0+ (1,0) [0|3] "NoUnit"  IDM
 SG_ RSDS_L_ObjRelAccelY_23 : 107|10@0+ (0.03125,-16) [-16|15.96875] "MtrPerSecSq"  IDM
 SG_ RSDS_L_ObjRelAccelX_23 : 101|10@0+ (0.03125,-16) [-16|15.96875] "MtrPerSecSq"  IDM
 SG_ RSDS_L_ObjRelVelY_23 : 82|13@0+ (0.0312,-128) [-128|126.9976] "mps"  IDM
 SG_ RSDS_L_ObjRelVelX_23 : 79|13@0+ (0.0312,-128) [-128|126.9976] "mps"  IDM
 SG_ RSDS_L_SGU12_Checksum2 : 71|8@0+ (1,0) [0|255] "NoUnit"  IDM
 SG_ RSDS_L_SGU12_RollingCounter1 : 59|4@0+ (1,0) [0|14] "NoUnit"  IDM
 SG_ RSDS_L_ObjType_23 : 63|4@0+ (1,0) [0|15] "NoUnit"  IDM
 SG_ RSDS_L_ObjDistXStd_23 : 54|6@0+ (0.1,0) [0|6] "m"  IDM
 SG_ RSDS_L_ObjDistY_23 : 33|11@0+ (0.125,-128) [-128|127.875] "m"  IDM
 SG_ RSDS_L_ObjDistX_23 : 29|12@0+ (0.0625,-128) [-128|126.9375] "m"  IDM
 SG_ RSDS_L_ObjObstacleProb_23 : 18|5@0+ (0.03326,0) [0|1.03106] "NoUnit"  IDM
 SG_ RSDS_L_ObjExistProb_23 : 23|5@0+ (0.03326,0) [0|1.03106] "NoUnit"  IDM
 SG_ RSDS_L_ObjID_23 : 15|8@0+ (1,0) [0|255] "NoUnit"  IDM
 SG_ RSDS_L_SGU12_Checksum1 : 7|8@0+ (1,0) [0|255] "NoUnit"  IDM

BO_ 1420 RSDS_L_SGU13: 64 CR_RL
 SG_ RSDS_L_SGU13_RollingCounter8 : 507|4@0+ (1,0) [0|14] "NoUnit"  IDM
 SG_ RSDS_L_SGU13_BlockCounter : 511|4@0+ (1,0) [0|15] "NoUnit"  IDM
 SG_ RSDS_L_HWATargetValidity_26 : 496|1@0+ (1,0) [0|1] "NoUnit"  IDM
 SG_ RSDS_L_ObjRefPoint_26 : 499|3@0+ (1,0) [0|7] "NoUnit"  IDM
 SG_ RSDS_L_ObjRCS_26 : 493|10@0+ (0.125,-50) [-50|70] "dBsm"  IDM
 SG_ RSDS_L_ObjYawrate_26 : 473|12@0+ (0.002,-3.14) [-3.14|5.05] "radPerSec"  IDM
 SG_ RSDS_L_ObjHeading_26 : 469|12@0+ (0.002,-3.14) [-3.14|5.05] "rad"  IDM
 SG_ RSDS_L_ObjLength_26 : 463|10@0+ (0.05,0) [0|20] "m"  IDM
 SG_ RSDS_L_SGU13_Checksum8 : 455|8@0+ (1,0) [0|255] "NoUnit"  IDM
 SG_ RSDS_L_SGU13_RollingCounter7 : 443|4@0+ (1,0) [0|14] "NoUnit"  IDM
 SG_ RSDS_L_ObjMotionDirection_26 : 447|3@0+ (1,0) [0|7] "NoUnit"  IDM
 SG_ RSDS_L_ObjAge_26 : 439|8@0+ (1,0) [0|255] "NoUnit"  IDM
 SG_ RSDS_L_ObjWidth_26 : 417|10@0+ (0.01,0) [0|5] "m"  IDM
 SG_ RSDS_L_ObjRAccelYStd_26 : 423|6@0+ (0.0625,0) [0|3.9375] "MtrPerSecSq"  IDM
 SG_ RSDS_L_ObjRAccelXStd_26 : 413|6@0+ (0.0625,0) [0|3.9375] "MtrPerSecSq"  IDM
 SG_ RSDS_L_ObjRelVelYStd_26 : 403|6@0+ (0.0625,0) [0|3.9375] "mps"  IDM
 SG_ RSDS_L_ObjRelVelXStd_26 : 393|6@0+ (0.0625,0) [0|3.9375] "mps"  IDM
 SG_ RSDS_L_ObjDistYStd_26 : 399|6@0+ (0.1,0) [0|6] "m"  IDM
 SG_ RSDS_L_SGU13_Checksum7 : 391|8@0+ (1,0) [0|255] "NoUnit"  IDM
 SG_ RSDS_L_SGU13_RollingCounter6 : 379|4@0+ (1,0) [0|14] "NoUnit"  IDM
 SG_ RSDS_L_ObjMotionType_26 : 383|3@0+ (1,0) [0|7] "NoUnit"  IDM
 SG_ RSDS_L_ObjMeasured_26 : 369|2@0+ (1,0) [0|3] "NoUnit"  IDM
 SG_ RSDS_L_ObjRelAccelY_26 : 363|10@0+ (0.03125,-16) [-16|15.96875] "MtrPerSecSq"  IDM
 SG_ RSDS_L_ObjRelAccelX_26 : 357|10@0+ (0.03125,-16) [-16|15.96875] "MtrPerSecSq"  IDM
 SG_ RSDS_L_ObjRelVelY_26 : 338|13@0+ (0.0312,-128) [-128|126.9976] "mps"  IDM
 SG_ RSDS_L_ObjRelVelX_26 : 335|13@0+ (0.0312,-128) [-128|126.9976] "mps"  IDM
 SG_ RSDS_L_SGU13_Checksum6 : 327|8@0+ (1,0) [0|255] "NoUnit"  IDM
 SG_ RSDS_L_SGU13_RollingCounter5 : 315|4@0+ (1,0) [0|14] "NoUnit"  IDM
 SG_ RSDS_L_ObjType_26 : 319|4@0+ (1,0) [0|15] "NoUnit"  IDM
 SG_ RSDS_L_ObjDistXStd_26 : 310|6@0+ (0.1,0) [0|6] "m"  IDM
 SG_ RSDS_L_ObjDistY_26 : 289|11@0+ (0.125,-128) [-128|127.875] "m"  IDM
 SG_ RSDS_L_ObjDistX_26 : 285|12@0+ (0.0625,-128) [-128|126.9375] "m"  IDM
 SG_ RSDS_L_ObjObstacleProb_26 : 274|5@0+ (0.03326,0) [0|1.03106] "NoUnit"  IDM
 SG_ RSDS_L_ObjExistProb_26 : 279|5@0+ (0.03326,0) [0|1.03106] "NoUnit"  IDM
 SG_ RSDS_L_ObjID_26 : 271|8@0+ (1,0) [0|255] "NoUnit"  IDM
 SG_ RSDS_L_SGU13_Checksum5 : 263|8@0+ (1,0) [0|255] "NoUnit"  IDM
 SG_ RSDS_L_SGU13_RollingCounter4 : 251|4@0+ (1,0) [0|14] "NoUnit"  IDM
 SG_ RSDS_L_HWATargetValidity_25 : 240|1@0+ (1,0) [0|1] "NoUnit"  IDM
 SG_ RSDS_L_ObjRefPoint_25 : 243|3@0+ (1,0) [0|7] "NoUnit"  IDM
 SG_ RSDS_L_ObjRCS_25 : 237|10@0+ (0.125,-50) [-50|70] "dBsm"  IDM
 SG_ RSDS_L_ObjYawrate_25 : 217|12@0+ (0.002,-3.14) [-3.14|5.05] "radPerSec"  IDM
 SG_ RSDS_L_ObjHeading_25 : 213|12@0+ (0.002,-3.14) [-3.14|5.05] "rad"  IDM
 SG_ RSDS_L_ObjLength_25 : 207|10@0+ (0.05,0) [0|20] "m"  IDM
 SG_ RSDS_L_SGU13_Checksum4 : 199|8@0+ (1,0) [0|255] "NoUnit"  IDM
 SG_ RSDS_L_SGU13_RollingCounter3 : 187|4@0+ (1,0) [0|14] "NoUnit"  IDM
 SG_ RSDS_L_ObjMotionDirection_25 : 191|3@0+ (1,0) [0|7] "NoUnit"  IDM
 SG_ RSDS_L_ObjAge_25 : 183|8@0+ (1,0) [0|255] "NoUnit"  IDM
 SG_ RSDS_L_ObjWidth_25 : 161|10@0+ (0.01,0) [0|5] "m"  IDM
 SG_ RSDS_L_ObjRAccelYStd_25 : 167|6@0+ (0.0625,0) [0|3.9375] "MtrPerSecSq"  IDM
 SG_ RSDS_L_ObjRAccelXStd_25 : 157|6@0+ (0.0625,0) [0|3.9375] "MtrPerSecSq"  IDM
 SG_ RSDS_L_ObjRelVelYStd_25 : 147|6@0+ (0.0625,0) [0|3.9375] "mps"  IDM
 SG_ RSDS_L_ObjRelVelXStd_25 : 137|6@0+ (0.0625,0) [0|3.9375] "mps"  IDM
 SG_ RSDS_L_ObjDistYStd_25 : 143|6@0+ (0.1,0) [0|6] "m"  IDM
 SG_ RSDS_L_SGU13_Checksum3 : 135|8@0+ (1,0) [0|255] "NoUnit"  IDM
 SG_ RSDS_L_SGU13_RollingCounter2 : 123|4@0+ (1,0) [0|14] "NoUnit"  IDM
 SG_ RSDS_L_ObjMotionType_25 : 127|3@0+ (1,0) [0|7] "NoUnit"  IDM
 SG_ RSDS_L_ObjMeasured_25 : 113|2@0+ (1,0) [0|3] "NoUnit"  IDM
 SG_ RSDS_L_ObjRelAccelY_25 : 107|10@0+ (0.03125,-16) [-16|15.96875] "MtrPerSecSq"  IDM
 SG_ RSDS_L_ObjRelAccelX_25 : 101|10@0+ (0.03125,-16) [-16|15.96875] "MtrPerSecSq"  IDM
 SG_ RSDS_L_ObjRelVelY_25 : 82|13@0+ (0.0312,-128) [-128|126.9976] "mps"  IDM
 SG_ RSDS_L_ObjRelVelX_25 : 79|13@0+ (0.0312,-128) [-128|126.9976] "mps"  IDM
 SG_ RSDS_L_SGU13_Checksum2 : 71|8@0+ (1,0) [0|255] "NoUnit"  IDM
 SG_ RSDS_L_SGU13_RollingCounter1 : 59|4@0+ (1,0) [0|14] "NoUnit"  IDM
 SG_ RSDS_L_ObjType_25 : 63|4@0+ (1,0) [0|15] "NoUnit"  IDM
 SG_ RSDS_L_ObjDistXStd_25 : 54|6@0+ (0.1,0) [0|6] "m"  IDM
 SG_ RSDS_L_ObjDistY_25 : 33|11@0+ (0.125,-128) [-128|127.875] "m"  IDM
 SG_ RSDS_L_ObjDistX_25 : 29|12@0+ (0.0625,-128) [-128|126.9375] "m"  IDM
 SG_ RSDS_L_ObjObstacleProb_25 : 18|5@0+ (0.03326,0) [0|1.03106] "NoUnit"  IDM
 SG_ RSDS_L_ObjExistProb_25 : 23|5@0+ (0.03326,0) [0|1.03106] "NoUnit"  IDM
 SG_ RSDS_L_ObjID_25 : 15|8@0+ (1,0) [0|255] "NoUnit"  IDM
 SG_ RSDS_L_SGU13_Checksum1 : 7|8@0+ (1,0) [0|255] "NoUnit"  IDM

BO_ 1421 RSDS_L_SGU14: 64 CR_RL
 SG_ RSDS_L_SGU14_RollingCounter8 : 507|4@0+ (1,0) [0|14] "NoUnit"  IDM
 SG_ RSDS_L_SGU14_BlockCounter : 511|4@0+ (1,0) [0|15] "NoUnit"  IDM
 SG_ RSDS_L_HWATargetValidity_28 : 496|1@0+ (1,0) [0|1] "NoUnit"  IDM
 SG_ RSDS_L_ObjRefPoint_28 : 499|3@0+ (1,0) [0|7] "NoUnit"  IDM
 SG_ RSDS_L_ObjRCS_28 : 493|10@0+ (0.125,-50) [-50|70] "dBsm"  IDM
 SG_ RSDS_L_ObjYawrate_28 : 473|12@0+ (0.002,-3.14) [-3.14|5.05] "radPerSec"  IDM
 SG_ RSDS_L_ObjHeading_28 : 469|12@0+ (0.002,-3.14) [-3.14|5.05] "rad"  IDM
 SG_ RSDS_L_ObjLength_28 : 463|10@0+ (0.05,0) [0|20] "m"  IDM
 SG_ RSDS_L_SGU14_Checksum8 : 455|8@0+ (1,0) [0|255] "NoUnit"  IDM
 SG_ RSDS_L_SGU14_RollingCounter7 : 443|4@0+ (1,0) [0|14] "NoUnit"  IDM
 SG_ RSDS_L_ObjMotionDirection_28 : 447|3@0+ (1,0) [0|7] "NoUnit"  IDM
 SG_ RSDS_L_ObjAge_28 : 439|8@0+ (1,0) [0|255] "NoUnit"  IDM
 SG_ RSDS_L_ObjWidth_28 : 417|10@0+ (0.01,0) [0|5] "m"  IDM
 SG_ RSDS_L_ObjRAccelYStd_28 : 423|6@0+ (0.0625,0) [0|3.9375] "MtrPerSecSq"  IDM
 SG_ RSDS_L_ObjRAccelXStd_28 : 413|6@0+ (0.0625,0) [0|3.9375] "MtrPerSecSq"  IDM
 SG_ RSDS_L_ObjRelVelYStd_28 : 403|6@0+ (0.0625,0) [0|3.9375] "mps"  IDM
 SG_ RSDS_L_ObjRelVelXStd_28 : 393|6@0+ (0.0625,0) [0|3.9375] "mps"  IDM
 SG_ RSDS_L_ObjDistYStd_28 : 399|6@0+ (0.1,0) [0|6] "m"  IDM
 SG_ RSDS_L_SGU14_Checksum7 : 391|8@0+ (1,0) [0|255] "NoUnit"  IDM
 SG_ RSDS_L_SGU14_RollingCounter6 : 379|4@0+ (1,0) [0|14] "NoUnit"  IDM
 SG_ RSDS_L_ObjMotionType_28 : 383|3@0+ (1,0) [0|7] "NoUnit"  IDM
 SG_ RSDS_L_ObjMeasured_28 : 369|2@0+ (1,0) [0|3] "NoUnit"  IDM
 SG_ RSDS_L_ObjRelAccelY_28 : 363|10@0+ (0.03125,-16) [-16|15.96875] "MtrPerSecSq"  IDM
 SG_ RSDS_L_ObjRelAccelX_28 : 357|10@0+ (0.03125,-16) [-16|15.96875] "MtrPerSecSq"  IDM
 SG_ RSDS_L_ObjRelVelY_28 : 338|13@0+ (0.0312,-128) [-128|126.9976] "mps"  IDM
 SG_ RSDS_L_ObjRelVelX_28 : 335|13@0+ (0.0312,-128) [-128|126.9976] "mps"  IDM
 SG_ RSDS_L_SGU14_Checksum6 : 327|8@0+ (1,0) [0|255] "NoUnit"  IDM
 SG_ RSDS_L_SGU14_RollingCounter5 : 315|4@0+ (1,0) [0|14] "NoUnit"  IDM
 SG_ RSDS_L_ObjType_28 : 319|4@0+ (1,0) [0|15] "NoUnit"  IDM
 SG_ RSDS_L_ObjDistXStd_28 : 310|6@0+ (0.1,0) [0|6] "m"  IDM
 SG_ RSDS_L_ObjDistY_28 : 289|11@0+ (0.125,-128) [-128|127.875] "m"  IDM
 SG_ RSDS_L_ObjDistX_28 : 285|12@0+ (0.0625,-128) [-128|126.9375] "m"  IDM
 SG_ RSDS_L_ObjObstacleProb_28 : 274|5@0+ (0.03326,0) [0|1.03106] "NoUnit"  IDM
 SG_ RSDS_L_ObjExistProb_28 : 279|5@0+ (0.03326,0) [0|1.03106] "NoUnit"  IDM
 SG_ RSDS_L_ObjID_28 : 271|8@0+ (1,0) [0|255] "NoUnit"  IDM
 SG_ RSDS_L_SGU14_Checksum5 : 263|8@0+ (1,0) [0|255] "NoUnit"  IDM
 SG_ RSDS_L_SGU14_RollingCounter4 : 251|4@0+ (1,0) [0|14] "NoUnit"  IDM
 SG_ RSDS_L_HWATargetValidity_27 : 240|1@0+ (1,0) [0|1] "NoUnit"  IDM
 SG_ RSDS_L_ObjRefPoint_27 : 243|3@0+ (1,0) [0|7] "NoUnit"  IDM
 SG_ RSDS_L_ObjRCS_27 : 237|10@0+ (0.125,-50) [-50|70] "dBsm"  IDM
 SG_ RSDS_L_ObjYawrate_27 : 217|12@0+ (0.002,-3.14) [-3.14|5.05] "radPerSec"  IDM
 SG_ RSDS_L_ObjHeading_27 : 213|12@0+ (0.002,-3.14) [-3.14|5.05] "rad"  IDM
 SG_ RSDS_L_ObjLength_27 : 207|10@0+ (0.05,0) [0|20] "m"  IDM
 SG_ RSDS_L_SGU14_Checksum4 : 199|8@0+ (1,0) [0|255] "NoUnit"  IDM
 SG_ RSDS_L_SGU14_RollingCounter3 : 187|4@0+ (1,0) [0|14] "NoUnit"  IDM
 SG_ RSDS_L_ObjMotionDirection_27 : 191|3@0+ (1,0) [0|7] "NoUnit"  IDM
 SG_ RSDS_L_ObjAge_27 : 183|8@0+ (1,0) [0|255] "NoUnit"  IDM
 SG_ RSDS_L_ObjWidth_27 : 161|10@0+ (0.01,0) [0|5] "m"  IDM
 SG_ RSDS_L_ObjRAccelYStd_27 : 167|6@0+ (0.0625,0) [0|3.9375] "MtrPerSecSq"  IDM
 SG_ RSDS_L_ObjRAccelXStd_27 : 157|6@0+ (0.0625,0) [0|3.9375] "MtrPerSecSq"  IDM
 SG_ RSDS_L_ObjRelVelYStd_27 : 147|6@0+ (0.0625,0) [0|3.9375] "mps"  IDM
 SG_ RSDS_L_ObjRelVelXStd_27 : 137|6@0+ (0.0625,0) [0|3.9375] "mps"  IDM
 SG_ RSDS_L_ObjDistYStd_27 : 143|6@0+ (0.1,0) [0|6] "m"  IDM
 SG_ RSDS_L_SGU14_Checksum3 : 135|8@0+ (1,0) [0|255] "NoUnit"  IDM
 SG_ RSDS_L_SGU14_RollingCounter2 : 123|4@0+ (1,0) [0|14] "NoUnit"  IDM
 SG_ RSDS_L_ObjMotionType_27 : 127|3@0+ (1,0) [0|7] "NoUnit"  IDM
 SG_ RSDS_L_ObjMeasured_27 : 113|2@0+ (1,0) [0|3] "NoUnit"  IDM
 SG_ RSDS_L_ObjRelAccelY_27 : 107|10@0+ (0.03125,-16) [-16|15.96875] "MtrPerSecSq"  IDM
 SG_ RSDS_L_ObjRelAccelX_27 : 101|10@0+ (0.03125,-16) [-16|15.96875] "MtrPerSecSq"  IDM
 SG_ RSDS_L_ObjRelVelY_27 : 82|13@0+ (0.0312,-128) [-128|126.9976] "mps"  IDM
 SG_ RSDS_L_ObjRelVelX_27 : 79|13@0+ (0.0312,-128) [-128|126.9976] "mps"  IDM
 SG_ RSDS_L_SGU14_Checksum2 : 71|8@0+ (1,0) [0|255] "NoUnit"  IDM
 SG_ RSDS_L_SGU14_RollingCounter1 : 59|4@0+ (1,0) [0|14] "NoUnit"  IDM
 SG_ RSDS_L_ObjType_27 : 63|4@0+ (1,0) [0|15] "NoUnit"  IDM
 SG_ RSDS_L_ObjDistXStd_27 : 54|6@0+ (0.1,0) [0|6] "m"  IDM
 SG_ RSDS_L_ObjDistY_27 : 33|11@0+ (0.125,-128) [-128|127.875] "m"  IDM
 SG_ RSDS_L_ObjDistX_27 : 29|12@0+ (0.0625,-128) [-128|126.9375] "m"  IDM
 SG_ RSDS_L_ObjObstacleProb_27 : 18|5@0+ (0.03326,0) [0|1.03106] "NoUnit"  IDM
 SG_ RSDS_L_ObjExistProb_27 : 23|5@0+ (0.03326,0) [0|1.03106] "NoUnit"  IDM
 SG_ RSDS_L_ObjID_27 : 15|8@0+ (1,0) [0|255] "NoUnit"  IDM
 SG_ RSDS_L_SGU14_Checksum1 : 7|8@0+ (1,0) [0|255] "NoUnit"  IDM

BO_ 1422 RSDS_L_SGU15: 64 CR_RL
 SG_ RSDS_L_SGU15_RollingCounter8 : 507|4@0+ (1,0) [0|14] "NoUnit"  IDM
 SG_ RSDS_L_SGU15_BlockCounter : 511|4@0+ (1,0) [0|15] "NoUnit"  IDM
 SG_ RSDS_L_HWATargetValidity_30 : 496|1@0+ (1,0) [0|1] "NoUnit"  IDM
 SG_ RSDS_L_ObjRefPoint_30 : 499|3@0+ (1,0) [0|7] "NoUnit"  IDM
 SG_ RSDS_L_ObjRCS_30 : 493|10@0+ (0.125,-50) [-50|70] "dBsm"  IDM
 SG_ RSDS_L_ObjYawrate_30 : 473|12@0+ (0.002,-3.14) [-3.14|5.05] "radPerSec"  IDM
 SG_ RSDS_L_ObjHeading_30 : 469|12@0+ (0.002,-3.14) [-3.14|5.05] "rad"  IDM
 SG_ RSDS_L_ObjLength_30 : 463|10@0+ (0.05,0) [0|20] "m"  IDM
 SG_ RSDS_L_SGU15_Checksum8 : 455|8@0+ (1,0) [0|255] "NoUnit"  IDM
 SG_ RSDS_L_SGU15_RollingCounter7 : 443|4@0+ (1,0) [0|14] "NoUnit"  IDM
 SG_ RSDS_L_ObjMotionDirection_30 : 447|3@0+ (1,0) [0|7] "NoUnit"  IDM
 SG_ RSDS_L_ObjAge_30 : 439|8@0+ (1,0) [0|255] "NoUnit"  IDM
 SG_ RSDS_L_ObjWidth_30 : 417|10@0+ (0.01,0) [0|5] "m"  IDM
 SG_ RSDS_L_ObjRAccelYStd_30 : 423|6@0+ (0.0625,0) [0|3.9375] "MtrPerSecSq"  IDM
 SG_ RSDS_L_ObjRAccelXStd_30 : 413|6@0+ (0.0625,0) [0|3.9375] "MtrPerSecSq"  IDM
 SG_ RSDS_L_ObjRelVelYStd_30 : 403|6@0+ (0.0625,0) [0|3.9375] "mps"  IDM
 SG_ RSDS_L_ObjRelVelXStd_30 : 393|6@0+ (0.0625,0) [0|3.9375] "mps"  IDM
 SG_ RSDS_L_ObjDistYStd_30 : 399|6@0+ (0.1,0) [0|6] "m"  IDM
 SG_ RSDS_L_SGU15_Checksum7 : 391|8@0+ (1,0) [0|255] "NoUnit"  IDM
 SG_ RSDS_L_SGU15_RollingCounter6 : 379|4@0+ (1,0) [0|14] "NoUnit"  IDM
 SG_ RSDS_L_ObjMotionType_30 : 383|3@0+ (1,0) [0|7] "NoUnit"  IDM
 SG_ RSDS_L_ObjMeasured_30 : 369|2@0+ (1,0) [0|3] "NoUnit"  IDM
 SG_ RSDS_L_ObjRelAccelY_30 : 363|10@0+ (0.03125,-16) [-16|15.96875] "MtrPerSecSq"  IDM
 SG_ RSDS_L_ObjRelAccelX_30 : 357|10@0+ (0.03125,-16) [-16|15.96875] "MtrPerSecSq"  IDM
 SG_ RSDS_L_ObjRelVelY_30 : 338|13@0+ (0.0312,-128) [-128|126.9976] "mps"  IDM
 SG_ RSDS_L_ObjRelVelX_30 : 335|13@0+ (0.0312,-128) [-128|126.9976] "mps"  IDM
 SG_ RSDS_L_SGU15_Checksum6 : 327|8@0+ (1,0) [0|255] "NoUnit"  IDM
 SG_ RSDS_L_SGU15_RollingCounter5 : 315|4@0+ (1,0) [0|14] "NoUnit"  IDM
 SG_ RSDS_L_ObjType_30 : 319|4@0+ (1,0) [0|15] "NoUnit"  IDM
 SG_ RSDS_L_ObjDistXStd_30 : 310|6@0+ (0.1,0) [0|6] "m"  IDM
 SG_ RSDS_L_ObjDistY_30 : 289|11@0+ (0.125,-128) [-128|127.875] "m"  IDM
 SG_ RSDS_L_ObjDistX_30 : 285|12@0+ (0.0625,-128) [-128|126.9375] "m"  IDM
 SG_ RSDS_L_ObjObstacleProb_30 : 274|5@0+ (0.03326,0) [0|1.03106] "NoUnit"  IDM
 SG_ RSDS_L_ObjExistProb_30 : 279|5@0+ (0.03326,0) [0|1.03106] "NoUnit"  IDM
 SG_ RSDS_L_ObjID_30 : 271|8@0+ (1,0) [0|255] "NoUnit"  IDM
 SG_ RSDS_L_SGU15_Checksum5 : 263|8@0+ (1,0) [0|255] "NoUnit"  IDM
 SG_ RSDS_L_SGU15_RollingCounter4 : 251|4@0+ (1,0) [0|14] "NoUnit"  IDM
 SG_ RSDS_L_HWATargetValidity_29 : 240|1@0+ (1,0) [0|1] "NoUnit"  IDM
 SG_ RSDS_L_ObjRefPoint_29 : 243|3@0+ (1,0) [0|7] "NoUnit"  IDM
 SG_ RSDS_L_ObjRCS_29 : 237|10@0+ (0.125,-50) [-50|70] "dBsm"  IDM
 SG_ RSDS_L_ObjYawrate_29 : 217|12@0+ (0.002,-3.14) [-3.14|5.05] "radPerSec"  IDM
 SG_ RSDS_L_ObjHeading_29 : 213|12@0+ (0.002,-3.14) [-3.14|5.05] "rad"  IDM
 SG_ RSDS_L_ObjLength_29 : 207|10@0+ (0.05,0) [0|20] "m"  IDM
 SG_ RSDS_L_SGU15_Checksum4 : 199|8@0+ (1,0) [0|255] "NoUnit"  IDM
 SG_ RSDS_L_SGU15_RollingCounter3 : 187|4@0+ (1,0) [0|14] "NoUnit"  IDM
 SG_ RSDS_L_ObjMotionDirection_29 : 191|3@0+ (1,0) [0|7] "NoUnit"  IDM
 SG_ RSDS_L_ObjAge_29 : 183|8@0+ (1,0) [0|255] "NoUnit"  IDM
 SG_ RSDS_L_ObjWidth_29 : 161|10@0+ (0.01,0) [0|5] "m"  IDM
 SG_ RSDS_L_ObjRAccelYStd_29 : 167|6@0+ (0.0625,0) [0|3.9375] "MtrPerSecSq"  IDM
 SG_ RSDS_L_ObjRAccelXStd_29 : 157|6@0+ (0.0625,0) [0|3.9375] "MtrPerSecSq"  IDM
 SG_ RSDS_L_ObjRelVelYStd_29 : 147|6@0+ (0.0625,0) [0|3.9375] "mps"  IDM
 SG_ RSDS_L_ObjRelVelXStd_29 : 137|6@0+ (0.0625,0) [0|3.9375] "mps"  IDM
 SG_ RSDS_L_ObjDistYStd_29 : 143|6@0+ (0.1,0) [0|6] "m"  IDM
 SG_ RSDS_L_SGU15_Checksum3 : 135|8@0+ (1,0) [0|255] "NoUnit"  IDM
 SG_ RSDS_L_SGU15_RollingCounter2 : 123|4@0+ (1,0) [0|14] "NoUnit"  IDM
 SG_ RSDS_L_ObjMotionType_29 : 127|3@0+ (1,0) [0|7] "NoUnit"  IDM
 SG_ RSDS_L_ObjMeasured_29 : 113|2@0+ (1,0) [0|3] "NoUnit"  IDM
 SG_ RSDS_L_ObjRelAccelY_29 : 107|10@0+ (0.03125,-16) [-16|15.96875] "MtrPerSecSq"  IDM
 SG_ RSDS_L_ObjRelAccelX_29 : 101|10@0+ (0.03125,-16) [-16|15.96875] "MtrPerSecSq"  IDM
 SG_ RSDS_L_ObjRelVelY_29 : 82|13@0+ (0.0312,-128) [-128|126.9976] "mps"  IDM
 SG_ RSDS_L_ObjRelVelX_29 : 79|13@0+ (0.0312,-128) [-128|126.9976] "mps"  IDM
 SG_ RSDS_L_SGU15_Checksum2 : 71|8@0+ (1,0) [0|255] "NoUnit"  IDM
 SG_ RSDS_L_SGU15_RollingCounter1 : 59|4@0+ (1,0) [0|14] "NoUnit"  IDM
 SG_ RSDS_L_ObjType_29 : 63|4@0+ (1,0) [0|15] "NoUnit"  IDM
 SG_ RSDS_L_ObjDistXStd_29 : 54|6@0+ (0.1,0) [0|6] "m"  IDM
 SG_ RSDS_L_ObjDistY_29 : 33|11@0+ (0.125,-128) [-128|127.875] "m"  IDM
 SG_ RSDS_L_ObjDistX_29 : 29|12@0+ (0.0625,-128) [-128|126.9375] "m"  IDM
 SG_ RSDS_L_ObjObstacleProb_29 : 18|5@0+ (0.03326,0) [0|1.03106] "NoUnit"  IDM
 SG_ RSDS_L_ObjExistProb_29 : 23|5@0+ (0.03326,0) [0|1.03106] "NoUnit"  IDM
 SG_ RSDS_L_ObjID_29 : 15|8@0+ (1,0) [0|255] "NoUnit"  IDM
 SG_ RSDS_L_SGU15_Checksum1 : 7|8@0+ (1,0) [0|255] "NoUnit"  IDM

BO_ 1423 RSDS_L_SGU16: 64 CR_RL
 SG_ RSDS_L_SGU16_RollingCounter8 : 507|4@0+ (1,0) [0|14] "NoUnit"  IDM
 SG_ RSDS_L_SGU16_BlockCounter : 511|4@0+ (1,0) [0|15] "NoUnit"  IDM
 SG_ RSDS_L_HWATargetValidity_32 : 496|1@0+ (1,0) [0|1] "NoUnit"  IDM
 SG_ RSDS_L_ObjRefPoint_32 : 499|3@0+ (1,0) [0|7] "NoUnit"  IDM
 SG_ RSDS_L_ObjRCS_32 : 493|10@0+ (0.125,-50) [-50|70] "dBsm"  IDM
 SG_ RSDS_L_ObjYawrate_32 : 473|12@0+ (0.002,-3.14) [-3.14|5.05] "radPerSec"  IDM
 SG_ RSDS_L_ObjHeading_32 : 469|12@0+ (0.002,-3.14) [-3.14|5.05] "rad"  IDM
 SG_ RSDS_L_ObjLength_32 : 463|10@0+ (0.05,0) [0|20] "m"  IDM
 SG_ RSDS_L_SGU16_Checksum8 : 455|8@0+ (1,0) [0|255] "NoUnit"  IDM
 SG_ RSDS_L_SGU16_RollingCounter7 : 443|4@0+ (1,0) [0|14] "NoUnit"  IDM
 SG_ RSDS_L_ObjMotionDirection_32 : 447|3@0+ (1,0) [0|7] "NoUnit"  IDM
 SG_ RSDS_L_ObjAge_32 : 439|8@0+ (1,0) [0|255] "NoUnit"  IDM
 SG_ RSDS_L_ObjWidth_32 : 417|10@0+ (0.01,0) [0|5] "m"  IDM
 SG_ RSDS_L_ObjRAccelYStd_32 : 423|6@0+ (0.0625,0) [0|3.9375] "MtrPerSecSq"  IDM
 SG_ RSDS_L_ObjRAccelXStd_32 : 413|6@0+ (0.0625,0) [0|3.9375] "MtrPerSecSq"  IDM
 SG_ RSDS_L_ObjRelVelYStd_32 : 403|6@0+ (0.0625,0) [0|3.9375] "mps"  IDM
 SG_ RSDS_L_ObjRelVelXStd_32 : 393|6@0+ (0.0625,0) [0|3.9375] "mps"  IDM
 SG_ RSDS_L_ObjDistYStd_32 : 399|6@0+ (0.1,0) [0|6] "m"  IDM
 SG_ RSDS_L_SGU16_Checksum7 : 391|8@0+ (1,0) [0|255] "NoUnit"  IDM
 SG_ RSDS_L_SGU16_RollingCounter6 : 379|4@0+ (1,0) [0|14] "NoUnit"  IDM
 SG_ RSDS_L_ObjMotionType_32 : 383|3@0+ (1,0) [0|7] "NoUnit"  IDM
 SG_ RSDS_L_ObjMeasured_32 : 369|2@0+ (1,0) [0|3] "NoUnit"  IDM
 SG_ RSDS_L_ObjRelAccelY_32 : 363|10@0+ (0.03125,-16) [-16|15.96875] "MtrPerSecSq"  IDM
 SG_ RSDS_L_ObjRelAccelX_32 : 357|10@0+ (0.03125,-16) [-16|15.96875] "MtrPerSecSq"  IDM
 SG_ RSDS_L_ObjRelVelY_32 : 338|13@0+ (0.0312,-128) [-128|126.9976] "mps"  IDM
 SG_ RSDS_L_ObjRelVelX_32 : 335|13@0+ (0.0312,-128) [-128|126.9976] "mps"  IDM
 SG_ RSDS_L_SGU16_Checksum6 : 327|8@0+ (1,0) [0|255] "NoUnit"  IDM
 SG_ RSDS_L_SGU16_RollingCounter5 : 315|4@0+ (1,0) [0|14] "NoUnit"  IDM
 SG_ RSDS_L_ObjType_32 : 319|4@0+ (1,0) [0|15] "NoUnit"  IDM
 SG_ RSDS_L_ObjDistXStd_32 : 310|6@0+ (0.1,0) [0|6] "m"  IDM
 SG_ RSDS_L_ObjDistY_32 : 289|11@0+ (0.125,-128) [-128|127.875] "m"  IDM
 SG_ RSDS_L_ObjDistX_32 : 285|12@0+ (0.0625,-128) [-128|126.9375] "m"  IDM
 SG_ RSDS_L_ObjObstacleProb_32 : 274|5@0+ (0.03326,0) [0|1.03106] "NoUnit"  IDM
 SG_ RSDS_L_ObjExistProb_32 : 279|5@0+ (0.03326,0) [0|1.03106] "NoUnit"  IDM
 SG_ RSDS_L_ObjID_32 : 271|8@0+ (1,0) [0|255] "NoUnit"  IDM
 SG_ RSDS_L_SGU16_Checksum5 : 263|8@0+ (1,0) [0|255] "NoUnit"  IDM
 SG_ RSDS_L_SGU16_RollingCounter4 : 251|4@0+ (1,0) [0|14] "NoUnit"  IDM
 SG_ RSDS_L_HWATargetValidity_31 : 240|1@0+ (1,0) [0|1] "NoUnit"  IDM
 SG_ RSDS_L_ObjRefPoint_31 : 243|3@0+ (1,0) [0|7] "NoUnit"  IDM
 SG_ RSDS_L_ObjRCS_31 : 237|10@0+ (0.125,-50) [-50|70] "dBsm"  IDM
 SG_ RSDS_L_ObjYawrate_31 : 217|12@0+ (0.002,-3.14) [-3.14|5.05] "radPerSec"  IDM
 SG_ RSDS_L_ObjHeading_31 : 213|12@0+ (0.002,-3.14) [-3.14|5.05] "rad"  IDM
 SG_ RSDS_L_ObjLength_31 : 207|10@0+ (0.05,0) [0|20] "m"  IDM
 SG_ RSDS_L_SGU16_Checksum4 : 199|8@0+ (1,0) [0|255] "NoUnit"  IDM
 SG_ RSDS_L_SGU16_RollingCounter3 : 187|4@0+ (1,0) [0|14] "NoUnit"  IDM
 SG_ RSDS_L_ObjMotionDirection_31 : 191|3@0+ (1,0) [0|7] "NoUnit"  IDM
 SG_ RSDS_L_ObjAge_31 : 183|8@0+ (1,0) [0|255] "NoUnit"  IDM
 SG_ RSDS_L_ObjWidth_31 : 161|10@0+ (0.01,0) [0|5] "m"  IDM
 SG_ RSDS_L_ObjRAccelYStd_31 : 167|6@0+ (0.0625,0) [0|3.9375] "MtrPerSecSq"  IDM
 SG_ RSDS_L_ObjRAccelXStd_31 : 157|6@0+ (0.0625,0) [0|3.9375] "MtrPerSecSq"  IDM
 SG_ RSDS_L_ObjRelVelYStd_31 : 147|6@0+ (0.0625,0) [0|3.9375] "mps"  IDM
 SG_ RSDS_L_ObjRelVelXStd_31 : 137|6@0+ (0.0625,0) [0|3.9375] "mps"  IDM
 SG_ RSDS_L_ObjDistYStd_31 : 143|6@0+ (0.1,0) [0|6] "m"  IDM
 SG_ RSDS_L_SGU16_Checksum3 : 135|8@0+ (1,0) [0|255] "NoUnit"  IDM
 SG_ RSDS_L_SGU16_RollingCounter2 : 123|4@0+ (1,0) [0|14] "NoUnit"  IDM
 SG_ RSDS_L_ObjMotionType_31 : 127|3@0+ (1,0) [0|7] "NoUnit"  IDM
 SG_ RSDS_L_ObjMeasured_31 : 113|2@0+ (1,0) [0|3] "NoUnit"  IDM
 SG_ RSDS_L_ObjRelAccelY_31 : 107|10@0+ (0.03125,-16) [-16|15.96875] "MtrPerSecSq"  IDM
 SG_ RSDS_L_ObjRelAccelX_31 : 101|10@0+ (0.03125,-16) [-16|15.96875] "MtrPerSecSq"  IDM
 SG_ RSDS_L_ObjRelVelY_31 : 82|13@0+ (0.0312,-128) [-128|126.9976] "mps"  IDM
 SG_ RSDS_L_ObjRelVelX_31 : 79|13@0+ (0.0312,-128) [-128|126.9976] "mps"  IDM
 SG_ RSDS_L_SGU16_Checksum2 : 71|8@0+ (1,0) [0|255] "NoUnit"  IDM
 SG_ RSDS_L_SGU16_RollingCounter1 : 59|4@0+ (1,0) [0|14] "NoUnit"  IDM
 SG_ RSDS_L_ObjType_31 : 63|4@0+ (1,0) [0|15] "NoUnit"  IDM
 SG_ RSDS_L_ObjDistXStd_31 : 54|6@0+ (0.1,0) [0|6] "m"  IDM
 SG_ RSDS_L_ObjDistY_31 : 33|11@0+ (0.125,-128) [-128|127.875] "m"  IDM
 SG_ RSDS_L_ObjDistX_31 : 29|12@0+ (0.0625,-128) [-128|126.9375] "m"  IDM
 SG_ RSDS_L_ObjObstacleProb_31 : 18|5@0+ (0.03326,0) [0|1.03106] "NoUnit"  IDM
 SG_ RSDS_L_ObjExistProb_31 : 23|5@0+ (0.03326,0) [0|1.03106] "NoUnit"  IDM
 SG_ RSDS_L_ObjID_31 : 15|8@0+ (1,0) [0|255] "NoUnit"  IDM
 SG_ RSDS_L_SGU16_Checksum1 : 7|8@0+ (1,0) [0|255] "NoUnit"  IDM

BO_ 1486 RSDS_L_SGU_HEAD: 32 CR_RL
 SG_ RSDS_L_SGU_HEAD_RollingCounter4 : 251|4@0+ (1,0) [0|15] ""  IDM
 SG_ RSDS_L_SGU_HEAD_BlockCounter : 255|4@0+ (1,0) [0|15] ""  IDM
 SG_ RSDS_L_ObjAziAngleCalib : 236|13@0+ (0.0009,-2) [-2|2] "rad"  IDM
 SG_ RSDS_L_Guardrail_dxStart : 219|15@0+ (0.01,-160) [-160|160] "m"  IDM
 SG_ RSDS_L_GuardrailC3 : 207|20@0+ (1E-008,-0.004) [-0.004|0.004] "INV(m2)"  IDM
 SG_ RSDS_L_SGU_HEAD_Checksum4 : 199|8@0+ (1,0) [0|255] ""  IDM
 SG_ RSDS_L_SGU_HEAD_RollingCounter3 : 187|4@0+ (1,0) [0|15] ""  IDM
 SG_ RSDS_L_GuardrailC2 : 175|16@0+ (5E-006,-0.125) [-0.125|0.125] "INV(m)"  IDM
 SG_ RSDS_L_GuardrailC1 : 159|13@0+ (0.0009,-2) [-2|2] "rad"  IDM
 SG_ RSDS_L_GuardrailC0 : 143|13@0+ (0.01,-30) [-30|30] "m"  IDM
 SG_ RSDS_L_SGU_HEAD_Checksum3 : 135|8@0+ (1,0) [0|255] ""  IDM
 SG_ RSDS_L_SGU_HEAD_RollingCounter2 : 123|4@0+ (1,0) [0|15] ""  IDM
 SG_ RSDS_L_hdr_AutosarTimeStamp : 79|42@0+ (1,0) [0|4398046511103] "ms"  IDM
 SG_ RSDS_L_SGU_HEAD_Checksum2 : 71|8@0+ (1,0) [0|255] ""  IDM
 SG_ RSDS_L_SGU_HEAD_RollingCounter1 : 59|4@0+ (1,0) [0|15] ""  IDM
 SG_ RSDS_L_hdr_ErrorStatus : 63|4@0+ (1,0) [0|15] ""  IDM
 SG_ RSDS_L_Guardrail_dxEnd : 47|15@0+ (0.01,-160) [-160|160] "m"  IDM
 SG_ RSDS_L_GuardrailConfidence : 39|7@0+ (0.01,0) [0|1] ""  IDM
 SG_ RSDS_L_ObjDetected : 29|6@0+ (1,0) [0|63] ""  IDM
 SG_ RSDS_L_BLIND : 31|2@0+ (1,0) [0|3] ""  IDM
 SG_ RSDS_L_hdr_TimeStampStatus : 23|8@0+ (1,0) [0|255] ""  IDM
 SG_ RSDS_L_hdr_TimeStamp : 15|8@0+ (1,0) [0|255] "ms"  IDM
 SG_ RSDS_L_SGU_HEAD_Checksum1 : 7|8@0+ (1,0) [0|255] ""  IDM

BO_ 1966 RSDS_L_Phy_Resp: 8 CR_RL
 SG_ RSDS_L_Phy_Resp : 7|64@0+ (1,0) [0|1.84467440737096E+019] ""  IDM

BO_ 1424 RSDS_R_SGU1: 64 CR_RR
 SG_ RSDS_R_SGU1_RollingCounter8 : 507|4@0+ (1,0) [0|15] ""  IDM
 SG_ RSDS_R_SGU1_BlockCounter : 511|4@0+ (1,0) [0|15] ""  IDM
 SG_ RSDS_R_HWATargetValidity_2 : 496|1@0+ (1,0) [0|1] ""  IDM
 SG_ RSDS_R_ObjRefPoint_2 : 499|3@0+ (1,0) [0|8] ""  IDM
 SG_ RSDS_R_ObjRCS_2 : 493|10@0+ (0.125,-50) [-50|70] "dBm2"  IDM
 SG_ RSDS_R_ObjYawrate_2 : 473|12@0+ (0.002,-3.14) [-3.14|3.14] "rad/s"  IDM
 SG_ RSDS_R_ObjHeading_2 : 469|12@0+ (0.002,-3.14) [-3.14|3.14] "rad"  IDM
 SG_ RSDS_R_ObjLength_2 : 463|10@0+ (0.05,0) [0|20] "m"  IDM
 SG_ RSDS_R_SGU1_Checksum8 : 455|8@0+ (1,0) [0|255] ""  IDM
 SG_ RSDS_R_SGU1_RollingCounter7 : 443|4@0+ (1,0) [0|15] ""  IDM
 SG_ RSDS_R_ObjMotionDirection_2 : 447|3@0+ (1,0) [0|7] ""  IDM
 SG_ RSDS_R_ObjAge_2 : 439|8@0+ (1,0) [0|255] ""  IDM
 SG_ RSDS_R_ObjWidth_2 : 417|10@0+ (0.01,0) [0|5] "m"  IDM
 SG_ RSDS_R_ObjRAccelYStd_2 : 423|6@0+ (0.0625,0) [0|3.9375] "mps2"  IDM
 SG_ RSDS_R_ObjRAccelXStd_2 : 413|6@0+ (0.0625,0) [0|3.9375] "mps2"  IDM
 SG_ RSDS_R_ObjRelVelYStd_2 : 403|6@0+ (0.0625,0) [0|3.9375] "mps"  IDM
 SG_ RSDS_R_ObjRelVelXStd_2 : 393|6@0+ (0.0625,0) [0|3.9375] "mps"  IDM
 SG_ RSDS_R_ObjDistYStd_2 : 399|6@0+ (0.1,0) [0|6] "m"  IDM
 SG_ RSDS_R_SGU1_Checksum7 : 391|8@0+ (1,0) [0|255] ""  IDM
 SG_ RSDS_R_SGU1_RollingCounter6 : 379|4@0+ (1,0) [0|15] ""  IDM
 SG_ RSDS_R_ObjMotionType_2 : 383|3@0+ (1,0) [0|7] ""  IDM
 SG_ RSDS_R_ObjMeasured_2 : 369|2@0+ (1,0) [0|3] ""  IDM
 SG_ RSDS_R_ObjRelAccelY_2 : 363|10@0+ (0.03125,-16) [-16|15.96875] "mps2"  IDM
 SG_ RSDS_R_ObjRelAccelX_2 : 357|10@0+ (0.03125,-16) [-16|15.96875] "mps2"  IDM
 SG_ RSDS_R_ObjRelVelY_2 : 338|13@0+ (0.0312,-128) [-128|126.9976] "mps"  IDM
 SG_ RSDS_R_ObjRelVelX_2 : 335|13@0+ (0.0312,-128) [-128|126.9976] "mps"  IDM
 SG_ RSDS_R_SGU1_Checksum6 : 327|8@0+ (1,0) [0|255] ""  IDM
 SG_ RSDS_R_SGU1_RollingCounter5 : 315|4@0+ (1,0) [0|15] ""  IDM
 SG_ RSDS_R_ObjType_2 : 319|4@0+ (1,0) [0|15] ""  IDM
 SG_ RSDS_R_ObjDistXStd_2 : 310|6@0+ (0.1,0) [0|6] "m"  IDM
 SG_ RSDS_R_ObjDistY_2 : 289|11@0+ (0.125,-128) [-128|127.875] "m"  IDM
 SG_ RSDS_R_ObjDistX_2 : 285|12@0+ (0.0625,-128) [-128|127.9375] "m"  IDM
 SG_ RSDS_R_ObjObstacleProb_2 : 274|5@0+ (0.03326,0) [0|1] ""  IDM
 SG_ RSDS_R_ObjExistProb_2 : 279|5@0+ (0.03326,0) [0|1] ""  IDM
 SG_ RSDS_R_ObjID_2 : 271|8@0+ (1,0) [0|255] ""  IDM
 SG_ RSDS_R_SGU1_Checksum5 : 263|8@0+ (1,0) [0|255] ""  IDM
 SG_ RSDS_R_SGU1_RollingCounter4 : 251|4@0+ (1,0) [0|15] ""  IDM
 SG_ RSDS_R_HWATargetValidity_1 : 240|1@0+ (1,0) [0|1] ""  IDM
 SG_ RSDS_R_ObjRefPoint_1 : 243|3@0+ (1,0) [0|8] ""  IDM
 SG_ RSDS_R_ObjRCS_1 : 237|10@0+ (0.125,-50) [-50|70] "dBm2"  IDM
 SG_ RSDS_R_ObjYawrate_1 : 217|12@0+ (0.002,-3.14) [-3.14|3.14] "rad/s"  IDM
 SG_ RSDS_R_ObjHeading_1 : 213|12@0+ (0.002,-3.14) [-3.14|3.14] "rad"  IDM
 SG_ RSDS_R_ObjLength_1 : 207|10@0+ (0.05,0) [0|20] "m"  IDM
 SG_ RSDS_R_SGU1_Checksum4 : 199|8@0+ (1,0) [0|255] ""  IDM
 SG_ RSDS_R_SGU1_RollingCounter3 : 187|4@0+ (1,0) [0|15] ""  IDM
 SG_ RSDS_R_ObjMotionDirection_1 : 191|3@0+ (1,0) [0|7] ""  IDM
 SG_ RSDS_R_ObjAge_1 : 183|8@0+ (1,0) [0|255] ""  IDM
 SG_ RSDS_R_ObjWidth_1 : 161|10@0+ (0.01,0) [0|5] "m"  IDM
 SG_ RSDS_R_ObjRAccelYStd_1 : 167|6@0+ (0.0625,0) [0|3.9375] "mps2"  IDM
 SG_ RSDS_R_ObjRAccelXStd_1 : 157|6@0+ (0.0625,0) [0|3.9375] "mps2"  IDM
 SG_ RSDS_R_ObjRelVelYStd_1 : 147|6@0+ (0.0625,0) [0|3.9375] "mps"  IDM
 SG_ RSDS_R_ObjRelVelXStd_1 : 137|6@0+ (0.0625,0) [0|3.9375] "mps"  IDM
 SG_ RSDS_R_ObjDistYStd_1 : 143|6@0+ (0.1,0) [0|6] "m"  IDM
 SG_ RSDS_R_SGU1_Checksum3 : 135|8@0+ (1,0) [0|255] ""  IDM
 SG_ RSDS_R_SGU1_RollingCounter2 : 123|4@0+ (1,0) [0|15] ""  IDM
 SG_ RSDS_R_ObjMotionType_1 : 127|3@0+ (1,0) [0|7] ""  IDM
 SG_ RSDS_R_ObjMeasured_1 : 113|2@0+ (1,0) [0|3] ""  IDM
 SG_ RSDS_R_ObjRelAccelY_1 : 107|10@0+ (0.03125,-16) [-16|15.96875] "mps2"  IDM
 SG_ RSDS_R_ObjRelAccelX_1 : 101|10@0+ (0.03125,-16) [-16|15.96875] "mps2"  IDM
 SG_ RSDS_R_ObjRelVelY_1 : 82|13@0+ (0.0312,-128) [-128|126.9976] "mps"  IDM
 SG_ RSDS_R_ObjRelVelX_1 : 79|13@0+ (0.0312,-128) [-128|126.9976] "mps"  IDM
 SG_ RSDS_R_SGU1_Checksum2 : 71|8@0+ (1,0) [0|255] ""  IDM
 SG_ RSDS_R_SGU1_RollingCounter1 : 59|4@0+ (1,0) [0|15] ""  IDM
 SG_ RSDS_R_ObjType_1 : 63|4@0+ (1,0) [0|15] ""  IDM
 SG_ RSDS_R_ObjDistXStd_1 : 54|6@0+ (0.1,0) [0|6] "m"  IDM
 SG_ RSDS_R_ObjDistY_1 : 33|11@0+ (0.125,-128) [-128|127.875] "m"  IDM
 SG_ RSDS_R_ObjDistX_1 : 29|12@0+ (0.0625,-128) [-128|127.9375] "m"  IDM
 SG_ RSDS_R_ObjObstacleProb_1 : 18|5@0+ (0.03326,0) [0|1] ""  IDM
 SG_ RSDS_R_ObjExistProb_1 : 23|5@0+ (0.03326,0) [0|1] ""  IDM
 SG_ RSDS_R_ObjID_1 : 15|8@0+ (1,0) [0|255] ""  IDM
 SG_ RSDS_R_SGU1_Checksum1 : 7|8@0+ (1,0) [0|255] ""  IDM

BO_ 1425 RSDS_R_SGU2: 64 CR_RR
 SG_ RSDS_R_SGU2_RollingCounter8 : 507|4@0+ (1,0) [0|15] ""  IDM
 SG_ RSDS_R_SGU2_BlockCounter : 511|4@0+ (1,0) [0|15] ""  IDM
 SG_ RSDS_R_HWATargetValidity_4 : 496|1@0+ (1,0) [0|1] ""  IDM
 SG_ RSDS_R_ObjRefPoint_4 : 499|3@0+ (1,0) [0|8] ""  IDM
 SG_ RSDS_R_ObjRCS_4 : 493|10@0+ (0.125,-50) [-50|70] "dBm2"  IDM
 SG_ RSDS_R_ObjYawrate_4 : 473|12@0+ (0.002,-3.14) [-3.14|3.14] "rad/s"  IDM
 SG_ RSDS_R_ObjHeading_4 : 469|12@0+ (0.002,-3.14) [-3.14|3.14] "rad"  IDM
 SG_ RSDS_R_ObjLength_4 : 463|10@0+ (0.05,0) [0|20] "m"  IDM
 SG_ RSDS_R_SGU2_Checksum8 : 455|8@0+ (1,0) [0|255] ""  IDM
 SG_ RSDS_R_SGU2_RollingCounter7 : 443|4@0+ (1,0) [0|15] ""  IDM
 SG_ RSDS_R_ObjMotionDirection_4 : 447|3@0+ (1,0) [0|7] ""  IDM
 SG_ RSDS_R_ObjAge_4 : 439|8@0+ (1,0) [0|255] ""  IDM
 SG_ RSDS_R_ObjWidth_4 : 417|10@0+ (0.01,0) [0|5] "m"  IDM
 SG_ RSDS_R_ObjRAccelYStd_4 : 423|6@0+ (0.0625,0) [0|3.9375] "mps2"  IDM
 SG_ RSDS_R_ObjRAccelXStd_4 : 413|6@0+ (0.0625,0) [0|3.9375] "mps2"  IDM
 SG_ RSDS_R_ObjRelVelYStd_4 : 403|6@0+ (0.0625,0) [0|3.9375] "mps"  IDM
 SG_ RSDS_R_ObjRelVelXStd_4 : 393|6@0+ (0.0625,0) [0|3.9375] "mps"  IDM
 SG_ RSDS_R_ObjDistYStd_4 : 399|6@0+ (0.1,0) [0|6] "m"  IDM
 SG_ RSDS_R_SGU2_Checksum7 : 391|8@0+ (1,0) [0|255] ""  IDM
 SG_ RSDS_R_SGU2_RollingCounter6 : 379|4@0+ (1,0) [0|15] ""  IDM
 SG_ RSDS_R_ObjMotionType_4 : 383|3@0+ (1,0) [0|7] ""  IDM
 SG_ RSDS_R_ObjMeasured_4 : 369|2@0+ (1,0) [0|3] ""  IDM
 SG_ RSDS_R_ObjRelAccelY_4 : 363|10@0+ (0.03125,-16) [-16|15.96875] "mps2"  IDM
 SG_ RSDS_R_ObjRelAccelX_4 : 357|10@0+ (0.03125,-16) [-16|15.96875] "mps2"  IDM
 SG_ RSDS_R_ObjRelVelY_4 : 338|13@0+ (0.0312,-128) [-128|126.9976] "mps"  IDM
 SG_ RSDS_R_ObjRelVelX_4 : 335|13@0+ (0.0312,-128) [-128|126.9976] "mps"  IDM
 SG_ RSDS_R_SGU2_Checksum6 : 327|8@0+ (1,0) [0|255] ""  IDM
 SG_ RSDS_R_SGU2_RollingCounter5 : 315|4@0+ (1,0) [0|15] ""  IDM
 SG_ RSDS_R_ObjType_4 : 319|4@0+ (1,0) [0|15] ""  IDM
 SG_ RSDS_R_ObjDistXStd_4 : 310|6@0+ (0.1,0) [0|6] "m"  IDM
 SG_ RSDS_R_ObjDistY_4 : 289|11@0+ (0.125,-128) [-128|127.875] "m"  IDM
 SG_ RSDS_R_ObjDistX_4 : 285|12@0+ (0.0625,-128) [-128|127.9375] "m"  IDM
 SG_ RSDS_R_ObjObstacleProb_4 : 274|5@0+ (0.03326,0) [0|1] ""  IDM
 SG_ RSDS_R_ObjExistProb_4 : 279|5@0+ (0.03326,0) [0|1] ""  IDM
 SG_ RSDS_R_ObjID_4 : 271|8@0+ (1,0) [0|255] ""  IDM
 SG_ RSDS_R_SGU2_Checksum5 : 263|8@0+ (1,0) [0|255] ""  IDM
 SG_ RSDS_R_SGU2_RollingCounter4 : 251|4@0+ (1,0) [0|15] ""  IDM
 SG_ RSDS_R_HWATargetValidity_3 : 240|1@0+ (1,0) [0|1] ""  IDM
 SG_ RSDS_R_ObjRefPoint_3 : 243|3@0+ (1,0) [0|8] ""  IDM
 SG_ RSDS_R_ObjRCS_3 : 237|10@0+ (0.125,-50) [-50|70] "dBm2"  IDM
 SG_ RSDS_R_ObjYawrate_3 : 217|12@0+ (0.002,-3.14) [-3.14|3.14] "rad/s"  IDM
 SG_ RSDS_R_ObjHeading_3 : 213|12@0+ (0.002,-3.14) [-3.14|3.14] "rad"  IDM
 SG_ RSDS_R_ObjLength_3 : 207|10@0+ (0.05,0) [0|20] "m"  IDM
 SG_ RSDS_R_SGU2_Checksum4 : 199|8@0+ (1,0) [0|255] ""  IDM
 SG_ RSDS_R_SGU2_RollingCounter3 : 187|4@0+ (1,0) [0|15] ""  IDM
 SG_ RSDS_R_ObjMotionDirection_3 : 191|3@0+ (1,0) [0|7] ""  IDM
 SG_ RSDS_R_ObjAge_3 : 183|8@0+ (1,0) [0|255] ""  IDM
 SG_ RSDS_R_ObjWidth_3 : 161|10@0+ (0.01,0) [0|5] "m"  IDM
 SG_ RSDS_R_ObjRAccelYStd_3 : 167|6@0+ (0.0625,0) [0|3.9375] "mps2"  IDM
 SG_ RSDS_R_ObjRAccelXStd_3 : 157|6@0+ (0.0625,0) [0|3.9375] "mps2"  IDM
 SG_ RSDS_R_ObjRelVelYStd_3 : 147|6@0+ (0.0625,0) [0|3.9375] "mps"  IDM
 SG_ RSDS_R_ObjRelVelXStd_3 : 137|6@0+ (0.0625,0) [0|3.9375] "mps"  IDM
 SG_ RSDS_R_ObjDistYStd_3 : 143|6@0+ (0.1,0) [0|6] "m"  IDM
 SG_ RSDS_R_SGU2_Checksum3 : 135|8@0+ (1,0) [0|255] ""  IDM
 SG_ RSDS_R_SGU2_RollingCounter2 : 123|4@0+ (1,0) [0|15] ""  IDM
 SG_ RSDS_R_ObjMotionType_3 : 127|3@0+ (1,0) [0|7] ""  IDM
 SG_ RSDS_R_ObjMeasured_3 : 113|2@0+ (1,0) [0|3] ""  IDM
 SG_ RSDS_R_ObjRelAccelY_3 : 107|10@0+ (0.03125,-16) [-16|15.96875] "mps2"  IDM
 SG_ RSDS_R_ObjRelAccelX_3 : 101|10@0+ (0.03125,-16) [-16|15.96875] "mps2"  IDM
 SG_ RSDS_R_ObjRelVelY_3 : 82|13@0+ (0.0312,-128) [-128|126.9976] "mps"  IDM
 SG_ RSDS_R_ObjRelVelX_3 : 79|13@0+ (0.0312,-128) [-128|126.9976] "mps"  IDM
 SG_ RSDS_R_SGU2_Checksum2 : 71|8@0+ (1,0) [0|255] ""  IDM
 SG_ RSDS_R_SGU2_RollingCounter1 : 59|4@0+ (1,0) [0|15] ""  IDM
 SG_ RSDS_R_ObjType_3 : 63|4@0+ (1,0) [0|15] ""  IDM
 SG_ RSDS_R_ObjDistXStd_3 : 54|6@0+ (0.1,0) [0|6] "m"  IDM
 SG_ RSDS_R_ObjDistY_3 : 33|11@0+ (0.125,-128) [-128|127.875] "m"  IDM
 SG_ RSDS_R_ObjDistX_3 : 29|12@0+ (0.0625,-128) [-128|127.9375] "m"  IDM
 SG_ RSDS_R_ObjObstacleProb_3 : 18|5@0+ (0.03326,0) [0|1] ""  IDM
 SG_ RSDS_R_ObjExistProb_3 : 23|5@0+ (0.03326,0) [0|1] ""  IDM
 SG_ RSDS_R_ObjID_3 : 15|8@0+ (1,0) [0|255] ""  IDM
 SG_ RSDS_R_SGU2_Checksum1 : 7|8@0+ (1,0) [0|255] ""  IDM

BO_ 1426 RSDS_R_SGU3: 64 CR_RR
 SG_ RSDS_R_SGU3_RollingCounter8 : 507|4@0+ (1,0) [0|15] ""  IDM
 SG_ RSDS_R_SGU3_BlockCounter : 511|4@0+ (1,0) [0|15] ""  IDM
 SG_ RSDS_R_HWATargetValidity_6 : 496|1@0+ (1,0) [0|1] ""  IDM
 SG_ RSDS_R_ObjRefPoint_6 : 499|3@0+ (1,0) [0|8] ""  IDM
 SG_ RSDS_R_ObjRCS_6 : 493|10@0+ (0.125,-50) [-50|70] "dBm2"  IDM
 SG_ RSDS_R_ObjYawrate_6 : 473|12@0+ (0.002,-3.14) [-3.14|3.14] "rad/s"  IDM
 SG_ RSDS_R_ObjHeading_6 : 469|12@0+ (0.002,-3.14) [-3.14|3.14] "rad"  IDM
 SG_ RSDS_R_ObjLength_6 : 463|10@0+ (0.05,0) [0|20] "m"  IDM
 SG_ RSDS_R_SGU3_Checksum8 : 455|8@0+ (1,0) [0|255] ""  IDM
 SG_ RSDS_R_SGU3_RollingCounter7 : 443|4@0+ (1,0) [0|15] ""  IDM
 SG_ RSDS_R_ObjMotionDirection_6 : 447|3@0+ (1,0) [0|7] ""  IDM
 SG_ RSDS_R_ObjAge_6 : 439|8@0+ (1,0) [0|255] ""  IDM
 SG_ RSDS_R_ObjWidth_6 : 417|10@0+ (0.01,0) [0|5] "m"  IDM
 SG_ RSDS_R_ObjRAccelYStd_6 : 423|6@0+ (0.0625,0) [0|3.9375] "mps2"  IDM
 SG_ RSDS_R_ObjRAccelXStd_6 : 413|6@0+ (0.0625,0) [0|3.9375] "mps2"  IDM
 SG_ RSDS_R_ObjRelVelYStd_6 : 403|6@0+ (0.0625,0) [0|3.9375] "mps"  IDM
 SG_ RSDS_R_ObjRelVelXStd_6 : 393|6@0+ (0.0625,0) [0|3.9375] "mps"  IDM
 SG_ RSDS_R_ObjDistYStd_6 : 399|6@0+ (0.1,0) [0|6] "m"  IDM
 SG_ RSDS_R_SGU3_Checksum7 : 391|8@0+ (1,0) [0|255] ""  IDM
 SG_ RSDS_R_SGU3_RollingCounter6 : 379|4@0+ (1,0) [0|15] ""  IDM
 SG_ RSDS_R_ObjMotionType_6 : 383|3@0+ (1,0) [0|7] ""  IDM
 SG_ RSDS_R_ObjMeasured_6 : 369|2@0+ (1,0) [0|3] ""  IDM
 SG_ RSDS_R_ObjRelAccelY_6 : 363|10@0+ (0.03125,-16) [-16|15.96875] "mps2"  IDM
 SG_ RSDS_R_ObjRelAccelX_6 : 357|10@0+ (0.03125,-16) [-16|15.96875] "mps2"  IDM
 SG_ RSDS_R_ObjRelVelY_6 : 338|13@0+ (0.0312,-128) [-128|126.9976] "mps"  IDM
 SG_ RSDS_R_ObjRelVelX_6 : 335|13@0+ (0.0312,-128) [-128|126.9976] "mps"  IDM
 SG_ RSDS_R_SGU3_Checksum6 : 327|8@0+ (1,0) [0|255] ""  IDM
 SG_ RSDS_R_SGU3_RollingCounter5 : 315|4@0+ (1,0) [0|15] ""  IDM
 SG_ RSDS_R_ObjType_6 : 319|4@0+ (1,0) [0|15] ""  IDM
 SG_ RSDS_R_ObjDistXStd_6 : 310|6@0+ (0.1,0) [0|6] "m"  IDM
 SG_ RSDS_R_ObjDistY_6 : 289|11@0+ (0.125,-128) [-128|127.875] "m"  IDM
 SG_ RSDS_R_ObjDistX_6 : 285|12@0+ (0.0625,-128) [-128|127.9375] "m"  IDM
 SG_ RSDS_R_ObjObstacleProb_6 : 274|5@0+ (0.03326,0) [0|1] ""  IDM
 SG_ RSDS_R_ObjExistProb_6 : 279|5@0+ (0.03326,0) [0|1] ""  IDM
 SG_ RSDS_R_ObjID_6 : 271|8@0+ (1,0) [0|255] ""  IDM
 SG_ RSDS_R_SGU3_Checksum5 : 263|8@0+ (1,0) [0|255] ""  IDM
 SG_ RSDS_R_SGU3_RollingCounter4 : 251|4@0+ (1,0) [0|15] ""  IDM
 SG_ RSDS_R_HWATargetValidity_5 : 240|1@0+ (1,0) [0|1] ""  IDM
 SG_ RSDS_R_ObjRefPoint_5 : 243|3@0+ (1,0) [0|8] ""  IDM
 SG_ RSDS_R_ObjRCS_5 : 237|10@0+ (0.125,-50) [-50|70] "dBm2"  IDM
 SG_ RSDS_R_ObjYawrate_5 : 217|12@0+ (0.002,-3.14) [-3.14|3.14] "rad/s"  IDM
 SG_ RSDS_R_ObjHeading_5 : 213|12@0+ (0.002,-3.14) [-3.14|3.14] "rad"  IDM
 SG_ RSDS_R_ObjLength_5 : 207|10@0+ (0.05,0) [0|20] "m"  IDM
 SG_ RSDS_R_SGU3_Checksum4 : 199|8@0+ (1,0) [0|255] ""  IDM
 SG_ RSDS_R_SGU3_RollingCounter3 : 187|4@0+ (1,0) [0|15] ""  IDM
 SG_ RSDS_R_ObjMotionDirection_5 : 191|3@0+ (1,0) [0|7] ""  IDM
 SG_ RSDS_R_ObjAge_5 : 183|8@0+ (1,0) [0|255] ""  IDM
 SG_ RSDS_R_ObjWidth_5 : 161|10@0+ (0.01,0) [0|5] "m"  IDM
 SG_ RSDS_R_ObjRAccelYStd_5 : 167|6@0+ (0.0625,0) [0|3.9375] "mps2"  IDM
 SG_ RSDS_R_ObjRAccelXStd_5 : 157|6@0+ (0.0625,0) [0|3.9375] "mps2"  IDM
 SG_ RSDS_R_ObjRelVelYStd_5 : 147|6@0+ (0.0625,0) [0|3.9375] "mps"  IDM
 SG_ RSDS_R_ObjRelVelXStd_5 : 137|6@0+ (0.0625,0) [0|3.9375] "mps"  IDM
 SG_ RSDS_R_ObjDistYStd_5 : 143|6@0+ (0.1,0) [0|6] "m"  IDM
 SG_ RSDS_R_SGU3_Checksum3 : 135|8@0+ (1,0) [0|255] ""  IDM
 SG_ RSDS_R_SGU3_RollingCounter2 : 123|4@0+ (1,0) [0|15] ""  IDM
 SG_ RSDS_R_ObjMotionType_5 : 127|3@0+ (1,0) [0|7] ""  IDM
 SG_ RSDS_R_ObjMeasured_5 : 113|2@0+ (1,0) [0|3] ""  IDM
 SG_ RSDS_R_ObjRelAccelY_5 : 107|10@0+ (0.03125,-16) [-16|15.96875] "mps2"  IDM
 SG_ RSDS_R_ObjRelAccelX_5 : 101|10@0+ (0.03125,-16) [-16|15.96875] "mps2"  IDM
 SG_ RSDS_R_ObjRelVelY_5 : 82|13@0+ (0.0312,-128) [-128|126.9976] "mps"  IDM
 SG_ RSDS_R_ObjRelVelX_5 : 79|13@0+ (0.0312,-128) [-128|126.9976] "mps"  IDM
 SG_ RSDS_R_SGU3_Checksum2 : 71|8@0+ (1,0) [0|255] ""  IDM
 SG_ RSDS_R_SGU3_RollingCounter1 : 59|4@0+ (1,0) [0|15] ""  IDM
 SG_ RSDS_R_ObjType_5 : 63|4@0+ (1,0) [0|15] ""  IDM
 SG_ RSDS_R_ObjDistXStd_5 : 54|6@0+ (0.1,0) [0|6] "m"  IDM
 SG_ RSDS_R_ObjDistY_5 : 33|11@0+ (0.125,-128) [-128|127.875] "m"  IDM
 SG_ RSDS_R_ObjDistX_5 : 29|12@0+ (0.0625,-128) [-128|127.9375] "m"  IDM
 SG_ RSDS_R_ObjObstacleProb_5 : 18|5@0+ (0.03326,0) [0|1] ""  IDM
 SG_ RSDS_R_ObjExistProb_5 : 23|5@0+ (0.03326,0) [0|1] ""  IDM
 SG_ RSDS_R_ObjID_5 : 15|8@0+ (1,0) [0|255] ""  IDM
 SG_ RSDS_R_SGU3_Checksum1 : 7|8@0+ (1,0) [0|255] ""  IDM

BO_ 1427 RSDS_R_SGU4: 64 CR_RR
 SG_ RSDS_R_SGU4_RollingCounter8 : 507|4@0+ (1,0) [0|15] ""  IDM
 SG_ RSDS_R_SGU4_BlockCounter : 511|4@0+ (1,0) [0|15] ""  IDM
 SG_ RSDS_R_HWATargetValidity_8 : 496|1@0+ (1,0) [0|1] ""  IDM
 SG_ RSDS_R_ObjRefPoint_8 : 499|3@0+ (1,0) [0|8] ""  IDM
 SG_ RSDS_R_ObjRCS_8 : 493|10@0+ (0.125,-50) [-50|70] "dBm2"  IDM
 SG_ RSDS_R_ObjYawrate_8 : 473|12@0+ (0.002,-3.14) [-3.14|3.14] "rad/s"  IDM
 SG_ RSDS_R_ObjHeading_8 : 469|12@0+ (0.002,-3.14) [-3.14|3.14] "rad"  IDM
 SG_ RSDS_R_ObjLength_8 : 463|10@0+ (0.05,0) [0|20] "m"  IDM
 SG_ RSDS_R_SGU4_Checksum8 : 455|8@0+ (1,0) [0|255] ""  IDM
 SG_ RSDS_R_SGU4_RollingCounter7 : 443|4@0+ (1,0) [0|15] ""  IDM
 SG_ RSDS_R_ObjMotionDirection_8 : 447|3@0+ (1,0) [0|7] ""  IDM
 SG_ RSDS_R_ObjAge_8 : 439|8@0+ (1,0) [0|255] ""  IDM
 SG_ RSDS_R_ObjWidth_8 : 417|10@0+ (0.01,0) [0|5] "m"  IDM
 SG_ RSDS_R_ObjRAccelYStd_8 : 423|6@0+ (0.0625,0) [0|3.9375] "mps2"  IDM
 SG_ RSDS_R_ObjRAccelXStd_8 : 413|6@0+ (0.0625,0) [0|3.9375] "mps2"  IDM
 SG_ RSDS_R_ObjRelVelYStd_8 : 403|6@0+ (0.0625,0) [0|3.9375] "mps"  IDM
 SG_ RSDS_R_ObjRelVelXStd_8 : 393|6@0+ (0.0625,0) [0|3.9375] "mps"  IDM
 SG_ RSDS_R_ObjDistYStd_8 : 399|6@0+ (0.1,0) [0|6] "m"  IDM
 SG_ RSDS_R_SGU4_Checksum7 : 391|8@0+ (1,0) [0|255] ""  IDM
 SG_ RSDS_R_SGU4_RollingCounter6 : 379|4@0+ (1,0) [0|15] ""  IDM
 SG_ RSDS_R_ObjMotionType_8 : 383|3@0+ (1,0) [0|7] ""  IDM
 SG_ RSDS_R_ObjMeasured_8 : 369|2@0+ (1,0) [0|3] ""  IDM
 SG_ RSDS_R_ObjRelAccelY_8 : 363|10@0+ (0.03125,-16) [-16|15.96875] "mps2"  IDM
 SG_ RSDS_R_ObjRelAccelX_8 : 357|10@0+ (0.03125,-16) [-16|15.96875] "mps2"  IDM
 SG_ RSDS_R_ObjRelVelY_8 : 338|13@0+ (0.0312,-128) [-128|126.9976] "mps"  IDM
 SG_ RSDS_R_ObjRelVelX_8 : 335|13@0+ (0.0312,-128) [-128|126.9976] "mps"  IDM
 SG_ RSDS_R_SGU4_Checksum6 : 327|8@0+ (1,0) [0|255] ""  IDM
 SG_ RSDS_R_SGU4_RollingCounter5 : 315|4@0+ (1,0) [0|15] ""  IDM
 SG_ RSDS_R_ObjType_8 : 319|4@0+ (1,0) [0|15] ""  IDM
 SG_ RSDS_R_ObjDistXStd_8 : 310|6@0+ (0.1,0) [0|6] "m"  IDM
 SG_ RSDS_R_ObjDistY_8 : 289|11@0+ (0.125,-128) [-128|127.875] "m"  IDM
 SG_ RSDS_R_ObjDistX_8 : 285|12@0+ (0.0625,-128) [-128|127.9375] "m"  IDM
 SG_ RSDS_R_ObjObstacleProb_8 : 274|5@0+ (0.03326,0) [0|1] ""  IDM
 SG_ RSDS_R_ObjExistProb_8 : 279|5@0+ (0.03326,0) [0|1] ""  IDM
 SG_ RSDS_R_ObjID_8 : 271|8@0+ (1,0) [0|255] ""  IDM
 SG_ RSDS_R_SGU4_Checksum5 : 263|8@0+ (1,0) [0|255] ""  IDM
 SG_ RSDS_R_SGU4_RollingCounter4 : 251|4@0+ (1,0) [0|15] ""  IDM
 SG_ RSDS_R_HWATargetValidity_7 : 240|1@0+ (1,0) [0|1] ""  IDM
 SG_ RSDS_R_ObjRefPoint_7 : 243|3@0+ (1,0) [0|8] ""  IDM
 SG_ RSDS_R_ObjRCS_7 : 237|10@0+ (0.125,-50) [-50|70] "dBm2"  IDM
 SG_ RSDS_R_ObjYawrate_7 : 217|12@0+ (0.002,-3.14) [-3.14|3.14] "rad/s"  IDM
 SG_ RSDS_R_ObjHeading_7 : 213|12@0+ (0.002,-3.14) [-3.14|3.14] "rad"  IDM
 SG_ RSDS_R_ObjLength_7 : 207|10@0+ (0.05,0) [0|20] "m"  IDM
 SG_ RSDS_R_SGU4_Checksum4 : 199|8@0+ (1,0) [0|255] ""  IDM
 SG_ RSDS_R_SGU4_RollingCounter3 : 187|4@0+ (1,0) [0|15] ""  IDM
 SG_ RSDS_R_ObjMotionDirection_7 : 191|3@0+ (1,0) [0|7] ""  IDM
 SG_ RSDS_R_ObjAge_7 : 183|8@0+ (1,0) [0|255] ""  IDM
 SG_ RSDS_R_ObjWidth_7 : 161|10@0+ (0.01,0) [0|5] "m"  IDM
 SG_ RSDS_R_ObjRAccelYStd_7 : 167|6@0+ (0.0625,0) [0|3.9375] "mps2"  IDM
 SG_ RSDS_R_ObjRAccelXStd_7 : 157|6@0+ (0.0625,0) [0|3.9375] "mps2"  IDM
 SG_ RSDS_R_ObjRelVelYStd_7 : 147|6@0+ (0.0625,0) [0|3.9375] "mps"  IDM
 SG_ RSDS_R_ObjRelVelXStd_7 : 137|6@0+ (0.0625,0) [0|3.9375] "mps"  IDM
 SG_ RSDS_R_ObjDistYStd_7 : 143|6@0+ (0.1,0) [0|6] "m"  IDM
 SG_ RSDS_R_SGU4_Checksum3 : 135|8@0+ (1,0) [0|255] ""  IDM
 SG_ RSDS_R_SGU4_RollingCounter2 : 123|4@0+ (1,0) [0|15] ""  IDM
 SG_ RSDS_R_ObjMotionType_7 : 127|3@0+ (1,0) [0|7] ""  IDM
 SG_ RSDS_R_ObjMeasured_7 : 113|2@0+ (1,0) [0|3] ""  IDM
 SG_ RSDS_R_ObjRelAccelY_7 : 107|10@0+ (0.03125,-16) [-16|15.96875] "mps2"  IDM
 SG_ RSDS_R_ObjRelAccelX_7 : 101|10@0+ (0.03125,-16) [-16|15.96875] "mps2"  IDM
 SG_ RSDS_R_ObjRelVelY_7 : 82|13@0+ (0.0312,-128) [-128|126.9976] "mps"  IDM
 SG_ RSDS_R_ObjRelVelX_7 : 79|13@0+ (0.0312,-128) [-128|126.9976] "mps"  IDM
 SG_ RSDS_R_SGU4_Checksum2 : 71|8@0+ (1,0) [0|255] ""  IDM
 SG_ RSDS_R_SGU4_RollingCounter1 : 59|4@0+ (1,0) [0|15] ""  IDM
 SG_ RSDS_R_ObjType_7 : 63|4@0+ (1,0) [0|15] ""  IDM
 SG_ RSDS_R_ObjDistXStd_7 : 54|6@0+ (0.1,0) [0|6] "m"  IDM
 SG_ RSDS_R_ObjDistY_7 : 33|11@0+ (0.125,-128) [-128|127.875] "m"  IDM
 SG_ RSDS_R_ObjDistX_7 : 29|12@0+ (0.0625,-128) [-128|127.9375] "m"  IDM
 SG_ RSDS_R_ObjObstacleProb_7 : 18|5@0+ (0.03326,0) [0|1] ""  IDM
 SG_ RSDS_R_ObjExistProb_7 : 23|5@0+ (0.03326,0) [0|1] ""  IDM
 SG_ RSDS_R_ObjID_7 : 15|8@0+ (1,0) [0|255] ""  IDM
 SG_ RSDS_R_SGU4_Checksum1 : 7|8@0+ (1,0) [0|255] ""  IDM

BO_ 1428 RSDS_R_SGU5: 64 CR_RR
 SG_ RSDS_R_SGU5_RollingCounter8 : 507|4@0+ (1,0) [0|15] ""  IDM
 SG_ RSDS_R_SGU5_BlockCounter : 511|4@0+ (1,0) [0|15] ""  IDM
 SG_ RSDS_R_HWATargetValidity_10 : 496|1@0+ (1,0) [0|1] ""  IDM
 SG_ RSDS_R_ObjRefPoint_10 : 499|3@0+ (1,0) [0|8] ""  IDM
 SG_ RSDS_R_ObjRCS_10 : 493|10@0+ (0.125,-50) [-50|70] "dBm2"  IDM
 SG_ RSDS_R_ObjYawrate_10 : 473|12@0+ (0.002,-3.14) [-3.14|3.14] "rad/s"  IDM
 SG_ RSDS_R_ObjHeading_10 : 469|12@0+ (0.002,-3.14) [-3.14|3.14] "rad"  IDM
 SG_ RSDS_R_ObjLength_10 : 463|10@0+ (0.05,0) [0|20] "m"  IDM
 SG_ RSDS_R_SGU5_Checksum8 : 455|8@0+ (1,0) [0|255] ""  IDM
 SG_ RSDS_R_SGU5_RollingCounter7 : 443|4@0+ (1,0) [0|15] ""  IDM
 SG_ RSDS_R_ObjMotionDirection_10 : 447|3@0+ (1,0) [0|7] ""  IDM
 SG_ RSDS_R_ObjAge_10 : 439|8@0+ (1,0) [0|255] ""  IDM
 SG_ RSDS_R_ObjWidth_10 : 417|10@0+ (0.01,0) [0|5] "m"  IDM
 SG_ RSDS_R_ObjRAccelYStd_10 : 423|6@0+ (0.0625,0) [0|3.9375] "mps2"  IDM
 SG_ RSDS_R_ObjRAccelXStd_10 : 413|6@0+ (0.0625,0) [0|3.9375] "mps2"  IDM
 SG_ RSDS_R_ObjRelVelYStd_10 : 403|6@0+ (0.0625,0) [0|3.9375] "mps"  IDM
 SG_ RSDS_R_ObjRelVelXStd_10 : 393|6@0+ (0.0625,0) [0|3.9375] "mps"  IDM
 SG_ RSDS_R_ObjDistYStd_10 : 399|6@0+ (0.1,0) [0|6] "m"  IDM
 SG_ RSDS_R_SGU5_Checksum7 : 391|8@0+ (1,0) [0|255] ""  IDM
 SG_ RSDS_R_SGU5_RollingCounter6 : 379|4@0+ (1,0) [0|15] ""  IDM
 SG_ RSDS_R_ObjMotionType_10 : 383|3@0+ (1,0) [0|7] ""  IDM
 SG_ RSDS_R_ObjMeasured_10 : 369|2@0+ (1,0) [0|3] ""  IDM
 SG_ RSDS_R_ObjRelAccelY_10 : 363|10@0+ (0.03125,-16) [-16|15.96875] "mps2"  IDM
 SG_ RSDS_R_ObjRelAccelX_10 : 357|10@0+ (0.03125,-16) [-16|15.96875] "mps2"  IDM
 SG_ RSDS_R_ObjRelVelY_10 : 338|13@0+ (0.0312,-128) [-128|126.9976] "mps"  IDM
 SG_ RSDS_R_ObjRelVelX_10 : 335|13@0+ (0.0312,-128) [-128|126.9976] "mps"  IDM
 SG_ RSDS_R_SGU5_Checksum6 : 327|8@0+ (1,0) [0|255] ""  IDM
 SG_ RSDS_R_SGU5_RollingCounter5 : 315|4@0+ (1,0) [0|15] ""  IDM
 SG_ RSDS_R_ObjType_10 : 319|4@0+ (1,0) [0|15] ""  IDM
 SG_ RSDS_R_ObjDistXStd_10 : 310|6@0+ (0.1,0) [0|6] "m"  IDM
 SG_ RSDS_R_ObjDistY_10 : 289|11@0+ (0.125,-128) [-128|127.875] "m"  IDM
 SG_ RSDS_R_ObjDistX_10 : 285|12@0+ (0.0625,-128) [-128|127.9375] "m"  IDM
 SG_ RSDS_R_ObjObstacleProb_10 : 274|5@0+ (0.03326,0) [0|1] ""  IDM
 SG_ RSDS_R_ObjExistProb_10 : 279|5@0+ (0.03326,0) [0|1] ""  IDM
 SG_ RSDS_R_ObjID_10 : 271|8@0+ (1,0) [0|255] ""  IDM
 SG_ RSDS_R_SGU5_Checksum5 : 263|8@0+ (1,0) [0|255] ""  IDM
 SG_ RSDS_R_SGU5_RollingCounter4 : 251|4@0+ (1,0) [0|15] ""  IDM
 SG_ RSDS_R_HWATargetValidity_9 : 240|1@0+ (1,0) [0|1] ""  IDM
 SG_ RSDS_R_ObjRefPoint_9 : 243|3@0+ (1,0) [0|8] ""  IDM
 SG_ RSDS_R_ObjRCS_9 : 237|10@0+ (0.125,-50) [-50|70] "dBm2"  IDM
 SG_ RSDS_R_ObjYawrate_9 : 217|12@0+ (0.002,-3.14) [-3.14|3.14] "rad/s"  IDM
 SG_ RSDS_R_ObjHeading_9 : 213|12@0+ (0.002,-3.14) [-3.14|3.14] "rad"  IDM
 SG_ RSDS_R_ObjLength_9 : 207|10@0+ (0.05,0) [0|20] "m"  IDM
 SG_ RSDS_R_SGU5_Checksum4 : 199|8@0+ (1,0) [0|255] ""  IDM
 SG_ RSDS_R_SGU5_RollingCounter3 : 187|4@0+ (1,0) [0|15] ""  IDM
 SG_ RSDS_R_ObjMotionDirection_9 : 191|3@0+ (1,0) [0|7] ""  IDM
 SG_ RSDS_R_ObjAge_9 : 183|8@0+ (1,0) [0|255] ""  IDM
 SG_ RSDS_R_ObjWidth_9 : 161|10@0+ (0.01,0) [0|5] "m"  IDM
 SG_ RSDS_R_ObjRAccelYStd_9 : 167|6@0+ (0.0625,0) [0|3.9375] "mps2"  IDM
 SG_ RSDS_R_ObjRAccelXStd_9 : 157|6@0+ (0.0625,0) [0|3.9375] "mps2"  IDM
 SG_ RSDS_R_ObjRelVelYStd_9 : 147|6@0+ (0.0625,0) [0|3.9375] "mps"  IDM
 SG_ RSDS_R_ObjRelVelXStd_9 : 137|6@0+ (0.0625,0) [0|3.9375] "mps"  IDM
 SG_ RSDS_R_ObjDistYStd_9 : 143|6@0+ (0.1,0) [0|6] "m"  IDM
 SG_ RSDS_R_SGU5_Checksum3 : 135|8@0+ (1,0) [0|255] ""  IDM
 SG_ RSDS_R_SGU5_RollingCounter2 : 123|4@0+ (1,0) [0|15] ""  IDM
 SG_ RSDS_R_ObjMotionType_9 : 127|3@0+ (1,0) [0|7] ""  IDM
 SG_ RSDS_R_ObjMeasured_9 : 113|2@0+ (1,0) [0|3] ""  IDM
 SG_ RSDS_R_ObjRelAccelY_9 : 107|10@0+ (0.03125,-16) [-16|15.96875] "mps2"  IDM
 SG_ RSDS_R_ObjRelAccelX_9 : 101|10@0+ (0.03125,-16) [-16|15.96875] "mps2"  IDM
 SG_ RSDS_R_ObjRelVelY_9 : 82|13@0+ (0.0312,-128) [-128|126.9976] "mps"  IDM
 SG_ RSDS_R_ObjRelVelX_9 : 79|13@0+ (0.0312,-128) [-128|126.9976] "mps"  IDM
 SG_ RSDS_R_SGU5_Checksum2 : 71|8@0+ (1,0) [0|255] ""  IDM
 SG_ RSDS_R_SGU5_RollingCounter1 : 59|4@0+ (1,0) [0|15] ""  IDM
 SG_ RSDS_R_ObjType_9 : 63|4@0+ (1,0) [0|15] ""  IDM
 SG_ RSDS_R_ObjDistXStd_9 : 54|6@0+ (0.1,0) [0|6] "m"  IDM
 SG_ RSDS_R_ObjDistY_9 : 33|11@0+ (0.125,-128) [-128|127.875] "m"  IDM
 SG_ RSDS_R_ObjDistX_9 : 29|12@0+ (0.0625,-128) [-128|127.9375] "m"  IDM
 SG_ RSDS_R_ObjObstacleProb_9 : 18|5@0+ (0.03326,0) [0|1] ""  IDM
 SG_ RSDS_R_ObjExistProb_9 : 23|5@0+ (0.03326,0) [0|1] ""  IDM
 SG_ RSDS_R_ObjID_9 : 15|8@0+ (1,0) [0|255] ""  IDM
 SG_ RSDS_R_SGU5_Checksum1 : 7|8@0+ (1,0) [0|255] ""  IDM

CM_ SG_ 1486 RSDS_L_SGU_HEAD_RollingCounter4 "/";
CM_ SG_ 1486 RSDS_L_SGU_HEAD_BlockCounter "/";
CM_ SG_ 1486 RSDS_L_ObjAziAngleCalib "/";
CM_ SG_ 1486 RSDS_L_Guardrail_dxStart "/";
CM_ SG_ 1486 RSDS_L_GuardrailC3 "/";
CM_ SG_ 1486 RSDS_L_SGU_HEAD_Checksum4 "/";
CM_ SG_ 1486 RSDS_L_SGU_HEAD_RollingCounter3 "/";
CM_ SG_ 1486 RSDS_L_GuardrailC2 "/";
CM_ SG_ 1486 RSDS_L_GuardrailC1 "/";
CM_ SG_ 1486 RSDS_L_GuardrailC0 "/";
CM_ SG_ 1486 RSDS_L_SGU_HEAD_Checksum3 "/";
CM_ SG_ 1486 RSDS_L_SGU_HEAD_RollingCounter2 "/";
CM_ SG_ 1486 RSDS_L_hdr_AutosarTimeStamp "/";
CM_ SG_ 1486 RSDS_L_SGU_HEAD_Checksum2 "/";
CM_ SG_ 1486 RSDS_L_SGU_HEAD_RollingCounter1 "/";
CM_ SG_ 1486 RSDS_L_hdr_ErrorStatus "/";
CM_ SG_ 1486 RSDS_L_Guardrail_dxEnd "/";
CM_ SG_ 1486 RSDS_L_GuardrailConfidence "/";
CM_ SG_ 1486 RSDS_L_ObjDetected "/";
CM_ SG_ 1486 RSDS_L_BLIND "/";
CM_ SG_ 1486 RSDS_L_hdr_TimeStampStatus "/";
CM_ SG_ 1486 RSDS_L_hdr_TimeStamp "/";
CM_ SG_ 1486 RSDS_L_SGU_HEAD_Checksum1 "/";
CM_ SG_ 1424 RSDS_R_SGU1_RollingCounter8 "/";
CM_ SG_ 1424 RSDS_R_SGU1_BlockCounter "/";
CM_ SG_ 1424 RSDS_R_HWATargetValidity_2 "/";
CM_ SG_ 1424 RSDS_R_ObjRefPoint_2 "/";
CM_ SG_ 1424 RSDS_R_ObjRCS_2 "/";
CM_ SG_ 1424 RSDS_R_ObjYawrate_2 "/";
CM_ SG_ 1424 RSDS_R_ObjHeading_2 "/";
CM_ SG_ 1424 RSDS_R_ObjLength_2 "/";
CM_ SG_ 1424 RSDS_R_SGU1_Checksum8 "/";
CM_ SG_ 1424 RSDS_R_SGU1_RollingCounter7 "/";
CM_ SG_ 1424 RSDS_R_ObjMotionDirection_2 "/";
CM_ SG_ 1424 RSDS_R_ObjAge_2 "/";
CM_ SG_ 1424 RSDS_R_ObjWidth_2 "/";
CM_ SG_ 1424 RSDS_R_ObjRAccelYStd_2 "/";
CM_ SG_ 1424 RSDS_R_ObjRAccelXStd_2 "/";
CM_ SG_ 1424 RSDS_R_ObjRelVelYStd_2 "/";
CM_ SG_ 1424 RSDS_R_ObjRelVelXStd_2 "/";
CM_ SG_ 1424 RSDS_R_ObjDistYStd_2 "/";
CM_ SG_ 1424 RSDS_R_SGU1_Checksum7 "/";
CM_ SG_ 1424 RSDS_R_SGU1_RollingCounter6 "/";
CM_ SG_ 1424 RSDS_R_ObjMotionType_2 "/";
CM_ SG_ 1424 RSDS_R_ObjMeasured_2 "/";
CM_ SG_ 1424 RSDS_R_ObjRelAccelY_2 "/";
CM_ SG_ 1424 RSDS_R_ObjRelAccelX_2 "/";
CM_ SG_ 1424 RSDS_R_ObjRelVelY_2 "/";
CM_ SG_ 1424 RSDS_R_ObjRelVelX_2 "/";
CM_ SG_ 1424 RSDS_R_SGU1_Checksum6 "/";
CM_ SG_ 1424 RSDS_R_SGU1_RollingCounter5 "/";
CM_ SG_ 1424 RSDS_R_ObjType_2 "/";
CM_ SG_ 1424 RSDS_R_ObjDistXStd_2 "/";
CM_ SG_ 1424 RSDS_R_ObjDistY_2 "/";
CM_ SG_ 1424 RSDS_R_ObjDistX_2 "/";
CM_ SG_ 1424 RSDS_R_ObjObstacleProb_2 "/";
CM_ SG_ 1424 RSDS_R_ObjExistProb_2 "/";
CM_ SG_ 1424 RSDS_R_ObjID_2 "/";
CM_ SG_ 1424 RSDS_R_SGU1_Checksum5 "/";
CM_ SG_ 1424 RSDS_R_SGU1_RollingCounter4 "/";
CM_ SG_ 1424 RSDS_R_HWATargetValidity_1 "/";
CM_ SG_ 1424 RSDS_R_ObjRefPoint_1 "/";
CM_ SG_ 1424 RSDS_R_ObjRCS_1 "/";
CM_ SG_ 1424 RSDS_R_ObjYawrate_1 "/";
CM_ SG_ 1424 RSDS_R_ObjHeading_1 "/";
CM_ SG_ 1424 RSDS_R_ObjLength_1 "/";
CM_ SG_ 1424 RSDS_R_SGU1_Checksum4 "/";
CM_ SG_ 1424 RSDS_R_SGU1_RollingCounter3 "/";
CM_ SG_ 1424 RSDS_R_ObjMotionDirection_1 "/";
CM_ SG_ 1424 RSDS_R_ObjAge_1 "/";
CM_ SG_ 1424 RSDS_R_ObjWidth_1 "/";
CM_ SG_ 1424 RSDS_R_ObjRAccelYStd_1 "/";
CM_ SG_ 1424 RSDS_R_ObjRAccelXStd_1 "/";
CM_ SG_ 1424 RSDS_R_ObjRelVelYStd_1 "/";
CM_ SG_ 1424 RSDS_R_ObjRelVelXStd_1 "/";
CM_ SG_ 1424 RSDS_R_ObjDistYStd_1 "/";
CM_ SG_ 1424 RSDS_R_SGU1_Checksum3 "/";
CM_ SG_ 1424 RSDS_R_SGU1_RollingCounter2 "/";
CM_ SG_ 1424 RSDS_R_ObjMotionType_1 "/";
CM_ SG_ 1424 RSDS_R_ObjMeasured_1 "/";
CM_ SG_ 1424 RSDS_R_ObjRelAccelY_1 "/";
CM_ SG_ 1424 RSDS_R_ObjRelAccelX_1 "/";
CM_ SG_ 1424 RSDS_R_ObjRelVelY_1 "/";
CM_ SG_ 1424 RSDS_R_ObjRelVelX_1 "/";
CM_ SG_ 1424 RSDS_R_SGU1_Checksum2 "/";
CM_ SG_ 1424 RSDS_R_SGU1_RollingCounter1 "/";
CM_ SG_ 1424 RSDS_R_ObjType_1 "/";
CM_ SG_ 1424 RSDS_R_ObjDistXStd_1 "/";
CM_ SG_ 1424 RSDS_R_ObjDistY_1 "/";
CM_ SG_ 1424 RSDS_R_ObjDistX_1 "/";
CM_ SG_ 1424 RSDS_R_ObjObstacleProb_1 "/";
CM_ SG_ 1424 RSDS_R_ObjExistProb_1 "/";
CM_ SG_ 1424 RSDS_R_ObjID_1 "/";
CM_ SG_ 1424 RSDS_R_SGU1_Checksum1 "/";
CM_ SG_ 1425 RSDS_R_SGU2_RollingCounter8 "/";
CM_ SG_ 1425 RSDS_R_SGU2_BlockCounter "/";
CM_ SG_ 1425 RSDS_R_HWATargetValidity_4 "/";
CM_ SG_ 1425 RSDS_R_ObjRefPoint_4 "/";
CM_ SG_ 1425 RSDS_R_ObjRCS_4 "/";
CM_ SG_ 1425 RSDS_R_ObjYawrate_4 "/";
CM_ SG_ 1425 RSDS_R_ObjHeading_4 "/";
CM_ SG_ 1425 RSDS_R_ObjLength_4 "/";
CM_ SG_ 1425 RSDS_R_SGU2_Checksum8 "/";
CM_ SG_ 1425 RSDS_R_SGU2_RollingCounter7 "/";
CM_ SG_ 1425 RSDS_R_ObjMotionDirection_4 "/";
CM_ SG_ 1425 RSDS_R_ObjAge_4 "/";
CM_ SG_ 1425 RSDS_R_ObjWidth_4 "/";
CM_ SG_ 1425 RSDS_R_ObjRAccelYStd_4 "/";
CM_ SG_ 1425 RSDS_R_ObjRAccelXStd_4 "/";
CM_ SG_ 1425 RSDS_R_ObjRelVelYStd_4 "/";
CM_ SG_ 1425 RSDS_R_ObjRelVelXStd_4 "/";
CM_ SG_ 1425 RSDS_R_ObjDistYStd_4 "/";
CM_ SG_ 1425 RSDS_R_SGU2_Checksum7 "/";
CM_ SG_ 1425 RSDS_R_SGU2_RollingCounter6 "/";
CM_ SG_ 1425 RSDS_R_ObjMotionType_4 "/";
CM_ SG_ 1425 RSDS_R_ObjMeasured_4 "/";
CM_ SG_ 1425 RSDS_R_ObjRelAccelY_4 "/";
CM_ SG_ 1425 RSDS_R_ObjRelAccelX_4 "/";
CM_ SG_ 1425 RSDS_R_ObjRelVelY_4 "/";
CM_ SG_ 1425 RSDS_R_ObjRelVelX_4 "/";
CM_ SG_ 1425 RSDS_R_SGU2_Checksum6 "/";
CM_ SG_ 1425 RSDS_R_SGU2_RollingCounter5 "/";
CM_ SG_ 1425 RSDS_R_ObjType_4 "/";
CM_ SG_ 1425 RSDS_R_ObjDistXStd_4 "/";
CM_ SG_ 1425 RSDS_R_ObjDistY_4 "/";
CM_ SG_ 1425 RSDS_R_ObjDistX_4 "/";
CM_ SG_ 1425 RSDS_R_ObjObstacleProb_4 "/";
CM_ SG_ 1425 RSDS_R_ObjExistProb_4 "/";
CM_ SG_ 1425 RSDS_R_ObjID_4 "/";
CM_ SG_ 1425 RSDS_R_SGU2_Checksum5 "/";
CM_ SG_ 1425 RSDS_R_SGU2_RollingCounter4 "/";
CM_ SG_ 1425 RSDS_R_HWATargetValidity_3 "/";
CM_ SG_ 1425 RSDS_R_ObjRefPoint_3 "/";
CM_ SG_ 1425 RSDS_R_ObjRCS_3 "/";
CM_ SG_ 1425 RSDS_R_ObjYawrate_3 "/";
CM_ SG_ 1425 RSDS_R_ObjHeading_3 "/";
CM_ SG_ 1425 RSDS_R_ObjLength_3 "/";
CM_ SG_ 1425 RSDS_R_SGU2_Checksum4 "/";
CM_ SG_ 1425 RSDS_R_SGU2_RollingCounter3 "/";
CM_ SG_ 1425 RSDS_R_ObjMotionDirection_3 "/";
CM_ SG_ 1425 RSDS_R_ObjAge_3 "/";
CM_ SG_ 1425 RSDS_R_ObjWidth_3 "/";
CM_ SG_ 1425 RSDS_R_ObjRAccelYStd_3 "/";
CM_ SG_ 1425 RSDS_R_ObjRAccelXStd_3 "/";
CM_ SG_ 1425 RSDS_R_ObjRelVelYStd_3 "/";
CM_ SG_ 1425 RSDS_R_ObjRelVelXStd_3 "/";
CM_ SG_ 1425 RSDS_R_ObjDistYStd_3 "/";
CM_ SG_ 1425 RSDS_R_SGU2_Checksum3 "/";
CM_ SG_ 1425 RSDS_R_SGU2_RollingCounter2 "/";
CM_ SG_ 1425 RSDS_R_ObjMotionType_3 "/";
CM_ SG_ 1425 RSDS_R_ObjMeasured_3 "/";
CM_ SG_ 1425 RSDS_R_ObjRelAccelY_3 "/";
CM_ SG_ 1425 RSDS_R_ObjRelAccelX_3 "/";
CM_ SG_ 1425 RSDS_R_ObjRelVelY_3 "/";
CM_ SG_ 1425 RSDS_R_ObjRelVelX_3 "/";
CM_ SG_ 1425 RSDS_R_SGU2_Checksum2 "/";
CM_ SG_ 1425 RSDS_R_SGU2_RollingCounter1 "/";
CM_ SG_ 1425 RSDS_R_ObjType_3 "/";
CM_ SG_ 1425 RSDS_R_ObjDistXStd_3 "/";
CM_ SG_ 1425 RSDS_R_ObjDistY_3 "/";
CM_ SG_ 1425 RSDS_R_ObjDistX_3 "/";
CM_ SG_ 1425 RSDS_R_ObjObstacleProb_3 "/";
CM_ SG_ 1425 RSDS_R_ObjExistProb_3 "/";
CM_ SG_ 1425 RSDS_R_ObjID_3 "/";
CM_ SG_ 1425 RSDS_R_SGU2_Checksum1 "/";
CM_ SG_ 1426 RSDS_R_SGU3_RollingCounter8 "/";
CM_ SG_ 1426 RSDS_R_SGU3_BlockCounter "/";
CM_ SG_ 1426 RSDS_R_HWATargetValidity_6 "/";
CM_ SG_ 1426 RSDS_R_ObjRefPoint_6 "/";
CM_ SG_ 1426 RSDS_R_ObjRCS_6 "/";
CM_ SG_ 1426 RSDS_R_ObjYawrate_6 "/";
CM_ SG_ 1426 RSDS_R_ObjHeading_6 "/";
CM_ SG_ 1426 RSDS_R_ObjLength_6 "/";
CM_ SG_ 1426 RSDS_R_SGU3_Checksum8 "/";
CM_ SG_ 1426 RSDS_R_SGU3_RollingCounter7 "/";
CM_ SG_ 1426 RSDS_R_ObjMotionDirection_6 "/";
CM_ SG_ 1426 RSDS_R_ObjAge_6 "/";
CM_ SG_ 1426 RSDS_R_ObjWidth_6 "/";
CM_ SG_ 1426 RSDS_R_ObjRAccelYStd_6 "/";
CM_ SG_ 1426 RSDS_R_ObjRAccelXStd_6 "/";
CM_ SG_ 1426 RSDS_R_ObjRelVelYStd_6 "/";
CM_ SG_ 1426 RSDS_R_ObjRelVelXStd_6 "/";
CM_ SG_ 1426 RSDS_R_ObjDistYStd_6 "/";
CM_ SG_ 1426 RSDS_R_SGU3_Checksum7 "/";
CM_ SG_ 1426 RSDS_R_SGU3_RollingCounter6 "/";
CM_ SG_ 1426 RSDS_R_ObjMotionType_6 "/";
CM_ SG_ 1426 RSDS_R_ObjMeasured_6 "/";
CM_ SG_ 1426 RSDS_R_ObjRelAccelY_6 "/";
CM_ SG_ 1426 RSDS_R_ObjRelAccelX_6 "/";
CM_ SG_ 1426 RSDS_R_ObjRelVelY_6 "/";
CM_ SG_ 1426 RSDS_R_ObjRelVelX_6 "/";
CM_ SG_ 1426 RSDS_R_SGU3_Checksum6 "/";
CM_ SG_ 1426 RSDS_R_SGU3_RollingCounter5 "/";
CM_ SG_ 1426 RSDS_R_ObjType_6 "/";
CM_ SG_ 1426 RSDS_R_ObjDistXStd_6 "/";
CM_ SG_ 1426 RSDS_R_ObjDistY_6 "/";
CM_ SG_ 1426 RSDS_R_ObjDistX_6 "/";
CM_ SG_ 1426 RSDS_R_ObjObstacleProb_6 "/";
CM_ SG_ 1426 RSDS_R_ObjExistProb_6 "/";
CM_ SG_ 1426 RSDS_R_ObjID_6 "/";
CM_ SG_ 1426 RSDS_R_SGU3_Checksum5 "/";
CM_ SG_ 1426 RSDS_R_SGU3_RollingCounter4 "/";
CM_ SG_ 1426 RSDS_R_HWATargetValidity_5 "/";
CM_ SG_ 1426 RSDS_R_ObjRefPoint_5 "/";
CM_ SG_ 1426 RSDS_R_ObjRCS_5 "/";
CM_ SG_ 1426 RSDS_R_ObjYawrate_5 "/";
CM_ SG_ 1426 RSDS_R_ObjHeading_5 "/";
CM_ SG_ 1426 RSDS_R_ObjLength_5 "/";
CM_ SG_ 1426 RSDS_R_SGU3_Checksum4 "/";
CM_ SG_ 1426 RSDS_R_SGU3_RollingCounter3 "/";
CM_ SG_ 1426 RSDS_R_ObjMotionDirection_5 "/";
CM_ SG_ 1426 RSDS_R_ObjAge_5 "/";
CM_ SG_ 1426 RSDS_R_ObjWidth_5 "/";
CM_ SG_ 1426 RSDS_R_ObjRAccelYStd_5 "/";
CM_ SG_ 1426 RSDS_R_ObjRAccelXStd_5 "/";
CM_ SG_ 1426 RSDS_R_ObjRelVelYStd_5 "/";
CM_ SG_ 1426 RSDS_R_ObjRelVelXStd_5 "/";
CM_ SG_ 1426 RSDS_R_ObjDistYStd_5 "/";
CM_ SG_ 1426 RSDS_R_SGU3_Checksum3 "/";
CM_ SG_ 1426 RSDS_R_SGU3_RollingCounter2 "/";
CM_ SG_ 1426 RSDS_R_ObjMotionType_5 "/";
CM_ SG_ 1426 RSDS_R_ObjMeasured_5 "/";
CM_ SG_ 1426 RSDS_R_ObjRelAccelY_5 "/";
CM_ SG_ 1426 RSDS_R_ObjRelAccelX_5 "/";
CM_ SG_ 1426 RSDS_R_ObjRelVelY_5 "/";
CM_ SG_ 1426 RSDS_R_ObjRelVelX_5 "/";
CM_ SG_ 1426 RSDS_R_SGU3_Checksum2 "/";
CM_ SG_ 1426 RSDS_R_SGU3_RollingCounter1 "/";
CM_ SG_ 1426 RSDS_R_ObjType_5 "/";
CM_ SG_ 1426 RSDS_R_ObjDistXStd_5 "/";
CM_ SG_ 1426 RSDS_R_ObjDistY_5 "/";
CM_ SG_ 1426 RSDS_R_ObjDistX_5 "/";
CM_ SG_ 1426 RSDS_R_ObjObstacleProb_5 "/";
CM_ SG_ 1426 RSDS_R_ObjExistProb_5 "/";
CM_ SG_ 1426 RSDS_R_ObjID_5 "/";
CM_ SG_ 1426 RSDS_R_SGU3_Checksum1 "/";
CM_ SG_ 1427 RSDS_R_SGU4_RollingCounter8 "/";
CM_ SG_ 1427 RSDS_R_SGU4_BlockCounter "/";
CM_ SG_ 1427 RSDS_R_HWATargetValidity_8 "/";
CM_ SG_ 1427 RSDS_R_ObjRefPoint_8 "/";
CM_ SG_ 1427 RSDS_R_ObjRCS_8 "/";
CM_ SG_ 1427 RSDS_R_ObjYawrate_8 "/";
CM_ SG_ 1427 RSDS_R_ObjHeading_8 "/";
CM_ SG_ 1427 RSDS_R_ObjLength_8 "/";
CM_ SG_ 1427 RSDS_R_SGU4_Checksum8 "/";
CM_ SG_ 1427 RSDS_R_SGU4_RollingCounter7 "/";
CM_ SG_ 1427 RSDS_R_ObjMotionDirection_8 "/";
CM_ SG_ 1427 RSDS_R_ObjAge_8 "/";
CM_ SG_ 1427 RSDS_R_ObjWidth_8 "/";
CM_ SG_ 1427 RSDS_R_ObjRAccelYStd_8 "/";
CM_ SG_ 1427 RSDS_R_ObjRAccelXStd_8 "/";
CM_ SG_ 1427 RSDS_R_ObjRelVelYStd_8 "/";
CM_ SG_ 1427 RSDS_R_ObjRelVelXStd_8 "/";
CM_ SG_ 1427 RSDS_R_ObjDistYStd_8 "/";
CM_ SG_ 1427 RSDS_R_SGU4_Checksum7 "/";
CM_ SG_ 1427 RSDS_R_SGU4_RollingCounter6 "/";
CM_ SG_ 1427 RSDS_R_ObjMotionType_8 "/";
CM_ SG_ 1427 RSDS_R_ObjMeasured_8 "/";
CM_ SG_ 1427 RSDS_R_ObjRelAccelY_8 "/";
CM_ SG_ 1427 RSDS_R_ObjRelAccelX_8 "/";
CM_ SG_ 1427 RSDS_R_ObjRelVelY_8 "/";
CM_ SG_ 1427 RSDS_R_ObjRelVelX_8 "/";
CM_ SG_ 1427 RSDS_R_SGU4_Checksum6 "/";
CM_ SG_ 1427 RSDS_R_SGU4_RollingCounter5 "/";
CM_ SG_ 1427 RSDS_R_ObjType_8 "/";
CM_ SG_ 1427 RSDS_R_ObjDistXStd_8 "/";
CM_ SG_ 1427 RSDS_R_ObjDistY_8 "/";
CM_ SG_ 1427 RSDS_R_ObjDistX_8 "/";
CM_ SG_ 1427 RSDS_R_ObjObstacleProb_8 "/";
CM_ SG_ 1427 RSDS_R_ObjExistProb_8 "/";
CM_ SG_ 1427 RSDS_R_ObjID_8 "/";
CM_ SG_ 1427 RSDS_R_SGU4_Checksum5 "/";
CM_ SG_ 1427 RSDS_R_SGU4_RollingCounter4 "/";
CM_ SG_ 1427 RSDS_R_HWATargetValidity_7 "/";
CM_ SG_ 1427 RSDS_R_ObjRefPoint_7 "/";
CM_ SG_ 1427 RSDS_R_ObjRCS_7 "/";
CM_ SG_ 1427 RSDS_R_ObjYawrate_7 "/";
CM_ SG_ 1427 RSDS_R_ObjHeading_7 "/";
CM_ SG_ 1427 RSDS_R_ObjLength_7 "/";
CM_ SG_ 1427 RSDS_R_SGU4_Checksum4 "/";
CM_ SG_ 1427 RSDS_R_SGU4_RollingCounter3 "/";
CM_ SG_ 1427 RSDS_R_ObjMotionDirection_7 "/";
CM_ SG_ 1427 RSDS_R_ObjAge_7 "/";
CM_ SG_ 1427 RSDS_R_ObjWidth_7 "/";
CM_ SG_ 1427 RSDS_R_ObjRAccelYStd_7 "/";
CM_ SG_ 1427 RSDS_R_ObjRAccelXStd_7 "/";
CM_ SG_ 1427 RSDS_R_ObjRelVelYStd_7 "/";
CM_ SG_ 1427 RSDS_R_ObjRelVelXStd_7 "/";
CM_ SG_ 1427 RSDS_R_ObjDistYStd_7 "/";
CM_ SG_ 1427 RSDS_R_SGU4_Checksum3 "/";
CM_ SG_ 1427 RSDS_R_SGU4_RollingCounter2 "/";
CM_ SG_ 1427 RSDS_R_ObjMotionType_7 "/";
CM_ SG_ 1427 RSDS_R_ObjMeasured_7 "/";
CM_ SG_ 1427 RSDS_R_ObjRelAccelY_7 "/";
CM_ SG_ 1427 RSDS_R_ObjRelAccelX_7 "/";
CM_ SG_ 1427 RSDS_R_ObjRelVelY_7 "/";
CM_ SG_ 1427 RSDS_R_ObjRelVelX_7 "/";
CM_ SG_ 1427 RSDS_R_SGU4_Checksum2 "/";
CM_ SG_ 1427 RSDS_R_SGU4_RollingCounter1 "/";
CM_ SG_ 1427 RSDS_R_ObjType_7 "/";
CM_ SG_ 1427 RSDS_R_ObjDistXStd_7 "/";
CM_ SG_ 1427 RSDS_R_ObjDistY_7 "/";
CM_ SG_ 1427 RSDS_R_ObjDistX_7 "/";
CM_ SG_ 1427 RSDS_R_ObjObstacleProb_7 "/";
CM_ SG_ 1427 RSDS_R_ObjExistProb_7 "/";
CM_ SG_ 1427 RSDS_R_ObjID_7 "/";
CM_ SG_ 1427 RSDS_R_SGU4_Checksum1 "/";
CM_ SG_ 1428 RSDS_R_SGU5_RollingCounter8 "/";
CM_ SG_ 1428 RSDS_R_SGU5_BlockCounter "/";
CM_ SG_ 1428 RSDS_R_HWATargetValidity_10 "/";
CM_ SG_ 1428 RSDS_R_ObjRefPoint_10 "/";
CM_ SG_ 1428 RSDS_R_ObjRCS_10 "/";
CM_ SG_ 1428 RSDS_R_ObjYawrate_10 "/";
CM_ SG_ 1428 RSDS_R_ObjHeading_10 "/";
CM_ SG_ 1428 RSDS_R_ObjLength_10 "/";
CM_ SG_ 1428 RSDS_R_SGU5_Checksum8 "/";
CM_ SG_ 1428 RSDS_R_SGU5_RollingCounter7 "/";
CM_ SG_ 1428 RSDS_R_ObjMotionDirection_10 "/";
CM_ SG_ 1428 RSDS_R_ObjAge_10 "/";
CM_ SG_ 1428 RSDS_R_ObjWidth_10 "/";
CM_ SG_ 1428 RSDS_R_ObjRAccelYStd_10 "/";
CM_ SG_ 1428 RSDS_R_ObjRAccelXStd_10 "/";
CM_ SG_ 1428 RSDS_R_ObjRelVelYStd_10 "/";
CM_ SG_ 1428 RSDS_R_ObjRelVelXStd_10 "/";
CM_ SG_ 1428 RSDS_R_ObjDistYStd_10 "/";
CM_ SG_ 1428 RSDS_R_SGU5_Checksum7 "/";
CM_ SG_ 1428 RSDS_R_SGU5_RollingCounter6 "/";
CM_ SG_ 1428 RSDS_R_ObjMotionType_10 "/";
CM_ SG_ 1428 RSDS_R_ObjMeasured_10 "/";
CM_ SG_ 1428 RSDS_R_ObjRelAccelY_10 "/";
CM_ SG_ 1428 RSDS_R_ObjRelAccelX_10 "/";
CM_ SG_ 1428 RSDS_R_ObjRelVelY_10 "/";
CM_ SG_ 1428 RSDS_R_ObjRelVelX_10 "/";
CM_ SG_ 1428 RSDS_R_SGU5_Checksum6 "/";
CM_ SG_ 1428 RSDS_R_SGU5_RollingCounter5 "/";
CM_ SG_ 1428 RSDS_R_ObjType_10 "/";
CM_ SG_ 1428 RSDS_R_ObjDistXStd_10 "/";
CM_ SG_ 1428 RSDS_R_ObjDistY_10 "/";
CM_ SG_ 1428 RSDS_R_ObjDistX_10 "/";
CM_ SG_ 1428 RSDS_R_ObjObstacleProb_10 "/";
CM_ SG_ 1428 RSDS_R_ObjExistProb_10 "/";
CM_ SG_ 1428 RSDS_R_ObjID_10 "/";
CM_ SG_ 1428 RSDS_R_SGU5_Checksum5 "/";
CM_ SG_ 1428 RSDS_R_SGU5_RollingCounter4 "/";
CM_ SG_ 1428 RSDS_R_HWATargetValidity_9 "/";
CM_ SG_ 1428 RSDS_R_ObjRefPoint_9 "/";
CM_ SG_ 1428 RSDS_R_ObjRCS_9 "/";
CM_ SG_ 1428 RSDS_R_ObjYawrate_9 "/";
CM_ SG_ 1428 RSDS_R_ObjHeading_9 "/";
CM_ SG_ 1428 RSDS_R_ObjLength_9 "/";
CM_ SG_ 1428 RSDS_R_SGU5_Checksum4 "/";
CM_ SG_ 1428 RSDS_R_SGU5_RollingCounter3 "/";
CM_ SG_ 1428 RSDS_R_ObjMotionDirection_9 "/";
CM_ SG_ 1428 RSDS_R_ObjAge_9 "/";
CM_ SG_ 1428 RSDS_R_ObjWidth_9 "/";
CM_ SG_ 1428 RSDS_R_ObjRAccelYStd_9 "/";
CM_ SG_ 1428 RSDS_R_ObjRAccelXStd_9 "/";
CM_ SG_ 1428 RSDS_R_ObjRelVelYStd_9 "/";
CM_ SG_ 1428 RSDS_R_ObjRelVelXStd_9 "/";
CM_ SG_ 1428 RSDS_R_ObjDistYStd_9 "/";
CM_ SG_ 1428 RSDS_R_SGU5_Checksum3 "/";
CM_ SG_ 1428 RSDS_R_SGU5_RollingCounter2 "/";
CM_ SG_ 1428 RSDS_R_ObjMotionType_9 "/";
CM_ SG_ 1428 RSDS_R_ObjMeasured_9 "/";
CM_ SG_ 1428 RSDS_R_ObjRelAccelY_9 "/";
CM_ SG_ 1428 RSDS_R_ObjRelAccelX_9 "/";
CM_ SG_ 1428 RSDS_R_ObjRelVelY_9 "/";
CM_ SG_ 1428 RSDS_R_ObjRelVelX_9 "/";
CM_ SG_ 1428 RSDS_R_SGU5_Checksum2 "/";
CM_ SG_ 1428 RSDS_R_SGU5_RollingCounter1 "/";
CM_ SG_ 1428 RSDS_R_ObjType_9 "/";
CM_ SG_ 1428 RSDS_R_ObjDistXStd_9 "/";
CM_ SG_ 1428 RSDS_R_ObjDistY_9 "/";
CM_ SG_ 1428 RSDS_R_ObjDistX_9 "/";
CM_ SG_ 1428 RSDS_R_ObjObstacleProb_9 "/";
CM_ SG_ 1428 RSDS_R_ObjExistProb_9 "/";
CM_ SG_ 1428 RSDS_R_ObjID_9 "/";
CM_ SG_ 1428 RSDS_R_SGU5_Checksum1 "/";
BA_DEF_ BO_  "GenMsgILSupport" ENUM  "No","Yes";
BA_DEF_ BO_  "VFrameFormat" ENUM  "StandardCAN","ExtendedCAN","reserved","reserved","reserved","reserved","reserved","reserved","reserved","reserved","reserved","reserved","reserved","reserved","StandardCAN_FD","ExtendedCAN_FD";
BA_DEF_ SG_  "GenSigSendType" ENUM  "Cyclic","OnWrite","OnWriteWithRepetition","OnChange","OnChangeWithRepetition","IfActive","IfActiveWithRepetition","NoSigSendType","CyclicAndSpontanX","NotUsed","Event","CE";
BA_DEF_ SG_  "IsMonitor" ENUM  "*","Monitor";
BA_DEF_ SG_  "UnitConversionFactor" FLOAT -100 100;
BA_DEF_ SG_  "SigInvalidSetFlag" ENUM  "*","Yes";
BA_DEF_ SG_  "Internal_type" ENUM  "*","UB","UW","UL","SB","SW","SL";
BA_DEF_ SG_  "IsCrcSignal" ENUM  "No","Yes";
BA_DEF_ SG_  "IsRcSignal" ENUM  "No","Yes";
BA_DEF_ BO_  "GenMsgSendType" ENUM  "Cyclic","Event","CE","NotUsed","NotUsed","NotUsed","NotUsed","NotUsed","NoMsgSendType","IfActive","IfActiveWithRepetition","CyclicAndSpontanX";
BA_DEF_ SG_  "GenSigStartValue" INT 0 2147483647;
BA_DEF_ BO_  "MsgType" ENUM  "Normal","NM","Diag","vector_leerstring";
BA_DEF_ BO_  "GenMsgCycleTime" INT 0 65535;
BA_DEF_DEF_  "GenMsgILSupport" "Yes";
BA_DEF_DEF_  "VFrameFormat" "StandardCAN";
BA_DEF_DEF_  "GenSigSendType" "Cyclic";
BA_DEF_DEF_  "IsMonitor" "*";
BA_DEF_DEF_  "UnitConversionFactor" 1;
BA_DEF_DEF_  "SigInvalidSetFlag" "*";
BA_DEF_DEF_  "Internal_type" "*";
BA_DEF_DEF_  "IsCrcSignal" "No";
BA_DEF_DEF_  "IsRcSignal" "No";
BA_DEF_DEF_  "GenMsgSendType" "Cyclic";
BA_DEF_DEF_  "GenSigStartValue" 0;
BA_DEF_DEF_  "MsgType" "";
BA_DEF_DEF_  "GenMsgCycleTime" 0;
BA_ "GenMsgSendType" BO_ 1418 1;
BA_ "MsgType" BO_ 1418 0;
BA_ "VFrameFormat" BO_ 1418 14;
BA_ "GenMsgSendType" BO_ 1419 1;
BA_ "MsgType" BO_ 1419 0;
BA_ "VFrameFormat" BO_ 1419 14;
BA_ "GenMsgSendType" BO_ 1420 1;
BA_ "MsgType" BO_ 1420 0;
BA_ "VFrameFormat" BO_ 1420 14;
BA_ "GenMsgSendType" BO_ 1421 1;
BA_ "MsgType" BO_ 1421 0;
BA_ "VFrameFormat" BO_ 1421 14;
BA_ "GenMsgSendType" BO_ 1422 1;
BA_ "MsgType" BO_ 1422 0;
BA_ "VFrameFormat" BO_ 1422 14;
BA_ "GenMsgSendType" BO_ 1423 1;
BA_ "MsgType" BO_ 1423 0;
BA_ "VFrameFormat" BO_ 1423 14;
BA_ "GenMsgSendType" BO_ 1486 1;
BA_ "MsgType" BO_ 1486 0;
BA_ "VFrameFormat" BO_ 1486 14;
BA_ "GenMsgSendType" BO_ 1966 1;
BA_ "MsgType" BO_ 1966 0;
BA_ "GenMsgSendType" BO_ 1424 1;
BA_ "MsgType" BO_ 1424 0;
BA_ "VFrameFormat" BO_ 1424 14;
BA_ "GenMsgSendType" BO_ 1425 1;
BA_ "MsgType" BO_ 1425 0;
BA_ "VFrameFormat" BO_ 1425 14;
BA_ "GenMsgSendType" BO_ 1426 1;
BA_ "MsgType" BO_ 1426 0;
BA_ "VFrameFormat" BO_ 1426 14;
BA_ "GenMsgSendType" BO_ 1427 1;
BA_ "MsgType" BO_ 1427 0;
BA_ "VFrameFormat" BO_ 1427 14;
BA_ "GenMsgSendType" BO_ 1428 1;
BA_ "MsgType" BO_ 1428 0;
BA_ "VFrameFormat" BO_ 1428 14;
BA_ "GenSigSendType" SG_ 1418 RSDS_L_SGU11_RollingCounter8 9;
BA_ "IsRcSignal" SG_ 1418 RSDS_L_SGU11_RollingCounter8 1;
BA_ "GenSigSendType" SG_ 1418 RSDS_L_SGU11_BlockCounter 9;
BA_ "GenSigSendType" SG_ 1418 RSDS_L_HWATargetValidity_22 9;
BA_ "GenSigSendType" SG_ 1418 RSDS_L_ObjRefPoint_22 9;
BA_ "GenSigStartValue" SG_ 1418 RSDS_L_ObjRCS_22 400;
BA_ "GenSigSendType" SG_ 1418 RSDS_L_ObjRCS_22 9;
BA_ "GenSigSendType" SG_ 1418 RSDS_L_ObjYawrate_22 9;
BA_ "GenSigSendType" SG_ 1418 RSDS_L_ObjHeading_22 9;
BA_ "GenSigSendType" SG_ 1418 RSDS_L_ObjLength_22 9;
BA_ "GenSigSendType" SG_ 1418 RSDS_L_SGU11_Checksum8 9;
BA_ "IsCrcSignal" SG_ 1418 RSDS_L_SGU11_Checksum8 1;
BA_ "GenSigSendType" SG_ 1418 RSDS_L_SGU11_RollingCounter7 9;
BA_ "IsRcSignal" SG_ 1418 RSDS_L_SGU11_RollingCounter7 1;
BA_ "GenSigSendType" SG_ 1418 RSDS_L_ObjMotionDirection_22 9;
BA_ "GenSigSendType" SG_ 1418 RSDS_L_ObjAge_22 9;
BA_ "GenSigSendType" SG_ 1418 RSDS_L_ObjWidth_22 9;
BA_ "GenSigSendType" SG_ 1418 RSDS_L_ObjRAccelYStd_22 9;
BA_ "GenSigSendType" SG_ 1418 RSDS_L_ObjRAccelXStd_22 9;
BA_ "GenSigSendType" SG_ 1418 RSDS_L_ObjRelVelYStd_22 9;
BA_ "GenSigSendType" SG_ 1418 RSDS_L_ObjRelVelXStd_22 9;
BA_ "GenSigSendType" SG_ 1418 RSDS_L_ObjDistYStd_22 9;
BA_ "GenSigSendType" SG_ 1418 RSDS_L_SGU11_Checksum7 9;
BA_ "IsCrcSignal" SG_ 1418 RSDS_L_SGU11_Checksum7 1;
BA_ "GenSigSendType" SG_ 1418 RSDS_L_SGU11_RollingCounter6 9;
BA_ "IsRcSignal" SG_ 1418 RSDS_L_SGU11_RollingCounter6 1;
BA_ "GenSigSendType" SG_ 1418 RSDS_L_ObjMotionType_22 9;
BA_ "GenSigStartValue" SG_ 1418 RSDS_L_ObjMeasured_22 1;
BA_ "GenSigSendType" SG_ 1418 RSDS_L_ObjMeasured_22 9;
BA_ "GenSigStartValue" SG_ 1418 RSDS_L_ObjRelAccelY_22 512;
BA_ "GenSigSendType" SG_ 1418 RSDS_L_ObjRelAccelY_22 9;
BA_ "GenSigStartValue" SG_ 1418 RSDS_L_ObjRelAccelX_22 512;
BA_ "GenSigSendType" SG_ 1418 RSDS_L_ObjRelAccelX_22 9;
BA_ "GenSigStartValue" SG_ 1418 RSDS_L_ObjRelVelY_22 4102;
BA_ "GenSigSendType" SG_ 1418 RSDS_L_ObjRelVelY_22 9;
BA_ "GenSigStartValue" SG_ 1418 RSDS_L_ObjRelVelX_22 4102;
BA_ "GenSigSendType" SG_ 1418 RSDS_L_ObjRelVelX_22 9;
BA_ "GenSigSendType" SG_ 1418 RSDS_L_SGU11_Checksum6 9;
BA_ "IsCrcSignal" SG_ 1418 RSDS_L_SGU11_Checksum6 1;
BA_ "GenSigSendType" SG_ 1418 RSDS_L_SGU11_RollingCounter5 9;
BA_ "IsRcSignal" SG_ 1418 RSDS_L_SGU11_RollingCounter5 1;
BA_ "GenSigSendType" SG_ 1418 RSDS_L_ObjType_22 9;
BA_ "GenSigSendType" SG_ 1418 RSDS_L_ObjDistXStd_22 9;
BA_ "GenSigStartValue" SG_ 1418 RSDS_L_ObjDistY_22 1024;
BA_ "GenSigSendType" SG_ 1418 RSDS_L_ObjDistY_22 9;
BA_ "GenSigSendType" SG_ 1418 RSDS_L_ObjDistX_22 9;
BA_ "GenSigSendType" SG_ 1418 RSDS_L_ObjObstacleProb_22 9;
BA_ "GenSigSendType" SG_ 1418 RSDS_L_ObjExistProb_22 9;
BA_ "GenSigSendType" SG_ 1418 RSDS_L_ObjID_22 9;
BA_ "GenSigSendType" SG_ 1418 RSDS_L_SGU11_Checksum5 9;
BA_ "IsCrcSignal" SG_ 1418 RSDS_L_SGU11_Checksum5 1;
BA_ "GenSigSendType" SG_ 1418 RSDS_L_SGU11_RollingCounter4 9;
BA_ "IsRcSignal" SG_ 1418 RSDS_L_SGU11_RollingCounter4 1;
BA_ "GenSigSendType" SG_ 1418 RSDS_L_HWATargetValidity_21 9;
BA_ "GenSigSendType" SG_ 1418 RSDS_L_ObjRefPoint_21 9;
BA_ "GenSigStartValue" SG_ 1418 RSDS_L_ObjRCS_21 400;
BA_ "GenSigSendType" SG_ 1418 RSDS_L_ObjRCS_21 9;
BA_ "GenSigSendType" SG_ 1418 RSDS_L_ObjYawrate_21 9;
BA_ "GenSigSendType" SG_ 1418 RSDS_L_ObjHeading_21 9;
BA_ "GenSigSendType" SG_ 1418 RSDS_L_ObjLength_21 9;
BA_ "GenSigSendType" SG_ 1418 RSDS_L_SGU11_Checksum4 9;
BA_ "IsCrcSignal" SG_ 1418 RSDS_L_SGU11_Checksum4 1;
BA_ "GenSigSendType" SG_ 1418 RSDS_L_SGU11_RollingCounter3 9;
BA_ "IsRcSignal" SG_ 1418 RSDS_L_SGU11_RollingCounter3 1;
BA_ "GenSigSendType" SG_ 1418 RSDS_L_ObjMotionDirection_21 9;
BA_ "GenSigSendType" SG_ 1418 RSDS_L_ObjAge_21 9;
BA_ "GenSigSendType" SG_ 1418 RSDS_L_ObjWidth_21 9;
BA_ "GenSigSendType" SG_ 1418 RSDS_L_ObjRAccelYStd_21 9;
BA_ "GenSigSendType" SG_ 1418 RSDS_L_ObjRAccelXStd_21 9;
BA_ "GenSigSendType" SG_ 1418 RSDS_L_ObjRelVelYStd_21 9;
BA_ "GenSigSendType" SG_ 1418 RSDS_L_ObjRelVelXStd_21 9;
BA_ "GenSigSendType" SG_ 1418 RSDS_L_ObjDistYStd_21 9;
BA_ "GenSigSendType" SG_ 1418 RSDS_L_SGU11_Checksum3 9;
BA_ "IsCrcSignal" SG_ 1418 RSDS_L_SGU11_Checksum3 1;
BA_ "GenSigSendType" SG_ 1418 RSDS_L_SGU11_RollingCounter2 9;
BA_ "IsRcSignal" SG_ 1418 RSDS_L_SGU11_RollingCounter2 1;
BA_ "GenSigSendType" SG_ 1418 RSDS_L_ObjMotionType_21 9;
BA_ "GenSigStartValue" SG_ 1418 RSDS_L_ObjMeasured_21 1;
BA_ "GenSigSendType" SG_ 1418 RSDS_L_ObjMeasured_21 9;
BA_ "GenSigStartValue" SG_ 1418 RSDS_L_ObjRelAccelY_21 512;
BA_ "GenSigSendType" SG_ 1418 RSDS_L_ObjRelAccelY_21 9;
BA_ "GenSigStartValue" SG_ 1418 RSDS_L_ObjRelAccelX_21 512;
BA_ "GenSigSendType" SG_ 1418 RSDS_L_ObjRelAccelX_21 9;
BA_ "GenSigStartValue" SG_ 1418 RSDS_L_ObjRelVelY_21 4102;
BA_ "GenSigSendType" SG_ 1418 RSDS_L_ObjRelVelY_21 9;
BA_ "GenSigStartValue" SG_ 1418 RSDS_L_ObjRelVelX_21 4102;
BA_ "GenSigSendType" SG_ 1418 RSDS_L_ObjRelVelX_21 9;
BA_ "GenSigSendType" SG_ 1418 RSDS_L_SGU11_Checksum2 9;
BA_ "IsCrcSignal" SG_ 1418 RSDS_L_SGU11_Checksum2 1;
BA_ "GenSigSendType" SG_ 1418 RSDS_L_SGU11_RollingCounter1 9;
BA_ "IsRcSignal" SG_ 1418 RSDS_L_SGU11_RollingCounter1 1;
BA_ "GenSigSendType" SG_ 1418 RSDS_L_ObjType_21 9;
BA_ "GenSigSendType" SG_ 1418 RSDS_L_ObjDistXStd_21 9;
BA_ "GenSigStartValue" SG_ 1418 RSDS_L_ObjDistY_21 1024;
BA_ "GenSigSendType" SG_ 1418 RSDS_L_ObjDistY_21 9;
BA_ "GenSigSendType" SG_ 1418 RSDS_L_ObjDistX_21 9;
BA_ "GenSigSendType" SG_ 1418 RSDS_L_ObjObstacleProb_21 9;
BA_ "GenSigSendType" SG_ 1418 RSDS_L_ObjExistProb_21 9;
BA_ "GenSigSendType" SG_ 1418 RSDS_L_ObjID_21 9;
BA_ "GenSigSendType" SG_ 1418 RSDS_L_SGU11_Checksum1 9;
BA_ "IsCrcSignal" SG_ 1418 RSDS_L_SGU11_Checksum1 1;
BA_ "GenSigSendType" SG_ 1419 RSDS_L_SGU12_RollingCounter8 9;
BA_ "IsRcSignal" SG_ 1419 RSDS_L_SGU12_RollingCounter8 1;
BA_ "GenSigSendType" SG_ 1419 RSDS_L_SGU12_BlockCounter 9;
BA_ "GenSigSendType" SG_ 1419 RSDS_L_HWATargetValidity_24 9;
BA_ "GenSigSendType" SG_ 1419 RSDS_L_ObjRefPoint_24 9;
BA_ "GenSigStartValue" SG_ 1419 RSDS_L_ObjRCS_24 400;
BA_ "GenSigSendType" SG_ 1419 RSDS_L_ObjRCS_24 9;
BA_ "GenSigSendType" SG_ 1419 RSDS_L_ObjYawrate_24 9;
BA_ "GenSigSendType" SG_ 1419 RSDS_L_ObjHeading_24 9;
BA_ "GenSigSendType" SG_ 1419 RSDS_L_ObjLength_24 9;
BA_ "GenSigSendType" SG_ 1419 RSDS_L_SGU12_Checksum8 9;
BA_ "IsCrcSignal" SG_ 1419 RSDS_L_SGU12_Checksum8 1;
BA_ "GenSigSendType" SG_ 1419 RSDS_L_SGU12_RollingCounter7 9;
BA_ "IsRcSignal" SG_ 1419 RSDS_L_SGU12_RollingCounter7 1;
BA_ "GenSigSendType" SG_ 1419 RSDS_L_ObjMotionDirection_24 9;
BA_ "GenSigSendType" SG_ 1419 RSDS_L_ObjAge_24 9;
BA_ "GenSigSendType" SG_ 1419 RSDS_L_ObjWidth_24 9;
BA_ "GenSigSendType" SG_ 1419 RSDS_L_ObjRAccelYStd_24 9;
BA_ "GenSigSendType" SG_ 1419 RSDS_L_ObjRAccelXStd_24 9;
BA_ "GenSigSendType" SG_ 1419 RSDS_L_ObjRelVelYStd_24 9;
BA_ "GenSigSendType" SG_ 1419 RSDS_L_ObjRelVelXStd_24 9;
BA_ "GenSigSendType" SG_ 1419 RSDS_L_ObjDistYStd_24 9;
BA_ "GenSigSendType" SG_ 1419 RSDS_L_SGU12_Checksum7 9;
BA_ "IsCrcSignal" SG_ 1419 RSDS_L_SGU12_Checksum7 1;
BA_ "GenSigSendType" SG_ 1419 RSDS_L_SGU12_RollingCounter6 9;
BA_ "IsRcSignal" SG_ 1419 RSDS_L_SGU12_RollingCounter6 1;
BA_ "GenSigSendType" SG_ 1419 RSDS_L_ObjMotionType_24 9;
BA_ "GenSigStartValue" SG_ 1419 RSDS_L_ObjMeasured_24 1;
BA_ "GenSigSendType" SG_ 1419 RSDS_L_ObjMeasured_24 9;
BA_ "GenSigStartValue" SG_ 1419 RSDS_L_ObjRelAccelY_24 512;
BA_ "GenSigSendType" SG_ 1419 RSDS_L_ObjRelAccelY_24 9;
BA_ "GenSigStartValue" SG_ 1419 RSDS_L_ObjRelAccelX_24 512;
BA_ "GenSigSendType" SG_ 1419 RSDS_L_ObjRelAccelX_24 9;
BA_ "GenSigStartValue" SG_ 1419 RSDS_L_ObjRelVelY_24 4102;
BA_ "GenSigSendType" SG_ 1419 RSDS_L_ObjRelVelY_24 9;
BA_ "GenSigStartValue" SG_ 1419 RSDS_L_ObjRelVelX_24 4102;
BA_ "GenSigSendType" SG_ 1419 RSDS_L_ObjRelVelX_24 9;
BA_ "GenSigSendType" SG_ 1419 RSDS_L_SGU12_Checksum6 9;
BA_ "IsCrcSignal" SG_ 1419 RSDS_L_SGU12_Checksum6 1;
BA_ "GenSigSendType" SG_ 1419 RSDS_L_SGU12_RollingCounter5 9;
BA_ "IsRcSignal" SG_ 1419 RSDS_L_SGU12_RollingCounter5 1;
BA_ "GenSigSendType" SG_ 1419 RSDS_L_ObjType_24 9;
BA_ "GenSigSendType" SG_ 1419 RSDS_L_ObjDistXStd_24 9;
BA_ "GenSigStartValue" SG_ 1419 RSDS_L_ObjDistY_24 1024;
BA_ "GenSigSendType" SG_ 1419 RSDS_L_ObjDistY_24 9;
BA_ "GenSigSendType" SG_ 1419 RSDS_L_ObjDistX_24 9;
BA_ "GenSigSendType" SG_ 1419 RSDS_L_ObjObstacleProb_24 9;
BA_ "GenSigSendType" SG_ 1419 RSDS_L_ObjExistProb_24 9;
BA_ "GenSigSendType" SG_ 1419 RSDS_L_ObjID_24 9;
BA_ "GenSigSendType" SG_ 1419 RSDS_L_SGU12_Checksum5 9;
BA_ "IsCrcSignal" SG_ 1419 RSDS_L_SGU12_Checksum5 1;
BA_ "GenSigSendType" SG_ 1419 RSDS_L_SGU12_RollingCounter4 9;
BA_ "IsRcSignal" SG_ 1419 RSDS_L_SGU12_RollingCounter4 1;
BA_ "GenSigSendType" SG_ 1419 RSDS_L_HWATargetValidity_23 9;
BA_ "GenSigSendType" SG_ 1419 RSDS_L_ObjRefPoint_23 9;
BA_ "GenSigStartValue" SG_ 1419 RSDS_L_ObjRCS_23 400;
BA_ "GenSigSendType" SG_ 1419 RSDS_L_ObjRCS_23 9;
BA_ "GenSigSendType" SG_ 1419 RSDS_L_ObjYawrate_23 9;
BA_ "GenSigSendType" SG_ 1419 RSDS_L_ObjHeading_23 9;
BA_ "GenSigSendType" SG_ 1419 RSDS_L_ObjLength_23 9;
BA_ "GenSigSendType" SG_ 1419 RSDS_L_SGU12_Checksum4 9;
BA_ "IsCrcSignal" SG_ 1419 RSDS_L_SGU12_Checksum4 1;
BA_ "GenSigSendType" SG_ 1419 RSDS_L_SGU12_RollingCounter3 9;
BA_ "IsRcSignal" SG_ 1419 RSDS_L_SGU12_RollingCounter3 1;
BA_ "GenSigSendType" SG_ 1419 RSDS_L_ObjMotionDirection_23 9;
BA_ "GenSigSendType" SG_ 1419 RSDS_L_ObjAge_23 9;
BA_ "GenSigSendType" SG_ 1419 RSDS_L_ObjWidth_23 9;
BA_ "GenSigSendType" SG_ 1419 RSDS_L_ObjRAccelYStd_23 9;
BA_ "GenSigSendType" SG_ 1419 RSDS_L_ObjRAccelXStd_23 9;
BA_ "GenSigSendType" SG_ 1419 RSDS_L_ObjRelVelYStd_23 9;
BA_ "GenSigSendType" SG_ 1419 RSDS_L_ObjRelVelXStd_23 9;
BA_ "GenSigSendType" SG_ 1419 RSDS_L_ObjDistYStd_23 9;
BA_ "GenSigSendType" SG_ 1419 RSDS_L_SGU12_Checksum3 9;
BA_ "IsCrcSignal" SG_ 1419 RSDS_L_SGU12_Checksum3 1;
BA_ "GenSigSendType" SG_ 1419 RSDS_L_SGU12_RollingCounter2 9;
BA_ "IsRcSignal" SG_ 1419 RSDS_L_SGU12_RollingCounter2 1;
BA_ "GenSigSendType" SG_ 1419 RSDS_L_ObjMotionType_23 9;
BA_ "GenSigStartValue" SG_ 1419 RSDS_L_ObjMeasured_23 1;
BA_ "GenSigSendType" SG_ 1419 RSDS_L_ObjMeasured_23 9;
BA_ "GenSigStartValue" SG_ 1419 RSDS_L_ObjRelAccelY_23 512;
BA_ "GenSigSendType" SG_ 1419 RSDS_L_ObjRelAccelY_23 9;
BA_ "GenSigStartValue" SG_ 1419 RSDS_L_ObjRelAccelX_23 512;
BA_ "GenSigSendType" SG_ 1419 RSDS_L_ObjRelAccelX_23 9;
BA_ "GenSigStartValue" SG_ 1419 RSDS_L_ObjRelVelY_23 4102;
BA_ "GenSigSendType" SG_ 1419 RSDS_L_ObjRelVelY_23 9;
BA_ "GenSigStartValue" SG_ 1419 RSDS_L_ObjRelVelX_23 4102;
BA_ "GenSigSendType" SG_ 1419 RSDS_L_ObjRelVelX_23 9;
BA_ "GenSigSendType" SG_ 1419 RSDS_L_SGU12_Checksum2 9;
BA_ "IsCrcSignal" SG_ 1419 RSDS_L_SGU12_Checksum2 1;
BA_ "GenSigSendType" SG_ 1419 RSDS_L_SGU12_RollingCounter1 9;
BA_ "IsRcSignal" SG_ 1419 RSDS_L_SGU12_RollingCounter1 1;
BA_ "GenSigSendType" SG_ 1419 RSDS_L_ObjType_23 9;
BA_ "GenSigSendType" SG_ 1419 RSDS_L_ObjDistXStd_23 9;
BA_ "GenSigStartValue" SG_ 1419 RSDS_L_ObjDistY_23 1024;
BA_ "GenSigSendType" SG_ 1419 RSDS_L_ObjDistY_23 9;
BA_ "GenSigSendType" SG_ 1419 RSDS_L_ObjDistX_23 9;
BA_ "GenSigSendType" SG_ 1419 RSDS_L_ObjObstacleProb_23 9;
BA_ "GenSigSendType" SG_ 1419 RSDS_L_ObjExistProb_23 9;
BA_ "GenSigSendType" SG_ 1419 RSDS_L_ObjID_23 9;
BA_ "GenSigSendType" SG_ 1419 RSDS_L_SGU12_Checksum1 9;
BA_ "IsCrcSignal" SG_ 1419 RSDS_L_SGU12_Checksum1 1;
BA_ "GenSigSendType" SG_ 1420 RSDS_L_SGU13_RollingCounter8 9;
BA_ "IsRcSignal" SG_ 1420 RSDS_L_SGU13_RollingCounter8 1;
BA_ "GenSigSendType" SG_ 1420 RSDS_L_SGU13_BlockCounter 9;
BA_ "GenSigSendType" SG_ 1420 RSDS_L_HWATargetValidity_26 9;
BA_ "GenSigSendType" SG_ 1420 RSDS_L_ObjRefPoint_26 9;
BA_ "GenSigStartValue" SG_ 1420 RSDS_L_ObjRCS_26 400;
BA_ "GenSigSendType" SG_ 1420 RSDS_L_ObjRCS_26 9;
BA_ "GenSigSendType" SG_ 1420 RSDS_L_ObjYawrate_26 9;
BA_ "GenSigSendType" SG_ 1420 RSDS_L_ObjHeading_26 9;
BA_ "GenSigSendType" SG_ 1420 RSDS_L_ObjLength_26 9;
BA_ "GenSigSendType" SG_ 1420 RSDS_L_SGU13_Checksum8 9;
BA_ "IsCrcSignal" SG_ 1420 RSDS_L_SGU13_Checksum8 1;
BA_ "GenSigSendType" SG_ 1420 RSDS_L_SGU13_RollingCounter7 9;
BA_ "IsRcSignal" SG_ 1420 RSDS_L_SGU13_RollingCounter7 1;
BA_ "GenSigSendType" SG_ 1420 RSDS_L_ObjMotionDirection_26 9;
BA_ "GenSigSendType" SG_ 1420 RSDS_L_ObjAge_26 9;
BA_ "GenSigSendType" SG_ 1420 RSDS_L_ObjWidth_26 9;
BA_ "GenSigSendType" SG_ 1420 RSDS_L_ObjRAccelYStd_26 9;
BA_ "GenSigSendType" SG_ 1420 RSDS_L_ObjRAccelXStd_26 9;
BA_ "GenSigSendType" SG_ 1420 RSDS_L_ObjRelVelYStd_26 9;
BA_ "GenSigSendType" SG_ 1420 RSDS_L_ObjRelVelXStd_26 9;
BA_ "GenSigSendType" SG_ 1420 RSDS_L_ObjDistYStd_26 9;
BA_ "GenSigSendType" SG_ 1420 RSDS_L_SGU13_Checksum7 9;
BA_ "IsCrcSignal" SG_ 1420 RSDS_L_SGU13_Checksum7 1;
BA_ "GenSigSendType" SG_ 1420 RSDS_L_SGU13_RollingCounter6 9;
BA_ "IsRcSignal" SG_ 1420 RSDS_L_SGU13_RollingCounter6 1;
BA_ "GenSigSendType" SG_ 1420 RSDS_L_ObjMotionType_26 9;
BA_ "GenSigStartValue" SG_ 1420 RSDS_L_ObjMeasured_26 1;
BA_ "GenSigSendType" SG_ 1420 RSDS_L_ObjMeasured_26 9;
BA_ "GenSigStartValue" SG_ 1420 RSDS_L_ObjRelAccelY_26 512;
BA_ "GenSigSendType" SG_ 1420 RSDS_L_ObjRelAccelY_26 9;
BA_ "GenSigStartValue" SG_ 1420 RSDS_L_ObjRelAccelX_26 512;
BA_ "GenSigSendType" SG_ 1420 RSDS_L_ObjRelAccelX_26 9;
BA_ "GenSigStartValue" SG_ 1420 RSDS_L_ObjRelVelY_26 4102;
BA_ "GenSigSendType" SG_ 1420 RSDS_L_ObjRelVelY_26 9;
BA_ "GenSigStartValue" SG_ 1420 RSDS_L_ObjRelVelX_26 4102;
BA_ "GenSigSendType" SG_ 1420 RSDS_L_ObjRelVelX_26 9;
BA_ "GenSigSendType" SG_ 1420 RSDS_L_SGU13_Checksum6 9;
BA_ "IsCrcSignal" SG_ 1420 RSDS_L_SGU13_Checksum6 1;
BA_ "GenSigSendType" SG_ 1420 RSDS_L_SGU13_RollingCounter5 9;
BA_ "IsRcSignal" SG_ 1420 RSDS_L_SGU13_RollingCounter5 1;
BA_ "GenSigSendType" SG_ 1420 RSDS_L_ObjType_26 9;
BA_ "GenSigSendType" SG_ 1420 RSDS_L_ObjDistXStd_26 9;
BA_ "GenSigStartValue" SG_ 1420 RSDS_L_ObjDistY_26 1024;
BA_ "GenSigSendType" SG_ 1420 RSDS_L_ObjDistY_26 9;
BA_ "GenSigSendType" SG_ 1420 RSDS_L_ObjDistX_26 9;
BA_ "GenSigSendType" SG_ 1420 RSDS_L_ObjObstacleProb_26 9;
BA_ "GenSigSendType" SG_ 1420 RSDS_L_ObjExistProb_26 9;
BA_ "GenSigSendType" SG_ 1420 RSDS_L_ObjID_26 9;
BA_ "GenSigSendType" SG_ 1420 RSDS_L_SGU13_Checksum5 9;
BA_ "IsCrcSignal" SG_ 1420 RSDS_L_SGU13_Checksum5 1;
BA_ "GenSigSendType" SG_ 1420 RSDS_L_SGU13_RollingCounter4 9;
BA_ "IsRcSignal" SG_ 1420 RSDS_L_SGU13_RollingCounter4 1;
BA_ "GenSigSendType" SG_ 1420 RSDS_L_HWATargetValidity_25 9;
BA_ "GenSigSendType" SG_ 1420 RSDS_L_ObjRefPoint_25 9;
BA_ "GenSigStartValue" SG_ 1420 RSDS_L_ObjRCS_25 400;
BA_ "GenSigSendType" SG_ 1420 RSDS_L_ObjRCS_25 9;
BA_ "GenSigSendType" SG_ 1420 RSDS_L_ObjYawrate_25 9;
BA_ "GenSigSendType" SG_ 1420 RSDS_L_ObjHeading_25 9;
BA_ "GenSigSendType" SG_ 1420 RSDS_L_ObjLength_25 9;
BA_ "GenSigSendType" SG_ 1420 RSDS_L_SGU13_Checksum4 9;
BA_ "IsCrcSignal" SG_ 1420 RSDS_L_SGU13_Checksum4 1;
BA_ "GenSigSendType" SG_ 1420 RSDS_L_SGU13_RollingCounter3 9;
BA_ "IsRcSignal" SG_ 1420 RSDS_L_SGU13_RollingCounter3 1;
BA_ "GenSigSendType" SG_ 1420 RSDS_L_ObjMotionDirection_25 9;
BA_ "GenSigSendType" SG_ 1420 RSDS_L_ObjAge_25 9;
BA_ "GenSigSendType" SG_ 1420 RSDS_L_ObjWidth_25 9;
BA_ "GenSigSendType" SG_ 1420 RSDS_L_ObjRAccelYStd_25 9;
BA_ "GenSigSendType" SG_ 1420 RSDS_L_ObjRAccelXStd_25 9;
BA_ "GenSigSendType" SG_ 1420 RSDS_L_ObjRelVelYStd_25 9;
BA_ "GenSigSendType" SG_ 1420 RSDS_L_ObjRelVelXStd_25 9;
BA_ "GenSigSendType" SG_ 1420 RSDS_L_ObjDistYStd_25 9;
BA_ "GenSigSendType" SG_ 1420 RSDS_L_SGU13_Checksum3 9;
BA_ "IsCrcSignal" SG_ 1420 RSDS_L_SGU13_Checksum3 1;
BA_ "GenSigSendType" SG_ 1420 RSDS_L_SGU13_RollingCounter2 9;
BA_ "IsRcSignal" SG_ 1420 RSDS_L_SGU13_RollingCounter2 1;
BA_ "GenSigSendType" SG_ 1420 RSDS_L_ObjMotionType_25 9;
BA_ "GenSigStartValue" SG_ 1420 RSDS_L_ObjMeasured_25 1;
BA_ "GenSigSendType" SG_ 1420 RSDS_L_ObjMeasured_25 9;
BA_ "GenSigStartValue" SG_ 1420 RSDS_L_ObjRelAccelY_25 512;
BA_ "GenSigSendType" SG_ 1420 RSDS_L_ObjRelAccelY_25 9;
BA_ "GenSigStartValue" SG_ 1420 RSDS_L_ObjRelAccelX_25 512;
BA_ "GenSigSendType" SG_ 1420 RSDS_L_ObjRelAccelX_25 9;
BA_ "GenSigStartValue" SG_ 1420 RSDS_L_ObjRelVelY_25 4102;
BA_ "GenSigSendType" SG_ 1420 RSDS_L_ObjRelVelY_25 9;
BA_ "GenSigStartValue" SG_ 1420 RSDS_L_ObjRelVelX_25 4102;
BA_ "GenSigSendType" SG_ 1420 RSDS_L_ObjRelVelX_25 9;
BA_ "GenSigSendType" SG_ 1420 RSDS_L_SGU13_Checksum2 9;
BA_ "IsCrcSignal" SG_ 1420 RSDS_L_SGU13_Checksum2 1;
BA_ "GenSigSendType" SG_ 1420 RSDS_L_SGU13_RollingCounter1 9;
BA_ "IsRcSignal" SG_ 1420 RSDS_L_SGU13_RollingCounter1 1;
BA_ "GenSigSendType" SG_ 1420 RSDS_L_ObjType_25 9;
BA_ "GenSigSendType" SG_ 1420 RSDS_L_ObjDistXStd_25 9;
BA_ "GenSigStartValue" SG_ 1420 RSDS_L_ObjDistY_25 1024;
BA_ "GenSigSendType" SG_ 1420 RSDS_L_ObjDistY_25 9;
BA_ "GenSigSendType" SG_ 1420 RSDS_L_ObjDistX_25 9;
BA_ "GenSigSendType" SG_ 1420 RSDS_L_ObjObstacleProb_25 9;
BA_ "GenSigSendType" SG_ 1420 RSDS_L_ObjExistProb_25 9;
BA_ "GenSigSendType" SG_ 1420 RSDS_L_ObjID_25 9;
BA_ "GenSigSendType" SG_ 1420 RSDS_L_SGU13_Checksum1 9;
BA_ "IsCrcSignal" SG_ 1420 RSDS_L_SGU13_Checksum1 1;
BA_ "GenSigSendType" SG_ 1421 RSDS_L_SGU14_RollingCounter8 9;
BA_ "IsRcSignal" SG_ 1421 RSDS_L_SGU14_RollingCounter8 1;
BA_ "GenSigSendType" SG_ 1421 RSDS_L_SGU14_BlockCounter 9;
BA_ "GenSigSendType" SG_ 1421 RSDS_L_HWATargetValidity_28 9;
BA_ "GenSigSendType" SG_ 1421 RSDS_L_ObjRefPoint_28 9;
BA_ "GenSigStartValue" SG_ 1421 RSDS_L_ObjRCS_28 400;
BA_ "GenSigSendType" SG_ 1421 RSDS_L_ObjRCS_28 9;
BA_ "GenSigSendType" SG_ 1421 RSDS_L_ObjYawrate_28 9;
BA_ "GenSigSendType" SG_ 1421 RSDS_L_ObjHeading_28 9;
BA_ "GenSigSendType" SG_ 1421 RSDS_L_ObjLength_28 9;
BA_ "GenSigSendType" SG_ 1421 RSDS_L_SGU14_Checksum8 9;
BA_ "IsCrcSignal" SG_ 1421 RSDS_L_SGU14_Checksum8 1;
BA_ "GenSigSendType" SG_ 1421 RSDS_L_SGU14_RollingCounter7 9;
BA_ "IsRcSignal" SG_ 1421 RSDS_L_SGU14_RollingCounter7 1;
BA_ "GenSigSendType" SG_ 1421 RSDS_L_ObjMotionDirection_28 9;
BA_ "GenSigSendType" SG_ 1421 RSDS_L_ObjAge_28 9;
BA_ "GenSigSendType" SG_ 1421 RSDS_L_ObjWidth_28 9;
BA_ "GenSigSendType" SG_ 1421 RSDS_L_ObjRAccelYStd_28 9;
BA_ "GenSigSendType" SG_ 1421 RSDS_L_ObjRAccelXStd_28 9;
BA_ "GenSigSendType" SG_ 1421 RSDS_L_ObjRelVelYStd_28 9;
BA_ "GenSigSendType" SG_ 1421 RSDS_L_ObjRelVelXStd_28 9;
BA_ "GenSigSendType" SG_ 1421 RSDS_L_ObjDistYStd_28 9;
BA_ "GenSigSendType" SG_ 1421 RSDS_L_SGU14_Checksum7 9;
BA_ "IsCrcSignal" SG_ 1421 RSDS_L_SGU14_Checksum7 1;
BA_ "GenSigSendType" SG_ 1421 RSDS_L_SGU14_RollingCounter6 9;
BA_ "IsRcSignal" SG_ 1421 RSDS_L_SGU14_RollingCounter6 1;
BA_ "GenSigSendType" SG_ 1421 RSDS_L_ObjMotionType_28 9;
BA_ "GenSigStartValue" SG_ 1421 RSDS_L_ObjMeasured_28 1;
BA_ "GenSigSendType" SG_ 1421 RSDS_L_ObjMeasured_28 9;
BA_ "GenSigStartValue" SG_ 1421 RSDS_L_ObjRelAccelY_28 512;
BA_ "GenSigSendType" SG_ 1421 RSDS_L_ObjRelAccelY_28 9;
BA_ "GenSigStartValue" SG_ 1421 RSDS_L_ObjRelAccelX_28 512;
BA_ "GenSigSendType" SG_ 1421 RSDS_L_ObjRelAccelX_28 9;
BA_ "GenSigStartValue" SG_ 1421 RSDS_L_ObjRelVelY_28 4102;
BA_ "GenSigSendType" SG_ 1421 RSDS_L_ObjRelVelY_28 9;
BA_ "GenSigStartValue" SG_ 1421 RSDS_L_ObjRelVelX_28 4102;
BA_ "GenSigSendType" SG_ 1421 RSDS_L_ObjRelVelX_28 9;
BA_ "GenSigSendType" SG_ 1421 RSDS_L_SGU14_Checksum6 9;
BA_ "IsCrcSignal" SG_ 1421 RSDS_L_SGU14_Checksum6 1;
BA_ "GenSigSendType" SG_ 1421 RSDS_L_SGU14_RollingCounter5 9;
BA_ "IsRcSignal" SG_ 1421 RSDS_L_SGU14_RollingCounter5 1;
BA_ "GenSigSendType" SG_ 1421 RSDS_L_ObjType_28 9;
BA_ "GenSigSendType" SG_ 1421 RSDS_L_ObjDistXStd_28 9;
BA_ "GenSigStartValue" SG_ 1421 RSDS_L_ObjDistY_28 1024;
BA_ "GenSigSendType" SG_ 1421 RSDS_L_ObjDistY_28 9;
BA_ "GenSigSendType" SG_ 1421 RSDS_L_ObjDistX_28 9;
BA_ "GenSigSendType" SG_ 1421 RSDS_L_ObjObstacleProb_28 9;
BA_ "GenSigSendType" SG_ 1421 RSDS_L_ObjExistProb_28 9;
BA_ "GenSigSendType" SG_ 1421 RSDS_L_ObjID_28 9;
BA_ "GenSigSendType" SG_ 1421 RSDS_L_SGU14_Checksum5 9;
BA_ "IsCrcSignal" SG_ 1421 RSDS_L_SGU14_Checksum5 1;
BA_ "GenSigSendType" SG_ 1421 RSDS_L_SGU14_RollingCounter4 9;
BA_ "IsRcSignal" SG_ 1421 RSDS_L_SGU14_RollingCounter4 1;
BA_ "GenSigSendType" SG_ 1421 RSDS_L_HWATargetValidity_27 9;
BA_ "GenSigSendType" SG_ 1421 RSDS_L_ObjRefPoint_27 9;
BA_ "GenSigStartValue" SG_ 1421 RSDS_L_ObjRCS_27 400;
BA_ "GenSigSendType" SG_ 1421 RSDS_L_ObjRCS_27 9;
BA_ "GenSigSendType" SG_ 1421 RSDS_L_ObjYawrate_27 9;
BA_ "GenSigSendType" SG_ 1421 RSDS_L_ObjHeading_27 9;
BA_ "GenSigSendType" SG_ 1421 RSDS_L_ObjLength_27 9;
BA_ "GenSigSendType" SG_ 1421 RSDS_L_SGU14_Checksum4 9;
BA_ "IsCrcSignal" SG_ 1421 RSDS_L_SGU14_Checksum4 1;
BA_ "GenSigSendType" SG_ 1421 RSDS_L_SGU14_RollingCounter3 9;
BA_ "IsRcSignal" SG_ 1421 RSDS_L_SGU14_RollingCounter3 1;
BA_ "GenSigSendType" SG_ 1421 RSDS_L_ObjMotionDirection_27 9;
BA_ "GenSigSendType" SG_ 1421 RSDS_L_ObjAge_27 9;
BA_ "GenSigSendType" SG_ 1421 RSDS_L_ObjWidth_27 9;
BA_ "GenSigSendType" SG_ 1421 RSDS_L_ObjRAccelYStd_27 9;
BA_ "GenSigSendType" SG_ 1421 RSDS_L_ObjRAccelXStd_27 9;
BA_ "GenSigSendType" SG_ 1421 RSDS_L_ObjRelVelYStd_27 9;
BA_ "GenSigSendType" SG_ 1421 RSDS_L_ObjRelVelXStd_27 9;
BA_ "GenSigSendType" SG_ 1421 RSDS_L_ObjDistYStd_27 9;
BA_ "GenSigSendType" SG_ 1421 RSDS_L_SGU14_Checksum3 9;
BA_ "IsCrcSignal" SG_ 1421 RSDS_L_SGU14_Checksum3 1;
BA_ "GenSigSendType" SG_ 1421 RSDS_L_SGU14_RollingCounter2 9;
BA_ "IsRcSignal" SG_ 1421 RSDS_L_SGU14_RollingCounter2 1;
BA_ "GenSigSendType" SG_ 1421 RSDS_L_ObjMotionType_27 9;
BA_ "GenSigStartValue" SG_ 1421 RSDS_L_ObjMeasured_27 1;
BA_ "GenSigSendType" SG_ 1421 RSDS_L_ObjMeasured_27 9;
BA_ "GenSigStartValue" SG_ 1421 RSDS_L_ObjRelAccelY_27 512;
BA_ "GenSigSendType" SG_ 1421 RSDS_L_ObjRelAccelY_27 9;
BA_ "GenSigStartValue" SG_ 1421 RSDS_L_ObjRelAccelX_27 512;
BA_ "GenSigSendType" SG_ 1421 RSDS_L_ObjRelAccelX_27 9;
BA_ "GenSigStartValue" SG_ 1421 RSDS_L_ObjRelVelY_27 4102;
BA_ "GenSigSendType" SG_ 1421 RSDS_L_ObjRelVelY_27 9;
BA_ "GenSigStartValue" SG_ 1421 RSDS_L_ObjRelVelX_27 4102;
BA_ "GenSigSendType" SG_ 1421 RSDS_L_ObjRelVelX_27 9;
BA_ "GenSigSendType" SG_ 1421 RSDS_L_SGU14_Checksum2 9;
BA_ "IsCrcSignal" SG_ 1421 RSDS_L_SGU14_Checksum2 1;
BA_ "GenSigSendType" SG_ 1421 RSDS_L_SGU14_RollingCounter1 9;
BA_ "IsRcSignal" SG_ 1421 RSDS_L_SGU14_RollingCounter1 1;
BA_ "GenSigSendType" SG_ 1421 RSDS_L_ObjType_27 9;
BA_ "GenSigSendType" SG_ 1421 RSDS_L_ObjDistXStd_27 9;
BA_ "GenSigStartValue" SG_ 1421 RSDS_L_ObjDistY_27 1024;
BA_ "GenSigSendType" SG_ 1421 RSDS_L_ObjDistY_27 9;
BA_ "GenSigSendType" SG_ 1421 RSDS_L_ObjDistX_27 9;
BA_ "GenSigSendType" SG_ 1421 RSDS_L_ObjObstacleProb_27 9;
BA_ "GenSigSendType" SG_ 1421 RSDS_L_ObjExistProb_27 9;
BA_ "GenSigSendType" SG_ 1421 RSDS_L_ObjID_27 9;
BA_ "GenSigSendType" SG_ 1421 RSDS_L_SGU14_Checksum1 9;
BA_ "IsCrcSignal" SG_ 1421 RSDS_L_SGU14_Checksum1 1;
BA_ "GenSigSendType" SG_ 1422 RSDS_L_SGU15_RollingCounter8 9;
BA_ "IsRcSignal" SG_ 1422 RSDS_L_SGU15_RollingCounter8 1;
BA_ "GenSigSendType" SG_ 1422 RSDS_L_SGU15_BlockCounter 9;
BA_ "GenSigSendType" SG_ 1422 RSDS_L_HWATargetValidity_30 9;
BA_ "GenSigSendType" SG_ 1422 RSDS_L_ObjRefPoint_30 9;
BA_ "GenSigStartValue" SG_ 1422 RSDS_L_ObjRCS_30 400;
BA_ "GenSigSendType" SG_ 1422 RSDS_L_ObjRCS_30 9;
BA_ "GenSigSendType" SG_ 1422 RSDS_L_ObjYawrate_30 9;
BA_ "GenSigSendType" SG_ 1422 RSDS_L_ObjHeading_30 9;
BA_ "GenSigSendType" SG_ 1422 RSDS_L_ObjLength_30 9;
BA_ "GenSigSendType" SG_ 1422 RSDS_L_SGU15_Checksum8 9;
BA_ "IsCrcSignal" SG_ 1422 RSDS_L_SGU15_Checksum8 1;
BA_ "GenSigSendType" SG_ 1422 RSDS_L_SGU15_RollingCounter7 9;
BA_ "IsRcSignal" SG_ 1422 RSDS_L_SGU15_RollingCounter7 1;
BA_ "GenSigSendType" SG_ 1422 RSDS_L_ObjMotionDirection_30 9;
BA_ "GenSigSendType" SG_ 1422 RSDS_L_ObjAge_30 9;
BA_ "GenSigSendType" SG_ 1422 RSDS_L_ObjWidth_30 9;
BA_ "GenSigSendType" SG_ 1422 RSDS_L_ObjRAccelYStd_30 9;
BA_ "GenSigSendType" SG_ 1422 RSDS_L_ObjRAccelXStd_30 9;
BA_ "GenSigSendType" SG_ 1422 RSDS_L_ObjRelVelYStd_30 9;
BA_ "GenSigSendType" SG_ 1422 RSDS_L_ObjRelVelXStd_30 9;
BA_ "GenSigSendType" SG_ 1422 RSDS_L_ObjDistYStd_30 9;
BA_ "GenSigSendType" SG_ 1422 RSDS_L_SGU15_Checksum7 9;
BA_ "IsCrcSignal" SG_ 1422 RSDS_L_SGU15_Checksum7 1;
BA_ "GenSigSendType" SG_ 1422 RSDS_L_SGU15_RollingCounter6 9;
BA_ "IsRcSignal" SG_ 1422 RSDS_L_SGU15_RollingCounter6 1;
BA_ "GenSigSendType" SG_ 1422 RSDS_L_ObjMotionType_30 9;
BA_ "GenSigStartValue" SG_ 1422 RSDS_L_ObjMeasured_30 1;
BA_ "GenSigSendType" SG_ 1422 RSDS_L_ObjMeasured_30 9;
BA_ "GenSigStartValue" SG_ 1422 RSDS_L_ObjRelAccelY_30 512;
BA_ "GenSigSendType" SG_ 1422 RSDS_L_ObjRelAccelY_30 9;
BA_ "GenSigStartValue" SG_ 1422 RSDS_L_ObjRelAccelX_30 512;
BA_ "GenSigSendType" SG_ 1422 RSDS_L_ObjRelAccelX_30 9;
BA_ "GenSigStartValue" SG_ 1422 RSDS_L_ObjRelVelY_30 4102;
BA_ "GenSigSendType" SG_ 1422 RSDS_L_ObjRelVelY_30 9;
BA_ "GenSigStartValue" SG_ 1422 RSDS_L_ObjRelVelX_30 4102;
BA_ "GenSigSendType" SG_ 1422 RSDS_L_ObjRelVelX_30 9;
BA_ "GenSigSendType" SG_ 1422 RSDS_L_SGU15_Checksum6 9;
BA_ "IsCrcSignal" SG_ 1422 RSDS_L_SGU15_Checksum6 1;
BA_ "GenSigSendType" SG_ 1422 RSDS_L_SGU15_RollingCounter5 9;
BA_ "IsRcSignal" SG_ 1422 RSDS_L_SGU15_RollingCounter5 1;
BA_ "GenSigSendType" SG_ 1422 RSDS_L_ObjType_30 9;
BA_ "GenSigSendType" SG_ 1422 RSDS_L_ObjDistXStd_30 9;
BA_ "GenSigStartValue" SG_ 1422 RSDS_L_ObjDistY_30 1024;
BA_ "GenSigSendType" SG_ 1422 RSDS_L_ObjDistY_30 9;
BA_ "GenSigSendType" SG_ 1422 RSDS_L_ObjDistX_30 9;
BA_ "GenSigSendType" SG_ 1422 RSDS_L_ObjObstacleProb_30 9;
BA_ "GenSigSendType" SG_ 1422 RSDS_L_ObjExistProb_30 9;
BA_ "GenSigSendType" SG_ 1422 RSDS_L_ObjID_30 9;
BA_ "GenSigSendType" SG_ 1422 RSDS_L_SGU15_Checksum5 9;
BA_ "IsCrcSignal" SG_ 1422 RSDS_L_SGU15_Checksum5 1;
BA_ "GenSigSendType" SG_ 1422 RSDS_L_SGU15_RollingCounter4 9;
BA_ "IsRcSignal" SG_ 1422 RSDS_L_SGU15_RollingCounter4 1;
BA_ "GenSigSendType" SG_ 1422 RSDS_L_HWATargetValidity_29 9;
BA_ "GenSigSendType" SG_ 1422 RSDS_L_ObjRefPoint_29 9;
BA_ "GenSigStartValue" SG_ 1422 RSDS_L_ObjRCS_29 400;
BA_ "GenSigSendType" SG_ 1422 RSDS_L_ObjRCS_29 9;
BA_ "GenSigSendType" SG_ 1422 RSDS_L_ObjYawrate_29 9;
BA_ "GenSigSendType" SG_ 1422 RSDS_L_ObjHeading_29 9;
BA_ "GenSigSendType" SG_ 1422 RSDS_L_ObjLength_29 9;
BA_ "GenSigSendType" SG_ 1422 RSDS_L_SGU15_Checksum4 9;
BA_ "IsCrcSignal" SG_ 1422 RSDS_L_SGU15_Checksum4 1;
BA_ "GenSigSendType" SG_ 1422 RSDS_L_SGU15_RollingCounter3 9;
BA_ "IsRcSignal" SG_ 1422 RSDS_L_SGU15_RollingCounter3 1;
BA_ "GenSigSendType" SG_ 1422 RSDS_L_ObjMotionDirection_29 9;
BA_ "GenSigSendType" SG_ 1422 RSDS_L_ObjAge_29 9;
BA_ "GenSigSendType" SG_ 1422 RSDS_L_ObjWidth_29 9;
BA_ "GenSigSendType" SG_ 1422 RSDS_L_ObjRAccelYStd_29 9;
BA_ "GenSigSendType" SG_ 1422 RSDS_L_ObjRAccelXStd_29 9;
BA_ "GenSigSendType" SG_ 1422 RSDS_L_ObjRelVelYStd_29 9;
BA_ "GenSigSendType" SG_ 1422 RSDS_L_ObjRelVelXStd_29 9;
BA_ "GenSigSendType" SG_ 1422 RSDS_L_ObjDistYStd_29 9;
BA_ "GenSigSendType" SG_ 1422 RSDS_L_SGU15_Checksum3 9;
BA_ "IsCrcSignal" SG_ 1422 RSDS_L_SGU15_Checksum3 1;
BA_ "GenSigSendType" SG_ 1422 RSDS_L_SGU15_RollingCounter2 9;
BA_ "IsRcSignal" SG_ 1422 RSDS_L_SGU15_RollingCounter2 1;
BA_ "GenSigSendType" SG_ 1422 RSDS_L_ObjMotionType_29 9;
BA_ "GenSigStartValue" SG_ 1422 RSDS_L_ObjMeasured_29 1;
BA_ "GenSigSendType" SG_ 1422 RSDS_L_ObjMeasured_29 9;
BA_ "GenSigStartValue" SG_ 1422 RSDS_L_ObjRelAccelY_29 512;
BA_ "GenSigSendType" SG_ 1422 RSDS_L_ObjRelAccelY_29 9;
BA_ "GenSigStartValue" SG_ 1422 RSDS_L_ObjRelAccelX_29 512;
BA_ "GenSigSendType" SG_ 1422 RSDS_L_ObjRelAccelX_29 9;
BA_ "GenSigStartValue" SG_ 1422 RSDS_L_ObjRelVelY_29 4102;
BA_ "GenSigSendType" SG_ 1422 RSDS_L_ObjRelVelY_29 9;
BA_ "GenSigStartValue" SG_ 1422 RSDS_L_ObjRelVelX_29 4102;
BA_ "GenSigSendType" SG_ 1422 RSDS_L_ObjRelVelX_29 9;
BA_ "GenSigSendType" SG_ 1422 RSDS_L_SGU15_Checksum2 9;
BA_ "IsCrcSignal" SG_ 1422 RSDS_L_SGU15_Checksum2 1;
BA_ "GenSigSendType" SG_ 1422 RSDS_L_SGU15_RollingCounter1 9;
BA_ "IsRcSignal" SG_ 1422 RSDS_L_SGU15_RollingCounter1 1;
BA_ "GenSigSendType" SG_ 1422 RSDS_L_ObjType_29 9;
BA_ "GenSigSendType" SG_ 1422 RSDS_L_ObjDistXStd_29 9;
BA_ "GenSigStartValue" SG_ 1422 RSDS_L_ObjDistY_29 1024;
BA_ "GenSigSendType" SG_ 1422 RSDS_L_ObjDistY_29 9;
BA_ "GenSigSendType" SG_ 1422 RSDS_L_ObjDistX_29 9;
BA_ "GenSigSendType" SG_ 1422 RSDS_L_ObjObstacleProb_29 9;
BA_ "GenSigSendType" SG_ 1422 RSDS_L_ObjExistProb_29 9;
BA_ "GenSigSendType" SG_ 1422 RSDS_L_ObjID_29 9;
BA_ "GenSigSendType" SG_ 1422 RSDS_L_SGU15_Checksum1 9;
BA_ "IsCrcSignal" SG_ 1422 RSDS_L_SGU15_Checksum1 1;
BA_ "GenSigSendType" SG_ 1423 RSDS_L_SGU16_RollingCounter8 9;
BA_ "IsRcSignal" SG_ 1423 RSDS_L_SGU16_RollingCounter8 1;
BA_ "GenSigSendType" SG_ 1423 RSDS_L_SGU16_BlockCounter 9;
BA_ "GenSigSendType" SG_ 1423 RSDS_L_HWATargetValidity_32 9;
BA_ "GenSigSendType" SG_ 1423 RSDS_L_ObjRefPoint_32 9;
BA_ "GenSigStartValue" SG_ 1423 RSDS_L_ObjRCS_32 400;
BA_ "GenSigSendType" SG_ 1423 RSDS_L_ObjRCS_32 9;
BA_ "GenSigSendType" SG_ 1423 RSDS_L_ObjYawrate_32 9;
BA_ "GenSigSendType" SG_ 1423 RSDS_L_ObjHeading_32 9;
BA_ "GenSigSendType" SG_ 1423 RSDS_L_ObjLength_32 9;
BA_ "GenSigSendType" SG_ 1423 RSDS_L_SGU16_Checksum8 9;
BA_ "IsCrcSignal" SG_ 1423 RSDS_L_SGU16_Checksum8 1;
BA_ "GenSigSendType" SG_ 1423 RSDS_L_SGU16_RollingCounter7 9;
BA_ "IsRcSignal" SG_ 1423 RSDS_L_SGU16_RollingCounter7 1;
BA_ "GenSigSendType" SG_ 1423 RSDS_L_ObjMotionDirection_32 9;
BA_ "GenSigSendType" SG_ 1423 RSDS_L_ObjAge_32 9;
BA_ "GenSigSendType" SG_ 1423 RSDS_L_ObjWidth_32 9;
BA_ "GenSigSendType" SG_ 1423 RSDS_L_ObjRAccelYStd_32 9;
BA_ "GenSigSendType" SG_ 1423 RSDS_L_ObjRAccelXStd_32 9;
BA_ "GenSigSendType" SG_ 1423 RSDS_L_ObjRelVelYStd_32 9;
BA_ "GenSigSendType" SG_ 1423 RSDS_L_ObjRelVelXStd_32 9;
BA_ "GenSigSendType" SG_ 1423 RSDS_L_ObjDistYStd_32 9;
BA_ "GenSigSendType" SG_ 1423 RSDS_L_SGU16_Checksum7 9;
BA_ "IsCrcSignal" SG_ 1423 RSDS_L_SGU16_Checksum7 1;
BA_ "GenSigSendType" SG_ 1423 RSDS_L_SGU16_RollingCounter6 9;
BA_ "IsRcSignal" SG_ 1423 RSDS_L_SGU16_RollingCounter6 1;
BA_ "GenSigSendType" SG_ 1423 RSDS_L_ObjMotionType_32 9;
BA_ "GenSigStartValue" SG_ 1423 RSDS_L_ObjMeasured_32 1;
BA_ "GenSigSendType" SG_ 1423 RSDS_L_ObjMeasured_32 9;
BA_ "GenSigStartValue" SG_ 1423 RSDS_L_ObjRelAccelY_32 512;
BA_ "GenSigSendType" SG_ 1423 RSDS_L_ObjRelAccelY_32 9;
BA_ "GenSigStartValue" SG_ 1423 RSDS_L_ObjRelAccelX_32 512;
BA_ "GenSigSendType" SG_ 1423 RSDS_L_ObjRelAccelX_32 9;
BA_ "GenSigStartValue" SG_ 1423 RSDS_L_ObjRelVelY_32 4102;
BA_ "GenSigSendType" SG_ 1423 RSDS_L_ObjRelVelY_32 9;
BA_ "GenSigStartValue" SG_ 1423 RSDS_L_ObjRelVelX_32 4102;
BA_ "GenSigSendType" SG_ 1423 RSDS_L_ObjRelVelX_32 9;
BA_ "GenSigSendType" SG_ 1423 RSDS_L_SGU16_Checksum6 9;
BA_ "IsCrcSignal" SG_ 1423 RSDS_L_SGU16_Checksum6 1;
BA_ "GenSigSendType" SG_ 1423 RSDS_L_SGU16_RollingCounter5 9;
BA_ "IsRcSignal" SG_ 1423 RSDS_L_SGU16_RollingCounter5 1;
BA_ "GenSigSendType" SG_ 1423 RSDS_L_ObjType_32 9;
BA_ "GenSigSendType" SG_ 1423 RSDS_L_ObjDistXStd_32 9;
BA_ "GenSigStartValue" SG_ 1423 RSDS_L_ObjDistY_32 1024;
BA_ "GenSigSendType" SG_ 1423 RSDS_L_ObjDistY_32 9;
BA_ "GenSigSendType" SG_ 1423 RSDS_L_ObjDistX_32 9;
BA_ "GenSigSendType" SG_ 1423 RSDS_L_ObjObstacleProb_32 9;
BA_ "GenSigSendType" SG_ 1423 RSDS_L_ObjExistProb_32 9;
BA_ "GenSigSendType" SG_ 1423 RSDS_L_ObjID_32 9;
BA_ "GenSigSendType" SG_ 1423 RSDS_L_SGU16_Checksum5 9;
BA_ "IsCrcSignal" SG_ 1423 RSDS_L_SGU16_Checksum5 1;
BA_ "GenSigSendType" SG_ 1423 RSDS_L_SGU16_RollingCounter4 9;
BA_ "IsRcSignal" SG_ 1423 RSDS_L_SGU16_RollingCounter4 1;
BA_ "GenSigSendType" SG_ 1423 RSDS_L_HWATargetValidity_31 9;
BA_ "GenSigSendType" SG_ 1423 RSDS_L_ObjRefPoint_31 9;
BA_ "GenSigStartValue" SG_ 1423 RSDS_L_ObjRCS_31 400;
BA_ "GenSigSendType" SG_ 1423 RSDS_L_ObjRCS_31 9;
BA_ "GenSigSendType" SG_ 1423 RSDS_L_ObjYawrate_31 9;
BA_ "GenSigSendType" SG_ 1423 RSDS_L_ObjHeading_31 9;
BA_ "GenSigSendType" SG_ 1423 RSDS_L_ObjLength_31 9;
BA_ "GenSigSendType" SG_ 1423 RSDS_L_SGU16_Checksum4 9;
BA_ "IsCrcSignal" SG_ 1423 RSDS_L_SGU16_Checksum4 1;
BA_ "GenSigSendType" SG_ 1423 RSDS_L_SGU16_RollingCounter3 9;
BA_ "IsRcSignal" SG_ 1423 RSDS_L_SGU16_RollingCounter3 1;
BA_ "GenSigSendType" SG_ 1423 RSDS_L_ObjMotionDirection_31 9;
BA_ "GenSigSendType" SG_ 1423 RSDS_L_ObjAge_31 9;
BA_ "GenSigSendType" SG_ 1423 RSDS_L_ObjWidth_31 9;
BA_ "GenSigSendType" SG_ 1423 RSDS_L_ObjRAccelYStd_31 9;
BA_ "GenSigSendType" SG_ 1423 RSDS_L_ObjRAccelXStd_31 9;
BA_ "GenSigSendType" SG_ 1423 RSDS_L_ObjRelVelYStd_31 9;
BA_ "GenSigSendType" SG_ 1423 RSDS_L_ObjRelVelXStd_31 9;
BA_ "GenSigSendType" SG_ 1423 RSDS_L_ObjDistYStd_31 9;
BA_ "GenSigSendType" SG_ 1423 RSDS_L_SGU16_Checksum3 9;
BA_ "IsCrcSignal" SG_ 1423 RSDS_L_SGU16_Checksum3 1;
BA_ "GenSigSendType" SG_ 1423 RSDS_L_SGU16_RollingCounter2 9;
BA_ "IsRcSignal" SG_ 1423 RSDS_L_SGU16_RollingCounter2 1;
BA_ "GenSigSendType" SG_ 1423 RSDS_L_ObjMotionType_31 9;
BA_ "GenSigStartValue" SG_ 1423 RSDS_L_ObjMeasured_31 1;
BA_ "GenSigSendType" SG_ 1423 RSDS_L_ObjMeasured_31 9;
BA_ "GenSigStartValue" SG_ 1423 RSDS_L_ObjRelAccelY_31 512;
BA_ "GenSigSendType" SG_ 1423 RSDS_L_ObjRelAccelY_31 9;
BA_ "GenSigStartValue" SG_ 1423 RSDS_L_ObjRelAccelX_31 512;
BA_ "GenSigSendType" SG_ 1423 RSDS_L_ObjRelAccelX_31 9;
BA_ "GenSigStartValue" SG_ 1423 RSDS_L_ObjRelVelY_31 4102;
BA_ "GenSigSendType" SG_ 1423 RSDS_L_ObjRelVelY_31 9;
BA_ "GenSigStartValue" SG_ 1423 RSDS_L_ObjRelVelX_31 4102;
BA_ "GenSigSendType" SG_ 1423 RSDS_L_ObjRelVelX_31 9;
BA_ "GenSigSendType" SG_ 1423 RSDS_L_SGU16_Checksum2 9;
BA_ "IsCrcSignal" SG_ 1423 RSDS_L_SGU16_Checksum2 1;
BA_ "GenSigSendType" SG_ 1423 RSDS_L_SGU16_RollingCounter1 9;
BA_ "IsRcSignal" SG_ 1423 RSDS_L_SGU16_RollingCounter1 1;
BA_ "GenSigSendType" SG_ 1423 RSDS_L_ObjType_31 9;
BA_ "GenSigSendType" SG_ 1423 RSDS_L_ObjDistXStd_31 9;
BA_ "GenSigStartValue" SG_ 1423 RSDS_L_ObjDistY_31 1024;
BA_ "GenSigSendType" SG_ 1423 RSDS_L_ObjDistY_31 9;
BA_ "GenSigSendType" SG_ 1423 RSDS_L_ObjDistX_31 9;
BA_ "GenSigSendType" SG_ 1423 RSDS_L_ObjObstacleProb_31 9;
BA_ "GenSigSendType" SG_ 1423 RSDS_L_ObjExistProb_31 9;
BA_ "GenSigSendType" SG_ 1423 RSDS_L_ObjID_31 9;
BA_ "GenSigSendType" SG_ 1423 RSDS_L_SGU16_Checksum1 9;
BA_ "IsCrcSignal" SG_ 1423 RSDS_L_SGU16_Checksum1 1;
BA_ "GenSigSendType" SG_ 1486 RSDS_L_SGU_HEAD_RollingCounter4 9;
BA_ "IsRcSignal" SG_ 1486 RSDS_L_SGU_HEAD_RollingCounter4 1;
BA_ "GenSigSendType" SG_ 1486 RSDS_L_SGU_HEAD_BlockCounter 9;
BA_ "GenSigSendType" SG_ 1486 RSDS_L_ObjAziAngleCalib 9;
BA_ "GenSigSendType" SG_ 1486 RSDS_L_Guardrail_dxStart 9;
BA_ "GenSigSendType" SG_ 1486 RSDS_L_GuardrailC3 9;
BA_ "GenSigSendType" SG_ 1486 RSDS_L_SGU_HEAD_Checksum4 9;
BA_ "IsCrcSignal" SG_ 1486 RSDS_L_SGU_HEAD_Checksum4 1;
BA_ "GenSigSendType" SG_ 1486 RSDS_L_SGU_HEAD_RollingCounter3 9;
BA_ "IsRcSignal" SG_ 1486 RSDS_L_SGU_HEAD_RollingCounter3 1;
BA_ "GenSigSendType" SG_ 1486 RSDS_L_GuardrailC2 9;
BA_ "GenSigSendType" SG_ 1486 RSDS_L_GuardrailC1 9;
BA_ "GenSigSendType" SG_ 1486 RSDS_L_GuardrailC0 9;
BA_ "GenSigSendType" SG_ 1486 RSDS_L_SGU_HEAD_Checksum3 9;
BA_ "IsCrcSignal" SG_ 1486 RSDS_L_SGU_HEAD_Checksum3 1;
BA_ "GenSigSendType" SG_ 1486 RSDS_L_SGU_HEAD_RollingCounter2 9;
BA_ "IsRcSignal" SG_ 1486 RSDS_L_SGU_HEAD_RollingCounter2 1;
BA_ "GenSigSendType" SG_ 1486 RSDS_L_hdr_AutosarTimeStamp 9;
BA_ "GenSigSendType" SG_ 1486 RSDS_L_SGU_HEAD_Checksum2 9;
BA_ "IsCrcSignal" SG_ 1486 RSDS_L_SGU_HEAD_Checksum2 1;
BA_ "GenSigSendType" SG_ 1486 RSDS_L_SGU_HEAD_RollingCounter1 9;
BA_ "IsRcSignal" SG_ 1486 RSDS_L_SGU_HEAD_RollingCounter1 1;
BA_ "GenSigSendType" SG_ 1486 RSDS_L_hdr_ErrorStatus 9;
BA_ "GenSigSendType" SG_ 1486 RSDS_L_Guardrail_dxEnd 9;
BA_ "GenSigSendType" SG_ 1486 RSDS_L_GuardrailConfidence 9;
BA_ "GenSigSendType" SG_ 1486 RSDS_L_ObjDetected 9;
BA_ "GenSigSendType" SG_ 1486 RSDS_L_BLIND 9;
BA_ "GenSigSendType" SG_ 1486 RSDS_L_hdr_TimeStampStatus 9;
BA_ "GenSigSendType" SG_ 1486 RSDS_L_hdr_TimeStamp 9;
BA_ "GenSigSendType" SG_ 1486 RSDS_L_SGU_HEAD_Checksum1 9;
BA_ "IsCrcSignal" SG_ 1486 RSDS_L_SGU_HEAD_Checksum1 1;
BA_ "GenSigSendType" SG_ 1966 RSDS_L_Phy_Resp 9;
BA_ "GenSigSendType" SG_ 1424 RSDS_R_SGU1_RollingCounter8 9;
BA_ "IsRcSignal" SG_ 1424 RSDS_R_SGU1_RollingCounter8 1;
BA_ "GenSigSendType" SG_ 1424 RSDS_R_SGU1_BlockCounter 9;
BA_ "GenSigSendType" SG_ 1424 RSDS_R_HWATargetValidity_2 9;
BA_ "GenSigSendType" SG_ 1424 RSDS_R_ObjRefPoint_2 9;
BA_ "GenSigStartValue" SG_ 1424 RSDS_R_ObjRCS_2 400;
BA_ "GenSigSendType" SG_ 1424 RSDS_R_ObjRCS_2 9;
BA_ "GenSigSendType" SG_ 1424 RSDS_R_ObjYawrate_2 9;
BA_ "GenSigSendType" SG_ 1424 RSDS_R_ObjHeading_2 9;
BA_ "GenSigSendType" SG_ 1424 RSDS_R_ObjLength_2 9;
BA_ "GenSigSendType" SG_ 1424 RSDS_R_SGU1_Checksum8 9;
BA_ "IsCrcSignal" SG_ 1424 RSDS_R_SGU1_Checksum8 1;
BA_ "GenSigSendType" SG_ 1424 RSDS_R_SGU1_RollingCounter7 9;
BA_ "IsRcSignal" SG_ 1424 RSDS_R_SGU1_RollingCounter7 1;
BA_ "GenSigSendType" SG_ 1424 RSDS_R_ObjMotionDirection_2 9;
BA_ "GenSigSendType" SG_ 1424 RSDS_R_ObjAge_2 9;
BA_ "GenSigSendType" SG_ 1424 RSDS_R_ObjWidth_2 9;
BA_ "GenSigSendType" SG_ 1424 RSDS_R_ObjRAccelYStd_2 9;
BA_ "GenSigSendType" SG_ 1424 RSDS_R_ObjRAccelXStd_2 9;
BA_ "GenSigSendType" SG_ 1424 RSDS_R_ObjRelVelYStd_2 9;
BA_ "GenSigSendType" SG_ 1424 RSDS_R_ObjRelVelXStd_2 9;
BA_ "GenSigSendType" SG_ 1424 RSDS_R_ObjDistYStd_2 9;
BA_ "GenSigSendType" SG_ 1424 RSDS_R_SGU1_Checksum7 9;
BA_ "IsCrcSignal" SG_ 1424 RSDS_R_SGU1_Checksum7 1;
BA_ "GenSigSendType" SG_ 1424 RSDS_R_SGU1_RollingCounter6 9;
BA_ "IsRcSignal" SG_ 1424 RSDS_R_SGU1_RollingCounter6 1;
BA_ "GenSigSendType" SG_ 1424 RSDS_R_ObjMotionType_2 9;
BA_ "GenSigStartValue" SG_ 1424 RSDS_R_ObjMeasured_2 1;
BA_ "GenSigSendType" SG_ 1424 RSDS_R_ObjMeasured_2 9;
BA_ "GenSigStartValue" SG_ 1424 RSDS_R_ObjRelAccelY_2 512;
BA_ "GenSigSendType" SG_ 1424 RSDS_R_ObjRelAccelY_2 9;
BA_ "GenSigStartValue" SG_ 1424 RSDS_R_ObjRelAccelX_2 512;
BA_ "GenSigSendType" SG_ 1424 RSDS_R_ObjRelAccelX_2 9;
BA_ "GenSigStartValue" SG_ 1424 RSDS_R_ObjRelVelY_2 4102;
BA_ "GenSigSendType" SG_ 1424 RSDS_R_ObjRelVelY_2 9;
BA_ "GenSigStartValue" SG_ 1424 RSDS_R_ObjRelVelX_2 4102;
BA_ "GenSigSendType" SG_ 1424 RSDS_R_ObjRelVelX_2 9;
BA_ "GenSigSendType" SG_ 1424 RSDS_R_SGU1_Checksum6 9;
BA_ "IsCrcSignal" SG_ 1424 RSDS_R_SGU1_Checksum6 1;
BA_ "GenSigSendType" SG_ 1424 RSDS_R_SGU1_RollingCounter5 9;
BA_ "IsRcSignal" SG_ 1424 RSDS_R_SGU1_RollingCounter5 1;
BA_ "GenSigSendType" SG_ 1424 RSDS_R_ObjType_2 9;
BA_ "GenSigSendType" SG_ 1424 RSDS_R_ObjDistXStd_2 9;
BA_ "GenSigStartValue" SG_ 1424 RSDS_R_ObjDistY_2 1024;
BA_ "GenSigSendType" SG_ 1424 RSDS_R_ObjDistY_2 9;
BA_ "GenSigSendType" SG_ 1424 RSDS_R_ObjDistX_2 9;
BA_ "GenSigSendType" SG_ 1424 RSDS_R_ObjObstacleProb_2 9;
BA_ "GenSigSendType" SG_ 1424 RSDS_R_ObjExistProb_2 9;
BA_ "GenSigSendType" SG_ 1424 RSDS_R_ObjID_2 9;
BA_ "GenSigSendType" SG_ 1424 RSDS_R_SGU1_Checksum5 9;
BA_ "IsCrcSignal" SG_ 1424 RSDS_R_SGU1_Checksum5 1;
BA_ "GenSigSendType" SG_ 1424 RSDS_R_SGU1_RollingCounter4 9;
BA_ "IsRcSignal" SG_ 1424 RSDS_R_SGU1_RollingCounter4 1;
BA_ "GenSigSendType" SG_ 1424 RSDS_R_HWATargetValidity_1 9;
BA_ "GenSigSendType" SG_ 1424 RSDS_R_ObjRefPoint_1 9;
BA_ "GenSigStartValue" SG_ 1424 RSDS_R_ObjRCS_1 400;
BA_ "GenSigSendType" SG_ 1424 RSDS_R_ObjRCS_1 9;
BA_ "GenSigSendType" SG_ 1424 RSDS_R_ObjYawrate_1 9;
BA_ "GenSigSendType" SG_ 1424 RSDS_R_ObjHeading_1 9;
BA_ "GenSigSendType" SG_ 1424 RSDS_R_ObjLength_1 9;
BA_ "GenSigSendType" SG_ 1424 RSDS_R_SGU1_Checksum4 9;
BA_ "IsCrcSignal" SG_ 1424 RSDS_R_SGU1_Checksum4 1;
BA_ "GenSigSendType" SG_ 1424 RSDS_R_SGU1_RollingCounter3 9;
BA_ "IsRcSignal" SG_ 1424 RSDS_R_SGU1_RollingCounter3 1;
BA_ "GenSigSendType" SG_ 1424 RSDS_R_ObjMotionDirection_1 9;
BA_ "GenSigSendType" SG_ 1424 RSDS_R_ObjAge_1 9;
BA_ "GenSigSendType" SG_ 1424 RSDS_R_ObjWidth_1 9;
BA_ "GenSigSendType" SG_ 1424 RSDS_R_ObjRAccelYStd_1 9;
BA_ "GenSigSendType" SG_ 1424 RSDS_R_ObjRAccelXStd_1 9;
BA_ "GenSigSendType" SG_ 1424 RSDS_R_ObjRelVelYStd_1 9;
BA_ "GenSigSendType" SG_ 1424 RSDS_R_ObjRelVelXStd_1 9;
BA_ "GenSigSendType" SG_ 1424 RSDS_R_ObjDistYStd_1 9;
BA_ "GenSigSendType" SG_ 1424 RSDS_R_SGU1_Checksum3 9;
BA_ "IsCrcSignal" SG_ 1424 RSDS_R_SGU1_Checksum3 1;
BA_ "GenSigSendType" SG_ 1424 RSDS_R_SGU1_RollingCounter2 9;
BA_ "IsRcSignal" SG_ 1424 RSDS_R_SGU1_RollingCounter2 1;
BA_ "GenSigSendType" SG_ 1424 RSDS_R_ObjMotionType_1 9;
BA_ "GenSigStartValue" SG_ 1424 RSDS_R_ObjMeasured_1 1;
BA_ "GenSigSendType" SG_ 1424 RSDS_R_ObjMeasured_1 9;
BA_ "GenSigStartValue" SG_ 1424 RSDS_R_ObjRelAccelY_1 512;
BA_ "GenSigSendType" SG_ 1424 RSDS_R_ObjRelAccelY_1 9;
BA_ "GenSigStartValue" SG_ 1424 RSDS_R_ObjRelAccelX_1 512;
BA_ "GenSigSendType" SG_ 1424 RSDS_R_ObjRelAccelX_1 9;
BA_ "GenSigStartValue" SG_ 1424 RSDS_R_ObjRelVelY_1 4102;
BA_ "GenSigSendType" SG_ 1424 RSDS_R_ObjRelVelY_1 9;
BA_ "GenSigStartValue" SG_ 1424 RSDS_R_ObjRelVelX_1 4102;
BA_ "GenSigSendType" SG_ 1424 RSDS_R_ObjRelVelX_1 9;
BA_ "GenSigSendType" SG_ 1424 RSDS_R_SGU1_Checksum2 9;
BA_ "IsCrcSignal" SG_ 1424 RSDS_R_SGU1_Checksum2 1;
BA_ "GenSigSendType" SG_ 1424 RSDS_R_SGU1_RollingCounter1 9;
BA_ "IsRcSignal" SG_ 1424 RSDS_R_SGU1_RollingCounter1 1;
BA_ "GenSigSendType" SG_ 1424 RSDS_R_ObjType_1 9;
BA_ "GenSigSendType" SG_ 1424 RSDS_R_ObjDistXStd_1 9;
BA_ "GenSigStartValue" SG_ 1424 RSDS_R_ObjDistY_1 1024;
BA_ "GenSigSendType" SG_ 1424 RSDS_R_ObjDistY_1 9;
BA_ "GenSigSendType" SG_ 1424 RSDS_R_ObjDistX_1 9;
BA_ "GenSigSendType" SG_ 1424 RSDS_R_ObjObstacleProb_1 9;
BA_ "GenSigSendType" SG_ 1424 RSDS_R_ObjExistProb_1 9;
BA_ "GenSigSendType" SG_ 1424 RSDS_R_ObjID_1 9;
BA_ "GenSigSendType" SG_ 1424 RSDS_R_SGU1_Checksum1 9;
BA_ "IsCrcSignal" SG_ 1424 RSDS_R_SGU1_Checksum1 1;
BA_ "GenSigSendType" SG_ 1425 RSDS_R_SGU2_RollingCounter8 9;
BA_ "IsRcSignal" SG_ 1425 RSDS_R_SGU2_RollingCounter8 1;
BA_ "GenSigSendType" SG_ 1425 RSDS_R_SGU2_BlockCounter 9;
BA_ "GenSigSendType" SG_ 1425 RSDS_R_HWATargetValidity_4 9;
BA_ "GenSigSendType" SG_ 1425 RSDS_R_ObjRefPoint_4 9;
BA_ "GenSigStartValue" SG_ 1425 RSDS_R_ObjRCS_4 400;
BA_ "GenSigSendType" SG_ 1425 RSDS_R_ObjRCS_4 9;
BA_ "GenSigSendType" SG_ 1425 RSDS_R_ObjYawrate_4 9;
BA_ "GenSigSendType" SG_ 1425 RSDS_R_ObjHeading_4 9;
BA_ "GenSigSendType" SG_ 1425 RSDS_R_ObjLength_4 9;
BA_ "GenSigSendType" SG_ 1425 RSDS_R_SGU2_Checksum8 9;
BA_ "IsCrcSignal" SG_ 1425 RSDS_R_SGU2_Checksum8 1;
BA_ "GenSigSendType" SG_ 1425 RSDS_R_SGU2_RollingCounter7 9;
BA_ "IsRcSignal" SG_ 1425 RSDS_R_SGU2_RollingCounter7 1;
BA_ "GenSigSendType" SG_ 1425 RSDS_R_ObjMotionDirection_4 9;
BA_ "GenSigSendType" SG_ 1425 RSDS_R_ObjAge_4 9;
BA_ "GenSigSendType" SG_ 1425 RSDS_R_ObjWidth_4 9;
BA_ "GenSigSendType" SG_ 1425 RSDS_R_ObjRAccelYStd_4 9;
BA_ "GenSigSendType" SG_ 1425 RSDS_R_ObjRAccelXStd_4 9;
BA_ "GenSigSendType" SG_ 1425 RSDS_R_ObjRelVelYStd_4 9;
BA_ "GenSigSendType" SG_ 1425 RSDS_R_ObjRelVelXStd_4 9;
BA_ "GenSigSendType" SG_ 1425 RSDS_R_ObjDistYStd_4 9;
BA_ "GenSigSendType" SG_ 1425 RSDS_R_SGU2_Checksum7 9;
BA_ "IsCrcSignal" SG_ 1425 RSDS_R_SGU2_Checksum7 1;
BA_ "GenSigSendType" SG_ 1425 RSDS_R_SGU2_RollingCounter6 9;
BA_ "IsRcSignal" SG_ 1425 RSDS_R_SGU2_RollingCounter6 1;
BA_ "GenSigSendType" SG_ 1425 RSDS_R_ObjMotionType_4 9;
BA_ "GenSigStartValue" SG_ 1425 RSDS_R_ObjMeasured_4 1;
BA_ "GenSigSendType" SG_ 1425 RSDS_R_ObjMeasured_4 9;
BA_ "GenSigStartValue" SG_ 1425 RSDS_R_ObjRelAccelY_4 512;
BA_ "GenSigSendType" SG_ 1425 RSDS_R_ObjRelAccelY_4 9;
BA_ "GenSigStartValue" SG_ 1425 RSDS_R_ObjRelAccelX_4 512;
BA_ "GenSigSendType" SG_ 1425 RSDS_R_ObjRelAccelX_4 9;
BA_ "GenSigStartValue" SG_ 1425 RSDS_R_ObjRelVelY_4 4102;
BA_ "GenSigSendType" SG_ 1425 RSDS_R_ObjRelVelY_4 9;
BA_ "GenSigStartValue" SG_ 1425 RSDS_R_ObjRelVelX_4 4102;
BA_ "GenSigSendType" SG_ 1425 RSDS_R_ObjRelVelX_4 9;
BA_ "GenSigSendType" SG_ 1425 RSDS_R_SGU2_Checksum6 9;
BA_ "IsCrcSignal" SG_ 1425 RSDS_R_SGU2_Checksum6 1;
BA_ "GenSigSendType" SG_ 1425 RSDS_R_SGU2_RollingCounter5 9;
BA_ "IsRcSignal" SG_ 1425 RSDS_R_SGU2_RollingCounter5 1;
BA_ "GenSigSendType" SG_ 1425 RSDS_R_ObjType_4 9;
BA_ "GenSigSendType" SG_ 1425 RSDS_R_ObjDistXStd_4 9;
BA_ "GenSigStartValue" SG_ 1425 RSDS_R_ObjDistY_4 1024;
BA_ "GenSigSendType" SG_ 1425 RSDS_R_ObjDistY_4 9;
BA_ "GenSigSendType" SG_ 1425 RSDS_R_ObjDistX_4 9;
BA_ "GenSigSendType" SG_ 1425 RSDS_R_ObjObstacleProb_4 9;
BA_ "GenSigSendType" SG_ 1425 RSDS_R_ObjExistProb_4 9;
BA_ "GenSigSendType" SG_ 1425 RSDS_R_ObjID_4 9;
BA_ "GenSigSendType" SG_ 1425 RSDS_R_SGU2_Checksum5 9;
BA_ "IsCrcSignal" SG_ 1425 RSDS_R_SGU2_Checksum5 1;
BA_ "GenSigSendType" SG_ 1425 RSDS_R_SGU2_RollingCounter4 9;
BA_ "IsRcSignal" SG_ 1425 RSDS_R_SGU2_RollingCounter4 1;
BA_ "GenSigSendType" SG_ 1425 RSDS_R_HWATargetValidity_3 9;
BA_ "GenSigSendType" SG_ 1425 RSDS_R_ObjRefPoint_3 9;
BA_ "GenSigStartValue" SG_ 1425 RSDS_R_ObjRCS_3 400;
BA_ "GenSigSendType" SG_ 1425 RSDS_R_ObjRCS_3 9;
BA_ "GenSigSendType" SG_ 1425 RSDS_R_ObjYawrate_3 9;
BA_ "GenSigSendType" SG_ 1425 RSDS_R_ObjHeading_3 9;
BA_ "GenSigSendType" SG_ 1425 RSDS_R_ObjLength_3 9;
BA_ "GenSigSendType" SG_ 1425 RSDS_R_SGU2_Checksum4 9;
BA_ "IsCrcSignal" SG_ 1425 RSDS_R_SGU2_Checksum4 1;
BA_ "GenSigSendType" SG_ 1425 RSDS_R_SGU2_RollingCounter3 9;
BA_ "IsRcSignal" SG_ 1425 RSDS_R_SGU2_RollingCounter3 1;
BA_ "GenSigSendType" SG_ 1425 RSDS_R_ObjMotionDirection_3 9;
BA_ "GenSigSendType" SG_ 1425 RSDS_R_ObjAge_3 9;
BA_ "GenSigSendType" SG_ 1425 RSDS_R_ObjWidth_3 9;
BA_ "GenSigSendType" SG_ 1425 RSDS_R_ObjRAccelYStd_3 9;
BA_ "GenSigSendType" SG_ 1425 RSDS_R_ObjRAccelXStd_3 9;
BA_ "GenSigSendType" SG_ 1425 RSDS_R_ObjRelVelYStd_3 9;
BA_ "GenSigSendType" SG_ 1425 RSDS_R_ObjRelVelXStd_3 9;
BA_ "GenSigSendType" SG_ 1425 RSDS_R_ObjDistYStd_3 9;
BA_ "GenSigSendType" SG_ 1425 RSDS_R_SGU2_Checksum3 9;
BA_ "IsCrcSignal" SG_ 1425 RSDS_R_SGU2_Checksum3 1;
BA_ "GenSigSendType" SG_ 1425 RSDS_R_SGU2_RollingCounter2 9;
BA_ "IsRcSignal" SG_ 1425 RSDS_R_SGU2_RollingCounter2 1;
BA_ "GenSigSendType" SG_ 1425 RSDS_R_ObjMotionType_3 9;
BA_ "GenSigStartValue" SG_ 1425 RSDS_R_ObjMeasured_3 1;
BA_ "GenSigSendType" SG_ 1425 RSDS_R_ObjMeasured_3 9;
BA_ "GenSigStartValue" SG_ 1425 RSDS_R_ObjRelAccelY_3 512;
BA_ "GenSigSendType" SG_ 1425 RSDS_R_ObjRelAccelY_3 9;
BA_ "GenSigStartValue" SG_ 1425 RSDS_R_ObjRelAccelX_3 512;
BA_ "GenSigSendType" SG_ 1425 RSDS_R_ObjRelAccelX_3 9;
BA_ "GenSigStartValue" SG_ 1425 RSDS_R_ObjRelVelY_3 4102;
BA_ "GenSigSendType" SG_ 1425 RSDS_R_ObjRelVelY_3 9;
BA_ "GenSigStartValue" SG_ 1425 RSDS_R_ObjRelVelX_3 4102;
BA_ "GenSigSendType" SG_ 1425 RSDS_R_ObjRelVelX_3 9;
BA_ "GenSigSendType" SG_ 1425 RSDS_R_SGU2_Checksum2 9;
BA_ "IsCrcSignal" SG_ 1425 RSDS_R_SGU2_Checksum2 1;
BA_ "GenSigSendType" SG_ 1425 RSDS_R_SGU2_RollingCounter1 9;
BA_ "IsRcSignal" SG_ 1425 RSDS_R_SGU2_RollingCounter1 1;
BA_ "GenSigSendType" SG_ 1425 RSDS_R_ObjType_3 9;
BA_ "GenSigSendType" SG_ 1425 RSDS_R_ObjDistXStd_3 9;
BA_ "GenSigStartValue" SG_ 1425 RSDS_R_ObjDistY_3 1024;
BA_ "GenSigSendType" SG_ 1425 RSDS_R_ObjDistY_3 9;
BA_ "GenSigSendType" SG_ 1425 RSDS_R_ObjDistX_3 9;
BA_ "GenSigSendType" SG_ 1425 RSDS_R_ObjObstacleProb_3 9;
BA_ "GenSigSendType" SG_ 1425 RSDS_R_ObjExistProb_3 9;
BA_ "GenSigSendType" SG_ 1425 RSDS_R_ObjID_3 9;
BA_ "GenSigSendType" SG_ 1425 RSDS_R_SGU2_Checksum1 9;
BA_ "IsCrcSignal" SG_ 1425 RSDS_R_SGU2_Checksum1 1;
BA_ "GenSigSendType" SG_ 1426 RSDS_R_SGU3_RollingCounter8 9;
BA_ "IsRcSignal" SG_ 1426 RSDS_R_SGU3_RollingCounter8 1;
BA_ "GenSigSendType" SG_ 1426 RSDS_R_SGU3_BlockCounter 9;
BA_ "GenSigSendType" SG_ 1426 RSDS_R_HWATargetValidity_6 9;
BA_ "GenSigSendType" SG_ 1426 RSDS_R_ObjRefPoint_6 9;
BA_ "GenSigStartValue" SG_ 1426 RSDS_R_ObjRCS_6 400;
BA_ "GenSigSendType" SG_ 1426 RSDS_R_ObjRCS_6 9;
BA_ "GenSigSendType" SG_ 1426 RSDS_R_ObjYawrate_6 9;
BA_ "GenSigSendType" SG_ 1426 RSDS_R_ObjHeading_6 9;
BA_ "GenSigSendType" SG_ 1426 RSDS_R_ObjLength_6 9;
BA_ "GenSigSendType" SG_ 1426 RSDS_R_SGU3_Checksum8 9;
BA_ "IsCrcSignal" SG_ 1426 RSDS_R_SGU3_Checksum8 1;
BA_ "GenSigSendType" SG_ 1426 RSDS_R_SGU3_RollingCounter7 9;
BA_ "IsRcSignal" SG_ 1426 RSDS_R_SGU3_RollingCounter7 1;
BA_ "GenSigSendType" SG_ 1426 RSDS_R_ObjMotionDirection_6 9;
BA_ "GenSigSendType" SG_ 1426 RSDS_R_ObjAge_6 9;
BA_ "GenSigSendType" SG_ 1426 RSDS_R_ObjWidth_6 9;
BA_ "GenSigSendType" SG_ 1426 RSDS_R_ObjRAccelYStd_6 9;
BA_ "GenSigSendType" SG_ 1426 RSDS_R_ObjRAccelXStd_6 9;
BA_ "GenSigSendType" SG_ 1426 RSDS_R_ObjRelVelYStd_6 9;
BA_ "GenSigSendType" SG_ 1426 RSDS_R_ObjRelVelXStd_6 9;
BA_ "GenSigSendType" SG_ 1426 RSDS_R_ObjDistYStd_6 9;
BA_ "GenSigSendType" SG_ 1426 RSDS_R_SGU3_Checksum7 9;
BA_ "IsCrcSignal" SG_ 1426 RSDS_R_SGU3_Checksum7 1;
BA_ "GenSigSendType" SG_ 1426 RSDS_R_SGU3_RollingCounter6 9;
BA_ "IsRcSignal" SG_ 1426 RSDS_R_SGU3_RollingCounter6 1;
BA_ "GenSigSendType" SG_ 1426 RSDS_R_ObjMotionType_6 9;
BA_ "GenSigStartValue" SG_ 1426 RSDS_R_ObjMeasured_6 1;
BA_ "GenSigSendType" SG_ 1426 RSDS_R_ObjMeasured_6 9;
BA_ "GenSigStartValue" SG_ 1426 RSDS_R_ObjRelAccelY_6 512;
BA_ "GenSigSendType" SG_ 1426 RSDS_R_ObjRelAccelY_6 9;
BA_ "GenSigStartValue" SG_ 1426 RSDS_R_ObjRelAccelX_6 512;
BA_ "GenSigSendType" SG_ 1426 RSDS_R_ObjRelAccelX_6 9;
BA_ "GenSigStartValue" SG_ 1426 RSDS_R_ObjRelVelY_6 4102;
BA_ "GenSigSendType" SG_ 1426 RSDS_R_ObjRelVelY_6 9;
BA_ "GenSigStartValue" SG_ 1426 RSDS_R_ObjRelVelX_6 4102;
BA_ "GenSigSendType" SG_ 1426 RSDS_R_ObjRelVelX_6 9;
BA_ "GenSigSendType" SG_ 1426 RSDS_R_SGU3_Checksum6 9;
BA_ "IsCrcSignal" SG_ 1426 RSDS_R_SGU3_Checksum6 1;
BA_ "GenSigSendType" SG_ 1426 RSDS_R_SGU3_RollingCounter5 9;
BA_ "IsRcSignal" SG_ 1426 RSDS_R_SGU3_RollingCounter5 1;
BA_ "GenSigSendType" SG_ 1426 RSDS_R_ObjType_6 9;
BA_ "GenSigSendType" SG_ 1426 RSDS_R_ObjDistXStd_6 9;
BA_ "GenSigStartValue" SG_ 1426 RSDS_R_ObjDistY_6 1024;
BA_ "GenSigSendType" SG_ 1426 RSDS_R_ObjDistY_6 9;
BA_ "GenSigSendType" SG_ 1426 RSDS_R_ObjDistX_6 9;
BA_ "GenSigSendType" SG_ 1426 RSDS_R_ObjObstacleProb_6 9;
BA_ "GenSigSendType" SG_ 1426 RSDS_R_ObjExistProb_6 9;
BA_ "GenSigSendType" SG_ 1426 RSDS_R_ObjID_6 9;
BA_ "GenSigSendType" SG_ 1426 RSDS_R_SGU3_Checksum5 9;
BA_ "IsCrcSignal" SG_ 1426 RSDS_R_SGU3_Checksum5 1;
BA_ "GenSigSendType" SG_ 1426 RSDS_R_SGU3_RollingCounter4 9;
BA_ "IsRcSignal" SG_ 1426 RSDS_R_SGU3_RollingCounter4 1;
BA_ "GenSigSendType" SG_ 1426 RSDS_R_HWATargetValidity_5 9;
BA_ "GenSigSendType" SG_ 1426 RSDS_R_ObjRefPoint_5 9;
BA_ "GenSigStartValue" SG_ 1426 RSDS_R_ObjRCS_5 400;
BA_ "GenSigSendType" SG_ 1426 RSDS_R_ObjRCS_5 9;
BA_ "GenSigSendType" SG_ 1426 RSDS_R_ObjYawrate_5 9;
BA_ "GenSigSendType" SG_ 1426 RSDS_R_ObjHeading_5 9;
BA_ "GenSigSendType" SG_ 1426 RSDS_R_ObjLength_5 9;
BA_ "GenSigSendType" SG_ 1426 RSDS_R_SGU3_Checksum4 9;
BA_ "IsCrcSignal" SG_ 1426 RSDS_R_SGU3_Checksum4 1;
BA_ "GenSigSendType" SG_ 1426 RSDS_R_SGU3_RollingCounter3 9;
BA_ "IsRcSignal" SG_ 1426 RSDS_R_SGU3_RollingCounter3 1;
BA_ "GenSigSendType" SG_ 1426 RSDS_R_ObjMotionDirection_5 9;
BA_ "GenSigSendType" SG_ 1426 RSDS_R_ObjAge_5 9;
BA_ "GenSigSendType" SG_ 1426 RSDS_R_ObjWidth_5 9;
BA_ "GenSigSendType" SG_ 1426 RSDS_R_ObjRAccelYStd_5 9;
BA_ "GenSigSendType" SG_ 1426 RSDS_R_ObjRAccelXStd_5 9;
BA_ "GenSigSendType" SG_ 1426 RSDS_R_ObjRelVelYStd_5 9;
BA_ "GenSigSendType" SG_ 1426 RSDS_R_ObjRelVelXStd_5 9;
BA_ "GenSigSendType" SG_ 1426 RSDS_R_ObjDistYStd_5 9;
BA_ "GenSigSendType" SG_ 1426 RSDS_R_SGU3_Checksum3 9;
BA_ "IsCrcSignal" SG_ 1426 RSDS_R_SGU3_Checksum3 1;
BA_ "GenSigSendType" SG_ 1426 RSDS_R_SGU3_RollingCounter2 9;
BA_ "IsRcSignal" SG_ 1426 RSDS_R_SGU3_RollingCounter2 1;
BA_ "GenSigSendType" SG_ 1426 RSDS_R_ObjMotionType_5 9;
BA_ "GenSigStartValue" SG_ 1426 RSDS_R_ObjMeasured_5 1;
BA_ "GenSigSendType" SG_ 1426 RSDS_R_ObjMeasured_5 9;
BA_ "GenSigStartValue" SG_ 1426 RSDS_R_ObjRelAccelY_5 512;
BA_ "GenSigSendType" SG_ 1426 RSDS_R_ObjRelAccelY_5 9;
BA_ "GenSigStartValue" SG_ 1426 RSDS_R_ObjRelAccelX_5 512;
BA_ "GenSigSendType" SG_ 1426 RSDS_R_ObjRelAccelX_5 9;
BA_ "GenSigStartValue" SG_ 1426 RSDS_R_ObjRelVelY_5 4102;
BA_ "GenSigSendType" SG_ 1426 RSDS_R_ObjRelVelY_5 9;
BA_ "GenSigStartValue" SG_ 1426 RSDS_R_ObjRelVelX_5 4102;
BA_ "GenSigSendType" SG_ 1426 RSDS_R_ObjRelVelX_5 9;
BA_ "GenSigSendType" SG_ 1426 RSDS_R_SGU3_Checksum2 9;
BA_ "IsCrcSignal" SG_ 1426 RSDS_R_SGU3_Checksum2 1;
BA_ "GenSigSendType" SG_ 1426 RSDS_R_SGU3_RollingCounter1 9;
BA_ "IsRcSignal" SG_ 1426 RSDS_R_SGU3_RollingCounter1 1;
BA_ "GenSigSendType" SG_ 1426 RSDS_R_ObjType_5 9;
BA_ "GenSigSendType" SG_ 1426 RSDS_R_ObjDistXStd_5 9;
BA_ "GenSigStartValue" SG_ 1426 RSDS_R_ObjDistY_5 1024;
BA_ "GenSigSendType" SG_ 1426 RSDS_R_ObjDistY_5 9;
BA_ "GenSigSendType" SG_ 1426 RSDS_R_ObjDistX_5 9;
BA_ "GenSigSendType" SG_ 1426 RSDS_R_ObjObstacleProb_5 9;
BA_ "GenSigSendType" SG_ 1426 RSDS_R_ObjExistProb_5 9;
BA_ "GenSigSendType" SG_ 1426 RSDS_R_ObjID_5 9;
BA_ "GenSigSendType" SG_ 1426 RSDS_R_SGU3_Checksum1 9;
BA_ "IsCrcSignal" SG_ 1426 RSDS_R_SGU3_Checksum1 1;
BA_ "GenSigSendType" SG_ 1427 RSDS_R_SGU4_RollingCounter8 9;
BA_ "IsRcSignal" SG_ 1427 RSDS_R_SGU4_RollingCounter8 1;
BA_ "GenSigSendType" SG_ 1427 RSDS_R_SGU4_BlockCounter 9;
BA_ "GenSigSendType" SG_ 1427 RSDS_R_HWATargetValidity_8 9;
BA_ "GenSigSendType" SG_ 1427 RSDS_R_ObjRefPoint_8 9;
BA_ "GenSigStartValue" SG_ 1427 RSDS_R_ObjRCS_8 400;
BA_ "GenSigSendType" SG_ 1427 RSDS_R_ObjRCS_8 9;
BA_ "GenSigSendType" SG_ 1427 RSDS_R_ObjYawrate_8 9;
BA_ "GenSigSendType" SG_ 1427 RSDS_R_ObjHeading_8 9;
BA_ "GenSigSendType" SG_ 1427 RSDS_R_ObjLength_8 9;
BA_ "GenSigSendType" SG_ 1427 RSDS_R_SGU4_Checksum8 9;
BA_ "IsCrcSignal" SG_ 1427 RSDS_R_SGU4_Checksum8 1;
BA_ "GenSigSendType" SG_ 1427 RSDS_R_SGU4_RollingCounter7 9;
BA_ "IsRcSignal" SG_ 1427 RSDS_R_SGU4_RollingCounter7 1;
BA_ "GenSigSendType" SG_ 1427 RSDS_R_ObjMotionDirection_8 9;
BA_ "GenSigSendType" SG_ 1427 RSDS_R_ObjAge_8 9;
BA_ "GenSigSendType" SG_ 1427 RSDS_R_ObjWidth_8 9;
BA_ "GenSigSendType" SG_ 1427 RSDS_R_ObjRAccelYStd_8 9;
BA_ "GenSigSendType" SG_ 1427 RSDS_R_ObjRAccelXStd_8 9;
BA_ "GenSigSendType" SG_ 1427 RSDS_R_ObjRelVelYStd_8 9;
BA_ "GenSigSendType" SG_ 1427 RSDS_R_ObjRelVelXStd_8 9;
BA_ "GenSigSendType" SG_ 1427 RSDS_R_ObjDistYStd_8 9;
BA_ "GenSigSendType" SG_ 1427 RSDS_R_SGU4_Checksum7 9;
BA_ "IsCrcSignal" SG_ 1427 RSDS_R_SGU4_Checksum7 1;
BA_ "GenSigSendType" SG_ 1427 RSDS_R_SGU4_RollingCounter6 9;
BA_ "IsRcSignal" SG_ 1427 RSDS_R_SGU4_RollingCounter6 1;
BA_ "GenSigSendType" SG_ 1427 RSDS_R_ObjMotionType_8 9;
BA_ "GenSigStartValue" SG_ 1427 RSDS_R_ObjMeasured_8 1;
BA_ "GenSigSendType" SG_ 1427 RSDS_R_ObjMeasured_8 9;
BA_ "GenSigStartValue" SG_ 1427 RSDS_R_ObjRelAccelY_8 512;
BA_ "GenSigSendType" SG_ 1427 RSDS_R_ObjRelAccelY_8 9;
BA_ "GenSigStartValue" SG_ 1427 RSDS_R_ObjRelAccelX_8 512;
BA_ "GenSigSendType" SG_ 1427 RSDS_R_ObjRelAccelX_8 9;
BA_ "GenSigStartValue" SG_ 1427 RSDS_R_ObjRelVelY_8 4102;
BA_ "GenSigSendType" SG_ 1427 RSDS_R_ObjRelVelY_8 9;
BA_ "GenSigStartValue" SG_ 1427 RSDS_R_ObjRelVelX_8 4102;
BA_ "GenSigSendType" SG_ 1427 RSDS_R_ObjRelVelX_8 9;
BA_ "GenSigSendType" SG_ 1427 RSDS_R_SGU4_Checksum6 9;
BA_ "IsCrcSignal" SG_ 1427 RSDS_R_SGU4_Checksum6 1;
BA_ "GenSigSendType" SG_ 1427 RSDS_R_SGU4_RollingCounter5 9;
BA_ "IsRcSignal" SG_ 1427 RSDS_R_SGU4_RollingCounter5 1;
BA_ "GenSigSendType" SG_ 1427 RSDS_R_ObjType_8 9;
BA_ "GenSigSendType" SG_ 1427 RSDS_R_ObjDistXStd_8 9;
BA_ "GenSigStartValue" SG_ 1427 RSDS_R_ObjDistY_8 1024;
BA_ "GenSigSendType" SG_ 1427 RSDS_R_ObjDistY_8 9;
BA_ "GenSigSendType" SG_ 1427 RSDS_R_ObjDistX_8 9;
BA_ "GenSigSendType" SG_ 1427 RSDS_R_ObjObstacleProb_8 9;
BA_ "GenSigSendType" SG_ 1427 RSDS_R_ObjExistProb_8 9;
BA_ "GenSigSendType" SG_ 1427 RSDS_R_ObjID_8 9;
BA_ "GenSigSendType" SG_ 1427 RSDS_R_SGU4_Checksum5 9;
BA_ "IsCrcSignal" SG_ 1427 RSDS_R_SGU4_Checksum5 1;
BA_ "GenSigSendType" SG_ 1427 RSDS_R_SGU4_RollingCounter4 9;
BA_ "IsRcSignal" SG_ 1427 RSDS_R_SGU4_RollingCounter4 1;
BA_ "GenSigSendType" SG_ 1427 RSDS_R_HWATargetValidity_7 9;
BA_ "GenSigSendType" SG_ 1427 RSDS_R_ObjRefPoint_7 9;
BA_ "GenSigStartValue" SG_ 1427 RSDS_R_ObjRCS_7 400;
BA_ "GenSigSendType" SG_ 1427 RSDS_R_ObjRCS_7 9;
BA_ "GenSigSendType" SG_ 1427 RSDS_R_ObjYawrate_7 9;
BA_ "GenSigSendType" SG_ 1427 RSDS_R_ObjHeading_7 9;
BA_ "GenSigSendType" SG_ 1427 RSDS_R_ObjLength_7 9;
BA_ "GenSigSendType" SG_ 1427 RSDS_R_SGU4_Checksum4 9;
BA_ "IsCrcSignal" SG_ 1427 RSDS_R_SGU4_Checksum4 1;
BA_ "GenSigSendType" SG_ 1427 RSDS_R_SGU4_RollingCounter3 9;
BA_ "IsRcSignal" SG_ 1427 RSDS_R_SGU4_RollingCounter3 1;
BA_ "GenSigSendType" SG_ 1427 RSDS_R_ObjMotionDirection_7 9;
BA_ "GenSigSendType" SG_ 1427 RSDS_R_ObjAge_7 9;
BA_ "GenSigSendType" SG_ 1427 RSDS_R_ObjWidth_7 9;
BA_ "GenSigSendType" SG_ 1427 RSDS_R_ObjRAccelYStd_7 9;
BA_ "GenSigSendType" SG_ 1427 RSDS_R_ObjRAccelXStd_7 9;
BA_ "GenSigSendType" SG_ 1427 RSDS_R_ObjRelVelYStd_7 9;
BA_ "GenSigSendType" SG_ 1427 RSDS_R_ObjRelVelXStd_7 9;
BA_ "GenSigSendType" SG_ 1427 RSDS_R_ObjDistYStd_7 9;
BA_ "GenSigSendType" SG_ 1427 RSDS_R_SGU4_Checksum3 9;
BA_ "IsCrcSignal" SG_ 1427 RSDS_R_SGU4_Checksum3 1;
BA_ "GenSigSendType" SG_ 1427 RSDS_R_SGU4_RollingCounter2 9;
BA_ "IsRcSignal" SG_ 1427 RSDS_R_SGU4_RollingCounter2 1;
BA_ "GenSigSendType" SG_ 1427 RSDS_R_ObjMotionType_7 9;
BA_ "GenSigStartValue" SG_ 1427 RSDS_R_ObjMeasured_7 1;
BA_ "GenSigSendType" SG_ 1427 RSDS_R_ObjMeasured_7 9;
BA_ "GenSigStartValue" SG_ 1427 RSDS_R_ObjRelAccelY_7 512;
BA_ "GenSigSendType" SG_ 1427 RSDS_R_ObjRelAccelY_7 9;
BA_ "GenSigStartValue" SG_ 1427 RSDS_R_ObjRelAccelX_7 512;
BA_ "GenSigSendType" SG_ 1427 RSDS_R_ObjRelAccelX_7 9;
BA_ "GenSigStartValue" SG_ 1427 RSDS_R_ObjRelVelY_7 4102;
BA_ "GenSigSendType" SG_ 1427 RSDS_R_ObjRelVelY_7 9;
BA_ "GenSigStartValue" SG_ 1427 RSDS_R_ObjRelVelX_7 4102;
BA_ "GenSigSendType" SG_ 1427 RSDS_R_ObjRelVelX_7 9;
BA_ "GenSigSendType" SG_ 1427 RSDS_R_SGU4_Checksum2 9;
BA_ "IsCrcSignal" SG_ 1427 RSDS_R_SGU4_Checksum2 1;
BA_ "GenSigSendType" SG_ 1427 RSDS_R_SGU4_RollingCounter1 9;
BA_ "IsRcSignal" SG_ 1427 RSDS_R_SGU4_RollingCounter1 1;
BA_ "GenSigSendType" SG_ 1427 RSDS_R_ObjType_7 9;
BA_ "GenSigSendType" SG_ 1427 RSDS_R_ObjDistXStd_7 9;
BA_ "GenSigStartValue" SG_ 1427 RSDS_R_ObjDistY_7 1024;
BA_ "GenSigSendType" SG_ 1427 RSDS_R_ObjDistY_7 9;
BA_ "GenSigSendType" SG_ 1427 RSDS_R_ObjDistX_7 9;
BA_ "GenSigSendType" SG_ 1427 RSDS_R_ObjObstacleProb_7 9;
BA_ "GenSigSendType" SG_ 1427 RSDS_R_ObjExistProb_7 9;
BA_ "GenSigSendType" SG_ 1427 RSDS_R_ObjID_7 9;
BA_ "GenSigSendType" SG_ 1427 RSDS_R_SGU4_Checksum1 9;
BA_ "IsCrcSignal" SG_ 1427 RSDS_R_SGU4_Checksum1 1;
BA_ "GenSigSendType" SG_ 1428 RSDS_R_SGU5_RollingCounter8 9;
BA_ "IsRcSignal" SG_ 1428 RSDS_R_SGU5_RollingCounter8 1;
BA_ "GenSigSendType" SG_ 1428 RSDS_R_SGU5_BlockCounter 9;
BA_ "GenSigSendType" SG_ 1428 RSDS_R_HWATargetValidity_10 9;
BA_ "GenSigSendType" SG_ 1428 RSDS_R_ObjRefPoint_10 9;
BA_ "GenSigStartValue" SG_ 1428 RSDS_R_ObjRCS_10 400;
BA_ "GenSigSendType" SG_ 1428 RSDS_R_ObjRCS_10 9;
BA_ "GenSigSendType" SG_ 1428 RSDS_R_ObjYawrate_10 9;
BA_ "GenSigSendType" SG_ 1428 RSDS_R_ObjHeading_10 9;
BA_ "GenSigSendType" SG_ 1428 RSDS_R_ObjLength_10 9;
BA_ "GenSigSendType" SG_ 1428 RSDS_R_SGU5_Checksum8 9;
BA_ "IsCrcSignal" SG_ 1428 RSDS_R_SGU5_Checksum8 1;
BA_ "GenSigSendType" SG_ 1428 RSDS_R_SGU5_RollingCounter7 9;
BA_ "IsRcSignal" SG_ 1428 RSDS_R_SGU5_RollingCounter7 1;
BA_ "GenSigSendType" SG_ 1428 RSDS_R_ObjMotionDirection_10 9;
BA_ "GenSigSendType" SG_ 1428 RSDS_R_ObjAge_10 9;
BA_ "GenSigSendType" SG_ 1428 RSDS_R_ObjWidth_10 9;
BA_ "GenSigSendType" SG_ 1428 RSDS_R_ObjRAccelYStd_10 9;
BA_ "GenSigSendType" SG_ 1428 RSDS_R_ObjRAccelXStd_10 9;
BA_ "GenSigSendType" SG_ 1428 RSDS_R_ObjRelVelYStd_10 9;
BA_ "GenSigSendType" SG_ 1428 RSDS_R_ObjRelVelXStd_10 9;
BA_ "GenSigSendType" SG_ 1428 RSDS_R_ObjDistYStd_10 9;
BA_ "GenSigSendType" SG_ 1428 RSDS_R_SGU5_Checksum7 9;
BA_ "IsCrcSignal" SG_ 1428 RSDS_R_SGU5_Checksum7 1;
BA_ "GenSigSendType" SG_ 1428 RSDS_R_SGU5_RollingCounter6 9;
BA_ "IsRcSignal" SG_ 1428 RSDS_R_SGU5_RollingCounter6 1;
BA_ "GenSigSendType" SG_ 1428 RSDS_R_ObjMotionType_10 9;
BA_ "GenSigStartValue" SG_ 1428 RSDS_R_ObjMeasured_10 1;
BA_ "GenSigSendType" SG_ 1428 RSDS_R_ObjMeasured_10 9;
BA_ "GenSigStartValue" SG_ 1428 RSDS_R_ObjRelAccelY_10 512;
BA_ "GenSigSendType" SG_ 1428 RSDS_R_ObjRelAccelY_10 9;
BA_ "GenSigStartValue" SG_ 1428 RSDS_R_ObjRelAccelX_10 512;
BA_ "GenSigSendType" SG_ 1428 RSDS_R_ObjRelAccelX_10 9;
BA_ "GenSigStartValue" SG_ 1428 RSDS_R_ObjRelVelY_10 4102;
BA_ "GenSigSendType" SG_ 1428 RSDS_R_ObjRelVelY_10 9;
BA_ "GenSigStartValue" SG_ 1428 RSDS_R_ObjRelVelX_10 4102;
BA_ "GenSigSendType" SG_ 1428 RSDS_R_ObjRelVelX_10 9;
BA_ "GenSigSendType" SG_ 1428 RSDS_R_SGU5_Checksum6 9;
BA_ "IsCrcSignal" SG_ 1428 RSDS_R_SGU5_Checksum6 1;
BA_ "GenSigSendType" SG_ 1428 RSDS_R_SGU5_RollingCounter5 9;
BA_ "IsRcSignal" SG_ 1428 RSDS_R_SGU5_RollingCounter5 1;
BA_ "GenSigSendType" SG_ 1428 RSDS_R_ObjType_10 9;
BA_ "GenSigSendType" SG_ 1428 RSDS_R_ObjDistXStd_10 9;
BA_ "GenSigStartValue" SG_ 1428 RSDS_R_ObjDistY_10 1024;
BA_ "GenSigSendType" SG_ 1428 RSDS_R_ObjDistY_10 9;
BA_ "GenSigSendType" SG_ 1428 RSDS_R_ObjDistX_10 9;
BA_ "GenSigSendType" SG_ 1428 RSDS_R_ObjObstacleProb_10 9;
BA_ "GenSigSendType" SG_ 1428 RSDS_R_ObjExistProb_10 9;
BA_ "GenSigSendType" SG_ 1428 RSDS_R_ObjID_10 9;
BA_ "GenSigSendType" SG_ 1428 RSDS_R_SGU5_Checksum5 9;
BA_ "IsCrcSignal" SG_ 1428 RSDS_R_SGU5_Checksum5 1;
BA_ "GenSigSendType" SG_ 1428 RSDS_R_SGU5_RollingCounter4 9;
BA_ "IsRcSignal" SG_ 1428 RSDS_R_SGU5_RollingCounter4 1;
BA_ "GenSigSendType" SG_ 1428 RSDS_R_HWATargetValidity_9 9;
BA_ "GenSigSendType" SG_ 1428 RSDS_R_ObjRefPoint_9 9;
BA_ "GenSigStartValue" SG_ 1428 RSDS_R_ObjRCS_9 400;
BA_ "GenSigSendType" SG_ 1428 RSDS_R_ObjRCS_9 9;
BA_ "GenSigSendType" SG_ 1428 RSDS_R_ObjYawrate_9 9;
BA_ "GenSigSendType" SG_ 1428 RSDS_R_ObjHeading_9 9;
BA_ "GenSigSendType" SG_ 1428 RSDS_R_ObjLength_9 9;
BA_ "GenSigSendType" SG_ 1428 RSDS_R_SGU5_Checksum4 9;
BA_ "IsCrcSignal" SG_ 1428 RSDS_R_SGU5_Checksum4 1;
BA_ "GenSigSendType" SG_ 1428 RSDS_R_SGU5_RollingCounter3 9;
BA_ "IsRcSignal" SG_ 1428 RSDS_R_SGU5_RollingCounter3 1;
BA_ "GenSigSendType" SG_ 1428 RSDS_R_ObjMotionDirection_9 9;
BA_ "GenSigSendType" SG_ 1428 RSDS_R_ObjAge_9 9;
BA_ "GenSigSendType" SG_ 1428 RSDS_R_ObjWidth_9 9;
BA_ "GenSigSendType" SG_ 1428 RSDS_R_ObjRAccelYStd_9 9;
BA_ "GenSigSendType" SG_ 1428 RSDS_R_ObjRAccelXStd_9 9;
BA_ "GenSigSendType" SG_ 1428 RSDS_R_ObjRelVelYStd_9 9;
BA_ "GenSigSendType" SG_ 1428 RSDS_R_ObjRelVelXStd_9 9;
BA_ "GenSigSendType" SG_ 1428 RSDS_R_ObjDistYStd_9 9;
BA_ "GenSigSendType" SG_ 1428 RSDS_R_SGU5_Checksum3 9;
BA_ "IsCrcSignal" SG_ 1428 RSDS_R_SGU5_Checksum3 1;
BA_ "GenSigSendType" SG_ 1428 RSDS_R_SGU5_RollingCounter2 9;
BA_ "IsRcSignal" SG_ 1428 RSDS_R_SGU5_RollingCounter2 1;
BA_ "GenSigSendType" SG_ 1428 RSDS_R_ObjMotionType_9 9;
BA_ "GenSigStartValue" SG_ 1428 RSDS_R_ObjMeasured_9 1;
BA_ "GenSigSendType" SG_ 1428 RSDS_R_ObjMeasured_9 9;
BA_ "GenSigStartValue" SG_ 1428 RSDS_R_ObjRelAccelY_9 512;
BA_ "GenSigSendType" SG_ 1428 RSDS_R_ObjRelAccelY_9 9;
BA_ "GenSigStartValue" SG_ 1428 RSDS_R_ObjRelAccelX_9 512;
BA_ "GenSigSendType" SG_ 1428 RSDS_R_ObjRelAccelX_9 9;
BA_ "GenSigStartValue" SG_ 1428 RSDS_R_ObjRelVelY_9 4102;
BA_ "GenSigSendType" SG_ 1428 RSDS_R_ObjRelVelY_9 9;
BA_ "GenSigStartValue" SG_ 1428 RSDS_R_ObjRelVelX_9 4102;
BA_ "GenSigSendType" SG_ 1428 RSDS_R_ObjRelVelX_9 9;
BA_ "GenSigSendType" SG_ 1428 RSDS_R_SGU5_Checksum2 9;
BA_ "IsCrcSignal" SG_ 1428 RSDS_R_SGU5_Checksum2 1;
BA_ "GenSigSendType" SG_ 1428 RSDS_R_SGU5_RollingCounter1 9;
BA_ "IsRcSignal" SG_ 1428 RSDS_R_SGU5_RollingCounter1 1;
BA_ "GenSigSendType" SG_ 1428 RSDS_R_ObjType_9 9;
BA_ "GenSigSendType" SG_ 1428 RSDS_R_ObjDistXStd_9 9;
BA_ "GenSigStartValue" SG_ 1428 RSDS_R_ObjDistY_9 1024;
BA_ "GenSigSendType" SG_ 1428 RSDS_R_ObjDistY_9 9;
BA_ "GenSigSendType" SG_ 1428 RSDS_R_ObjDistX_9 9;
BA_ "GenSigSendType" SG_ 1428 RSDS_R_ObjObstacleProb_9 9;
BA_ "GenSigSendType" SG_ 1428 RSDS_R_ObjExistProb_9 9;
BA_ "GenSigSendType" SG_ 1428 RSDS_R_ObjID_9 9;
BA_ "GenSigSendType" SG_ 1428 RSDS_R_SGU5_Checksum1 9;
BA_ "IsCrcSignal" SG_ 1428 RSDS_R_SGU5_Checksum1 1;
VAL_ 1418 RSDS_L_SGU11_RollingCounter8 15 "InValid_value" ;
VAL_ 1418 RSDS_L_HWATargetValidity_22 0 "NOT_HWA_Target" 1 "HWA_Target" ;
VAL_ 1418 RSDS_L_ObjRefPoint_22 0 "Rear" 1 "Rear_left" 2 "Left" 3 "Front_left" 4 "Front" 5 "Front_Right" 6 "Right" 7 "Rear_right" ;
VAL_ 1418 RSDS_L_SGU11_RollingCounter7 15 "InValid_value" ;
VAL_ 1418 RSDS_L_ObjMotionDirection_22 0 "Initial_Value" 1 "Inverse_direction" 2 "Same_direction" 3 "Cross" ;
VAL_ 1418 RSDS_L_ObjDistYStd_22 0 "Valid_values" ;
VAL_ 1418 RSDS_L_SGU11_RollingCounter6 15 "InValid_value" ;
VAL_ 1418 RSDS_L_ObjMotionType_22 0 "Initial_Value" 1 "Unknown" 2 "Drive" 3 "Stopped" 4 "Stand" ;
VAL_ 1418 RSDS_L_ObjMeasured_22 0 "Initial_Value" 1 "Measured" 2 "Predicted" ;
VAL_ 1418 RSDS_L_SGU11_RollingCounter5 15 "InValid_value" ;
VAL_ 1418 RSDS_L_ObjType_22 0 "Unknown" 1 "Truck" 2 "Car" 3 "Pedestrian" 4 "Cyclist" ;
VAL_ 1418 RSDS_L_ObjDistXStd_22 0 "Valid_values" ;
VAL_ 1418 RSDS_L_SGU11_RollingCounter4 15 "InValid_value" ;
VAL_ 1418 RSDS_L_HWATargetValidity_21 0 "NOT_HWA_Target" 1 "HWA_Target" ;
VAL_ 1418 RSDS_L_ObjRefPoint_21 0 "Rear" 1 "Rear_left" 2 "Left" 3 "Front_left" 4 "Front" 5 "Front_Right" 6 "Right" 7 "Rear_right" ;
VAL_ 1418 RSDS_L_SGU11_RollingCounter3 15 "InValid_value" ;
VAL_ 1418 RSDS_L_ObjMotionDirection_21 0 "Initial_Value" 1 "Inverse_direction" 2 "Same_direction" 3 "Cross" ;
VAL_ 1418 RSDS_L_ObjDistYStd_21 0 "Valid_values" ;
VAL_ 1418 RSDS_L_SGU11_RollingCounter2 15 "InValid_value" ;
VAL_ 1418 RSDS_L_ObjMotionType_21 0 "Initial_Value" 1 "Unknown" 2 "Drive" 3 "Stopped" 4 "Stand" ;
VAL_ 1418 RSDS_L_ObjMeasured_21 0 "Initial_Value" 1 "Measured" 2 "Predicted" ;
VAL_ 1418 RSDS_L_SGU11_RollingCounter1 15 "InValid_value" ;
VAL_ 1418 RSDS_L_ObjType_21 0 "Unknown" 1 "Truck" 2 "Car" 3 "Pedestrian" 4 "Cyclist" ;
VAL_ 1418 RSDS_L_ObjDistXStd_21 0 "Valid_values" ;
VAL_ 1419 RSDS_L_SGU12_RollingCounter8 15 "InValid_value" ;
VAL_ 1419 RSDS_L_HWATargetValidity_24 0 "NOT_HWA_Target" 1 "HWA_Target" ;
VAL_ 1419 RSDS_L_ObjRefPoint_24 0 "Rear" 1 "Rear_left" 2 "Left" 3 "Front_left" 4 "Front" 5 "Front_Right" 6 "Right" 7 "Rear_right" ;
VAL_ 1419 RSDS_L_SGU12_RollingCounter7 15 "InValid_value" ;
VAL_ 1419 RSDS_L_ObjMotionDirection_24 0 "Initial_Value" 1 "Inverse_direction" 2 "Same_direction" 3 "Cross" ;
VAL_ 1419 RSDS_L_ObjDistYStd_24 0 "Valid_values" ;
VAL_ 1419 RSDS_L_SGU12_RollingCounter6 15 "InValid_value" ;
VAL_ 1419 RSDS_L_ObjMotionType_24 0 "Initial_Value" 1 "Unknown" 2 "Drive" 3 "Stopped" 4 "Stand" ;
VAL_ 1419 RSDS_L_ObjMeasured_24 0 "Initial_Value" 1 "Measured" 2 "Predicted" ;
VAL_ 1419 RSDS_L_SGU12_RollingCounter5 15 "InValid_value" ;
VAL_ 1419 RSDS_L_ObjType_24 0 "Unknown" 1 "Truck" 2 "Car" 3 "Pedestrian" 4 "Cyclist" ;
VAL_ 1419 RSDS_L_ObjDistXStd_24 0 "Valid_values" ;
VAL_ 1419 RSDS_L_SGU12_RollingCounter4 15 "InValid_value" ;
VAL_ 1419 RSDS_L_HWATargetValidity_23 0 "NOT_HWA_Target" 1 "HWA_Target" ;
VAL_ 1419 RSDS_L_ObjRefPoint_23 0 "Rear" 1 "Rear_left" 2 "Left" 3 "Front_left" 4 "Front" 5 "Front_Right" 6 "Right" 7 "Rear_right" ;
VAL_ 1419 RSDS_L_SGU12_RollingCounter3 15 "InValid_value" ;
VAL_ 1419 RSDS_L_ObjMotionDirection_23 0 "Initial_Value" 1 "Inverse_direction" 2 "Same_direction" 3 "Cross" ;
VAL_ 1419 RSDS_L_ObjDistYStd_23 0 "Valid_values" ;
VAL_ 1419 RSDS_L_SGU12_RollingCounter2 15 "InValid_value" ;
VAL_ 1419 RSDS_L_ObjMotionType_23 0 "Initial_Value" 1 "Unknown" 2 "Drive" 3 "Stopped" 4 "Stand" ;
VAL_ 1419 RSDS_L_ObjMeasured_23 0 "Initial_Value" 1 "Measured" 2 "Predicted" ;
VAL_ 1419 RSDS_L_SGU12_RollingCounter1 15 "InValid_value" ;
VAL_ 1419 RSDS_L_ObjType_23 0 "Unknown" 1 "Truck" 2 "Car" 3 "Pedestrian" 4 "Cyclist" ;
VAL_ 1419 RSDS_L_ObjDistXStd_23 0 "Valid_values" ;
VAL_ 1420 RSDS_L_SGU13_RollingCounter8 15 "InValid_value" ;
VAL_ 1420 RSDS_L_HWATargetValidity_26 0 "NOT_HWA_Target" 1 "HWA_Target" ;
VAL_ 1420 RSDS_L_ObjRefPoint_26 0 "Rear" 1 "Rear_left" 2 "Left" 3 "Front_left" 4 "Front" 5 "Front_Right" 6 "Right" 7 "Rear_right" ;
VAL_ 1420 RSDS_L_SGU13_RollingCounter7 15 "InValid_value" ;
VAL_ 1420 RSDS_L_ObjMotionDirection_26 0 "Initial_Value" 1 "Inverse_direction" 2 "Same_direction" 3 "Cross" ;
VAL_ 1420 RSDS_L_ObjDistYStd_26 0 "Valid_values" ;
VAL_ 1420 RSDS_L_SGU13_RollingCounter6 15 "InValid_value" ;
VAL_ 1420 RSDS_L_ObjMotionType_26 0 "Initial_Value" 1 "Unknown" 2 "Drive" 3 "Stopped" 4 "Stand" ;
VAL_ 1420 RSDS_L_ObjMeasured_26 0 "Initial_Value" 1 "Measured" 2 "Predicted" ;
VAL_ 1420 RSDS_L_SGU13_RollingCounter5 15 "InValid_value" ;
VAL_ 1420 RSDS_L_ObjType_26 0 "Unknown" 1 "Truck" 2 "Car" 3 "Pedestrian" 4 "Cyclist" ;
VAL_ 1420 RSDS_L_ObjDistXStd_26 0 "Valid_values" ;
VAL_ 1420 RSDS_L_SGU13_RollingCounter4 15 "InValid_value" ;
VAL_ 1420 RSDS_L_HWATargetValidity_25 0 "NOT_HWA_Target" 1 "HWA_Target" ;
VAL_ 1420 RSDS_L_ObjRefPoint_25 0 "Rear" 1 "Rear_left" 2 "Left" 3 "Front_left" 4 "Front" 5 "Front_Right" 6 "Right" 7 "Rear_right" ;
VAL_ 1420 RSDS_L_SGU13_RollingCounter3 15 "InValid_value" ;
VAL_ 1420 RSDS_L_ObjMotionDirection_25 0 "Initial_Value" 1 "Inverse_direction" 2 "Same_direction" 3 "Cross" ;
VAL_ 1420 RSDS_L_ObjDistYStd_25 0 "Valid_values" ;
VAL_ 1420 RSDS_L_SGU13_RollingCounter2 15 "InValid_value" ;
VAL_ 1420 RSDS_L_ObjMotionType_25 0 "Initial_Value" 1 "Unknown" 2 "Drive" 3 "Stopped" 4 "Stand" ;
VAL_ 1420 RSDS_L_ObjMeasured_25 0 "Initial_Value" 1 "Measured" 2 "Predicted" ;
VAL_ 1420 RSDS_L_SGU13_RollingCounter1 15 "InValid_value" ;
VAL_ 1420 RSDS_L_ObjType_25 0 "Unknown" 1 "Truck" 2 "Car" 3 "Pedestrian" 4 "Cyclist" ;
VAL_ 1420 RSDS_L_ObjDistXStd_25 0 "Valid_values" ;
VAL_ 1421 RSDS_L_SGU14_RollingCounter8 15 "InValid_value" ;
VAL_ 1421 RSDS_L_HWATargetValidity_28 0 "NOT_HWA_Target" 1 "HWA_Target" ;
VAL_ 1421 RSDS_L_ObjRefPoint_28 0 "Rear" 1 "Rear_left" 2 "Left" 3 "Front_left" 4 "Front" 5 "Front_Right" 6 "Right" 7 "Rear_right" ;
VAL_ 1421 RSDS_L_SGU14_RollingCounter7 15 "InValid_value" ;
VAL_ 1421 RSDS_L_ObjMotionDirection_28 0 "Initial_Value" 1 "Inverse_direction" 2 "Same_direction" 3 "Cross" ;
VAL_ 1421 RSDS_L_ObjDistYStd_28 0 "Valid_values" ;
VAL_ 1421 RSDS_L_SGU14_RollingCounter6 15 "InValid_value" ;
VAL_ 1421 RSDS_L_ObjMotionType_28 0 "Initial_Value" 1 "Unknown" 2 "Drive" 3 "Stopped" 4 "Stand" ;
VAL_ 1421 RSDS_L_ObjMeasured_28 0 "Initial_Value" 1 "Measured" 2 "Predicted" ;
VAL_ 1421 RSDS_L_SGU14_RollingCounter5 15 "InValid_value" ;
VAL_ 1421 RSDS_L_ObjType_28 0 "Unknown" 1 "Truck" 2 "Car" 3 "Pedestrian" 4 "Cyclist" ;
VAL_ 1421 RSDS_L_ObjDistXStd_28 0 "Valid_values" ;
VAL_ 1421 RSDS_L_SGU14_RollingCounter4 15 "InValid_value" ;
VAL_ 1421 RSDS_L_HWATargetValidity_27 0 "NOT_HWA_Target" 1 "HWA_Target" ;
VAL_ 1421 RSDS_L_ObjRefPoint_27 0 "Rear" 1 "Rear_left" 2 "Left" 3 "Front_left" 4 "Front" 5 "Front_Right" 6 "Right" 7 "Rear_right" ;
VAL_ 1421 RSDS_L_SGU14_RollingCounter3 15 "InValid_value" ;
VAL_ 1421 RSDS_L_ObjMotionDirection_27 0 "Initial_Value" 1 "Inverse_direction" 2 "Same_direction" 3 "Cross" ;
VAL_ 1421 RSDS_L_ObjDistYStd_27 0 "Valid_values" ;
VAL_ 1421 RSDS_L_SGU14_RollingCounter2 15 "InValid_value" ;
VAL_ 1421 RSDS_L_ObjMotionType_27 0 "Initial_Value" 1 "Unknown" 2 "Drive" 3 "Stopped" 4 "Stand" ;
VAL_ 1421 RSDS_L_ObjMeasured_27 0 "Initial_Value" 1 "Measured" 2 "Predicted" ;
VAL_ 1421 RSDS_L_SGU14_RollingCounter1 15 "InValid_value" ;
VAL_ 1421 RSDS_L_ObjType_27 0 "Unknown" 1 "Truck" 2 "Car" 3 "Pedestrian" 4 "Cyclist" ;
VAL_ 1421 RSDS_L_ObjDistXStd_27 0 "Valid_values" ;
VAL_ 1422 RSDS_L_SGU15_RollingCounter8 15 "InValid_value" ;
VAL_ 1422 RSDS_L_HWATargetValidity_30 0 "NOT_HWA_Target" 1 "HWA_Target" ;
VAL_ 1422 RSDS_L_ObjRefPoint_30 0 "Rear" 1 "Rear_left" 2 "Left" 3 "Front_left" 4 "Front" 5 "Front_Right" 6 "Right" 7 "Rear_right" ;
VAL_ 1422 RSDS_L_SGU15_RollingCounter7 15 "InValid_value" ;
VAL_ 1422 RSDS_L_ObjMotionDirection_30 0 "Initial_Value" 1 "Inverse_direction" 2 "Same_direction" 3 "Cross" ;
VAL_ 1422 RSDS_L_ObjDistYStd_30 0 "Valid_values" ;
VAL_ 1422 RSDS_L_SGU15_RollingCounter6 15 "InValid_value" ;
VAL_ 1422 RSDS_L_ObjMotionType_30 0 "Initial_Value" 1 "Unknown" 2 "Drive" 3 "Stopped" 4 "Stand" ;
VAL_ 1422 RSDS_L_ObjMeasured_30 0 "Initial_Value" 1 "Measured" 2 "Predicted" ;
VAL_ 1422 RSDS_L_SGU15_RollingCounter5 15 "InValid_value" ;
VAL_ 1422 RSDS_L_ObjType_30 0 "Unknown" 1 "Truck" 2 "Car" 3 "Pedestrian" 4 "Cyclist" ;
VAL_ 1422 RSDS_L_ObjDistXStd_30 0 "Valid_values" ;
VAL_ 1422 RSDS_L_SGU15_RollingCounter4 15 "InValid_value" ;
VAL_ 1422 RSDS_L_HWATargetValidity_29 0 "NOT_HWA_Target" 1 "HWA_Target" ;
VAL_ 1422 RSDS_L_ObjRefPoint_29 0 "Rear" 1 "Rear_left" 2 "Left" 3 "Front_left" 4 "Front" 5 "Front_Right" 6 "Right" 7 "Rear_right" ;
VAL_ 1422 RSDS_L_SGU15_RollingCounter3 15 "InValid_value" ;
VAL_ 1422 RSDS_L_ObjMotionDirection_29 0 "Initial_Value" 1 "Inverse_direction" 2 "Same_direction" 3 "Cross" ;
VAL_ 1422 RSDS_L_ObjDistYStd_29 0 "Valid_values" ;
VAL_ 1422 RSDS_L_SGU15_RollingCounter2 15 "InValid_value" ;
VAL_ 1422 RSDS_L_ObjMotionType_29 0 "Initial_Value" 1 "Unknown" 2 "Drive" 3 "Stopped" 4 "Stand" ;
VAL_ 1422 RSDS_L_ObjMeasured_29 0 "Initial_Value" 1 "Measured" 2 "Predicted" ;
VAL_ 1422 RSDS_L_SGU15_RollingCounter1 15 "InValid_value" ;
VAL_ 1422 RSDS_L_ObjType_29 0 "Unknown" 1 "Truck" 2 "Car" 3 "Pedestrian" 4 "Cyclist" ;
VAL_ 1422 RSDS_L_ObjDistXStd_29 0 "Valid_values" ;
VAL_ 1423 RSDS_L_SGU16_RollingCounter8 15 "InValid_value" ;
VAL_ 1423 RSDS_L_HWATargetValidity_32 0 "NOT_HWA_Target" 1 "HWA_Target" ;
VAL_ 1423 RSDS_L_ObjRefPoint_32 0 "Rear" 1 "Rear_left" 2 "Left" 3 "Front_left" 4 "Front" 5 "Front_Right" 6 "Right" 7 "Rear_right" ;
VAL_ 1423 RSDS_L_SGU16_RollingCounter7 15 "InValid_value" ;
VAL_ 1423 RSDS_L_ObjMotionDirection_32 0 "Initial_Value" 1 "Inverse_direction" 2 "Same_direction" 3 "Cross" ;
VAL_ 1423 RSDS_L_ObjDistYStd_32 0 "Valid_values" ;
VAL_ 1423 RSDS_L_SGU16_RollingCounter6 15 "InValid_value" ;
VAL_ 1423 RSDS_L_ObjMotionType_32 0 "Initial_Value" 1 "Unknown" 2 "Drive" 3 "Stopped" 4 "Stand" ;
VAL_ 1423 RSDS_L_ObjMeasured_32 0 "Initial_Value" 1 "Measured" 2 "Predicted" ;
VAL_ 1423 RSDS_L_SGU16_RollingCounter5 15 "InValid_value" ;
VAL_ 1423 RSDS_L_ObjType_32 0 "Unknown" 1 "Truck" 2 "Car" 3 "Pedestrian" 4 "Cyclist" ;
VAL_ 1423 RSDS_L_ObjDistXStd_32 0 "Valid_values" ;
VAL_ 1423 RSDS_L_SGU16_RollingCounter4 15 "InValid_value" ;
VAL_ 1423 RSDS_L_HWATargetValidity_31 0 "NOT_HWA_Target" 1 "HWA_Target" ;
VAL_ 1423 RSDS_L_ObjRefPoint_31 0 "Rear" 1 "Rear_left" 2 "Left" 3 "Front_left" 4 "Front" 5 "Front_Right" 6 "Right" 7 "Rear_right" ;
VAL_ 1423 RSDS_L_SGU16_RollingCounter3 15 "InValid_value" ;
VAL_ 1423 RSDS_L_ObjMotionDirection_31 0 "Initial_Value" 1 "Inverse_direction" 2 "Same_direction" 3 "Cross" ;
VAL_ 1423 RSDS_L_ObjDistYStd_31 0 "Valid_values" ;
VAL_ 1423 RSDS_L_SGU16_RollingCounter2 15 "InValid_value" ;
VAL_ 1423 RSDS_L_ObjMotionType_31 0 "Initial_Value" 1 "Unknown" 2 "Drive" 3 "Stopped" 4 "Stand" ;
VAL_ 1423 RSDS_L_ObjMeasured_31 0 "Initial_Value" 1 "Measured" 2 "Predicted" ;
VAL_ 1423 RSDS_L_SGU16_RollingCounter1 15 "InValid_value" ;
VAL_ 1423 RSDS_L_ObjType_31 0 "Unknown" 1 "Truck" 2 "Car" 3 "Pedestrian" 4 "Cyclist" ;
VAL_ 1423 RSDS_L_ObjDistXStd_31 0 "Valid_values" ;
VAL_ 1486 RSDS_L_SGU_HEAD_RollingCounter4 0 "Valid_value" 15 "Invalid_value" ;
VAL_ 1486 RSDS_L_SGU_HEAD_BlockCounter 0 "Valid_values" ;
VAL_ 1486 RSDS_L_ObjAziAngleCalib 0 "Valid_values" ;
VAL_ 1486 RSDS_L_Guardrail_dxStart 0 "Valid_values" 32001 "Reserved" ;
VAL_ 1486 RSDS_L_GuardrailC3 0 "Valid_values" 800001 "Reserved" ;
VAL_ 1486 RSDS_L_SGU_HEAD_Checksum4 0 "Valid_value" ;
VAL_ 1486 RSDS_L_SGU_HEAD_RollingCounter3 0 "Valid_value" 15 "Invalid_value" ;
VAL_ 1486 RSDS_L_GuardrailC2 0 "Valid_values" 50000 "Reserved" ;
VAL_ 1486 RSDS_L_GuardrailC1 0 "Valid_values" 4446 "Reserved" ;
VAL_ 1486 RSDS_L_GuardrailC0 0 "Valid_values" 6001 "Reserved" ;
VAL_ 1486 RSDS_L_SGU_HEAD_Checksum3 0 "Valid_value" ;
VAL_ 1486 RSDS_L_SGU_HEAD_RollingCounter2 0 "Valid_value" 15 "Invalid_value" ;
VAL_ 1486 RSDS_L_hdr_AutosarTimeStamp 0 "Valid_values" ;
VAL_ 1486 RSDS_L_SGU_HEAD_Checksum2 0 "Valid_value" ;
VAL_ 1486 RSDS_L_SGU_HEAD_RollingCounter1 0 "Valid_value" 15 "Invalid_value" ;
VAL_ 1486 RSDS_L_hdr_ErrorStatus 0 "No_error" 1 "Not_Defined" 2 "misalignment_elevation" 3 "misalignment_azimuth" 4 "temporary_failure" 5 "permanent_failure" 6 "Voltage_error" 7 "Production_mode" 8 "EOL_error" 9 "Calibration_parameter_error" 10 "Reserved" ;
VAL_ 1486 RSDS_L_Guardrail_dxEnd 0 "Valid_values" 32001 "Reserved" ;
VAL_ 1486 RSDS_L_GuardrailConfidence 0 "Valid_values" 101 "Reserved" ;
VAL_ 1486 RSDS_L_ObjDetected 0 "Valid_values" ;
VAL_ 1486 RSDS_L_BLIND 0 "No_Blindness" 1 "Blindness" 2 "Reserved" 3 "Reserved" ;
VAL_ 1486 RSDS_L_hdr_TimeStampStatus 0 "Valid_value" ;
VAL_ 1486 RSDS_L_hdr_TimeStamp 0 "Valid_value" ;
VAL_ 1486 RSDS_L_SGU_HEAD_Checksum1 0 "Valid_value" ;
VAL_ 1424 RSDS_R_SGU1_RollingCounter8 0 "Valid_value" 15 "Invalid_value" ;
VAL_ 1424 RSDS_R_SGU1_BlockCounter 0 "Valid_value" ;
VAL_ 1424 RSDS_R_HWATargetValidity_2 0 "NOT_HWA_Target" 1 "HWA_Target" ;
VAL_ 1424 RSDS_R_ObjRefPoint_2 0 "Rear" 1 "Rear_left" 2 "Left" 3 "Front_left" 4 "Front" 5 "Front_Right" 6 "Right" 7 "Rear_right" ;
VAL_ 1424 RSDS_R_ObjRCS_2 0 "Valid_values" ;
VAL_ 1424 RSDS_R_ObjYawrate_2 0 "Valid_values" 4446 "Reserved" ;
VAL_ 1424 RSDS_R_ObjHeading_2 0 "Valid_values" 4446 "Reserved" ;
VAL_ 1424 RSDS_R_ObjLength_2 0 "Valid_values" 401 "Reserved" ;
VAL_ 1424 RSDS_R_SGU1_Checksum8 0 "Valid_value" ;
VAL_ 1424 RSDS_R_SGU1_RollingCounter7 0 "Valid_value" 15 "Invalid_value" ;
VAL_ 1424 RSDS_R_ObjMotionDirection_2 0 "Init" 1 "Inverse_direction" 2 "Same_direction" 3 "cross" 4 "reserved" 5 "reserved" 6 "reserved" 7 "reserved" ;
VAL_ 1424 RSDS_R_ObjAge_2 0 "Valid_values" ;
VAL_ 1424 RSDS_R_ObjWidth_2 0 "Valid_values" 501 "Reserved" ;
VAL_ 1424 RSDS_R_ObjRAccelYStd_2 0 "Valid_values" ;
VAL_ 1424 RSDS_R_ObjRAccelXStd_2 0 "Valid_values" ;
VAL_ 1424 RSDS_R_ObjRelVelYStd_2 0 "Valid_values" ;
VAL_ 1424 RSDS_R_ObjRelVelXStd_2 0 "Valid_values" ;
VAL_ 1424 RSDS_R_ObjDistYStd_2 0 "Valid_values" ;
VAL_ 1424 RSDS_R_SGU1_Checksum7 0 "Valid_value" ;
VAL_ 1424 RSDS_R_SGU1_RollingCounter6 0 "Valid_value" 15 "Invalid_value" ;
VAL_ 1424 RSDS_R_ObjMotionType_2 0 "int" 1 "unknown" 2 "Drive" 3 "Stopped" 4 "Stand" 5 "reserved" 6 "reserved" 7 "reserved" ;
VAL_ 1424 RSDS_R_ObjMeasured_2 0 "Init" 1 "Measured" 2 "Predicted" 3 "Reserved" ;
VAL_ 1424 RSDS_R_ObjRelAccelY_2 0 "Valid_values" ;
VAL_ 1424 RSDS_R_ObjRelAccelX_2 0 "Valid_values" ;
VAL_ 1424 RSDS_R_ObjRelVelY_2 0 "Valid_values" 8174 "Reserved" ;
VAL_ 1424 RSDS_R_ObjRelVelX_2 0 "Valid_values" 8174 "Reserved" ;
VAL_ 1424 RSDS_R_SGU1_Checksum6 0 "Valid_value" ;
VAL_ 1424 RSDS_R_SGU1_RollingCounter5 0 "Valid_value" 15 "Invalid_value" ;
VAL_ 1424 RSDS_R_ObjType_2 0 "Unknown" 1 "Truck" 2 "Car" 3 "Pedestrian" 4 "Cyclist" 5 "Reserved" ;
VAL_ 1424 RSDS_R_ObjDistXStd_2 0 "Valid_values" ;
VAL_ 1424 RSDS_R_ObjDistY_2 0 "Valid_values" ;
VAL_ 1424 RSDS_R_ObjDistX_2 0 "Valid_values" 4080 "Reserved" ;
VAL_ 1424 RSDS_R_ObjObstacleProb_2 0 "Valid_values" ;
VAL_ 1424 RSDS_R_ObjExistProb_2 0 "Valid_values" ;
VAL_ 1424 RSDS_R_ObjID_2 0 "Valid_values" ;
VAL_ 1424 RSDS_R_SGU1_Checksum5 0 "Valid_value" ;
VAL_ 1424 RSDS_R_SGU1_RollingCounter4 0 "Valid_value" 15 "Invalid_value" ;
VAL_ 1424 RSDS_R_HWATargetValidity_1 0 "NOT_HWA_Target" 1 "HWA_Target" ;
VAL_ 1424 RSDS_R_ObjRefPoint_1 0 "Rear" 1 "Rear_left" 2 "Left" 3 "Front_left" 4 "Front" 5 "Front_Right" 6 "Right" 7 "Rear_right" ;
VAL_ 1424 RSDS_R_ObjRCS_1 0 "Valid_values" ;
VAL_ 1424 RSDS_R_ObjYawrate_1 0 "Valid_values" 4446 "Reserved" ;
VAL_ 1424 RSDS_R_ObjHeading_1 0 "Valid_values" 4446 "Reserved" ;
VAL_ 1424 RSDS_R_ObjLength_1 0 "Valid_values" 401 "Reserved" ;
VAL_ 1424 RSDS_R_SGU1_Checksum4 0 "Valid_value" ;
VAL_ 1424 RSDS_R_SGU1_RollingCounter3 0 "Valid_value" 15 "Invalid_value" ;
VAL_ 1424 RSDS_R_ObjMotionDirection_1 0 "Init" 1 "Inverse_direction" 2 "Same_direction" 3 "cross" 4 "reserved" 5 "reserved" 6 "reserved" 7 "reserved" ;
VAL_ 1424 RSDS_R_ObjAge_1 0 "Valid_values" ;
VAL_ 1424 RSDS_R_ObjWidth_1 0 "Valid_values" 501 "Reserved" ;
VAL_ 1424 RSDS_R_ObjRAccelYStd_1 0 "Valid_values" ;
VAL_ 1424 RSDS_R_ObjRAccelXStd_1 0 "Valid_values" ;
VAL_ 1424 RSDS_R_ObjRelVelYStd_1 0 "Valid_values" ;
VAL_ 1424 RSDS_R_ObjRelVelXStd_1 0 "Valid_values" ;
VAL_ 1424 RSDS_R_ObjDistYStd_1 0 "Valid_values" ;
VAL_ 1424 RSDS_R_SGU1_Checksum3 0 "Valid_value" ;
VAL_ 1424 RSDS_R_SGU1_RollingCounter2 0 "Valid_value" 15 "Invalid_value" ;
VAL_ 1424 RSDS_R_ObjMotionType_1 0 "int" 1 "unknown" 2 "Drive" 3 "Stopped" 4 "Stand" 5 "reserved" 6 "reserved" 7 "reserved" ;
VAL_ 1424 RSDS_R_ObjMeasured_1 0 "Init" 1 "Measured" 2 "Predicted" 3 "Reserved" ;
VAL_ 1424 RSDS_R_ObjRelAccelY_1 0 "Valid_values" ;
VAL_ 1424 RSDS_R_ObjRelAccelX_1 0 "Valid_values" ;
VAL_ 1424 RSDS_R_ObjRelVelY_1 0 "Valid_values" 8174 "Reserved" ;
VAL_ 1424 RSDS_R_ObjRelVelX_1 0 "Valid_values" 8174 "Reserved" ;
VAL_ 1424 RSDS_R_SGU1_Checksum2 0 "Valid_value" ;
VAL_ 1424 RSDS_R_SGU1_RollingCounter1 0 "Valid_value" 15 "Invalid_value" ;
VAL_ 1424 RSDS_R_ObjType_1 0 "Unknown" 1 "Truck" 2 "Car" 3 "Pedestrian" 4 "Cyclist" 5 "Reserved" ;
VAL_ 1424 RSDS_R_ObjDistXStd_1 0 "Valid_values" ;
VAL_ 1424 RSDS_R_ObjDistY_1 0 "Valid_values" ;
VAL_ 1424 RSDS_R_ObjDistX_1 0 "Valid_values" 4080 "Reserved" ;
VAL_ 1424 RSDS_R_ObjObstacleProb_1 0 "Valid_values" ;
VAL_ 1424 RSDS_R_ObjExistProb_1 0 "Valid_values" ;
VAL_ 1424 RSDS_R_ObjID_1 0 "Valid_values" ;
VAL_ 1424 RSDS_R_SGU1_Checksum1 0 "Valid_value" ;
VAL_ 1425 RSDS_R_SGU2_RollingCounter8 0 "Valid_value" 15 "Invalid_value" ;
VAL_ 1425 RSDS_R_SGU2_BlockCounter 0 "Valid_value" ;
VAL_ 1425 RSDS_R_HWATargetValidity_4 0 "NOT_HWA_Target" 1 "HWA_Target" ;
VAL_ 1425 RSDS_R_ObjRefPoint_4 0 "Rear" 1 "Rear_left" 2 "Left" 3 "Front_left" 4 "Front" 5 "Front_Right" 6 "Right" 7 "Rear_right" ;
VAL_ 1425 RSDS_R_ObjRCS_4 0 "Valid_values" ;
VAL_ 1425 RSDS_R_ObjYawrate_4 0 "Valid_values" 4446 "Reserved" ;
VAL_ 1425 RSDS_R_ObjHeading_4 0 "Valid_values" 4446 "Reserved" ;
VAL_ 1425 RSDS_R_ObjLength_4 0 "Valid_values" 401 "Reserved" ;
VAL_ 1425 RSDS_R_SGU2_Checksum8 0 "Valid_value" ;
VAL_ 1425 RSDS_R_SGU2_RollingCounter7 0 "Valid_value" 15 "Invalid_value" ;
VAL_ 1425 RSDS_R_ObjMotionDirection_4 0 "Init" 1 "Inverse_direction" 2 "Same__direction" 3 "cross" 4 "reserved" 5 "reserved" 6 "reserved" 7 "reserved" ;
VAL_ 1425 RSDS_R_ObjAge_4 0 "Valid_values" ;
VAL_ 1425 RSDS_R_ObjWidth_4 0 "Valid_values" 501 "Reserved" ;
VAL_ 1425 RSDS_R_ObjRAccelYStd_4 0 "Valid_values" ;
VAL_ 1425 RSDS_R_ObjRAccelXStd_4 0 "Valid_values" ;
VAL_ 1425 RSDS_R_ObjRelVelYStd_4 0 "Valid_values" ;
VAL_ 1425 RSDS_R_ObjRelVelXStd_4 0 "Valid_values" ;
VAL_ 1425 RSDS_R_ObjDistYStd_4 0 "Valid_values" ;
VAL_ 1425 RSDS_R_SGU2_Checksum7 0 "Valid_value" ;
VAL_ 1425 RSDS_R_SGU2_RollingCounter6 0 "Valid_value" 15 "Invalid_value" ;
VAL_ 1425 RSDS_R_ObjMotionType_4 0 "int" 1 "unknown" 2 "Drive" 3 "Stopped" 4 "Stand" 5 "reserved" 6 "reserved" 7 "reserved" ;
VAL_ 1425 RSDS_R_ObjMeasured_4 0 "Init" 1 "Measured" 2 "Predicted" 3 "Reserved" ;
VAL_ 1425 RSDS_R_ObjRelAccelY_4 0 "Valid_values" ;
VAL_ 1425 RSDS_R_ObjRelAccelX_4 0 "Valid_values" ;
VAL_ 1425 RSDS_R_ObjRelVelY_4 0 "Valid_values" 8174 "Reserved" ;
VAL_ 1425 RSDS_R_ObjRelVelX_4 0 "Valid_values" 8174 "Reserved" ;
VAL_ 1425 RSDS_R_SGU2_Checksum6 0 "Valid_value" ;
VAL_ 1425 RSDS_R_SGU2_RollingCounter5 0 "Valid_value" 15 "Invalid_value" ;
VAL_ 1425 RSDS_R_ObjType_4 0 "Unknown" 1 "Truck" 2 "Car" 3 "Pedestrian" 4 "Cyclist" 5 "Reserved" ;
VAL_ 1425 RSDS_R_ObjDistXStd_4 0 "Valid_values" ;
VAL_ 1425 RSDS_R_ObjDistY_4 0 "Valid_values" ;
VAL_ 1425 RSDS_R_ObjDistX_4 0 "Valid_values" 4080 "Reserved" ;
VAL_ 1425 RSDS_R_ObjObstacleProb_4 0 "Valid_values" ;
VAL_ 1425 RSDS_R_ObjExistProb_4 0 "Valid_values" ;
VAL_ 1425 RSDS_R_ObjID_4 0 "Valid_values" ;
VAL_ 1425 RSDS_R_SGU2_Checksum5 0 "Valid_value" ;
VAL_ 1425 RSDS_R_SGU2_RollingCounter4 0 "Valid_value" 15 "Invalid_value" ;
VAL_ 1425 RSDS_R_HWATargetValidity_3 0 "NOT_HWA_Target" 1 "HWA_Target" ;
VAL_ 1425 RSDS_R_ObjRefPoint_3 0 "Rear" 1 "Rear_left" 2 "Left" 3 "Front_left" 4 "Front" 5 "Front_Right" 6 "Right" 7 "Rear_right" ;
VAL_ 1425 RSDS_R_ObjRCS_3 0 "Valid_values" ;
VAL_ 1425 RSDS_R_ObjYawrate_3 0 "Valid_values" 4446 "Reserved" ;
VAL_ 1425 RSDS_R_ObjHeading_3 0 "Valid_values" 4446 "Reserved" ;
VAL_ 1425 RSDS_R_ObjLength_3 0 "Valid_values" 401 "Reserved" ;
VAL_ 1425 RSDS_R_SGU2_Checksum4 0 "Valid_value" ;
VAL_ 1425 RSDS_R_SGU2_RollingCounter3 0 "Valid_value" 15 "Invalid_value" ;
VAL_ 1425 RSDS_R_ObjMotionDirection_3 0 "Init" 1 "Inverse_direction" 2 "Same__direction" 3 "cross" 4 "reserved" 5 "reserved" 6 "reserved" 7 "reserved" ;
VAL_ 1425 RSDS_R_ObjAge_3 0 "Valid_values" ;
VAL_ 1425 RSDS_R_ObjWidth_3 0 "Valid_values" 501 "Reserved" ;
VAL_ 1425 RSDS_R_ObjRAccelYStd_3 0 "Valid_values" ;
VAL_ 1425 RSDS_R_ObjRAccelXStd_3 0 "Valid_values" ;
VAL_ 1425 RSDS_R_ObjRelVelYStd_3 0 "Valid_values" ;
VAL_ 1425 RSDS_R_ObjRelVelXStd_3 0 "Valid_values" ;
VAL_ 1425 RSDS_R_ObjDistYStd_3 0 "Valid_values" ;
VAL_ 1425 RSDS_R_SGU2_Checksum3 0 "Valid_value" ;
VAL_ 1425 RSDS_R_SGU2_RollingCounter2 0 "Valid_value" 15 "Invalid_value" ;
VAL_ 1425 RSDS_R_ObjMotionType_3 0 "int" 1 "unknown" 2 "Drive" 3 "Stopped" 4 "Stand" 5 "reserved" 6 "reserved" 7 "reserved" ;
VAL_ 1425 RSDS_R_ObjMeasured_3 0 "Init" 1 "Measured" 2 "Predicted" 3 "Reserved" ;
VAL_ 1425 RSDS_R_ObjRelAccelY_3 0 "Valid_values" ;
VAL_ 1425 RSDS_R_ObjRelAccelX_3 0 "Valid_values" ;
VAL_ 1425 RSDS_R_ObjRelVelY_3 0 "Valid_values" 8174 "Reserved" ;
VAL_ 1425 RSDS_R_ObjRelVelX_3 0 "Valid_values" 8174 "Reserved" ;
VAL_ 1425 RSDS_R_SGU2_Checksum2 0 "Valid_value" ;
VAL_ 1425 RSDS_R_SGU2_RollingCounter1 0 "Valid_value" 15 "Invalid_value" ;
VAL_ 1425 RSDS_R_ObjType_3 0 "Unknown" 1 "Truck" 2 "Car" 3 "Pedestrian" 4 "Cyclist" 5 "Reserved" ;
VAL_ 1425 RSDS_R_ObjDistXStd_3 0 "Valid_values" ;
VAL_ 1425 RSDS_R_ObjDistY_3 0 "Valid_values" ;
VAL_ 1425 RSDS_R_ObjDistX_3 0 "Valid_values" 4080 "Reserved" ;
VAL_ 1425 RSDS_R_ObjObstacleProb_3 0 "Valid_values" ;
VAL_ 1425 RSDS_R_ObjExistProb_3 0 "Valid_values" ;
VAL_ 1425 RSDS_R_ObjID_3 0 "Valid_values" ;
VAL_ 1425 RSDS_R_SGU2_Checksum1 0 "Valid_value" ;
VAL_ 1426 RSDS_R_SGU3_RollingCounter8 0 "Valid_value" 15 "Invalid_value" ;
VAL_ 1426 RSDS_R_SGU3_BlockCounter 0 "Valid_value" ;
VAL_ 1426 RSDS_R_HWATargetValidity_6 0 "NOT_HWA_Target" 1 "HWA_Target" ;
VAL_ 1426 RSDS_R_ObjRefPoint_6 0 "Rear" 1 "Rear_left" 2 "Left" 3 "Front_left" 4 "Front" 5 "Front_Right" 6 "Right" 7 "Rear_right" ;
VAL_ 1426 RSDS_R_ObjRCS_6 0 "Valid_values" ;
VAL_ 1426 RSDS_R_ObjYawrate_6 0 "Valid_values" 4446 "Reserved" ;
VAL_ 1426 RSDS_R_ObjHeading_6 0 "Valid_values" 4446 "Reserved" ;
VAL_ 1426 RSDS_R_ObjLength_6 0 "Valid_values" 401 "Reserved" ;
VAL_ 1426 RSDS_R_SGU3_Checksum8 0 "Valid_value" ;
VAL_ 1426 RSDS_R_SGU3_RollingCounter7 0 "Valid_value" 15 "Invalid_value" ;
VAL_ 1426 RSDS_R_ObjMotionDirection_6 0 "Init" 1 "Inverse_direction" 2 "Same__direction" 3 "cross" 4 "reserved" 5 "reserved" 6 "reserved" 7 "reserved" ;
VAL_ 1426 RSDS_R_ObjAge_6 0 "Valid_values" ;
VAL_ 1426 RSDS_R_ObjWidth_6 0 "Valid_values" 501 "Reserved" ;
VAL_ 1426 RSDS_R_ObjRAccelYStd_6 0 "Valid_values" ;
VAL_ 1426 RSDS_R_ObjRAccelXStd_6 0 "Valid_values" ;
VAL_ 1426 RSDS_R_ObjRelVelYStd_6 0 "Valid_values" ;
VAL_ 1426 RSDS_R_ObjRelVelXStd_6 0 "Valid_values" ;
VAL_ 1426 RSDS_R_ObjDistYStd_6 0 "Valid_values" ;
VAL_ 1426 RSDS_R_SGU3_Checksum7 0 "Valid_value" ;
VAL_ 1426 RSDS_R_SGU3_RollingCounter6 0 "Valid_value" 15 "Invalid_value" ;
VAL_ 1426 RSDS_R_ObjMotionType_6 0 "int" 1 "unknown" 2 "Drive" 3 "Stopped" 4 "Stand" 5 "reserved" 6 "reserved" 7 "reserved" ;
VAL_ 1426 RSDS_R_ObjMeasured_6 0 "Init" 1 "Measured" 2 "Predicted" 3 "Reserved" ;
VAL_ 1426 RSDS_R_ObjRelAccelY_6 0 "Valid_values" ;
VAL_ 1426 RSDS_R_ObjRelAccelX_6 0 "Valid_values" ;
VAL_ 1426 RSDS_R_ObjRelVelY_6 0 "Valid_values" 8174 "Reserved" ;
VAL_ 1426 RSDS_R_ObjRelVelX_6 0 "Valid_values" 8174 "Reserved" ;
VAL_ 1426 RSDS_R_SGU3_Checksum6 0 "Valid_value" ;
VAL_ 1426 RSDS_R_SGU3_RollingCounter5 0 "Valid_value" 15 "Invalid_value" ;
VAL_ 1426 RSDS_R_ObjType_6 0 "Unknown" 1 "Truck" 2 "Car" 3 "Pedestrian" 4 "Cyclist" 5 "Reserved" ;
VAL_ 1426 RSDS_R_ObjDistXStd_6 0 "Valid_values" ;
VAL_ 1426 RSDS_R_ObjDistY_6 0 "Valid_values" ;
VAL_ 1426 RSDS_R_ObjDistX_6 0 "Valid_values" 4080 "Reserved" ;
VAL_ 1426 RSDS_R_ObjObstacleProb_6 0 "Valid_values" ;
VAL_ 1426 RSDS_R_ObjExistProb_6 0 "Valid_values" ;
VAL_ 1426 RSDS_R_ObjID_6 0 "Valid_values" ;
VAL_ 1426 RSDS_R_SGU3_Checksum5 0 "Valid_value" ;
VAL_ 1426 RSDS_R_SGU3_RollingCounter4 0 "Valid_value" 15 "Invalid_value" ;
VAL_ 1426 RSDS_R_HWATargetValidity_5 0 "NOT_HWA_Target" 1 "HWA_Target" ;
VAL_ 1426 RSDS_R_ObjRefPoint_5 0 "Rear" 1 "Rear_left" 2 "Left" 3 "Front_left" 4 "Front" 5 "Front_Right" 6 "Right" 7 "Rear_right" ;
VAL_ 1426 RSDS_R_ObjRCS_5 0 "Valid_values" ;
VAL_ 1426 RSDS_R_ObjYawrate_5 0 "Valid_values" 4446 "Reserved" ;
VAL_ 1426 RSDS_R_ObjHeading_5 0 "Valid_values" 4446 "Reserved" ;
VAL_ 1426 RSDS_R_ObjLength_5 0 "Valid_values" 401 "Reserved" ;
VAL_ 1426 RSDS_R_SGU3_Checksum4 0 "Valid_value" ;
VAL_ 1426 RSDS_R_SGU3_RollingCounter3 0 "Valid_value" 15 "Invalid_value" ;
VAL_ 1426 RSDS_R_ObjMotionDirection_5 0 "Init" 1 "Inverse_direction" 2 "Same__direction" 3 "cross" 4 "reserved" 5 "reserved" 6 "reserved" 7 "reserved" ;
VAL_ 1426 RSDS_R_ObjAge_5 0 "Valid_values" ;
VAL_ 1426 RSDS_R_ObjWidth_5 0 "Valid_values" 501 "Reserved" ;
VAL_ 1426 RSDS_R_ObjRAccelYStd_5 0 "Valid_values" ;
VAL_ 1426 RSDS_R_ObjRAccelXStd_5 0 "Valid_values" ;
VAL_ 1426 RSDS_R_ObjRelVelYStd_5 0 "Valid_values" ;
VAL_ 1426 RSDS_R_ObjRelVelXStd_5 0 "Valid_values" ;
VAL_ 1426 RSDS_R_ObjDistYStd_5 0 "Valid_values" ;
VAL_ 1426 RSDS_R_SGU3_Checksum3 0 "Valid_value" ;
VAL_ 1426 RSDS_R_SGU3_RollingCounter2 0 "Valid_value" 15 "Invalid_value" ;
VAL_ 1426 RSDS_R_ObjMotionType_5 0 "int" 1 "unknown" 2 "Drive" 3 "Stopped" 4 "Stand" 5 "reserved" 6 "reserved" 7 "reserved" ;
VAL_ 1426 RSDS_R_ObjMeasured_5 0 "Init" 1 "Measured" 2 "Predicted" 3 "Reserved" ;
VAL_ 1426 RSDS_R_ObjRelAccelY_5 0 "Valid_values" ;
VAL_ 1426 RSDS_R_ObjRelAccelX_5 0 "Valid_values" ;
VAL_ 1426 RSDS_R_ObjRelVelY_5 0 "Valid_values" 8174 "Reserved" ;
VAL_ 1426 RSDS_R_ObjRelVelX_5 0 "Valid_values" 8174 "Reserved" ;
VAL_ 1426 RSDS_R_SGU3_Checksum2 0 "Valid_value" ;
VAL_ 1426 RSDS_R_SGU3_RollingCounter1 0 "Valid_value" 15 "Invalid_value" ;
VAL_ 1426 RSDS_R_ObjType_5 0 "Unknown" 1 "Truck" 2 "Car" 3 "Pedestrian" 4 "Cyclist" 5 "Reserved" ;
VAL_ 1426 RSDS_R_ObjDistXStd_5 0 "Valid_values" ;
VAL_ 1426 RSDS_R_ObjDistY_5 0 "Valid_values" ;
VAL_ 1426 RSDS_R_ObjDistX_5 0 "Valid_values" 4080 "Reserved" ;
VAL_ 1426 RSDS_R_ObjObstacleProb_5 0 "Valid_values" ;
VAL_ 1426 RSDS_R_ObjExistProb_5 0 "Valid_values" ;
VAL_ 1426 RSDS_R_ObjID_5 0 "Valid_values" ;
VAL_ 1426 RSDS_R_SGU3_Checksum1 0 "Valid_value" ;
VAL_ 1427 RSDS_R_SGU4_RollingCounter8 0 "Valid_value" 15 "Invalid_value" ;
VAL_ 1427 RSDS_R_SGU4_BlockCounter 0 "Valid_value" ;
VAL_ 1427 RSDS_R_HWATargetValidity_8 0 "NOT_HWA_Target" 1 "HWA_Target" ;
VAL_ 1427 RSDS_R_ObjRefPoint_8 0 "Rear" 1 "Rear_left" 2 "Left" 3 "Front_left" 4 "Front" 5 "Front_Right" 6 "Right" 7 "Rear_right" ;
VAL_ 1427 RSDS_R_ObjRCS_8 0 "Valid_values" ;
VAL_ 1427 RSDS_R_ObjYawrate_8 0 "Valid_values" 4446 "Reserved" ;
VAL_ 1427 RSDS_R_ObjHeading_8 0 "Valid_values" 4446 "Reserved" ;
VAL_ 1427 RSDS_R_ObjLength_8 0 "Valid_values" 401 "Reserved" ;
VAL_ 1427 RSDS_R_SGU4_Checksum8 0 "Valid_value" ;
VAL_ 1427 RSDS_R_SGU4_RollingCounter7 0 "Valid_value" 15 "Invalid_value" ;
VAL_ 1427 RSDS_R_ObjMotionDirection_8 0 "Init" 1 "Inverse_direction" 2 "Same__direction" 3 "cross" 4 "reserved" 5 "reserved" 6 "reserved" 7 "reserved" ;
VAL_ 1427 RSDS_R_ObjAge_8 0 "Valid_values" ;
VAL_ 1427 RSDS_R_ObjWidth_8 0 "Valid_values" 501 "Reserved" ;
VAL_ 1427 RSDS_R_ObjRAccelYStd_8 0 "Valid_values" ;
VAL_ 1427 RSDS_R_ObjRAccelXStd_8 0 "Valid_values" ;
VAL_ 1427 RSDS_R_ObjRelVelYStd_8 0 "Valid_values" ;
VAL_ 1427 RSDS_R_ObjRelVelXStd_8 0 "Valid_values" ;
VAL_ 1427 RSDS_R_ObjDistYStd_8 0 "Valid_values" ;
VAL_ 1427 RSDS_R_SGU4_Checksum7 0 "Valid_value" ;
VAL_ 1427 RSDS_R_SGU4_RollingCounter6 0 "Valid_value" 15 "Invalid_value" ;
VAL_ 1427 RSDS_R_ObjMotionType_8 0 "int" 1 "unknown" 2 "Drive" 3 "Stopped" 4 "Stand" 5 "reserved" 6 "reserved" 7 "reserved" ;
VAL_ 1427 RSDS_R_ObjMeasured_8 0 "Init" 1 "Measured" 2 "Predicted" 3 "Reserved" ;
VAL_ 1427 RSDS_R_ObjRelAccelY_8 0 "Valid_values" ;
VAL_ 1427 RSDS_R_ObjRelAccelX_8 0 "Valid_values" ;
VAL_ 1427 RSDS_R_ObjRelVelY_8 0 "Valid_values" 8174 "Reserved" ;
VAL_ 1427 RSDS_R_ObjRelVelX_8 0 "Valid_values" 8174 "Reserved" ;
VAL_ 1427 RSDS_R_SGU4_Checksum6 0 "Valid_value" ;
VAL_ 1427 RSDS_R_SGU4_RollingCounter5 0 "Valid_value" 15 "Invalid_value" ;
VAL_ 1427 RSDS_R_ObjType_8 0 "Unknown" 1 "Truck" 2 "Car" 3 "Pedestrian" 4 "Cyclist" 5 "Reserved" ;
VAL_ 1427 RSDS_R_ObjDistXStd_8 0 "Valid_values" ;
VAL_ 1427 RSDS_R_ObjDistY_8 0 "Valid_values" ;
VAL_ 1427 RSDS_R_ObjDistX_8 0 "Valid_values" 4080 "Reserved" ;
VAL_ 1427 RSDS_R_ObjObstacleProb_8 0 "Valid_values" ;
VAL_ 1427 RSDS_R_ObjExistProb_8 0 "Valid_values" ;
VAL_ 1427 RSDS_R_ObjID_8 0 "Valid_values" ;
VAL_ 1427 RSDS_R_SGU4_Checksum5 0 "Valid_value" ;
VAL_ 1427 RSDS_R_SGU4_RollingCounter4 0 "Valid_value" 15 "Invalid_value" ;
VAL_ 1427 RSDS_R_HWATargetValidity_7 0 "NOT_HWA_Target" 1 "HWA_Target" ;
VAL_ 1427 RSDS_R_ObjRefPoint_7 0 "Rear" 1 "Rear_left" 2 "Left" 3 "Front_left" 4 "Front" 5 "Front_Right" 6 "Right" 7 "Rear_right" ;
VAL_ 1427 RSDS_R_ObjRCS_7 0 "Valid_values" ;
VAL_ 1427 RSDS_R_ObjYawrate_7 0 "Valid_values" 4446 "Reserved" ;
VAL_ 1427 RSDS_R_ObjHeading_7 0 "Valid_values" 4446 "Reserved" ;
VAL_ 1427 RSDS_R_ObjLength_7 0 "Valid_values" 401 "Reserved" ;
VAL_ 1427 RSDS_R_SGU4_Checksum4 0 "Valid_value" ;
VAL_ 1427 RSDS_R_SGU4_RollingCounter3 0 "Valid_value" 15 "Invalid_value" ;
VAL_ 1427 RSDS_R_ObjMotionDirection_7 0 "Init" 1 "Inverse_direction" 2 "Same__direction" 3 "cross" 4 "reserved" 5 "reserved" 6 "reserved" 7 "reserved" ;
VAL_ 1427 RSDS_R_ObjAge_7 0 "Valid_values" ;
VAL_ 1427 RSDS_R_ObjWidth_7 0 "Valid_values" 501 "Reserved" ;
VAL_ 1427 RSDS_R_ObjRAccelYStd_7 0 "Valid_values" ;
VAL_ 1427 RSDS_R_ObjRAccelXStd_7 0 "Valid_values" ;
VAL_ 1427 RSDS_R_ObjRelVelYStd_7 0 "Valid_values" ;
VAL_ 1427 RSDS_R_ObjRelVelXStd_7 0 "Valid_values" ;
VAL_ 1427 RSDS_R_ObjDistYStd_7 0 "Valid_values" ;
VAL_ 1427 RSDS_R_SGU4_Checksum3 0 "Valid_value" ;
VAL_ 1427 RSDS_R_SGU4_RollingCounter2 0 "Valid_value" 15 "Invalid_value" ;
VAL_ 1427 RSDS_R_ObjMotionType_7 0 "int" 1 "unknown" 2 "Drive" 3 "Stopped" 4 "Stand" 5 "reserved" 6 "reserved" 7 "reserved" ;
VAL_ 1427 RSDS_R_ObjMeasured_7 0 "Init" 1 "Measured" 2 "Predicted" 3 "Reserved" ;
VAL_ 1427 RSDS_R_ObjRelAccelY_7 0 "Valid_values" ;
VAL_ 1427 RSDS_R_ObjRelAccelX_7 0 "Valid_values" ;
VAL_ 1427 RSDS_R_ObjRelVelY_7 0 "Valid_values" 8174 "Reserved" ;
VAL_ 1427 RSDS_R_ObjRelVelX_7 0 "Valid_values" 8174 "Reserved" ;
VAL_ 1427 RSDS_R_SGU4_Checksum2 0 "Valid_value" ;
VAL_ 1427 RSDS_R_SGU4_RollingCounter1 0 "Valid_value" 15 "Invalid_value" ;
VAL_ 1427 RSDS_R_ObjType_7 0 "Unknown" 1 "Truck" 2 "Car" 3 "Pedestrian" 4 "Cyclist" 5 "Reserved" ;
VAL_ 1427 RSDS_R_ObjDistXStd_7 0 "Valid_values" ;
VAL_ 1427 RSDS_R_ObjDistY_7 0 "Valid_values" ;
VAL_ 1427 RSDS_R_ObjDistX_7 0 "Valid_values" 4080 "Reserved" ;
VAL_ 1427 RSDS_R_ObjObstacleProb_7 0 "Valid_values" ;
VAL_ 1427 RSDS_R_ObjExistProb_7 0 "Valid_values" ;
VAL_ 1427 RSDS_R_ObjID_7 0 "Valid_values" ;
VAL_ 1427 RSDS_R_SGU4_Checksum1 0 "Valid_value" ;
VAL_ 1428 RSDS_R_SGU5_RollingCounter8 0 "Valid_value" 15 "Invalid_value" ;
VAL_ 1428 RSDS_R_SGU5_BlockCounter 0 "Valid_value" ;
VAL_ 1428 RSDS_R_HWATargetValidity_10 0 "NOT_HWA_Target" 1 "HWA_Target" ;
VAL_ 1428 RSDS_R_ObjRefPoint_10 0 "Rear" 1 "Rear_left" 2 "Left" 3 "Front_left" 4 "Front" 5 "Front_Right" 6 "Right" 7 "Rear_right" ;
VAL_ 1428 RSDS_R_ObjRCS_10 0 "Valid_values" ;
VAL_ 1428 RSDS_R_ObjYawrate_10 0 "Valid_values" 4446 "Reserved" ;
VAL_ 1428 RSDS_R_ObjHeading_10 0 "Valid_values" 4446 "Reserved" ;
VAL_ 1428 RSDS_R_ObjLength_10 0 "Valid_values" 401 "Reserved" ;
VAL_ 1428 RSDS_R_SGU5_Checksum8 0 "Valid_value" ;
VAL_ 1428 RSDS_R_SGU5_RollingCounter7 0 "Valid_value" 15 "Invalid_value" ;
VAL_ 1428 RSDS_R_ObjMotionDirection_10 0 "Init" 1 "Inverse_direction" 2 "Same__direction" 3 "cross" 4 "reserved" 5 "reserved" 6 "reserved" 7 "reserved" ;
VAL_ 1428 RSDS_R_ObjAge_10 0 "Valid_values" ;
VAL_ 1428 RSDS_R_ObjWidth_10 0 "Valid_values" 501 "Reserved" ;
VAL_ 1428 RSDS_R_ObjRAccelYStd_10 0 "Valid_values" ;
VAL_ 1428 RSDS_R_ObjRAccelXStd_10 0 "Valid_values" ;
VAL_ 1428 RSDS_R_ObjRelVelYStd_10 0 "Valid_values" ;
VAL_ 1428 RSDS_R_ObjRelVelXStd_10 0 "Valid_values" ;
VAL_ 1428 RSDS_R_ObjDistYStd_10 0 "Valid_values" ;
VAL_ 1428 RSDS_R_SGU5_Checksum7 0 "Valid_value" ;
VAL_ 1428 RSDS_R_SGU5_RollingCounter6 0 "Valid_value" 15 "Invalid_value" ;
VAL_ 1428 RSDS_R_ObjMotionType_10 0 "int" 1 "unknown" 2 "Drive" 3 "Stopped" 4 "Stand" 5 "reserved" 6 "reserved" 7 "reserved" ;
VAL_ 1428 RSDS_R_ObjMeasured_10 0 "Init" 1 "Measured" 2 "Predicted" 3 "Reserved" ;
VAL_ 1428 RSDS_R_ObjRelAccelY_10 0 "Valid_values" ;
VAL_ 1428 RSDS_R_ObjRelAccelX_10 0 "Valid_values" ;
VAL_ 1428 RSDS_R_ObjRelVelY_10 0 "Valid_values" 8174 "Reserved" ;
VAL_ 1428 RSDS_R_ObjRelVelX_10 0 "Valid_values" 8174 "Reserved" ;
VAL_ 1428 RSDS_R_SGU5_Checksum6 0 "Valid_value" ;
VAL_ 1428 RSDS_R_SGU5_RollingCounter5 0 "Valid_value" 15 "Invalid_value" ;
VAL_ 1428 RSDS_R_ObjType_10 0 "Unknown" 1 "Truck" 2 "Car" 3 "Pedestrian" 4 "Cyclist" 5 "Reserved" ;
VAL_ 1428 RSDS_R_ObjDistXStd_10 0 "Valid_values" ;
VAL_ 1428 RSDS_R_ObjDistY_10 0 "Valid_values" ;
VAL_ 1428 RSDS_R_ObjDistX_10 0 "Valid_values" 4080 "Reserved" ;
VAL_ 1428 RSDS_R_ObjObstacleProb_10 0 "Valid_values" ;
VAL_ 1428 RSDS_R_ObjExistProb_10 0 "Valid_values" ;
VAL_ 1428 RSDS_R_ObjID_10 0 "Valid_values" ;
VAL_ 1428 RSDS_R_SGU5_Checksum5 0 "Valid_value" ;
VAL_ 1428 RSDS_R_SGU5_RollingCounter4 0 "Valid_value" 15 "Invalid_value" ;
VAL_ 1428 RSDS_R_HWATargetValidity_9 0 "NOT_HWA_Target" 1 "HWA_Target" ;
VAL_ 1428 RSDS_R_ObjRefPoint_9 0 "Rear" 1 "Rear_left" 2 "Left" 3 "Front_left" 4 "Front" 5 "Front_Right" 6 "Right" 7 "Rear_right" ;
VAL_ 1428 RSDS_R_ObjRCS_9 0 "Valid_values" ;
VAL_ 1428 RSDS_R_ObjYawrate_9 0 "Valid_values" 4446 "Reserved" ;
VAL_ 1428 RSDS_R_ObjHeading_9 0 "Valid_values" 4446 "Reserved" ;
VAL_ 1428 RSDS_R_ObjLength_9 0 "Valid_values" 401 "Reserved" ;
VAL_ 1428 RSDS_R_SGU5_Checksum4 0 "Valid_value" ;
VAL_ 1428 RSDS_R_SGU5_RollingCounter3 0 "Valid_value" 15 "Invalid_value" ;
VAL_ 1428 RSDS_R_ObjMotionDirection_9 0 "Init" 1 "Inverse_direction" 2 "Same__direction" 3 "cross" 4 "reserved" 5 "reserved" 6 "reserved" 7 "reserved" ;
VAL_ 1428 RSDS_R_ObjAge_9 0 "Valid_values" ;
VAL_ 1428 RSDS_R_ObjWidth_9 0 "Valid_values" 501 "Reserved" ;
VAL_ 1428 RSDS_R_ObjRAccelYStd_9 0 "Valid_values" ;
VAL_ 1428 RSDS_R_ObjRAccelXStd_9 0 "Valid_values" ;
VAL_ 1428 RSDS_R_ObjRelVelYStd_9 0 "Valid_values" ;
VAL_ 1428 RSDS_R_ObjRelVelXStd_9 0 "Valid_values" ;
VAL_ 1428 RSDS_R_ObjDistYStd_9 0 "Valid_values" ;
VAL_ 1428 RSDS_R_SGU5_Checksum3 0 "Valid_value" ;
VAL_ 1428 RSDS_R_SGU5_RollingCounter2 0 "Valid_value" 15 "Invalid_value" ;
VAL_ 1428 RSDS_R_ObjMotionType_9 0 "int" 1 "unknown" 2 "Drive" 3 "Stopped" 4 "Stand" 5 "reserved" 6 "reserved" 7 "reserved" ;
VAL_ 1428 RSDS_R_ObjMeasured_9 0 "Init" 1 "Measured" 2 "Predicted" 3 "Reserved" ;
VAL_ 1428 RSDS_R_ObjRelAccelY_9 0 "Valid_values" ;
VAL_ 1428 RSDS_R_ObjRelAccelX_9 0 "Valid_values" ;
VAL_ 1428 RSDS_R_ObjRelVelY_9 0 "Valid_values" 8174 "Reserved" ;
VAL_ 1428 RSDS_R_ObjRelVelX_9 0 "Valid_values" 8174 "Reserved" ;
VAL_ 1428 RSDS_R_SGU5_Checksum2 0 "Valid_value" ;
VAL_ 1428 RSDS_R_SGU5_RollingCounter1 0 "Valid_value" 15 "Invalid_value" ;
VAL_ 1428 RSDS_R_ObjType_9 0 "Unknown" 1 "Truck" 2 "Car" 3 "Pedestrian" 4 "Cyclist" 5 "Reserved" ;
VAL_ 1428 RSDS_R_ObjDistXStd_9 0 "Valid_values" ;
VAL_ 1428 RSDS_R_ObjDistY_9 0 "Valid_values" ;
VAL_ 1428 RSDS_R_ObjDistX_9 0 "Valid_values" 4080 "Reserved" ;
VAL_ 1428 RSDS_R_ObjObstacleProb_9 0 "Valid_values" ;
VAL_ 1428 RSDS_R_ObjExistProb_9 0 "Valid_values" ;
VAL_ 1428 RSDS_R_ObjID_9 0 "Valid_values" ;
VAL_ 1428 RSDS_R_SGU5_Checksum1 0 "Valid_value" ;
