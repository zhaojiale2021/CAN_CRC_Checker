VERSION ""

NS_ :

BS_:

BU_: IDC Delete_FDCA Delete_APA Delete_CMRR_FL Delete_CMRR_FR CMRR_RL CMRR_RR MRR CGW

BO_ 547 ADAS3_ACANFD: 64 IDC
 SG_ AdasHmiNeighboringObj9XOut : 359|8@0+ (1.2,-50) [-50|250] "m" CGW
 SG_ AdasHmiNeighboringObj9YOut : 367|8@0+ (0.06,-7.5) [-7.5|7.5] "m" CGW
 SG_ Obj9VX : 375|13@0+ (0.0312,-128) [-128|126.9976] "m/s" CGW
 SG_ AdasHmiNeighboringObj10ObjTyp : 391|3@0+ (1,0) [0|7] "-" CGW
 SG_ Obj10ObjExistProb : 388|5@0+ (0.03125,0) [0|0.96875] "" CGW
 SG_ AdasHmiNeighboringObj10XOut : 399|8@0+ (1.2,-50) [-50|250] "m" CGW
 SG_ AdasHmiNeighboringObj10YOut : 407|8@0+ (0.06,-7.5) [-7.5|7.5] "m" CGW
 SG_ Obj10VX : 415|13@0+ (0.0312,-128) [-128|126.9976] "m/s" CGW
 SG_ AdasHmiNeighboringObj11ObjTyp : 431|3@0+ (1,0) [0|7] "-" CGW
 SG_ Obj11ObjExistProb : 428|5@0+ (0.03125,0) [0|0.96875] "" CGW
 SG_ AdasHmiNeighboringObj11XOut : 439|8@0+ (1.2,-50) [-50|250] "m" CGW
 SG_ AdasHmiNeighboringObj11YOut : 447|8@0+ (0.06,-7.5) [-7.5|7.5] "m" CGW
 SG_ Obj11VX : 455|13@0+ (0.0312,-128) [-128|126.9976] "m/s" CGW
 SG_ AdasHmiNeighboringObj12ObjTyp : 471|3@0+ (1,0) [0|7] "-" CGW
 SG_ Obj12ObjExistProb : 468|5@0+ (0.03125,0) [0|0.96875] "" CGW
 SG_ AdasHmiNeighboringObj12XOut : 479|8@0+ (1.2,-50) [-50|250] "m" CGW
 SG_ AdasHmiNeighboringObj12YOut : 487|8@0+ (0.06,-7.5) [-7.5|7.5] "m" CGW
 SG_ Obj12VX : 495|13@0+ (0.0312,-128) [-128|126.9976] "m/s" CGW
 SG_ ADAS_TgtVehicleID_ACC : 507|4@0+ (1,0) [0|7] "" CGW

BO_ 552 ADAS4_ACANFD: 64 IDC
 SG_ MpcLine01ExistProb : 7|6@0+ (2,0) [0|100] "Percent" CGW
 SG_ MpcLine01Typ : 1|5@0+ (1,0) [0|31] "" CGW
 SG_ MpcLine01HeadingAg : 12|13@0+ (0.000488281,-1.6) [-1.6|1.6] "rad" CGW
 SG_ MpcLine01Dy : 31|12@0+ (0.015625,-32) [-32|31.984375] "m" CGW
 SG_ MpcLine01CrvtChg : 35|12@0+ (0.0000038147,-0.0078125) [-0.0078125|0.0078086965] "1pm2" CGW
 SG_ MpcLine01Crvt : 55|13@0+ (0.0000038147,-0.015625) [-0.015625|0.0156212077] "1pm" CGW
 SG_ MpcLine02ExistProb : 71|6@0+ (2,0) [0|100] "Percent" CGW
 SG_ MpcLine02HeadingAg : 79|13@0+ (0.000488281,-1.6) [-1.6|1.6] "rad" CGW
 SG_ MpcLine02Dy : 95|12@0+ (0.015625,-32) [-32|31.984375] "m" CGW
 SG_ MpcLine02CrvtChg : 99|12@0+ (0.0000038147,-0.0078125) [-0.0078125|0.0078086965] "1pm2" CGW
 SG_ MpcLine02Crvt : 119|13@0+ (0.0000038147,-0.015625) [-0.015625|0.0156212077] "1pm" CGW
 SG_ MpcLine03Typ : 132|5@0+ (1,0) [0|31] "" CGW
 SG_ MpcLine02Typ : 143|5@0+ (1,0) [0|31] "" CGW
 SG_ MpcLine03ExistProb : 151|6@0+ (2,0) [0|100] "Percent" CGW
 SG_ MpcLine03HeadingAg : 159|13@0+ (0.000488281,-1.6) [-1.6|1.6] "rad" CGW
 SG_ MpcLine03Dy : 175|12@0+ (0.015625,-32) [-32|31.984375] "m" CGW
 SG_ MpcLine03CrvtChg : 179|12@0+ (0.0000038147,-0.0078125) [-0.0078125|0.0078086965] "1pm2" CGW
 SG_ MpcLine03Crvt : 199|13@0+ (0.00000381,-0.015625) [-0.015625|0.0156212077] "1pm" CGW
 SG_ MpcLine04ExistProb : 215|6@0+ (2,0) [0|100] "Percent" CGW
 SG_ MpcLine04HeadingAg : 223|13@0+ (0.000488281,-1.6) [-1.6|1.6] "rad" CGW
 SG_ MpcLine04Dy : 239|12@0+ (0.015625,-32) [-32|31.984375] "m" CGW
 SG_ MpcLine04CrvtChg : 243|12@0+ (0.0000038147,-0.0078125) [-0.0078125|0.0078086965] "1pm2" CGW
 SG_ MpcLine04Crvt : 263|13@0+ (0.0000038147,-0.015625) [-0.015625|0.0156212077] "1pm" CGW
 SG_ MpcLine04Typ : 266|5@0+ (1,0) [0|31] "" CGW
 SG_ MpcLine05ExistProb : 277|6@0+ (2,0) [0|100] "Percent" CGW
 SG_ MpcLine05HeadingAg : 287|13@0+ (0.000488281,-1.6) [-1.6|1.6] "rad" CGW
 SG_ MpcLine05Dy : 303|12@0+ (0.015625,-32) [-32|31.984375] "m" CGW
 SG_ MpcLine05CrvtChg : 307|12@0+ (0.0000038147,-0.0078125) [-0.0078125|0.0078086965] "1pm2" CGW
 SG_ ADAS4_HmiTar1XOut : 325|6@0+ (1.2,0) [0|75.6] "" CGW
 SG_ ADAS4_HmiTar1YOut : 335|8@0+ (0.06,-4.5) [-4.5|10.8] "" CGW
 SG_ MpcLine05Crvt : 343|13@0+ (0.0000038147,-0.015625) [-0.015625|0.0156212077] "1pm" CGW
 SG_ ADAS4_HmiTar1Typ : 354|3@0+ (1,0) [0|7] "" CGW
 SG_ MpcLine05Typ : 359|5@0+ (1,0) [0|31] "" CGW
 SG_ MpcLine06ExistProb : 367|6@0+ (2,0) [0|100] "Percent" CGW
 SG_ MpcLine06HeadingAg : 375|13@0+ (0.000488281,-1.6) [-1.6|1.6] "rad" CGW
 SG_ ADAS4_HmiTar2Typ : 378|3@0+ (1,0) [0|7] "" CGW
 SG_ MpcLine06Dy : 391|12@0+ (0.015625,-32) [-32|31.984375] "m" CGW
 SG_ MpcLine06CrvtChg : 395|12@0+ (0.0000038147,-0.0078125) [-0.0078125|0.0078086965] "1pm2" CGW
 SG_ ADAS4_HmiTar3Typ : 418|3@0+ (1,0) [0|7] "" Vector__XXX
 SG_ MpcLine06Crvt : 415|13@0+ (0.0000038147,-0.015625) [-0.015625|0.0156212077] "1pm" Vector__XXX
 SG_ ADAS4_HmiTar4Typ : 426|3@0+ (1,0) [0|7] "" Vector__XXX
 SG_ MpcLine06Typ : 431|5@0+ (1,0) [0|31] "" Vector__XXX
 SG_ ADAS4_HmiTar2XOut : 437|6@0+ (1.2,0) [0|75.6] "" Vector__XXX
 SG_ TjaIcaLineSrc : 439|2@0+ (1,0) [0|3] "" Vector__XXX
 SG_ ADAS4_HmiTar2YOut : 447|8@0+ (0.06,-4.5) [-4.5|10.8] "" Vector__XXX
 SG_ ADAS4_HmiTar3YOut : 455|8@0+ (0.06,-4.5) [-4.5|10.8] "" Vector__XXX
 SG_ ADAS4_HmiTar3XOut : 463|6@0+ (1.2,0) [0|75.6] "" Vector__XXX
 SG_ ADAS4_HmiTar5Typ : 456|3@0+ (1,0) [0|7] "" Vector__XXX
 SG_ ADAS5_HmiTar4XOut : 469|6@0+ (1.2,0) [0|75.6] "" Vector__XXX
 SG_ ADAS4_HmiTar4YOut : 479|8@0+ (0.06,-4.5) [-4.5|10.8] "" Vector__XXX
 SG_ ADAS4_HmiTar5YOut : 487|8@0+ (0.06,-4.5) [-4.5|10.8] "" Vector__XXX
 SG_ ADAS4_HmiTar5XOut : 495|6@0+ (1.2,0) [0|75.6] "" Vector__XXX
 SG_ ADAS4_HmiTar6Typ : 488|3@0+ (1,0) [0|7] "" Vector__XXX
 SG_ ADAS4_HmiTar6XOut : 501|6@0+ (1.2,0) [0|75.6] "" Vector__XXX
 SG_ ADAS4_HmiTar6YOut : 511|8@0+ (0.06,-4.5) [-4.5|10.8] "" Vector__XXX

BO_ 2015 DLC_Diag_Function: 8 CGW

BO_ 585 APA_0x249: 8 IDC
 SG_ RemPrkgReq : 1|2@0+ (1,0) [0|3] "" CGW
 SG_ ApaAbordReason : 7|6@0+ (1,0) [0|63] "" CGW
 SG_ ApaSts : 11|4@0+ (1,0) [0|15] "" Delete_FDCA,Delete_CMRR_FL,Delete_CMRR_FR,CMRR_RL,CMRR_RR,MRR,CGW
 SG_ RpaSts : 15|4@0+ (1,0) [0|15] "" Delete_CMRR_FL,Delete_CMRR_FR,CMRR_RL,CMRR_RR,MRR,CGW
 SG_ APA_0x249_St_ParkingOutMode : 23|2@0+ (1,0) [0|3] "" CGW
 SG_ APA_0x249_St_ParkingInMode : 21|2@0+ (1,0) [0|3] "" CGW
 SG_ ApaParkOutDirSts : 19|4@0+ (1,0) [0|15] "" CGW
 SG_ RpaTxtDisp : 31|8@0+ (1,0) [0|255] "" CGW
 SG_ DirHalfLeAvl : 32|1@0+ (1,0) [0|1] "" CGW
 SG_ DirHalfRiAvl : 33|1@0+ (1,0) [0|1] "" CGW
 SG_ DirVertFwdAvl : 34|1@0+ (1,0) [0|1] "" CGW
 SG_ DirVertBwdAvl : 35|1@0+ (1,0) [0|1] "" CGW
 SG_ DirVertHdLeAvl : 36|1@0+ (1,0) [0|1] "" CGW
 SG_ DirVertHdRiAvl : 37|1@0+ (1,0) [0|1] "" CGW
 SG_ DirVertTrLeAvl : 38|1@0+ (1,0) [0|1] "" CGW
 SG_ DirVertTrRiAvl : 39|1@0+ (1,0) [0|1] "" CGW
 SG_ ApaVehModStsFb : 42|3@0+ (1,0) [0|7] "" CGW
 SG_ ApaUnfoldMirror : 45|2@0+ (1,0) [0|3] "" CGW
 SG_ APA_HazardWarningLightsReq : 47|2@0+ (1,0) [0|3] "" CGW
 SG_ ApaSuspendReason : 55|4@0+ (1,0) [0|15] "" CGW
 SG_ APA_0x249_RollingCounter : 51|4@0+ (1,0) [0|15] "" Delete_CMRR_FL,Delete_CMRR_FR,CMRR_RL,CMRR_RR,MRR,CGW
 SG_ APA_0x249_Checksum : 63|8@0+ (1,0) [0|255] "" Delete_CMRR_FL,Delete_CMRR_FR,CMRR_RL,CMRR_RR,MRR,CGW

BO_ 658 APA_5: 24 IDC
 SG_ ApaDispReq : 13|6@0+ (1,0) [0|63] "" CGW
 SG_ ApaParkModSts : 18|3@0+ (1,0) [0|7] "" CGW
 SG_ ApaParkInSlotSts : 21|3@0+ (1,0) [0|7] "" CGW
 SG_ ApaTragParkSetSts : 29|2@0+ (1,0) [0|3] "" CGW
 SG_ ApaVoicBrdtSts : 31|2@0+ (1,0) [0|3] "" CGW
 SG_ ApaParkStrtSts : 34|3@0+ (1,0) [0|7] "" CGW
 SG_ ApaPathSts : 63|2@0+ (1,0) [0|3] "" CGW
 SG_ ApaVoicBrdtReq : 71|8@0+ (1,0) [0|255] "" CGW
 SG_ ApaTragParkSts : 85|4@0+ (1,0) [0|15] "" CGW
 SG_ SlotAutoSearchSts : 87|2@0+ (1,0) [0|3] "" CGW
 SG_ ApaCurPahNrRate : 92|5@0+ (4,0) [0|100] "%" CGW
 SG_ RpaDstSetSts : 95|3@0+ (1,0) [0|7] "" CGW
 SG_ ApaRemnDst : 103|13@0+ (0.1,0) [0|819.1] "m" CGW
 SG_ OperToutExitSetSts : 106|3@0+ (1,0) [0|7] "" CGW
 SG_ Apaparkout : 112|1@0+ (1,0) [0|1] "" CGW
 SG_ CustSelSlot : 113|1@0+ (1,0) [0|1] "" CGW
 SG_ ApaParkin : 114|1@0+ (1,0) [0|1] "" CGW
 SG_ AvmFuncSts : 115|1@0+ (1,0) [0|1] "" CGW
 SG_ ApaFuncSts : 116|1@0+ (1,0) [0|1] "" CGW
 SG_ CustSlecSlotSts : 117|1@0+ (1,0) [0|1] "" CGW
 SG_ ApaTrackingFuncSts : 118|1@0+ (1,0) [0|1] "" CGW
 SG_ ApaSysFaild : 119|1@0+ (1,0) [0|1] "" CGW
 SG_ AvmMoveObjDetnSts : 121|2@0+ (1,0) [0|3] "" CGW

BO_TX_BU_ 552 : IDC,Delete_FDCA;

BO_TX_BU_ 585 : IDC,Delete_APA;

BO_TX_BU_ 658 : IDC,Delete_APA;
CM_ BO_ 552 "车道线";
CM_ BO_ 2015 "矩阵中诊断报文的DLC仅用于适配DBC文件的生成，ECU实际开发采用的DLC长度应满足UDS技术要求";
CM_ BO_ 585 "底盘交互有关，对应B41的0x291报文（APA2）；转到TCANFD是1000ms";
CM_ BO_ 658 "与车机交互有关，转到TCANFD是1000ms";
CM_ SG_ 547 AdasHmiNeighboringObj9XOut "Provides the location of the neighboring Object no.1 as a longitudinal distance from ego center";
CM_ SG_ 547 AdasHmiNeighboringObj9YOut "Provides the location of the neighboring Object no.1 as a lateral distance from ego center";
CM_ SG_ 547 Obj9VX "Relative target object velocity in x-direction";
CM_ SG_ 547 AdasHmiNeighboringObj10ObjTyp "Provides the type of the neihboring Object no. 10";
CM_ SG_ 547 Obj10ObjExistProb "The probability of an object to exist in reality";
CM_ SG_ 547 AdasHmiNeighboringObj10XOut "Provides the location of the neighboring Object no.1 as a longitudinal distance from ego center";
CM_ SG_ 547 AdasHmiNeighboringObj10YOut "Provides the location of the neighboring Object no.1 as a lateral distance from ego center";
CM_ SG_ 547 Obj10VX "Relative target object velocity in x-direction";
CM_ SG_ 547 AdasHmiNeighboringObj11ObjTyp "Provides the type of the neihboring Object no. 11";
CM_ SG_ 547 Obj11ObjExistProb "The probability of an object to exist in reality";
CM_ SG_ 547 AdasHmiNeighboringObj11XOut "Provides the location of the neighboring Object no.1 as a longitudinal distance from ego center";
CM_ SG_ 547 AdasHmiNeighboringObj11YOut "Provides the location of the neighboring Object no.1 as a lateral distance from ego center";
CM_ SG_ 547 Obj11VX "Relative target object velocity in x-direction";
CM_ SG_ 547 AdasHmiNeighboringObj12ObjTyp "Provides the type of the neihboring Object no. 12";
CM_ SG_ 547 Obj12ObjExistProb "The probability of an object to exist in reality";
CM_ SG_ 547 AdasHmiNeighboringObj12XOut "Provides the location of the neighboring Object no.1 as a longitudinal distance from ego center";
CM_ SG_ 547 AdasHmiNeighboringObj12YOut "Provides the location of the neighboring Object no.1 as a lateral distance from ego center";
CM_ SG_ 547 Obj12VX "Relative target object velocity in x-direction";
CM_ SG_ 547 ADAS_TgtVehicleID_ACC "关键目标 ID, 用于在 ACC激活状态下，使仪表显示时将ACC目标车高亮显示";
CM_ SG_ 552 MpcLine01ExistProb "Confidence for this line";
CM_ SG_ 552 MpcLine01Typ "Type of the Line";
CM_ SG_ 552 MpcLine01HeadingAg "Heading angle, difference in yaw angle between vehicle heading and Line";
CM_ SG_ 552 MpcLine01Dy "Dy at position of DxStart  (not always x=0, because of high values for 2nd segment)";
CM_ SG_ 552 MpcLine01CrvtChg "Currvature change or alteration of the Line, also called kappaDt";
CM_ SG_ 552 MpcLine01Crvt "Curvature of the Line, also called kappa";
CM_ SG_ 552 MpcLine02ExistProb "Confidence for this line";
CM_ SG_ 552 MpcLine02HeadingAg "Heading angle, difference in yaw angle between vehicle heading and Line";
CM_ SG_ 552 MpcLine02Dy "Dy at position of DxStart  (not always x=0, because of high values for 2nd segment)";
CM_ SG_ 552 MpcLine02CrvtChg "Curvature change or alteration of the Line, also called kappaDt";
CM_ SG_ 552 MpcLine02Crvt "Curvature of the Line, also called kappa";
CM_ SG_ 552 MpcLine03Typ "Type of the Line";
CM_ SG_ 552 MpcLine02Typ "Type of the Line";
CM_ SG_ 552 MpcLine03ExistProb "Confidence for this line";
CM_ SG_ 552 MpcLine03HeadingAg "Heading angle, difference in yaw angle between vehicle heading and Line";
CM_ SG_ 552 MpcLine03Dy "Dy at position of DxStart  (not always x=0, because of high values for 2nd segment)";
CM_ SG_ 552 MpcLine03CrvtChg "Currvature change or alteration of the Line, also called kappaDt";
CM_ SG_ 552 MpcLine03Crvt "Curvature of the Line, also called kappa";
CM_ SG_ 552 MpcLine04ExistProb "Confidence for this line";
CM_ SG_ 552 MpcLine04HeadingAg "Heading angle, difference in yaw angle between vehicle heading and Line";
CM_ SG_ 552 MpcLine04Dy "Dy at position of DxStart  (not always x=0, because of high values for 2nd segment)";
CM_ SG_ 552 MpcLine04CrvtChg "Currvature change or alteration of the Line, also called kappaDt";
CM_ SG_ 552 MpcLine04Crvt "Curvature of the Line, also called kappa";
CM_ SG_ 552 MpcLine04Typ "Type of the Line";
CM_ SG_ 552 MpcLine05ExistProb "Confidence for this line";
CM_ SG_ 552 MpcLine05HeadingAg "Heading angle, difference in yaw angle between vehicle heading and Line";
CM_ SG_ 552 MpcLine05Dy "Dy at position of DxStart  (not always x=0, because of high values for 2nd segment)";
CM_ SG_ 552 MpcLine05CrvtChg "Currvature change or alteration of the Line, also called kappaDt";
CM_ SG_ 552 ADAS4_HmiTar1XOut " distance (positive values are front)";
CM_ SG_ 552 ADAS4_HmiTar1YOut "distance left from ego centerdistance right from ego center";
CM_ SG_ 552 MpcLine05Crvt "Curvature of the Line, also called kappa";
CM_ SG_ 552 MpcLine05Typ "Type of the Line";
CM_ SG_ 552 MpcLine06ExistProb "Confidence for this line";
CM_ SG_ 552 MpcLine06HeadingAg "Heading angle, difference in yaw angle between vehicle heading and Line";
CM_ SG_ 552 MpcLine06Dy "Dy at position of DxStart  (not always x=0, because of high values for 2nd segment)";
CM_ SG_ 552 MpcLine06CrvtChg "Currvature change or alteration of the Line, also called kappaDt";
CM_ SG_ 552 MpcLine06Crvt "Curvature of the Line, also called kappa";
CM_ SG_ 552 MpcLine06Typ "Type of the Line";
CM_ SG_ 552 ADAS4_HmiTar2XOut " distance (positive values are front)";
CM_ SG_ 552 TjaIcaLineSrc "The line source of TJA ICA.video 视觉模式，基于MPC识别的车道线进行控制;DOP Drive Object Path，基于目标车辆或者车流进行控制; TIPL Traffic in Parallel Line ，基于MRRTIPL算法给出的车道线进行控制.";
CM_ SG_ 552 ADAS4_HmiTar2YOut "distance left from ego centerdistance right from ego center";
CM_ SG_ 552 ADAS4_HmiTar3YOut "distance left from ego centerdistance right from ego center";
CM_ SG_ 552 ADAS4_HmiTar3XOut " distance (positive values are front)";
CM_ SG_ 552 ADAS5_HmiTar4XOut " distance (positive values are front)";
CM_ SG_ 552 ADAS4_HmiTar4YOut "distance left from ego centerdistance right from ego center";
CM_ SG_ 552 ADAS4_HmiTar5YOut "distance left from ego centerdistance right from ego center";
CM_ SG_ 552 ADAS4_HmiTar5XOut " distance (positive values are front)";
CM_ SG_ 552 ADAS4_HmiTar6XOut " distance (positive values are front)";
CM_ SG_ 552 ADAS4_HmiTar6YOut "distance left from ego centerdistance right from ego center";
CM_ SG_ 585 RemPrkgReq "RemoteParkingRequest 判断RPA条件,响应TBOX握手请求";
CM_ SG_ 585 ApaAbordReason "Auto Parking Abort reason.主动泊车、遥控泊车中止原因";
CM_ SG_ 585 ApaSts "APA function status.";
CM_ SG_ 585 RpaSts "RPA status";
CM_ SG_ 585 APA_0x249_St_ParkingOutMode "泊出方式Parking_Mode";
CM_ SG_ 585 APA_0x249_St_ParkingInMode "泊入方式Parking in Mode";
CM_ SG_ 585 ApaParkOutDirSts "APA泊出方向对应HUM信号ApaParkOutDirSetTBOX需要收";
CM_ SG_ 585 RpaTxtDisp "RPA Text Display手机端文字提示";
CM_ SG_ 585 DirHalfLeAvl "Availability of ParkOut Direction--Half Vehicle Left";
CM_ SG_ 585 DirHalfRiAvl "Availability of ParkOut Direction-- Half Vehicle Right";
CM_ SG_ 585 DirVertFwdAvl "Availability of ParkOut Direction--Vertical forward";
CM_ SG_ 585 DirVertBwdAvl "Availability of ParkOut Direction--Vertical backward";
CM_ SG_ 585 DirVertHdLeAvl "Availability of ParkOut Direction--Vertical Head Left";
CM_ SG_ 585 DirVertHdRiAvl "Availability of ParkOut Direction--Vertical Head Right";
CM_ SG_ 585 DirVertTrLeAvl "Availability of ParkOut Direction-- Vertical Trunk Left";
CM_ SG_ 585 DirVertTrRiAvl "Availability of ParkOut Direction--Vertical Trunk Right";
CM_ SG_ 585 ApaVehModStsFb "vehicle mode status feedback.车辆模式状态反馈";
CM_ SG_ 585 ApaUnfoldMirror "Rpa Unfold Mirror";
CM_ SG_ 585 APA_HazardWarningLightsReq "危险警报灯请求";
CM_ SG_ 585 ApaSuspendReason "Auto Parking Suspended reason.主动泊车/遥控泊车暂停原因";
CM_ SG_ 585 APA_0x249_RollingCounter "Message counter for the message transmitted.The transmitter shall update the value of signal RollingCounter each time the message is transmitted, even if no data updated in the message.The value of the rolling counter increases according to the sequence such as '0,1,2...15,0,1,2...15', and the initial value will be set to zero once transmission is started.";
CM_ SG_ 585 APA_0x249_Checksum "Checksum = (byte0+byte1+…+byte 6）and 0xFF";
CM_ SG_ 658 ApaDispReq "APA request HUM to switch display interface.";
CM_ SG_ 658 ApaParkModSts "APA 泊车方式选择反馈。对应HUM0x321中ApaParkModSet";
CM_ SG_ 658 ApaParkInSlotSts "APA泊入车位类型设置反馈。对应HUM0x321中ApaParkInSlotSet";
CM_ SG_ 658 ApaTragParkSetSts "APA tracking parking Status对应HUM信号ApaTragParkSet";
CM_ SG_ 658 ApaVoicBrdtSts "APA voice broadcast status对应HUM信号ApaVoicBrdtSwt";
CM_ SG_ 658 ApaParkStrtSts "APA泊车功能开始反馈，包含自动泊入/遥控泊入/自动泊出/循迹倒车对应HUM信号ApaParkStrtSet";
CM_ SG_ 658 ApaPathSts "APA泊车路径选择，车头/车尾";
CM_ SG_ 658 ApaVoicBrdtReq "APA voice broadcast Request。";
CM_ SG_ 658 ApaTragParkSts "循迹倒车工作状态信息";
CM_ SG_ 658 SlotAutoSearchSts "自动搜索车位功能开关状态";
CM_ SG_ 658 ApaCurPahNrRate "Reserved.The complete progress for APA .自动泊车和循迹倒车完成进度，循迹倒车是距离的进度，泊车时路径完成进度。每个档位的进度。";
CM_ SG_ 658 RpaDstSetSts "遥控泊车距离设定";
CM_ SG_ 658 ApaRemnDst "Reserved. Remaining distance当前步骤中泊车剩余距离/与ESP的停车距离啥关系";
CM_ SG_ 658 OperToutExitSetSts "Operation timeout用户操作超时退出时间设定";
CM_ SG_ 658 Apaparkout "泊出功能可用性信号";
CM_ SG_ 658 CustSelSlot "自选车位功能可用性信号";
CM_ SG_ 658 ApaParkin "泊入功能可用性信号";
CM_ SG_ 658 AvmFuncSts "全景功能是否可用信号";
CM_ SG_ 658 ApaFuncSts "自动泊车功能是否可用信号";
CM_ SG_ 658 CustSlecSlotSts "自选车位是否可泊";
CM_ SG_ 658 ApaTrackingFuncSts "倒车循迹功能是否可用信号";
CM_ SG_ 658 ApaSysFaild "控制器故障信号";
CM_ SG_ 658 AvmMoveObjDetnSts "object detection Indicate the MOD(MoveObjectDetection) running status of AVM. When the system is in initializtion, the signal is set to 0x0.移动物体识别开关反馈";

BA_DEF_ BO_  "NmMessage" ENUM "No","Yes";
BA_DEF_ BO_  "DiagState" ENUM  "No","Yes";
BA_DEF_ BO_  "DiagResponse" ENUM  "No","Yes";
BA_DEF_ BO_  "GenMsgSendType" ENUM  "cyclic","NoMsgSendType","IfActive","Event","CA","CE";
BA_DEF_ BO_  "GenMsgCycleTime" INT 0 0;
BA_DEF_ SG_  "GenSigSendType" ENUM  "cyclic","OnChange","OnWrite","IfActive","OnChangeWithRepetition","OnWriteWithRepetition","IfActiveWithRepetition","CA","CE","Event";
BA_DEF_ SG_  "GenSigStartValue" INT 0 0;
BA_DEF_ BO_  "GenMsgCycleTimeFast" INT 0 0;
BA_DEF_ BO_  "GenMsgNrOfRepetition" INT 0 0;
BA_DEF_ BO_  "CANFD_BRS" ENUM  "0","1";
BA_DEF_ BO_  "VFrameFormat" ENUM  "StandardCAN","ExtendedCAN","reserved","reserved","reserved","reserved","reserved","reserved","reserved","reserved","reserved","reserved","reserved","reserved","StandardCAN_FD","ExtendedCAN_FD";
BA_DEF_ BO_  "GenMsgILSupport" ENUM  "No","Yes";
BA_DEF_ SG_ "sigDespEng" STRING;
BA_DEF_ SG_ "sigSecLevel" STRING;
BA_DEF_ SG_ "sigConfig" STRING;
BA_DEF_ SG_ "sigExplanation" STRING;

BA_DEF_DEF_  "NmMessage" "No";
BA_DEF_DEF_  "DiagState" "No";
BA_DEF_DEF_  "DiagResponse" "No";
BA_DEF_DEF_  "GenMsgSendType" "cyclic";
BA_DEF_DEF_  "GenMsgCycleTime" 0;
BA_DEF_DEF_  "GenSigSendType" "cyclic";
BA_DEF_DEF_  "GenSigStartValue" 0;
BA_DEF_DEF_  "GenMsgCycleTimeFast" 0;
BA_DEF_DEF_  "GenMsgNrOfRepetition" 0;
BA_DEF_DEF_  "CANFD_BRS" "1";
BA_DEF_DEF_  "VFrameFormat" "StandardCAN";
BA_DEF_DEF_  "GenMsgILSupport" "Yes";
BA_DEF_DEF_ "sigDespEng" "" ;
BA_DEF_DEF_ "sigSecLevel" "QM" ;
BA_DEF_DEF_ "sigConfig" "" ;
BA_DEF_DEF_ "sigExplanation" "" ;
BA_ "sigSecLevel"  SG_ 547 AdasHmiNeighboringObj9XOut "";
BA_ "sigExplanation"  SG_ 547 AdasHmiNeighboringObj9XOut "CDCIPC";
BA_ "sigSecLevel"  SG_ 547 AdasHmiNeighboringObj9YOut "";
BA_ "sigExplanation"  SG_ 547 AdasHmiNeighboringObj9YOut "CDCIPC";
BA_ "sigSecLevel"  SG_ 547 Obj9VX "";
BA_ "sigExplanation"  SG_ 547 Obj9VX "CDCIPC";
BA_ "sigSecLevel"  SG_ 547 AdasHmiNeighboringObj10ObjTyp "";
BA_ "sigExplanation"  SG_ 547 AdasHmiNeighboringObj10ObjTyp "CDCIPC";
BA_ "sigSecLevel"  SG_ 547 Obj10ObjExistProb "";
BA_ "sigExplanation"  SG_ 547 Obj10ObjExistProb "CDCIPC";
BA_ "sigSecLevel"  SG_ 547 AdasHmiNeighboringObj10XOut "";
BA_ "sigExplanation"  SG_ 547 AdasHmiNeighboringObj10XOut "CDCIPC";
BA_ "sigSecLevel"  SG_ 547 AdasHmiNeighboringObj10YOut "";
BA_ "sigExplanation"  SG_ 547 AdasHmiNeighboringObj10YOut "CDCIPC";
BA_ "sigSecLevel"  SG_ 547 Obj10VX "";
BA_ "sigExplanation"  SG_ 547 Obj10VX "CDCIPC";
BA_ "sigSecLevel"  SG_ 547 AdasHmiNeighboringObj11ObjTyp "";
BA_ "sigExplanation"  SG_ 547 AdasHmiNeighboringObj11ObjTyp "CDCIPC";
BA_ "sigSecLevel"  SG_ 547 Obj11ObjExistProb "";
BA_ "sigExplanation"  SG_ 547 Obj11ObjExistProb "CDCIPC";
BA_ "sigSecLevel"  SG_ 547 AdasHmiNeighboringObj11XOut "";
BA_ "sigExplanation"  SG_ 547 AdasHmiNeighboringObj11XOut "CDCIPC";
BA_ "sigSecLevel"  SG_ 547 AdasHmiNeighboringObj11YOut "";
BA_ "sigExplanation"  SG_ 547 AdasHmiNeighboringObj11YOut "CDCIPC";
BA_ "sigSecLevel"  SG_ 547 Obj11VX "";
BA_ "sigExplanation"  SG_ 547 Obj11VX "CDCIPC";
BA_ "sigSecLevel"  SG_ 547 AdasHmiNeighboringObj12ObjTyp "";
BA_ "sigExplanation"  SG_ 547 AdasHmiNeighboringObj12ObjTyp "CDCIPC";
BA_ "sigSecLevel"  SG_ 547 Obj12ObjExistProb "";
BA_ "sigExplanation"  SG_ 547 Obj12ObjExistProb "CDCIPC";
BA_ "sigSecLevel"  SG_ 547 AdasHmiNeighboringObj12XOut "";
BA_ "sigExplanation"  SG_ 547 AdasHmiNeighboringObj12XOut "CDCIPC";
BA_ "sigSecLevel"  SG_ 547 AdasHmiNeighboringObj12YOut "";
BA_ "sigExplanation"  SG_ 547 AdasHmiNeighboringObj12YOut "CDCIPC";
BA_ "sigSecLevel"  SG_ 547 Obj12VX "";
BA_ "sigExplanation"  SG_ 547 Obj12VX "CDCIPC";
BA_ "sigSecLevel"  SG_ 547 ADAS_TgtVehicleID_ACC "";
BA_ "sigExplanation"  SG_ 547 ADAS_TgtVehicleID_ACC "CDCIPC";
BA_ "GenMsgCycleTime" BO_ 552 100;
BA_ "VFrameFormat" BO_ 552 14;
BA_ "sigSecLevel"  SG_ 552 MpcLine01ExistProb "";
BA_ "sigExplanation"  SG_ 552 MpcLine01ExistProb "CDCIPC";
BA_ "sigSecLevel"  SG_ 552 MpcLine01Typ "";
BA_ "sigExplanation"  SG_ 552 MpcLine01Typ "CDCIPC";
BA_ "sigDespEng"  SG_ 552 MpcLine01HeadingAg "航向角1";
BA_ "sigSecLevel"  SG_ 552 MpcLine01HeadingAg "";
BA_ "sigConfig"  SG_ 552 MpcLine01HeadingAg "tsp";
BA_ "sigExplanation"  SG_ 552 MpcLine01HeadingAg "CDCIPC";
BA_ "GenSigStartValue" SG_ 552 MpcLine01Dy 2048;
BA_ "sigDespEng"  SG_ 552 MpcLine01Dy "车道线宽度1";
BA_ "sigSecLevel"  SG_ 552 MpcLine01Dy "";
BA_ "sigConfig"  SG_ 552 MpcLine01Dy "tsp";
BA_ "sigExplanation"  SG_ 552 MpcLine01Dy "CDCIPC";
BA_ "sigSecLevel"  SG_ 552 MpcLine01CrvtChg "";
BA_ "sigExplanation"  SG_ 552 MpcLine01CrvtChg "CDCIPC";
BA_ "GenSigStartValue" SG_ 552 MpcLine01Crvt 4097;
BA_ "sigDespEng"  SG_ 552 MpcLine01Crvt "车道线曲率1";
BA_ "sigSecLevel"  SG_ 552 MpcLine01Crvt "";
BA_ "sigConfig"  SG_ 552 MpcLine01Crvt "tsp";
BA_ "sigExplanation"  SG_ 552 MpcLine01Crvt "CDCIPC";
BA_ "sigSecLevel"  SG_ 552 MpcLine02ExistProb "";
BA_ "sigExplanation"  SG_ 552 MpcLine02ExistProb "CDCIPC";
BA_ "sigDespEng"  SG_ 552 MpcLine02HeadingAg "航向角2";
BA_ "sigSecLevel"  SG_ 552 MpcLine02HeadingAg "";
BA_ "sigConfig"  SG_ 552 MpcLine02HeadingAg "tsp";
BA_ "sigExplanation"  SG_ 552 MpcLine02HeadingAg "CDCIPC";
BA_ "GenSigStartValue" SG_ 552 MpcLine02Dy 2048;
BA_ "sigDespEng"  SG_ 552 MpcLine02Dy "车道线宽度2";
BA_ "sigSecLevel"  SG_ 552 MpcLine02Dy "";
BA_ "sigConfig"  SG_ 552 MpcLine02Dy "tsp";
BA_ "sigExplanation"  SG_ 552 MpcLine02Dy "CDCIPC";
BA_ "GenSigStartValue" SG_ 552 MpcLine02CrvtChg 2047;
BA_ "sigSecLevel"  SG_ 552 MpcLine02CrvtChg "";
BA_ "sigExplanation"  SG_ 552 MpcLine02CrvtChg "CDCIPC";
BA_ "GenSigStartValue" SG_ 552 MpcLine02Crvt 4097;
BA_ "sigDespEng"  SG_ 552 MpcLine02Crvt "车道线曲率2";
BA_ "sigSecLevel"  SG_ 552 MpcLine02Crvt "";
BA_ "sigConfig"  SG_ 552 MpcLine02Crvt "tsp";
BA_ "sigExplanation"  SG_ 552 MpcLine02Crvt "CDCIPC";
BA_ "sigSecLevel"  SG_ 552 MpcLine03Typ "";
BA_ "sigExplanation"  SG_ 552 MpcLine03Typ "CDCIPC";
BA_ "sigSecLevel"  SG_ 552 MpcLine02Typ "";
BA_ "sigExplanation"  SG_ 552 MpcLine02Typ "CDCIPC";
BA_ "sigSecLevel"  SG_ 552 MpcLine03ExistProb "";
BA_ "sigExplanation"  SG_ 552 MpcLine03ExistProb "CDCIPC";
BA_ "sigSecLevel"  SG_ 552 MpcLine03HeadingAg "";
BA_ "sigExplanation"  SG_ 552 MpcLine03HeadingAg "CDCIPC";
BA_ "GenSigStartValue" SG_ 552 MpcLine03Dy 2048;
BA_ "sigSecLevel"  SG_ 552 MpcLine03Dy "";
BA_ "sigExplanation"  SG_ 552 MpcLine03Dy "CDCIPC";
BA_ "sigSecLevel"  SG_ 552 MpcLine03CrvtChg "";
BA_ "sigExplanation"  SG_ 552 MpcLine03CrvtChg "CDCIPC";
BA_ "GenSigStartValue" SG_ 552 MpcLine03Crvt 4097;
BA_ "sigSecLevel"  SG_ 552 MpcLine03Crvt "";
BA_ "sigExplanation"  SG_ 552 MpcLine03Crvt "CDCIPC";
BA_ "sigSecLevel"  SG_ 552 MpcLine04ExistProb "";
BA_ "sigExplanation"  SG_ 552 MpcLine04ExistProb "CDCIPC";
BA_ "sigSecLevel"  SG_ 552 MpcLine04HeadingAg "";
BA_ "sigExplanation"  SG_ 552 MpcLine04HeadingAg "CDCIPC";
BA_ "GenSigStartValue" SG_ 552 MpcLine04Dy 2048;
BA_ "sigSecLevel"  SG_ 552 MpcLine04Dy "";
BA_ "sigExplanation"  SG_ 552 MpcLine04Dy "CDCIPC";
BA_ "sigSecLevel"  SG_ 552 MpcLine04CrvtChg "";
BA_ "sigExplanation"  SG_ 552 MpcLine04CrvtChg "CDCIPC";
BA_ "GenSigStartValue" SG_ 552 MpcLine04Crvt 4097;
BA_ "sigSecLevel"  SG_ 552 MpcLine04Crvt "";
BA_ "sigExplanation"  SG_ 552 MpcLine04Crvt "CDCIPC";
BA_ "sigSecLevel"  SG_ 552 MpcLine04Typ "";
BA_ "sigExplanation"  SG_ 552 MpcLine04Typ "CDCIPC";
BA_ "sigSecLevel"  SG_ 552 MpcLine05ExistProb "";
BA_ "sigExplanation"  SG_ 552 MpcLine05ExistProb "CDCIPC";
BA_ "sigSecLevel"  SG_ 552 MpcLine05HeadingAg "";
BA_ "sigExplanation"  SG_ 552 MpcLine05HeadingAg "CDCIPC";
BA_ "GenSigStartValue" SG_ 552 MpcLine05Dy 2048;
BA_ "sigSecLevel"  SG_ 552 MpcLine05Dy "";
BA_ "sigExplanation"  SG_ 552 MpcLine05Dy "CDCIPC";
BA_ "sigSecLevel"  SG_ 552 MpcLine05CrvtChg "";
BA_ "sigExplanation"  SG_ 552 MpcLine05CrvtChg "CDCIPC";
BA_ "sigSecLevel"  SG_ 552 ADAS4_HmiTar1XOut "";
BA_ "sigExplanation"  SG_ 552 ADAS4_HmiTar1XOut "CDCIPC";
BA_ "sigSecLevel"  SG_ 552 ADAS4_HmiTar1YOut "";
BA_ "sigExplanation"  SG_ 552 ADAS4_HmiTar1YOut "CDCIPC";
BA_ "GenSigStartValue" SG_ 552 MpcLine05Crvt 4097;
BA_ "sigSecLevel"  SG_ 552 MpcLine05Crvt "";
BA_ "sigExplanation"  SG_ 552 MpcLine05Crvt "CDCIPC";
BA_ "sigSecLevel"  SG_ 552 ADAS4_HmiTar1Typ "";
BA_ "sigExplanation"  SG_ 552 ADAS4_HmiTar1Typ "CDCIPC";
BA_ "sigSecLevel"  SG_ 552 MpcLine05Typ "";
BA_ "sigExplanation"  SG_ 552 MpcLine05Typ "CDCIPC";
BA_ "sigSecLevel"  SG_ 552 MpcLine06ExistProb "";
BA_ "sigExplanation"  SG_ 552 MpcLine06ExistProb "CDCIPC";
BA_ "sigSecLevel"  SG_ 552 MpcLine06HeadingAg "";
BA_ "sigExplanation"  SG_ 552 MpcLine06HeadingAg "CDCIPC";
BA_ "sigSecLevel"  SG_ 552 ADAS4_HmiTar2Typ "";
BA_ "sigExplanation"  SG_ 552 ADAS4_HmiTar2Typ "CDCIPC";
BA_ "GenSigStartValue" SG_ 552 MpcLine06Dy 2048;
BA_ "sigSecLevel"  SG_ 552 MpcLine06Dy "";
BA_ "sigExplanation"  SG_ 552 MpcLine06Dy "CDCIPC";
BA_ "sigSecLevel"  SG_ 552 MpcLine06CrvtChg "";
BA_ "sigExplanation"  SG_ 552 MpcLine06CrvtChg "CDCIPC";
BA_ "sigSecLevel"  SG_ 552 ADAS4_HmiTar3Typ "";
BA_ "sigExplanation"  SG_ 552 ADAS4_HmiTar3Typ "CDCIPC";
BA_ "GenSigStartValue" SG_ 552 MpcLine06Crvt 4097;
BA_ "sigSecLevel"  SG_ 552 MpcLine06Crvt "";
BA_ "sigExplanation"  SG_ 552 MpcLine06Crvt "CDCIPC";
BA_ "sigSecLevel"  SG_ 552 ADAS4_HmiTar4Typ "";
BA_ "sigExplanation"  SG_ 552 ADAS4_HmiTar4Typ "CDCIPC";
BA_ "sigSecLevel"  SG_ 552 MpcLine06Typ "";
BA_ "sigExplanation"  SG_ 552 MpcLine06Typ "CDCIPC";
BA_ "sigSecLevel"  SG_ 552 ADAS4_HmiTar2XOut "";
BA_ "sigExplanation"  SG_ 552 ADAS4_HmiTar2XOut "CDCIPC";
BA_ "sigSecLevel"  SG_ 552 TjaIcaLineSrc "";
BA_ "sigExplanation"  SG_ 552 TjaIcaLineSrc "CDCIPC";
BA_ "sigSecLevel"  SG_ 552 ADAS4_HmiTar2YOut "";
BA_ "sigExplanation"  SG_ 552 ADAS4_HmiTar2YOut "CDCIPC";
BA_ "sigSecLevel"  SG_ 552 ADAS4_HmiTar3YOut "";
BA_ "sigExplanation"  SG_ 552 ADAS4_HmiTar3YOut "CDCIPC";
BA_ "sigSecLevel"  SG_ 552 ADAS4_HmiTar3XOut "";
BA_ "sigExplanation"  SG_ 552 ADAS4_HmiTar3XOut "CDCIPC";
BA_ "sigSecLevel"  SG_ 552 ADAS4_HmiTar5Typ "";
BA_ "sigExplanation"  SG_ 552 ADAS4_HmiTar5Typ "CDCIPC";
BA_ "sigSecLevel"  SG_ 552 ADAS5_HmiTar4XOut "";
BA_ "sigExplanation"  SG_ 552 ADAS5_HmiTar4XOut "CDCIPC";
BA_ "sigSecLevel"  SG_ 552 ADAS4_HmiTar4YOut "";
BA_ "sigExplanation"  SG_ 552 ADAS4_HmiTar4YOut "CDCIPC";
BA_ "sigSecLevel"  SG_ 552 ADAS4_HmiTar5YOut "";
BA_ "sigExplanation"  SG_ 552 ADAS4_HmiTar5YOut "CDCIPC";
BA_ "sigSecLevel"  SG_ 552 ADAS4_HmiTar5XOut "";
BA_ "sigExplanation"  SG_ 552 ADAS4_HmiTar5XOut "CDCIPC";
BA_ "sigSecLevel"  SG_ 552 ADAS4_HmiTar6Typ "";
BA_ "sigExplanation"  SG_ 552 ADAS4_HmiTar6Typ "CDCIPC";
BA_ "sigSecLevel"  SG_ 552 ADAS4_HmiTar6XOut "";
BA_ "sigExplanation"  SG_ 552 ADAS4_HmiTar6XOut "CDCIPC";
BA_ "sigSecLevel"  SG_ 552 ADAS4_HmiTar6YOut "";
BA_ "sigExplanation"  SG_ 552 ADAS4_HmiTar6YOut "CDCIPC";
BA_ "DiagState" BO_ 2015 1;
BA_ "DiagResponse" BO_ 2015 1;
BA_ "GenMsgSendType" BO_ 2015 1;
BA_ "VFrameFormat" BO_ 2015 14;
BA_ "GenMsgCycleTime" BO_ 585 20;
BA_ "VFrameFormat" BO_ 585 14;
BA_ "sigSecLevel"  SG_ 585 RemPrkgReq "";
BA_ "sigExplanation"  SG_ 585 RemPrkgReq "BLE";
BA_ "sigSecLevel"  SG_ 585 ApaAbordReason "";
BA_ "sigConfig"  SG_ 585 ApaAbordReason "tsp";
BA_ "sigSecLevel"  SG_ 585 ApaSts "";
BA_ "sigConfig"  SG_ 585 ApaSts "tsp";
BA_ "sigExplanation"  SG_ 585 ApaSts "PDCU，FDCA, cmrr,BDC,IDS";
BA_ "sigSecLevel"  SG_ 585 RpaSts "";
BA_ "sigConfig"  SG_ 585 RpaSts "tsp";
BA_ "sigExplanation"  SG_ 585 RpaSts "cmrr,BDC,BLE";
BA_ "sigSecLevel"  SG_ 585 APA_0x249_St_ParkingOutMode "";
BA_ "sigExplanation"  SG_ 585 APA_0x249_St_ParkingOutMode "BDC";
BA_ "sigSecLevel"  SG_ 585 APA_0x249_St_ParkingInMode "";
BA_ "sigExplanation"  SG_ 585 APA_0x249_St_ParkingInMode "BDC";
BA_ "sigSecLevel"  SG_ 585 ApaParkOutDirSts "";
BA_ "sigExplanation"  SG_ 585 ApaParkOutDirSts "BLE";
BA_ "sigSecLevel"  SG_ 585 RpaTxtDisp "";
BA_ "sigConfig"  SG_ 585 RpaTxtDisp "tsp";
BA_ "sigExplanation"  SG_ 585 RpaTxtDisp "BLE";
BA_ "sigSecLevel"  SG_ 585 DirHalfLeAvl "";
BA_ "sigExplanation"  SG_ 585 DirHalfLeAvl "BLE";
BA_ "sigSecLevel"  SG_ 585 DirHalfRiAvl "";
BA_ "sigExplanation"  SG_ 585 DirHalfRiAvl "BLE";
BA_ "sigSecLevel"  SG_ 585 DirVertFwdAvl "";
BA_ "sigExplanation"  SG_ 585 DirVertFwdAvl "BLE";
BA_ "sigSecLevel"  SG_ 585 DirVertBwdAvl "";
BA_ "sigExplanation"  SG_ 585 DirVertBwdAvl "BLE";
BA_ "sigSecLevel"  SG_ 585 DirVertHdLeAvl "";
BA_ "sigExplanation"  SG_ 585 DirVertHdLeAvl "BLE";
BA_ "sigSecLevel"  SG_ 585 DirVertHdRiAvl "";
BA_ "sigExplanation"  SG_ 585 DirVertHdRiAvl "BLE";
BA_ "sigSecLevel"  SG_ 585 DirVertTrLeAvl "";
BA_ "sigExplanation"  SG_ 585 DirVertTrLeAvl "BLE";
BA_ "sigSecLevel"  SG_ 585 DirVertTrRiAvl "";
BA_ "sigExplanation"  SG_ 585 DirVertTrRiAvl "BLE";
BA_ "sigDespEng"  SG_ 585 ApaVehModStsFb "APA_St_VehicleMode：APA接收到车辆模式信号后返回的状态信号";
BA_ "sigSecLevel"  SG_ 585 ApaVehModStsFb "";
BA_ "sigExplanation"  SG_ 585 ApaVehModStsFb "BDC";
BA_ "sigSecLevel"  SG_ 585 ApaUnfoldMirror "";
BA_ "sigExplanation"  SG_ 585 ApaUnfoldMirror "BDC";
BA_ "sigSecLevel"  SG_ 585 APA_HazardWarningLightsReq "";
BA_ "sigExplanation"  SG_ 585 APA_HazardWarningLightsReq "BDC";
BA_ "sigSecLevel"  SG_ 585 ApaSuspendReason "";
BA_ "sigConfig"  SG_ 585 ApaSuspendReason "tsp";
BA_ "sigSecLevel"  SG_ 585 APA_0x249_RollingCounter "";
BA_ "sigExplanation"  SG_ 585 APA_0x249_RollingCounter "cmrr,BLE,IDS";
BA_ "sigSecLevel"  SG_ 585 APA_0x249_Checksum "";
BA_ "sigExplanation"  SG_ 585 APA_0x249_Checksum "cmrr,BLE,IDS";
BA_ "GenMsgCycleTime" BO_ 658 100;
BA_ "VFrameFormat" BO_ 658 14;
BA_ "sigSecLevel"  SG_ 658 ApaDispReq "";
BA_ "sigConfig"  SG_ 658 ApaDispReq "tsp";
BA_ "sigSecLevel"  SG_ 658 ApaParkModSts "";
BA_ "sigSecLevel"  SG_ 658 ApaParkInSlotSts "";
BA_ "sigSecLevel"  SG_ 658 ApaTragParkSetSts "";
BA_ "sigSecLevel"  SG_ 658 ApaVoicBrdtSts "";
BA_ "sigSecLevel"  SG_ 658 ApaParkStrtSts "";
BA_ "sigSecLevel"  SG_ 658 ApaPathSts "";
BA_ "sigSecLevel"  SG_ 658 ApaVoicBrdtReq "";
BA_ "sigSecLevel"  SG_ 658 ApaTragParkSts "";
BA_ "sigConfig"  SG_ 658 ApaTragParkSts "tsp";
BA_ "sigSecLevel"  SG_ 658 SlotAutoSearchSts "";
BA_ "sigSecLevel"  SG_ 658 ApaCurPahNrRate "";
BA_ "sigSecLevel"  SG_ 658 RpaDstSetSts "";
BA_ "sigSecLevel"  SG_ 658 ApaRemnDst "";
BA_ "sigSecLevel"  SG_ 658 OperToutExitSetSts "";
BA_ "sigSecLevel"  SG_ 658 Apaparkout "";
BA_ "sigSecLevel"  SG_ 658 CustSelSlot "";
BA_ "sigSecLevel"  SG_ 658 ApaParkin "";
BA_ "sigSecLevel"  SG_ 658 AvmFuncSts "";
BA_ "sigSecLevel"  SG_ 658 ApaFuncSts "";
BA_ "sigSecLevel"  SG_ 658 CustSlecSlotSts "";
BA_ "sigSecLevel"  SG_ 658 ApaTrackingFuncSts "";
BA_ "sigSecLevel"  SG_ 658 ApaSysFaild "";
BA_ "sigSecLevel"  SG_ 658 AvmMoveObjDetnSts "";
VAL_ 547 AdasHmiNeighboringObj9XOut 255 "distance (positive values are front, negative values rear from ego center)" 254 "distance (positive values are front, negative values rear from ego center)" 253 "distance (positive values are front, negative values rear from ego center)" 252 "distance (positive values are front, negative values rear from ego center)" 251 "distance (positive values are front, negative values rear from ego center)" 250 "distance (positive values are front, negative values rear from ego center)" 249 "distance (positive values are front, negative values rear from ego center)" 248 "distance (positive values are front, negative values rear from ego center)" 247 "distance (positive values are front, negative values rear from ego center)" 246 "distance (positive values are front, negative values rear from ego center)" 245 "distance (positive values are front, negative values rear from ego center)" 244 "distance (positive values are front, negative values rear from ego center)" 243 "distance (positive values are front, negative values rear from ego center)" 242 "distance (positive values are front, negative values rear from ego center)" 241 "distance (positive values are front, negative values rear from ego center)" 240 "distance (positive values are front, negative values rear from ego center)" 239 "distance (positive values are front, negative values rear from ego center)" 238 "distance (positive values are front, negative values rear from ego center)" 237 "distance (positive values are front, negative values rear from ego center)" 236 "distance (positive values are front, negative values rear from ego center)" 235 "distance (positive values are front, negative values rear from ego center)" 234 "distance (positive values are front, negative values rear from ego center)" 233 "distance (positive values are front, negative values rear from ego center)" 232 "distance (positive values are front, negative values rear from ego center)" 231 "distance (positive values are front, negative values rear from ego center)" 230 "distance (positive values are front, negative values rear from ego center)" 229 "distance (positive values are front, negative values rear from ego center)" 228 "distance (positive values are front, negative values rear from ego center)" 227 "distance (positive values are front, negative values rear from ego center)" 226 "distance (positive values are front, negative values rear from ego center)" 225 "distance (positive values are front, negative values rear from ego center)" 224 "distance (positive values are front, negative values rear from ego center)" 223 "distance (positive values are front, negative values rear from ego center)" 222 "distance (positive values are front, negative values rear from ego center)" 221 "distance (positive values are front, negative values rear from ego center)" 220 "distance (positive values are front, negative values rear from ego center)" 219 "distance (positive values are front, negative values rear from ego center)" 218 "distance (positive values are front, negative values rear from ego center)" 217 "distance (positive values are front, negative values rear from ego center)" 216 "distance (positive values are front, negative values rear from ego center)" 215 "distance (positive values are front, negative values rear from ego center)" 214 "distance (positive values are front, negative values rear from ego center)" 213 "distance (positive values are front, negative values rear from ego center)" 212 "distance (positive values are front, negative values rear from ego center)" 211 "distance (positive values are front, negative values rear from ego center)" 210 "distance (positive values are front, negative values rear from ego center)" 209 "distance (positive values are front, negative values rear from ego center)" 208 "distance (positive values are front, negative values rear from ego center)" 207 "distance (positive values are front, negative values rear from ego center)" 206 "distance (positive values are front, negative values rear from ego center)" 205 "distance (positive values are front, negative values rear from ego center)" 204 "distance (positive values are front, negative values rear from ego center)" 203 "distance (positive values are front, negative values rear from ego center)" 202 "distance (positive values are front, negative values rear from ego center)" 201 "distance (positive values are front, negative values rear from ego center)" 200 "distance (positive values are front, negative values rear from ego center)" 199 "distance (positive values are front, negative values rear from ego center)" 198 "distance (positive values are front, negative values rear from ego center)" 197 "distance (positive values are front, negative values rear from ego center)" 196 "distance (positive values are front, negative values rear from ego center)" 195 "distance (positive values are front, negative values rear from ego center)" 194 "distance (positive values are front, negative values rear from ego center)" 193 "distance (positive values are front, negative values rear from ego center)" 192 "distance (positive values are front, negative values rear from ego center)" 191 "distance (positive values are front, negative values rear from ego center)" 190 "distance (positive values are front, negative values rear from ego center)" 189 "distance (positive values are front, negative values rear from ego center)" 188 "distance (positive values are front, negative values rear from ego center)" 187 "distance (positive values are front, negative values rear from ego center)" 186 "distance (positive values are front, negative values rear from ego center)" 185 "distance (positive values are front, negative values rear from ego center)" 184 "distance (positive values are front, negative values rear from ego center)" 183 "distance (positive values are front, negative values rear from ego center)" 182 "distance (positive values are front, negative values rear from ego center)" 181 "distance (positive values are front, negative values rear from ego center)" 180 "distance (positive values are front, negative values rear from ego center)" 179 "distance (positive values are front, negative values rear from ego center)" 178 "distance (positive values are front, negative values rear from ego center)" 177 "distance (positive values are front, negative values rear from ego center)" 176 "distance (positive values are front, negative values rear from ego center)" 175 "distance (positive values are front, negative values rear from ego center)" 174 "distance (positive values are front, negative values rear from ego center)" 173 "distance (positive values are front, negative values rear from ego center)" 172 "distance (positive values are front, negative values rear from ego center)" 171 "distance (positive values are front, negative values rear from ego center)" 170 "distance (positive values are front, negative values rear from ego center)" 169 "distance (positive values are front, negative values rear from ego center)" 168 "distance (positive values are front, negative values rear from ego center)" 167 "distance (positive values are front, negative values rear from ego center)" 166 "distance (positive values are front, negative values rear from ego center)" 165 "distance (positive values are front, negative values rear from ego center)" 164 "distance (positive values are front, negative values rear from ego center)" 163 "distance (positive values are front, negative values rear from ego center)" 162 "distance (positive values are front, negative values rear from ego center)" 161 "distance (positive values are front, negative values rear from ego center)" 160 "distance (positive values are front, negative values rear from ego center)" 159 "distance (positive values are front, negative values rear from ego center)" 158 "distance (positive values are front, negative values rear from ego center)" 157 "distance (positive values are front, negative values rear from ego center)" 156 "distance (positive values are front, negative values rear from ego center)" 155 "distance (positive values are front, negative values rear from ego center)" 154 "distance (positive values are front, negative values rear from ego center)" 153 "distance (positive values are front, negative values rear from ego center)" 152 "distance (positive values are front, negative values rear from ego center)" 151 "distance (positive values are front, negative values rear from ego center)" 150 "distance (positive values are front, negative values rear from ego center)" 149 "distance (positive values are front, negative values rear from ego center)" 148 "distance (positive values are front, negative values rear from ego center)" 147 "distance (positive values are front, negative values rear from ego center)" 146 "distance (positive values are front, negative values rear from ego center)" 145 "distance (positive values are front, negative values rear from ego center)" 144 "distance (positive values are front, negative values rear from ego center)" 143 "distance (positive values are front, negative values rear from ego center)" 142 "distance (positive values are front, negative values rear from ego center)" 141 "distance (positive values are front, negative values rear from ego center)" 140 "distance (positive values are front, negative values rear from ego center)" 139 "distance (positive values are front, negative values rear from ego center)" 138 "distance (positive values are front, negative values rear from ego center)" 137 "distance (positive values are front, negative values rear from ego center)" 136 "distance (positive values are front, negative values rear from ego center)" 135 "distance (positive values are front, negative values rear from ego center)" 134 "distance (positive values are front, negative values rear from ego center)" 133 "distance (positive values are front, negative values rear from ego center)" 132 "distance (positive values are front, negative values rear from ego center)" 131 "distance (positive values are front, negative values rear from ego center)" 130 "distance (positive values are front, negative values rear from ego center)" 129 "distance (positive values are front, negative values rear from ego center)" 128 "distance (positive values are front, negative values rear from ego center)" 127 "distance (positive values are front, negative values rear from ego center)" 126 "distance (positive values are front, negative values rear from ego center)" 125 "distance (positive values are front, negative values rear from ego center)" 124 "distance (positive values are front, negative values rear from ego center)" 123 "distance (positive values are front, negative values rear from ego center)" 122 "distance (positive values are front, negative values rear from ego center)" 121 "distance (positive values are front, negative values rear from ego center)" 120 "distance (positive values are front, negative values rear from ego center)" 119 "distance (positive values are front, negative values rear from ego center)" 118 "distance (positive values are front, negative values rear from ego center)" 117 "distance (positive values are front, negative values rear from ego center)" 116 "distance (positive values are front, negative values rear from ego center)" 115 "distance (positive values are front, negative values rear from ego center)" 114 "distance (positive values are front, negative values rear from ego center)" 113 "distance (positive values are front, negative values rear from ego center)" 112 "distance (positive values are front, negative values rear from ego center)" 111 "distance (positive values are front, negative values rear from ego center)" 110 "distance (positive values are front, negative values rear from ego center)" 109 "distance (positive values are front, negative values rear from ego center)" 108 "distance (positive values are front, negative values rear from ego center)" 107 "distance (positive values are front, negative values rear from ego center)" 106 "distance (positive values are front, negative values rear from ego center)" 105 "distance (positive values are front, negative values rear from ego center)" 104 "distance (positive values are front, negative values rear from ego center)" 103 "distance (positive values are front, negative values rear from ego center)" 102 "distance (positive values are front, negative values rear from ego center)" 101 "distance (positive values are front, negative values rear from ego center)" 100 "distance (positive values are front, negative values rear from ego center)" 99 "distance (positive values are front, negative values rear from ego center)" 98 "distance (positive values are front, negative values rear from ego center)" 97 "distance (positive values are front, negative values rear from ego center)" 96 "distance (positive values are front, negative values rear from ego center)" 95 "distance (positive values are front, negative values rear from ego center)" 94 "distance (positive values are front, negative values rear from ego center)" 93 "distance (positive values are front, negative values rear from ego center)" 92 "distance (positive values are front, negative values rear from ego center)" 91 "distance (positive values are front, negative values rear from ego center)" 90 "distance (positive values are front, negative values rear from ego center)" 89 "distance (positive values are front, negative values rear from ego center)" 88 "distance (positive values are front, negative values rear from ego center)" 87 "distance (positive values are front, negative values rear from ego center)" 86 "distance (positive values are front, negative values rear from ego center)" 85 "distance (positive values are front, negative values rear from ego center)" 84 "distance (positive values are front, negative values rear from ego center)" 83 "distance (positive values are front, negative values rear from ego center)" 82 "distance (positive values are front, negative values rear from ego center)" 81 "distance (positive values are front, negative values rear from ego center)" 80 "distance (positive values are front, negative values rear from ego center)" 79 "distance (positive values are front, negative values rear from ego center)" 78 "distance (positive values are front, negative values rear from ego center)" 77 "distance (positive values are front, negative values rear from ego center)" 76 "distance (positive values are front, negative values rear from ego center)" 75 "distance (positive values are front, negative values rear from ego center)" 74 "distance (positive values are front, negative values rear from ego center)" 73 "distance (positive values are front, negative values rear from ego center)" 72 "distance (positive values are front, negative values rear from ego center)" 71 "distance (positive values are front, negative values rear from ego center)" 70 "distance (positive values are front, negative values rear from ego center)" 69 "distance (positive values are front, negative values rear from ego center)" 68 "distance (positive values are front, negative values rear from ego center)" 67 "distance (positive values are front, negative values rear from ego center)" 66 "distance (positive values are front, negative values rear from ego center)" 65 "distance (positive values are front, negative values rear from ego center)" 64 "distance (positive values are front, negative values rear from ego center)" 63 "distance (positive values are front, negative values rear from ego center)" 62 "distance (positive values are front, negative values rear from ego center)" 61 "distance (positive values are front, negative values rear from ego center)" 60 "distance (positive values are front, negative values rear from ego center)" 59 "distance (positive values are front, negative values rear from ego center)" 58 "distance (positive values are front, negative values rear from ego center)" 57 "distance (positive values are front, negative values rear from ego center)" 56 "distance (positive values are front, negative values rear from ego center)" 55 "distance (positive values are front, negative values rear from ego center)" 54 "distance (positive values are front, negative values rear from ego center)" 53 "distance (positive values are front, negative values rear from ego center)" 52 "distance (positive values are front, negative values rear from ego center)" 51 "distance (positive values are front, negative values rear from ego center)" 50 "distance (positive values are front, negative values rear from ego center)" 49 "distance (positive values are front, negative values rear from ego center)" 48 "distance (positive values are front, negative values rear from ego center)" 47 "distance (positive values are front, negative values rear from ego center)" 46 "distance (positive values are front, negative values rear from ego center)" 45 "distance (positive values are front, negative values rear from ego center)" 44 "distance (positive values are front, negative values rear from ego center)" 43 "distance (positive values are front, negative values rear from ego center)" 42 "distance (positive values are front, negative values rear from ego center)" 41 "distance (positive values are front, negative values rear from ego center)" 40 "distance (positive values are front, negative values rear from ego center)" 39 "distance (positive values are front, negative values rear from ego center)" 38 "distance (positive values are front, negative values rear from ego center)" 37 "distance (positive values are front, negative values rear from ego center)" 36 "distance (positive values are front, negative values rear from ego center)" 35 "distance (positive values are front, negative values rear from ego center)" 34 "distance (positive values are front, negative values rear from ego center)" 33 "distance (positive values are front, negative values rear from ego center)" 32 "distance (positive values are front, negative values rear from ego center)" 31 "distance (positive values are front, negative values rear from ego center)" 30 "distance (positive values are front, negative values rear from ego center)" 29 "distance (positive values are front, negative values rear from ego center)" 28 "distance (positive values are front, negative values rear from ego center)" 27 "distance (positive values are front, negative values rear from ego center)" 26 "distance (positive values are front, negative values rear from ego center)" 25 "distance (positive values are front, negative values rear from ego center)" 24 "distance (positive values are front, negative values rear from ego center)" 23 "distance (positive values are front, negative values rear from ego center)" 22 "distance (positive values are front, negative values rear from ego center)" 21 "distance (positive values are front, negative values rear from ego center)" 20 "distance (positive values are front, negative values rear from ego center)" 19 "distance (positive values are front, negative values rear from ego center)" 18 "distance (positive values are front, negative values rear from ego center)" 17 "distance (positive values are front, negative values rear from ego center)" 16 "distance (positive values are front, negative values rear from ego center)" 15 "distance (positive values are front, negative values rear from ego center)" 14 "distance (positive values are front, negative values rear from ego center)" 13 "distance (positive values are front, negative values rear from ego center)" 12 "distance (positive values are front, negative values rear from ego center)" 11 "distance (positive values are front, negative values rear from ego center)" 10 "distance (positive values are front, negative values rear from ego center)" 9 "distance (positive values are front, negative values rear from ego center)" 8 "distance (positive values are front, negative values rear from ego center)" 7 "distance (positive values are front, negative values rear from ego center)" 6 "distance (positive values are front, negative values rear from ego center)" 5 "distance (positive values are front, negative values rear from ego center)" 4 "distance (positive values are front, negative values rear from ego center)" 3 "distance (positive values are front, negative values rear from ego center)" 2 "distance (positive values are front, negative values rear from ego center)" 1 "distance (positive values are front, negative values rear from ego center)" 0 "distance (positive values are front, negative values rear from ego center)" ;
VAL_ 547 AdasHmiNeighboringObj9YOut 255 "distance right from ego center" 254 "distance right from ego center" 253 "distance right from ego center" 252 "distance right from ego center" 251 "distance right from ego center" 250 "distance right from ego center" 249 "distance right from ego center" 248 "distance right from ego center" 247 "distance right from ego center" 246 "distance right from ego center" 245 "distance right from ego center" 244 "distance right from ego center" 243 "distance right from ego center" 242 "distance right from ego center" 241 "distance right from ego center" 240 "distance right from ego center" 239 "distance right from ego center" 238 "distance right from ego center" 237 "distance right from ego center" 236 "distance right from ego center" 235 "distance right from ego center" 234 "distance right from ego center" 233 "distance right from ego center" 232 "distance right from ego center" 231 "distance right from ego center" 230 "distance right from ego center" 229 "distance right from ego center" 228 "distance right from ego center" 227 "distance right from ego center" 226 "distance right from ego center" 225 "distance right from ego center" 224 "distance right from ego center" 223 "distance right from ego center" 222 "distance right from ego center" 221 "distance right from ego center" 220 "distance right from ego center" 219 "distance right from ego center" 218 "distance right from ego center" 217 "distance right from ego center" 216 "distance right from ego center" 215 "distance right from ego center" 214 "distance right from ego center" 213 "distance right from ego center" 212 "distance right from ego center" 211 "distance right from ego center" 210 "distance right from ego center" 209 "distance right from ego center" 208 "distance right from ego center" 207 "distance right from ego center" 206 "distance right from ego center" 205 "distance right from ego center" 204 "distance right from ego center" 203 "distance right from ego center" 202 "distance right from ego center" 201 "distance right from ego center" 200 "distance right from ego center" 199 "distance right from ego center" 198 "distance right from ego center" 197 "distance right from ego center" 196 "distance right from ego center" 195 "distance right from ego center" 194 "distance right from ego center" 193 "distance right from ego center" 192 "distance right from ego center" 191 "distance right from ego center" 190 "distance right from ego center" 189 "distance right from ego center" 188 "distance right from ego center" 187 "distance right from ego center" 186 "distance right from ego center" 185 "distance right from ego center" 184 "distance right from ego center" 183 "distance right from ego center" 182 "distance right from ego center" 181 "distance right from ego center" 180 "distance right from ego center" 179 "distance right from ego center" 178 "distance right from ego center" 177 "distance right from ego center" 176 "distance right from ego center" 175 "distance right from ego center" 174 "distance right from ego center" 173 "distance right from ego center" 172 "distance right from ego center" 171 "distance right from ego center" 170 "distance right from ego center" 169 "distance right from ego center" 168 "distance right from ego center" 167 "distance right from ego center" 166 "distance right from ego center" 165 "distance right from ego center" 164 "distance right from ego center" 163 "distance right from ego center" 162 "distance right from ego center" 161 "distance right from ego center" 160 "distance right from ego center" 159 "distance right from ego center" 158 "distance right from ego center" 157 "distance right from ego center" 156 "distance right from ego center" 155 "distance right from ego center" 154 "distance right from ego center" 153 "distance right from ego center" 152 "distance right from ego center" 151 "distance right from ego center" 150 "distance right from ego center" 149 "distance right from ego center" 148 "distance right from ego center" 147 "distance right from ego center" 146 "distance right from ego center" 145 "distance right from ego center" 144 "distance right from ego center" 143 "distance right from ego center" 142 "distance right from ego center" 141 "distance right from ego center" 140 "distance right from ego center" 139 "distance right from ego center" 138 "distance right from ego center" 137 "distance right from ego center" 136 "distance right from ego center" 135 "distance right from ego center" 134 "distance right from ego center" 133 "distance right from ego center" 132 "distance right from ego center" 131 "distance right from ego center" 130 "distance right from ego center" 129 "distance right from ego center" 128 "distance right from ego center" 127 "distance left from ego center" 126 "distance left from ego center" 125 "distance left from ego center" 124 "distance left from ego center" 123 "distance left from ego center" 122 "distance left from ego center" 121 "distance left from ego center" 120 "distance left from ego center" 119 "distance left from ego center" 118 "distance left from ego center" 117 "distance left from ego center" 116 "distance left from ego center" 115 "distance left from ego center" 114 "distance left from ego center" 113 "distance left from ego center" 112 "distance left from ego center" 111 "distance left from ego center" 110 "distance left from ego center" 109 "distance left from ego center" 108 "distance left from ego center" 107 "distance left from ego center" 106 "distance left from ego center" 105 "distance left from ego center" 104 "distance left from ego center" 103 "distance left from ego center" 102 "distance left from ego center" 101 "distance left from ego center" 100 "distance left from ego center" 99 "distance left from ego center" 98 "distance left from ego center" 97 "distance left from ego center" 96 "distance left from ego center" 95 "distance left from ego center" 94 "distance left from ego center" 93 "distance left from ego center" 92 "distance left from ego center" 91 "distance left from ego center" 90 "distance left from ego center" 89 "distance left from ego center" 88 "distance left from ego center" 87 "distance left from ego center" 86 "distance left from ego center" 85 "distance left from ego center" 84 "distance left from ego center" 83 "distance left from ego center" 82 "distance left from ego center" 81 "distance left from ego center" 80 "distance left from ego center" 79 "distance left from ego center" 78 "distance left from ego center" 77 "distance left from ego center" 76 "distance left from ego center" 75 "distance left from ego center" 74 "distance left from ego center" 73 "distance left from ego center" 72 "distance left from ego center" 71 "distance left from ego center" 70 "distance left from ego center" 69 "distance left from ego center" 68 "distance left from ego center" 67 "distance left from ego center" 66 "distance left from ego center" 65 "distance left from ego center" 64 "distance left from ego center" 63 "distance left from ego center" 62 "distance left from ego center" 61 "distance left from ego center" 60 "distance left from ego center" 59 "distance left from ego center" 58 "distance left from ego center" 57 "distance left from ego center" 56 "distance left from ego center" 55 "distance left from ego center" 54 "distance left from ego center" 53 "distance left from ego center" 52 "distance left from ego center" 51 "distance left from ego center" 50 "distance left from ego center" 49 "distance left from ego center" 48 "distance left from ego center" 47 "distance left from ego center" 46 "distance left from ego center" 45 "distance left from ego center" 44 "distance left from ego center" 43 "distance left from ego center" 42 "distance left from ego center" 41 "distance left from ego center" 40 "distance left from ego center" 39 "distance left from ego center" 38 "distance left from ego center" 37 "distance left from ego center" 36 "distance left from ego center" 35 "distance left from ego center" 34 "distance left from ego center" 33 "distance left from ego center" 32 "distance left from ego center" 31 "distance left from ego center" 30 "distance left from ego center" 29 "distance left from ego center" 28 "distance left from ego center" 27 "distance left from ego center" 26 "distance left from ego center" 25 "distance left from ego center" 24 "distance left from ego center" 23 "distance left from ego center" 22 "distance left from ego center" 21 "distance left from ego center" 20 "distance left from ego center" 19 "distance left from ego center" 18 "distance left from ego center" 17 "distance left from ego center" 16 "distance left from ego center" 15 "distance left from ego center" 14 "distance left from ego center" 13 "distance left from ego center" 12 "distance left from ego center" 11 "distance left from ego center" 10 "distance left from ego center" 9 "distance left from ego center" 8 "distance left from ego center" 7 "distance left from ego center" 6 "distance left from ego center" 5 "distance left from ego center" 4 "distance left from ego center" 3 "distance left from ego center" 2 "distance left from ego center" 1 "distance left from ego center" 0 "distance left from ego center" ;
VAL_ 547 AdasHmiNeighboringObj10ObjTyp 7 "reserved" 6 "three-wheeler 三轮车" 5 "bus 公共汽车" 4 "pedestrian 行人" 3 "motorbike/Bicycle 二轮车" 2 "truck 卡车" 1 "passenger car 小轿车" 0 "Object not present" ;
VAL_ 547 AdasHmiNeighboringObj10XOut 255 "distance (positive values are front, negative values rear from ego center)" 254 "distance (positive values are front, negative values rear from ego center)" 253 "distance (positive values are front, negative values rear from ego center)" 252 "distance (positive values are front, negative values rear from ego center)" 251 "distance (positive values are front, negative values rear from ego center)" 250 "distance (positive values are front, negative values rear from ego center)" 249 "distance (positive values are front, negative values rear from ego center)" 248 "distance (positive values are front, negative values rear from ego center)" 247 "distance (positive values are front, negative values rear from ego center)" 246 "distance (positive values are front, negative values rear from ego center)" 245 "distance (positive values are front, negative values rear from ego center)" 244 "distance (positive values are front, negative values rear from ego center)" 243 "distance (positive values are front, negative values rear from ego center)" 242 "distance (positive values are front, negative values rear from ego center)" 241 "distance (positive values are front, negative values rear from ego center)" 240 "distance (positive values are front, negative values rear from ego center)" 239 "distance (positive values are front, negative values rear from ego center)" 238 "distance (positive values are front, negative values rear from ego center)" 237 "distance (positive values are front, negative values rear from ego center)" 236 "distance (positive values are front, negative values rear from ego center)" 235 "distance (positive values are front, negative values rear from ego center)" 234 "distance (positive values are front, negative values rear from ego center)" 233 "distance (positive values are front, negative values rear from ego center)" 232 "distance (positive values are front, negative values rear from ego center)" 231 "distance (positive values are front, negative values rear from ego center)" 230 "distance (positive values are front, negative values rear from ego center)" 229 "distance (positive values are front, negative values rear from ego center)" 228 "distance (positive values are front, negative values rear from ego center)" 227 "distance (positive values are front, negative values rear from ego center)" 226 "distance (positive values are front, negative values rear from ego center)" 225 "distance (positive values are front, negative values rear from ego center)" 224 "distance (positive values are front, negative values rear from ego center)" 223 "distance (positive values are front, negative values rear from ego center)" 222 "distance (positive values are front, negative values rear from ego center)" 221 "distance (positive values are front, negative values rear from ego center)" 220 "distance (positive values are front, negative values rear from ego center)" 219 "distance (positive values are front, negative values rear from ego center)" 218 "distance (positive values are front, negative values rear from ego center)" 217 "distance (positive values are front, negative values rear from ego center)" 216 "distance (positive values are front, negative values rear from ego center)" 215 "distance (positive values are front, negative values rear from ego center)" 214 "distance (positive values are front, negative values rear from ego center)" 213 "distance (positive values are front, negative values rear from ego center)" 212 "distance (positive values are front, negative values rear from ego center)" 211 "distance (positive values are front, negative values rear from ego center)" 210 "distance (positive values are front, negative values rear from ego center)" 209 "distance (positive values are front, negative values rear from ego center)" 208 "distance (positive values are front, negative values rear from ego center)" 207 "distance (positive values are front, negative values rear from ego center)" 206 "distance (positive values are front, negative values rear from ego center)" 205 "distance (positive values are front, negative values rear from ego center)" 204 "distance (positive values are front, negative values rear from ego center)" 203 "distance (positive values are front, negative values rear from ego center)" 202 "distance (positive values are front, negative values rear from ego center)" 201 "distance (positive values are front, negative values rear from ego center)" 200 "distance (positive values are front, negative values rear from ego center)" 199 "distance (positive values are front, negative values rear from ego center)" 198 "distance (positive values are front, negative values rear from ego center)" 197 "distance (positive values are front, negative values rear from ego center)" 196 "distance (positive values are front, negative values rear from ego center)" 195 "distance (positive values are front, negative values rear from ego center)" 194 "distance (positive values are front, negative values rear from ego center)" 193 "distance (positive values are front, negative values rear from ego center)" 192 "distance (positive values are front, negative values rear from ego center)" 191 "distance (positive values are front, negative values rear from ego center)" 190 "distance (positive values are front, negative values rear from ego center)" 189 "distance (positive values are front, negative values rear from ego center)" 188 "distance (positive values are front, negative values rear from ego center)" 187 "distance (positive values are front, negative values rear from ego center)" 186 "distance (positive values are front, negative values rear from ego center)" 185 "distance (positive values are front, negative values rear from ego center)" 184 "distance (positive values are front, negative values rear from ego center)" 183 "distance (positive values are front, negative values rear from ego center)" 182 "distance (positive values are front, negative values rear from ego center)" 181 "distance (positive values are front, negative values rear from ego center)" 180 "distance (positive values are front, negative values rear from ego center)" 179 "distance (positive values are front, negative values rear from ego center)" 178 "distance (positive values are front, negative values rear from ego center)" 177 "distance (positive values are front, negative values rear from ego center)" 176 "distance (positive values are front, negative values rear from ego center)" 175 "distance (positive values are front, negative values rear from ego center)" 174 "distance (positive values are front, negative values rear from ego center)" 173 "distance (positive values are front, negative values rear from ego center)" 172 "distance (positive values are front, negative values rear from ego center)" 171 "distance (positive values are front, negative values rear from ego center)" 170 "distance (positive values are front, negative values rear from ego center)" 169 "distance (positive values are front, negative values rear from ego center)" 168 "distance (positive values are front, negative values rear from ego center)" 167 "distance (positive values are front, negative values rear from ego center)" 166 "distance (positive values are front, negative values rear from ego center)" 165 "distance (positive values are front, negative values rear from ego center)" 164 "distance (positive values are front, negative values rear from ego center)" 163 "distance (positive values are front, negative values rear from ego center)" 162 "distance (positive values are front, negative values rear from ego center)" 161 "distance (positive values are front, negative values rear from ego center)" 160 "distance (positive values are front, negative values rear from ego center)" 159 "distance (positive values are front, negative values rear from ego center)" 158 "distance (positive values are front, negative values rear from ego center)" 157 "distance (positive values are front, negative values rear from ego center)" 156 "distance (positive values are front, negative values rear from ego center)" 155 "distance (positive values are front, negative values rear from ego center)" 154 "distance (positive values are front, negative values rear from ego center)" 153 "distance (positive values are front, negative values rear from ego center)" 152 "distance (positive values are front, negative values rear from ego center)" 151 "distance (positive values are front, negative values rear from ego center)" 150 "distance (positive values are front, negative values rear from ego center)" 149 "distance (positive values are front, negative values rear from ego center)" 148 "distance (positive values are front, negative values rear from ego center)" 147 "distance (positive values are front, negative values rear from ego center)" 146 "distance (positive values are front, negative values rear from ego center)" 145 "distance (positive values are front, negative values rear from ego center)" 144 "distance (positive values are front, negative values rear from ego center)" 143 "distance (positive values are front, negative values rear from ego center)" 142 "distance (positive values are front, negative values rear from ego center)" 141 "distance (positive values are front, negative values rear from ego center)" 140 "distance (positive values are front, negative values rear from ego center)" 139 "distance (positive values are front, negative values rear from ego center)" 138 "distance (positive values are front, negative values rear from ego center)" 137 "distance (positive values are front, negative values rear from ego center)" 136 "distance (positive values are front, negative values rear from ego center)" 135 "distance (positive values are front, negative values rear from ego center)" 134 "distance (positive values are front, negative values rear from ego center)" 133 "distance (positive values are front, negative values rear from ego center)" 132 "distance (positive values are front, negative values rear from ego center)" 131 "distance (positive values are front, negative values rear from ego center)" 130 "distance (positive values are front, negative values rear from ego center)" 129 "distance (positive values are front, negative values rear from ego center)" 128 "distance (positive values are front, negative values rear from ego center)" 127 "distance (positive values are front, negative values rear from ego center)" 126 "distance (positive values are front, negative values rear from ego center)" 125 "distance (positive values are front, negative values rear from ego center)" 124 "distance (positive values are front, negative values rear from ego center)" 123 "distance (positive values are front, negative values rear from ego center)" 122 "distance (positive values are front, negative values rear from ego center)" 121 "distance (positive values are front, negative values rear from ego center)" 120 "distance (positive values are front, negative values rear from ego center)" 119 "distance (positive values are front, negative values rear from ego center)" 118 "distance (positive values are front, negative values rear from ego center)" 117 "distance (positive values are front, negative values rear from ego center)" 116 "distance (positive values are front, negative values rear from ego center)" 115 "distance (positive values are front, negative values rear from ego center)" 114 "distance (positive values are front, negative values rear from ego center)" 113 "distance (positive values are front, negative values rear from ego center)" 112 "distance (positive values are front, negative values rear from ego center)" 111 "distance (positive values are front, negative values rear from ego center)" 110 "distance (positive values are front, negative values rear from ego center)" 109 "distance (positive values are front, negative values rear from ego center)" 108 "distance (positive values are front, negative values rear from ego center)" 107 "distance (positive values are front, negative values rear from ego center)" 106 "distance (positive values are front, negative values rear from ego center)" 105 "distance (positive values are front, negative values rear from ego center)" 104 "distance (positive values are front, negative values rear from ego center)" 103 "distance (positive values are front, negative values rear from ego center)" 102 "distance (positive values are front, negative values rear from ego center)" 101 "distance (positive values are front, negative values rear from ego center)" 100 "distance (positive values are front, negative values rear from ego center)" 99 "distance (positive values are front, negative values rear from ego center)" 98 "distance (positive values are front, negative values rear from ego center)" 97 "distance (positive values are front, negative values rear from ego center)" 96 "distance (positive values are front, negative values rear from ego center)" 95 "distance (positive values are front, negative values rear from ego center)" 94 "distance (positive values are front, negative values rear from ego center)" 93 "distance (positive values are front, negative values rear from ego center)" 92 "distance (positive values are front, negative values rear from ego center)" 91 "distance (positive values are front, negative values rear from ego center)" 90 "distance (positive values are front, negative values rear from ego center)" 89 "distance (positive values are front, negative values rear from ego center)" 88 "distance (positive values are front, negative values rear from ego center)" 87 "distance (positive values are front, negative values rear from ego center)" 86 "distance (positive values are front, negative values rear from ego center)" 85 "distance (positive values are front, negative values rear from ego center)" 84 "distance (positive values are front, negative values rear from ego center)" 83 "distance (positive values are front, negative values rear from ego center)" 82 "distance (positive values are front, negative values rear from ego center)" 81 "distance (positive values are front, negative values rear from ego center)" 80 "distance (positive values are front, negative values rear from ego center)" 79 "distance (positive values are front, negative values rear from ego center)" 78 "distance (positive values are front, negative values rear from ego center)" 77 "distance (positive values are front, negative values rear from ego center)" 76 "distance (positive values are front, negative values rear from ego center)" 75 "distance (positive values are front, negative values rear from ego center)" 74 "distance (positive values are front, negative values rear from ego center)" 73 "distance (positive values are front, negative values rear from ego center)" 72 "distance (positive values are front, negative values rear from ego center)" 71 "distance (positive values are front, negative values rear from ego center)" 70 "distance (positive values are front, negative values rear from ego center)" 69 "distance (positive values are front, negative values rear from ego center)" 68 "distance (positive values are front, negative values rear from ego center)" 67 "distance (positive values are front, negative values rear from ego center)" 66 "distance (positive values are front, negative values rear from ego center)" 65 "distance (positive values are front, negative values rear from ego center)" 64 "distance (positive values are front, negative values rear from ego center)" 63 "distance (positive values are front, negative values rear from ego center)" 62 "distance (positive values are front, negative values rear from ego center)" 61 "distance (positive values are front, negative values rear from ego center)" 60 "distance (positive values are front, negative values rear from ego center)" 59 "distance (positive values are front, negative values rear from ego center)" 58 "distance (positive values are front, negative values rear from ego center)" 57 "distance (positive values are front, negative values rear from ego center)" 56 "distance (positive values are front, negative values rear from ego center)" 55 "distance (positive values are front, negative values rear from ego center)" 54 "distance (positive values are front, negative values rear from ego center)" 53 "distance (positive values are front, negative values rear from ego center)" 52 "distance (positive values are front, negative values rear from ego center)" 51 "distance (positive values are front, negative values rear from ego center)" 50 "distance (positive values are front, negative values rear from ego center)" 49 "distance (positive values are front, negative values rear from ego center)" 48 "distance (positive values are front, negative values rear from ego center)" 47 "distance (positive values are front, negative values rear from ego center)" 46 "distance (positive values are front, negative values rear from ego center)" 45 "distance (positive values are front, negative values rear from ego center)" 44 "distance (positive values are front, negative values rear from ego center)" 43 "distance (positive values are front, negative values rear from ego center)" 42 "distance (positive values are front, negative values rear from ego center)" 41 "distance (positive values are front, negative values rear from ego center)" 40 "distance (positive values are front, negative values rear from ego center)" 39 "distance (positive values are front, negative values rear from ego center)" 38 "distance (positive values are front, negative values rear from ego center)" 37 "distance (positive values are front, negative values rear from ego center)" 36 "distance (positive values are front, negative values rear from ego center)" 35 "distance (positive values are front, negative values rear from ego center)" 34 "distance (positive values are front, negative values rear from ego center)" 33 "distance (positive values are front, negative values rear from ego center)" 32 "distance (positive values are front, negative values rear from ego center)" 31 "distance (positive values are front, negative values rear from ego center)" 30 "distance (positive values are front, negative values rear from ego center)" 29 "distance (positive values are front, negative values rear from ego center)" 28 "distance (positive values are front, negative values rear from ego center)" 27 "distance (positive values are front, negative values rear from ego center)" 26 "distance (positive values are front, negative values rear from ego center)" 25 "distance (positive values are front, negative values rear from ego center)" 24 "distance (positive values are front, negative values rear from ego center)" 23 "distance (positive values are front, negative values rear from ego center)" 22 "distance (positive values are front, negative values rear from ego center)" 21 "distance (positive values are front, negative values rear from ego center)" 20 "distance (positive values are front, negative values rear from ego center)" 19 "distance (positive values are front, negative values rear from ego center)" 18 "distance (positive values are front, negative values rear from ego center)" 17 "distance (positive values are front, negative values rear from ego center)" 16 "distance (positive values are front, negative values rear from ego center)" 15 "distance (positive values are front, negative values rear from ego center)" 14 "distance (positive values are front, negative values rear from ego center)" 13 "distance (positive values are front, negative values rear from ego center)" 12 "distance (positive values are front, negative values rear from ego center)" 11 "distance (positive values are front, negative values rear from ego center)" 10 "distance (positive values are front, negative values rear from ego center)" 9 "distance (positive values are front, negative values rear from ego center)" 8 "distance (positive values are front, negative values rear from ego center)" 7 "distance (positive values are front, negative values rear from ego center)" 6 "distance (positive values are front, negative values rear from ego center)" 5 "distance (positive values are front, negative values rear from ego center)" 4 "distance (positive values are front, negative values rear from ego center)" 3 "distance (positive values are front, negative values rear from ego center)" 2 "distance (positive values are front, negative values rear from ego center)" 1 "distance (positive values are front, negative values rear from ego center)" 0 "distance (positive values are front, negative values rear from ego center)" ;
VAL_ 547 AdasHmiNeighboringObj10YOut 255 "distance right from ego center" 254 "distance right from ego center" 253 "distance right from ego center" 252 "distance right from ego center" 251 "distance right from ego center" 250 "distance right from ego center" 249 "distance right from ego center" 248 "distance right from ego center" 247 "distance right from ego center" 246 "distance right from ego center" 245 "distance right from ego center" 244 "distance right from ego center" 243 "distance right from ego center" 242 "distance right from ego center" 241 "distance right from ego center" 240 "distance right from ego center" 239 "distance right from ego center" 238 "distance right from ego center" 237 "distance right from ego center" 236 "distance right from ego center" 235 "distance right from ego center" 234 "distance right from ego center" 233 "distance right from ego center" 232 "distance right from ego center" 231 "distance right from ego center" 230 "distance right from ego center" 229 "distance right from ego center" 228 "distance right from ego center" 227 "distance right from ego center" 226 "distance right from ego center" 225 "distance right from ego center" 224 "distance right from ego center" 223 "distance right from ego center" 222 "distance right from ego center" 221 "distance right from ego center" 220 "distance right from ego center" 219 "distance right from ego center" 218 "distance right from ego center" 217 "distance right from ego center" 216 "distance right from ego center" 215 "distance right from ego center" 214 "distance right from ego center" 213 "distance right from ego center" 212 "distance right from ego center" 211 "distance right from ego center" 210 "distance right from ego center" 209 "distance right from ego center" 208 "distance right from ego center" 207 "distance right from ego center" 206 "distance right from ego center" 205 "distance right from ego center" 204 "distance right from ego center" 203 "distance right from ego center" 202 "distance right from ego center" 201 "distance right from ego center" 200 "distance right from ego center" 199 "distance right from ego center" 198 "distance right from ego center" 197 "distance right from ego center" 196 "distance right from ego center" 195 "distance right from ego center" 194 "distance right from ego center" 193 "distance right from ego center" 192 "distance right from ego center" 191 "distance right from ego center" 190 "distance right from ego center" 189 "distance right from ego center" 188 "distance right from ego center" 187 "distance right from ego center" 186 "distance right from ego center" 185 "distance right from ego center" 184 "distance right from ego center" 183 "distance right from ego center" 182 "distance right from ego center" 181 "distance right from ego center" 180 "distance right from ego center" 179 "distance right from ego center" 178 "distance right from ego center" 177 "distance right from ego center" 176 "distance right from ego center" 175 "distance right from ego center" 174 "distance right from ego center" 173 "distance right from ego center" 172 "distance right from ego center" 171 "distance right from ego center" 170 "distance right from ego center" 169 "distance right from ego center" 168 "distance right from ego center" 167 "distance right from ego center" 166 "distance right from ego center" 165 "distance right from ego center" 164 "distance right from ego center" 163 "distance right from ego center" 162 "distance right from ego center" 161 "distance right from ego center" 160 "distance right from ego center" 159 "distance right from ego center" 158 "distance right from ego center" 157 "distance right from ego center" 156 "distance right from ego center" 155 "distance right from ego center" 154 "distance right from ego center" 153 "distance right from ego center" 152 "distance right from ego center" 151 "distance right from ego center" 150 "distance right from ego center" 149 "distance right from ego center" 148 "distance right from ego center" 147 "distance right from ego center" 146 "distance right from ego center" 145 "distance right from ego center" 144 "distance right from ego center" 143 "distance right from ego center" 142 "distance right from ego center" 141 "distance right from ego center" 140 "distance right from ego center" 139 "distance right from ego center" 138 "distance right from ego center" 137 "distance right from ego center" 136 "distance right from ego center" 135 "distance right from ego center" 134 "distance right from ego center" 133 "distance right from ego center" 132 "distance right from ego center" 131 "distance right from ego center" 130 "distance right from ego center" 129 "distance right from ego center" 128 "distance right from ego center" 127 "distance left from ego center" 126 "distance left from ego center" 125 "distance left from ego center" 124 "distance left from ego center" 123 "distance left from ego center" 122 "distance left from ego center" 121 "distance left from ego center" 120 "distance left from ego center" 119 "distance left from ego center" 118 "distance left from ego center" 117 "distance left from ego center" 116 "distance left from ego center" 115 "distance left from ego center" 114 "distance left from ego center" 113 "distance left from ego center" 112 "distance left from ego center" 111 "distance left from ego center" 110 "distance left from ego center" 109 "distance left from ego center" 108 "distance left from ego center" 107 "distance left from ego center" 106 "distance left from ego center" 105 "distance left from ego center" 104 "distance left from ego center" 103 "distance left from ego center" 102 "distance left from ego center" 101 "distance left from ego center" 100 "distance left from ego center" 99 "distance left from ego center" 98 "distance left from ego center" 97 "distance left from ego center" 96 "distance left from ego center" 95 "distance left from ego center" 94 "distance left from ego center" 93 "distance left from ego center" 92 "distance left from ego center" 91 "distance left from ego center" 90 "distance left from ego center" 89 "distance left from ego center" 88 "distance left from ego center" 87 "distance left from ego center" 86 "distance left from ego center" 85 "distance left from ego center" 84 "distance left from ego center" 83 "distance left from ego center" 82 "distance left from ego center" 81 "distance left from ego center" 80 "distance left from ego center" 79 "distance left from ego center" 78 "distance left from ego center" 77 "distance left from ego center" 76 "distance left from ego center" 75 "distance left from ego center" 74 "distance left from ego center" 73 "distance left from ego center" 72 "distance left from ego center" 71 "distance left from ego center" 70 "distance left from ego center" 69 "distance left from ego center" 68 "distance left from ego center" 67 "distance left from ego center" 66 "distance left from ego center" 65 "distance left from ego center" 64 "distance left from ego center" 63 "distance left from ego center" 62 "distance left from ego center" 61 "distance left from ego center" 60 "distance left from ego center" 59 "distance left from ego center" 58 "distance left from ego center" 57 "distance left from ego center" 56 "distance left from ego center" 55 "distance left from ego center" 54 "distance left from ego center" 53 "distance left from ego center" 52 "distance left from ego center" 51 "distance left from ego center" 50 "distance left from ego center" 49 "distance left from ego center" 48 "distance left from ego center" 47 "distance left from ego center" 46 "distance left from ego center" 45 "distance left from ego center" 44 "distance left from ego center" 43 "distance left from ego center" 42 "distance left from ego center" 41 "distance left from ego center" 40 "distance left from ego center" 39 "distance left from ego center" 38 "distance left from ego center" 37 "distance left from ego center" 36 "distance left from ego center" 35 "distance left from ego center" 34 "distance left from ego center" 33 "distance left from ego center" 32 "distance left from ego center" 31 "distance left from ego center" 30 "distance left from ego center" 29 "distance left from ego center" 28 "distance left from ego center" 27 "distance left from ego center" 26 "distance left from ego center" 25 "distance left from ego center" 24 "distance left from ego center" 23 "distance left from ego center" 22 "distance left from ego center" 21 "distance left from ego center" 20 "distance left from ego center" 19 "distance left from ego center" 18 "distance left from ego center" 17 "distance left from ego center" 16 "distance left from ego center" 15 "distance left from ego center" 14 "distance left from ego center" 13 "distance left from ego center" 12 "distance left from ego center" 11 "distance left from ego center" 10 "distance left from ego center" 9 "distance left from ego center" 8 "distance left from ego center" 7 "distance left from ego center" 6 "distance left from ego center" 5 "distance left from ego center" 4 "distance left from ego center" 3 "distance left from ego center" 2 "distance left from ego center" 1 "distance left from ego center" 0 "distance left from ego center" ;
VAL_ 547 AdasHmiNeighboringObj11ObjTyp 7 "reserved" 6 "three-wheeler 三轮车" 5 "bus 公共汽车" 4 "pedestrian 行人" 3 "motorbike/Bicycle 二轮车" 2 "truck 卡车" 1 "passenger car 小轿车" 0 "Object not present" ;
VAL_ 547 AdasHmiNeighboringObj11XOut 255 "distance (positive values are front, negative values rear from ego center)" 254 "distance (positive values are front, negative values rear from ego center)" 253 "distance (positive values are front, negative values rear from ego center)" 252 "distance (positive values are front, negative values rear from ego center)" 251 "distance (positive values are front, negative values rear from ego center)" 250 "distance (positive values are front, negative values rear from ego center)" 249 "distance (positive values are front, negative values rear from ego center)" 248 "distance (positive values are front, negative values rear from ego center)" 247 "distance (positive values are front, negative values rear from ego center)" 246 "distance (positive values are front, negative values rear from ego center)" 245 "distance (positive values are front, negative values rear from ego center)" 244 "distance (positive values are front, negative values rear from ego center)" 243 "distance (positive values are front, negative values rear from ego center)" 242 "distance (positive values are front, negative values rear from ego center)" 241 "distance (positive values are front, negative values rear from ego center)" 240 "distance (positive values are front, negative values rear from ego center)" 239 "distance (positive values are front, negative values rear from ego center)" 238 "distance (positive values are front, negative values rear from ego center)" 237 "distance (positive values are front, negative values rear from ego center)" 236 "distance (positive values are front, negative values rear from ego center)" 235 "distance (positive values are front, negative values rear from ego center)" 234 "distance (positive values are front, negative values rear from ego center)" 233 "distance (positive values are front, negative values rear from ego center)" 232 "distance (positive values are front, negative values rear from ego center)" 231 "distance (positive values are front, negative values rear from ego center)" 230 "distance (positive values are front, negative values rear from ego center)" 229 "distance (positive values are front, negative values rear from ego center)" 228 "distance (positive values are front, negative values rear from ego center)" 227 "distance (positive values are front, negative values rear from ego center)" 226 "distance (positive values are front, negative values rear from ego center)" 225 "distance (positive values are front, negative values rear from ego center)" 224 "distance (positive values are front, negative values rear from ego center)" 223 "distance (positive values are front, negative values rear from ego center)" 222 "distance (positive values are front, negative values rear from ego center)" 221 "distance (positive values are front, negative values rear from ego center)" 220 "distance (positive values are front, negative values rear from ego center)" 219 "distance (positive values are front, negative values rear from ego center)" 218 "distance (positive values are front, negative values rear from ego center)" 217 "distance (positive values are front, negative values rear from ego center)" 216 "distance (positive values are front, negative values rear from ego center)" 215 "distance (positive values are front, negative values rear from ego center)" 214 "distance (positive values are front, negative values rear from ego center)" 213 "distance (positive values are front, negative values rear from ego center)" 212 "distance (positive values are front, negative values rear from ego center)" 211 "distance (positive values are front, negative values rear from ego center)" 210 "distance (positive values are front, negative values rear from ego center)" 209 "distance (positive values are front, negative values rear from ego center)" 208 "distance (positive values are front, negative values rear from ego center)" 207 "distance (positive values are front, negative values rear from ego center)" 206 "distance (positive values are front, negative values rear from ego center)" 205 "distance (positive values are front, negative values rear from ego center)" 204 "distance (positive values are front, negative values rear from ego center)" 203 "distance (positive values are front, negative values rear from ego center)" 202 "distance (positive values are front, negative values rear from ego center)" 201 "distance (positive values are front, negative values rear from ego center)" 200 "distance (positive values are front, negative values rear from ego center)" 199 "distance (positive values are front, negative values rear from ego center)" 198 "distance (positive values are front, negative values rear from ego center)" 197 "distance (positive values are front, negative values rear from ego center)" 196 "distance (positive values are front, negative values rear from ego center)" 195 "distance (positive values are front, negative values rear from ego center)" 194 "distance (positive values are front, negative values rear from ego center)" 193 "distance (positive values are front, negative values rear from ego center)" 192 "distance (positive values are front, negative values rear from ego center)" 191 "distance (positive values are front, negative values rear from ego center)" 190 "distance (positive values are front, negative values rear from ego center)" 189 "distance (positive values are front, negative values rear from ego center)" 188 "distance (positive values are front, negative values rear from ego center)" 187 "distance (positive values are front, negative values rear from ego center)" 186 "distance (positive values are front, negative values rear from ego center)" 185 "distance (positive values are front, negative values rear from ego center)" 184 "distance (positive values are front, negative values rear from ego center)" 183 "distance (positive values are front, negative values rear from ego center)" 182 "distance (positive values are front, negative values rear from ego center)" 181 "distance (positive values are front, negative values rear from ego center)" 180 "distance (positive values are front, negative values rear from ego center)" 179 "distance (positive values are front, negative values rear from ego center)" 178 "distance (positive values are front, negative values rear from ego center)" 177 "distance (positive values are front, negative values rear from ego center)" 176 "distance (positive values are front, negative values rear from ego center)" 175 "distance (positive values are front, negative values rear from ego center)" 174 "distance (positive values are front, negative values rear from ego center)" 173 "distance (positive values are front, negative values rear from ego center)" 172 "distance (positive values are front, negative values rear from ego center)" 171 "distance (positive values are front, negative values rear from ego center)" 170 "distance (positive values are front, negative values rear from ego center)" 169 "distance (positive values are front, negative values rear from ego center)" 168 "distance (positive values are front, negative values rear from ego center)" 167 "distance (positive values are front, negative values rear from ego center)" 166 "distance (positive values are front, negative values rear from ego center)" 165 "distance (positive values are front, negative values rear from ego center)" 164 "distance (positive values are front, negative values rear from ego center)" 163 "distance (positive values are front, negative values rear from ego center)" 162 "distance (positive values are front, negative values rear from ego center)" 161 "distance (positive values are front, negative values rear from ego center)" 160 "distance (positive values are front, negative values rear from ego center)" 159 "distance (positive values are front, negative values rear from ego center)" 158 "distance (positive values are front, negative values rear from ego center)" 157 "distance (positive values are front, negative values rear from ego center)" 156 "distance (positive values are front, negative values rear from ego center)" 155 "distance (positive values are front, negative values rear from ego center)" 154 "distance (positive values are front, negative values rear from ego center)" 153 "distance (positive values are front, negative values rear from ego center)" 152 "distance (positive values are front, negative values rear from ego center)" 151 "distance (positive values are front, negative values rear from ego center)" 150 "distance (positive values are front, negative values rear from ego center)" 149 "distance (positive values are front, negative values rear from ego center)" 148 "distance (positive values are front, negative values rear from ego center)" 147 "distance (positive values are front, negative values rear from ego center)" 146 "distance (positive values are front, negative values rear from ego center)" 145 "distance (positive values are front, negative values rear from ego center)" 144 "distance (positive values are front, negative values rear from ego center)" 143 "distance (positive values are front, negative values rear from ego center)" 142 "distance (positive values are front, negative values rear from ego center)" 141 "distance (positive values are front, negative values rear from ego center)" 140 "distance (positive values are front, negative values rear from ego center)" 139 "distance (positive values are front, negative values rear from ego center)" 138 "distance (positive values are front, negative values rear from ego center)" 137 "distance (positive values are front, negative values rear from ego center)" 136 "distance (positive values are front, negative values rear from ego center)" 135 "distance (positive values are front, negative values rear from ego center)" 134 "distance (positive values are front, negative values rear from ego center)" 133 "distance (positive values are front, negative values rear from ego center)" 132 "distance (positive values are front, negative values rear from ego center)" 131 "distance (positive values are front, negative values rear from ego center)" 130 "distance (positive values are front, negative values rear from ego center)" 129 "distance (positive values are front, negative values rear from ego center)" 128 "distance (positive values are front, negative values rear from ego center)" 127 "distance (positive values are front, negative values rear from ego center)" 126 "distance (positive values are front, negative values rear from ego center)" 125 "distance (positive values are front, negative values rear from ego center)" 124 "distance (positive values are front, negative values rear from ego center)" 123 "distance (positive values are front, negative values rear from ego center)" 122 "distance (positive values are front, negative values rear from ego center)" 121 "distance (positive values are front, negative values rear from ego center)" 120 "distance (positive values are front, negative values rear from ego center)" 119 "distance (positive values are front, negative values rear from ego center)" 118 "distance (positive values are front, negative values rear from ego center)" 117 "distance (positive values are front, negative values rear from ego center)" 116 "distance (positive values are front, negative values rear from ego center)" 115 "distance (positive values are front, negative values rear from ego center)" 114 "distance (positive values are front, negative values rear from ego center)" 113 "distance (positive values are front, negative values rear from ego center)" 112 "distance (positive values are front, negative values rear from ego center)" 111 "distance (positive values are front, negative values rear from ego center)" 110 "distance (positive values are front, negative values rear from ego center)" 109 "distance (positive values are front, negative values rear from ego center)" 108 "distance (positive values are front, negative values rear from ego center)" 107 "distance (positive values are front, negative values rear from ego center)" 106 "distance (positive values are front, negative values rear from ego center)" 105 "distance (positive values are front, negative values rear from ego center)" 104 "distance (positive values are front, negative values rear from ego center)" 103 "distance (positive values are front, negative values rear from ego center)" 102 "distance (positive values are front, negative values rear from ego center)" 101 "distance (positive values are front, negative values rear from ego center)" 100 "distance (positive values are front, negative values rear from ego center)" 99 "distance (positive values are front, negative values rear from ego center)" 98 "distance (positive values are front, negative values rear from ego center)" 97 "distance (positive values are front, negative values rear from ego center)" 96 "distance (positive values are front, negative values rear from ego center)" 95 "distance (positive values are front, negative values rear from ego center)" 94 "distance (positive values are front, negative values rear from ego center)" 93 "distance (positive values are front, negative values rear from ego center)" 92 "distance (positive values are front, negative values rear from ego center)" 91 "distance (positive values are front, negative values rear from ego center)" 90 "distance (positive values are front, negative values rear from ego center)" 89 "distance (positive values are front, negative values rear from ego center)" 88 "distance (positive values are front, negative values rear from ego center)" 87 "distance (positive values are front, negative values rear from ego center)" 86 "distance (positive values are front, negative values rear from ego center)" 85 "distance (positive values are front, negative values rear from ego center)" 84 "distance (positive values are front, negative values rear from ego center)" 83 "distance (positive values are front, negative values rear from ego center)" 82 "distance (positive values are front, negative values rear from ego center)" 81 "distance (positive values are front, negative values rear from ego center)" 80 "distance (positive values are front, negative values rear from ego center)" 79 "distance (positive values are front, negative values rear from ego center)" 78 "distance (positive values are front, negative values rear from ego center)" 77 "distance (positive values are front, negative values rear from ego center)" 76 "distance (positive values are front, negative values rear from ego center)" 75 "distance (positive values are front, negative values rear from ego center)" 74 "distance (positive values are front, negative values rear from ego center)" 73 "distance (positive values are front, negative values rear from ego center)" 72 "distance (positive values are front, negative values rear from ego center)" 71 "distance (positive values are front, negative values rear from ego center)" 70 "distance (positive values are front, negative values rear from ego center)" 69 "distance (positive values are front, negative values rear from ego center)" 68 "distance (positive values are front, negative values rear from ego center)" 67 "distance (positive values are front, negative values rear from ego center)" 66 "distance (positive values are front, negative values rear from ego center)" 65 "distance (positive values are front, negative values rear from ego center)" 64 "distance (positive values are front, negative values rear from ego center)" 63 "distance (positive values are front, negative values rear from ego center)" 62 "distance (positive values are front, negative values rear from ego center)" 61 "distance (positive values are front, negative values rear from ego center)" 60 "distance (positive values are front, negative values rear from ego center)" 59 "distance (positive values are front, negative values rear from ego center)" 58 "distance (positive values are front, negative values rear from ego center)" 57 "distance (positive values are front, negative values rear from ego center)" 56 "distance (positive values are front, negative values rear from ego center)" 55 "distance (positive values are front, negative values rear from ego center)" 54 "distance (positive values are front, negative values rear from ego center)" 53 "distance (positive values are front, negative values rear from ego center)" 52 "distance (positive values are front, negative values rear from ego center)" 51 "distance (positive values are front, negative values rear from ego center)" 50 "distance (positive values are front, negative values rear from ego center)" 49 "distance (positive values are front, negative values rear from ego center)" 48 "distance (positive values are front, negative values rear from ego center)" 47 "distance (positive values are front, negative values rear from ego center)" 46 "distance (positive values are front, negative values rear from ego center)" 45 "distance (positive values are front, negative values rear from ego center)" 44 "distance (positive values are front, negative values rear from ego center)" 43 "distance (positive values are front, negative values rear from ego center)" 42 "distance (positive values are front, negative values rear from ego center)" 41 "distance (positive values are front, negative values rear from ego center)" 40 "distance (positive values are front, negative values rear from ego center)" 39 "distance (positive values are front, negative values rear from ego center)" 38 "distance (positive values are front, negative values rear from ego center)" 37 "distance (positive values are front, negative values rear from ego center)" 36 "distance (positive values are front, negative values rear from ego center)" 35 "distance (positive values are front, negative values rear from ego center)" 34 "distance (positive values are front, negative values rear from ego center)" 33 "distance (positive values are front, negative values rear from ego center)" 32 "distance (positive values are front, negative values rear from ego center)" 31 "distance (positive values are front, negative values rear from ego center)" 30 "distance (positive values are front, negative values rear from ego center)" 29 "distance (positive values are front, negative values rear from ego center)" 28 "distance (positive values are front, negative values rear from ego center)" 27 "distance (positive values are front, negative values rear from ego center)" 26 "distance (positive values are front, negative values rear from ego center)" 25 "distance (positive values are front, negative values rear from ego center)" 24 "distance (positive values are front, negative values rear from ego center)" 23 "distance (positive values are front, negative values rear from ego center)" 22 "distance (positive values are front, negative values rear from ego center)" 21 "distance (positive values are front, negative values rear from ego center)" 20 "distance (positive values are front, negative values rear from ego center)" 19 "distance (positive values are front, negative values rear from ego center)" 18 "distance (positive values are front, negative values rear from ego center)" 17 "distance (positive values are front, negative values rear from ego center)" 16 "distance (positive values are front, negative values rear from ego center)" 15 "distance (positive values are front, negative values rear from ego center)" 14 "distance (positive values are front, negative values rear from ego center)" 13 "distance (positive values are front, negative values rear from ego center)" 12 "distance (positive values are front, negative values rear from ego center)" 11 "distance (positive values are front, negative values rear from ego center)" 10 "distance (positive values are front, negative values rear from ego center)" 9 "distance (positive values are front, negative values rear from ego center)" 8 "distance (positive values are front, negative values rear from ego center)" 7 "distance (positive values are front, negative values rear from ego center)" 6 "distance (positive values are front, negative values rear from ego center)" 5 "distance (positive values are front, negative values rear from ego center)" 4 "distance (positive values are front, negative values rear from ego center)" 3 "distance (positive values are front, negative values rear from ego center)" 2 "distance (positive values are front, negative values rear from ego center)" 1 "distance (positive values are front, negative values rear from ego center)" 0 "distance (positive values are front, negative values rear from ego center)" ;
VAL_ 547 AdasHmiNeighboringObj11YOut 255 "distance right from ego center" 254 "distance right from ego center" 253 "distance right from ego center" 252 "distance right from ego center" 251 "distance right from ego center" 250 "distance right from ego center" 249 "distance right from ego center" 248 "distance right from ego center" 247 "distance right from ego center" 246 "distance right from ego center" 245 "distance right from ego center" 244 "distance right from ego center" 243 "distance right from ego center" 242 "distance right from ego center" 241 "distance right from ego center" 240 "distance right from ego center" 239 "distance right from ego center" 238 "distance right from ego center" 237 "distance right from ego center" 236 "distance right from ego center" 235 "distance right from ego center" 234 "distance right from ego center" 233 "distance right from ego center" 232 "distance right from ego center" 231 "distance right from ego center" 230 "distance right from ego center" 229 "distance right from ego center" 228 "distance right from ego center" 227 "distance right from ego center" 226 "distance right from ego center" 225 "distance right from ego center" 224 "distance right from ego center" 223 "distance right from ego center" 222 "distance right from ego center" 221 "distance right from ego center" 220 "distance right from ego center" 219 "distance right from ego center" 218 "distance right from ego center" 217 "distance right from ego center" 216 "distance right from ego center" 215 "distance right from ego center" 214 "distance right from ego center" 213 "distance right from ego center" 212 "distance right from ego center" 211 "distance right from ego center" 210 "distance right from ego center" 209 "distance right from ego center" 208 "distance right from ego center" 207 "distance right from ego center" 206 "distance right from ego center" 205 "distance right from ego center" 204 "distance right from ego center" 203 "distance right from ego center" 202 "distance right from ego center" 201 "distance right from ego center" 200 "distance right from ego center" 199 "distance right from ego center" 198 "distance right from ego center" 197 "distance right from ego center" 196 "distance right from ego center" 195 "distance right from ego center" 194 "distance right from ego center" 193 "distance right from ego center" 192 "distance right from ego center" 191 "distance right from ego center" 190 "distance right from ego center" 189 "distance right from ego center" 188 "distance right from ego center" 187 "distance right from ego center" 186 "distance right from ego center" 185 "distance right from ego center" 184 "distance right from ego center" 183 "distance right from ego center" 182 "distance right from ego center" 181 "distance right from ego center" 180 "distance right from ego center" 179 "distance right from ego center" 178 "distance right from ego center" 177 "distance right from ego center" 176 "distance right from ego center" 175 "distance right from ego center" 174 "distance right from ego center" 173 "distance right from ego center" 172 "distance right from ego center" 171 "distance right from ego center" 170 "distance right from ego center" 169 "distance right from ego center" 168 "distance right from ego center" 167 "distance right from ego center" 166 "distance right from ego center" 165 "distance right from ego center" 164 "distance right from ego center" 163 "distance right from ego center" 162 "distance right from ego center" 161 "distance right from ego center" 160 "distance right from ego center" 159 "distance right from ego center" 158 "distance right from ego center" 157 "distance right from ego center" 156 "distance right from ego center" 155 "distance right from ego center" 154 "distance right from ego center" 153 "distance right from ego center" 152 "distance right from ego center" 151 "distance right from ego center" 150 "distance right from ego center" 149 "distance right from ego center" 148 "distance right from ego center" 147 "distance right from ego center" 146 "distance right from ego center" 145 "distance right from ego center" 144 "distance right from ego center" 143 "distance right from ego center" 142 "distance right from ego center" 141 "distance right from ego center" 140 "distance right from ego center" 139 "distance right from ego center" 138 "distance right from ego center" 137 "distance right from ego center" 136 "distance right from ego center" 135 "distance right from ego center" 134 "distance right from ego center" 133 "distance right from ego center" 132 "distance right from ego center" 131 "distance right from ego center" 130 "distance right from ego center" 129 "distance right from ego center" 128 "distance right from ego center" 127 "distance left from ego center" 126 "distance left from ego center" 125 "distance left from ego center" 124 "distance left from ego center" 123 "distance left from ego center" 122 "distance left from ego center" 121 "distance left from ego center" 120 "distance left from ego center" 119 "distance left from ego center" 118 "distance left from ego center" 117 "distance left from ego center" 116 "distance left from ego center" 115 "distance left from ego center" 114 "distance left from ego center" 113 "distance left from ego center" 112 "distance left from ego center" 111 "distance left from ego center" 110 "distance left from ego center" 109 "distance left from ego center" 108 "distance left from ego center" 107 "distance left from ego center" 106 "distance left from ego center" 105 "distance left from ego center" 104 "distance left from ego center" 103 "distance left from ego center" 102 "distance left from ego center" 101 "distance left from ego center" 100 "distance left from ego center" 99 "distance left from ego center" 98 "distance left from ego center" 97 "distance left from ego center" 96 "distance left from ego center" 95 "distance left from ego center" 94 "distance left from ego center" 93 "distance left from ego center" 92 "distance left from ego center" 91 "distance left from ego center" 90 "distance left from ego center" 89 "distance left from ego center" 88 "distance left from ego center" 87 "distance left from ego center" 86 "distance left from ego center" 85 "distance left from ego center" 84 "distance left from ego center" 83 "distance left from ego center" 82 "distance left from ego center" 81 "distance left from ego center" 80 "distance left from ego center" 79 "distance left from ego center" 78 "distance left from ego center" 77 "distance left from ego center" 76 "distance left from ego center" 75 "distance left from ego center" 74 "distance left from ego center" 73 "distance left from ego center" 72 "distance left from ego center" 71 "distance left from ego center" 70 "distance left from ego center" 69 "distance left from ego center" 68 "distance left from ego center" 67 "distance left from ego center" 66 "distance left from ego center" 65 "distance left from ego center" 64 "distance left from ego center" 63 "distance left from ego center" 62 "distance left from ego center" 61 "distance left from ego center" 60 "distance left from ego center" 59 "distance left from ego center" 58 "distance left from ego center" 57 "distance left from ego center" 56 "distance left from ego center" 55 "distance left from ego center" 54 "distance left from ego center" 53 "distance left from ego center" 52 "distance left from ego center" 51 "distance left from ego center" 50 "distance left from ego center" 49 "distance left from ego center" 48 "distance left from ego center" 47 "distance left from ego center" 46 "distance left from ego center" 45 "distance left from ego center" 44 "distance left from ego center" 43 "distance left from ego center" 42 "distance left from ego center" 41 "distance left from ego center" 40 "distance left from ego center" 39 "distance left from ego center" 38 "distance left from ego center" 37 "distance left from ego center" 36 "distance left from ego center" 35 "distance left from ego center" 34 "distance left from ego center" 33 "distance left from ego center" 32 "distance left from ego center" 31 "distance left from ego center" 30 "distance left from ego center" 29 "distance left from ego center" 28 "distance left from ego center" 27 "distance left from ego center" 26 "distance left from ego center" 25 "distance left from ego center" 24 "distance left from ego center" 23 "distance left from ego center" 22 "distance left from ego center" 21 "distance left from ego center" 20 "distance left from ego center" 19 "distance left from ego center" 18 "distance left from ego center" 17 "distance left from ego center" 16 "distance left from ego center" 15 "distance left from ego center" 14 "distance left from ego center" 13 "distance left from ego center" 12 "distance left from ego center" 11 "distance left from ego center" 10 "distance left from ego center" 9 "distance left from ego center" 8 "distance left from ego center" 7 "distance left from ego center" 6 "distance left from ego center" 5 "distance left from ego center" 4 "distance left from ego center" 3 "distance left from ego center" 2 "distance left from ego center" 1 "distance left from ego center" 0 "distance left from ego center" ;
VAL_ 547 AdasHmiNeighboringObj12ObjTyp 7 "reserved" 6 "three-wheeler 三轮车" 5 "bus 公共汽车" 4 "pedestrian 行人" 3 "motorbike/Bicycle 二轮车" 2 "truck 卡车" 1 "passenger car 小轿车" 0 "Object not present" ;
VAL_ 547 AdasHmiNeighboringObj12XOut 255 "distance (positive values are front, negative values rear from ego center)" 254 "distance (positive values are front, negative values rear from ego center)" 253 "distance (positive values are front, negative values rear from ego center)" 252 "distance (positive values are front, negative values rear from ego center)" 251 "distance (positive values are front, negative values rear from ego center)" 250 "distance (positive values are front, negative values rear from ego center)" 249 "distance (positive values are front, negative values rear from ego center)" 248 "distance (positive values are front, negative values rear from ego center)" 247 "distance (positive values are front, negative values rear from ego center)" 246 "distance (positive values are front, negative values rear from ego center)" 245 "distance (positive values are front, negative values rear from ego center)" 244 "distance (positive values are front, negative values rear from ego center)" 243 "distance (positive values are front, negative values rear from ego center)" 242 "distance (positive values are front, negative values rear from ego center)" 241 "distance (positive values are front, negative values rear from ego center)" 240 "distance (positive values are front, negative values rear from ego center)" 239 "distance (positive values are front, negative values rear from ego center)" 238 "distance (positive values are front, negative values rear from ego center)" 237 "distance (positive values are front, negative values rear from ego center)" 236 "distance (positive values are front, negative values rear from ego center)" 235 "distance (positive values are front, negative values rear from ego center)" 234 "distance (positive values are front, negative values rear from ego center)" 233 "distance (positive values are front, negative values rear from ego center)" 232 "distance (positive values are front, negative values rear from ego center)" 231 "distance (positive values are front, negative values rear from ego center)" 230 "distance (positive values are front, negative values rear from ego center)" 229 "distance (positive values are front, negative values rear from ego center)" 228 "distance (positive values are front, negative values rear from ego center)" 227 "distance (positive values are front, negative values rear from ego center)" 226 "distance (positive values are front, negative values rear from ego center)" 225 "distance (positive values are front, negative values rear from ego center)" 224 "distance (positive values are front, negative values rear from ego center)" 223 "distance (positive values are front, negative values rear from ego center)" 222 "distance (positive values are front, negative values rear from ego center)" 221 "distance (positive values are front, negative values rear from ego center)" 220 "distance (positive values are front, negative values rear from ego center)" 219 "distance (positive values are front, negative values rear from ego center)" 218 "distance (positive values are front, negative values rear from ego center)" 217 "distance (positive values are front, negative values rear from ego center)" 216 "distance (positive values are front, negative values rear from ego center)" 215 "distance (positive values are front, negative values rear from ego center)" 214 "distance (positive values are front, negative values rear from ego center)" 213 "distance (positive values are front, negative values rear from ego center)" 212 "distance (positive values are front, negative values rear from ego center)" 211 "distance (positive values are front, negative values rear from ego center)" 210 "distance (positive values are front, negative values rear from ego center)" 209 "distance (positive values are front, negative values rear from ego center)" 208 "distance (positive values are front, negative values rear from ego center)" 207 "distance (positive values are front, negative values rear from ego center)" 206 "distance (positive values are front, negative values rear from ego center)" 205 "distance (positive values are front, negative values rear from ego center)" 204 "distance (positive values are front, negative values rear from ego center)" 203 "distance (positive values are front, negative values rear from ego center)" 202 "distance (positive values are front, negative values rear from ego center)" 201 "distance (positive values are front, negative values rear from ego center)" 200 "distance (positive values are front, negative values rear from ego center)" 199 "distance (positive values are front, negative values rear from ego center)" 198 "distance (positive values are front, negative values rear from ego center)" 197 "distance (positive values are front, negative values rear from ego center)" 196 "distance (positive values are front, negative values rear from ego center)" 195 "distance (positive values are front, negative values rear from ego center)" 194 "distance (positive values are front, negative values rear from ego center)" 193 "distance (positive values are front, negative values rear from ego center)" 192 "distance (positive values are front, negative values rear from ego center)" 191 "distance (positive values are front, negative values rear from ego center)" 190 "distance (positive values are front, negative values rear from ego center)" 189 "distance (positive values are front, negative values rear from ego center)" 188 "distance (positive values are front, negative values rear from ego center)" 187 "distance (positive values are front, negative values rear from ego center)" 186 "distance (positive values are front, negative values rear from ego center)" 185 "distance (positive values are front, negative values rear from ego center)" 184 "distance (positive values are front, negative values rear from ego center)" 183 "distance (positive values are front, negative values rear from ego center)" 182 "distance (positive values are front, negative values rear from ego center)" 181 "distance (positive values are front, negative values rear from ego center)" 180 "distance (positive values are front, negative values rear from ego center)" 179 "distance (positive values are front, negative values rear from ego center)" 178 "distance (positive values are front, negative values rear from ego center)" 177 "distance (positive values are front, negative values rear from ego center)" 176 "distance (positive values are front, negative values rear from ego center)" 175 "distance (positive values are front, negative values rear from ego center)" 174 "distance (positive values are front, negative values rear from ego center)" 173 "distance (positive values are front, negative values rear from ego center)" 172 "distance (positive values are front, negative values rear from ego center)" 171 "distance (positive values are front, negative values rear from ego center)" 170 "distance (positive values are front, negative values rear from ego center)" 169 "distance (positive values are front, negative values rear from ego center)" 168 "distance (positive values are front, negative values rear from ego center)" 167 "distance (positive values are front, negative values rear from ego center)" 166 "distance (positive values are front, negative values rear from ego center)" 165 "distance (positive values are front, negative values rear from ego center)" 164 "distance (positive values are front, negative values rear from ego center)" 163 "distance (positive values are front, negative values rear from ego center)" 162 "distance (positive values are front, negative values rear from ego center)" 161 "distance (positive values are front, negative values rear from ego center)" 160 "distance (positive values are front, negative values rear from ego center)" 159 "distance (positive values are front, negative values rear from ego center)" 158 "distance (positive values are front, negative values rear from ego center)" 157 "distance (positive values are front, negative values rear from ego center)" 156 "distance (positive values are front, negative values rear from ego center)" 155 "distance (positive values are front, negative values rear from ego center)" 154 "distance (positive values are front, negative values rear from ego center)" 153 "distance (positive values are front, negative values rear from ego center)" 152 "distance (positive values are front, negative values rear from ego center)" 151 "distance (positive values are front, negative values rear from ego center)" 150 "distance (positive values are front, negative values rear from ego center)" 149 "distance (positive values are front, negative values rear from ego center)" 148 "distance (positive values are front, negative values rear from ego center)" 147 "distance (positive values are front, negative values rear from ego center)" 146 "distance (positive values are front, negative values rear from ego center)" 145 "distance (positive values are front, negative values rear from ego center)" 144 "distance (positive values are front, negative values rear from ego center)" 143 "distance (positive values are front, negative values rear from ego center)" 142 "distance (positive values are front, negative values rear from ego center)" 141 "distance (positive values are front, negative values rear from ego center)" 140 "distance (positive values are front, negative values rear from ego center)" 139 "distance (positive values are front, negative values rear from ego center)" 138 "distance (positive values are front, negative values rear from ego center)" 137 "distance (positive values are front, negative values rear from ego center)" 136 "distance (positive values are front, negative values rear from ego center)" 135 "distance (positive values are front, negative values rear from ego center)" 134 "distance (positive values are front, negative values rear from ego center)" 133 "distance (positive values are front, negative values rear from ego center)" 132 "distance (positive values are front, negative values rear from ego center)" 131 "distance (positive values are front, negative values rear from ego center)" 130 "distance (positive values are front, negative values rear from ego center)" 129 "distance (positive values are front, negative values rear from ego center)" 128 "distance (positive values are front, negative values rear from ego center)" 127 "distance (positive values are front, negative values rear from ego center)" 126 "distance (positive values are front, negative values rear from ego center)" 125 "distance (positive values are front, negative values rear from ego center)" 124 "distance (positive values are front, negative values rear from ego center)" 123 "distance (positive values are front, negative values rear from ego center)" 122 "distance (positive values are front, negative values rear from ego center)" 121 "distance (positive values are front, negative values rear from ego center)" 120 "distance (positive values are front, negative values rear from ego center)" 119 "distance (positive values are front, negative values rear from ego center)" 118 "distance (positive values are front, negative values rear from ego center)" 117 "distance (positive values are front, negative values rear from ego center)" 116 "distance (positive values are front, negative values rear from ego center)" 115 "distance (positive values are front, negative values rear from ego center)" 114 "distance (positive values are front, negative values rear from ego center)" 113 "distance (positive values are front, negative values rear from ego center)" 112 "distance (positive values are front, negative values rear from ego center)" 111 "distance (positive values are front, negative values rear from ego center)" 110 "distance (positive values are front, negative values rear from ego center)" 109 "distance (positive values are front, negative values rear from ego center)" 108 "distance (positive values are front, negative values rear from ego center)" 107 "distance (positive values are front, negative values rear from ego center)" 106 "distance (positive values are front, negative values rear from ego center)" 105 "distance (positive values are front, negative values rear from ego center)" 104 "distance (positive values are front, negative values rear from ego center)" 103 "distance (positive values are front, negative values rear from ego center)" 102 "distance (positive values are front, negative values rear from ego center)" 101 "distance (positive values are front, negative values rear from ego center)" 100 "distance (positive values are front, negative values rear from ego center)" 99 "distance (positive values are front, negative values rear from ego center)" 98 "distance (positive values are front, negative values rear from ego center)" 97 "distance (positive values are front, negative values rear from ego center)" 96 "distance (positive values are front, negative values rear from ego center)" 95 "distance (positive values are front, negative values rear from ego center)" 94 "distance (positive values are front, negative values rear from ego center)" 93 "distance (positive values are front, negative values rear from ego center)" 92 "distance (positive values are front, negative values rear from ego center)" 91 "distance (positive values are front, negative values rear from ego center)" 90 "distance (positive values are front, negative values rear from ego center)" 89 "distance (positive values are front, negative values rear from ego center)" 88 "distance (positive values are front, negative values rear from ego center)" 87 "distance (positive values are front, negative values rear from ego center)" 86 "distance (positive values are front, negative values rear from ego center)" 85 "distance (positive values are front, negative values rear from ego center)" 84 "distance (positive values are front, negative values rear from ego center)" 83 "distance (positive values are front, negative values rear from ego center)" 82 "distance (positive values are front, negative values rear from ego center)" 81 "distance (positive values are front, negative values rear from ego center)" 80 "distance (positive values are front, negative values rear from ego center)" 79 "distance (positive values are front, negative values rear from ego center)" 78 "distance (positive values are front, negative values rear from ego center)" 77 "distance (positive values are front, negative values rear from ego center)" 76 "distance (positive values are front, negative values rear from ego center)" 75 "distance (positive values are front, negative values rear from ego center)" 74 "distance (positive values are front, negative values rear from ego center)" 73 "distance (positive values are front, negative values rear from ego center)" 72 "distance (positive values are front, negative values rear from ego center)" 71 "distance (positive values are front, negative values rear from ego center)" 70 "distance (positive values are front, negative values rear from ego center)" 69 "distance (positive values are front, negative values rear from ego center)" 68 "distance (positive values are front, negative values rear from ego center)" 67 "distance (positive values are front, negative values rear from ego center)" 66 "distance (positive values are front, negative values rear from ego center)" 65 "distance (positive values are front, negative values rear from ego center)" 64 "distance (positive values are front, negative values rear from ego center)" 63 "distance (positive values are front, negative values rear from ego center)" 62 "distance (positive values are front, negative values rear from ego center)" 61 "distance (positive values are front, negative values rear from ego center)" 60 "distance (positive values are front, negative values rear from ego center)" 59 "distance (positive values are front, negative values rear from ego center)" 58 "distance (positive values are front, negative values rear from ego center)" 57 "distance (positive values are front, negative values rear from ego center)" 56 "distance (positive values are front, negative values rear from ego center)" 55 "distance (positive values are front, negative values rear from ego center)" 54 "distance (positive values are front, negative values rear from ego center)" 53 "distance (positive values are front, negative values rear from ego center)" 52 "distance (positive values are front, negative values rear from ego center)" 51 "distance (positive values are front, negative values rear from ego center)" 50 "distance (positive values are front, negative values rear from ego center)" 49 "distance (positive values are front, negative values rear from ego center)" 48 "distance (positive values are front, negative values rear from ego center)" 47 "distance (positive values are front, negative values rear from ego center)" 46 "distance (positive values are front, negative values rear from ego center)" 45 "distance (positive values are front, negative values rear from ego center)" 44 "distance (positive values are front, negative values rear from ego center)" 43 "distance (positive values are front, negative values rear from ego center)" 42 "distance (positive values are front, negative values rear from ego center)" 41 "distance (positive values are front, negative values rear from ego center)" 40 "distance (positive values are front, negative values rear from ego center)" 39 "distance (positive values are front, negative values rear from ego center)" 38 "distance (positive values are front, negative values rear from ego center)" 37 "distance (positive values are front, negative values rear from ego center)" 36 "distance (positive values are front, negative values rear from ego center)" 35 "distance (positive values are front, negative values rear from ego center)" 34 "distance (positive values are front, negative values rear from ego center)" 33 "distance (positive values are front, negative values rear from ego center)" 32 "distance (positive values are front, negative values rear from ego center)" 31 "distance (positive values are front, negative values rear from ego center)" 30 "distance (positive values are front, negative values rear from ego center)" 29 "distance (positive values are front, negative values rear from ego center)" 28 "distance (positive values are front, negative values rear from ego center)" 27 "distance (positive values are front, negative values rear from ego center)" 26 "distance (positive values are front, negative values rear from ego center)" 25 "distance (positive values are front, negative values rear from ego center)" 24 "distance (positive values are front, negative values rear from ego center)" 23 "distance (positive values are front, negative values rear from ego center)" 22 "distance (positive values are front, negative values rear from ego center)" 21 "distance (positive values are front, negative values rear from ego center)" 20 "distance (positive values are front, negative values rear from ego center)" 19 "distance (positive values are front, negative values rear from ego center)" 18 "distance (positive values are front, negative values rear from ego center)" 17 "distance (positive values are front, negative values rear from ego center)" 16 "distance (positive values are front, negative values rear from ego center)" 15 "distance (positive values are front, negative values rear from ego center)" 14 "distance (positive values are front, negative values rear from ego center)" 13 "distance (positive values are front, negative values rear from ego center)" 12 "distance (positive values are front, negative values rear from ego center)" 11 "distance (positive values are front, negative values rear from ego center)" 10 "distance (positive values are front, negative values rear from ego center)" 9 "distance (positive values are front, negative values rear from ego center)" 8 "distance (positive values are front, negative values rear from ego center)" 7 "distance (positive values are front, negative values rear from ego center)" 6 "distance (positive values are front, negative values rear from ego center)" 5 "distance (positive values are front, negative values rear from ego center)" 4 "distance (positive values are front, negative values rear from ego center)" 3 "distance (positive values are front, negative values rear from ego center)" 2 "distance (positive values are front, negative values rear from ego center)" 1 "distance (positive values are front, negative values rear from ego center)" 0 "distance (positive values are front, negative values rear from ego center)" ;
VAL_ 547 AdasHmiNeighboringObj12YOut 255 "distance right from ego center" 254 "distance right from ego center" 253 "distance right from ego center" 252 "distance right from ego center" 251 "distance right from ego center" 250 "distance right from ego center" 249 "distance right from ego center" 248 "distance right from ego center" 247 "distance right from ego center" 246 "distance right from ego center" 245 "distance right from ego center" 244 "distance right from ego center" 243 "distance right from ego center" 242 "distance right from ego center" 241 "distance right from ego center" 240 "distance right from ego center" 239 "distance right from ego center" 238 "distance right from ego center" 237 "distance right from ego center" 236 "distance right from ego center" 235 "distance right from ego center" 234 "distance right from ego center" 233 "distance right from ego center" 232 "distance right from ego center" 231 "distance right from ego center" 230 "distance right from ego center" 229 "distance right from ego center" 228 "distance right from ego center" 227 "distance right from ego center" 226 "distance right from ego center" 225 "distance right from ego center" 224 "distance right from ego center" 223 "distance right from ego center" 222 "distance right from ego center" 221 "distance right from ego center" 220 "distance right from ego center" 219 "distance right from ego center" 218 "distance right from ego center" 217 "distance right from ego center" 216 "distance right from ego center" 215 "distance right from ego center" 214 "distance right from ego center" 213 "distance right from ego center" 212 "distance right from ego center" 211 "distance right from ego center" 210 "distance right from ego center" 209 "distance right from ego center" 208 "distance right from ego center" 207 "distance right from ego center" 206 "distance right from ego center" 205 "distance right from ego center" 204 "distance right from ego center" 203 "distance right from ego center" 202 "distance right from ego center" 201 "distance right from ego center" 200 "distance right from ego center" 199 "distance right from ego center" 198 "distance right from ego center" 197 "distance right from ego center" 196 "distance right from ego center" 195 "distance right from ego center" 194 "distance right from ego center" 193 "distance right from ego center" 192 "distance right from ego center" 191 "distance right from ego center" 190 "distance right from ego center" 189 "distance right from ego center" 188 "distance right from ego center" 187 "distance right from ego center" 186 "distance right from ego center" 185 "distance right from ego center" 184 "distance right from ego center" 183 "distance right from ego center" 182 "distance right from ego center" 181 "distance right from ego center" 180 "distance right from ego center" 179 "distance right from ego center" 178 "distance right from ego center" 177 "distance right from ego center" 176 "distance right from ego center" 175 "distance right from ego center" 174 "distance right from ego center" 173 "distance right from ego center" 172 "distance right from ego center" 171 "distance right from ego center" 170 "distance right from ego center" 169 "distance right from ego center" 168 "distance right from ego center" 167 "distance right from ego center" 166 "distance right from ego center" 165 "distance right from ego center" 164 "distance right from ego center" 163 "distance right from ego center" 162 "distance right from ego center" 161 "distance right from ego center" 160 "distance right from ego center" 159 "distance right from ego center" 158 "distance right from ego center" 157 "distance right from ego center" 156 "distance right from ego center" 155 "distance right from ego center" 154 "distance right from ego center" 153 "distance right from ego center" 152 "distance right from ego center" 151 "distance right from ego center" 150 "distance right from ego center" 149 "distance right from ego center" 148 "distance right from ego center" 147 "distance right from ego center" 146 "distance right from ego center" 145 "distance right from ego center" 144 "distance right from ego center" 143 "distance right from ego center" 142 "distance right from ego center" 141 "distance right from ego center" 140 "distance right from ego center" 139 "distance right from ego center" 138 "distance right from ego center" 137 "distance right from ego center" 136 "distance right from ego center" 135 "distance right from ego center" 134 "distance right from ego center" 133 "distance right from ego center" 132 "distance right from ego center" 131 "distance right from ego center" 130 "distance right from ego center" 129 "distance right from ego center" 128 "distance right from ego center" 127 "distance left from ego center" 126 "distance left from ego center" 125 "distance left from ego center" 124 "distance left from ego center" 123 "distance left from ego center" 122 "distance left from ego center" 121 "distance left from ego center" 120 "distance left from ego center" 119 "distance left from ego center" 118 "distance left from ego center" 117 "distance left from ego center" 116 "distance left from ego center" 115 "distance left from ego center" 114 "distance left from ego center" 113 "distance left from ego center" 112 "distance left from ego center" 111 "distance left from ego center" 110 "distance left from ego center" 109 "distance left from ego center" 108 "distance left from ego center" 107 "distance left from ego center" 106 "distance left from ego center" 105 "distance left from ego center" 104 "distance left from ego center" 103 "distance left from ego center" 102 "distance left from ego center" 101 "distance left from ego center" 100 "distance left from ego center" 99 "distance left from ego center" 98 "distance left from ego center" 97 "distance left from ego center" 96 "distance left from ego center" 95 "distance left from ego center" 94 "distance left from ego center" 93 "distance left from ego center" 92 "distance left from ego center" 91 "distance left from ego center" 90 "distance left from ego center" 89 "distance left from ego center" 88 "distance left from ego center" 87 "distance left from ego center" 86 "distance left from ego center" 85 "distance left from ego center" 84 "distance left from ego center" 83 "distance left from ego center" 82 "distance left from ego center" 81 "distance left from ego center" 80 "distance left from ego center" 79 "distance left from ego center" 78 "distance left from ego center" 77 "distance left from ego center" 76 "distance left from ego center" 75 "distance left from ego center" 74 "distance left from ego center" 73 "distance left from ego center" 72 "distance left from ego center" 71 "distance left from ego center" 70 "distance left from ego center" 69 "distance left from ego center" 68 "distance left from ego center" 67 "distance left from ego center" 66 "distance left from ego center" 65 "distance left from ego center" 64 "distance left from ego center" 63 "distance left from ego center" 62 "distance left from ego center" 61 "distance left from ego center" 60 "distance left from ego center" 59 "distance left from ego center" 58 "distance left from ego center" 57 "distance left from ego center" 56 "distance left from ego center" 55 "distance left from ego center" 54 "distance left from ego center" 53 "distance left from ego center" 52 "distance left from ego center" 51 "distance left from ego center" 50 "distance left from ego center" 49 "distance left from ego center" 48 "distance left from ego center" 47 "distance left from ego center" 46 "distance left from ego center" 45 "distance left from ego center" 44 "distance left from ego center" 43 "distance left from ego center" 42 "distance left from ego center" 41 "distance left from ego center" 40 "distance left from ego center" 39 "distance left from ego center" 38 "distance left from ego center" 37 "distance left from ego center" 36 "distance left from ego center" 35 "distance left from ego center" 34 "distance left from ego center" 33 "distance left from ego center" 32 "distance left from ego center" 31 "distance left from ego center" 30 "distance left from ego center" 29 "distance left from ego center" 28 "distance left from ego center" 27 "distance left from ego center" 26 "distance left from ego center" 25 "distance left from ego center" 24 "distance left from ego center" 23 "distance left from ego center" 22 "distance left from ego center" 21 "distance left from ego center" 20 "distance left from ego center" 19 "distance left from ego center" 18 "distance left from ego center" 17 "distance left from ego center" 16 "distance left from ego center" 15 "distance left from ego center" 14 "distance left from ego center" 13 "distance left from ego center" 12 "distance left from ego center" 11 "distance left from ego center" 10 "distance left from ego center" 9 "distance left from ego center" 8 "distance left from ego center" 7 "distance left from ego center" 6 "distance left from ego center" 5 "distance left from ego center" 4 "distance left from ego center" 3 "distance left from ego center" 2 "distance left from ego center" 1 "distance left from ego center" 0 "distance left from ego center" ;
VAL_ 547 ADAS_TgtVehicleID_ACC 15 "Reserved" 14 "Reserved" 13 "Reserved" 12 "Obj12" 11 "Obj11" 10 "Obj10" 9 "Obj9" 8 "Obj8" 7 "Obj7" 6 "Obj6" 5 "Obj5" 4 "Obj4" 3 "Obj3" 2 "Obj2" 1 "Obj1" 0 "No Obj" ;
VAL_ 552 MpcLine01Typ 31 "reserved" 30 "reserved" 29 "reserved" 28 "reserved" 27 "reserved" 26 "reserved" 25 "reserved" 24 "reserved" 23 "reserved" 22 "reserved" 21 "reserved" 20 "reserved" 19 "TYPE_UNKNOWN" 18 "TYPE_UNKNOWN_RAISED" 17 "TYPE_PARKING_CAR" 16 "TYPE_DELINEATOR_POST" 15 "TYPE_TRAFFIC_CONE" 14 "TYPE_WALL" 13 "TYPE_CURBSTONE" 12 "TYPE_GUARDRAIL" 11 "TYPE_ROAD_EDGE" 10 "TYPE_BOTTS_DOTS" 9 "TYPE_ASPHALT_JOINT" 8 "TYPE_CAR_POOL" 7 "TYPE_MULTIPLE_WARNING" 6 "TYPE_MULTIPLE" 5 "TYPE_DOUBLE_SOLID_SOLID" 4 "TYPE_DOUBLE_SOLID_DASHED" 3 "TYPE_DOUBLE_DASHED_SOLID" 2 "TYPE_DOUBLE_DASHED_DASHED" 1 "TYPE_DASHED_LINE" 0 "TYPE_SOLID_LINE" ;
VAL_ 552 MpcLine03Typ 19 "TYPE_UNKNOWN" 18 "TYPE_UNKNOWN_RAISED" 17 "TYPE_PARKING_CAR" 16 "TYPE_DELINEATOR_POST" 15 "TYPE_TRAFFIC_CONE" 14 "TYPE_WALL" 13 "TYPE_CURBSTONE" 12 "TYPE_GUARDRAIL" 11 "TYPE_ROAD_EDGE" 10 "TYPE_BOTTS_DOTS" 9 "TYPE_ASPHALT_JOINT" 8 "TYPE_CAR_POOL" 7 "TYPE_MULTIPLE_WARNING" 6 "TYPE_MULTIPLE" 5 "TYPE_DOUBLE_SOLID_SOLID" 4 "TYPE_DOUBLE_SOLID_DASHED" 3 "TYPE_DOUBLE_DASHED_SOLID" 2 "TYPE_DOUBLE_DASHED_DASHED" 1 "TYPE_DASHED_LINE" 0 "TYPE_SOLID_LINE" ;
VAL_ 552 MpcLine02Typ 19 "TYPE_UNKNOWN" 18 "TYPE_UNKNOWN_RAISED" 17 "TYPE_PARKING_CAR" 16 "TYPE_DELINEATOR_POST" 15 "TYPE_TRAFFIC_CONE" 14 "TYPE_WALL" 13 "TYPE_CURBSTONE" 12 "TYPE_GUARDRAIL" 11 "TYPE_ROAD_EDGE" 10 "TYPE_BOTTS_DOTS" 9 "TYPE_ASPHALT_JOINT" 8 "TYPE_CAR_POOL" 7 "TYPE_MULTIPLE_WARNING" 6 "TYPE_MULTIPLE" 5 "TYPE_DOUBLE_SOLID_SOLID" 4 "TYPE_DOUBLE_SOLID_DASHED" 3 "TYPE_DOUBLE_DASHED_SOLID" 2 "TYPE_DOUBLE_DASHED_DASHED" 1 "TYPE_DASHED_LINE" 0 "TYPE_SOLID_LINE" ;
VAL_ 552 MpcLine04Typ 19 "TYPE_UNKNOWN" 18 "TYPE_UNKNOWN_RAISED" 17 "TYPE_PARKING_CAR" 16 "TYPE_DELINEATOR_POST" 15 "TYPE_TRAFFIC_CONE" 14 "TYPE_WALL" 13 "TYPE_CURBSTONE" 12 "TYPE_GUARDRAIL" 11 "TYPE_ROAD_EDGE" 10 "TYPE_BOTTS_DOTS" 9 "TYPE_ASPHALT_JOINT" 8 "TYPE_CAR_POOL" 7 "TYPE_MULTIPLE_WARNING" 6 "TYPE_MULTIPLE" 5 "TYPE_DOUBLE_SOLID_SOLID" 4 "TYPE_DOUBLE_SOLID_DASHED" 3 "TYPE_DOUBLE_DASHED_SOLID" 2 "TYPE_DOUBLE_DASHED_DASHED" 1 "TYPE_DASHED_LINE" 0 "TYPE_SOLID_LINE" ;
VAL_ 552 ADAS4_HmiTar1Typ 7 "reserved" 6 "reserved" 5 "reserved" 4 "reserved" 3 "reserved" 2 "Conical  Barrel/ safety barrel 锥桶/防撞桶" 1 "Water Barriers 水马" 0 "Tar not present" ;
VAL_ 552 MpcLine05Typ 19 "TYPE_UNKNOWN" 18 "TYPE_UNKNOWN_RAISED" 17 "TYPE_PARKING_CAR" 16 "TYPE_DELINEATOR_POST" 15 "TYPE_TRAFFIC_CONE" 14 "TYPE_WALL" 13 "TYPE_CURBSTONE" 12 "TYPE_GUARDRAIL" 11 "TYPE_ROAD_EDGE" 10 "TYPE_BOTTS_DOTS" 9 "TYPE_ASPHALT_JOINT" 8 "TYPE_CAR_POOL" 7 "TYPE_MULTIPLE_WARNING" 6 "TYPE_MULTIPLE" 5 "TYPE_DOUBLE_SOLID_SOLID" 4 "TYPE_DOUBLE_SOLID_DASHED" 3 "TYPE_DOUBLE_DASHED_SOLID" 2 "TYPE_DOUBLE_DASHED_DASHED" 1 "TYPE_DASHED_LINE" 0 "TYPE_SOLID_LINE" ;
VAL_ 552 ADAS4_HmiTar2Typ 7 "reserved" 6 "reserved" 5 "reserved" 4 "reserved" 3 "reserved" 2 "Conical  Barrel/ safety barrel 锥桶/防撞桶" 1 "Water Barriers 水马" 0 "Tar not present" ;
VAL_ 552 ADAS4_HmiTar3Typ 7 "reserved" 6 "reserved" 5 "reserved" 4 "reserved" 3 "reserved" 2 "Conical  Barrel/ safety barrel 锥桶/防撞桶" 1 "Water Barriers 水马" 0 "Tar not present" ;
VAL_ 552 ADAS4_HmiTar4Typ 7 "reserved" 6 "reserved" 5 "reserved" 4 "reserved" 3 "reserved" 2 "Conical  Barrel/ safety barrel 锥桶/防撞桶" 1 "Water Barriers 水马" 0 "Tar not present" ;
VAL_ 552 MpcLine06Typ 19 "TYPE_UNKNOWN" 18 "TYPE_UNKNOWN_RAISED" 17 "TYPE_PARKING_CAR" 16 "TYPE_DELINEATOR_POST" 15 "TYPE_TRAFFIC_CONE" 14 "TYPE_WALL" 13 "TYPE_CURBSTONE" 12 "TYPE_GUARDRAIL" 11 "TYPE_ROAD_EDGE" 10 "TYPE_BOTTS_DOTS" 9 "TYPE_ASPHALT_JOINT" 8 "TYPE_CAR_POOL" 7 "TYPE_MULTIPLE_WARNING" 6 "TYPE_MULTIPLE" 5 "TYPE_DOUBLE_SOLID_SOLID" 4 "TYPE_DOUBLE_SOLID_DASHED" 3 "TYPE_DOUBLE_DASHED_SOLID" 2 "TYPE_DOUBLE_DASHED_DASHED" 1 "TYPE_DASHED_LINE" 0 "TYPE_SOLID_LINE" ;
VAL_ 552 TjaIcaLineSrc 3 "TIPL" 2 "DOP" 1 "Video" 0 "None" ;
VAL_ 552 ADAS4_HmiTar5Typ 7 "reserved" 6 "reserved" 5 "reserved" 4 "reserved" 3 "reserved" 2 "Conical  Barrel/ safety barrel 锥桶/防撞桶" 1 "Water Barriers 水马" 0 "Tar not present" ;
VAL_ 552 ADAS4_HmiTar6Typ 7 "reserved" 6 "reserved" 5 "reserved" 4 "reserved" 3 "reserved" 2 "Conical  Barrel/ safety barrel 锥桶/防撞桶" 1 "Water Barriers 水马" 0 "Tar not present" ;
VAL_ 585 RemPrkgReq 3 "Reserved" 2 "Request to parking out" 1 "Request to parking in" 0 "No request" ;
VAL_ 585 ApaAbordReason 63 "Reserved" 62 "Reserved" 61 "Reserved" 60 "后视镜折叠Review_Mirror_Fold_Up" 59 "轨迹超出规划 Beyond_The_Planning" 58 "视频信号故障" 57 "摄像头故障" 56 "雷达故障" 55 "车辆锁止，Vehicle Block" 54 "差速锁开启" 53 "四驱开启" 52 "Intervention_Accelerator Pedal" 51 "TPS_HMI feedback timeout" 50 "TPS_Suspend timeout" 49 "Over_Interruption_Time" 48 "Limit Slope" 47 "IMU fault" 46 "Around view camera fault" 45 "USS fault" 44 "TPS_Beyond_The_Planning" 43 "TPS Active timeout" 42 "Shake hands with Bluetooth Module Timeout" 41 "Response from TCU Timeout" 40 "Shake hands with EPS Timeout" 39 "Shake hands with ESP Timeout" 38 "TCU system failure" 37 "ESP system failure" 36 "SAS system failure" 35 "SDM system failure" 34 "EPS system failure" 33 "EMS system failure" 32 "APA Internal failure" 31 "BDC system failure(During RPA)" 30 "BLE system failure (During RPA)" 29 "Invalid lateral accel signal" 28 "Invalid longi accel signal" 27 "Invalid yaw rate signal" 26 "Invalid brake pedal switch state" 25 "Invalid vehicle speed" 24 "Invalid wheel pulse counter signal" 23 "HUM system Failure（待定）" 22 "Video interrupt (Feedback from HUM )（待定）" 21 "ECS active" 20 "EBD active over 500ms" 19 "ABS active" 18 "TCS active" 17 "Engine off" 16 "TPMS abnormal" 15 "Vehicle speed too fast" 14 "Intervention_ShiftGear" 13 "Intervention_EPB" 12 "Intervention_Steering wheel" 11 "Deviation from planned track" 10 "Vehicle Block（from ESP signal）" 9 "Insufficient space when parking out/ Tracking parkassist" 8 "Suspend Times beyond" 7 "ParkingOut Steps beyond_APA/RPA" 6 "ParkingIn Steps beyond_Vertical/inclined parking" 5 "ParkingIn Steps beyond_Parallel parking" 4 "RPA_HMI feedback timeout" 3 "APA_HMI feedback timeout" 2 "APA Suspend timeout" 1 "APA Active timeout" 0 "No fault" ;
VAL_ 585 ApaSts 15 "Invalid" 14 "Reserved" 13 "Reserved" 12 "Reserved" 11 "Reserved" 10 "Reserved" 9 "Reserved" 8 "Reserved" 7 "inhibit" 6 "Terminated" 5 "Failure" 4 "Completed" 3 "Guidance active" 2 "Searching" 1 "Standby" 0 "Off" ;
VAL_ 585 RpaSts 15 "Invalid" 14 "Reserved" 13 "Reserved" 12 "Reserved" 11 "Reserved" 10 "Reserved" 9 "RPA System Fault" 8 "RPA Out Success" 7 "RPA In Success" 6 "RPA Abort" 5 "RPA Suspend" 4 "RPA Operating" 3 "RPA Ready" 2 "RPA Parking Out Standby" 1 "RPA Parking In Standby" 0 "RPA Off" ;
VAL_ 585 APA_0x249_St_ParkingOutMode 3 "Reserved" 2 "遥控泊出 Tele_Control_Parking_Out" 1 "一键泊出 One_Key_Parking_Out" 0 "NONE" ;
VAL_ 585 APA_0x249_St_ParkingInMode 2 "遥控泊入 Tele_Control_Parking_In" 1 "一键泊入 One_Key_Parking_In" 0 "None" ;
VAL_ 585 ApaParkOutDirSts 15 "Invalid" 14 "Reserved" 13 "Reserved" 12 "Reserved" 11 "Reserved" 10 "Reserved" 9 "Reserved" 8 "Vertical Trunk Right" 7 "Vertical Trunk Left" 6 "Vertical Head Right" 5 "Vertical Head Left" 4 "Vertical backward" 3 "Vertical forward" 2 "Half Vehicle Right" 1 "Half Vehicle Left" 0 "Inactive" ;
VAL_ 585 RpaTxtDisp 255 "Reserved" 254 "Reserved" 253 "Reserved" 252 "Reserved" 251 "Reserved" 250 "Reserved" 249 "Reserved" 248 "Reserved" 247 "Reserved" 246 "Reserved" 245 "Reserved" 244 "Reserved" 243 "Reserved" 242 "Reserved" 241 "Reserved" 240 "Reserved" 239 "Reserved" 238 "Reserved" 237 "Reserved" 236 "Reserved" 235 "Reserved" 234 "Reserved" 233 "Reserved" 232 "Reserved" 231 "Reserved" 230 "Reserved" 229 "Reserved" 228 "Reserved" 227 "Reserved" 226 "Reserved" 225 "Reserved" 224 "Reserved" 223 "Reserved" 222 "Reserved" 221 "Reserved" 220 "Reserved" 219 "Reserved" 218 "Reserved" 217 "Reserved" 216 "Reserved" 215 "Reserved" 214 "Reserved" 213 "Reserved" 212 "Reserved" 211 "Reserved" 210 "Reserved" 209 "Reserved" 208 "Reserved" 207 "Reserved" 206 "Reserved" 205 "Reserved" 204 "Reserved" 203 "Reserved" 202 "Reserved" 201 "Reserved" 200 "Reserved" 199 "Reserved" 198 "Reserved" 197 "Reserved" 196 "Reserved" 195 "Reserved" 194 "Reserved" 193 "Reserved" 192 "Reserved" 191 "Reserved" 190 "Reserved" 189 "Reserved" 188 "Reserved" 187 "Reserved" 186 "Reserved" 185 "Reserved" 184 "Reserved" 183 "Reserved" 182 "Reserved" 181 "Reserved" 180 "Reserved" 179 "Reserved" 178 "Reserved" 177 "Reserved" 176 "Reserved" 175 "Reserved" 174 "Reserved" 173 "Reserved" 172 "Reserved" 171 "Reserved" 170 "Reserved" 169 "Reserved" 168 "Reserved" 167 "Reserved" 166 "Reserved" 165 "Reserved" 164 "Reserved" 163 "Reserved" 162 "Reserved" 161 "Reserved" 160 "Reserved" 159 "Reserved" 158 "Reserved" 157 "Reserved" 156 "Reserved" 155 "Reserved" 154 "Reserved" 153 "Reserved" 152 "Reserved" 151 "Reserved" 150 "Reserved" 149 "Reserved" 148 "Reserved" 147 "Reserved" 146 "Reserved" 145 "Reserved" 144 "Reserved" 143 "发动机舱盖未关闭，循迹倒车功能已暂停" 142 "请关好发动机舱盖，继续泊车" 141 "没有有效的倒车循迹路径，无法循迹倒车" 140 "车辆行驶状态下，无法启用循迹倒车功能，请保持车辆静止后，再启用该功能" 139 "响应超时，循迹倒车已终止" 138 "系统异常，循迹倒车已终止" 137 "人为介入循迹倒车过程，循迹倒车已终止" 136 "不满足循迹倒车条件，循迹倒车已终止" 135 "安全带未系好，循迹倒车功能已暂停" 134 "后背门未关闭，循迹倒车功能已暂停" 133 "后方出现障碍物，循迹倒车功能已暂停" 132 "车门未关闭，循迹倒车功能已暂停" 131 "请驾驶员注意周边环境，随时接管车辆" 130 "车辆到达目的地，请接管车辆" 129 "车辆即将到达目的地，请准备接管车辆" 128 "循迹倒车开始，请松开刹车，松开方向盘" 127 "Reserved for RADS" 126 "Reserved for RADS" 125 "Please turn to D" 124 "Release the brake, Driving assistance start" 123 "Please turn to R" 122 "No continue driving Parking quited" 121 "Obstacles Detected, RADS sys exits" 120 "Mirror fold, RADS sys exits" 119 "Seat belt drop, RADS sys exits" 118 "Door open, RADS sys exits" 117 "Trunk open, RADS sys exits" 116 "Release the brake" 115 "Arrive at the bourn" 114 "Near the bourn" 113 "RADS running, be ready to brake" 112 "No save distance，RADS sys esits" 111 "Reserved" 110 "Reserved" 109 "Reserved" 108 "Reserved" 107 "Reserved" 106 "Reserved" 105 "Reserved" 104 "Reserved" 103 "Reserved" 102 "Path match failed caused by internal error" 101 "Path match failed caused by long time no action" 100 "Path match failed caused by path error" 99 "Path match failed caused by communication error" 98 "Please select play back mode" 97 "Path matche please stop" 96 "Please drive to path start point" 95 "Reserved" 94 "Reserved" 93 "Reserved" 92 "Reserved" 91 "Reserved" 90 "Reserved" 89 "Reserved" 88 "Reserved" 87 "Reserved" 86 "Path saving failed caused by internal error" 85 "Path saving failed caused by Path error limit storage room" 84 "Path saving failed caused by Path error" 83 "Path saving failed caused by communication error" 82 "Path saving failed caused by Path too short" 81 "Path saving Succeed" 80 "Path saving" 79 "Reserved" 78 "Reserved" 77 "Reserved" 76 "Reserved" 75 "Reserved" 74 "Reserved" 73 "Reserved" 72 "Path studying failed caused by internal error" 71 "Path studying failed caused by learn time too long" 70 "Path studying failed caused by Path error" 69 "Path studying failed caused by communication error" 68 "Path studying failed caused by Speed too high" 67 "Path studying failed caused by Path too long" 66 "Confirm study finished" 65 "Path studying" 64 "Path study begin please drive the car" 63 "NextStep" 62 "LastStep" 61 "Slope over ,system exits" 60 "Please release switch to en-ter guidance" 59 "Please brake,And long press switch 2s to enter_POC_Right" 58 "Select Remote parking out type" 57 "Please Turn P and Apply EPB Remote parking sys not Running" 56 "Control unit error, Parking sys can not start" 55 "System error, Parking sys can not start" 54 "Parking suspended,Remote connection error" 53 "Remote Parking in exit" 52 "please confirm to start parking" 51 "please get off the car with keys to start remote parking" 50 "please select park out direction" 49 "please select park out" 48 "path is smooth" 47 "Driving Mode not supported" 46 "Too Small Slot Please select another direction" 45 "Parking suspended, fold the Mirror" 44 "Parking sys exits" 43 "Please brake， And long press switch 2s to enter_POC_left" 42 "Please select the parking direction by turning the turn switch" 41 "Parking is not available" 40 "Please brake, And long press switch 2s to continue auto parking" 39 "Parking suspended, Please release the gas pedal" 38 "Long press switch 2s to enter auto parking" 37 "Select parking type" 36 "Speed is too high,sys exits" 35 "Speed is too high, need <30km/h" 34 "Please turn D to search for parking slot" 33 "RPA is Suspend，Please press to continue" 32 "RPA is Operating" 31 "Reserved" 30 "Reserved" 29 "Reserved" 28 "Reserved" 27 "Reserved" 26 "Reserved" 25 "Reserved" 24 "Reserved" 23 "Reserved" 22 "Reserved" 21 "Reserved" 20 "Reserved" 19 "Conditions unsatisfied Parking sys exits" 18 "Driver intervention Parking sys exits" 17 "Response timeoutParking sys exits" 16 "System error Parking sys exits" 15 "Reserved" 14 "Reserved" 13 "Reserved" 12 "Please start the engine" 11 "Bluetooth connection error" 10 "Please fetch key" 9 "Obstacles Detected" 8 "Please turn on the emergency light" 7 "Please pop-up the door hands" 6 "Please unfold the Mirror" 5 "Please close the hood lid" 4 "Please close the door" 3 "Please close the trunk" 2 "Turn D to search for slot" 1 "Wrong gear position to start parking" 0 "No Request" ;
VAL_ 585 DirHalfLeAvl 1 "not availability" 0 "Availability" ;
VAL_ 585 DirHalfRiAvl 1 "not availability" 0 "Availability" ;
VAL_ 585 DirVertFwdAvl 1 "not availability" 0 "Availability" ;
VAL_ 585 DirVertBwdAvl 1 "not availability" 0 "Availability" ;
VAL_ 585 DirVertHdLeAvl 1 "not availability" 0 "Availability" ;
VAL_ 585 DirVertHdRiAvl 1 "not availability" 0 "Availability" ;
VAL_ 585 DirVertTrLeAvl 1 "not availability" 0 "Availability" ;
VAL_ 585 DirVertTrRiAvl 1 "not availability" 0 "Availability" ;
VAL_ 585 ApaVehModStsFb 7 "Rerserved" 6 "Gallery Mode" 5 "Test Mode（预留）" 4 "Crash Mode（预留）" 3 "Transport Mode" 2 "Factory Mode（default）" 1 "Normal Mode" 0 "initialization" ;
VAL_ 585 ApaUnfoldMirror 3 "Reserved" 2 "Unfold Invalid" 1 "Unfold Valid" 0 "Initializing" ;
VAL_ 585 APA_HazardWarningLightsReq 3 "Reserved" 2 "Reserved" 1 "Request" 0 "No Request" ;
VAL_ 585 ApaSuspendReason 15 "Reserved" 14 "Reserved" 13 "Reserved" 12 "Reserved" 11 "Reserved" 10 "Reserved" 9 "MirrorFold" 8 "Brake pedal pressed" 7 "Hood lid open" 6 "Tmodule bluetooth disconnect" 5 "Seat belt released" 4 "Trunk open" 3 "Any door open" 2 "Obstacle on path" 1 "User not operating(During RPA)" 0 "Not suspended" ;
VAL_ 658 ApaDispReq 63 "Reserved" 62 "Reserved" 61 "Reserved" 60 "Reserved" 59 "Reserved" 58 "Reserved" 57 "Reserved" 56 "Reserved" 55 "Reserved" 54 "Reserved" 53 "Reserved" 52 "Reserved" 51 "Reserved" 50 "Reserved" 49 "Reserved" 48 "Reserved" 47 "Reserved" 46 "Reserved" 45 "Reserved" 44 "Reserved" 43 "Reserved" 42 "Reserved" 41 "Reserved" 40 "Reserved" 39 "Reserved" 38 "Reserved" 37 "Reserved" 36 "Reserved" 35 "Reserved" 34 "Reserved" 33 "Reserved" 32 "Reserved" 31 "泊车系统故障界面" 30 "请启动发动机" 29 "Too_Fast_To_Searching_Slot车速过快无法找车位" 28 "No_Room_To_Parking_Out泊出空间不足" 27 "Please Press Brake Pedal 请踩刹车提示" 26 "Please_Release_Brake松开踏板双手离开方向盘" 25 "Please_Stop 找到车位请停车" 24 "Please_Switch_D_Gear请挂D挡搜索车位" 23 "Request Track astern process interface" 22 "Request Track astern confirm interface" 21 "Request RPA prepareing interface" 20 "Request Customer select slot confirming interface" 19 "Request Parking out Direction selection interface" 18 "Request Customer select slot parking fail interface" 17 "Request speed too high interface" 16 "Request Track astern Abort interface" 15 "Request Track astern Suspend interface" 14 "Request Track astern success interface" 13 "Request Track astern begining interface" 12 "Request Customer select slot parking interface" 11 "self-parking for insufficient of space" 10 "self-parking for plenty of space" 9 "Request Parking Abort interface" 8 "Request Parking Suspend interface" 7 "Request Parking success interface" 6 "Request Remote Parking In interface" 5 "Request Parking progress interface" 4 "Request Parkingin path selection interface" 3 "Request Parking select interface" 2 "Request Parking search interface" 1 "Request Parking type interface" 0 "no request" ;
VAL_ 658 ApaParkModSts 7 "Invalid" 6 "Reserved" 5 "Reserved" 4 "Reserved" 3 "Customer Select Slot" 2 "Park out" 1 "Park in" 0 "Inactive" ;
VAL_ 658 ApaParkInSlotSts 7 "Invalid" 6 "Reserved" 5 "Reserved" 4 "Reserved" 3 "Slant parking" 2 "Vertical parking" 1 "Transverse parking" 0 "Inactive" ;
VAL_ 658 ApaTragParkSetSts 3 "Invalid" 2 "Off" 1 "On" 0 "Inactive" ;
VAL_ 658 ApaVoicBrdtSts 3 "Invalid" 2 "Off" 1 "On" 0 "Inactive" ;
VAL_ 658 ApaParkStrtSts 7 "Invalid" 6 "Selected Slot Parking In" 5 "Comfirmation" 4 "Tracking Parking In" 3 "Auto Parking Out" 2 "Remote Parking In" 1 "Auto Parking In" 0 "Inactive" ;
VAL_ 658 ApaPathSts 3 "Invalid" 2 "Vehicle tail" 1 "Vehicle head" 0 "Inactive" ;
VAL_ 658 ApaVoicBrdtReq 255 "Invalid" 254 "Reserved" 253 "Reserved" 252 "Reserved" 251 "Reserved" 250 "Reserved" 249 "Reserved" 248 "Reserved" 247 "Reserved" 246 "Reserved" 245 "Reserved" 244 "Reserved" 243 "Reserved" 242 "Reserved" 241 "Reserved" 240 "Reserved" 239 "Reserved" 238 "Reserved" 237 "Reserved" 236 "Reserved" 235 "Reserved" 234 "Reserved" 233 "Reserved" 232 "Reserved" 231 "Reserved" 230 "Reserved" 229 "Reserved" 228 "Reserved" 227 "Reserved" 226 "Reserved" 225 "Reserved" 224 "Reserved" 223 "Reserved" 222 "Reserved" 221 "Reserved" 220 "Reserved" 219 "Reserved" 218 "Reserved" 217 "Reserved" 216 "Reserved" 215 "Reserved" 214 "Reserved" 213 "Reserved" 212 "Reserved" 211 "Reserved" 210 "Reserved" 209 "Reserved" 208 "Reserved" 207 "Reserved" 206 "Reserved" 205 "Reserved" 204 "Reserved" 203 "Reserved" 202 "Reserved" 201 "Reserved" 200 "Reserved" 199 "Reserved" 198 "Reserved" 197 "Reserved" 196 "Reserved" 195 "Reserved" 194 "Reserved" 193 "Reserved" 192 "Reserved" 191 "Reserved" 190 "Reserved" 189 "Reserved" 188 "Reserved" 187 "Reserved" 186 "Reserved" 185 "Reserved" 184 "Reserved" 183 "Reserved" 182 "Reserved" 181 "Reserved" 180 "Reserved" 179 "Reserved" 178 "Reserved" 177 "Reserved" 176 "Reserved" 175 "Reserved" 174 "Reserved" 173 "Reserved" 172 "Reserved" 171 "Reserved" 170 "Reserved" 169 "Reserved" 168 "Reserved" 167 "Reserved" 166 "Reserved" 165 "Reserved" 164 "Reserved" 163 "Reserved" 162 "Reserved" 161 "Reserved" 160 "Reserved" 159 "Reserved" 158 "Reserved" 157 "Reserved" 156 "Reserved" 155 "Reserved" 154 "Reserved" 153 "Reserved" 152 "Reserved" 151 "Reserved" 150 "Reserved" 149 "Reserved" 148 "Reserved" 147 "Reserved" 146 "Reserved" 145 "Reserved" 144 "Reserved" 143 "Reserved" 142 "Reserved" 141 "Reserved" 140 "Reserved" 139 "Reserved" 138 "Reserved" 137 "Reserved" 136 "Reserved" 135 "Reserved" 134 "Reserved" 133 "Reserved" 132 "Reserved" 131 "Reserved" 130 "Reserved" 129 "Reserved" 128 "Reserved" 127 "Reserved" 126 "Reserved" 125 "Reserved" 124 "Reserved" 123 "Reserved" 122 "Reserved" 121 "Reserved" 120 "Reserved" 119 "Reserved" 118 "Reserved" 117 "Reserved" 116 "Reserved" 115 "Reserved" 114 "Reserved" 113 "Reserved" 112 "Reserved" 111 "Reserved" 110 "Reserved" 109 "Reserved" 108 "Reserved" 107 "Reserved" 106 "Reserved" 105 "Reserved" 104 "Reserved" 103 "Reserved" 102 "Reserved" 101 "Reserved" 100 "Reserved" 99 "Reserved" 98 "Reserved" 97 "Reserved" 96 "Reserved" 95 "Reserved" 94 "Reserved" 93 "Reserved" 92 "Reserved" 91 "Reserved" 90 "Reserved" 89 "Reserved" 88 "Reserved" 87 "Reserved" 86 "Reserved" 85 "Reserved" 84 "Reserved" 83 "Reserved" 82 "Reserved" 81 "Reserved" 80 "Reserved" 79 "Reserved" 78 "Reserved" 77 "Reserved" 76 "Reserved" 75 "Reserved" 74 "Reserved" 73 "Reserved" 72 "Reserved" 71 "Reserved" 70 "Reserved" 69 "Reserved" 68 "Reserved" 67 "Reserved" 66 "Reserved" 65 "Reserved" 64 "Reserved" 63 "Reserved" 62 "Reserved" 61 "Reserved" 60 "Reserved" 59 "Reserved" 58 "Reserved" 57 "Reserved" 56 "Reserved" 55 "Reserved" 54 "Reserved" 53 "Reserved" 52 "Reserved" 51 "Broadcast 33-发动机舱盖未关闭，循迹倒车功能已暂停" 50 "Broadcast 32-请关好发动机舱盖，继续泊车" 49 "Broadcast 31-没有有效的倒车循迹路径，无法循迹倒车" 48 "Broadcast 30-车辆行驶状态下，无法启用循迹倒车功能，请保持车辆静止后，再启用该功能" 47 "Broadcast 2F-响应超时，循迹倒车已终止" 46 "Broadcast 2E-系统异常，循迹倒车已终止" 45 "Broadcast 2D-人为介入循迹倒车过程，循迹倒车已终止" 44 "Broadcast 2C-不满足循迹倒车条件，循迹倒车已终止" 43 "Broadcast 2B-安全带未系好，循迹倒车功能已暂停" 42 "Broadcast 2A-后背门未关闭，循迹倒车功能已暂停" 41 "Broadcast 29-后方出现障碍物，循迹倒车功能已暂停" 40 "Broadcast 28-车门未关闭，循迹倒车功能已暂停" 39 "Broadcast 27-车辆到达目的地，请接管车辆" 38 "Broadcast 26-车辆即将到达目的地，请准备接管车辆" 37 "Broadcast 25-循迹倒车开始，请松开刹车，松开方向盘" 36 "Broadcast 24-请驾驶员注意周边环境，随时接管车辆" 35 "Broadcast 23-请在可泊区域选择目标车位" 34 "Broadcast 22-泊出方向已选择" 33 "Broadcast 21-泊入方向/路径已选择" 32 "Broadcast 20-车位已选择" 31 "Broadcast 1F-自动泊车功能已开启" 30 "Broadcast 1E-请连接手机蓝牙，根据系统提示进行遥控泊车操作" 29 "Broadcast 1D-泊出空间不足，请尝试自行泊出" 28 "Broadcast 1C-路径畅通，可尝试自行泊出" 27 "Broadcast 1B-请选择车辆泊出方向" 26 "Broadcast 1A-泊车完成，请您接管车辆" 25 "Broadcast 19-泊车停止，请您接管车辆" 24 "Broadcast 18-驾驶员已接管车辆，泊车退出" 23 "Broadcast 17-移库次数过多，泊车退出" 22 "Broadcast 16-泊车暂停次数较多，泊车退出" 21 "Broadcast 15-车速异常，泊车退出" 20 "Broadcast 14-未到达目标位置，泊车退出" 19 "Broadcast 13-泊车系统故障，泊车退出" 18 "Broadcast 12-不满足泊车条件，泊车退出" 17 "Broadcast 11-车辆动力系统故障，泊车退出" 16 "Broadcast 10-车辆转向系统故障，泊车退出" 15 "Broadcast F-车辆制动系统故障，泊车退出" 14 "Broadcast E-泊车时间过长，泊车退出" 13 "Broadcast D-泊车空间不足，泊车退出" 12 "Broadcast C-请系好安全带，继续泊车" 11 "Broadcast B-请关好后背门，继续泊车" 10 "Broadcast A-请关好车门，继续泊车" 9 "Broadcast 9-前方出现障碍物，请注意安全" 8 "Broadcast 8-后方出现障碍物，请注意安全" 7 "Broadcast 7-请选择泊车方式，开始泊车" 6 "Broadcast 5-请松开方向盘和刹车，开始自动泊车" 5 "Broadcast 5-开始自动泊车控制，请您注意周边安全" 4 "Broadcast 4-车位空间较小，可选择遥控泊车" 3 "Broadcast 3-搜索到空车位，可以选择车位开始自动泊车" 2 "Broadcast 2-车速过快，请控制车速" 1 "Broadcast 1-请向前行驶，开始智能搜索空车位" 0 "no broadcast Request" ;
VAL_ 658 ApaTragParkSts 15 "Invalid" 14 "Reserved" 13 "Reserved" 12 "Reserved" 11 "Reserved" 10 "Reserved" 9 "Reserved" 8 "Reserved" 7 "APA tracking Recording" 6 "APA tracking parking system fault" 5 "APA tracking parking Suspend" 4 "APA tracking parking abort" 3 "APA tracking parking  sucessfully" 2 "APA tracking parking active" 1 "APA tracking parking Standby" 0 "Off" ;
VAL_ 658 SlotAutoSearchSts 3 "Invalid" 2 "OFF" 1 "ON" 0 "Inactive" ;
VAL_ 658 ApaCurPahNrRate 31 "Invalid" ;
VAL_ 658 RpaDstSetSts 7 "Invalid" 6 "Reserved" 5 "Reserved" 4 "Reserved" 3 "8m" 2 "5m" 1 "3m" 0 "Inactive" ;
VAL_ 658 OperToutExitSetSts 7 "Invalid" 6 "Reserved" 5 "Reserved" 4 "Reserved" 3 "No Exit" 2 "1min" 1 "30s" 0 "Inactive" ;
VAL_ 658 Apaparkout 1 "not availability" 0 "Availability" ;
VAL_ 658 CustSelSlot 1 "not availability" 0 "Availability" ;
VAL_ 658 ApaParkin 1 "not availability" 0 "Availability" ;
VAL_ 658 AvmFuncSts 1 "可用 avaliable" 0 "不可用 InAvailable" ;
VAL_ 658 ApaFuncSts 1 "可用 avaliable" 0 "不可用 InAvailable" ;
VAL_ 658 CustSlecSlotSts 1 "not availability" 0 "Availability" ;
VAL_ 658 ApaTrackingFuncSts 1 "可用 avaliable" 0 "不可用 InAvailable" ;
VAL_ 658 ApaSysFaild 1 "Fault" 0 "No Fault" ;
VAL_ 658 AvmMoveObjDetnSts 3 "MOD Failed" 2 "MOD OFF" 1 "MOD Active" 0 "Initial" ;
