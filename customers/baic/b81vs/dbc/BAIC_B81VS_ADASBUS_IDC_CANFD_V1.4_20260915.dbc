VERSION ""

NS_ :

BS_:

BU_: IDC Delete_FDCA Delete_APA Delete_CMRR_FL Delete_CMRR_FR CMRR_RL CMRR_RR MRR CGW

BO_ 547 ADAS3_ACANFD: 64 IDC
 SG_ AdasHmiNeighboringObj3YOut : 127|8@0+ (0.06,-7.5) [-7.5|7.5] "m" CGW
 SG_ Obj3VelX : 135|13@0+ (0.0312,-128) [-128|126.9976] "m/s" CGW
 SG_ AdasHmiNeighboringObj4ObjTyp : 151|3@0+ (1,0) [0|7] "-" CGW
 SG_ Obj4ObjExistProb : 148|5@0+ (0.03125,0) [0|0.96875] "" CGW
 SG_ AdasHmiNeighboringObj4XOut : 159|8@0+ (1.2,-50) [-50|250] "m" CGW
 SG_ AdasHmiNeighboringObj4YOut : 167|8@0+ (0.06,-7.5) [-7.5|7.5] "m" CGW
 SG_ Obj4VX : 175|13@0+ (0.0312,-128) [-128|126.9976] "m/s" CGW
 SG_ AdasHmiNeighboringObj5ObjTyp : 191|3@0+ (1,0) [0|7] "-" CGW
 SG_ Obj5ObjExistProb : 188|5@0+ (0.03125,0) [0|0.96875] "" CGW
 SG_ AdasHmiNeighboringObj5XOut : 199|8@0+ (1.2,-50) [-50|250] "m" CGW
 SG_ AdasHmiNeighboringObj5YOut : 207|8@0+ (0.06,-7.5) [-7.5|7.5] "m" CGW
 SG_ Obj5VX : 215|13@0+ (0.0312,-128) [-128|126.9976] "m/s" CGW
 SG_ AdasHmiNeighboringObj6ObjTyp : 231|3@0+ (1,0) [0|7] "-" CGW
 SG_ Obj6ObjExistProb : 228|5@0+ (0.03125,0) [0|0.96875] "" CGW
 SG_ AdasHmiNeighboringObj6XOut : 239|8@0+ (1.2,-50) [-50|250] "m" CGW
 SG_ AdasHmiNeighboringObj6YOut : 247|8@0+ (0.06,-7.5) [-7.5|7.5] "m" CGW
 SG_ AdasHmiNeighboringObj7ObjTyp : 255|3@0+ (1,0) [0|7] "-" CGW
 SG_ Obj7ObjExistProb : 252|5@0+ (0.03125,0) [0|0.96875] "" CGW
 SG_ Obj6VX : 263|13@0+ (0.0312,-128) [-128|126.9976] "m/s" CGW
 SG_ AdasHmiNeighboringObj7XOut : 279|8@0+ (1.2,-50) [-50|250] "m" CGW
 SG_ AdasHmiNeighboringObj7YOut : 287|8@0+ (0.06,-7.5) [-7.5|7.5] "m" CGW
 SG_ Obj7VX : 295|13@0+ (0.0312,-128) [-128|126.9976] "m/s" CGW
 SG_ AdasHmiNeighboringObj8ObjTyp : 311|3@0+ (1,0) [0|7] "-" CGW
 SG_ Obj8ObjExistProb : 308|5@0+ (0.03125,0) [0|0.96875] "" CGW
 SG_ AdasHmiNeighboringObj8XOut : 319|8@0+ (1.2,-50) [-50|250] "m" CGW
 SG_ AdasHmiNeighboringObj8YOut : 327|8@0+ (0.06,-7.5) [-7.5|7.5] "m" CGW
 SG_ Obj8VX : 335|13@0+ (0.0312,-128) [-128|126.9976] "m/s" CGW
 SG_ AdasHmiNeighboringObj9ObjTyp : 351|3@0+ (1,0) [0|7] "-" CGW
 SG_ Obj9ObjExistProb : 348|5@0+ (0.03125,0) [0|0.96875] "" CGW

CM_ SG_ 547 AdasHmiNeighboringObj3YOut "Provides the location of the neighboring Object no.1 as a lateral distance from ego center";
CM_ SG_ 547 Obj3VelX "Relative target object velocity in x-direction";
CM_ SG_ 547 AdasHmiNeighboringObj4ObjTyp "Provides the type of the neihboring Object no. 4";
CM_ SG_ 547 Obj4ObjExistProb "The probability of an object to exist in reality";
CM_ SG_ 547 AdasHmiNeighboringObj4XOut "Provides the location of the neighboring Object no.1 as a longitudinal distance from ego center";
CM_ SG_ 547 AdasHmiNeighboringObj4YOut "Provides the location of the neighboring Object no.1 as a lateral distance from ego center";
CM_ SG_ 547 Obj4VX "Relative target object velocity in x-direction";
CM_ SG_ 547 AdasHmiNeighboringObj5ObjTyp "Provides the type of the neihboring Object no. 5";
CM_ SG_ 547 Obj5ObjExistProb "The probability of an object to exist in reality";
CM_ SG_ 547 AdasHmiNeighboringObj5XOut "Provides the location of the neighboring Object no.1 as a longitudinal distance from ego center";
CM_ SG_ 547 AdasHmiNeighboringObj5YOut "Provides the location of the neighboring Object no.1 as a lateral distance from ego center";
CM_ SG_ 547 Obj5VX "Relative target object velocity in x-direction";
CM_ SG_ 547 AdasHmiNeighboringObj6ObjTyp "Provides the type of the neihboring Object no. 6";
CM_ SG_ 547 Obj6ObjExistProb "The probability of an object to exist in reality";
CM_ SG_ 547 AdasHmiNeighboringObj6XOut "Provides the location of the neighboring Object no.1 as a longitudinal distance from ego center";
CM_ SG_ 547 AdasHmiNeighboringObj6YOut "Provides the location of the neighboring Object no.1 as a lateral distance from ego center";
CM_ SG_ 547 AdasHmiNeighboringObj7ObjTyp "Provides the type of the neihboring Object no. 7";
CM_ SG_ 547 Obj7ObjExistProb "The probability of an object to exist in reality";
CM_ SG_ 547 Obj6VX "Relative target object velocity in x-direction";
CM_ SG_ 547 AdasHmiNeighboringObj7XOut "Provides the location of the neighboring Object no.1 as a longitudinal distance from ego center";
CM_ SG_ 547 AdasHmiNeighboringObj7YOut "Provides the location of the neighboring Object no.1 as a lateral distance from ego center";
CM_ SG_ 547 Obj7VX "Relative target object velocity in x-direction";
CM_ SG_ 547 AdasHmiNeighboringObj8ObjTyp "Provides the type of the neihboring Object no. 8";
CM_ SG_ 547 Obj8ObjExistProb "The probability of an object to exist in reality";
CM_ SG_ 547 AdasHmiNeighboringObj8XOut "Provides the location of the neighboring Object no.1 as a longitudinal distance from ego center";
CM_ SG_ 547 AdasHmiNeighboringObj8YOut "Provides the location of the neighboring Object no.1 as a lateral distance from ego center";
CM_ SG_ 547 Obj8VX "Relative target object velocity in x-direction";
CM_ SG_ 547 AdasHmiNeighboringObj9ObjTyp "Provides the type of the neihboring Object no. 9";
CM_ SG_ 547 Obj9ObjExistProb "The probability of an object to exist in reality";

BA_DEF_ BO_  "NmMessage" ENUM "No","Yes";
BA_DEF_ BO_  "DiagState" ENUM  "No","Yes";
BA_DEF_ BO_  "DiagResponse" ENUM  "No","Yes";
BA_DEF_ BO_  "GenMsgSendType" ENUM  "cyclic","NoMsgSendType","IfActive","Event","CA","CE";
BA_DEF_ BO_  "GenMsgCycleTime" INT 0 0;
BA_DEF_ SG_  "GenSigSendType" ENUM  "cyclic","OnChange","OnWrite","IfActive","OnChangeWithRepetition","OnWriteWithRepetition","IfActiveWithRepetition","CA","CE","Event";
BA_DEF_ SG_  "GenSigStartValue" INT 0 0;
BA_DEF_ BO_  "GenMsgCycleTimeFast" INT 0 0;
BA_DEF_ BO_  "GenMsgNrOfRepetition" INT 0 0;
BA_DEF_ BO_  "CANFD_BRS" ENUM  "0","1";
BA_DEF_ BO_  "VFrameFormat" ENUM  "StandardCAN","ExtendedCAN","reserved","reserved","reserved","reserved","reserved","reserved","reserved","reserved","reserved","reserved","reserved","reserved","StandardCAN_FD","ExtendedCAN_FD";
BA_DEF_ BO_  "GenMsgILSupport" ENUM  "No","Yes";
BA_DEF_ SG_ "sigDespEng" STRING;
BA_DEF_ SG_ "sigSecLevel" STRING;
BA_DEF_ SG_ "sigConfig" STRING;
BA_DEF_ SG_ "sigExplanation" STRING;

BA_DEF_DEF_  "NmMessage" "No";
BA_DEF_DEF_  "DiagState" "No";
BA_DEF_DEF_  "DiagResponse" "No";
BA_DEF_DEF_  "GenMsgSendType" "cyclic";
BA_DEF_DEF_  "GenMsgCycleTime" 0;
BA_DEF_DEF_  "GenSigSendType" "cyclic";
BA_DEF_DEF_  "GenSigStartValue" 0;
BA_DEF_DEF_  "GenMsgCycleTimeFast" 0;
BA_DEF_DEF_  "GenMsgNrOfRepetition" 0;
BA_DEF_DEF_  "CANFD_BRS" "1";
BA_DEF_DEF_  "VFrameFormat" "StandardCAN";
BA_DEF_DEF_  "GenMsgILSupport" "Yes";
BA_DEF_DEF_ "sigDespEng" "" ;
BA_DEF_DEF_ "sigSecLevel" "QM" ;
BA_DEF_DEF_ "sigConfig" "" ;
BA_DEF_DEF_ "sigExplanation" "" ;
BA_ "sigSecLevel"  SG_ 547 AdasHmiNeighboringObj3YOut "";
BA_ "sigExplanation"  SG_ 547 AdasHmiNeighboringObj3YOut "CDCIPC";
BA_ "sigSecLevel"  SG_ 547 Obj3VelX "";
BA_ "sigExplanation"  SG_ 547 Obj3VelX "CDCIPC";
BA_ "sigSecLevel"  SG_ 547 AdasHmiNeighboringObj4ObjTyp "";
BA_ "sigExplanation"  SG_ 547 AdasHmiNeighboringObj4ObjTyp "CDCIPC";
BA_ "sigSecLevel"  SG_ 547 Obj4ObjExistProb "";
BA_ "sigExplanation"  SG_ 547 Obj4ObjExistProb "CDCIPC";
BA_ "sigSecLevel"  SG_ 547 AdasHmiNeighboringObj4XOut "";
BA_ "sigExplanation"  SG_ 547 AdasHmiNeighboringObj4XOut "CDCIPC";
BA_ "sigSecLevel"  SG_ 547 AdasHmiNeighboringObj4YOut "";
BA_ "sigExplanation"  SG_ 547 AdasHmiNeighboringObj4YOut "CDCIPC";
BA_ "sigSecLevel"  SG_ 547 Obj4VX "";
BA_ "sigExplanation"  SG_ 547 Obj4VX "CDCIPC";
BA_ "sigSecLevel"  SG_ 547 AdasHmiNeighboringObj5ObjTyp "";
BA_ "sigExplanation"  SG_ 547 AdasHmiNeighboringObj5ObjTyp "CDCIPC";
BA_ "sigSecLevel"  SG_ 547 Obj5ObjExistProb "";
BA_ "sigExplanation"  SG_ 547 Obj5ObjExistProb "CDCIPC";
BA_ "sigSecLevel"  SG_ 547 AdasHmiNeighboringObj5XOut "";
BA_ "sigExplanation"  SG_ 547 AdasHmiNeighboringObj5XOut "CDCIPC";
BA_ "sigSecLevel"  SG_ 547 AdasHmiNeighboringObj5YOut "";
BA_ "sigExplanation"  SG_ 547 AdasHmiNeighboringObj5YOut "CDCIPC";
BA_ "sigSecLevel"  SG_ 547 Obj5VX "";
BA_ "sigExplanation"  SG_ 547 Obj5VX "CDCIPC";
BA_ "sigSecLevel"  SG_ 547 AdasHmiNeighboringObj6ObjTyp "";
BA_ "sigExplanation"  SG_ 547 AdasHmiNeighboringObj6ObjTyp "CDCIPC";
BA_ "sigSecLevel"  SG_ 547 Obj6ObjExistProb "";
BA_ "sigExplanation"  SG_ 547 Obj6ObjExistProb "CDCIPC";
BA_ "sigSecLevel"  SG_ 547 AdasHmiNeighboringObj6XOut "";
BA_ "sigExplanation"  SG_ 547 AdasHmiNeighboringObj6XOut "CDCIPC";
BA_ "sigSecLevel"  SG_ 547 AdasHmiNeighboringObj6YOut "";
BA_ "sigExplanation"  SG_ 547 AdasHmiNeighboringObj6YOut "CDCIPC";
BA_ "sigSecLevel"  SG_ 547 AdasHmiNeighboringObj7ObjTyp "";
BA_ "sigExplanation"  SG_ 547 AdasHmiNeighboringObj7ObjTyp "CDCIPC";
BA_ "sigSecLevel"  SG_ 547 Obj7ObjExistProb "";
BA_ "sigExplanation"  SG_ 547 Obj7ObjExistProb "CDCIPC";
BA_ "sigSecLevel"  SG_ 547 Obj6VX "";
BA_ "sigExplanation"  SG_ 547 Obj6VX "CDCIPC";
BA_ "sigSecLevel"  SG_ 547 AdasHmiNeighboringObj7XOut "";
BA_ "sigExplanation"  SG_ 547 AdasHmiNeighboringObj7XOut "CDCIPC";
BA_ "sigSecLevel"  SG_ 547 AdasHmiNeighboringObj7YOut "";
BA_ "sigExplanation"  SG_ 547 AdasHmiNeighboringObj7YOut "CDCIPC";
BA_ "sigSecLevel"  SG_ 547 Obj7VX "";
BA_ "sigExplanation"  SG_ 547 Obj7VX "CDCIPC";
BA_ "sigSecLevel"  SG_ 547 AdasHmiNeighboringObj8ObjTyp "";
BA_ "sigExplanation"  SG_ 547 AdasHmiNeighboringObj8ObjTyp "CDCIPC";
BA_ "sigSecLevel"  SG_ 547 Obj8ObjExistProb "";
BA_ "sigExplanation"  SG_ 547 Obj8ObjExistProb "CDCIPC";
BA_ "sigSecLevel"  SG_ 547 AdasHmiNeighboringObj8XOut "";
BA_ "sigExplanation"  SG_ 547 AdasHmiNeighboringObj8XOut "CDCIPC";
BA_ "sigSecLevel"  SG_ 547 AdasHmiNeighboringObj8YOut "";
BA_ "sigExplanation"  SG_ 547 AdasHmiNeighboringObj8YOut "CDCIPC";
BA_ "sigSecLevel"  SG_ 547 Obj8VX "";
BA_ "sigExplanation"  SG_ 547 Obj8VX "CDCIPC";
BA_ "sigSecLevel"  SG_ 547 AdasHmiNeighboringObj9ObjTyp "";
BA_ "sigExplanation"  SG_ 547 AdasHmiNeighboringObj9ObjTyp "CDCIPC";
BA_ "sigSecLevel"  SG_ 547 Obj9ObjExistProb "";
BA_ "sigExplanation"  SG_ 547 Obj9ObjExistProb "CDCIPC";
VAL_ 547 AdasHmiNeighboringObj3YOut 255 "distance right from ego center" 254 "distance right from ego center" 253 "distance right from ego center" 252 "distance right from ego center" 251 "distance right from ego center" 250 "distance right from ego center" 249 "distance right from ego center" 248 "distance right from ego center" 247 "distance right from ego center" 246 "distance right from ego center" 245 "distance right from ego center" 244 "distance right from ego center" 243 "distance right from ego center" 242 "distance right from ego center" 241 "distance right from ego center" 240 "distance right from ego center" 239 "distance right from ego center" 238 "distance right from ego center" 237 "distance right from ego center" 236 "distance right from ego center" 235 "distance right from ego center" 234 "distance right from ego center" 233 "distance right from ego center" 232 "distance right from ego center" 231 "distance right from ego center" 230 "distance right from ego center" 229 "distance right from ego center" 228 "distance right from ego center" 227 "distance right from ego center" 226 "distance right from ego center" 225 "distance right from ego center" 224 "distance right from ego center" 223 "distance right from ego center" 222 "distance right from ego center" 221 "distance right from ego center" 220 "distance right from ego center" 219 "distance right from ego center" 218 "distance right from ego center" 217 "distance right from ego center" 216 "distance right from ego center" 215 "distance right from ego center" 214 "distance right from ego center" 213 "distance right from ego center" 212 "distance right from ego center" 211 "distance right from ego center" 210 "distance right from ego center" 209 "distance right from ego center" 208 "distance right from ego center" 207 "distance right from ego center" 206 "distance right from ego center" 205 "distance right from ego center" 204 "distance right from ego center" 203 "distance right from ego center" 202 "distance right from ego center" 201 "distance right from ego center" 200 "distance right from ego center" 199 "distance right from ego center" 198 "distance right from ego center" 197 "distance right from ego center" 196 "distance right from ego center" 195 "distance right from ego center" 194 "distance right from ego center" 193 "distance right from ego center" 192 "distance right from ego center" 191 "distance right from ego center" 190 "distance right from ego center" 189 "distance right from ego center" 188 "distance right from ego center" 187 "distance right from ego center" 186 "distance right from ego center" 185 "distance right from ego center" 184 "distance right from ego center" 183 "distance right from ego center" 182 "distance right from ego center" 181 "distance right from ego center" 180 "distance right from ego center" 179 "distance right from ego center" 178 "distance right from ego center" 177 "distance right from ego center" 176 "distance right from ego center" 175 "distance right from ego center" 174 "distance right from ego center" 173 "distance right from ego center" 172 "distance right from ego center" 171 "distance right from ego center" 170 "distance right from ego center" 169 "distance right from ego center" 168 "distance right from ego center" 167 "distance right from ego center" 166 "distance right from ego center" 165 "distance right from ego center" 164 "distance right from ego center" 163 "distance right from ego center" 162 "distance right from ego center" 161 "distance right from ego center" 160 "distance right from ego center" 159 "distance right from ego center" 158 "distance right from ego center" 157 "distance right from ego center" 156 "distance right from ego center" 155 "distance right from ego center" 154 "distance right from ego center" 153 "distance right from ego center" 152 "distance right from ego center" 151 "distance right from ego center" 150 "distance right from ego center" 149 "distance right from ego center" 148 "distance right from ego center" 147 "distance right from ego center" 146 "distance right from ego center" 145 "distance right from ego center" 144 "distance right from ego center" 143 "distance right from ego center" 142 "distance right from ego center" 141 "distance right from ego center" 140 "distance right from ego center" 139 "distance right from ego center" 138 "distance right from ego center" 137 "distance right from ego center" 136 "distance right from ego center" 135 "distance right from ego center" 134 "distance right from ego center" 133 "distance right from ego center" 132 "distance right from ego center" 131 "distance right from ego center" 130 "distance right from ego center" 129 "distance right from ego center" 128 "distance right from ego center" 127 "distance left from ego center" 126 "distance left from ego center" 125 "distance left from ego center" 124 "distance left from ego center" 123 "distance left from ego center" 122 "distance left from ego center" 121 "distance left from ego center" 120 "distance left from ego center" 119 "distance left from ego center" 118 "distance left from ego center" 117 "distance left from ego center" 116 "distance left from ego center" 115 "distance left from ego center" 114 "distance left from ego center" 113 "distance left from ego center" 112 "distance left from ego center" 111 "distance left from ego center" 110 "distance left from ego center" 109 "distance left from ego center" 108 "distance left from ego center" 107 "distance left from ego center" 106 "distance left from ego center" 105 "distance left from ego center" 104 "distance left from ego center" 103 "distance left from ego center" 102 "distance left from ego center" 101 "distance left from ego center" 100 "distance left from ego center" 99 "distance left from ego center" 98 "distance left from ego center" 97 "distance left from ego center" 96 "distance left from ego center" 95 "distance left from ego center" 94 "distance left from ego center" 93 "distance left from ego center" 92 "distance left from ego center" 91 "distance left from ego center" 90 "distance left from ego center" 89 "distance left from ego center" 88 "distance left from ego center" 87 "distance left from ego center" 86 "distance left from ego center" 85 "distance left from ego center" 84 "distance left from ego center" 83 "distance left from ego center" 82 "distance left from ego center" 81 "distance left from ego center" 80 "distance left from ego center" 79 "distance left from ego center" 78 "distance left from ego center" 77 "distance left from ego center" 76 "distance left from ego center" 75 "distance left from ego center" 74 "distance left from ego center" 73 "distance left from ego center" 72 "distance left from ego center" 71 "distance left from ego center" 70 "distance left from ego center" 69 "distance left from ego center" 68 "distance left from ego center" 67 "distance left from ego center" 66 "distance left from ego center" 65 "distance left from ego center" 64 "distance left from ego center" 63 "distance left from ego center" 62 "distance left from ego center" 61 "distance left from ego center" 60 "distance left from ego center" 59 "distance left from ego center" 58 "distance left from ego center" 57 "distance left from ego center" 56 "distance left from ego center" 55 "distance left from ego center" 54 "distance left from ego center" 53 "distance left from ego center" 52 "distance left from ego center" 51 "distance left from ego center" 50 "distance left from ego center" 49 "distance left from ego center" 48 "distance left from ego center" 47 "distance left from ego center" 46 "distance left from ego center" 45 "distance left from ego center" 44 "distance left from ego center" 43 "distance left from ego center" 42 "distance left from ego center" 41 "distance left from ego center" 40 "distance left from ego center" 39 "distance left from ego center" 38 "distance left from ego center" 37 "distance left from ego center" 36 "distance left from ego center" 35 "distance left from ego center" 34 "distance left from ego center" 33 "distance left from ego center" 32 "distance left from ego center" 31 "distance left from ego center" 30 "distance left from ego center" 29 "distance left from ego center" 28 "distance left from ego center" 27 "distance left from ego center" 26 "distance left from ego center" 25 "distance left from ego center" 24 "distance left from ego center" 23 "distance left from ego center" 22 "distance left from ego center" 21 "distance left from ego center" 20 "distance left from ego center" 19 "distance left from ego center" 18 "distance left from ego center" 17 "distance left from ego center" 16 "distance left from ego center" 15 "distance left from ego center" 14 "distance left from ego center" 13 "distance left from ego center" 12 "distance left from ego center" 11 "distance left from ego center" 10 "distance left from ego center" 9 "distance left from ego center" 8 "distance left from ego center" 7 "distance left from ego center" 6 "distance left from ego center" 5 "distance left from ego center" 4 "distance left from ego center" 3 "distance left from ego center" 2 "distance left from ego center" 1 "distance left from ego center" 0 "distance left from ego center" ;
VAL_ 547 AdasHmiNeighboringObj4ObjTyp 7 "reserved" 6 "three-wheeler 三轮车" 5 "bus 公共汽车" 4 "pedestrian 行人" 3 "motorbike/Bicycle 二轮车" 2 "truck 卡车" 1 "passenger car 小轿车" 0 "Object not present" ;
VAL_ 547 AdasHmiNeighboringObj4XOut 255 "distance (positive values are front, negative values rear from ego center)" 254 "distance (positive values are front, negative values rear from ego center)" 253 "distance (positive values are front, negative values rear from ego center)" 252 "distance (positive values are front, negative values rear from ego center)" 251 "distance (positive values are front, negative values rear from ego center)" 250 "distance (positive values are front, negative values rear from ego center)" 249 "distance (positive values are front, negative values rear from ego center)" 248 "distance (positive values are front, negative values rear from ego center)" 247 "distance (positive values are front, negative values rear from ego center)" 246 "distance (positive values are front, negative values rear from ego center)" 245 "distance (positive values are front, negative values rear from ego center)" 244 "distance (positive values are front, negative values rear from ego center)" 243 "distance (positive values are front, negative values rear from ego center)" 242 "distance (positive values are front, negative values rear from ego center)" 241 "distance (positive values are front, negative values rear from ego center)" 240 "distance (positive values are front, negative values rear from ego center)" 239 "distance (positive values are front, negative values rear from ego center)" 238 "distance (positive values are front, negative values rear from ego center)" 237 "distance (positive values are front, negative values rear from ego center)" 236 "distance (positive values are front, negative values rear from ego center)" 235 "distance (positive values are front, negative values rear from ego center)" 234 "distance (positive values are front, negative values rear from ego center)" 233 "distance (positive values are front, negative values rear from ego center)" 232 "distance (positive values are front, negative values rear from ego center)" 231 "distance (positive values are front, negative values rear from ego center)" 230 "distance (positive values are front, negative values rear from ego center)" 229 "distance (positive values are front, negative values rear from ego center)" 228 "distance (positive values are front, negative values rear from ego center)" 227 "distance (positive values are front, negative values rear from ego center)" 226 "distance (positive values are front, negative values rear from ego center)" 225 "distance (positive values are front, negative values rear from ego center)" 224 "distance (positive values are front, negative values rear from ego center)" 223 "distance (positive values are front, negative values rear from ego center)" 222 "distance (positive values are front, negative values rear from ego center)" 221 "distance (positive values are front, negative values rear from ego center)" 220 "distance (positive values are front, negative values rear from ego center)" 219 "distance (positive values are front, negative values rear from ego center)" 218 "distance (positive values are front, negative values rear from ego center)" 217 "distance (positive values are front, negative values rear from ego center)" 216 "distance (positive values are front, negative values rear from ego center)" 215 "distance (positive values are front, negative values rear from ego center)" 214 "distance (positive values are front, negative values rear from ego center)" 213 "distance (positive values are front, negative values rear from ego center)" 212 "distance (positive values are front, negative values rear from ego center)" 211 "distance (positive values are front, negative values rear from ego center)" 210 "distance (positive values are front, negative values rear from ego center)" 209 "distance (positive values are front, negative values rear from ego center)" 208 "distance (positive values are front, negative values rear from ego center)" 207 "distance (positive values are front, negative values rear from ego center)" 206 "distance (positive values are front, negative values rear from ego center)" 205 "distance (positive values are front, negative values rear from ego center)" 204 "distance (positive values are front, negative values rear from ego center)" 203 "distance (positive values are front, negative values rear from ego center)" 202 "distance (positive values are front, negative values rear from ego center)" 201 "distance (positive values are front, negative values rear from ego center)" 200 "distance (positive values are front, negative values rear from ego center)" 199 "distance (positive values are front, negative values rear from ego center)" 198 "distance (positive values are front, negative values rear from ego center)" 197 "distance (positive values are front, negative values rear from ego center)" 196 "distance (positive values are front, negative values rear from ego center)" 195 "distance (positive values are front, negative values rear from ego center)" 194 "distance (positive values are front, negative values rear from ego center)" 193 "distance (positive values are front, negative values rear from ego center)" 192 "distance (positive values are front, negative values rear from ego center)" 191 "distance (positive values are front, negative values rear from ego center)" 190 "distance (positive values are front, negative values rear from ego center)" 189 "distance (positive values are front, negative values rear from ego center)" 188 "distance (positive values are front, negative values rear from ego center)" 187 "distance (positive values are front, negative values rear from ego center)" 186 "distance (positive values are front, negative values rear from ego center)" 185 "distance (positive values are front, negative values rear from ego center)" 184 "distance (positive values are front, negative values rear from ego center)" 183 "distance (positive values are front, negative values rear from ego center)" 182 "distance (positive values are front, negative values rear from ego center)" 181 "distance (positive values are front, negative values rear from ego center)" 180 "distance (positive values are front, negative values rear from ego center)" 179 "distance (positive values are front, negative values rear from ego center)" 178 "distance (positive values are front, negative values rear from ego center)" 177 "distance (positive values are front, negative values rear from ego center)" 176 "distance (positive values are front, negative values rear from ego center)" 175 "distance (positive values are front, negative values rear from ego center)" 174 "distance (positive values are front, negative values rear from ego center)" 173 "distance (positive values are front, negative values rear from ego center)" 172 "distance (positive values are front, negative values rear from ego center)" 171 "distance (positive values are front, negative values rear from ego center)" 170 "distance (positive values are front, negative values rear from ego center)" 169 "distance (positive values are front, negative values rear from ego center)" 168 "distance (positive values are front, negative values rear from ego center)" 167 "distance (positive values are front, negative values rear from ego center)" 166 "distance (positive values are front, negative values rear from ego center)" 165 "distance (positive values are front, negative values rear from ego center)" 164 "distance (positive values are front, negative values rear from ego center)" 163 "distance (positive values are front, negative values rear from ego center)" 162 "distance (positive values are front, negative values rear from ego center)" 161 "distance (positive values are front, negative values rear from ego center)" 160 "distance (positive values are front, negative values rear from ego center)" 159 "distance (positive values are front, negative values rear from ego center)" 158 "distance (positive values are front, negative values rear from ego center)" 157 "distance (positive values are front, negative values rear from ego center)" 156 "distance (positive values are front, negative values rear from ego center)" 155 "distance (positive values are front, negative values rear from ego center)" 154 "distance (positive values are front, negative values rear from ego center)" 153 "distance (positive values are front, negative values rear from ego center)" 152 "distance (positive values are front, negative values rear from ego center)" 151 "distance (positive values are front, negative values rear from ego center)" 150 "distance (positive values are front, negative values rear from ego center)" 149 "distance (positive values are front, negative values rear from ego center)" 148 "distance (positive values are front, negative values rear from ego center)" 147 "distance (positive values are front, negative values rear from ego center)" 146 "distance (positive values are front, negative values rear from ego center)" 145 "distance (positive values are front, negative values rear from ego center)" 144 "distance (positive values are front, negative values rear from ego center)" 143 "distance (positive values are front, negative values rear from ego center)" 142 "distance (positive values are front, negative values rear from ego center)" 141 "distance (positive values are front, negative values rear from ego center)" 140 "distance (positive values are front, negative values rear from ego center)" 139 "distance (positive values are front, negative values rear from ego center)" 138 "distance (positive values are front, negative values rear from ego center)" 137 "distance (positive values are front, negative values rear from ego center)" 136 "distance (positive values are front, negative values rear from ego center)" 135 "distance (positive values are front, negative values rear from ego center)" 134 "distance (positive values are front, negative values rear from ego center)" 133 "distance (positive values are front, negative values rear from ego center)" 132 "distance (positive values are front, negative values rear from ego center)" 131 "distance (positive values are front, negative values rear from ego center)" 130 "distance (positive values are front, negative values rear from ego center)" 129 "distance (positive values are front, negative values rear from ego center)" 128 "distance (positive values are front, negative values rear from ego center)" 127 "distance (positive values are front, negative values rear from ego center)" 126 "distance (positive values are front, negative values rear from ego center)" 125 "distance (positive values are front, negative values rear from ego center)" 124 "distance (positive values are front, negative values rear from ego center)" 123 "distance (positive values are front, negative values rear from ego center)" 122 "distance (positive values are front, negative values rear from ego center)" 121 "distance (positive values are front, negative values rear from ego center)" 120 "distance (positive values are front, negative values rear from ego center)" 119 "distance (positive values are front, negative values rear from ego center)" 118 "distance (positive values are front, negative values rear from ego center)" 117 "distance (positive values are front, negative values rear from ego center)" 116 "distance (positive values are front, negative values rear from ego center)" 115 "distance (positive values are front, negative values rear from ego center)" 114 "distance (positive values are front, negative values rear from ego center)" 113 "distance (positive values are front, negative values rear from ego center)" 112 "distance (positive values are front, negative values rear from ego center)" 111 "distance (positive values are front, negative values rear from ego center)" 110 "distance (positive values are front, negative values rear from ego center)" 109 "distance (positive values are front, negative values rear from ego center)" 108 "distance (positive values are front, negative values rear from ego center)" 107 "distance (positive values are front, negative values rear from ego center)" 106 "distance (positive values are front, negative values rear from ego center)" 105 "distance (positive values are front, negative values rear from ego center)" 104 "distance (positive values are front, negative values rear from ego center)" 103 "distance (positive values are front, negative values rear from ego center)" 102 "distance (positive values are front, negative values rear from ego center)" 101 "distance (positive values are front, negative values rear from ego center)" 100 "distance (positive values are front, negative values rear from ego center)" 99 "distance (positive values are front, negative values rear from ego center)" 98 "distance (positive values are front, negative values rear from ego center)" 97 "distance (positive values are front, negative values rear from ego center)" 96 "distance (positive values are front, negative values rear from ego center)" 95 "distance (positive values are front, negative values rear from ego center)" 94 "distance (positive values are front, negative values rear from ego center)" 93 "distance (positive values are front, negative values rear from ego center)" 92 "distance (positive values are front, negative values rear from ego center)" 91 "distance (positive values are front, negative values rear from ego center)" 90 "distance (positive values are front, negative values rear from ego center)" 89 "distance (positive values are front, negative values rear from ego center)" 88 "distance (positive values are front, negative values rear from ego center)" 87 "distance (positive values are front, negative values rear from ego center)" 86 "distance (positive values are front, negative values rear from ego center)" 85 "distance (positive values are front, negative values rear from ego center)" 84 "distance (positive values are front, negative values rear from ego center)" 83 "distance (positive values are front, negative values rear from ego center)" 82 "distance (positive values are front, negative values rear from ego center)" 81 "distance (positive values are front, negative values rear from ego center)" 80 "distance (positive values are front, negative values rear from ego center)" 79 "distance (positive values are front, negative values rear from ego center)" 78 "distance (positive values are front, negative values rear from ego center)" 77 "distance (positive values are front, negative values rear from ego center)" 76 "distance (positive values are front, negative values rear from ego center)" 75 "distance (positive values are front, negative values rear from ego center)" 74 "distance (positive values are front, negative values rear from ego center)" 73 "distance (positive values are front, negative values rear from ego center)" 72 "distance (positive values are front, negative values rear from ego center)" 71 "distance (positive values are front, negative values rear from ego center)" 70 "distance (positive values are front, negative values rear from ego center)" 69 "distance (positive values are front, negative values rear from ego center)" 68 "distance (positive values are front, negative values rear from ego center)" 67 "distance (positive values are front, negative values rear from ego center)" 66 "distance (positive values are front, negative values rear from ego center)" 65 "distance (positive values are front, negative values rear from ego center)" 64 "distance (positive values are front, negative values rear from ego center)" 63 "distance (positive values are front, negative values rear from ego center)" 62 "distance (positive values are front, negative values rear from ego center)" 61 "distance (positive values are front, negative values rear from ego center)" 60 "distance (positive values are front, negative values rear from ego center)" 59 "distance (positive values are front, negative values rear from ego center)" 58 "distance (positive values are front, negative values rear from ego center)" 57 "distance (positive values are front, negative values rear from ego center)" 56 "distance (positive values are front, negative values rear from ego center)" 55 "distance (positive values are front, negative values rear from ego center)" 54 "distance (positive values are front, negative values rear from ego center)" 53 "distance (positive values are front, negative values rear from ego center)" 52 "distance (positive values are front, negative values rear from ego center)" 51 "distance (positive values are front, negative values rear from ego center)" 50 "distance (positive values are front, negative values rear from ego center)" 49 "distance (positive values are front, negative values rear from ego center)" 48 "distance (positive values are front, negative values rear from ego center)" 47 "distance (positive values are front, negative values rear from ego center)" 46 "distance (positive values are front, negative values rear from ego center)" 45 "distance (positive values are front, negative values rear from ego center)" 44 "distance (positive values are front, negative values rear from ego center)" 43 "distance (positive values are front, negative values rear from ego center)" 42 "distance (positive values are front, negative values rear from ego center)" 41 "distance (positive values are front, negative values rear from ego center)" 40 "distance (positive values are front, negative values rear from ego center)" 39 "distance (positive values are front, negative values rear from ego center)" 38 "distance (positive values are front, negative values rear from ego center)" 37 "distance (positive values are front, negative values rear from ego center)" 36 "distance (positive values are front, negative values rear from ego center)" 35 "distance (positive values are front, negative values rear from ego center)" 34 "distance (positive values are front, negative values rear from ego center)" 33 "distance (positive values are front, negative values rear from ego center)" 32 "distance (positive values are front, negative values rear from ego center)" 31 "distance (positive values are front, negative values rear from ego center)" 30 "distance (positive values are front, negative values rear from ego center)" 29 "distance (positive values are front, negative values rear from ego center)" 28 "distance (positive values are front, negative values rear from ego center)" 27 "distance (positive values are front, negative values rear from ego center)" 26 "distance (positive values are front, negative values rear from ego center)" 25 "distance (positive values are front, negative values rear from ego center)" 24 "distance (positive values are front, negative values rear from ego center)" 23 "distance (positive values are front, negative values rear from ego center)" 22 "distance (positive values are front, negative values rear from ego center)" 21 "distance (positive values are front, negative values rear from ego center)" 20 "distance (positive values are front, negative values rear from ego center)" 19 "distance (positive values are front, negative values rear from ego center)" 18 "distance (positive values are front, negative values rear from ego center)" 17 "distance (positive values are front, negative values rear from ego center)" 16 "distance (positive values are front, negative values rear from ego center)" 15 "distance (positive values are front, negative values rear from ego center)" 14 "distance (positive values are front, negative values rear from ego center)" 13 "distance (positive values are front, negative values rear from ego center)" 12 "distance (positive values are front, negative values rear from ego center)" 11 "distance (positive values are front, negative values rear from ego center)" 10 "distance (positive values are front, negative values rear from ego center)" 9 "distance (positive values are front, negative values rear from ego center)" 8 "distance (positive values are front, negative values rear from ego center)" 7 "distance (positive values are front, negative values rear from ego center)" 6 "distance (positive values are front, negative values rear from ego center)" 5 "distance (positive values are front, negative values rear from ego center)" 4 "distance (positive values are front, negative values rear from ego center)" 3 "distance (positive values are front, negative values rear from ego center)" 2 "distance (positive values are front, negative values rear from ego center)" 1 "distance (positive values are front, negative values rear from ego center)" 0 "distance (positive values are front, negative values rear from ego center)" ;
VAL_ 547 AdasHmiNeighboringObj4YOut 255 "distance right from ego center" 254 "distance right from ego center" 253 "distance right from ego center" 252 "distance right from ego center" 251 "distance right from ego center" 250 "distance right from ego center" 249 "distance right from ego center" 248 "distance right from ego center" 247 "distance right from ego center" 246 "distance right from ego center" 245 "distance right from ego center" 244 "distance right from ego center" 243 "distance right from ego center" 242 "distance right from ego center" 241 "distance right from ego center" 240 "distance right from ego center" 239 "distance right from ego center" 238 "distance right from ego center" 237 "distance right from ego center" 236 "distance right from ego center" 235 "distance right from ego center" 234 "distance right from ego center" 233 "distance right from ego center" 232 "distance right from ego center" 231 "distance right from ego center" 230 "distance right from ego center" 229 "distance right from ego center" 228 "distance right from ego center" 227 "distance right from ego center" 226 "distance right from ego center" 225 "distance right from ego center" 224 "distance right from ego center" 223 "distance right from ego center" 222 "distance right from ego center" 221 "distance right from ego center" 220 "distance right from ego center" 219 "distance right from ego center" 218 "distance right from ego center" 217 "distance right from ego center" 216 "distance right from ego center" 215 "distance right from ego center" 214 "distance right from ego center" 213 "distance right from ego center" 212 "distance right from ego center" 211 "distance right from ego center" 210 "distance right from ego center" 209 "distance right from ego center" 208 "distance right from ego center" 207 "distance right from ego center" 206 "distance right from ego center" 205 "distance right from ego center" 204 "distance right from ego center" 203 "distance right from ego center" 202 "distance right from ego center" 201 "distance right from ego center" 200 "distance right from ego center" 199 "distance right from ego center" 198 "distance right from ego center" 197 "distance right from ego center" 196 "distance right from ego center" 195 "distance right from ego center" 194 "distance right from ego center" 193 "distance right from ego center" 192 "distance right from ego center" 191 "distance right from ego center" 190 "distance right from ego center" 189 "distance right from ego center" 188 "distance right from ego center" 187 "distance right from ego center" 186 "distance right from ego center" 185 "distance right from ego center" 184 "distance right from ego center" 183 "distance right from ego center" 182 "distance right from ego center" 181 "distance right from ego center" 180 "distance right from ego center" 179 "distance right from ego center" 178 "distance right from ego center" 177 "distance right from ego center" 176 "distance right from ego center" 175 "distance right from ego center" 174 "distance right from ego center" 173 "distance right from ego center" 172 "distance right from ego center" 171 "distance right from ego center" 170 "distance right from ego center" 169 "distance right from ego center" 168 "distance right from ego center" 167 "distance right from ego center" 166 "distance right from ego center" 165 "distance right from ego center" 164 "distance right from ego center" 163 "distance right from ego center" 162 "distance right from ego center" 161 "distance right from ego center" 160 "distance right from ego center" 159 "distance right from ego center" 158 "distance right from ego center" 157 "distance right from ego center" 156 "distance right from ego center" 155 "distance right from ego center" 154 "distance right from ego center" 153 "distance right from ego center" 152 "distance right from ego center" 151 "distance right from ego center" 150 "distance right from ego center" 149 "distance right from ego center" 148 "distance right from ego center" 147 "distance right from ego center" 146 "distance right from ego center" 145 "distance right from ego center" 144 "distance right from ego center" 143 "distance right from ego center" 142 "distance right from ego center" 141 "distance right from ego center" 140 "distance right from ego center" 139 "distance right from ego center" 138 "distance right from ego center" 137 "distance right from ego center" 136 "distance right from ego center" 135 "distance right from ego center" 134 "distance right from ego center" 133 "distance right from ego center" 132 "distance right from ego center" 131 "distance right from ego center" 130 "distance right from ego center" 129 "distance right from ego center" 128 "distance right from ego center" 127 "distance left from ego center" 126 "distance left from ego center" 125 "distance left from ego center" 124 "distance left from ego center" 123 "distance left from ego center" 122 "distance left from ego center" 121 "distance left from ego center" 120 "distance left from ego center" 119 "distance left from ego center" 118 "distance left from ego center" 117 "distance left from ego center" 116 "distance left from ego center" 115 "distance left from ego center" 114 "distance left from ego center" 113 "distance left from ego center" 112 "distance left from ego center" 111 "distance left from ego center" 110 "distance left from ego center" 109 "distance left from ego center" 108 "distance left from ego center" 107 "distance left from ego center" 106 "distance left from ego center" 105 "distance left from ego center" 104 "distance left from ego center" 103 "distance left from ego center" 102 "distance left from ego center" 101 "distance left from ego center" 100 "distance left from ego center" 99 "distance left from ego center" 98 "distance left from ego center" 97 "distance left from ego center" 96 "distance left from ego center" 95 "distance left from ego center" 94 "distance left from ego center" 93 "distance left from ego center" 92 "distance left from ego center" 91 "distance left from ego center" 90 "distance left from ego center" 89 "distance left from ego center" 88 "distance left from ego center" 87 "distance left from ego center" 86 "distance left from ego center" 85 "distance left from ego center" 84 "distance left from ego center" 83 "distance left from ego center" 82 "distance left from ego center" 81 "distance left from ego center" 80 "distance left from ego center" 79 "distance left from ego center" 78 "distance left from ego center" 77 "distance left from ego center" 76 "distance left from ego center" 75 "distance left from ego center" 74 "distance left from ego center" 73 "distance left from ego center" 72 "distance left from ego center" 71 "distance left from ego center" 70 "distance left from ego center" 69 "distance left from ego center" 68 "distance left from ego center" 67 "distance left from ego center" 66 "distance left from ego center" 65 "distance left from ego center" 64 "distance left from ego center" 63 "distance left from ego center" 62 "distance left from ego center" 61 "distance left from ego center" 60 "distance left from ego center" 59 "distance left from ego center" 58 "distance left from ego center" 57 "distance left from ego center" 56 "distance left from ego center" 55 "distance left from ego center" 54 "distance left from ego center" 53 "distance left from ego center" 52 "distance left from ego center" 51 "distance left from ego center" 50 "distance left from ego center" 49 "distance left from ego center" 48 "distance left from ego center" 47 "distance left from ego center" 46 "distance left from ego center" 45 "distance left from ego center" 44 "distance left from ego center" 43 "distance left from ego center" 42 "distance left from ego center" 41 "distance left from ego center" 40 "distance left from ego center" 39 "distance left from ego center" 38 "distance left from ego center" 37 "distance left from ego center" 36 "distance left from ego center" 35 "distance left from ego center" 34 "distance left from ego center" 33 "distance left from ego center" 32 "distance left from ego center" 31 "distance left from ego center" 30 "distance left from ego center" 29 "distance left from ego center" 28 "distance left from ego center" 27 "distance left from ego center" 26 "distance left from ego center" 25 "distance left from ego center" 24 "distance left from ego center" 23 "distance left from ego center" 22 "distance left from ego center" 21 "distance left from ego center" 20 "distance left from ego center" 19 "distance left from ego center" 18 "distance left from ego center" 17 "distance left from ego center" 16 "distance left from ego center" 15 "distance left from ego center" 14 "distance left from ego center" 13 "distance left from ego center" 12 "distance left from ego center" 11 "distance left from ego center" 10 "distance left from ego center" 9 "distance left from ego center" 8 "distance left from ego center" 7 "distance left from ego center" 6 "distance left from ego center" 5 "distance left from ego center" 4 "distance left from ego center" 3 "distance left from ego center" 2 "distance left from ego center" 1 "distance left from ego center" 0 "distance left from ego center" ;
VAL_ 547 AdasHmiNeighboringObj5ObjTyp 7 "reserved" 6 "three-wheeler 三轮车" 5 "bus 公共汽车" 4 "pedestrian 行人" 3 "motorbike/Bicycle 二轮车" 2 "truck 卡车" 1 "passenger car 小轿车" 0 "Object not present" ;
VAL_ 547 AdasHmiNeighboringObj5XOut 255 "distance (positive values are front, negative values rear from ego center)" 254 "distance (positive values are front, negative values rear from ego center)" 253 "distance (positive values are front, negative values rear from ego center)" 252 "distance (positive values are front, negative values rear from ego center)" 251 "distance (positive values are front, negative values rear from ego center)" 250 "distance (positive values are front, negative values rear from ego center)" 249 "distance (positive values are front, negative values rear from ego center)" 248 "distance (positive values are front, negative values rear from ego center)" 247 "distance (positive values are front, negative values rear from ego center)" 246 "distance (positive values are front, negative values rear from ego center)" 245 "distance (positive values are front, negative values rear from ego center)" 244 "distance (positive values are front, negative values rear from ego center)" 243 "distance (positive values are front, negative values rear from ego center)" 242 "distance (positive values are front, negative values rear from ego center)" 241 "distance (positive values are front, negative values rear from ego center)" 240 "distance (positive values are front, negative values rear from ego center)" 239 "distance (positive values are front, negative values rear from ego center)" 238 "distance (positive values are front, negative values rear from ego center)" 237 "distance (positive values are front, negative values rear from ego center)" 236 "distance (positive values are front, negative values rear from ego center)" 235 "distance (positive values are front, negative values rear from ego center)" 234 "distance (positive values are front, negative values rear from ego center)" 233 "distance (positive values are front, negative values rear from ego center)" 232 "distance (positive values are front, negative values rear from ego center)" 231 "distance (positive values are front, negative values rear from ego center)" 230 "distance (positive values are front, negative values rear from ego center)" 229 "distance (positive values are front, negative values rear from ego center)" 228 "distance (positive values are front, negative values rear from ego center)" 227 "distance (positive values are front, negative values rear from ego center)" 226 "distance (positive values are front, negative values rear from ego center)" 225 "distance (positive values are front, negative values rear from ego center)" 224 "distance (positive values are front, negative values rear from ego center)" 223 "distance (positive values are front, negative values rear from ego center)" 222 "distance (positive values are front, negative values rear from ego center)" 221 "distance (positive values are front, negative values rear from ego center)" 220 "distance (positive values are front, negative values rear from ego center)" 219 "distance (positive values are front, negative values rear from ego center)" 218 "distance (positive values are front, negative values rear from ego center)" 217 "distance (positive values are front, negative values rear from ego center)" 216 "distance (positive values are front, negative values rear from ego center)" 215 "distance (positive values are front, negative values rear from ego center)" 214 "distance (positive values are front, negative values rear from ego center)" 213 "distance (positive values are front, negative values rear from ego center)" 212 "distance (positive values are front, negative values rear from ego center)" 211 "distance (positive values are front, negative values rear from ego center)" 210 "distance (positive values are front, negative values rear from ego center)" 209 "distance (positive values are front, negative values rear from ego center)" 208 "distance (positive values are front, negative values rear from ego center)" 207 "distance (positive values are front, negative values rear from ego center)" 206 "distance (positive values are front, negative values rear from ego center)" 205 "distance (positive values are front, negative values rear from ego center)" 204 "distance (positive values are front, negative values rear from ego center)" 203 "distance (positive values are front, negative values rear from ego center)" 202 "distance (positive values are front, negative values rear from ego center)" 201 "distance (positive values are front, negative values rear from ego center)" 200 "distance (positive values are front, negative values rear from ego center)" 199 "distance (positive values are front, negative values rear from ego center)" 198 "distance (positive values are front, negative values rear from ego center)" 197 "distance (positive values are front, negative values rear from ego center)" 196 "distance (positive values are front, negative values rear from ego center)" 195 "distance (positive values are front, negative values rear from ego center)" 194 "distance (positive values are front, negative values rear from ego center)" 193 "distance (positive values are front, negative values rear from ego center)" 192 "distance (positive values are front, negative values rear from ego center)" 191 "distance (positive values are front, negative values rear from ego center)" 190 "distance (positive values are front, negative values rear from ego center)" 189 "distance (positive values are front, negative values rear from ego center)" 188 "distance (positive values are front, negative values rear from ego center)" 187 "distance (positive values are front, negative values rear from ego center)" 186 "distance (positive values are front, negative values rear from ego center)" 185 "distance (positive values are front, negative values rear from ego center)" 184 "distance (positive values are front, negative values rear from ego center)" 183 "distance (positive values are front, negative values rear from ego center)" 182 "distance (positive values are front, negative values rear from ego center)" 181 "distance (positive values are front, negative values rear from ego center)" 180 "distance (positive values are front, negative values rear from ego center)" 179 "distance (positive values are front, negative values rear from ego center)" 178 "distance (positive values are front, negative values rear from ego center)" 177 "distance (positive values are front, negative values rear from ego center)" 176 "distance (positive values are front, negative values rear from ego center)" 175 "distance (positive values are front, negative values rear from ego center)" 174 "distance (positive values are front, negative values rear from ego center)" 173 "distance (positive values are front, negative values rear from ego center)" 172 "distance (positive values are front, negative values rear from ego center)" 171 "distance (positive values are front, negative values rear from ego center)" 170 "distance (positive values are front, negative values rear from ego center)" 169 "distance (positive values are front, negative values rear from ego center)" 168 "distance (positive values are front, negative values rear from ego center)" 167 "distance (positive values are front, negative values rear from ego center)" 166 "distance (positive values are front, negative values rear from ego center)" 165 "distance (positive values are front, negative values rear from ego center)" 164 "distance (positive values are front, negative values rear from ego center)" 163 "distance (positive values are front, negative values rear from ego center)" 162 "distance (positive values are front, negative values rear from ego center)" 161 "distance (positive values are front, negative values rear from ego center)" 160 "distance (positive values are front, negative values rear from ego center)" 159 "distance (positive values are front, negative values rear from ego center)" 158 "distance (positive values are front, negative values rear from ego center)" 157 "distance (positive values are front, negative values rear from ego center)" 156 "distance (positive values are front, negative values rear from ego center)" 155 "distance (positive values are front, negative values rear from ego center)" 154 "distance (positive values are front, negative values rear from ego center)" 153 "distance (positive values are front, negative values rear from ego center)" 152 "distance (positive values are front, negative values rear from ego center)" 151 "distance (positive values are front, negative values rear from ego center)" 150 "distance (positive values are front, negative values rear from ego center)" 149 "distance (positive values are front, negative values rear from ego center)" 148 "distance (positive values are front, negative values rear from ego center)" 147 "distance (positive values are front, negative values rear from ego center)" 146 "distance (positive values are front, negative values rear from ego center)" 145 "distance (positive values are front, negative values rear from ego center)" 144 "distance (positive values are front, negative values rear from ego center)" 143 "distance (positive values are front, negative values rear from ego center)" 142 "distance (positive values are front, negative values rear from ego center)" 141 "distance (positive values are front, negative values rear from ego center)" 140 "distance (positive values are front, negative values rear from ego center)" 139 "distance (positive values are front, negative values rear from ego center)" 138 "distance (positive values are front, negative values rear from ego center)" 137 "distance (positive values are front, negative values rear from ego center)" 136 "distance (positive values are front, negative values rear from ego center)" 135 "distance (positive values are front, negative values rear from ego center)" 134 "distance (positive values are front, negative values rear from ego center)" 133 "distance (positive values are front, negative values rear from ego center)" 132 "distance (positive values are front, negative values rear from ego center)" 131 "distance (positive values are front, negative values rear from ego center)" 130 "distance (positive values are front, negative values rear from ego center)" 129 "distance (positive values are front, negative values rear from ego center)" 128 "distance (positive values are front, negative values rear from ego center)" 127 "distance (positive values are front, negative values rear from ego center)" 126 "distance (positive values are front, negative values rear from ego center)" 125 "distance (positive values are front, negative values rear from ego center)" 124 "distance (positive values are front, negative values rear from ego center)" 123 "distance (positive values are front, negative values rear from ego center)" 122 "distance (positive values are front, negative values rear from ego center)" 121 "distance (positive values are front, negative values rear from ego center)" 120 "distance (positive values are front, negative values rear from ego center)" 119 "distance (positive values are front, negative values rear from ego center)" 118 "distance (positive values are front, negative values rear from ego center)" 117 "distance (positive values are front, negative values rear from ego center)" 116 "distance (positive values are front, negative values rear from ego center)" 115 "distance (positive values are front, negative values rear from ego center)" 114 "distance (positive values are front, negative values rear from ego center)" 113 "distance (positive values are front, negative values rear from ego center)" 112 "distance (positive values are front, negative values rear from ego center)" 111 "distance (positive values are front, negative values rear from ego center)" 110 "distance (positive values are front, negative values rear from ego center)" 109 "distance (positive values are front, negative values rear from ego center)" 108 "distance (positive values are front, negative values rear from ego center)" 107 "distance (positive values are front, negative values rear from ego center)" 106 "distance (positive values are front, negative values rear from ego center)" 105 "distance (positive values are front, negative values rear from ego center)" 104 "distance (positive values are front, negative values rear from ego center)" 103 "distance (positive values are front, negative values rear from ego center)" 102 "distance (positive values are front, negative values rear from ego center)" 101 "distance (positive values are front, negative values rear from ego center)" 100 "distance (positive values are front, negative values rear from ego center)" 99 "distance (positive values are front, negative values rear from ego center)" 98 "distance (positive values are front, negative values rear from ego center)" 97 "distance (positive values are front, negative values rear from ego center)" 96 "distance (positive values are front, negative values rear from ego center)" 95 "distance (positive values are front, negative values rear from ego center)" 94 "distance (positive values are front, negative values rear from ego center)" 93 "distance (positive values are front, negative values rear from ego center)" 92 "distance (positive values are front, negative values rear from ego center)" 91 "distance (positive values are front, negative values rear from ego center)" 90 "distance (positive values are front, negative values rear from ego center)" 89 "distance (positive values are front, negative values rear from ego center)" 88 "distance (positive values are front, negative values rear from ego center)" 87 "distance (positive values are front, negative values rear from ego center)" 86 "distance (positive values are front, negative values rear from ego center)" 85 "distance (positive values are front, negative values rear from ego center)" 84 "distance (positive values are front, negative values rear from ego center)" 83 "distance (positive values are front, negative values rear from ego center)" 82 "distance (positive values are front, negative values rear from ego center)" 81 "distance (positive values are front, negative values rear from ego center)" 80 "distance (positive values are front, negative values rear from ego center)" 79 "distance (positive values are front, negative values rear from ego center)" 78 "distance (positive values are front, negative values rear from ego center)" 77 "distance (positive values are front, negative values rear from ego center)" 76 "distance (positive values are front, negative values rear from ego center)" 75 "distance (positive values are front, negative values rear from ego center)" 74 "distance (positive values are front, negative values rear from ego center)" 73 "distance (positive values are front, negative values rear from ego center)" 72 "distance (positive values are front, negative values rear from ego center)" 71 "distance (positive values are front, negative values rear from ego center)" 70 "distance (positive values are front, negative values rear from ego center)" 69 "distance (positive values are front, negative values rear from ego center)" 68 "distance (positive values are front, negative values rear from ego center)" 67 "distance (positive values are front, negative values rear from ego center)" 66 "distance (positive values are front, negative values rear from ego center)" 65 "distance (positive values are front, negative values rear from ego center)" 64 "distance (positive values are front, negative values rear from ego center)" 63 "distance (positive values are front, negative values rear from ego center)" 62 "distance (positive values are front, negative values rear from ego center)" 61 "distance (positive values are front, negative values rear from ego center)" 60 "distance (positive values are front, negative values rear from ego center)" 59 "distance (positive values are front, negative values rear from ego center)" 58 "distance (positive values are front, negative values rear from ego center)" 57 "distance (positive values are front, negative values rear from ego center)" 56 "distance (positive values are front, negative values rear from ego center)" 55 "distance (positive values are front, negative values rear from ego center)" 54 "distance (positive values are front, negative values rear from ego center)" 53 "distance (positive values are front, negative values rear from ego center)" 52 "distance (positive values are front, negative values rear from ego center)" 51 "distance (positive values are front, negative values rear from ego center)" 50 "distance (positive values are front, negative values rear from ego center)" 49 "distance (positive values are front, negative values rear from ego center)" 48 "distance (positive values are front, negative values rear from ego center)" 47 "distance (positive values are front, negative values rear from ego center)" 46 "distance (positive values are front, negative values rear from ego center)" 45 "distance (positive values are front, negative values rear from ego center)" 44 "distance (positive values are front, negative values rear from ego center)" 43 "distance (positive values are front, negative values rear from ego center)" 42 "distance (positive values are front, negative values rear from ego center)" 41 "distance (positive values are front, negative values rear from ego center)" 40 "distance (positive values are front, negative values rear from ego center)" 39 "distance (positive values are front, negative values rear from ego center)" 38 "distance (positive values are front, negative values rear from ego center)" 37 "distance (positive values are front, negative values rear from ego center)" 36 "distance (positive values are front, negative values rear from ego center)" 35 "distance (positive values are front, negative values rear from ego center)" 34 "distance (positive values are front, negative values rear from ego center)" 33 "distance (positive values are front, negative values rear from ego center)" 32 "distance (positive values are front, negative values rear from ego center)" 31 "distance (positive values are front, negative values rear from ego center)" 30 "distance (positive values are front, negative values rear from ego center)" 29 "distance (positive values are front, negative values rear from ego center)" 28 "distance (positive values are front, negative values rear from ego center)" 27 "distance (positive values are front, negative values rear from ego center)" 26 "distance (positive values are front, negative values rear from ego center)" 25 "distance (positive values are front, negative values rear from ego center)" 24 "distance (positive values are front, negative values rear from ego center)" 23 "distance (positive values are front, negative values rear from ego center)" 22 "distance (positive values are front, negative values rear from ego center)" 21 "distance (positive values are front, negative values rear from ego center)" 20 "distance (positive values are front, negative values rear from ego center)" 19 "distance (positive values are front, negative values rear from ego center)" 18 "distance (positive values are front, negative values rear from ego center)" 17 "distance (positive values are front, negative values rear from ego center)" 16 "distance (positive values are front, negative values rear from ego center)" 15 "distance (positive values are front, negative values rear from ego center)" 14 "distance (positive values are front, negative values rear from ego center)" 13 "distance (positive values are front, negative values rear from ego center)" 12 "distance (positive values are front, negative values rear from ego center)" 11 "distance (positive values are front, negative values rear from ego center)" 10 "distance (positive values are front, negative values rear from ego center)" 9 "distance (positive values are front, negative values rear from ego center)" 8 "distance (positive values are front, negative values rear from ego center)" 7 "distance (positive values are front, negative values rear from ego center)" 6 "distance (positive values are front, negative values rear from ego center)" 5 "distance (positive values are front, negative values rear from ego center)" 4 "distance (positive values are front, negative values rear from ego center)" 3 "distance (positive values are front, negative values rear from ego center)" 2 "distance (positive values are front, negative values rear from ego center)" 1 "distance (positive values are front, negative values rear from ego center)" 0 "distance (positive values are front, negative values rear from ego center)" ;
VAL_ 547 AdasHmiNeighboringObj5YOut 255 "distance right from ego center" 254 "distance right from ego center" 253 "distance right from ego center" 252 "distance right from ego center" 251 "distance right from ego center" 250 "distance right from ego center" 249 "distance right from ego center" 248 "distance right from ego center" 247 "distance right from ego center" 246 "distance right from ego center" 245 "distance right from ego center" 244 "distance right from ego center" 243 "distance right from ego center" 242 "distance right from ego center" 241 "distance right from ego center" 240 "distance right from ego center" 239 "distance right from ego center" 238 "distance right from ego center" 237 "distance right from ego center" 236 "distance right from ego center" 235 "distance right from ego center" 234 "distance right from ego center" 233 "distance right from ego center" 232 "distance right from ego center" 231 "distance right from ego center" 230 "distance right from ego center" 229 "distance right from ego center" 228 "distance right from ego center" 227 "distance right from ego center" 226 "distance right from ego center" 225 "distance right from ego center" 224 "distance right from ego center" 223 "distance right from ego center" 222 "distance right from ego center" 221 "distance right from ego center" 220 "distance right from ego center" 219 "distance right from ego center" 218 "distance right from ego center" 217 "distance right from ego center" 216 "distance right from ego center" 215 "distance right from ego center" 214 "distance right from ego center" 213 "distance right from ego center" 212 "distance right from ego center" 211 "distance right from ego center" 210 "distance right from ego center" 209 "distance right from ego center" 208 "distance right from ego center" 207 "distance right from ego center" 206 "distance right from ego center" 205 "distance right from ego center" 204 "distance right from ego center" 203 "distance right from ego center" 202 "distance right from ego center" 201 "distance right from ego center" 200 "distance right from ego center" 199 "distance right from ego center" 198 "distance right from ego center" 197 "distance right from ego center" 196 "distance right from ego center" 195 "distance right from ego center" 194 "distance right from ego center" 193 "distance right from ego center" 192 "distance right from ego center" 191 "distance right from ego center" 190 "distance right from ego center" 189 "distance right from ego center" 188 "distance right from ego center" 187 "distance right from ego center" 186 "distance right from ego center" 185 "distance right from ego center" 184 "distance right from ego center" 183 "distance right from ego center" 182 "distance right from ego center" 181 "distance right from ego center" 180 "distance right from ego center" 179 "distance right from ego center" 178 "distance right from ego center" 177 "distance right from ego center" 176 "distance right from ego center" 175 "distance right from ego center" 174 "distance right from ego center" 173 "distance right from ego center" 172 "distance right from ego center" 171 "distance right from ego center" 170 "distance right from ego center" 169 "distance right from ego center" 168 "distance right from ego center" 167 "distance right from ego center" 166 "distance right from ego center" 165 "distance right from ego center" 164 "distance right from ego center" 163 "distance right from ego center" 162 "distance right from ego center" 161 "distance right from ego center" 160 "distance right from ego center" 159 "distance right from ego center" 158 "distance right from ego center" 157 "distance right from ego center" 156 "distance right from ego center" 155 "distance right from ego center" 154 "distance right from ego center" 153 "distance right from ego center" 152 "distance right from ego center" 151 "distance right from ego center" 150 "distance right from ego center" 149 "distance right from ego center" 148 "distance right from ego center" 147 "distance right from ego center" 146 "distance right from ego center" 145 "distance right from ego center" 144 "distance right from ego center" 143 "distance right from ego center" 142 "distance right from ego center" 141 "distance right from ego center" 140 "distance right from ego center" 139 "distance right from ego center" 138 "distance right from ego center" 137 "distance right from ego center" 136 "distance right from ego center" 135 "distance right from ego center" 134 "distance right from ego center" 133 "distance right from ego center" 132 "distance right from ego center" 131 "distance right from ego center" 130 "distance right from ego center" 129 "distance right from ego center" 128 "distance right from ego center" 127 "distance left from ego center" 126 "distance left from ego center" 125 "distance left from ego center" 124 "distance left from ego center" 123 "distance left from ego center" 122 "distance left from ego center" 121 "distance left from ego center" 120 "distance left from ego center" 119 "distance left from ego center" 118 "distance left from ego center" 117 "distance left from ego center" 116 "distance left from ego center" 115 "distance left from ego center" 114 "distance left from ego center" 113 "distance left from ego center" 112 "distance left from ego center" 111 "distance left from ego center" 110 "distance left from ego center" 109 "distance left from ego center" 108 "distance left from ego center" 107 "distance left from ego center" 106 "distance left from ego center" 105 "distance left from ego center" 104 "distance left from ego center" 103 "distance left from ego center" 102 "distance left from ego center" 101 "distance left from ego center" 100 "distance left from ego center" 99 "distance left from ego center" 98 "distance left from ego center" 97 "distance left from ego center" 96 "distance left from ego center" 95 "distance left from ego center" 94 "distance left from ego center" 93 "distance left from ego center" 92 "distance left from ego center" 91 "distance left from ego center" 90 "distance left from ego center" 89 "distance left from ego center" 88 "distance left from ego center" 87 "distance left from ego center" 86 "distance left from ego center" 85 "distance left from ego center" 84 "distance left from ego center" 83 "distance left from ego center" 82 "distance left from ego center" 81 "distance left from ego center" 80 "distance left from ego center" 79 "distance left from ego center" 78 "distance left from ego center" 77 "distance left from ego center" 76 "distance left from ego center" 75 "distance left from ego center" 74 "distance left from ego center" 73 "distance left from ego center" 72 "distance left from ego center" 71 "distance left from ego center" 70 "distance left from ego center" 69 "distance left from ego center" 68 "distance left from ego center" 67 "distance left from ego center" 66 "distance left from ego center" 65 "distance left from ego center" 64 "distance left from ego center" 63 "distance left from ego center" 62 "distance left from ego center" 61 "distance left from ego center" 60 "distance left from ego center" 59 "distance left from ego center" 58 "distance left from ego center" 57 "distance left from ego center" 56 "distance left from ego center" 55 "distance left from ego center" 54 "distance left from ego center" 53 "distance left from ego center" 52 "distance left from ego center" 51 "distance left from ego center" 50 "distance left from ego center" 49 "distance left from ego center" 48 "distance left from ego center" 47 "distance left from ego center" 46 "distance left from ego center" 45 "distance left from ego center" 44 "distance left from ego center" 43 "distance left from ego center" 42 "distance left from ego center" 41 "distance left from ego center" 40 "distance left from ego center" 39 "distance left from ego center" 38 "distance left from ego center" 37 "distance left from ego center" 36 "distance left from ego center" 35 "distance left from ego center" 34 "distance left from ego center" 33 "distance left from ego center" 32 "distance left from ego center" 31 "distance left from ego center" 30 "distance left from ego center" 29 "distance left from ego center" 28 "distance left from ego center" 27 "distance left from ego center" 26 "distance left from ego center" 25 "distance left from ego center" 24 "distance left from ego center" 23 "distance left from ego center" 22 "distance left from ego center" 21 "distance left from ego center" 20 "distance left from ego center" 19 "distance left from ego center" 18 "distance left from ego center" 17 "distance left from ego center" 16 "distance left from ego center" 15 "distance left from ego center" 14 "distance left from ego center" 13 "distance left from ego center" 12 "distance left from ego center" 11 "distance left from ego center" 10 "distance left from ego center" 9 "distance left from ego center" 8 "distance left from ego center" 7 "distance left from ego center" 6 "distance left from ego center" 5 "distance left from ego center" 4 "distance left from ego center" 3 "distance left from ego center" 2 "distance left from ego center" 1 "distance left from ego center" 0 "distance left from ego center" ;
VAL_ 547 AdasHmiNeighboringObj6ObjTyp 7 "reserved" 6 "three-wheeler 三轮车" 5 "bus 公共汽车" 4 "pedestrian 行人" 3 "motorbike/Bicycle 二轮车" 2 "truck 卡车" 1 "passenger car 小轿车" 0 "Object not present" ;
VAL_ 547 AdasHmiNeighboringObj6XOut 255 "distance (positive values are front, negative values rear from ego center)" 254 "distance (positive values are front, negative values rear from ego center)" 253 "distance (positive values are front, negative values rear from ego center)" 252 "distance (positive values are front, negative values rear from ego center)" 251 "distance (positive values are front, negative values rear from ego center)" 250 "distance (positive values are front, negative values rear from ego center)" 249 "distance (positive values are front, negative values rear from ego center)" 248 "distance (positive values are front, negative values rear from ego center)" 247 "distance (positive values are front, negative values rear from ego center)" 246 "distance (positive values are front, negative values rear from ego center)" 245 "distance (positive values are front, negative values rear from ego center)" 244 "distance (positive values are front, negative values rear from ego center)" 243 "distance (positive values are front, negative values rear from ego center)" 242 "distance (positive values are front, negative values rear from ego center)" 241 "distance (positive values are front, negative values rear from ego center)" 240 "distance (positive values are front, negative values rear from ego center)" 239 "distance (positive values are front, negative values rear from ego center)" 238 "distance (positive values are front, negative values rear from ego center)" 237 "distance (positive values are front, negative values rear from ego center)" 236 "distance (positive values are front, negative values rear from ego center)" 235 "distance (positive values are front, negative values rear from ego center)" 234 "distance (positive values are front, negative values rear from ego center)" 233 "distance (positive values are front, negative values rear from ego center)" 232 "distance (positive values are front, negative values rear from ego center)" 231 "distance (positive values are front, negative values rear from ego center)" 230 "distance (positive values are front, negative values rear from ego center)" 229 "distance (positive values are front, negative values rear from ego center)" 228 "distance (positive values are front, negative values rear from ego center)" 227 "distance (positive values are front, negative values rear from ego center)" 226 "distance (positive values are front, negative values rear from ego center)" 225 "distance (positive values are front, negative values rear from ego center)" 224 "distance (positive values are front, negative values rear from ego center)" 223 "distance (positive values are front, negative values rear from ego center)" 222 "distance (positive values are front, negative values rear from ego center)" 221 "distance (positive values are front, negative values rear from ego center)" 220 "distance (positive values are front, negative values rear from ego center)" 219 "distance (positive values are front, negative values rear from ego center)" 218 "distance (positive values are front, negative values rear from ego center)" 217 "distance (positive values are front, negative values rear from ego center)" 216 "distance (positive values are front, negative values rear from ego center)" 215 "distance (positive values are front, negative values rear from ego center)" 214 "distance (positive values are front, negative values rear from ego center)" 213 "distance (positive values are front, negative values rear from ego center)" 212 "distance (positive values are front, negative values rear from ego center)" 211 "distance (positive values are front, negative values rear from ego center)" 210 "distance (positive values are front, negative values rear from ego center)" 209 "distance (positive values are front, negative values rear from ego center)" 208 "distance (positive values are front, negative values rear from ego center)" 207 "distance (positive values are front, negative values rear from ego center)" 206 "distance (positive values are front, negative values rear from ego center)" 205 "distance (positive values are front, negative values rear from ego center)" 204 "distance (positive values are front, negative values rear from ego center)" 203 "distance (positive values are front, negative values rear from ego center)" 202 "distance (positive values are front, negative values rear from ego center)" 201 "distance (positive values are front, negative values rear from ego center)" 200 "distance (positive values are front, negative values rear from ego center)" 199 "distance (positive values are front, negative values rear from ego center)" 198 "distance (positive values are front, negative values rear from ego center)" 197 "distance (positive values are front, negative values rear from ego center)" 196 "distance (positive values are front, negative values rear from ego center)" 195 "distance (positive values are front, negative values rear from ego center)" 194 "distance (positive values are front, negative values rear from ego center)" 193 "distance (positive values are front, negative values rear from ego center)" 192 "distance (positive values are front, negative values rear from ego center)" 191 "distance (positive values are front, negative values rear from ego center)" 190 "distance (positive values are front, negative values rear from ego center)" 189 "distance (positive values are front, negative values rear from ego center)" 188 "distance (positive values are front, negative values rear from ego center)" 187 "distance (positive values are front, negative values rear from ego center)" 186 "distance (positive values are front, negative values rear from ego center)" 185 "distance (positive values are front, negative values rear from ego center)" 184 "distance (positive values are front, negative values rear from ego center)" 183 "distance (positive values are front, negative values rear from ego center)" 182 "distance (positive values are front, negative values rear from ego center)" 181 "distance (positive values are front, negative values rear from ego center)" 180 "distance (positive values are front, negative values rear from ego center)" 179 "distance (positive values are front, negative values rear from ego center)" 178 "distance (positive values are front, negative values rear from ego center)" 177 "distance (positive values are front, negative values rear from ego center)" 176 "distance (positive values are front, negative values rear from ego center)" 175 "distance (positive values are front, negative values rear from ego center)" 174 "distance (positive values are front, negative values rear from ego center)" 173 "distance (positive values are front, negative values rear from ego center)" 172 "distance (positive values are front, negative values rear from ego center)" 171 "distance (positive values are front, negative values rear from ego center)" 170 "distance (positive values are front, negative values rear from ego center)" 169 "distance (positive values are front, negative values rear from ego center)" 168 "distance (positive values are front, negative values rear from ego center)" 167 "distance (positive values are front, negative values rear from ego center)" 166 "distance (positive values are front, negative values rear from ego center)" 165 "distance (positive values are front, negative values rear from ego center)" 164 "distance (positive values are front, negative values rear from ego center)" 163 "distance (positive values are front, negative values rear from ego center)" 162 "distance (positive values are front, negative values rear from ego center)" 161 "distance (positive values are front, negative values rear from ego center)" 160 "distance (positive values are front, negative values rear from ego center)" 159 "distance (positive values are front, negative values rear from ego center)" 158 "distance (positive values are front, negative values rear from ego center)" 157 "distance (positive values are front, negative values rear from ego center)" 156 "distance (positive values are front, negative values rear from ego center)" 155 "distance (positive values are front, negative values rear from ego center)" 154 "distance (positive values are front, negative values rear from ego center)" 153 "distance (positive values are front, negative values rear from ego center)" 152 "distance (positive values are front, negative values rear from ego center)" 151 "distance (positive values are front, negative values rear from ego center)" 150 "distance (positive values are front, negative values rear from ego center)" 149 "distance (positive values are front, negative values rear from ego center)" 148 "distance (positive values are front, negative values rear from ego center)" 147 "distance (positive values are front, negative values rear from ego center)" 146 "distance (positive values are front, negative values rear from ego center)" 145 "distance (positive values are front, negative values rear from ego center)" 144 "distance (positive values are front, negative values rear from ego center)" 143 "distance (positive values are front, negative values rear from ego center)" 142 "distance (positive values are front, negative values rear from ego center)" 141 "distance (positive values are front, negative values rear from ego center)" 140 "distance (positive values are front, negative values rear from ego center)" 139 "distance (positive values are front, negative values rear from ego center)" 138 "distance (positive values are front, negative values rear from ego center)" 137 "distance (positive values are front, negative values rear from ego center)" 136 "distance (positive values are front, negative values rear from ego center)" 135 "distance (positive values are front, negative values rear from ego center)" 134 "distance (positive values are front, negative values rear from ego center)" 133 "distance (positive values are front, negative values rear from ego center)" 132 "distance (positive values are front, negative values rear from ego center)" 131 "distance (positive values are front, negative values rear from ego center)" 130 "distance (positive values are front, negative values rear from ego center)" 129 "distance (positive values are front, negative values rear from ego center)" 128 "distance (positive values are front, negative values rear from ego center)" 127 "distance (positive values are front, negative values rear from ego center)" 126 "distance (positive values are front, negative values rear from ego center)" 125 "distance (positive values are front, negative values rear from ego center)" 124 "distance (positive values are front, negative values rear from ego center)" 123 "distance (positive values are front, negative values rear from ego center)" 122 "distance (positive values are front, negative values rear from ego center)" 121 "distance (positive values are front, negative values rear from ego center)" 120 "distance (positive values are front, negative values rear from ego center)" 119 "distance (positive values are front, negative values rear from ego center)" 118 "distance (positive values are front, negative values rear from ego center)" 117 "distance (positive values are front, negative values rear from ego center)" 116 "distance (positive values are front, negative values rear from ego center)" 115 "distance (positive values are front, negative values rear from ego center)" 114 "distance (positive values are front, negative values rear from ego center)" 113 "distance (positive values are front, negative values rear from ego center)" 112 "distance (positive values are front, negative values rear from ego center)" 111 "distance (positive values are front, negative values rear from ego center)" 110 "distance (positive values are front, negative values rear from ego center)" 109 "distance (positive values are front, negative values rear from ego center)" 108 "distance (positive values are front, negative values rear from ego center)" 107 "distance (positive values are front, negative values rear from ego center)" 106 "distance (positive values are front, negative values rear from ego center)" 105 "distance (positive values are front, negative values rear from ego center)" 104 "distance (positive values are front, negative values rear from ego center)" 103 "distance (positive values are front, negative values rear from ego center)" 102 "distance (positive values are front, negative values rear from ego center)" 101 "distance (positive values are front, negative values rear from ego center)" 100 "distance (positive values are front, negative values rear from ego center)" 99 "distance (positive values are front, negative values rear from ego center)" 98 "distance (positive values are front, negative values rear from ego center)" 97 "distance (positive values are front, negative values rear from ego center)" 96 "distance (positive values are front, negative values rear from ego center)" 95 "distance (positive values are front, negative values rear from ego center)" 94 "distance (positive values are front, negative values rear from ego center)" 93 "distance (positive values are front, negative values rear from ego center)" 92 "distance (positive values are front, negative values rear from ego center)" 91 "distance (positive values are front, negative values rear from ego center)" 90 "distance (positive values are front, negative values rear from ego center)" 89 "distance (positive values are front, negative values rear from ego center)" 88 "distance (positive values are front, negative values rear from ego center)" 87 "distance (positive values are front, negative values rear from ego center)" 86 "distance (positive values are front, negative values rear from ego center)" 85 "distance (positive values are front, negative values rear from ego center)" 84 "distance (positive values are front, negative values rear from ego center)" 83 "distance (positive values are front, negative values rear from ego center)" 82 "distance (positive values are front, negative values rear from ego center)" 81 "distance (positive values are front, negative values rear from ego center)" 80 "distance (positive values are front, negative values rear from ego center)" 79 "distance (positive values are front, negative values rear from ego center)" 78 "distance (positive values are front, negative values rear from ego center)" 77 "distance (positive values are front, negative values rear from ego center)" 76 "distance (positive values are front, negative values rear from ego center)" 75 "distance (positive values are front, negative values rear from ego center)" 74 "distance (positive values are front, negative values rear from ego center)" 73 "distance (positive values are front, negative values rear from ego center)" 72 "distance (positive values are front, negative values rear from ego center)" 71 "distance (positive values are front, negative values rear from ego center)" 70 "distance (positive values are front, negative values rear from ego center)" 69 "distance (positive values are front, negative values rear from ego center)" 68 "distance (positive values are front, negative values rear from ego center)" 67 "distance (positive values are front, negative values rear from ego center)" 66 "distance (positive values are front, negative values rear from ego center)" 65 "distance (positive values are front, negative values rear from ego center)" 64 "distance (positive values are front, negative values rear from ego center)" 63 "distance (positive values are front, negative values rear from ego center)" 62 "distance (positive values are front, negative values rear from ego center)" 61 "distance (positive values are front, negative values rear from ego center)" 60 "distance (positive values are front, negative values rear from ego center)" 59 "distance (positive values are front, negative values rear from ego center)" 58 "distance (positive values are front, negative values rear from ego center)" 57 "distance (positive values are front, negative values rear from ego center)" 56 "distance (positive values are front, negative values rear from ego center)" 55 "distance (positive values are front, negative values rear from ego center)" 54 "distance (positive values are front, negative values rear from ego center)" 53 "distance (positive values are front, negative values rear from ego center)" 52 "distance (positive values are front, negative values rear from ego center)" 51 "distance (positive values are front, negative values rear from ego center)" 50 "distance (positive values are front, negative values rear from ego center)" 49 "distance (positive values are front, negative values rear from ego center)" 48 "distance (positive values are front, negative values rear from ego center)" 47 "distance (positive values are front, negative values rear from ego center)" 46 "distance (positive values are front, negative values rear from ego center)" 45 "distance (positive values are front, negative values rear from ego center)" 44 "distance (positive values are front, negative values rear from ego center)" 43 "distance (positive values are front, negative values rear from ego center)" 42 "distance (positive values are front, negative values rear from ego center)" 41 "distance (positive values are front, negative values rear from ego center)" 40 "distance (positive values are front, negative values rear from ego center)" 39 "distance (positive values are front, negative values rear from ego center)" 38 "distance (positive values are front, negative values rear from ego center)" 37 "distance (positive values are front, negative values rear from ego center)" 36 "distance (positive values are front, negative values rear from ego center)" 35 "distance (positive values are front, negative values rear from ego center)" 34 "distance (positive values are front, negative values rear from ego center)" 33 "distance (positive values are front, negative values rear from ego center)" 32 "distance (positive values are front, negative values rear from ego center)" 31 "distance (positive values are front, negative values rear from ego center)" 30 "distance (positive values are front, negative values rear from ego center)" 29 "distance (positive values are front, negative values rear from ego center)" 28 "distance (positive values are front, negative values rear from ego center)" 27 "distance (positive values are front, negative values rear from ego center)" 26 "distance (positive values are front, negative values rear from ego center)" 25 "distance (positive values are front, negative values rear from ego center)" 24 "distance (positive values are front, negative values rear from ego center)" 23 "distance (positive values are front, negative values rear from ego center)" 22 "distance (positive values are front, negative values rear from ego center)" 21 "distance (positive values are front, negative values rear from ego center)" 20 "distance (positive values are front, negative values rear from ego center)" 19 "distance (positive values are front, negative values rear from ego center)" 18 "distance (positive values are front, negative values rear from ego center)" 17 "distance (positive values are front, negative values rear from ego center)" 16 "distance (positive values are front, negative values rear from ego center)" 15 "distance (positive values are front, negative values rear from ego center)" 14 "distance (positive values are front, negative values rear from ego center)" 13 "distance (positive values are front, negative values rear from ego center)" 12 "distance (positive values are front, negative values rear from ego center)" 11 "distance (positive values are front, negative values rear from ego center)" 10 "distance (positive values are front, negative values rear from ego center)" 9 "distance (positive values are front, negative values rear from ego center)" 8 "distance (positive values are front, negative values rear from ego center)" 7 "distance (positive values are front, negative values rear from ego center)" 6 "distance (positive values are front, negative values rear from ego center)" 5 "distance (positive values are front, negative values rear from ego center)" 4 "distance (positive values are front, negative values rear from ego center)" 3 "distance (positive values are front, negative values rear from ego center)" 2 "distance (positive values are front, negative values rear from ego center)" 1 "distance (positive values are front, negative values rear from ego center)" 0 "distance (positive values are front, negative values rear from ego center)" ;
VAL_ 547 AdasHmiNeighboringObj6YOut 255 "distance right from ego center" 254 "distance right from ego center" 253 "distance right from ego center" 252 "distance right from ego center" 251 "distance right from ego center" 250 "distance right from ego center" 249 "distance right from ego center" 248 "distance right from ego center" 247 "distance right from ego center" 246 "distance right from ego center" 245 "distance right from ego center" 244 "distance right from ego center" 243 "distance right from ego center" 242 "distance right from ego center" 241 "distance right from ego center" 240 "distance right from ego center" 239 "distance right from ego center" 238 "distance right from ego center" 237 "distance right from ego center" 236 "distance right from ego center" 235 "distance right from ego center" 234 "distance right from ego center" 233 "distance right from ego center" 232 "distance right from ego center" 231 "distance right from ego center" 230 "distance right from ego center" 229 "distance right from ego center" 228 "distance right from ego center" 227 "distance right from ego center" 226 "distance right from ego center" 225 "distance right from ego center" 224 "distance right from ego center" 223 "distance right from ego center" 222 "distance right from ego center" 221 "distance right from ego center" 220 "distance right from ego center" 219 "distance right from ego center" 218 "distance right from ego center" 217 "distance right from ego center" 216 "distance right from ego center" 215 "distance right from ego center" 214 "distance right from ego center" 213 "distance right from ego center" 212 "distance right from ego center" 211 "distance right from ego center" 210 "distance right from ego center" 209 "distance right from ego center" 208 "distance right from ego center" 207 "distance right from ego center" 206 "distance right from ego center" 205 "distance right from ego center" 204 "distance right from ego center" 203 "distance right from ego center" 202 "distance right from ego center" 201 "distance right from ego center" 200 "distance right from ego center" 199 "distance right from ego center" 198 "distance right from ego center" 197 "distance right from ego center" 196 "distance right from ego center" 195 "distance right from ego center" 194 "distance right from ego center" 193 "distance right from ego center" 192 "distance right from ego center" 191 "distance right from ego center" 190 "distance right from ego center" 189 "distance right from ego center" 188 "distance right from ego center" 187 "distance right from ego center" 186 "distance right from ego center" 185 "distance right from ego center" 184 "distance right from ego center" 183 "distance right from ego center" 182 "distance right from ego center" 181 "distance right from ego center" 180 "distance right from ego center" 179 "distance right from ego center" 178 "distance right from ego center" 177 "distance right from ego center" 176 "distance right from ego center" 175 "distance right from ego center" 174 "distance right from ego center" 173 "distance right from ego center" 172 "distance right from ego center" 171 "distance right from ego center" 170 "distance right from ego center" 169 "distance right from ego center" 168 "distance right from ego center" 167 "distance right from ego center" 166 "distance right from ego center" 165 "distance right from ego center" 164 "distance right from ego center" 163 "distance right from ego center" 162 "distance right from ego center" 161 "distance right from ego center" 160 "distance right from ego center" 159 "distance right from ego center" 158 "distance right from ego center" 157 "distance right from ego center" 156 "distance right from ego center" 155 "distance right from ego center" 154 "distance right from ego center" 153 "distance right from ego center" 152 "distance right from ego center" 151 "distance right from ego center" 150 "distance right from ego center" 149 "distance right from ego center" 148 "distance right from ego center" 147 "distance right from ego center" 146 "distance right from ego center" 145 "distance right from ego center" 144 "distance right from ego center" 143 "distance right from ego center" 142 "distance right from ego center" 141 "distance right from ego center" 140 "distance right from ego center" 139 "distance right from ego center" 138 "distance right from ego center" 137 "distance right from ego center" 136 "distance right from ego center" 135 "distance right from ego center" 134 "distance right from ego center" 133 "distance right from ego center" 132 "distance right from ego center" 131 "distance right from ego center" 130 "distance right from ego center" 129 "distance right from ego center" 128 "distance right from ego center" 127 "distance left from ego center" 126 "distance left from ego center" 125 "distance left from ego center" 124 "distance left from ego center" 123 "distance left from ego center" 122 "distance left from ego center" 121 "distance left from ego center" 120 "distance left from ego center" 119 "distance left from ego center" 118 "distance left from ego center" 117 "distance left from ego center" 116 "distance left from ego center" 115 "distance left from ego center" 114 "distance left from ego center" 113 "distance left from ego center" 112 "distance left from ego center" 111 "distance left from ego center" 110 "distance left from ego center" 109 "distance left from ego center" 108 "distance left from ego center" 107 "distance left from ego center" 106 "distance left from ego center" 105 "distance left from ego center" 104 "distance left from ego center" 103 "distance left from ego center" 102 "distance left from ego center" 101 "distance left from ego center" 100 "distance left from ego center" 99 "distance left from ego center" 98 "distance left from ego center" 97 "distance left from ego center" 96 "distance left from ego center" 95 "distance left from ego center" 94 "distance left from ego center" 93 "distance left from ego center" 92 "distance left from ego center" 91 "distance left from ego center" 90 "distance left from ego center" 89 "distance left from ego center" 88 "distance left from ego center" 87 "distance left from ego center" 86 "distance left from ego center" 85 "distance left from ego center" 84 "distance left from ego center" 83 "distance left from ego center" 82 "distance left from ego center" 81 "distance left from ego center" 80 "distance left from ego center" 79 "distance left from ego center" 78 "distance left from ego center" 77 "distance left from ego center" 76 "distance left from ego center" 75 "distance left from ego center" 74 "distance left from ego center" 73 "distance left from ego center" 72 "distance left from ego center" 71 "distance left from ego center" 70 "distance left from ego center" 69 "distance left from ego center" 68 "distance left from ego center" 67 "distance left from ego center" 66 "distance left from ego center" 65 "distance left from ego center" 64 "distance left from ego center" 63 "distance left from ego center" 62 "distance left from ego center" 61 "distance left from ego center" 60 "distance left from ego center" 59 "distance left from ego center" 58 "distance left from ego center" 57 "distance left from ego center" 56 "distance left from ego center" 55 "distance left from ego center" 54 "distance left from ego center" 53 "distance left from ego center" 52 "distance left from ego center" 51 "distance left from ego center" 50 "distance left from ego center" 49 "distance left from ego center" 48 "distance left from ego center" 47 "distance left from ego center" 46 "distance left from ego center" 45 "distance left from ego center" 44 "distance left from ego center" 43 "distance left from ego center" 42 "distance left from ego center" 41 "distance left from ego center" 40 "distance left from ego center" 39 "distance left from ego center" 38 "distance left from ego center" 37 "distance left from ego center" 36 "distance left from ego center" 35 "distance left from ego center" 34 "distance left from ego center" 33 "distance left from ego center" 32 "distance left from ego center" 31 "distance left from ego center" 30 "distance left from ego center" 29 "distance left from ego center" 28 "distance left from ego center" 27 "distance left from ego center" 26 "distance left from ego center" 25 "distance left from ego center" 24 "distance left from ego center" 23 "distance left from ego center" 22 "distance left from ego center" 21 "distance left from ego center" 20 "distance left from ego center" 19 "distance left from ego center" 18 "distance left from ego center" 17 "distance left from ego center" 16 "distance left from ego center" 15 "distance left from ego center" 14 "distance left from ego center" 13 "distance left from ego center" 12 "distance left from ego center" 11 "distance left from ego center" 10 "distance left from ego center" 9 "distance left from ego center" 8 "distance left from ego center" 7 "distance left from ego center" 6 "distance left from ego center" 5 "distance left from ego center" 4 "distance left from ego center" 3 "distance left from ego center" 2 "distance left from ego center" 1 "distance left from ego center" 0 "distance left from ego center" ;
VAL_ 547 AdasHmiNeighboringObj7ObjTyp 7 "reserved" 6 "three-wheeler 三轮车" 5 "bus 公共汽车" 4 "pedestrian 行人" 3 "motorbike/Bicycle 二轮车" 2 "truck 卡车" 1 "passenger car 小轿车" 0 "Object not present" ;
VAL_ 547 AdasHmiNeighboringObj7XOut 255 "distance (positive values are front, negative values rear from ego center)" 254 "distance (positive values are front, negative values rear from ego center)" 253 "distance (positive values are front, negative values rear from ego center)" 252 "distance (positive values are front, negative values rear from ego center)" 251 "distance (positive values are front, negative values rear from ego center)" 250 "distance (positive values are front, negative values rear from ego center)" 249 "distance (positive values are front, negative values rear from ego center)" 248 "distance (positive values are front, negative values rear from ego center)" 247 "distance (positive values are front, negative values rear from ego center)" 246 "distance (positive values are front, negative values rear from ego center)" 245 "distance (positive values are front, negative values rear from ego center)" 244 "distance (positive values are front, negative values rear from ego center)" 243 "distance (positive values are front, negative values rear from ego center)" 242 "distance (positive values are front, negative values rear from ego center)" 241 "distance (positive values are front, negative values rear from ego center)" 240 "distance (positive values are front, negative values rear from ego center)" 239 "distance (positive values are front, negative values rear from ego center)" 238 "distance (positive values are front, negative values rear from ego center)" 237 "distance (positive values are front, negative values rear from ego center)" 236 "distance (positive values are front, negative values rear from ego center)" 235 "distance (positive values are front, negative values rear from ego center)" 234 "distance (positive values are front, negative values rear from ego center)" 233 "distance (positive values are front, negative values rear from ego center)" 232 "distance (positive values are front, negative values rear from ego center)" 231 "distance (positive values are front, negative values rear from ego center)" 230 "distance (positive values are front, negative values rear from ego center)" 229 "distance (positive values are front, negative values rear from ego center)" 228 "distance (positive values are front, negative values rear from ego center)" 227 "distance (positive values are front, negative values rear from ego center)" 226 "distance (positive values are front, negative values rear from ego center)" 225 "distance (positive values are front, negative values rear from ego center)" 224 "distance (positive values are front, negative values rear from ego center)" 223 "distance (positive values are front, negative values rear from ego center)" 222 "distance (positive values are front, negative values rear from ego center)" 221 "distance (positive values are front, negative values rear from ego center)" 220 "distance (positive values are front, negative values rear from ego center)" 219 "distance (positive values are front, negative values rear from ego center)" 218 "distance (positive values are front, negative values rear from ego center)" 217 "distance (positive values are front, negative values rear from ego center)" 216 "distance (positive values are front, negative values rear from ego center)" 215 "distance (positive values are front, negative values rear from ego center)" 214 "distance (positive values are front, negative values rear from ego center)" 213 "distance (positive values are front, negative values rear from ego center)" 212 "distance (positive values are front, negative values rear from ego center)" 211 "distance (positive values are front, negative values rear from ego center)" 210 "distance (positive values are front, negative values rear from ego center)" 209 "distance (positive values are front, negative values rear from ego center)" 208 "distance (positive values are front, negative values rear from ego center)" 207 "distance (positive values are front, negative values rear from ego center)" 206 "distance (positive values are front, negative values rear from ego center)" 205 "distance (positive values are front, negative values rear from ego center)" 204 "distance (positive values are front, negative values rear from ego center)" 203 "distance (positive values are front, negative values rear from ego center)" 202 "distance (positive values are front, negative values rear from ego center)" 201 "distance (positive values are front, negative values rear from ego center)" 200 "distance (positive values are front, negative values rear from ego center)" 199 "distance (positive values are front, negative values rear from ego center)" 198 "distance (positive values are front, negative values rear from ego center)" 197 "distance (positive values are front, negative values rear from ego center)" 196 "distance (positive values are front, negative values rear from ego center)" 195 "distance (positive values are front, negative values rear from ego center)" 194 "distance (positive values are front, negative values rear from ego center)" 193 "distance (positive values are front, negative values rear from ego center)" 192 "distance (positive values are front, negative values rear from ego center)" 191 "distance (positive values are front, negative values rear from ego center)" 190 "distance (positive values are front, negative values rear from ego center)" 189 "distance (positive values are front, negative values rear from ego center)" 188 "distance (positive values are front, negative values rear from ego center)" 187 "distance (positive values are front, negative values rear from ego center)" 186 "distance (positive values are front, negative values rear from ego center)" 185 "distance (positive values are front, negative values rear from ego center)" 184 "distance (positive values are front, negative values rear from ego center)" 183 "distance (positive values are front, negative values rear from ego center)" 182 "distance (positive values are front, negative values rear from ego center)" 181 "distance (positive values are front, negative values rear from ego center)" 180 "distance (positive values are front, negative values rear from ego center)" 179 "distance (positive values are front, negative values rear from ego center)" 178 "distance (positive values are front, negative values rear from ego center)" 177 "distance (positive values are front, negative values rear from ego center)" 176 "distance (positive values are front, negative values rear from ego center)" 175 "distance (positive values are front, negative values rear from ego center)" 174 "distance (positive values are front, negative values rear from ego center)" 173 "distance (positive values are front, negative values rear from ego center)" 172 "distance (positive values are front, negative values rear from ego center)" 171 "distance (positive values are front, negative values rear from ego center)" 170 "distance (positive values are front, negative values rear from ego center)" 169 "distance (positive values are front, negative values rear from ego center)" 168 "distance (positive values are front, negative values rear from ego center)" 167 "distance (positive values are front, negative values rear from ego center)" 166 "distance (positive values are front, negative values rear from ego center)" 165 "distance (positive values are front, negative values rear from ego center)" 164 "distance (positive values are front, negative values rear from ego center)" 163 "distance (positive values are front, negative values rear from ego center)" 162 "distance (positive values are front, negative values rear from ego center)" 161 "distance (positive values are front, negative values rear from ego center)" 160 "distance (positive values are front, negative values rear from ego center)" 159 "distance (positive values are front, negative values rear from ego center)" 158 "distance (positive values are front, negative values rear from ego center)" 157 "distance (positive values are front, negative values rear from ego center)" 156 "distance (positive values are front, negative values rear from ego center)" 155 "distance (positive values are front, negative values rear from ego center)" 154 "distance (positive values are front, negative values rear from ego center)" 153 "distance (positive values are front, negative values rear from ego center)" 152 "distance (positive values are front, negative values rear from ego center)" 151 "distance (positive values are front, negative values rear from ego center)" 150 "distance (positive values are front, negative values rear from ego center)" 149 "distance (positive values are front, negative values rear from ego center)" 148 "distance (positive values are front, negative values rear from ego center)" 147 "distance (positive values are front, negative values rear from ego center)" 146 "distance (positive values are front, negative values rear from ego center)" 145 "distance (positive values are front, negative values rear from ego center)" 144 "distance (positive values are front, negative values rear from ego center)" 143 "distance (positive values are front, negative values rear from ego center)" 142 "distance (positive values are front, negative values rear from ego center)" 141 "distance (positive values are front, negative values rear from ego center)" 140 "distance (positive values are front, negative values rear from ego center)" 139 "distance (positive values are front, negative values rear from ego center)" 138 "distance (positive values are front, negative values rear from ego center)" 137 "distance (positive values are front, negative values rear from ego center)" 136 "distance (positive values are front, negative values rear from ego center)" 135 "distance (positive values are front, negative values rear from ego center)" 134 "distance (positive values are front, negative values rear from ego center)" 133 "distance (positive values are front, negative values rear from ego center)" 132 "distance (positive values are front, negative values rear from ego center)" 131 "distance (positive values are front, negative values rear from ego center)" 130 "distance (positive values are front, negative values rear from ego center)" 129 "distance (positive values are front, negative values rear from ego center)" 128 "distance (positive values are front, negative values rear from ego center)" 127 "distance (positive values are front, negative values rear from ego center)" 126 "distance (positive values are front, negative values rear from ego center)" 125 "distance (positive values are front, negative values rear from ego center)" 124 "distance (positive values are front, negative values rear from ego center)" 123 "distance (positive values are front, negative values rear from ego center)" 122 "distance (positive values are front, negative values rear from ego center)" 121 "distance (positive values are front, negative values rear from ego center)" 120 "distance (positive values are front, negative values rear from ego center)" 119 "distance (positive values are front, negative values rear from ego center)" 118 "distance (positive values are front, negative values rear from ego center)" 117 "distance (positive values are front, negative values rear from ego center)" 116 "distance (positive values are front, negative values rear from ego center)" 115 "distance (positive values are front, negative values rear from ego center)" 114 "distance (positive values are front, negative values rear from ego center)" 113 "distance (positive values are front, negative values rear from ego center)" 112 "distance (positive values are front, negative values rear from ego center)" 111 "distance (positive values are front, negative values rear from ego center)" 110 "distance (positive values are front, negative values rear from ego center)" 109 "distance (positive values are front, negative values rear from ego center)" 108 "distance (positive values are front, negative values rear from ego center)" 107 "distance (positive values are front, negative values rear from ego center)" 106 "distance (positive values are front, negative values rear from ego center)" 105 "distance (positive values are front, negative values rear from ego center)" 104 "distance (positive values are front, negative values rear from ego center)" 103 "distance (positive values are front, negative values rear from ego center)" 102 "distance (positive values are front, negative values rear from ego center)" 101 "distance (positive values are front, negative values rear from ego center)" 100 "distance (positive values are front, negative values rear from ego center)" 99 "distance (positive values are front, negative values rear from ego center)" 98 "distance (positive values are front, negative values rear from ego center)" 97 "distance (positive values are front, negative values rear from ego center)" 96 "distance (positive values are front, negative values rear from ego center)" 95 "distance (positive values are front, negative values rear from ego center)" 94 "distance (positive values are front, negative values rear from ego center)" 93 "distance (positive values are front, negative values rear from ego center)" 92 "distance (positive values are front, negative values rear from ego center)" 91 "distance (positive values are front, negative values rear from ego center)" 90 "distance (positive values are front, negative values rear from ego center)" 89 "distance (positive values are front, negative values rear from ego center)" 88 "distance (positive values are front, negative values rear from ego center)" 87 "distance (positive values are front, negative values rear from ego center)" 86 "distance (positive values are front, negative values rear from ego center)" 85 "distance (positive values are front, negative values rear from ego center)" 84 "distance (positive values are front, negative values rear from ego center)" 83 "distance (positive values are front, negative values rear from ego center)" 82 "distance (positive values are front, negative values rear from ego center)" 81 "distance (positive values are front, negative values rear from ego center)" 80 "distance (positive values are front, negative values rear from ego center)" 79 "distance (positive values are front, negative values rear from ego center)" 78 "distance (positive values are front, negative values rear from ego center)" 77 "distance (positive values are front, negative values rear from ego center)" 76 "distance (positive values are front, negative values rear from ego center)" 75 "distance (positive values are front, negative values rear from ego center)" 74 "distance (positive values are front, negative values rear from ego center)" 73 "distance (positive values are front, negative values rear from ego center)" 72 "distance (positive values are front, negative values rear from ego center)" 71 "distance (positive values are front, negative values rear from ego center)" 70 "distance (positive values are front, negative values rear from ego center)" 69 "distance (positive values are front, negative values rear from ego center)" 68 "distance (positive values are front, negative values rear from ego center)" 67 "distance (positive values are front, negative values rear from ego center)" 66 "distance (positive values are front, negative values rear from ego center)" 65 "distance (positive values are front, negative values rear from ego center)" 64 "distance (positive values are front, negative values rear from ego center)" 63 "distance (positive values are front, negative values rear from ego center)" 62 "distance (positive values are front, negative values rear from ego center)" 61 "distance (positive values are front, negative values rear from ego center)" 60 "distance (positive values are front, negative values rear from ego center)" 59 "distance (positive values are front, negative values rear from ego center)" 58 "distance (positive values are front, negative values rear from ego center)" 57 "distance (positive values are front, negative values rear from ego center)" 56 "distance (positive values are front, negative values rear from ego center)" 55 "distance (positive values are front, negative values rear from ego center)" 54 "distance (positive values are front, negative values rear from ego center)" 53 "distance (positive values are front, negative values rear from ego center)" 52 "distance (positive values are front, negative values rear from ego center)" 51 "distance (positive values are front, negative values rear from ego center)" 50 "distance (positive values are front, negative values rear from ego center)" 49 "distance (positive values are front, negative values rear from ego center)" 48 "distance (positive values are front, negative values rear from ego center)" 47 "distance (positive values are front, negative values rear from ego center)" 46 "distance (positive values are front, negative values rear from ego center)" 45 "distance (positive values are front, negative values rear from ego center)" 44 "distance (positive values are front, negative values rear from ego center)" 43 "distance (positive values are front, negative values rear from ego center)" 42 "distance (positive values are front, negative values rear from ego center)" 41 "distance (positive values are front, negative values rear from ego center)" 40 "distance (positive values are front, negative values rear from ego center)" 39 "distance (positive values are front, negative values rear from ego center)" 38 "distance (positive values are front, negative values rear from ego center)" 37 "distance (positive values are front, negative values rear from ego center)" 36 "distance (positive values are front, negative values rear from ego center)" 35 "distance (positive values are front, negative values rear from ego center)" 34 "distance (positive values are front, negative values rear from ego center)" 33 "distance (positive values are front, negative values rear from ego center)" 32 "distance (positive values are front, negative values rear from ego center)" 31 "distance (positive values are front, negative values rear from ego center)" 30 "distance (positive values are front, negative values rear from ego center)" 29 "distance (positive values are front, negative values rear from ego center)" 28 "distance (positive values are front, negative values rear from ego center)" 27 "distance (positive values are front, negative values rear from ego center)" 26 "distance (positive values are front, negative values rear from ego center)" 25 "distance (positive values are front, negative values rear from ego center)" 24 "distance (positive values are front, negative values rear from ego center)" 23 "distance (positive values are front, negative values rear from ego center)" 22 "distance (positive values are front, negative values rear from ego center)" 21 "distance (positive values are front, negative values rear from ego center)" 20 "distance (positive values are front, negative values rear from ego center)" 19 "distance (positive values are front, negative values rear from ego center)" 18 "distance (positive values are front, negative values rear from ego center)" 17 "distance (positive values are front, negative values rear from ego center)" 16 "distance (positive values are front, negative values rear from ego center)" 15 "distance (positive values are front, negative values rear from ego center)" 14 "distance (positive values are front, negative values rear from ego center)" 13 "distance (positive values are front, negative values rear from ego center)" 12 "distance (positive values are front, negative values rear from ego center)" 11 "distance (positive values are front, negative values rear from ego center)" 10 "distance (positive values are front, negative values rear from ego center)" 9 "distance (positive values are front, negative values rear from ego center)" 8 "distance (positive values are front, negative values rear from ego center)" 7 "distance (positive values are front, negative values rear from ego center)" 6 "distance (positive values are front, negative values rear from ego center)" 5 "distance (positive values are front, negative values rear from ego center)" 4 "distance (positive values are front, negative values rear from ego center)" 3 "distance (positive values are front, negative values rear from ego center)" 2 "distance (positive values are front, negative values rear from ego center)" 1 "distance (positive values are front, negative values rear from ego center)" 0 "distance (positive values are front, negative values rear from ego center)" ;
VAL_ 547 AdasHmiNeighboringObj7YOut 255 "distance right from ego center" 254 "distance right from ego center" 253 "distance right from ego center" 252 "distance right from ego center" 251 "distance right from ego center" 250 "distance right from ego center" 249 "distance right from ego center" 248 "distance right from ego center" 247 "distance right from ego center" 246 "distance right from ego center" 245 "distance right from ego center" 244 "distance right from ego center" 243 "distance right from ego center" 242 "distance right from ego center" 241 "distance right from ego center" 240 "distance right from ego center" 239 "distance right from ego center" 238 "distance right from ego center" 237 "distance right from ego center" 236 "distance right from ego center" 235 "distance right from ego center" 234 "distance right from ego center" 233 "distance right from ego center" 232 "distance right from ego center" 231 "distance right from ego center" 230 "distance right from ego center" 229 "distance right from ego center" 228 "distance right from ego center" 227 "distance right from ego center" 226 "distance right from ego center" 225 "distance right from ego center" 224 "distance right from ego center" 223 "distance right from ego center" 222 "distance right from ego center" 221 "distance right from ego center" 220 "distance right from ego center" 219 "distance right from ego center" 218 "distance right from ego center" 217 "distance right from ego center" 216 "distance right from ego center" 215 "distance right from ego center" 214 "distance right from ego center" 213 "distance right from ego center" 212 "distance right from ego center" 211 "distance right from ego center" 210 "distance right from ego center" 209 "distance right from ego center" 208 "distance right from ego center" 207 "distance right from ego center" 206 "distance right from ego center" 205 "distance right from ego center" 204 "distance right from ego center" 203 "distance right from ego center" 202 "distance right from ego center" 201 "distance right from ego center" 200 "distance right from ego center" 199 "distance right from ego center" 198 "distance right from ego center" 197 "distance right from ego center" 196 "distance right from ego center" 195 "distance right from ego center" 194 "distance right from ego center" 193 "distance right from ego center" 192 "distance right from ego center" 191 "distance right from ego center" 190 "distance right from ego center" 189 "distance right from ego center" 188 "distance right from ego center" 187 "distance right from ego center" 186 "distance right from ego center" 185 "distance right from ego center" 184 "distance right from ego center" 183 "distance right from ego center" 182 "distance right from ego center" 181 "distance right from ego center" 180 "distance right from ego center" 179 "distance right from ego center" 178 "distance right from ego center" 177 "distance right from ego center" 176 "distance right from ego center" 175 "distance right from ego center" 174 "distance right from ego center" 173 "distance right from ego center" 172 "distance right from ego center" 171 "distance right from ego center" 170 "distance right from ego center" 169 "distance right from ego center" 168 "distance right from ego center" 167 "distance right from ego center" 166 "distance right from ego center" 165 "distance right from ego center" 164 "distance right from ego center" 163 "distance right from ego center" 162 "distance right from ego center" 161 "distance right from ego center" 160 "distance right from ego center" 159 "distance right from ego center" 158 "distance right from ego center" 157 "distance right from ego center" 156 "distance right from ego center" 155 "distance right from ego center" 154 "distance right from ego center" 153 "distance right from ego center" 152 "distance right from ego center" 151 "distance right from ego center" 150 "distance right from ego center" 149 "distance right from ego center" 148 "distance right from ego center" 147 "distance right from ego center" 146 "distance right from ego center" 145 "distance right from ego center" 144 "distance right from ego center" 143 "distance right from ego center" 142 "distance right from ego center" 141 "distance right from ego center" 140 "distance right from ego center" 139 "distance right from ego center" 138 "distance right from ego center" 137 "distance right from ego center" 136 "distance right from ego center" 135 "distance right from ego center" 134 "distance right from ego center" 133 "distance right from ego center" 132 "distance right from ego center" 131 "distance right from ego center" 130 "distance right from ego center" 129 "distance right from ego center" 128 "distance right from ego center" 127 "distance left from ego center" 126 "distance left from ego center" 125 "distance left from ego center" 124 "distance left from ego center" 123 "distance left from ego center" 122 "distance left from ego center" 121 "distance left from ego center" 120 "distance left from ego center" 119 "distance left from ego center" 118 "distance left from ego center" 117 "distance left from ego center" 116 "distance left from ego center" 115 "distance left from ego center" 114 "distance left from ego center" 113 "distance left from ego center" 112 "distance left from ego center" 111 "distance left from ego center" 110 "distance left from ego center" 109 "distance left from ego center" 108 "distance left from ego center" 107 "distance left from ego center" 106 "distance left from ego center" 105 "distance left from ego center" 104 "distance left from ego center" 103 "distance left from ego center" 102 "distance left from ego center" 101 "distance left from ego center" 100 "distance left from ego center" 99 "distance left from ego center" 98 "distance left from ego center" 97 "distance left from ego center" 96 "distance left from ego center" 95 "distance left from ego center" 94 "distance left from ego center" 93 "distance left from ego center" 92 "distance left from ego center" 91 "distance left from ego center" 90 "distance left from ego center" 89 "distance left from ego center" 88 "distance left from ego center" 87 "distance left from ego center" 86 "distance left from ego center" 85 "distance left from ego center" 84 "distance left from ego center" 83 "distance left from ego center" 82 "distance left from ego center" 81 "distance left from ego center" 80 "distance left from ego center" 79 "distance left from ego center" 78 "distance left from ego center" 77 "distance left from ego center" 76 "distance left from ego center" 75 "distance left from ego center" 74 "distance left from ego center" 73 "distance left from ego center" 72 "distance left from ego center" 71 "distance left from ego center" 70 "distance left from ego center" 69 "distance left from ego center" 68 "distance left from ego center" 67 "distance left from ego center" 66 "distance left from ego center" 65 "distance left from ego center" 64 "distance left from ego center" 63 "distance left from ego center" 62 "distance left from ego center" 61 "distance left from ego center" 60 "distance left from ego center" 59 "distance left from ego center" 58 "distance left from ego center" 57 "distance left from ego center" 56 "distance left from ego center" 55 "distance left from ego center" 54 "distance left from ego center" 53 "distance left from ego center" 52 "distance left from ego center" 51 "distance left from ego center" 50 "distance left from ego center" 49 "distance left from ego center" 48 "distance left from ego center" 47 "distance left from ego center" 46 "distance left from ego center" 45 "distance left from ego center" 44 "distance left from ego center" 43 "distance left from ego center" 42 "distance left from ego center" 41 "distance left from ego center" 40 "distance left from ego center" 39 "distance left from ego center" 38 "distance left from ego center" 37 "distance left from ego center" 36 "distance left from ego center" 35 "distance left from ego center" 34 "distance left from ego center" 33 "distance left from ego center" 32 "distance left from ego center" 31 "distance left from ego center" 30 "distance left from ego center" 29 "distance left from ego center" 28 "distance left from ego center" 27 "distance left from ego center" 26 "distance left from ego center" 25 "distance left from ego center" 24 "distance left from ego center" 23 "distance left from ego center" 22 "distance left from ego center" 21 "distance left from ego center" 20 "distance left from ego center" 19 "distance left from ego center" 18 "distance left from ego center" 17 "distance left from ego center" 16 "distance left from ego center" 15 "distance left from ego center" 14 "distance left from ego center" 13 "distance left from ego center" 12 "distance left from ego center" 11 "distance left from ego center" 10 "distance left from ego center" 9 "distance left from ego center" 8 "distance left from ego center" 7 "distance left from ego center" 6 "distance left from ego center" 5 "distance left from ego center" 4 "distance left from ego center" 3 "distance left from ego center" 2 "distance left from ego center" 1 "distance left from ego center" 0 "distance left from ego center" ;
VAL_ 547 AdasHmiNeighboringObj8ObjTyp 7 "reserved" 6 "three-wheeler 三轮车" 5 "bus 公共汽车" 4 "pedestrian 行人" 3 "motorbike/Bicycle 二轮车" 2 "truck 卡车" 1 "passenger car 小轿车" 0 "Object not present" ;
VAL_ 547 AdasHmiNeighboringObj8XOut 255 "distance (positive values are front, negative values rear from ego center)" 254 "distance (positive values are front, negative values rear from ego center)" 253 "distance (positive values are front, negative values rear from ego center)" 252 "distance (positive values are front, negative values rear from ego center)" 251 "distance (positive values are front, negative values rear from ego center)" 250 "distance (positive values are front, negative values rear from ego center)" 249 "distance (positive values are front, negative values rear from ego center)" 248 "distance (positive values are front, negative values rear from ego center)" 247 "distance (positive values are front, negative values rear from ego center)" 246 "distance (positive values are front, negative values rear from ego center)" 245 "distance (positive values are front, negative values rear from ego center)" 244 "distance (positive values are front, negative values rear from ego center)" 243 "distance (positive values are front, negative values rear from ego center)" 242 "distance (positive values are front, negative values rear from ego center)" 241 "distance (positive values are front, negative values rear from ego center)" 240 "distance (positive values are front, negative values rear from ego center)" 239 "distance (positive values are front, negative values rear from ego center)" 238 "distance (positive values are front, negative values rear from ego center)" 237 "distance (positive values are front, negative values rear from ego center)" 236 "distance (positive values are front, negative values rear from ego center)" 235 "distance (positive values are front, negative values rear from ego center)" 234 "distance (positive values are front, negative values rear from ego center)" 233 "distance (positive values are front, negative values rear from ego center)" 232 "distance (positive values are front, negative values rear from ego center)" 231 "distance (positive values are front, negative values rear from ego center)" 230 "distance (positive values are front, negative values rear from ego center)" 229 "distance (positive values are front, negative values rear from ego center)" 228 "distance (positive values are front, negative values rear from ego center)" 227 "distance (positive values are front, negative values rear from ego center)" 226 "distance (positive values are front, negative values rear from ego center)" 225 "distance (positive values are front, negative values rear from ego center)" 224 "distance (positive values are front, negative values rear from ego center)" 223 "distance (positive values are front, negative values rear from ego center)" 222 "distance (positive values are front, negative values rear from ego center)" 221 "distance (positive values are front, negative values rear from ego center)" 220 "distance (positive values are front, negative values rear from ego center)" 219 "distance (positive values are front, negative values rear from ego center)" 218 "distance (positive values are front, negative values rear from ego center)" 217 "distance (positive values are front, negative values rear from ego center)" 216 "distance (positive values are front, negative values rear from ego center)" 215 "distance (positive values are front, negative values rear from ego center)" 214 "distance (positive values are front, negative values rear from ego center)" 213 "distance (positive values are front, negative values rear from ego center)" 212 "distance (positive values are front, negative values rear from ego center)" 211 "distance (positive values are front, negative values rear from ego center)" 210 "distance (positive values are front, negative values rear from ego center)" 209 "distance (positive values are front, negative values rear from ego center)" 208 "distance (positive values are front, negative values rear from ego center)" 207 "distance (positive values are front, negative values rear from ego center)" 206 "distance (positive values are front, negative values rear from ego center)" 205 "distance (positive values are front, negative values rear from ego center)" 204 "distance (positive values are front, negative values rear from ego center)" 203 "distance (positive values are front, negative values rear from ego center)" 202 "distance (positive values are front, negative values rear from ego center)" 201 "distance (positive values are front, negative values rear from ego center)" 200 "distance (positive values are front, negative values rear from ego center)" 199 "distance (positive values are front, negative values rear from ego center)" 198 "distance (positive values are front, negative values rear from ego center)" 197 "distance (positive values are front, negative values rear from ego center)" 196 "distance (positive values are front, negative values rear from ego center)" 195 "distance (positive values are front, negative values rear from ego center)" 194 "distance (positive values are front, negative values rear from ego center)" 193 "distance (positive values are front, negative values rear from ego center)" 192 "distance (positive values are front, negative values rear from ego center)" 191 "distance (positive values are front, negative values rear from ego center)" 190 "distance (positive values are front, negative values rear from ego center)" 189 "distance (positive values are front, negative values rear from ego center)" 188 "distance (positive values are front, negative values rear from ego center)" 187 "distance (positive values are front, negative values rear from ego center)" 186 "distance (positive values are front, negative values rear from ego center)" 185 "distance (positive values are front, negative values rear from ego center)" 184 "distance (positive values are front, negative values rear from ego center)" 183 "distance (positive values are front, negative values rear from ego center)" 182 "distance (positive values are front, negative values rear from ego center)" 181 "distance (positive values are front, negative values rear from ego center)" 180 "distance (positive values are front, negative values rear from ego center)" 179 "distance (positive values are front, negative values rear from ego center)" 178 "distance (positive values are front, negative values rear from ego center)" 177 "distance (positive values are front, negative values rear from ego center)" 176 "distance (positive values are front, negative values rear from ego center)" 175 "distance (positive values are front, negative values rear from ego center)" 174 "distance (positive values are front, negative values rear from ego center)" 173 "distance (positive values are front, negative values rear from ego center)" 172 "distance (positive values are front, negative values rear from ego center)" 171 "distance (positive values are front, negative values rear from ego center)" 170 "distance (positive values are front, negative values rear from ego center)" 169 "distance (positive values are front, negative values rear from ego center)" 168 "distance (positive values are front, negative values rear from ego center)" 167 "distance (positive values are front, negative values rear from ego center)" 166 "distance (positive values are front, negative values rear from ego center)" 165 "distance (positive values are front, negative values rear from ego center)" 164 "distance (positive values are front, negative values rear from ego center)" 163 "distance (positive values are front, negative values rear from ego center)" 162 "distance (positive values are front, negative values rear from ego center)" 161 "distance (positive values are front, negative values rear from ego center)" 160 "distance (positive values are front, negative values rear from ego center)" 159 "distance (positive values are front, negative values rear from ego center)" 158 "distance (positive values are front, negative values rear from ego center)" 157 "distance (positive values are front, negative values rear from ego center)" 156 "distance (positive values are front, negative values rear from ego center)" 155 "distance (positive values are front, negative values rear from ego center)" 154 "distance (positive values are front, negative values rear from ego center)" 153 "distance (positive values are front, negative values rear from ego center)" 152 "distance (positive values are front, negative values rear from ego center)" 151 "distance (positive values are front, negative values rear from ego center)" 150 "distance (positive values are front, negative values rear from ego center)" 149 "distance (positive values are front, negative values rear from ego center)" 148 "distance (positive values are front, negative values rear from ego center)" 147 "distance (positive values are front, negative values rear from ego center)" 146 "distance (positive values are front, negative values rear from ego center)" 145 "distance (positive values are front, negative values rear from ego center)" 144 "distance (positive values are front, negative values rear from ego center)" 143 "distance (positive values are front, negative values rear from ego center)" 142 "distance (positive values are front, negative values rear from ego center)" 141 "distance (positive values are front, negative values rear from ego center)" 140 "distance (positive values are front, negative values rear from ego center)" 139 "distance (positive values are front, negative values rear from ego center)" 138 "distance (positive values are front, negative values rear from ego center)" 137 "distance (positive values are front, negative values rear from ego center)" 136 "distance (positive values are front, negative values rear from ego center)" 135 "distance (positive values are front, negative values rear from ego center)" 134 "distance (positive values are front, negative values rear from ego center)" 133 "distance (positive values are front, negative values rear from ego center)" 132 "distance (positive values are front, negative values rear from ego center)" 131 "distance (positive values are front, negative values rear from ego center)" 130 "distance (positive values are front, negative values rear from ego center)" 129 "distance (positive values are front, negative values rear from ego center)" 128 "distance (positive values are front, negative values rear from ego center)" 127 "distance (positive values are front, negative values rear from ego center)" 126 "distance (positive values are front, negative values rear from ego center)" 125 "distance (positive values are front, negative values rear from ego center)" 124 "distance (positive values are front, negative values rear from ego center)" 123 "distance (positive values are front, negative values rear from ego center)" 122 "distance (positive values are front, negative values rear from ego center)" 121 "distance (positive values are front, negative values rear from ego center)" 120 "distance (positive values are front, negative values rear from ego center)" 119 "distance (positive values are front, negative values rear from ego center)" 118 "distance (positive values are front, negative values rear from ego center)" 117 "distance (positive values are front, negative values rear from ego center)" 116 "distance (positive values are front, negative values rear from ego center)" 115 "distance (positive values are front, negative values rear from ego center)" 114 "distance (positive values are front, negative values rear from ego center)" 113 "distance (positive values are front, negative values rear from ego center)" 112 "distance (positive values are front, negative values rear from ego center)" 111 "distance (positive values are front, negative values rear from ego center)" 110 "distance (positive values are front, negative values rear from ego center)" 109 "distance (positive values are front, negative values rear from ego center)" 108 "distance (positive values are front, negative values rear from ego center)" 107 "distance (positive values are front, negative values rear from ego center)" 106 "distance (positive values are front, negative values rear from ego center)" 105 "distance (positive values are front, negative values rear from ego center)" 104 "distance (positive values are front, negative values rear from ego center)" 103 "distance (positive values are front, negative values rear from ego center)" 102 "distance (positive values are front, negative values rear from ego center)" 101 "distance (positive values are front, negative values rear from ego center)" 100 "distance (positive values are front, negative values rear from ego center)" 99 "distance (positive values are front, negative values rear from ego center)" 98 "distance (positive values are front, negative values rear from ego center)" 97 "distance (positive values are front, negative values rear from ego center)" 96 "distance (positive values are front, negative values rear from ego center)" 95 "distance (positive values are front, negative values rear from ego center)" 94 "distance (positive values are front, negative values rear from ego center)" 93 "distance (positive values are front, negative values rear from ego center)" 92 "distance (positive values are front, negative values rear from ego center)" 91 "distance (positive values are front, negative values rear from ego center)" 90 "distance (positive values are front, negative values rear from ego center)" 89 "distance (positive values are front, negative values rear from ego center)" 88 "distance (positive values are front, negative values rear from ego center)" 87 "distance (positive values are front, negative values rear from ego center)" 86 "distance (positive values are front, negative values rear from ego center)" 85 "distance (positive values are front, negative values rear from ego center)" 84 "distance (positive values are front, negative values rear from ego center)" 83 "distance (positive values are front, negative values rear from ego center)" 82 "distance (positive values are front, negative values rear from ego center)" 81 "distance (positive values are front, negative values rear from ego center)" 80 "distance (positive values are front, negative values rear from ego center)" 79 "distance (positive values are front, negative values rear from ego center)" 78 "distance (positive values are front, negative values rear from ego center)" 77 "distance (positive values are front, negative values rear from ego center)" 76 "distance (positive values are front, negative values rear from ego center)" 75 "distance (positive values are front, negative values rear from ego center)" 74 "distance (positive values are front, negative values rear from ego center)" 73 "distance (positive values are front, negative values rear from ego center)" 72 "distance (positive values are front, negative values rear from ego center)" 71 "distance (positive values are front, negative values rear from ego center)" 70 "distance (positive values are front, negative values rear from ego center)" 69 "distance (positive values are front, negative values rear from ego center)" 68 "distance (positive values are front, negative values rear from ego center)" 67 "distance (positive values are front, negative values rear from ego center)" 66 "distance (positive values are front, negative values rear from ego center)" 65 "distance (positive values are front, negative values rear from ego center)" 64 "distance (positive values are front, negative values rear from ego center)" 63 "distance (positive values are front, negative values rear from ego center)" 62 "distance (positive values are front, negative values rear from ego center)" 61 "distance (positive values are front, negative values rear from ego center)" 60 "distance (positive values are front, negative values rear from ego center)" 59 "distance (positive values are front, negative values rear from ego center)" 58 "distance (positive values are front, negative values rear from ego center)" 57 "distance (positive values are front, negative values rear from ego center)" 56 "distance (positive values are front, negative values rear from ego center)" 55 "distance (positive values are front, negative values rear from ego center)" 54 "distance (positive values are front, negative values rear from ego center)" 53 "distance (positive values are front, negative values rear from ego center)" 52 "distance (positive values are front, negative values rear from ego center)" 51 "distance (positive values are front, negative values rear from ego center)" 50 "distance (positive values are front, negative values rear from ego center)" 49 "distance (positive values are front, negative values rear from ego center)" 48 "distance (positive values are front, negative values rear from ego center)" 47 "distance (positive values are front, negative values rear from ego center)" 46 "distance (positive values are front, negative values rear from ego center)" 45 "distance (positive values are front, negative values rear from ego center)" 44 "distance (positive values are front, negative values rear from ego center)" 43 "distance (positive values are front, negative values rear from ego center)" 42 "distance (positive values are front, negative values rear from ego center)" 41 "distance (positive values are front, negative values rear from ego center)" 40 "distance (positive values are front, negative values rear from ego center)" 39 "distance (positive values are front, negative values rear from ego center)" 38 "distance (positive values are front, negative values rear from ego center)" 37 "distance (positive values are front, negative values rear from ego center)" 36 "distance (positive values are front, negative values rear from ego center)" 35 "distance (positive values are front, negative values rear from ego center)" 34 "distance (positive values are front, negative values rear from ego center)" 33 "distance (positive values are front, negative values rear from ego center)" 32 "distance (positive values are front, negative values rear from ego center)" 31 "distance (positive values are front, negative values rear from ego center)" 30 "distance (positive values are front, negative values rear from ego center)" 29 "distance (positive values are front, negative values rear from ego center)" 28 "distance (positive values are front, negative values rear from ego center)" 27 "distance (positive values are front, negative values rear from ego center)" 26 "distance (positive values are front, negative values rear from ego center)" 25 "distance (positive values are front, negative values rear from ego center)" 24 "distance (positive values are front, negative values rear from ego center)" 23 "distance (positive values are front, negative values rear from ego center)" 22 "distance (positive values are front, negative values rear from ego center)" 21 "distance (positive values are front, negative values rear from ego center)" 20 "distance (positive values are front, negative values rear from ego center)" 19 "distance (positive values are front, negative values rear from ego center)" 18 "distance (positive values are front, negative values rear from ego center)" 17 "distance (positive values are front, negative values rear from ego center)" 16 "distance (positive values are front, negative values rear from ego center)" 15 "distance (positive values are front, negative values rear from ego center)" 14 "distance (positive values are front, negative values rear from ego center)" 13 "distance (positive values are front, negative values rear from ego center)" 12 "distance (positive values are front, negative values rear from ego center)" 11 "distance (positive values are front, negative values rear from ego center)" 10 "distance (positive values are front, negative values rear from ego center)" 9 "distance (positive values are front, negative values rear from ego center)" 8 "distance (positive values are front, negative values rear from ego center)" 7 "distance (positive values are front, negative values rear from ego center)" 6 "distance (positive values are front, negative values rear from ego center)" 5 "distance (positive values are front, negative values rear from ego center)" 4 "distance (positive values are front, negative values rear from ego center)" 3 "distance (positive values are front, negative values rear from ego center)" 2 "distance (positive values are front, negative values rear from ego center)" 1 "distance (positive values are front, negative values rear from ego center)" 0 "distance (positive values are front, negative values rear from ego center)" ;
VAL_ 547 AdasHmiNeighboringObj8YOut 255 "distance right from ego center" 254 "distance right from ego center" 253 "distance right from ego center" 252 "distance right from ego center" 251 "distance right from ego center" 250 "distance right from ego center" 249 "distance right from ego center" 248 "distance right from ego center" 247 "distance right from ego center" 246 "distance right from ego center" 245 "distance right from ego center" 244 "distance right from ego center" 243 "distance right from ego center" 242 "distance right from ego center" 241 "distance right from ego center" 240 "distance right from ego center" 239 "distance right from ego center" 238 "distance right from ego center" 237 "distance right from ego center" 236 "distance right from ego center" 235 "distance right from ego center" 234 "distance right from ego center" 233 "distance right from ego center" 232 "distance right from ego center" 231 "distance right from ego center" 230 "distance right from ego center" 229 "distance right from ego center" 228 "distance right from ego center" 227 "distance right from ego center" 226 "distance right from ego center" 225 "distance right from ego center" 224 "distance right from ego center" 223 "distance right from ego center" 222 "distance right from ego center" 221 "distance right from ego center" 220 "distance right from ego center" 219 "distance right from ego center" 218 "distance right from ego center" 217 "distance right from ego center" 216 "distance right from ego center" 215 "distance right from ego center" 214 "distance right from ego center" 213 "distance right from ego center" 212 "distance right from ego center" 211 "distance right from ego center" 210 "distance right from ego center" 209 "distance right from ego center" 208 "distance right from ego center" 207 "distance right from ego center" 206 "distance right from ego center" 205 "distance right from ego center" 204 "distance right from ego center" 203 "distance right from ego center" 202 "distance right from ego center" 201 "distance right from ego center" 200 "distance right from ego center" 199 "distance right from ego center" 198 "distance right from ego center" 197 "distance right from ego center" 196 "distance right from ego center" 195 "distance right from ego center" 194 "distance right from ego center" 193 "distance right from ego center" 192 "distance right from ego center" 191 "distance right from ego center" 190 "distance right from ego center" 189 "distance right from ego center" 188 "distance right from ego center" 187 "distance right from ego center" 186 "distance right from ego center" 185 "distance right from ego center" 184 "distance right from ego center" 183 "distance right from ego center" 182 "distance right from ego center" 181 "distance right from ego center" 180 "distance right from ego center" 179 "distance right from ego center" 178 "distance right from ego center" 177 "distance right from ego center" 176 "distance right from ego center" 175 "distance right from ego center" 174 "distance right from ego center" 173 "distance right from ego center" 172 "distance right from ego center" 171 "distance right from ego center" 170 "distance right from ego center" 169 "distance right from ego center" 168 "distance right from ego center" 167 "distance right from ego center" 166 "distance right from ego center" 165 "distance right from ego center" 164 "distance right from ego center" 163 "distance right from ego center" 162 "distance right from ego center" 161 "distance right from ego center" 160 "distance right from ego center" 159 "distance right from ego center" 158 "distance right from ego center" 157 "distance right from ego center" 156 "distance right from ego center" 155 "distance right from ego center" 154 "distance right from ego center" 153 "distance right from ego center" 152 "distance right from ego center" 151 "distance right from ego center" 150 "distance right from ego center" 149 "distance right from ego center" 148 "distance right from ego center" 147 "distance right from ego center" 146 "distance right from ego center" 145 "distance right from ego center" 144 "distance right from ego center" 143 "distance right from ego center" 142 "distance right from ego center" 141 "distance right from ego center" 140 "distance right from ego center" 139 "distance right from ego center" 138 "distance right from ego center" 137 "distance right from ego center" 136 "distance right from ego center" 135 "distance right from ego center" 134 "distance right from ego center" 133 "distance right from ego center" 132 "distance right from ego center" 131 "distance right from ego center" 130 "distance right from ego center" 129 "distance right from ego center" 128 "distance right from ego center" 127 "distance left from ego center" 126 "distance left from ego center" 125 "distance left from ego center" 124 "distance left from ego center" 123 "distance left from ego center" 122 "distance left from ego center" 121 "distance left from ego center" 120 "distance left from ego center" 119 "distance left from ego center" 118 "distance left from ego center" 117 "distance left from ego center" 116 "distance left from ego center" 115 "distance left from ego center" 114 "distance left from ego center" 113 "distance left from ego center" 112 "distance left from ego center" 111 "distance left from ego center" 110 "distance left from ego center" 109 "distance left from ego center" 108 "distance left from ego center" 107 "distance left from ego center" 106 "distance left from ego center" 105 "distance left from ego center" 104 "distance left from ego center" 103 "distance left from ego center" 102 "distance left from ego center" 101 "distance left from ego center" 100 "distance left from ego center" 99 "distance left from ego center" 98 "distance left from ego center" 97 "distance left from ego center" 96 "distance left from ego center" 95 "distance left from ego center" 94 "distance left from ego center" 93 "distance left from ego center" 92 "distance left from ego center" 91 "distance left from ego center" 90 "distance left from ego center" 89 "distance left from ego center" 88 "distance left from ego center" 87 "distance left from ego center" 86 "distance left from ego center" 85 "distance left from ego center" 84 "distance left from ego center" 83 "distance left from ego center" 82 "distance left from ego center" 81 "distance left from ego center" 80 "distance left from ego center" 79 "distance left from ego center" 78 "distance left from ego center" 77 "distance left from ego center" 76 "distance left from ego center" 75 "distance left from ego center" 74 "distance left from ego center" 73 "distance left from ego center" 72 "distance left from ego center" 71 "distance left from ego center" 70 "distance left from ego center" 69 "distance left from ego center" 68 "distance left from ego center" 67 "distance left from ego center" 66 "distance left from ego center" 65 "distance left from ego center" 64 "distance left from ego center" 63 "distance left from ego center" 62 "distance left from ego center" 61 "distance left from ego center" 60 "distance left from ego center" 59 "distance left from ego center" 58 "distance left from ego center" 57 "distance left from ego center" 56 "distance left from ego center" 55 "distance left from ego center" 54 "distance left from ego center" 53 "distance left from ego center" 52 "distance left from ego center" 51 "distance left from ego center" 50 "distance left from ego center" 49 "distance left from ego center" 48 "distance left from ego center" 47 "distance left from ego center" 46 "distance left from ego center" 45 "distance left from ego center" 44 "distance left from ego center" 43 "distance left from ego center" 42 "distance left from ego center" 41 "distance left from ego center" 40 "distance left from ego center" 39 "distance left from ego center" 38 "distance left from ego center" 37 "distance left from ego center" 36 "distance left from ego center" 35 "distance left from ego center" 34 "distance left from ego center" 33 "distance left from ego center" 32 "distance left from ego center" 31 "distance left from ego center" 30 "distance left from ego center" 29 "distance left from ego center" 28 "distance left from ego center" 27 "distance left from ego center" 26 "distance left from ego center" 25 "distance left from ego center" 24 "distance left from ego center" 23 "distance left from ego center" 22 "distance left from ego center" 21 "distance left from ego center" 20 "distance left from ego center" 19 "distance left from ego center" 18 "distance left from ego center" 17 "distance left from ego center" 16 "distance left from ego center" 15 "distance left from ego center" 14 "distance left from ego center" 13 "distance left from ego center" 12 "distance left from ego center" 11 "distance left from ego center" 10 "distance left from ego center" 9 "distance left from ego center" 8 "distance left from ego center" 7 "distance left from ego center" 6 "distance left from ego center" 5 "distance left from ego center" 4 "distance left from ego center" 3 "distance left from ego center" 2 "distance left from ego center" 1 "distance left from ego center" 0 "distance left from ego center" ;
VAL_ 547 AdasHmiNeighboringObj9ObjTyp 7 "reserved" 6 "three-wheeler 三轮车" 5 "bus 公共汽车" 4 "pedestrian 行人" 3 "motorbike/Bicycle 二轮车" 2 "truck 卡车" 1 "passenger car 小轿车" 0 "Object not present" ;
