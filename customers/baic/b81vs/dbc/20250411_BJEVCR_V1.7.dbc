VERSION ""

NS_ :

BS_:

BU_: CR_RR CR_RL MPC

BO_ 65 Sync_0x41: 8 MPC
 SG_ TimeSync_Type M : 7|8@0+ (1,0) [0|255] ""  CR_RR,CR_RL
 SG_ TimeSync_CRC : 15|8@0+ (1,0) [0|255] ""  CR_RR,CR_RL
 SG_ TimeSync_SequenceCounter : 19|4@0+ (1,0) [0|15] ""  CR_RR,CR_RL
 SG_ TimeSync_TimeDomain : 23|4@0+ (1,0) [0|15] ""  CR_RR,CR_RL
 SG_ TimeSync_UserByte0 m32 : 31|8@0+ (1,0) [0|255] ""  CR_RR,CR_RL
 SG_ TimeSync_SyncTimeSec m32 : 39|32@0+ (1,0) [0|4294967295] ""  CR_RR,CR_RL
 SG_ TimeSync_OverflowOfSeconds m40 : 25|2@0+ (1,0) [0|3] ""  CR_RR,CR_RL
 SG_ TimeSync_SGW m40 : 26|1@0+ (1,0) [0|1] ""  CR_RR,CR_RL
 SG_ TimeSync_Reserved0 m40 : 31|5@0+ (1,0) [0|31] ""  CR_RR,CR_RL
 SG_ TimeSync_SyncTimeNSec m40 : 39|32@0+ (1,0) [0|4294967295] ""  CR_RR,CR_RL

BO_ 367 RSDS_FD1: 64 CR_RL
 SG_ Checksum16F : 7|16@0+ (1,0) [0|65535] ""  CR_RR
 SG_ RollingCounter16F : 23|8@0+ (1,0) [0|255] ""  CR_RR
 SG_ RSDS_Brk_ErrSts : 79|1@0+ (1,0) [0|1] ""  CR_RR
 SG_ RSDS_BrkgReq : 78|1@0+ (1,0) [0|1] ""  CR_RR
 SG_ RSDS_BrkgReqVal : 77|8@0+ (0.05,-10) [-10|2.75] "MtrPerSecSq"  CR_RR
 SG_ RSDS_RCW_Trigger : 105|2@0+ (1,0) [0|3] ""  CR_RR
 SG_ BSD_LCA_warningReqleft : 93|2@0+ (1,0) [0|3] ""  CR_RR
 SG_ DOW_warningReqleft : 89|2@0+ (1,0) [0|3] ""  CR_RR
 SG_ RSDS_LEDLightReqLeft : 85|2@0+ (1,0) [0|3] ""  CR_RR
 SG_ RCTA_warningReqLeft : 124|1@0+ (1,0) [0|1] ""  CR_RR
 SG_ RSDS_ObjRelAccelY_Le : 41|10@0+ (0.03125,-16) [-16|15.9688] "MtrPerSecSq"  CR_RR
 SG_ LeTarSts : 143|2@0+ (1,0) [0|3] "NoUnit"  CR_RR
 SG_ ObjIDLe : 141|6@0+ (1,0) [0|63] "NoUnit"  CR_RR
 SG_ ObjLgtPosnCurvLe : 151|10@0+ (0.1,-92.3) [-92.3|10] "m"  CR_RR
 SG_ ObjLatPosnCurvLe : 157|8@0+ (0.1,-12.8) [-12.8|12.7] "m"  CR_RR
 SG_ ObjLgtSpdCurvLe : 165|10@0+ (0.1,-10) [-10|92.3] "mps"  CR_RR
 SG_ ObjLatSpdCurvLe : 171|7@0+ (0.1,-6.4) [-6.4|6.3] "mps"  CR_RR
 SG_ ObjTTCLe : 180|7@0+ (0.1,0) [0|12.7] "s"  CR_RR
 SG_ ObjLenLe : 207|4@0+ (1,0) [0|15] "m"  CR_RR
 SG_ ObjWidthLe : 203|3@0+ (0.5,0) [0|3.5] "m"  CR_RR
 SG_ ObjStatyLe : 200|1@0+ (1,0) [0|1] "NoUnit"  CR_RR
 SG_ ZoneIndLe : 215|2@0+ (1,0) [0|3] "NoUnit"  CR_RR
 SG_ ObjStsLe : 213|2@0+ (1,0) [0|3] "NoUnit"  CR_RR
 SG_ RSDS_ObjDistXStd_Le : 335|5@0+ (0.375,0) [0|11.625] "m"  CR_RR
 SG_ RSDS_ObjDistYStd_Le : 330|5@0+ (0.375,0) [0|11.625] "m"  CR_RR
 SG_ RSDS_ObjRelVelXStd_Le : 341|5@0+ (0.375,0) [0|11.625] "mps"  CR_RR
 SG_ RSDS_ObjRelVelYStd_Le : 336|5@0+ (0.375,0) [0|11.625] "mps"  CR_RR
 SG_ RSDS_ObjRAccelXStd_Le : 347|5@0+ (0.375,0) [0|11.625] "MtrPerSecSq"  CR_RR
 SG_ RSDS_ObjRAccelYStd_Le : 358|5@0+ (0.375,0) [0|11.625] "MtrPerSecSq"  CR_RR
 SG_ RSDS_ObjRelAccelX_Le : 415|10@0+ (0.03125,-16) [-16|15.9688] "MtrPerSecSq"  CR_RR

BO_ 1486 RSDS_L_SGU_HEAD: 64 CR_RL
 SG_ RSDS_L_hdr_SGU_ErrorStatus : 63|4@0+ (1,0) [0|15] ""  MPC
 SG_ RSDS_L_hdr_SGU_TimeStamp : 271|8@0+ (1,0) [0|255] "ms"  MPC
 SG_ RSDS_L_hdr_SGU_TimeStampStatus : 287|8@0+ (1,0) [0|255] ""  MPC
 SG_ RSDS_L_BLIND : 31|2@0+ (1,0) [0|3] ""  MPC
 SG_ RSDS_L_ObjDetected : 29|6@0+ (1,0) [0|63] ""  MPC
 SG_ Checksum5CE : 7|16@0+ (1,0) [0|65535] ""  MPC
 SG_ RollingCounter5CE : 23|8@0+ (1,0) [0|255] ""  MPC
 SG_ RSDS_L_GuardrailConfidence : 39|7@0+ (0.01,0) [0|1] ""  MPC
 SG_ RSDS_L_Guardrail_dxEnd : 47|15@0+ (0.01,-160) [-160|160] "m"  MPC
 SG_ RSDS_L_hdr_SGU_AutosarTimeStamp : 79|42@0+ (1,0) [0|4398046511103] "ms"  MPC
 SG_ RSDS_L_hdr_SGU_TimeStampsecond : 295|32@0+ (1,0) [0|4294967295] "S"  MPC
 SG_ RSDS_L_ELK_OT : 278|1@0+ (1,0) [0|1] ""  MPC
 SG_ RSDS_L_GuardrailC0 : 143|13@0+ (0.01,-30) [-30|30] "m"  MPC
 SG_ RSDS_L_GuardrailC1 : 159|13@0+ (0.0009,-2) [-2|2] "rad"  MPC
 SG_ RSDS_L_GuardrailC2 : 175|16@0+ (5E-006,-0.125) [-0.125|0.125] "INV(m)"  MPC
 SG_ RSDS_L_GuardrailC3 : 207|20@0+ (1E-008,-0.004) [-0.004|0.004] "INV(m2)"  MPC
 SG_ RSDS_L_Guardrail_dxStart : 219|15@0+ (0.01,-160) [-160|160] "m"  MPC
 SG_ RSDS_L_ObjAziAngleCalib : 236|13@0+ (0.0009,-2) [-2|2] "rad"  MPC
 SG_ RSDS_L_SGU_HEAD_BlockCounter : 255|4@0+ (1,0) [0|15] ""  MPC
 SG_ RSDS_L_ObjHdr_MountPosX : 395|9@0+ (0.02,-5.12) [-5.12|5.1] "m"  MPC
 SG_ RSDS_L_ObjHdr_MountPosY : 402|8@0+ (0.01,-1.28) [-1.28|1.27] "m"  MPC
 SG_ RSDS_L_ObjHdr_MountPosZ : 410|5@0+ (0.05,0) [0|1.55] "m"  MPC
 SG_ RSDS_L_ObjHdr_YawMountAngle : 421|16@0+ (0.00017,-5.57056) [-3.2|3.2] "rad"  MPC
 SG_ RSDS_L_ObjHdr_YawAngleLower : 347|15@0+ (0.00017,-2.78528) [-1.6|1.6] "rad"  MPC
 SG_ RSDS_L_ObjHdr_YawAngleUpper : 454|15@0+ (0.00017,-2.78528) [-1.6|1.6] "rad"  MPC
 SG_ RSDS_L_ObjHdr_PitchMountAngle : 471|12@0+ (0.00017,-0.34816) [-0.2|0.2] "rad"  MPC
 SG_ RSDS_L_ObjHdr_PitchAngleLower : 475|12@0+ (0.00017,-0.34816) [-0.2|0.2] "rad"  MPC
 SG_ RSDS_L_ObjHdr_PitchAngleUpper : 495|12@0+ (0.00017,-0.34816) [-0.2|0.2] "rad"  MPC
 SG_ RSDS_L_ObjHdr_RollMountAngle : 499|12@0+ (0.00017,-0.34816) [-0.2|0.2] "rad"  MPC

BO_ 1487 RSDS_R_SGU_HEAD: 64 CR_RR
 SG_ RSDS_R_hdr_SGU_ErrorStatus : 63|4@0+ (1,0) [0|15] ""  MPC
 SG_ RSDS_R_hdr_SGU_TimeStamp : 271|8@0+ (1,0) [0|255] "ms"  MPC
 SG_ RSDS_R_hdr_SGU_TimeStampStatus : 287|8@0+ (1,0) [0|255] ""  MPC
 SG_ RSDS_R_hdr_SGU_TimeStampsecond : 295|32@0+ (1,0) [0|4294967295] "S"  MPC
 SG_ RSDS_R_ELK_OT : 278|1@0+ (1,0) [0|1] ""  MPC
 SG_ RSDS_R_BLIND : 31|2@0+ (1,0) [0|3] ""  MPC
 SG_ RSDS_R_ObjDetected : 29|6@0+ (1,0) [0|63] ""  MPC
 SG_ RSDS_R_GuardrailConfidence : 39|7@0+ (0.01,0) [0|1] ""  MPC
 SG_ RSDS_R_Guardrail_dxEnd : 47|15@0+ (0.01,-160) [-160|160] "m"  MPC
 SG_ RSDS_R_hdr_SGU_AutosarTimeStamp : 79|42@0+ (1,0) [0|4398046511103] "ms"  MPC
 SG_ Checksum5CF : 7|16@0+ (1,0) [0|65535] ""  MPC
 SG_ RollingCounter5CF : 23|8@0+ (1,0) [0|255] ""  MPC
 SG_ RSDS_R_GuardrailC0 : 143|13@0+ (0.01,-30) [-30|30] "m"  MPC
 SG_ RSDS_R_GuardrailC1 : 159|13@0+ (0.0009,-2) [-2|2] "rad"  MPC
 SG_ RSDS_R_GuardrailC2 : 175|16@0+ (5E-006,-0.125) [-0.125|0.125] "INV(m)"  MPC
 SG_ RSDS_R_GuardrailC3 : 207|20@0+ (1E-008,-0.004) [-0.004|0.004] "INV(m2)"  MPC
 SG_ RSDS_R_Guardrail_dxStart : 219|15@0+ (0.01,-160) [-160|160] "m"  MPC
 SG_ RSDS_R_ObjAziAngleCalib : 236|13@0+ (0.0009,-2) [-2|2] "rad"  MPC
 SG_ RSDS_R_SGU_HEAD_BlockCounter : 255|4@0+ (1,0) [0|15] ""  MPC
 SG_ RSDS_R_ObjHdr_MountPosX : 395|9@0+ (0.02,-5.12) [-5.12|5.1] "m"  MPC
 SG_ RSDS_R_ObjHdr_MountPosY : 402|8@0+ (0.01,-1.28) [-1.28|1.27] "m"  MPC
 SG_ RSDS_R_ObjHdr_MountPosZ : 410|5@0+ (0.05,0) [0|1.55] "m"  MPC
 SG_ RSDS_R_ObjHdr_YawMountAngle : 421|16@0+ (0.00017,-5.57056) [-3.2|3.2] "rad"  MPC
 SG_ RSDS_R_ObjHdr_YawAngleLower : 347|15@0+ (0.00017,-2.78528) [-1.6|1.6] "rad"  MPC
 SG_ RSDS_R_ObjHdr_YawAngleUpper : 454|15@0+ (0.00017,-2.78528) [-1.6|1.6] "rad"  MPC
 SG_ RSDS_R_ObjHdr_PitchMountAngle : 471|12@0+ (0.00017,-0.34816) [-0.2|0.2] "rad"  MPC
 SG_ RSDS_R_ObjHdr_PitchAngleLower : 475|12@0+ (0.00017,-0.34816) [-0.2|0.2] "rad"  MPC
 SG_ RSDS_R_ObjHdr_PitchAngleUpper : 495|12@0+ (0.00017,-0.34816) [-0.2|0.2] "rad"  MPC
 SG_ RSDS_R_ObjHdr_RollMountAngle : 499|12@0+ (0.00017,-0.34816) [-0.2|0.2] "rad"  MPC

BO_ 1408 RSDS_L_SGU1: 64 CR_RL
 SG_ RSDS_L_ObjID_1 : 71|8@0+ (1,0) [0|255] ""  MPC
 SG_ RSDS_L_ObjExistProb_1 : 124|5@0+ (0.03326,0) [0|1] ""  MPC
 SG_ RSDS_L_ObjObstacleProb_1 : 135|5@0+ (0.03326,0) [0|1] ""  MPC
 SG_ RSDS_L_ObjDistX_1 : 187|12@0+ (0.0625,-128) [-128|127.9375] "m"  MPC
 SG_ RSDS_L_ObjDistY_1 : 33|11@0+ (0.125,-128) [-128|127.875] "m"  MPC
 SG_ RSDS_L_ObjDistXStd_1 : 54|6@0+ (0.1,0) [0|6] "m"  MPC
 SG_ RSDS_L_ObjType_1 : 63|4@0+ (1,0) [0|15] ""  MPC
 SG_ RSDS_L_ObjRelVelX_1 : 79|13@0+ (0.0312,-128) [-128|126.9976] "mps"  MPC
 SG_ RSDS_L_ObjRelVelY_1 : 82|13@0+ (0.0312,-128) [-128|126.9976] "mps"  MPC
 SG_ RSDS_L_ObjRelAccelX_1 : 101|10@0+ (0.03125,-16) [-16|15.96875] "mps2"  MPC
 SG_ RSDS_L_ObjRelAccelY_1 : 107|10@0+ (0.03125,-16) [-16|15.96875] "mps2"  MPC
 SG_ RSDS_L_ObjMotionType_1 : 127|3@0+ (1,0) [0|7] ""  MPC
 SG_ RSDS_L_ObjMeasured_1 : 113|2@0+ (1,0) [0|3] ""  MPC
 SG_ RSDS_L_ObjDistYStd_1 : 143|6@0+ (0.1,0) [0|6] "m"  MPC
 SG_ RSDS_L_ObjRelVelXStd_1 : 137|6@0+ (0.0625,0) [0|3.9375] "mps"  MPC
 SG_ RSDS_L_ObjRelVelYStd_1 : 147|6@0+ (0.0625,0) [0|3.9375] "mps"  MPC
 SG_ RSDS_L_ObjRAccelXStd_1 : 157|6@0+ (0.0625,0) [0|3.9375] "mps2"  MPC
 SG_ RSDS_L_ObjRAccelYStd_1 : 167|6@0+ (0.0625,0) [0|3.9375] "mps2"  MPC
 SG_ RSDS_L_ObjWidth_1 : 161|10@0+ (0.01,0) [0|5] "m"  MPC
 SG_ RSDS_L_ObjMotionDirection_1 : 191|3@0+ (1,0) [0|7] ""  MPC
 SG_ RSDS_L_ObjAge_1 : 183|8@0+ (1,0) [0|255] ""  MPC
 SG_ RSDS_L_ObjLength_1 : 207|10@0+ (0.05,0) [0|20] "m"  MPC
 SG_ RSDS_L_ObjHeading_1 : 213|12@0+ (0.002,-3.14) [-3.14|3.14] "rad"  MPC
 SG_ RSDS_L_ObjYawrate_1 : 217|12@0+ (0.002,-3.14) [-3.14|3.14] "rad/s"  MPC
 SG_ RSDS_L_ObjRCS_1 : 237|10@0+ (0.125,-50) [-50|70] "dBm2"  MPC
 SG_ RSDS_L_ObjRefPoint_1 : 243|3@0+ (1,0) [0|8] ""  MPC
 SG_ RSDS_L_HWATargetValidity_1 : 240|1@0+ (1,0) [0|1] ""  MPC
 SG_ RSDS_L_ObjID_2 : 271|8@0+ (1,0) [0|255] ""  MPC
 SG_ RSDS_L_ObjExistProb_2 : 279|5@0+ (0.03326,0) [0|1] ""  MPC
 SG_ RSDS_L_ObjObstacleProb_2 : 274|5@0+ (0.03326,0) [0|1] ""  MPC
 SG_ RSDS_L_ObjDistX_2 : 285|12@0+ (0.0625,-128) [-128|127.9375] "m"  MPC
 SG_ RSDS_L_ObjDistY_2 : 289|11@0+ (0.125,-128) [-128|127.875] "m"  MPC
 SG_ RSDS_L_ObjDistXStd_2 : 310|6@0+ (0.1,0) [0|6] "m"  MPC
 SG_ RSDS_L_ObjType_2 : 319|4@0+ (1,0) [0|15] ""  MPC
 SG_ RSDS_L_ObjRelVelX_2 : 335|13@0+ (0.0312,-128) [-128|126.9976] "mps"  MPC
 SG_ RSDS_L_ObjRelVelY_2 : 338|13@0+ (0.0312,-128) [-128|126.9976] "mps"  MPC
 SG_ RSDS_L_ObjRelAccelX_2 : 357|10@0+ (0.03125,-16) [-16|15.96875] "mps2"  MPC
 SG_ RSDS_L_ObjRelAccelY_2 : 363|10@0+ (0.03125,-16) [-16|15.96875] "mps2"  MPC
 SG_ RSDS_L_ObjMotionType_2 : 383|3@0+ (1,0) [0|7] ""  MPC
 SG_ RSDS_L_ObjMeasured_2 : 369|2@0+ (1,0) [0|3] ""  MPC
 SG_ RSDS_L_ObjDistYStd_2 : 399|6@0+ (0.1,0) [0|6] "m"  MPC
 SG_ RSDS_L_ObjRelVelXStd_2 : 393|6@0+ (0.0625,0) [0|3.9375] "mps"  MPC
 SG_ RSDS_L_ObjRelVelYStd_2 : 403|6@0+ (0.0625,0) [0|3.9375] "mps"  MPC
 SG_ RSDS_L_ObjRAccelXStd_2 : 413|6@0+ (0.0625,0) [0|3.9375] "mps2"  MPC
 SG_ RSDS_L_ObjRAccelYStd_2 : 423|6@0+ (0.0625,0) [0|3.9375] "mps2"  MPC
 SG_ RSDS_L_ObjWidth_2 : 417|10@0+ (0.01,0) [0|5] "m"  MPC
 SG_ RSDS_L_ObjMotionDirection_2 : 447|3@0+ (1,0) [0|7] ""  MPC
 SG_ RSDS_L_ObjAge_2 : 439|8@0+ (1,0) [0|255] ""  MPC
 SG_ RSDS_L_ObjLength_2 : 463|10@0+ (0.05,0) [0|20] "m"  MPC
 SG_ RSDS_L_ObjHeading_2 : 469|12@0+ (0.002,-3.14) [-3.14|3.14] "rad"  MPC
 SG_ RSDS_L_ObjYawrate_2 : 473|12@0+ (0.002,-3.14) [-3.14|3.14] "rad/s"  MPC
 SG_ RSDS_L_ObjRCS_2 : 493|10@0+ (0.125,-50) [-50|70] "dBm2"  MPC
 SG_ RSDS_L_ObjRefPoint_2 : 499|3@0+ (1,0) [0|8] ""  MPC
 SG_ RSDS_L_HWATargetValidity_2 : 496|1@0+ (1,0) [0|1] ""  MPC
 SG_ RSDS_L_SGU1_BlockCounter : 511|4@0+ (1,0) [0|15] ""  MPC
 SG_ RSDS_L_ObjValid_1 : 252|1@0+ (1,0) [0|1] ""  MPC
 SG_ RSDS_L_ObjValid_2 : 253|1@0+ (1,0) [0|1] ""  MPC
 SG_ Checksum580 : 7|16@0+ (1,0) [0|65535] ""  MPC
 SG_ RollingCounter580 : 23|8@0+ (1,0) [0|255] ""  MPC
 SG_ RSDS_L_ObjHYAS_Reserved_1 : 261|6@0+ (0.017,0) [0|1.071] ""  MPC
 SG_ RSDS_L_ObjHYAS_Reserved_2 : 251|6@0+ (0.017,0) [0|1.071] ""  MPC
 SG_ RSDS_L_ObjTypeProb_1 : 325|6@0+ (2,0) [0|100] "%"  MPC
 SG_ RSDS_L_ObjTypeProb_2 : 315|6@0+ (2,0) [0|100] "%"  MPC
 SG_ RSDS_L_ObjHeight_1 : 31|10@0+ (0.01,0) [0|6] "m"  MPC
 SG_ RSDS_L_ObjHeight_2 : 379|10@0+ (0.01,0) [0|6] "m"  MPC

BO_ 1409 RSDS_L_SGU2: 64 CR_RL
 SG_ RSDS_L_ObjID_3 : 71|8@0+ (1,0) [0|255] ""  MPC
 SG_ RSDS_L_ObjExistProb_3 : 124|5@0+ (0.03326,0) [0|1] ""  MPC
 SG_ RSDS_L_ObjObstacleProb_3 : 135|5@0+ (0.03326,0) [0|1] ""  MPC
 SG_ RSDS_L_ObjDistX_3 : 187|12@0+ (0.0625,-128) [-128|127.9375] "m"  MPC
 SG_ RSDS_L_ObjDistY_3 : 33|11@0+ (0.125,-128) [-128|127.875] "m"  MPC
 SG_ RSDS_L_ObjDistXStd_3 : 54|6@0+ (0.1,0) [0|6] "m"  MPC
 SG_ RSDS_L_ObjType_3 : 63|4@0+ (1,0) [0|15] ""  MPC
 SG_ RSDS_L_ObjRelVelX_3 : 79|13@0+ (0.0312,-128) [-128|126.9976] "mps"  MPC
 SG_ RSDS_L_ObjRelVelY_3 : 82|13@0+ (0.0312,-128) [-128|126.9976] "mps"  MPC
 SG_ RSDS_L_ObjRelAccelX_3 : 101|10@0+ (0.03125,-16) [-16|15.96875] "mps2"  MPC
 SG_ RSDS_L_ObjRelAccelY_3 : 107|10@0+ (0.03125,-16) [-16|15.96875] "mps2"  MPC
 SG_ RSDS_L_ObjMotionType_3 : 127|3@0+ (1,0) [0|7] ""  MPC
 SG_ RSDS_L_ObjMeasured_3 : 113|2@0+ (1,0) [0|3] ""  MPC
 SG_ RSDS_L_ObjDistYStd_3 : 143|6@0+ (0.1,0) [0|6] "m"  MPC
 SG_ RSDS_L_ObjRelVelXStd_3 : 137|6@0+ (0.0625,0) [0|3.9375] "mps"  MPC
 SG_ RSDS_L_ObjRelVelYStd_3 : 147|6@0+ (0.0625,0) [0|3.9375] "mps"  MPC
 SG_ RSDS_L_ObjRAccelXStd_3 : 157|6@0+ (0.0625,0) [0|3.9375] "mps2"  MPC
 SG_ RSDS_L_ObjRAccelYStd_3 : 167|6@0+ (0.0625,0) [0|3.9375] "mps2"  MPC
 SG_ RSDS_L_ObjWidth_3 : 161|10@0+ (0.01,0) [0|5] "m"  MPC
 SG_ RSDS_L_ObjMotionDirection_3 : 191|3@0+ (1,0) [0|7] ""  MPC
 SG_ RSDS_L_ObjAge_3 : 183|8@0+ (1,0) [0|255] ""  MPC
 SG_ RSDS_L_ObjLength_3 : 207|10@0+ (0.05,0) [0|20] "m"  MPC
 SG_ RSDS_L_ObjHeading_3 : 213|12@0+ (0.002,-3.14) [-3.14|3.14] "rad"  MPC
 SG_ RSDS_L_ObjYawrate_3 : 217|12@0+ (0.002,-3.14) [-3.14|3.14] "rad/s"  MPC
 SG_ RSDS_L_ObjRCS_3 : 237|10@0+ (0.125,-50) [-50|70] "dBm2"  MPC
 SG_ RSDS_L_ObjRefPoint_3 : 243|3@0+ (1,0) [0|8] ""  MPC
 SG_ RSDS_L_HWATargetValidity_3 : 240|1@0+ (1,0) [0|1] ""  MPC
 SG_ RSDS_L_ObjID_4 : 271|8@0+ (1,0) [0|255] ""  MPC
 SG_ RSDS_L_ObjExistProb_4 : 279|5@0+ (0.03326,0) [0|1] ""  MPC
 SG_ RSDS_L_ObjObstacleProb_4 : 274|5@0+ (0.03326,0) [0|1] ""  MPC
 SG_ RSDS_L_ObjDistX_4 : 285|12@0+ (0.0625,-128) [-128|127.9375] "m"  MPC
 SG_ RSDS_L_ObjDistY_4 : 289|11@0+ (0.125,-128) [-128|127.875] "m"  MPC
 SG_ RSDS_L_ObjDistXStd_4 : 310|6@0+ (0.1,0) [0|6] "m"  MPC
 SG_ RSDS_L_ObjType_4 : 319|4@0+ (1,0) [0|15] ""  MPC
 SG_ RSDS_L_ObjRelVelX_4 : 335|13@0+ (0.0312,-128) [-128|126.9976] "mps"  MPC
 SG_ RSDS_L_ObjRelVelY_4 : 338|13@0+ (0.0312,-128) [-128|126.9976] "mps"  MPC
 SG_ RSDS_L_ObjRelAccelX_4 : 357|10@0+ (0.03125,-16) [-16|15.96875] "mps2"  MPC
 SG_ RSDS_L_ObjRelAccelY_4 : 363|10@0+ (0.03125,-16) [-16|15.96875] "mps2"  MPC
 SG_ RSDS_L_ObjMotionType_4 : 383|3@0+ (1,0) [0|7] ""  MPC
 SG_ RSDS_L_ObjMeasured_4 : 369|2@0+ (1,0) [0|3] ""  MPC
 SG_ RSDS_L_ObjDistYStd_4 : 399|6@0+ (0.1,0) [0|6] "m"  MPC
 SG_ RSDS_L_ObjRelVelXStd_4 : 393|6@0+ (0.0625,0) [0|3.9375] "mps"  MPC
 SG_ RSDS_L_ObjRelVelYStd_4 : 403|6@0+ (0.0625,0) [0|3.9375] "mps"  MPC
 SG_ RSDS_L_ObjRAccelXStd_4 : 413|6@0+ (0.0625,0) [0|3.9375] "mps2"  MPC
 SG_ RSDS_L_ObjRAccelYStd_4 : 423|6@0+ (0.0625,0) [0|3.9375] "mps2"  MPC
 SG_ RSDS_L_ObjWidth_4 : 417|10@0+ (0.01,0) [0|5] "m"  MPC
 SG_ RSDS_L_ObjMotionDirection_4 : 447|3@0+ (1,0) [0|7] ""  MPC
 SG_ RSDS_L_ObjAge_4 : 439|8@0+ (1,0) [0|255] ""  MPC
 SG_ RSDS_L_ObjLength_4 : 463|10@0+ (0.05,0) [0|20] "m"  MPC
 SG_ RSDS_L_ObjHeading_4 : 469|12@0+ (0.002,-3.14) [-3.14|3.14] "rad"  MPC
 SG_ RSDS_L_ObjYawrate_4 : 473|12@0+ (0.002,-3.14) [-3.14|3.14] "rad/s"  MPC
 SG_ RSDS_L_ObjRCS_4 : 493|10@0+ (0.125,-50) [-50|70] "dBm2"  MPC
 SG_ RSDS_L_HWATargetValidity_4 : 496|1@0+ (1,0) [0|1] ""  MPC
 SG_ RSDS_L_ObjRefPoint_4 : 499|3@0+ (1,0) [0|8] ""  MPC
 SG_ RSDS_L_SGU2_BlockCounter : 511|4@0+ (1,0) [0|15] ""  MPC
 SG_ RSDS_L_ObjValid_3 : 252|1@0+ (1,0) [0|1] ""  MPC
 SG_ RSDS_L_ObjValid_4 : 253|1@0+ (1,0) [0|1] ""  MPC
 SG_ Checksum581 : 7|16@0+ (1,0) [0|65535] ""  MPC
 SG_ RollingCounter581 : 23|8@0+ (1,0) [0|255] ""  MPC
 SG_ RSDS_L_ObjHYAS_Reserved_3 : 261|6@0+ (0.017,0) [0|1.071] ""  MPC
 SG_ RSDS_L_ObjHYAS_Reserved_4 : 251|6@0+ (0.017,0) [0|1.071] ""  MPC
 SG_ RSDS_L_ObjTypeProb_3 : 325|6@0+ (2,0) [0|100] "%"  MPC
 SG_ RSDS_L_ObjTypeProb_4 : 315|6@0+ (2,0) [0|100] "%"  MPC
 SG_ RSDS_L_ObjHeight_3 : 31|10@0+ (0.01,0) [0|6] "m"  MPC
 SG_ RSDS_L_ObjHeight_4 : 379|10@0+ (0.01,0) [0|6] "m"  MPC

BO_ 1410 RSDS_L_SGU3: 64 CR_RL
 SG_ RSDS_L_ObjID_5 : 71|8@0+ (1,0) [0|255] ""  MPC
 SG_ RSDS_L_ObjExistProb_5 : 124|5@0+ (0.03326,0) [0|1] ""  MPC
 SG_ RSDS_L_ObjObstacleProb_5 : 135|5@0+ (0.03326,0) [0|1] ""  MPC
 SG_ RSDS_L_ObjDistX_5 : 187|12@0+ (0.0625,-128) [-128|127.9375] "m"  MPC
 SG_ RSDS_L_ObjDistY_5 : 33|11@0+ (0.125,-128) [-128|127.875] "m"  MPC
 SG_ RSDS_L_ObjDistXStd_5 : 54|6@0+ (0.1,0) [0|6] "m"  MPC
 SG_ RSDS_L_ObjType_5 : 63|4@0+ (1,0) [0|15] ""  MPC
 SG_ RSDS_L_ObjRelVelX_5 : 79|13@0+ (0.0312,-128) [-128|126.9976] "mps"  MPC
 SG_ RSDS_L_ObjRelVelY_5 : 82|13@0+ (0.0312,-128) [-128|126.9976] "mps"  MPC
 SG_ RSDS_L_ObjRelAccelX_5 : 101|10@0+ (0.03125,-16) [-16|15.96875] "mps2"  MPC
 SG_ RSDS_L_ObjRelAccelY_5 : 107|10@0+ (0.03125,-16) [-16|15.96875] "mps2"  MPC
 SG_ RSDS_L_ObjMotionType_5 : 127|3@0+ (1,0) [0|7] ""  MPC
 SG_ RSDS_L_ObjMeasured_5 : 113|2@0+ (1,0) [0|3] ""  MPC
 SG_ RSDS_L_ObjDistYStd_5 : 143|6@0+ (0.1,0) [0|6] "m"  MPC
 SG_ RSDS_L_ObjRelVelXStd_5 : 137|6@0+ (0.0625,0) [0|3.9375] "mps"  MPC
 SG_ RSDS_L_ObjRelVelYStd_5 : 147|6@0+ (0.0625,0) [0|3.9375] "mps"  MPC
 SG_ RSDS_L_ObjRAccelXStd_5 : 157|6@0+ (0.0625,0) [0|3.9375] "mps2"  MPC
 SG_ RSDS_L_ObjRAccelYStd_5 : 167|6@0+ (0.0625,0) [0|3.9375] "mps2"  MPC
 SG_ RSDS_L_ObjWidth_5 : 161|10@0+ (0.01,0) [0|5] "m"  MPC
 SG_ RSDS_L_ObjMotionDirection_5 : 191|3@0+ (1,0) [0|7] ""  MPC
 SG_ RSDS_L_ObjAge_5 : 183|8@0+ (1,0) [0|255] ""  MPC
 SG_ RSDS_L_ObjLength_5 : 207|10@0+ (0.05,0) [0|20] "m"  MPC
 SG_ RSDS_L_ObjHeading_5 : 213|12@0+ (0.002,-3.14) [-3.14|3.14] "rad"  MPC
 SG_ RSDS_L_ObjYawrate_5 : 217|12@0+ (0.002,-3.14) [-3.14|3.14] "rad/s"  MPC
 SG_ RSDS_L_ObjRCS_5 : 237|10@0+ (0.125,-50) [-50|70] "dBm2"  MPC
 SG_ RSDS_L_ObjRefPoint_5 : 243|3@0+ (1,0) [0|8] ""  MPC
 SG_ RSDS_L_HWATargetValidity_5 : 240|1@0+ (1,0) [0|1] ""  MPC
 SG_ RSDS_L_ObjID_6 : 271|8@0+ (1,0) [0|255] ""  MPC
 SG_ RSDS_L_ObjExistProb_6 : 279|5@0+ (0.03326,0) [0|1] ""  MPC
 SG_ RSDS_L_ObjObstacleProb_6 : 274|5@0+ (0.03326,0) [0|1] ""  MPC
 SG_ RSDS_L_ObjDistX_6 : 285|12@0+ (0.0625,-128) [-128|127.9375] "m"  MPC
 SG_ RSDS_L_ObjDistY_6 : 289|11@0+ (0.125,-128) [-128|127.875] "m"  MPC
 SG_ RSDS_L_ObjDistXStd_6 : 310|6@0+ (0.1,0) [0|6] "m"  MPC
 SG_ RSDS_L_ObjType_6 : 319|4@0+ (1,0) [0|15] ""  MPC
 SG_ RSDS_L_ObjRelVelX_6 : 335|13@0+ (0.0312,-128) [-128|126.9976] "mps"  MPC
 SG_ RSDS_L_ObjRelVelY_6 : 338|13@0+ (0.0312,-128) [-128|126.9976] "mps"  MPC
 SG_ RSDS_L_ObjRelAccelX_6 : 357|10@0+ (0.03125,-16) [-16|15.96875] "mps2"  MPC
 SG_ RSDS_L_ObjRelAccelY_6 : 363|10@0+ (0.03125,-16) [-16|15.96875] "mps2"  MPC
 SG_ RSDS_L_ObjMotionType_6 : 383|3@0+ (1,0) [0|7] ""  MPC
 SG_ RSDS_L_ObjMeasured_6 : 369|2@0+ (1,0) [0|3] ""  MPC
 SG_ RSDS_L_ObjDistYStd_6 : 399|6@0+ (0.1,0) [0|6] "m"  MPC
 SG_ RSDS_L_ObjRelVelXStd_6 : 393|6@0+ (0.0625,0) [0|3.9375] "mps"  MPC
 SG_ RSDS_L_ObjRelVelYStd_6 : 403|6@0+ (0.0625,0) [0|3.9375] "mps"  MPC
 SG_ RSDS_L_ObjRAccelXStd_6 : 413|6@0+ (0.0625,0) [0|3.9375] "mps2"  MPC
 SG_ RSDS_L_ObjRAccelYStd_6 : 423|6@0+ (0.0625,0) [0|3.9375] "mps2"  MPC
 SG_ RSDS_L_ObjWidth_6 : 417|10@0+ (0.01,0) [0|5] "m"  MPC
 SG_ RSDS_L_ObjMotionDirection_6 : 447|3@0+ (1,0) [0|7] ""  MPC
 SG_ RSDS_L_ObjAge_6 : 439|8@0+ (1,0) [0|255] ""  MPC
 SG_ RSDS_L_ObjLength_6 : 463|10@0+ (0.05,0) [0|20] "m"  MPC
 SG_ RSDS_L_ObjHeading_6 : 469|12@0+ (0.002,-3.14) [-3.14|3.14] "rad"  MPC
 SG_ RSDS_L_ObjYawrate_6 : 473|12@0+ (0.002,-3.14) [-3.14|3.14] "rad/s"  MPC
 SG_ RSDS_L_ObjRCS_6 : 493|10@0+ (0.125,-50) [-50|70] "dBm2"  MPC
 SG_ RSDS_L_ObjRefPoint_6 : 499|3@0+ (1,0) [0|8] ""  MPC
 SG_ RSDS_L_HWATargetValidity_6 : 496|1@0+ (1,0) [0|1] ""  MPC
 SG_ RSDS_L_SGU3_BlockCounter : 511|4@0+ (1,0) [0|15] ""  MPC
 SG_ RSDS_L_ObjValid_5 : 252|1@0+ (1,0) [0|1] ""  MPC
 SG_ RSDS_L_ObjValid_6 : 253|1@0+ (1,0) [0|1] ""  MPC
 SG_ Checksum582 : 7|16@0+ (1,0) [0|65535] ""  MPC
 SG_ RollingCounter582 : 23|8@0+ (1,0) [0|255] ""  MPC
 SG_ RSDS_L_ObjHYAS_Reserved_5 : 261|6@0+ (0.017,0) [0|1.071] ""  MPC
 SG_ RSDS_L_ObjHYAS_Reserved_6 : 251|6@0+ (0.017,0) [0|1.071] ""  MPC
 SG_ RSDS_L_ObjTypeProb_5 : 325|6@0+ (2,0) [0|100] "%"  MPC
 SG_ RSDS_L_ObjTypeProb_6 : 315|6@0+ (2,0) [0|100] "%"  MPC
 SG_ RSDS_L_ObjHeight_5 : 31|10@0+ (0.01,0) [0|6] "m"  MPC
 SG_ RSDS_L_ObjHeight_6 : 379|10@0+ (0.01,0) [0|6] "m"  MPC

BO_ 1411 RSDS_L_SGU4: 64 CR_RL
 SG_ RSDS_L_ObjID_7 : 71|8@0+ (1,0) [0|255] ""  MPC
 SG_ RSDS_L_ObjExistProb_7 : 124|5@0+ (0.03326,0) [0|1] ""  MPC
 SG_ RSDS_L_ObjObstacleProb_7 : 135|5@0+ (0.03326,0) [0|1] ""  MPC
 SG_ RSDS_L_ObjDistX_7 : 187|12@0+ (0.0625,-128) [-128|127.9375] "m"  MPC
 SG_ RSDS_L_ObjDistY_7 : 33|11@0+ (0.125,-128) [-128|127.875] "m"  MPC
 SG_ RSDS_L_ObjDistXStd_7 : 54|6@0+ (0.1,0) [0|6] "m"  MPC
 SG_ RSDS_L_ObjType_7 : 63|4@0+ (1,0) [0|15] ""  MPC
 SG_ RSDS_L_ObjRelVelX_7 : 79|13@0+ (0.0312,-128) [-128|126.9976] "mps"  MPC
 SG_ RSDS_L_ObjRelVelY_7 : 82|13@0+ (0.0312,-128) [-128|126.9976] "mps"  MPC
 SG_ RSDS_L_ObjRelAccelX_7 : 101|10@0+ (0.03125,-16) [-16|15.96875] "mps2"  MPC
 SG_ RSDS_L_ObjRelAccelY_7 : 107|10@0+ (0.03125,-16) [-16|15.96875] "mps2"  MPC
 SG_ RSDS_L_ObjMotionType_7 : 127|3@0+ (1,0) [0|7] ""  MPC
 SG_ RSDS_L_ObjMeasured_7 : 113|2@0+ (1,0) [0|3] ""  MPC
 SG_ RSDS_L_ObjDistYStd_7 : 143|6@0+ (0.1,0) [0|6] "m"  MPC
 SG_ RSDS_L_ObjRelVelXStd_7 : 137|6@0+ (0.0625,0) [0|3.9375] "mps"  MPC
 SG_ RSDS_L_ObjRelVelYStd_7 : 147|6@0+ (0.0625,0) [0|3.9375] "mps"  MPC
 SG_ RSDS_L_ObjRAccelXStd_7 : 157|6@0+ (0.0625,0) [0|3.9375] "mps2"  MPC
 SG_ RSDS_L_ObjRAccelYStd_7 : 167|6@0+ (0.0625,0) [0|3.9375] "mps2"  MPC
 SG_ RSDS_L_ObjWidth_7 : 161|10@0+ (0.01,0) [0|5] "m"  MPC
 SG_ RSDS_L_ObjMotionDirection_7 : 191|3@0+ (1,0) [0|7] ""  MPC
 SG_ RSDS_L_ObjAge_7 : 183|8@0+ (1,0) [0|255] ""  MPC
 SG_ RSDS_L_ObjLength_7 : 207|10@0+ (0.05,0) [0|20] "m"  MPC
 SG_ RSDS_L_ObjHeading_7 : 213|12@0+ (0.002,-3.14) [-3.14|3.14] "rad"  MPC
 SG_ RSDS_L_ObjYawrate_7 : 217|12@0+ (0.002,-3.14) [-3.14|3.14] "rad/s"  MPC
 SG_ RSDS_L_ObjRCS_7 : 237|10@0+ (0.125,-50) [-50|70] "dBm2"  MPC
 SG_ RSDS_L_ObjRefPoint_7 : 243|3@0+ (1,0) [0|8] ""  MPC
 SG_ RSDS_L_HWATargetValidity_7 : 240|1@0+ (1,0) [0|1] ""  MPC
 SG_ RSDS_L_ObjID_8 : 271|8@0+ (1,0) [0|255] ""  MPC
 SG_ RSDS_L_ObjExistProb_8 : 279|5@0+ (0.03326,0) [0|1] ""  MPC
 SG_ RSDS_L_ObjObstacleProb_8 : 274|5@0+ (0.03326,0) [0|1] ""  MPC
 SG_ RSDS_L_ObjDistX_8 : 285|12@0+ (0.0625,-128) [-128|127.9375] "m"  MPC
 SG_ RSDS_L_ObjDistY_8 : 289|11@0+ (0.125,-128) [-128|127.875] "m"  MPC
 SG_ RSDS_L_ObjDistXStd_8 : 310|6@0+ (0.1,0) [0|6] "m"  MPC
 SG_ RSDS_L_ObjType_8 : 319|4@0+ (1,0) [0|15] ""  MPC
 SG_ RSDS_L_ObjRelVelX_8 : 335|13@0+ (0.0312,-128) [-128|126.9976] "mps"  MPC
 SG_ RSDS_L_ObjRelVelY_8 : 338|13@0+ (0.0312,-128) [-128|126.9976] "mps"  MPC
 SG_ RSDS_L_ObjRelAccelX_8 : 357|10@0+ (0.03125,-16) [-16|15.96875] "mps2"  MPC
 SG_ RSDS_L_ObjRelAccelY_8 : 363|10@0+ (0.03125,-16) [-16|15.96875] "mps2"  MPC
 SG_ RSDS_L_ObjMotionType_8 : 383|3@0+ (1,0) [0|7] ""  MPC
 SG_ RSDS_L_ObjMeasured_8 : 369|2@0+ (1,0) [0|3] ""  MPC
 SG_ RSDS_L_ObjDistYStd_8 : 399|6@0+ (0.1,0) [0|6] "m"  MPC
 SG_ RSDS_L_ObjRelVelXStd_8 : 393|6@0+ (0.0625,0) [0|3.9375] "mps"  MPC
 SG_ RSDS_L_ObjRelVelYStd_8 : 403|6@0+ (0.0625,0) [0|3.9375] "mps"  MPC
 SG_ RSDS_L_ObjRAccelXStd_8 : 413|6@0+ (0.0625,0) [0|3.9375] "mps2"  MPC
 SG_ RSDS_L_ObjRAccelYStd_8 : 423|6@0+ (0.0625,0) [0|3.9375] "mps2"  MPC
 SG_ RSDS_L_ObjWidth_8 : 417|10@0+ (0.01,0) [0|5] "m"  MPC
 SG_ RSDS_L_ObjMotionDirection_8 : 447|3@0+ (1,0) [0|7] ""  MPC
 SG_ RSDS_L_ObjAge_8 : 439|8@0+ (1,0) [0|255] ""  MPC
 SG_ RSDS_L_ObjLength_8 : 463|10@0+ (0.05,0) [0|20] "m"  MPC
 SG_ RSDS_L_ObjHeading_8 : 469|12@0+ (0.002,-3.14) [-3.14|3.14] "rad"  MPC
 SG_ RSDS_L_ObjYawrate_8 : 473|12@0+ (0.002,-3.14) [-3.14|3.14] "rad/s"  MPC
 SG_ RSDS_L_ObjRCS_8 : 493|10@0+ (0.125,-50) [-50|70] "dBm2"  MPC
 SG_ RSDS_L_ObjRefPoint_8 : 499|3@0+ (1,0) [0|8] ""  MPC
 SG_ RSDS_L_HWATargetValidity_8 : 496|1@0+ (1,0) [0|1] ""  MPC
 SG_ RSDS_L_SGU4_BlockCounter : 511|4@0+ (1,0) [0|15] ""  MPC
 SG_ RSDS_L_ObjValid_7 : 252|1@0+ (1,0) [0|1] ""  MPC
 SG_ RSDS_L_ObjValid_8 : 253|1@0+ (1,0) [0|1] ""  MPC
 SG_ Checksum583 : 7|16@0+ (1,0) [0|65535] ""  MPC
 SG_ RollingCounter583 : 23|8@0+ (1,0) [0|255] ""  MPC
 SG_ RSDS_L_ObjHYAS_Reserved_7 : 261|6@0+ (0.017,0) [0|1.071] ""  MPC
 SG_ RSDS_L_ObjHYAS_Reserved_8 : 251|6@0+ (0.017,0) [0|1.071] ""  MPC
 SG_ RSDS_L_ObjTypeProb_7 : 325|6@0+ (2,0) [0|100] "%"  MPC
 SG_ RSDS_L_ObjTypeProb_8 : 315|6@0+ (2,0) [0|100] "%"  MPC
 SG_ RSDS_L_ObjHeight_7 : 31|10@0+ (0.01,0) [0|6] "m"  MPC
 SG_ RSDS_L_ObjHeight_8 : 379|10@0+ (0.01,0) [0|6] "m"  MPC

BO_ 1412 RSDS_L_SGU5: 64 CR_RL
 SG_ RSDS_L_ObjID_9 : 71|8@0+ (1,0) [0|255] ""  MPC
 SG_ RSDS_L_ObjExistProb_9 : 124|5@0+ (0.03326,0) [0|1] ""  MPC
 SG_ RSDS_L_ObjObstacleProb_9 : 135|5@0+ (0.03326,0) [0|1] ""  MPC
 SG_ RSDS_L_ObjDistX_9 : 187|12@0+ (0.0625,-128) [-128|127.9375] "m"  MPC
 SG_ RSDS_L_ObjDistY_9 : 33|11@0+ (0.125,-128) [-128|127.875] "m"  MPC
 SG_ RSDS_L_ObjDistXStd_9 : 54|6@0+ (0.1,0) [0|6] "m"  MPC
 SG_ RSDS_L_ObjType_9 : 63|4@0+ (1,0) [0|15] ""  MPC
 SG_ RSDS_L_ObjRelVelX_9 : 79|13@0+ (0.0312,-128) [-128|126.9976] "mps"  MPC
 SG_ RSDS_L_ObjRelVelY_9 : 82|13@0+ (0.0312,-128) [-128|126.9976] "mps"  MPC
 SG_ RSDS_L_ObjRelAccelX_9 : 101|10@0+ (0.03125,-16) [-16|15.96875] "mps2"  MPC
 SG_ RSDS_L_ObjRelAccelY_9 : 107|10@0+ (0.03125,-16) [-16|15.96875] "mps2"  MPC
 SG_ RSDS_L_ObjMotionType_9 : 127|3@0+ (1,0) [0|7] ""  MPC
 SG_ RSDS_L_ObjMeasured_9 : 113|2@0+ (1,0) [0|3] ""  MPC
 SG_ RSDS_L_ObjDistYStd_9 : 143|6@0+ (0.1,0) [0|6] "m"  MPC
 SG_ RSDS_L_ObjRelVelXStd_9 : 137|6@0+ (0.0625,0) [0|3.9375] "mps"  MPC
 SG_ RSDS_L_ObjRelVelYStd_9 : 147|6@0+ (0.0625,0) [0|3.9375] "mps"  MPC
 SG_ RSDS_L_ObjRAccelXStd_9 : 157|6@0+ (0.0625,0) [0|3.9375] "mps2"  MPC
 SG_ RSDS_L_ObjRAccelYStd_9 : 167|6@0+ (0.0625,0) [0|3.9375] "mps2"  MPC
 SG_ RSDS_L_ObjWidth_9 : 161|10@0+ (0.01,0) [0|5] "m"  MPC
 SG_ RSDS_L_ObjMotionDirection_9 : 191|3@0+ (1,0) [0|7] ""  MPC
 SG_ RSDS_L_ObjAge_9 : 183|8@0+ (1,0) [0|255] ""  MPC
 SG_ RSDS_L_ObjLength_9 : 207|10@0+ (0.05,0) [0|20] "m"  MPC
 SG_ RSDS_L_ObjHeading_9 : 213|12@0+ (0.002,-3.14) [-3.14|3.14] "rad"  MPC
 SG_ RSDS_L_ObjYawrate_9 : 217|12@0+ (0.002,-3.14) [-3.14|3.14] "rad/s"  MPC
 SG_ RSDS_L_ObjRCS_9 : 237|10@0+ (0.125,-50) [-50|70] "dBm2"  MPC
 SG_ RSDS_L_ObjRefPoint_9 : 243|3@0+ (1,0) [0|8] ""  MPC
 SG_ RSDS_L_HWATargetValidity_9 : 240|1@0+ (1,0) [0|1] ""  MPC
 SG_ RSDS_L_ObjID_10 : 271|8@0+ (1,0) [0|255] ""  MPC
 SG_ RSDS_L_ObjExistProb_10 : 279|5@0+ (0.03326,0) [0|1] ""  MPC
 SG_ RSDS_L_ObjObstacleProb_10 : 274|5@0+ (0.03326,0) [0|1] ""  MPC
 SG_ RSDS_L_ObjDistX_10 : 285|12@0+ (0.0625,-128) [-128|127.9375] "m"  MPC
 SG_ RSDS_L_ObjDistY_10 : 289|11@0+ (0.125,-128) [-128|127.875] "m"  MPC
 SG_ RSDS_L_ObjDistXStd_10 : 310|6@0+ (0.1,0) [0|6] "m"  MPC
 SG_ RSDS_L_ObjType_10 : 319|4@0+ (1,0) [0|15] ""  MPC
 SG_ RSDS_L_ObjRelVelX_10 : 335|13@0+ (0.0312,-128) [-128|126.9976] "mps"  MPC
 SG_ RSDS_L_ObjRelVelY_10 : 338|13@0+ (0.0312,-128) [-128|126.9976] "mps"  MPC
 SG_ RSDS_L_ObjRelAccelX_10 : 357|10@0+ (0.03125,-16) [-16|15.96875] "mps2"  MPC
 SG_ RSDS_L_ObjRelAccelY_10 : 363|10@0+ (0.03125,-16) [-16|15.96875] "mps2"  MPC
 SG_ RSDS_L_ObjMotionType_10 : 383|3@0+ (1,0) [0|7] ""  MPC
 SG_ RSDS_L_ObjMeasured_10 : 369|2@0+ (1,0) [0|3] ""  MPC
 SG_ RSDS_L_ObjDistYStd_10 : 399|6@0+ (0.1,0) [0|6] "m"  MPC
 SG_ RSDS_L_ObjRelVelXStd_10 : 393|6@0+ (0.0625,0) [0|3.9375] "mps"  MPC
 SG_ RSDS_L_ObjRelVelYStd_10 : 403|6@0+ (0.0625,0) [0|3.9375] "mps"  MPC
 SG_ RSDS_L_ObjRAccelXStd_10 : 413|6@0+ (0.0625,0) [0|3.9375] "mps2"  MPC
 SG_ RSDS_L_ObjRAccelYStd_10 : 423|6@0+ (0.0625,0) [0|3.9375] "mps2"  MPC
 SG_ RSDS_L_ObjWidth_10 : 417|10@0+ (0.01,0) [0|5] "m"  MPC
 SG_ RSDS_L_ObjMotionDirection_10 : 447|3@0+ (1,0) [0|7] ""  MPC
 SG_ RSDS_L_ObjAge_10 : 439|8@0+ (1,0) [0|255] ""  MPC
 SG_ RSDS_L_ObjLength_10 : 463|10@0+ (0.05,0) [0|20] "m"  MPC
 SG_ RSDS_L_ObjHeading_10 : 469|12@0+ (0.002,-3.14) [-3.14|3.14] "rad"  MPC
 SG_ RSDS_L_ObjYawrate_10 : 473|12@0+ (0.002,-3.14) [-3.14|3.14] "rad/s"  MPC
 SG_ RSDS_L_ObjRCS_10 : 493|10@0+ (0.125,-50) [-50|70] "dBm2"  MPC
 SG_ RSDS_L_ObjRefPoint_10 : 499|3@0+ (1,0) [0|8] ""  MPC
 SG_ RSDS_L_HWATargetValidity_10 : 496|1@0+ (1,0) [0|1] ""  MPC
 SG_ RSDS_L_SGU5_BlockCounter : 511|4@0+ (1,0) [0|15] ""  MPC
 SG_ RSDS_L_ObjValid_9 : 252|1@0+ (1,0) [0|1] ""  MPC
 SG_ RSDS_L_ObjValid_10 : 253|1@0+ (1,0) [0|1] ""  MPC
 SG_ Checksum584 : 7|16@0+ (1,0) [0|65535] ""  MPC
 SG_ RollingCounter584 : 23|8@0+ (1,0) [0|255] ""  MPC
 SG_ RSDS_L_ObjHYAS_Reserved_9 : 261|6@0+ (0.017,0) [0|1.071] ""  MPC
 SG_ RSDS_L_ObjHYAS_Reserved_10 : 251|6@0+ (0.017,0) [0|1.071] ""  MPC
 SG_ RSDS_L_ObjTypeProb_9 : 325|6@0+ (2,0) [0|100] "%"  MPC
 SG_ RSDS_L_ObjTypeProb_10 : 315|6@0+ (2,0) [0|100] "%"  MPC
 SG_ RSDS_L_ObjHeight_9 : 31|10@0+ (0.01,0) [0|6] "m"  MPC
 SG_ RSDS_L_ObjHeight_10 : 379|10@0+ (0.01,0) [0|6] "m"  MPC

BO_ 1413 RSDS_L_SGU6: 64 CR_RL
 SG_ RSDS_L_ObjID_11 : 71|8@0+ (1,0) [0|255] ""  MPC
 SG_ RSDS_L_ObjExistProb_11 : 124|5@0+ (0.03326,0) [0|1] ""  MPC
 SG_ RSDS_L_ObjObstacleProb_11 : 135|5@0+ (0.03326,0) [0|1] ""  MPC
 SG_ RSDS_L_ObjDistX_11 : 187|12@0+ (0.0625,-128) [-128|127.9375] "m"  MPC
 SG_ RSDS_L_ObjDistY_11 : 33|11@0+ (0.125,-128) [-128|127.875] "m"  MPC
 SG_ RSDS_L_ObjDistXStd_11 : 54|6@0+ (0.1,0) [0|6] "m"  MPC
 SG_ RSDS_L_ObjType_11 : 63|4@0+ (1,0) [0|15] ""  MPC
 SG_ RSDS_L_ObjRelVelX_11 : 79|13@0+ (0.0312,-128) [-128|126.9976] "mps"  MPC
 SG_ RSDS_L_ObjRelVelY_11 : 82|13@0+ (0.0312,-128) [-128|126.9976] "mps"  MPC
 SG_ RSDS_L_ObjRelAccelX_11 : 101|10@0+ (0.03125,-16) [-16|15.96875] "mps2"  MPC
 SG_ RSDS_L_ObjRelAccelY_11 : 107|10@0+ (0.03125,-16) [-16|15.96875] "mps2"  MPC
 SG_ RSDS_L_ObjMotionType_11 : 127|3@0+ (1,0) [0|7] ""  MPC
 SG_ RSDS_L_ObjMeasured_11 : 113|2@0+ (1,0) [0|3] ""  MPC
 SG_ RSDS_L_ObjDistYStd_11 : 143|6@0+ (0.1,0) [0|6] "m"  MPC
 SG_ RSDS_L_ObjRelVelXStd_11 : 137|6@0+ (0.0625,0) [0|3.9375] "mps"  MPC
 SG_ RSDS_L_ObjRelVelYStd_11 : 147|6@0+ (0.0625,0) [0|3.9375] "mps"  MPC
 SG_ RSDS_L_ObjRAccelXStd_11 : 157|6@0+ (0.0625,0) [0|3.9375] "mps2"  MPC
 SG_ RSDS_L_ObjRAccelYStd_11 : 167|6@0+ (0.0625,0) [0|3.9375] "mps2"  MPC
 SG_ RSDS_L_ObjWidth_11 : 161|10@0+ (0.01,0) [0|5] "m"  MPC
 SG_ RSDS_L_ObjMotionDirection_11 : 191|3@0+ (1,0) [0|7] ""  MPC
 SG_ RSDS_L_ObjAge_11 : 183|8@0+ (1,0) [0|255] ""  MPC
 SG_ RSDS_L_ObjLength_11 : 207|10@0+ (0.05,0) [0|20] "m"  MPC
 SG_ RSDS_L_ObjHeading_11 : 213|12@0+ (0.002,-3.14) [-3.14|3.14] "rad"  MPC
 SG_ RSDS_L_ObjYawrate_11 : 217|12@0+ (0.002,-3.14) [-3.14|3.14] "rad/s"  MPC
 SG_ RSDS_L_ObjRCS_11 : 237|10@0+ (0.125,-50) [-50|70] "dBm2"  MPC
 SG_ RSDS_L_ObjRefPoint_11 : 243|3@0+ (1,0) [0|8] ""  MPC
 SG_ RSDS_L_HWATargetValidity_11 : 240|1@0+ (1,0) [0|1] ""  MPC
 SG_ RSDS_L_ObjID_12 : 271|8@0+ (1,0) [0|255] ""  MPC
 SG_ RSDS_L_ObjExistProb_12 : 279|5@0+ (0.03326,0) [0|1] ""  MPC
 SG_ RSDS_L_ObjObstacleProb_12 : 274|5@0+ (0.03326,0) [0|1] ""  MPC
 SG_ RSDS_L_ObjDistX_12 : 285|12@0+ (0.0625,-128) [-128|127.9375] "m"  MPC
 SG_ RSDS_L_ObjDistY_12 : 289|11@0+ (0.125,-128) [-128|127.875] "m"  MPC
 SG_ RSDS_L_ObjDistXStd_12 : 310|6@0+ (0.1,0) [0|6] "m"  MPC
 SG_ RSDS_L_ObjType_12 : 319|4@0+ (1,0) [0|15] ""  MPC
 SG_ RSDS_L_ObjRelVelX_12 : 335|13@0+ (0.0312,-128) [-128|126.9976] "mps"  MPC
 SG_ RSDS_L_ObjRelVelY_12 : 338|13@0+ (0.0312,-128) [-128|126.9976] "mps"  MPC
 SG_ RSDS_L_ObjRelAccelX_12 : 357|10@0+ (0.03125,-16) [-16|15.96875] "mps2"  MPC
 SG_ RSDS_L_ObjRelAccelY_12 : 363|10@0+ (0.03125,-16) [-16|15.96875] "mps2"  MPC
 SG_ RSDS_L_ObjMotionType_12 : 383|3@0+ (1,0) [0|7] ""  MPC
 SG_ RSDS_L_ObjMeasured_12 : 369|2@0+ (1,0) [0|3] ""  MPC
 SG_ RSDS_L_ObjDistYStd_12 : 399|6@0+ (0.1,0) [0|6] "m"  MPC
 SG_ RSDS_L_ObjRelVelXStd_12 : 393|6@0+ (0.0625,0) [0|3.9375] "mps"  MPC
 SG_ RSDS_L_ObjRelVelYStd_12 : 403|6@0+ (0.0625,0) [0|3.9375] "mps"  MPC
 SG_ RSDS_L_ObjRAccelXStd_12 : 413|6@0+ (0.0625,0) [0|3.9375] "mps2"  MPC
 SG_ RSDS_L_ObjRAccelYStd_12 : 423|6@0+ (0.0625,0) [0|3.9375] "mps2"  MPC
 SG_ RSDS_L_ObjWidth_12 : 417|10@0+ (0.01,0) [0|5] "m"  MPC
 SG_ RSDS_L_ObjMotionDirection_12 : 447|3@0+ (1,0) [0|7] ""  MPC
 SG_ RSDS_L_ObjAge_12 : 439|8@0+ (1,0) [0|255] ""  MPC
 SG_ RSDS_L_ObjLength_12 : 463|10@0+ (0.05,0) [0|20] "m"  MPC
 SG_ RSDS_L_ObjHeading_12 : 469|12@0+ (0.002,-3.14) [-3.14|3.14] "rad"  MPC
 SG_ RSDS_L_ObjYawrate_12 : 473|12@0+ (0.002,-3.14) [-3.14|3.14] "rad/s"  MPC
 SG_ RSDS_L_ObjRCS_12 : 493|10@0+ (0.125,-50) [-50|70] "dBm2"  MPC
 SG_ RSDS_L_ObjRefPoint_12 : 499|3@0+ (1,0) [0|8] ""  MPC
 SG_ RSDS_L_HWATargetValidity_12 : 496|1@0+ (1,0) [0|1] ""  MPC
 SG_ RSDS_L_SGU6_BlockCounter : 511|4@0+ (1,0) [0|15] ""  MPC
 SG_ RSDS_L_ObjValid_11 : 252|1@0+ (1,0) [0|1] ""  MPC
 SG_ RSDS_L_ObjValid_12 : 253|1@0+ (1,0) [0|1] ""  MPC
 SG_ Checksum585 : 7|16@0+ (1,0) [0|65535] ""  MPC
 SG_ RollingCounter585 : 23|8@0+ (1,0) [0|255] ""  MPC
 SG_ RSDS_L_ObjHYAS_Reserved_11 : 261|6@0+ (0.017,0) [0|1.071] ""  MPC
 SG_ RSDS_L_ObjHYAS_Reserved_12 : 251|6@0+ (0.017,0) [0|1.071] ""  MPC
 SG_ RSDS_L_ObjTypeProb_11 : 325|6@0+ (2,0) [0|100] "%"  MPC
 SG_ RSDS_L_ObjTypeProb_12 : 315|6@0+ (2,0) [0|100] "%"  MPC
 SG_ RSDS_L_ObjHeight_11 : 31|10@0+ (0.01,0) [0|6] "m"  MPC
 SG_ RSDS_L_ObjHeight_12 : 379|10@0+ (0.01,0) [0|6] "m"  MPC

BO_ 1414 RSDS_L_SGU7: 64 CR_RL
 SG_ RSDS_L_ObjID_13 : 71|8@0+ (1,0) [0|255] ""  MPC
 SG_ RSDS_L_ObjExistProb_13 : 124|5@0+ (0.03326,0) [0|1] ""  MPC
 SG_ RSDS_L_ObjObstacleProb_13 : 135|5@0+ (0.03326,0) [0|1] ""  MPC
 SG_ RSDS_L_ObjDistX_13 : 187|12@0+ (0.0625,-128) [-128|127.9375] "m"  MPC
 SG_ RSDS_L_ObjDistY_13 : 33|11@0+ (0.125,-128) [-128|127.875] "m"  MPC
 SG_ RSDS_L_ObjDistXStd_13 : 54|6@0+ (0.1,0) [0|6] "m"  MPC
 SG_ RSDS_L_ObjType_13 : 63|4@0+ (1,0) [0|15] ""  MPC
 SG_ RSDS_L_ObjRelVelX_13 : 79|13@0+ (0.0312,-128) [-128|126.9976] "mps"  MPC
 SG_ RSDS_L_ObjRelVelY_13 : 82|13@0+ (0.0312,-128) [-128|126.9976] "mps"  MPC
 SG_ RSDS_L_ObjRelAccelX_13 : 101|10@0+ (0.03125,-16) [-16|15.96875] "mps2"  MPC
 SG_ RSDS_L_ObjRelAccelY_13 : 107|10@0+ (0.03125,-16) [-16|15.96875] "mps2"  MPC
 SG_ RSDS_L_ObjMotionType_13 : 127|3@0+ (1,0) [0|7] ""  MPC
 SG_ RSDS_L_ObjMeasured_13 : 113|2@0+ (1,0) [0|3] ""  MPC
 SG_ RSDS_L_ObjDistYStd_13 : 143|6@0+ (0.1,0) [0|6] "m"  MPC
 SG_ RSDS_L_ObjRelVelXStd_13 : 137|6@0+ (0.0625,0) [0|3.9375] "mps"  MPC
 SG_ RSDS_L_ObjRelVelYStd_13 : 147|6@0+ (0.0625,0) [0|3.9375] "mps"  MPC
 SG_ RSDS_L_ObjRAccelXStd_13 : 157|6@0+ (0.0625,0) [0|3.9375] "mps2"  MPC
 SG_ RSDS_L_ObjRAccelYStd_13 : 167|6@0+ (0.0625,0) [0|3.9375] "mps2"  MPC
 SG_ RSDS_L_ObjWidth_13 : 161|10@0+ (0.01,0) [0|5] "m"  MPC
 SG_ RSDS_L_ObjMotionDirection_13 : 191|3@0+ (1,0) [0|7] ""  MPC
 SG_ RSDS_L_ObjAge_13 : 183|8@0+ (1,0) [0|255] ""  MPC
 SG_ RSDS_L_ObjLength_13 : 207|10@0+ (0.05,0) [0|20] "m"  MPC
 SG_ RSDS_L_ObjHeading_13 : 213|12@0+ (0.002,-3.14) [-3.14|3.14] "rad"  MPC
 SG_ RSDS_L_ObjYawrate_13 : 217|12@0+ (0.002,-3.14) [-3.14|3.14] "rad/s"  MPC
 SG_ RSDS_L_ObjRCS_13 : 237|10@0+ (0.125,-50) [-50|70] "dBm2"  MPC
 SG_ RSDS_L_ObjRefPoint_13 : 243|3@0+ (1,0) [0|8] ""  MPC
 SG_ RSDS_L_HWATargetValidity_13 : 240|1@0+ (1,0) [0|1] ""  MPC
 SG_ RSDS_L_ObjID_14 : 271|8@0+ (1,0) [0|255] ""  MPC
 SG_ RSDS_L_ObjExistProb_14 : 279|5@0+ (0.03326,0) [0|1] ""  MPC
 SG_ RSDS_L_ObjObstacleProb_14 : 274|5@0+ (0.03326,0) [0|1] ""  MPC
 SG_ RSDS_L_ObjDistX_14 : 285|12@0+ (0.0625,-128) [-128|127.9375] "m"  MPC
 SG_ RSDS_L_ObjDistY_14 : 289|11@0+ (0.125,-128) [-128|127.875] "m"  MPC
 SG_ RSDS_L_ObjDistXStd_14 : 310|6@0+ (0.1,0) [0|6] "m"  MPC
 SG_ RSDS_L_ObjType_14 : 319|4@0+ (1,0) [0|15] ""  MPC
 SG_ RSDS_L_ObjRelVelX_14 : 335|13@0+ (0.0312,-128) [-128|126.9976] "mps"  MPC
 SG_ RSDS_L_ObjRelVelY_14 : 338|13@0+ (0.0312,-128) [-128|126.9976] "mps"  MPC
 SG_ RSDS_L_ObjRelAccelX_14 : 357|10@0+ (0.03125,-16) [-16|15.96875] "mps2"  MPC
 SG_ RSDS_L_ObjRelAccelY_14 : 363|10@0+ (0.03125,-16) [-16|15.96875] "mps2"  MPC
 SG_ RSDS_L_ObjMotionType_14 : 383|3@0+ (1,0) [0|7] ""  MPC
 SG_ RSDS_L_ObjMeasured_14 : 369|2@0+ (1,0) [0|3] ""  MPC
 SG_ RSDS_L_ObjDistYStd_14 : 399|6@0+ (0.1,0) [0|6] "m"  MPC
 SG_ RSDS_L_ObjRelVelXStd_14 : 393|6@0+ (0.0625,0) [0|3.9375] "mps"  MPC
 SG_ RSDS_L_ObjRelVelYStd_14 : 403|6@0+ (0.0625,0) [0|3.9375] "mps"  MPC
 SG_ RSDS_L_ObjRAccelXStd_14 : 413|6@0+ (0.0625,0) [0|3.9375] "mps2"  MPC
 SG_ RSDS_L_ObjRAccelYStd_14 : 423|6@0+ (0.0625,0) [0|3.9375] "mps2"  MPC
 SG_ RSDS_L_ObjWidth_14 : 417|10@0+ (0.01,0) [0|5] "m"  MPC
 SG_ RSDS_L_ObjMotionDirection_14 : 447|3@0+ (1,0) [0|7] ""  MPC
 SG_ RSDS_L_ObjAge_14 : 439|8@0+ (1,0) [0|255] ""  MPC
 SG_ RSDS_L_ObjLength_14 : 463|10@0+ (0.05,0) [0|20] "m"  MPC
 SG_ RSDS_L_ObjHeading_14 : 469|12@0+ (0.002,-3.14) [-3.14|3.14] "rad"  MPC
 SG_ RSDS_L_ObjYawrate_14 : 473|12@0+ (0.002,-3.14) [-3.14|3.14] "rad/s"  MPC
 SG_ RSDS_L_ObjRCS_14 : 493|10@0+ (0.125,-50) [-50|70] "dBm2"  MPC
 SG_ RSDS_L_ObjRefPoint_14 : 499|3@0+ (1,0) [0|8] ""  MPC
 SG_ RSDS_L_HWATargetValidity_14 : 496|1@0+ (1,0) [0|1] ""  MPC
 SG_ RSDS_L_SGU7_BlockCounter : 511|4@0+ (1,0) [0|15] ""  MPC
 SG_ RSDS_L_ObjValid_13 : 252|1@0+ (1,0) [0|1] ""  MPC
 SG_ RSDS_L_ObjValid_14 : 253|1@0+ (1,0) [0|1] ""  MPC
 SG_ Checksum586 : 7|16@0+ (1,0) [0|65535] ""  MPC
 SG_ RollingCounter586 : 23|8@0+ (1,0) [0|255] ""  MPC
 SG_ RSDS_L_ObjHYAS_Reserved_13 : 261|6@0+ (0.017,0) [0|1.071] ""  MPC
 SG_ RSDS_L_ObjHYAS_Reserved_14 : 251|6@0+ (0.017,0) [0|1.071] ""  MPC
 SG_ RSDS_L_ObjTypeProb_13 : 325|6@0+ (2,0) [0|100] "%"  MPC
 SG_ RSDS_L_ObjTypeProb_14 : 315|6@0+ (2,0) [0|100] "%"  MPC
 SG_ RSDS_L_ObjHeight_13 : 31|10@0+ (0.01,0) [0|6] "m"  MPC
 SG_ RSDS_L_ObjHeight_14 : 379|10@0+ (0.01,0) [0|6] "m"  MPC

BO_ 1415 RSDS_L_SGU8: 64 CR_RL
 SG_ RSDS_L_ObjID_15 : 71|8@0+ (1,0) [0|255] ""  MPC
 SG_ RSDS_L_ObjExistProb_15 : 124|5@0+ (0.03326,0) [0|1] ""  MPC
 SG_ RSDS_L_ObjObstacleProb_15 : 135|5@0+ (0.03326,0) [0|1] ""  MPC
 SG_ RSDS_L_ObjDistX_15 : 187|12@0+ (0.0625,-128) [-128|127.9375] "m"  MPC
 SG_ RSDS_L_ObjDistY_15 : 33|11@0+ (0.125,-128) [-128|127.875] "m"  MPC
 SG_ RSDS_L_ObjDistXStd_15 : 54|6@0+ (0.1,0) [0|6] "m"  MPC
 SG_ RSDS_L_ObjType_15 : 63|4@0+ (1,0) [0|15] ""  MPC
 SG_ RSDS_L_ObjRelVelX_15 : 79|13@0+ (0.0312,-128) [-128|126.9976] "mps"  MPC
 SG_ RSDS_L_ObjRelVelY_15 : 82|13@0+ (0.0312,-128) [-128|126.9976] "mps"  MPC
 SG_ RSDS_L_ObjRelAccelX_15 : 101|10@0+ (0.03125,-16) [-16|15.96875] "mps2"  MPC
 SG_ RSDS_L_ObjRelAccelY_15 : 107|10@0+ (0.03125,-16) [-16|15.96875] "mps2"  MPC
 SG_ RSDS_L_ObjMotionType_15 : 127|3@0+ (1,0) [0|7] ""  MPC
 SG_ RSDS_L_ObjMeasured_15 : 113|2@0+ (1,0) [0|3] ""  MPC
 SG_ RSDS_L_ObjDistYStd_15 : 143|6@0+ (0.1,0) [0|6] "m"  MPC
 SG_ RSDS_L_ObjRelVelXStd_15 : 137|6@0+ (0.0625,0) [0|3.9375] "mps"  MPC
 SG_ RSDS_L_ObjRelVelYStd_15 : 147|6@0+ (0.0625,0) [0|3.9375] "mps"  MPC
 SG_ RSDS_L_ObjRAccelXStd_15 : 157|6@0+ (0.0625,0) [0|3.9375] "mps2"  MPC
 SG_ RSDS_L_ObjRAccelYStd_15 : 167|6@0+ (0.0625,0) [0|3.9375] "mps2"  MPC
 SG_ RSDS_L_ObjWidth_15 : 161|10@0+ (0.01,0) [0|5] "m"  MPC
 SG_ RSDS_L_ObjMotionDirection_15 : 191|3@0+ (1,0) [0|7] ""  MPC
 SG_ RSDS_L_ObjAge_15 : 183|8@0+ (1,0) [0|255] ""  MPC
 SG_ RSDS_L_ObjLength_15 : 207|10@0+ (0.05,0) [0|20] "m"  MPC
 SG_ RSDS_L_ObjHeading_15 : 213|12@0+ (0.002,-3.14) [-3.14|3.14] "rad"  MPC
 SG_ RSDS_L_ObjYawrate_15 : 217|12@0+ (0.002,-3.14) [-3.14|3.14] "rad/s"  MPC
 SG_ RSDS_L_ObjRCS_15 : 237|10@0+ (0.125,-50) [-50|70] "dBm2"  MPC
 SG_ RSDS_L_ObjRefPoint_15 : 243|3@0+ (1,0) [0|8] ""  MPC
 SG_ RSDS_L_HWATargetValidity_15 : 240|1@0+ (1,0) [0|1] ""  MPC
 SG_ RSDS_L_ObjID_16 : 271|8@0+ (1,0) [0|255] ""  MPC
 SG_ RSDS_L_ObjExistProb_16 : 279|5@0+ (0.03326,0) [0|1] ""  MPC
 SG_ RSDS_L_ObjObstacleProb_16 : 274|5@0+ (0.03326,0) [0|1] ""  MPC
 SG_ RSDS_L_ObjDistX_16 : 285|12@0+ (0.0625,-128) [-128|127.9375] "m"  MPC
 SG_ RSDS_L_ObjDistY_16 : 289|11@0+ (0.125,-128) [-128|127.875] "m"  MPC
 SG_ RSDS_L_ObjDistXStd_16 : 310|6@0+ (0.1,0) [0|6] "m"  MPC
 SG_ RSDS_L_ObjType_16 : 319|4@0+ (1,0) [0|15] ""  MPC
 SG_ RSDS_L_ObjRelVelX_16 : 335|13@0+ (0.0312,-128) [-128|126.9976] "mps"  MPC
 SG_ RSDS_L_ObjRelVelY_16 : 338|13@0+ (0.0312,-128) [-128|126.9976] "mps"  MPC
 SG_ RSDS_L_ObjRelAccelX_16 : 357|10@0+ (0.03125,-16) [-16|15.96875] "mps2"  MPC
 SG_ RSDS_L_ObjRelAccelY_16 : 363|10@0+ (0.03125,-16) [-16|15.96875] "mps2"  MPC
 SG_ RSDS_L_ObjMotionType_16 : 383|3@0+ (1,0) [0|7] ""  MPC
 SG_ RSDS_L_ObjMeasured_16 : 369|2@0+ (1,0) [0|3] ""  MPC
 SG_ RSDS_L_ObjDistYStd_16 : 399|6@0+ (0.1,0) [0|6] "m"  MPC
 SG_ RSDS_L_ObjRelVelXStd_16 : 393|6@0+ (0.0625,0) [0|3.9375] "mps"  MPC
 SG_ RSDS_L_ObjRelVelYStd_16 : 403|6@0+ (0.0625,0) [0|3.9375] "mps"  MPC
 SG_ RSDS_L_ObjRAccelXStd_16 : 413|6@0+ (0.0625,0) [0|3.9375] "mps2"  MPC
 SG_ RSDS_L_ObjRAccelYStd_16 : 423|6@0+ (0.0625,0) [0|3.9375] "mps2"  MPC
 SG_ RSDS_L_ObjWidth_16 : 417|10@0+ (0.01,0) [0|5] "m"  MPC
 SG_ RSDS_L_ObjMotionDirection_16 : 447|3@0+ (1,0) [0|7] ""  MPC
 SG_ RSDS_L_ObjAge_16 : 439|8@0+ (1,0) [0|255] ""  MPC
 SG_ RSDS_L_ObjLength_16 : 463|10@0+ (0.05,0) [0|20] "m"  MPC
 SG_ RSDS_L_ObjHeading_16 : 469|12@0+ (0.002,-3.14) [-3.14|3.14] "rad"  MPC
 SG_ RSDS_L_ObjYawrate_16 : 473|12@0+ (0.002,-3.14) [-3.14|3.14] "rad/s"  MPC
 SG_ RSDS_L_ObjRCS_16 : 493|10@0+ (0.125,-50) [-50|70] "dBm2"  MPC
 SG_ RSDS_L_ObjRefPoint_16 : 499|3@0+ (1,0) [0|8] ""  MPC
 SG_ RSDS_L_HWATargetValidity_16 : 496|1@0+ (1,0) [0|1] ""  MPC
 SG_ RSDS_L_SGU8_BlockCounter : 511|4@0+ (1,0) [0|15] ""  MPC
 SG_ RSDS_L_ObjValid_15 : 252|1@0+ (1,0) [0|1] ""  MPC
 SG_ RSDS_L_ObjValid_16 : 253|1@0+ (1,0) [0|1] ""  MPC
 SG_ Checksum587 : 7|16@0+ (1,0) [0|65535] ""  MPC
 SG_ RollingCounter587 : 23|8@0+ (1,0) [0|255] ""  MPC
 SG_ RSDS_L_ObjHYAS_Reserved_15 : 261|6@0+ (0.017,0) [0|1.071] ""  MPC
 SG_ RSDS_L_ObjHYAS_Reserved_16 : 251|6@0+ (0.017,0) [0|1.071] ""  MPC
 SG_ RSDS_L_ObjTypeProb_15 : 325|6@0+ (2,0) [0|100] "%"  MPC
 SG_ RSDS_L_ObjTypeProb_16 : 315|6@0+ (2,0) [0|100] "%"  MPC
 SG_ RSDS_L_ObjHeight_15 : 31|10@0+ (0.01,0) [0|6] "m"  MPC
 SG_ RSDS_L_ObjHeight_16 : 379|10@0+ (0.01,0) [0|6] "m"  MPC

BO_ 1424 RSDS_R_SGU1: 64 CR_RR
 SG_ RSDS_R_ObjID_1 : 71|8@0+ (1,0) [0|255] ""  MPC
 SG_ RSDS_R_ObjExistProb_1 : 124|5@0+ (0.03326,0) [0|1] ""  MPC
 SG_ RSDS_R_ObjObstacleProb_1 : 135|5@0+ (0.03326,0) [0|1] ""  MPC
 SG_ RSDS_R_ObjDistX_1 : 187|12@0+ (0.0625,-128) [-128|127.9375] "m"  MPC
 SG_ RSDS_R_ObjDistY_1 : 33|11@0+ (0.125,-128) [-128|127.875] "m"  MPC
 SG_ RSDS_R_ObjDistXStd_1 : 54|6@0+ (0.1,0) [0|6] "m"  MPC
 SG_ RSDS_R_ObjType_1 : 63|4@0+ (1,0) [0|15] ""  MPC
 SG_ RSDS_R_ObjRelVelX_1 : 79|13@0+ (0.0312,-128) [-128|126.9976] "mps"  MPC
 SG_ RSDS_R_ObjRelVelY_1 : 82|13@0+ (0.0312,-128) [-128|126.9976] "mps"  MPC
 SG_ RSDS_R_ObjRelAccelX_1 : 101|10@0+ (0.03125,-16) [-16|15.96875] "mps2"  MPC
 SG_ RSDS_R_ObjRelAccelY_1 : 107|10@0+ (0.03125,-16) [-16|15.96875] "mps2"  MPC
 SG_ RSDS_R_ObjMotionType_1 : 127|3@0+ (1,0) [0|7] ""  MPC
 SG_ RSDS_R_ObjMeasured_1 : 113|2@0+ (1,0) [0|3] ""  MPC
 SG_ RSDS_R_ObjDistYStd_1 : 143|6@0+ (0.1,0) [0|6] "m"  MPC
 SG_ RSDS_R_ObjRelVelXStd_1 : 137|6@0+ (0.0625,0) [0|3.9375] "mps"  MPC
 SG_ RSDS_R_ObjRelVelYStd_1 : 147|6@0+ (0.0625,0) [0|3.9375] "mps"  MPC
 SG_ RSDS_R_ObjRAccelXStd_1 : 157|6@0+ (0.0625,0) [0|3.9375] "mps2"  MPC
 SG_ RSDS_R_ObjRAccelYStd_1 : 167|6@0+ (0.0625,0) [0|3.9375] "mps2"  MPC
 SG_ RSDS_R_ObjWidth_1 : 161|10@0+ (0.01,0) [0|5] "m"  MPC
 SG_ RSDS_R_ObjMotionDirection_1 : 191|3@0+ (1,0) [0|7] ""  MPC
 SG_ RSDS_R_ObjAge_1 : 183|8@0+ (1,0) [0|255] ""  MPC
 SG_ RSDS_R_ObjLength_1 : 207|10@0+ (0.05,0) [0|20] "m"  MPC
 SG_ RSDS_R_ObjHeading_1 : 213|12@0+ (0.002,-3.14) [-3.14|3.14] "rad"  MPC
 SG_ RSDS_R_ObjYawrate_1 : 217|12@0+ (0.002,-3.14) [-3.14|3.14] "rad/s"  MPC
 SG_ RSDS_R_ObjRCS_1 : 237|10@0+ (0.125,-50) [-50|70] "dBm2"  MPC
 SG_ RSDS_R_ObjRefPoint_1 : 243|3@0+ (1,0) [0|8] ""  MPC
 SG_ RSDS_R_HWATargetValidity_1 : 240|1@0+ (1,0) [0|1] ""  MPC
 SG_ RSDS_R_ObjID_2 : 271|8@0+ (1,0) [0|255] ""  MPC
 SG_ RSDS_R_ObjExistProb_2 : 279|5@0+ (0.03326,0) [0|1] ""  MPC
 SG_ RSDS_R_ObjObstacleProb_2 : 274|5@0+ (0.03326,0) [0|1] ""  MPC
 SG_ RSDS_R_ObjDistX_2 : 285|12@0+ (0.0625,-128) [-128|127.9375] "m"  MPC
 SG_ RSDS_R_ObjDistY_2 : 289|11@0+ (0.125,-128) [-128|127.875] "m"  MPC
 SG_ RSDS_R_ObjDistXStd_2 : 310|6@0+ (0.1,0) [0|6] "m"  MPC
 SG_ RSDS_R_ObjType_2 : 319|4@0+ (1,0) [0|15] ""  MPC
 SG_ RSDS_R_ObjRelVelX_2 : 335|13@0+ (0.0312,-128) [-128|126.9976] "mps"  MPC
 SG_ RSDS_R_ObjRelVelY_2 : 338|13@0+ (0.0312,-128) [-128|126.9976] "mps"  MPC
 SG_ RSDS_R_ObjRelAccelX_2 : 357|10@0+ (0.03125,-16) [-16|15.96875] "mps2"  MPC
 SG_ RSDS_R_ObjRelAccelY_2 : 363|10@0+ (0.03125,-16) [-16|15.96875] "mps2"  MPC
 SG_ RSDS_R_ObjMotionType_2 : 383|3@0+ (1,0) [0|7] ""  MPC
 SG_ RSDS_R_ObjMeasured_2 : 369|2@0+ (1,0) [0|3] ""  MPC
 SG_ RSDS_R_ObjDistYStd_2 : 399|6@0+ (0.1,0) [0|6] "m"  MPC
 SG_ RSDS_R_ObjRelVelXStd_2 : 393|6@0+ (0.0625,0) [0|3.9375] "mps"  MPC
 SG_ RSDS_R_ObjRelVelYStd_2 : 403|6@0+ (0.0625,0) [0|3.9375] "mps"  MPC
 SG_ RSDS_R_ObjRAccelXStd_2 : 413|6@0+ (0.0625,0) [0|3.9375] "mps2"  MPC
 SG_ RSDS_R_ObjRAccelYStd_2 : 423|6@0+ (0.0625,0) [0|3.9375] "mps2"  MPC
 SG_ RSDS_R_ObjWidth_2 : 417|10@0+ (0.01,0) [0|5] "m"  MPC
 SG_ RSDS_R_ObjMotionDirection_2 : 447|3@0+ (1,0) [0|7] ""  MPC
 SG_ RSDS_R_ObjAge_2 : 439|8@0+ (1,0) [0|255] ""  MPC
 SG_ RSDS_R_ObjLength_2 : 463|10@0+ (0.05,0) [0|20] "m"  MPC
 SG_ RSDS_R_ObjHeading_2 : 469|12@0+ (0.002,-3.14) [-3.14|3.14] "rad"  MPC
 SG_ RSDS_R_ObjYawrate_2 : 473|12@0+ (0.002,-3.14) [-3.14|3.14] "rad/s"  MPC
 SG_ RSDS_R_ObjRCS_2 : 493|10@0+ (0.125,-50) [-50|70] "dBm2"  MPC
 SG_ RSDS_R_ObjRefPoint_2 : 499|3@0+ (1,0) [0|8] ""  MPC
 SG_ RSDS_R_HWATargetValidity_2 : 496|1@0+ (1,0) [0|1] ""  MPC
 SG_ RSDS_R_SGU1_BlockCounter : 511|4@0+ (1,0) [0|15] ""  MPC
 SG_ RSDS_R_ObjValid_1 : 252|1@0+ (1,0) [0|1] ""  MPC
 SG_ RSDS_R_ObjValid_2 : 253|1@0+ (1,0) [0|1] ""  MPC
 SG_ Checksum590 : 7|16@0+ (1,0) [0|65535] ""  MPC
 SG_ RollingCounter590 : 23|8@0+ (1,0) [0|255] ""  MPC
 SG_ RSDS_R_ObjHYAS_Reserved_1 : 261|6@0+ (0.017,0) [0|1.071] ""  MPC
 SG_ RSDS_R_ObjHYAS_Reserved_2 : 251|6@0+ (0.017,0) [0|1.071] ""  MPC
 SG_ RSDS_R_ObjTypeProb_1 : 325|6@0+ (2,0) [0|100] "%"  MPC
 SG_ RSDS_R_ObjTypeProb_2 : 315|6@0+ (2,0) [0|100] "%"  MPC
 SG_ RSDS_R_ObjHeight_1 : 31|10@0+ (0.01,0) [0|6] "m"  MPC
 SG_ RSDS_R_ObjHeight_2 : 379|10@0+ (0.01,0) [0|6] "m"  MPC

BO_ 1425 RSDS_R_SGU2: 64 CR_RR
 SG_ RSDS_R_ObjID_3 : 71|8@0+ (1,0) [0|255] ""  MPC
 SG_ RSDS_R_ObjExistProb_3 : 124|5@0+ (0.03326,0) [0|1] ""  MPC
 SG_ RSDS_R_ObjObstacleProb_3 : 135|5@0+ (0.03326,0) [0|1] ""  MPC
 SG_ RSDS_R_ObjDistX_3 : 187|12@0+ (0.0625,-128) [-128|127.9375] "m"  MPC
 SG_ RSDS_R_ObjDistY_3 : 33|11@0+ (0.125,-128) [-128|127.875] "m"  MPC
 SG_ RSDS_R_ObjDistXStd_3 : 54|6@0+ (0.1,0) [0|6] "m"  MPC
 SG_ RSDS_R_ObjType_3 : 63|4@0+ (1,0) [0|15] ""  MPC
 SG_ RSDS_R_ObjRelVelX_3 : 79|13@0+ (0.0312,-128) [-128|126.9976] "mps"  MPC
 SG_ RSDS_R_ObjRelVelY_3 : 82|13@0+ (0.0312,-128) [-128|126.9976] "mps"  MPC
 SG_ RSDS_R_ObjRelAccelX_3 : 101|10@0+ (0.03125,-16) [-16|15.96875] "mps2"  MPC
 SG_ RSDS_R_ObjRelAccelY_3 : 107|10@0+ (0.03125,-16) [-16|15.96875] "mps2"  MPC
 SG_ RSDS_R_ObjMotionType_3 : 127|3@0+ (1,0) [0|7] ""  MPC
 SG_ RSDS_R_ObjMeasured_3 : 113|2@0+ (1,0) [0|3] ""  MPC
 SG_ RSDS_R_ObjDistYStd_3 : 143|6@0+ (0.1,0) [0|6] "m"  MPC
 SG_ RSDS_R_ObjRelVelXStd_3 : 137|6@0+ (0.0625,0) [0|3.9375] "mps"  MPC
 SG_ RSDS_R_ObjRelVelYStd_3 : 147|6@0+ (0.0625,0) [0|3.9375] "mps"  MPC
 SG_ RSDS_R_ObjRAccelXStd_3 : 157|6@0+ (0.0625,0) [0|3.9375] "mps2"  MPC
 SG_ RSDS_R_ObjRAccelYStd_3 : 167|6@0+ (0.0625,0) [0|3.9375] "mps2"  MPC
 SG_ RSDS_R_ObjWidth_3 : 161|10@0+ (0.01,0) [0|5] "m"  MPC
 SG_ RSDS_R_ObjMotionDirection_3 : 191|3@0+ (1,0) [0|7] ""  MPC
 SG_ RSDS_R_ObjAge_3 : 183|8@0+ (1,0) [0|255] ""  MPC
 SG_ RSDS_R_ObjLength_3 : 207|10@0+ (0.05,0) [0|20] "m"  MPC
 SG_ RSDS_R_ObjHeading_3 : 213|12@0+ (0.002,-3.14) [-3.14|3.14] "rad"  MPC
 SG_ RSDS_R_ObjYawrate_3 : 217|12@0+ (0.002,-3.14) [-3.14|3.14] "rad/s"  MPC
 SG_ RSDS_R_ObjRCS_3 : 237|10@0+ (0.125,-50) [-50|70] "dBm2"  MPC
 SG_ RSDS_R_ObjRefPoint_3 : 243|3@0+ (1,0) [0|8] ""  MPC
 SG_ RSDS_R_HWATargetValidity_3 : 240|1@0+ (1,0) [0|1] ""  MPC
 SG_ RSDS_R_ObjID_4 : 271|8@0+ (1,0) [0|255] ""  MPC
 SG_ RSDS_R_ObjExistProb_4 : 279|5@0+ (0.03326,0) [0|1] ""  MPC
 SG_ RSDS_R_ObjObstacleProb_4 : 274|5@0+ (0.03326,0) [0|1] ""  MPC
 SG_ RSDS_R_ObjDistX_4 : 285|12@0+ (0.0625,-128) [-128|127.9375] "m"  MPC
 SG_ RSDS_R_ObjDistY_4 : 289|11@0+ (0.125,-128) [-128|127.875] "m"  MPC
 SG_ RSDS_R_ObjDistXStd_4 : 310|6@0+ (0.1,0) [0|6] "m"  MPC
 SG_ RSDS_R_ObjType_4 : 319|4@0+ (1,0) [0|15] ""  MPC
 SG_ RSDS_R_ObjRelVelX_4 : 335|13@0+ (0.0312,-128) [-128|126.9976] "mps"  MPC
 SG_ RSDS_R_ObjRelVelY_4 : 338|13@0+ (0.0312,-128) [-128|126.9976] "mps"  MPC
 SG_ RSDS_R_ObjRelAccelX_4 : 357|10@0+ (0.03125,-16) [-16|15.96875] "mps2"  MPC
 SG_ RSDS_R_ObjRelAccelY_4 : 363|10@0+ (0.03125,-16) [-16|15.96875] "mps2"  MPC
 SG_ RSDS_R_ObjMotionType_4 : 383|3@0+ (1,0) [0|7] ""  MPC
 SG_ RSDS_R_ObjMeasured_4 : 369|2@0+ (1,0) [0|3] ""  MPC
 SG_ RSDS_R_ObjDistYStd_4 : 399|6@0+ (0.1,0) [0|6] "m"  MPC
 SG_ RSDS_R_ObjRelVelXStd_4 : 393|6@0+ (0.0625,0) [0|3.9375] "mps"  MPC
 SG_ RSDS_R_ObjRelVelYStd_4 : 403|6@0+ (0.0625,0) [0|3.9375] "mps"  MPC
 SG_ RSDS_R_ObjRAccelXStd_4 : 413|6@0+ (0.0625,0) [0|3.9375] "mps2"  MPC
 SG_ RSDS_R_ObjRAccelYStd_4 : 423|6@0+ (0.0625,0) [0|3.9375] "mps2"  MPC
 SG_ RSDS_R_ObjWidth_4 : 417|10@0+ (0.01,0) [0|5] "m"  MPC
 SG_ RSDS_R_ObjMotionDirection_4 : 447|3@0+ (1,0) [0|7] ""  MPC
 SG_ RSDS_R_ObjAge_4 : 439|8@0+ (1,0) [0|255] ""  MPC
 SG_ RSDS_R_ObjLength_4 : 463|10@0+ (0.05,0) [0|20] "m"  MPC
 SG_ RSDS_R_ObjHeading_4 : 469|12@0+ (0.002,-3.14) [-3.14|3.14] "rad"  MPC
 SG_ RSDS_R_ObjYawrate_4 : 473|12@0+ (0.002,-3.14) [-3.14|3.14] "rad/s"  MPC
 SG_ RSDS_R_ObjRCS_4 : 493|10@0+ (0.125,-50) [-50|70] "dBm2"  MPC
 SG_ RSDS_R_ObjRefPoint_4 : 499|3@0+ (1,0) [0|8] ""  MPC
 SG_ RSDS_R_HWATargetValidity_4 : 496|1@0+ (1,0) [0|1] ""  MPC
 SG_ RSDS_R_SGU2_BlockCounter : 511|4@0+ (1,0) [0|15] ""  MPC
 SG_ RSDS_R_ObjValid_3 : 252|1@0+ (1,0) [0|1] ""  MPC
 SG_ RSDS_R_ObjValid_4 : 253|1@0+ (1,0) [0|1] ""  MPC
 SG_ Checksum591 : 7|16@0+ (1,0) [0|65535] ""  MPC
 SG_ RollingCounter591 : 23|8@0+ (1,0) [0|255] ""  MPC
 SG_ RSDS_R_ObjHYAS_Reserved_3 : 261|6@0+ (0.017,0) [0|1.071] ""  MPC
 SG_ RSDS_R_ObjHYAS_Reserved_4 : 251|6@0+ (0.017,0) [0|1.071] ""  MPC
 SG_ RSDS_R_ObjTypeProb_3 : 325|6@0+ (2,0) [0|100] "%"  MPC
 SG_ RSDS_R_ObjTypeProb_4 : 315|6@0+ (2,0) [0|100] "%"  MPC
 SG_ RSDS_R_ObjHeight_3 : 31|10@0+ (0.01,0) [0|6] "m"  MPC
 SG_ RSDS_R_ObjHeight_4 : 379|10@0+ (0.01,0) [0|6] "m"  MPC

BO_ 1426 RSDS_R_SGU3: 64 CR_RR
 SG_ RSDS_R_ObjID_5 : 71|8@0+ (1,0) [0|255] ""  MPC
 SG_ RSDS_R_ObjExistProb_5 : 124|5@0+ (0.03326,0) [0|1] ""  MPC
 SG_ RSDS_R_ObjObstacleProb_5 : 135|5@0+ (0.03326,0) [0|1] ""  MPC
 SG_ RSDS_R_ObjDistX_5 : 187|12@0+ (0.0625,-128) [-128|127.9375] "m"  MPC
 SG_ RSDS_R_ObjDistY_5 : 33|11@0+ (0.125,-128) [-128|127.875] "m"  MPC
 SG_ RSDS_R_ObjDistXStd_5 : 54|6@0+ (0.1,0) [0|6] "m"  MPC
 SG_ RSDS_R_ObjType_5 : 63|4@0+ (1,0) [0|15] ""  MPC
 SG_ RSDS_R_ObjRelVelX_5 : 79|13@0+ (0.0312,-128) [-128|126.9976] "mps"  MPC
 SG_ RSDS_R_ObjRelVelY_5 : 82|13@0+ (0.0312,-128) [-128|126.9976] "mps"  MPC
 SG_ RSDS_R_ObjRelAccelX_5 : 101|10@0+ (0.03125,-16) [-16|15.96875] "mps2"  MPC
 SG_ RSDS_R_ObjRelAccelY_5 : 107|10@0+ (0.03125,-16) [-16|15.96875] "mps2"  MPC
 SG_ RSDS_R_ObjMotionType_5 : 127|3@0+ (1,0) [0|7] ""  MPC
 SG_ RSDS_R_ObjMeasured_5 : 113|2@0+ (1,0) [0|3] ""  MPC
 SG_ RSDS_R_ObjDistYStd_5 : 143|6@0+ (0.1,0) [0|6] "m"  MPC
 SG_ RSDS_R_ObjRelVelXStd_5 : 137|6@0+ (0.0625,0) [0|3.9375] "mps"  MPC
 SG_ RSDS_R_ObjRelVelYStd_5 : 147|6@0+ (0.0625,0) [0|3.9375] "mps"  MPC
 SG_ RSDS_R_ObjRAccelXStd_5 : 157|6@0+ (0.0625,0) [0|3.9375] "mps2"  MPC
 SG_ RSDS_R_ObjRAccelYStd_5 : 167|6@0+ (0.0625,0) [0|3.9375] "mps2"  MPC
 SG_ RSDS_R_ObjWidth_5 : 161|10@0+ (0.01,0) [0|5] "m"  MPC
 SG_ RSDS_R_ObjMotionDirection_5 : 191|3@0+ (1,0) [0|7] ""  MPC
 SG_ RSDS_R_ObjAge_5 : 183|8@0+ (1,0) [0|255] ""  MPC
 SG_ RSDS_R_ObjLength_5 : 207|10@0+ (0.05,0) [0|20] "m"  MPC
 SG_ RSDS_R_ObjHeading_5 : 213|12@0+ (0.002,-3.14) [-3.14|3.14] "rad"  MPC
 SG_ RSDS_R_ObjYawrate_5 : 217|12@0+ (0.002,-3.14) [-3.14|3.14] "rad/s"  MPC
 SG_ RSDS_R_ObjRCS_5 : 237|10@0+ (0.125,-50) [-50|70] "dBm2"  MPC
 SG_ RSDS_R_ObjRefPoint_5 : 243|3@0+ (1,0) [0|8] ""  MPC
 SG_ RSDS_R_HWATargetValidity_5 : 240|1@0+ (1,0) [0|1] ""  MPC
 SG_ RSDS_R_ObjID_6 : 271|8@0+ (1,0) [0|255] ""  MPC
 SG_ RSDS_R_ObjExistProb_6 : 279|5@0+ (0.03326,0) [0|1] ""  MPC
 SG_ RSDS_R_ObjObstacleProb_6 : 274|5@0+ (0.03326,0) [0|1] ""  MPC
 SG_ RSDS_R_ObjDistX_6 : 285|12@0+ (0.0625,-128) [-128|127.9375] "m"  MPC
 SG_ RSDS_R_ObjDistY_6 : 289|11@0+ (0.125,-128) [-128|127.875] "m"  MPC
 SG_ RSDS_R_ObjDistXStd_6 : 310|6@0+ (0.1,0) [0|6] "m"  MPC
 SG_ RSDS_R_ObjType_6 : 319|4@0+ (1,0) [0|15] ""  MPC
 SG_ RSDS_R_ObjRelVelX_6 : 335|13@0+ (0.0312,-128) [-128|126.9976] "mps"  MPC
 SG_ RSDS_R_ObjRelVelY_6 : 338|13@0+ (0.0312,-128) [-128|126.9976] "mps"  MPC
 SG_ RSDS_R_ObjRelAccelX_6 : 357|10@0+ (0.03125,-16) [-16|15.96875] "mps2"  MPC
 SG_ RSDS_R_ObjRelAccelY_6 : 363|10@0+ (0.03125,-16) [-16|15.96875] "mps2"  MPC
 SG_ RSDS_R_ObjMotionType_6 : 383|3@0+ (1,0) [0|7] ""  MPC
 SG_ RSDS_R_ObjMeasured_6 : 369|2@0+ (1,0) [0|3] ""  MPC
 SG_ RSDS_R_ObjDistYStd_6 : 399|6@0+ (0.1,0) [0|6] "m"  MPC
 SG_ RSDS_R_ObjRelVelXStd_6 : 393|6@0+ (0.0625,0) [0|3.9375] "mps"  MPC
 SG_ RSDS_R_ObjRelVelYStd_6 : 403|6@0+ (0.0625,0) [0|3.9375] "mps"  MPC
 SG_ RSDS_R_ObjRAccelXStd_6 : 413|6@0+ (0.0625,0) [0|3.9375] "mps2"  MPC
 SG_ RSDS_R_ObjRAccelYStd_6 : 423|6@0+ (0.0625,0) [0|3.9375] "mps2"  MPC
 SG_ RSDS_R_ObjWidth_6 : 417|10@0+ (0.01,0) [0|5] "m"  MPC
 SG_ RSDS_R_ObjMotionDirection_6 : 447|3@0+ (1,0) [0|7] ""  MPC
 SG_ RSDS_R_ObjAge_6 : 439|8@0+ (1,0) [0|255] ""  MPC
 SG_ RSDS_R_ObjLength_6 : 463|10@0+ (0.05,0) [0|20] "m"  MPC
 SG_ RSDS_R_ObjHeading_6 : 469|12@0+ (0.002,-3.14) [-3.14|3.14] "rad"  MPC
 SG_ RSDS_R_ObjYawrate_6 : 473|12@0+ (0.002,-3.14) [-3.14|3.14] "rad/s"  MPC
 SG_ RSDS_R_ObjRCS_6 : 493|10@0+ (0.125,-50) [-50|70] "dBm2"  MPC
 SG_ RSDS_R_ObjRefPoint_6 : 499|3@0+ (1,0) [0|8] ""  MPC
 SG_ RSDS_R_HWATargetValidity_6 : 496|1@0+ (1,0) [0|1] ""  MPC
 SG_ RSDS_R_SGU3_BlockCounter : 511|4@0+ (1,0) [0|15] ""  MPC
 SG_ RSDS_R_ObjValid_5 : 252|1@0+ (1,0) [0|1] ""  MPC
 SG_ RSDS_R_ObjValid_6 : 253|1@0+ (1,0) [0|1] ""  MPC
 SG_ Checksum592 : 7|16@0+ (1,0) [0|65535] ""  MPC
 SG_ RollingCounter592 : 23|8@0+ (1,0) [0|255] ""  MPC
 SG_ RSDS_R_ObjHYAS_Reserved_5 : 261|6@0+ (0.017,0) [0|1.071] ""  MPC
 SG_ RSDS_R_ObjHYAS_Reserved_6 : 251|6@0+ (0.017,0) [0|1.071] ""  MPC
 SG_ RSDS_R_ObjTypeProb_5 : 325|6@0+ (2,0) [0|100] "%"  MPC
 SG_ RSDS_R_ObjTypeProb_6 : 315|6@0+ (2,0) [0|100] "%"  MPC
 SG_ RSDS_R_ObjHeight_5 : 31|10@0+ (0.01,0) [0|6] "m"  MPC
 SG_ RSDS_R_ObjHeight_6 : 379|10@0+ (0.01,0) [0|6] "m"  MPC

BO_ 1427 RSDS_R_SGU4: 64 CR_RR
 SG_ RSDS_R_ObjID_7 : 71|8@0+ (1,0) [0|255] ""  MPC
 SG_ RSDS_R_ObjExistProb_7 : 124|5@0+ (0.03326,0) [0|1] ""  MPC
 SG_ RSDS_R_ObjObstacleProb_7 : 135|5@0+ (0.03326,0) [0|1] ""  MPC
 SG_ RSDS_R_ObjDistX_7 : 187|12@0+ (0.0625,-128) [-128|127.9375] "m"  MPC
 SG_ RSDS_R_ObjDistY_7 : 33|11@0+ (0.125,-128) [-128|127.875] "m"  MPC
 SG_ RSDS_R_ObjDistXStd_7 : 54|6@0+ (0.1,0) [0|6] "m"  MPC
 SG_ RSDS_R_ObjType_7 : 63|4@0+ (1,0) [0|15] ""  MPC
 SG_ RSDS_R_ObjRelVelX_7 : 79|13@0+ (0.0312,-128) [-128|126.9976] "mps"  MPC
 SG_ RSDS_R_ObjRelVelY_7 : 82|13@0+ (0.0312,-128) [-128|126.9976] "mps"  MPC
 SG_ RSDS_R_ObjRelAccelX_7 : 101|10@0+ (0.03125,-16) [-16|15.96875] "mps2"  MPC
 SG_ RSDS_R_ObjRelAccelY_7 : 107|10@0+ (0.03125,-16) [-16|15.96875] "mps2"  MPC
 SG_ RSDS_R_ObjMotionType_7 : 127|3@0+ (1,0) [0|7] ""  MPC
 SG_ RSDS_R_ObjMeasured_7 : 113|2@0+ (1,0) [0|3] ""  MPC
 SG_ RSDS_R_ObjDistYStd_7 : 143|6@0+ (0.1,0) [0|6] "m"  MPC
 SG_ RSDS_R_ObjRelVelXStd_7 : 137|6@0+ (0.0625,0) [0|3.9375] "mps"  MPC
 SG_ RSDS_R_ObjRelVelYStd_7 : 147|6@0+ (0.0625,0) [0|3.9375] "mps"  MPC
 SG_ RSDS_R_ObjRAccelXStd_7 : 157|6@0+ (0.0625,0) [0|3.9375] "mps2"  MPC
 SG_ RSDS_R_ObjRAccelYStd_7 : 167|6@0+ (0.0625,0) [0|3.9375] "mps2"  MPC
 SG_ RSDS_R_ObjWidth_7 : 161|10@0+ (0.01,0) [0|5] "m"  MPC
 SG_ RSDS_R_ObjMotionDirection_7 : 191|3@0+ (1,0) [0|7] ""  MPC
 SG_ RSDS_R_ObjAge_7 : 183|8@0+ (1,0) [0|255] ""  MPC
 SG_ RSDS_R_ObjLength_7 : 207|10@0+ (0.05,0) [0|20] "m"  MPC
 SG_ RSDS_R_ObjHeading_7 : 213|12@0+ (0.002,-3.14) [-3.14|3.14] "rad"  MPC
 SG_ RSDS_R_ObjYawrate_7 : 217|12@0+ (0.002,-3.14) [-3.14|3.14] "rad/s"  MPC
 SG_ RSDS_R_ObjRCS_7 : 237|10@0+ (0.125,-50) [-50|70] "dBm2"  MPC
 SG_ RSDS_R_ObjRefPoint_7 : 243|3@0+ (1,0) [0|8] ""  MPC
 SG_ RSDS_R_HWATargetValidity_7 : 240|1@0+ (1,0) [0|1] ""  MPC
 SG_ RSDS_R_ObjID_8 : 271|8@0+ (1,0) [0|255] ""  MPC
 SG_ RSDS_R_ObjExistProb_8 : 279|5@0+ (0.03326,0) [0|1] ""  MPC
 SG_ RSDS_R_ObjObstacleProb_8 : 274|5@0+ (0.03326,0) [0|1] ""  MPC
 SG_ RSDS_R_ObjDistX_8 : 285|12@0+ (0.0625,-128) [-128|127.9375] "m"  MPC
 SG_ RSDS_R_ObjDistY_8 : 289|11@0+ (0.125,-128) [-128|127.875] "m"  MPC
 SG_ RSDS_R_ObjDistXStd_8 : 310|6@0+ (0.1,0) [0|6] "m"  MPC
 SG_ RSDS_R_ObjType_8 : 319|4@0+ (1,0) [0|15] ""  MPC
 SG_ RSDS_R_ObjRelVelX_8 : 335|13@0+ (0.0312,-128) [-128|126.9976] "mps"  MPC
 SG_ RSDS_R_ObjRelVelY_8 : 338|13@0+ (0.0312,-128) [-128|126.9976] "mps"  MPC
 SG_ RSDS_R_ObjRelAccelX_8 : 357|10@0+ (0.03125,-16) [-16|15.96875] "mps2"  MPC
 SG_ RSDS_R_ObjRelAccelY_8 : 363|10@0+ (0.03125,-16) [-16|15.96875] "mps2"  MPC
 SG_ RSDS_R_ObjMotionType_8 : 383|3@0+ (1,0) [0|7] ""  MPC
 SG_ RSDS_R_ObjMeasured_8 : 369|2@0+ (1,0) [0|3] ""  MPC
 SG_ RSDS_R_ObjDistYStd_8 : 399|6@0+ (0.1,0) [0|6] "m"  MPC
 SG_ RSDS_R_ObjRelVelXStd_8 : 393|6@0+ (0.0625,0) [0|3.9375] "mps"  MPC
 SG_ RSDS_R_ObjRelVelYStd_8 : 403|6@0+ (0.0625,0) [0|3.9375] "mps"  MPC
 SG_ RSDS_R_ObjRAccelXStd_8 : 413|6@0+ (0.0625,0) [0|3.9375] "mps2"  MPC
 SG_ RSDS_R_ObjRAccelYStd_8 : 423|6@0+ (0.0625,0) [0|3.9375] "mps2"  MPC
 SG_ RSDS_R_ObjWidth_8 : 417|10@0+ (0.01,0) [0|5] "m"  MPC
 SG_ RSDS_R_ObjMotionDirection_8 : 447|3@0+ (1,0) [0|7] ""  MPC
 SG_ RSDS_R_ObjAge_8 : 439|8@0+ (1,0) [0|255] ""  MPC
 SG_ RSDS_R_ObjLength_8 : 463|10@0+ (0.05,0) [0|20] "m"  MPC
 SG_ RSDS_R_ObjHeading_8 : 469|12@0+ (0.002,-3.14) [-3.14|3.14] "rad"  MPC
 SG_ RSDS_R_ObjYawrate_8 : 473|12@0+ (0.002,-3.14) [-3.14|3.14] "rad/s"  MPC
 SG_ RSDS_R_ObjRCS_8 : 493|10@0+ (0.125,-50) [-50|70] "dBm2"  MPC
 SG_ RSDS_R_ObjRefPoint_8 : 499|3@0+ (1,0) [0|8] ""  MPC
 SG_ RSDS_R_HWATargetValidity_8 : 496|1@0+ (1,0) [0|1] ""  MPC
 SG_ RSDS_R_SGU4_BlockCounter : 511|4@0+ (1,0) [0|15] ""  MPC
 SG_ RSDS_R_ObjValid_7 : 252|1@0+ (1,0) [0|1] ""  MPC
 SG_ RSDS_R_ObjValid_8 : 253|1@0+ (1,0) [0|1] ""  MPC
 SG_ Checksum593 : 7|16@0+ (1,0) [0|65535] ""  MPC
 SG_ RollingCounter593 : 23|8@0+ (1,0) [0|255] ""  MPC
 SG_ RSDS_R_ObjHYAS_Reserved_7 : 261|6@0+ (0.017,0) [0|1.071] ""  MPC
 SG_ RSDS_R_ObjHYAS_Reserved_8 : 251|6@0+ (0.017,0) [0|1.071] ""  MPC
 SG_ RSDS_R_ObjTypeProb_7 : 325|6@0+ (2,0) [0|100] "%"  MPC
 SG_ RSDS_R_ObjTypeProb_8 : 315|6@0+ (2,0) [0|100] "%"  MPC
 SG_ RSDS_R_ObjHeight_7 : 31|10@0+ (0.01,0) [0|6] "m"  MPC
 SG_ RSDS_R_ObjHeight_8 : 379|10@0+ (0.01,0) [0|6] "m"  MPC

BO_ 1428 RSDS_R_SGU5: 64 CR_RR
 SG_ RSDS_R_ObjID_9 : 71|8@0+ (1,0) [0|255] ""  MPC
 SG_ RSDS_R_ObjExistProb_9 : 124|5@0+ (0.03326,0) [0|1] ""  MPC
 SG_ RSDS_R_ObjObstacleProb_9 : 135|5@0+ (0.03326,0) [0|1] ""  MPC
 SG_ RSDS_R_ObjDistX_9 : 187|12@0+ (0.0625,-128) [-128|127.9375] "m"  MPC
 SG_ RSDS_R_ObjDistY_9 : 33|11@0+ (0.125,-128) [-128|127.875] "m"  MPC
 SG_ RSDS_R_ObjDistXStd_9 : 54|6@0+ (0.1,0) [0|6] "m"  MPC
 SG_ RSDS_R_ObjType_9 : 63|4@0+ (1,0) [0|15] ""  MPC
 SG_ RSDS_R_ObjRelVelX_9 : 79|13@0+ (0.0312,-128) [-128|126.9976] "mps"  MPC
 SG_ RSDS_R_ObjRelVelY_9 : 82|13@0+ (0.0312,-128) [-128|126.9976] "mps"  MPC
 SG_ RSDS_R_ObjRelAccelX_9 : 101|10@0+ (0.03125,-16) [-16|15.96875] "mps2"  MPC
 SG_ RSDS_R_ObjRelAccelY_9 : 107|10@0+ (0.03125,-16) [-16|15.96875] "mps2"  MPC
 SG_ RSDS_R_ObjMotionType_9 : 127|3@0+ (1,0) [0|7] ""  MPC
 SG_ RSDS_R_ObjMeasured_9 : 113|2@0+ (1,0) [0|3] ""  MPC
 SG_ RSDS_R_ObjDistYStd_9 : 143|6@0+ (0.1,0) [0|6] "m"  MPC
 SG_ RSDS_R_ObjRelVelXStd_9 : 137|6@0+ (0.0625,0) [0|3.9375] "mps"  MPC
 SG_ RSDS_R_ObjRelVelYStd_9 : 147|6@0+ (0.0625,0) [0|3.9375] "mps"  MPC
 SG_ RSDS_R_ObjRAccelXStd_9 : 157|6@0+ (0.0625,0) [0|3.9375] "mps2"  MPC
 SG_ RSDS_R_ObjRAccelYStd_9 : 167|6@0+ (0.0625,0) [0|3.9375] "mps2"  MPC
 SG_ RSDS_R_ObjWidth_9 : 161|10@0+ (0.01,0) [0|5] "m"  MPC
 SG_ RSDS_R_ObjMotionDirection_9 : 191|3@0+ (1,0) [0|7] ""  MPC
 SG_ RSDS_R_ObjAge_9 : 183|8@0+ (1,0) [0|255] ""  MPC
 SG_ RSDS_R_ObjLength_9 : 207|10@0+ (0.05,0) [0|20] "m"  MPC
 SG_ RSDS_R_ObjHeading_9 : 213|12@0+ (0.002,-3.14) [-3.14|3.14] "rad"  MPC
 SG_ RSDS_R_ObjYawrate_9 : 217|12@0+ (0.002,-3.14) [-3.14|3.14] "rad/s"  MPC
 SG_ RSDS_R_ObjRCS_9 : 237|10@0+ (0.125,-50) [-50|70] "dBm2"  MPC
 SG_ RSDS_R_ObjRefPoint_9 : 243|3@0+ (1,0) [0|8] ""  MPC
 SG_ RSDS_R_HWATargetValidity_9 : 240|1@0+ (1,0) [0|1] ""  MPC
 SG_ RSDS_R_ObjID_10 : 271|8@0+ (1,0) [0|255] ""  MPC
 SG_ RSDS_R_ObjExistProb_10 : 279|5@0+ (0.03326,0) [0|1] ""  MPC
 SG_ RSDS_R_ObjObstacleProb_10 : 274|5@0+ (0.03326,0) [0|1] ""  MPC
 SG_ RSDS_R_ObjDistX_10 : 285|12@0+ (0.0625,-128) [-128|127.9375] "m"  MPC
 SG_ RSDS_R_ObjDistY_10 : 289|11@0+ (0.125,-128) [-128|127.875] "m"  MPC
 SG_ RSDS_R_ObjDistXStd_10 : 310|6@0+ (0.1,0) [0|6] "m"  MPC
 SG_ RSDS_R_ObjType_10 : 319|4@0+ (1,0) [0|15] ""  MPC
 SG_ RSDS_R_ObjRelVelX_10 : 335|13@0+ (0.0312,-128) [-128|126.9976] "mps"  MPC
 SG_ RSDS_R_ObjRelVelY_10 : 338|13@0+ (0.0312,-128) [-128|126.9976] "mps"  MPC
 SG_ RSDS_R_ObjRelAccelX_10 : 357|10@0+ (0.03125,-16) [-16|15.96875] "mps2"  MPC
 SG_ RSDS_R_ObjRelAccelY_10 : 363|10@0+ (0.03125,-16) [-16|15.96875] "mps2"  MPC
 SG_ RSDS_R_ObjMotionType_10 : 383|3@0+ (1,0) [0|7] ""  MPC
 SG_ RSDS_R_ObjMeasured_10 : 369|2@0+ (1,0) [0|3] ""  MPC
 SG_ RSDS_R_ObjDistYStd_10 : 399|6@0+ (0.1,0) [0|6] "m"  MPC
 SG_ RSDS_R_ObjRelVelXStd_10 : 393|6@0+ (0.0625,0) [0|3.9375] "mps"  MPC
 SG_ RSDS_R_ObjRelVelYStd_10 : 403|6@0+ (0.0625,0) [0|3.9375] "mps"  MPC
 SG_ RSDS_R_ObjRAccelXStd_10 : 413|6@0+ (0.0625,0) [0|3.9375] "mps2"  MPC
 SG_ RSDS_R_ObjRAccelYStd_10 : 423|6@0+ (0.0625,0) [0|3.9375] "mps2"  MPC
 SG_ RSDS_R_ObjWidth_10 : 417|10@0+ (0.01,0) [0|5] "m"  MPC
 SG_ RSDS_R_ObjMotionDirection_10 : 447|3@0+ (1,0) [0|7] ""  MPC
 SG_ RSDS_R_ObjAge_10 : 439|8@0+ (1,0) [0|255] ""  MPC
 SG_ RSDS_R_ObjLength_10 : 463|10@0+ (0.05,0) [0|20] "m"  MPC
 SG_ RSDS_R_ObjHeading_10 : 469|12@0+ (0.002,-3.14) [-3.14|3.14] "rad"  MPC
 SG_ RSDS_R_ObjYawrate_10 : 473|12@0+ (0.002,-3.14) [-3.14|3.14] "rad/s"  MPC
 SG_ RSDS_R_ObjRCS_10 : 493|10@0+ (0.125,-50) [-50|70] "dBm2"  MPC
 SG_ RSDS_R_ObjRefPoint_10 : 499|3@0+ (1,0) [0|8] ""  MPC
 SG_ RSDS_R_HWATargetValidity_10 : 496|1@0+ (1,0) [0|1] ""  MPC
 SG_ RSDS_R_SGU5_BlockCounter : 511|4@0+ (1,0) [0|15] ""  MPC
 SG_ RSDS_R_ObjValid_9 : 252|1@0+ (1,0) [0|1] ""  MPC
 SG_ RSDS_R_ObjValid_10 : 253|1@0+ (1,0) [0|1] ""  MPC
 SG_ Checksum594 : 7|16@0+ (1,0) [0|65535] ""  MPC
 SG_ RollingCounter594 : 23|8@0+ (1,0) [0|255] ""  MPC
 SG_ RSDS_R_ObjHYAS_Reserved_9 : 261|6@0+ (0.017,0) [0|1.071] ""  MPC
 SG_ RSDS_R_ObjHYAS_Reserved_10 : 251|6@0+ (0.017,0) [0|1.071] ""  MPC
 SG_ RSDS_R_ObjTypeProb_9 : 325|6@0+ (2,0) [0|100] "%"  MPC
 SG_ RSDS_R_ObjTypeProb_10 : 315|6@0+ (2,0) [0|100] "%"  MPC
 SG_ RSDS_R_ObjHeight_9 : 31|10@0+ (0.01,0) [0|6] "m"  MPC
 SG_ RSDS_R_ObjHeight_10 : 379|10@0+ (0.01,0) [0|6] "m"  MPC

BO_ 1429 RSDS_R_SGU6: 64 CR_RR
 SG_ RSDS_R_ObjID_11 : 71|8@0+ (1,0) [0|255] ""  MPC
 SG_ RSDS_R_ObjExistProb_11 : 124|5@0+ (0.03326,0) [0|1] ""  MPC
 SG_ RSDS_R_ObjObstacleProb_11 : 135|5@0+ (0.03326,0) [0|1] ""  MPC
 SG_ RSDS_R_ObjDistX_11 : 187|12@0+ (0.0625,-128) [-128|127.9375] "m"  MPC
 SG_ RSDS_R_ObjDistY_11 : 33|11@0+ (0.125,-128) [-128|127.875] "m"  MPC
 SG_ RSDS_R_ObjDistXStd_11 : 54|6@0+ (0.1,0) [0|6] "m"  MPC
 SG_ RSDS_R_ObjType_11 : 63|4@0+ (1,0) [0|15] ""  MPC
 SG_ RSDS_R_ObjRelVelX_11 : 79|13@0+ (0.0312,-128) [-128|126.9976] "mps"  MPC
 SG_ RSDS_R_ObjRelVelY_11 : 82|13@0+ (0.0312,-128) [-128|126.9976] "mps"  MPC
 SG_ RSDS_R_ObjRelAccelX_11 : 101|10@0+ (0.03125,-16) [-16|15.96875] "mps2"  MPC
 SG_ RSDS_R_ObjRelAccelY_11 : 107|10@0+ (0.03125,-16) [-16|15.96875] "mps2"  MPC
 SG_ RSDS_R_ObjMotionType_11 : 127|3@0+ (1,0) [0|7] ""  MPC
 SG_ RSDS_R_ObjMeasured_11 : 113|2@0+ (1,0) [0|3] ""  MPC
 SG_ RSDS_R_ObjDistYStd_11 : 143|6@0+ (0.1,0) [0|6] "m"  MPC
 SG_ RSDS_R_ObjRelVelXStd_11 : 137|6@0+ (0.0625,0) [0|3.9375] "mps"  MPC
 SG_ RSDS_R_ObjRelVelYStd_11 : 147|6@0+ (0.0625,0) [0|3.9375] "mps"  MPC
 SG_ RSDS_R_ObjRAccelXStd_11 : 157|6@0+ (0.0625,0) [0|3.9375] "mps2"  MPC
 SG_ RSDS_R_ObjRAccelYStd_11 : 167|6@0+ (0.0625,0) [0|3.9375] "mps2"  MPC
 SG_ RSDS_R_ObjWidth_11 : 161|10@0+ (0.01,0) [0|5] "m"  MPC
 SG_ RSDS_R_ObjMotionDirection_11 : 191|3@0+ (1,0) [0|7] ""  MPC
 SG_ RSDS_R_ObjAge_11 : 183|8@0+ (1,0) [0|255] ""  MPC
 SG_ RSDS_R_ObjLength_11 : 207|10@0+ (0.05,0) [0|20] "m"  MPC
 SG_ RSDS_R_ObjHeading_11 : 213|12@0+ (0.002,-3.14) [-3.14|3.14] "rad"  MPC
 SG_ RSDS_R_ObjYawrate_11 : 217|12@0+ (0.002,-3.14) [-3.14|3.14] "rad/s"  MPC
 SG_ RSDS_R_ObjRCS_11 : 237|10@0+ (0.125,-50) [-50|70] "dBm2"  MPC
 SG_ RSDS_R_ObjRefPoint_11 : 243|3@0+ (1,0) [0|8] ""  MPC
 SG_ RSDS_R_HWATargetValidity_11 : 240|1@0+ (1,0) [0|1] ""  MPC
 SG_ RSDS_R_ObjID_12 : 271|8@0+ (1,0) [0|255] ""  MPC
 SG_ RSDS_R_ObjExistProb_12 : 279|5@0+ (0.03326,0) [0|1] ""  MPC
 SG_ RSDS_R_ObjObstacleProb_12 : 274|5@0+ (0.03326,0) [0|1] ""  MPC
 SG_ RSDS_R_ObjDistX_12 : 285|12@0+ (0.0625,-128) [-128|127.9375] "m"  MPC
 SG_ RSDS_R_ObjDistY_12 : 289|11@0+ (0.125,-128) [-128|127.875] "m"  MPC
 SG_ RSDS_R_ObjDistXStd_12 : 310|6@0+ (0.1,0) [0|6] "m"  MPC
 SG_ RSDS_R_ObjType_12 : 319|4@0+ (1,0) [0|15] ""  MPC
 SG_ RSDS_R_ObjRelVelX_12 : 335|13@0+ (0.0312,-128) [-128|126.9976] "mps"  MPC
 SG_ RSDS_R_ObjRelVelY_12 : 338|13@0+ (0.0312,-128) [-128|126.9976] "mps"  MPC
 SG_ RSDS_R_ObjRelAccelX_12 : 357|10@0+ (0.03125,-16) [-16|15.96875] "mps2"  MPC
 SG_ RSDS_R_ObjRelAccelY_12 : 363|10@0+ (0.03125,-16) [-16|15.96875] "mps2"  MPC
 SG_ RSDS_R_ObjMotionType_12 : 383|3@0+ (1,0) [0|7] ""  MPC
 SG_ RSDS_R_ObjMeasured_12 : 369|2@0+ (1,0) [0|3] ""  MPC
 SG_ RSDS_R_ObjDistYStd_12 : 399|6@0+ (0.1,0) [0|6] "m"  MPC
 SG_ RSDS_R_ObjRelVelXStd_12 : 393|6@0+ (0.0625,0) [0|3.9375] "mps"  MPC
 SG_ RSDS_R_ObjRelVelYStd_12 : 403|6@0+ (0.0625,0) [0|3.9375] "mps"  MPC
 SG_ RSDS_R_ObjRAccelXStd_12 : 413|6@0+ (0.0625,0) [0|3.9375] "mps2"  MPC
 SG_ RSDS_R_ObjRAccelYStd_12 : 423|6@0+ (0.0625,0) [0|3.9375] "mps2"  MPC
 SG_ RSDS_R_ObjWidth_12 : 417|10@0+ (0.01,0) [0|5] "m"  MPC
 SG_ RSDS_R_ObjMotionDirection_12 : 447|3@0+ (1,0) [0|7] ""  MPC
 SG_ RSDS_R_ObjAge_12 : 439|8@0+ (1,0) [0|255] ""  MPC
 SG_ RSDS_R_ObjLength_12 : 463|10@0+ (0.05,0) [0|20] "m"  MPC
 SG_ RSDS_R_ObjHeading_12 : 469|12@0+ (0.002,-3.14) [-3.14|3.14] "rad"  MPC
 SG_ RSDS_R_ObjYawrate_12 : 473|12@0+ (0.002,-3.14) [-3.14|3.14] "rad/s"  MPC
 SG_ RSDS_R_ObjRCS_12 : 493|10@0+ (0.125,-50) [-50|70] "dBm2"  MPC
 SG_ RSDS_R_ObjRefPoint_12 : 499|3@0+ (1,0) [0|8] ""  MPC
 SG_ RSDS_R_HWATargetValidity_12 : 496|1@0+ (1,0) [0|1] ""  MPC
 SG_ RSDS_R_SGU6_BlockCounter : 511|4@0+ (1,0) [0|15] ""  MPC
 SG_ RSDS_R_ObjValid_11 : 252|1@0+ (1,0) [0|1] ""  MPC
 SG_ RSDS_R_ObjValid_12 : 253|1@0+ (1,0) [0|1] ""  MPC
 SG_ Checksum595 : 7|16@0+ (1,0) [0|65535] ""  MPC
 SG_ RollingCounter595 : 23|8@0+ (1,0) [0|255] ""  MPC
 SG_ RSDS_R_ObjHYAS_Reserved_11 : 261|6@0+ (0.017,0) [0|1.071] ""  MPC
 SG_ RSDS_R_ObjHYAS_Reserved_12 : 251|6@0+ (0.017,0) [0|1.071] ""  MPC
 SG_ RSDS_R_ObjTypeProb_11 : 325|6@0+ (2,0) [0|100] "%"  MPC
 SG_ RSDS_R_ObjTypeProb_12 : 315|6@0+ (2,0) [0|100] "%"  MPC
 SG_ RSDS_R_ObjHeight_11 : 31|10@0+ (0.01,0) [0|6] "m"  MPC
 SG_ RSDS_R_ObjHeight_12 : 379|10@0+ (0.01,0) [0|6] "m"  MPC

BO_ 1430 RSDS_R_SGU7: 64 CR_RR
 SG_ RollingCounter596 : 23|8@0+ (1,0) [0|255] "" Vector__XXX
 SG_ Checksum596 : 7|16@0+ (1,0) [0|65535] "" Vector__XXX
 SG_ RSDS_R_ObjID_13 : 71|8@0+ (1,0) [0|255] ""  MPC
 SG_ RSDS_R_ObjExistProb_13 : 124|5@0+ (0.03326,0) [0|1] ""  MPC
 SG_ RSDS_R_ObjObstacleProb_13 : 135|5@0+ (0.03326,0) [0|1] ""  MPC
 SG_ RSDS_R_ObjDistX_13 : 187|12@0+ (0.0625,-128) [-128|127.9375] "m"  MPC
 SG_ RSDS_R_ObjDistY_13 : 33|11@0+ (0.125,-128) [-128|127.875] "m"  MPC
 SG_ RSDS_R_ObjDistXStd_13 : 54|6@0+ (0.1,0) [0|6] "m"  MPC
 SG_ RSDS_R_ObjType_13 : 63|4@0+ (1,0) [0|15] ""  MPC
 SG_ RSDS_R_ObjRelVelX_13 : 79|13@0+ (0.0312,-128) [-128|126.9976] "mps"  MPC
 SG_ RSDS_R_ObjRelVelY_13 : 82|13@0+ (0.0312,-128) [-128|126.9976] "mps"  MPC
 SG_ RSDS_R_ObjRelAccelX_13 : 101|10@0+ (0.03125,-16) [-16|15.96875] "mps2"  MPC
 SG_ RSDS_R_ObjRelAccelY_13 : 107|10@0+ (0.03125,-16) [-16|15.96875] "mps2"  MPC
 SG_ RSDS_R_ObjMotionType_13 : 127|3@0+ (1,0) [0|7] ""  MPC
 SG_ RSDS_R_ObjMeasured_13 : 113|2@0+ (1,0) [0|3] ""  MPC
 SG_ RSDS_R_ObjDistYStd_13 : 143|6@0+ (0.1,0) [0|6] "m"  MPC
 SG_ RSDS_R_ObjRelVelXStd_13 : 137|6@0+ (0.0625,0) [0|3.9375] "mps"  MPC
 SG_ RSDS_R_ObjRelVelYStd_13 : 147|6@0+ (0.0625,0) [0|3.9375] "mps"  MPC
 SG_ RSDS_R_ObjRAccelXStd_13 : 157|6@0+ (0.0625,0) [0|3.9375] "mps2"  MPC
 SG_ RSDS_R_ObjRAccelYStd_13 : 167|6@0+ (0.0625,0) [0|3.9375] "mps2"  MPC
 SG_ RSDS_R_ObjWidth_13 : 161|10@0+ (0.01,0) [0|5] "m"  MPC
 SG_ RSDS_R_ObjMotionDirection_13 : 191|3@0+ (1,0) [0|7] ""  MPC
 SG_ RSDS_R_ObjAge_13 : 183|8@0+ (1,0) [0|255] ""  MPC
 SG_ RSDS_R_ObjLength_13 : 207|10@0+ (0.05,0) [0|20] "m"  MPC
 SG_ RSDS_R_ObjHeading_13 : 213|12@0+ (0.002,-3.14) [-3.14|3.14] "rad"  MPC
 SG_ RSDS_R_ObjYawrate_13 : 217|12@0+ (0.002,-3.14) [-3.14|3.14] "rad/s"  MPC
 SG_ RSDS_R_ObjRCS_13 : 237|10@0+ (0.125,-50) [-50|70] "dBm2"  MPC
 SG_ RSDS_R_ObjRefPoint_13 : 243|3@0+ (1,0) [0|8] ""  MPC
 SG_ RSDS_R_HWATargetValidity_13 : 240|1@0+ (1,0) [0|1] ""  MPC
 SG_ RSDS_R_ObjID_14 : 271|8@0+ (1,0) [0|255] ""  MPC
 SG_ RSDS_R_ObjExistProb_14 : 279|5@0+ (0.03326,0) [0|1] ""  MPC
 SG_ RSDS_R_ObjObstacleProb_14 : 274|5@0+ (0.03326,0) [0|1] ""  MPC
 SG_ RSDS_R_ObjDistX_14 : 285|12@0+ (0.0625,-128) [-128|127.9375] "m"  MPC
 SG_ RSDS_R_ObjDistY_14 : 289|11@0+ (0.125,-128) [-128|127.875] "m"  MPC
 SG_ RSDS_R_ObjDistXStd_14 : 310|6@0+ (0.1,0) [0|6] "m"  MPC
 SG_ RSDS_R_ObjType_14 : 319|4@0+ (1,0) [0|15] ""  MPC
 SG_ RSDS_R_ObjRelVelX_14 : 335|13@0+ (0.0312,-128) [-128|126.9976] "mps"  MPC
 SG_ RSDS_R_ObjRelVelY_14 : 338|13@0+ (0.0312,-128) [-128|126.9976] "mps"  MPC
 SG_ RSDS_R_ObjRelAccelX_14 : 357|10@0+ (0.03125,-16) [-16|15.96875] "mps2"  MPC
 SG_ RSDS_R_ObjRelAccelY_14 : 363|10@0+ (0.03125,-16) [-16|15.96875] "mps2"  MPC
 SG_ RSDS_R_ObjMotionType_14 : 383|3@0+ (1,0) [0|7] ""  MPC
 SG_ RSDS_R_ObjMeasured_14 : 369|2@0+ (1,0) [0|3] ""  MPC
 SG_ RSDS_R_ObjDistYStd_14 : 399|6@0+ (0.1,0) [0|6] "m"  MPC
 SG_ RSDS_R_ObjRelVelXStd_14 : 393|6@0+ (0.0625,0) [0|3.9375] "mps"  MPC
 SG_ RSDS_R_ObjRelVelYStd_14 : 403|6@0+ (0.0625,0) [0|3.9375] "mps"  MPC
 SG_ RSDS_R_ObjRAccelXStd_14 : 413|6@0+ (0.0625,0) [0|3.9375] "mps2"  MPC
 SG_ RSDS_R_ObjRAccelYStd_14 : 423|6@0+ (0.0625,0) [0|3.9375] "mps2"  MPC
 SG_ RSDS_R_ObjWidth_14 : 417|10@0+ (0.01,0) [0|5] "m"  MPC
 SG_ RSDS_R_ObjMotionDirection_14 : 447|3@0+ (1,0) [0|7] ""  MPC
 SG_ RSDS_R_ObjAge_14 : 439|8@0+ (1,0) [0|255] ""  MPC
 SG_ RSDS_R_ObjLength_14 : 463|10@0+ (0.05,0) [0|20] "m"  MPC
 SG_ RSDS_R_ObjHeading_14 : 469|12@0+ (0.002,-3.14) [-3.14|3.14] "rad"  MPC
 SG_ RSDS_R_ObjYawrate_14 : 473|12@0+ (0.002,-3.14) [-3.14|3.14] "rad/s"  MPC
 SG_ RSDS_R_ObjRCS_14 : 493|10@0+ (0.125,-50) [-50|70] "dBm2"  MPC
 SG_ RSDS_R_ObjRefPoint_14 : 499|3@0+ (1,0) [0|8] ""  MPC
 SG_ RSDS_R_HWATargetValidity_14 : 496|1@0+ (1,0) [0|1] ""  MPC
 SG_ RSDS_R_SGU7_BlockCounter : 511|4@0+ (1,0) [0|15] ""  MPC
 SG_ RSDS_R_ObjValid_13 : 252|1@0+ (1,0) [0|1] ""  MPC
 SG_ RSDS_R_ObjValid_14 : 253|1@0+ (1,0) [0|1] ""  MPC
 SG_ RSDS_R_ObjHYAS_Reserved_13 : 261|6@0+ (0.017,0) [0|1.071] ""  MPC
 SG_ RSDS_R_ObjHYAS_Reserved_14 : 251|6@0+ (0.017,0) [0|1.071] ""  MPC
 SG_ RSDS_R_ObjTypeProb_13 : 325|6@0+ (2,0) [0|100] "%"  MPC
 SG_ RSDS_R_ObjTypeProb_14 : 315|6@0+ (2,0) [0|100] "%"  MPC
 SG_ RSDS_R_ObjHeight_13 : 31|10@0+ (0.01,0) [0|6] "m"  MPC
 SG_ RSDS_R_ObjHeight_14 : 379|10@0+ (0.01,0) [0|6] "m"  MPC

BO_ 1431 RSDS_R_SGU8: 64 CR_RR
 SG_ RollingCounter597 : 23|8@0+ (1,0) [0|255] "" Vector__XXX
 SG_ Checksum597 : 7|16@0+ (1,0) [0|65535] "" Vector__XXX
 SG_ RSDS_R_ObjID_15 : 71|8@0+ (1,0) [0|255] ""  MPC
 SG_ RSDS_R_ObjExistProb_15 : 124|5@0+ (0.03326,0) [0|1] ""  MPC
 SG_ RSDS_R_ObjObstacleProb_15 : 135|5@0+ (0.03326,0) [0|1] ""  MPC
 SG_ RSDS_R_ObjDistX_15 : 187|12@0+ (0.0625,-128) [-128|127.9375] "m"  MPC
 SG_ RSDS_R_ObjDistY_15 : 33|11@0+ (0.125,-128) [-128|127.875] "m"  MPC
 SG_ RSDS_R_ObjDistXStd_15 : 54|6@0+ (0.1,0) [0|6] "m"  MPC
 SG_ RSDS_R_ObjType_15 : 63|4@0+ (1,0) [0|15] ""  MPC
 SG_ RSDS_R_ObjRelVelX_15 : 79|13@0+ (0.0312,-128) [-128|126.9976] "mps"  MPC
 SG_ RSDS_R_ObjRelVelY_15 : 82|13@0+ (0.0312,-128) [-128|126.9976] "mps"  MPC
 SG_ RSDS_R_ObjRelAccelX_15 : 101|10@0+ (0.03125,-16) [-16|15.96875] "mps2"  MPC
 SG_ RSDS_R_ObjRelAccelY_15 : 107|10@0+ (0.03125,-16) [-16|15.96875] "mps2"  MPC
 SG_ RSDS_R_ObjMotionType_15 : 127|3@0+ (1,0) [0|7] ""  MPC
 SG_ RSDS_R_ObjMeasured_15 : 113|2@0+ (1,0) [0|3] ""  MPC
 SG_ RSDS_R_ObjDistYStd_15 : 143|6@0+ (0.1,0) [0|6] "m"  MPC
 SG_ RSDS_R_ObjRelVelXStd_15 : 137|6@0+ (0.0625,0) [0|3.9375] "mps"  MPC
 SG_ RSDS_R_ObjRelVelYStd_15 : 147|6@0+ (0.0625,0) [0|3.9375] "mps"  MPC
 SG_ RSDS_R_ObjRAccelXStd_15 : 157|6@0+ (0.0625,0) [0|3.9375] "mps2"  MPC
 SG_ RSDS_R_ObjRAccelYStd_15 : 167|6@0+ (0.0625,0) [0|3.9375] "mps2"  MPC
 SG_ RSDS_R_ObjWidth_15 : 161|10@0+ (0.01,0) [0|5] "m"  MPC
 SG_ RSDS_R_ObjMotionDirection_15 : 191|3@0+ (1,0) [0|7] ""  MPC
 SG_ RSDS_R_ObjAge_15 : 183|8@0+ (1,0) [0|255] ""  MPC
 SG_ RSDS_R_ObjLength_15 : 207|10@0+ (0.05,0) [0|20] "m"  MPC
 SG_ RSDS_R_ObjHeading_15 : 213|12@0+ (0.002,-3.14) [-3.14|3.14] "rad"  MPC
 SG_ RSDS_R_ObjYawrate_15 : 217|12@0+ (0.002,-3.14) [-3.14|3.14] "rad/s"  MPC
 SG_ RSDS_R_ObjRCS_15 : 237|10@0+ (0.125,-50) [-50|70] "dBm2"  MPC
 SG_ RSDS_R_ObjRefPoint_15 : 243|3@0+ (1,0) [0|8] ""  MPC
 SG_ RSDS_R_HWATargetValidity_15 : 240|1@0+ (1,0) [0|1] ""  MPC
 SG_ RSDS_R_ObjID_16 : 271|8@0+ (1,0) [0|255] ""  MPC
 SG_ RSDS_R_ObjExistProb_16 : 279|5@0+ (0.03326,0) [0|1] ""  MPC
 SG_ RSDS_R_ObjObstacleProb_16 : 274|5@0+ (0.03326,0) [0|1] ""  MPC
 SG_ RSDS_R_ObjDistX_16 : 285|12@0+ (0.0625,-128) [-128|127.9375] "m"  MPC
 SG_ RSDS_R_ObjDistY_16 : 289|11@0+ (0.125,-128) [-128|127.875] "m"  MPC
 SG_ RSDS_R_ObjDistXStd_16 : 310|6@0+ (0.1,0) [0|6] "m"  MPC
 SG_ RSDS_R_ObjType_16 : 319|4@0+ (1,0) [0|15] ""  MPC
 SG_ RSDS_R_ObjRelVelX_16 : 335|13@0+ (0.0312,-128) [-128|126.9976] "mps"  MPC
 SG_ RSDS_R_ObjRelVelY_16 : 338|13@0+ (0.0312,-128) [-128|126.9976] "mps"  MPC
 SG_ RSDS_R_ObjRelAccelX_16 : 357|10@0+ (0.03125,-16) [-16|15.96875] "mps2"  MPC
 SG_ RSDS_R_ObjRelAccelY_16 : 363|10@0+ (0.03125,-16) [-16|15.96875] "mps2"  MPC
 SG_ RSDS_R_ObjMotionType_16 : 383|3@0+ (1,0) [0|7] ""  MPC
 SG_ RSDS_R_ObjMeasured_16 : 369|2@0+ (1,0) [0|3] ""  MPC
 SG_ RSDS_R_ObjDistYStd_16 : 399|6@0+ (0.1,0) [0|6] "m"  MPC
 SG_ RSDS_R_ObjRelVelXStd_16 : 393|6@0+ (0.0625,0) [0|3.9375] "mps"  MPC
 SG_ RSDS_R_ObjRelVelYStd_16 : 403|6@0+ (0.0625,0) [0|3.9375] "mps"  MPC
 SG_ RSDS_R_ObjRAccelXStd_16 : 413|6@0+ (0.0625,0) [0|3.9375] "mps2"  MPC
 SG_ RSDS_R_ObjRAccelYStd_16 : 423|6@0+ (0.0625,0) [0|3.9375] "mps2"  MPC
 SG_ RSDS_R_ObjWidth_16 : 417|10@0+ (0.01,0) [0|5] "m"  MPC
 SG_ RSDS_R_ObjMotionDirection_16 : 447|3@0+ (1,0) [0|7] ""  MPC
 SG_ RSDS_R_ObjAge_16 : 439|8@0+ (1,0) [0|255] ""  MPC
 SG_ RSDS_R_ObjLength_16 : 463|10@0+ (0.05,0) [0|20] "m"  MPC
 SG_ RSDS_R_ObjHeading_16 : 469|12@0+ (0.002,-3.14) [-3.14|3.14] "rad"  MPC
 SG_ RSDS_R_ObjYawrate_16 : 473|12@0+ (0.002,-3.14) [-3.14|3.14] "rad/s"  MPC
 SG_ RSDS_R_ObjRCS_16 : 493|10@0+ (0.125,-50) [-50|70] "dBm2"  MPC
 SG_ RSDS_R_ObjRefPoint_16 : 499|3@0+ (1,0) [0|8] ""  MPC
 SG_ RSDS_R_HWATargetValidity_16 : 496|1@0+ (1,0) [0|1] ""  MPC
 SG_ RSDS_R_SGU8_BlockCounter : 511|4@0+ (1,0) [0|15] ""  MPC
 SG_ RSDS_R_ObjValid_15 : 252|1@0+ (1,0) [0|1] ""  MPC
 SG_ RSDS_R_ObjValid_16 : 253|1@0+ (1,0) [0|1] ""  MPC
 SG_ RSDS_R_ObjHYAS_Reserved_15 : 261|6@0+ (0.017,0) [0|1.071] ""  MPC
 SG_ RSDS_R_ObjHYAS_Reserved_16 : 251|6@0+ (0.017,0) [0|1.071] ""  MPC
 SG_ RSDS_R_ObjTypeProb_15 : 325|6@0+ (2,0) [0|100] "%"  MPC
 SG_ RSDS_R_ObjTypeProb_16 : 315|6@0+ (2,0) [0|100] "%"  MPC
 SG_ RSDS_R_ObjHeight_15 : 31|10@0+ (0.01,0) [0|6] "m"  MPC
 SG_ RSDS_R_ObjHeight_16 : 379|10@0+ (0.01,0) [0|6] "m"  MPC

BO_ 1416 RSDS_L_SGU9: 64 CR_RL
 SG_ RSDS_L_ObjID_17 : 71|8@0+ (1,0) [0|255] ""  MPC
 SG_ RSDS_L_ObjExistProb_17 : 124|5@0+ (0.03326,0) [0|1] ""  MPC
 SG_ RSDS_L_ObjObstacleProb_17 : 135|5@0+ (0.03326,0) [0|1] ""  MPC
 SG_ RSDS_L_ObjDistX_17 : 187|12@0+ (0.0625,-128) [-128|127.9375] "m"  MPC
 SG_ RSDS_L_ObjDistY_17 : 33|11@0+ (0.125,-128) [-128|127.875] "m"  MPC
 SG_ RSDS_L_ObjDistXStd_17 : 54|6@0+ (0.1,0) [0|6] "m"  MPC
 SG_ RSDS_L_ObjType_17 : 63|4@0+ (1,0) [0|15] ""  MPC
 SG_ RSDS_L_ObjRelVelX_17 : 79|13@0+ (0.0312,-128) [-128|126.9976] "mps"  MPC
 SG_ RSDS_L_ObjRelVelY_17 : 82|13@0+ (0.0312,-128) [-128|126.9976] "mps"  MPC
 SG_ RSDS_L_ObjRelAccelX_17 : 101|10@0+ (0.03125,-16) [-16|15.96875] "mps2"  MPC
 SG_ RSDS_L_ObjRelAccelY_17 : 107|10@0+ (0.03125,-16) [-16|15.96875] "mps2"  MPC
 SG_ RSDS_L_ObjMotionType_17 : 127|3@0+ (1,0) [0|7] ""  MPC
 SG_ RSDS_L_ObjMeasured_17 : 113|2@0+ (1,0) [0|3] ""  MPC
 SG_ RSDS_L_ObjDistYStd_17 : 143|6@0+ (0.1,0) [0|6] "m"  MPC
 SG_ RSDS_L_ObjRelVelXStd_17 : 137|6@0+ (0.0625,0) [0|3.9375] "mps"  MPC
 SG_ RSDS_L_ObjRelVelYStd_17 : 147|6@0+ (0.0625,0) [0|3.9375] "mps"  MPC
 SG_ RSDS_L_ObjRAccelXStd_17 : 157|6@0+ (0.0625,0) [0|3.9375] "mps2"  MPC
 SG_ RSDS_L_ObjRAccelYStd_17 : 167|6@0+ (0.0625,0) [0|3.9375] "mps2"  MPC
 SG_ RSDS_L_ObjWidth_17 : 161|10@0+ (0.01,0) [0|5] "m"  MPC
 SG_ RSDS_L_ObjMotionDirection_17 : 191|3@0+ (1,0) [0|7] ""  MPC
 SG_ RSDS_L_ObjAge_17 : 183|8@0+ (1,0) [0|255] ""  MPC
 SG_ RSDS_L_ObjLength_17 : 207|10@0+ (0.05,0) [0|20] "m"  MPC
 SG_ RSDS_L_ObjHeading_17 : 213|12@0+ (0.002,-3.14) [-3.14|3.14] "rad"  MPC
 SG_ RSDS_L_ObjYawrate_17 : 217|12@0+ (0.002,-3.14) [-3.14|3.14] "rad/s"  MPC
 SG_ RSDS_L_ObjRCS_17 : 237|10@0+ (0.125,-50) [-50|70] "dBm2"  MPC
 SG_ RSDS_L_ObjRefPoint_17 : 243|3@0+ (1,0) [0|7] ""  MPC
 SG_ RSDS_L_HWATargetValidity_17 : 240|1@0+ (1,0) [0|1] ""  MPC
 SG_ RSDS_L_ObjID_18 : 271|8@0+ (1,0) [0|255] ""  MPC
 SG_ RSDS_L_ObjExistProb_18 : 279|5@0+ (0.03326,0) [0|1] ""  MPC
 SG_ RSDS_L_ObjObstacleProb_18 : 274|5@0+ (0.03326,0) [0|1] ""  MPC
 SG_ RSDS_L_ObjDistX_18 : 285|12@0+ (0.0625,-128) [-128|127.9375] "m"  MPC
 SG_ RSDS_L_ObjDistY_18 : 289|11@0+ (0.125,-128) [-128|127.875] "m"  MPC
 SG_ RSDS_L_ObjDistXStd_18 : 310|6@0+ (0.1,0) [0|6] "m"  MPC
 SG_ RSDS_L_ObjType_18 : 319|4@0+ (1,0) [0|15] ""  MPC
 SG_ RSDS_L_ObjRelVelX_18 : 335|13@0+ (0.0312,-128) [-128|126.9976] "mps"  MPC
 SG_ RSDS_L_ObjRelVelY_18 : 338|13@0+ (0.0312,-128) [-128|126.9976] "mps"  MPC
 SG_ RSDS_L_ObjRelAccelX_18 : 357|10@0+ (0.03125,-16) [-16|15.96875] "mps2"  MPC
 SG_ RSDS_L_ObjRelAccelY_18 : 363|10@0+ (0.03125,-16) [-16|15.96875] "mps2"  MPC
 SG_ RSDS_L_ObjMotionType_18 : 383|3@0+ (1,0) [0|7] ""  MPC
 SG_ RSDS_L_ObjMeasured_18 : 369|2@0+ (1,0) [0|3] ""  MPC
 SG_ RSDS_L_ObjDistYStd_18 : 399|6@0+ (0.1,0) [0|6] "m"  MPC
 SG_ RSDS_L_ObjRelVelXStd_18 : 393|6@0+ (0.0625,0) [0|3.9375] "mps"  MPC
 SG_ RSDS_L_ObjRelVelYStd_18 : 403|6@0+ (0.0625,0) [0|3.9375] "mps"  MPC
 SG_ RSDS_L_ObjRAccelXStd_18 : 413|6@0+ (0.0625,0) [0|3.9375] "mps2"  MPC
 SG_ RSDS_L_ObjRAccelYStd_18 : 423|6@0+ (0.0625,0) [0|3.9375] "mps2"  MPC
 SG_ RSDS_L_ObjWidth_18 : 417|10@0+ (0.01,0) [0|5] "m"  MPC
 SG_ RSDS_L_ObjMotionDirection_18 : 447|3@0+ (1,0) [0|7] ""  MPC
 SG_ RSDS_L_ObjAge_18 : 439|8@0+ (1,0) [0|255] ""  MPC
 SG_ RSDS_L_ObjLength_18 : 463|10@0+ (0.05,0) [0|20] "m"  MPC
 SG_ RSDS_L_ObjHeading_18 : 469|12@0+ (0.002,-3.14) [-3.14|3.14] "rad"  MPC
 SG_ RSDS_L_ObjYawrate_18 : 473|12@0+ (0.002,-3.14) [-3.14|3.14] "rad/s"  MPC
 SG_ RSDS_L_ObjRCS_18 : 493|10@0+ (0.125,-50) [-50|70] "dBm2"  MPC
 SG_ RSDS_L_ObjRefPoint_18 : 499|3@0+ (1,0) [0|7] ""  MPC
 SG_ RSDS_L_HWATargetValidity_18 : 496|1@0+ (1,0) [0|1] ""  MPC
 SG_ RSDS_L_SGU9_BlockCounter : 511|4@0+ (1,0) [0|15] ""  MPC
 SG_ RSDS_L_ObjValid_17 : 252|1@0+ (1,0) [0|1] ""  MPC
 SG_ RSDS_L_ObjValid_18 : 253|1@0+ (1,0) [0|1] ""  MPC
 SG_ Checksum588 : 7|16@0+ (1,0) [0|65535] ""  MPC
 SG_ RollingCounter588 : 23|8@0+ (1,0) [0|255] ""  MPC
 SG_ RSDS_L_ObjHYAS_Reserved_17 : 261|6@0+ (0.017,0) [0|1.071] ""  MPC
 SG_ RSDS_L_ObjHYAS_Reserved_18 : 251|6@0+ (0.017,0) [0|1.071] ""  MPC
 SG_ RSDS_L_ObjTypeProb_17 : 325|6@0+ (2,0) [0|100] "%"  MPC
 SG_ RSDS_L_ObjTypeProb_18 : 315|6@0+ (2,0) [0|100] "%"  MPC
 SG_ RSDS_L_ObjHeight_17 : 31|10@0+ (0.01,0) [0|6] "m"  MPC
 SG_ RSDS_L_ObjHeight_18 : 379|10@0+ (0.01,0) [0|6] "m"  MPC

BA_DEF_ BO_  "GenMsgSendType" ENUM  "cyclic","NoMsgSendType","IfActive","Event","CA","CE";
BA_DEF_ BO_  "GenMsgCycleTime" INT 0 0;
BA_DEF_ SG_  "GenSigStartValue" INT 0 0;
BA_DEF_  "DBName" STRING ;
BA_DEF_ BO_  "CANFD_BRS" ENUM  "0","1";
BA_DEF_ BO_  "VFrameFormat" ENUM  "StandardCAN","ExtendedCAN","reserved","reserved","reserved","reserved","reserved","reserved","reserved","reserved","reserved","reserved","reserved","reserved","StandardCAN_FD","ExtendedCAN_FD";
BA_DEF_  "BusBaudateData" INT 0 10000;
BA_DEF_  "BusBaudateOther" INT 0 10000;
BA_DEF_ BO_  "GenMsgILSupport" ENUM  "No","Yes";
BA_DEF_  "BusType" STRING ;
BA_DEF_DEF_  "GenMsgSendType" "cyclic";
BA_DEF_DEF_  "GenMsgCycleTime" 0;
BA_DEF_DEF_  "GenSigStartValue" 0;
BA_DEF_DEF_  "DBName" "";
BA_DEF_DEF_  "CANFD_BRS" "1";
BA_DEF_DEF_  "VFrameFormat" "";
BA_DEF_DEF_  "BusBaudateData" 2;
BA_DEF_DEF_  "BusBaudateOther" 500;
BA_DEF_DEF_  "GenMsgILSupport" "Yes";
BA_DEF_DEF_  "BusType" "CAN FD";
BA_ "DBName" "BAIC_CR";
BA_ "GenMsgCycleTime" BO_ 65 500;
BA_ "VFrameFormat" BO_ 65 14;
BA_ "GenMsgCycleTime" BO_ 367 20;
BA_ "VFrameFormat" BO_ 367 14;
BA_ "GenMsgSendType" BO_ 1486 3;
BA_ "VFrameFormat" BO_ 1486 14;
BA_ "GenMsgSendType" BO_ 1487 3;
BA_ "VFrameFormat" BO_ 1487 14;
BA_ "GenMsgSendType" BO_ 1408 3;
BA_ "VFrameFormat" BO_ 1408 14;
BA_ "GenMsgSendType" BO_ 1409 3;
BA_ "VFrameFormat" BO_ 1409 14;
BA_ "GenMsgSendType" BO_ 1410 3;
BA_ "VFrameFormat" BO_ 1410 14;
BA_ "GenMsgSendType" BO_ 1411 3;
BA_ "VFrameFormat" BO_ 1411 14;
BA_ "GenMsgSendType" BO_ 1412 3;
BA_ "VFrameFormat" BO_ 1412 14;
BA_ "GenMsgSendType" BO_ 1413 3;
BA_ "VFrameFormat" BO_ 1413 14;
BA_ "GenMsgSendType" BO_ 1414 3;
BA_ "VFrameFormat" BO_ 1414 14;
BA_ "GenMsgSendType" BO_ 1415 3;
BA_ "VFrameFormat" BO_ 1415 14;
BA_ "GenMsgSendType" BO_ 1424 3;
BA_ "VFrameFormat" BO_ 1424 14;
BA_ "GenMsgSendType" BO_ 1425 3;
BA_ "VFrameFormat" BO_ 1425 14;
BA_ "GenMsgSendType" BO_ 1426 3;
BA_ "VFrameFormat" BO_ 1426 14;
BA_ "GenMsgSendType" BO_ 1427 3;
BA_ "VFrameFormat" BO_ 1427 14;
BA_ "GenMsgSendType" BO_ 1428 3;
BA_ "VFrameFormat" BO_ 1428 14;
BA_ "GenMsgSendType" BO_ 1429 3;
BA_ "VFrameFormat" BO_ 1429 14;
BA_ "GenMsgSendType" BO_ 1430 3;
BA_ "VFrameFormat" BO_ 1430 14;
BA_ "GenMsgSendType" BO_ 1431 3;
BA_ "VFrameFormat" BO_ 1431 14;
BA_ "GenMsgSendType" BO_ 1416 3;
BA_ "VFrameFormat" BO_ 1416 14;
BA_ "GenSigStartValue" SG_ 367 RSDS_BrkgReqVal 200;
BA_ "GenSigStartValue" SG_ 367 RSDS_ObjRelAccelY_Le 512;
BA_ "GenSigStartValue" SG_ 367 LeTarSts 2;
BA_ "GenSigStartValue" SG_ 367 ObjLatPosnCurvLe 128;
BA_ "GenSigStartValue" SG_ 367 ObjLatSpdCurvLe 64;
BA_ "GenSigStartValue" SG_ 367 ObjTTCLe 127;
BA_ "GenSigStartValue" SG_ 367 RSDS_ObjRelAccelX_Le 512;
BA_ "GenSigStartValue" SG_ 1486 RSDS_L_ObjHdr_MountPosX 256;
BA_ "GenSigStartValue" SG_ 1486 RSDS_L_ObjHdr_MountPosY 128;
BA_ "GenSigStartValue" SG_ 1486 RSDS_L_ObjHdr_YawMountAngle 32768;
BA_ "GenSigStartValue" SG_ 1486 RSDS_L_ObjHdr_YawAngleLower 16384;
BA_ "GenSigStartValue" SG_ 1486 RSDS_L_ObjHdr_YawAngleUpper 16384;
BA_ "GenSigStartValue" SG_ 1486 RSDS_L_ObjHdr_PitchMountAngle 2048;
BA_ "GenSigStartValue" SG_ 1486 RSDS_L_ObjHdr_PitchAngleLower 2048;
BA_ "GenSigStartValue" SG_ 1486 RSDS_L_ObjHdr_PitchAngleUpper 2048;
BA_ "GenSigStartValue" SG_ 1486 RSDS_L_ObjHdr_RollMountAngle 2048;
BA_ "GenSigStartValue" SG_ 1487 RSDS_R_ObjHdr_MountPosX 256;
BA_ "GenSigStartValue" SG_ 1487 RSDS_R_ObjHdr_MountPosY 128;
BA_ "GenSigStartValue" SG_ 1487 RSDS_R_ObjHdr_YawMountAngle 32768;
BA_ "GenSigStartValue" SG_ 1487 RSDS_R_ObjHdr_YawAngleLower 16384;
BA_ "GenSigStartValue" SG_ 1487 RSDS_R_ObjHdr_YawAngleUpper 16384;
BA_ "GenSigStartValue" SG_ 1487 RSDS_R_ObjHdr_PitchMountAngle 2048;
BA_ "GenSigStartValue" SG_ 1487 RSDS_R_ObjHdr_PitchAngleLower 2048;
BA_ "GenSigStartValue" SG_ 1487 RSDS_R_ObjHdr_PitchAngleUpper 2048;
BA_ "GenSigStartValue" SG_ 1487 RSDS_R_ObjHdr_RollMountAngle 2048;
BA_ "GenSigStartValue" SG_ 1408 RSDS_L_ObjDistY_1 1024;
BA_ "GenSigStartValue" SG_ 1408 RSDS_L_ObjRelVelX_1 4102;
BA_ "GenSigStartValue" SG_ 1408 RSDS_L_ObjRelVelY_1 4102;
BA_ "GenSigStartValue" SG_ 1408 RSDS_L_ObjRelAccelX_1 512;
BA_ "GenSigStartValue" SG_ 1408 RSDS_L_ObjRelAccelY_1 512;
BA_ "GenSigStartValue" SG_ 1408 RSDS_L_ObjMeasured_1 1;
BA_ "GenSigStartValue" SG_ 1408 RSDS_L_ObjRCS_1 400;
BA_ "GenSigStartValue" SG_ 1408 RSDS_L_ObjDistY_2 1024;
BA_ "GenSigStartValue" SG_ 1408 RSDS_L_ObjRelVelX_2 4102;
BA_ "GenSigStartValue" SG_ 1408 RSDS_L_ObjRelVelY_2 4102;
BA_ "GenSigStartValue" SG_ 1408 RSDS_L_ObjRelAccelX_2 512;
BA_ "GenSigStartValue" SG_ 1408 RSDS_L_ObjRelAccelY_2 512;
BA_ "GenSigStartValue" SG_ 1408 RSDS_L_ObjMeasured_2 1;
BA_ "GenSigStartValue" SG_ 1408 RSDS_L_ObjRCS_2 400;
BA_ "GenSigStartValue" SG_ 1409 RSDS_L_ObjDistY_3 1024;
BA_ "GenSigStartValue" SG_ 1409 RSDS_L_ObjRelVelX_3 4102;
BA_ "GenSigStartValue" SG_ 1409 RSDS_L_ObjRelVelY_3 4102;
BA_ "GenSigStartValue" SG_ 1409 RSDS_L_ObjRelAccelX_3 512;
BA_ "GenSigStartValue" SG_ 1409 RSDS_L_ObjRelAccelY_3 512;
BA_ "GenSigStartValue" SG_ 1409 RSDS_L_ObjMeasured_3 1;
BA_ "GenSigStartValue" SG_ 1409 RSDS_L_ObjRCS_3 400;
BA_ "GenSigStartValue" SG_ 1409 RSDS_L_ObjDistY_4 1024;
BA_ "GenSigStartValue" SG_ 1409 RSDS_L_ObjRelVelX_4 4102;
BA_ "GenSigStartValue" SG_ 1409 RSDS_L_ObjRelVelY_4 4102;
BA_ "GenSigStartValue" SG_ 1409 RSDS_L_ObjRelAccelX_4 512;
BA_ "GenSigStartValue" SG_ 1409 RSDS_L_ObjRelAccelY_4 512;
BA_ "GenSigStartValue" SG_ 1409 RSDS_L_ObjMeasured_4 1;
BA_ "GenSigStartValue" SG_ 1409 RSDS_L_ObjRCS_4 400;
BA_ "GenSigStartValue" SG_ 1410 RSDS_L_ObjDistY_5 1024;
BA_ "GenSigStartValue" SG_ 1410 RSDS_L_ObjRelVelX_5 4102;
BA_ "GenSigStartValue" SG_ 1410 RSDS_L_ObjRelVelY_5 4102;
BA_ "GenSigStartValue" SG_ 1410 RSDS_L_ObjRelAccelX_5 512;
BA_ "GenSigStartValue" SG_ 1410 RSDS_L_ObjRelAccelY_5 512;
BA_ "GenSigStartValue" SG_ 1410 RSDS_L_ObjMeasured_5 1;
BA_ "GenSigStartValue" SG_ 1410 RSDS_L_ObjRCS_5 400;
BA_ "GenSigStartValue" SG_ 1410 RSDS_L_ObjDistY_6 1024;
BA_ "GenSigStartValue" SG_ 1410 RSDS_L_ObjRelVelX_6 4102;
BA_ "GenSigStartValue" SG_ 1410 RSDS_L_ObjRelVelY_6 4102;
BA_ "GenSigStartValue" SG_ 1410 RSDS_L_ObjRelAccelX_6 512;
BA_ "GenSigStartValue" SG_ 1410 RSDS_L_ObjRelAccelY_6 512;
BA_ "GenSigStartValue" SG_ 1410 RSDS_L_ObjMeasured_6 1;
BA_ "GenSigStartValue" SG_ 1410 RSDS_L_ObjRCS_6 400;
BA_ "GenSigStartValue" SG_ 1411 RSDS_L_ObjDistY_7 1024;
BA_ "GenSigStartValue" SG_ 1411 RSDS_L_ObjRelVelX_7 4102;
BA_ "GenSigStartValue" SG_ 1411 RSDS_L_ObjRelVelY_7 4102;
BA_ "GenSigStartValue" SG_ 1411 RSDS_L_ObjRelAccelX_7 512;
BA_ "GenSigStartValue" SG_ 1411 RSDS_L_ObjRelAccelY_7 512;
BA_ "GenSigStartValue" SG_ 1411 RSDS_L_ObjMeasured_7 1;
BA_ "GenSigStartValue" SG_ 1411 RSDS_L_ObjRCS_7 400;
BA_ "GenSigStartValue" SG_ 1411 RSDS_L_ObjDistY_8 1024;
BA_ "GenSigStartValue" SG_ 1411 RSDS_L_ObjRelVelX_8 4102;
BA_ "GenSigStartValue" SG_ 1411 RSDS_L_ObjRelVelY_8 4102;
BA_ "GenSigStartValue" SG_ 1411 RSDS_L_ObjRelAccelX_8 512;
BA_ "GenSigStartValue" SG_ 1411 RSDS_L_ObjRelAccelY_8 512;
BA_ "GenSigStartValue" SG_ 1411 RSDS_L_ObjMeasured_8 1;
BA_ "GenSigStartValue" SG_ 1411 RSDS_L_ObjRCS_8 400;
BA_ "GenSigStartValue" SG_ 1412 RSDS_L_ObjDistY_9 1024;
BA_ "GenSigStartValue" SG_ 1412 RSDS_L_ObjRelVelX_9 4102;
BA_ "GenSigStartValue" SG_ 1412 RSDS_L_ObjRelVelY_9 4102;
BA_ "GenSigStartValue" SG_ 1412 RSDS_L_ObjRelAccelX_9 512;
BA_ "GenSigStartValue" SG_ 1412 RSDS_L_ObjRelAccelY_9 512;
BA_ "GenSigStartValue" SG_ 1412 RSDS_L_ObjMeasured_9 1;
BA_ "GenSigStartValue" SG_ 1412 RSDS_L_ObjRCS_9 400;
BA_ "GenSigStartValue" SG_ 1412 RSDS_L_ObjDistY_10 1024;
BA_ "GenSigStartValue" SG_ 1412 RSDS_L_ObjRelVelX_10 4102;
BA_ "GenSigStartValue" SG_ 1412 RSDS_L_ObjRelVelY_10 4102;
BA_ "GenSigStartValue" SG_ 1412 RSDS_L_ObjRelAccelX_10 512;
BA_ "GenSigStartValue" SG_ 1412 RSDS_L_ObjRelAccelY_10 512;
BA_ "GenSigStartValue" SG_ 1412 RSDS_L_ObjMeasured_10 1;
BA_ "GenSigStartValue" SG_ 1412 RSDS_L_ObjRCS_10 400;
BA_ "GenSigStartValue" SG_ 1413 RSDS_L_ObjDistY_11 1024;
BA_ "GenSigStartValue" SG_ 1413 RSDS_L_ObjRelVelX_11 4102;
BA_ "GenSigStartValue" SG_ 1413 RSDS_L_ObjRelVelY_11 4102;
BA_ "GenSigStartValue" SG_ 1413 RSDS_L_ObjRelAccelX_11 512;
BA_ "GenSigStartValue" SG_ 1413 RSDS_L_ObjRelAccelY_11 512;
BA_ "GenSigStartValue" SG_ 1413 RSDS_L_ObjMeasured_11 1;
BA_ "GenSigStartValue" SG_ 1413 RSDS_L_ObjRCS_11 400;
BA_ "GenSigStartValue" SG_ 1413 RSDS_L_ObjDistY_12 1024;
BA_ "GenSigStartValue" SG_ 1413 RSDS_L_ObjRelVelX_12 4102;
BA_ "GenSigStartValue" SG_ 1413 RSDS_L_ObjRelVelY_12 4102;
BA_ "GenSigStartValue" SG_ 1413 RSDS_L_ObjRelAccelX_12 512;
BA_ "GenSigStartValue" SG_ 1413 RSDS_L_ObjRelAccelY_12 512;
BA_ "GenSigStartValue" SG_ 1413 RSDS_L_ObjMeasured_12 1;
BA_ "GenSigStartValue" SG_ 1413 RSDS_L_ObjRCS_12 400;
BA_ "GenSigStartValue" SG_ 1414 RSDS_L_ObjDistY_13 1024;
BA_ "GenSigStartValue" SG_ 1414 RSDS_L_ObjRelVelX_13 4102;
BA_ "GenSigStartValue" SG_ 1414 RSDS_L_ObjRelVelY_13 4102;
BA_ "GenSigStartValue" SG_ 1414 RSDS_L_ObjRelAccelX_13 512;
BA_ "GenSigStartValue" SG_ 1414 RSDS_L_ObjRelAccelY_13 512;
BA_ "GenSigStartValue" SG_ 1414 RSDS_L_ObjMeasured_13 1;
BA_ "GenSigStartValue" SG_ 1414 RSDS_L_ObjRCS_13 400;
BA_ "GenSigStartValue" SG_ 1414 RSDS_L_ObjDistY_14 1024;
BA_ "GenSigStartValue" SG_ 1414 RSDS_L_ObjRelVelX_14 4102;
BA_ "GenSigStartValue" SG_ 1414 RSDS_L_ObjRelVelY_14 4102;
BA_ "GenSigStartValue" SG_ 1414 RSDS_L_ObjRelAccelX_14 512;
BA_ "GenSigStartValue" SG_ 1414 RSDS_L_ObjRelAccelY_14 512;
BA_ "GenSigStartValue" SG_ 1414 RSDS_L_ObjMeasured_14 1;
BA_ "GenSigStartValue" SG_ 1414 RSDS_L_ObjRCS_14 400;
BA_ "GenSigStartValue" SG_ 1415 RSDS_L_ObjDistY_15 1024;
BA_ "GenSigStartValue" SG_ 1415 RSDS_L_ObjRelVelX_15 4102;
BA_ "GenSigStartValue" SG_ 1415 RSDS_L_ObjRelVelY_15 4102;
BA_ "GenSigStartValue" SG_ 1415 RSDS_L_ObjRelAccelX_15 512;
BA_ "GenSigStartValue" SG_ 1415 RSDS_L_ObjRelAccelY_15 512;
BA_ "GenSigStartValue" SG_ 1415 RSDS_L_ObjMeasured_15 1;
BA_ "GenSigStartValue" SG_ 1415 RSDS_L_ObjRCS_15 400;
BA_ "GenSigStartValue" SG_ 1415 RSDS_L_ObjDistY_16 1024;
BA_ "GenSigStartValue" SG_ 1415 RSDS_L_ObjRelVelX_16 4102;
BA_ "GenSigStartValue" SG_ 1415 RSDS_L_ObjRelVelY_16 4102;
BA_ "GenSigStartValue" SG_ 1415 RSDS_L_ObjRelAccelX_16 512;
BA_ "GenSigStartValue" SG_ 1415 RSDS_L_ObjRelAccelY_16 512;
BA_ "GenSigStartValue" SG_ 1415 RSDS_L_ObjMeasured_16 1;
BA_ "GenSigStartValue" SG_ 1415 RSDS_L_ObjRCS_16 400;
BA_ "GenSigStartValue" SG_ 1424 RSDS_R_ObjDistY_1 1024;
BA_ "GenSigStartValue" SG_ 1424 RSDS_R_ObjRelVelX_1 4102;
BA_ "GenSigStartValue" SG_ 1424 RSDS_R_ObjRelVelY_1 4102;
BA_ "GenSigStartValue" SG_ 1424 RSDS_R_ObjRelAccelX_1 512;
BA_ "GenSigStartValue" SG_ 1424 RSDS_R_ObjRelAccelY_1 512;
BA_ "GenSigStartValue" SG_ 1424 RSDS_R_ObjMeasured_1 1;
BA_ "GenSigStartValue" SG_ 1424 RSDS_R_ObjRCS_1 400;
BA_ "GenSigStartValue" SG_ 1424 RSDS_R_ObjDistY_2 1024;
BA_ "GenSigStartValue" SG_ 1424 RSDS_R_ObjRelVelX_2 4102;
BA_ "GenSigStartValue" SG_ 1424 RSDS_R_ObjRelVelY_2 4102;
BA_ "GenSigStartValue" SG_ 1424 RSDS_R_ObjRelAccelX_2 512;
BA_ "GenSigStartValue" SG_ 1424 RSDS_R_ObjRelAccelY_2 512;
BA_ "GenSigStartValue" SG_ 1424 RSDS_R_ObjMeasured_2 1;
BA_ "GenSigStartValue" SG_ 1424 RSDS_R_ObjRCS_2 400;
BA_ "GenSigStartValue" SG_ 1425 RSDS_R_ObjDistY_3 1024;
BA_ "GenSigStartValue" SG_ 1425 RSDS_R_ObjRelVelX_3 4102;
BA_ "GenSigStartValue" SG_ 1425 RSDS_R_ObjRelVelY_3 4102;
BA_ "GenSigStartValue" SG_ 1425 RSDS_R_ObjRelAccelX_3 512;
BA_ "GenSigStartValue" SG_ 1425 RSDS_R_ObjRelAccelY_3 512;
BA_ "GenSigStartValue" SG_ 1425 RSDS_R_ObjMeasured_3 1;
BA_ "GenSigStartValue" SG_ 1425 RSDS_R_ObjRCS_3 400;
BA_ "GenSigStartValue" SG_ 1425 RSDS_R_ObjDistY_4 1024;
BA_ "GenSigStartValue" SG_ 1425 RSDS_R_ObjRelVelX_4 4102;
BA_ "GenSigStartValue" SG_ 1425 RSDS_R_ObjRelVelY_4 4102;
BA_ "GenSigStartValue" SG_ 1425 RSDS_R_ObjRelAccelX_4 512;
BA_ "GenSigStartValue" SG_ 1425 RSDS_R_ObjRelAccelY_4 512;
BA_ "GenSigStartValue" SG_ 1425 RSDS_R_ObjMeasured_4 1;
BA_ "GenSigStartValue" SG_ 1425 RSDS_R_ObjRCS_4 400;
BA_ "GenSigStartValue" SG_ 1426 RSDS_R_ObjDistY_5 1024;
BA_ "GenSigStartValue" SG_ 1426 RSDS_R_ObjRelVelX_5 4102;
BA_ "GenSigStartValue" SG_ 1426 RSDS_R_ObjRelVelY_5 4102;
BA_ "GenSigStartValue" SG_ 1426 RSDS_R_ObjRelAccelX_5 512;
BA_ "GenSigStartValue" SG_ 1426 RSDS_R_ObjRelAccelY_5 512;
BA_ "GenSigStartValue" SG_ 1426 RSDS_R_ObjMeasured_5 1;
BA_ "GenSigStartValue" SG_ 1426 RSDS_R_ObjRCS_5 400;
BA_ "GenSigStartValue" SG_ 1426 RSDS_R_ObjDistY_6 1024;
BA_ "GenSigStartValue" SG_ 1426 RSDS_R_ObjRelVelX_6 4102;
BA_ "GenSigStartValue" SG_ 1426 RSDS_R_ObjRelVelY_6 4102;
BA_ "GenSigStartValue" SG_ 1426 RSDS_R_ObjRelAccelX_6 512;
BA_ "GenSigStartValue" SG_ 1426 RSDS_R_ObjRelAccelY_6 512;
BA_ "GenSigStartValue" SG_ 1426 RSDS_R_ObjMeasured_6 1;
BA_ "GenSigStartValue" SG_ 1426 RSDS_R_ObjRCS_6 400;
BA_ "GenSigStartValue" SG_ 1427 RSDS_R_ObjDistY_7 1024;
BA_ "GenSigStartValue" SG_ 1427 RSDS_R_ObjRelVelX_7 4102;
BA_ "GenSigStartValue" SG_ 1427 RSDS_R_ObjRelVelY_7 4102;
BA_ "GenSigStartValue" SG_ 1427 RSDS_R_ObjRelAccelX_7 512;
BA_ "GenSigStartValue" SG_ 1427 RSDS_R_ObjRelAccelY_7 512;
BA_ "GenSigStartValue" SG_ 1427 RSDS_R_ObjMeasured_7 1;
BA_ "GenSigStartValue" SG_ 1427 RSDS_R_ObjRCS_7 400;
BA_ "GenSigStartValue" SG_ 1427 RSDS_R_ObjDistY_8 1024;
BA_ "GenSigStartValue" SG_ 1427 RSDS_R_ObjRelVelX_8 4102;
BA_ "GenSigStartValue" SG_ 1427 RSDS_R_ObjRelVelY_8 4102;
BA_ "GenSigStartValue" SG_ 1427 RSDS_R_ObjRelAccelX_8 512;
BA_ "GenSigStartValue" SG_ 1427 RSDS_R_ObjRelAccelY_8 512;
BA_ "GenSigStartValue" SG_ 1427 RSDS_R_ObjMeasured_8 1;
BA_ "GenSigStartValue" SG_ 1427 RSDS_R_ObjRCS_8 400;
BA_ "GenSigStartValue" SG_ 1428 RSDS_R_ObjDistY_9 1024;
BA_ "GenSigStartValue" SG_ 1428 RSDS_R_ObjRelVelX_9 4102;
BA_ "GenSigStartValue" SG_ 1428 RSDS_R_ObjRelVelY_9 4102;
BA_ "GenSigStartValue" SG_ 1428 RSDS_R_ObjRelAccelX_9 512;
BA_ "GenSigStartValue" SG_ 1428 RSDS_R_ObjRelAccelY_9 512;
BA_ "GenSigStartValue" SG_ 1428 RSDS_R_ObjMeasured_9 1;
BA_ "GenSigStartValue" SG_ 1428 RSDS_R_ObjRCS_9 400;
BA_ "GenSigStartValue" SG_ 1428 RSDS_R_ObjDistY_10 1024;
BA_ "GenSigStartValue" SG_ 1428 RSDS_R_ObjRelVelX_10 4102;
BA_ "GenSigStartValue" SG_ 1428 RSDS_R_ObjRelVelY_10 4102;
BA_ "GenSigStartValue" SG_ 1428 RSDS_R_ObjRelAccelX_10 512;
BA_ "GenSigStartValue" SG_ 1428 RSDS_R_ObjRelAccelY_10 512;
BA_ "GenSigStartValue" SG_ 1428 RSDS_R_ObjMeasured_10 1;
BA_ "GenSigStartValue" SG_ 1428 RSDS_R_ObjRCS_10 400;
BA_ "GenSigStartValue" SG_ 1429 RSDS_R_ObjDistY_11 1024;
BA_ "GenSigStartValue" SG_ 1429 RSDS_R_ObjRelVelX_11 4102;
BA_ "GenSigStartValue" SG_ 1429 RSDS_R_ObjRelVelY_11 4102;
BA_ "GenSigStartValue" SG_ 1429 RSDS_R_ObjRelAccelX_11 512;
BA_ "GenSigStartValue" SG_ 1429 RSDS_R_ObjRelAccelY_11 512;
BA_ "GenSigStartValue" SG_ 1429 RSDS_R_ObjMeasured_11 1;
BA_ "GenSigStartValue" SG_ 1429 RSDS_R_ObjRCS_11 400;
BA_ "GenSigStartValue" SG_ 1429 RSDS_R_ObjDistY_12 1024;
BA_ "GenSigStartValue" SG_ 1429 RSDS_R_ObjRelVelX_12 4102;
BA_ "GenSigStartValue" SG_ 1429 RSDS_R_ObjRelVelY_12 4102;
BA_ "GenSigStartValue" SG_ 1429 RSDS_R_ObjRelAccelX_12 512;
BA_ "GenSigStartValue" SG_ 1429 RSDS_R_ObjRelAccelY_12 512;
BA_ "GenSigStartValue" SG_ 1429 RSDS_R_ObjMeasured_12 1;
BA_ "GenSigStartValue" SG_ 1429 RSDS_R_ObjRCS_12 400;
BA_ "GenSigStartValue" SG_ 1430 RSDS_R_ObjDistY_13 1024;
BA_ "GenSigStartValue" SG_ 1430 RSDS_R_ObjRelVelX_13 4102;
BA_ "GenSigStartValue" SG_ 1430 RSDS_R_ObjRelVelY_13 4102;
BA_ "GenSigStartValue" SG_ 1430 RSDS_R_ObjRelAccelX_13 512;
BA_ "GenSigStartValue" SG_ 1430 RSDS_R_ObjRelAccelY_13 512;
BA_ "GenSigStartValue" SG_ 1430 RSDS_R_ObjMeasured_13 1;
BA_ "GenSigStartValue" SG_ 1430 RSDS_R_ObjRCS_13 400;
BA_ "GenSigStartValue" SG_ 1430 RSDS_R_ObjDistY_14 1024;
BA_ "GenSigStartValue" SG_ 1430 RSDS_R_ObjRelVelX_14 4102;
BA_ "GenSigStartValue" SG_ 1430 RSDS_R_ObjRelVelY_14 4102;
BA_ "GenSigStartValue" SG_ 1430 RSDS_R_ObjRelAccelX_14 512;
BA_ "GenSigStartValue" SG_ 1430 RSDS_R_ObjRelAccelY_14 512;
BA_ "GenSigStartValue" SG_ 1430 RSDS_R_ObjMeasured_14 1;
BA_ "GenSigStartValue" SG_ 1430 RSDS_R_ObjRCS_14 400;
BA_ "GenSigStartValue" SG_ 1431 RSDS_R_ObjDistY_15 1024;
BA_ "GenSigStartValue" SG_ 1431 RSDS_R_ObjRelVelX_15 4102;
BA_ "GenSigStartValue" SG_ 1431 RSDS_R_ObjRelVelY_15 4102;
BA_ "GenSigStartValue" SG_ 1431 RSDS_R_ObjRelAccelX_15 512;
BA_ "GenSigStartValue" SG_ 1431 RSDS_R_ObjRelAccelY_15 512;
BA_ "GenSigStartValue" SG_ 1431 RSDS_R_ObjMeasured_15 1;
BA_ "GenSigStartValue" SG_ 1431 RSDS_R_ObjRCS_15 400;
BA_ "GenSigStartValue" SG_ 1431 RSDS_R_ObjDistY_16 1024;
BA_ "GenSigStartValue" SG_ 1431 RSDS_R_ObjRelVelX_16 4102;
BA_ "GenSigStartValue" SG_ 1431 RSDS_R_ObjRelVelY_16 4102;
BA_ "GenSigStartValue" SG_ 1431 RSDS_R_ObjRelAccelX_16 512;
BA_ "GenSigStartValue" SG_ 1431 RSDS_R_ObjRelAccelY_16 512;
BA_ "GenSigStartValue" SG_ 1431 RSDS_R_ObjMeasured_16 1;
BA_ "GenSigStartValue" SG_ 1431 RSDS_R_ObjRCS_16 400;
BA_ "GenSigStartValue" SG_ 1416 RSDS_L_ObjDistY_17 1024;
BA_ "GenSigStartValue" SG_ 1416 RSDS_L_ObjRelVelX_17 4102;
BA_ "GenSigStartValue" SG_ 1416 RSDS_L_ObjRelVelY_17 4102;
BA_ "GenSigStartValue" SG_ 1416 RSDS_L_ObjRelAccelX_17 512;
BA_ "GenSigStartValue" SG_ 1416 RSDS_L_ObjRelAccelY_17 512;
BA_ "GenSigStartValue" SG_ 1416 RSDS_L_ObjMeasured_17 1;
BA_ "GenSigStartValue" SG_ 1416 RSDS_L_ObjRCS_17 400;
BA_ "GenSigStartValue" SG_ 1416 RSDS_L_ObjDistY_18 1024;
BA_ "GenSigStartValue" SG_ 1416 RSDS_L_ObjRelVelX_18 4102;
BA_ "GenSigStartValue" SG_ 1416 RSDS_L_ObjRelVelY_18 4102;
BA_ "GenSigStartValue" SG_ 1416 RSDS_L_ObjRelAccelX_18 512;
BA_ "GenSigStartValue" SG_ 1416 RSDS_L_ObjRelAccelY_18 512;
BA_ "GenSigStartValue" SG_ 1416 RSDS_L_ObjMeasured_18 1;
BA_ "GenSigStartValue" SG_ 1416 RSDS_L_ObjRCS_18 400;
VAL_ 367 RSDS_Brk_ErrSts 0 "Noerror" 1 "Error" ;
VAL_ 367 RSDS_BrkgReq 0 "NoRequest" 1 "Request" ;
VAL_ 367 RSDS_RCW_Trigger 0 "Nowarning" 1 "RCWlevel1" 2 "RCWlevel2" ;
VAL_ 367 BSD_LCA_warningReqleft 0 "Nowarning" 1 "Warninglevel1" 2 "Warninglevel2" ;
VAL_ 367 DOW_warningReqleft 0 "Nowarning" 1 "Warninglevel1" 2 "Warninglevel2" ;
VAL_ 367 RSDS_LEDLightReqLeft 0 "Nowarning" 1 "Warninglevel1LED" 2 "Warninglevel2LED2Hz" 3 "Warninglevel3LED4Hz" ;
VAL_ 367 RCTA_warningReqLeft 0 "Nowarning" 1 "Warninglevel2" ;
VAL_ 367 LeTarSts 0 "TargetInvalid" 1 "TargetValid" 2 "Notarget" ;
VAL_ 367 ObjStatyLe 0 "Stationary" 1 "NotStationary" ;
VAL_ 367 ZoneIndLe 0 "NoObjectintheZone" 1 "ObjectinBSWZone" 2 "ObjectinCVWZone" 3 "ObjectintheSharedZone" ;
VAL_ 367 ObjStsLe 0 "Invalid" 1 "New" 2 "Mature" 3 "Coasted" ;
VAL_ 1486 RSDS_L_hdr_SGU_ErrorStatus 0 "Noerror" 1 "NotDefined" 2 "Misalignmentelevation" 3 "Misalignmentazimuth" 4 "Temporaryfailure" 5 "Permanentfailure" 6 "Voltageerror" 7 "Productionmode" 8 "EOLerror" 9 "Calibrationparametererror" 10 "partnerECUsignalerror" ;
VAL_ 1486 RSDS_L_BLIND 0 "NoBlindness" 1 "Blindness" ;
VAL_ 1486 RSDS_L_ELK_OT 0 "NoRequest" 1 "Request" ;
VAL_ 1487 RSDS_R_hdr_SGU_ErrorStatus 0 "Noerror" 1 "NotDefined" 2 "Misalignmentelevation" 3 "Misalignmentazimuth" 4 "Temporaryfailure" 5 "Permanentfailure" 6 "Voltageerror" 7 "Productionmode" 8 "EOLerror" 9 "Calibrationparametererror" 10 "partnerECUsignalerror" ;
VAL_ 1487 RSDS_R_ELK_OT 0 "NoRequest" 1 "Request" ;
VAL_ 1487 RSDS_R_BLIND 0 "NoBlindness" 1 "Blindness" ;
VAL_ 1408 RSDS_L_ObjType_1 0 "Unknown" 1 "Truck" 2 "Car" 3 "Pedestrian" 4 "Cyclist" ;
VAL_ 1408 RSDS_L_ObjMotionType_1 0 "Int" 1 "Unknown" 2 "Drive" 3 "Stopped" 4 "Stand" ;
VAL_ 1408 RSDS_L_ObjMeasured_1 0 "Init" 1 "Measured" 2 "Predicted" ;
VAL_ 1408 RSDS_L_ObjMotionDirection_1 0 "Init" 1 "Inversedirection" 2 "Samedirection" 3 "Cross" ;
VAL_ 1408 RSDS_L_ObjRefPoint_1 0 "Rear" 1 "Rearleft" 2 "Left" 3 "Frontleft" 4 "Front" 5 "FrontRight" 6 "Right" 7 "Rearright" ;
VAL_ 1408 RSDS_L_HWATargetValidity_1 0 "NOTHWATarget" 1 "HWATarget" ;
VAL_ 1408 RSDS_L_ObjType_2 0 "Unknown" 1 "Truck" 2 "Car" 3 "Pedestrian" 4 "Cyclist" ;
VAL_ 1408 RSDS_L_ObjMotionType_2 0 "Int" 1 "Unknown" 2 "Drive" 3 "Stopped" 4 "Stand" ;
VAL_ 1408 RSDS_L_ObjMeasured_2 0 "Init" 1 "Measured" 2 "Predicted" ;
VAL_ 1408 RSDS_L_ObjMotionDirection_2 0 "Init" 1 "Inversedirection" 2 "Samedirection" 3 "Cross" ;
VAL_ 1408 RSDS_L_ObjRefPoint_2 0 "Rear" 1 "Rearleft" 2 "Left" 3 "Frontleft" 4 "Front" 5 "FrontRight" 6 "Right" 7 "Rearright" ;
VAL_ 1408 RSDS_L_HWATargetValidity_2 0 "NOTHWATarget" 1 "HWATarget" ;
VAL_ 1408 RSDS_L_ObjValid_1 0 "Validvalues" 1 "invalidvalues" ;
VAL_ 1408 RSDS_L_ObjValid_2 0 "Validvalues" 1 "invalidvalues" ;
VAL_ 1409 RSDS_L_ObjType_3 0 "Unknown" 1 "Truck" 2 "Car" 3 "Pedestrian" 4 "Cyclist" ;
VAL_ 1409 RSDS_L_ObjMotionType_3 0 "Int" 1 "Unknown" 2 "Drive" 3 "Stopped" 4 "Stand" ;
VAL_ 1409 RSDS_L_ObjMeasured_3 0 "Init" 1 "Measured" 2 "Predicted" ;
VAL_ 1409 RSDS_L_ObjMotionDirection_3 0 "Init" 1 "Inversedirection" 2 "Samedirection" 3 "Cross" ;
VAL_ 1409 RSDS_L_ObjRefPoint_3 0 "Rear" 1 "Rearleft" 2 "Left" 3 "Frontleft" 4 "Front" 5 "FrontRight" 6 "Right" 7 "Rearright" ;
VAL_ 1409 RSDS_L_HWATargetValidity_3 0 "NOTHWATarget" 1 "HWATarget" ;
VAL_ 1409 RSDS_L_ObjType_4 0 "Unknown" 1 "Truck" 2 "Car" 3 "Pedestrian" 4 "Cyclist" ;
VAL_ 1409 RSDS_L_ObjMotionType_4 0 "Int" 1 "Unknown" 2 "Drive" 3 "Stopped" 4 "Stand" ;
VAL_ 1409 RSDS_L_ObjMeasured_4 0 "Init" 1 "Measured" 2 "Predicted" ;
VAL_ 1409 RSDS_L_ObjMotionDirection_4 0 "Init" 1 "Inversedirection" 2 "Samedirection" 3 "Cross" ;
VAL_ 1409 RSDS_L_HWATargetValidity_4 0 "NOTHWATarget" 1 "HWATarget" ;
VAL_ 1409 RSDS_L_ObjRefPoint_4 0 "Rear" 1 "Rearleft" 2 "Left" 3 "Frontleft" 4 "Front" 5 "FrontRight" 6 "Right" 7 "Rearright" ;
VAL_ 1409 RSDS_L_ObjValid_3 0 "Validvalues" 1 "invalidvalues" ;
VAL_ 1409 RSDS_L_ObjValid_4 0 "Validvalues" 1 "invalidvalues" ;
VAL_ 1410 RSDS_L_ObjType_5 0 "Unknown" 1 "Truck" 2 "Car" 3 "Pedestrian" 4 "Cyclist" ;
VAL_ 1410 RSDS_L_ObjMotionType_5 0 "Int" 1 "Unknown" 2 "Drive" 3 "Stopped" 4 "Stand" ;
VAL_ 1410 RSDS_L_ObjMeasured_5 0 "Init" 1 "Measured" 2 "Predicted" ;
VAL_ 1410 RSDS_L_ObjMotionDirection_5 0 "Init" 1 "Inversedirection" 2 "Samedirection" 3 "Cross" ;
VAL_ 1410 RSDS_L_ObjRefPoint_5 0 "Rear" 1 "Rearleft" 2 "Left" 3 "Frontleft" 4 "Front" 5 "FrontRight" 6 "Right" 7 "Rearright" ;
VAL_ 1410 RSDS_L_HWATargetValidity_5 0 "NOTHWATarget" 1 "HWATarget" ;
VAL_ 1410 RSDS_L_ObjType_6 0 "Unknown" 1 "Truck" 2 "Car" 3 "Pedestrian" 4 "Cyclist" ;
VAL_ 1410 RSDS_L_ObjMotionType_6 0 "Int" 1 "Unknown" 2 "Drive" 3 "Stopped" 4 "Stand" ;
VAL_ 1410 RSDS_L_ObjMeasured_6 0 "Init" 1 "Measured" 2 "Predicted" ;
VAL_ 1410 RSDS_L_ObjMotionDirection_6 0 "Init" 1 "Inversedirection" 2 "Samedirection" 3 "Cross" ;
VAL_ 1410 RSDS_L_ObjRefPoint_6 0 "Rear" 1 "Rearleft" 2 "Left" 3 "Frontleft" 4 "Front" 5 "FrontRight" 6 "Right" 7 "Rearright" ;
VAL_ 1410 RSDS_L_HWATargetValidity_6 0 "NOTHWATarget" 1 "HWATarget" ;
VAL_ 1410 RSDS_L_ObjValid_5 0 "Validvalues" 1 "invalidvalues" ;
VAL_ 1410 RSDS_L_ObjValid_6 0 "Validvalues" 1 "invalidvalues" ;
VAL_ 1411 RSDS_L_ObjType_7 0 "Unknown" 1 "Truck" 2 "Car" 3 "Pedestrian" 4 "Cyclist" ;
VAL_ 1411 RSDS_L_ObjMotionType_7 0 "Int" 1 "Unknown" 2 "Drive" 3 "Stopped" 4 "Stand" ;
VAL_ 1411 RSDS_L_ObjMeasured_7 0 "Init" 1 "Measured" 2 "Predicted" ;
VAL_ 1411 RSDS_L_ObjMotionDirection_7 0 "Init" 1 "Inversedirection" 2 "Samedirection" 3 "Cross" ;
VAL_ 1411 RSDS_L_ObjRefPoint_7 0 "Rear" 1 "Rearleft" 2 "Left" 3 "Frontleft" 4 "Front" 5 "FrontRight" 6 "Right" 7 "Rearright" ;
VAL_ 1411 RSDS_L_HWATargetValidity_7 0 "NOTHWATarget" 1 "HWATarget" ;
VAL_ 1411 RSDS_L_ObjType_8 0 "Unknown" 1 "Truck" 2 "Car" 3 "Pedestrian" 4 "Cyclist" ;
VAL_ 1411 RSDS_L_ObjMotionType_8 0 "Int" 1 "Unknown" 2 "Drive" 3 "Stopped" 4 "Stand" ;
VAL_ 1411 RSDS_L_ObjMeasured_8 0 "Init" 1 "Measured" 2 "Predicted" ;
VAL_ 1411 RSDS_L_ObjMotionDirection_8 0 "Init" 1 "Inversedirection" 2 "Samedirection" 3 "Cross" ;
VAL_ 1411 RSDS_L_ObjRefPoint_8 0 "Rear" 1 "Rearleft" 2 "Left" 3 "Frontleft" 4 "Front" 5 "FrontRight" 6 "Right" 7 "Rearright" ;
VAL_ 1411 RSDS_L_HWATargetValidity_8 0 "NOTHWATarget" 1 "HWATarget" ;
VAL_ 1411 RSDS_L_ObjValid_7 0 "Validvalues" 1 "invalidvalues" ;
VAL_ 1411 RSDS_L_ObjValid_8 0 "Validvalues" 1 "invalidvalues" ;
VAL_ 1412 RSDS_L_ObjType_9 0 "Unknown" 1 "Truck" 2 "Car" 3 "Pedestrian" 4 "Cyclist" ;
VAL_ 1412 RSDS_L_ObjMotionType_9 0 "Int" 1 "Unknown" 2 "Drive" 3 "Stopped" 4 "Stand" ;
VAL_ 1412 RSDS_L_ObjMeasured_9 0 "Init" 1 "Measured" 2 "Predicted" ;
VAL_ 1412 RSDS_L_ObjMotionDirection_9 0 "Init" 1 "Inversedirection" 2 "Samedirection" 3 "Cross" ;
VAL_ 1412 RSDS_L_ObjRefPoint_9 0 "Rear" 1 "Rearleft" 2 "Left" 3 "Frontleft" 4 "Front" 5 "FrontRight" 6 "Right" 7 "Rearright" ;
VAL_ 1412 RSDS_L_HWATargetValidity_9 0 "NOTHWATarget" 1 "HWATarget" ;
VAL_ 1412 RSDS_L_ObjType_10 0 "Unknown" 1 "Truck" 2 "Car" 3 "Pedestrian" 4 "Cyclist" ;
VAL_ 1412 RSDS_L_ObjMotionType_10 0 "Int" 1 "Unknown" 2 "Drive" 3 "Stopped" 4 "Stand" ;
VAL_ 1412 RSDS_L_ObjMeasured_10 0 "Init" 1 "Measured" 2 "Predicted" ;
VAL_ 1412 RSDS_L_ObjMotionDirection_10 0 "Init" 1 "Inversedirection" 2 "Samedirection" 3 "Cross" ;
VAL_ 1412 RSDS_L_ObjRefPoint_10 0 "Rear" 1 "Rearleft" 2 "Left" 3 "Frontleft" 4 "Front" 5 "FrontRight" 6 "Right" 7 "Rearright" ;
VAL_ 1412 RSDS_L_HWATargetValidity_10 0 "NOTHWATarget" 1 "HWATarget" ;
VAL_ 1412 RSDS_L_ObjValid_9 0 "Validvalues" 1 "invalidvalues" ;
VAL_ 1412 RSDS_L_ObjValid_10 0 "Validvalues" 1 "invalidvalues" ;
VAL_ 1413 RSDS_L_ObjType_11 0 "Unknown" 1 "Truck" 2 "Car" 3 "Pedestrian" 4 "Cyclist" ;
VAL_ 1413 RSDS_L_ObjMotionType_11 0 "Int" 1 "Unknown" 2 "Drive" 3 "Stopped" 4 "Stand" ;
VAL_ 1413 RSDS_L_ObjMeasured_11 0 "Init" 1 "Measured" 2 "Predicted" ;
VAL_ 1413 RSDS_L_ObjMotionDirection_11 0 "Init" 1 "Inversedirection" 2 "Samedirection" 3 "Cross" ;
VAL_ 1413 RSDS_L_ObjRefPoint_11 0 "Rear" 1 "Rearleft" 2 "Left" 3 "Frontleft" 4 "Front" 5 "FrontRight" 6 "Right" 7 "Rearright" ;
VAL_ 1413 RSDS_L_HWATargetValidity_11 0 "NOTHWATarget" 1 "HWATarget" ;
VAL_ 1413 RSDS_L_ObjType_12 0 "Unknown" 1 "Truck" 2 "Car" 3 "Pedestrian" 4 "Cyclist" ;
VAL_ 1413 RSDS_L_ObjMotionType_12 0 "Int" 1 "Unknown" 2 "Drive" 3 "Stopped" 4 "Stand" ;
VAL_ 1413 RSDS_L_ObjMeasured_12 0 "Init" 1 "Measured" 2 "Predicted" ;
VAL_ 1413 RSDS_L_ObjMotionDirection_12 0 "Init" 1 "Inversedirection" 2 "Samedirection" 3 "Cross" ;
VAL_ 1413 RSDS_L_ObjRefPoint_12 0 "Rear" 1 "Rearleft" 2 "Left" 3 "Frontleft" 4 "Front" 5 "FrontRight" 6 "Right" 7 "Rearright" ;
VAL_ 1413 RSDS_L_HWATargetValidity_12 0 "NOTHWATarget" 1 "HWATarget" ;
VAL_ 1413 RSDS_L_ObjValid_11 0 "Validvalues" 1 "invalidvalues" ;
VAL_ 1413 RSDS_L_ObjValid_12 0 "Validvalues" 1 "invalidvalues" ;
VAL_ 1414 RSDS_L_ObjType_13 0 "Unknown" 1 "Truck" 2 "Car" 3 "Pedestrian" 4 "Cyclist" ;
VAL_ 1414 RSDS_L_ObjMotionType_13 0 "Int" 1 "Unknown" 2 "Drive" 3 "Stopped" 4 "Stand" ;
VAL_ 1414 RSDS_L_ObjMeasured_13 0 "Init" 1 "Measured" 2 "Predicted" ;
VAL_ 1414 RSDS_L_ObjMotionDirection_13 0 "Init" 1 "Inversedirection" 2 "Samedirection" 3 "Cross" ;
VAL_ 1414 RSDS_L_ObjRefPoint_13 0 "Rear" 1 "Rearleft" 2 "Left" 3 "Frontleft" 4 "Front" 5 "FrontRight" 6 "Right" 7 "Rearright" ;
VAL_ 1414 RSDS_L_HWATargetValidity_13 0 "NOTHWATarget" 1 "HWATarget" ;
VAL_ 1414 RSDS_L_ObjType_14 0 "Unknown" 1 "Truck" 2 "Car" 3 "Pedestrian" 4 "Cyclist" ;
VAL_ 1414 RSDS_L_ObjMotionType_14 0 "Int" 1 "Unknown" 2 "Drive" 3 "Stopped" 4 "Stand" ;
VAL_ 1414 RSDS_L_ObjMeasured_14 0 "Init" 1 "Measured" 2 "Predicted" ;
VAL_ 1414 RSDS_L_ObjMotionDirection_14 0 "Init" 1 "Inversedirection" 2 "Samedirection" 3 "Cross" ;
VAL_ 1414 RSDS_L_ObjRefPoint_14 0 "Rear" 1 "Rearleft" 2 "Left" 3 "Frontleft" 4 "Front" 5 "FrontRight" 6 "Right" 7 "Rearright" ;
VAL_ 1414 RSDS_L_HWATargetValidity_14 0 "NOTHWATarget" 1 "HWATarget" ;
VAL_ 1414 RSDS_L_ObjValid_13 0 "Validvalues" 1 "invalidvalues" ;
VAL_ 1414 RSDS_L_ObjValid_14 0 "Validvalues" 1 "invalidvalues" ;
VAL_ 1415 RSDS_L_ObjType_15 0 "Unknown" 1 "Truck" 2 "Car" 3 "Pedestrian" 4 "Cyclist" ;
VAL_ 1415 RSDS_L_ObjMotionType_15 0 "Int" 1 "Unknown" 2 "Drive" 3 "Stopped" 4 "Stand" ;
VAL_ 1415 RSDS_L_ObjMeasured_15 0 "Init" 1 "Measured" 2 "Predicted" ;
VAL_ 1415 RSDS_L_ObjMotionDirection_15 0 "Init" 1 "Inversedirection" 2 "Samedirection" 3 "Cross" ;
VAL_ 1415 RSDS_L_ObjRefPoint_15 0 "Rear" 1 "Rearleft" 2 "Left" 3 "Frontleft" 4 "Front" 5 "FrontRight" 6 "Right" 7 "Rearright" ;
VAL_ 1415 RSDS_L_HWATargetValidity_15 0 "NOTHWATarget" 1 "HWATarget" ;
VAL_ 1415 RSDS_L_ObjType_16 0 "Unknown" 1 "Truck" 2 "Car" 3 "Pedestrian" 4 "Cyclist" ;
VAL_ 1415 RSDS_L_ObjMotionType_16 0 "Int" 1 "Unknown" 2 "Drive" 3 "Stopped" 4 "Stand" ;
VAL_ 1415 RSDS_L_ObjMeasured_16 0 "Init" 1 "Measured" 2 "Predicted" ;
VAL_ 1415 RSDS_L_ObjMotionDirection_16 0 "Init" 1 "Inversedirection" 2 "Samedirection" 3 "Cross" ;
VAL_ 1415 RSDS_L_ObjRefPoint_16 0 "Rear" 1 "Rearleft" 2 "Left" 3 "Frontleft" 4 "Front" 5 "FrontRight" 6 "Right" 7 "Rearright" ;
VAL_ 1415 RSDS_L_HWATargetValidity_16 0 "NOTHWATarget" 1 "HWATarget" ;
VAL_ 1415 RSDS_L_ObjValid_15 0 "Validvalues" 1 "invalidvalues" ;
VAL_ 1415 RSDS_L_ObjValid_16 0 "Validvalues" 1 "invalidvalues" ;
VAL_ 1424 RSDS_R_ObjType_1 0 "Unknown" 1 "Truck" 2 "Car" 3 "Pedestrian" 4 "Cyclist" ;
VAL_ 1424 RSDS_R_ObjMotionType_1 0 "Int" 1 "Unknown" 2 "Drive" 3 "Stopped" 4 "Stand" ;
VAL_ 1424 RSDS_R_ObjMeasured_1 0 "Init" 1 "Measured" 2 "Predicted" ;
VAL_ 1424 RSDS_R_ObjMotionDirection_1 0 "Init" 1 "Inversedirection" 2 "Samedirection" 3 "Cross" ;
VAL_ 1424 RSDS_R_ObjRefPoint_1 0 "Rear" 1 "Rearleft" 2 "Left" 3 "Frontleft" 4 "Front" 5 "FrontRight" 6 "Right" 7 "Rearright" ;
VAL_ 1424 RSDS_R_HWATargetValidity_1 0 "NOTHWATarget" 1 "HWATarget" ;
VAL_ 1424 RSDS_R_ObjType_2 0 "Unknown" 1 "Truck" 2 "Car" 3 "Pedestrian" 4 "Cyclist" ;
VAL_ 1424 RSDS_R_ObjMotionType_2 0 "Int" 1 "Unknown" 2 "Drive" 3 "Stopped" 4 "Stand" ;
VAL_ 1424 RSDS_R_ObjMeasured_2 0 "Init" 1 "Measured" 2 "Predicted" ;
VAL_ 1424 RSDS_R_ObjMotionDirection_2 0 "Init" 1 "Inversedirection" 2 "Samedirection" 3 "Cross" ;
VAL_ 1424 RSDS_R_ObjRefPoint_2 0 "Rear" 1 "Rearleft" 2 "Left" 3 "Frontleft" 4 "Front" 5 "FrontRight" 6 "Right" 7 "Rearright" ;
VAL_ 1424 RSDS_R_HWATargetValidity_2 0 "NOTHWATarget" 1 "HWATarget" ;
VAL_ 1424 RSDS_R_ObjValid_1 0 "Validvalues" 1 "invalidvalues" ;
VAL_ 1424 RSDS_R_ObjValid_2 0 "Validvalues" 1 "invalidvalues" ;
VAL_ 1425 RSDS_R_ObjType_3 0 "Unknown" 1 "Truck" 2 "Car" 3 "Pedestrian" 4 "Cyclist" ;
VAL_ 1425 RSDS_R_ObjMotionType_3 0 "Int" 1 "Unknown" 2 "Drive" 3 "Stopped" 4 "Stand" ;
VAL_ 1425 RSDS_R_ObjMeasured_3 0 "Init" 1 "Measured" 2 "Predicted" ;
VAL_ 1425 RSDS_R_ObjMotionDirection_3 0 "Init" 1 "Inversedirection" 2 "Samedirection" 3 "Cross" ;
VAL_ 1425 RSDS_R_ObjRefPoint_3 0 "Rear" 1 "Rearleft" 2 "Left" 3 "Frontleft" 4 "Front" 5 "FrontRight" 6 "Right" 7 "Rearright" ;
VAL_ 1425 RSDS_R_HWATargetValidity_3 0 "NOTHWATarget" 1 "HWATarget" ;
VAL_ 1425 RSDS_R_ObjType_4 0 "Unknown" 1 "Truck" 2 "Car" 3 "Pedestrian" 4 "Cyclist" ;
VAL_ 1425 RSDS_R_ObjMotionType_4 0 "Int" 1 "Unknown" 2 "Drive" 3 "Stopped" 4 "Stand" ;
VAL_ 1425 RSDS_R_ObjMeasured_4 0 "Init" 1 "Measured" 2 "Predicted" ;
VAL_ 1425 RSDS_R_ObjMotionDirection_4 0 "Init" 1 "Inversedirection" 2 "Samedirection" 3 "Cross" ;
VAL_ 1425 RSDS_R_ObjRefPoint_4 0 "Rear" 1 "Rearleft" 2 "Left" 3 "Frontleft" 4 "Front" 5 "FrontRight" 6 "Right" 7 "Rearright" ;
VAL_ 1425 RSDS_R_HWATargetValidity_4 0 "NOTHWATarget" 1 "HWATarget" ;
VAL_ 1425 RSDS_R_ObjValid_3 0 "Validvalues" 1 "invalidvalues" ;
VAL_ 1425 RSDS_R_ObjValid_4 0 "Validvalues" 1 "invalidvalues" ;
VAL_ 1426 RSDS_R_ObjType_5 0 "Unknown" 1 "Truck" 2 "Car" 3 "Pedestrian" 4 "Cyclist" ;
VAL_ 1426 RSDS_R_ObjMotionType_5 0 "Int" 1 "Unknown" 2 "Drive" 3 "Stopped" 4 "Stand" ;
VAL_ 1426 RSDS_R_ObjMeasured_5 0 "Init" 1 "Measured" 2 "Predicted" ;
VAL_ 1426 RSDS_R_ObjMotionDirection_5 0 "Init" 1 "Inversedirection" 2 "Samedirection" 3 "Cross" ;
VAL_ 1426 RSDS_R_ObjRefPoint_5 0 "Rear" 1 "Rearleft" 2 "Left" 3 "Frontleft" 4 "Front" 5 "FrontRight" 6 "Right" 7 "Rearright" ;
VAL_ 1426 RSDS_R_HWATargetValidity_5 0 "NOTHWATarget" 1 "HWATarget" ;
VAL_ 1426 RSDS_R_ObjType_6 0 "Unknown" 1 "Truck" 2 "Car" 3 "Pedestrian" 4 "Cyclist" ;
VAL_ 1426 RSDS_R_ObjMotionType_6 0 "Int" 1 "Unknown" 2 "Drive" 3 "Stopped" 4 "Stand" ;
VAL_ 1426 RSDS_R_ObjMeasured_6 0 "Init" 1 "Measured" 2 "Predicted" ;
VAL_ 1426 RSDS_R_ObjMotionDirection_6 0 "Init" 1 "Inversedirection" 2 "Samedirection" 3 "Cross" ;
VAL_ 1426 RSDS_R_ObjRefPoint_6 0 "Rear" 1 "Rearleft" 2 "Left" 3 "Frontleft" 4 "Front" 5 "FrontRight" 6 "Right" 7 "Rearright" ;
VAL_ 1426 RSDS_R_HWATargetValidity_6 0 "NOTHWATarget" 1 "HWATarget" ;
VAL_ 1426 RSDS_R_ObjValid_5 0 "Validvalues" 1 "invalidvalues" ;
VAL_ 1426 RSDS_R_ObjValid_6 0 "Validvalues" 1 "invalidvalues" ;
VAL_ 1427 RSDS_R_ObjType_7 0 "Unknown" 1 "Truck" 2 "Car" 3 "Pedestrian" 4 "Cyclist" ;
VAL_ 1427 RSDS_R_ObjMotionType_7 0 "Int" 1 "Unknown" 2 "Drive" 3 "Stopped" 4 "Stand" ;
VAL_ 1427 RSDS_R_ObjMeasured_7 0 "Init" 1 "Measured" 2 "Predicted" ;
VAL_ 1427 RSDS_R_ObjMotionDirection_7 0 "Init" 1 "Inversedirection" 2 "Samedirection" 3 "Cross" ;
VAL_ 1427 RSDS_R_ObjRefPoint_7 0 "Rear" 1 "Rearleft" 2 "Left" 3 "Frontleft" 4 "Front" 5 "FrontRight" 6 "Right" 7 "Rearright" ;
VAL_ 1427 RSDS_R_HWATargetValidity_7 0 "NOTHWATarget" 1 "HWATarget" ;
VAL_ 1427 RSDS_R_ObjType_8 0 "Unknown" 1 "Truck" 2 "Car" 3 "Pedestrian" 4 "Cyclist" ;
VAL_ 1427 RSDS_R_ObjMotionType_8 0 "Int" 1 "Unknown" 2 "Drive" 3 "Stopped" 4 "Stand" ;
VAL_ 1427 RSDS_R_ObjMeasured_8 0 "Init" 1 "Measured" 2 "Predicted" ;
VAL_ 1427 RSDS_R_ObjMotionDirection_8 0 "Init" 1 "Inversedirection" 2 "Samedirection" 3 "Cross" ;
VAL_ 1427 RSDS_R_ObjRefPoint_8 0 "Rear" 1 "Rearleft" 2 "Left" 3 "Frontleft" 4 "Front" 5 "FrontRight" 6 "Right" 7 "Rearright" ;
VAL_ 1427 RSDS_R_HWATargetValidity_8 0 "NOTHWATarget" 1 "HWATarget" ;
VAL_ 1427 RSDS_R_ObjValid_7 0 "Validvalues" 1 "invalidvalues" ;
VAL_ 1427 RSDS_R_ObjValid_8 0 "Validvalues" 1 "invalidvalues" ;
VAL_ 1428 RSDS_R_ObjType_9 0 "Unknown" 1 "Truck" 2 "Car" 3 "Pedestrian" 4 "Cyclist" ;
VAL_ 1428 RSDS_R_ObjMotionType_9 0 "Int" 1 "Unknown" 2 "Drive" 3 "Stopped" 4 "Stand" ;
VAL_ 1428 RSDS_R_ObjMeasured_9 0 "Init" 1 "Measured" 2 "Predicted" ;
VAL_ 1428 RSDS_R_ObjMotionDirection_9 0 "Init" 1 "Inversedirection" 2 "Samedirection" 3 "Cross" ;
VAL_ 1428 RSDS_R_ObjRefPoint_9 0 "Rear" 1 "Rearleft" 2 "Left" 3 "Frontleft" 4 "Front" 5 "FrontRight" 6 "Right" 7 "Rearright" ;
VAL_ 1428 RSDS_R_HWATargetValidity_9 0 "NOTHWATarget" 1 "HWATarget" ;
VAL_ 1428 RSDS_R_ObjType_10 0 "Unknown" 1 "Truck" 2 "Car" 3 "Pedestrian" 4 "Cyclist" ;
VAL_ 1428 RSDS_R_ObjMotionType_10 0 "Int" 1 "Unknown" 2 "Drive" 3 "Stopped" 4 "Stand" ;
VAL_ 1428 RSDS_R_ObjMeasured_10 0 "Init" 1 "Measured" 2 "Predicted" ;
VAL_ 1428 RSDS_R_ObjMotionDirection_10 0 "Init" 1 "Inversedirection" 2 "Samedirection" 3 "Cross" ;
VAL_ 1428 RSDS_R_ObjRefPoint_10 0 "Rear" 1 "Rearleft" 2 "Left" 3 "Frontleft" 4 "Front" 5 "FrontRight" 6 "Right" 7 "Rearright" ;
VAL_ 1428 RSDS_R_HWATargetValidity_10 0 "NOTHWATarget" 1 "HWATarget" ;
VAL_ 1428 RSDS_R_ObjValid_9 0 "Validvalues" 1 "invalidvalues" ;
VAL_ 1428 RSDS_R_ObjValid_10 0 "Validvalues" 1 "invalidvalues" ;
VAL_ 1429 RSDS_R_ObjType_11 0 "Unknown" 1 "Truck" 2 "Car" 3 "Pedestrian" 4 "Cyclist" ;
VAL_ 1429 RSDS_R_ObjMotionType_11 0 "Int" 1 "Unknown" 2 "Drive" 3 "Stopped" 4 "Stand" ;
VAL_ 1429 RSDS_R_ObjMeasured_11 0 "Init" 1 "Measured" 2 "Predicted" ;
VAL_ 1429 RSDS_R_ObjMotionDirection_11 0 "Init" 1 "Inversedirection" 2 "Samedirection" 3 "Cross" ;
VAL_ 1429 RSDS_R_ObjRefPoint_11 0 "Rear" 1 "Rearleft" 2 "Left" 3 "Frontleft" 4 "Front" 5 "FrontRight" 6 "Right" 7 "Rearright" ;
VAL_ 1429 RSDS_R_HWATargetValidity_11 0 "NOTHWATarget" 1 "HWATarget" ;
VAL_ 1429 RSDS_R_ObjType_12 0 "Unknown" 1 "Truck" 2 "Car" 3 "Pedestrian" 4 "Cyclist" ;
VAL_ 1429 RSDS_R_ObjMotionType_12 0 "Int" 1 "Unknown" 2 "Drive" 3 "Stopped" 4 "Stand" ;
VAL_ 1429 RSDS_R_ObjMeasured_12 0 "Init" 1 "Measured" 2 "Predicted" ;
VAL_ 1429 RSDS_R_ObjMotionDirection_12 0 "Init" 1 "Inversedirection" 2 "Samedirection" 3 "Cross" ;
VAL_ 1429 RSDS_R_ObjRefPoint_12 0 "Rear" 1 "Rearleft" 2 "Left" 3 "Frontleft" 4 "Front" 5 "FrontRight" 6 "Right" 7 "Rearright" ;
VAL_ 1429 RSDS_R_HWATargetValidity_12 0 "NOTHWATarget" 1 "HWATarget" ;
VAL_ 1429 RSDS_R_ObjValid_11 0 "Validvalues" 1 "invalidvalues" ;
VAL_ 1429 RSDS_R_ObjValid_12 0 "Validvalues" 1 "invalidvalues" ;
VAL_ 1430 RSDS_R_ObjType_13 0 "Unknown" 1 "Truck" 2 "Car" 3 "Pedestrian" 4 "Cyclist" ;
VAL_ 1430 RSDS_R_ObjMotionType_13 0 "Int" 1 "Unknown" 2 "Drive" 3 "Stopped" 4 "Stand" ;
VAL_ 1430 RSDS_R_ObjMeasured_13 0 "Init" 1 "Measured" 2 "Predicted" ;
VAL_ 1430 RSDS_R_ObjMotionDirection_13 0 "Init" 1 "Inversedirection" 2 "Samedirection" 3 "Cross" ;
VAL_ 1430 RSDS_R_ObjRefPoint_13 0 "Rear" 1 "Rearleft" 2 "Left" 3 "Frontleft" 4 "Front" 5 "FrontRight" 6 "Right" 7 "Rearright" ;
VAL_ 1430 RSDS_R_HWATargetValidity_13 0 "NOTHWATarget" 1 "HWATarget" ;
VAL_ 1430 RSDS_R_ObjType_14 0 "Unknown" 1 "Truck" 2 "Car" 3 "Pedestrian" 4 "Cyclist" ;
VAL_ 1430 RSDS_R_ObjMotionType_14 0 "Int" 1 "Unknown" 2 "Drive" 3 "Stopped" 4 "Stand" ;
VAL_ 1430 RSDS_R_ObjMeasured_14 0 "Init" 1 "Measured" 2 "Predicted" ;
VAL_ 1430 RSDS_R_ObjMotionDirection_14 0 "Init" 1 "Inversedirection" 2 "Samedirection" 3 "Cross" ;
VAL_ 1430 RSDS_R_ObjRefPoint_14 0 "Rear" 1 "Rearleft" 2 "Left" 3 "Frontleft" 4 "Front" 5 "FrontRight" 6 "Right" 7 "Rearright" ;
VAL_ 1430 RSDS_R_HWATargetValidity_14 0 "NOTHWATarget" 1 "HWATarget" ;
VAL_ 1430 RSDS_R_ObjValid_13 0 "Validvalues" 1 "invalidvalues" ;
VAL_ 1430 RSDS_R_ObjValid_14 0 "Validvalues" 1 "invalidvalues" ;
VAL_ 1431 RSDS_R_ObjType_15 0 "Unknown" 1 "Truck" 2 "Car" 3 "Pedestrian" 4 "Cyclist" ;
VAL_ 1431 RSDS_R_ObjMotionType_15 0 "Int" 1 "Unknown" 2 "Drive" 3 "Stopped" 4 "Stand" ;
VAL_ 1431 RSDS_R_ObjMeasured_15 0 "Init" 1 "Measured" 2 "Predicted" ;
VAL_ 1431 RSDS_R_ObjMotionDirection_15 0 "Init" 1 "Inversedirection" 2 "Samedirection" 3 "Cross" ;
VAL_ 1431 RSDS_R_ObjRefPoint_15 0 "Rear" 1 "Rearleft" 2 "Left" 3 "Frontleft" 4 "Front" 5 "FrontRight" 6 "Right" 7 "Rearright" ;
VAL_ 1431 RSDS_R_HWATargetValidity_15 0 "NOTHWATarget" 1 "HWATarget" ;
VAL_ 1431 RSDS_R_ObjType_16 0 "Unknown" 1 "Truck" 2 "Car" 3 "Pedestrian" 4 "Cyclist" ;
VAL_ 1431 RSDS_R_ObjMotionType_16 0 "Int" 1 "Unknown" 2 "Drive" 3 "Stopped" 4 "Stand" ;
VAL_ 1431 RSDS_R_ObjMeasured_16 0 "Init" 1 "Measured" 2 "Predicted" ;
VAL_ 1431 RSDS_R_ObjMotionDirection_16 0 "Init" 1 "Inversedirection" 2 "Samedirection" 3 "Cross" ;
VAL_ 1431 RSDS_R_ObjRefPoint_16 0 "Rear" 1 "Rearleft" 2 "Left" 3 "Frontleft" 4 "Front" 5 "FrontRight" 6 "Right" 7 "Rearright" ;
VAL_ 1431 RSDS_R_HWATargetValidity_16 0 "NOTHWATarget" 1 "HWATarget" ;
VAL_ 1431 RSDS_R_ObjValid_15 0 "Validvalues" 1 "invalidvalues" ;
VAL_ 1431 RSDS_R_ObjValid_16 0 "Validvalues" 1 "invalidvalues" ;
VAL_ 1416 RSDS_L_ObjType_17 0 "Unknown" 1 "Truck" 2 "Car" 3 "Pedestrian" 4 "Cyclist" ;
VAL_ 1416 RSDS_L_ObjMotionType_17 0 "InitialValue" 1 "Unknown" 2 "Drive" 3 "Stopped" 4 "Stand" ;
VAL_ 1416 RSDS_L_ObjMeasured_17 0 "InitialValue" 1 "Measured" 2 "Predicted" ;
VAL_ 1416 RSDS_L_ObjMotionDirection_17 0 "InitialValue" 1 "Inversedirection" 2 "Samedirection" 3 "Cross" ;
VAL_ 1416 RSDS_L_ObjRefPoint_17 0 "Rear" 1 "Rearleft" 2 "Left" 3 "Frontleft" 4 "Front" 5 "FrontRight" 6 "Right" 7 "Rearright" ;
VAL_ 1416 RSDS_L_HWATargetValidity_17 0 "NOTHWATarget" 1 "HWATarget" ;
VAL_ 1416 RSDS_L_ObjType_18 0 "Unknown" 1 "Truck" 2 "Car" 3 "Pedestrian" 4 "Cyclist" ;
VAL_ 1416 RSDS_L_ObjMotionType_18 0 "InitialValue" 1 "Unknown" 2 "Drive" 3 "Stopped" 4 "Stand" ;
VAL_ 1416 RSDS_L_ObjMeasured_18 0 "InitialValue" 1 "Measured" 2 "Predicted" ;
VAL_ 1416 RSDS_L_ObjMotionDirection_18 0 "InitialValue" 1 "Inversedirection" 2 "Samedirection" 3 "Cross" ;
VAL_ 1416 RSDS_L_ObjRefPoint_18 0 "Rear" 1 "Rearleft" 2 "Left" 3 "Frontleft" 4 "Front" 5 "FrontRight" 6 "Right" 7 "Rearright" ;
VAL_ 1416 RSDS_L_HWATargetValidity_18 0 "NOTHWATarget" 1 "HWATarget" ;
VAL_ 1416 RSDS_L_ObjValid_17 0 "Validvalues" 1 "invalidvalues" ;
VAL_ 1416 RSDS_L_ObjValid_18 0 "Validvalues" 1 "invalidvalues" ;
