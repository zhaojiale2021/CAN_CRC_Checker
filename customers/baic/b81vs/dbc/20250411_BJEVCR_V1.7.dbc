VERSION ""

NS_ :

BS_:

BU_: CR_RR CR_RL MPC

BO_ 1417 RSDS_L_SGU10: 64 CR_RL
 SG_ RSDS_L_ObjID_19 : 71|8@0+ (1,0) [0|255] ""  MPC
 SG_ RSDS_L_ObjExistProb_19 : 124|5@0+ (0.03326,0) [0|1] ""  MPC
 SG_ RSDS_L_ObjObstacleProb_19 : 135|5@0+ (0.03326,0) [0|1] ""  MPC
 SG_ RSDS_L_ObjDistX_19 : 187|12@0+ (0.0625,-128) [-128|127.9375] "m"  MPC
 SG_ RSDS_L_ObjDistY_19 : 33|11@0+ (0.125,-128) [-128|127.875] "m"  MPC
 SG_ RSDS_L_ObjDistXStd_19 : 54|6@0+ (0.1,0) [0|6] "m"  MPC
 SG_ RSDS_L_ObjType_19 : 63|4@0+ (1,0) [0|15] ""  MPC
 SG_ RSDS_L_ObjRelVelX_19 : 79|13@0+ (0.0312,-128) [-128|126.9976] "mps"  MPC
 SG_ RSDS_L_ObjRelVelY_19 : 82|13@0+ (0.0312,-128) [-128|126.9976] "mps"  MPC
 SG_ RSDS_L_ObjRelAccelX_19 : 101|10@0+ (0.03125,-16) [-16|15.96875] "mps2"  MPC
 SG_ RSDS_L_ObjRelAccelY_19 : 107|10@0+ (0.03125,-16) [-16|15.96875] "mps2"  MPC
 SG_ RSDS_L_ObjMotionType_19 : 127|3@0+ (1,0) [0|7] ""  MPC
 SG_ RSDS_L_ObjMeasured_19 : 113|2@0+ (1,0) [0|3] ""  MPC
 SG_ RSDS_L_ObjDistYStd_19 : 143|6@0+ (0.1,0) [0|6] "m"  MPC
 SG_ RSDS_L_ObjRelVelXStd_19 : 137|6@0+ (0.0625,0) [0|3.9375] "mps"  MPC
 SG_ RSDS_L_ObjRelVelYStd_19 : 147|6@0+ (0.0625,0) [0|3.9375] "mps"  MPC
 SG_ RSDS_L_ObjRAccelXStd_19 : 157|6@0+ (0.0625,0) [0|3.9375] "mps2"  MPC
 SG_ RSDS_L_ObjRAccelYStd_19 : 167|6@0+ (0.0625,0) [0|3.9375] "mps2"  MPC
 SG_ RSDS_L_ObjWidth_19 : 161|10@0+ (0.01,0) [0|5] "m"  MPC
 SG_ RSDS_L_ObjMotionDirection_19 : 191|3@0+ (1,0) [0|7] ""  MPC
 SG_ RSDS_L_ObjAge_19 : 183|8@0+ (1,0) [0|255] ""  MPC
 SG_ RSDS_L_ObjLength_19 : 207|10@0+ (0.05,0) [0|20] "m"  MPC
 SG_ RSDS_L_ObjHeading_19 : 213|12@0+ (0.002,-3.14) [-3.14|3.14] "rad"  MPC
 SG_ RSDS_L_ObjYawrate_19 : 217|12@0+ (0.002,-3.14) [-3.14|3.14] "rad/s"  MPC
 SG_ RSDS_L_ObjRCS_19 : 237|10@0+ (0.125,-50) [-50|70] "dBm2"  MPC
 SG_ RSDS_L_ObjRefPoint_19 : 243|3@0+ (1,0) [0|7] ""  MPC
 SG_ RSDS_L_HWATargetValidity_19 : 240|1@0+ (1,0) [0|1] ""  MPC
 SG_ RSDS_L_ObjID_20 : 271|8@0+ (1,0) [0|255] ""  MPC
 SG_ RSDS_L_ObjExistProb_20 : 279|5@0+ (0.03326,0) [0|1] ""  MPC
 SG_ RSDS_L_ObjObstacleProb_20 : 274|5@0+ (0.03326,0) [0|1] ""  MPC
 SG_ RSDS_L_ObjDistX_20 : 285|12@0+ (0.0625,-128) [-128|127.9375] "m"  MPC
 SG_ RSDS_L_ObjDistY_20 : 289|11@0+ (0.125,-128) [-128|127.875] "m"  MPC
 SG_ RSDS_L_ObjDistXStd_20 : 310|6@0+ (0.1,0) [0|6] "m"  MPC
 SG_ RSDS_L_ObjType_20 : 319|4@0+ (1,0) [0|15] ""  MPC
 SG_ RSDS_L_ObjRelVelX_20 : 335|13@0+ (0.0312,-128) [-128|126.9976] "mps"  MPC
 SG_ RSDS_L_ObjRelVelY_20 : 338|13@0+ (0.0312,-128) [-128|126.9976] "mps"  MPC
 SG_ RSDS_L_ObjRelAccelX_20 : 357|10@0+ (0.03125,-16) [-16|15.96875] "mps2"  MPC
 SG_ RSDS_L_ObjRelAccelY_20 : 363|10@0+ (0.03125,-16) [-16|15.96875] "mps2"  MPC
 SG_ RSDS_L_ObjMotionType_20 : 383|3@0+ (1,0) [0|7] ""  MPC
 SG_ RSDS_L_ObjMeasured_20 : 369|2@0+ (1,0) [0|3] ""  MPC
 SG_ RSDS_L_ObjDistYStd_20 : 399|6@0+ (0.1,0) [0|6] "m"  MPC
 SG_ RSDS_L_ObjRelVelXStd_20 : 393|6@0+ (0.0625,0) [0|3.9375] "mps"  MPC
 SG_ RSDS_L_ObjRelVelYStd_20 : 403|6@0+ (0.0625,0) [0|3.9375] "mps"  MPC
 SG_ RSDS_L_ObjRAccelXStd_20 : 413|6@0+ (0.0625,0) [0|3.9375] "mps2"  MPC
 SG_ RSDS_L_ObjRAccelYStd_20 : 423|6@0+ (0.0625,0) [0|3.9375] "mps2"  MPC
 SG_ RSDS_L_ObjWidth_20 : 417|10@0+ (0.01,0) [0|5] "m"  MPC
 SG_ RSDS_L_ObjMotionDirection_20 : 447|3@0+ (1,0) [0|7] ""  MPC
 SG_ RSDS_L_ObjAge_20 : 439|8@0+ (1,0) [0|255] ""  MPC
 SG_ RSDS_L_ObjLength_20 : 463|10@0+ (0.05,0) [0|20] "m"  MPC
 SG_ RSDS_L_ObjHeading_20 : 469|12@0+ (0.002,-3.14) [-3.14|3.14] "rad"  MPC
 SG_ RSDS_L_ObjYawrate_20 : 473|12@0+ (0.002,-3.14) [-3.14|3.14] "rad/s"  MPC
 SG_ RSDS_L_ObjRCS_20 : 493|10@0+ (0.125,-50) [-50|70] "dBm2"  MPC
 SG_ RSDS_L_ObjRefPoint_20 : 499|3@0+ (1,0) [0|7] ""  MPC
 SG_ RSDS_L_HWATargetValidity_20 : 496|1@0+ (1,0) [0|1] ""  MPC
 SG_ RSDS_L_SGU10_BlockCounter : 511|4@0+ (1,0) [0|15] ""  MPC
 SG_ RSDS_L_ObjValid_19 : 252|1@0+ (1,0) [0|1] ""  MPC
 SG_ RSDS_L_ObjValid_20 : 253|1@0+ (1,0) [0|1] ""  MPC
 SG_ Checksum589 : 7|16@0+ (1,0) [0|65535] ""  MPC
 SG_ RollingCounter589 : 23|8@0+ (1,0) [0|255] ""  MPC
 SG_ RSDS_L_ObjHYAS_Reserved_19 : 261|6@0+ (0.017,0) [0|1.071] ""  MPC
 SG_ RSDS_L_ObjHYAS_Reserved_20 : 251|6@0+ (0.017,0) [0|1.071] ""  MPC
 SG_ RSDS_L_ObjTypeProb_19 : 325|6@0+ (2,0) [0|100] "%"  MPC
 SG_ RSDS_L_ObjTypeProb_20 : 315|6@0+ (2,0) [0|100] "%"  MPC
 SG_ RSDS_L_ObjHeight_19 : 31|10@0+ (0.01,0) [0|6] "m"  MPC
 SG_ RSDS_L_ObjHeight_20 : 379|10@0+ (0.01,0) [0|6] "m"  MPC

BO_ 1418 RSDS_L_SGU11: 64 CR_RL
 SG_ RSDS_L_ObjID_21 : 71|8@0+ (1,0) [0|255] ""  MPC
 SG_ RSDS_L_ObjExistProb_21 : 124|5@0+ (0.03326,0) [0|1] ""  MPC
 SG_ RSDS_L_ObjObstacleProb_21 : 135|5@0+ (0.03326,0) [0|1] ""  MPC
 SG_ RSDS_L_ObjDistX_21 : 187|12@0+ (0.0625,-128) [-128|127.9375] "m"  MPC
 SG_ RSDS_L_ObjDistY_21 : 33|11@0+ (0.125,-128) [-128|127.875] "m"  MPC
 SG_ RSDS_L_ObjDistXStd_21 : 54|6@0+ (0.1,0) [0|6] "m"  MPC
 SG_ RSDS_L_ObjType_21 : 63|4@0+ (1,0) [0|15] ""  MPC
 SG_ RSDS_L_ObjRelVelX_21 : 79|13@0+ (0.0312,-128) [-128|126.9976] "mps"  MPC
 SG_ RSDS_L_ObjRelVelY_21 : 82|13@0+ (0.0312,-128) [-128|126.9976] "mps"  MPC
 SG_ RSDS_L_ObjRelAccelX_21 : 101|10@0+ (0.03125,-16) [-16|15.96875] "mps2"  MPC
 SG_ RSDS_L_ObjRelAccelY_21 : 107|10@0+ (0.03125,-16) [-16|15.96875] "mps2"  MPC
 SG_ RSDS_L_ObjMotionType_21 : 127|3@0+ (1,0) [0|7] ""  MPC
 SG_ RSDS_L_ObjMeasured_21 : 113|2@0+ (1,0) [0|3] ""  MPC
 SG_ RSDS_L_ObjDistYStd_21 : 143|6@0+ (0.1,0) [0|6] "m"  MPC
 SG_ RSDS_L_ObjRelVelXStd_21 : 137|6@0+ (0.0625,0) [0|3.9375] "mps"  MPC
 SG_ RSDS_L_ObjRelVelYStd_21 : 147|6@0+ (0.0625,0) [0|3.9375] "mps"  MPC
 SG_ RSDS_L_ObjRAccelXStd_21 : 157|6@0+ (0.0625,0) [0|3.9375] "mps2"  MPC
 SG_ RSDS_L_ObjRAccelYStd_21 : 167|6@0+ (0.0625,0) [0|3.9375] "mps2"  MPC
 SG_ RSDS_L_ObjWidth_21 : 161|10@0+ (0.01,0) [0|5] "m"  MPC
 SG_ RSDS_L_ObjMotionDirection_21 : 191|3@0+ (1,0) [0|7] ""  MPC
 SG_ RSDS_L_ObjAge_21 : 183|8@0+ (1,0) [0|255] ""  MPC
 SG_ RSDS_L_ObjLength_21 : 207|10@0+ (0.05,0) [0|20] "m"  MPC
 SG_ RSDS_L_ObjHeading_21 : 213|12@0+ (0.002,-3.14) [-3.14|3.14] "rad"  MPC
 SG_ RSDS_L_ObjYawrate_21 : 217|12@0+ (0.002,-3.14) [-3.14|3.14] "rad/s"  MPC
 SG_ RSDS_L_ObjRCS_21 : 237|10@0+ (0.125,-50) [-50|70] "dBm2"  MPC
 SG_ RSDS_L_ObjRefPoint_21 : 243|3@0+ (1,0) [0|7] ""  MPC
 SG_ RSDS_L_HWATargetValidity_21 : 240|1@0+ (1,0) [0|1] ""  MPC
 SG_ RSDS_L_ObjID_22 : 271|8@0+ (1,0) [0|255] ""  MPC
 SG_ RSDS_L_ObjExistProb_22 : 279|5@0+ (0.03326,0) [0|1] ""  MPC
 SG_ RSDS_L_ObjObstacleProb_22 : 274|5@0+ (0.03326,0) [0|1] ""  MPC
 SG_ RSDS_L_ObjDistX_22 : 285|12@0+ (0.0625,-128) [-128|127.9375] "m"  MPC
 SG_ RSDS_L_ObjDistY_22 : 289|11@0+ (0.125,-128) [-128|127.875] "m"  MPC
 SG_ RSDS_L_ObjDistXStd_22 : 310|6@0+ (0.1,0) [0|6] "m"  MPC
 SG_ RSDS_L_ObjType_22 : 319|4@0+ (1,0) [0|15] ""  MPC
 SG_ RSDS_L_ObjRelVelX_22 : 335|13@0+ (0.0312,-128) [-128|126.9976] "mps"  MPC
 SG_ RSDS_L_ObjRelVelY_22 : 338|13@0+ (0.0312,-128) [-128|126.9976] "mps"  MPC
 SG_ RSDS_L_ObjRelAccelX_22 : 357|10@0+ (0.03125,-16) [-16|15.96875] "mps2"  MPC
 SG_ RSDS_L_ObjRelAccelY_22 : 363|10@0+ (0.03125,-16) [-16|15.96875] "mps2"  MPC
 SG_ RSDS_L_ObjMotionType_22 : 383|3@0+ (1,0) [0|7] ""  MPC
 SG_ RSDS_L_ObjMeasured_22 : 369|2@0+ (1,0) [0|3] ""  MPC
 SG_ RSDS_L_ObjDistYStd_22 : 399|6@0+ (0.1,0) [0|6] "m"  MPC
 SG_ RSDS_L_ObjRelVelXStd_22 : 393|6@0+ (0.0625,0) [0|3.9375] "mps"  MPC
 SG_ RSDS_L_ObjRelVelYStd_22 : 403|6@0+ (0.0625,0) [0|3.9375] "mps"  MPC
 SG_ RSDS_L_ObjRAccelXStd_22 : 413|6@0+ (0.0625,0) [0|3.9375] "mps2"  MPC
 SG_ RSDS_L_ObjRAccelYStd_22 : 423|6@0+ (0.0625,0) [0|3.9375] "mps2"  MPC
 SG_ RSDS_L_ObjWidth_22 : 417|10@0+ (0.01,0) [0|5] "m"  MPC
 SG_ RSDS_L_ObjMotionDirection_22 : 447|3@0+ (1,0) [0|7] ""  MPC
 SG_ RSDS_L_ObjAge_22 : 439|8@0+ (1,0) [0|255] ""  MPC
 SG_ RSDS_L_ObjLength_22 : 463|10@0+ (0.05,0) [0|20] "m"  MPC
 SG_ RSDS_L_ObjHeading_22 : 469|12@0+ (0.002,-3.14) [-3.14|3.14] "rad"  MPC
 SG_ RSDS_L_ObjYawrate_22 : 473|12@0+ (0.002,-3.14) [-3.14|3.14] "rad/s"  MPC
 SG_ RSDS_L_ObjRCS_22 : 493|10@0+ (0.125,-50) [-50|70] "dBm2"  MPC
 SG_ RSDS_L_ObjRefPoint_22 : 499|3@0+ (1,0) [0|7] ""  MPC
 SG_ RSDS_L_HWATargetValidity_22 : 496|1@0+ (1,0) [0|1] ""  MPC
 SG_ RSDS_L_SGU11_BlockCounter : 511|4@0+ (1,0) [0|15] ""  MPC
 SG_ RSDS_L_ObjValid_21 : 252|1@0+ (1,0) [0|1] ""  MPC
 SG_ RSDS_L_ObjValid_22 : 253|1@0+ (1,0) [0|1] ""  MPC
 SG_ Checksum58A : 7|16@0+ (1,0) [0|65535] ""  MPC
 SG_ RollingCounter58A : 23|8@0+ (1,0) [0|255] ""  MPC
 SG_ RSDS_L_ObjHYAS_Reserved_21 : 261|6@0+ (0.017,0) [0|1.071] ""  MPC
 SG_ RSDS_L_ObjHYAS_Reserved_22 : 251|6@0+ (0.017,0) [0|1.071] ""  MPC
 SG_ RSDS_L_ObjTypeProb_21 : 325|6@0+ (2,0) [0|100] "%"  MPC
 SG_ RSDS_L_ObjTypeProb_22 : 315|6@0+ (2,0) [0|100] "%"  MPC
 SG_ RSDS_L_ObjHeight_21 : 31|10@0+ (0.01,0) [0|6] "m"  MPC
 SG_ RSDS_L_ObjHeight_22 : 379|10@0+ (0.01,0) [0|6] "m"  MPC

BO_ 1419 RSDS_L_SGU12: 64 CR_RL
 SG_ RSDS_L_ObjID_23 : 71|8@0+ (1,0) [0|255] ""  MPC
 SG_ RSDS_L_ObjExistProb_23 : 124|5@0+ (0.03326,0) [0|1] ""  MPC
 SG_ RSDS_L_ObjObstacleProb_23 : 135|5@0+ (0.03326,0) [0|1] ""  MPC
 SG_ RSDS_L_ObjDistX_23 : 187|12@0+ (0.0625,-128) [-128|127.9375] "m"  MPC
 SG_ RSDS_L_ObjDistY_23 : 33|11@0+ (0.125,-128) [-128|127.875] "m"  MPC
 SG_ RSDS_L_ObjDistXStd_23 : 54|6@0+ (0.1,0) [0|6] "m"  MPC
 SG_ RSDS_L_ObjType_23 : 63|4@0+ (1,0) [0|15] ""  MPC
 SG_ RSDS_L_ObjRelVelX_23 : 79|13@0+ (0.0312,-128) [-128|126.9976] "mps"  MPC
 SG_ RSDS_L_ObjRelVelY_23 : 82|13@0+ (0.0312,-128) [-128|126.9976] "mps"  MPC
 SG_ RSDS_L_ObjRelAccelX_23 : 101|10@0+ (0.03125,-16) [-16|15.96875] "mps2"  MPC
 SG_ RSDS_L_ObjRelAccelY_23 : 107|10@0+ (0.03125,-16) [-16|15.96875] "mps2"  MPC
 SG_ RSDS_L_ObjMotionType_23 : 127|3@0+ (1,0) [0|7] ""  MPC
 SG_ RSDS_L_ObjMeasured_23 : 113|2@0+ (1,0) [0|3] ""  MPC
 SG_ RSDS_L_ObjDistYStd_23 : 143|6@0+ (0.1,0) [0|6] "m"  MPC
 SG_ RSDS_L_ObjRelVelXStd_23 : 137|6@0+ (0.0625,0) [0|3.9375] "mps"  MPC
 SG_ RSDS_L_ObjRelVelYStd_23 : 147|6@0+ (0.0625,0) [0|3.9375] "mps"  MPC
 SG_ RSDS_L_ObjRAccelXStd_23 : 157|6@0+ (0.0625,0) [0|3.9375] "mps2"  MPC
 SG_ RSDS_L_ObjRAccelYStd_23 : 167|6@0+ (0.0625,0) [0|3.9375] "mps2"  MPC
 SG_ RSDS_L_ObjWidth_23 : 161|10@0+ (0.01,0) [0|5] "m"  MPC
 SG_ RSDS_L_ObjMotionDirection_23 : 191|3@0+ (1,0) [0|7] ""  MPC
 SG_ RSDS_L_ObjAge_23 : 183|8@0+ (1,0) [0|255] ""  MPC
 SG_ RSDS_L_ObjLength_23 : 207|10@0+ (0.05,0) [0|20] "m"  MPC
 SG_ RSDS_L_ObjHeading_23 : 213|12@0+ (0.002,-3.14) [-3.14|3.14] "rad"  MPC
 SG_ RSDS_L_ObjYawrate_23 : 217|12@0+ (0.002,-3.14) [-3.14|3.14] "rad/s"  MPC
 SG_ RSDS_L_ObjRCS_23 : 237|10@0+ (0.125,-50) [-50|70] "dBm2"  MPC
 SG_ RSDS_L_ObjRefPoint_23 : 243|3@0+ (1,0) [0|7] ""  MPC
 SG_ RSDS_L_HWATargetValidity_23 : 240|1@0+ (1,0) [0|1] ""  MPC
 SG_ RSDS_L_ObjID_24 : 271|8@0+ (1,0) [0|255] ""  MPC
 SG_ RSDS_L_ObjExistProb_24 : 279|5@0+ (0.03326,0) [0|1] ""  MPC
 SG_ RSDS_L_ObjObstacleProb_24 : 274|5@0+ (0.03326,0) [0|1] ""  MPC
 SG_ RSDS_L_ObjDistX_24 : 285|12@0+ (0.0625,-128) [-128|127.9375] "m"  MPC
 SG_ RSDS_L_ObjDistY_24 : 289|11@0+ (0.125,-128) [-128|127.875] "m"  MPC
 SG_ RSDS_L_ObjDistXStd_24 : 310|6@0+ (0.1,0) [0|6] "m"  MPC
 SG_ RSDS_L_ObjType_24 : 319|4@0+ (1,0) [0|15] ""  MPC
 SG_ RSDS_L_ObjRelVelX_24 : 335|13@0+ (0.0312,-128) [-128|126.9976] "mps"  MPC
 SG_ RSDS_L_ObjRelVelY_24 : 338|13@0+ (0.0312,-128) [-128|126.9976] "mps"  MPC
 SG_ RSDS_L_ObjRelAccelX_24 : 357|10@0+ (0.03125,-16) [-16|15.96875] "mps2"  MPC
 SG_ RSDS_L_ObjRelAccelY_24 : 363|10@0+ (0.03125,-16) [-16|15.96875] "mps2"  MPC
 SG_ RSDS_L_ObjMotionType_24 : 383|3@0+ (1,0) [0|7] ""  MPC
 SG_ RSDS_L_ObjMeasured_24 : 369|2@0+ (1,0) [0|3] ""  MPC
 SG_ RSDS_L_ObjDistYStd_24 : 399|6@0+ (0.1,0) [0|6] "m"  MPC
 SG_ RSDS_L_ObjRelVelXStd_24 : 393|6@0+ (0.0625,0) [0|3.9375] "mps"  MPC
 SG_ RSDS_L_ObjRelVelYStd_24 : 403|6@0+ (0.0625,0) [0|3.9375] "mps"  MPC
 SG_ RSDS_L_ObjRAccelXStd_24 : 413|6@0+ (0.0625,0) [0|3.9375] "mps2"  MPC
 SG_ RSDS_L_ObjRAccelYStd_24 : 423|6@0+ (0.0625,0) [0|3.9375] "mps2"  MPC
 SG_ RSDS_L_ObjWidth_24 : 417|10@0+ (0.01,0) [0|5] "m"  MPC
 SG_ RSDS_L_ObjMotionDirection_24 : 447|3@0+ (1,0) [0|7] ""  MPC
 SG_ RSDS_L_ObjAge_24 : 439|8@0+ (1,0) [0|255] ""  MPC
 SG_ RSDS_L_ObjLength_24 : 463|10@0+ (0.05,0) [0|20] "m"  MPC
 SG_ RSDS_L_ObjHeading_24 : 469|12@0+ (0.002,-3.14) [-3.14|3.14] "rad"  MPC
 SG_ RSDS_L_ObjYawrate_24 : 473|12@0+ (0.002,-3.14) [-3.14|3.14] "rad/s"  MPC
 SG_ RSDS_L_ObjRCS_24 : 493|10@0+ (0.125,-50) [-50|70] "dBm2"  MPC
 SG_ RSDS_L_ObjRefPoint_24 : 499|3@0+ (1,0) [0|7] ""  MPC
 SG_ RSDS_L_HWATargetValidity_24 : 496|1@0+ (1,0) [0|1] ""  MPC
 SG_ RSDS_L_SGU12_BlockCounter : 511|4@0+ (1,0) [0|15] ""  MPC
 SG_ RSDS_L_ObjValid_23 : 252|1@0+ (1,0) [0|1] ""  MPC
 SG_ RSDS_L_ObjValid_24 : 253|1@0+ (1,0) [0|1] ""  MPC
 SG_ Checksum58B : 7|16@0+ (1,0) [0|65535] ""  MPC
 SG_ RollingCounter58B : 23|8@0+ (1,0) [0|255] ""  MPC
 SG_ RSDS_L_ObjHYAS_Reserved_23 : 261|6@0+ (0.017,0) [0|1.071] ""  MPC
 SG_ RSDS_L_ObjHYAS_Reserved_24 : 251|6@0+ (0.017,0) [0|1.071] ""  MPC
 SG_ RSDS_L_ObjTypeProb_23 : 325|6@0+ (2,0) [0|100] "%"  MPC
 SG_ RSDS_L_ObjTypeProb_24 : 315|6@0+ (2,0) [0|100] "%"  MPC
 SG_ RSDS_L_ObjHeight_23 : 31|10@0+ (0.01,0) [0|6] "m"  MPC
 SG_ RSDS_L_ObjHeight_24 : 379|10@0+ (0.01,0) [0|6] "m"  MPC

BO_ 1420 RSDS_L_SGU13: 64 CR_RL
 SG_ RSDS_L_ObjID_25 : 71|8@0+ (1,0) [0|255] ""  MPC
 SG_ RSDS_L_ObjExistProb_25 : 124|5@0+ (0.03326,0) [0|1] ""  MPC
 SG_ RSDS_L_ObjObstacleProb_25 : 135|5@0+ (0.03326,0) [0|1] ""  MPC
 SG_ RSDS_L_ObjDistX_25 : 187|12@0+ (0.0625,-128) [-128|127.9375] "m"  MPC
 SG_ RSDS_L_ObjDistY_25 : 33|11@0+ (0.125,-128) [-128|127.875] "m"  MPC
 SG_ RSDS_L_ObjDistXStd_25 : 54|6@0+ (0.1,0) [0|6] "m"  MPC
 SG_ RSDS_L_ObjType_25 : 63|4@0+ (1,0) [0|15] ""  MPC
 SG_ RSDS_L_ObjRelVelX_25 : 79|13@0+ (0.0312,-128) [-128|126.9976] "mps"  MPC
 SG_ RSDS_L_ObjRelVelY_25 : 82|13@0+ (0.0312,-128) [-128|126.9976] "mps"  MPC
 SG_ RSDS_L_ObjRelAccelX_25 : 101|10@0+ (0.03125,-16) [-16|15.96875] "mps2"  MPC
 SG_ RSDS_L_ObjRelAccelY_25 : 107|10@0+ (0.03125,-16) [-16|15.96875] "mps2"  MPC
 SG_ RSDS_L_ObjMotionType_25 : 127|3@0+ (1,0) [0|7] ""  MPC
 SG_ RSDS_L_ObjMeasured_25 : 113|2@0+ (1,0) [0|3] ""  MPC
 SG_ RSDS_L_ObjDistYStd_25 : 143|6@0+ (0.1,0) [0|6] "m"  MPC
 SG_ RSDS_L_ObjRelVelXStd_25 : 137|6@0+ (0.0625,0) [0|3.9375] "mps"  MPC
 SG_ RSDS_L_ObjRelVelYStd_25 : 147|6@0+ (0.0625,0) [0|3.9375] "mps"  MPC
 SG_ RSDS_L_ObjRAccelXStd_25 : 157|6@0+ (0.0625,0) [0|3.9375] "mps2"  MPC
 SG_ RSDS_L_ObjRAccelYStd_25 : 167|6@0+ (0.0625,0) [0|3.9375] "mps2"  MPC
 SG_ RSDS_L_ObjWidth_25 : 161|10@0+ (0.01,0) [0|5] "m"  MPC
 SG_ RSDS_L_ObjMotionDirection_25 : 191|3@0+ (1,0) [0|7] ""  MPC
 SG_ RSDS_L_ObjAge_25 : 183|8@0+ (1,0) [0|255] ""  MPC
 SG_ RSDS_L_ObjLength_25 : 207|10@0+ (0.05,0) [0|20] "m"  MPC
 SG_ RSDS_L_ObjHeading_25 : 213|12@0+ (0.002,-3.14) [-3.14|3.14] "rad"  MPC
 SG_ RSDS_L_ObjYawrate_25 : 217|12@0+ (0.002,-3.14) [-3.14|3.14] "rad/s"  MPC
 SG_ RSDS_L_ObjRCS_25 : 237|10@0+ (0.125,-50) [-50|70] "dBm2"  MPC
 SG_ RSDS_L_ObjRefPoint_25 : 243|3@0+ (1,0) [0|7] ""  MPC
 SG_ RSDS_L_HWATargetValidity_25 : 240|1@0+ (1,0) [0|1] ""  MPC
 SG_ RSDS_L_ObjID_26 : 271|8@0+ (1,0) [0|255] ""  MPC
 SG_ RSDS_L_ObjExistProb_26 : 279|5@0+ (0.03326,0) [0|1] ""  MPC
 SG_ RSDS_L_ObjObstacleProb_26 : 274|5@0+ (0.03326,0) [0|1] ""  MPC
 SG_ RSDS_L_ObjDistX_26 : 285|12@0+ (0.0625,-128) [-128|127.9375] "m"  MPC
 SG_ RSDS_L_ObjDistY_26 : 289|11@0+ (0.125,-128) [-128|127.875] "m"  MPC
 SG_ RSDS_L_ObjDistXStd_26 : 310|6@0+ (0.1,0) [0|6] "m"  MPC
 SG_ RSDS_L_ObjType_26 : 319|4@0+ (1,0) [0|15] ""  MPC
 SG_ RSDS_L_ObjRelVelX_26 : 335|13@0+ (0.0312,-128) [-128|126.9976] "mps"  MPC
 SG_ RSDS_L_ObjRelVelY_26 : 338|13@0+ (0.0312,-128) [-128|126.9976] "mps"  MPC
 SG_ RSDS_L_ObjRelAccelX_26 : 357|10@0+ (0.03125,-16) [-16|15.96875] "mps2"  MPC
 SG_ RSDS_L_ObjRelAccelY_26 : 363|10@0+ (0.03125,-16) [-16|15.96875] "mps2"  MPC
 SG_ RSDS_L_ObjMotionType_26 : 383|3@0+ (1,0) [0|7] ""  MPC
 SG_ RSDS_L_ObjMeasured_26 : 369|2@0+ (1,0) [0|3] ""  MPC
 SG_ RSDS_L_ObjDistYStd_26 : 399|6@0+ (0.1,0) [0|6] "m"  MPC
 SG_ RSDS_L_ObjRelVelXStd_26 : 393|6@0+ (0.0625,0) [0|3.9375] "mps"  MPC
 SG_ RSDS_L_ObjRelVelYStd_26 : 403|6@0+ (0.0625,0) [0|3.9375] "mps"  MPC
 SG_ RSDS_L_ObjRAccelXStd_26 : 413|6@0+ (0.0625,0) [0|3.9375] "mps2"  MPC
 SG_ RSDS_L_ObjRAccelYStd_26 : 423|6@0+ (0.0625,0) [0|3.9375] "mps2"  MPC
 SG_ RSDS_L_ObjWidth_26 : 417|10@0+ (0.01,0) [0|5] "m"  MPC
 SG_ RSDS_L_ObjMotionDirection_26 : 447|3@0+ (1,0) [0|7] ""  MPC
 SG_ RSDS_L_ObjAge_26 : 439|8@0+ (1,0) [0|255] ""  MPC
 SG_ RSDS_L_ObjLength_26 : 463|10@0+ (0.05,0) [0|20] "m"  MPC
 SG_ RSDS_L_ObjHeading_26 : 469|12@0+ (0.002,-3.14) [-3.14|3.14] "rad"  MPC
 SG_ RSDS_L_ObjYawrate_26 : 473|12@0+ (0.002,-3.14) [-3.14|3.14] "rad/s"  MPC
 SG_ RSDS_L_ObjRCS_26 : 493|10@0+ (0.125,-50) [-50|70] "dBm2"  MPC
 SG_ RSDS_L_ObjRefPoint_26 : 499|3@0+ (1,0) [0|7] ""  MPC
 SG_ RSDS_L_HWATargetValidity_26 : 496|1@0+ (1,0) [0|1] ""  MPC
 SG_ RSDS_L_SGU13_BlockCounter : 511|4@0+ (1,0) [0|15] ""  MPC
 SG_ RSDS_L_ObjValid_25 : 252|1@0+ (1,0) [0|1] ""  MPC
 SG_ RSDS_L_ObjValid_26 : 253|1@0+ (1,0) [0|1] ""  MPC
 SG_ Checksum58C : 7|16@0+ (1,0) [0|65535] ""  MPC
 SG_ RollingCounter58C : 23|8@0+ (1,0) [0|255] ""  MPC
 SG_ RSDS_L_ObjHYAS_Reserved_25 : 261|6@0+ (0.017,0) [0|1.071] ""  MPC
 SG_ RSDS_L_ObjHYAS_Reserved_26 : 251|6@0+ (0.017,0) [0|1.071] ""  MPC
 SG_ RSDS_L_ObjTypeProb_25 : 325|6@0+ (2,0) [0|100] "%"  MPC
 SG_ RSDS_L_ObjTypeProb_26 : 315|6@0+ (2,0) [0|100] "%"  MPC
 SG_ RSDS_L_ObjHeight_25 : 31|10@0+ (0.01,0) [0|6] "m"  MPC
 SG_ RSDS_L_ObjHeight_26 : 379|10@0+ (0.01,0) [0|6] "m"  MPC

BO_ 1421 RSDS_L_SGU14: 64 CR_RL
 SG_ RSDS_L_ObjID_27 : 71|8@0+ (1,0) [0|255] ""  MPC
 SG_ RSDS_L_ObjExistProb_27 : 124|5@0+ (0.03326,0) [0|1] ""  MPC
 SG_ RSDS_L_ObjObstacleProb_27 : 135|5@0+ (0.03326,0) [0|1] ""  MPC
 SG_ RSDS_L_ObjDistX_27 : 187|12@0+ (0.0625,-128) [-128|127.9375] "m"  MPC
 SG_ RSDS_L_ObjDistY_27 : 33|11@0+ (0.125,-128) [-128|127.875] "m"  MPC
 SG_ RSDS_L_ObjDistXStd_27 : 54|6@0+ (0.1,0) [0|6] "m"  MPC
 SG_ RSDS_L_ObjType_27 : 63|4@0+ (1,0) [0|15] ""  MPC
 SG_ RSDS_L_ObjRelVelX_27 : 79|13@0+ (0.0312,-128) [-128|126.9976] "mps"  MPC
 SG_ RSDS_L_ObjRelVelY_27 : 82|13@0+ (0.0312,-128) [-128|126.9976] "mps"  MPC
 SG_ RSDS_L_ObjRelAccelX_27 : 101|10@0+ (0.03125,-16) [-16|15.96875] "mps2"  MPC
 SG_ RSDS_L_ObjRelAccelY_27 : 107|10@0+ (0.03125,-16) [-16|15.96875] "mps2"  MPC
 SG_ RSDS_L_ObjMotionType_27 : 127|3@0+ (1,0) [0|7] ""  MPC
 SG_ RSDS_L_ObjMeasured_27 : 113|2@0+ (1,0) [0|3] ""  MPC
 SG_ RSDS_L_ObjDistYStd_27 : 143|6@0+ (0.1,0) [0|6] "m"  MPC
 SG_ RSDS_L_ObjRelVelXStd_27 : 137|6@0+ (0.0625,0) [0|3.9375] "mps"  MPC
 SG_ RSDS_L_ObjRelVelYStd_27 : 147|6@0+ (0.0625,0) [0|3.9375] "mps"  MPC
 SG_ RSDS_L_ObjRAccelXStd_27 : 157|6@0+ (0.0625,0) [0|3.9375] "mps2"  MPC
 SG_ RSDS_L_ObjRAccelYStd_27 : 167|6@0+ (0.0625,0) [0|3.9375] "mps2"  MPC
 SG_ RSDS_L_ObjWidth_27 : 161|10@0+ (0.01,0) [0|5] "m"  MPC
 SG_ RSDS_L_ObjMotionDirection_27 : 191|3@0+ (1,0) [0|7] ""  MPC
 SG_ RSDS_L_ObjAge_27 : 183|8@0+ (1,0) [0|255] ""  MPC
 SG_ RSDS_L_ObjLength_27 : 207|10@0+ (0.05,0) [0|20] "m"  MPC
 SG_ RSDS_L_ObjHeading_27 : 213|12@0+ (0.002,-3.14) [-3.14|3.14] "rad"  MPC
 SG_ RSDS_L_ObjYawrate_27 : 217|12@0+ (0.002,-3.14) [-3.14|3.14] "rad/s"  MPC
 SG_ RSDS_L_ObjRCS_27 : 237|10@0+ (0.125,-50) [-50|70] "dBm2"  MPC
 SG_ RSDS_L_ObjRefPoint_27 : 243|3@0+ (1,0) [0|7] ""  MPC
 SG_ RSDS_L_HWATargetValidity_27 : 240|1@0+ (1,0) [0|1] ""  MPC
 SG_ RSDS_L_ObjID_28 : 271|8@0+ (1,0) [0|255] ""  MPC
 SG_ RSDS_L_ObjExistProb_28 : 279|5@0+ (0.03326,0) [0|1] ""  MPC
 SG_ RSDS_L_ObjObstacleProb_28 : 274|5@0+ (0.03326,0) [0|1] ""  MPC
 SG_ RSDS_L_ObjDistX_28 : 285|12@0+ (0.0625,-128) [-128|127.9375] "m"  MPC
 SG_ RSDS_L_ObjDistY_28 : 289|11@0+ (0.125,-128) [-128|127.875] "m"  MPC
 SG_ RSDS_L_ObjDistXStd_28 : 310|6@0+ (0.1,0) [0|6] "m"  MPC
 SG_ RSDS_L_ObjType_28 : 319|4@0+ (1,0) [0|15] ""  MPC
 SG_ RSDS_L_ObjRelVelX_28 : 335|13@0+ (0.0312,-128) [-128|126.9976] "mps"  MPC
 SG_ RSDS_L_ObjRelVelY_28 : 338|13@0+ (0.0312,-128) [-128|126.9976] "mps"  MPC
 SG_ RSDS_L_ObjRelAccelX_28 : 357|10@0+ (0.03125,-16) [-16|15.96875] "mps2"  MPC
 SG_ RSDS_L_ObjRelAccelY_28 : 363|10@0+ (0.03125,-16) [-16|15.96875] "mps2"  MPC
 SG_ RSDS_L_ObjMotionType_28 : 383|3@0+ (1,0) [0|7] ""  MPC
 SG_ RSDS_L_ObjMeasured_28 : 369|2@0+ (1,0) [0|3] ""  MPC
 SG_ RSDS_L_ObjDistYStd_28 : 399|6@0+ (0.1,0) [0|6] "m"  MPC
 SG_ RSDS_L_ObjRelVelXStd_28 : 393|6@0+ (0.0625,0) [0|3.9375] "mps"  MPC
 SG_ RSDS_L_ObjRelVelYStd_28 : 403|6@0+ (0.0625,0) [0|3.9375] "mps"  MPC
 SG_ RSDS_L_ObjRAccelXStd_28 : 413|6@0+ (0.0625,0) [0|3.9375] "mps2"  MPC
 SG_ RSDS_L_ObjRAccelYStd_28 : 423|6@0+ (0.0625,0) [0|3.9375] "mps2"  MPC
 SG_ RSDS_L_ObjWidth_28 : 417|10@0+ (0.01,0) [0|5] "m"  MPC
 SG_ RSDS_L_ObjMotionDirection_28 : 447|3@0+ (1,0) [0|7] ""  MPC
 SG_ RSDS_L_ObjAge_28 : 439|8@0+ (1,0) [0|255] ""  MPC
 SG_ RSDS_L_ObjLength_28 : 463|10@0+ (0.05,0) [0|20] "m"  MPC
 SG_ RSDS_L_ObjHeading_28 : 469|12@0+ (0.002,-3.14) [-3.14|3.14] "rad"  MPC
 SG_ RSDS_L_ObjYawrate_28 : 473|12@0+ (0.002,-3.14) [-3.14|3.14] "rad/s"  MPC
 SG_ RSDS_L_ObjRCS_28 : 493|10@0+ (0.125,-50) [-50|70] "dBm2"  MPC
 SG_ RSDS_L_ObjRefPoint_28 : 499|3@0+ (1,0) [0|7] ""  MPC
 SG_ RSDS_L_HWATargetValidity_28 : 496|1@0+ (1,0) [0|1] ""  MPC
 SG_ RSDS_L_SGU14_BlockCounter : 511|4@0+ (1,0) [0|15] ""  MPC
 SG_ RSDS_L_ObjValid_27 : 252|1@0+ (1,0) [0|1] ""  MPC
 SG_ RSDS_L_ObjValid_28 : 253|1@0+ (1,0) [0|1] ""  MPC
 SG_ Checksum58D : 7|16@0+ (1,0) [0|65535] ""  MPC
 SG_ RollingCounter58D : 23|8@0+ (1,0) [0|255] ""  MPC
 SG_ RSDS_L_ObjHYAS_Reserved_27 : 261|6@0+ (0.017,0) [0|1.071] ""  MPC
 SG_ RSDS_L_ObjHYAS_Reserved_28 : 251|6@0+ (0.017,0) [0|1.071] ""  MPC
 SG_ RSDS_L_ObjTypeProb_27 : 325|6@0+ (2,0) [0|100] "%"  MPC
 SG_ RSDS_L_ObjTypeProb_28 : 315|6@0+ (2,0) [0|100] "%"  MPC
 SG_ RSDS_L_ObjHeight_27 : 31|10@0+ (0.01,0) [0|6] "m"  MPC
 SG_ RSDS_L_ObjHeight_28 : 379|10@0+ (0.01,0) [0|6] "m"  MPC

BO_ 1422 RSDS_L_SGU15: 64 CR_RL
 SG_ RSDS_L_ObjID_29 : 71|8@0+ (1,0) [0|255] ""  MPC
 SG_ RSDS_L_ObjExistProb_29 : 124|5@0+ (0.03326,0) [0|1] ""  MPC
 SG_ RSDS_L_ObjObstacleProb_29 : 135|5@0+ (0.03326,0) [0|1] ""  MPC
 SG_ RSDS_L_ObjDistX_29 : 187|12@0+ (0.0625,-128) [-128|127.9375] "m"  MPC
 SG_ RSDS_L_ObjDistY_29 : 33|11@0+ (0.125,-128) [-128|127.875] "m"  MPC
 SG_ RSDS_L_ObjDistXStd_29 : 54|6@0+ (0.1,0) [0|6] "m"  MPC
 SG_ RSDS_L_ObjType_29 : 63|4@0+ (1,0) [0|15] ""  MPC
 SG_ RSDS_L_ObjRelVelX_29 : 79|13@0+ (0.0312,-128) [-128|126.9976] "mps"  MPC
 SG_ RSDS_L_ObjRelVelY_29 : 82|13@0+ (0.0312,-128) [-128|126.9976] "mps"  MPC
 SG_ RSDS_L_ObjRelAccelX_29 : 101|10@0+ (0.03125,-16) [-16|15.96875] "mps2"  MPC
 SG_ RSDS_L_ObjRelAccelY_29 : 107|10@0+ (0.03125,-16) [-16|15.96875] "mps2"  MPC
 SG_ RSDS_L_ObjMotionType_29 : 127|3@0+ (1,0) [0|7] ""  MPC
 SG_ RSDS_L_ObjMeasured_29 : 113|2@0+ (1,0) [0|3] ""  MPC
 SG_ RSDS_L_ObjDistYStd_29 : 143|6@0+ (0.1,0) [0|6] "m"  MPC
 SG_ RSDS_L_ObjRelVelXStd_29 : 137|6@0+ (0.0625,0) [0|3.9375] "mps"  MPC
 SG_ RSDS_L_ObjRelVelYStd_29 : 147|6@0+ (0.0625,0) [0|3.9375] "mps"  MPC
 SG_ RSDS_L_ObjRAccelXStd_29 : 157|6@0+ (0.0625,0) [0|3.9375] "mps2"  MPC
 SG_ RSDS_L_ObjRAccelYStd_29 : 167|6@0+ (0.0625,0) [0|3.9375] "mps2"  MPC
 SG_ RSDS_L_ObjWidth_29 : 161|10@0+ (0.01,0) [0|5] "m"  MPC
 SG_ RSDS_L_ObjMotionDirection_29 : 191|3@0+ (1,0) [0|7] ""  MPC
 SG_ RSDS_L_ObjAge_29 : 183|8@0+ (1,0) [0|255] ""  MPC
 SG_ RSDS_L_ObjLength_29 : 207|10@0+ (0.05,0) [0|20] "m"  MPC
 SG_ RSDS_L_ObjHeading_29 : 213|12@0+ (0.002,-3.14) [-3.14|3.14] "rad"  MPC
 SG_ RSDS_L_ObjYawrate_29 : 217|12@0+ (0.002,-3.14) [-3.14|3.14] "rad/s"  MPC
 SG_ RSDS_L_ObjRCS_29 : 237|10@0+ (0.125,-50) [-50|70] "dBm2"  MPC
 SG_ RSDS_L_ObjRefPoint_29 : 243|3@0+ (1,0) [0|7] ""  MPC
 SG_ RSDS_L_HWATargetValidity_29 : 240|1@0+ (1,0) [0|1] ""  MPC
 SG_ RSDS_L_ObjID_30 : 271|8@0+ (1,0) [0|255] ""  MPC
 SG_ RSDS_L_ObjExistProb_30 : 279|5@0+ (0.03326,0) [0|1] ""  MPC
 SG_ RSDS_L_ObjObstacleProb_30 : 274|5@0+ (0.03326,0) [0|1] ""  MPC
 SG_ RSDS_L_ObjDistX_30 : 285|12@0+ (0.0625,-128) [-128|127.9375] "m"  MPC
 SG_ RSDS_L_ObjDistY_30 : 289|11@0+ (0.125,-128) [-128|127.875] "m"  MPC
 SG_ RSDS_L_ObjDistXStd_30 : 310|6@0+ (0.1,0) [0|6] "m"  MPC
 SG_ RSDS_L_ObjType_30 : 319|4@0+ (1,0) [0|15] ""  MPC
 SG_ RSDS_L_ObjRelVelX_30 : 335|13@0+ (0.0312,-128) [-128|126.9976] "mps"  MPC
 SG_ RSDS_L_ObjRelVelY_30 : 338|13@0+ (0.0312,-128) [-128|126.9976] "mps"  MPC
 SG_ RSDS_L_ObjRelAccelX_30 : 357|10@0+ (0.03125,-16) [-16|15.96875] "mps2"  MPC
 SG_ RSDS_L_ObjRelAccelY_30 : 363|10@0+ (0.03125,-16) [-16|15.96875] "mps2"  MPC
 SG_ RSDS_L_ObjMotionType_30 : 383|3@0+ (1,0) [0|7] ""  MPC
 SG_ RSDS_L_ObjMeasured_30 : 369|2@0+ (1,0) [0|3] ""  MPC
 SG_ RSDS_L_ObjDistYStd_30 : 399|6@0+ (0.1,0) [0|6] "m"  MPC
 SG_ RSDS_L_ObjRelVelXStd_30 : 393|6@0+ (0.0625,0) [0|3.9375] "mps"  MPC
 SG_ RSDS_L_ObjRelVelYStd_30 : 403|6@0+ (0.0625,0) [0|3.9375] "mps"  MPC
 SG_ RSDS_L_ObjRAccelXStd_30 : 413|6@0+ (0.0625,0) [0|3.9375] "mps2"  MPC
 SG_ RSDS_L_ObjRAccelYStd_30 : 423|6@0+ (0.0625,0) [0|3.9375] "mps2"  MPC
 SG_ RSDS_L_ObjWidth_30 : 417|10@0+ (0.01,0) [0|5] "m"  MPC
 SG_ RSDS_L_ObjMotionDirection_30 : 447|3@0+ (1,0) [0|7] ""  MPC
 SG_ RSDS_L_ObjAge_30 : 439|8@0+ (1,0) [0|255] ""  MPC
 SG_ RSDS_L_ObjLength_30 : 463|10@0+ (0.05,0) [0|20] "m"  MPC
 SG_ RSDS_L_ObjHeading_30 : 469|12@0+ (0.002,-3.14) [-3.14|3.14] "rad"  MPC
 SG_ RSDS_L_ObjYawrate_30 : 473|12@0+ (0.002,-3.14) [-3.14|3.14] "rad/s"  MPC
 SG_ RSDS_L_ObjRCS_30 : 493|10@0+ (0.125,-50) [-50|70] "dBm2"  MPC
 SG_ RSDS_L_ObjRefPoint_30 : 499|3@0+ (1,0) [0|7] ""  MPC
 SG_ RSDS_L_HWATargetValidity_30 : 496|1@0+ (1,0) [0|1] ""  MPC
 SG_ RSDS_L_SGU15_BlockCounter : 511|4@0+ (1,0) [0|15] ""  MPC
 SG_ RSDS_L_ObjValid_29 : 252|1@0+ (1,0) [0|1] ""  MPC
 SG_ RSDS_L_ObjValid_30 : 253|1@0+ (1,0) [0|1] ""  MPC
 SG_ Checksum58E : 7|16@0+ (1,0) [0|65535] ""  MPC
 SG_ RollingCounter58E : 23|8@0+ (1,0) [0|255] ""  MPC
 SG_ RSDS_L_ObjHYAS_Reserved_29 : 261|6@0+ (0.017,0) [0|1.071] ""  MPC
 SG_ RSDS_L_ObjHYAS_Reserved_30 : 251|6@0+ (0.017,0) [0|1.071] ""  MPC
 SG_ RSDS_L_ObjTypeProb_29 : 325|6@0+ (2,0) [0|100] "%"  MPC
 SG_ RSDS_L_ObjTypeProb_30 : 315|6@0+ (2,0) [0|100] "%"  MPC
 SG_ RSDS_L_ObjHeight_29 : 31|10@0+ (0.01,0) [0|6] "m"  MPC
 SG_ RSDS_L_ObjHeight_30 : 379|10@0+ (0.01,0) [0|6] "m"  MPC

BO_ 1423 RSDS_L_SGU16: 64 CR_RL
 SG_ RSDS_L_ObjID_31 : 71|8@0+ (1,0) [0|255] ""  MPC
 SG_ RSDS_L_ObjExistProb_31 : 124|5@0+ (0.03326,0) [0|1] ""  MPC
 SG_ RSDS_L_ObjObstacleProb_31 : 135|5@0+ (0.03326,0) [0|1] ""  MPC
 SG_ RSDS_L_ObjDistX_31 : 187|12@0+ (0.0625,-128) [-128|127.9375] "m"  MPC
 SG_ RSDS_L_ObjDistY_31 : 33|11@0+ (0.125,-128) [-128|127.875] "m"  MPC
 SG_ RSDS_L_ObjDistXStd_31 : 54|6@0+ (0.1,0) [0|6] "m"  MPC
 SG_ RSDS_L_ObjType_31 : 63|4@0+ (1,0) [0|15] ""  MPC
 SG_ RSDS_L_ObjRelVelX_31 : 79|13@0+ (0.0312,-128) [-128|126.9976] "mps"  MPC
 SG_ RSDS_L_ObjRelVelY_31 : 82|13@0+ (0.0312,-128) [-128|126.9976] "mps"  MPC
 SG_ RSDS_L_ObjRelAccelX_31 : 101|10@0+ (0.03125,-16) [-16|15.96875] "mps2"  MPC
 SG_ RSDS_L_ObjRelAccelY_31 : 107|10@0+ (0.03125,-16) [-16|15.96875] "mps2"  MPC
 SG_ RSDS_L_ObjMotionType_31 : 127|3@0+ (1,0) [0|7] ""  MPC
 SG_ RSDS_L_ObjMeasured_31 : 113|2@0+ (1,0) [0|3] ""  MPC
 SG_ RSDS_L_ObjDistYStd_31 : 143|6@0+ (0.1,0) [0|6] "m"  MPC
 SG_ RSDS_L_ObjRelVelXStd_31 : 137|6@0+ (0.0625,0) [0|3.9375] "mps"  MPC
 SG_ RSDS_L_ObjRelVelYStd_31 : 147|6@0+ (0.0625,0) [0|3.9375] "mps"  MPC
 SG_ RSDS_L_ObjRAccelXStd_31 : 157|6@0+ (0.0625,0) [0|3.9375] "mps2"  MPC
 SG_ RSDS_L_ObjRAccelYStd_31 : 167|6@0+ (0.0625,0) [0|3.9375] "mps2"  MPC
 SG_ RSDS_L_ObjWidth_31 : 161|10@0+ (0.01,0) [0|5] "m"  MPC
 SG_ RSDS_L_ObjMotionDirection_31 : 191|3@0+ (1,0) [0|7] ""  MPC
 SG_ RSDS_L_ObjAge_31 : 183|8@0+ (1,0) [0|255] ""  MPC
 SG_ RSDS_L_ObjLength_31 : 207|10@0+ (0.05,0) [0|20] "m"  MPC
 SG_ RSDS_L_ObjHeading_31 : 213|12@0+ (0.002,-3.14) [-3.14|3.14] "rad"  MPC
 SG_ RSDS_L_ObjYawrate_31 : 217|12@0+ (0.002,-3.14) [-3.14|3.14] "rad/s"  MPC
 SG_ RSDS_L_ObjRCS_31 : 237|10@0+ (0.125,-50) [-50|70] "dBm2"  MPC
 SG_ RSDS_L_ObjRefPoint_31 : 243|3@0+ (1,0) [0|7] ""  MPC
 SG_ RSDS_L_HWATargetValidity_31 : 240|1@0+ (1,0) [0|1] ""  MPC
 SG_ RSDS_L_ObjID_32 : 271|8@0+ (1,0) [0|255] ""  MPC
 SG_ RSDS_L_ObjExistProb_32 : 279|5@0+ (0.03326,0) [0|1] ""  MPC
 SG_ RSDS_L_ObjObstacleProb_32 : 274|5@0+ (0.03326,0) [0|1] ""  MPC
 SG_ RSDS_L_ObjDistX_32 : 285|12@0+ (0.0625,-128) [-128|127.9375] "m"  MPC
 SG_ RSDS_L_ObjDistY_32 : 289|11@0+ (0.125,-128) [-128|127.875] "m"  MPC
 SG_ RSDS_L_ObjDistXStd_32 : 310|6@0+ (0.1,0) [0|6] "m"  MPC
 SG_ RSDS_L_ObjType_32 : 319|4@0+ (1,0) [0|15] ""  MPC
 SG_ RSDS_L_ObjRelVelX_32 : 335|13@0+ (0.0312,-128) [-128|126.9976] "mps"  MPC
 SG_ RSDS_L_ObjRelVelY_32 : 338|13@0+ (0.0312,-128) [-128|126.9976] "mps"  MPC
 SG_ RSDS_L_ObjRelAccelX_32 : 357|10@0+ (0.03125,-16) [-16|15.96875] "mps2"  MPC
 SG_ RSDS_L_ObjRelAccelY_32 : 363|10@0+ (0.03125,-16) [-16|15.96875] "mps2"  MPC
 SG_ RSDS_L_ObjMotionType_32 : 383|3@0+ (1,0) [0|7] ""  MPC
 SG_ RSDS_L_ObjMeasured_32 : 369|2@0+ (1,0) [0|3] ""  MPC
 SG_ RSDS_L_ObjDistYStd_32 : 399|6@0+ (0.1,0) [0|6] "m"  MPC
 SG_ RSDS_L_ObjRelVelXStd_32 : 393|6@0+ (0.0625,0) [0|3.9375] "mps"  MPC
 SG_ RSDS_L_ObjRelVelYStd_32 : 403|6@0+ (0.0625,0) [0|3.9375] "mps"  MPC
 SG_ RSDS_L_ObjRAccelXStd_32 : 413|6@0+ (0.0625,0) [0|3.9375] "mps2"  MPC
 SG_ RSDS_L_ObjRAccelYStd_32 : 423|6@0+ (0.0625,0) [0|3.9375] "mps2"  MPC
 SG_ RSDS_L_ObjWidth_32 : 417|10@0+ (0.01,0) [0|5] "m"  MPC
 SG_ RSDS_L_ObjMotionDirection_32 : 447|3@0+ (1,0) [0|7] ""  MPC
 SG_ RSDS_L_ObjAge_32 : 439|8@0+ (1,0) [0|255] ""  MPC
 SG_ RSDS_L_ObjLength_32 : 463|10@0+ (0.05,0) [0|20] "m"  MPC
 SG_ RSDS_L_ObjHeading_32 : 469|12@0+ (0.002,-3.14) [-3.14|3.14] "rad"  MPC
 SG_ RSDS_L_ObjYawrate_32 : 473|12@0+ (0.002,-3.14) [-3.14|3.14] "rad/s"  MPC
 SG_ RSDS_L_ObjRCS_32 : 493|10@0+ (0.125,-50) [-50|70] "dBm2"  MPC
 SG_ RSDS_L_ObjRefPoint_32 : 499|3@0+ (1,0) [0|7] ""  MPC
 SG_ RSDS_L_HWATargetValidity_32 : 496|1@0+ (1,0) [0|1] ""  MPC
 SG_ RSDS_L_SGU16_BlockCounter : 511|4@0+ (1,0) [0|15] ""  MPC
 SG_ RSDS_L_ObjValid_31 : 252|1@0+ (1,0) [0|1] ""  MPC
 SG_ RSDS_L_ObjValid_32 : 253|1@0+ (1,0) [0|1] ""  MPC
 SG_ Checksum58F : 7|16@0+ (1,0) [0|65535] ""  MPC
 SG_ RollingCounter58F : 23|8@0+ (1,0) [0|255] ""  MPC
 SG_ RSDS_L_ObjHYAS_Reserved_31 : 261|6@0+ (0.017,0) [0|1.071] ""  MPC
 SG_ RSDS_L_ObjHYAS_Reserved_32 : 251|6@0+ (0.017,0) [0|1.071] ""  MPC
 SG_ RSDS_L_ObjTypeProb_31 : 325|6@0+ (2,0) [0|100] "%"  MPC
 SG_ RSDS_L_ObjTypeProb_32 : 315|6@0+ (2,0) [0|100] "%"  MPC
 SG_ RSDS_L_ObjHeight_31 : 31|10@0+ (0.01,0) [0|6] "m"  MPC
 SG_ RSDS_L_ObjHeight_32 : 379|10@0+ (0.01,0) [0|6] "m"  MPC

BO_ 1432 RSDS_R_SGU9: 64 CR_RR
 SG_ RSDS_R_ObjID_17 : 71|8@0+ (1,0) [0|255] ""  MPC
 SG_ RSDS_R_ObjExistProb_17 : 124|5@0+ (0.03326,0) [0|1] ""  MPC
 SG_ RSDS_R_ObjObstacleProb_17 : 135|5@0+ (0.03326,0) [0|1] ""  MPC
 SG_ RSDS_R_ObjDistX_17 : 187|12@0+ (0.0625,-128) [-128|127.9375] "m"  MPC
 SG_ RSDS_R_ObjDistY_17 : 33|11@0+ (0.125,-128) [-128|127.875] "m"  MPC
 SG_ RSDS_R_ObjDistXStd_17 : 54|6@0+ (0.1,0) [0|6] "m"  MPC
 SG_ RSDS_R_ObjType_17 : 63|4@0+ (1,0) [0|15] ""  MPC
 SG_ RSDS_R_ObjRelVelX_17 : 79|13@0+ (0.0312,-128) [-128|126.9976] "mps"  MPC
 SG_ RSDS_R_ObjRelVelY_17 : 82|13@0+ (0.0312,-128) [-128|126.9976] "mps"  MPC
 SG_ RSDS_R_ObjRelAccelX_17 : 101|10@0+ (0.03125,-16) [-16|15.96875] "mps2"  MPC
 SG_ RSDS_R_ObjRelAccelY_17 : 107|10@0+ (0.03125,-16) [-16|15.96875] "mps2"  MPC
 SG_ RSDS_R_ObjMotionType_17 : 127|3@0+ (1,0) [0|7] ""  MPC
 SG_ RSDS_R_ObjMeasured_17 : 113|2@0+ (1,0) [0|3] ""  MPC
 SG_ RSDS_R_ObjDistYStd_17 : 143|6@0+ (0.1,0) [0|6] "m"  MPC
 SG_ RSDS_R_ObjRelVelXStd_17 : 137|6@0+ (0.0625,0) [0|3.9375] "mps"  MPC
 SG_ RSDS_R_ObjRelVelYStd_17 : 147|6@0+ (0.0625,0) [0|3.9375] "mps"  MPC
 SG_ RSDS_R_ObjRAccelXStd_17 : 157|6@0+ (0.0625,0) [0|3.9375] "mps2"  MPC
 SG_ RSDS_R_ObjRAccelYStd_17 : 167|6@0+ (0.0625,0) [0|3.9375] "mps2"  MPC
 SG_ RSDS_R_ObjWidth_17 : 161|10@0+ (0.01,0) [0|5] "m"  MPC
 SG_ RSDS_R_ObjMotionDirection_17 : 191|3@0+ (1,0) [0|7] ""  MPC
 SG_ RSDS_R_ObjAge_17 : 183|8@0+ (1,0) [0|255] ""  MPC
 SG_ RSDS_R_ObjLength_17 : 207|10@0+ (0.05,0) [0|20] "m"  MPC
 SG_ RSDS_R_ObjHeading_17 : 213|12@0+ (0.002,-3.14) [-3.14|3.14] "rad"  MPC
 SG_ RSDS_R_ObjYawrate_17 : 217|12@0+ (0.002,-3.14) [-3.14|3.14] "rad/s"  MPC
 SG_ RSDS_R_ObjRCS_17 : 237|10@0+ (0.125,-50) [-50|70] "dBm2"  MPC
 SG_ RSDS_R_ObjRefPoint_17 : 243|3@0+ (1,0) [0|7] ""  MPC
 SG_ RSDS_R_HWATargetValidity_17 : 240|1@0+ (1,0) [0|1] ""  MPC
 SG_ RSDS_R_ObjID_18 : 271|8@0+ (1,0) [0|255] ""  MPC
 SG_ RSDS_R_ObjExistProb_18 : 279|5@0+ (0.03326,0) [0|1] ""  MPC
 SG_ RSDS_R_ObjObstacleProb_18 : 274|5@0+ (0.03326,0) [0|1] ""  MPC
 SG_ RSDS_R_ObjDistX_18 : 285|12@0+ (0.0625,-128) [-128|127.9375] "m"  MPC
 SG_ RSDS_R_ObjDistY_18 : 289|11@0+ (0.125,-128) [-128|127.875] "m"  MPC
 SG_ RSDS_R_ObjDistXStd_18 : 310|6@0+ (0.1,0) [0|6] "m"  MPC
 SG_ RSDS_R_ObjType_18 : 319|4@0+ (1,0) [0|15] ""  MPC
 SG_ RSDS_R_ObjRelVelX_18 : 335|13@0+ (0.0312,-128) [-128|126.9976] "mps"  MPC
 SG_ RSDS_R_ObjRelVelY_18 : 338|13@0+ (0.0312,-128) [-128|126.9976] "mps"  MPC
 SG_ RSDS_R_ObjRelAccelX_18 : 357|10@0+ (0.03125,-16) [-16|15.96875] "mps2"  MPC
 SG_ RSDS_R_ObjRelAccelY_18 : 363|10@0+ (0.03125,-16) [-16|15.96875] "mps2"  MPC
 SG_ RSDS_R_ObjMotionType_18 : 383|3@0+ (1,0) [0|7] ""  MPC
 SG_ RSDS_R_ObjMeasured_18 : 369|2@0+ (1,0) [0|3] ""  MPC
 SG_ RSDS_R_ObjDistYStd_18 : 399|6@0+ (0.1,0) [0|6] "m"  MPC
 SG_ RSDS_R_ObjRelVelXStd_18 : 393|6@0+ (0.0625,0) [0|3.9375] "mps"  MPC
 SG_ RSDS_R_ObjRelVelYStd_18 : 403|6@0+ (0.0625,0) [0|3.9375] "mps"  MPC
 SG_ RSDS_R_ObjRAccelXStd_18 : 413|6@0+ (0.0625,0) [0|3.9375] "mps2"  MPC
 SG_ RSDS_R_ObjRAccelYStd_18 : 423|6@0+ (0.0625,0) [0|3.9375] "mps2"  MPC
 SG_ RSDS_R_ObjWidth_18 : 417|10@0+ (0.01,0) [0|5] "m"  MPC
 SG_ RSDS_R_ObjMotionDirection_18 : 447|3@0+ (1,0) [0|7] ""  MPC
 SG_ RSDS_R_ObjAge_18 : 439|8@0+ (1,0) [0|255] ""  MPC
 SG_ RSDS_R_ObjLength_18 : 463|10@0+ (0.05,0) [0|20] "m"  MPC
 SG_ RSDS_R_ObjHeading_18 : 469|12@0+ (0.002,-3.14) [-3.14|3.14] "rad"  MPC
 SG_ RSDS_R_ObjYawrate_18 : 473|12@0+ (0.002,-3.14) [-3.14|3.14] "rad/s"  MPC
 SG_ RSDS_R_ObjRCS_18 : 493|10@0+ (0.125,-50) [-50|70] "dBm2"  MPC
 SG_ RSDS_R_ObjRefPoint_18 : 499|3@0+ (1,0) [0|7] ""  MPC
 SG_ RSDS_R_HWATargetValidity_18 : 496|1@0+ (1,0) [0|1] ""  MPC
 SG_ RSDS_R_SGU9_BlockCounter : 511|4@0+ (1,0) [0|15] ""  MPC
 SG_ RSDS_R_ObjValid_17 : 252|1@0+ (1,0) [0|1] ""  MPC
 SG_ RSDS_R_ObjValid_18 : 253|1@0+ (1,0) [0|1] ""  MPC
 SG_ Checksum598 : 7|16@0+ (1,0) [0|65535] ""  MPC
 SG_ RollingCounter598 : 23|8@0+ (1,0) [0|255] ""  MPC
 SG_ RSDS_R_ObjHYAS_Reserved_17 : 261|6@0+ (0.017,0) [0|1.071] ""  MPC
 SG_ RSDS_R_ObjHYAS_Reserved_18 : 251|6@0+ (0.017,0) [0|1.071] ""  MPC
 SG_ RSDS_R_ObjTypeProb_17 : 325|6@0+ (2,0) [0|100] "%"  MPC
 SG_ RSDS_R_ObjTypeProb_18 : 315|6@0+ (2,0) [0|100] "%"  MPC
 SG_ RSDS_R_ObjHeight_17 : 31|10@0+ (0.01,0) [0|6] "m"  MPC
 SG_ RSDS_R_ObjHeight_18 : 379|10@0+ (0.01,0) [0|6] "m"  MPC

BO_ 1433 RSDS_R_SGU10: 64 CR_RR
 SG_ RSDS_R_ObjID_19 : 71|8@0+ (1,0) [0|255] ""  MPC
 SG_ RSDS_R_ObjExistProb_19 : 124|5@0+ (0.03326,0) [0|1] ""  MPC
 SG_ RSDS_R_ObjObstacleProb_19 : 135|5@0+ (0.03326,0) [0|1] ""  MPC
 SG_ RSDS_R_ObjDistX_19 : 187|12@0+ (0.0625,-128) [-128|127.9375] "m"  MPC
 SG_ RSDS_R_ObjDistY_19 : 33|11@0+ (0.125,-128) [-128|127.875] "m"  MPC
 SG_ RSDS_R_ObjDistXStd_19 : 54|6@0+ (0.1,0) [0|6] "m"  MPC
 SG_ RSDS_R_ObjType_19 : 63|4@0+ (1,0) [0|15] ""  MPC
 SG_ RSDS_R_ObjRelVelX_19 : 79|13@0+ (0.0312,-128) [-128|126.9976] "mps"  MPC
 SG_ RSDS_R_ObjRelVelY_19 : 82|13@0+ (0.0312,-128) [-128|126.9976] "mps"  MPC
 SG_ RSDS_R_ObjRelAccelX_19 : 101|10@0+ (0.03125,-16) [-16|15.96875] "mps2"  MPC
 SG_ RSDS_R_ObjRelAccelY_19 : 107|10@0+ (0.03125,-16) [-16|15.96875] "mps2"  MPC
 SG_ RSDS_R_ObjMotionType_19 : 127|3@0+ (1,0) [0|7] ""  MPC
 SG_ RSDS_R_ObjMeasured_19 : 113|2@0+ (1,0) [0|3] ""  MPC
 SG_ RSDS_R_ObjDistYStd_19 : 143|6@0+ (0.1,0) [0|6] "m"  MPC
 SG_ RSDS_R_ObjRelVelXStd_19 : 137|6@0+ (0.0625,0) [0|3.9375] "mps"  MPC
 SG_ RSDS_R_ObjRelVelYStd_19 : 147|6@0+ (0.0625,0) [0|3.9375] "mps"  MPC
 SG_ RSDS_R_ObjRAccelXStd_19 : 157|6@0+ (0.0625,0) [0|3.9375] "mps2"  MPC
 SG_ RSDS_R_ObjRAccelYStd_19 : 167|6@0+ (0.0625,0) [0|3.9375] "mps2"  MPC
 SG_ RSDS_R_ObjWidth_19 : 161|10@0+ (0.01,0) [0|5] "m"  MPC
 SG_ RSDS_R_ObjMotionDirection_19 : 191|3@0+ (1,0) [0|7] ""  MPC
 SG_ RSDS_R_ObjAge_19 : 183|8@0+ (1,0) [0|255] ""  MPC
 SG_ RSDS_R_ObjLength_19 : 207|10@0+ (0.05,0) [0|20] "m"  MPC
 SG_ RSDS_R_ObjHeading_19 : 213|12@0+ (0.002,-3.14) [-3.14|3.14] "rad"  MPC
 SG_ RSDS_R_ObjYawrate_19 : 217|12@0+ (0.002,-3.14) [-3.14|3.14] "rad/s"  MPC
 SG_ RSDS_R_ObjRCS_19 : 237|10@0+ (0.125,-50) [-50|70] "dBm2"  MPC
 SG_ RSDS_R_ObjRefPoint_19 : 243|3@0+ (1,0) [0|7] ""  MPC
 SG_ RSDS_R_HWATargetValidity_19 : 240|1@0+ (1,0) [0|1] ""  MPC
 SG_ RSDS_R_ObjID_20 : 271|8@0+ (1,0) [0|255] ""  MPC
 SG_ RSDS_R_ObjExistProb_20 : 279|5@0+ (0.03326,0) [0|1] ""  MPC
 SG_ RSDS_R_ObjObstacleProb_20 : 274|5@0+ (0.03326,0) [0|1] ""  MPC
 SG_ RSDS_R_ObjDistX_20 : 285|12@0+ (0.0625,-128) [-128|127.9375] "m"  MPC
 SG_ RSDS_R_ObjDistY_20 : 289|11@0+ (0.125,-128) [-128|127.875] "m"  MPC
 SG_ RSDS_R_ObjDistXStd_20 : 310|6@0+ (0.1,0) [0|6] "m"  MPC
 SG_ RSDS_R_ObjType_20 : 319|4@0+ (1,0) [0|15] ""  MPC
 SG_ RSDS_R_ObjRelVelX_20 : 335|13@0+ (0.0312,-128) [-128|126.9976] "mps"  MPC
 SG_ RSDS_R_ObjRelVelY_20 : 338|13@0+ (0.0312,-128) [-128|126.9976] "mps"  MPC
 SG_ RSDS_R_ObjRelAccelX_20 : 357|10@0+ (0.03125,-16) [-16|15.96875] "mps2"  MPC
 SG_ RSDS_R_ObjRelAccelY_20 : 363|10@0+ (0.03125,-16) [-16|15.96875] "mps2"  MPC
 SG_ RSDS_R_ObjMotionType_20 : 383|3@0+ (1,0) [0|7] ""  MPC
 SG_ RSDS_R_ObjMeasured_20 : 369|2@0+ (1,0) [0|3] ""  MPC
 SG_ RSDS_R_ObjDistYStd_20 : 399|6@0+ (0.1,0) [0|6] "m"  MPC
 SG_ RSDS_R_ObjRelVelXStd_20 : 393|6@0+ (0.0625,0) [0|3.9375] "mps"  MPC
 SG_ RSDS_R_ObjRelVelYStd_20 : 403|6@0+ (0.0625,0) [0|3.9375] "mps"  MPC
 SG_ RSDS_R_ObjRAccelXStd_20 : 413|6@0+ (0.0625,0) [0|3.9375] "mps2"  MPC
 SG_ RSDS_R_ObjRAccelYStd_20 : 423|6@0+ (0.0625,0) [0|3.9375] "mps2"  MPC
 SG_ RSDS_R_ObjWidth_20 : 417|10@0+ (0.01,0) [0|5] "m"  MPC
 SG_ RSDS_R_ObjMotionDirection_20 : 447|3@0+ (1,0) [0|7] ""  MPC
 SG_ RSDS_R_ObjAge_20 : 439|8@0+ (1,0) [0|255] ""  MPC
 SG_ RSDS_R_ObjLength_20 : 463|10@0+ (0.05,0) [0|20] "m"  MPC
 SG_ RSDS_R_ObjHeading_20 : 469|12@0+ (0.002,-3.14) [-3.14|3.14] "rad"  MPC
 SG_ RSDS_R_ObjYawrate_20 : 473|12@0+ (0.002,-3.14) [-3.14|3.14] "rad/s"  MPC
 SG_ RSDS_R_ObjRCS_20 : 493|10@0+ (0.125,-50) [-50|70] "dBm2"  MPC
 SG_ RSDS_R_ObjRefPoint_20 : 499|3@0+ (1,0) [0|7] ""  MPC
 SG_ RSDS_R_HWATargetValidity_20 : 496|1@0+ (1,0) [0|1] ""  MPC
 SG_ RSDS_R_SGU10_BlockCounter : 511|4@0+ (1,0) [0|15] ""  MPC
 SG_ RSDS_R_ObjValid_19 : 252|1@0+ (1,0) [0|1] ""  MPC
 SG_ RSDS_R_ObjValid_20 : 253|1@0+ (1,0) [0|1] ""  MPC
 SG_ Checksum599 : 7|16@0+ (1,0) [0|65535] ""  MPC
 SG_ RollingCounter599 : 23|8@0+ (1,0) [0|255] ""  MPC
 SG_ RSDS_R_ObjHYAS_Reserved_19 : 261|6@0+ (0.017,0) [0|1.071] ""  MPC
 SG_ RSDS_R_ObjHYAS_Reserved_20 : 251|6@0+ (0.017,0) [0|1.071] ""  MPC
 SG_ RSDS_R_ObjTypeProb_19 : 325|6@0+ (2,0) [0|100] "%"  MPC
 SG_ RSDS_R_ObjTypeProb_20 : 315|6@0+ (2,0) [0|100] "%"  MPC
 SG_ RSDS_R_ObjHeight_19 : 31|10@0+ (0.01,0) [0|6] "m"  MPC
 SG_ RSDS_R_ObjHeight_20 : 379|10@0+ (0.01,0) [0|6] "m"  MPC

BO_ 1434 RSDS_R_SGU11: 64 CR_RR
 SG_ RSDS_R_ObjID_21 : 71|8@0+ (1,0) [0|255] ""  MPC
 SG_ RSDS_R_ObjExistProb_21 : 124|5@0+ (0.03326,0) [0|1] ""  MPC
 SG_ RSDS_R_ObjObstacleProb_21 : 135|5@0+ (0.03326,0) [0|1] ""  MPC
 SG_ RSDS_R_ObjDistX_21 : 187|12@0+ (0.0625,-128) [-128|127.9375] "m"  MPC
 SG_ RSDS_R_ObjDistY_21 : 33|11@0+ (0.125,-128) [-128|127.875] "m"  MPC
 SG_ RSDS_R_ObjDistXStd_21 : 54|6@0+ (0.1,0) [0|6] "m"  MPC
 SG_ RSDS_R_ObjType_21 : 63|4@0+ (1,0) [0|15] ""  MPC
 SG_ RSDS_R_ObjRelVelX_21 : 79|13@0+ (0.0312,-128) [-128|126.9976] "mps"  MPC
 SG_ RSDS_R_ObjRelVelY_21 : 82|13@0+ (0.0312,-128) [-128|126.9976] "mps"  MPC
 SG_ RSDS_R_ObjRelAccelX_21 : 101|10@0+ (0.03125,-16) [-16|15.96875] "mps2"  MPC
 SG_ RSDS_R_ObjRelAccelY_21 : 107|10@0+ (0.03125,-16) [-16|15.96875] "mps2"  MPC
 SG_ RSDS_R_ObjMotionType_21 : 127|3@0+ (1,0) [0|7] ""  MPC
 SG_ RSDS_R_ObjMeasured_21 : 113|2@0+ (1,0) [0|3] ""  MPC
 SG_ RSDS_R_ObjDistYStd_21 : 143|6@0+ (0.1,0) [0|6] "m"  MPC
 SG_ RSDS_R_ObjRelVelXStd_21 : 137|6@0+ (0.0625,0) [0|3.9375] "mps"  MPC
 SG_ RSDS_R_ObjRelVelYStd_21 : 147|6@0+ (0.0625,0) [0|3.9375] "mps"  MPC
 SG_ RSDS_R_ObjRAccelXStd_21 : 157|6@0+ (0.0625,0) [0|3.9375] "mps2"  MPC
 SG_ RSDS_R_ObjRAccelYStd_21 : 167|6@0+ (0.0625,0) [0|3.9375] "mps2"  MPC
 SG_ RSDS_R_ObjWidth_21 : 161|10@0+ (0.01,0) [0|5] "m"  MPC
 SG_ RSDS_R_ObjMotionDirection_21 : 191|3@0+ (1,0) [0|7] ""  MPC
 SG_ RSDS_R_ObjAge_21 : 183|8@0+ (1,0) [0|255] ""  MPC
 SG_ RSDS_R_ObjLength_21 : 207|10@0+ (0.05,0) [0|20] "m"  MPC
 SG_ RSDS_R_ObjHeading_21 : 213|12@0+ (0.002,-3.14) [-3.14|3.14] "rad"  MPC
 SG_ RSDS_R_ObjYawrate_21 : 217|12@0+ (0.002,-3.14) [-3.14|3.14] "rad/s"  MPC
 SG_ RSDS_R_ObjRCS_21 : 237|10@0+ (0.125,-50) [-50|70] "dBm2"  MPC
 SG_ RSDS_R_ObjRefPoint_21 : 243|3@0+ (1,0) [0|7] ""  MPC
 SG_ RSDS_R_HWATargetValidity_21 : 240|1@0+ (1,0) [0|1] ""  MPC
 SG_ RSDS_R_ObjID_22 : 271|8@0+ (1,0) [0|255] ""  MPC
 SG_ RSDS_R_ObjExistProb_22 : 279|5@0+ (0.03326,0) [0|1] ""  MPC
 SG_ RSDS_R_ObjObstacleProb_22 : 274|5@0+ (0.03326,0) [0|1] ""  MPC
 SG_ RSDS_R_ObjDistX_22 : 285|12@0+ (0.0625,-128) [-128|127.9375] "m"  MPC
 SG_ RSDS_R_ObjDistY_22 : 289|11@0+ (0.125,-128) [-128|127.875] "m"  MPC
 SG_ RSDS_R_ObjDistXStd_22 : 310|6@0+ (0.1,0) [0|6] "m"  MPC
 SG_ RSDS_R_ObjType_22 : 319|4@0+ (1,0) [0|15] ""  MPC
 SG_ RSDS_R_ObjRelVelX_22 : 335|13@0+ (0.0312,-128) [-128|126.9976] "mps"  MPC
 SG_ RSDS_R_ObjRelVelY_22 : 338|13@0+ (0.0312,-128) [-128|126.9976] "mps"  MPC
 SG_ RSDS_R_ObjRelAccelX_22 : 357|10@0+ (0.03125,-16) [-16|15.96875] "mps2"  MPC
 SG_ RSDS_R_ObjRelAccelY_22 : 363|10@0+ (0.03125,-16) [-16|15.96875] "mps2"  MPC
 SG_ RSDS_R_ObjMotionType_22 : 383|3@0+ (1,0) [0|7] ""  MPC
 SG_ RSDS_R_ObjMeasured_22 : 369|2@0+ (1,0) [0|3] ""  MPC
 SG_ RSDS_R_ObjDistYStd_22 : 399|6@0+ (0.1,0) [0|6] "m"  MPC
 SG_ RSDS_R_ObjRelVelXStd_22 : 393|6@0+ (0.0625,0) [0|3.9375] "mps"  MPC
 SG_ RSDS_R_ObjRelVelYStd_22 : 403|6@0+ (0.0625,0) [0|3.9375] "mps"  MPC
 SG_ RSDS_R_ObjRAccelXStd_22 : 413|6@0+ (0.0625,0) [0|3.9375] "mps2"  MPC
 SG_ RSDS_R_ObjRAccelYStd_22 : 423|6@0+ (0.0625,0) [0|3.9375] "mps2"  MPC
 SG_ RSDS_R_ObjWidth_22 : 417|10@0+ (0.01,0) [0|5] "m"  MPC
 SG_ RSDS_R_ObjMotionDirection_22 : 447|3@0+ (1,0) [0|7] ""  MPC
 SG_ RSDS_R_ObjAge_22 : 439|8@0+ (1,0) [0|255] ""  MPC
 SG_ RSDS_R_ObjLength_22 : 463|10@0+ (0.05,0) [0|20] "m"  MPC
 SG_ RSDS_R_ObjHeading_22 : 469|12@0+ (0.002,-3.14) [-3.14|3.14] "rad"  MPC
 SG_ RSDS_R_ObjYawrate_22 : 473|12@0+ (0.002,-3.14) [-3.14|3.14] "rad/s"  MPC
 SG_ RSDS_R_ObjRCS_22 : 493|10@0+ (0.125,-50) [-50|70] "dBm2"  MPC
 SG_ RSDS_R_ObjRefPoint_22 : 499|3@0+ (1,0) [0|7] ""  MPC
 SG_ RSDS_R_HWATargetValidity_22 : 496|1@0+ (1,0) [0|1] ""  MPC
 SG_ RSDS_R_SGU11_BlockCounter : 511|4@0+ (1,0) [0|15] ""  MPC
 SG_ RSDS_R_ObjValid_21 : 252|1@0+ (1,0) [0|1] ""  MPC
 SG_ RSDS_R_ObjValid_22 : 253|1@0+ (1,0) [0|1] ""  MPC
 SG_ Checksum59A : 7|16@0+ (1,0) [0|65535] ""  MPC
 SG_ RollingCounter59A : 23|8@0+ (1,0) [0|255] ""  MPC
 SG_ RSDS_R_ObjHYAS_Reserved_21 : 261|6@0+ (0.017,0) [0|1.071] ""  MPC
 SG_ RSDS_R_ObjHYAS_Reserved_22 : 251|6@0+ (0.017,0) [0|1.071] ""  MPC
 SG_ RSDS_R_ObjTypeProb_21 : 325|6@0+ (2,0) [0|100] "%"  MPC
 SG_ RSDS_R_ObjTypeProb_22 : 315|6@0+ (2,0) [0|100] "%"  MPC
 SG_ RSDS_R_ObjHeight_21 : 31|10@0+ (0.01,0) [0|6] "m"  MPC
 SG_ RSDS_R_ObjHeight_22 : 379|10@0+ (0.01,0) [0|6] "m"  MPC

BO_ 1435 RSDS_R_SGU12: 64 CR_RR
 SG_ RSDS_R_ObjID_23 : 71|8@0+ (1,0) [0|255] ""  MPC
 SG_ RSDS_R_ObjExistProb_23 : 124|5@0+ (0.03326,0) [0|1] ""  MPC
 SG_ RSDS_R_ObjObstacleProb_23 : 135|5@0+ (0.03326,0) [0|1] ""  MPC
 SG_ RSDS_R_ObjDistX_23 : 187|12@0+ (0.0625,-128) [-128|127.9375] "m"  MPC
 SG_ RSDS_R_ObjDistY_23 : 33|11@0+ (0.125,-128) [-128|127.875] "m"  MPC
 SG_ RSDS_R_ObjDistXStd_23 : 54|6@0+ (0.1,0) [0|6] "m"  MPC
 SG_ RSDS_R_ObjType_23 : 63|4@0+ (1,0) [0|15] ""  MPC
 SG_ RSDS_R_ObjRelVelX_23 : 79|13@0+ (0.0312,-128) [-128|126.9976] "mps"  MPC
 SG_ RSDS_R_ObjRelVelY_23 : 82|13@0+ (0.0312,-128) [-128|126.9976] "mps"  MPC
 SG_ RSDS_R_ObjRelAccelX_23 : 101|10@0+ (0.03125,-16) [-16|15.96875] "mps2"  MPC
 SG_ RSDS_R_ObjRelAccelY_23 : 107|10@0+ (0.03125,-16) [-16|15.96875] "mps2"  MPC
 SG_ RSDS_R_ObjMotionType_23 : 127|3@0+ (1,0) [0|7] ""  MPC
 SG_ RSDS_R_ObjMeasured_23 : 113|2@0+ (1,0) [0|3] ""  MPC
 SG_ RSDS_R_ObjDistYStd_23 : 143|6@0+ (0.1,0) [0|6] "m"  MPC
 SG_ RSDS_R_ObjRelVelXStd_23 : 137|6@0+ (0.0625,0) [0|3.9375] "mps"  MPC
 SG_ RSDS_R_ObjRelVelYStd_23 : 147|6@0+ (0.0625,0) [0|3.9375] "mps"  MPC
 SG_ RSDS_R_ObjRAccelXStd_23 : 157|6@0+ (0.0625,0) [0|3.9375] "mps2"  MPC
 SG_ RSDS_R_ObjRAccelYStd_23 : 167|6@0+ (0.0625,0) [0|3.9375] "mps2"  MPC
 SG_ RSDS_R_ObjWidth_23 : 161|10@0+ (0.01,0) [0|5] "m"  MPC
 SG_ RSDS_R_ObjMotionDirection_23 : 191|3@0+ (1,0) [0|7] ""  MPC
 SG_ RSDS_R_ObjAge_23 : 183|8@0+ (1,0) [0|255] ""  MPC
 SG_ RSDS_R_ObjLength_23 : 207|10@0+ (0.05,0) [0|20] "m"  MPC
 SG_ RSDS_R_ObjHeading_23 : 213|12@0+ (0.002,-3.14) [-3.14|3.14] "rad"  MPC
 SG_ RSDS_R_ObjYawrate_23 : 217|12@0+ (0.002,-3.14) [-3.14|3.14] "rad/s"  MPC
 SG_ RSDS_R_ObjRCS_23 : 237|10@0+ (0.125,-50) [-50|70] "dBm2"  MPC
 SG_ RSDS_R_ObjRefPoint_23 : 243|3@0+ (1,0) [0|7] ""  MPC
 SG_ RSDS_R_HWATargetValidity_23 : 240|1@0+ (1,0) [0|1] ""  MPC
 SG_ RSDS_R_ObjID_24 : 271|8@0+ (1,0) [0|255] ""  MPC
 SG_ RSDS_R_ObjExistProb_24 : 279|5@0+ (0.03326,0) [0|1] ""  MPC
 SG_ RSDS_R_ObjObstacleProb_24 : 274|5@0+ (0.03326,0) [0|1] ""  MPC
 SG_ RSDS_R_ObjDistX_24 : 285|12@0+ (0.0625,-128) [-128|127.9375] "m"  MPC
 SG_ RSDS_R_ObjDistY_24 : 289|11@0+ (0.125,-128) [-128|127.875] "m"  MPC
 SG_ RSDS_R_ObjDistXStd_24 : 310|6@0+ (0.1,0) [0|6] "m"  MPC
 SG_ RSDS_R_ObjType_24 : 319|4@0+ (1,0) [0|15] ""  MPC
 SG_ RSDS_R_ObjRelVelX_24 : 335|13@0+ (0.0312,-128) [-128|126.9976] "mps"  MPC
 SG_ RSDS_R_ObjRelVelY_24 : 338|13@0+ (0.0312,-128) [-128|126.9976] "mps"  MPC
 SG_ RSDS_R_ObjRelAccelX_24 : 357|10@0+ (0.03125,-16) [-16|15.96875] "mps2"  MPC
 SG_ RSDS_R_ObjRelAccelY_24 : 363|10@0+ (0.03125,-16) [-16|15.96875] "mps2"  MPC
 SG_ RSDS_R_ObjMotionType_24 : 383|3@0+ (1,0) [0|7] ""  MPC
 SG_ RSDS_R_ObjMeasured_24 : 369|2@0+ (1,0) [0|3] ""  MPC
 SG_ RSDS_R_ObjDistYStd_24 : 399|6@0+ (0.1,0) [0|6] "m"  MPC
 SG_ RSDS_R_ObjRelVelXStd_24 : 393|6@0+ (0.0625,0) [0|3.9375] "mps"  MPC
 SG_ RSDS_R_ObjRelVelYStd_24 : 403|6@0+ (0.0625,0) [0|3.9375] "mps"  MPC
 SG_ RSDS_R_ObjRAccelXStd_24 : 413|6@0+ (0.0625,0) [0|3.9375] "mps2"  MPC
 SG_ RSDS_R_ObjRAccelYStd_24 : 423|6@0+ (0.0625,0) [0|3.9375] "mps2"  MPC
 SG_ RSDS_R_ObjWidth_24 : 417|10@0+ (0.01,0) [0|5] "m"  MPC
 SG_ RSDS_R_ObjMotionDirection_24 : 447|3@0+ (1,0) [0|7] ""  MPC
 SG_ RSDS_R_ObjAge_24 : 439|8@0+ (1,0) [0|255] ""  MPC
 SG_ RSDS_R_ObjLength_24 : 463|10@0+ (0.05,0) [0|20] "m"  MPC
 SG_ RSDS_R_ObjHeading_24 : 469|12@0+ (0.002,-3.14) [-3.14|3.14] "rad"  MPC
 SG_ RSDS_R_ObjYawrate_24 : 473|12@0+ (0.002,-3.14) [-3.14|3.14] "rad/s"  MPC
 SG_ RSDS_R_ObjRCS_24 : 493|10@0+ (0.125,-50) [-50|70] "dBm2"  MPC
 SG_ RSDS_R_ObjRefPoint_24 : 499|3@0+ (1,0) [0|7] ""  MPC
 SG_ RSDS_R_HWATargetValidity_24 : 496|1@0+ (1,0) [0|1] ""  MPC
 SG_ RSDS_R_SGU12_BlockCounter : 511|4@0+ (1,0) [0|15] ""  MPC
 SG_ RSDS_R_ObjValid_23 : 252|1@0+ (1,0) [0|1] ""  MPC
 SG_ RSDS_R_ObjValid_24 : 253|1@0+ (1,0) [0|1] ""  MPC
 SG_ Checksum59B : 7|16@0+ (1,0) [0|65535] ""  MPC
 SG_ RollingCounter59B : 23|8@0+ (1,0) [0|255] ""  MPC
 SG_ RSDS_R_ObjHYAS_Reserved_23 : 261|6@0+ (0.017,0) [0|1.071] ""  MPC
 SG_ RSDS_R_ObjHYAS_Reserved_24 : 251|6@0+ (0.017,0) [0|1.071] ""  MPC
 SG_ RSDS_R_ObjTypeProb_23 : 325|6@0+ (2,0) [0|100] "%"  MPC
 SG_ RSDS_R_ObjTypeProb_24 : 315|6@0+ (2,0) [0|100] "%"  MPC
 SG_ RSDS_R_ObjHeight_23 : 31|10@0+ (0.01,0) [0|6] "m"  MPC
 SG_ RSDS_R_ObjHeight_24 : 379|10@0+ (0.01,0) [0|6] "m"  MPC

BO_ 1436 RSDS_R_SGU13: 64 CR_RR
 SG_ RSDS_R_ObjID_25 : 71|8@0+ (1,0) [0|255] ""  MPC
 SG_ RSDS_R_ObjExistProb_25 : 124|5@0+ (0.03326,0) [0|1] ""  MPC
 SG_ RSDS_R_ObjObstacleProb_25 : 135|5@0+ (0.03326,0) [0|1] ""  MPC
 SG_ RSDS_R_ObjDistX_25 : 187|12@0+ (0.0625,-128) [-128|127.9375] "m"  MPC
 SG_ RSDS_R_ObjDistY_25 : 33|11@0+ (0.125,-128) [-128|127.875] "m"  MPC
 SG_ RSDS_R_ObjDistXStd_25 : 54|6@0+ (0.1,0) [0|6] "m"  MPC
 SG_ RSDS_R_ObjType_25 : 63|4@0+ (1,0) [0|15] ""  MPC
 SG_ RSDS_R_ObjRelVelX_25 : 79|13@0+ (0.0312,-128) [-128|126.9976] "mps"  MPC
 SG_ RSDS_R_ObjRelVelY_25 : 82|13@0+ (0.0312,-128) [-128|126.9976] "mps"  MPC
 SG_ RSDS_R_ObjRelAccelX_25 : 101|10@0+ (0.03125,-16) [-16|15.96875] "mps2"  MPC
 SG_ RSDS_R_ObjRelAccelY_25 : 107|10@0+ (0.03125,-16) [-16|15.96875] "mps2"  MPC
 SG_ RSDS_R_ObjMotionType_25 : 127|3@0+ (1,0) [0|7] ""  MPC
 SG_ RSDS_R_ObjMeasured_25 : 113|2@0+ (1,0) [0|3] ""  MPC
 SG_ RSDS_R_ObjDistYStd_25 : 143|6@0+ (0.1,0) [0|6] "m"  MPC
 SG_ RSDS_R_ObjRelVelXStd_25 : 137|6@0+ (0.0625,0) [0|3.9375] "mps"  MPC
 SG_ RSDS_R_ObjRelVelYStd_25 : 147|6@0+ (0.0625,0) [0|3.9375] "mps"  MPC
 SG_ RSDS_R_ObjRAccelXStd_25 : 157|6@0+ (0.0625,0) [0|3.9375] "mps2"  MPC
 SG_ RSDS_R_ObjRAccelYStd_25 : 167|6@0+ (0.0625,0) [0|3.9375] "mps2"  MPC
 SG_ RSDS_R_ObjWidth_25 : 161|10@0+ (0.01,0) [0|5] "m"  MPC
 SG_ RSDS_R_ObjMotionDirection_25 : 191|3@0+ (1,0) [0|7] ""  MPC
 SG_ RSDS_R_ObjAge_25 : 183|8@0+ (1,0) [0|255] ""  MPC
 SG_ RSDS_R_ObjLength_25 : 207|10@0+ (0.05,0) [0|20] "m"  MPC
 SG_ RSDS_R_ObjHeading_25 : 213|12@0+ (0.002,-3.14) [-3.14|3.14] "rad"  MPC
 SG_ RSDS_R_ObjYawrate_25 : 217|12@0+ (0.002,-3.14) [-3.14|3.14] "rad/s"  MPC
 SG_ RSDS_R_ObjRCS_25 : 237|10@0+ (0.125,-50) [-50|70] "dBm2"  MPC
 SG_ RSDS_R_ObjRefPoint_25 : 243|3@0+ (1,0) [0|7] ""  MPC
 SG_ RSDS_R_HWATargetValidity_25 : 240|1@0+ (1,0) [0|1] ""  MPC
 SG_ RSDS_R_ObjID_26 : 271|8@0+ (1,0) [0|255] ""  MPC
 SG_ RSDS_R_ObjExistProb_26 : 279|5@0+ (0.03326,0) [0|1] ""  MPC
 SG_ RSDS_R_ObjObstacleProb_26 : 274|5@0+ (0.03326,0) [0|1] ""  MPC
 SG_ RSDS_R_ObjDistX_26 : 285|12@0+ (0.0625,-128) [-128|127.9375] "m"  MPC
 SG_ RSDS_R_ObjDistY_26 : 289|11@0+ (0.125,-128) [-128|127.875] "m"  MPC
 SG_ RSDS_R_ObjDistXStd_26 : 310|6@0+ (0.1,0) [0|6] "m"  MPC
 SG_ RSDS_R_ObjType_26 : 319|4@0+ (1,0) [0|15] ""  MPC
 SG_ RSDS_R_ObjRelVelX_26 : 335|13@0+ (0.0312,-128) [-128|126.9976] "mps"  MPC
 SG_ RSDS_R_ObjRelVelY_26 : 338|13@0+ (0.0312,-128) [-128|126.9976] "mps"  MPC
 SG_ RSDS_R_ObjRelAccelX_26 : 357|10@0+ (0.03125,-16) [-16|15.96875] "mps2"  MPC
 SG_ RSDS_R_ObjRelAccelY_26 : 363|10@0+ (0.03125,-16) [-16|15.96875] "mps2"  MPC
 SG_ RSDS_R_ObjMotionType_26 : 383|3@0+ (1,0) [0|7] ""  MPC
 SG_ RSDS_R_ObjMeasured_26 : 369|2@0+ (1,0) [0|3] ""  MPC
 SG_ RSDS_R_ObjDistYStd_26 : 399|6@0+ (0.1,0) [0|6] "m"  MPC
 SG_ RSDS_R_ObjRelVelXStd_26 : 393|6@0+ (0.0625,0) [0|3.9375] "mps"  MPC
 SG_ RSDS_R_ObjRelVelYStd_26 : 403|6@0+ (0.0625,0) [0|3.9375] "mps"  MPC
 SG_ RSDS_R_ObjRAccelXStd_26 : 413|6@0+ (0.0625,0) [0|3.9375] "mps2"  MPC
 SG_ RSDS_R_ObjRAccelYStd_26 : 423|6@0+ (0.0625,0) [0|3.9375] "mps2"  MPC
 SG_ RSDS_R_ObjWidth_26 : 417|10@0+ (0.01,0) [0|5] "m"  MPC
 SG_ RSDS_R_ObjMotionDirection_26 : 447|3@0+ (1,0) [0|7] ""  MPC
 SG_ RSDS_R_ObjAge_26 : 439|8@0+ (1,0) [0|255] ""  MPC
 SG_ RSDS_R_ObjLength_26 : 463|10@0+ (0.05,0) [0|20] "m"  MPC
 SG_ RSDS_R_ObjHeading_26 : 469|12@0+ (0.002,-3.14) [-3.14|3.14] "rad"  MPC
 SG_ RSDS_R_ObjYawrate_26 : 473|12@0+ (0.002,-3.14) [-3.14|3.14] "rad/s"  MPC
 SG_ RSDS_R_ObjRCS_26 : 493|10@0+ (0.125,-50) [-50|70] "dBm2"  MPC
 SG_ RSDS_R_ObjRefPoint_26 : 499|3@0+ (1,0) [0|7] ""  MPC
 SG_ RSDS_R_HWATargetValidity_26 : 496|1@0+ (1,0) [0|1] ""  MPC
 SG_ RSDS_R_SGU13_BlockCounter : 511|4@0+ (1,0) [0|15] ""  MPC
 SG_ RSDS_R_ObjValid_25 : 252|1@0+ (1,0) [0|1] ""  MPC
 SG_ RSDS_R_ObjValid_26 : 253|1@0+ (1,0) [0|1] ""  MPC
 SG_ Checksum59C : 7|16@0+ (1,0) [0|65535] ""  MPC
 SG_ RollingCounter59C : 23|8@0+ (1,0) [0|255] ""  MPC
 SG_ RSDS_R_ObjHYAS_Reserved_25 : 261|6@0+ (0.017,0) [0|1.071] ""  MPC
 SG_ RSDS_R_ObjHYAS_Reserved_26 : 251|6@0+ (0.017,0) [0|1.071] ""  MPC
 SG_ RSDS_R_ObjTypeProb_25 : 325|6@0+ (2,0) [0|100] "%"  MPC
 SG_ RSDS_R_ObjTypeProb_26 : 315|6@0+ (2,0) [0|100] "%"  MPC
 SG_ RSDS_R_ObjHeight_25 : 31|10@0+ (0.01,0) [0|6] "m"  MPC
 SG_ RSDS_R_ObjHeight_26 : 379|10@0+ (0.01,0) [0|6] "m"  MPC

BO_ 1437 RSDS_R_SGU14: 64 CR_RR
 SG_ RSDS_R_ObjID_27 : 71|8@0+ (1,0) [0|255] ""  MPC
 SG_ RSDS_R_ObjExistProb_27 : 124|5@0+ (0.03326,0) [0|1] ""  MPC
 SG_ RSDS_R_ObjObstacleProb_27 : 135|5@0+ (0.03326,0) [0|1] ""  MPC
 SG_ RSDS_R_ObjDistX_27 : 187|12@0+ (0.0625,-128) [-128|127.9375] "m"  MPC
 SG_ RSDS_R_ObjDistY_27 : 33|11@0+ (0.125,-128) [-128|127.875] "m"  MPC
 SG_ RSDS_R_ObjDistXStd_27 : 54|6@0+ (0.1,0) [0|6] "m"  MPC
 SG_ RSDS_R_ObjType_27 : 63|4@0+ (1,0) [0|15] ""  MPC
 SG_ RSDS_R_ObjRelVelX_27 : 79|13@0+ (0.0312,-128) [-128|126.9976] "mps"  MPC
 SG_ RSDS_R_ObjRelVelY_27 : 82|13@0+ (0.0312,-128) [-128|126.9976] "mps"  MPC
 SG_ RSDS_R_ObjRelAccelX_27 : 101|10@0+ (0.03125,-16) [-16|15.96875] "mps2"  MPC
 SG_ RSDS_R_ObjRelAccelY_27 : 107|10@0+ (0.03125,-16) [-16|15.96875] "mps2"  MPC
 SG_ RSDS_R_ObjMotionType_27 : 127|3@0+ (1,0) [0|7] ""  MPC
 SG_ RSDS_R_ObjMeasured_27 : 113|2@0+ (1,0) [0|3] ""  MPC
 SG_ RSDS_R_ObjDistYStd_27 : 143|6@0+ (0.1,0) [0|6] "m"  MPC
 SG_ RSDS_R_ObjRelVelXStd_27 : 137|6@0+ (0.0625,0) [0|3.9375] "mps"  MPC
 SG_ RSDS_R_ObjRelVelYStd_27 : 147|6@0+ (0.0625,0) [0|3.9375] "mps"  MPC
 SG_ RSDS_R_ObjRAccelXStd_27 : 157|6@0+ (0.0625,0) [0|3.9375] "mps2"  MPC
 SG_ RSDS_R_ObjRAccelYStd_27 : 167|6@0+ (0.0625,0) [0|3.9375] "mps2"  MPC
 SG_ RSDS_R_ObjWidth_27 : 161|10@0+ (0.01,0) [0|5] "m"  MPC
 SG_ RSDS_R_ObjMotionDirection_27 : 191|3@0+ (1,0) [0|7] ""  MPC
 SG_ RSDS_R_ObjAge_27 : 183|8@0+ (1,0) [0|255] ""  MPC
 SG_ RSDS_R_ObjLength_27 : 207|10@0+ (0.05,0) [0|20] "m"  MPC
 SG_ RSDS_R_ObjHeading_27 : 213|12@0+ (0.002,-3.14) [-3.14|3.14] "rad"  MPC
 SG_ RSDS_R_ObjYawrate_27 : 217|12@0+ (0.002,-3.14) [-3.14|3.14] "rad/s"  MPC
 SG_ RSDS_R_ObjRCS_27 : 237|10@0+ (0.125,-50) [-50|70] "dBm2"  MPC
 SG_ RSDS_R_ObjRefPoint_27 : 243|3@0+ (1,0) [0|7] ""  MPC
 SG_ RSDS_R_HWATargetValidity_27 : 240|1@0+ (1,0) [0|1] ""  MPC
 SG_ RSDS_R_ObjID_28 : 271|8@0+ (1,0) [0|255] ""  MPC
 SG_ RSDS_R_ObjExistProb_28 : 279|5@0+ (0.03326,0) [0|1] ""  MPC
 SG_ RSDS_R_ObjObstacleProb_28 : 274|5@0+ (0.03326,0) [0|1] ""  MPC
 SG_ RSDS_R_ObjDistX_28 : 285|12@0+ (0.0625,-128) [-128|127.9375] "m"  MPC
 SG_ RSDS_R_ObjDistY_28 : 289|11@0+ (0.125,-128) [-128|127.875] "m"  MPC
 SG_ RSDS_R_ObjDistXStd_28 : 310|6@0+ (0.1,0) [0|6] "m"  MPC
 SG_ RSDS_R_ObjType_28 : 319|4@0+ (1,0) [0|15] ""  MPC
 SG_ RSDS_R_ObjRelVelX_28 : 335|13@0+ (0.0312,-128) [-128|126.9976] "mps"  MPC
 SG_ RSDS_R_ObjRelVelY_28 : 338|13@0+ (0.0312,-128) [-128|126.9976] "mps"  MPC
 SG_ RSDS_R_ObjRelAccelX_28 : 357|10@0+ (0.03125,-16) [-16|15.96875] "mps2"  MPC
 SG_ RSDS_R_ObjRelAccelY_28 : 363|10@0+ (0.03125,-16) [-16|15.96875] "mps2"  MPC
 SG_ RSDS_R_ObjMotionType_28 : 383|3@0+ (1,0) [0|7] ""  MPC
 SG_ RSDS_R_ObjMeasured_28 : 369|2@0+ (1,0) [0|3] ""  MPC
 SG_ RSDS_R_ObjDistYStd_28 : 399|6@0+ (0.1,0) [0|6] "m"  MPC
 SG_ RSDS_R_ObjRelVelXStd_28 : 393|6@0+ (0.0625,0) [0|3.9375] "mps"  MPC
 SG_ RSDS_R_ObjRelVelYStd_28 : 403|6@0+ (0.0625,0) [0|3.9375] "mps"  MPC
 SG_ RSDS_R_ObjRAccelXStd_28 : 413|6@0+ (0.0625,0) [0|3.9375] "mps2"  MPC
 SG_ RSDS_R_ObjRAccelYStd_28 : 423|6@0+ (0.0625,0) [0|3.9375] "mps2"  MPC
 SG_ RSDS_R_ObjWidth_28 : 417|10@0+ (0.01,0) [0|5] "m"  MPC
 SG_ RSDS_R_ObjMotionDirection_28 : 447|3@0+ (1,0) [0|7] ""  MPC
 SG_ RSDS_R_ObjAge_28 : 439|8@0+ (1,0) [0|255] ""  MPC
 SG_ RSDS_R_ObjLength_28 : 463|10@0+ (0.05,0) [0|20] "m"  MPC
 SG_ RSDS_R_ObjHeading_28 : 469|12@0+ (0.002,-3.14) [-3.14|3.14] "rad"  MPC
 SG_ RSDS_R_ObjYawrate_28 : 473|12@0+ (0.002,-3.14) [-3.14|3.14] "rad/s"  MPC
 SG_ RSDS_R_ObjRCS_28 : 493|10@0+ (0.125,-50) [-50|70] "dBm2"  MPC
 SG_ RSDS_R_ObjRefPoint_28 : 499|3@0+ (1,0) [0|7] ""  MPC
 SG_ RSDS_R_HWATargetValidity_28 : 496|1@0+ (1,0) [0|1] ""  MPC
 SG_ RSDS_R_SGU14_BlockCounter : 511|4@0+ (1,0) [0|15] ""  MPC
 SG_ RSDS_R_ObjValid_27 : 252|1@0+ (1,0) [0|1] ""  MPC
 SG_ RSDS_R_ObjValid_28 : 253|1@0+ (1,0) [0|1] ""  MPC
 SG_ Checksum59D : 7|16@0+ (1,0) [0|65535] ""  MPC
 SG_ RollingCounter59D : 23|8@0+ (1,0) [0|255] ""  MPC
 SG_ RSDS_R_ObjHYAS_Reserved_27 : 261|6@0+ (0.017,0) [0|1.071] ""  MPC
 SG_ RSDS_R_ObjHYAS_Reserved_28 : 251|6@0+ (0.017,0) [0|1.071] ""  MPC
 SG_ RSDS_R_ObjTypeProb_27 : 325|6@0+ (2,0) [0|100] "%"  MPC
 SG_ RSDS_R_ObjTypeProb_28 : 315|6@0+ (2,0) [0|100] "%"  MPC
 SG_ RSDS_R_ObjHeight_27 : 31|10@0+ (0.01,0) [0|6] "m"  MPC
 SG_ RSDS_R_ObjHeight_28 : 379|10@0+ (0.01,0) [0|6] "m"  MPC

BO_ 1438 RSDS_R_SGU15: 64 CR_RR
 SG_ RSDS_R_ObjID_29 : 71|8@0+ (1,0) [0|255] ""  MPC
 SG_ RSDS_R_ObjExistProb_29 : 124|5@0+ (0.03326,0) [0|1] ""  MPC
 SG_ RSDS_R_ObjObstacleProb_29 : 135|5@0+ (0.03326,0) [0|1] ""  MPC
 SG_ RSDS_R_ObjDistX_29 : 187|12@0+ (0.0625,-128) [-128|127.9375] "m"  MPC
 SG_ RSDS_R_ObjDistY_29 : 33|11@0+ (0.125,-128) [-128|127.875] "m"  MPC
 SG_ RSDS_R_ObjDistXStd_29 : 54|6@0+ (0.1,0) [0|6] "m"  MPC
 SG_ RSDS_R_ObjType_29 : 63|4@0+ (1,0) [0|15] ""  MPC
 SG_ RSDS_R_ObjRelVelX_29 : 79|13@0+ (0.0312,-128) [-128|126.9976] "mps"  MPC
 SG_ RSDS_R_ObjRelVelY_29 : 82|13@0+ (0.0312,-128) [-128|126.9976] "mps"  MPC
 SG_ RSDS_R_ObjRelAccelX_29 : 101|10@0+ (0.03125,-16) [-16|15.96875] "mps2"  MPC
 SG_ RSDS_R_ObjRelAccelY_29 : 107|10@0+ (0.03125,-16) [-16|15.96875] "mps2"  MPC
 SG_ RSDS_R_ObjMotionType_29 : 127|3@0+ (1,0) [0|7] ""  MPC
 SG_ RSDS_R_ObjMeasured_29 : 113|2@0+ (1,0) [0|3] ""  MPC
 SG_ RSDS_R_ObjDistYStd_29 : 143|6@0+ (0.1,0) [0|6] "m"  MPC
 SG_ RSDS_R_ObjRelVelXStd_29 : 137|6@0+ (0.0625,0) [0|3.9375] "mps"  MPC
 SG_ RSDS_R_ObjRelVelYStd_29 : 147|6@0+ (0.0625,0) [0|3.9375] "mps"  MPC
 SG_ RSDS_R_ObjRAccelXStd_29 : 157|6@0+ (0.0625,0) [0|3.9375] "mps2"  MPC
 SG_ RSDS_R_ObjRAccelYStd_29 : 167|6@0+ (0.0625,0) [0|3.9375] "mps2"  MPC
 SG_ RSDS_R_ObjWidth_29 : 161|10@0+ (0.01,0) [0|5] "m"  MPC
 SG_ RSDS_R_ObjMotionDirection_29 : 191|3@0+ (1,0) [0|7] ""  MPC
 SG_ RSDS_R_ObjAge_29 : 183|8@0+ (1,0) [0|255] ""  MPC
 SG_ RSDS_R_ObjLength_29 : 207|10@0+ (0.05,0) [0|20] "m"  MPC
 SG_ RSDS_R_ObjHeading_29 : 213|12@0+ (0.002,-3.14) [-3.14|3.14] "rad"  MPC
 SG_ RSDS_R_ObjYawrate_29 : 217|12@0+ (0.002,-3.14) [-3.14|3.14] "rad/s"  MPC
 SG_ RSDS_R_ObjRCS_29 : 237|10@0+ (0.125,-50) [-50|70] "dBm2"  MPC
 SG_ RSDS_R_ObjRefPoint_29 : 243|3@0+ (1,0) [0|7] ""  MPC
 SG_ RSDS_R_HWATargetValidity_29 : 240|1@0+ (1,0) [0|1] ""  MPC
 SG_ RSDS_R_ObjID_30 : 271|8@0+ (1,0) [0|255] ""  MPC
 SG_ RSDS_R_ObjExistProb_30 : 279|5@0+ (0.03326,0) [0|1] ""  MPC
 SG_ RSDS_R_ObjObstacleProb_30 : 274|5@0+ (0.03326,0) [0|1] ""  MPC
 SG_ RSDS_R_ObjDistX_30 : 285|12@0+ (0.0625,-128) [-128|127.9375] "m"  MPC
 SG_ RSDS_R_ObjDistY_30 : 289|11@0+ (0.125,-128) [-128|127.875] "m"  MPC
 SG_ RSDS_R_ObjDistXStd_30 : 310|6@0+ (0.1,0) [0|6] "m"  MPC
 SG_ RSDS_R_ObjType_30 : 319|4@0+ (1,0) [0|15] ""  MPC
 SG_ RSDS_R_ObjRelVelX_30 : 335|13@0+ (0.0312,-128) [-128|126.9976] "mps"  MPC
 SG_ RSDS_R_ObjRelVelY_30 : 338|13@0+ (0.0312,-128) [-128|126.9976] "mps"  MPC
 SG_ RSDS_R_ObjRelAccelX_30 : 357|10@0+ (0.03125,-16) [-16|15.96875] "mps2"  MPC
 SG_ RSDS_R_ObjRelAccelY_30 : 363|10@0+ (0.03125,-16) [-16|15.96875] "mps2"  MPC
 SG_ RSDS_R_ObjMotionType_30 : 383|3@0+ (1,0) [0|7] ""  MPC
 SG_ RSDS_R_ObjMeasured_30 : 369|2@0+ (1,0) [0|3] ""  MPC
 SG_ RSDS_R_ObjDistYStd_30 : 399|6@0+ (0.1,0) [0|6] "m"  MPC
 SG_ RSDS_R_ObjRelVelXStd_30 : 393|6@0+ (0.0625,0) [0|3.9375] "mps"  MPC
 SG_ RSDS_R_ObjRelVelYStd_30 : 403|6@0+ (0.0625,0) [0|3.9375] "mps"  MPC
 SG_ RSDS_R_ObjRAccelXStd_30 : 413|6@0+ (0.0625,0) [0|3.9375] "mps2"  MPC
 SG_ RSDS_R_ObjRAccelYStd_30 : 423|6@0+ (0.0625,0) [0|3.9375] "mps2"  MPC
 SG_ RSDS_R_ObjWidth_30 : 417|10@0+ (0.01,0) [0|5] "m"  MPC
 SG_ RSDS_R_ObjMotionDirection_30 : 447|3@0+ (1,0) [0|7] ""  MPC
 SG_ RSDS_R_ObjAge_30 : 439|8@0+ (1,0) [0|255] ""  MPC
 SG_ RSDS_R_ObjLength_30 : 463|10@0+ (0.05,0) [0|20] "m"  MPC
 SG_ RSDS_R_ObjHeading_30 : 469|12@0+ (0.002,-3.14) [-3.14|3.14] "rad"  MPC
 SG_ RSDS_R_ObjYawrate_30 : 473|12@0+ (0.002,-3.14) [-3.14|3.14] "rad/s"  MPC
 SG_ RSDS_R_ObjRCS_30 : 493|10@0+ (0.125,-50) [-50|70] "dBm2"  MPC
 SG_ RSDS_R_ObjRefPoint_30 : 499|3@0+ (1,0) [0|7] ""  MPC
 SG_ RSDS_R_HWATargetValidity_30 : 496|1@0+ (1,0) [0|1] ""  MPC
 SG_ RSDS_R_SGU15_BlockCounter : 511|4@0+ (1,0) [0|15] ""  MPC
 SG_ RSDS_R_ObjValid_29 : 252|1@0+ (1,0) [0|1] ""  MPC
 SG_ RSDS_R_ObjValid_30 : 253|1@0+ (1,0) [0|1] ""  MPC
 SG_ Checksum59E : 7|16@0+ (1,0) [0|65535] ""  MPC
 SG_ RollingCounter59E : 23|8@0+ (1,0) [0|255] ""  MPC
 SG_ RSDS_R_ObjHYAS_Reserved_29 : 261|6@0+ (0.017,0) [0|1.071] ""  MPC
 SG_ RSDS_R_ObjHYAS_Reserved_30 : 251|6@0+ (0.017,0) [0|1.071] ""  MPC
 SG_ RSDS_R_ObjTypeProb_29 : 325|6@0+ (2,0) [0|100] "%"  MPC
 SG_ RSDS_R_ObjTypeProb_30 : 315|6@0+ (2,0) [0|100] "%"  MPC
 SG_ RSDS_R_ObjHeight_29 : 31|10@0+ (0.01,0) [0|6] "m"  MPC
 SG_ RSDS_R_ObjHeight_30 : 379|10@0+ (0.01,0) [0|6] "m"  MPC

BO_ 1439 RSDS_R_SGU16: 64 CR_RR
 SG_ RSDS_R_ObjID_31 : 71|8@0+ (1,0) [0|255] ""  MPC
 SG_ RSDS_R_ObjExistProb_31 : 124|5@0+ (0.03326,0) [0|1] ""  MPC
 SG_ RSDS_R_ObjObstacleProb_31 : 135|5@0+ (0.03326,0) [0|1] ""  MPC
 SG_ RSDS_R_ObjDistX_31 : 187|12@0+ (0.0625,-128) [-128|127.9375] "m"  MPC
 SG_ RSDS_R_ObjDistY_31 : 33|11@0+ (0.125,-128) [-128|127.875] "m"  MPC
 SG_ RSDS_R_ObjDistXStd_31 : 54|6@0+ (0.1,0) [0|6] "m"  MPC
 SG_ RSDS_R_ObjType_31 : 63|4@0+ (1,0) [0|15] ""  MPC
 SG_ RSDS_R_ObjRelVelX_31 : 79|13@0+ (0.0312,-128) [-128|126.9976] "mps"  MPC
 SG_ RSDS_R_ObjRelVelY_31 : 82|13@0+ (0.0312,-128) [-128|126.9976] "mps"  MPC
 SG_ RSDS_R_ObjRelAccelX_31 : 101|10@0+ (0.03125,-16) [-16|15.96875] "mps2"  MPC
 SG_ RSDS_R_ObjRelAccelY_31 : 107|10@0+ (0.03125,-16) [-16|15.96875] "mps2"  MPC
 SG_ RSDS_R_ObjMotionType_31 : 127|3@0+ (1,0) [0|7] ""  MPC
 SG_ RSDS_R_ObjMeasured_31 : 113|2@0+ (1,0) [0|3] ""  MPC
 SG_ RSDS_R_ObjDistYStd_31 : 143|6@0+ (0.1,0) [0|6] "m"  MPC
 SG_ RSDS_R_ObjRelVelXStd_31 : 137|6@0+ (0.0625,0) [0|3.9375] "mps"  MPC
 SG_ RSDS_R_ObjRelVelYStd_31 : 147|6@0+ (0.0625,0) [0|3.9375] "mps"  MPC
 SG_ RSDS_R_ObjRAccelXStd_31 : 157|6@0+ (0.0625,0) [0|3.9375] "mps2"  MPC
 SG_ RSDS_R_ObjRAccelYStd_31 : 167|6@0+ (0.0625,0) [0|3.9375] "mps2"  MPC
 SG_ RSDS_R_ObjWidth_31 : 161|10@0+ (0.01,0) [0|5] "m"  MPC
 SG_ RSDS_R_ObjMotionDirection_31 : 191|3@0+ (1,0) [0|7] ""  MPC
 SG_ RSDS_R_ObjAge_31 : 183|8@0+ (1,0) [0|255] ""  MPC
 SG_ RSDS_R_ObjLength_31 : 207|10@0+ (0.05,0) [0|20] "m"  MPC
 SG_ RSDS_R_ObjHeading_31 : 213|12@0+ (0.002,-3.14) [-3.14|3.14] "rad"  MPC
 SG_ RSDS_R_ObjYawrate_31 : 217|12@0+ (0.002,-3.14) [-3.14|3.14] "rad/s"  MPC
 SG_ RSDS_R_ObjRCS_31 : 237|10@0+ (0.125,-50) [-50|70] "dBm2"  MPC
 SG_ RSDS_R_ObjRefPoint_31 : 243|3@0+ (1,0) [0|7] ""  MPC
 SG_ RSDS_R_HWATargetValidity_31 : 240|1@0+ (1,0) [0|1] ""  MPC
 SG_ RSDS_R_ObjID_32 : 271|8@0+ (1,0) [0|255] ""  MPC
 SG_ RSDS_R_ObjExistProb_32 : 279|5@0+ (0.03326,0) [0|1] ""  MPC
 SG_ RSDS_R_ObjObstacleProb_32 : 274|5@0+ (0.03326,0) [0|1] ""  MPC
 SG_ RSDS_R_ObjDistX_32 : 285|12@0+ (0.0625,-128) [-128|127.9375] "m"  MPC
 SG_ RSDS_R_ObjDistY_32 : 289|11@0+ (0.125,-128) [-128|127.875] "m"  MPC
 SG_ RSDS_R_ObjDistXStd_32 : 310|6@0+ (0.1,0) [0|6] "m"  MPC
 SG_ RSDS_R_ObjType_32 : 319|4@0+ (1,0) [0|15] ""  MPC
 SG_ RSDS_R_ObjRelVelX_32 : 335|13@0+ (0.0312,-128) [-128|126.9976] "mps"  MPC
 SG_ RSDS_R_ObjRelVelY_32 : 338|13@0+ (0.0312,-128) [-128|126.9976] "mps"  MPC
 SG_ RSDS_R_ObjRelAccelX_32 : 357|10@0+ (0.03125,-16) [-16|15.96875] "mps2"  MPC
 SG_ RSDS_R_ObjRelAccelY_32 : 363|10@0+ (0.03125,-16) [-16|15.96875] "mps2"  MPC
 SG_ RSDS_R_ObjMotionType_32 : 383|3@0+ (1,0) [0|7] ""  MPC
 SG_ RSDS_R_ObjMeasured_32 : 369|2@0+ (1,0) [0|3] ""  MPC
 SG_ RSDS_R_ObjDistYStd_32 : 399|6@0+ (0.1,0) [0|6] "m"  MPC
 SG_ RSDS_R_ObjRelVelXStd_32 : 393|6@0+ (0.0625,0) [0|3.9375] "mps"  MPC
 SG_ RSDS_R_ObjRelVelYStd_32 : 403|6@0+ (0.0625,0) [0|3.9375] "mps"  MPC
 SG_ RSDS_R_ObjRAccelXStd_32 : 413|6@0+ (0.0625,0) [0|3.9375] "mps2"  MPC
 SG_ RSDS_R_ObjRAccelYStd_32 : 423|6@0+ (0.0625,0) [0|3.9375] "mps2"  MPC
 SG_ RSDS_R_ObjWidth_32 : 417|10@0+ (0.01,0) [0|5] "m"  MPC
 SG_ RSDS_R_ObjMotionDirection_32 : 447|3@0+ (1,0) [0|7] ""  MPC
 SG_ RSDS_R_ObjAge_32 : 439|8@0+ (1,0) [0|255] ""  MPC
 SG_ RSDS_R_ObjLength_32 : 463|10@0+ (0.05,0) [0|20] "m"  MPC
 SG_ RSDS_R_ObjHeading_32 : 469|12@0+ (0.002,-3.14) [-3.14|3.14] "rad"  MPC
 SG_ RSDS_R_ObjYawrate_32 : 473|12@0+ (0.002,-3.14) [-3.14|3.14] "rad/s"  MPC
 SG_ RSDS_R_ObjRCS_32 : 493|10@0+ (0.125,-50) [-50|70] "dBm2"  MPC
 SG_ RSDS_R_ObjRefPoint_32 : 499|3@0+ (1,0) [0|7] ""  MPC
 SG_ RSDS_R_HWATargetValidity_32 : 496|1@0+ (1,0) [0|1] ""  MPC
 SG_ RSDS_R_SGU16_BlockCounter : 511|4@0+ (1,0) [0|15] ""  MPC
 SG_ RSDS_R_ObjValid_31 : 252|1@0+ (1,0) [0|1] ""  MPC
 SG_ RSDS_R_ObjValid_32 : 253|1@0+ (1,0) [0|1] ""  MPC
 SG_ Checksum59F : 7|16@0+ (1,0) [0|65535] ""  MPC
 SG_ RollingCounter59F : 23|8@0+ (1,0) [0|255] ""  MPC
 SG_ RSDS_R_ObjHYAS_Reserved_31 : 261|6@0+ (0.017,0) [0|1.071] ""  MPC
 SG_ RSDS_R_ObjHYAS_Reserved_32 : 251|6@0+ (0.017,0) [0|1.071] ""  MPC
 SG_ RSDS_R_ObjTypeProb_31 : 325|6@0+ (2,0) [0|100] "%"  MPC
 SG_ RSDS_R_ObjTypeProb_32 : 315|6@0+ (2,0) [0|100] "%"  MPC
 SG_ RSDS_R_ObjHeight_31 : 31|10@0+ (0.01,0) [0|6] "m"  MPC
 SG_ RSDS_R_ObjHeight_32 : 379|10@0+ (0.01,0) [0|6] "m"  MPC

BO_ 1104 RSDS_L_AD1: 64 CR_RL
 SG_ Checksum450 : 7|16@0+ (1,0) [0|65535] ""  MPC
 SG_ RollingCounter450 : 23|8@0+ (1,0) [0|255] ""  MPC
 SG_ RSDS_HWA_L_hdr_TimeStamp : 207|27@0+ (0.00097,0) [0|65536] "s"  MPC
 SG_ RSDS_HWA_L_ObjID_1 : 181|8@0+ (1,0) [0|255] ""  MPC
 SG_ RSDS_HWA_L_ObjExistProb_1 : 189|5@0+ (0.0322581,0) [0|1] ""  MPC
 SG_ RSDS_HWA_L_ObjObstacleProb_1 : 184|5@0+ (0.0322581,0) [0|1] ""  MPC
 SG_ RSDS_HWA_L_ObjDistX_1 : 243|12@0+ (0.0625,-128) [-128|126.9375] "m"  MPC
 SG_ RSDS_HWA_L_ObjDistY_1 : 33|11@0+ (0.125,-128) [-128|127.875] "m"  MPC
 SG_ RSDS_HWA_L_ObjRelVelX_1 : 79|13@0+ (0.0312,-128) [-128|126.9976] "mps"  MPC
 SG_ RSDS_HWA_L_ObjRelVelY_1 : 82|13@0+ (0.0312,-128) [-128|126.9976] "mps"  MPC
 SG_ RSDS_HWA_L_ObjRelAccelX_1 : 54|10@0+ (0.03125,-16) [-16|15.96875] "mps2"  MPC
 SG_ RSDS_HWA_L_ObjRelAccelY_1 : 143|10@0+ (0.03125,-16) [-16|15.96875] "mps2"  MPC
 SG_ RSDS_HWA_L_ObjDistXStd_1 : 101|6@0+ (0.1,0) [0|6] "m"  MPC
 SG_ RSDS_HWA_L_ObjDistYStd_1 : 111|6@0+ (0.1,0) [0|6] "m"  MPC
 SG_ RSDS_HWA_L_ObjRelVelXStd_1 : 105|6@0+ (0.0625,0) [0|3.9375] "mps"  MPC
 SG_ RSDS_HWA_L_ObjRelVelYStd_1 : 115|6@0+ (0.0625,0) [0|3.9375] "mps"  MPC
 SG_ RSDS_HWA_L_ObjRAccelXStd_1 : 149|6@0+ (0.0625,0) [0|3.9375] "mps2"  MPC
 SG_ RSDS_HWA_L_ObjRAccelYStd_1 : 159|6@0+ (0.0625,0) [0|3.9375] "mps2"  MPC
 SG_ RSDS_HWA_L_CR_ObjWidth_1 : 153|10@0+ (0.01,0) [0|5] "m"  MPC
 SG_ RSDS_HWA_L_CR_ObjLength_1 : 175|10@0+ (0.05,0) [0|20] "m"  MPC
 SG_ RSDS_HWA_L_ObjID_2 : 335|8@0+ (1,0) [0|255] ""  MPC
 SG_ RSDS_HWA_L_ObjExistProb_2 : 343|5@0+ (0.0322581,0) [0|1] ""  MPC
 SG_ RSDS_HWA_L_ObjObstacleProb_2 : 338|5@0+ (0.0322581,0) [0|1] ""  MPC
 SG_ RSDS_HWA_L_ObjDistX_2 : 349|12@0+ (0.0625,-128) [-128|126.9375] "m"  MPC
 SG_ RSDS_HWA_L_ObjDistY_2 : 353|11@0+ (0.125,-128) [-128|127.875] "m"  MPC
 SG_ RSDS_HWA_L_ObjRelVelX_2 : 399|13@0+ (0.0312,-128) [-128|126.9976] "mps"  MPC
 SG_ RSDS_HWA_L_ObjRelVelY_2 : 402|13@0+ (0.0312,-128) [-128|126.9976] "mps"  MPC
 SG_ RSDS_HWA_L_ObjRelAccelX_2 : 374|10@0+ (0.03125,-16) [-16|15.96875] "mps2"  MPC
 SG_ RSDS_HWA_L_ObjRelAccelY_2 : 463|10@0+ (0.03125,-16) [-16|15.96875] "mps2"  MPC
 SG_ RSDS_HWA_L_ObjDistXStd_2 : 421|6@0+ (0.1,0) [0|6] "m"  MPC
 SG_ RSDS_HWA_L_ObjDistYStd_2 : 431|6@0+ (0.1,0) [0|6] "m"  MPC
 SG_ RSDS_HWA_L_ObjRelVelXStd_2 : 425|6@0+ (0.0625,0) [0|3.9375] "mps"  MPC
 SG_ RSDS_HWA_L_ObjRelVelYStd_2 : 435|6@0+ (0.0625,0) [0|3.9375] "mps"  MPC
 SG_ RSDS_HWA_L_ObjRAccelXStd_2 : 469|6@0+ (0.0625,0) [0|3.9375] "mps2"  MPC
 SG_ RSDS_HWA_L_ObjRAccelYStd_2 : 479|6@0+ (0.0625,0) [0|3.9375] "mps2"  MPC
 SG_ RSDS_HWA_L_CR_ObjWidth_2 : 473|10@0+ (0.01,0) [0|5] "m"  MPC
 SG_ RSDS_HWA_L_CR_ObjLength_2 : 495|10@0+ (0.05,0) [0|20] "m"  MPC
 SG_ RSDS_HWA_L_ObjMeasured_1 : 497|2@0+ (1,0) [0|3] ""  MPC
 SG_ RSDS_HWA_L_ObjMeasured_2 : 499|2@0+ (1,0) [0|3] ""  MPC
 SG_ RSDS_HWA_L_hdr_TimerStempStatus : 228|8@0+ (1,0) [0|255] ""  MPC
 SG_ BlockCounter1 : 236|4@0+ (1,0) [0|15] ""  MPC
 SG_ RSDS_HWA_L_hdr_AutosarTimeStamp : 263|26@0+ (1,0) [0|67108863] "ms"  MPC
 SG_ RSDS_HWA_L_hdr_TimeStampsecond : 295|32@0+ (1,0) [0|4294967295] "S"  MPC

BO_ 1105 RSDS_L_AD2: 64 CR_RL
 SG_ Checksum451 : 7|16@0+ (1,0) [0|65535] ""  MPC
 SG_ RollingCounter451 : 23|8@0+ (1,0) [0|255] ""  MPC
 SG_ RSDS_HWA_L_ObjID_3 : 197|8@0+ (1,0) [0|255] ""  MPC
 SG_ RSDS_HWA_L_ObjExistProb_3 : 205|5@0+ (0.0322581,0) [0|1] ""  MPC
 SG_ RSDS_HWA_L_ObjObstacleProb_3 : 200|5@0+ (0.0322581,0) [0|1] ""  MPC
 SG_ RSDS_HWA_L_ObjDistX_3 : 211|12@0+ (0.0625,-128) [-128|126.9375] "m"  MPC
 SG_ RSDS_HWA_L_ObjDistY_3 : 33|11@0+ (0.125,-128) [-128|127.875] "m"  MPC
 SG_ RSDS_HWA_L_ObjRelVelX_3 : 79|13@0+ (0.0312,-128) [-128|126.9976] "mps"  MPC
 SG_ RSDS_HWA_L_ObjRelVelY_3 : 82|13@0+ (0.0312,-128) [-128|126.9976] "mps"  MPC
 SG_ RSDS_HWA_L_ObjRelAccelX_3 : 54|10@0+ (0.03125,-16) [-16|15.96875] "mps2"  MPC
 SG_ RSDS_HWA_L_ObjRelAccelY_3 : 143|10@0+ (0.03125,-16) [-16|15.96875] "mps2"  MPC
 SG_ RSDS_HWA_L_ObjDistXStd_3 : 101|6@0+ (0.1,0) [0|6] "m"  MPC
 SG_ RSDS_HWA_L_ObjDistYStd_3 : 111|6@0+ (0.1,0) [0|6] "m"  MPC
 SG_ RSDS_HWA_L_ObjRelVelXStd_3 : 105|6@0+ (0.0625,0) [0|3.9375] "mps"  MPC
 SG_ RSDS_HWA_L_ObjRelVelYStd_3 : 115|6@0+ (0.0625,0) [0|3.9375] "mps"  MPC
 SG_ RSDS_HWA_L_ObjRAccelXStd_3 : 149|6@0+ (0.0625,0) [0|3.9375] "mps2"  MPC
 SG_ RSDS_HWA_L_ObjRAccelYStd_3 : 159|6@0+ (0.0625,0) [0|3.9375] "mps2"  MPC
 SG_ RSDS_HWA_L_CR_ObjWidth_3 : 153|10@0+ (0.01,0) [0|5] "m"  MPC
 SG_ RSDS_HWA_L_CR_ObjLength_3 : 175|10@0+ (0.05,0) [0|20] "m"  MPC
 SG_ RSDS_HWA_L_ObjID_4 : 335|8@0+ (1,0) [0|255] ""  MPC
 SG_ RSDS_HWA_L_ObjExistProb_4 : 343|5@0+ (0.0322581,0) [0|1] ""  MPC
 SG_ RSDS_HWA_L_ObjObstacleProb_4 : 338|5@0+ (0.0322581,0) [0|1] ""  MPC
 SG_ RSDS_HWA_L_ObjDistX_4 : 349|12@0+ (0.0625,-128) [-128|126.9375] "m"  MPC
 SG_ RSDS_HWA_L_ObjDistY_4 : 353|11@0+ (0.125,-128) [-128|127.875] "m"  MPC
 SG_ RSDS_HWA_L_ObjRelVelX_4 : 399|13@0+ (0.0312,-128) [-128|126.9976] "mps"  MPC
 SG_ RSDS_HWA_L_ObjRelVelY_4 : 402|13@0+ (0.0312,-128) [-128|126.9976] "mps"  MPC
 SG_ RSDS_HWA_L_ObjRelAccelX_4 : 374|10@0+ (0.03125,-16) [-16|15.96875] "mps2"  MPC
 SG_ RSDS_HWA_L_ObjRelAccelY_4 : 463|10@0+ (0.03125,-16) [-16|15.96875] "mps2"  MPC
 SG_ RSDS_HWA_L_ObjDistXStd_4 : 421|6@0+ (0.1,0) [0|6] "m"  MPC
 SG_ RSDS_HWA_L_ObjDistYStd_4 : 431|6@0+ (0.1,0) [0|6] "m"  MPC
 SG_ RSDS_HWA_L_ObjRelVelXStd_4 : 425|6@0+ (0.0625,0) [0|3.9375] "mps"  MPC
 SG_ RSDS_HWA_L_ObjRelVelYStd_4 : 435|6@0+ (0.0625,0) [0|3.9375] "mps"  MPC
 SG_ RSDS_HWA_L_ObjRAccelXStd_4 : 469|6@0+ (0.0625,0) [0|3.9375] "mps2"  MPC
 SG_ RSDS_HWA_L_ObjRAccelYStd_4 : 479|6@0+ (0.0625,0) [0|3.9375] "mps2"  MPC
 SG_ RSDS_HWA_L_CR_ObjWidth_4 : 473|10@0+ (0.01,0) [0|5] "m"  MPC
 SG_ RSDS_HWA_L_CR_ObjLength_4 : 495|10@0+ (0.05,0) [0|20] "m"  MPC
 SG_ RSDS_HWA_L_ObjMeasured_3 : 497|2@0+ (1,0) [0|3] ""  MPC
 SG_ RSDS_HWA_L_ObjMeasured_4 : 499|2@0+ (1,0) [0|3] ""  MPC
 SG_ BlockCounter2 : 236|4@0+ (1,0) [0|15] ""  MPC

BO_ 1106 RSDS_L_AD3: 64 CR_RL
 SG_ Checksum452 : 7|16@0+ (1,0) [0|65535] ""  MPC
 SG_ RollingCounter452 : 23|8@0+ (1,0) [0|255] ""  MPC
 SG_ RSDS_HWA_L_ObjID_5 : 197|8@0+ (1,0) [0|255] ""  MPC
 SG_ RSDS_HWA_L_ObjExistProb_5 : 205|5@0+ (0.0322581,0) [0|1] ""  MPC
 SG_ RSDS_HWA_L_ObjObstacleProb_5 : 200|5@0+ (0.0322581,0) [0|1] ""  MPC
 SG_ RSDS_HWA_L_ObjDistX_5 : 211|12@0+ (0.0625,-128) [-128|126.9375] "m"  MPC
 SG_ RSDS_HWA_L_ObjDistY_5 : 33|11@0+ (0.125,-128) [-128|127.875] "m"  MPC
 SG_ RSDS_HWA_L_ObjRelVelX_5 : 79|13@0+ (0.0312,-128) [-128|126.9976] "mps"  MPC
 SG_ RSDS_HWA_L_ObjRelVelY_5 : 82|13@0+ (0.0312,-128) [-128|126.9976] "mps"  MPC
 SG_ RSDS_HWA_L_ObjRelAccelX_5 : 54|10@0+ (0.03125,-16) [-16|15.96875] "mps2"  MPC
 SG_ RSDS_HWA_L_ObjRelAccelY_5 : 143|10@0+ (0.03125,-16) [-16|15.96875] "mps2"  MPC
 SG_ RSDS_HWA_L_ObjDistXStd_5 : 101|6@0+ (0.1,0) [0|6] "m"  MPC
 SG_ RSDS_HWA_L_ObjDistYStd_5 : 111|6@0+ (0.1,0) [0|6] "m"  MPC
 SG_ RSDS_HWA_L_ObjRelVelXStd_5 : 105|6@0+ (0.0625,0) [0|3.9375] "mps"  MPC
 SG_ RSDS_HWA_L_ObjRelVelYStd_5 : 115|6@0+ (0.0625,0) [0|3.9375] "mps"  MPC
 SG_ RSDS_HWA_L_ObjRAccelXStd_5 : 149|6@0+ (0.0625,0) [0|3.9375] "mps2"  MPC
 SG_ RSDS_HWA_L_ObjRAccelYStd_5 : 159|6@0+ (0.0625,0) [0|3.9375] "mps2"  MPC
 SG_ RSDS_HWA_L_CR_ObjWidth_5 : 153|10@0+ (0.01,0) [0|5] "m"  MPC
 SG_ RSDS_HWA_L_CR_ObjLength_5 : 175|10@0+ (0.05,0) [0|20] "m"  MPC
 SG_ RSDS_HWA_L_ObjID_6 : 335|8@0+ (1,0) [0|255] ""  MPC
 SG_ RSDS_HWA_L_ObjExistProb_6 : 343|5@0+ (0.0322581,0) [0|1] ""  MPC
 SG_ RSDS_HWA_L_ObjObstacleProb_6 : 338|5@0+ (0.0322581,0) [0|1] ""  MPC
 SG_ RSDS_HWA_L_ObjDistX_6 : 349|12@0+ (0.0625,-128) [-128|126.9375] "m"  MPC
 SG_ RSDS_HWA_L_ObjDistY_6 : 353|11@0+ (0.125,-128) [-128|127.875] "m"  MPC
 SG_ RSDS_HWA_L_ObjRelVelX_6 : 399|13@0+ (0.0312,-128) [-128|126.9976] "mps"  MPC
 SG_ RSDS_HWA_L_ObjRelVelY_6 : 402|13@0+ (0.0312,-128) [-128|126.9976] "mps"  MPC
 SG_ RSDS_HWA_L_ObjRelAccelX_6 : 374|10@0+ (0.03125,-16) [-16|15.96875] "mps2"  MPC
 SG_ RSDS_HWA_L_ObjRelAccelY_6 : 463|10@0+ (0.03125,-16) [-16|15.96875] "mps2"  MPC
 SG_ RSDS_HWA_L_ObjDistXStd_6 : 421|6@0+ (0.1,0) [0|6] "m"  MPC
 SG_ RSDS_HWA_L_ObjDistYStd_6 : 431|6@0+ (0.1,0) [0|6] "m"  MPC
 SG_ RSDS_HWA_L_ObjRelVelXStd_6 : 425|6@0+ (0.0625,0) [0|3.9375] "mps"  MPC
 SG_ RSDS_HWA_L_ObjRelVelYStd_6 : 435|6@0+ (0.0625,0) [0|3.9375] "mps"  MPC
 SG_ RSDS_HWA_L_ObjRAccelXStd_6 : 469|6@0+ (0.0625,0) [0|3.9375] "mps2"  MPC
 SG_ RSDS_HWA_L_ObjRAccelYStd_6 : 479|6@0+ (0.0625,0) [0|3.9375] "mps2"  MPC
 SG_ RSDS_HWA_L_CR_ObjWidth_6 : 473|10@0+ (0.01,0) [0|5] "m"  MPC
 SG_ RSDS_HWA_L_CR_ObjLength_6 : 495|10@0+ (0.05,0) [0|20] "m"  MPC
 SG_ RSDS_HWA_L_ObjMeasured_5 : 497|2@0+ (1,0) [0|3] ""  MPC
 SG_ RSDS_HWA_L_ObjMeasured_6 : 499|2@0+ (1,0) [0|3] ""  MPC
 SG_ BlockCounter3 : 236|4@0+ (1,0) [0|15] ""  MPC

BO_ 1107 RSDS_R_AD1: 64 CR_RR
 SG_ Checksum453 : 7|16@0+ (1,0) [0|65535] ""  MPC
 SG_ RollingCounter453 : 23|8@0+ (1,0) [0|255] ""  MPC
 SG_ RSDS_HWA_R_hdr_TimeStamp : 207|27@0+ (0.00097,0) [0|65536] "s"  MPC
 SG_ RSDS_HWA_R_ObjID_1 : 181|8@0+ (1,0) [0|255] ""  MPC
 SG_ RSDS_HWA_R_ObjExistProb_1 : 189|5@0+ (0.0322581,0) [0|1] ""  MPC
 SG_ RSDS_HWA_R_ObjObstacleProb_1 : 184|5@0+ (0.0322581,0) [0|1] ""  MPC
 SG_ RSDS_HWA_R_ObjDistX_1 : 243|12@0+ (0.0625,-128) [-128|126.9375] "m"  MPC
 SG_ RSDS_HWA_R_ObjDistY_1 : 33|11@0+ (0.125,-128) [-128|127.875] "m"  MPC
 SG_ RSDS_HWA_R_ObjRelVelX_1 : 79|13@0+ (0.0312,-128) [-128|126.9976] "mps"  MPC
 SG_ RSDS_HWA_R_ObjRelVelY_1 : 82|13@0+ (0.0312,-128) [-128|126.9976] "mps"  MPC
 SG_ RSDS_HWA_R_ObjRelAccelX_1 : 54|10@0+ (0.03125,-16) [-16|15.96875] "mps2"  MPC
 SG_ RSDS_HWA_R_ObjRelAccelY_1 : 143|10@0+ (0.03125,-16) [-16|15.96875] "mps2"  MPC
 SG_ RSDS_HWA_R_ObjDistXStd_1 : 101|6@0+ (0.1,0) [0|6] "m"  MPC
 SG_ RSDS_HWA_R_ObjDistYStd_1 : 111|6@0+ (0.1,0) [0|6] "m"  MPC
 SG_ RSDS_HWA_R_ObjRelVelXStd_1 : 105|6@0+ (0.0625,0) [0|3.9375] "mps"  MPC
 SG_ RSDS_HWA_R_ObjRelVelYStd_1 : 115|6@0+ (0.0625,0) [0|3.9375] "mps"  MPC
 SG_ RSDS_HWA_R_ObjRAccelXStd_1 : 149|6@0+ (0.0625,0) [0|3.9375] "mps2"  MPC
 SG_ RSDS_HWA_R_ObjRAccelYStd_1 : 159|6@0+ (0.0625,0) [0|3.9375] "mps2"  MPC
 SG_ RSDS_HWA_R_CR_ObjWidth_1 : 153|10@0+ (0.01,0) [0|5] "m"  MPC
 SG_ RSDS_HWA_R_CR_ObjLength_1 : 175|10@0+ (0.05,0) [0|20] "m"  MPC
 SG_ RSDS_HWA_R_ObjID_2 : 335|8@0+ (1,0) [0|255] ""  MPC
 SG_ RSDS_HWA_R_ObjExistProb_2 : 343|5@0+ (0.0322581,0) [0|1] ""  MPC
 SG_ RSDS_HWA_R_ObjObstacleProb_2 : 338|5@0+ (0.0322581,0) [0|1] ""  MPC
 SG_ RSDS_HWA_R_ObjDistX_2 : 349|12@0+ (0.0625,-128) [-128|126.9375] "m"  MPC
 SG_ RSDS_HWA_R_ObjDistY_2 : 353|11@0+ (0.125,-128) [-128|127.875] "m"  MPC
 SG_ RSDS_HWA_R_ObjRelVelX_2 : 399|13@0+ (0.0312,-128) [-128|126.9976] "mps"  MPC
 SG_ RSDS_HWA_R_ObjRelVelY_2 : 402|13@0+ (0.0312,-128) [-128|126.9976] "mps"  MPC
 SG_ RSDS_HWA_R_ObjRelAccelX_2 : 374|10@0+ (0.03125,-16) [-16|15.96875] "mps2"  MPC
 SG_ RSDS_HWA_R_ObjRelAccelY_2 : 463|10@0+ (0.03125,-16) [-16|15.96875] "mps2"  MPC
 SG_ RSDS_HWA_R_ObjDistXStd_2 : 421|6@0+ (0.1,0) [0|6] "m"  MPC
 SG_ RSDS_HWA_R_ObjDistYStd_2 : 431|6@0+ (0.1,0) [0|6] "m"  MPC
 SG_ RSDS_HWA_R_ObjRelVelXStd_2 : 425|6@0+ (0.0625,0) [0|3.9375] "mps"  MPC
 SG_ RSDS_HWA_R_ObjRelVelYStd_2 : 435|6@0+ (0.0625,0) [0|3.9375] "mps"  MPC
 SG_ RSDS_HWA_R_ObjRAccelXStd_2 : 469|6@0+ (0.0625,0) [0|3.9375] "mps2"  MPC
 SG_ RSDS_HWA_R_ObjRAccelYStd_2 : 479|6@0+ (0.0625,0) [0|3.9375] "mps2"  MPC
 SG_ RSDS_HWA_R_CR_ObjWidth_2 : 473|10@0+ (0.01,0) [0|5] "m"  MPC
 SG_ RSDS_HWA_R_CR_ObjLength_2 : 495|10@0+ (0.05,0) [0|20] "m"  MPC
 SG_ RSDS_HWA_R_ObjMeasured_1 : 497|2@0+ (1,0) [0|3] ""  MPC
 SG_ RSDS_HWA_R_ObjMeasured_2 : 499|2@0+ (1,0) [0|3] ""  MPC
 SG_ RSDS_HWA_R_hdr_TimerStempStatus : 228|8@0+ (1,0) [0|255] ""  MPC
 SG_ BlockCounter4 : 236|4@0+ (1,0) [0|15] ""  MPC
 SG_ RSDS_HWA_R_hdr_AutosarTimeStamp : 263|26@0+ (1,0) [0|67108863] "ms"  MPC
 SG_ RSDS_HWA_R_hdr_TimeStampsecond : 295|32@0+ (1,0) [0|4294967295] "S"  MPC

BO_ 1108 RSDS_R_AD2: 64 CR_RR
 SG_ Checksum454 : 7|16@0+ (1,0) [0|65535] ""  MPC
 SG_ RollingCounter454 : 23|8@0+ (1,0) [0|255] ""  MPC
 SG_ RSDS_HWA_R_ObjID_3 : 197|8@0+ (1,0) [0|255] ""  MPC
 SG_ RSDS_HWA_R_ObjExistProb_3 : 205|5@0+ (0.0322581,0) [0|1] ""  MPC
 SG_ RSDS_HWA_R_ObjObstacleProb_3 : 200|5@0+ (0.0322581,0) [0|1] ""  MPC
 SG_ RSDS_HWA_R_ObjDistX_3 : 211|12@0+ (0.0625,-128) [-128|126.9375] "m"  MPC
 SG_ RSDS_HWA_R_ObjDistY_3 : 33|11@0+ (0.125,-128) [-128|127.875] "m"  MPC
 SG_ RSDS_HWA_R_ObjRelVelX_3 : 79|13@0+ (0.0312,-128) [-128|126.9976] "mps"  MPC
 SG_ RSDS_HWA_R_ObjRelVelY_3 : 82|13@0+ (0.0312,-128) [-128|126.9976] "mps"  MPC
 SG_ RSDS_HWA_R_ObjRelAccelX_3 : 54|10@0+ (0.03125,-16) [-16|15.96875] "mps2"  MPC
 SG_ RSDS_HWA_R_ObjRelAccelY_3 : 143|10@0+ (0.03125,-16) [-16|15.96875] "mps2"  MPC
 SG_ RSDS_HWA_R_ObjDistXStd_3 : 101|6@0+ (0.1,0) [0|6] "m"  MPC
 SG_ RSDS_HWA_R_ObjDistYStd_3 : 111|6@0+ (0.1,0) [0|6] "m"  MPC
 SG_ RSDS_HWA_R_ObjRelVelXStd_3 : 105|6@0+ (0.0625,0) [0|3.9375] "mps"  MPC
 SG_ RSDS_HWA_R_ObjRelVelYStd_3 : 115|6@0+ (0.0625,0) [0|3.9375] "mps"  MPC
 SG_ RSDS_HWA_R_ObjRAccelXStd_3 : 149|6@0+ (0.0625,0) [0|3.9375] "mps2"  MPC
 SG_ RSDS_HWA_R_ObjRAccelYStd_3 : 159|6@0+ (0.0625,0) [0|3.9375] "mps2"  MPC
 SG_ RSDS_HWA_R_CR_ObjWidth_3 : 153|10@0+ (0.01,0) [0|5] "m"  MPC
 SG_ RSDS_HWA_R_CR_ObjLength_3 : 175|10@0+ (0.05,0) [0|20] "m"  MPC
 SG_ RSDS_HWA_R_ObjID_4 : 335|8@0+ (1,0) [0|255] ""  MPC
 SG_ RSDS_HWA_R_ObjExistProb_4 : 343|5@0+ (0.0322581,0) [0|1] ""  MPC
 SG_ RSDS_HWA_R_ObjObstacleProb_4 : 338|5@0+ (0.0322581,0) [0|1] ""  MPC
 SG_ RSDS_HWA_R_ObjDistX_4 : 349|12@0+ (0.0625,-128) [-128|126.9375] "m"  MPC
 SG_ RSDS_HWA_R_ObjDistY_4 : 353|11@0+ (0.125,-128) [-128|127.875] "m"  MPC
 SG_ RSDS_HWA_R_ObjRelVelX_4 : 399|13@0+ (0.0312,-128) [-128|126.9976] "mps"  MPC
 SG_ RSDS_HWA_R_ObjRelVelY_4 : 402|13@0+ (0.0312,-128) [-128|126.9976] "mps"  MPC
 SG_ RSDS_HWA_R_ObjRelAccelX_4 : 374|10@0+ (0.03125,-16) [-16|15.96875] "mps2"  MPC
 SG_ RSDS_HWA_R_ObjRelAccelY_4 : 463|10@0+ (0.03125,-16) [-16|15.96875] "mps2"  MPC
 SG_ RSDS_HWA_R_ObjDistXStd_4 : 421|6@0+ (0.1,0) [0|6] "m"  MPC
 SG_ RSDS_HWA_R_ObjDistYStd_4 : 431|6@0+ (0.1,0) [0|6] "m"  MPC
 SG_ RSDS_HWA_R_ObjRelVelXStd_4 : 425|6@0+ (0.0625,0) [0|3.9375] "mps"  MPC
 SG_ RSDS_HWA_R_ObjRelVelYStd_4 : 435|6@0+ (0.0625,0) [0|3.9375] "mps"  MPC
 SG_ RSDS_HWA_R_ObjRAccelXStd_4 : 469|6@0+ (0.0625,0) [0|3.9375] "mps2"  MPC
 SG_ RSDS_HWA_R_ObjRAccelYStd_4 : 479|6@0+ (0.0625,0) [0|3.9375] "mps2"  MPC
 SG_ RSDS_HWA_R_CR_ObjWidth_4 : 473|10@0+ (0.01,0) [0|5] "m"  MPC
 SG_ RSDS_HWA_R_CR_ObjLength_4 : 495|10@0+ (0.05,0) [0|20] "m"  MPC
 SG_ RSDS_HWA_R_ObjMeasured_3 : 497|2@0+ (1,0) [0|3] ""  MPC
 SG_ RSDS_HWA_R_ObjMeasured_4 : 499|2@0+ (1,0) [0|3] ""  MPC
 SG_ BlockCounter5 : 236|4@0+ (1,0) [0|15] ""  MPC

BO_ 1109 RSDS_R_AD3: 64 CR_RR
 SG_ Checksum455 : 7|16@0+ (1,0) [0|65535] ""  MPC
 SG_ RollingCounter455 : 23|8@0+ (1,0) [0|255] ""  MPC
 SG_ RSDS_HWA_R_ObjID_5 : 197|8@0+ (1,0) [0|255] ""  MPC
 SG_ RSDS_HWA_R_ObjExistProb_5 : 205|5@0+ (0.0322581,0) [0|1] ""  MPC
 SG_ RSDS_HWA_R_ObjObstacleProb_5 : 200|5@0+ (0.0322581,0) [0|1] ""  MPC
 SG_ RSDS_HWA_R_ObjDistX_5 : 211|12@0+ (0.0625,-128) [-128|126.9375] "m"  MPC
 SG_ RSDS_HWA_R_ObjDistY_5 : 33|11@0+ (0.125,-128) [-128|127.875] "m"  MPC
 SG_ RSDS_HWA_R_ObjRelVelX_5 : 79|13@0+ (0.0312,-128) [-128|126.9976] "mps"  MPC
 SG_ RSDS_HWA_R_ObjRelVelY_5 : 82|13@0+ (0.0312,-128) [-128|126.9976] "mps"  MPC
 SG_ RSDS_HWA_R_ObjRelAccelX_5 : 54|10@0+ (0.03125,-16) [-16|15.96875] "mps2"  MPC
 SG_ RSDS_HWA_R_ObjRelAccelY_5 : 143|10@0+ (0.03125,-16) [-16|15.96875] "mps2"  MPC
 SG_ RSDS_HWA_R_ObjDistXStd_5 : 101|6@0+ (0.1,0) [0|6] "m"  MPC
 SG_ RSDS_HWA_R_ObjDistYStd_5 : 111|6@0+ (0.1,0) [0|6] "m"  MPC
 SG_ RSDS_HWA_R_ObjRelVelXStd_5 : 105|6@0+ (0.0625,0) [0|3.9375] "mps"  MPC
 SG_ RSDS_HWA_R_ObjRelVelYStd_5 : 115|6@0+ (0.0625,0) [0|3.9375] "mps"  MPC
 SG_ RSDS_HWA_R_ObjRAccelXStd_5 : 149|6@0+ (0.0625,0) [0|3.9375] "mps2"  MPC
 SG_ RSDS_HWA_R_ObjRAccelYStd_5 : 159|6@0+ (0.0625,0) [0|3.9375] "mps2"  MPC
 SG_ RSDS_HWA_R_CR_ObjWidth_5 : 153|10@0+ (0.01,0) [0|5] "m"  MPC
 SG_ RSDS_HWA_R_CR_ObjLength_5 : 175|10@0+ (0.05,0) [0|20] "m"  MPC
 SG_ RSDS_HWA_R_ObjID_6 : 335|8@0+ (1,0) [0|255] ""  MPC
 SG_ RSDS_HWA_R_ObjExistProb_6 : 343|5@0+ (0.0322581,0) [0|1] ""  MPC
 SG_ RSDS_HWA_R_ObjObstacleProb_6 : 338|5@0+ (0.0322581,0) [0|1] ""  MPC
 SG_ RSDS_HWA_R_ObjDistX_6 : 349|12@0+ (0.0625,-128) [-128|126.9375] "m"  MPC
 SG_ RSDS_HWA_R_ObjDistY_6 : 353|11@0+ (0.125,-128) [-128|127.875] "m"  MPC
 SG_ RSDS_HWA_R_ObjRelVelX_6 : 399|13@0+ (0.0312,-128) [-128|126.9976] "mps"  MPC
 SG_ RSDS_HWA_R_ObjRelVelY_6 : 402|13@0+ (0.0312,-128) [-128|126.9976] "mps"  MPC
 SG_ RSDS_HWA_R_ObjRelAccelX_6 : 374|10@0+ (0.03125,-16) [-16|15.96875] "mps2"  MPC
 SG_ RSDS_HWA_R_ObjRelAccelY_6 : 463|10@0+ (0.03125,-16) [-16|15.96875] "mps2"  MPC
 SG_ RSDS_HWA_R_ObjDistXStd_6 : 421|6@0+ (0.1,0) [0|6] "m"  MPC
 SG_ RSDS_HWA_R_ObjDistYStd_6 : 431|6@0+ (0.1,0) [0|6] "m"  MPC
 SG_ RSDS_HWA_R_ObjRelVelXStd_6 : 425|6@0+ (0.0625,0) [0|3.9375] "mps"  MPC
 SG_ RSDS_HWA_R_ObjRelVelYStd_6 : 435|6@0+ (0.0625,0) [0|3.9375] "mps"  MPC
 SG_ RSDS_HWA_R_ObjRAccelXStd_6 : 469|6@0+ (0.0625,0) [0|3.9375] "mps2"  MPC
 SG_ RSDS_HWA_R_ObjRAccelYStd_6 : 479|6@0+ (0.0625,0) [0|3.9375] "mps2"  MPC
 SG_ RSDS_HWA_R_CR_ObjWidth_6 : 473|10@0+ (0.01,0) [0|5] "m"  MPC
 SG_ RSDS_HWA_R_CR_ObjLength_6 : 495|10@0+ (0.05,0) [0|20] "m"  MPC
 SG_ RSDS_HWA_R_ObjMeasured_5 : 497|2@0+ (1,0) [0|3] ""  MPC
 SG_ RSDS_HWA_R_ObjMeasured_6 : 499|2@0+ (1,0) [0|3] ""  MPC
 SG_ BlockCounter6 : 236|4@0+ (1,0) [0|15] ""  MPC

BA_DEF_ BO_  "GenMsgSendType" ENUM  "cyclic","NoMsgSendType","IfActive","Event","CA","CE";
BA_DEF_ BO_  "GenMsgCycleTime" INT 0 0;
BA_DEF_ SG_  "GenSigStartValue" INT 0 0;
BA_DEF_ BO_  "CANFD_BRS" ENUM  "0","1";
BA_DEF_ BO_  "VFrameFormat" ENUM  "StandardCAN","ExtendedCAN","reserved","reserved","reserved","reserved","reserved","reserved","reserved","reserved","reserved","reserved","reserved","reserved","StandardCAN_FD","ExtendedCAN_FD";
BA_DEF_ BO_  "GenMsgILSupport" ENUM  "No","Yes";
BA_DEF_DEF_  "GenMsgSendType" "cyclic";
BA_DEF_DEF_  "GenMsgCycleTime" 0;
BA_DEF_DEF_  "GenSigStartValue" 0;
BA_DEF_DEF_  "CANFD_BRS" "1";
BA_DEF_DEF_  "VFrameFormat" "";
BA_DEF_DEF_  "GenMsgILSupport" "Yes";
BA_ "GenMsgSendType" BO_ 1417 3;
BA_ "VFrameFormat" BO_ 1417 14;
BA_ "GenMsgSendType" BO_ 1418 3;
BA_ "VFrameFormat" BO_ 1418 14;
BA_ "GenMsgSendType" BO_ 1419 3;
BA_ "VFrameFormat" BO_ 1419 14;
BA_ "GenMsgSendType" BO_ 1420 3;
BA_ "VFrameFormat" BO_ 1420 14;
BA_ "GenMsgSendType" BO_ 1421 3;
BA_ "VFrameFormat" BO_ 1421 14;
BA_ "GenMsgSendType" BO_ 1422 3;
BA_ "VFrameFormat" BO_ 1422 14;
BA_ "GenMsgSendType" BO_ 1423 3;
BA_ "VFrameFormat" BO_ 1423 14;
BA_ "GenMsgSendType" BO_ 1432 3;
BA_ "VFrameFormat" BO_ 1432 14;
BA_ "GenMsgSendType" BO_ 1433 3;
BA_ "VFrameFormat" BO_ 1433 14;
BA_ "GenMsgSendType" BO_ 1434 3;
BA_ "VFrameFormat" BO_ 1434 14;
BA_ "GenMsgSendType" BO_ 1435 3;
BA_ "VFrameFormat" BO_ 1435 14;
BA_ "GenMsgSendType" BO_ 1436 3;
BA_ "VFrameFormat" BO_ 1436 14;
BA_ "GenMsgSendType" BO_ 1437 3;
BA_ "VFrameFormat" BO_ 1437 14;
BA_ "GenMsgSendType" BO_ 1438 3;
BA_ "VFrameFormat" BO_ 1438 14;
BA_ "GenMsgSendType" BO_ 1439 3;
BA_ "VFrameFormat" BO_ 1439 14;
BA_ "GenMsgSendType" BO_ 1104 3;
BA_ "VFrameFormat" BO_ 1104 14;
BA_ "GenMsgSendType" BO_ 1105 3;
BA_ "VFrameFormat" BO_ 1105 14;
BA_ "GenMsgSendType" BO_ 1106 3;
BA_ "VFrameFormat" BO_ 1106 14;
BA_ "GenMsgSendType" BO_ 1107 3;
BA_ "VFrameFormat" BO_ 1107 14;
BA_ "GenMsgSendType" BO_ 1108 3;
BA_ "VFrameFormat" BO_ 1108 14;
BA_ "GenMsgSendType" BO_ 1109 3;
BA_ "VFrameFormat" BO_ 1109 14;
BA_ "GenSigStartValue" SG_ 1417 RSDS_L_ObjDistY_19 1024;
BA_ "GenSigStartValue" SG_ 1417 RSDS_L_ObjRelVelX_19 4102;
BA_ "GenSigStartValue" SG_ 1417 RSDS_L_ObjRelVelY_19 4102;
BA_ "GenSigStartValue" SG_ 1417 RSDS_L_ObjRelAccelX_19 512;
BA_ "GenSigStartValue" SG_ 1417 RSDS_L_ObjRelAccelY_19 512;
BA_ "GenSigStartValue" SG_ 1417 RSDS_L_ObjMeasured_19 1;
BA_ "GenSigStartValue" SG_ 1417 RSDS_L_ObjRCS_19 400;
BA_ "GenSigStartValue" SG_ 1417 RSDS_L_ObjDistY_20 1024;
BA_ "GenSigStartValue" SG_ 1417 RSDS_L_ObjRelVelX_20 4102;
BA_ "GenSigStartValue" SG_ 1417 RSDS_L_ObjRelVelY_20 4102;
BA_ "GenSigStartValue" SG_ 1417 RSDS_L_ObjRelAccelX_20 512;
BA_ "GenSigStartValue" SG_ 1417 RSDS_L_ObjRelAccelY_20 512;
BA_ "GenSigStartValue" SG_ 1417 RSDS_L_ObjMeasured_20 1;
BA_ "GenSigStartValue" SG_ 1417 RSDS_L_ObjRCS_20 400;
BA_ "GenSigStartValue" SG_ 1418 RSDS_L_ObjDistY_21 1024;
BA_ "GenSigStartValue" SG_ 1418 RSDS_L_ObjRelVelX_21 4102;
BA_ "GenSigStartValue" SG_ 1418 RSDS_L_ObjRelVelY_21 4102;
BA_ "GenSigStartValue" SG_ 1418 RSDS_L_ObjRelAccelX_21 512;
BA_ "GenSigStartValue" SG_ 1418 RSDS_L_ObjRelAccelY_21 512;
BA_ "GenSigStartValue" SG_ 1418 RSDS_L_ObjMeasured_21 1;
BA_ "GenSigStartValue" SG_ 1418 RSDS_L_ObjRCS_21 400;
BA_ "GenSigStartValue" SG_ 1418 RSDS_L_ObjDistY_22 1024;
BA_ "GenSigStartValue" SG_ 1418 RSDS_L_ObjRelVelX_22 4102;
BA_ "GenSigStartValue" SG_ 1418 RSDS_L_ObjRelVelY_22 4102;
BA_ "GenSigStartValue" SG_ 1418 RSDS_L_ObjRelAccelX_22 512;
BA_ "GenSigStartValue" SG_ 1418 RSDS_L_ObjRelAccelY_22 512;
BA_ "GenSigStartValue" SG_ 1418 RSDS_L_ObjMeasured_22 1;
BA_ "GenSigStartValue" SG_ 1418 RSDS_L_ObjRCS_22 400;
BA_ "GenSigStartValue" SG_ 1419 RSDS_L_ObjDistY_23 1024;
BA_ "GenSigStartValue" SG_ 1419 RSDS_L_ObjRelVelX_23 4102;
BA_ "GenSigStartValue" SG_ 1419 RSDS_L_ObjRelVelY_23 4102;
BA_ "GenSigStartValue" SG_ 1419 RSDS_L_ObjRelAccelX_23 512;
BA_ "GenSigStartValue" SG_ 1419 RSDS_L_ObjRelAccelY_23 512;
BA_ "GenSigStartValue" SG_ 1419 RSDS_L_ObjMeasured_23 1;
BA_ "GenSigStartValue" SG_ 1419 RSDS_L_ObjRCS_23 400;
BA_ "GenSigStartValue" SG_ 1419 RSDS_L_ObjDistY_24 1024;
BA_ "GenSigStartValue" SG_ 1419 RSDS_L_ObjRelVelX_24 4102;
BA_ "GenSigStartValue" SG_ 1419 RSDS_L_ObjRelVelY_24 4102;
BA_ "GenSigStartValue" SG_ 1419 RSDS_L_ObjRelAccelX_24 512;
BA_ "GenSigStartValue" SG_ 1419 RSDS_L_ObjRelAccelY_24 512;
BA_ "GenSigStartValue" SG_ 1419 RSDS_L_ObjMeasured_24 1;
BA_ "GenSigStartValue" SG_ 1419 RSDS_L_ObjRCS_24 400;
BA_ "GenSigStartValue" SG_ 1420 RSDS_L_ObjDistY_25 1024;
BA_ "GenSigStartValue" SG_ 1420 RSDS_L_ObjRelVelX_25 4102;
BA_ "GenSigStartValue" SG_ 1420 RSDS_L_ObjRelVelY_25 4102;
BA_ "GenSigStartValue" SG_ 1420 RSDS_L_ObjRelAccelX_25 512;
BA_ "GenSigStartValue" SG_ 1420 RSDS_L_ObjRelAccelY_25 512;
BA_ "GenSigStartValue" SG_ 1420 RSDS_L_ObjMeasured_25 1;
BA_ "GenSigStartValue" SG_ 1420 RSDS_L_ObjRCS_25 400;
BA_ "GenSigStartValue" SG_ 1420 RSDS_L_ObjDistY_26 1024;
BA_ "GenSigStartValue" SG_ 1420 RSDS_L_ObjRelVelX_26 4102;
BA_ "GenSigStartValue" SG_ 1420 RSDS_L_ObjRelVelY_26 4102;
BA_ "GenSigStartValue" SG_ 1420 RSDS_L_ObjRelAccelX_26 512;
BA_ "GenSigStartValue" SG_ 1420 RSDS_L_ObjRelAccelY_26 512;
BA_ "GenSigStartValue" SG_ 1420 RSDS_L_ObjMeasured_26 1;
BA_ "GenSigStartValue" SG_ 1420 RSDS_L_ObjRCS_26 400;
BA_ "GenSigStartValue" SG_ 1421 RSDS_L_ObjDistY_27 1024;
BA_ "GenSigStartValue" SG_ 1421 RSDS_L_ObjRelVelX_27 4102;
BA_ "GenSigStartValue" SG_ 1421 RSDS_L_ObjRelVelY_27 4102;
BA_ "GenSigStartValue" SG_ 1421 RSDS_L_ObjRelAccelX_27 512;
BA_ "GenSigStartValue" SG_ 1421 RSDS_L_ObjRelAccelY_27 512;
BA_ "GenSigStartValue" SG_ 1421 RSDS_L_ObjMeasured_27 1;
BA_ "GenSigStartValue" SG_ 1421 RSDS_L_ObjRCS_27 400;
BA_ "GenSigStartValue" SG_ 1421 RSDS_L_ObjDistY_28 1024;
BA_ "GenSigStartValue" SG_ 1421 RSDS_L_ObjRelVelX_28 4102;
BA_ "GenSigStartValue" SG_ 1421 RSDS_L_ObjRelVelY_28 4102;
BA_ "GenSigStartValue" SG_ 1421 RSDS_L_ObjRelAccelX_28 512;
BA_ "GenSigStartValue" SG_ 1421 RSDS_L_ObjRelAccelY_28 512;
BA_ "GenSigStartValue" SG_ 1421 RSDS_L_ObjMeasured_28 1;
BA_ "GenSigStartValue" SG_ 1421 RSDS_L_ObjRCS_28 400;
BA_ "GenSigStartValue" SG_ 1422 RSDS_L_ObjDistY_29 1024;
BA_ "GenSigStartValue" SG_ 1422 RSDS_L_ObjRelVelX_29 4102;
BA_ "GenSigStartValue" SG_ 1422 RSDS_L_ObjRelVelY_29 4102;
BA_ "GenSigStartValue" SG_ 1422 RSDS_L_ObjRelAccelX_29 512;
BA_ "GenSigStartValue" SG_ 1422 RSDS_L_ObjRelAccelY_29 512;
BA_ "GenSigStartValue" SG_ 1422 RSDS_L_ObjMeasured_29 1;
BA_ "GenSigStartValue" SG_ 1422 RSDS_L_ObjRCS_29 400;
BA_ "GenSigStartValue" SG_ 1422 RSDS_L_ObjDistY_30 1024;
BA_ "GenSigStartValue" SG_ 1422 RSDS_L_ObjRelVelX_30 4102;
BA_ "GenSigStartValue" SG_ 1422 RSDS_L_ObjRelVelY_30 4102;
BA_ "GenSigStartValue" SG_ 1422 RSDS_L_ObjRelAccelX_30 512;
BA_ "GenSigStartValue" SG_ 1422 RSDS_L_ObjRelAccelY_30 512;
BA_ "GenSigStartValue" SG_ 1422 RSDS_L_ObjMeasured_30 1;
BA_ "GenSigStartValue" SG_ 1422 RSDS_L_ObjRCS_30 400;
BA_ "GenSigStartValue" SG_ 1423 RSDS_L_ObjDistY_31 1024;
BA_ "GenSigStartValue" SG_ 1423 RSDS_L_ObjRelVelX_31 4102;
BA_ "GenSigStartValue" SG_ 1423 RSDS_L_ObjRelVelY_31 4102;
BA_ "GenSigStartValue" SG_ 1423 RSDS_L_ObjRelAccelX_31 512;
BA_ "GenSigStartValue" SG_ 1423 RSDS_L_ObjRelAccelY_31 512;
BA_ "GenSigStartValue" SG_ 1423 RSDS_L_ObjMeasured_31 1;
BA_ "GenSigStartValue" SG_ 1423 RSDS_L_ObjRCS_31 400;
BA_ "GenSigStartValue" SG_ 1423 RSDS_L_ObjDistY_32 1024;
BA_ "GenSigStartValue" SG_ 1423 RSDS_L_ObjRelVelX_32 4102;
BA_ "GenSigStartValue" SG_ 1423 RSDS_L_ObjRelVelY_32 4102;
BA_ "GenSigStartValue" SG_ 1423 RSDS_L_ObjRelAccelX_32 512;
BA_ "GenSigStartValue" SG_ 1423 RSDS_L_ObjRelAccelY_32 512;
BA_ "GenSigStartValue" SG_ 1423 RSDS_L_ObjMeasured_32 1;
BA_ "GenSigStartValue" SG_ 1423 RSDS_L_ObjRCS_32 400;
BA_ "GenSigStartValue" SG_ 1432 RSDS_R_ObjDistY_17 1024;
BA_ "GenSigStartValue" SG_ 1432 RSDS_R_ObjRelVelX_17 4102;
BA_ "GenSigStartValue" SG_ 1432 RSDS_R_ObjRelVelY_17 4102;
BA_ "GenSigStartValue" SG_ 1432 RSDS_R_ObjRelAccelX_17 512;
BA_ "GenSigStartValue" SG_ 1432 RSDS_R_ObjRelAccelY_17 512;
BA_ "GenSigStartValue" SG_ 1432 RSDS_R_ObjMeasured_17 1;
BA_ "GenSigStartValue" SG_ 1432 RSDS_R_ObjRCS_17 400;
BA_ "GenSigStartValue" SG_ 1432 RSDS_R_ObjDistY_18 1024;
BA_ "GenSigStartValue" SG_ 1432 RSDS_R_ObjRelVelX_18 4102;
BA_ "GenSigStartValue" SG_ 1432 RSDS_R_ObjRelVelY_18 4102;
BA_ "GenSigStartValue" SG_ 1432 RSDS_R_ObjRelAccelX_18 512;
BA_ "GenSigStartValue" SG_ 1432 RSDS_R_ObjRelAccelY_18 512;
BA_ "GenSigStartValue" SG_ 1432 RSDS_R_ObjMeasured_18 1;
BA_ "GenSigStartValue" SG_ 1432 RSDS_R_ObjRCS_18 400;
BA_ "GenSigStartValue" SG_ 1433 RSDS_R_ObjDistY_19 1024;
BA_ "GenSigStartValue" SG_ 1433 RSDS_R_ObjRelVelX_19 4102;
BA_ "GenSigStartValue" SG_ 1433 RSDS_R_ObjRelVelY_19 4102;
BA_ "GenSigStartValue" SG_ 1433 RSDS_R_ObjRelAccelX_19 512;
BA_ "GenSigStartValue" SG_ 1433 RSDS_R_ObjRelAccelY_19 512;
BA_ "GenSigStartValue" SG_ 1433 RSDS_R_ObjMeasured_19 1;
BA_ "GenSigStartValue" SG_ 1433 RSDS_R_ObjRCS_19 400;
BA_ "GenSigStartValue" SG_ 1433 RSDS_R_ObjDistY_20 1024;
BA_ "GenSigStartValue" SG_ 1433 RSDS_R_ObjRelVelX_20 4102;
BA_ "GenSigStartValue" SG_ 1433 RSDS_R_ObjRelVelY_20 4102;
BA_ "GenSigStartValue" SG_ 1433 RSDS_R_ObjRelAccelX_20 512;
BA_ "GenSigStartValue" SG_ 1433 RSDS_R_ObjRelAccelY_20 512;
BA_ "GenSigStartValue" SG_ 1433 RSDS_R_ObjMeasured_20 1;
BA_ "GenSigStartValue" SG_ 1433 RSDS_R_ObjRCS_20 400;
BA_ "GenSigStartValue" SG_ 1434 RSDS_R_ObjDistY_21 1024;
BA_ "GenSigStartValue" SG_ 1434 RSDS_R_ObjRelVelX_21 4102;
BA_ "GenSigStartValue" SG_ 1434 RSDS_R_ObjRelVelY_21 4102;
BA_ "GenSigStartValue" SG_ 1434 RSDS_R_ObjRelAccelX_21 512;
BA_ "GenSigStartValue" SG_ 1434 RSDS_R_ObjRelAccelY_21 512;
BA_ "GenSigStartValue" SG_ 1434 RSDS_R_ObjMeasured_21 1;
BA_ "GenSigStartValue" SG_ 1434 RSDS_R_ObjRCS_21 400;
BA_ "GenSigStartValue" SG_ 1434 RSDS_R_ObjDistY_22 1024;
BA_ "GenSigStartValue" SG_ 1434 RSDS_R_ObjRelVelX_22 4102;
BA_ "GenSigStartValue" SG_ 1434 RSDS_R_ObjRelVelY_22 4102;
BA_ "GenSigStartValue" SG_ 1434 RSDS_R_ObjRelAccelX_22 512;
BA_ "GenSigStartValue" SG_ 1434 RSDS_R_ObjRelAccelY_22 512;
BA_ "GenSigStartValue" SG_ 1434 RSDS_R_ObjMeasured_22 1;
BA_ "GenSigStartValue" SG_ 1434 RSDS_R_ObjRCS_22 400;
BA_ "GenSigStartValue" SG_ 1435 RSDS_R_ObjDistY_23 1024;
BA_ "GenSigStartValue" SG_ 1435 RSDS_R_ObjRelVelX_23 4102;
BA_ "GenSigStartValue" SG_ 1435 RSDS_R_ObjRelVelY_23 4102;
BA_ "GenSigStartValue" SG_ 1435 RSDS_R_ObjRelAccelX_23 512;
BA_ "GenSigStartValue" SG_ 1435 RSDS_R_ObjRelAccelY_23 512;
BA_ "GenSigStartValue" SG_ 1435 RSDS_R_ObjMeasured_23 1;
BA_ "GenSigStartValue" SG_ 1435 RSDS_R_ObjRCS_23 400;
BA_ "GenSigStartValue" SG_ 1435 RSDS_R_ObjDistY_24 1024;
BA_ "GenSigStartValue" SG_ 1435 RSDS_R_ObjRelVelX_24 4102;
BA_ "GenSigStartValue" SG_ 1435 RSDS_R_ObjRelVelY_24 4102;
BA_ "GenSigStartValue" SG_ 1435 RSDS_R_ObjRelAccelX_24 512;
BA_ "GenSigStartValue" SG_ 1435 RSDS_R_ObjRelAccelY_24 512;
BA_ "GenSigStartValue" SG_ 1435 RSDS_R_ObjMeasured_24 1;
BA_ "GenSigStartValue" SG_ 1435 RSDS_R_ObjRCS_24 400;
BA_ "GenSigStartValue" SG_ 1436 RSDS_R_ObjDistY_25 1024;
BA_ "GenSigStartValue" SG_ 1436 RSDS_R_ObjRelVelX_25 4102;
BA_ "GenSigStartValue" SG_ 1436 RSDS_R_ObjRelVelY_25 4102;
BA_ "GenSigStartValue" SG_ 1436 RSDS_R_ObjRelAccelX_25 512;
BA_ "GenSigStartValue" SG_ 1436 RSDS_R_ObjRelAccelY_25 512;
BA_ "GenSigStartValue" SG_ 1436 RSDS_R_ObjMeasured_25 1;
BA_ "GenSigStartValue" SG_ 1436 RSDS_R_ObjRCS_25 400;
BA_ "GenSigStartValue" SG_ 1436 RSDS_R_ObjDistY_26 1024;
BA_ "GenSigStartValue" SG_ 1436 RSDS_R_ObjRelVelX_26 4102;
BA_ "GenSigStartValue" SG_ 1436 RSDS_R_ObjRelVelY_26 4102;
BA_ "GenSigStartValue" SG_ 1436 RSDS_R_ObjRelAccelX_26 512;
BA_ "GenSigStartValue" SG_ 1436 RSDS_R_ObjRelAccelY_26 512;
BA_ "GenSigStartValue" SG_ 1436 RSDS_R_ObjMeasured_26 1;
BA_ "GenSigStartValue" SG_ 1436 RSDS_R_ObjRCS_26 400;
BA_ "GenSigStartValue" SG_ 1437 RSDS_R_ObjDistY_27 1024;
BA_ "GenSigStartValue" SG_ 1437 RSDS_R_ObjRelVelX_27 4102;
BA_ "GenSigStartValue" SG_ 1437 RSDS_R_ObjRelVelY_27 4102;
BA_ "GenSigStartValue" SG_ 1437 RSDS_R_ObjRelAccelX_27 512;
BA_ "GenSigStartValue" SG_ 1437 RSDS_R_ObjRelAccelY_27 512;
BA_ "GenSigStartValue" SG_ 1437 RSDS_R_ObjMeasured_27 1;
BA_ "GenSigStartValue" SG_ 1437 RSDS_R_ObjRCS_27 400;
BA_ "GenSigStartValue" SG_ 1437 RSDS_R_ObjDistY_28 1024;
BA_ "GenSigStartValue" SG_ 1437 RSDS_R_ObjRelVelX_28 4102;
BA_ "GenSigStartValue" SG_ 1437 RSDS_R_ObjRelVelY_28 4102;
BA_ "GenSigStartValue" SG_ 1437 RSDS_R_ObjRelAccelX_28 512;
BA_ "GenSigStartValue" SG_ 1437 RSDS_R_ObjRelAccelY_28 512;
BA_ "GenSigStartValue" SG_ 1437 RSDS_R_ObjMeasured_28 1;
BA_ "GenSigStartValue" SG_ 1437 RSDS_R_ObjRCS_28 400;
BA_ "GenSigStartValue" SG_ 1438 RSDS_R_ObjDistY_29 1024;
BA_ "GenSigStartValue" SG_ 1438 RSDS_R_ObjRelVelX_29 4102;
BA_ "GenSigStartValue" SG_ 1438 RSDS_R_ObjRelVelY_29 4102;
BA_ "GenSigStartValue" SG_ 1438 RSDS_R_ObjRelAccelX_29 512;
BA_ "GenSigStartValue" SG_ 1438 RSDS_R_ObjRelAccelY_29 512;
BA_ "GenSigStartValue" SG_ 1438 RSDS_R_ObjMeasured_29 1;
BA_ "GenSigStartValue" SG_ 1438 RSDS_R_ObjRCS_29 400;
BA_ "GenSigStartValue" SG_ 1438 RSDS_R_ObjDistY_30 1024;
BA_ "GenSigStartValue" SG_ 1438 RSDS_R_ObjRelVelX_30 4102;
BA_ "GenSigStartValue" SG_ 1438 RSDS_R_ObjRelVelY_30 4102;
BA_ "GenSigStartValue" SG_ 1438 RSDS_R_ObjRelAccelX_30 512;
BA_ "GenSigStartValue" SG_ 1438 RSDS_R_ObjRelAccelY_30 512;
BA_ "GenSigStartValue" SG_ 1438 RSDS_R_ObjMeasured_30 1;
BA_ "GenSigStartValue" SG_ 1438 RSDS_R_ObjRCS_30 400;
BA_ "GenSigStartValue" SG_ 1439 RSDS_R_ObjDistY_31 1024;
BA_ "GenSigStartValue" SG_ 1439 RSDS_R_ObjRelVelX_31 4102;
BA_ "GenSigStartValue" SG_ 1439 RSDS_R_ObjRelVelY_31 4102;
BA_ "GenSigStartValue" SG_ 1439 RSDS_R_ObjRelAccelX_31 512;
BA_ "GenSigStartValue" SG_ 1439 RSDS_R_ObjRelAccelY_31 512;
BA_ "GenSigStartValue" SG_ 1439 RSDS_R_ObjMeasured_31 1;
BA_ "GenSigStartValue" SG_ 1439 RSDS_R_ObjRCS_31 400;
BA_ "GenSigStartValue" SG_ 1439 RSDS_R_ObjDistY_32 1024;
BA_ "GenSigStartValue" SG_ 1439 RSDS_R_ObjRelVelX_32 4102;
BA_ "GenSigStartValue" SG_ 1439 RSDS_R_ObjRelVelY_32 4102;
BA_ "GenSigStartValue" SG_ 1439 RSDS_R_ObjRelAccelX_32 512;
BA_ "GenSigStartValue" SG_ 1439 RSDS_R_ObjRelAccelY_32 512;
BA_ "GenSigStartValue" SG_ 1439 RSDS_R_ObjMeasured_32 1;
BA_ "GenSigStartValue" SG_ 1439 RSDS_R_ObjRCS_32 400;
BA_ "GenSigStartValue" SG_ 1104 RSDS_HWA_L_ObjDistY_1 1024;
BA_ "GenSigStartValue" SG_ 1104 RSDS_HWA_L_ObjRelVelX_1 4102;
BA_ "GenSigStartValue" SG_ 1104 RSDS_HWA_L_ObjRelVelY_1 4102;
BA_ "GenSigStartValue" SG_ 1104 RSDS_HWA_L_ObjRelAccelX_1 512;
BA_ "GenSigStartValue" SG_ 1104 RSDS_HWA_L_ObjRelAccelY_1 512;
BA_ "GenSigStartValue" SG_ 1104 RSDS_HWA_L_ObjDistY_2 1024;
BA_ "GenSigStartValue" SG_ 1104 RSDS_HWA_L_ObjRelVelX_2 4102;
BA_ "GenSigStartValue" SG_ 1104 RSDS_HWA_L_ObjRelVelY_2 4102;
BA_ "GenSigStartValue" SG_ 1104 RSDS_HWA_L_ObjRelAccelX_2 512;
BA_ "GenSigStartValue" SG_ 1104 RSDS_HWA_L_ObjRelAccelY_2 512;
BA_ "GenSigStartValue" SG_ 1105 RSDS_HWA_L_ObjDistY_3 1024;
BA_ "GenSigStartValue" SG_ 1105 RSDS_HWA_L_ObjRelVelX_3 4102;
BA_ "GenSigStartValue" SG_ 1105 RSDS_HWA_L_ObjRelVelY_3 4102;
BA_ "GenSigStartValue" SG_ 1105 RSDS_HWA_L_ObjRelAccelX_3 512;
BA_ "GenSigStartValue" SG_ 1105 RSDS_HWA_L_ObjRelAccelY_3 512;
BA_ "GenSigStartValue" SG_ 1105 RSDS_HWA_L_ObjDistY_4 1024;
BA_ "GenSigStartValue" SG_ 1105 RSDS_HWA_L_ObjRelVelX_4 4102;
BA_ "GenSigStartValue" SG_ 1105 RSDS_HWA_L_ObjRelVelY_4 4102;
BA_ "GenSigStartValue" SG_ 1105 RSDS_HWA_L_ObjRelAccelX_4 512;
BA_ "GenSigStartValue" SG_ 1105 RSDS_HWA_L_ObjRelAccelY_4 512;
BA_ "GenSigStartValue" SG_ 1106 RSDS_HWA_L_ObjDistY_5 1024;
BA_ "GenSigStartValue" SG_ 1106 RSDS_HWA_L_ObjRelVelX_5 4102;
BA_ "GenSigStartValue" SG_ 1106 RSDS_HWA_L_ObjRelVelY_5 4102;
BA_ "GenSigStartValue" SG_ 1106 RSDS_HWA_L_ObjRelAccelX_5 512;
BA_ "GenSigStartValue" SG_ 1106 RSDS_HWA_L_ObjRelAccelY_5 512;
BA_ "GenSigStartValue" SG_ 1106 RSDS_HWA_L_ObjDistY_6 1024;
BA_ "GenSigStartValue" SG_ 1106 RSDS_HWA_L_ObjRelVelX_6 4102;
BA_ "GenSigStartValue" SG_ 1106 RSDS_HWA_L_ObjRelVelY_6 4102;
BA_ "GenSigStartValue" SG_ 1106 RSDS_HWA_L_ObjRelAccelX_6 512;
BA_ "GenSigStartValue" SG_ 1106 RSDS_HWA_L_ObjRelAccelY_6 512;
BA_ "GenSigStartValue" SG_ 1107 RSDS_HWA_R_ObjDistY_1 1024;
BA_ "GenSigStartValue" SG_ 1107 RSDS_HWA_R_ObjRelVelX_1 4102;
BA_ "GenSigStartValue" SG_ 1107 RSDS_HWA_R_ObjRelVelY_1 4102;
BA_ "GenSigStartValue" SG_ 1107 RSDS_HWA_R_ObjRelAccelX_1 512;
BA_ "GenSigStartValue" SG_ 1107 RSDS_HWA_R_ObjRelAccelY_1 512;
BA_ "GenSigStartValue" SG_ 1107 RSDS_HWA_R_ObjDistY_2 1024;
BA_ "GenSigStartValue" SG_ 1107 RSDS_HWA_R_ObjRelVelX_2 4102;
BA_ "GenSigStartValue" SG_ 1107 RSDS_HWA_R_ObjRelVelY_2 4102;
BA_ "GenSigStartValue" SG_ 1107 RSDS_HWA_R_ObjRelAccelX_2 512;
BA_ "GenSigStartValue" SG_ 1107 RSDS_HWA_R_ObjRelAccelY_2 512;
BA_ "GenSigStartValue" SG_ 1108 RSDS_HWA_R_ObjDistY_3 1024;
BA_ "GenSigStartValue" SG_ 1108 RSDS_HWA_R_ObjRelVelX_3 4102;
BA_ "GenSigStartValue" SG_ 1108 RSDS_HWA_R_ObjRelVelY_3 4102;
BA_ "GenSigStartValue" SG_ 1108 RSDS_HWA_R_ObjRelAccelX_3 512;
BA_ "GenSigStartValue" SG_ 1108 RSDS_HWA_R_ObjRelAccelY_3 512;
BA_ "GenSigStartValue" SG_ 1108 RSDS_HWA_R_ObjDistY_4 1024;
BA_ "GenSigStartValue" SG_ 1108 RSDS_HWA_R_ObjRelVelX_4 4102;
BA_ "GenSigStartValue" SG_ 1108 RSDS_HWA_R_ObjRelVelY_4 4102;
BA_ "GenSigStartValue" SG_ 1108 RSDS_HWA_R_ObjRelAccelX_4 512;
BA_ "GenSigStartValue" SG_ 1108 RSDS_HWA_R_ObjRelAccelY_4 512;
BA_ "GenSigStartValue" SG_ 1109 RSDS_HWA_R_ObjDistY_5 1024;
BA_ "GenSigStartValue" SG_ 1109 RSDS_HWA_R_ObjRelVelX_5 4102;
BA_ "GenSigStartValue" SG_ 1109 RSDS_HWA_R_ObjRelVelY_5 4102;
BA_ "GenSigStartValue" SG_ 1109 RSDS_HWA_R_ObjRelAccelX_5 512;
BA_ "GenSigStartValue" SG_ 1109 RSDS_HWA_R_ObjRelAccelY_5 512;
BA_ "GenSigStartValue" SG_ 1109 RSDS_HWA_R_ObjDistY_6 1024;
BA_ "GenSigStartValue" SG_ 1109 RSDS_HWA_R_ObjRelVelX_6 4102;
BA_ "GenSigStartValue" SG_ 1109 RSDS_HWA_R_ObjRelVelY_6 4102;
BA_ "GenSigStartValue" SG_ 1109 RSDS_HWA_R_ObjRelAccelX_6 512;
BA_ "GenSigStartValue" SG_ 1109 RSDS_HWA_R_ObjRelAccelY_6 512;
VAL_ 1417 RSDS_L_ObjType_19 0 "Unknown" 1 "Truck" 2 "Car" 3 "Pedestrian" 4 "Cyclist" ;
VAL_ 1417 RSDS_L_ObjMotionType_19 0 "InitialValue" 1 "Unknown" 2 "Drive" 3 "Stopped" 4 "Stand" ;
VAL_ 1417 RSDS_L_ObjMeasured_19 0 "InitialValue" 1 "Measured" 2 "Predicted" ;
VAL_ 1417 RSDS_L_ObjMotionDirection_19 0 "InitialValue" 1 "Inversedirection" 2 "Samedirection" 3 "Cross" ;
VAL_ 1417 RSDS_L_ObjRefPoint_19 0 "Rear" 1 "Rearleft" 2 "Left" 3 "Frontleft" 4 "Front" 5 "FrontRight" 6 "Right" 7 "Rearright" ;
VAL_ 1417 RSDS_L_HWATargetValidity_19 0 "NOTHWATarget" 1 "HWATarget" ;
VAL_ 1417 RSDS_L_ObjType_20 0 "Unknown" 1 "Truck" 2 "Car" 3 "Pedestrian" 4 "Cyclist" ;
VAL_ 1417 RSDS_L_ObjMotionType_20 0 "InitialValue" 1 "Unknown" 2 "Drive" 3 "Stopped" 4 "Stand" ;
VAL_ 1417 RSDS_L_ObjMeasured_20 0 "InitialValue" 1 "Measured" 2 "Predicted" ;
VAL_ 1417 RSDS_L_ObjMotionDirection_20 0 "InitialValue" 1 "Inversedirection" 2 "Samedirection" 3 "Cross" ;
VAL_ 1417 RSDS_L_ObjRefPoint_20 0 "Rear" 1 "Rearleft" 2 "Left" 3 "Frontleft" 4 "Front" 5 "FrontRight" 6 "Right" 7 "Rearright" ;
VAL_ 1417 RSDS_L_HWATargetValidity_20 0 "NOTHWATarget" 1 "HWATarget" ;
VAL_ 1417 RSDS_L_ObjValid_19 0 "Validvalues" 1 "invalidvalues" ;
VAL_ 1417 RSDS_L_ObjValid_20 0 "Validvalues" 1 "invalidvalues" ;
VAL_ 1418 RSDS_L_ObjType_21 0 "Unknown" 1 "Truck" 2 "Car" 3 "Pedestrian" 4 "Cyclist" ;
VAL_ 1418 RSDS_L_ObjMotionType_21 0 "InitialValue" 1 "Unknown" 2 "Drive" 3 "Stopped" 4 "Stand" ;
VAL_ 1418 RSDS_L_ObjMeasured_21 0 "InitialValue" 1 "Measured" 2 "Predicted" ;
VAL_ 1418 RSDS_L_ObjMotionDirection_21 0 "InitialValue" 1 "Inversedirection" 2 "Samedirection" 3 "Cross" ;
VAL_ 1418 RSDS_L_ObjRefPoint_21 0 "Rear" 1 "Rearleft" 2 "Left" 3 "Frontleft" 4 "Front" 5 "FrontRight" 6 "Right" 7 "Rearright" ;
VAL_ 1418 RSDS_L_HWATargetValidity_21 0 "NOTHWATarget" 1 "HWATarget" ;
VAL_ 1418 RSDS_L_ObjType_22 0 "Unknown" 1 "Truck" 2 "Car" 3 "Pedestrian" 4 "Cyclist" ;
VAL_ 1418 RSDS_L_ObjMotionType_22 0 "InitialValue" 1 "Unknown" 2 "Drive" 3 "Stopped" 4 "Stand" ;
VAL_ 1418 RSDS_L_ObjMeasured_22 0 "InitialValue" 1 "Measured" 2 "Predicted" ;
VAL_ 1418 RSDS_L_ObjMotionDirection_22 0 "InitialValue" 1 "Inversedirection" 2 "Samedirection" 3 "Cross" ;
VAL_ 1418 RSDS_L_ObjRefPoint_22 0 "Rear" 1 "Rearleft" 2 "Left" 3 "Frontleft" 4 "Front" 5 "FrontRight" 6 "Right" 7 "Rearright" ;
VAL_ 1418 RSDS_L_HWATargetValidity_22 0 "NOTHWATarget" 1 "HWATarget" ;
VAL_ 1418 RSDS_L_ObjValid_21 0 "Validvalues" 1 "invalidvalues" ;
VAL_ 1418 RSDS_L_ObjValid_22 0 "Validvalues" 1 "invalidvalues" ;
VAL_ 1419 RSDS_L_ObjType_23 0 "Unknown" 1 "Truck" 2 "Car" 3 "Pedestrian" 4 "Cyclist" ;
VAL_ 1419 RSDS_L_ObjMotionType_23 0 "InitialValue" 1 "Unknown" 2 "Drive" 3 "Stopped" 4 "Stand" ;
VAL_ 1419 RSDS_L_ObjMeasured_23 0 "InitialValue" 1 "Measured" 2 "Predicted" ;
VAL_ 1419 RSDS_L_ObjMotionDirection_23 0 "InitialValue" 1 "Inversedirection" 2 "Samedirection" 3 "Cross" ;
VAL_ 1419 RSDS_L_ObjRefPoint_23 0 "Rear" 1 "Rearleft" 2 "Left" 3 "Frontleft" 4 "Front" 5 "FrontRight" 6 "Right" 7 "Rearright" ;
VAL_ 1419 RSDS_L_HWATargetValidity_23 0 "NOTHWATarget" 1 "HWATarget" ;
VAL_ 1419 RSDS_L_ObjType_24 0 "Unknown" 1 "Truck" 2 "Car" 3 "Pedestrian" 4 "Cyclist" ;
VAL_ 1419 RSDS_L_ObjMotionType_24 0 "InitialValue" 1 "Unknown" 2 "Drive" 3 "Stopped" 4 "Stand" ;
VAL_ 1419 RSDS_L_ObjMeasured_24 0 "InitialValue" 1 "Measured" 2 "Predicted" ;
VAL_ 1419 RSDS_L_ObjMotionDirection_24 0 "InitialValue" 1 "Inversedirection" 2 "Samedirection" 3 "Cross" ;
VAL_ 1419 RSDS_L_ObjRefPoint_24 0 "Rear" 1 "Rearleft" 2 "Left" 3 "Frontleft" 4 "Front" 5 "FrontRight" 6 "Right" 7 "Rearright" ;
VAL_ 1419 RSDS_L_HWATargetValidity_24 0 "NOTHWATarget" 1 "HWATarget" ;
VAL_ 1419 RSDS_L_ObjValid_23 0 "Validvalues" 1 "invalidvalues" ;
VAL_ 1419 RSDS_L_ObjValid_24 0 "Validvalues" 1 "invalidvalues" ;
VAL_ 1420 RSDS_L_ObjType_25 0 "Unknown" 1 "Truck" 2 "Car" 3 "Pedestrian" 4 "Cyclist" ;
VAL_ 1420 RSDS_L_ObjMotionType_25 0 "InitialValue" 1 "Unknown" 2 "Drive" 3 "Stopped" 4 "Stand" ;
VAL_ 1420 RSDS_L_ObjMeasured_25 0 "InitialValue" 1 "Measured" 2 "Predicted" ;
VAL_ 1420 RSDS_L_ObjMotionDirection_25 0 "InitialValue" 1 "Inversedirection" 2 "Samedirection" 3 "Cross" ;
VAL_ 1420 RSDS_L_ObjRefPoint_25 0 "Rear" 1 "Rearleft" 2 "Left" 3 "Frontleft" 4 "Front" 5 "FrontRight" 6 "Right" 7 "Rearright" ;
VAL_ 1420 RSDS_L_HWATargetValidity_25 0 "NOTHWATarget" 1 "HWATarget" ;
VAL_ 1420 RSDS_L_ObjType_26 0 "Unknown" 1 "Truck" 2 "Car" 3 "Pedestrian" 4 "Cyclist" ;
VAL_ 1420 RSDS_L_ObjMotionType_26 0 "InitialValue" 1 "Unknown" 2 "Drive" 3 "Stopped" 4 "Stand" ;
VAL_ 1420 RSDS_L_ObjMeasured_26 0 "InitialValue" 1 "Measured" 2 "Predicted" ;
VAL_ 1420 RSDS_L_ObjMotionDirection_26 0 "InitialValue" 1 "Inversedirection" 2 "Samedirection" 3 "Cross" ;
VAL_ 1420 RSDS_L_ObjRefPoint_26 0 "Rear" 1 "Rearleft" 2 "Left" 3 "Frontleft" 4 "Front" 5 "FrontRight" 6 "Right" 7 "Rearright" ;
VAL_ 1420 RSDS_L_HWATargetValidity_26 0 "NOTHWATarget" 1 "HWATarget" ;
VAL_ 1420 RSDS_L_ObjValid_25 0 "Validvalues" 1 "invalidvalues" ;
VAL_ 1420 RSDS_L_ObjValid_26 0 "Validvalues" 1 "invalidvalues" ;
VAL_ 1421 RSDS_L_ObjType_27 0 "Unknown" 1 "Truck" 2 "Car" 3 "Pedestrian" 4 "Cyclist" ;
VAL_ 1421 RSDS_L_ObjMotionType_27 0 "InitialValue" 1 "Unknown" 2 "Drive" 3 "Stopped" 4 "Stand" ;
VAL_ 1421 RSDS_L_ObjMeasured_27 0 "InitialValue" 1 "Measured" 2 "Predicted" ;
VAL_ 1421 RSDS_L_ObjMotionDirection_27 0 "InitialValue" 1 "Inversedirection" 2 "Samedirection" 3 "Cross" ;
VAL_ 1421 RSDS_L_ObjRefPoint_27 0 "Rear" 1 "Rearleft" 2 "Left" 3 "Frontleft" 4 "Front" 5 "FrontRight" 6 "Right" 7 "Rearright" ;
VAL_ 1421 RSDS_L_HWATargetValidity_27 0 "NOTHWATarget" 1 "HWATarget" ;
VAL_ 1421 RSDS_L_ObjType_28 0 "Unknown" 1 "Truck" 2 "Car" 3 "Pedestrian" 4 "Cyclist" ;
VAL_ 1421 RSDS_L_ObjMotionType_28 0 "InitialValue" 1 "Unknown" 2 "Drive" 3 "Stopped" 4 "Stand" ;
VAL_ 1421 RSDS_L_ObjMeasured_28 0 "InitialValue" 1 "Measured" 2 "Predicted" ;
VAL_ 1421 RSDS_L_ObjMotionDirection_28 0 "InitialValue" 1 "Inversedirection" 2 "Samedirection" 3 "Cross" ;
VAL_ 1421 RSDS_L_ObjRefPoint_28 0 "Rear" 1 "Rearleft" 2 "Left" 3 "Frontleft" 4 "Front" 5 "FrontRight" 6 "Right" 7 "Rearright" ;
VAL_ 1421 RSDS_L_HWATargetValidity_28 0 "NOTHWATarget" 1 "HWATarget" ;
VAL_ 1421 RSDS_L_ObjValid_27 0 "Validvalues" 1 "invalidvalues" ;
VAL_ 1421 RSDS_L_ObjValid_28 0 "Validvalues" 1 "invalidvalues" ;
VAL_ 1422 RSDS_L_ObjType_29 0 "Unknown" 1 "Truck" 2 "Car" 3 "Pedestrian" 4 "Cyclist" ;
VAL_ 1422 RSDS_L_ObjMotionType_29 0 "InitialValue" 1 "Unknown" 2 "Drive" 3 "Stopped" 4 "Stand" ;
VAL_ 1422 RSDS_L_ObjMeasured_29 0 "InitialValue" 1 "Measured" 2 "Predicted" ;
VAL_ 1422 RSDS_L_ObjMotionDirection_29 0 "InitialValue" 1 "Inversedirection" 2 "Samedirection" 3 "Cross" ;
VAL_ 1422 RSDS_L_ObjRefPoint_29 0 "Rear" 1 "Rearleft" 2 "Left" 3 "Frontleft" 4 "Front" 5 "FrontRight" 6 "Right" 7 "Rearright" ;
VAL_ 1422 RSDS_L_HWATargetValidity_29 0 "NOTHWATarget" 1 "HWATarget" ;
VAL_ 1422 RSDS_L_ObjType_30 0 "Unknown" 1 "Truck" 2 "Car" 3 "Pedestrian" 4 "Cyclist" ;
VAL_ 1422 RSDS_L_ObjMotionType_30 0 "InitialValue" 1 "Unknown" 2 "Drive" 3 "Stopped" 4 "Stand" ;
VAL_ 1422 RSDS_L_ObjMeasured_30 0 "InitialValue" 1 "Measured" 2 "Predicted" ;
VAL_ 1422 RSDS_L_ObjMotionDirection_30 0 "InitialValue" 1 "Inversedirection" 2 "Samedirection" 3 "Cross" ;
VAL_ 1422 RSDS_L_ObjRefPoint_30 0 "Rear" 1 "Rearleft" 2 "Left" 3 "Frontleft" 4 "Front" 5 "FrontRight" 6 "Right" 7 "Rearright" ;
VAL_ 1422 RSDS_L_HWATargetValidity_30 0 "NOTHWATarget" 1 "HWATarget" ;
VAL_ 1422 RSDS_L_ObjValid_29 0 "Validvalues" 1 "invalidvalues" ;
VAL_ 1422 RSDS_L_ObjValid_30 0 "Validvalues" 1 "invalidvalues" ;
VAL_ 1423 RSDS_L_ObjType_31 0 "Unknown" 1 "Truck" 2 "Car" 3 "Pedestrian" 4 "Cyclist" ;
VAL_ 1423 RSDS_L_ObjMotionType_31 0 "InitialValue" 1 "Unknown" 2 "Drive" 3 "Stopped" 4 "Stand" ;
VAL_ 1423 RSDS_L_ObjMeasured_31 0 "InitialValue" 1 "Measured" 2 "Predicted" ;
VAL_ 1423 RSDS_L_ObjMotionDirection_31 0 "InitialValue" 1 "Inversedirection" 2 "Samedirection" 3 "Cross" ;
VAL_ 1423 RSDS_L_ObjRefPoint_31 0 "Rear" 1 "Rearleft" 2 "Left" 3 "Frontleft" 4 "Front" 5 "FrontRight" 6 "Right" 7 "Rearright" ;
VAL_ 1423 RSDS_L_HWATargetValidity_31 0 "NOTHWATarget" 1 "HWATarget" ;
VAL_ 1423 RSDS_L_ObjType_32 0 "Unknown" 1 "Truck" 2 "Car" 3 "Pedestrian" 4 "Cyclist" ;
VAL_ 1423 RSDS_L_ObjMotionType_32 0 "InitialValue" 1 "Unknown" 2 "Drive" 3 "Stopped" 4 "Stand" ;
VAL_ 1423 RSDS_L_ObjMeasured_32 0 "InitialValue" 1 "Measured" 2 "Predicted" ;
VAL_ 1423 RSDS_L_ObjMotionDirection_32 0 "InitialValue" 1 "Inversedirection" 2 "Samedirection" 3 "Cross" ;
VAL_ 1423 RSDS_L_ObjRefPoint_32 0 "Rear" 1 "Rearleft" 2 "Left" 3 "Frontleft" 4 "Front" 5 "FrontRight" 6 "Right" 7 "Rearright" ;
VAL_ 1423 RSDS_L_HWATargetValidity_32 0 "NOTHWATarget" 1 "HWATarget" ;
VAL_ 1423 RSDS_L_ObjValid_31 0 "Validvalues" 1 "invalidvalues" ;
VAL_ 1423 RSDS_L_ObjValid_32 0 "Validvalues" 1 "invalidvalues" ;
VAL_ 1432 RSDS_R_ObjType_17 0 "Unknown" 1 "Truck" 2 "Car" 3 "Pedestrian" 4 "Cyclist" ;
VAL_ 1432 RSDS_R_ObjMotionType_17 0 "InitialValue" 1 "Unknown" 2 "Drive" 3 "Stopped" 4 "Stand" ;
VAL_ 1432 RSDS_R_ObjMeasured_17 0 "InitialValue" 1 "Measured" 2 "Predicted" ;
VAL_ 1432 RSDS_R_ObjMotionDirection_17 0 "InitialValue" 1 "Inversedirection" 2 "Samedirection" 3 "Cross" ;
VAL_ 1432 RSDS_R_ObjRefPoint_17 0 "Rear" 1 "Rearleft" 2 "Left" 3 "Frontleft" 4 "Front" 5 "FrontRight" 6 "Right" 7 "Rearright" ;
VAL_ 1432 RSDS_R_HWATargetValidity_17 0 "NOTHWATarget" 1 "HWATarget" ;
VAL_ 1432 RSDS_R_ObjType_18 0 "Unknown" 1 "Truck" 2 "Car" 3 "Pedestrian" 4 "Cyclist" ;
VAL_ 1432 RSDS_R_ObjMotionType_18 0 "InitialValue" 1 "Unknown" 2 "Drive" 3 "Stopped" 4 "Stand" ;
VAL_ 1432 RSDS_R_ObjMeasured_18 0 "InitialValue" 1 "Measured" 2 "Predicted" ;
VAL_ 1432 RSDS_R_ObjMotionDirection_18 0 "InitialValue" 1 "Inversedirection" 2 "Samedirection" 3 "Cross" ;
VAL_ 1432 RSDS_R_ObjRefPoint_18 0 "Rear" 1 "Rearleft" 2 "Left" 3 "Frontleft" 4 "Front" 5 "FrontRight" 6 "Right" 7 "Rearright" ;
VAL_ 1432 RSDS_R_HWATargetValidity_18 0 "NOTHWATarget" 1 "HWATarget" ;
VAL_ 1432 RSDS_R_ObjValid_17 0 "Validvalues" 1 "invalidvalues" ;
VAL_ 1432 RSDS_R_ObjValid_18 0 "Validvalues" 1 "invalidvalues" ;
VAL_ 1433 RSDS_R_ObjType_19 0 "Unknown" 1 "Truck" 2 "Car" 3 "Pedestrian" 4 "Cyclist" ;
VAL_ 1433 RSDS_R_ObjMotionType_19 0 "InitialValue" 1 "Unknown" 2 "Drive" 3 "Stopped" 4 "Stand" ;
VAL_ 1433 RSDS_R_ObjMeasured_19 0 "InitialValue" 1 "Measured" 2 "Predicted" ;
VAL_ 1433 RSDS_R_ObjMotionDirection_19 0 "InitialValue" 1 "Inversedirection" 2 "Samedirection" 3 "Cross" ;
VAL_ 1433 RSDS_R_ObjRefPoint_19 0 "Rear" 1 "Rearleft" 2 "Left" 3 "Frontleft" 4 "Front" 5 "FrontRight" 6 "Right" 7 "Rearright" ;
VAL_ 1433 RSDS_R_HWATargetValidity_19 0 "NOTHWATarget" 1 "HWATarget" ;
VAL_ 1433 RSDS_R_ObjType_20 0 "Unknown" 1 "Truck" 2 "Car" 3 "Pedestrian" 4 "Cyclist" ;
VAL_ 1433 RSDS_R_ObjMotionType_20 0 "InitialValue" 1 "Unknown" 2 "Drive" 3 "Stopped" 4 "Stand" ;
VAL_ 1433 RSDS_R_ObjMeasured_20 0 "InitialValue" 1 "Measured" 2 "Predicted" ;
VAL_ 1433 RSDS_R_ObjMotionDirection_20 0 "InitialValue" 1 "Inversedirection" 2 "Samedirection" 3 "Cross" ;
VAL_ 1433 RSDS_R_ObjRefPoint_20 0 "Rear" 1 "Rearleft" 2 "Left" 3 "Frontleft" 4 "Front" 5 "FrontRight" 6 "Right" 7 "Rearright" ;
VAL_ 1433 RSDS_R_HWATargetValidity_20 0 "NOTHWATarget" 1 "HWATarget" ;
VAL_ 1433 RSDS_R_ObjValid_19 0 "Validvalues" 1 "invalidvalues" ;
VAL_ 1433 RSDS_R_ObjValid_20 0 "Validvalues" 1 "invalidvalues" ;
VAL_ 1434 RSDS_R_ObjType_21 0 "Unknown" 1 "Truck" 2 "Car" 3 "Pedestrian" 4 "Cyclist" ;
VAL_ 1434 RSDS_R_ObjMotionType_21 0 "InitialValue" 1 "Unknown" 2 "Drive" 3 "Stopped" 4 "Stand" ;
VAL_ 1434 RSDS_R_ObjMeasured_21 0 "InitialValue" 1 "Measured" 2 "Predicted" ;
VAL_ 1434 RSDS_R_ObjMotionDirection_21 0 "InitialValue" 1 "Inversedirection" 2 "Samedirection" 3 "Cross" ;
VAL_ 1434 RSDS_R_ObjRefPoint_21 0 "Rear" 1 "Rearleft" 2 "Left" 3 "Frontleft" 4 "Front" 5 "FrontRight" 6 "Right" 7 "Rearright" ;
VAL_ 1434 RSDS_R_HWATargetValidity_21 0 "NOTHWATarget" 1 "HWATarget" ;
VAL_ 1434 RSDS_R_ObjType_22 0 "Unknown" 1 "Truck" 2 "Car" 3 "Pedestrian" 4 "Cyclist" ;
VAL_ 1434 RSDS_R_ObjMotionType_22 0 "InitialValue" 1 "Unknown" 2 "Drive" 3 "Stopped" 4 "Stand" ;
VAL_ 1434 RSDS_R_ObjMeasured_22 0 "InitialValue" 1 "Measured" 2 "Predicted" ;
VAL_ 1434 RSDS_R_ObjMotionDirection_22 0 "InitialValue" 1 "Inversedirection" 2 "Samedirection" 3 "Cross" ;
VAL_ 1434 RSDS_R_ObjRefPoint_22 0 "Rear" 1 "Rearleft" 2 "Left" 3 "Frontleft" 4 "Front" 5 "FrontRight" 6 "Right" 7 "Rearright" ;
VAL_ 1434 RSDS_R_HWATargetValidity_22 0 "NOTHWATarget" 1 "HWATarget" ;
VAL_ 1434 RSDS_R_ObjValid_21 0 "Validvalues" 1 "invalidvalues" ;
VAL_ 1434 RSDS_R_ObjValid_22 0 "Validvalues" 1 "invalidvalues" ;
VAL_ 1435 RSDS_R_ObjType_23 0 "Unknown" 1 "Truck" 2 "Car" 3 "Pedestrian" 4 "Cyclist" ;
VAL_ 1435 RSDS_R_ObjMotionType_23 0 "InitialValue" 1 "Unknown" 2 "Drive" 3 "Stopped" 4 "Stand" ;
VAL_ 1435 RSDS_R_ObjMeasured_23 0 "InitialValue" 1 "Measured" 2 "Predicted" ;
VAL_ 1435 RSDS_R_ObjMotionDirection_23 0 "InitialValue" 1 "Inversedirection" 2 "Samedirection" 3 "Cross" ;
VAL_ 1435 RSDS_R_ObjRefPoint_23 0 "Rear" 1 "Rearleft" 2 "Left" 3 "Frontleft" 4 "Front" 5 "FrontRight" 6 "Right" 7 "Rearright" ;
VAL_ 1435 RSDS_R_HWATargetValidity_23 0 "NOTHWATarget" 1 "HWATarget" ;
VAL_ 1435 RSDS_R_ObjType_24 0 "Unknown" 1 "Truck" 2 "Car" 3 "Pedestrian" 4 "Cyclist" ;
VAL_ 1435 RSDS_R_ObjMotionType_24 0 "InitialValue" 1 "Unknown" 2 "Drive" 3 "Stopped" 4 "Stand" ;
VAL_ 1435 RSDS_R_ObjMeasured_24 0 "InitialValue" 1 "Measured" 2 "Predicted" ;
VAL_ 1435 RSDS_R_ObjMotionDirection_24 0 "InitialValue" 1 "Inversedirection" 2 "Samedirection" 3 "Cross" ;
VAL_ 1435 RSDS_R_ObjRefPoint_24 0 "Rear" 1 "Rearleft" 2 "Left" 3 "Frontleft" 4 "Front" 5 "FrontRight" 6 "Right" 7 "Rearright" ;
VAL_ 1435 RSDS_R_HWATargetValidity_24 0 "NOTHWATarget" 1 "HWATarget" ;
VAL_ 1435 RSDS_R_ObjValid_23 0 "Validvalues" 1 "invalidvalues" ;
VAL_ 1435 RSDS_R_ObjValid_24 0 "Validvalues" 1 "invalidvalues" ;
VAL_ 1436 RSDS_R_ObjType_25 0 "Unknown" 1 "Truck" 2 "Car" 3 "Pedestrian" 4 "Cyclist" ;
VAL_ 1436 RSDS_R_ObjMotionType_25 0 "InitialValue" 1 "Unknown" 2 "Drive" 3 "Stopped" 4 "Stand" ;
VAL_ 1436 RSDS_R_ObjMeasured_25 0 "InitialValue" 1 "Measured" 2 "Predicted" ;
VAL_ 1436 RSDS_R_ObjMotionDirection_25 0 "InitialValue" 1 "Inversedirection" 2 "Samedirection" 3 "Cross" ;
VAL_ 1436 RSDS_R_ObjRefPoint_25 0 "Rear" 1 "Rearleft" 2 "Left" 3 "Frontleft" 4 "Front" 5 "FrontRight" 6 "Right" 7 "Rearright" ;
VAL_ 1436 RSDS_R_HWATargetValidity_25 0 "NOTHWATarget" 1 "HWATarget" ;
VAL_ 1436 RSDS_R_ObjType_26 0 "Unknown" 1 "Truck" 2 "Car" 3 "Pedestrian" 4 "Cyclist" ;
VAL_ 1436 RSDS_R_ObjMotionType_26 0 "InitialValue" 1 "Unknown" 2 "Drive" 3 "Stopped" 4 "Stand" ;
VAL_ 1436 RSDS_R_ObjMeasured_26 0 "InitialValue" 1 "Measured" 2 "Predicted" ;
VAL_ 1436 RSDS_R_ObjMotionDirection_26 0 "InitialValue" 1 "Inversedirection" 2 "Samedirection" 3 "Cross" ;
VAL_ 1436 RSDS_R_ObjRefPoint_26 0 "Rear" 1 "Rearleft" 2 "Left" 3 "Frontleft" 4 "Front" 5 "FrontRight" 6 "Right" 7 "Rearright" ;
VAL_ 1436 RSDS_R_HWATargetValidity_26 0 "NOTHWATarget" 1 "HWATarget" ;
VAL_ 1436 RSDS_R_ObjValid_25 0 "Validvalues" 1 "invalidvalues" ;
VAL_ 1436 RSDS_R_ObjValid_26 0 "Validvalues" 1 "invalidvalues" ;
VAL_ 1437 RSDS_R_ObjType_27 0 "Unknown" 1 "Truck" 2 "Car" 3 "Pedestrian" 4 "Cyclist" ;
VAL_ 1437 RSDS_R_ObjMotionType_27 0 "InitialValue" 1 "Unknown" 2 "Drive" 3 "Stopped" 4 "Stand" ;
VAL_ 1437 RSDS_R_ObjMeasured_27 0 "InitialValue" 1 "Measured" 2 "Predicted" ;
VAL_ 1437 RSDS_R_ObjMotionDirection_27 0 "InitialValue" 1 "Inversedirection" 2 "Samedirection" 3 "Cross" ;
VAL_ 1437 RSDS_R_ObjRefPoint_27 0 "Rear" 1 "Rearleft" 2 "Left" 3 "Frontleft" 4 "Front" 5 "FrontRight" 6 "Right" 7 "Rearright" ;
VAL_ 1437 RSDS_R_HWATargetValidity_27 0 "NOTHWATarget" 1 "HWATarget" ;
VAL_ 1437 RSDS_R_ObjType_28 0 "Unknown" 1 "Truck" 2 "Car" 3 "Pedestrian" 4 "Cyclist" ;
VAL_ 1437 RSDS_R_ObjMotionType_28 0 "InitialValue" 1 "Unknown" 2 "Drive" 3 "Stopped" 4 "Stand" ;
VAL_ 1437 RSDS_R_ObjMeasured_28 0 "InitialValue" 1 "Measured" 2 "Predicted" ;
VAL_ 1437 RSDS_R_ObjMotionDirection_28 0 "InitialValue" 1 "Inversedirection" 2 "Samedirection" 3 "Cross" ;
VAL_ 1437 RSDS_R_ObjRefPoint_28 0 "Rear" 1 "Rearleft" 2 "Left" 3 "Frontleft" 4 "Front" 5 "FrontRight" 6 "Right" 7 "Rearright" ;
VAL_ 1437 RSDS_R_HWATargetValidity_28 0 "NOTHWATarget" 1 "HWATarget" ;
VAL_ 1437 RSDS_R_ObjValid_27 0 "Validvalues" 1 "invalidvalues" ;
VAL_ 1437 RSDS_R_ObjValid_28 0 "Validvalues" 1 "invalidvalues" ;
VAL_ 1438 RSDS_R_ObjType_29 0 "Unknown" 1 "Truck" 2 "Car" 3 "Pedestrian" 4 "Cyclist" ;
VAL_ 1438 RSDS_R_ObjMotionType_29 0 "InitialValue" 1 "Unknown" 2 "Drive" 3 "Stopped" 4 "Stand" ;
VAL_ 1438 RSDS_R_ObjMeasured_29 0 "InitialValue" 1 "Measured" 2 "Predicted" ;
VAL_ 1438 RSDS_R_ObjMotionDirection_29 0 "InitialValue" 1 "Inversedirection" 2 "Samedirection" 3 "Cross" ;
VAL_ 1438 RSDS_R_ObjRefPoint_29 0 "Rear" 1 "Rearleft" 2 "Left" 3 "Frontleft" 4 "Front" 5 "FrontRight" 6 "Right" 7 "Rearright" ;
VAL_ 1438 RSDS_R_HWATargetValidity_29 0 "NOTHWATarget" 1 "HWATarget" ;
VAL_ 1438 RSDS_R_ObjType_30 0 "Unknown" 1 "Truck" 2 "Car" 3 "Pedestrian" 4 "Cyclist" ;
VAL_ 1438 RSDS_R_ObjMotionType_30 0 "InitialValue" 1 "Unknown" 2 "Drive" 3 "Stopped" 4 "Stand" ;
VAL_ 1438 RSDS_R_ObjMeasured_30 0 "InitialValue" 1 "Measured" 2 "Predicted" ;
VAL_ 1438 RSDS_R_ObjMotionDirection_30 0 "InitialValue" 1 "Inversedirection" 2 "Samedirection" 3 "Cross" ;
VAL_ 1438 RSDS_R_ObjRefPoint_30 0 "Rear" 1 "Rearleft" 2 "Left" 3 "Frontleft" 4 "Front" 5 "FrontRight" 6 "Right" 7 "Rearright" ;
VAL_ 1438 RSDS_R_HWATargetValidity_30 0 "NOTHWATarget" 1 "HWATarget" ;
VAL_ 1438 RSDS_R_ObjValid_29 0 "Validvalues" 1 "invalidvalues" ;
VAL_ 1438 RSDS_R_ObjValid_30 0 "Validvalues" 1 "invalidvalues" ;
VAL_ 1439 RSDS_R_ObjType_31 0 "Unknown" 1 "Truck" 2 "Car" 3 "Pedestrian" 4 "Cyclist" ;
VAL_ 1439 RSDS_R_ObjMotionType_31 0 "InitialValue" 1 "Unknown" 2 "Drive" 3 "Stopped" 4 "Stand" ;
VAL_ 1439 RSDS_R_ObjMeasured_31 0 "InitialValue" 1 "Measured" 2 "Predicted" ;
VAL_ 1439 RSDS_R_ObjMotionDirection_31 0 "InitialValue" 1 "Inversedirection" 2 "Samedirection" 3 "Cross" ;
VAL_ 1439 RSDS_R_ObjRefPoint_31 0 "Rear" 1 "Rearleft" 2 "Left" 3 "Frontleft" 4 "Front" 5 "FrontRight" 6 "Right" 7 "Rearright" ;
VAL_ 1439 RSDS_R_HWATargetValidity_31 0 "NOTHWATarget" 1 "HWATarget" ;
VAL_ 1439 RSDS_R_ObjType_32 0 "Unknown" 1 "Truck" 2 "Car" 3 "Pedestrian" 4 "Cyclist" ;
VAL_ 1439 RSDS_R_ObjMotionType_32 0 "InitialValue" 1 "Unknown" 2 "Drive" 3 "Stopped" 4 "Stand" ;
VAL_ 1439 RSDS_R_ObjMeasured_32 0 "InitialValue" 1 "Measured" 2 "Predicted" ;
VAL_ 1439 RSDS_R_ObjMotionDirection_32 0 "InitialValue" 1 "Inversedirection" 2 "Samedirection" 3 "Cross" ;
VAL_ 1439 RSDS_R_ObjRefPoint_32 0 "Rear" 1 "Rearleft" 2 "Left" 3 "Frontleft" 4 "Front" 5 "FrontRight" 6 "Right" 7 "Rearright" ;
VAL_ 1439 RSDS_R_HWATargetValidity_32 0 "NOTHWATarget" 1 "HWATarget" ;
VAL_ 1439 RSDS_R_ObjValid_31 0 "Validvalues" 1 "invalidvalues" ;
VAL_ 1439 RSDS_R_ObjValid_32 0 "Validvalues" 1 "invalidvalues" ;
VAL_ 1104 RSDS_HWA_L_ObjMeasured_1 0 "Init" 1 "Measured" 2 "Predicted" ;
VAL_ 1104 RSDS_HWA_L_ObjMeasured_2 0 "Init" 1 "Measured" 2 "Predicted" ;
VAL_ 1105 RSDS_HWA_L_ObjMeasured_3 0 "Init" 1 "Measured" 2 "Predicted" ;
VAL_ 1105 RSDS_HWA_L_ObjMeasured_4 0 "Init" 1 "Measured" 2 "Predicted" ;
VAL_ 1106 RSDS_HWA_L_ObjMeasured_5 0 "Init" 1 "Measured" 2 "Predicted" ;
VAL_ 1106 RSDS_HWA_L_ObjMeasured_6 0 "Init" 1 "Measured" 2 "Predicted" ;
VAL_ 1107 RSDS_HWA_R_ObjMeasured_1 0 "Init" 1 "Measured" 2 "Predicted" ;
VAL_ 1107 RSDS_HWA_R_ObjMeasured_2 0 "Init" 1 "Measured" 2 "Predicted" ;
VAL_ 1108 RSDS_HWA_R_ObjMeasured_3 0 "Init" 1 "Measured" 2 "Predicted" ;
VAL_ 1108 RSDS_HWA_R_ObjMeasured_4 0 "Init" 1 "Measured" 2 "Predicted" ;
VAL_ 1109 RSDS_HWA_R_ObjMeasured_5 0 "Init" 1 "Measured" 2 "Predicted" ;
VAL_ 1109 RSDS_HWA_R_ObjMeasured_6 0 "Init" 1 "Measured" 2 "Predicted" ;
