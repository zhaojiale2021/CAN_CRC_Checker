VERSION ""

NS_ :

BS_:

BU_: MPC FR

BO_ 1065 MRRAD_HEAD: 64 FR
 SG_ Checksum429 : 7|16@0+ (1,0) [0|65535] ""  MPC
 SG_ FR_hdr_AutosarTimeStamp : 31|26@0+ (1,0) [0|65535] "ms"  MPC
 SG_ FR_hdr_TimeStamp : 100|16@0+ (1,0) [0|255] "ms"  MPC
 SG_ FR_BLIND : 61|2@0+ (1,0) [0|3] ""  MPC
 SG_ RollingCounter429 : 23|8@0+ (1,0) [0|255] ""  MPC
 SG_ FR_hdr_ErrorStatus : 79|4@0+ (1,0) [0|15] ""  MPC
 SG_ FR_hdr_TimeStampStatus : 87|8@0+ (1,0) [0|255] ""  MPC
 SG_ BlockCounter0 : 75|4@0+ (1,0) [0|15] ""  MPC
 SG_ FR_ObjDetected : 95|6@0+ (1,0) [0|63] ""  MPC
 SG_ FR_hdr_TimeStampsecond : 147|32@0+ (1,0) [0|4294967295] "S"  MPC
 SG_ FR_ObjHdr_MountPosX : 395|9@0+ (0.02,-5.12) [-5.12|5.1] "m"  MPC
 SG_ FR_ObjHdr_MountPosY : 402|8@0+ (0.01,-1.28) [-1.28|1.27] "m"  MPC
 SG_ FR_ObjHdr_MountPosZ : 410|5@0+ (0.05,0) [0|1.55] "m"  MPC
 SG_ FR_ObjHdr_YawMountAngle : 421|16@0+ (0.00017,-5.57056) [-3.2|3.2] "rad"  MPC
 SG_ FR_ObjHdr_YawAngleLower : 347|15@0+ (0.00017,-2.78528) [-1.6|1.6] "rad"  MPC
 SG_ FR_ObjHdr_YawAngleUpper : 454|15@0+ (0.00017,-2.78528) [-1.6|1.6] "rad"  MPC
 SG_ FR_ObjHdr_PitchMountAngle : 471|12@0+ (0.00017,-0.34816) [-0.2|0.2] "rad"  MPC
 SG_ FR_ObjHdr_PitchAngleLower : 475|12@0+ (0.00017,-0.34816) [-0.2|0.2] "rad"  MPC
 SG_ FR_ObjHdr_PitchAngleUpper : 495|12@0+ (0.00017,-0.34816) [-0.2|0.2] "rad"  MPC
 SG_ FR_ObjHdr_RollMountAngle : 499|12@0+ (0.00017,-0.34816) [-0.2|0.2] "rad"  MPC

BO_ 1072 MRRAD1: 64 FR
 SG_ Checksum430 : 7|16@0+ (1,0) [0|65535] ""  MPC
 SG_ RollingCounter430 : 23|8@0+ (1,0) [0|255] ""  MPC
 SG_ MRR_ObjHYAS_Reserved_1 : 31|6@0+ (0.017,0) [0|1.071] ""  MPC
 SG_ MRR_ObjTypeProb_1 : 39|6@0+ (2,0) [0|100] "%"  MPC
 SG_ MRR_ObjID_1 : 41|8@0+ (1,0) [0|255] ""  MPC
 SG_ MRR_ObjObstacleProb_1 : 60|5@0+ (0.04,0) [0|1] ""  MPC
 SG_ MRR_ObjExistProb_1 : 49|5@0+ (0.04,0) [0|1] ""  MPC
 SG_ MRR_ObjDistX_1 : 71|12@0+ (0.075,0) [0|305.925] "m"  MPC
 SG_ MRR_ObjDistY_1 : 75|11@0+ (0.125,-128) [-128|127.875] "m"  MPC
 SG_ MRR_ObjRelAccelX_1 : 80|10@0+ (0.03125,-16) [-16|15.96875] "mps2"  MPC
 SG_ MRR_ObjRelVelX_1 : 102|13@0+ (0.0312,-128) [-128|126.9976] "mps"  MPC
 SG_ MRR_ObjRelVelY_1 : 105|13@0+ (0.0312,-128) [-128|126.9976] "mps"  MPC
 SG_ MRR_ObjRelAccelY_1 : 124|10@0+ (0.03125,-16) [-16|15.96875] "mps2"  MPC
 SG_ MRR_ObjDistXStd_1 : 130|6@0+ (0.1,0) [0|6] "m"  MPC
 SG_ MRR_ObjType_1 : 150|4@0+ (1,0) [0|15] ""  MPC
 SG_ MRR_ObjDistYStd_1 : 140|6@0+ (0.1,0) [0|6] "m"  MPC
 SG_ MRR_ObjRelVelXStd_1 : 146|6@0+ (0.0625,0) [0|3.9375] "mps"  MPC
 SG_ MRR_ObjRAccelXStd_1 : 166|6@0+ (0.0625,0) [0|3.9375] "mps2"  MPC
 SG_ MRR_ObjRelVelYStd_1 : 156|6@0+ (0.0625,0) [0|3.9375] "mps"  MPC
 SG_ MRR_ObjMotionType_1 : 170|3@0+ (1,0) [0|7] ""  MPC
 SG_ MRR_ObjRAccelYStd_1 : 160|6@0+ (0.0625,0) [0|3.9375] "mps2"  MPC
 SG_ MRR_ObjWidth_1 : 183|10@0+ (0.01,0) [0|5] "m"  MPC
 SG_ MRR_ObjMotionDirection_1 : 195|3@0+ (1,0) [0|7] ""  MPC
 SG_ MRR_ObjLength_1 : 189|10@0+ (0.05,0) [0|20] "m"  MPC
 SG_ MRR_ObjHeight_1 : 207|10@0+ (0.01,0) [0|6] "m"  MPC
 SG_ MRR_ObjHeading_1 : 213|12@0+ (0.002,-3.14) [-3.14|3.14] "rad"  MPC
 SG_ MRR_ObjRCS_1 : 217|10@0+ (0.125,-50) [-50|70] "dBsm"  MPC
 SG_ MRR_ObjAge_1 : 239|8@0+ (1,0) [0|255] ""  MPC
 SG_ MRR_ObjRefPoint_1 : 243|3@0+ (1,0) [0|7] "NoUnit"  MPC
 SG_ MRR_ObjRefPoint_2 : 247|3@0+ (1,0) [0|7] "NoUnit"  MPC
 SG_ MRR_ObjHYAS_Reserved_2 : 255|6@0+ (0.017,0) [0|1.071] ""  MPC
 SG_ MRR_ObjTypeProb_2 : 263|6@0+ (2,0) [0|100] "%"  MPC
 SG_ MRR_ObjID_2 : 271|8@0+ (1,0) [0|255] ""  MPC
 SG_ MRR_ObjExistProb_2 : 279|5@0+ (0.04,0) [0|1] ""  MPC
 SG_ MRR_ObjObstacleProb_2 : 274|5@0+ (0.04,0) [0|1] ""  MPC
 SG_ MRR_ObjDistX_2 : 285|12@0+ (0.075,0) [0|305.925] "m"  MPC
 SG_ MRR_ObjDistY_2 : 289|11@0+ (0.125,-128) [-128|127.875] "m"  MPC
 SG_ MRR_ObjRelAccelX_2 : 310|10@0+ (0.03125,-16) [-16|15.96875] "mps2"  MPC
 SG_ MRR_ObjRelVelX_2 : 335|13@0+ (0.0312,-128) [-128|126.9976] "mps"  MPC
 SG_ MRR_ObjRelVelY_2 : 338|13@0+ (0.0312,-128) [-128|126.9976] "mps"  MPC
 SG_ MRR_ObjRelAccelY_2 : 357|10@0+ (0.03125,-16) [-16|15.96875] "mps2"  MPC
 SG_ MRR_ObjDistYStd_2 : 373|6@0+ (0.1,0) [0|6] "m"  MPC
 SG_ MRR_ObjDistXStd_2 : 363|6@0+ (0.1,0) [0|6] "m"  MPC
 SG_ MRR_ObjType_2 : 383|4@0+ (1,0) [0|15] ""  MPC
 SG_ MRR_ObjRelVelXStd_2 : 399|6@0+ (0.0625,0) [0|3.9375] "mps"  MPC
 SG_ MRR_ObjRelVelYStd_2 : 393|6@0+ (0.0625,0) [0|3.9375] "mps"  MPC
 SG_ MRR_ObjRAccelYStd_2 : 413|6@0+ (0.0625,0) [0|3.9375] "mps2"  MPC
 SG_ MRR_ObjRAccelXStd_2 : 403|6@0+ (0.0625,0) [0|3.9375] "mps2"  MPC
 SG_ MRR_ObjMotionType_2 : 423|3@0+ (1,0) [0|7] ""  MPC
 SG_ MRR_ObjWidth_2 : 420|10@0+ (0.01,0) [0|5] "m"  MPC
 SG_ MRR_ObjLength_2 : 426|10@0+ (0.05,0) [0|20] "m"  MPC
 SG_ MRR_ObjMotionDirection_2 : 432|3@0+ (1,0) [0|7] ""  MPC
 SG_ BlockCounter1 : 469|4@0+ (1,0) [0|15] ""  MPC
 SG_ MRR_ObjHeight_2 : 463|10@0+ (0.01,0) [0|6] "m"  MPC
 SG_ MRR_ObjRCS_2 : 465|10@0+ (0.125,-50) [-50|70] "dBsm"  MPC
 SG_ MRR_ObjAge_2 : 487|8@0+ (1,0) [0|255] ""  MPC
 SG_ MRR_ObjMeasured_1 : 497|2@0+ (1,0) [0|3] ""  MPC
 SG_ MRR_ObjMeasured_2 : 499|2@0+ (1,0) [0|3] ""  MPC
 SG_ MRR_ObjHeading_2 : 495|12@0+ (0.002,-3.14) [-3.14|3.14] "rad"  MPC
 SG_ MRR_ObjValid_1 : 508|1@0+ (1,0) [0|1] ""  MPC
 SG_ MRR_ObjValid_2 : 509|1@0+ (1,0) [0|1] ""  MPC

BO_ 1073 MRRAD2: 64 FR
 SG_ Checksum431 : 7|16@0+ (1,0) [0|65535] ""  MPC
 SG_ RollingCounter431 : 23|8@0+ (1,0) [0|255] ""  MPC
 SG_ MRR_ObjHYAS_Reserved_3 : 31|6@0+ (0.017,0) [0|1.071] ""  MPC
 SG_ MRR_ObjTypeProb_3 : 39|6@0+ (2,0) [0|100] "%"  MPC
 SG_ MRR_ObjID_3 : 41|8@0+ (1,0) [0|255] ""  MPC
 SG_ MRR_ObjObstacleProb_3 : 60|5@0+ (0.04,0) [0|1] ""  MPC
 SG_ MRR_ObjExistProb_3 : 49|5@0+ (0.04,0) [0|1] ""  MPC
 SG_ MRR_ObjDistX_3 : 71|12@0+ (0.075,0) [0|305.925] "m"  MPC
 SG_ MRR_ObjDistY_3 : 75|11@0+ (0.125,-128) [-128|127.875] "m"  MPC
 SG_ MRR_ObjRelAccelX_3 : 80|10@0+ (0.03125,-16) [-16|15.96875] "mps2"  MPC
 SG_ MRR_ObjRelVelX_3 : 102|13@0+ (0.0312,-128) [-128|126.9976] "mps"  MPC
 SG_ MRR_ObjRelVelY_3 : 105|13@0+ (0.0312,-128) [-128|126.9976] "mps"  MPC
 SG_ MRR_ObjRelAccelY_3 : 124|10@0+ (0.03125,-16) [-16|15.96875] "mps2"  MPC
 SG_ MRR_ObjDistXStd_3 : 130|6@0+ (0.1,0) [0|6] "m"  MPC
 SG_ MRR_ObjType_3 : 150|4@0+ (1,0) [0|15] ""  MPC
 SG_ MRR_ObjDistYStd_3 : 140|6@0+ (0.1,0) [0|6] "m"  MPC
 SG_ MRR_ObjRelVelXStd_3 : 146|6@0+ (0.0625,0) [0|3.9375] "mps"  MPC
 SG_ MRR_ObjRAccelXStd_3 : 166|6@0+ (0.0625,0) [0|3.9375] "mps2"  MPC
 SG_ MRR_ObjRelVelYStd_3 : 156|6@0+ (0.0625,0) [0|3.9375] "mps"  MPC
 SG_ MRR_ObjMotionType_3 : 170|3@0+ (1,0) [0|7] ""  MPC
 SG_ MRR_ObjRAccelYStd_3 : 160|6@0+ (0.0625,0) [0|3.9375] "mps2"  MPC
 SG_ MRR_ObjWidth_3 : 183|10@0+ (0.01,0) [0|5] "m"  MPC
 SG_ MRR_ObjMotionDirection_3 : 195|3@0+ (1,0) [0|7] ""  MPC
 SG_ MRR_ObjLength_3 : 189|10@0+ (0.05,0) [0|20] "m"  MPC
 SG_ MRR_ObjHeight_3 : 207|10@0+ (0.01,0) [0|6] "m"  MPC
 SG_ MRR_ObjHeading_3 : 213|12@0+ (0.002,-3.14) [-3.14|3.14] "rad"  MPC
 SG_ MRR_ObjRCS_3 : 217|10@0+ (0.125,-50) [-50|70] "dBsm"  MPC
 SG_ MRR_ObjAge_3 : 239|8@0+ (1,0) [0|255] ""  MPC
 SG_ MRR_ObjRefPoint_3 : 243|3@0+ (1,0) [0|7] "NoUnit"  MPC
 SG_ MRR_ObjRefPoint_4 : 247|3@0+ (1,0) [0|7] "NoUnit"  MPC
 SG_ MRR_ObjHYAS_Reserved_4 : 255|6@0+ (0.017,0) [0|1.071] ""  MPC
 SG_ MRR_ObjTypeProb_4 : 263|6@0+ (2,0) [0|100] "%"  MPC
 SG_ MRR_ObjID_4 : 271|8@0+ (1,0) [0|255] ""  MPC
 SG_ MRR_ObjExistProb_4 : 279|5@0+ (0.04,0) [0|1] ""  MPC
 SG_ MRR_ObjObstacleProb_4 : 274|5@0+ (0.04,0) [0|1] ""  MPC
 SG_ MRR_ObjDistX_4 : 285|12@0+ (0.075,0) [0|305.925] "m"  MPC
 SG_ MRR_ObjDistY_4 : 289|11@0+ (0.125,-128) [-128|127.875] "m"  MPC
 SG_ MRR_ObjRelAccelX_4 : 310|10@0+ (0.03125,-16) [-16|15.96875] "mps2"  MPC
 SG_ MRR_ObjRelVelX_4 : 335|13@0+ (0.0312,-128) [-128|126.9976] "mps"  MPC
 SG_ MRR_ObjRelVelY_4 : 338|13@0+ (0.0312,-128) [-128|126.9976] "mps"  MPC
 SG_ MRR_ObjRelAccelY_4 : 357|10@0+ (0.03125,-16) [-16|15.96875] "mps2"  MPC
 SG_ MRR_ObjDistYStd_4 : 373|6@0+ (0.1,0) [0|6] "m"  MPC
 SG_ MRR_ObjDistXStd_4 : 363|6@0+ (0.1,0) [0|6] "m"  MPC
 SG_ MRR_ObjType_4 : 383|4@0+ (1,0) [0|15] ""  MPC
 SG_ MRR_ObjRelVelXStd_4 : 399|6@0+ (0.0625,0) [0|3.9375] "mps"  MPC
 SG_ MRR_ObjRelVelYStd_4 : 393|6@0+ (0.0625,0) [0|3.9375] "mps"  MPC
 SG_ MRR_ObjRAccelYStd_4 : 413|6@0+ (0.0625,0) [0|3.9375] "mps2"  MPC
 SG_ MRR_ObjRAccelXStd_4 : 403|6@0+ (0.0625,0) [0|3.9375] "mps2"  MPC
 SG_ MRR_ObjMotionType_4 : 423|3@0+ (1,0) [0|7] ""  MPC
 SG_ MRR_ObjWidth_4 : 420|10@0+ (0.01,0) [0|5] "m"  MPC
 SG_ MRR_ObjLength_4 : 426|10@0+ (0.05,0) [0|20] "m"  MPC
 SG_ MRR_ObjMotionDirection_4 : 432|3@0+ (1,0) [0|7] ""  MPC
 SG_ BlockCounter2 : 469|4@0+ (1,0) [0|15] ""  MPC
 SG_ MRR_ObjHeight_4 : 463|10@0+ (0.01,0) [0|6] "m"  MPC
 SG_ MRR_ObjRCS_4 : 465|10@0+ (0.125,-50) [-50|70] "dBsm"  MPC
 SG_ MRR_ObjAge_4 : 487|8@0+ (1,0) [0|255] ""  MPC
 SG_ MRR_ObjMeasured_3 : 497|2@0+ (1,0) [0|3] ""  MPC
 SG_ MRR_ObjMeasured_4 : 499|2@0+ (1,0) [0|3] ""  MPC
 SG_ MRR_ObjHeading_4 : 495|12@0+ (0.002,-3.14) [-3.14|3.14] "rad"  MPC
 SG_ MRR_ObjValid_3 : 508|1@0+ (1,0) [0|1] ""  MPC
 SG_ MRR_ObjValid_4 : 509|1@0+ (1,0) [0|1] ""  MPC

BO_ 1074 MRRAD3: 64 FR
 SG_ Checksum432 : 7|16@0+ (1,0) [0|65535] ""  MPC
 SG_ RollingCounter432 : 23|8@0+ (1,0) [0|255] ""  MPC
 SG_ MRR_ObjHYAS_Reserved_5 : 31|6@0+ (0.017,0) [0|1.071] ""  MPC
 SG_ MRR_ObjTypeProb_5 : 39|6@0+ (2,0) [0|100] "%"  MPC
 SG_ MRR_ObjID_5 : 41|8@0+ (1,0) [0|255] ""  MPC
 SG_ MRR_ObjObstacleProb_5 : 60|5@0+ (0.04,0) [0|1] ""  MPC
 SG_ MRR_ObjExistProb_5 : 49|5@0+ (0.04,0) [0|1] ""  MPC
 SG_ MRR_ObjDistX_5 : 71|12@0+ (0.075,0) [0|305.925] "m"  MPC
 SG_ MRR_ObjDistY_5 : 75|11@0+ (0.125,-128) [-128|127.875] "m"  MPC
 SG_ MRR_ObjRelAccelX_5 : 80|10@0+ (0.03125,-16) [-16|15.96875] "mps2"  MPC
 SG_ MRR_ObjRelVelX_5 : 102|13@0+ (0.0312,-128) [-128|126.9976] "mps"  MPC
 SG_ MRR_ObjRelVelY_5 : 105|13@0+ (0.0312,-128) [-128|126.9976] "mps"  MPC
 SG_ MRR_ObjRelAccelY_5 : 124|10@0+ (0.03125,-16) [-16|15.96875] "mps2"  MPC
 SG_ MRR_ObjDistXStd_5 : 130|6@0+ (0.1,0) [0|6] "m"  MPC
 SG_ MRR_ObjType_5 : 150|4@0+ (1,0) [0|15] ""  MPC
 SG_ MRR_ObjDistYStd_5 : 140|6@0+ (0.1,0) [0|6] "m"  MPC
 SG_ MRR_ObjRelVelXStd_5 : 146|6@0+ (0.0625,0) [0|3.9375] "mps"  MPC
 SG_ MRR_ObjRAccelXStd_5 : 166|6@0+ (0.0625,0) [0|3.9375] "mps2"  MPC
 SG_ MRR_ObjRelVelYStd_5 : 156|6@0+ (0.0625,0) [0|3.9375] "mps"  MPC
 SG_ MRR_ObjMotionType_5 : 170|3@0+ (1,0) [0|7] ""  MPC
 SG_ MRR_ObjRAccelYStd_5 : 160|6@0+ (0.0625,0) [0|3.9375] "mps2"  MPC
 SG_ MRR_ObjWidth_5 : 183|10@0+ (0.01,0) [0|5] "m"  MPC
 SG_ MRR_ObjMotionDirection_5 : 195|3@0+ (1,0) [0|7] ""  MPC
 SG_ MRR_ObjLength_5 : 189|10@0+ (0.05,0) [0|20] "m"  MPC
 SG_ MRR_ObjHeight_5 : 207|10@0+ (0.01,0) [0|6] "m"  MPC
 SG_ MRR_ObjHeading_5 : 213|12@0+ (0.002,-3.14) [-3.14|3.14] "rad"  MPC
 SG_ MRR_ObjRCS_5 : 217|10@0+ (0.125,-50) [-50|70] "dBsm"  MPC
 SG_ MRR_ObjAge_5 : 239|8@0+ (1,0) [0|255] ""  MPC
 SG_ MRR_ObjRefPoint_5 : 243|3@0+ (1,0) [0|7] "NoUnit"  MPC
 SG_ MRR_ObjRefPoint_6 : 247|3@0+ (1,0) [0|7] "NoUnit"  MPC
 SG_ MRR_ObjHYAS_Reserved_6 : 255|6@0+ (0.017,0) [0|1.071] ""  MPC
 SG_ MRR_ObjTypeProb_6 : 263|6@0+ (2,0) [0|100] "%"  MPC
 SG_ MRR_ObjID_6 : 271|8@0+ (1,0) [0|255] ""  MPC
 SG_ MRR_ObjExistProb_6 : 279|5@0+ (0.04,0) [0|1] ""  MPC
 SG_ MRR_ObjObstacleProb_6 : 274|5@0+ (0.04,0) [0|1] ""  MPC
 SG_ MRR_ObjDistX_6 : 285|12@0+ (0.075,0) [0|305.925] "m"  MPC
 SG_ MRR_ObjDistY_6 : 289|11@0+ (0.125,-128) [-128|127.875] "m"  MPC
 SG_ MRR_ObjRelAccelX_6 : 310|10@0+ (0.03125,-16) [-16|15.96875] "mps2"  MPC
 SG_ MRR_ObjRelVelX_6 : 335|13@0+ (0.0312,-128) [-128|126.9976] "mps"  MPC
 SG_ MRR_ObjRelVelY_6 : 338|13@0+ (0.0312,-128) [-128|126.9976] "mps"  MPC
 SG_ MRR_ObjRelAccelY_6 : 357|10@0+ (0.03125,-16) [-16|15.96875] "mps2"  MPC
 SG_ MRR_ObjDistYStd_6 : 373|6@0+ (0.1,0) [0|6] "m"  MPC
 SG_ MRR_ObjDistXStd_6 : 363|6@0+ (0.1,0) [0|6] "m"  MPC
 SG_ MRR_ObjType_6 : 383|4@0+ (1,0) [0|15] ""  MPC
 SG_ MRR_ObjRelVelXStd_6 : 399|6@0+ (0.0625,0) [0|3.9375] "mps"  MPC
 SG_ MRR_ObjRelVelYStd_6 : 393|6@0+ (0.0625,0) [0|3.9375] "mps"  MPC
 SG_ MRR_ObjRAccelYStd_6 : 413|6@0+ (0.0625,0) [0|3.9375] "mps2"  MPC
 SG_ MRR_ObjRAccelXStd_6 : 403|6@0+ (0.0625,0) [0|3.9375] "mps2"  MPC
 SG_ MRR_ObjMotionType_6 : 423|3@0+ (1,0) [0|7] ""  MPC
 SG_ MRR_ObjWidth_6 : 420|10@0+ (0.01,0) [0|5] "m"  MPC
 SG_ MRR_ObjLength_6 : 426|10@0+ (0.05,0) [0|20] "m"  MPC
 SG_ MRR_ObjMotionDirection_6 : 432|3@0+ (1,0) [0|7] ""  MPC
 SG_ BlockCounter3 : 469|4@0+ (1,0) [0|15] ""  MPC
 SG_ MRR_ObjHeight_6 : 463|10@0+ (0.01,0) [0|6] "m"  MPC
 SG_ MRR_ObjRCS_6 : 465|10@0+ (0.125,-50) [-50|70] "dBsm"  MPC
 SG_ MRR_ObjAge_6 : 487|8@0+ (1,0) [0|255] ""  MPC
 SG_ MRR_ObjMeasured_5 : 497|2@0+ (1,0) [0|3] ""  MPC
 SG_ MRR_ObjMeasured_6 : 499|2@0+ (1,0) [0|3] ""  MPC
 SG_ MRR_ObjHeading_6 : 495|12@0+ (0.002,-3.14) [-3.14|3.14] "rad"  MPC
 SG_ MRR_ObjValid_5 : 508|1@0+ (1,0) [0|1] ""  MPC
 SG_ MRR_ObjValid_6 : 509|1@0+ (1,0) [0|1] ""  MPC

BO_ 1075 MRRAD4: 64 FR
 SG_ Checksum433 : 7|16@0+ (1,0) [0|65535] ""  MPC
 SG_ RollingCounter433 : 23|8@0+ (1,0) [0|255] ""  MPC
 SG_ MRR_ObjHYAS_Reserved_7 : 31|6@0+ (0.017,0) [0|1.071] ""  MPC
 SG_ MRR_ObjTypeProb_7 : 39|6@0+ (2,0) [0|100] "%"  MPC
 SG_ MRR_ObjID_7 : 41|8@0+ (1,0) [0|255] ""  MPC
 SG_ MRR_ObjObstacleProb_7 : 60|5@0+ (0.04,0) [0|1] ""  MPC
 SG_ MRR_ObjExistProb_7 : 49|5@0+ (0.04,0) [0|1] ""  MPC
 SG_ MRR_ObjDistX_7 : 71|12@0+ (0.075,0) [0|305.925] "m"  MPC
 SG_ MRR_ObjDistY_7 : 75|11@0+ (0.125,-128) [-128|127.875] "m"  MPC
 SG_ MRR_ObjRelAccelX_7 : 80|10@0+ (0.03125,-16) [-16|15.96875] "mps2"  MPC
 SG_ MRR_ObjRelVelX_7 : 102|13@0+ (0.0312,-128) [-128|126.9976] "mps"  MPC
 SG_ MRR_ObjRelVelY_7 : 105|13@0+ (0.0312,-128) [-128|126.9976] "mps"  MPC
 SG_ MRR_ObjRelAccelY_7 : 124|10@0+ (0.03125,-16) [-16|15.96875] "mps2"  MPC
 SG_ MRR_ObjDistXStd_7 : 130|6@0+ (0.1,0) [0|6] "m"  MPC
 SG_ MRR_ObjType_7 : 150|4@0+ (1,0) [0|15] ""  MPC
 SG_ MRR_ObjDistYStd_7 : 140|6@0+ (0.1,0) [0|6] "m"  MPC
 SG_ MRR_ObjRelVelXStd_7 : 146|6@0+ (0.0625,0) [0|3.9375] "mps"  MPC
 SG_ MRR_ObjRAccelXStd_7 : 166|6@0+ (0.0625,0) [0|3.9375] "mps2"  MPC
 SG_ MRR_ObjRelVelYStd_7 : 156|6@0+ (0.0625,0) [0|3.9375] "mps"  MPC
 SG_ MRR_ObjMotionType_7 : 170|3@0+ (1,0) [0|7] ""  MPC
 SG_ MRR_ObjRAccelYStd_7 : 160|6@0+ (0.0625,0) [0|3.9375] "mps2"  MPC
 SG_ MRR_ObjWidth_7 : 183|10@0+ (0.01,0) [0|5] "m"  MPC
 SG_ MRR_ObjMotionDirection_7 : 195|3@0+ (1,0) [0|7] ""  MPC
 SG_ MRR_ObjLength_7 : 189|10@0+ (0.05,0) [0|20] "m"  MPC
 SG_ MRR_ObjHeight_7 : 207|10@0+ (0.01,0) [0|6] "m"  MPC
 SG_ MRR_ObjHeading_7 : 213|12@0+ (0.002,-3.14) [-3.14|3.14] "rad"  MPC
 SG_ MRR_ObjRCS_7 : 217|10@0+ (0.125,-50) [-50|70] "dBsm"  MPC
 SG_ MRR_ObjAge_7 : 239|8@0+ (1,0) [0|255] ""  MPC
 SG_ MRR_ObjRefPoint_7 : 243|3@0+ (1,0) [0|7] "NoUnit"  MPC
 SG_ MRR_ObjRefPoint_8 : 247|3@0+ (1,0) [0|7] "NoUnit"  MPC
 SG_ MRR_ObjHYAS_Reserved_8 : 255|6@0+ (0.017,0) [0|1.071] ""  MPC
 SG_ MRR_ObjTypeProb_8 : 263|6@0+ (2,0) [0|100] "%"  MPC
 SG_ MRR_ObjID_8 : 271|8@0+ (1,0) [0|255] ""  MPC
 SG_ MRR_ObjExistProb_8 : 279|5@0+ (0.04,0) [0|1] ""  MPC
 SG_ MRR_ObjObstacleProb_8 : 274|5@0+ (0.04,0) [0|1] ""  MPC
 SG_ MRR_ObjDistX_8 : 285|12@0+ (0.075,0) [0|305.925] "m"  MPC
 SG_ MRR_ObjDistY_8 : 289|11@0+ (0.125,-128) [-128|127.875] "m"  MPC
 SG_ MRR_ObjRelAccelX_8 : 310|10@0+ (0.03125,-16) [-16|15.96875] "mps2"  MPC
 SG_ MRR_ObjRelVelX_8 : 335|13@0+ (0.0312,-128) [-128|126.9976] "mps"  MPC
 SG_ MRR_ObjRelVelY_8 : 338|13@0+ (0.0312,-128) [-128|126.9976] "mps"  MPC
 SG_ MRR_ObjRelAccelY_8 : 357|10@0+ (0.03125,-16) [-16|15.96875] "mps2"  MPC
 SG_ MRR_ObjDistYStd_8 : 373|6@0+ (0.1,0) [0|6] "m"  MPC
 SG_ MRR_ObjDistXStd_8 : 363|6@0+ (0.1,0) [0|6] "m"  MPC
 SG_ MRR_ObjType_8 : 383|4@0+ (1,0) [0|15] ""  MPC
 SG_ MRR_ObjRelVelXStd_8 : 399|6@0+ (0.0625,0) [0|3.9375] "mps"  MPC
 SG_ MRR_ObjRelVelYStd_8 : 393|6@0+ (0.0625,0) [0|3.9375] "mps"  MPC
 SG_ MRR_ObjRAccelYStd_8 : 413|6@0+ (0.0625,0) [0|3.9375] "mps2"  MPC
 SG_ MRR_ObjRAccelXStd_8 : 403|6@0+ (0.0625,0) [0|3.9375] "mps2"  MPC
 SG_ MRR_ObjMotionType_8 : 423|3@0+ (1,0) [0|7] ""  MPC
 SG_ MRR_ObjWidth_8 : 420|10@0+ (0.01,0) [0|5] "m"  MPC
 SG_ MRR_ObjLength_8 : 426|10@0+ (0.05,0) [0|20] "m"  MPC
 SG_ MRR_ObjMotionDirection_8 : 432|3@0+ (1,0) [0|7] ""  MPC
 SG_ BlockCounter4 : 469|4@0+ (1,0) [0|15] ""  MPC
 SG_ MRR_ObjHeight_8 : 463|10@0+ (0.01,0) [0|6] "m"  MPC
 SG_ MRR_ObjRCS_8 : 465|10@0+ (0.125,-50) [-50|70] "dBsm"  MPC
 SG_ MRR_ObjAge_8 : 487|8@0+ (1,0) [0|255] ""  MPC
 SG_ MRR_ObjMeasured_7 : 497|2@0+ (1,0) [0|3] ""  MPC
 SG_ MRR_ObjMeasured_8 : 499|2@0+ (1,0) [0|3] ""  MPC
 SG_ MRR_ObjHeading_8 : 495|12@0+ (0.002,-3.14) [-3.14|3.14] "rad"  MPC
 SG_ MRR_ObjValid_7 : 508|1@0+ (1,0) [0|1] ""  MPC
 SG_ MRR_ObjValid_8 : 509|1@0+ (1,0) [0|1] ""  MPC

BO_ 1076 MRRAD5: 64 FR
 SG_ Checksum434 : 7|16@0+ (1,0) [0|65535] ""  MPC
 SG_ RollingCounter434 : 23|8@0+ (1,0) [0|255] ""  MPC
 SG_ MRR_ObjHYAS_Reserved_9 : 31|6@0+ (0.017,0) [0|1.071] ""  MPC
 SG_ MRR_ObjTypeProb_9 : 39|6@0+ (2,0) [0|100] "%"  MPC
 SG_ MRR_ObjID_9 : 41|8@0+ (1,0) [0|255] ""  MPC
 SG_ MRR_ObjObstacleProb_9 : 60|5@0+ (0.04,0) [0|1] ""  MPC
 SG_ MRR_ObjExistProb_9 : 49|5@0+ (0.04,0) [0|1] ""  MPC
 SG_ MRR_ObjDistX_9 : 71|12@0+ (0.075,0) [0|305.925] "m"  MPC
 SG_ MRR_ObjDistY_9 : 75|11@0+ (0.125,-128) [-128|127.875] "m"  MPC
 SG_ MRR_ObjRelAccelX_9 : 80|10@0+ (0.03125,-16) [-16|15.96875] "mps2"  MPC
 SG_ MRR_ObjRelVelX_9 : 102|13@0+ (0.0312,-128) [-128|126.9976] "mps"  MPC
 SG_ MRR_ObjRelVelY_9 : 105|13@0+ (0.0312,-128) [-128|126.9976] "mps"  MPC
 SG_ MRR_ObjRelAccelY_9 : 124|10@0+ (0.03125,-16) [-16|15.96875] "mps2"  MPC
 SG_ MRR_ObjDistXStd_9 : 130|6@0+ (0.1,0) [0|6] "m"  MPC
 SG_ MRR_ObjType_9 : 150|4@0+ (1,0) [0|15] ""  MPC
 SG_ MRR_ObjDistYStd_9 : 140|6@0+ (0.1,0) [0|6] "m"  MPC
 SG_ MRR_ObjRelVelXStd_9 : 146|6@0+ (0.0625,0) [0|3.9375] "mps"  MPC
 SG_ MRR_ObjRAccelXStd_9 : 166|6@0+ (0.0625,0) [0|3.9375] "mps2"  MPC
 SG_ MRR_ObjRelVelYStd_9 : 156|6@0+ (0.0625,0) [0|3.9375] "mps"  MPC
 SG_ MRR_ObjMotionType_9 : 170|3@0+ (1,0) [0|7] ""  MPC
 SG_ MRR_ObjRAccelYStd_9 : 160|6@0+ (0.0625,0) [0|3.9375] "mps2"  MPC
 SG_ MRR_ObjWidth_9 : 183|10@0+ (0.01,0) [0|5] "m"  MPC
 SG_ MRR_ObjMotionDirection_9 : 195|3@0+ (1,0) [0|7] ""  MPC
 SG_ MRR_ObjLength_9 : 189|10@0+ (0.05,0) [0|20] "m"  MPC
 SG_ MRR_ObjHeight_9 : 207|10@0+ (0.01,0) [0|6] "m"  MPC
 SG_ MRR_ObjHeading_9 : 213|12@0+ (0.002,-3.14) [-3.14|3.14] "rad"  MPC
 SG_ MRR_ObjRCS_9 : 217|10@0+ (0.125,-50) [-50|70] "dBsm"  MPC
 SG_ MRR_ObjAge_9 : 239|8@0+ (1,0) [0|255] ""  MPC
 SG_ MRR_ObjRefPoint_9 : 243|3@0+ (1,0) [0|7] "NoUnit"  MPC
 SG_ MRR_ObjRefPoint_10 : 247|3@0+ (1,0) [0|7] "NoUnit"  MPC
 SG_ MRR_ObjHYAS_Reserved_10 : 255|6@0+ (0.017,0) [0|1.071] ""  MPC
 SG_ MRR_ObjTypeProb_10 : 263|6@0+ (2,0) [0|100] "%"  MPC
 SG_ MRR_ObjID_10 : 271|8@0+ (1,0) [0|255] ""  MPC
 SG_ MRR_ObjExistProb_10 : 279|5@0+ (0.04,0) [0|1] ""  MPC
 SG_ MRR_ObjObstacleProb_10 : 274|5@0+ (0.04,0) [0|1] ""  MPC
 SG_ MRR_ObjDistX_10 : 285|12@0+ (0.075,0) [0|305.925] "m"  MPC
 SG_ MRR_ObjDistY_10 : 289|11@0+ (0.125,-128) [-128|127.875] "m"  MPC
 SG_ MRR_ObjRelAccelX_10 : 310|10@0+ (0.03125,-16) [-16|15.96875] "mps2"  MPC
 SG_ MRR_ObjRelVelX_10 : 335|13@0+ (0.0312,-128) [-128|126.9976] "mps"  MPC
 SG_ MRR_ObjRelVelY_10 : 338|13@0+ (0.0312,-128) [-128|126.9976] "mps"  MPC
 SG_ MRR_ObjRelAccelY_10 : 357|10@0+ (0.03125,-16) [-16|15.96875] "mps2"  MPC
 SG_ MRR_ObjDistYStd_10 : 373|6@0+ (0.1,0) [0|6] "m"  MPC
 SG_ MRR_ObjDistXStd_10 : 363|6@0+ (0.1,0) [0|6] "m"  MPC
 SG_ MRR_ObjType_10 : 383|4@0+ (1,0) [0|15] ""  MPC
 SG_ MRR_ObjRelVelXStd_10 : 399|6@0+ (0.0625,0) [0|3.9375] "mps"  MPC
 SG_ MRR_ObjRelVelYStd_10 : 393|6@0+ (0.0625,0) [0|3.9375] "mps"  MPC
 SG_ MRR_ObjRAccelYStd_10 : 413|6@0+ (0.0625,0) [0|3.9375] "mps2"  MPC
 SG_ MRR_ObjRAccelXStd_10 : 403|6@0+ (0.0625,0) [0|3.9375] "mps2"  MPC
 SG_ MRR_ObjMotionType_10 : 423|3@0+ (1,0) [0|7] ""  MPC
 SG_ MRR_ObjWidth_10 : 420|10@0+ (0.01,0) [0|5] "m"  MPC
 SG_ MRR_ObjLength_10 : 426|10@0+ (0.05,0) [0|20] "m"  MPC
 SG_ MRR_ObjMotionDirection_10 : 432|3@0+ (1,0) [0|7] ""  MPC
 SG_ BlockCounter5 : 469|4@0+ (1,0) [0|15] ""  MPC
 SG_ MRR_ObjHeight_10 : 463|10@0+ (0.01,0) [0|6] "m"  MPC
 SG_ MRR_ObjRCS_10 : 465|10@0+ (0.125,-50) [-50|70] "dBsm"  MPC
 SG_ MRR_ObjAge_10 : 487|8@0+ (1,0) [0|255] ""  MPC
 SG_ MRR_ObjMeasured_9 : 497|2@0+ (1,0) [0|3] ""  MPC
 SG_ MRR_ObjMeasured_10 : 499|2@0+ (1,0) [0|3] ""  MPC
 SG_ MRR_ObjHeading_10 : 495|12@0+ (0.002,-3.14) [-3.14|3.14] "rad"  MPC
 SG_ MRR_ObjValid_9 : 508|1@0+ (1,0) [0|1] ""  MPC
 SG_ MRR_ObjValid_10 : 509|1@0+ (1,0) [0|1] ""  MPC

BO_ 1077 MRRAD6: 64 FR
 SG_ Checksum435 : 7|16@0+ (1,0) [0|65535] ""  MPC
 SG_ RollingCounter435 : 23|8@0+ (1,0) [0|255] ""  MPC
 SG_ MRR_ObjHYAS_Reserved_11 : 31|6@0+ (0.017,0) [0|1.071] ""  MPC
 SG_ MRR_ObjTypeProb_11 : 39|6@0+ (2,0) [0|100] "%"  MPC
 SG_ MRR_ObjID_11 : 41|8@0+ (1,0) [0|255] ""  MPC
 SG_ MRR_ObjObstacleProb_11 : 60|5@0+ (0.04,0) [0|1] ""  MPC
 SG_ MRR_ObjExistProb_11 : 49|5@0+ (0.04,0) [0|1] ""  MPC
 SG_ MRR_ObjDistX_11 : 71|12@0+ (0.075,0) [0|305.925] "m"  MPC
 SG_ MRR_ObjDistY_11 : 75|11@0+ (0.125,-128) [-128|127.875] "m"  MPC
 SG_ MRR_ObjRelAccelX_11 : 80|10@0+ (0.03125,-16) [-16|15.96875] "mps2"  MPC
 SG_ MRR_ObjRelVelX_11 : 102|13@0+ (0.0312,-128) [-128|126.9976] "mps"  MPC
 SG_ MRR_ObjRelVelY_11 : 105|13@0+ (0.0312,-128) [-128|126.9976] "mps"  MPC
 SG_ MRR_ObjRelAccelY_11 : 124|10@0+ (0.03125,-16) [-16|15.96875] "mps2"  MPC
 SG_ MRR_ObjDistXStd_11 : 130|6@0+ (0.1,0) [0|6] "m"  MPC
 SG_ MRR_ObjType_11 : 150|4@0+ (1,0) [0|15] ""  MPC
 SG_ MRR_ObjDistYStd_11 : 140|6@0+ (0.1,0) [0|6] "m"  MPC
 SG_ MRR_ObjRelVelXStd_11 : 146|6@0+ (0.0625,0) [0|3.9375] "mps"  MPC
 SG_ MRR_ObjRAccelXStd_11 : 166|6@0+ (0.0625,0) [0|3.9375] "mps2"  MPC
 SG_ MRR_ObjRelVelYStd_11 : 156|6@0+ (0.0625,0) [0|3.9375] "mps"  MPC
 SG_ MRR_ObjMotionType_11 : 170|3@0+ (1,0) [0|7] ""  MPC
 SG_ MRR_ObjRAccelYStd_11 : 160|6@0+ (0.0625,0) [0|3.9375] "mps2"  MPC
 SG_ MRR_ObjWidth_11 : 183|10@0+ (0.01,0) [0|5] "m"  MPC
 SG_ MRR_ObjMotionDirection_11 : 195|3@0+ (1,0) [0|7] ""  MPC
 SG_ MRR_ObjLength_11 : 189|10@0+ (0.05,0) [0|20] "m"  MPC
 SG_ MRR_ObjHeight_11 : 207|10@0+ (0.01,0) [0|6] "m"  MPC
 SG_ MRR_ObjHeading_11 : 213|12@0+ (0.002,-3.14) [-3.14|3.14] "rad"  MPC
 SG_ MRR_ObjRCS_11 : 217|10@0+ (0.125,-50) [-50|70] "dBsm"  MPC
 SG_ MRR_ObjAge_11 : 239|8@0+ (1,0) [0|255] ""  MPC
 SG_ MRR_ObjRefPoint_11 : 243|3@0+ (1,0) [0|7] "NoUnit"  MPC
 SG_ MRR_ObjRefPoint_12 : 247|3@0+ (1,0) [0|7] "NoUnit"  MPC
 SG_ MRR_ObjHYAS_Reserved_12 : 255|6@0+ (0.017,0) [0|1.071] ""  MPC
 SG_ MRR_ObjTypeProb_12 : 263|6@0+ (2,0) [0|100] "%"  MPC
 SG_ MRR_ObjID_12 : 271|8@0+ (1,0) [0|255] ""  MPC
 SG_ MRR_ObjExistProb_12 : 279|5@0+ (0.04,0) [0|1] ""  MPC
 SG_ MRR_ObjObstacleProb_12 : 274|5@0+ (0.04,0) [0|1] ""  MPC
 SG_ MRR_ObjDistX_12 : 285|12@0+ (0.075,0) [0|305.925] "m"  MPC
 SG_ MRR_ObjDistY_12 : 289|11@0+ (0.125,-128) [-128|127.875] "m"  MPC
 SG_ MRR_ObjRelAccelX_12 : 310|10@0+ (0.03125,-16) [-16|15.96875] "mps2"  MPC
 SG_ MRR_ObjRelVelX_12 : 335|13@0+ (0.0312,-128) [-128|126.9976] "mps"  MPC
 SG_ MRR_ObjRelVelY_12 : 338|13@0+ (0.0312,-128) [-128|126.9976] "mps"  MPC
 SG_ MRR_ObjRelAccelY_12 : 357|10@0+ (0.03125,-16) [-16|15.96875] "mps2"  MPC
 SG_ MRR_ObjDistYStd_12 : 373|6@0+ (0.1,0) [0|6] "m"  MPC
 SG_ MRR_ObjDistXStd_12 : 363|6@0+ (0.1,0) [0|6] "m"  MPC
 SG_ MRR_ObjType_12 : 383|4@0+ (1,0) [0|15] ""  MPC
 SG_ MRR_ObjRelVelXStd_12 : 399|6@0+ (0.0625,0) [0|3.9375] "mps"  MPC
 SG_ MRR_ObjRelVelYStd_12 : 393|6@0+ (0.0625,0) [0|3.9375] "mps"  MPC
 SG_ MRR_ObjRAccelYStd_12 : 413|6@0+ (0.0625,0) [0|3.9375] "mps2"  MPC
 SG_ MRR_ObjRAccelXStd_12 : 403|6@0+ (0.0625,0) [0|3.9375] "mps2"  MPC
 SG_ MRR_ObjMotionType_12 : 423|3@0+ (1,0) [0|7] ""  MPC
 SG_ MRR_ObjWidth_12 : 420|10@0+ (0.01,0) [0|5] "m"  MPC
 SG_ MRR_ObjLength_12 : 426|10@0+ (0.05,0) [0|20] "m"  MPC
 SG_ MRR_ObjMotionDirection_12 : 432|3@0+ (1,0) [0|7] ""  MPC
 SG_ BlockCounter6 : 469|4@0+ (1,0) [0|15] ""  MPC
 SG_ MRR_ObjHeight_12 : 463|10@0+ (0.01,0) [0|6] "m"  MPC
 SG_ MRR_ObjRCS_12 : 465|10@0+ (0.125,-50) [-50|70] "dBsm"  MPC
 SG_ MRR_ObjAge_12 : 487|8@0+ (1,0) [0|255] ""  MPC
 SG_ MRR_ObjMeasured_11 : 497|2@0+ (1,0) [0|3] ""  MPC
 SG_ MRR_ObjMeasured_12 : 499|2@0+ (1,0) [0|3] ""  MPC
 SG_ MRR_ObjHeading_12 : 495|12@0+ (0.002,-3.14) [-3.14|3.14] "rad"  MPC
 SG_ MRR_ObjValid_11 : 508|1@0+ (1,0) [0|1] ""  MPC
 SG_ MRR_ObjValid_12 : 509|1@0+ (1,0) [0|1] ""  MPC

BO_ 1078 MRRAD7: 64 FR
 SG_ Checksum436 : 7|16@0+ (1,0) [0|65535] ""  MPC
 SG_ RollingCounter436 : 23|8@0+ (1,0) [0|255] ""  MPC
 SG_ MRR_ObjHYAS_Reserved_13 : 31|6@0+ (0.017,0) [0|1.071] ""  MPC
 SG_ MRR_ObjTypeProb_13 : 39|6@0+ (2,0) [0|100] "%"  MPC
 SG_ MRR_ObjID_13 : 41|8@0+ (1,0) [0|255] ""  MPC
 SG_ MRR_ObjObstacleProb_13 : 60|5@0+ (0.04,0) [0|1] ""  MPC
 SG_ MRR_ObjExistProb_13 : 49|5@0+ (0.04,0) [0|1] ""  MPC
 SG_ MRR_ObjDistX_13 : 71|12@0+ (0.075,0) [0|305.925] "m"  MPC
 SG_ MRR_ObjDistY_13 : 75|11@0+ (0.125,-128) [-128|127.875] "m"  MPC
 SG_ MRR_ObjRelAccelX_13 : 80|10@0+ (0.03125,-16) [-16|15.96875] "mps2"  MPC
 SG_ MRR_ObjRelVelX_13 : 102|13@0+ (0.0312,-128) [-128|126.9976] "mps"  MPC
 SG_ MRR_ObjRelVelY_13 : 105|13@0+ (0.0312,-128) [-128|126.9976] "mps"  MPC
 SG_ MRR_ObjRelAccelY_13 : 124|10@0+ (0.03125,-16) [-16|15.96875] "mps2"  MPC
 SG_ MRR_ObjDistXStd_13 : 130|6@0+ (0.1,0) [0|6] "m"  MPC
 SG_ MRR_ObjType_13 : 150|4@0+ (1,0) [0|15] ""  MPC
 SG_ MRR_ObjDistYStd_13 : 140|6@0+ (0.1,0) [0|6] "m"  MPC
 SG_ MRR_ObjRelVelXStd_13 : 146|6@0+ (0.0625,0) [0|3.9375] "mps"  MPC
 SG_ MRR_ObjRAccelXStd_13 : 166|6@0+ (0.0625,0) [0|3.9375] "mps2"  MPC
 SG_ MRR_ObjRelVelYStd_13 : 156|6@0+ (0.0625,0) [0|3.9375] "mps"  MPC
 SG_ MRR_ObjMotionType_13 : 170|3@0+ (1,0) [0|7] ""  MPC
 SG_ MRR_ObjRAccelYStd_13 : 160|6@0+ (0.0625,0) [0|3.9375] "mps2"  MPC
 SG_ MRR_ObjWidth_13 : 183|10@0+ (0.01,0) [0|5] "m"  MPC
 SG_ MRR_ObjMotionDirection_13 : 195|3@0+ (1,0) [0|7] ""  MPC
 SG_ MRR_ObjLength_13 : 189|10@0+ (0.05,0) [0|20] "m"  MPC
 SG_ MRR_ObjHeight_13 : 207|10@0+ (0.01,0) [0|6] "m"  MPC
 SG_ MRR_ObjHeading_13 : 213|12@0+ (0.002,-3.14) [-3.14|3.14] "rad"  MPC
 SG_ MRR_ObjRCS_13 : 217|10@0+ (0.125,-50) [-50|70] "dBsm"  MPC
 SG_ MRR_ObjAge_13 : 239|8@0+ (1,0) [0|255] ""  MPC
 SG_ MRR_ObjRefPoint_13 : 243|3@0+ (1,0) [0|7] "NoUnit"  MPC
 SG_ MRR_ObjRefPoint_14 : 247|3@0+ (1,0) [0|7] "NoUnit"  MPC
 SG_ MRR_ObjHYAS_Reserved_14 : 255|6@0+ (0.017,0) [0|1.071] ""  MPC
 SG_ MRR_ObjTypeProb_14 : 263|6@0+ (2,0) [0|100] "%"  MPC
 SG_ MRR_ObjID_14 : 271|8@0+ (1,0) [0|255] ""  MPC
 SG_ MRR_ObjExistProb_14 : 279|5@0+ (0.04,0) [0|1] ""  MPC
 SG_ MRR_ObjObstacleProb_14 : 274|5@0+ (0.04,0) [0|1] ""  MPC
 SG_ MRR_ObjDistX_14 : 285|12@0+ (0.075,0) [0|305.925] "m"  MPC
 SG_ MRR_ObjDistY_14 : 289|11@0+ (0.125,-128) [-128|127.875] "m"  MPC
 SG_ MRR_ObjRelAccelX_14 : 310|10@0+ (0.03125,-16) [-16|15.96875] "mps2"  MPC
 SG_ MRR_ObjRelVelX_14 : 335|13@0+ (0.0312,-128) [-128|126.9976] "mps"  MPC
 SG_ MRR_ObjRelVelY_14 : 338|13@0+ (0.0312,-128) [-128|126.9976] "mps"  MPC
 SG_ MRR_ObjRelAccelY_14 : 357|10@0+ (0.03125,-16) [-16|15.96875] "mps2"  MPC
 SG_ MRR_ObjDistYStd_14 : 373|6@0+ (0.1,0) [0|6] "m"  MPC
 SG_ MRR_ObjDistXStd_14 : 363|6@0+ (0.1,0) [0|6] "m"  MPC
 SG_ MRR_ObjType_14 : 383|4@0+ (1,0) [0|15] ""  MPC
 SG_ MRR_ObjRelVelXStd_14 : 399|6@0+ (0.0625,0) [0|3.9375] "mps"  MPC
 SG_ MRR_ObjRelVelYStd_14 : 393|6@0+ (0.0625,0) [0|3.9375] "mps"  MPC
 SG_ MRR_ObjRAccelYStd_14 : 413|6@0+ (0.0625,0) [0|3.9375] "mps2"  MPC
 SG_ MRR_ObjRAccelXStd_14 : 403|6@0+ (0.0625,0) [0|3.9375] "mps2"  MPC
 SG_ MRR_ObjMotionType_14 : 423|3@0+ (1,0) [0|7] ""  MPC
 SG_ MRR_ObjWidth_14 : 420|10@0+ (0.01,0) [0|5] "m"  MPC
 SG_ MRR_ObjLength_14 : 426|10@0+ (0.05,0) [0|20] "m"  MPC
 SG_ MRR_ObjMotionDirection_14 : 432|3@0+ (1,0) [0|7] ""  MPC
 SG_ BlockCounter7 : 469|4@0+ (1,0) [0|15] ""  MPC
 SG_ MRR_ObjHeight_14 : 463|10@0+ (0.01,0) [0|6] "m"  MPC
 SG_ MRR_ObjRCS_14 : 465|10@0+ (0.125,-50) [-50|70] "dBsm"  MPC
 SG_ MRR_ObjAge_14 : 487|8@0+ (1,0) [0|255] ""  MPC
 SG_ MRR_ObjMeasured_13 : 497|2@0+ (1,0) [0|3] ""  MPC
 SG_ MRR_ObjMeasured_14 : 499|2@0+ (1,0) [0|3] ""  MPC
 SG_ MRR_ObjHeading_14 : 495|12@0+ (0.002,-3.14) [-3.14|3.14] "rad"  MPC
 SG_ MRR_ObjValid_13 : 508|1@0+ (1,0) [0|1] ""  MPC
 SG_ MRR_ObjValid_14 : 509|1@0+ (1,0) [0|1] ""  MPC

BO_ 1079 MRRAD8: 64 FR
 SG_ Checksum437 : 7|16@0+ (1,0) [0|65535] ""  MPC
 SG_ RollingCounter437 : 23|8@0+ (1,0) [0|255] ""  MPC
 SG_ MRR_ObjHYAS_Reserved_15 : 31|6@0+ (0.017,0) [0|1.071] ""  MPC
 SG_ MRR_ObjTypeProb_15 : 39|6@0+ (2,0) [0|100] "%"  MPC
 SG_ MRR_ObjID_15 : 41|8@0+ (1,0) [0|255] ""  MPC
 SG_ MRR_ObjObstacleProb_15 : 60|5@0+ (0.04,0) [0|1] ""  MPC
 SG_ MRR_ObjExistProb_15 : 49|5@0+ (0.04,0) [0|1] ""  MPC
 SG_ MRR_ObjDistX_15 : 71|12@0+ (0.075,0) [0|305.925] "m"  MPC
 SG_ MRR_ObjDistY_15 : 75|11@0+ (0.125,-128) [-128|127.875] "m"  MPC
 SG_ MRR_ObjRelAccelX_15 : 80|10@0+ (0.03125,-16) [-16|15.96875] "mps2"  MPC
 SG_ MRR_ObjRelVelX_15 : 102|13@0+ (0.0312,-128) [-128|126.9976] "mps"  MPC
 SG_ MRR_ObjRelVelY_15 : 105|13@0+ (0.0312,-128) [-128|126.9976] "mps"  MPC
 SG_ MRR_ObjRelAccelY_15 : 124|10@0+ (0.03125,-16) [-16|15.96875] "mps2"  MPC
 SG_ MRR_ObjDistXStd_15 : 130|6@0+ (0.1,0) [0|6] "m"  MPC
 SG_ MRR_ObjType_15 : 150|4@0+ (1,0) [0|15] ""  MPC
 SG_ MRR_ObjDistYStd_15 : 140|6@0+ (0.1,0) [0|6] "m"  MPC
 SG_ MRR_ObjRelVelXStd_15 : 146|6@0+ (0.0625,0) [0|3.9375] "mps"  MPC
 SG_ MRR_ObjRAccelXStd_15 : 166|6@0+ (0.0625,0) [0|3.9375] "mps2"  MPC
 SG_ MRR_ObjRelVelYStd_15 : 156|6@0+ (0.0625,0) [0|3.9375] "mps"  MPC
 SG_ MRR_ObjMotionType_15 : 170|3@0+ (1,0) [0|7] ""  MPC
 SG_ MRR_ObjRAccelYStd_15 : 160|6@0+ (0.0625,0) [0|3.9375] "mps2"  MPC
 SG_ MRR_ObjWidth_15 : 183|10@0+ (0.01,0) [0|5] "m"  MPC
 SG_ MRR_ObjMotionDirection_15 : 195|3@0+ (1,0) [0|7] ""  MPC
 SG_ MRR_ObjLength_15 : 189|10@0+ (0.05,0) [0|20] "m"  MPC
 SG_ MRR_ObjHeight_15 : 207|10@0+ (0.01,0) [0|6] "m"  MPC
 SG_ MRR_ObjHeading_15 : 213|12@0+ (0.002,-3.14) [-3.14|3.14] "rad"  MPC
 SG_ MRR_ObjRCS_15 : 217|10@0+ (0.125,-50) [-50|70] "dBsm"  MPC
 SG_ MRR_ObjAge_15 : 239|8@0+ (1,0) [0|255] ""  MPC
 SG_ MRR_ObjRefPoint_15 : 243|3@0+ (1,0) [0|7] "NoUnit"  MPC
 SG_ MRR_ObjRefPoint_16 : 247|3@0+ (1,0) [0|7] "NoUnit"  MPC
 SG_ MRR_ObjHYAS_Reserved_16 : 255|6@0+ (0.017,0) [0|1.071] ""  MPC
 SG_ MRR_ObjTypeProb_16 : 263|6@0+ (2,0) [0|100] "%"  MPC
 SG_ MRR_ObjID_16 : 271|8@0+ (1,0) [0|255] ""  MPC
 SG_ MRR_ObjExistProb_16 : 279|5@0+ (0.04,0) [0|1] ""  MPC
 SG_ MRR_ObjObstacleProb_16 : 274|5@0+ (0.04,0) [0|1] ""  MPC
 SG_ MRR_ObjDistX_16 : 285|12@0+ (0.075,0) [0|305.925] "m"  MPC
 SG_ MRR_ObjDistY_16 : 289|11@0+ (0.125,-128) [-128|127.875] "m"  MPC
 SG_ MRR_ObjRelAccelX_16 : 310|10@0+ (0.03125,-16) [-16|15.96875] "mps2"  MPC
 SG_ MRR_ObjRelVelX_16 : 335|13@0+ (0.0312,-128) [-128|126.9976] "mps"  MPC
 SG_ MRR_ObjRelVelY_16 : 338|13@0+ (0.0312,-128) [-128|126.9976] "mps"  MPC
 SG_ MRR_ObjRelAccelY_16 : 357|10@0+ (0.03125,-16) [-16|15.96875] "mps2"  MPC
 SG_ MRR_ObjDistYStd_16 : 373|6@0+ (0.1,0) [0|6] "m"  MPC
 SG_ MRR_ObjDistXStd_16 : 363|6@0+ (0.1,0) [0|6] "m"  MPC
 SG_ MRR_ObjType_16 : 383|4@0+ (1,0) [0|15] ""  MPC
 SG_ MRR_ObjRelVelXStd_16 : 399|6@0+ (0.0625,0) [0|3.9375] "mps"  MPC
 SG_ MRR_ObjRelVelYStd_16 : 393|6@0+ (0.0625,0) [0|3.9375] "mps"  MPC
 SG_ MRR_ObjRAccelYStd_16 : 413|6@0+ (0.0625,0) [0|3.9375] "mps2"  MPC
 SG_ MRR_ObjRAccelXStd_16 : 403|6@0+ (0.0625,0) [0|3.9375] "mps2"  MPC
 SG_ MRR_ObjMotionType_16 : 423|3@0+ (1,0) [0|7] ""  MPC
 SG_ MRR_ObjWidth_16 : 420|10@0+ (0.01,0) [0|5] "m"  MPC
 SG_ MRR_ObjLength_16 : 426|10@0+ (0.05,0) [0|20] "m"  MPC
 SG_ MRR_ObjMotionDirection_16 : 432|3@0+ (1,0) [0|7] ""  MPC
 SG_ BlockCounter8 : 469|4@0+ (1,0) [0|15] ""  MPC
 SG_ MRR_ObjHeight_16 : 463|10@0+ (0.01,0) [0|6] "m"  MPC
 SG_ MRR_ObjRCS_16 : 465|10@0+ (0.125,-50) [-50|70] "dBsm"  MPC
 SG_ MRR_ObjAge_16 : 487|8@0+ (1,0) [0|255] ""  MPC
 SG_ MRR_ObjMeasured_15 : 497|2@0+ (1,0) [0|3] ""  MPC
 SG_ MRR_ObjMeasured_16 : 499|2@0+ (1,0) [0|3] ""  MPC
 SG_ MRR_ObjHeading_16 : 495|12@0+ (0.002,-3.14) [-3.14|3.14] "rad"  MPC
 SG_ MRR_ObjValid_15 : 508|1@0+ (1,0) [0|1] ""  MPC
 SG_ MRR_ObjValid_16 : 509|1@0+ (1,0) [0|1] ""  MPC

BO_ 1080 MRRAD9: 64 FR
 SG_ Checksum438 : 7|16@0+ (1,0) [0|65535] ""  MPC
 SG_ RollingCounter438 : 23|8@0+ (1,0) [0|255] ""  MPC
 SG_ MRR_ObjHYAS_Reserved_17 : 31|6@0+ (0.017,0) [0|1.071] ""  MPC
 SG_ MRR_ObjTypeProb_17 : 39|6@0+ (2,0) [0|100] "%"  MPC
 SG_ MRR_ObjID_17 : 41|8@0+ (1,0) [0|255] ""  MPC
 SG_ MRR_ObjObstacleProb_17 : 60|5@0+ (0.04,0) [0|1] ""  MPC
 SG_ MRR_ObjExistProb_17 : 49|5@0+ (0.04,0) [0|1] ""  MPC
 SG_ MRR_ObjDistX_17 : 71|12@0+ (0.075,0) [0|305.925] "m"  MPC
 SG_ MRR_ObjDistY_17 : 75|11@0+ (0.125,-128) [-128|127.875] "m"  MPC
 SG_ MRR_ObjRelAccelX_17 : 80|10@0+ (0.03125,-16) [-16|15.96875] "mps2"  MPC
 SG_ MRR_ObjRelVelX_17 : 102|13@0+ (0.0312,-128) [-128|126.9976] "mps"  MPC
 SG_ MRR_ObjRelVelY_17 : 105|13@0+ (0.0312,-128) [-128|126.9976] "mps"  MPC
 SG_ MRR_ObjRelAccelY_17 : 124|10@0+ (0.03125,-16) [-16|15.96875] "mps2"  MPC
 SG_ MRR_ObjDistXStd_17 : 130|6@0+ (0.1,0) [0|6] "m"  MPC
 SG_ MRR_ObjType_17 : 150|4@0+ (1,0) [0|15] ""  MPC
 SG_ MRR_ObjDistYStd_17 : 140|6@0+ (0.1,0) [0|6] "m"  MPC
 SG_ MRR_ObjRelVelXStd_17 : 146|6@0+ (0.0625,0) [0|3.9375] "mps"  MPC
 SG_ MRR_ObjRAccelXStd_17 : 166|6@0+ (0.0625,0) [0|3.9375] "mps2"  MPC
 SG_ MRR_ObjRelVelYStd_17 : 156|6@0+ (0.0625,0) [0|3.9375] "mps"  MPC
 SG_ MRR_ObjMotionType_17 : 170|3@0+ (1,0) [0|7] ""  MPC
 SG_ MRR_ObjRAccelYStd_17 : 160|6@0+ (0.0625,0) [0|3.9375] "mps2"  MPC
 SG_ MRR_ObjWidth_17 : 183|10@0+ (0.01,0) [0|5] "m"  MPC
 SG_ MRR_ObjMotionDirection_17 : 195|3@0+ (1,0) [0|7] ""  MPC
 SG_ MRR_ObjLength_17 : 189|10@0+ (0.05,0) [0|20] "m"  MPC
 SG_ MRR_ObjHeight_17 : 207|10@0+ (0.01,0) [0|6] "m"  MPC
 SG_ MRR_ObjHeading_17 : 213|12@0+ (0.002,-3.14) [-3.14|3.14] "rad"  MPC
 SG_ MRR_ObjRCS_17 : 217|10@0+ (0.125,-50) [-50|70] "dBsm"  MPC
 SG_ MRR_ObjAge_17 : 239|8@0+ (1,0) [0|255] ""  MPC
 SG_ MRR_ObjRefPoint_17 : 243|3@0+ (1,0) [0|7] "NoUnit"  MPC
 SG_ MRR_ObjRefPoint_18 : 247|3@0+ (1,0) [0|7] "NoUnit"  MPC
 SG_ MRR_ObjHYAS_Reserved_18 : 255|6@0+ (0.017,0) [0|1.071] ""  MPC
 SG_ MRR_ObjTypeProb_18 : 263|6@0+ (2,0) [0|100] "%"  MPC
 SG_ MRR_ObjID_18 : 271|8@0+ (1,0) [0|255] ""  MPC
 SG_ MRR_ObjExistProb_18 : 279|5@0+ (0.04,0) [0|1] ""  MPC
 SG_ MRR_ObjObstacleProb_18 : 274|5@0+ (0.04,0) [0|1] ""  MPC
 SG_ MRR_ObjDistX_18 : 285|12@0+ (0.075,0) [0|305.925] "m"  MPC
 SG_ MRR_ObjDistY_18 : 289|11@0+ (0.125,-128) [-128|127.875] "m"  MPC
 SG_ MRR_ObjRelAccelX_18 : 310|10@0+ (0.03125,-16) [-16|15.96875] "mps2"  MPC
 SG_ MRR_ObjRelVelX_18 : 335|13@0+ (0.0312,-128) [-128|126.9976] "mps"  MPC
 SG_ MRR_ObjRelVelY_18 : 338|13@0+ (0.0312,-128) [-128|126.9976] "mps"  MPC
 SG_ MRR_ObjRelAccelY_18 : 357|10@0+ (0.03125,-16) [-16|15.96875] "mps2"  MPC
 SG_ MRR_ObjDistYStd_18 : 373|6@0+ (0.1,0) [0|6] "m"  MPC
 SG_ MRR_ObjDistXStd_18 : 363|6@0+ (0.1,0) [0|6] "m"  MPC
 SG_ MRR_ObjType_18 : 383|4@0+ (1,0) [0|15] ""  MPC
 SG_ MRR_ObjRelVelXStd_18 : 399|6@0+ (0.0625,0) [0|3.9375] "mps"  MPC
 SG_ MRR_ObjRelVelYStd_18 : 393|6@0+ (0.0625,0) [0|3.9375] "mps"  MPC
 SG_ MRR_ObjRAccelYStd_18 : 413|6@0+ (0.0625,0) [0|3.9375] "mps2"  MPC
 SG_ MRR_ObjRAccelXStd_18 : 403|6@0+ (0.0625,0) [0|3.9375] "mps2"  MPC
 SG_ MRR_ObjMotionType_18 : 423|3@0+ (1,0) [0|7] ""  MPC
 SG_ MRR_ObjWidth_18 : 420|10@0+ (0.01,0) [0|5] "m"  MPC
 SG_ MRR_ObjLength_18 : 426|10@0+ (0.05,0) [0|20] "m"  MPC
 SG_ MRR_ObjMotionDirection_18 : 432|3@0+ (1,0) [0|7] ""  MPC
 SG_ BlockCounter9 : 469|4@0+ (1,0) [0|15] ""  MPC
 SG_ MRR_ObjHeight_18 : 463|10@0+ (0.01,0) [0|6] "m"  MPC
 SG_ MRR_ObjRCS_18 : 465|10@0+ (0.125,-50) [-50|70] "dBsm"  MPC
 SG_ MRR_ObjAge_18 : 487|8@0+ (1,0) [0|255] ""  MPC
 SG_ MRR_ObjMeasured_17 : 497|2@0+ (1,0) [0|3] ""  MPC
 SG_ MRR_ObjMeasured_18 : 499|2@0+ (1,0) [0|3] ""  MPC
 SG_ MRR_ObjHeading_18 : 495|12@0+ (0.002,-3.14) [-3.14|3.14] "rad"  MPC
 SG_ MRR_ObjValid_17 : 508|1@0+ (1,0) [0|1] ""  MPC
 SG_ MRR_ObjValid_18 : 509|1@0+ (1,0) [0|1] ""  MPC

BO_ 1081 MRRAD10: 64 FR
 SG_ Checksum439 : 7|16@0+ (1,0) [0|65535] ""  MPC
 SG_ RollingCounter439 : 23|8@0+ (1,0) [0|255] ""  MPC
 SG_ MRR_ObjHYAS_Reserved_19 : 31|6@0+ (0.017,0) [0|1.071] ""  MPC
 SG_ MRR_ObjTypeProb_19 : 39|6@0+ (2,0) [0|100] "%"  MPC
 SG_ MRR_ObjID_19 : 41|8@0+ (1,0) [0|255] ""  MPC
 SG_ MRR_ObjObstacleProb_19 : 60|5@0+ (0.04,0) [0|1] ""  MPC
 SG_ MRR_ObjExistProb_19 : 49|5@0+ (0.04,0) [0|1] ""  MPC
 SG_ MRR_ObjDistX_19 : 71|12@0+ (0.075,0) [0|305.925] "m"  MPC
 SG_ MRR_ObjDistY_19 : 75|11@0+ (0.125,-128) [-128|127.875] "m"  MPC
 SG_ MRR_ObjRelAccelX_19 : 80|10@0+ (0.03125,-16) [-16|15.96875] "mps2"  MPC
 SG_ MRR_ObjRelVelX_19 : 102|13@0+ (0.0312,-128) [-128|126.9976] "mps"  MPC
 SG_ MRR_ObjRelVelY_19 : 105|13@0+ (0.0312,-128) [-128|126.9976] "mps"  MPC
 SG_ MRR_ObjRelAccelY_19 : 124|10@0+ (0.03125,-16) [-16|15.96875] "mps2"  MPC
 SG_ MRR_ObjDistXStd_19 : 130|6@0+ (0.1,0) [0|6] "m"  MPC
 SG_ MRR_ObjType_19 : 150|4@0+ (1,0) [0|15] ""  MPC
 SG_ MRR_ObjDistYStd_19 : 140|6@0+ (0.1,0) [0|6] "m"  MPC
 SG_ MRR_ObjRelVelXStd_19 : 146|6@0+ (0.0625,0) [0|3.9375] "mps"  MPC
 SG_ MRR_ObjRAccelXStd_19 : 166|6@0+ (0.0625,0) [0|3.9375] "mps2"  MPC
 SG_ MRR_ObjRelVelYStd_19 : 156|6@0+ (0.0625,0) [0|3.9375] "mps"  MPC
 SG_ MRR_ObjMotionType_19 : 170|3@0+ (1,0) [0|7] ""  MPC
 SG_ MRR_ObjRAccelYStd_19 : 160|6@0+ (0.0625,0) [0|3.9375] "mps2"  MPC
 SG_ MRR_ObjWidth_19 : 183|10@0+ (0.01,0) [0|5] "m"  MPC
 SG_ MRR_ObjMotionDirection_19 : 195|3@0+ (1,0) [0|7] ""  MPC
 SG_ MRR_ObjLength_19 : 189|10@0+ (0.05,0) [0|20] "m"  MPC
 SG_ MRR_ObjHeight_19 : 207|10@0+ (0.01,0) [0|6] "m"  MPC
 SG_ MRR_ObjHeading_19 : 213|12@0+ (0.002,-3.14) [-3.14|3.14] "rad"  MPC
 SG_ MRR_ObjRCS_19 : 217|10@0+ (0.125,-50) [-50|70] "dBsm"  MPC
 SG_ MRR_ObjAge_19 : 239|8@0+ (1,0) [0|255] ""  MPC
 SG_ MRR_ObjRefPoint_19 : 243|3@0+ (1,0) [0|7] "NoUnit"  MPC
 SG_ MRR_ObjRefPoint_20 : 247|3@0+ (1,0) [0|7] "NoUnit"  MPC
 SG_ MRR_ObjHYAS_Reserved_20 : 255|6@0+ (0.017,0) [0|1.071] ""  MPC
 SG_ MRR_ObjTypeProb_20 : 263|6@0+ (2,0) [0|100] "%"  MPC
 SG_ MRR_ObjID_20 : 271|8@0+ (1,0) [0|255] ""  MPC
 SG_ MRR_ObjExistProb_20 : 279|5@0+ (0.04,0) [0|1] ""  MPC
 SG_ MRR_ObjObstacleProb_20 : 274|5@0+ (0.04,0) [0|1] ""  MPC
 SG_ MRR_ObjDistX_20 : 285|12@0+ (0.075,0) [0|305.925] "m"  MPC
 SG_ MRR_ObjDistY_20 : 289|11@0+ (0.125,-128) [-128|127.875] "m"  MPC
 SG_ MRR_ObjRelAccelX_20 : 310|10@0+ (0.03125,-16) [-16|15.96875] "mps2"  MPC
 SG_ MRR_ObjRelVelX_20 : 335|13@0+ (0.0312,-128) [-128|126.9976] "mps"  MPC
 SG_ MRR_ObjRelVelY_20 : 338|13@0+ (0.0312,-128) [-128|126.9976] "mps"  MPC
 SG_ MRR_ObjRelAccelY_20 : 357|10@0+ (0.03125,-16) [-16|15.96875] "mps2"  MPC
 SG_ MRR_ObjDistYStd_20 : 373|6@0+ (0.1,0) [0|6] "m"  MPC
 SG_ MRR_ObjDistXStd_20 : 363|6@0+ (0.1,0) [0|6] "m"  MPC
 SG_ MRR_ObjType_20 : 383|4@0+ (1,0) [0|15] ""  MPC
 SG_ MRR_ObjRelVelXStd_20 : 399|6@0+ (0.0625,0) [0|3.9375] "mps"  MPC
 SG_ MRR_ObjRelVelYStd_20 : 393|6@0+ (0.0625,0) [0|3.9375] "mps"  MPC
 SG_ MRR_ObjRAccelYStd_20 : 413|6@0+ (0.0625,0) [0|3.9375] "mps2"  MPC
 SG_ MRR_ObjRAccelXStd_20 : 403|6@0+ (0.0625,0) [0|3.9375] "mps2"  MPC
 SG_ MRR_ObjMotionType_20 : 423|3@0+ (1,0) [0|7] ""  MPC
 SG_ MRR_ObjWidth_20 : 420|10@0+ (0.01,0) [0|5] "m"  MPC
 SG_ MRR_ObjLength_20 : 426|10@0+ (0.05,0) [0|20] "m"  MPC
 SG_ MRR_ObjMotionDirection_20 : 432|3@0+ (1,0) [0|7] ""  MPC
 SG_ BlockCounter10 : 469|4@0+ (1,0) [0|15] ""  MPC
 SG_ MRR_ObjHeight_20 : 463|10@0+ (0.01,0) [0|6] "m"  MPC
 SG_ MRR_ObjRCS_20 : 465|10@0+ (0.125,-50) [-50|70] "dBsm"  MPC
 SG_ MRR_ObjAge_20 : 487|8@0+ (1,0) [0|255] ""  MPC
 SG_ MRR_ObjMeasured_19 : 497|2@0+ (1,0) [0|3] ""  MPC
 SG_ MRR_ObjMeasured_20 : 499|2@0+ (1,0) [0|3] ""  MPC
 SG_ MRR_ObjHeading_20 : 495|12@0+ (0.002,-3.14) [-3.14|3.14] "rad"  MPC
 SG_ MRR_ObjValid_19 : 508|1@0+ (1,0) [0|1] ""  MPC
 SG_ MRR_ObjValid_20 : 509|1@0+ (1,0) [0|1] ""  MPC

BO_ 1082 MRRAD11: 64 FR
 SG_ Checksum43A : 7|16@0+ (1,0) [0|65535] ""  MPC
 SG_ RollingCounter43A : 23|8@0+ (1,0) [0|255] ""  MPC
 SG_ MRR_ObjHYAS_Reserved_21 : 31|6@0+ (0.017,0) [0|1.071] ""  MPC
 SG_ MRR_ObjTypeProb_21 : 39|6@0+ (2,0) [0|100] "%"  MPC
 SG_ MRR_ObjID_21 : 41|8@0+ (1,0) [0|255] ""  MPC
 SG_ MRR_ObjObstacleProb_21 : 60|5@0+ (0.04,0) [0|1] ""  MPC
 SG_ MRR_ObjExistProb_21 : 49|5@0+ (0.04,0) [0|1] ""  MPC
 SG_ MRR_ObjDistX_21 : 71|12@0+ (0.075,0) [0|305.925] "m"  MPC
 SG_ MRR_ObjDistY_21 : 75|11@0+ (0.125,-128) [-128|127.875] "m"  MPC
 SG_ MRR_ObjRelAccelX_21 : 80|10@0+ (0.03125,-16) [-16|15.96875] "mps2"  MPC
 SG_ MRR_ObjRelVelX_21 : 102|13@0+ (0.0312,-128) [-128|126.9976] "mps"  MPC
 SG_ MRR_ObjRelVelY_21 : 105|13@0+ (0.0312,-128) [-128|126.9976] "mps"  MPC
 SG_ MRR_ObjRelAccelY_21 : 124|10@0+ (0.03125,-16) [-16|15.96875] "mps2"  MPC
 SG_ MRR_ObjDistXStd_21 : 130|6@0+ (0.1,0) [0|6] "m"  MPC
 SG_ MRR_ObjType_21 : 150|4@0+ (1,0) [0|15] ""  MPC
 SG_ MRR_ObjDistYStd_21 : 140|6@0+ (0.1,0) [0|6] "m"  MPC
 SG_ MRR_ObjRelVelXStd_21 : 146|6@0+ (0.0625,0) [0|3.9375] "mps"  MPC
 SG_ MRR_ObjRAccelXStd_21 : 166|6@0+ (0.0625,0) [0|3.9375] "mps2"  MPC
 SG_ MRR_ObjRelVelYStd_21 : 156|6@0+ (0.0625,0) [0|3.9375] "mps"  MPC
 SG_ MRR_ObjMotionType_21 : 170|3@0+ (1,0) [0|7] ""  MPC
 SG_ MRR_ObjRAccelYStd_21 : 160|6@0+ (0.0625,0) [0|3.9375] "mps2"  MPC
 SG_ MRR_ObjWidth_21 : 183|10@0+ (0.01,0) [0|5] "m"  MPC
 SG_ MRR_ObjMotionDirection_21 : 195|3@0+ (1,0) [0|7] ""  MPC
 SG_ MRR_ObjLength_21 : 189|10@0+ (0.05,0) [0|20] "m"  MPC
 SG_ MRR_ObjHeight_21 : 207|10@0+ (0.01,0) [0|6] "m"  MPC
 SG_ MRR_ObjHeading_21 : 213|12@0+ (0.002,-3.14) [-3.14|3.14] "rad"  MPC
 SG_ MRR_ObjRCS_21 : 217|10@0+ (0.125,-50) [-50|70] "dBsm"  MPC
 SG_ MRR_ObjAge_21 : 239|8@0+ (1,0) [0|255] ""  MPC
 SG_ MRR_ObjRefPoint_21 : 243|3@0+ (1,0) [0|7] "NoUnit"  MPC
 SG_ MRR_ObjRefPoint_22 : 247|3@0+ (1,0) [0|7] "NoUnit"  MPC
 SG_ MRR_ObjHYAS_Reserved_22 : 255|6@0+ (0.017,0) [0|1.071] ""  MPC
 SG_ MRR_ObjTypeProb_22 : 263|6@0+ (2,0) [0|100] "%"  MPC
 SG_ MRR_ObjID_22 : 271|8@0+ (1,0) [0|255] ""  MPC
 SG_ MRR_ObjExistProb_22 : 279|5@0+ (0.04,0) [0|1] ""  MPC
 SG_ MRR_ObjObstacleProb_22 : 274|5@0+ (0.04,0) [0|1] ""  MPC
 SG_ MRR_ObjDistX_22 : 285|12@0+ (0.075,0) [0|305.925] "m"  MPC
 SG_ MRR_ObjDistY_22 : 289|11@0+ (0.125,-128) [-128|127.875] "m"  MPC
 SG_ MRR_ObjRelAccelX_22 : 310|10@0+ (0.03125,-16) [-16|15.96875] "mps2"  MPC
 SG_ MRR_ObjRelVelX_22 : 335|13@0+ (0.0312,-128) [-128|126.9976] "mps"  MPC
 SG_ MRR_ObjRelVelY_22 : 338|13@0+ (0.0312,-128) [-128|126.9976] "mps"  MPC
 SG_ MRR_ObjRelAccelY_22 : 357|10@0+ (0.03125,-16) [-16|15.96875] "mps2"  MPC
 SG_ MRR_ObjDistYStd_22 : 373|6@0+ (0.1,0) [0|6] "m"  MPC
 SG_ MRR_ObjDistXStd_22 : 363|6@0+ (0.1,0) [0|6] "m"  MPC
 SG_ MRR_ObjType_22 : 383|4@0+ (1,0) [0|15] ""  MPC
 SG_ MRR_ObjRelVelXStd_22 : 399|6@0+ (0.0625,0) [0|3.9375] "mps"  MPC
 SG_ MRR_ObjRelVelYStd_22 : 393|6@0+ (0.0625,0) [0|3.9375] "mps"  MPC
 SG_ MRR_ObjRAccelYStd_22 : 413|6@0+ (0.0625,0) [0|3.9375] "mps2"  MPC
 SG_ MRR_ObjRAccelXStd_22 : 403|6@0+ (0.0625,0) [0|3.9375] "mps2"  MPC
 SG_ MRR_ObjMotionType_22 : 423|3@0+ (1,0) [0|7] ""  MPC
 SG_ MRR_ObjWidth_22 : 420|10@0+ (0.01,0) [0|5] "m"  MPC
 SG_ MRR_ObjLength_22 : 426|10@0+ (0.05,0) [0|20] "m"  MPC
 SG_ MRR_ObjMotionDirection_22 : 432|3@0+ (1,0) [0|7] ""  MPC
 SG_ BlockCounter11 : 469|4@0+ (1,0) [0|15] ""  MPC
 SG_ MRR_ObjHeight_22 : 463|10@0+ (0.01,0) [0|6] "m"  MPC
 SG_ MRR_ObjRCS_22 : 465|10@0+ (0.125,-50) [-50|70] "dBsm"  MPC
 SG_ MRR_ObjAge_22 : 487|8@0+ (1,0) [0|255] ""  MPC
 SG_ MRR_ObjMeasured_21 : 497|2@0+ (1,0) [0|3] ""  MPC
 SG_ MRR_ObjMeasured_22 : 499|2@0+ (1,0) [0|3] ""  MPC
 SG_ MRR_ObjHeading_22 : 495|12@0+ (0.002,-3.14) [-3.14|3.14] "rad"  MPC
 SG_ MRR_ObjValid_21 : 508|1@0+ (1,0) [0|1] ""  MPC
 SG_ MRR_ObjValid_22 : 509|1@0+ (1,0) [0|1] ""  MPC

BO_ 1083 MRRAD12: 64 FR
 SG_ Checksum43B : 7|16@0+ (1,0) [0|65535] ""  MPC
 SG_ RollingCounter43B : 23|8@0+ (1,0) [0|255] ""  MPC
 SG_ MRR_ObjHYAS_Reserved_23 : 31|6@0+ (0.017,0) [0|1.071] ""  MPC
 SG_ MRR_ObjTypeProb_23 : 39|6@0+ (2,0) [0|100] "%"  MPC
 SG_ MRR_ObjID_23 : 41|8@0+ (1,0) [0|255] ""  MPC
 SG_ MRR_ObjObstacleProb_23 : 60|5@0+ (0.04,0) [0|1] ""  MPC
 SG_ MRR_ObjExistProb_23 : 49|5@0+ (0.04,0) [0|1] ""  MPC
 SG_ MRR_ObjDistX_23 : 71|12@0+ (0.075,0) [0|305.925] "m"  MPC
 SG_ MRR_ObjDistY_23 : 75|11@0+ (0.125,-128) [-128|127.875] "m"  MPC
 SG_ MRR_ObjRelAccelX_23 : 80|10@0+ (0.03125,-16) [-16|15.96875] "mps2"  MPC
 SG_ MRR_ObjRelVelX_23 : 102|13@0+ (0.0312,-128) [-128|126.9976] "mps"  MPC
 SG_ MRR_ObjRelVelY_23 : 105|13@0+ (0.0312,-128) [-128|126.9976] "mps"  MPC
 SG_ MRR_ObjRelAccelY_23 : 124|10@0+ (0.03125,-16) [-16|15.96875] "mps2"  MPC
 SG_ MRR_ObjDistXStd_23 : 130|6@0+ (0.1,0) [0|6] "m"  MPC
 SG_ MRR_ObjType_23 : 150|4@0+ (1,0) [0|15] ""  MPC
 SG_ MRR_ObjDistYStd_23 : 140|6@0+ (0.1,0) [0|6] "m"  MPC
 SG_ MRR_ObjRelVelXStd_23 : 146|6@0+ (0.0625,0) [0|3.9375] "mps"  MPC
 SG_ MRR_ObjRAccelXStd_23 : 166|6@0+ (0.0625,0) [0|3.9375] "mps2"  MPC
 SG_ MRR_ObjRelVelYStd_23 : 156|6@0+ (0.0625,0) [0|3.9375] "mps"  MPC
 SG_ MRR_ObjMotionType_23 : 170|3@0+ (1,0) [0|7] ""  MPC
 SG_ MRR_ObjRAccelYStd_23 : 160|6@0+ (0.0625,0) [0|3.9375] "mps2"  MPC
 SG_ MRR_ObjWidth_23 : 183|10@0+ (0.01,0) [0|5] "m"  MPC
 SG_ MRR_ObjMotionDirection_23 : 195|3@0+ (1,0) [0|7] ""  MPC
 SG_ MRR_ObjLength_23 : 189|10@0+ (0.05,0) [0|20] "m"  MPC
 SG_ MRR_ObjHeight_23 : 207|10@0+ (0.01,0) [0|6] "m"  MPC
 SG_ MRR_ObjHeading_23 : 213|12@0+ (0.002,-3.14) [-3.14|3.14] "rad"  MPC
 SG_ MRR_ObjRCS_23 : 217|10@0+ (0.125,-50) [-50|70] "dBsm"  MPC
 SG_ MRR_ObjAge_23 : 239|8@0+ (1,0) [0|255] ""  MPC
 SG_ MRR_ObjRefPoint_23 : 243|3@0+ (1,0) [0|7] "NoUnit"  MPC
 SG_ MRR_ObjRefPoint_24 : 247|3@0+ (1,0) [0|7] "NoUnit"  MPC
 SG_ MRR_ObjHYAS_Reserved_24 : 255|6@0+ (0.017,0) [0|1.071] ""  MPC
 SG_ MRR_ObjTypeProb_24 : 263|6@0+ (2,0) [0|100] "%"  MPC
 SG_ MRR_ObjID_24 : 271|8@0+ (1,0) [0|255] ""  MPC
 SG_ MRR_ObjExistProb_24 : 279|5@0+ (0.04,0) [0|1] ""  MPC
 SG_ MRR_ObjObstacleProb_24 : 274|5@0+ (0.04,0) [0|1] ""  MPC
 SG_ MRR_ObjDistX_24 : 285|12@0+ (0.075,0) [0|305.925] "m"  MPC
 SG_ MRR_ObjDistY_24 : 289|11@0+ (0.125,-128) [-128|127.875] "m"  MPC
 SG_ MRR_ObjRelAccelX_24 : 310|10@0+ (0.03125,-16) [-16|15.96875] "mps2"  MPC
 SG_ MRR_ObjRelVelX_24 : 335|13@0+ (0.0312,-128) [-128|126.9976] "mps"  MPC
 SG_ MRR_ObjRelVelY_24 : 338|13@0+ (0.0312,-128) [-128|126.9976] "mps"  MPC
 SG_ MRR_ObjRelAccelY_24 : 357|10@0+ (0.03125,-16) [-16|15.96875] "mps2"  MPC
 SG_ MRR_ObjDistYStd_24 : 373|6@0+ (0.1,0) [0|6] "m"  MPC
 SG_ MRR_ObjDistXStd_24 : 363|6@0+ (0.1,0) [0|6] "m"  MPC
 SG_ MRR_ObjType_24 : 383|4@0+ (1,0) [0|15] ""  MPC
 SG_ MRR_ObjRelVelXStd_24 : 399|6@0+ (0.0625,0) [0|3.9375] "mps"  MPC
 SG_ MRR_ObjRelVelYStd_24 : 393|6@0+ (0.0625,0) [0|3.9375] "mps"  MPC
 SG_ MRR_ObjRAccelYStd_24 : 413|6@0+ (0.0625,0) [0|3.9375] "mps2"  MPC
 SG_ MRR_ObjRAccelXStd_24 : 403|6@0+ (0.0625,0) [0|3.9375] "mps2"  MPC
 SG_ MRR_ObjMotionType_24 : 423|3@0+ (1,0) [0|7] ""  MPC
 SG_ MRR_ObjWidth_24 : 420|10@0+ (0.01,0) [0|5] "m"  MPC
 SG_ MRR_ObjLength_24 : 426|10@0+ (0.05,0) [0|20] "m"  MPC
 SG_ MRR_ObjMotionDirection_24 : 432|3@0+ (1,0) [0|7] ""  MPC
 SG_ BlockCounter12 : 469|4@0+ (1,0) [0|15] ""  MPC
 SG_ MRR_ObjHeight_24 : 463|10@0+ (0.01,0) [0|6] "m"  MPC
 SG_ MRR_ObjRCS_24 : 465|10@0+ (0.125,-50) [-50|70] "dBsm"  MPC
 SG_ MRR_ObjAge_24 : 487|8@0+ (1,0) [0|255] ""  MPC
 SG_ MRR_ObjMeasured_23 : 497|2@0+ (1,0) [0|3] ""  MPC
 SG_ MRR_ObjMeasured_24 : 499|2@0+ (1,0) [0|3] ""  MPC
 SG_ MRR_ObjHeading_24 : 495|12@0+ (0.002,-3.14) [-3.14|3.14] "rad"  MPC
 SG_ MRR_ObjValid_23 : 508|1@0+ (1,0) [0|1] ""  MPC
 SG_ MRR_ObjValid_24 : 509|1@0+ (1,0) [0|1] ""  MPC

BO_ 1084 MRRAD13: 64 FR
 SG_ Checksum43C : 7|16@0+ (1,0) [0|65535] ""  MPC
 SG_ RollingCounter43C : 23|8@0+ (1,0) [0|255] ""  MPC
 SG_ MRR_ObjHYAS_Reserved_25 : 31|6@0+ (0.017,0) [0|1.071] ""  MPC
 SG_ MRR_ObjTypeProb_25 : 39|6@0+ (2,0) [0|100] "%"  MPC
 SG_ MRR_ObjID_25 : 41|8@0+ (1,0) [0|255] ""  MPC
 SG_ MRR_ObjObstacleProb_25 : 60|5@0+ (0.04,0) [0|1] ""  MPC
 SG_ MRR_ObjExistProb_25 : 49|5@0+ (0.04,0) [0|1] ""  MPC
 SG_ MRR_ObjDistX_25 : 71|12@0+ (0.075,0) [0|305.925] "m"  MPC
 SG_ MRR_ObjDistY_25 : 75|11@0+ (0.125,-128) [-128|127.875] "m"  MPC
 SG_ MRR_ObjRelAccelX_25 : 80|10@0+ (0.03125,-16) [-16|15.96875] "mps2"  MPC
 SG_ MRR_ObjRelVelX_25 : 102|13@0+ (0.0312,-128) [-128|126.9976] "mps"  MPC
 SG_ MRR_ObjRelVelY_25 : 105|13@0+ (0.0312,-128) [-128|126.9976] "mps"  MPC
 SG_ MRR_ObjRelAccelY_25 : 124|10@0+ (0.03125,-16) [-16|15.96875] "mps2"  MPC
 SG_ MRR_ObjDistXStd_25 : 130|6@0+ (0.1,0) [0|6] "m"  MPC
 SG_ MRR_ObjType_25 : 150|4@0+ (1,0) [0|15] ""  MPC
 SG_ MRR_ObjDistYStd_25 : 140|6@0+ (0.1,0) [0|6] "m"  MPC
 SG_ MRR_ObjRelVelXStd_25 : 146|6@0+ (0.0625,0) [0|3.9375] "mps"  MPC
 SG_ MRR_ObjRAccelXStd_25 : 166|6@0+ (0.0625,0) [0|3.9375] "mps2"  MPC
 SG_ MRR_ObjRelVelYStd_25 : 156|6@0+ (0.0625,0) [0|3.9375] "mps"  MPC
 SG_ MRR_ObjMotionType_25 : 170|3@0+ (1,0) [0|7] ""  MPC
 SG_ MRR_ObjRAccelYStd_25 : 160|6@0+ (0.0625,0) [0|3.9375] "mps2"  MPC
 SG_ MRR_ObjWidth_25 : 183|10@0+ (0.01,0) [0|5] "m"  MPC
 SG_ MRR_ObjMotionDirection_25 : 195|3@0+ (1,0) [0|7] ""  MPC
 SG_ MRR_ObjLength_25 : 189|10@0+ (0.05,0) [0|20] "m"  MPC
 SG_ MRR_ObjHeight_25 : 207|10@0+ (0.01,0) [0|6] "m"  MPC
 SG_ MRR_ObjHeading_25 : 213|12@0+ (0.002,-3.14) [-3.14|3.14] "rad"  MPC
 SG_ MRR_ObjRCS_25 : 217|10@0+ (0.125,-50) [-50|70] "dBsm"  MPC
 SG_ MRR_ObjAge_25 : 239|8@0+ (1,0) [0|255] ""  MPC
 SG_ MRR_ObjRefPoint_25 : 243|3@0+ (1,0) [0|7] "NoUnit"  MPC
 SG_ MRR_ObjRefPoint_26 : 247|3@0+ (1,0) [0|7] "NoUnit"  MPC
 SG_ MRR_ObjHYAS_Reserved_26 : 255|6@0+ (0.017,0) [0|1.071] ""  MPC
 SG_ MRR_ObjTypeProb_26 : 263|6@0+ (2,0) [0|100] "%"  MPC
 SG_ MRR_ObjID_26 : 271|8@0+ (1,0) [0|255] ""  MPC
 SG_ MRR_ObjExistProb_26 : 279|5@0+ (0.04,0) [0|1] ""  MPC
 SG_ MRR_ObjObstacleProb_26 : 274|5@0+ (0.04,0) [0|1] ""  MPC
 SG_ MRR_ObjDistX_26 : 285|12@0+ (0.075,0) [0|305.925] "m"  MPC
 SG_ MRR_ObjDistY_26 : 289|11@0+ (0.125,-128) [-128|127.875] "m"  MPC
 SG_ MRR_ObjRelAccelX_26 : 310|10@0+ (0.03125,-16) [-16|15.96875] "mps2"  MPC
 SG_ MRR_ObjRelVelX_26 : 335|13@0+ (0.0312,-128) [-128|126.9976] "mps"  MPC
 SG_ MRR_ObjRelVelY_26 : 338|13@0+ (0.0312,-128) [-128|126.9976] "mps"  MPC
 SG_ MRR_ObjRelAccelY_26 : 357|10@0+ (0.03125,-16) [-16|15.96875] "mps2"  MPC
 SG_ MRR_ObjDistYStd_26 : 373|6@0+ (0.1,0) [0|6] "m"  MPC
 SG_ MRR_ObjDistXStd_26 : 363|6@0+ (0.1,0) [0|6] "m"  MPC
 SG_ MRR_ObjType_26 : 383|4@0+ (1,0) [0|15] ""  MPC
 SG_ MRR_ObjRelVelXStd_26 : 399|6@0+ (0.0625,0) [0|3.9375] "mps"  MPC
 SG_ MRR_ObjRelVelYStd_26 : 393|6@0+ (0.0625,0) [0|3.9375] "mps"  MPC
 SG_ MRR_ObjRAccelYStd_26 : 413|6@0+ (0.0625,0) [0|3.9375] "mps2"  MPC
 SG_ MRR_ObjRAccelXStd_26 : 403|6@0+ (0.0625,0) [0|3.9375] "mps2"  MPC
 SG_ MRR_ObjMotionType_26 : 423|3@0+ (1,0) [0|7] ""  MPC
 SG_ MRR_ObjWidth_26 : 420|10@0+ (0.01,0) [0|5] "m"  MPC
 SG_ MRR_ObjLength_26 : 426|10@0+ (0.05,0) [0|20] "m"  MPC
 SG_ MRR_ObjMotionDirection_26 : 432|3@0+ (1,0) [0|7] ""  MPC
 SG_ BlockCounter13 : 469|4@0+ (1,0) [0|15] ""  MPC
 SG_ MRR_ObjHeight_26 : 463|10@0+ (0.01,0) [0|6] "m"  MPC
 SG_ MRR_ObjRCS_26 : 465|10@0+ (0.125,-50) [-50|70] "dBsm"  MPC
 SG_ MRR_ObjAge_26 : 487|8@0+ (1,0) [0|255] ""  MPC
 SG_ MRR_ObjMeasured_25 : 497|2@0+ (1,0) [0|3] ""  MPC
 SG_ MRR_ObjMeasured_26 : 499|2@0+ (1,0) [0|3] ""  MPC
 SG_ MRR_ObjHeading_26 : 495|12@0+ (0.002,-3.14) [-3.14|3.14] "rad"  MPC
 SG_ MRR_ObjValid_25 : 508|1@0+ (1,0) [0|1] ""  MPC
 SG_ MRR_ObjValid_26 : 509|1@0+ (1,0) [0|1] ""  MPC

BO_ 1085 MRRAD14: 64 FR
 SG_ Checksum43D : 7|16@0+ (1,0) [0|65535] ""  MPC
 SG_ RollingCounter43D : 23|8@0+ (1,0) [0|255] ""  MPC
 SG_ MRR_ObjHYAS_Reserved_27 : 31|6@0+ (0.017,0) [0|1.071] ""  MPC
 SG_ MRR_ObjTypeProb_27 : 39|6@0+ (2,0) [0|100] "%"  MPC
 SG_ MRR_ObjID_27 : 41|8@0+ (1,0) [0|255] ""  MPC
 SG_ MRR_ObjObstacleProb_27 : 60|5@0+ (0.04,0) [0|1] ""  MPC
 SG_ MRR_ObjExistProb_27 : 49|5@0+ (0.04,0) [0|1] ""  MPC
 SG_ MRR_ObjDistX_27 : 71|12@0+ (0.075,0) [0|305.925] "m"  MPC
 SG_ MRR_ObjDistY_27 : 75|11@0+ (0.125,-128) [-128|127.875] "m"  MPC
 SG_ MRR_ObjRelAccelX_27 : 80|10@0+ (0.03125,-16) [-16|15.96875] "mps2"  MPC
 SG_ MRR_ObjRelVelX_27 : 102|13@0+ (0.0312,-128) [-128|126.9976] "mps"  MPC
 SG_ MRR_ObjRelVelY_27 : 105|13@0+ (0.0312,-128) [-128|126.9976] "mps"  MPC
 SG_ MRR_ObjRelAccelY_27 : 124|10@0+ (0.03125,-16) [-16|15.96875] "mps2"  MPC
 SG_ MRR_ObjDistXStd_27 : 130|6@0+ (0.1,0) [0|6] "m"  MPC
 SG_ MRR_ObjType_27 : 150|4@0+ (1,0) [0|15] ""  MPC
 SG_ MRR_ObjDistYStd_27 : 140|6@0+ (0.1,0) [0|6] "m"  MPC
 SG_ MRR_ObjRelVelXStd_27 : 146|6@0+ (0.0625,0) [0|3.9375] "mps"  MPC
 SG_ MRR_ObjRAccelXStd_27 : 166|6@0+ (0.0625,0) [0|3.9375] "mps2"  MPC
 SG_ MRR_ObjRelVelYStd_27 : 156|6@0+ (0.0625,0) [0|3.9375] "mps"  MPC
 SG_ MRR_ObjMotionType_27 : 170|3@0+ (1,0) [0|7] ""  MPC
 SG_ MRR_ObjRAccelYStd_27 : 160|6@0+ (0.0625,0) [0|3.9375] "mps2"  MPC
 SG_ MRR_ObjWidth_27 : 183|10@0+ (0.01,0) [0|5] "m"  MPC
 SG_ MRR_ObjMotionDirection_27 : 195|3@0+ (1,0) [0|7] ""  MPC
 SG_ MRR_ObjLength_27 : 189|10@0+ (0.05,0) [0|20] "m"  MPC
 SG_ MRR_ObjHeight_27 : 207|10@0+ (0.01,0) [0|6] "m"  MPC
 SG_ MRR_ObjHeading_27 : 213|12@0+ (0.002,-3.14) [-3.14|3.14] "rad"  MPC
 SG_ MRR_ObjRCS_27 : 217|10@0+ (0.125,-50) [-50|70] "dBsm"  MPC
 SG_ MRR_ObjAge_27 : 239|8@0+ (1,0) [0|255] ""  MPC
 SG_ MRR_ObjRefPoint_27 : 243|3@0+ (1,0) [0|7] "NoUnit"  MPC
 SG_ MRR_ObjRefPoint_28 : 247|3@0+ (1,0) [0|7] "NoUnit"  MPC
 SG_ MRR_ObjHYAS_Reserved_28 : 255|6@0+ (0.017,0) [0|1.071] ""  MPC
 SG_ MRR_ObjTypeProb_28 : 263|6@0+ (2,0) [0|100] "%"  MPC
 SG_ MRR_ObjID_28 : 271|8@0+ (1,0) [0|255] ""  MPC
 SG_ MRR_ObjExistProb_28 : 279|5@0+ (0.04,0) [0|1] ""  MPC
 SG_ MRR_ObjObstacleProb_28 : 274|5@0+ (0.04,0) [0|1] ""  MPC
 SG_ MRR_ObjDistX_28 : 285|12@0+ (0.075,0) [0|305.925] "m"  MPC
 SG_ MRR_ObjDistY_28 : 289|11@0+ (0.125,-128) [-128|127.875] "m"  MPC
 SG_ MRR_ObjRelAccelX_28 : 310|10@0+ (0.03125,-16) [-16|15.96875] "mps2"  MPC
 SG_ MRR_ObjRelVelX_28 : 335|13@0+ (0.0312,-128) [-128|126.9976] "mps"  MPC
 SG_ MRR_ObjRelVelY_28 : 338|13@0+ (0.0312,-128) [-128|126.9976] "mps"  MPC
 SG_ MRR_ObjRelAccelY_28 : 357|10@0+ (0.03125,-16) [-16|15.96875] "mps2"  MPC
 SG_ MRR_ObjDistYStd_28 : 373|6@0+ (0.1,0) [0|6] "m"  MPC
 SG_ MRR_ObjDistXStd_28 : 363|6@0+ (0.1,0) [0|6] "m"  MPC
 SG_ MRR_ObjType_28 : 383|4@0+ (1,0) [0|15] ""  MPC
 SG_ MRR_ObjRelVelXStd_28 : 399|6@0+ (0.0625,0) [0|3.9375] "mps"  MPC
 SG_ MRR_ObjRelVelYStd_28 : 393|6@0+ (0.0625,0) [0|3.9375] "mps"  MPC
 SG_ MRR_ObjRAccelYStd_28 : 413|6@0+ (0.0625,0) [0|3.9375] "mps2"  MPC
 SG_ MRR_ObjRAccelXStd_28 : 403|6@0+ (0.0625,0) [0|3.9375] "mps2"  MPC
 SG_ MRR_ObjMotionType_28 : 423|3@0+ (1,0) [0|7] ""  MPC
 SG_ MRR_ObjWidth_28 : 420|10@0+ (0.01,0) [0|5] "m"  MPC
 SG_ MRR_ObjLength_28 : 426|10@0+ (0.05,0) [0|20] "m"  MPC
 SG_ MRR_ObjMotionDirection_28 : 432|3@0+ (1,0) [0|7] ""  MPC
 SG_ BlockCounter14 : 469|4@0+ (1,0) [0|15] ""  MPC
 SG_ MRR_ObjHeight_28 : 463|10@0+ (0.01,0) [0|6] "m"  MPC
 SG_ MRR_ObjRCS_28 : 465|10@0+ (0.125,-50) [-50|70] "dBsm"  MPC
 SG_ MRR_ObjAge_28 : 487|8@0+ (1,0) [0|255] ""  MPC
 SG_ MRR_ObjMeasured_27 : 497|2@0+ (1,0) [0|3] ""  MPC
 SG_ MRR_ObjMeasured_28 : 499|2@0+ (1,0) [0|3] ""  MPC
 SG_ MRR_ObjHeading_28 : 495|12@0+ (0.002,-3.14) [-3.14|3.14] "rad"  MPC
 SG_ MRR_ObjValid_27 : 508|1@0+ (1,0) [0|1] ""  MPC
 SG_ MRR_ObjValid_28 : 509|1@0+ (1,0) [0|1] ""  MPC

BO_ 1086 MRRAD15: 64 FR
 SG_ Checksum43E : 7|16@0+ (1,0) [0|65535] ""  MPC
 SG_ RollingCounter43E : 23|8@0+ (1,0) [0|255] ""  MPC
 SG_ MRR_ObjHYAS_Reserved_29 : 31|6@0+ (0.017,0) [0|1.071] ""  MPC
 SG_ MRR_ObjTypeProb_29 : 39|6@0+ (2,0) [0|100] "%"  MPC
 SG_ MRR_ObjID_29 : 41|8@0+ (1,0) [0|255] ""  MPC
 SG_ MRR_ObjObstacleProb_29 : 60|5@0+ (0.04,0) [0|1] ""  MPC
 SG_ MRR_ObjExistProb_29 : 49|5@0+ (0.04,0) [0|1] ""  MPC
 SG_ MRR_ObjDistX_29 : 71|12@0+ (0.075,0) [0|305.925] "m"  MPC
 SG_ MRR_ObjDistY_29 : 75|11@0+ (0.125,-128) [-128|127.875] "m"  MPC
 SG_ MRR_ObjRelAccelX_29 : 80|10@0+ (0.03125,-16) [-16|15.96875] "mps2"  MPC
 SG_ MRR_ObjRelVelX_29 : 102|13@0+ (0.0312,-128) [-128|126.9976] "mps"  MPC
 SG_ MRR_ObjRelVelY_29 : 105|13@0+ (0.0312,-128) [-128|126.9976] "mps"  MPC
 SG_ MRR_ObjRelAccelY_29 : 124|10@0+ (0.03125,-16) [-16|15.96875] "mps2"  MPC
 SG_ MRR_ObjDistXStd_29 : 130|6@0+ (0.1,0) [0|6] "m"  MPC
 SG_ MRR_ObjType_29 : 150|4@0+ (1,0) [0|15] ""  MPC
 SG_ MRR_ObjDistYStd_29 : 140|6@0+ (0.1,0) [0|6] "m"  MPC
 SG_ MRR_ObjRelVelXStd_29 : 146|6@0+ (0.0625,0) [0|3.9375] "mps"  MPC
 SG_ MRR_ObjRAccelXStd_29 : 166|6@0+ (0.0625,0) [0|3.9375] "mps2"  MPC
 SG_ MRR_ObjRelVelYStd_29 : 156|6@0+ (0.0625,0) [0|3.9375] "mps"  MPC
 SG_ MRR_ObjMotionType_29 : 170|3@0+ (1,0) [0|7] ""  MPC
 SG_ MRR_ObjRAccelYStd_29 : 160|6@0+ (0.0625,0) [0|3.9375] "mps2"  MPC
 SG_ MRR_ObjWidth_29 : 183|10@0+ (0.01,0) [0|5] "m"  MPC
 SG_ MRR_ObjMotionDirection_29 : 195|3@0+ (1,0) [0|7] ""  MPC
 SG_ MRR_ObjLength_29 : 189|10@0+ (0.05,0) [0|20] "m"  MPC
 SG_ MRR_ObjHeight_29 : 207|10@0+ (0.01,0) [0|6] "m"  MPC
 SG_ MRR_ObjHeading_29 : 213|12@0+ (0.002,-3.14) [-3.14|3.14] "rad"  MPC
 SG_ MRR_ObjRCS_29 : 217|10@0+ (0.125,-50) [-50|70] "dBsm"  MPC
 SG_ MRR_ObjAge_29 : 239|8@0+ (1,0) [0|255] ""  MPC
 SG_ MRR_ObjRefPoint_29 : 243|3@0+ (1,0) [0|7] "NoUnit"  MPC
 SG_ MRR_ObjRefPoint_30 : 247|3@0+ (1,0) [0|7] "NoUnit"  MPC
 SG_ MRR_ObjHYAS_Reserved_30 : 255|6@0+ (0.017,0) [0|1.071] ""  MPC
 SG_ MRR_ObjTypeProb_30 : 263|6@0+ (2,0) [0|100] "%"  MPC
 SG_ MRR_ObjID_30 : 271|8@0+ (1,0) [0|255] ""  MPC
 SG_ MRR_ObjExistProb_30 : 279|5@0+ (0.04,0) [0|1] ""  MPC
 SG_ MRR_ObjObstacleProb_30 : 274|5@0+ (0.04,0) [0|1] ""  MPC
 SG_ MRR_ObjDistX_30 : 285|12@0+ (0.075,0) [0|305.925] "m"  MPC
 SG_ MRR_ObjDistY_30 : 289|11@0+ (0.125,-128) [-128|127.875] "m"  MPC
 SG_ MRR_ObjRelAccelX_30 : 310|10@0+ (0.03125,-16) [-16|15.96875] "mps2"  MPC
 SG_ MRR_ObjRelVelX_30 : 335|13@0+ (0.0312,-128) [-128|126.9976] "mps"  MPC
 SG_ MRR_ObjRelVelY_30 : 338|13@0+ (0.0312,-128) [-128|126.9976] "mps"  MPC
 SG_ MRR_ObjRelAccelY_30 : 357|10@0+ (0.03125,-16) [-16|15.96875] "mps2"  MPC
 SG_ MRR_ObjDistYStd_30 : 373|6@0+ (0.1,0) [0|6] "m"  MPC
 SG_ MRR_ObjDistXStd_30 : 363|6@0+ (0.1,0) [0|6] "m"  MPC
 SG_ MRR_ObjType_30 : 383|4@0+ (1,0) [0|15] ""  MPC
 SG_ MRR_ObjRelVelXStd_30 : 399|6@0+ (0.0625,0) [0|3.9375] "mps"  MPC
 SG_ MRR_ObjRelVelYStd_30 : 393|6@0+ (0.0625,0) [0|3.9375] "mps"  MPC
 SG_ MRR_ObjRAccelYStd_30 : 413|6@0+ (0.0625,0) [0|3.9375] "mps2"  MPC
 SG_ MRR_ObjRAccelXStd_30 : 403|6@0+ (0.0625,0) [0|3.9375] "mps2"  MPC
 SG_ MRR_ObjMotionType_30 : 423|3@0+ (1,0) [0|7] ""  MPC
 SG_ MRR_ObjWidth_30 : 420|10@0+ (0.01,0) [0|5] "m"  MPC
 SG_ MRR_ObjLength_30 : 426|10@0+ (0.05,0) [0|20] "m"  MPC
 SG_ MRR_ObjMotionDirection_30 : 432|3@0+ (1,0) [0|7] ""  MPC
 SG_ BlockCounter15 : 469|4@0+ (1,0) [0|15] ""  MPC
 SG_ MRR_ObjHeight_30 : 463|10@0+ (0.01,0) [0|6] "m"  MPC
 SG_ MRR_ObjRCS_30 : 465|10@0+ (0.125,-50) [-50|70] "dBsm"  MPC
 SG_ MRR_ObjAge_30 : 487|8@0+ (1,0) [0|255] ""  MPC
 SG_ MRR_ObjMeasured_29 : 497|2@0+ (1,0) [0|3] ""  MPC
 SG_ MRR_ObjMeasured_30 : 499|2@0+ (1,0) [0|3] ""  MPC
 SG_ MRR_ObjHeading_30 : 495|12@0+ (0.002,-3.14) [-3.14|3.14] "rad"  MPC
 SG_ MRR_ObjValid_29 : 508|1@0+ (1,0) [0|1] ""  MPC
 SG_ MRR_ObjValid_30 : 509|1@0+ (1,0) [0|1] ""  MPC

BO_ 1087 MRRAD16: 64 FR
 SG_ Checksum43F : 7|16@0+ (1,0) [0|65535] ""  MPC
 SG_ RollingCounter43F : 23|8@0+ (1,0) [0|255] ""  MPC
 SG_ MRR_ObjHYAS_Reserved_31 : 31|6@0+ (0.017,0) [0|1.071] ""  MPC
 SG_ MRR_ObjTypeProb_31 : 39|6@0+ (2,0) [0|100] "%"  MPC
 SG_ MRR_ObjID_31 : 41|8@0+ (1,0) [0|255] ""  MPC
 SG_ MRR_ObjObstacleProb_31 : 60|5@0+ (0.04,0) [0|1] ""  MPC
 SG_ MRR_ObjExistProb_31 : 49|5@0+ (0.04,0) [0|1] ""  MPC
 SG_ MRR_ObjDistX_31 : 71|12@0+ (0.075,0) [0|305.925] "m"  MPC
 SG_ MRR_ObjDistY_31 : 75|11@0+ (0.125,-128) [-128|127.875] "m"  MPC
 SG_ MRR_ObjRelAccelX_31 : 80|10@0+ (0.03125,-16) [-16|15.96875] "mps2"  MPC
 SG_ MRR_ObjRelVelX_31 : 102|13@0+ (0.0312,-128) [-128|126.9976] "mps"  MPC
 SG_ MRR_ObjRelVelY_31 : 105|13@0+ (0.0312,-128) [-128|126.9976] "mps"  MPC
 SG_ MRR_ObjRelAccelY_31 : 124|10@0+ (0.03125,-16) [-16|15.96875] "mps2"  MPC
 SG_ MRR_ObjDistXStd_31 : 130|6@0+ (0.1,0) [0|6] "m"  MPC
 SG_ MRR_ObjType_31 : 150|4@0+ (1,0) [0|15] ""  MPC
 SG_ MRR_ObjDistYStd_31 : 140|6@0+ (0.1,0) [0|6] "m"  MPC
 SG_ MRR_ObjRelVelXStd_31 : 146|6@0+ (0.0625,0) [0|3.9375] "mps"  MPC
 SG_ MRR_ObjRAccelXStd_31 : 166|6@0+ (0.0625,0) [0|3.9375] "mps2"  MPC
 SG_ MRR_ObjRelVelYStd_31 : 156|6@0+ (0.0625,0) [0|3.9375] "mps"  MPC
 SG_ MRR_ObjMotionType_31 : 170|3@0+ (1,0) [0|7] ""  MPC
 SG_ MRR_ObjRAccelYStd_31 : 160|6@0+ (0.0625,0) [0|3.9375] "mps2"  MPC
 SG_ MRR_ObjWidth_31 : 183|10@0+ (0.01,0) [0|5] "m"  MPC
 SG_ MRR_ObjMotionDirection_31 : 195|3@0+ (1,0) [0|7] ""  MPC
 SG_ MRR_ObjLength_31 : 189|10@0+ (0.05,0) [0|20] "m"  MPC
 SG_ MRR_ObjHeight_31 : 207|10@0+ (0.01,0) [0|6] "m"  MPC
 SG_ MRR_ObjHeading_31 : 213|12@0+ (0.002,-3.14) [-3.14|3.14] "rad"  MPC
 SG_ MRR_ObjRCS_31 : 217|10@0+ (0.125,-50) [-50|70] "dBsm"  MPC
 SG_ MRR_ObjAge_31 : 239|8@0+ (1,0) [0|255] ""  MPC
 SG_ MRR_ObjRefPoint_31 : 243|3@0+ (1,0) [0|7] "NoUnit"  MPC
 SG_ MRR_ObjRefPoint_32 : 247|3@0+ (1,0) [0|7] "NoUnit"  MPC
 SG_ MRR_ObjHYAS_Reserved_32 : 255|6@0+ (0.017,0) [0|1.071] ""  MPC
 SG_ MRR_ObjTypeProb_32 : 263|6@0+ (2,0) [0|100] "%"  MPC
 SG_ MRR_ObjID_32 : 271|8@0+ (1,0) [0|255] ""  MPC
 SG_ MRR_ObjExistProb_32 : 279|5@0+ (0.04,0) [0|1] ""  MPC
 SG_ MRR_ObjObstacleProb_32 : 274|5@0+ (0.04,0) [0|1] ""  MPC
 SG_ MRR_ObjDistX_32 : 285|12@0+ (0.075,0) [0|305.925] "m"  MPC
 SG_ MRR_ObjDistY_32 : 289|11@0+ (0.125,-128) [-128|127.875] "m"  MPC
 SG_ MRR_ObjRelAccelX_32 : 310|10@0+ (0.03125,-16) [-16|15.96875] "mps2"  MPC
 SG_ MRR_ObjRelVelX_32 : 335|13@0+ (0.0312,-128) [-128|126.9976] "mps"  MPC
 SG_ MRR_ObjRelVelY_32 : 338|13@0+ (0.0312,-128) [-128|126.9976] "mps"  MPC
 SG_ MRR_ObjRelAccelY_32 : 357|10@0+ (0.03125,-16) [-16|15.96875] "mps2"  MPC
 SG_ MRR_ObjDistYStd_32 : 373|6@0+ (0.1,0) [0|6] "m"  MPC
 SG_ MRR_ObjDistXStd_32 : 363|6@0+ (0.1,0) [0|6] "m"  MPC
 SG_ MRR_ObjType_32 : 383|4@0+ (1,0) [0|15] ""  MPC
 SG_ MRR_ObjRelVelXStd_32 : 399|6@0+ (0.0625,0) [0|3.9375] "mps"  MPC
 SG_ MRR_ObjRelVelYStd_32 : 393|6@0+ (0.0625,0) [0|3.9375] "mps"  MPC
 SG_ MRR_ObjRAccelYStd_32 : 413|6@0+ (0.0625,0) [0|3.9375] "mps2"  MPC
 SG_ MRR_ObjRAccelXStd_32 : 403|6@0+ (0.0625,0) [0|3.9375] "mps2"  MPC
 SG_ MRR_ObjMotionType_32 : 423|3@0+ (1,0) [0|7] ""  MPC
 SG_ MRR_ObjWidth_32 : 420|10@0+ (0.01,0) [0|5] "m"  MPC
 SG_ MRR_ObjLength_32 : 426|10@0+ (0.05,0) [0|20] "m"  MPC
 SG_ MRR_ObjMotionDirection_32 : 432|3@0+ (1,0) [0|7] ""  MPC
 SG_ BlockCounter16 : 469|4@0+ (1,0) [0|15] ""  MPC
 SG_ MRR_ObjHeight_32 : 463|10@0+ (0.01,0) [0|6] "m"  MPC
 SG_ MRR_ObjRCS_32 : 465|10@0+ (0.125,-50) [-50|70] "dBsm"  MPC
 SG_ MRR_ObjAge_32 : 487|8@0+ (1,0) [0|255] ""  MPC
 SG_ MRR_ObjMeasured_31 : 497|2@0+ (1,0) [0|3] ""  MPC
 SG_ MRR_ObjMeasured_32 : 499|2@0+ (1,0) [0|3] ""  MPC
 SG_ MRR_ObjHeading_32 : 495|12@0+ (0.002,-3.14) [-3.14|3.14] "rad"  MPC
 SG_ MRR_ObjValid_31 : 508|1@0+ (1,0) [0|1] ""  MPC
 SG_ MRR_ObjValid_32 : 509|1@0+ (1,0) [0|1] ""  MPC

BO_ 1088 MRRAD17: 64 FR
 SG_ Checksum440 : 7|16@0+ (1,0) [0|65535] ""  MPC
 SG_ RollingCounter440 : 23|8@0+ (1,0) [0|255] ""  MPC
 SG_ MRR_ObjHYAS_Reserved_33 : 31|6@0+ (0.017,0) [0|1.071] ""  MPC
 SG_ MRR_ObjTypeProb_33 : 39|6@0+ (2,0) [0|100] "%"  MPC
 SG_ MRR_ObjID_33 : 41|8@0+ (1,0) [0|255] ""  MPC
 SG_ MRR_ObjObstacleProb_33 : 60|5@0+ (0.04,0) [0|1] ""  MPC
 SG_ MRR_ObjExistProb_33 : 49|5@0+ (0.04,0) [0|1] ""  MPC
 SG_ MRR_ObjDistX_33 : 71|12@0+ (0.075,0) [0|305.925] "m"  MPC
 SG_ MRR_ObjDistY_33 : 75|11@0+ (0.125,-128) [-128|127.875] "m"  MPC
 SG_ MRR_ObjRelAccelX_33 : 80|10@0+ (0.03125,-16) [-16|15.96875] "mps2"  MPC
 SG_ MRR_ObjRelVelX_33 : 102|13@0+ (0.0312,-128) [-128|126.9976] "mps"  MPC
 SG_ MRR_ObjRelVelY_33 : 105|13@0+ (0.0312,-128) [-128|126.9976] "mps"  MPC
 SG_ MRR_ObjRelAccelY_33 : 124|10@0+ (0.03125,-16) [-16|15.96875] "mps2"  MPC
 SG_ MRR_ObjDistXStd_33 : 130|6@0+ (0.1,0) [0|6] "m"  MPC
 SG_ MRR_ObjType_33 : 150|4@0+ (1,0) [0|15] ""  MPC
 SG_ MRR_ObjDistYStd_33 : 140|6@0+ (0.1,0) [0|6] "m"  MPC
 SG_ MRR_ObjRelVelXStd_33 : 146|6@0+ (0.0625,0) [0|3.9375] "mps"  MPC
 SG_ MRR_ObjRAccelXStd_33 : 166|6@0+ (0.0625,0) [0|3.9375] "mps2"  MPC
 SG_ MRR_ObjRelVelYStd_33 : 156|6@0+ (0.0625,0) [0|3.9375] "mps"  MPC
 SG_ MRR_ObjMotionType_33 : 170|3@0+ (1,0) [0|7] ""  MPC
 SG_ MRR_ObjRAccelYStd_33 : 160|6@0+ (0.0625,0) [0|3.9375] "mps2"  MPC
 SG_ MRR_ObjWidth_33 : 183|10@0+ (0.01,0) [0|5] "m"  MPC
 SG_ MRR_ObjMotionDirection_33 : 195|3@0+ (1,0) [0|7] ""  MPC
 SG_ MRR_ObjLength_33 : 189|10@0+ (0.05,0) [0|20] "m"  MPC
 SG_ MRR_ObjHeight_33 : 207|10@0+ (0.01,0) [0|6] "m"  MPC
 SG_ MRR_ObjHeading_33 : 213|12@0+ (0.002,-3.14) [-3.14|3.14] "rad"  MPC
 SG_ MRR_ObjRCS_33 : 217|10@0+ (0.125,-50) [-50|70] "dBsm"  MPC
 SG_ MRR_ObjAge_33 : 239|8@0+ (1,0) [0|255] ""  MPC
 SG_ MRR_ObjRefPoint_33 : 243|3@0+ (1,0) [0|7] "NoUnit"  MPC
 SG_ MRR_ObjRefPoint_34 : 247|3@0+ (1,0) [0|7] "NoUnit"  MPC
 SG_ MRR_ObjHYAS_Reserved_34 : 255|6@0+ (0.017,0) [0|1.071] ""  MPC
 SG_ MRR_ObjTypeProb_34 : 263|6@0+ (2,0) [0|100] "%"  MPC
 SG_ MRR_ObjID_34 : 271|8@0+ (1,0) [0|255] ""  MPC
 SG_ MRR_ObjExistProb_34 : 279|5@0+ (0.04,0) [0|1] ""  MPC
 SG_ MRR_ObjObstacleProb_34 : 274|5@0+ (0.04,0) [0|1] ""  MPC
 SG_ MRR_ObjDistX_34 : 285|12@0+ (0.075,0) [0|305.925] "m"  MPC
 SG_ MRR_ObjDistY_34 : 289|11@0+ (0.125,-128) [-128|127.875] "m"  MPC
 SG_ MRR_ObjRelAccelX_34 : 310|10@0+ (0.03125,-16) [-16|15.96875] "mps2"  MPC
 SG_ MRR_ObjRelVelX_34 : 335|13@0+ (0.0312,-128) [-128|126.9976] "mps"  MPC
 SG_ MRR_ObjRelVelY_34 : 338|13@0+ (0.0312,-128) [-128|126.9976] "mps"  MPC
 SG_ MRR_ObjRelAccelY_34 : 357|10@0+ (0.03125,-16) [-16|15.96875] "mps2"  MPC
 SG_ MRR_ObjDistYStd_34 : 373|6@0+ (0.1,0) [0|6] "m"  MPC
 SG_ MRR_ObjDistXStd_34 : 363|6@0+ (0.1,0) [0|6] "m"  MPC
 SG_ MRR_ObjType_34 : 383|4@0+ (1,0) [0|15] ""  MPC
 SG_ MRR_ObjRelVelXStd_34 : 399|6@0+ (0.0625,0) [0|3.9375] "mps"  MPC
 SG_ MRR_ObjRelVelYStd_34 : 393|6@0+ (0.0625,0) [0|3.9375] "mps"  MPC
 SG_ MRR_ObjRAccelYStd_34 : 413|6@0+ (0.0625,0) [0|3.9375] "mps2"  MPC
 SG_ MRR_ObjRAccelXStd_34 : 403|6@0+ (0.0625,0) [0|3.9375] "mps2"  MPC
 SG_ MRR_ObjMotionType_34 : 423|3@0+ (1,0) [0|7] ""  MPC
 SG_ MRR_ObjWidth_34 : 420|10@0+ (0.01,0) [0|5] "m"  MPC
 SG_ MRR_ObjLength_34 : 426|10@0+ (0.05,0) [0|20] "m"  MPC
 SG_ MRR_ObjMotionDirection_34 : 432|3@0+ (1,0) [0|7] ""  MPC
 SG_ BlockCounter17 : 469|4@0+ (1,0) [0|15] ""  MPC
 SG_ MRR_ObjHeight_34 : 463|10@0+ (0.01,0) [0|6] "m"  MPC
 SG_ MRR_ObjRCS_34 : 465|10@0+ (0.125,-50) [-50|70] "dBsm"  MPC
 SG_ MRR_ObjAge_34 : 487|8@0+ (1,0) [0|255] ""  MPC
 SG_ MRR_ObjMeasured_33 : 497|2@0+ (1,0) [0|3] ""  MPC
 SG_ MRR_ObjMeasured_34 : 499|2@0+ (1,0) [0|3] ""  MPC
 SG_ MRR_ObjHeading_34 : 495|12@0+ (0.002,-3.14) [-3.14|3.14] "rad"  MPC
 SG_ MRR_ObjValid_33 : 508|1@0+ (1,0) [0|1] ""  MPC
 SG_ MRR_ObjValid_34 : 509|1@0+ (1,0) [0|1] ""  MPC

BO_ 1089 MRRAD18: 64 FR
 SG_ Checksum441 : 7|16@0+ (1,0) [0|65535] ""  MPC
 SG_ RollingCounter441 : 23|8@0+ (1,0) [0|255] ""  MPC
 SG_ MRR_ObjHYAS_Reserved_35 : 31|6@0+ (0.017,0) [0|1.071] ""  MPC
 SG_ MRR_ObjTypeProb_35 : 39|6@0+ (2,0) [0|100] "%"  MPC
 SG_ MRR_ObjID_35 : 41|8@0+ (1,0) [0|255] ""  MPC
 SG_ MRR_ObjObstacleProb_35 : 60|5@0+ (0.04,0) [0|1] ""  MPC
 SG_ MRR_ObjExistProb_35 : 49|5@0+ (0.04,0) [0|1] ""  MPC
 SG_ MRR_ObjDistX_35 : 71|12@0+ (0.075,0) [0|305.925] "m"  MPC
 SG_ MRR_ObjDistY_35 : 75|11@0+ (0.125,-128) [-128|127.875] "m"  MPC
 SG_ MRR_ObjRelAccelX_35 : 80|10@0+ (0.03125,-16) [-16|15.96875] "mps2"  MPC
 SG_ MRR_ObjRelVelX_35 : 102|13@0+ (0.0312,-128) [-128|126.9976] "mps"  MPC
 SG_ MRR_ObjRelVelY_35 : 105|13@0+ (0.0312,-128) [-128|126.9976] "mps"  MPC
 SG_ MRR_ObjRelAccelY_35 : 124|10@0+ (0.03125,-16) [-16|15.96875] "mps2"  MPC
 SG_ MRR_ObjDistXStd_35 : 130|6@0+ (0.1,0) [0|6] "m"  MPC
 SG_ MRR_ObjType_35 : 150|4@0+ (1,0) [0|15] ""  MPC
 SG_ MRR_ObjDistYStd_35 : 140|6@0+ (0.1,0) [0|6] "m"  MPC
 SG_ MRR_ObjRelVelXStd_35 : 146|6@0+ (0.0625,0) [0|3.9375] "mps"  MPC
 SG_ MRR_ObjRAccelXStd_35 : 166|6@0+ (0.0625,0) [0|3.9375] "mps2"  MPC
 SG_ MRR_ObjRelVelYStd_35 : 156|6@0+ (0.0625,0) [0|3.9375] "mps"  MPC
 SG_ MRR_ObjMotionType_35 : 170|3@0+ (1,0) [0|7] ""  MPC
 SG_ MRR_ObjRAccelYStd_35 : 160|6@0+ (0.0625,0) [0|3.9375] "mps2"  MPC
 SG_ MRR_ObjWidth_35 : 183|10@0+ (0.01,0) [0|5] "m"  MPC
 SG_ MRR_ObjMotionDirection_35 : 195|3@0+ (1,0) [0|7] ""  MPC
 SG_ MRR_ObjLength_35 : 189|10@0+ (0.05,0) [0|20] "m"  MPC
 SG_ MRR_ObjHeight_35 : 207|10@0+ (0.01,0) [0|6] "m"  MPC
 SG_ MRR_ObjHeading_35 : 213|12@0+ (0.002,-3.14) [-3.14|3.14] "rad"  MPC
 SG_ MRR_ObjRCS_35 : 217|10@0+ (0.125,-50) [-50|70] "dBsm"  MPC
 SG_ MRR_ObjAge_35 : 239|8@0+ (1,0) [0|255] ""  MPC
 SG_ MRR_ObjRefPoint_35 : 243|3@0+ (1,0) [0|7] "NoUnit"  MPC
 SG_ MRR_ObjRefPoint_36 : 247|3@0+ (1,0) [0|7] "NoUnit"  MPC
 SG_ MRR_ObjHYAS_Reserved_36 : 255|6@0+ (0.017,0) [0|1.071] ""  MPC
 SG_ MRR_ObjTypeProb_36 : 263|6@0+ (2,0) [0|100] "%"  MPC
 SG_ MRR_ObjID_36 : 271|8@0+ (1,0) [0|255] ""  MPC
 SG_ MRR_ObjExistProb_36 : 279|5@0+ (0.04,0) [0|1] ""  MPC
 SG_ MRR_ObjObstacleProb_36 : 274|5@0+ (0.04,0) [0|1] ""  MPC
 SG_ MRR_ObjDistX_36 : 285|12@0+ (0.075,0) [0|305.925] "m"  MPC
 SG_ MRR_ObjDistY_36 : 289|11@0+ (0.125,-128) [-128|127.875] "m"  MPC
 SG_ MRR_ObjRelAccelX_36 : 310|10@0+ (0.03125,-16) [-16|15.96875] "mps2"  MPC
 SG_ MRR_ObjRelVelX_36 : 335|13@0+ (0.0312,-128) [-128|126.9976] "mps"  MPC
 SG_ MRR_ObjRelVelY_36 : 338|13@0+ (0.0312,-128) [-128|126.9976] "mps"  MPC
 SG_ MRR_ObjRelAccelY_36 : 357|10@0+ (0.03125,-16) [-16|15.96875] "mps2"  MPC
 SG_ MRR_ObjDistYStd_36 : 373|6@0+ (0.1,0) [0|6] "m"  MPC
 SG_ MRR_ObjDistXStd_36 : 363|6@0+ (0.1,0) [0|6] "m"  MPC
 SG_ MRR_ObjType_36 : 383|4@0+ (1,0) [0|15] ""  MPC
 SG_ MRR_ObjRelVelXStd_36 : 399|6@0+ (0.0625,0) [0|3.9375] "mps"  MPC
 SG_ MRR_ObjRelVelYStd_36 : 393|6@0+ (0.0625,0) [0|3.9375] "mps"  MPC
 SG_ MRR_ObjRAccelYStd_36 : 413|6@0+ (0.0625,0) [0|3.9375] "mps2"  MPC
 SG_ MRR_ObjRAccelXStd_36 : 403|6@0+ (0.0625,0) [0|3.9375] "mps2"  MPC
 SG_ MRR_ObjMotionType_36 : 423|3@0+ (1,0) [0|7] ""  MPC
 SG_ MRR_ObjWidth_36 : 420|10@0+ (0.01,0) [0|5] "m"  MPC
 SG_ MRR_ObjLength_36 : 426|10@0+ (0.05,0) [0|20] "m"  MPC
 SG_ MRR_ObjMotionDirection_36 : 432|3@0+ (1,0) [0|7] ""  MPC
 SG_ BlockCounter18 : 469|4@0+ (1,0) [0|15] ""  MPC
 SG_ MRR_ObjHeight_36 : 463|10@0+ (0.01,0) [0|6] "m"  MPC
 SG_ MRR_ObjRCS_36 : 465|10@0+ (0.125,-50) [-50|70] "dBsm"  MPC
 SG_ MRR_ObjAge_36 : 487|8@0+ (1,0) [0|255] ""  MPC
 SG_ MRR_ObjMeasured_35 : 497|2@0+ (1,0) [0|3] ""  MPC
 SG_ MRR_ObjMeasured_36 : 499|2@0+ (1,0) [0|3] ""  MPC
 SG_ MRR_ObjHeading_36 : 495|12@0+ (0.002,-3.14) [-3.14|3.14] "rad"  MPC
 SG_ MRR_ObjValid_35 : 508|1@0+ (1,0) [0|1] ""  MPC
 SG_ MRR_ObjValid_36 : 509|1@0+ (1,0) [0|1] ""  MPC

BO_ 1090 MRRAD19: 64 FR
 SG_ Checksum442 : 7|16@0+ (1,0) [0|65535] ""  MPC
 SG_ RollingCounter442 : 23|8@0+ (1,0) [0|255] ""  MPC
 SG_ MRR_ObjHYAS_Reserved_37 : 31|6@0+ (0.017,0) [0|1.071] ""  MPC
 SG_ MRR_ObjTypeProb_37 : 39|6@0+ (2,0) [0|100] "%"  MPC
 SG_ MRR_ObjID_37 : 41|8@0+ (1,0) [0|255] ""  MPC
 SG_ MRR_ObjObstacleProb_37 : 60|5@0+ (0.04,0) [0|1] ""  MPC
 SG_ MRR_ObjExistProb_37 : 49|5@0+ (0.04,0) [0|1] ""  MPC
 SG_ MRR_ObjDistX_37 : 71|12@0+ (0.075,0) [0|305.925] "m"  MPC
 SG_ MRR_ObjDistY_37 : 75|11@0+ (0.125,-128) [-128|127.875] "m"  MPC
 SG_ MRR_ObjRelAccelX_37 : 80|10@0+ (0.03125,-16) [-16|15.96875] "mps2"  MPC
 SG_ MRR_ObjRelVelX_37 : 102|13@0+ (0.0312,-128) [-128|126.9976] "mps"  MPC
 SG_ MRR_ObjRelVelY_37 : 105|13@0+ (0.0312,-128) [-128|126.9976] "mps"  MPC
 SG_ MRR_ObjRelAccelY_37 : 124|10@0+ (0.03125,-16) [-16|15.96875] "mps2"  MPC
 SG_ MRR_ObjDistXStd_37 : 130|6@0+ (0.1,0) [0|6] "m"  MPC
 SG_ MRR_ObjType_37 : 150|4@0+ (1,0) [0|15] ""  MPC
 SG_ MRR_ObjDistYStd_37 : 140|6@0+ (0.1,0) [0|6] "m"  MPC
 SG_ MRR_ObjRelVelXStd_37 : 146|6@0+ (0.0625,0) [0|3.9375] "mps"  MPC
 SG_ MRR_ObjRAccelXStd_37 : 166|6@0+ (0.0625,0) [0|3.9375] "mps2"  MPC
 SG_ MRR_ObjRelVelYStd_37 : 156|6@0+ (0.0625,0) [0|3.9375] "mps"  MPC
 SG_ MRR_ObjMotionType_37 : 170|3@0+ (1,0) [0|7] ""  MPC
 SG_ MRR_ObjRAccelYStd_37 : 160|6@0+ (0.0625,0) [0|3.9375] "mps2"  MPC
 SG_ MRR_ObjWidth_37 : 183|10@0+ (0.01,0) [0|5] "m"  MPC
 SG_ MRR_ObjMotionDirection_37 : 195|3@0+ (1,0) [0|7] ""  MPC
 SG_ MRR_ObjLength_37 : 189|10@0+ (0.05,0) [0|20] "m"  MPC
 SG_ MRR_ObjHeight_37 : 207|10@0+ (0.01,0) [0|6] "m"  MPC
 SG_ MRR_ObjHeading_37 : 213|12@0+ (0.002,-3.14) [-3.14|3.14] "rad"  MPC
 SG_ MRR_ObjRCS_37 : 217|10@0+ (0.125,-50) [-50|70] "dBsm"  MPC
 SG_ MRR_ObjAge_37 : 239|8@0+ (1,0) [0|255] ""  MPC
 SG_ MRR_ObjRefPoint_37 : 243|3@0+ (1,0) [0|7] "NoUnit"  MPC
 SG_ MRR_ObjRefPoint_38 : 247|3@0+ (1,0) [0|7] "NoUnit"  MPC
 SG_ MRR_ObjHYAS_Reserved_38 : 255|6@0+ (0.017,0) [0|1.071] ""  MPC
 SG_ MRR_ObjTypeProb_38 : 263|6@0+ (2,0) [0|100] "%"  MPC
 SG_ MRR_ObjID_38 : 271|8@0+ (1,0) [0|255] ""  MPC
 SG_ MRR_ObjExistProb_38 : 279|5@0+ (0.04,0) [0|1] ""  MPC
 SG_ MRR_ObjObstacleProb_38 : 274|5@0+ (0.04,0) [0|1] ""  MPC
 SG_ MRR_ObjDistX_38 : 285|12@0+ (0.075,0) [0|305.925] "m"  MPC
 SG_ MRR_ObjDistY_38 : 289|11@0+ (0.125,-128) [-128|127.875] "m"  MPC
 SG_ MRR_ObjRelAccelX_38 : 310|10@0+ (0.03125,-16) [-16|15.96875] "mps2"  MPC
 SG_ MRR_ObjRelVelX_38 : 335|13@0+ (0.0312,-128) [-128|126.9976] "mps"  MPC
 SG_ MRR_ObjRelVelY_38 : 338|13@0+ (0.0312,-128) [-128|126.9976] "mps"  MPC
 SG_ MRR_ObjRelAccelY_38 : 357|10@0+ (0.03125,-16) [-16|15.96875] "mps2"  MPC
 SG_ MRR_ObjDistYStd_38 : 373|6@0+ (0.1,0) [0|6] "m"  MPC
 SG_ MRR_ObjDistXStd_38 : 363|6@0+ (0.1,0) [0|6] "m"  MPC
 SG_ MRR_ObjType_38 : 383|4@0+ (1,0) [0|15] ""  MPC
 SG_ MRR_ObjRelVelXStd_38 : 399|6@0+ (0.0625,0) [0|3.9375] "mps"  MPC
 SG_ MRR_ObjRelVelYStd_38 : 393|6@0+ (0.0625,0) [0|3.9375] "mps"  MPC
 SG_ MRR_ObjRAccelYStd_38 : 413|6@0+ (0.0625,0) [0|3.9375] "mps2"  MPC
 SG_ MRR_ObjRAccelXStd_38 : 403|6@0+ (0.0625,0) [0|3.9375] "mps2"  MPC
 SG_ MRR_ObjMotionType_38 : 423|3@0+ (1,0) [0|7] ""  MPC
 SG_ MRR_ObjWidth_38 : 420|10@0+ (0.01,0) [0|5] "m"  MPC
 SG_ MRR_ObjLength_38 : 426|10@0+ (0.05,0) [0|20] "m"  MPC
 SG_ MRR_ObjMotionDirection_38 : 432|3@0+ (1,0) [0|7] ""  MPC
 SG_ BlockCounter19 : 469|4@0+ (1,0) [0|15] ""  MPC
 SG_ MRR_ObjHeight_38 : 463|10@0+ (0.01,0) [0|6] "m"  MPC
 SG_ MRR_ObjRCS_38 : 465|10@0+ (0.125,-50) [-50|70] "dBsm"  MPC
 SG_ MRR_ObjAge_38 : 487|8@0+ (1,0) [0|255] ""  MPC
 SG_ MRR_ObjMeasured_37 : 497|2@0+ (1,0) [0|3] ""  MPC
 SG_ MRR_ObjMeasured_38 : 499|2@0+ (1,0) [0|3] ""  MPC
 SG_ MRR_ObjHeading_38 : 495|12@0+ (0.002,-3.14) [-3.14|3.14] "rad"  MPC
 SG_ MRR_ObjValid_37 : 508|1@0+ (1,0) [0|1] ""  MPC
 SG_ MRR_ObjValid_38 : 509|1@0+ (1,0) [0|1] ""  MPC

BO_ 1091 MRRAD20: 64 FR
 SG_ Checksum443 : 7|16@0+ (1,0) [0|65535] ""  MPC
 SG_ RollingCounter443 : 23|8@0+ (1,0) [0|255] ""  MPC
 SG_ MRR_ObjHYAS_Reserved_39 : 31|6@0+ (0.017,0) [0|1.071] ""  MPC
 SG_ MRR_ObjTypeProb_39 : 39|6@0+ (2,0) [0|100] "%"  MPC
 SG_ MRR_ObjID_39 : 41|8@0+ (1,0) [0|255] ""  MPC
 SG_ MRR_ObjObstacleProb_39 : 60|5@0+ (0.04,0) [0|1] ""  MPC
 SG_ MRR_ObjExistProb_39 : 49|5@0+ (0.04,0) [0|1] ""  MPC
 SG_ MRR_ObjDistX_39 : 71|12@0+ (0.075,0) [0|305.925] "m"  MPC
 SG_ MRR_ObjDistY_39 : 75|11@0+ (0.125,-128) [-128|127.875] "m"  MPC
 SG_ MRR_ObjRelAccelX_39 : 80|10@0+ (0.03125,-16) [-16|15.96875] "mps2"  MPC
 SG_ MRR_ObjRelVelX_39 : 102|13@0+ (0.0312,-128) [-128|126.9976] "mps"  MPC
 SG_ MRR_ObjRelVelY_39 : 105|13@0+ (0.0312,-128) [-128|126.9976] "mps"  MPC
 SG_ MRR_ObjRelAccelY_39 : 124|10@0+ (0.03125,-16) [-16|15.96875] "mps2"  MPC
 SG_ MRR_ObjDistXStd_39 : 130|6@0+ (0.1,0) [0|6] "m"  MPC
 SG_ MRR_ObjType_39 : 150|4@0+ (1,0) [0|15] ""  MPC
 SG_ MRR_ObjDistYStd_39 : 140|6@0+ (0.1,0) [0|6] "m"  MPC
 SG_ MRR_ObjRelVelXStd_39 : 146|6@0+ (0.0625,0) [0|3.9375] "mps"  MPC
 SG_ MRR_ObjRAccelXStd_39 : 166|6@0+ (0.0625,0) [0|3.9375] "mps2"  MPC
 SG_ MRR_ObjRelVelYStd_39 : 156|6@0+ (0.0625,0) [0|3.9375] "mps"  MPC
 SG_ MRR_ObjMotionType_39 : 170|3@0+ (1,0) [0|7] ""  MPC
 SG_ MRR_ObjRAccelYStd_39 : 160|6@0+ (0.0625,0) [0|3.9375] "mps2"  MPC
 SG_ MRR_ObjWidth_39 : 183|10@0+ (0.01,0) [0|5] "m"  MPC
 SG_ MRR_ObjMotionDirection_39 : 195|3@0+ (1,0) [0|7] ""  MPC
 SG_ MRR_ObjLength_39 : 189|10@0+ (0.05,0) [0|20] "m"  MPC
 SG_ MRR_ObjHeight_39 : 207|10@0+ (0.01,0) [0|6] "m"  MPC
 SG_ MRR_ObjHeading_39 : 213|12@0+ (0.002,-3.14) [-3.14|3.14] "rad"  MPC
 SG_ MRR_ObjRCS_39 : 217|10@0+ (0.125,-50) [-50|70] "dBsm"  MPC
 SG_ MRR_ObjAge_39 : 239|8@0+ (1,0) [0|255] ""  MPC
 SG_ MRR_ObjRefPoint_39 : 243|3@0+ (1,0) [0|7] "NoUnit"  MPC
 SG_ MRR_ObjRefPoint_40 : 247|3@0+ (1,0) [0|7] "NoUnit"  MPC
 SG_ MRR_ObjHYAS_Reserved_40 : 255|6@0+ (0.017,0) [0|1.071] ""  MPC
 SG_ MRR_ObjTypeProb_40 : 263|6@0+ (2,0) [0|100] "%"  MPC
 SG_ MRR_ObjID_40 : 271|8@0+ (1,0) [0|255] ""  MPC
 SG_ MRR_ObjExistProb_40 : 279|5@0+ (0.04,0) [0|1] ""  MPC
 SG_ MRR_ObjObstacleProb_40 : 274|5@0+ (0.04,0) [0|1] ""  MPC
 SG_ MRR_ObjDistX_40 : 285|12@0+ (0.075,0) [0|305.925] "m"  MPC
 SG_ MRR_ObjDistY_40 : 289|11@0+ (0.125,-128) [-128|127.875] "m"  MPC
 SG_ MRR_ObjRelAccelX_40 : 310|10@0+ (0.03125,-16) [-16|15.96875] "mps2"  MPC
 SG_ MRR_ObjRelVelX_40 : 335|13@0+ (0.0312,-128) [-128|126.9976] "mps"  MPC
 SG_ MRR_ObjRelVelY_40 : 338|13@0+ (0.0312,-128) [-128|126.9976] "mps"  MPC
 SG_ MRR_ObjRelAccelY_40 : 357|10@0+ (0.03125,-16) [-16|15.96875] "mps2"  MPC
 SG_ MRR_ObjDistYStd_40 : 373|6@0+ (0.1,0) [0|6] "m"  MPC
 SG_ MRR_ObjDistXStd_40 : 363|6@0+ (0.1,0) [0|6] "m"  MPC
 SG_ MRR_ObjType_40 : 383|4@0+ (1,0) [0|15] ""  MPC
 SG_ MRR_ObjRelVelXStd_40 : 399|6@0+ (0.0625,0) [0|3.9375] "mps"  MPC
 SG_ MRR_ObjRelVelYStd_40 : 393|6@0+ (0.0625,0) [0|3.9375] "mps"  MPC
 SG_ MRR_ObjRAccelYStd_40 : 413|6@0+ (0.0625,0) [0|3.9375] "mps2"  MPC
 SG_ MRR_ObjRAccelXStd_40 : 403|6@0+ (0.0625,0) [0|3.9375] "mps2"  MPC
 SG_ MRR_ObjMotionType_40 : 423|3@0+ (1,0) [0|7] ""  MPC
 SG_ MRR_ObjWidth_40 : 420|10@0+ (0.01,0) [0|5] "m"  MPC
 SG_ MRR_ObjLength_40 : 426|10@0+ (0.05,0) [0|20] "m"  MPC
 SG_ MRR_ObjMotionDirection_40 : 432|3@0+ (1,0) [0|7] ""  MPC
 SG_ BlockCounter20 : 469|4@0+ (1,0) [0|15] ""  MPC
 SG_ MRR_ObjHeight_40 : 463|10@0+ (0.01,0) [0|6] "m"  MPC
 SG_ MRR_ObjRCS_40 : 465|10@0+ (0.125,-50) [-50|70] "dBsm"  MPC
 SG_ MRR_ObjAge_40 : 487|8@0+ (1,0) [0|255] ""  MPC
 SG_ MRR_ObjMeasured_39 : 497|2@0+ (1,0) [0|3] ""  MPC
 SG_ MRR_ObjMeasured_40 : 499|2@0+ (1,0) [0|3] ""  MPC
 SG_ MRR_ObjHeading_40 : 495|12@0+ (0.002,-3.14) [-3.14|3.14] "rad"  MPC
 SG_ MRR_ObjValid_39 : 508|1@0+ (1,0) [0|1] ""  MPC
 SG_ MRR_ObjValid_40 : 509|1@0+ (1,0) [0|1] ""  MPC

BO_ 1092 MRRAD21: 64 FR
 SG_ Checksum444 : 7|16@0+ (1,0) [0|65535] ""  MPC
 SG_ RollingCounter444 : 23|8@0+ (1,0) [0|255] ""  MPC
 SG_ MRR_ObjHYAS_Reserved_41 : 31|6@0+ (0.017,0) [0|1.071] ""  MPC
 SG_ MRR_ObjTypeProb_41 : 39|6@0+ (2,0) [0|100] "%"  MPC
 SG_ MRR_ObjID_41 : 41|8@0+ (1,0) [0|255] ""  MPC
 SG_ MRR_ObjObstacleProb_41 : 60|5@0+ (0.04,0) [0|1] ""  MPC
 SG_ MRR_ObjExistProb_41 : 49|5@0+ (0.04,0) [0|1] ""  MPC
 SG_ MRR_ObjDistX_41 : 71|12@0+ (0.075,0) [0|305.925] "m"  MPC
 SG_ MRR_ObjDistY_41 : 75|11@0+ (0.125,-128) [-128|127.875] "m"  MPC
 SG_ MRR_ObjRelAccelX_41 : 80|10@0+ (0.03125,-16) [-16|15.96875] "mps2"  MPC
 SG_ MRR_ObjRelVelX_41 : 102|13@0+ (0.0312,-128) [-128|126.9976] "mps"  MPC
 SG_ MRR_ObjRelVelY_41 : 105|13@0+ (0.0312,-128) [-128|126.9976] "mps"  MPC
 SG_ MRR_ObjRelAccelY_41 : 124|10@0+ (0.03125,-16) [-16|15.96875] "mps2"  MPC
 SG_ MRR_ObjDistXStd_41 : 130|6@0+ (0.1,0) [0|6] "m"  MPC
 SG_ MRR_ObjType_41 : 150|4@0+ (1,0) [0|15] ""  MPC
 SG_ MRR_ObjDistYStd_41 : 140|6@0+ (0.1,0) [0|6] "m"  MPC
 SG_ MRR_ObjRelVelXStd_41 : 146|6@0+ (0.0625,0) [0|3.9375] "mps"  MPC
 SG_ MRR_ObjRAccelXStd_41 : 166|6@0+ (0.0625,0) [0|3.9375] "mps2"  MPC
 SG_ MRR_ObjRelVelYStd_41 : 156|6@0+ (0.0625,0) [0|3.9375] "mps"  MPC
 SG_ MRR_ObjMotionType_41 : 170|3@0+ (1,0) [0|7] ""  MPC
 SG_ MRR_ObjRAccelYStd_41 : 160|6@0+ (0.0625,0) [0|3.9375] "mps2"  MPC
 SG_ MRR_ObjWidth_41 : 183|10@0+ (0.01,0) [0|5] "m"  MPC
 SG_ MRR_ObjMotionDirection_41 : 195|3@0+ (1,0) [0|7] ""  MPC
 SG_ MRR_ObjLength_41 : 189|10@0+ (0.05,0) [0|20] "m"  MPC
 SG_ MRR_ObjHeight_41 : 207|10@0+ (0.01,0) [0|6] "m"  MPC
 SG_ MRR_ObjHeading_41 : 213|12@0+ (0.002,-3.14) [-3.14|3.14] "rad"  MPC
 SG_ MRR_ObjRCS_41 : 217|10@0+ (0.125,-50) [-50|70] "dBsm"  MPC
 SG_ MRR_ObjAge_41 : 239|8@0+ (1,0) [0|255] ""  MPC
 SG_ MRR_ObjRefPoint_41 : 243|3@0+ (1,0) [0|7] "NoUnit"  MPC
 SG_ MRR_ObjRefPoint_42 : 247|3@0+ (1,0) [0|7] "NoUnit"  MPC
 SG_ MRR_ObjHYAS_Reserved_42 : 255|6@0+ (0.017,0) [0|1.071] ""  MPC
 SG_ MRR_ObjTypeProb_42 : 263|6@0+ (2,0) [0|100] "%"  MPC
 SG_ MRR_ObjID_42 : 271|8@0+ (1,0) [0|255] ""  MPC
 SG_ MRR_ObjExistProb_42 : 279|5@0+ (0.04,0) [0|1] ""  MPC
 SG_ MRR_ObjObstacleProb_42 : 274|5@0+ (0.04,0) [0|1] ""  MPC
 SG_ MRR_ObjDistX_42 : 285|12@0+ (0.075,0) [0|305.925] "m"  MPC
 SG_ MRR_ObjDistY_42 : 289|11@0+ (0.125,-128) [-128|127.875] "m"  MPC
 SG_ MRR_ObjRelAccelX_42 : 310|10@0+ (0.03125,-16) [-16|15.96875] "mps2"  MPC
 SG_ MRR_ObjRelVelX_42 : 335|13@0+ (0.0312,-128) [-128|126.9976] "mps"  MPC
 SG_ MRR_ObjRelVelY_42 : 338|13@0+ (0.0312,-128) [-128|126.9976] "mps"  MPC
 SG_ MRR_ObjRelAccelY_42 : 357|10@0+ (0.03125,-16) [-16|15.96875] "mps2"  MPC
 SG_ MRR_ObjDistYStd_42 : 373|6@0+ (0.1,0) [0|6] "m"  MPC
 SG_ MRR_ObjDistXStd_42 : 363|6@0+ (0.1,0) [0|6] "m"  MPC
 SG_ MRR_ObjType_42 : 383|4@0+ (1,0) [0|15] ""  MPC
 SG_ MRR_ObjRelVelXStd_42 : 399|6@0+ (0.0625,0) [0|3.9375] "mps"  MPC
 SG_ MRR_ObjRelVelYStd_42 : 393|6@0+ (0.0625,0) [0|3.9375] "mps"  MPC
 SG_ MRR_ObjRAccelYStd_42 : 413|6@0+ (0.0625,0) [0|3.9375] "mps2"  MPC
 SG_ MRR_ObjRAccelXStd_42 : 403|6@0+ (0.0625,0) [0|3.9375] "mps2"  MPC
 SG_ MRR_ObjMotionType_42 : 423|3@0+ (1,0) [0|7] ""  MPC
 SG_ MRR_ObjWidth_42 : 420|10@0+ (0.01,0) [0|5] "m"  MPC
 SG_ MRR_ObjLength_42 : 426|10@0+ (0.05,0) [0|20] "m"  MPC
 SG_ MRR_ObjMotionDirection_42 : 432|3@0+ (1,0) [0|7] ""  MPC
 SG_ BlockCounter21 : 469|4@0+ (1,0) [0|15] ""  MPC
 SG_ MRR_ObjHeight_42 : 463|10@0+ (0.01,0) [0|6] "m"  MPC
 SG_ MRR_ObjRCS_42 : 465|10@0+ (0.125,-50) [-50|70] "dBsm"  MPC
 SG_ MRR_ObjAge_42 : 487|8@0+ (1,0) [0|255] ""  MPC
 SG_ MRR_ObjMeasured_41 : 497|2@0+ (1,0) [0|3] ""  MPC
 SG_ MRR_ObjMeasured_42 : 499|2@0+ (1,0) [0|3] ""  MPC
 SG_ MRR_ObjHeading_42 : 495|12@0+ (0.002,-3.14) [-3.14|3.14] "rad"  MPC
 SG_ MRR_ObjValid_41 : 508|1@0+ (1,0) [0|1] ""  MPC
 SG_ MRR_ObjValid_42 : 509|1@0+ (1,0) [0|1] ""  MPC

BO_ 1093 MRRAD22: 64 FR
 SG_ Checksum445 : 7|16@0+ (1,0) [0|65535] ""  MPC
 SG_ RollingCounter445 : 23|8@0+ (1,0) [0|255] ""  MPC
 SG_ MRR_ObjHYAS_Reserved_43 : 31|6@0+ (0.017,0) [0|1.071] ""  MPC
 SG_ MRR_ObjTypeProb_43 : 39|6@0+ (2,0) [0|100] "%"  MPC
 SG_ MRR_ObjID_43 : 41|8@0+ (1,0) [0|255] ""  MPC
 SG_ MRR_ObjObstacleProb_43 : 60|5@0+ (0.04,0) [0|1] ""  MPC
 SG_ MRR_ObjExistProb_43 : 49|5@0+ (0.04,0) [0|1] ""  MPC
 SG_ MRR_ObjDistX_43 : 71|12@0+ (0.075,0) [0|305.925] "m"  MPC
 SG_ MRR_ObjDistY_43 : 75|11@0+ (0.125,-128) [-128|127.875] "m"  MPC
 SG_ MRR_ObjRelAccelX_43 : 80|10@0+ (0.03125,-16) [-16|15.96875] "mps2"  MPC
 SG_ MRR_ObjRelVelX_43 : 102|13@0+ (0.0312,-128) [-128|126.9976] "mps"  MPC
 SG_ MRR_ObjRelVelY_43 : 105|13@0+ (0.0312,-128) [-128|126.9976] "mps"  MPC
 SG_ MRR_ObjRelAccelY_43 : 124|10@0+ (0.03125,-16) [-16|15.96875] "mps2"  MPC
 SG_ MRR_ObjDistXStd_43 : 130|6@0+ (0.1,0) [0|6] "m"  MPC
 SG_ MRR_ObjType_43 : 150|4@0+ (1,0) [0|15] ""  MPC
 SG_ MRR_ObjDistYStd_43 : 140|6@0+ (0.1,0) [0|6] "m"  MPC
 SG_ MRR_ObjRelVelXStd_43 : 146|6@0+ (0.0625,0) [0|3.9375] "mps"  MPC
 SG_ MRR_ObjRAccelXStd_43 : 166|6@0+ (0.0625,0) [0|3.9375] "mps2"  MPC
 SG_ MRR_ObjRelVelYStd_43 : 156|6@0+ (0.0625,0) [0|3.9375] "mps"  MPC
 SG_ MRR_ObjMotionType_43 : 170|3@0+ (1,0) [0|7] ""  MPC
 SG_ MRR_ObjRAccelYStd_43 : 160|6@0+ (0.0625,0) [0|3.9375] "mps2"  MPC
 SG_ MRR_ObjWidth_43 : 183|10@0+ (0.01,0) [0|5] "m"  MPC
 SG_ MRR_ObjMotionDirection_43 : 195|3@0+ (1,0) [0|7] ""  MPC
 SG_ MRR_ObjLength_43 : 189|10@0+ (0.05,0) [0|20] "m"  MPC
 SG_ MRR_ObjHeight_43 : 207|10@0+ (0.01,0) [0|6] "m"  MPC
 SG_ MRR_ObjHeading_43 : 213|12@0+ (0.002,-3.14) [-3.14|3.14] "rad"  MPC
 SG_ MRR_ObjRCS_43 : 217|10@0+ (0.125,-50) [-50|70] "dBsm"  MPC
 SG_ MRR_ObjAge_43 : 239|8@0+ (1,0) [0|255] ""  MPC
 SG_ MRR_ObjRefPoint_43 : 243|3@0+ (1,0) [0|7] "NoUnit"  MPC
 SG_ MRR_ObjRefPoint_44 : 247|3@0+ (1,0) [0|7] "NoUnit"  MPC
 SG_ MRR_ObjHYAS_Reserved_44 : 255|6@0+ (0.017,0) [0|1.071] ""  MPC
 SG_ MRR_ObjTypeProb_44 : 263|6@0+ (2,0) [0|100] "%"  MPC
 SG_ MRR_ObjID_44 : 271|8@0+ (1,0) [0|255] ""  MPC
 SG_ MRR_ObjExistProb_44 : 279|5@0+ (0.04,0) [0|1] ""  MPC
 SG_ MRR_ObjObstacleProb_44 : 274|5@0+ (0.04,0) [0|1] ""  MPC
 SG_ MRR_ObjDistX_44 : 285|12@0+ (0.075,0) [0|305.925] "m"  MPC
 SG_ MRR_ObjDistY_44 : 289|11@0+ (0.125,-128) [-128|127.875] "m"  MPC
 SG_ MRR_ObjRelAccelX_44 : 310|10@0+ (0.03125,-16) [-16|15.96875] "mps2"  MPC
 SG_ MRR_ObjRelVelX_44 : 335|13@0+ (0.0312,-128) [-128|126.9976] "mps"  MPC
 SG_ MRR_ObjRelVelY_44 : 338|13@0+ (0.0312,-128) [-128|126.9976] "mps"  MPC
 SG_ MRR_ObjRelAccelY_44 : 357|10@0+ (0.03125,-16) [-16|15.96875] "mps2"  MPC
 SG_ MRR_ObjDistYStd_44 : 373|6@0+ (0.1,0) [0|6] "m"  MPC
 SG_ MRR_ObjDistXStd_44 : 363|6@0+ (0.1,0) [0|6] "m"  MPC
 SG_ MRR_ObjType_44 : 383|4@0+ (1,0) [0|15] ""  MPC
 SG_ MRR_ObjRelVelXStd_44 : 399|6@0+ (0.0625,0) [0|3.9375] "mps"  MPC
 SG_ MRR_ObjRelVelYStd_44 : 393|6@0+ (0.0625,0) [0|3.9375] "mps"  MPC
 SG_ MRR_ObjRAccelYStd_44 : 413|6@0+ (0.0625,0) [0|3.9375] "mps2"  MPC
 SG_ MRR_ObjRAccelXStd_44 : 403|6@0+ (0.0625,0) [0|3.9375] "mps2"  MPC
 SG_ MRR_ObjMotionType_44 : 423|3@0+ (1,0) [0|7] ""  MPC
 SG_ MRR_ObjWidth_44 : 420|10@0+ (0.01,0) [0|5] "m"  MPC
 SG_ MRR_ObjLength_44 : 426|10@0+ (0.05,0) [0|20] "m"  MPC
 SG_ MRR_ObjMotionDirection_44 : 432|3@0+ (1,0) [0|7] ""  MPC
 SG_ BlockCounter22 : 469|4@0+ (1,0) [0|15] ""  MPC
 SG_ MRR_ObjHeight_44 : 463|10@0+ (0.01,0) [0|6] "m"  MPC
 SG_ MRR_ObjRCS_44 : 465|10@0+ (0.125,-50) [-50|70] "dBsm"  MPC
 SG_ MRR_ObjAge_44 : 487|8@0+ (1,0) [0|255] ""  MPC
 SG_ MRR_ObjMeasured_43 : 497|2@0+ (1,0) [0|3] ""  MPC
 SG_ MRR_ObjMeasured_44 : 499|2@0+ (1,0) [0|3] ""  MPC
 SG_ MRR_ObjHeading_44 : 495|12@0+ (0.002,-3.14) [-3.14|3.14] "rad"  MPC
 SG_ MRR_ObjValid_43 : 508|1@0+ (1,0) [0|1] ""  MPC
 SG_ MRR_ObjValid_44 : 509|1@0+ (1,0) [0|1] ""  MPC

BO_ 1094 MRRAD23: 64 FR
 SG_ Checksum446 : 7|16@0+ (1,0) [0|65535] ""  MPC
 SG_ RollingCounter446 : 23|8@0+ (1,0) [0|255] ""  MPC
 SG_ MRR_ObjHYAS_Reserved_45 : 31|6@0+ (0.017,0) [0|1.071] ""  MPC
 SG_ MRR_ObjTypeProb_45 : 39|6@0+ (2,0) [0|100] "%"  MPC
 SG_ MRR_ObjID_45 : 41|8@0+ (1,0) [0|255] ""  MPC
 SG_ MRR_ObjObstacleProb_45 : 60|5@0+ (0.04,0) [0|1] ""  MPC
 SG_ MRR_ObjExistProb_45 : 49|5@0+ (0.04,0) [0|1] ""  MPC
 SG_ MRR_ObjDistX_45 : 71|12@0+ (0.075,0) [0|305.925] "m"  MPC
 SG_ MRR_ObjDistY_45 : 75|11@0+ (0.125,-128) [-128|127.875] "m"  MPC
 SG_ MRR_ObjRelAccelX_45 : 80|10@0+ (0.03125,-16) [-16|15.96875] "mps2"  MPC
 SG_ MRR_ObjRelVelX_45 : 102|13@0+ (0.0312,-128) [-128|126.9976] "mps"  MPC
 SG_ MRR_ObjRelVelY_45 : 105|13@0+ (0.0312,-128) [-128|126.9976] "mps"  MPC
 SG_ MRR_ObjRelAccelY_45 : 124|10@0+ (0.03125,-16) [-16|15.96875] "mps2"  MPC
 SG_ MRR_ObjDistXStd_45 : 130|6@0+ (0.1,0) [0|6] "m"  MPC
 SG_ MRR_ObjType_45 : 150|4@0+ (1,0) [0|15] ""  MPC
 SG_ MRR_ObjDistYStd_45 : 140|6@0+ (0.1,0) [0|6] "m"  MPC
 SG_ MRR_ObjRelVelXStd_45 : 146|6@0+ (0.0625,0) [0|3.9375] "mps"  MPC
 SG_ MRR_ObjRAccelXStd_45 : 166|6@0+ (0.0625,0) [0|3.9375] "mps2"  MPC
 SG_ MRR_ObjRelVelYStd_45 : 156|6@0+ (0.0625,0) [0|3.9375] "mps"  MPC
 SG_ MRR_ObjMotionType_45 : 170|3@0+ (1,0) [0|7] ""  MPC
 SG_ MRR_ObjRAccelYStd_45 : 160|6@0+ (0.0625,0) [0|3.9375] "mps2"  MPC
 SG_ MRR_ObjWidth_45 : 183|10@0+ (0.01,0) [0|5] "m"  MPC
 SG_ MRR_ObjMotionDirection_45 : 195|3@0+ (1,0) [0|7] ""  MPC
 SG_ MRR_ObjLength_45 : 189|10@0+ (0.05,0) [0|20] "m"  MPC
 SG_ MRR_ObjHeight_45 : 207|10@0+ (0.01,0) [0|6] "m"  MPC
 SG_ MRR_ObjHeading_45 : 213|12@0+ (0.002,-3.14) [-3.14|3.14] "rad"  MPC
 SG_ MRR_ObjRCS_45 : 217|10@0+ (0.125,-50) [-50|70] "dBsm"  MPC
 SG_ MRR_ObjAge_45 : 239|8@0+ (1,0) [0|255] ""  MPC
 SG_ MRR_ObjRefPoint_45 : 243|3@0+ (1,0) [0|7] "NoUnit"  MPC
 SG_ MRR_ObjRefPoint_46 : 247|3@0+ (1,0) [0|7] "NoUnit"  MPC
 SG_ MRR_ObjHYAS_Reserved_46 : 255|6@0+ (0.017,0) [0|1.071] ""  MPC
 SG_ MRR_ObjTypeProb_46 : 263|6@0+ (2,0) [0|100] "%"  MPC
 SG_ MRR_ObjID_46 : 271|8@0+ (1,0) [0|255] ""  MPC
 SG_ MRR_ObjExistProb_46 : 279|5@0+ (0.04,0) [0|1] ""  MPC
 SG_ MRR_ObjObstacleProb_46 : 274|5@0+ (0.04,0) [0|1] ""  MPC
 SG_ MRR_ObjDistX_46 : 285|12@0+ (0.075,0) [0|305.925] "m"  MPC
 SG_ MRR_ObjDistY_46 : 289|11@0+ (0.125,-128) [-128|127.875] "m"  MPC
 SG_ MRR_ObjRelAccelX_46 : 310|10@0+ (0.03125,-16) [-16|15.96875] "mps2"  MPC
 SG_ MRR_ObjRelVelX_46 : 335|13@0+ (0.0312,-128) [-128|126.9976] "mps"  MPC
 SG_ MRR_ObjRelVelY_46 : 338|13@0+ (0.0312,-128) [-128|126.9976] "mps"  MPC
 SG_ MRR_ObjRelAccelY_46 : 357|10@0+ (0.03125,-16) [-16|15.96875] "mps2"  MPC
 SG_ MRR_ObjDistYStd_46 : 373|6@0+ (0.1,0) [0|6] "m"  MPC
 SG_ MRR_ObjDistXStd_46 : 363|6@0+ (0.1,0) [0|6] "m"  MPC
 SG_ MRR_ObjType_46 : 383|4@0+ (1,0) [0|15] ""  MPC
 SG_ MRR_ObjRelVelXStd_46 : 399|6@0+ (0.0625,0) [0|3.9375] "mps"  MPC
 SG_ MRR_ObjRelVelYStd_46 : 393|6@0+ (0.0625,0) [0|3.9375] "mps"  MPC
 SG_ MRR_ObjRAccelYStd_46 : 413|6@0+ (0.0625,0) [0|3.9375] "mps2"  MPC
 SG_ MRR_ObjRAccelXStd_46 : 403|6@0+ (0.0625,0) [0|3.9375] "mps2"  MPC
 SG_ MRR_ObjMotionType_46 : 423|3@0+ (1,0) [0|7] ""  MPC
 SG_ MRR_ObjWidth_46 : 420|10@0+ (0.01,0) [0|5] "m"  MPC
 SG_ MRR_ObjLength_46 : 426|10@0+ (0.05,0) [0|20] "m"  MPC
 SG_ MRR_ObjMotionDirection_46 : 432|3@0+ (1,0) [0|7] ""  MPC
 SG_ BlockCounter23 : 469|4@0+ (1,0) [0|15] ""  MPC
 SG_ MRR_ObjHeight_46 : 463|10@0+ (0.01,0) [0|6] "m"  MPC
 SG_ MRR_ObjRCS_46 : 465|10@0+ (0.125,-50) [-50|70] "dBsm"  MPC
 SG_ MRR_ObjAge_46 : 487|8@0+ (1,0) [0|255] ""  MPC
 SG_ MRR_ObjMeasured_45 : 497|2@0+ (1,0) [0|3] ""  MPC
 SG_ MRR_ObjMeasured_46 : 499|2@0+ (1,0) [0|3] ""  MPC
 SG_ MRR_ObjHeading_46 : 495|12@0+ (0.002,-3.14) [-3.14|3.14] "rad"  MPC
 SG_ MRR_ObjValid_45 : 508|1@0+ (1,0) [0|1] ""  MPC
 SG_ MRR_ObjValid_46 : 509|1@0+ (1,0) [0|1] ""  MPC

BO_ 1095 MRRAD24: 64 FR
 SG_ Checksum447 : 7|16@0+ (1,0) [0|65535] ""  MPC
 SG_ RollingCounter447 : 23|8@0+ (1,0) [0|255] ""  MPC
 SG_ MRR_ObjHYAS_Reserved_47 : 31|6@0+ (0.017,0) [0|1.071] ""  MPC
 SG_ MRR_ObjTypeProb_47 : 39|6@0+ (2,0) [0|100] "%"  MPC
 SG_ MRR_ObjID_47 : 41|8@0+ (1,0) [0|255] ""  MPC
 SG_ MRR_ObjObstacleProb_47 : 60|5@0+ (0.04,0) [0|1] ""  MPC
 SG_ MRR_ObjExistProb_47 : 49|5@0+ (0.04,0) [0|1] ""  MPC
 SG_ MRR_ObjDistX_47 : 71|12@0+ (0.075,0) [0|305.925] "m"  MPC
 SG_ MRR_ObjDistY_47 : 75|11@0+ (0.125,-128) [-128|127.875] "m"  MPC
 SG_ MRR_ObjRelAccelX_47 : 80|10@0+ (0.03125,-16) [-16|15.96875] "mps2"  MPC
 SG_ MRR_ObjRelVelX_47 : 102|13@0+ (0.0312,-128) [-128|126.9976] "mps"  MPC
 SG_ MRR_ObjRelVelY_47 : 105|13@0+ (0.0312,-128) [-128|126.9976] "mps"  MPC
 SG_ MRR_ObjRelAccelY_47 : 124|10@0+ (0.03125,-16) [-16|15.96875] "mps2"  MPC
 SG_ MRR_ObjDistXStd_47 : 130|6@0+ (0.1,0) [0|6] "m"  MPC
 SG_ MRR_ObjType_47 : 150|4@0+ (1,0) [0|15] ""  MPC
 SG_ MRR_ObjDistYStd_47 : 140|6@0+ (0.1,0) [0|6] "m"  MPC
 SG_ MRR_ObjRelVelXStd_47 : 146|6@0+ (0.0625,0) [0|3.9375] "mps"  MPC
 SG_ MRR_ObjRAccelXStd_47 : 166|6@0+ (0.0625,0) [0|3.9375] "mps2"  MPC
 SG_ MRR_ObjRelVelYStd_47 : 156|6@0+ (0.0625,0) [0|3.9375] "mps"  MPC
 SG_ MRR_ObjMotionType_47 : 170|3@0+ (1,0) [0|7] ""  MPC
 SG_ MRR_ObjRAccelYStd_47 : 160|6@0+ (0.0625,0) [0|3.9375] "mps2"  MPC
 SG_ MRR_ObjWidth_47 : 183|10@0+ (0.01,0) [0|5] "m"  MPC
 SG_ MRR_ObjMotionDirection_47 : 195|3@0+ (1,0) [0|7] ""  MPC
 SG_ MRR_ObjLength_47 : 189|10@0+ (0.05,0) [0|20] "m"  MPC
 SG_ MRR_ObjHeight_47 : 207|10@0+ (0.01,0) [0|6] "m"  MPC
 SG_ MRR_ObjHeading_47 : 213|12@0+ (0.002,-3.14) [-3.14|3.14] "rad"  MPC
 SG_ MRR_ObjRCS_47 : 217|10@0+ (0.125,-50) [-50|70] "dBsm"  MPC
 SG_ MRR_ObjAge_47 : 239|8@0+ (1,0) [0|255] ""  MPC
 SG_ MRR_ObjRefPoint_47 : 243|3@0+ (1,0) [0|7] "NoUnit"  MPC
 SG_ MRR_ObjRefPoint_48 : 247|3@0+ (1,0) [0|7] "NoUnit"  MPC
 SG_ MRR_ObjHYAS_Reserved_48 : 255|6@0+ (0.017,0) [0|1.071] ""  MPC
 SG_ MRR_ObjTypeProb_48 : 263|6@0+ (2,0) [0|100] "%"  MPC
 SG_ MRR_ObjID_48 : 271|8@0+ (1,0) [0|255] ""  MPC
 SG_ MRR_ObjExistProb_48 : 279|5@0+ (0.04,0) [0|1] ""  MPC
 SG_ MRR_ObjObstacleProb_48 : 274|5@0+ (0.04,0) [0|1] ""  MPC
 SG_ MRR_ObjDistX_48 : 285|12@0+ (0.075,0) [0|305.925] "m"  MPC
 SG_ MRR_ObjDistY_48 : 289|11@0+ (0.125,-128) [-128|127.875] "m"  MPC
 SG_ MRR_ObjRelAccelX_48 : 310|10@0+ (0.03125,-16) [-16|15.96875] "mps2"  MPC
 SG_ MRR_ObjRelVelX_48 : 335|13@0+ (0.0312,-128) [-128|126.9976] "mps"  MPC
 SG_ MRR_ObjRelVelY_48 : 338|13@0+ (0.0312,-128) [-128|126.9976] "mps"  MPC
 SG_ MRR_ObjRelAccelY_48 : 357|10@0+ (0.03125,-16) [-16|15.96875] "mps2"  MPC
 SG_ MRR_ObjDistYStd_48 : 373|6@0+ (0.1,0) [0|6] "m"  MPC
 SG_ MRR_ObjDistXStd_48 : 363|6@0+ (0.1,0) [0|6] "m"  MPC
 SG_ MRR_ObjType_48 : 383|4@0+ (1,0) [0|15] ""  MPC
 SG_ MRR_ObjRelVelXStd_48 : 399|6@0+ (0.0625,0) [0|3.9375] "mps"  MPC
 SG_ MRR_ObjRelVelYStd_48 : 393|6@0+ (0.0625,0) [0|3.9375] "mps"  MPC
 SG_ MRR_ObjRAccelYStd_48 : 413|6@0+ (0.0625,0) [0|3.9375] "mps2"  MPC
 SG_ MRR_ObjRAccelXStd_48 : 403|6@0+ (0.0625,0) [0|3.9375] "mps2"  MPC
 SG_ MRR_ObjMotionType_48 : 423|3@0+ (1,0) [0|7] ""  MPC
 SG_ MRR_ObjWidth_48 : 420|10@0+ (0.01,0) [0|5] "m"  MPC
 SG_ MRR_ObjLength_48 : 426|10@0+ (0.05,0) [0|20] "m"  MPC
 SG_ MRR_ObjMotionDirection_48 : 432|3@0+ (1,0) [0|7] ""  MPC
 SG_ BlockCounter24 : 469|4@0+ (1,0) [0|15] ""  MPC
 SG_ MRR_ObjHeight_48 : 463|10@0+ (0.01,0) [0|6] "m"  MPC
 SG_ MRR_ObjRCS_48 : 465|10@0+ (0.125,-50) [-50|70] "dBsm"  MPC
 SG_ MRR_ObjAge_48 : 487|8@0+ (1,0) [0|255] ""  MPC
 SG_ MRR_ObjMeasured_47 : 497|2@0+ (1,0) [0|3] ""  MPC
 SG_ MRR_ObjMeasured_48 : 499|2@0+ (1,0) [0|3] ""  MPC
 SG_ MRR_ObjHeading_48 : 495|12@0+ (0.002,-3.14) [-3.14|3.14] "rad"  MPC
 SG_ MRR_ObjValid_47 : 508|1@0+ (1,0) [0|1] ""  MPC
 SG_ MRR_ObjValid_48 : 509|1@0+ (1,0) [0|1] ""  MPC

BO_ 65 Sync_0x41: 8 MPC
 SG_ TimeSync_Type M : 7|8@0+ (1,0) [0|255] ""  FR
 SG_ TimeSync_CRC : 15|8@0+ (1,0) [0|255] ""  FR
 SG_ TimeSync_SequenceCounter : 19|4@0+ (1,0) [0|15] ""  FR
 SG_ TimeSync_TimeDomain : 23|4@0+ (1,0) [0|15] ""  FR
 SG_ TimeSync_UserByte0 m32 : 31|8@0+ (1,0) [0|255] ""  FR
 SG_ TimeSync_SyncTimeSec m32 : 39|32@0+ (1,0) [0|4294967295] ""  FR
 SG_ TimeSync_OverflowOfSeconds m40 : 25|2@0+ (1,0) [0|3] ""  FR
 SG_ TimeSync_SGW m40 : 26|1@0+ (1,0) [0|1] ""  FR
 SG_ TimeSync_Reserved0 m40 : 31|5@0+ (1,0) [0|31] ""  FR
 SG_ TimeSync_SyncTimeNSec m40 : 39|32@0+ (1,0) [0|4294967295] ""  FR

BA_DEF_ BO_  "GenMsgSendType" ENUM  "cyclic","NoMsgSendType","IfActive","Event","CA","CE";
BA_DEF_ BO_  "GenMsgCycleTime" INT 0 0;
BA_DEF_ SG_  "GenSigStartValue" INT 0 0;
BA_DEF_  "DBName" STRING ;
BA_DEF_ BO_  "CANFD_BRS" ENUM  "0","1";
BA_DEF_ BO_  "VFrameFormat" ENUM  "StandardCAN","ExtendedCAN","reserved","reserved","reserved","reserved","reserved","reserved","reserved","reserved","reserved","reserved","reserved","reserved","StandardCAN_FD","ExtendedCAN_FD";
BA_DEF_  "BusBaudateData" INT 0 10000;
BA_DEF_  "BusBaudateOther" INT 0 10000;
BA_DEF_ BO_  "GenMsgILSupport" ENUM  "No","Yes";
BA_DEF_  "BusType" STRING ;
BA_DEF_DEF_  "GenMsgSendType" "cyclic";
BA_DEF_DEF_  "GenMsgCycleTime" 0;
BA_DEF_DEF_  "GenSigStartValue" 0;
BA_DEF_DEF_  "DBName" "";
BA_DEF_DEF_  "CANFD_BRS" "1";
BA_DEF_DEF_  "VFrameFormat" "";
BA_DEF_DEF_  "BusBaudateData" 2;
BA_DEF_DEF_  "BusBaudateOther" 500;
BA_DEF_DEF_  "GenMsgILSupport" "Yes";
BA_DEF_DEF_  "BusType" "CAN FD";
BA_ "DBName" "BAIC_CR";
BA_ "GenMsgSendType" BO_ 1065 3;
BA_ "VFrameFormat" BO_ 1065 14;
BA_ "GenMsgSendType" BO_ 1072 3;
BA_ "VFrameFormat" BO_ 1072 14;
BA_ "GenMsgSendType" BO_ 1073 3;
BA_ "VFrameFormat" BO_ 1073 14;
BA_ "GenMsgSendType" BO_ 1074 3;
BA_ "VFrameFormat" BO_ 1074 14;
BA_ "GenMsgSendType" BO_ 1075 3;
BA_ "VFrameFormat" BO_ 1075 14;
BA_ "GenMsgSendType" BO_ 1076 3;
BA_ "VFrameFormat" BO_ 1076 14;
BA_ "GenMsgSendType" BO_ 1077 3;
BA_ "VFrameFormat" BO_ 1077 14;
BA_ "GenMsgSendType" BO_ 1078 3;
BA_ "VFrameFormat" BO_ 1078 14;
BA_ "GenMsgSendType" BO_ 1079 3;
BA_ "VFrameFormat" BO_ 1079 14;
BA_ "GenMsgSendType" BO_ 1080 3;
BA_ "VFrameFormat" BO_ 1080 14;
BA_ "GenMsgSendType" BO_ 1081 3;
BA_ "VFrameFormat" BO_ 1081 14;
BA_ "GenMsgSendType" BO_ 1082 3;
BA_ "VFrameFormat" BO_ 1082 14;
BA_ "GenMsgSendType" BO_ 1083 3;
BA_ "VFrameFormat" BO_ 1083 14;
BA_ "GenMsgSendType" BO_ 1084 3;
BA_ "VFrameFormat" BO_ 1084 14;
BA_ "GenMsgSendType" BO_ 1085 3;
BA_ "VFrameFormat" BO_ 1085 14;
BA_ "GenMsgSendType" BO_ 1086 3;
BA_ "VFrameFormat" BO_ 1086 14;
BA_ "GenMsgSendType" BO_ 1087 3;
BA_ "VFrameFormat" BO_ 1087 14;
BA_ "GenMsgSendType" BO_ 1088 3;
BA_ "VFrameFormat" BO_ 1088 14;
BA_ "GenMsgSendType" BO_ 1089 3;
BA_ "VFrameFormat" BO_ 1089 14;
BA_ "GenMsgSendType" BO_ 1090 3;
BA_ "VFrameFormat" BO_ 1090 14;
BA_ "GenMsgSendType" BO_ 1091 3;
BA_ "VFrameFormat" BO_ 1091 14;
BA_ "GenMsgSendType" BO_ 1092 3;
BA_ "VFrameFormat" BO_ 1092 14;
BA_ "GenMsgSendType" BO_ 1093 3;
BA_ "VFrameFormat" BO_ 1093 14;
BA_ "GenMsgSendType" BO_ 1094 3;
BA_ "VFrameFormat" BO_ 1094 14;
BA_ "GenMsgSendType" BO_ 1095 3;
BA_ "VFrameFormat" BO_ 1095 14;
BA_ "GenMsgCycleTime" BO_ 65 500;
BA_ "VFrameFormat" BO_ 65 14;
BA_ "GenSigStartValue" SG_ 1065 FR_ObjHdr_MountPosX 256;
BA_ "GenSigStartValue" SG_ 1065 FR_ObjHdr_MountPosY 128;
BA_ "GenSigStartValue" SG_ 1065 FR_ObjHdr_YawMountAngle 32768;
BA_ "GenSigStartValue" SG_ 1065 FR_ObjHdr_YawAngleLower 16384;
BA_ "GenSigStartValue" SG_ 1065 FR_ObjHdr_YawAngleUpper 16384;
BA_ "GenSigStartValue" SG_ 1065 FR_ObjHdr_PitchMountAngle 2048;
BA_ "GenSigStartValue" SG_ 1065 FR_ObjHdr_PitchAngleLower 2048;
BA_ "GenSigStartValue" SG_ 1065 FR_ObjHdr_PitchAngleUpper 2048;
BA_ "GenSigStartValue" SG_ 1065 FR_ObjHdr_RollMountAngle 2048;
BA_ "GenSigStartValue" SG_ 1072 MRR_ObjDistY_1 1024;
BA_ "GenSigStartValue" SG_ 1072 MRR_ObjRelAccelX_1 512;
BA_ "GenSigStartValue" SG_ 1072 MRR_ObjRelVelX_1 4102;
BA_ "GenSigStartValue" SG_ 1072 MRR_ObjRelVelY_1 4102;
BA_ "GenSigStartValue" SG_ 1072 MRR_ObjRelAccelY_1 512;
BA_ "GenSigStartValue" SG_ 1072 MRR_ObjRCS_1 400;
BA_ "GenSigStartValue" SG_ 1072 MRR_ObjDistY_2 1024;
BA_ "GenSigStartValue" SG_ 1072 MRR_ObjRelAccelX_2 512;
BA_ "GenSigStartValue" SG_ 1072 MRR_ObjRelVelX_2 4102;
BA_ "GenSigStartValue" SG_ 1072 MRR_ObjRelVelY_2 4102;
BA_ "GenSigStartValue" SG_ 1072 MRR_ObjRelAccelY_2 512;
BA_ "GenSigStartValue" SG_ 1072 MRR_ObjRCS_2 400;
BA_ "GenSigStartValue" SG_ 1072 MRR_ObjMeasured_1 1;
BA_ "GenSigStartValue" SG_ 1072 MRR_ObjMeasured_2 1;
BA_ "GenSigStartValue" SG_ 1073 MRR_ObjDistY_3 1024;
BA_ "GenSigStartValue" SG_ 1073 MRR_ObjRelAccelX_3 512;
BA_ "GenSigStartValue" SG_ 1073 MRR_ObjRelVelX_3 4102;
BA_ "GenSigStartValue" SG_ 1073 MRR_ObjRelVelY_3 4102;
BA_ "GenSigStartValue" SG_ 1073 MRR_ObjRelAccelY_3 512;
BA_ "GenSigStartValue" SG_ 1073 MRR_ObjRCS_3 400;
BA_ "GenSigStartValue" SG_ 1073 MRR_ObjDistY_4 1024;
BA_ "GenSigStartValue" SG_ 1073 MRR_ObjRelAccelX_4 512;
BA_ "GenSigStartValue" SG_ 1073 MRR_ObjRelVelX_4 4102;
BA_ "GenSigStartValue" SG_ 1073 MRR_ObjRelVelY_4 4102;
BA_ "GenSigStartValue" SG_ 1073 MRR_ObjRelAccelY_4 512;
BA_ "GenSigStartValue" SG_ 1073 MRR_ObjRCS_4 400;
BA_ "GenSigStartValue" SG_ 1073 MRR_ObjMeasured_3 1;
BA_ "GenSigStartValue" SG_ 1073 MRR_ObjMeasured_4 1;
BA_ "GenSigStartValue" SG_ 1074 MRR_ObjDistY_5 1024;
BA_ "GenSigStartValue" SG_ 1074 MRR_ObjRelAccelX_5 512;
BA_ "GenSigStartValue" SG_ 1074 MRR_ObjRelVelX_5 4102;
BA_ "GenSigStartValue" SG_ 1074 MRR_ObjRelVelY_5 4102;
BA_ "GenSigStartValue" SG_ 1074 MRR_ObjRelAccelY_5 512;
BA_ "GenSigStartValue" SG_ 1074 MRR_ObjRCS_5 400;
BA_ "GenSigStartValue" SG_ 1074 MRR_ObjDistY_6 1024;
BA_ "GenSigStartValue" SG_ 1074 MRR_ObjRelAccelX_6 512;
BA_ "GenSigStartValue" SG_ 1074 MRR_ObjRelVelX_6 4102;
BA_ "GenSigStartValue" SG_ 1074 MRR_ObjRelVelY_6 4102;
BA_ "GenSigStartValue" SG_ 1074 MRR_ObjRelAccelY_6 512;
BA_ "GenSigStartValue" SG_ 1074 MRR_ObjRCS_6 400;
BA_ "GenSigStartValue" SG_ 1074 MRR_ObjMeasured_5 1;
BA_ "GenSigStartValue" SG_ 1074 MRR_ObjMeasured_6 1;
BA_ "GenSigStartValue" SG_ 1075 MRR_ObjDistY_7 1024;
BA_ "GenSigStartValue" SG_ 1075 MRR_ObjRelAccelX_7 512;
BA_ "GenSigStartValue" SG_ 1075 MRR_ObjRelVelX_7 4102;
BA_ "GenSigStartValue" SG_ 1075 MRR_ObjRelVelY_7 4102;
BA_ "GenSigStartValue" SG_ 1075 MRR_ObjRelAccelY_7 512;
BA_ "GenSigStartValue" SG_ 1075 MRR_ObjRCS_7 400;
BA_ "GenSigStartValue" SG_ 1075 MRR_ObjDistY_8 1024;
BA_ "GenSigStartValue" SG_ 1075 MRR_ObjRelAccelX_8 512;
BA_ "GenSigStartValue" SG_ 1075 MRR_ObjRelVelX_8 4102;
BA_ "GenSigStartValue" SG_ 1075 MRR_ObjRelVelY_8 4102;
BA_ "GenSigStartValue" SG_ 1075 MRR_ObjRelAccelY_8 512;
BA_ "GenSigStartValue" SG_ 1075 MRR_ObjRCS_8 400;
BA_ "GenSigStartValue" SG_ 1075 MRR_ObjMeasured_7 1;
BA_ "GenSigStartValue" SG_ 1075 MRR_ObjMeasured_8 1;
BA_ "GenSigStartValue" SG_ 1076 MRR_ObjDistY_9 1024;
BA_ "GenSigStartValue" SG_ 1076 MRR_ObjRelAccelX_9 512;
BA_ "GenSigStartValue" SG_ 1076 MRR_ObjRelVelX_9 4102;
BA_ "GenSigStartValue" SG_ 1076 MRR_ObjRelVelY_9 4102;
BA_ "GenSigStartValue" SG_ 1076 MRR_ObjRelAccelY_9 512;
BA_ "GenSigStartValue" SG_ 1076 MRR_ObjRCS_9 400;
BA_ "GenSigStartValue" SG_ 1076 MRR_ObjDistY_10 1024;
BA_ "GenSigStartValue" SG_ 1076 MRR_ObjRelAccelX_10 512;
BA_ "GenSigStartValue" SG_ 1076 MRR_ObjRelVelX_10 4102;
BA_ "GenSigStartValue" SG_ 1076 MRR_ObjRelVelY_10 4102;
BA_ "GenSigStartValue" SG_ 1076 MRR_ObjRelAccelY_10 512;
BA_ "GenSigStartValue" SG_ 1076 MRR_ObjRCS_10 400;
BA_ "GenSigStartValue" SG_ 1076 MRR_ObjMeasured_9 1;
BA_ "GenSigStartValue" SG_ 1076 MRR_ObjMeasured_10 1;
BA_ "GenSigStartValue" SG_ 1077 MRR_ObjDistY_11 1024;
BA_ "GenSigStartValue" SG_ 1077 MRR_ObjRelAccelX_11 512;
BA_ "GenSigStartValue" SG_ 1077 MRR_ObjRelVelX_11 4102;
BA_ "GenSigStartValue" SG_ 1077 MRR_ObjRelVelY_11 4102;
BA_ "GenSigStartValue" SG_ 1077 MRR_ObjRelAccelY_11 512;
BA_ "GenSigStartValue" SG_ 1077 MRR_ObjRCS_11 400;
BA_ "GenSigStartValue" SG_ 1077 MRR_ObjDistY_12 1024;
BA_ "GenSigStartValue" SG_ 1077 MRR_ObjRelAccelX_12 512;
BA_ "GenSigStartValue" SG_ 1077 MRR_ObjRelVelX_12 4102;
BA_ "GenSigStartValue" SG_ 1077 MRR_ObjRelVelY_12 4102;
BA_ "GenSigStartValue" SG_ 1077 MRR_ObjRelAccelY_12 512;
BA_ "GenSigStartValue" SG_ 1077 MRR_ObjRCS_12 400;
BA_ "GenSigStartValue" SG_ 1077 MRR_ObjMeasured_11 1;
BA_ "GenSigStartValue" SG_ 1077 MRR_ObjMeasured_12 1;
BA_ "GenSigStartValue" SG_ 1078 MRR_ObjDistY_13 1024;
BA_ "GenSigStartValue" SG_ 1078 MRR_ObjRelAccelX_13 512;
BA_ "GenSigStartValue" SG_ 1078 MRR_ObjRelVelX_13 4102;
BA_ "GenSigStartValue" SG_ 1078 MRR_ObjRelVelY_13 4102;
BA_ "GenSigStartValue" SG_ 1078 MRR_ObjRelAccelY_13 512;
BA_ "GenSigStartValue" SG_ 1078 MRR_ObjRCS_13 400;
BA_ "GenSigStartValue" SG_ 1078 MRR_ObjDistY_14 1024;
BA_ "GenSigStartValue" SG_ 1078 MRR_ObjRelAccelX_14 512;
BA_ "GenSigStartValue" SG_ 1078 MRR_ObjRelVelX_14 4102;
BA_ "GenSigStartValue" SG_ 1078 MRR_ObjRelVelY_14 4102;
BA_ "GenSigStartValue" SG_ 1078 MRR_ObjRelAccelY_14 512;
BA_ "GenSigStartValue" SG_ 1078 MRR_ObjRCS_14 400;
BA_ "GenSigStartValue" SG_ 1078 MRR_ObjMeasured_13 1;
BA_ "GenSigStartValue" SG_ 1078 MRR_ObjMeasured_14 1;
BA_ "GenSigStartValue" SG_ 1079 MRR_ObjDistY_15 1024;
BA_ "GenSigStartValue" SG_ 1079 MRR_ObjRelAccelX_15 512;
BA_ "GenSigStartValue" SG_ 1079 MRR_ObjRelVelX_15 4102;
BA_ "GenSigStartValue" SG_ 1079 MRR_ObjRelVelY_15 4102;
BA_ "GenSigStartValue" SG_ 1079 MRR_ObjRelAccelY_15 512;
BA_ "GenSigStartValue" SG_ 1079 MRR_ObjRCS_15 400;
BA_ "GenSigStartValue" SG_ 1079 MRR_ObjDistY_16 1024;
BA_ "GenSigStartValue" SG_ 1079 MRR_ObjRelAccelX_16 512;
BA_ "GenSigStartValue" SG_ 1079 MRR_ObjRelVelX_16 4102;
BA_ "GenSigStartValue" SG_ 1079 MRR_ObjRelVelY_16 4102;
BA_ "GenSigStartValue" SG_ 1079 MRR_ObjRelAccelY_16 512;
BA_ "GenSigStartValue" SG_ 1079 MRR_ObjRCS_16 400;
BA_ "GenSigStartValue" SG_ 1079 MRR_ObjMeasured_15 1;
BA_ "GenSigStartValue" SG_ 1079 MRR_ObjMeasured_16 1;
BA_ "GenSigStartValue" SG_ 1080 MRR_ObjDistY_17 1024;
BA_ "GenSigStartValue" SG_ 1080 MRR_ObjRelAccelX_17 512;
BA_ "GenSigStartValue" SG_ 1080 MRR_ObjRelVelX_17 4102;
BA_ "GenSigStartValue" SG_ 1080 MRR_ObjRelVelY_17 4102;
BA_ "GenSigStartValue" SG_ 1080 MRR_ObjRelAccelY_17 512;
BA_ "GenSigStartValue" SG_ 1080 MRR_ObjRCS_17 400;
BA_ "GenSigStartValue" SG_ 1080 MRR_ObjDistY_18 1024;
BA_ "GenSigStartValue" SG_ 1080 MRR_ObjRelAccelX_18 512;
BA_ "GenSigStartValue" SG_ 1080 MRR_ObjRelVelX_18 4102;
BA_ "GenSigStartValue" SG_ 1080 MRR_ObjRelVelY_18 4102;
BA_ "GenSigStartValue" SG_ 1080 MRR_ObjRelAccelY_18 512;
BA_ "GenSigStartValue" SG_ 1080 MRR_ObjRCS_18 400;
BA_ "GenSigStartValue" SG_ 1080 MRR_ObjMeasured_17 1;
BA_ "GenSigStartValue" SG_ 1080 MRR_ObjMeasured_18 1;
BA_ "GenSigStartValue" SG_ 1081 MRR_ObjDistY_19 1024;
BA_ "GenSigStartValue" SG_ 1081 MRR_ObjRelAccelX_19 512;
BA_ "GenSigStartValue" SG_ 1081 MRR_ObjRelVelX_19 4102;
BA_ "GenSigStartValue" SG_ 1081 MRR_ObjRelVelY_19 4102;
BA_ "GenSigStartValue" SG_ 1081 MRR_ObjRelAccelY_19 512;
BA_ "GenSigStartValue" SG_ 1081 MRR_ObjRCS_19 400;
BA_ "GenSigStartValue" SG_ 1081 MRR_ObjDistY_20 1024;
BA_ "GenSigStartValue" SG_ 1081 MRR_ObjRelAccelX_20 512;
BA_ "GenSigStartValue" SG_ 1081 MRR_ObjRelVelX_20 4102;
BA_ "GenSigStartValue" SG_ 1081 MRR_ObjRelVelY_20 4102;
BA_ "GenSigStartValue" SG_ 1081 MRR_ObjRelAccelY_20 512;
BA_ "GenSigStartValue" SG_ 1081 MRR_ObjRCS_20 400;
BA_ "GenSigStartValue" SG_ 1081 MRR_ObjMeasured_19 1;
BA_ "GenSigStartValue" SG_ 1081 MRR_ObjMeasured_20 1;
BA_ "GenSigStartValue" SG_ 1082 MRR_ObjDistY_21 1024;
BA_ "GenSigStartValue" SG_ 1082 MRR_ObjRelAccelX_21 512;
BA_ "GenSigStartValue" SG_ 1082 MRR_ObjRelVelX_21 4102;
BA_ "GenSigStartValue" SG_ 1082 MRR_ObjRelVelY_21 4102;
BA_ "GenSigStartValue" SG_ 1082 MRR_ObjRelAccelY_21 512;
BA_ "GenSigStartValue" SG_ 1082 MRR_ObjRCS_21 400;
BA_ "GenSigStartValue" SG_ 1082 MRR_ObjDistY_22 1024;
BA_ "GenSigStartValue" SG_ 1082 MRR_ObjRelAccelX_22 512;
BA_ "GenSigStartValue" SG_ 1082 MRR_ObjRelVelX_22 4102;
BA_ "GenSigStartValue" SG_ 1082 MRR_ObjRelVelY_22 4102;
BA_ "GenSigStartValue" SG_ 1082 MRR_ObjRelAccelY_22 512;
BA_ "GenSigStartValue" SG_ 1082 MRR_ObjRCS_22 400;
BA_ "GenSigStartValue" SG_ 1082 MRR_ObjMeasured_21 1;
BA_ "GenSigStartValue" SG_ 1082 MRR_ObjMeasured_22 1;
BA_ "GenSigStartValue" SG_ 1083 MRR_ObjDistY_23 1024;
BA_ "GenSigStartValue" SG_ 1083 MRR_ObjRelAccelX_23 512;
BA_ "GenSigStartValue" SG_ 1083 MRR_ObjRelVelX_23 4102;
BA_ "GenSigStartValue" SG_ 1083 MRR_ObjRelVelY_23 4102;
BA_ "GenSigStartValue" SG_ 1083 MRR_ObjRelAccelY_23 512;
BA_ "GenSigStartValue" SG_ 1083 MRR_ObjRCS_23 400;
BA_ "GenSigStartValue" SG_ 1083 MRR_ObjDistY_24 1024;
BA_ "GenSigStartValue" SG_ 1083 MRR_ObjRelAccelX_24 512;
BA_ "GenSigStartValue" SG_ 1083 MRR_ObjRelVelX_24 4102;
BA_ "GenSigStartValue" SG_ 1083 MRR_ObjRelVelY_24 4102;
BA_ "GenSigStartValue" SG_ 1083 MRR_ObjRelAccelY_24 512;
BA_ "GenSigStartValue" SG_ 1083 MRR_ObjRCS_24 400;
BA_ "GenSigStartValue" SG_ 1083 MRR_ObjMeasured_23 1;
BA_ "GenSigStartValue" SG_ 1083 MRR_ObjMeasured_24 1;
BA_ "GenSigStartValue" SG_ 1084 MRR_ObjDistY_25 1024;
BA_ "GenSigStartValue" SG_ 1084 MRR_ObjRelAccelX_25 512;
BA_ "GenSigStartValue" SG_ 1084 MRR_ObjRelVelX_25 4102;
BA_ "GenSigStartValue" SG_ 1084 MRR_ObjRelVelY_25 4102;
BA_ "GenSigStartValue" SG_ 1084 MRR_ObjRelAccelY_25 512;
BA_ "GenSigStartValue" SG_ 1084 MRR_ObjRCS_25 400;
BA_ "GenSigStartValue" SG_ 1084 MRR_ObjDistY_26 1024;
BA_ "GenSigStartValue" SG_ 1084 MRR_ObjRelAccelX_26 512;
BA_ "GenSigStartValue" SG_ 1084 MRR_ObjRelVelX_26 4102;
BA_ "GenSigStartValue" SG_ 1084 MRR_ObjRelVelY_26 4102;
BA_ "GenSigStartValue" SG_ 1084 MRR_ObjRelAccelY_26 512;
BA_ "GenSigStartValue" SG_ 1084 MRR_ObjRCS_26 400;
BA_ "GenSigStartValue" SG_ 1084 MRR_ObjMeasured_25 1;
BA_ "GenSigStartValue" SG_ 1084 MRR_ObjMeasured_26 1;
BA_ "GenSigStartValue" SG_ 1085 MRR_ObjDistY_27 1024;
BA_ "GenSigStartValue" SG_ 1085 MRR_ObjRelAccelX_27 512;
BA_ "GenSigStartValue" SG_ 1085 MRR_ObjRelVelX_27 4102;
BA_ "GenSigStartValue" SG_ 1085 MRR_ObjRelVelY_27 4102;
BA_ "GenSigStartValue" SG_ 1085 MRR_ObjRelAccelY_27 512;
BA_ "GenSigStartValue" SG_ 1085 MRR_ObjRCS_27 400;
BA_ "GenSigStartValue" SG_ 1085 MRR_ObjDistY_28 1024;
BA_ "GenSigStartValue" SG_ 1085 MRR_ObjRelAccelX_28 512;
BA_ "GenSigStartValue" SG_ 1085 MRR_ObjRelVelX_28 4102;
BA_ "GenSigStartValue" SG_ 1085 MRR_ObjRelVelY_28 4102;
BA_ "GenSigStartValue" SG_ 1085 MRR_ObjRelAccelY_28 512;
BA_ "GenSigStartValue" SG_ 1085 MRR_ObjRCS_28 400;
BA_ "GenSigStartValue" SG_ 1085 MRR_ObjMeasured_27 1;
BA_ "GenSigStartValue" SG_ 1085 MRR_ObjMeasured_28 1;
BA_ "GenSigStartValue" SG_ 1086 MRR_ObjDistY_29 1024;
BA_ "GenSigStartValue" SG_ 1086 MRR_ObjRelAccelX_29 512;
BA_ "GenSigStartValue" SG_ 1086 MRR_ObjRelVelX_29 4102;
BA_ "GenSigStartValue" SG_ 1086 MRR_ObjRelVelY_29 4102;
BA_ "GenSigStartValue" SG_ 1086 MRR_ObjRelAccelY_29 512;
BA_ "GenSigStartValue" SG_ 1086 MRR_ObjRCS_29 400;
BA_ "GenSigStartValue" SG_ 1086 MRR_ObjDistY_30 1024;
BA_ "GenSigStartValue" SG_ 1086 MRR_ObjRelAccelX_30 512;
BA_ "GenSigStartValue" SG_ 1086 MRR_ObjRelVelX_30 4102;
BA_ "GenSigStartValue" SG_ 1086 MRR_ObjRelVelY_30 4102;
BA_ "GenSigStartValue" SG_ 1086 MRR_ObjRelAccelY_30 512;
BA_ "GenSigStartValue" SG_ 1086 MRR_ObjRCS_30 400;
BA_ "GenSigStartValue" SG_ 1086 MRR_ObjMeasured_29 1;
BA_ "GenSigStartValue" SG_ 1086 MRR_ObjMeasured_30 1;
BA_ "GenSigStartValue" SG_ 1087 MRR_ObjDistY_31 1024;
BA_ "GenSigStartValue" SG_ 1087 MRR_ObjRelAccelX_31 512;
BA_ "GenSigStartValue" SG_ 1087 MRR_ObjRelVelX_31 4102;
BA_ "GenSigStartValue" SG_ 1087 MRR_ObjRelVelY_31 4102;
BA_ "GenSigStartValue" SG_ 1087 MRR_ObjRelAccelY_31 512;
BA_ "GenSigStartValue" SG_ 1087 MRR_ObjRCS_31 400;
BA_ "GenSigStartValue" SG_ 1087 MRR_ObjDistY_32 1024;
BA_ "GenSigStartValue" SG_ 1087 MRR_ObjRelAccelX_32 512;
BA_ "GenSigStartValue" SG_ 1087 MRR_ObjRelVelX_32 4102;
BA_ "GenSigStartValue" SG_ 1087 MRR_ObjRelVelY_32 4102;
BA_ "GenSigStartValue" SG_ 1087 MRR_ObjRelAccelY_32 512;
BA_ "GenSigStartValue" SG_ 1087 MRR_ObjRCS_32 400;
BA_ "GenSigStartValue" SG_ 1087 MRR_ObjMeasured_31 1;
BA_ "GenSigStartValue" SG_ 1087 MRR_ObjMeasured_32 1;
BA_ "GenSigStartValue" SG_ 1088 MRR_ObjDistY_33 1024;
BA_ "GenSigStartValue" SG_ 1088 MRR_ObjRelAccelX_33 512;
BA_ "GenSigStartValue" SG_ 1088 MRR_ObjRelVelX_33 4102;
BA_ "GenSigStartValue" SG_ 1088 MRR_ObjRelVelY_33 4102;
BA_ "GenSigStartValue" SG_ 1088 MRR_ObjRelAccelY_33 512;
BA_ "GenSigStartValue" SG_ 1088 MRR_ObjRCS_33 400;
BA_ "GenSigStartValue" SG_ 1088 MRR_ObjDistY_34 1024;
BA_ "GenSigStartValue" SG_ 1088 MRR_ObjRelAccelX_34 512;
BA_ "GenSigStartValue" SG_ 1088 MRR_ObjRelVelX_34 4102;
BA_ "GenSigStartValue" SG_ 1088 MRR_ObjRelVelY_34 4102;
BA_ "GenSigStartValue" SG_ 1088 MRR_ObjRelAccelY_34 512;
BA_ "GenSigStartValue" SG_ 1088 MRR_ObjRCS_34 400;
BA_ "GenSigStartValue" SG_ 1088 MRR_ObjMeasured_33 1;
BA_ "GenSigStartValue" SG_ 1088 MRR_ObjMeasured_34 1;
BA_ "GenSigStartValue" SG_ 1089 MRR_ObjDistY_35 1024;
BA_ "GenSigStartValue" SG_ 1089 MRR_ObjRelAccelX_35 512;
BA_ "GenSigStartValue" SG_ 1089 MRR_ObjRelVelX_35 4102;
BA_ "GenSigStartValue" SG_ 1089 MRR_ObjRelVelY_35 4102;
BA_ "GenSigStartValue" SG_ 1089 MRR_ObjRelAccelY_35 512;
BA_ "GenSigStartValue" SG_ 1089 MRR_ObjRCS_35 400;
BA_ "GenSigStartValue" SG_ 1089 MRR_ObjDistY_36 1024;
BA_ "GenSigStartValue" SG_ 1089 MRR_ObjRelAccelX_36 512;
BA_ "GenSigStartValue" SG_ 1089 MRR_ObjRelVelX_36 4102;
BA_ "GenSigStartValue" SG_ 1089 MRR_ObjRelVelY_36 4102;
BA_ "GenSigStartValue" SG_ 1089 MRR_ObjRelAccelY_36 512;
BA_ "GenSigStartValue" SG_ 1089 MRR_ObjRCS_36 400;
BA_ "GenSigStartValue" SG_ 1089 MRR_ObjMeasured_35 1;
BA_ "GenSigStartValue" SG_ 1089 MRR_ObjMeasured_36 1;
BA_ "GenSigStartValue" SG_ 1090 MRR_ObjDistY_37 1024;
BA_ "GenSigStartValue" SG_ 1090 MRR_ObjRelAccelX_37 512;
BA_ "GenSigStartValue" SG_ 1090 MRR_ObjRelVelX_37 4102;
BA_ "GenSigStartValue" SG_ 1090 MRR_ObjRelVelY_37 4102;
BA_ "GenSigStartValue" SG_ 1090 MRR_ObjRelAccelY_37 512;
BA_ "GenSigStartValue" SG_ 1090 MRR_ObjRCS_37 400;
BA_ "GenSigStartValue" SG_ 1090 MRR_ObjDistY_38 1024;
BA_ "GenSigStartValue" SG_ 1090 MRR_ObjRelAccelX_38 512;
BA_ "GenSigStartValue" SG_ 1090 MRR_ObjRelVelX_38 4102;
BA_ "GenSigStartValue" SG_ 1090 MRR_ObjRelVelY_38 4102;
BA_ "GenSigStartValue" SG_ 1090 MRR_ObjRelAccelY_38 512;
BA_ "GenSigStartValue" SG_ 1090 MRR_ObjRCS_38 400;
BA_ "GenSigStartValue" SG_ 1090 MRR_ObjMeasured_37 1;
BA_ "GenSigStartValue" SG_ 1090 MRR_ObjMeasured_38 1;
BA_ "GenSigStartValue" SG_ 1091 MRR_ObjDistY_39 1024;
BA_ "GenSigStartValue" SG_ 1091 MRR_ObjRelAccelX_39 512;
BA_ "GenSigStartValue" SG_ 1091 MRR_ObjRelVelX_39 4102;
BA_ "GenSigStartValue" SG_ 1091 MRR_ObjRelVelY_39 4102;
BA_ "GenSigStartValue" SG_ 1091 MRR_ObjRelAccelY_39 512;
BA_ "GenSigStartValue" SG_ 1091 MRR_ObjRCS_39 400;
BA_ "GenSigStartValue" SG_ 1091 MRR_ObjDistY_40 1024;
BA_ "GenSigStartValue" SG_ 1091 MRR_ObjRelAccelX_40 512;
BA_ "GenSigStartValue" SG_ 1091 MRR_ObjRelVelX_40 4102;
BA_ "GenSigStartValue" SG_ 1091 MRR_ObjRelVelY_40 4102;
BA_ "GenSigStartValue" SG_ 1091 MRR_ObjRelAccelY_40 512;
BA_ "GenSigStartValue" SG_ 1091 MRR_ObjRCS_40 400;
BA_ "GenSigStartValue" SG_ 1091 MRR_ObjMeasured_39 1;
BA_ "GenSigStartValue" SG_ 1091 MRR_ObjMeasured_40 1;
BA_ "GenSigStartValue" SG_ 1092 MRR_ObjDistY_41 1024;
BA_ "GenSigStartValue" SG_ 1092 MRR_ObjRelAccelX_41 512;
BA_ "GenSigStartValue" SG_ 1092 MRR_ObjRelVelX_41 4102;
BA_ "GenSigStartValue" SG_ 1092 MRR_ObjRelVelY_41 4102;
BA_ "GenSigStartValue" SG_ 1092 MRR_ObjRelAccelY_41 512;
BA_ "GenSigStartValue" SG_ 1092 MRR_ObjRCS_41 400;
BA_ "GenSigStartValue" SG_ 1092 MRR_ObjDistY_42 1024;
BA_ "GenSigStartValue" SG_ 1092 MRR_ObjRelAccelX_42 512;
BA_ "GenSigStartValue" SG_ 1092 MRR_ObjRelVelX_42 4102;
BA_ "GenSigStartValue" SG_ 1092 MRR_ObjRelVelY_42 4102;
BA_ "GenSigStartValue" SG_ 1092 MRR_ObjRelAccelY_42 512;
BA_ "GenSigStartValue" SG_ 1092 MRR_ObjRCS_42 400;
BA_ "GenSigStartValue" SG_ 1092 MRR_ObjMeasured_41 1;
BA_ "GenSigStartValue" SG_ 1092 MRR_ObjMeasured_42 1;
BA_ "GenSigStartValue" SG_ 1093 MRR_ObjDistY_43 1024;
BA_ "GenSigStartValue" SG_ 1093 MRR_ObjRelAccelX_43 512;
BA_ "GenSigStartValue" SG_ 1093 MRR_ObjRelVelX_43 4102;
BA_ "GenSigStartValue" SG_ 1093 MRR_ObjRelVelY_43 4102;
BA_ "GenSigStartValue" SG_ 1093 MRR_ObjRelAccelY_43 512;
BA_ "GenSigStartValue" SG_ 1093 MRR_ObjRCS_43 400;
BA_ "GenSigStartValue" SG_ 1093 MRR_ObjDistY_44 1024;
BA_ "GenSigStartValue" SG_ 1093 MRR_ObjRelAccelX_44 512;
BA_ "GenSigStartValue" SG_ 1093 MRR_ObjRelVelX_44 4102;
BA_ "GenSigStartValue" SG_ 1093 MRR_ObjRelVelY_44 4102;
BA_ "GenSigStartValue" SG_ 1093 MRR_ObjRelAccelY_44 512;
BA_ "GenSigStartValue" SG_ 1093 MRR_ObjRCS_44 400;
BA_ "GenSigStartValue" SG_ 1093 MRR_ObjMeasured_43 1;
BA_ "GenSigStartValue" SG_ 1093 MRR_ObjMeasured_44 1;
BA_ "GenSigStartValue" SG_ 1094 MRR_ObjDistY_45 1024;
BA_ "GenSigStartValue" SG_ 1094 MRR_ObjRelAccelX_45 512;
BA_ "GenSigStartValue" SG_ 1094 MRR_ObjRelVelX_45 4102;
BA_ "GenSigStartValue" SG_ 1094 MRR_ObjRelVelY_45 4102;
BA_ "GenSigStartValue" SG_ 1094 MRR_ObjRelAccelY_45 512;
BA_ "GenSigStartValue" SG_ 1094 MRR_ObjRCS_45 400;
BA_ "GenSigStartValue" SG_ 1094 MRR_ObjDistY_46 1024;
BA_ "GenSigStartValue" SG_ 1094 MRR_ObjRelAccelX_46 512;
BA_ "GenSigStartValue" SG_ 1094 MRR_ObjRelVelX_46 4102;
BA_ "GenSigStartValue" SG_ 1094 MRR_ObjRelVelY_46 4102;
BA_ "GenSigStartValue" SG_ 1094 MRR_ObjRelAccelY_46 512;
BA_ "GenSigStartValue" SG_ 1094 MRR_ObjRCS_46 400;
BA_ "GenSigStartValue" SG_ 1094 MRR_ObjMeasured_45 1;
BA_ "GenSigStartValue" SG_ 1094 MRR_ObjMeasured_46 1;
BA_ "GenSigStartValue" SG_ 1095 MRR_ObjDistY_47 1024;
BA_ "GenSigStartValue" SG_ 1095 MRR_ObjRelAccelX_47 512;
BA_ "GenSigStartValue" SG_ 1095 MRR_ObjRelVelX_47 4102;
BA_ "GenSigStartValue" SG_ 1095 MRR_ObjRelVelY_47 4102;
BA_ "GenSigStartValue" SG_ 1095 MRR_ObjRelAccelY_47 512;
BA_ "GenSigStartValue" SG_ 1095 MRR_ObjRCS_47 400;
BA_ "GenSigStartValue" SG_ 1095 MRR_ObjDistY_48 1024;
BA_ "GenSigStartValue" SG_ 1095 MRR_ObjRelAccelX_48 512;
BA_ "GenSigStartValue" SG_ 1095 MRR_ObjRelVelX_48 4102;
BA_ "GenSigStartValue" SG_ 1095 MRR_ObjRelVelY_48 4102;
BA_ "GenSigStartValue" SG_ 1095 MRR_ObjRelAccelY_48 512;
BA_ "GenSigStartValue" SG_ 1095 MRR_ObjRCS_48 400;
BA_ "GenSigStartValue" SG_ 1095 MRR_ObjMeasured_47 1;
BA_ "GenSigStartValue" SG_ 1095 MRR_ObjMeasured_48 1;
VAL_ 1065 FR_BLIND 0 "NoBlindness" 1 "Blindness" ;
VAL_ 1065 FR_hdr_ErrorStatus 0 "Noerror" 1 "NotDefined" 2 "Misalignmentelevation" 3 "Misalignmentazimuth" 4 "Temporaryfailure" 5 "Permanentfailure" 6 "Voltageerror" 7 "Productionmode" 8 "EOLerror" 9 "Calibrationparametererror" 10 "partnerECUsignalerror" ;
VAL_ 1072 MRR_ObjType_1 0 "Unknown" 1 "Truck" 2 "Car" 3 "Pedestrian" 4 "Cyclist" ;
VAL_ 1072 MRR_ObjMotionType_1 0 "Int" 1 "Unknown" 2 "Drive" 3 "Stopped" 4 "Stand" ;
VAL_ 1072 MRR_ObjMotionDirection_1 0 "Init" 1 "Inversedirection" 2 "Samedirection" 3 "Cross" ;
VAL_ 1072 MRR_ObjRefPoint_1 0 "Rear" 1 "Rearleft" 2 "Left" 3 "Frontleft" 4 "Front" 5 "FrontRight" 6 "Right" 7 "Rearright" ;
VAL_ 1072 MRR_ObjRefPoint_2 0 "Rear" 1 "Rearleft" 2 "Left" 3 "Frontleft" 4 "Front" 5 "FrontRight" 6 "Right" 7 "Rearright" ;
VAL_ 1072 MRR_ObjType_2 0 "Unknown" 1 "Truck" 2 "Car" 3 "Pedestrian" 4 "Cyclist" ;
VAL_ 1072 MRR_ObjMotionType_2 0 "Int" 1 "Unknown" 2 "Drive" 3 "Stopped" 4 "Stand" ;
VAL_ 1072 MRR_ObjMotionDirection_2 0 "Init" 1 "Inversedirection" 2 "Samedirection" 3 "Cross" ;
VAL_ 1072 MRR_ObjMeasured_1 0 "Init" 1 "Measured" 2 "Predicted" ;
VAL_ 1072 MRR_ObjMeasured_2 0 "Init" 1 "Measured" 2 "Predicted" ;
VAL_ 1072 MRR_ObjValid_1 0 "Validvalues" 1 "invalidvalues" ;
VAL_ 1072 MRR_ObjValid_2 0 "Validvalues" 1 "invalidvalues" ;
VAL_ 1073 MRR_ObjType_3 0 "Unknown" 1 "Truck" 2 "Car" 3 "Pedestrian" 4 "Cyclist" ;
VAL_ 1073 MRR_ObjMotionType_3 0 "Int" 1 "Unknown" 2 "Drive" 3 "Stopped" 4 "Stand" ;
VAL_ 1073 MRR_ObjMotionDirection_3 0 "Init" 1 "Inversedirection" 2 "Samedirection" 3 "Cross" ;
VAL_ 1073 MRR_ObjRefPoint_3 0 "Rear" 1 "Rearleft" 2 "Left" 3 "Frontleft" 4 "Front" 5 "FrontRight" 6 "Right" 7 "Rearright" ;
VAL_ 1073 MRR_ObjRefPoint_4 0 "Rear" 1 "Rearleft" 2 "Left" 3 "Frontleft" 4 "Front" 5 "FrontRight" 6 "Right" 7 "Rearright" ;
VAL_ 1073 MRR_ObjType_4 0 "Unknown" 1 "Truck" 2 "Car" 3 "Pedestrian" 4 "Cyclist" ;
VAL_ 1073 MRR_ObjMotionType_4 0 "Int" 1 "Unknown" 2 "Drive" 3 "Stopped" 4 "Stand" ;
VAL_ 1073 MRR_ObjMotionDirection_4 0 "Init" 1 "Inversedirection" 2 "Samedirection" 3 "Cross" ;
VAL_ 1073 MRR_ObjMeasured_3 0 "Init" 1 "Measured" 2 "Predicted" ;
VAL_ 1073 MRR_ObjMeasured_4 0 "Init" 1 "Measured" 2 "Predicted" ;
VAL_ 1073 MRR_ObjValid_3 0 "Validvalues" 1 "invalidvalues" ;
VAL_ 1073 MRR_ObjValid_4 0 "Validvalues" 1 "invalidvalues" ;
VAL_ 1074 MRR_ObjType_5 0 "Unknown" 1 "Truck" 2 "Car" 3 "Pedestrian" 4 "Cyclist" ;
VAL_ 1074 MRR_ObjMotionType_5 0 "Int" 1 "Unknown" 2 "Drive" 3 "Stopped" 4 "Stand" ;
VAL_ 1074 MRR_ObjMotionDirection_5 0 "Init" 1 "Inversedirection" 2 "Samedirection" 3 "Cross" ;
VAL_ 1074 MRR_ObjRefPoint_5 0 "Rear" 1 "Rearleft" 2 "Left" 3 "Frontleft" 4 "Front" 5 "FrontRight" 6 "Right" 7 "Rearright" ;
VAL_ 1074 MRR_ObjRefPoint_6 0 "Rear" 1 "Rearleft" 2 "Left" 3 "Frontleft" 4 "Front" 5 "FrontRight" 6 "Right" 7 "Rearright" ;
VAL_ 1074 MRR_ObjType_6 0 "Unknown" 1 "Truck" 2 "Car" 3 "Pedestrian" 4 "Cyclist" ;
VAL_ 1074 MRR_ObjMotionType_6 0 "Int" 1 "Unknown" 2 "Drive" 3 "Stopped" 4 "Stand" ;
VAL_ 1074 MRR_ObjMotionDirection_6 0 "Init" 1 "Inversedirection" 2 "Samedirection" 3 "Cross" ;
VAL_ 1074 MRR_ObjMeasured_5 0 "Init" 1 "Measured" 2 "Predicted" ;
VAL_ 1074 MRR_ObjMeasured_6 0 "Init" 1 "Measured" 2 "Predicted" ;
VAL_ 1074 MRR_ObjValid_5 0 "Validvalues" 1 "invalidvalues" ;
VAL_ 1074 MRR_ObjValid_6 0 "Validvalues" 1 "invalidvalues" ;
VAL_ 1075 MRR_ObjType_7 0 "Unknown" 1 "Truck" 2 "Car" 3 "Pedestrian" 4 "Cyclist" ;
VAL_ 1075 MRR_ObjMotionType_7 0 "Int" 1 "Unknown" 2 "Drive" 3 "Stopped" 4 "Stand" ;
VAL_ 1075 MRR_ObjMotionDirection_7 0 "Init" 1 "Inversedirection" 2 "Samedirection" 3 "Cross" ;
VAL_ 1075 MRR_ObjRefPoint_7 0 "Rear" 1 "Rearleft" 2 "Left" 3 "Frontleft" 4 "Front" 5 "FrontRight" 6 "Right" 7 "Rearright" ;
VAL_ 1075 MRR_ObjRefPoint_8 0 "Rear" 1 "Rearleft" 2 "Left" 3 "Frontleft" 4 "Front" 5 "FrontRight" 6 "Right" 7 "Rearright" ;
VAL_ 1075 MRR_ObjType_8 0 "Unknown" 1 "Truck" 2 "Car" 3 "Pedestrian" 4 "Cyclist" ;
VAL_ 1075 MRR_ObjMotionType_8 0 "Int" 1 "Unknown" 2 "Drive" 3 "Stopped" 4 "Stand" ;
VAL_ 1075 MRR_ObjMotionDirection_8 0 "Init" 1 "Inversedirection" 2 "Samedirection" 3 "Cross" ;
VAL_ 1075 MRR_ObjMeasured_7 0 "Init" 1 "Measured" 2 "Predicted" ;
VAL_ 1075 MRR_ObjMeasured_8 0 "Init" 1 "Measured" 2 "Predicted" ;
VAL_ 1075 MRR_ObjValid_7 0 "Validvalues" 1 "invalidvalues" ;
VAL_ 1075 MRR_ObjValid_8 0 "Validvalues" 1 "invalidvalues" ;
VAL_ 1076 MRR_ObjType_9 0 "Unknown" 1 "Truck" 2 "Car" 3 "Pedestrian" 4 "Cyclist" ;
VAL_ 1076 MRR_ObjMotionType_9 0 "Int" 1 "Unknown" 2 "Drive" 3 "Stopped" 4 "Stand" ;
VAL_ 1076 MRR_ObjMotionDirection_9 0 "Init" 1 "Inversedirection" 2 "Samedirection" 3 "Cross" ;
VAL_ 1076 MRR_ObjRefPoint_9 0 "Rear" 1 "Rearleft" 2 "Left" 3 "Frontleft" 4 "Front" 5 "FrontRight" 6 "Right" 7 "Rearright" ;
VAL_ 1076 MRR_ObjRefPoint_10 0 "Rear" 1 "Rearleft" 2 "Left" 3 "Frontleft" 4 "Front" 5 "FrontRight" 6 "Right" 7 "Rearright" ;
VAL_ 1076 MRR_ObjType_10 0 "Unknown" 1 "Truck" 2 "Car" 3 "Pedestrian" 4 "Cyclist" ;
VAL_ 1076 MRR_ObjMotionType_10 0 "Int" 1 "Unknown" 2 "Drive" 3 "Stopped" 4 "Stand" ;
VAL_ 1076 MRR_ObjMotionDirection_10 0 "Init" 1 "Inversedirection" 2 "Samedirection" 3 "Cross" ;
VAL_ 1076 MRR_ObjMeasured_9 0 "Init" 1 "Measured" 2 "Predicted" ;
VAL_ 1076 MRR_ObjMeasured_10 0 "Init" 1 "Measured" 2 "Predicted" ;
VAL_ 1076 MRR_ObjValid_9 0 "Validvalues" 1 "invalidvalues" ;
VAL_ 1076 MRR_ObjValid_10 0 "Validvalues" 1 "invalidvalues" ;
VAL_ 1077 MRR_ObjType_11 0 "Unknown" 1 "Truck" 2 "Car" 3 "Pedestrian" 4 "Cyclist" ;
VAL_ 1077 MRR_ObjMotionType_11 0 "Int" 1 "Unknown" 2 "Drive" 3 "Stopped" 4 "Stand" ;
VAL_ 1077 MRR_ObjMotionDirection_11 0 "Init" 1 "Inversedirection" 2 "Samedirection" 3 "Cross" ;
VAL_ 1077 MRR_ObjRefPoint_11 0 "Rear" 1 "Rearleft" 2 "Left" 3 "Frontleft" 4 "Front" 5 "FrontRight" 6 "Right" 7 "Rearright" ;
VAL_ 1077 MRR_ObjRefPoint_12 0 "Rear" 1 "Rearleft" 2 "Left" 3 "Frontleft" 4 "Front" 5 "FrontRight" 6 "Right" 7 "Rearright" ;
VAL_ 1077 MRR_ObjType_12 0 "Unknown" 1 "Truck" 2 "Car" 3 "Pedestrian" 4 "Cyclist" ;
VAL_ 1077 MRR_ObjMotionType_12 0 "Int" 1 "Unknown" 2 "Drive" 3 "Stopped" 4 "Stand" ;
VAL_ 1077 MRR_ObjMotionDirection_12 0 "Init" 1 "Inversedirection" 2 "Samedirection" 3 "Cross" ;
VAL_ 1077 MRR_ObjMeasured_11 0 "Init" 1 "Measured" 2 "Predicted" ;
VAL_ 1077 MRR_ObjMeasured_12 0 "Init" 1 "Measured" 2 "Predicted" ;
VAL_ 1077 MRR_ObjValid_11 0 "Validvalues" 1 "invalidvalues" ;
VAL_ 1077 MRR_ObjValid_12 0 "Validvalues" 1 "invalidvalues" ;
VAL_ 1078 MRR_ObjType_13 0 "Unknown" 1 "Truck" 2 "Car" 3 "Pedestrian" 4 "Cyclist" ;
VAL_ 1078 MRR_ObjMotionType_13 0 "Int" 1 "Unknown" 2 "Drive" 3 "Stopped" 4 "Stand" ;
VAL_ 1078 MRR_ObjMotionDirection_13 0 "Init" 1 "Inversedirection" 2 "Samedirection" 3 "Cross" ;
VAL_ 1078 MRR_ObjRefPoint_13 0 "Rear" 1 "Rearleft" 2 "Left" 3 "Frontleft" 4 "Front" 5 "FrontRight" 6 "Right" 7 "Rearright" ;
VAL_ 1078 MRR_ObjRefPoint_14 0 "Rear" 1 "Rearleft" 2 "Left" 3 "Frontleft" 4 "Front" 5 "FrontRight" 6 "Right" 7 "Rearright" ;
VAL_ 1078 MRR_ObjType_14 0 "Unknown" 1 "Truck" 2 "Car" 3 "Pedestrian" 4 "Cyclist" ;
VAL_ 1078 MRR_ObjMotionType_14 0 "Int" 1 "Unknown" 2 "Drive" 3 "Stopped" 4 "Stand" ;
VAL_ 1078 MRR_ObjMotionDirection_14 0 "Init" 1 "Inversedirection" 2 "Samedirection" 3 "Cross" ;
VAL_ 1078 MRR_ObjMeasured_13 0 "Init" 1 "Measured" 2 "Predicted" ;
VAL_ 1078 MRR_ObjMeasured_14 0 "Init" 1 "Measured" 2 "Predicted" ;
VAL_ 1078 MRR_ObjValid_13 0 "Validvalues" 1 "invalidvalues" ;
VAL_ 1078 MRR_ObjValid_14 0 "Validvalues" 1 "invalidvalues" ;
VAL_ 1079 MRR_ObjType_15 0 "Unknown" 1 "Truck" 2 "Car" 3 "Pedestrian" 4 "Cyclist" ;
VAL_ 1079 MRR_ObjMotionType_15 0 "Int" 1 "Unknown" 2 "Drive" 3 "Stopped" 4 "Stand" ;
VAL_ 1079 MRR_ObjMotionDirection_15 0 "Init" 1 "Inversedirection" 2 "Samedirection" 3 "Cross" ;
VAL_ 1079 MRR_ObjRefPoint_15 0 "Rear" 1 "Rearleft" 2 "Left" 3 "Frontleft" 4 "Front" 5 "FrontRight" 6 "Right" 7 "Rearright" ;
VAL_ 1079 MRR_ObjRefPoint_16 0 "Rear" 1 "Rearleft" 2 "Left" 3 "Frontleft" 4 "Front" 5 "FrontRight" 6 "Right" 7 "Rearright" ;
VAL_ 1079 MRR_ObjType_16 0 "Unknown" 1 "Truck" 2 "Car" 3 "Pedestrian" 4 "Cyclist" ;
VAL_ 1079 MRR_ObjMotionType_16 0 "Int" 1 "Unknown" 2 "Drive" 3 "Stopped" 4 "Stand" ;
VAL_ 1079 MRR_ObjMotionDirection_16 0 "Init" 1 "Inversedirection" 2 "Samedirection" 3 "Cross" ;
VAL_ 1079 MRR_ObjMeasured_15 0 "Init" 1 "Measured" 2 "Predicted" ;
VAL_ 1079 MRR_ObjMeasured_16 0 "Init" 1 "Measured" 2 "Predicted" ;
VAL_ 1079 MRR_ObjValid_15 0 "Validvalues" 1 "invalidvalues" ;
VAL_ 1079 MRR_ObjValid_16 0 "Validvalues" 1 "invalidvalues" ;
VAL_ 1080 MRR_ObjType_17 0 "Unknown" 1 "Truck" 2 "Car" 3 "Pedestrian" 4 "Cyclist" ;
VAL_ 1080 MRR_ObjMotionType_17 0 "Int" 1 "Unknown" 2 "Drive" 3 "Stopped" 4 "Stand" ;
VAL_ 1080 MRR_ObjMotionDirection_17 0 "Init" 1 "Inversedirection" 2 "Samedirection" 3 "Cross" ;
VAL_ 1080 MRR_ObjRefPoint_17 0 "Rear" 1 "Rearleft" 2 "Left" 3 "Frontleft" 4 "Front" 5 "FrontRight" 6 "Right" 7 "Rearright" ;
VAL_ 1080 MRR_ObjRefPoint_18 0 "Rear" 1 "Rearleft" 2 "Left" 3 "Frontleft" 4 "Front" 5 "FrontRight" 6 "Right" 7 "Rearright" ;
VAL_ 1080 MRR_ObjType_18 0 "Unknown" 1 "Truck" 2 "Car" 3 "Pedestrian" 4 "Cyclist" ;
VAL_ 1080 MRR_ObjMotionType_18 0 "Int" 1 "Unknown" 2 "Drive" 3 "Stopped" 4 "Stand" ;
VAL_ 1080 MRR_ObjMotionDirection_18 0 "Init" 1 "Inversedirection" 2 "Samedirection" 3 "Cross" ;
VAL_ 1080 MRR_ObjMeasured_17 0 "Init" 1 "Measured" 2 "Predicted" ;
VAL_ 1080 MRR_ObjMeasured_18 0 "Init" 1 "Measured" 2 "Predicted" ;
VAL_ 1080 MRR_ObjValid_17 0 "Validvalues" 1 "invalidvalues" ;
VAL_ 1080 MRR_ObjValid_18 0 "Validvalues" 1 "invalidvalues" ;
VAL_ 1081 MRR_ObjType_19 0 "Unknown" 1 "Truck" 2 "Car" 3 "Pedestrian" 4 "Cyclist" ;
VAL_ 1081 MRR_ObjMotionType_19 0 "Int" 1 "Unknown" 2 "Drive" 3 "Stopped" 4 "Stand" ;
VAL_ 1081 MRR_ObjMotionDirection_19 0 "Init" 1 "Inversedirection" 2 "Samedirection" 3 "Cross" ;
VAL_ 1081 MRR_ObjRefPoint_19 0 "Rear" 1 "Rearleft" 2 "Left" 3 "Frontleft" 4 "Front" 5 "FrontRight" 6 "Right" 7 "Rearright" ;
VAL_ 1081 MRR_ObjRefPoint_20 0 "Rear" 1 "Rearleft" 2 "Left" 3 "Frontleft" 4 "Front" 5 "FrontRight" 6 "Right" 7 "Rearright" ;
VAL_ 1081 MRR_ObjType_20 0 "Unknown" 1 "Truck" 2 "Car" 3 "Pedestrian" 4 "Cyclist" ;
VAL_ 1081 MRR_ObjMotionType_20 0 "Int" 1 "Unknown" 2 "Drive" 3 "Stopped" 4 "Stand" ;
VAL_ 1081 MRR_ObjMotionDirection_20 0 "Init" 1 "Inversedirection" 2 "Samedirection" 3 "Cross" ;
VAL_ 1081 MRR_ObjMeasured_19 0 "Init" 1 "Measured" 2 "Predicted" ;
VAL_ 1081 MRR_ObjMeasured_20 0 "Init" 1 "Measured" 2 "Predicted" ;
VAL_ 1081 MRR_ObjValid_19 0 "Validvalues" 1 "invalidvalues" ;
VAL_ 1081 MRR_ObjValid_20 0 "Validvalues" 1 "invalidvalues" ;
VAL_ 1082 MRR_ObjType_21 0 "Unknown" 1 "Truck" 2 "Car" 3 "Pedestrian" 4 "Cyclist" ;
VAL_ 1082 MRR_ObjMotionType_21 0 "Int" 1 "Unknown" 2 "Drive" 3 "Stopped" 4 "Stand" ;
VAL_ 1082 MRR_ObjMotionDirection_21 0 "Init" 1 "Inversedirection" 2 "Samedirection" 3 "Cross" ;
VAL_ 1082 MRR_ObjRefPoint_21 0 "Rear" 1 "Rearleft" 2 "Left" 3 "Frontleft" 4 "Front" 5 "FrontRight" 6 "Right" 7 "Rearright" ;
VAL_ 1082 MRR_ObjRefPoint_22 0 "Rear" 1 "Rearleft" 2 "Left" 3 "Frontleft" 4 "Front" 5 "FrontRight" 6 "Right" 7 "Rearright" ;
VAL_ 1082 MRR_ObjType_22 0 "Unknown" 1 "Truck" 2 "Car" 3 "Pedestrian" 4 "Cyclist" ;
VAL_ 1082 MRR_ObjMotionType_22 0 "Int" 1 "Unknown" 2 "Drive" 3 "Stopped" 4 "Stand" ;
VAL_ 1082 MRR_ObjMotionDirection_22 0 "Init" 1 "Inversedirection" 2 "Samedirection" 3 "Cross" ;
VAL_ 1082 MRR_ObjMeasured_21 0 "Init" 1 "Measured" 2 "Predicted" ;
VAL_ 1082 MRR_ObjMeasured_22 0 "Init" 1 "Measured" 2 "Predicted" ;
VAL_ 1082 MRR_ObjValid_21 0 "Validvalues" 1 "invalidvalues" ;
VAL_ 1082 MRR_ObjValid_22 0 "Validvalues" 1 "invalidvalues" ;
VAL_ 1083 MRR_ObjType_23 0 "Unknown" 1 "Truck" 2 "Car" 3 "Pedestrian" 4 "Cyclist" ;
VAL_ 1083 MRR_ObjMotionType_23 0 "Int" 1 "Unknown" 2 "Drive" 3 "Stopped" 4 "Stand" ;
VAL_ 1083 MRR_ObjMotionDirection_23 0 "Init" 1 "Inversedirection" 2 "Samedirection" 3 "Cross" ;
VAL_ 1083 MRR_ObjRefPoint_23 0 "Rear" 1 "Rearleft" 2 "Left" 3 "Frontleft" 4 "Front" 5 "FrontRight" 6 "Right" 7 "Rearright" ;
VAL_ 1083 MRR_ObjRefPoint_24 0 "Rear" 1 "Rearleft" 2 "Left" 3 "Frontleft" 4 "Front" 5 "FrontRight" 6 "Right" 7 "Rearright" ;
VAL_ 1083 MRR_ObjType_24 0 "Unknown" 1 "Truck" 2 "Car" 3 "Pedestrian" 4 "Cyclist" ;
VAL_ 1083 MRR_ObjMotionType_24 0 "Int" 1 "Unknown" 2 "Drive" 3 "Stopped" 4 "Stand" ;
VAL_ 1083 MRR_ObjMotionDirection_24 0 "Init" 1 "Inversedirection" 2 "Samedirection" 3 "Cross" ;
VAL_ 1083 MRR_ObjMeasured_23 0 "Init" 1 "Measured" 2 "Predicted" ;
VAL_ 1083 MRR_ObjMeasured_24 0 "Init" 1 "Measured" 2 "Predicted" ;
VAL_ 1083 MRR_ObjValid_23 0 "Validvalues" 1 "invalidvalues" ;
VAL_ 1083 MRR_ObjValid_24 0 "Validvalues" 1 "invalidvalues" ;
VAL_ 1084 MRR_ObjType_25 0 "Unknown" 1 "Truck" 2 "Car" 3 "Pedestrian" 4 "Cyclist" ;
VAL_ 1084 MRR_ObjMotionType_25 0 "Int" 1 "Unknown" 2 "Drive" 3 "Stopped" 4 "Stand" ;
VAL_ 1084 MRR_ObjMotionDirection_25 0 "Init" 1 "Inversedirection" 2 "Samedirection" 3 "Cross" ;
VAL_ 1084 MRR_ObjRefPoint_25 0 "Rear" 1 "Rearleft" 2 "Left" 3 "Frontleft" 4 "Front" 5 "FrontRight" 6 "Right" 7 "Rearright" ;
VAL_ 1084 MRR_ObjRefPoint_26 0 "Rear" 1 "Rearleft" 2 "Left" 3 "Frontleft" 4 "Front" 5 "FrontRight" 6 "Right" 7 "Rearright" ;
VAL_ 1084 MRR_ObjType_26 0 "Unknown" 1 "Truck" 2 "Car" 3 "Pedestrian" 4 "Cyclist" ;
VAL_ 1084 MRR_ObjMotionType_26 0 "Int" 1 "Unknown" 2 "Drive" 3 "Stopped" 4 "Stand" ;
VAL_ 1084 MRR_ObjMotionDirection_26 0 "Init" 1 "Inversedirection" 2 "Samedirection" 3 "Cross" ;
VAL_ 1084 MRR_ObjMeasured_25 0 "Init" 1 "Measured" 2 "Predicted" ;
VAL_ 1084 MRR_ObjMeasured_26 0 "Init" 1 "Measured" 2 "Predicted" ;
VAL_ 1084 MRR_ObjValid_25 0 "Validvalues" 1 "invalidvalues" ;
VAL_ 1084 MRR_ObjValid_26 0 "Validvalues" 1 "invalidvalues" ;
VAL_ 1085 MRR_ObjType_27 0 "Unknown" 1 "Truck" 2 "Car" 3 "Pedestrian" 4 "Cyclist" ;
VAL_ 1085 MRR_ObjMotionType_27 0 "Int" 1 "Unknown" 2 "Drive" 3 "Stopped" 4 "Stand" ;
VAL_ 1085 MRR_ObjMotionDirection_27 0 "Init" 1 "Inversedirection" 2 "Samedirection" 3 "Cross" ;
VAL_ 1085 MRR_ObjRefPoint_27 0 "Rear" 1 "Rearleft" 2 "Left" 3 "Frontleft" 4 "Front" 5 "FrontRight" 6 "Right" 7 "Rearright" ;
VAL_ 1085 MRR_ObjRefPoint_28 0 "Rear" 1 "Rearleft" 2 "Left" 3 "Frontleft" 4 "Front" 5 "FrontRight" 6 "Right" 7 "Rearright" ;
VAL_ 1085 MRR_ObjType_28 0 "Unknown" 1 "Truck" 2 "Car" 3 "Pedestrian" 4 "Cyclist" ;
VAL_ 1085 MRR_ObjMotionType_28 0 "Int" 1 "Unknown" 2 "Drive" 3 "Stopped" 4 "Stand" ;
VAL_ 1085 MRR_ObjMotionDirection_28 0 "Init" 1 "Inversedirection" 2 "Samedirection" 3 "Cross" ;
VAL_ 1085 MRR_ObjMeasured_27 0 "Init" 1 "Measured" 2 "Predicted" ;
VAL_ 1085 MRR_ObjMeasured_28 0 "Init" 1 "Measured" 2 "Predicted" ;
VAL_ 1085 MRR_ObjValid_27 0 "Validvalues" 1 "invalidvalues" ;
VAL_ 1085 MRR_ObjValid_28 0 "Validvalues" 1 "invalidvalues" ;
VAL_ 1086 MRR_ObjType_29 0 "Unknown" 1 "Truck" 2 "Car" 3 "Pedestrian" 4 "Cyclist" ;
VAL_ 1086 MRR_ObjMotionType_29 0 "Int" 1 "Unknown" 2 "Drive" 3 "Stopped" 4 "Stand" ;
VAL_ 1086 MRR_ObjMotionDirection_29 0 "Init" 1 "Inversedirection" 2 "Samedirection" 3 "Cross" ;
VAL_ 1086 MRR_ObjRefPoint_29 0 "Rear" 1 "Rearleft" 2 "Left" 3 "Frontleft" 4 "Front" 5 "FrontRight" 6 "Right" 7 "Rearright" ;
VAL_ 1086 MRR_ObjRefPoint_30 0 "Rear" 1 "Rearleft" 2 "Left" 3 "Frontleft" 4 "Front" 5 "FrontRight" 6 "Right" 7 "Rearright" ;
VAL_ 1086 MRR_ObjType_30 0 "Unknown" 1 "Truck" 2 "Car" 3 "Pedestrian" 4 "Cyclist" ;
VAL_ 1086 MRR_ObjMotionType_30 0 "Int" 1 "Unknown" 2 "Drive" 3 "Stopped" 4 "Stand" ;
VAL_ 1086 MRR_ObjMotionDirection_30 0 "Init" 1 "Inversedirection" 2 "Samedirection" 3 "Cross" ;
VAL_ 1086 MRR_ObjMeasured_29 0 "Init" 1 "Measured" 2 "Predicted" ;
VAL_ 1086 MRR_ObjMeasured_30 0 "Init" 1 "Measured" 2 "Predicted" ;
VAL_ 1086 MRR_ObjValid_29 0 "Validvalues" 1 "invalidvalues" ;
VAL_ 1086 MRR_ObjValid_30 0 "Validvalues" 1 "invalidvalues" ;
VAL_ 1087 MRR_ObjType_31 0 "Unknown" 1 "Truck" 2 "Car" 3 "Pedestrian" 4 "Cyclist" ;
VAL_ 1087 MRR_ObjMotionType_31 0 "Int" 1 "Unknown" 2 "Drive" 3 "Stopped" 4 "Stand" ;
VAL_ 1087 MRR_ObjMotionDirection_31 0 "Init" 1 "Inversedirection" 2 "Samedirection" 3 "Cross" ;
VAL_ 1087 MRR_ObjRefPoint_31 0 "Rear" 1 "Rearleft" 2 "Left" 3 "Frontleft" 4 "Front" 5 "FrontRight" 6 "Right" 7 "Rearright" ;
VAL_ 1087 MRR_ObjRefPoint_32 0 "Rear" 1 "Rearleft" 2 "Left" 3 "Frontleft" 4 "Front" 5 "FrontRight" 6 "Right" 7 "Rearright" ;
VAL_ 1087 MRR_ObjType_32 0 "Unknown" 1 "Truck" 2 "Car" 3 "Pedestrian" 4 "Cyclist" ;
VAL_ 1087 MRR_ObjMotionType_32 0 "Int" 1 "Unknown" 2 "Drive" 3 "Stopped" 4 "Stand" ;
VAL_ 1087 MRR_ObjMotionDirection_32 0 "Init" 1 "Inversedirection" 2 "Samedirection" 3 "Cross" ;
VAL_ 1087 MRR_ObjMeasured_31 0 "Init" 1 "Measured" 2 "Predicted" ;
VAL_ 1087 MRR_ObjMeasured_32 0 "Init" 1 "Measured" 2 "Predicted" ;
VAL_ 1087 MRR_ObjValid_31 0 "Validvalues" 1 "invalidvalues" ;
VAL_ 1087 MRR_ObjValid_32 0 "Validvalues" 1 "invalidvalues" ;
VAL_ 1088 MRR_ObjType_33 0 "Unknown" 1 "Truck" 2 "Car" 3 "Pedestrian" 4 "Cyclist" ;
VAL_ 1088 MRR_ObjMotionType_33 0 "Int" 1 "Unknown" 2 "Drive" 3 "Stopped" 4 "Stand" ;
VAL_ 1088 MRR_ObjMotionDirection_33 0 "Init" 1 "Inversedirection" 2 "Samedirection" 3 "Cross" ;
VAL_ 1088 MRR_ObjRefPoint_33 0 "Rear" 1 "Rearleft" 2 "Left" 3 "Frontleft" 4 "Front" 5 "FrontRight" 6 "Right" 7 "Rearright" ;
VAL_ 1088 MRR_ObjRefPoint_34 0 "Rear" 1 "Rearleft" 2 "Left" 3 "Frontleft" 4 "Front" 5 "FrontRight" 6 "Right" 7 "Rearright" ;
VAL_ 1088 MRR_ObjType_34 0 "Unknown" 1 "Truck" 2 "Car" 3 "Pedestrian" 4 "Cyclist" ;
VAL_ 1088 MRR_ObjMotionType_34 0 "Int" 1 "Unknown" 2 "Drive" 3 "Stopped" 4 "Stand" ;
VAL_ 1088 MRR_ObjMotionDirection_34 0 "Init" 1 "Inversedirection" 2 "Samedirection" 3 "Cross" ;
VAL_ 1088 MRR_ObjMeasured_33 0 "Init" 1 "Measured" 2 "Predicted" ;
VAL_ 1088 MRR_ObjMeasured_34 0 "Init" 1 "Measured" 2 "Predicted" ;
VAL_ 1088 MRR_ObjValid_33 0 "Validvalues" 1 "invalidvalues" ;
VAL_ 1088 MRR_ObjValid_34 0 "Validvalues" 1 "invalidvalues" ;
VAL_ 1089 MRR_ObjType_35 0 "Unknown" 1 "Truck" 2 "Car" 3 "Pedestrian" 4 "Cyclist" ;
VAL_ 1089 MRR_ObjMotionType_35 0 "Int" 1 "Unknown" 2 "Drive" 3 "Stopped" 4 "Stand" ;
VAL_ 1089 MRR_ObjMotionDirection_35 0 "Init" 1 "Inversedirection" 2 "Samedirection" 3 "Cross" ;
VAL_ 1089 MRR_ObjRefPoint_35 0 "Rear" 1 "Rearleft" 2 "Left" 3 "Frontleft" 4 "Front" 5 "FrontRight" 6 "Right" 7 "Rearright" ;
VAL_ 1089 MRR_ObjRefPoint_36 0 "Rear" 1 "Rearleft" 2 "Left" 3 "Frontleft" 4 "Front" 5 "FrontRight" 6 "Right" 7 "Rearright" ;
VAL_ 1089 MRR_ObjType_36 0 "Unknown" 1 "Truck" 2 "Car" 3 "Pedestrian" 4 "Cyclist" ;
VAL_ 1089 MRR_ObjMotionType_36 0 "Int" 1 "Unknown" 2 "Drive" 3 "Stopped" 4 "Stand" ;
VAL_ 1089 MRR_ObjMotionDirection_36 0 "Init" 1 "Inversedirection" 2 "Samedirection" 3 "Cross" ;
VAL_ 1089 MRR_ObjMeasured_35 0 "Init" 1 "Measured" 2 "Predicted" ;
VAL_ 1089 MRR_ObjMeasured_36 0 "Init" 1 "Measured" 2 "Predicted" ;
VAL_ 1089 MRR_ObjValid_35 0 "Validvalues" 1 "invalidvalues" ;
VAL_ 1089 MRR_ObjValid_36 0 "Validvalues" 1 "invalidvalues" ;
VAL_ 1090 MRR_ObjType_37 0 "Unknown" 1 "Truck" 2 "Car" 3 "Pedestrian" 4 "Cyclist" ;
VAL_ 1090 MRR_ObjMotionType_37 0 "Int" 1 "Unknown" 2 "Drive" 3 "Stopped" 4 "Stand" ;
VAL_ 1090 MRR_ObjMotionDirection_37 0 "Init" 1 "Inversedirection" 2 "Samedirection" 3 "Cross" ;
VAL_ 1090 MRR_ObjRefPoint_37 0 "Rear" 1 "Rearleft" 2 "Left" 3 "Frontleft" 4 "Front" 5 "FrontRight" 6 "Right" 7 "Rearright" ;
VAL_ 1090 MRR_ObjRefPoint_38 0 "Rear" 1 "Rearleft" 2 "Left" 3 "Frontleft" 4 "Front" 5 "FrontRight" 6 "Right" 7 "Rearright" ;
VAL_ 1090 MRR_ObjType_38 0 "Unknown" 1 "Truck" 2 "Car" 3 "Pedestrian" 4 "Cyclist" ;
VAL_ 1090 MRR_ObjMotionType_38 0 "Int" 1 "Unknown" 2 "Drive" 3 "Stopped" 4 "Stand" ;
VAL_ 1090 MRR_ObjMotionDirection_38 0 "Init" 1 "Inversedirection" 2 "Samedirection" 3 "Cross" ;
VAL_ 1090 MRR_ObjMeasured_37 0 "Init" 1 "Measured" 2 "Predicted" ;
VAL_ 1090 MRR_ObjMeasured_38 0 "Init" 1 "Measured" 2 "Predicted" ;
VAL_ 1090 MRR_ObjValid_37 0 "Validvalues" 1 "invalidvalues" ;
VAL_ 1090 MRR_ObjValid_38 0 "Validvalues" 1 "invalidvalues" ;
VAL_ 1091 MRR_ObjType_39 0 "Unknown" 1 "Truck" 2 "Car" 3 "Pedestrian" 4 "Cyclist" ;
VAL_ 1091 MRR_ObjMotionType_39 0 "Int" 1 "Unknown" 2 "Drive" 3 "Stopped" 4 "Stand" ;
VAL_ 1091 MRR_ObjMotionDirection_39 0 "Init" 1 "Inversedirection" 2 "Samedirection" 3 "Cross" ;
VAL_ 1091 MRR_ObjRefPoint_39 0 "Rear" 1 "Rearleft" 2 "Left" 3 "Frontleft" 4 "Front" 5 "FrontRight" 6 "Right" 7 "Rearright" ;
VAL_ 1091 MRR_ObjRefPoint_40 0 "Rear" 1 "Rearleft" 2 "Left" 3 "Frontleft" 4 "Front" 5 "FrontRight" 6 "Right" 7 "Rearright" ;
VAL_ 1091 MRR_ObjType_40 0 "Unknown" 1 "Truck" 2 "Car" 3 "Pedestrian" 4 "Cyclist" ;
VAL_ 1091 MRR_ObjMotionType_40 0 "Int" 1 "Unknown" 2 "Drive" 3 "Stopped" 4 "Stand" ;
VAL_ 1091 MRR_ObjMotionDirection_40 0 "Init" 1 "Inversedirection" 2 "Samedirection" 3 "Cross" ;
VAL_ 1091 MRR_ObjMeasured_39 0 "Init" 1 "Measured" 2 "Predicted" ;
VAL_ 1091 MRR_ObjMeasured_40 0 "Init" 1 "Measured" 2 "Predicted" ;
VAL_ 1091 MRR_ObjValid_39 0 "Validvalues" 1 "invalidvalues" ;
VAL_ 1091 MRR_ObjValid_40 0 "Validvalues" 1 "invalidvalues" ;
VAL_ 1092 MRR_ObjType_41 0 "Unknown" 1 "Truck" 2 "Car" 3 "Pedestrian" 4 "Cyclist" ;
VAL_ 1092 MRR_ObjMotionType_41 0 "Int" 1 "Unknown" 2 "Drive" 3 "Stopped" 4 "Stand" ;
VAL_ 1092 MRR_ObjMotionDirection_41 0 "Init" 1 "Inversedirection" 2 "Samedirection" 3 "Cross" ;
VAL_ 1092 MRR_ObjRefPoint_41 0 "Rear" 1 "Rearleft" 2 "Left" 3 "Frontleft" 4 "Front" 5 "FrontRight" 6 "Right" 7 "Rearright" ;
VAL_ 1092 MRR_ObjRefPoint_42 0 "Rear" 1 "Rearleft" 2 "Left" 3 "Frontleft" 4 "Front" 5 "FrontRight" 6 "Right" 7 "Rearright" ;
VAL_ 1092 MRR_ObjType_42 0 "Unknown" 1 "Truck" 2 "Car" 3 "Pedestrian" 4 "Cyclist" ;
VAL_ 1092 MRR_ObjMotionType_42 0 "Int" 1 "Unknown" 2 "Drive" 3 "Stopped" 4 "Stand" ;
VAL_ 1092 MRR_ObjMotionDirection_42 0 "Init" 1 "Inversedirection" 2 "Samedirection" 3 "Cross" ;
VAL_ 1092 MRR_ObjMeasured_41 0 "Init" 1 "Measured" 2 "Predicted" ;
VAL_ 1092 MRR_ObjMeasured_42 0 "Init" 1 "Measured" 2 "Predicted" ;
VAL_ 1092 MRR_ObjValid_41 0 "Validvalues" 1 "invalidvalues" ;
VAL_ 1092 MRR_ObjValid_42 0 "Validvalues" 1 "invalidvalues" ;
VAL_ 1093 MRR_ObjType_43 0 "Unknown" 1 "Truck" 2 "Car" 3 "Pedestrian" 4 "Cyclist" ;
VAL_ 1093 MRR_ObjMotionType_43 0 "Int" 1 "Unknown" 2 "Drive" 3 "Stopped" 4 "Stand" ;
VAL_ 1093 MRR_ObjMotionDirection_43 0 "Init" 1 "Inversedirection" 2 "Samedirection" 3 "Cross" ;
VAL_ 1093 MRR_ObjRefPoint_43 0 "Rear" 1 "Rearleft" 2 "Left" 3 "Frontleft" 4 "Front" 5 "FrontRight" 6 "Right" 7 "Rearright" ;
VAL_ 1093 MRR_ObjRefPoint_44 0 "Rear" 1 "Rearleft" 2 "Left" 3 "Frontleft" 4 "Front" 5 "FrontRight" 6 "Right" 7 "Rearright" ;
VAL_ 1093 MRR_ObjType_44 0 "Unknown" 1 "Truck" 2 "Car" 3 "Pedestrian" 4 "Cyclist" ;
VAL_ 1093 MRR_ObjMotionType_44 0 "Int" 1 "Unknown" 2 "Drive" 3 "Stopped" 4 "Stand" ;
VAL_ 1093 MRR_ObjMotionDirection_44 0 "Init" 1 "Inversedirection" 2 "Samedirection" 3 "Cross" ;
VAL_ 1093 MRR_ObjMeasured_43 0 "Init" 1 "Measured" 2 "Predicted" ;
VAL_ 1093 MRR_ObjMeasured_44 0 "Init" 1 "Measured" 2 "Predicted" ;
VAL_ 1093 MRR_ObjValid_43 0 "Validvalues" 1 "invalidvalues" ;
VAL_ 1093 MRR_ObjValid_44 0 "Validvalues" 1 "invalidvalues" ;
VAL_ 1094 MRR_ObjType_45 0 "Unknown" 1 "Truck" 2 "Car" 3 "Pedestrian" 4 "Cyclist" ;
VAL_ 1094 MRR_ObjMotionType_45 0 "Int" 1 "Unknown" 2 "Drive" 3 "Stopped" 4 "Stand" ;
VAL_ 1094 MRR_ObjMotionDirection_45 0 "Init" 1 "Inversedirection" 2 "Samedirection" 3 "Cross" ;
VAL_ 1094 MRR_ObjRefPoint_45 0 "Rear" 1 "Rearleft" 2 "Left" 3 "Frontleft" 4 "Front" 5 "FrontRight" 6 "Right" 7 "Rearright" ;
VAL_ 1094 MRR_ObjRefPoint_46 0 "Rear" 1 "Rearleft" 2 "Left" 3 "Frontleft" 4 "Front" 5 "FrontRight" 6 "Right" 7 "Rearright" ;
VAL_ 1094 MRR_ObjType_46 0 "Unknown" 1 "Truck" 2 "Car" 3 "Pedestrian" 4 "Cyclist" ;
VAL_ 1094 MRR_ObjMotionType_46 0 "Int" 1 "Unknown" 2 "Drive" 3 "Stopped" 4 "Stand" ;
VAL_ 1094 MRR_ObjMotionDirection_46 0 "Init" 1 "Inversedirection" 2 "Samedirection" 3 "Cross" ;
VAL_ 1094 MRR_ObjMeasured_45 0 "Init" 1 "Measured" 2 "Predicted" ;
VAL_ 1094 MRR_ObjMeasured_46 0 "Init" 1 "Measured" 2 "Predicted" ;
VAL_ 1094 MRR_ObjValid_45 0 "Validvalues" 1 "invalidvalues" ;
VAL_ 1094 MRR_ObjValid_46 0 "Validvalues" 1 "invalidvalues" ;
VAL_ 1095 MRR_ObjType_47 0 "Unknown" 1 "Truck" 2 "Car" 3 "Pedestrian" 4 "Cyclist" ;
VAL_ 1095 MRR_ObjMotionType_47 0 "Int" 1 "Unknown" 2 "Drive" 3 "Stopped" 4 "Stand" ;
VAL_ 1095 MRR_ObjMotionDirection_47 0 "Init" 1 "Inversedirection" 2 "Samedirection" 3 "Cross" ;
VAL_ 1095 MRR_ObjRefPoint_47 0 "Rear" 1 "Rearleft" 2 "Left" 3 "Frontleft" 4 "Front" 5 "FrontRight" 6 "Right" 7 "Rearright" ;
VAL_ 1095 MRR_ObjRefPoint_48 0 "Rear" 1 "Rearleft" 2 "Left" 3 "Frontleft" 4 "Front" 5 "FrontRight" 6 "Right" 7 "Rearright" ;
VAL_ 1095 MRR_ObjType_48 0 "Unknown" 1 "Truck" 2 "Car" 3 "Pedestrian" 4 "Cyclist" ;
VAL_ 1095 MRR_ObjMotionType_48 0 "Int" 1 "Unknown" 2 "Drive" 3 "Stopped" 4 "Stand" ;
VAL_ 1095 MRR_ObjMotionDirection_48 0 "Init" 1 "Inversedirection" 2 "Samedirection" 3 "Cross" ;
VAL_ 1095 MRR_ObjMeasured_47 0 "Init" 1 "Measured" 2 "Predicted" ;
VAL_ 1095 MRR_ObjMeasured_48 0 "Init" 1 "Measured" 2 "Predicted" ;
VAL_ 1095 MRR_ObjValid_47 0 "Validvalues" 1 "invalidvalues" ;
VAL_ 1095 MRR_ObjValid_48 0 "Validvalues" 1 "invalidvalues" ;
